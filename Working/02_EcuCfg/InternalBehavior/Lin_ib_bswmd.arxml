AUTOSAR XML (schema 00048)
package /MICROSAR/Lin_Tricore
  bsw implementation Lin_Impl: programming-language=C, sw-version=15.02.00, used-code-generator=DaVinci Configurator, vendor-id=30, ar-release-version=4.00.03
package /MICROSAR/Lin_Canoeemu/Lin_ib_bswmd/BswModuleDescriptions
  bsw module description Lin
    bsw internal behavior LinBehavior
