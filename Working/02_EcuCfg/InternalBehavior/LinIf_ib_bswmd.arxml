AUTOSAR XML (schema 00048)
standard types defined: uint8
package /MICROSAR
  bsw implementation LinIf_Impl: programming-language=C, sw-version=10.00.00, used-code-generator=DaVinci Configurator, vendor-id=30, ar-release-version=4.00.03
    mc-variable-instances:
      5 x mc data instance, all with category=VALUE:
        LinIf_InitState: resulting-properties={base-type=uint8, sw-calibration-access=READ-ONLY, compu {0=LINIF_UNINIT, 165=LINIF_INIT}, range raw 0..255}, symbol=LinIf_Dev_InitDetect  # LinIf initialization state. If it has been initialized, this value is not equal to zero.
        LinIf_ChannelState_0: resulting-properties={base-type=uint8, sw-calibration-access=READ-ONLY, compu {0=LINIF_CHANNEL_UNINIT, 1=LINIF_CHANNEL_OPERATIONAL, 2=LINIF_CHANNEL_SLEEP}, range raw 0..255}, symbol=LinIf_ChannelData[0].LinIf_ChannelState  # LinIf channel state for channel 0
        LinIf_InternalStateTransition_0: resulting-properties={base-type=uint8, sw-calibration-access=READ-ONLY, compu {0=LINIF_IDLE, 1=LINIF_SLEEP_REQUESTED, 2=LINIF_SLEEP_TRANSMISSION, 3=LINIF_REWAKE, 4=LINIF_SLEEP_REQUESTED_INTERNAL, 5=LINIF_WAKEUP_TRANSMISSION}, range raw 0..255}, symbol=LinIf_ChannelData[0].LinIf_OnSleepModeFrameHandling  # LinIf internal state transition status for channel 0
        LinIf_CurrentScheduleTable_0: resulting-properties={base-type=uint8, sw-calibration-access=READ-ONLY, compu {0=LinIfConf_LinIfScheduleTable_NULLSchedule, 1=LinIfConf_LinIfScheduleTable_Diagnose_09c374bf, 2=LinIfConf_LinIfScheduleTable_Normal_48a571ca}, range raw 0..255}, symbol=LinIf_ChannelData[0].LinIf_SchedTabData.LinIf_CurrentTable  # LinIf current schedule table on channel 0
        LinIf_CurrentScheduleTableSlot_0: resulting-properties={base-type=uint8, sw-calibration-access=READ-ONLY, range raw 0..255}, symbol=LinIf_ChannelData[0].LinIf_SchedTabData.LinIf_CurrentSlot  # LinIf current processed slot in active schedule table on channel 0
