AUTOSAR XML (schema 00048)
package /MICROSAR/Cdd_AsrCdd
  bsw implementation Cdd_Impl: programming-language=C, used-code-generator=DaVinci Configurator, vendor-id=30, ar-release-version=4.00.03
    resource consumption ResourceConsumption
      memory section STARTAPPLICATIONETHCODE: prefix=STARTAPPLICATIONETH, sw-addrmethod=CODE, symbol=CODE
      section name prefix STARTAPPLICATIONETH
