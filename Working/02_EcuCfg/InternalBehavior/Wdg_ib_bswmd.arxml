AUTOSAR XML (schema 00048)
package /AURIX2G/EcucDefs/Wdg_ib_bswmd/BswModuleDescriptions
  bsw module description Wdg: provided-entrys=Wdg_17_Scu_Virtual
    bsw internal behavior WdgBehavior
      4 x exclusive area:
        TimerHandling
        ChangeMode
        Trigger
        CpuEndInit
      bsw called entity Wdg_17_Scu_Virtual: can-enter-exclusive-area=[TimerHandling, ChangeMode, Trigger, CpuEndInit], implemented-entry=Wdg_17_Scu_Virtual
