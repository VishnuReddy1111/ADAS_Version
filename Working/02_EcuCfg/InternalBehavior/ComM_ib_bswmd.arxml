[part 2 of 2: packages /MICROSAR to /MICROSAR/ComM_ib_bswmd/DataTypes/CompuMethods]
AUTOSAR XML (schema 4-3-0)
package /MICROSAR  (continued)
  bsw implementation ComM_Impl: programming-language=C, sw-version=16.00.01, used-code-generator=DaVinci Configurator, vendor-id=30, ar-release-version=4.00.03  (continued)
    mc-variable-instances:  (continued)
      77 x mc data instance, all with category=ARRAY:  (continued)
        ComM_User: array-size=50  # Information about ComM users
          50 x mc data instance, all with category=STRUCTURE:
            Element_0: symbol=[0]
              6 x mc data instance, all with category=VALUE:
                PncUserOfUser: resulting-properties={base-type=boolean, sw-calibration-access=READ-ONLY, compu {0=FALSE, 1..255=TRUE}, range raw 0..1}
                UserByteMaskEndIdxOfUser: resulting-properties={base-type=uint8, sw-calibration-access=READ-ONLY, compu {255=COMM_NO_USERBYTEMASKENDIDXOFUSER}, range raw 0..255}
                UserByteMaskStartIdxOfUser: resulting-properties={base-type=uint8, sw-calibration-access=READ-ONLY, compu {255=COMM_NO_USERBYTEMASKSTARTIDXOFUSER}, range raw 0..255}
                UserPncByteMaskEndIdxOfUser: resulting-properties={base-type=uint8, sw-calibration-access=READ-ONLY, compu {255=COMM_NO_USERPNCBYTEMASKENDIDXOFUSER}, range raw 0..255}
                UserPncByteMaskLengthOfUser: resulting-properties={base-type=uint8, sw-calibration-access=READ-ONLY, range raw 0..255}
                UserPncByteMaskStartIdxOfUser: resulting-properties={base-type=uint8, sw-calibration-access=READ-ONLY, compu {255=COMM_NO_USERPNCBYTEMASKSTARTIDXOFUSER}, range raw 0..255}
            Element_1: symbol=[1]
              6 x mc data instance, all with category=VALUE:
                PncUserOfUser: resulting-properties={base-type=boolean, sw-calibration-access=READ-ONLY, compu {0=FALSE, 1..255=TRUE}, range raw 0..1}
                UserByteMaskEndIdxOfUser: resulting-properties={base-type=uint8, sw-calibration-access=READ-ONLY, compu {255=COMM_NO_USERBYTEMASKENDIDXOFUSER}, range raw 0..255}
                UserByteMaskStartIdxOfUser: resulting-properties={base-type=uint8, sw-calibration-access=READ-ONLY, compu {255=COMM_NO_USERBYTEMASKSTARTIDXOFUSER}, range raw 0..255}
                UserPncByteMaskEndIdxOfUser: resulting-properties={base-type=uint8, sw-calibration-access=READ-ONLY, compu {255=COMM_NO_USERPNCBYTEMASKENDIDXOFUSER}, range raw 0..255}
                UserPncByteMaskLengthOfUser: resulting-properties={base-type=uint8, sw-calibration-access=READ-ONLY, range raw 0..255}
                UserPncByteMaskStartIdxOfUser: resulting-properties={base-type=uint8, sw-calibration-access=READ-ONLY, compu {255=COMM_NO_USERPNCBYTEMASKSTARTIDXOFUSER}, range raw 0..255}
            Element_2: symbol=[2]
              6 x mc data instance, all with category=VALUE:
                PncUserOfUser: resulting-properties={base-type=boolean, sw-calibration-access=READ-ONLY, compu {0=FALSE, 1..255=TRUE}, range raw 0..1}
                UserByteMaskEndIdxOfUser: resulting-properties={base-type=uint8, sw-calibration-access=READ-ONLY, compu {255=COMM_NO_USERBYTEMASKENDIDXOFUSER}, range raw 0..255}
                UserByteMaskStartIdxOfUser: resulting-properties={base-type=uint8, sw-calibration-access=READ-ONLY, compu {255=COMM_NO_USERBYTEMASKSTARTIDXOFUSER}, range raw 0..255}
                UserPncByteMaskEndIdxOfUser: resulting-properties={base-type=uint8, sw-calibration-access=READ-ONLY, compu {255=COMM_NO_USERPNCBYTEMASKENDIDXOFUSER}, range raw 0..255}
                UserPncByteMaskLengthOfUser: resulting-properties={base-type=uint8, sw-calibration-access=READ-ONLY, range raw 0..255}
                UserPncByteMaskStartIdxOfUser: resulting-properties={base-type=uint8, sw-calibration-access=READ-ONLY, compu {255=COMM_NO_USERPNCBYTEMASKSTARTIDXOFUSER}, range raw 0..255}
            Element_3: symbol=[3]
              6 x mc data instance, all with category=VALUE:
                PncUserOfUser: resulting-properties={base-type=boolean, sw-calibration-access=READ-ONLY, compu {0=FALSE, 1..255=TRUE}, range raw 0..1}
                UserByteMaskEndIdxOfUser: resulting-properties={base-type=uint8, sw-calibration-access=READ-ONLY, compu {255=COMM_NO_USERBYTEMASKENDIDXOFUSER}, range raw 0..255}
                UserByteMaskStartIdxOfUser: resulting-properties={base-type=uint8, sw-calibration-access=READ-ONLY, compu {255=COMM_NO_USERBYTEMASKSTARTIDXOFUSER}, range raw 0..255}
                UserPncByteMaskEndIdxOfUser: resulting-properties={base-type=uint8, sw-calibration-access=READ-ONLY, compu {255=COMM_NO_USERPNCBYTEMASKENDIDXOFUSER}, range raw 0..255}
                UserPncByteMaskLengthOfUser: resulting-properties={base-type=uint8, sw-calibration-access=READ-ONLY, range raw 0..255}
                UserPncByteMaskStartIdxOfUser: resulting-properties={base-type=uint8, sw-calibration-access=READ-ONLY, compu {255=COMM_NO_USERPNCBYTEMASKSTARTIDXOFUSER}, range raw 0..255}
            Element_4: symbol=[4]
              6 x mc data instance, all with category=VALUE:
                PncUserOfUser: resulting-properties={base-type=boolean, sw-calibration-access=READ-ONLY, compu {0=FALSE, 1..255=TRUE}, range raw 0..1}
                UserByteMaskEndIdxOfUser: resulting-properties={base-type=uint8, sw-calibration-access=READ-ONLY, compu {255=COMM_NO_USERBYTEMASKENDIDXOFUSER}, range raw 0..255}
                UserByteMaskStartIdxOfUser: resulting-properties={base-type=uint8, sw-calibration-access=READ-ONLY, compu {255=COMM_NO_USERBYTEMASKSTARTIDXOFUSER}, range raw 0..255}
                UserPncByteMaskEndIdxOfUser: resulting-properties={base-type=uint8, sw-calibration-access=READ-ONLY, compu {255=COMM_NO_USERPNCBYTEMASKENDIDXOFUSER}, range raw 0..255}
                UserPncByteMaskLengthOfUser: resulting-properties={base-type=uint8, sw-calibration-access=READ-ONLY, range raw 0..255}
                UserPncByteMaskStartIdxOfUser: resulting-properties={base-type=uint8, sw-calibration-access=READ-ONLY, compu {255=COMM_NO_USERPNCBYTEMASKSTARTIDXOFUSER}, range raw 0..255}
            Element_5: symbol=[5]
              6 x mc data instance, all with category=VALUE:
                PncUserOfUser: resulting-properties={base-type=boolean, sw-calibration-access=READ-ONLY, compu {0=FALSE, 1..255=TRUE}, range raw 0..1}
                UserByteMaskEndIdxOfUser: resulting-properties={base-type=uint8, sw-calibration-access=READ-ONLY, compu {255=COMM_NO_USERBYTEMASKENDIDXOFUSER}, range raw 0..255}
                UserByteMaskStartIdxOfUser: resulting-properties={base-type=uint8, sw-calibration-access=READ-ONLY, compu {255=COMM_NO_USERBYTEMASKSTARTIDXOFUSER}, range raw 0..255}
                UserPncByteMaskEndIdxOfUser: resulting-properties={base-type=uint8, sw-calibration-access=READ-ONLY, compu {255=COMM_NO_USERPNCBYTEMASKENDIDXOFUSER}, range raw 0..255}
                UserPncByteMaskLengthOfUser: resulting-properties={base-type=uint8, sw-calibration-access=READ-ONLY, range raw 0..255}
                UserPncByteMaskStartIdxOfUser: resulting-properties={base-type=uint8, sw-calibration-access=READ-ONLY, compu {255=COMM_NO_USERPNCBYTEMASKSTARTIDXOFUSER}, range raw 0..255}
            Element_6: symbol=[6]
              6 x mc data instance, all with category=VALUE:
                PncUserOfUser: resulting-properties={base-type=boolean, sw-calibration-access=READ-ONLY, compu {0=FALSE, 1..255=TRUE}, range raw 0..1}
                UserByteMaskEndIdxOfUser: resulting-properties={base-type=uint8, sw-calibration-access=READ-ONLY, compu {255=COMM_NO_USERBYTEMASKENDIDXOFUSER}, range raw 0..255}
                UserByteMaskStartIdxOfUser: resulting-properties={base-type=uint8, sw-calibration-access=READ-ONLY, compu {255=COMM_NO_USERBYTEMASKSTARTIDXOFUSER}, range raw 0..255}
                UserPncByteMaskEndIdxOfUser: resulting-properties={base-type=uint8, sw-calibration-access=READ-ONLY, compu {255=COMM_NO_USERPNCBYTEMASKENDIDXOFUSER}, range raw 0..255}
                UserPncByteMaskLengthOfUser: resulting-properties={base-type=uint8, sw-calibration-access=READ-ONLY, range raw 0..255}
                UserPncByteMaskStartIdxOfUser: resulting-properties={base-type=uint8, sw-calibration-access=READ-ONLY, compu {255=COMM_NO_USERPNCBYTEMASKSTARTIDXOFUSER}, range raw 0..255}
            Element_7: symbol=[7]
              6 x mc data instance, all with category=VALUE:
                PncUserOfUser: resulting-properties={base-type=boolean, sw-calibration-access=READ-ONLY, compu {0=FALSE, 1..255=TRUE}, range raw 0..1}
                UserByteMaskEndIdxOfUser: resulting-properties={base-type=uint8, sw-calibration-access=READ-ONLY, compu {255=COMM_NO_USERBYTEMASKENDIDXOFUSER}, range raw 0..255}
                UserByteMaskStartIdxOfUser: resulting-properties={base-type=uint8, sw-calibration-access=READ-ONLY, compu {255=COMM_NO_USERBYTEMASKSTARTIDXOFUSER}, range raw 0..255}
                UserPncByteMaskEndIdxOfUser: resulting-properties={base-type=uint8, sw-calibration-access=READ-ONLY, compu {255=COMM_NO_USERPNCBYTEMASKENDIDXOFUSER}, range raw 0..255}
                UserPncByteMaskLengthOfUser: resulting-properties={base-type=uint8, sw-calibration-access=READ-ONLY, range raw 0..255}
                UserPncByteMaskStartIdxOfUser: resulting-properties={base-type=uint8, sw-calibration-access=READ-ONLY, compu {255=COMM_NO_USERPNCBYTEMASKSTARTIDXOFUSER}, range raw 0..255}
            Element_8: symbol=[8]
              6 x mc data instance, all with category=VALUE:
                PncUserOfUser: resulting-properties={base-type=boolean, sw-calibration-access=READ-ONLY, compu {0=FALSE, 1..255=TRUE}, range raw 0..1}
                UserByteMaskEndIdxOfUser: resulting-properties={base-type=uint8, sw-calibration-access=READ-ONLY, compu {255=COMM_NO_USERBYTEMASKENDIDXOFUSER}, range raw 0..255}
                UserByteMaskStartIdxOfUser: resulting-properties={base-type=uint8, sw-calibration-access=READ-ONLY, compu {255=COMM_NO_USERBYTEMASKSTARTIDXOFUSER}, range raw 0..255}
                UserPncByteMaskEndIdxOfUser: resulting-properties={base-type=uint8, sw-calibration-access=READ-ONLY, compu {255=COMM_NO_USERPNCBYTEMASKENDIDXOFUSER}, range raw 0..255}
                UserPncByteMaskLengthOfUser: resulting-properties={base-type=uint8, sw-calibration-access=READ-ONLY, range raw 0..255}
                UserPncByteMaskStartIdxOfUser: resulting-properties={base-type=uint8, sw-calibration-access=READ-ONLY, compu {255=COMM_NO_USERPNCBYTEMASKSTARTIDXOFUSER}, range raw 0..255}
            Element_9: symbol=[9]
              6 x mc data instance, all with category=VALUE:
                PncUserOfUser: resulting-properties={base-type=boolean, sw-calibration-access=READ-ONLY, compu {0=FALSE, 1..255=TRUE}, range raw 0..1}
                UserByteMaskEndIdxOfUser: resulting-properties={base-type=uint8, sw-calibration-access=READ-ONLY, compu {255=COMM_NO_USERBYTEMASKENDIDXOFUSER}, range raw 0..255}
                UserByteMaskStartIdxOfUser: resulting-properties={base-type=uint8, sw-calibration-access=READ-ONLY, compu {255=COMM_NO_USERBYTEMASKSTARTIDXOFUSER}, range raw 0..255}
                UserPncByteMaskEndIdxOfUser: resulting-properties={base-type=uint8, sw-calibration-access=READ-ONLY, compu {255=COMM_NO_USERPNCBYTEMASKENDIDXOFUSER}, range raw 0..255}
                UserPncByteMaskLengthOfUser: resulting-properties={base-type=uint8, sw-calibration-access=READ-ONLY, range raw 0..255}
                UserPncByteMaskStartIdxOfUser: resulting-properties={base-type=uint8, sw-calibration-access=READ-ONLY, compu {255=COMM_NO_USERPNCBYTEMASKSTARTIDXOFUSER}, range raw 0..255}
            Element_10: symbol=[10]
              6 x mc data instance, all with category=VALUE:
                PncUserOfUser: resulting-properties={base-type=boolean, sw-calibration-access=READ-ONLY, compu {0=FALSE, 1..255=TRUE}, range raw 0..1}
                UserByteMaskEndIdxOfUser: resulting-properties={base-type=uint8, sw-calibration-access=READ-ONLY, compu {255=COMM_NO_USERBYTEMASKENDIDXOFUSER}, range raw 0..255}
                UserByteMaskStartIdxOfUser: resulting-properties={base-type=uint8, sw-calibration-access=READ-ONLY, compu {255=COMM_NO_USERBYTEMASKSTARTIDXOFUSER}, range raw 0..255}
                UserPncByteMaskEndIdxOfUser: resulting-properties={base-type=uint8, sw-calibration-access=READ-ONLY, compu {255=COMM_NO_USERPNCBYTEMASKENDIDXOFUSER}, range raw 0..255}
                UserPncByteMaskLengthOfUser: resulting-properties={base-type=uint8, sw-calibration-access=READ-ONLY, range raw 0..255}
                UserPncByteMaskStartIdxOfUser: resulting-properties={base-type=uint8, sw-calibration-access=READ-ONLY, compu {255=COMM_NO_USERPNCBYTEMASKSTARTIDXOFUSER}, range raw 0..255}
            Element_11: symbol=[11]
              6 x mc data instance, all with category=VALUE:
                PncUserOfUser: resulting-properties={base-type=boolean, sw-calibration-access=READ-ONLY, compu {0=FALSE, 1..255=TRUE}, range raw 0..1}
                UserByteMaskEndIdxOfUser: resulting-properties={base-type=uint8, sw-calibration-access=READ-ONLY, compu {255=COMM_NO_USERBYTEMASKENDIDXOFUSER}, range raw 0..255}
                UserByteMaskStartIdxOfUser: resulting-properties={base-type=uint8, sw-calibration-access=READ-ONLY, compu {255=COMM_NO_USERBYTEMASKSTARTIDXOFUSER}, range raw 0..255}
                UserPncByteMaskEndIdxOfUser: resulting-properties={base-type=uint8, sw-calibration-access=READ-ONLY, compu {255=COMM_NO_USERPNCBYTEMASKENDIDXOFUSER}, range raw 0..255}
                UserPncByteMaskLengthOfUser: resulting-properties={base-type=uint8, sw-calibration-access=READ-ONLY, range raw 0..255}
                UserPncByteMaskStartIdxOfUser: resulting-properties={base-type=uint8, sw-calibration-access=READ-ONLY, compu {255=COMM_NO_USERPNCBYTEMASKSTARTIDXOFUSER}, range raw 0..255}
            Element_12: symbol=[12]
              6 x mc data instance, all with category=VALUE:
                PncUserOfUser: resulting-properties={base-type=boolean, sw-calibration-access=READ-ONLY, compu {0=FALSE, 1..255=TRUE}, range raw 0..1}
                UserByteMaskEndIdxOfUser: resulting-properties={base-type=uint8, sw-calibration-access=READ-ONLY, compu {255=COMM_NO_USERBYTEMASKENDIDXOFUSER}, range raw 0..255}
                UserByteMaskStartIdxOfUser: resulting-properties={base-type=uint8, sw-calibration-access=READ-ONLY, compu {255=COMM_NO_USERBYTEMASKSTARTIDXOFUSER}, range raw 0..255}
                UserPncByteMaskEndIdxOfUser: resulting-properties={base-type=uint8, sw-calibration-access=READ-ONLY, compu {255=COMM_NO_USERPNCBYTEMASKENDIDXOFUSER}, range raw 0..255}
                UserPncByteMaskLengthOfUser: resulting-properties={base-type=uint8, sw-calibration-access=READ-ONLY, range raw 0..255}
                UserPncByteMaskStartIdxOfUser: resulting-properties={base-type=uint8, sw-calibration-access=READ-ONLY, compu {255=COMM_NO_USERPNCBYTEMASKSTARTIDXOFUSER}, range raw 0..255}
            Element_13: symbol=[13]
              6 x mc data instance, all with category=VALUE:
                PncUserOfUser: resulting-properties={base-type=boolean, sw-calibration-access=READ-ONLY, compu {0=FALSE, 1..255=TRUE}, range raw 0..1}
                UserByteMaskEndIdxOfUser: resulting-properties={base-type=uint8, sw-calibration-access=READ-ONLY, compu {255=COMM_NO_USERBYTEMASKENDIDXOFUSER}, range raw 0..255}
                UserByteMaskStartIdxOfUser: resulting-properties={base-type=uint8, sw-calibration-access=READ-ONLY, compu {255=COMM_NO_USERBYTEMASKSTARTIDXOFUSER}, range raw 0..255}
                UserPncByteMaskEndIdxOfUser: resulting-properties={base-type=uint8, sw-calibration-access=READ-ONLY, compu {255=COMM_NO_USERPNCBYTEMASKENDIDXOFUSER}, range raw 0..255}
                UserPncByteMaskLengthOfUser: resulting-properties={base-type=uint8, sw-calibration-access=READ-ONLY, range raw 0..255}
                UserPncByteMaskStartIdxOfUser: resulting-properties={base-type=uint8, sw-calibration-access=READ-ONLY, compu {255=COMM_NO_USERPNCBYTEMASKSTARTIDXOFUSER}, range raw 0..255}
            Element_14: symbol=[14]
              6 x mc data instance, all with category=VALUE:
                PncUserOfUser: resulting-properties={base-type=boolean, sw-calibration-access=READ-ONLY, compu {0=FALSE, 1..255=TRUE}, range raw 0..1}
                UserByteMaskEndIdxOfUser: resulting-properties={base-type=uint8, sw-calibration-access=READ-ONLY, compu {255=COMM_NO_USERBYTEMASKENDIDXOFUSER}, range raw 0..255}
                UserByteMaskStartIdxOfUser: resulting-properties={base-type=uint8, sw-calibration-access=READ-ONLY, compu {255=COMM_NO_USERBYTEMASKSTARTIDXOFUSER}, range raw 0..255}
                UserPncByteMaskEndIdxOfUser: resulting-properties={base-type=uint8, sw-calibration-access=READ-ONLY, compu {255=COMM_NO_USERPNCBYTEMASKENDIDXOFUSER}, range raw 0..255}
                UserPncByteMaskLengthOfUser: resulting-properties={base-type=uint8, sw-calibration-access=READ-ONLY, range raw 0..255}
                UserPncByteMaskStartIdxOfUser: resulting-properties={base-type=uint8, sw-calibration-access=READ-ONLY, compu {255=COMM_NO_USERPNCBYTEMASKSTARTIDXOFUSER}, range raw 0..255}
            Element_15: symbol=[15]
              6 x mc data instance, all with category=VALUE:
                PncUserOfUser: resulting-properties={base-type=boolean, sw-calibration-access=READ-ONLY, compu {0=FALSE, 1..255=TRUE}, range raw 0..1}
                UserByteMaskEndIdxOfUser: resulting-properties={base-type=uint8, sw-calibration-access=READ-ONLY, compu {255=COMM_NO_USERBYTEMASKENDIDXOFUSER}, range raw 0..255}
                UserByteMaskStartIdxOfUser: resulting-properties={base-type=uint8, sw-calibration-access=READ-ONLY, compu {255=COMM_NO_USERBYTEMASKSTARTIDXOFUSER}, range raw 0..255}
                UserPncByteMaskEndIdxOfUser: resulting-properties={base-type=uint8, sw-calibration-access=READ-ONLY, compu {255=COMM_NO_USERPNCBYTEMASKENDIDXOFUSER}, range raw 0..255}
                UserPncByteMaskLengthOfUser: resulting-properties={base-type=uint8, sw-calibration-access=READ-ONLY, range raw 0..255}
                UserPncByteMaskStartIdxOfUser: resulting-properties={base-type=uint8, sw-calibration-access=READ-ONLY, compu {255=COMM_NO_USERPNCBYTEMASKSTARTIDXOFUSER}, range raw 0..255}
            Element_16: symbol=[16]
              6 x mc data instance, all with category=VALUE:
                PncUserOfUser: resulting-properties={base-type=boolean, sw-calibration-access=READ-ONLY, compu {0=FALSE, 1..255=TRUE}, range raw 0..1}
                UserByteMaskEndIdxOfUser: resulting-properties={base-type=uint8, sw-calibration-access=READ-ONLY, compu {255=COMM_NO_USERBYTEMASKENDIDXOFUSER}, range raw 0..255}
                UserByteMaskStartIdxOfUser: resulting-properties={base-type=uint8, sw-calibration-access=READ-ONLY, compu {255=COMM_NO_USERBYTEMASKSTARTIDXOFUSER}, range raw 0..255}
                UserPncByteMaskEndIdxOfUser: resulting-properties={base-type=uint8, sw-calibration-access=READ-ONLY, compu {255=COMM_NO_USERPNCBYTEMASKENDIDXOFUSER}, range raw 0..255}
                UserPncByteMaskLengthOfUser: resulting-properties={base-type=uint8, sw-calibration-access=READ-ONLY, range raw 0..255}
                UserPncByteMaskStartIdxOfUser: resulting-properties={base-type=uint8, sw-calibration-access=READ-ONLY, compu {255=COMM_NO_USERPNCBYTEMASKSTARTIDXOFUSER}, range raw 0..255}
            Element_17: symbol=[17]
              6 x mc data instance, all with category=VALUE:
                PncUserOfUser: resulting-properties={base-type=boolean, sw-calibration-access=READ-ONLY, compu {0=FALSE, 1..255=TRUE}, range raw 0..1}
                UserByteMaskEndIdxOfUser: resulting-properties={base-type=uint8, sw-calibration-access=READ-ONLY, compu {255=COMM_NO_USERBYTEMASKENDIDXOFUSER}, range raw 0..255}
                UserByteMaskStartIdxOfUser: resulting-properties={base-type=uint8, sw-calibration-access=READ-ONLY, compu {255=COMM_NO_USERBYTEMASKSTARTIDXOFUSER}, range raw 0..255}
                UserPncByteMaskEndIdxOfUser: resulting-properties={base-type=uint8, sw-calibration-access=READ-ONLY, compu {255=COMM_NO_USERPNCBYTEMASKENDIDXOFUSER}, range raw 0..255}
                UserPncByteMaskLengthOfUser: resulting-properties={base-type=uint8, sw-calibration-access=READ-ONLY, range raw 0..255}
                UserPncByteMaskStartIdxOfUser: resulting-properties={base-type=uint8, sw-calibration-access=READ-ONLY, compu {255=COMM_NO_USERPNCBYTEMASKSTARTIDXOFUSER}, range raw 0..255}
            Element_18: symbol=[18]
              6 x mc data instance, all with category=VALUE:
                PncUserOfUser: resulting-properties={base-type=boolean, sw-calibration-access=READ-ONLY, compu {0=FALSE, 1..255=TRUE}, range raw 0..1}
                UserByteMaskEndIdxOfUser: resulting-properties={base-type=uint8, sw-calibration-access=READ-ONLY, compu {255=COMM_NO_USERBYTEMASKENDIDXOFUSER}, range raw 0..255}
                UserByteMaskStartIdxOfUser: resulting-properties={base-type=uint8, sw-calibration-access=READ-ONLY, compu {255=COMM_NO_USERBYTEMASKSTARTIDXOFUSER}, range raw 0..255}
                UserPncByteMaskEndIdxOfUser: resulting-properties={base-type=uint8, sw-calibration-access=READ-ONLY, compu {255=COMM_NO_USERPNCBYTEMASKENDIDXOFUSER}, range raw 0..255}
                UserPncByteMaskLengthOfUser: resulting-properties={base-type=uint8, sw-calibration-access=READ-ONLY, range raw 0..255}
                UserPncByteMaskStartIdxOfUser: resulting-properties={base-type=uint8, sw-calibration-access=READ-ONLY, compu {255=COMM_NO_USERPNCBYTEMASKSTARTIDXOFUSER}, range raw 0..255}
            Element_19: symbol=[19]
              6 x mc data instance, all with category=VALUE:
                PncUserOfUser: resulting-properties={base-type=boolean, sw-calibration-access=READ-ONLY, compu {0=FALSE, 1..255=TRUE}, range raw 0..1}
                UserByteMaskEndIdxOfUser: resulting-properties={base-type=uint8, sw-calibration-access=READ-ONLY, compu {255=COMM_NO_USERBYTEMASKENDIDXOFUSER}, range raw 0..255}
                UserByteMaskStartIdxOfUser: resulting-properties={base-type=uint8, sw-calibration-access=READ-ONLY, compu {255=COMM_NO_USERBYTEMASKSTARTIDXOFUSER}, range raw 0..255}
                UserPncByteMaskEndIdxOfUser: resulting-properties={base-type=uint8, sw-calibration-access=READ-ONLY, compu {255=COMM_NO_USERPNCBYTEMASKENDIDXOFUSER}, range raw 0..255}
                UserPncByteMaskLengthOfUser: resulting-properties={base-type=uint8, sw-calibration-access=READ-ONLY, range raw 0..255}
                UserPncByteMaskStartIdxOfUser: resulting-properties={base-type=uint8, sw-calibration-access=READ-ONLY, compu {255=COMM_NO_USERPNCBYTEMASKSTARTIDXOFUSER}, range raw 0..255}
            Element_20: symbol=[20]
              6 x mc data instance, all with category=VALUE:
                PncUserOfUser: resulting-properties={base-type=boolean, sw-calibration-access=READ-ONLY, compu {0=FALSE, 1..255=TRUE}, range raw 0..1}
                UserByteMaskEndIdxOfUser: resulting-properties={base-type=uint8, sw-calibration-access=READ-ONLY, compu {255=COMM_NO_USERBYTEMASKENDIDXOFUSER}, range raw 0..255}
                UserByteMaskStartIdxOfUser: resulting-properties={base-type=uint8, sw-calibration-access=READ-ONLY, compu {255=COMM_NO_USERBYTEMASKSTARTIDXOFUSER}, range raw 0..255}
                UserPncByteMaskEndIdxOfUser: resulting-properties={base-type=uint8, sw-calibration-access=READ-ONLY, compu {255=COMM_NO_USERPNCBYTEMASKENDIDXOFUSER}, range raw 0..255}
                UserPncByteMaskLengthOfUser: resulting-properties={base-type=uint8, sw-calibration-access=READ-ONLY, range raw 0..255}
                UserPncByteMaskStartIdxOfUser: resulting-properties={base-type=uint8, sw-calibration-access=READ-ONLY, compu {255=COMM_NO_USERPNCBYTEMASKSTARTIDXOFUSER}, range raw 0..255}
            Element_21: symbol=[21]
              6 x mc data instance, all with category=VALUE:
                PncUserOfUser: resulting-properties={base-type=boolean, sw-calibration-access=READ-ONLY, compu {0=FALSE, 1..255=TRUE}, range raw 0..1}
                UserByteMaskEndIdxOfUser: resulting-properties={base-type=uint8, sw-calibration-access=READ-ONLY, compu {255=COMM_NO_USERBYTEMASKENDIDXOFUSER}, range raw 0..255}
                UserByteMaskStartIdxOfUser: resulting-properties={base-type=uint8, sw-calibration-access=READ-ONLY, compu {255=COMM_NO_USERBYTEMASKSTARTIDXOFUSER}, range raw 0..255}
                UserPncByteMaskEndIdxOfUser: resulting-properties={base-type=uint8, sw-calibration-access=READ-ONLY, compu {255=COMM_NO_USERPNCBYTEMASKENDIDXOFUSER}, range raw 0..255}
                UserPncByteMaskLengthOfUser: resulting-properties={base-type=uint8, sw-calibration-access=READ-ONLY, range raw 0..255}
                UserPncByteMaskStartIdxOfUser: resulting-properties={base-type=uint8, sw-calibration-access=READ-ONLY, compu {255=COMM_NO_USERPNCBYTEMASKSTARTIDXOFUSER}, range raw 0..255}
            Element_22: symbol=[22]
              6 x mc data instance, all with category=VALUE:
                PncUserOfUser: resulting-properties={base-type=boolean, sw-calibration-access=READ-ONLY, compu {0=FALSE, 1..255=TRUE}, range raw 0..1}
                UserByteMaskEndIdxOfUser: resulting-properties={base-type=uint8, sw-calibration-access=READ-ONLY, compu {255=COMM_NO_USERBYTEMASKENDIDXOFUSER}, range raw 0..255}
                UserByteMaskStartIdxOfUser: resulting-properties={base-type=uint8, sw-calibration-access=READ-ONLY, compu {255=COMM_NO_USERBYTEMASKSTARTIDXOFUSER}, range raw 0..255}
                UserPncByteMaskEndIdxOfUser: resulting-properties={base-type=uint8, sw-calibration-access=READ-ONLY, compu {255=COMM_NO_USERPNCBYTEMASKENDIDXOFUSER}, range raw 0..255}
                UserPncByteMaskLengthOfUser: resulting-properties={base-type=uint8, sw-calibration-access=READ-ONLY, range raw 0..255}
                UserPncByteMaskStartIdxOfUser: resulting-properties={base-type=uint8, sw-calibration-access=READ-ONLY, compu {255=COMM_NO_USERPNCBYTEMASKSTARTIDXOFUSER}, range raw 0..255}
            Element_23: symbol=[23]
              6 x mc data instance, all with category=VALUE:
                PncUserOfUser: resulting-properties={base-type=boolean, sw-calibration-access=READ-ONLY, compu {0=FALSE, 1..255=TRUE}, range raw 0..1}
                UserByteMaskEndIdxOfUser: resulting-properties={base-type=uint8, sw-calibration-access=READ-ONLY, compu {255=COMM_NO_USERBYTEMASKENDIDXOFUSER}, range raw 0..255}
                UserByteMaskStartIdxOfUser: resulting-properties={base-type=uint8, sw-calibration-access=READ-ONLY, compu {255=COMM_NO_USERBYTEMASKSTARTIDXOFUSER}, range raw 0..255}
                UserPncByteMaskEndIdxOfUser: resulting-properties={base-type=uint8, sw-calibration-access=READ-ONLY, compu {255=COMM_NO_USERPNCBYTEMASKENDIDXOFUSER}, range raw 0..255}
                UserPncByteMaskLengthOfUser: resulting-properties={base-type=uint8, sw-calibration-access=READ-ONLY, range raw 0..255}
                UserPncByteMaskStartIdxOfUser: resulting-properties={base-type=uint8, sw-calibration-access=READ-ONLY, compu {255=COMM_NO_USERPNCBYTEMASKSTARTIDXOFUSER}, range raw 0..255}
            Element_24: symbol=[24]
              6 x mc data instance, all with category=VALUE:
                PncUserOfUser: resulting-properties={base-type=boolean, sw-calibration-access=READ-ONLY, compu {0=FALSE, 1..255=TRUE}, range raw 0..1}
                UserByteMaskEndIdxOfUser: resulting-properties={base-type=uint8, sw-calibration-access=READ-ONLY, compu {255=COMM_NO_USERBYTEMASKENDIDXOFUSER}, range raw 0..255}
                UserByteMaskStartIdxOfUser: resulting-properties={base-type=uint8, sw-calibration-access=READ-ONLY, compu {255=COMM_NO_USERBYTEMASKSTARTIDXOFUSER}, range raw 0..255}
                UserPncByteMaskEndIdxOfUser: resulting-properties={base-type=uint8, sw-calibration-access=READ-ONLY, compu {255=COMM_NO_USERPNCBYTEMASKENDIDXOFUSER}, range raw 0..255}
                UserPncByteMaskLengthOfUser: resulting-properties={base-type=uint8, sw-calibration-access=READ-ONLY, range raw 0..255}
                UserPncByteMaskStartIdxOfUser: resulting-properties={base-type=uint8, sw-calibration-access=READ-ONLY, compu {255=COMM_NO_USERPNCBYTEMASKSTARTIDXOFUSER}, range raw 0..255}
            Element_25: symbol=[25]
              6 x mc data instance, all with category=VALUE:
                PncUserOfUser: resulting-properties={base-type=boolean, sw-calibration-access=READ-ONLY, compu {0=FALSE, 1..255=TRUE}, range raw 0..1}
                UserByteMaskEndIdxOfUser: resulting-properties={base-type=uint8, sw-calibration-access=READ-ONLY, compu {255=COMM_NO_USERBYTEMASKENDIDXOFUSER}, range raw 0..255}
                UserByteMaskStartIdxOfUser: resulting-properties={base-type=uint8, sw-calibration-access=READ-ONLY, compu {255=COMM_NO_USERBYTEMASKSTARTIDXOFUSER}, range raw 0..255}
                UserPncByteMaskEndIdxOfUser: resulting-properties={base-type=uint8, sw-calibration-access=READ-ONLY, compu {255=COMM_NO_USERPNCBYTEMASKENDIDXOFUSER}, range raw 0..255}
                UserPncByteMaskLengthOfUser: resulting-properties={base-type=uint8, sw-calibration-access=READ-ONLY, range raw 0..255}
                UserPncByteMaskStartIdxOfUser: resulting-properties={base-type=uint8, sw-calibration-access=READ-ONLY, compu {255=COMM_NO_USERPNCBYTEMASKSTARTIDXOFUSER}, range raw 0..255}
            Element_26: symbol=[26]
              6 x mc data instance, all with category=VALUE:
                PncUserOfUser: resulting-properties={base-type=boolean, sw-calibration-access=READ-ONLY, compu {0=FALSE, 1..255=TRUE}, range raw 0..1}
                UserByteMaskEndIdxOfUser: resulting-properties={base-type=uint8, sw-calibration-access=READ-ONLY, compu {255=COMM_NO_USERBYTEMASKENDIDXOFUSER}, range raw 0..255}
                UserByteMaskStartIdxOfUser: resulting-properties={base-type=uint8, sw-calibration-access=READ-ONLY, compu {255=COMM_NO_USERBYTEMASKSTARTIDXOFUSER}, range raw 0..255}
                UserPncByteMaskEndIdxOfUser: resulting-properties={base-type=uint8, sw-calibration-access=READ-ONLY, compu {255=COMM_NO_USERPNCBYTEMASKENDIDXOFUSER}, range raw 0..255}
                UserPncByteMaskLengthOfUser: resulting-properties={base-type=uint8, sw-calibration-access=READ-ONLY, range raw 0..255}
                UserPncByteMaskStartIdxOfUser: resulting-properties={base-type=uint8, sw-calibration-access=READ-ONLY, compu {255=COMM_NO_USERPNCBYTEMASKSTARTIDXOFUSER}, range raw 0..255}
            Element_27: symbol=[27]
              6 x mc data instance, all with category=VALUE:
                PncUserOfUser: resulting-properties={base-type=boolean, sw-calibration-access=READ-ONLY, compu {0=FALSE, 1..255=TRUE}, range raw 0..1}
                UserByteMaskEndIdxOfUser: resulting-properties={base-type=uint8, sw-calibration-access=READ-ONLY, compu {255=COMM_NO_USERBYTEMASKENDIDXOFUSER}, range raw 0..255}
                UserByteMaskStartIdxOfUser: resulting-properties={base-type=uint8, sw-calibration-access=READ-ONLY, compu {255=COMM_NO_USERBYTEMASKSTARTIDXOFUSER}, range raw 0..255}
                UserPncByteMaskEndIdxOfUser: resulting-properties={base-type=uint8, sw-calibration-access=READ-ONLY, compu {255=COMM_NO_USERPNCBYTEMASKENDIDXOFUSER}, range raw 0..255}
                UserPncByteMaskLengthOfUser: resulting-properties={base-type=uint8, sw-calibration-access=READ-ONLY, range raw 0..255}
                UserPncByteMaskStartIdxOfUser: resulting-properties={base-type=uint8, sw-calibration-access=READ-ONLY, compu {255=COMM_NO_USERPNCBYTEMASKSTARTIDXOFUSER}, range raw 0..255}
            Element_28: symbol=[28]
              6 x mc data instance, all with category=VALUE:
                PncUserOfUser: resulting-properties={base-type=boolean, sw-calibration-access=READ-ONLY, compu {0=FALSE, 1..255=TRUE}, range raw 0..1}
                UserByteMaskEndIdxOfUser: resulting-properties={base-type=uint8, sw-calibration-access=READ-ONLY, compu {255=COMM_NO_USERBYTEMASKENDIDXOFUSER}, range raw 0..255}
                UserByteMaskStartIdxOfUser: resulting-properties={base-type=uint8, sw-calibration-access=READ-ONLY, compu {255=COMM_NO_USERBYTEMASKSTARTIDXOFUSER}, range raw 0..255}
                UserPncByteMaskEndIdxOfUser: resulting-properties={base-type=uint8, sw-calibration-access=READ-ONLY, compu {255=COMM_NO_USERPNCBYTEMASKENDIDXOFUSER}, range raw 0..255}
                UserPncByteMaskLengthOfUser: resulting-properties={base-type=uint8, sw-calibration-access=READ-ONLY, range raw 0..255}
                UserPncByteMaskStartIdxOfUser: resulting-properties={base-type=uint8, sw-calibration-access=READ-ONLY, compu {255=COMM_NO_USERPNCBYTEMASKSTARTIDXOFUSER}, range raw 0..255}
            Element_29: symbol=[29]
              6 x mc data instance, all with category=VALUE:
                PncUserOfUser: resulting-properties={base-type=boolean, sw-calibration-access=READ-ONLY, compu {0=FALSE, 1..255=TRUE}, range raw 0..1}
                UserByteMaskEndIdxOfUser: resulting-properties={base-type=uint8, sw-calibration-access=READ-ONLY, compu {255=COMM_NO_USERBYTEMASKENDIDXOFUSER}, range raw 0..255}
                UserByteMaskStartIdxOfUser: resulting-properties={base-type=uint8, sw-calibration-access=READ-ONLY, compu {255=COMM_NO_USERBYTEMASKSTARTIDXOFUSER}, range raw 0..255}
                UserPncByteMaskEndIdxOfUser: resulting-properties={base-type=uint8, sw-calibration-access=READ-ONLY, compu {255=COMM_NO_USERPNCBYTEMASKENDIDXOFUSER}, range raw 0..255}
                UserPncByteMaskLengthOfUser: resulting-properties={base-type=uint8, sw-calibration-access=READ-ONLY, range raw 0..255}
                UserPncByteMaskStartIdxOfUser: resulting-properties={base-type=uint8, sw-calibration-access=READ-ONLY, compu {255=COMM_NO_USERPNCBYTEMASKSTARTIDXOFUSER}, range raw 0..255}
            Element_30: symbol=[30]
              6 x mc data instance, all with category=VALUE:
                PncUserOfUser: resulting-properties={base-type=boolean, sw-calibration-access=READ-ONLY, compu {0=FALSE, 1..255=TRUE}, range raw 0..1}
                UserByteMaskEndIdxOfUser: resulting-properties={base-type=uint8, sw-calibration-access=READ-ONLY, compu {255=COMM_NO_USERBYTEMASKENDIDXOFUSER}, range raw 0..255}
                UserByteMaskStartIdxOfUser: resulting-properties={base-type=uint8, sw-calibration-access=READ-ONLY, compu {255=COMM_NO_USERBYTEMASKSTARTIDXOFUSER}, range raw 0..255}
                UserPncByteMaskEndIdxOfUser: resulting-properties={base-type=uint8, sw-calibration-access=READ-ONLY, compu {255=COMM_NO_USERPNCBYTEMASKENDIDXOFUSER}, range raw 0..255}
                UserPncByteMaskLengthOfUser: resulting-properties={base-type=uint8, sw-calibration-access=READ-ONLY, range raw 0..255}
                UserPncByteMaskStartIdxOfUser: resulting-properties={base-type=uint8, sw-calibration-access=READ-ONLY, compu {255=COMM_NO_USERPNCBYTEMASKSTARTIDXOFUSER}, range raw 0..255}
            Element_31: symbol=[31]
              6 x mc data instance, all with category=VALUE:
                PncUserOfUser: resulting-properties={base-type=boolean, sw-calibration-access=READ-ONLY, compu {0=FALSE, 1..255=TRUE}, range raw 0..1}
                UserByteMaskEndIdxOfUser: resulting-properties={base-type=uint8, sw-calibration-access=READ-ONLY, compu {255=COMM_NO_USERBYTEMASKENDIDXOFUSER}, range raw 0..255}
                UserByteMaskStartIdxOfUser: resulting-properties={base-type=uint8, sw-calibration-access=READ-ONLY, compu {255=COMM_NO_USERBYTEMASKSTARTIDXOFUSER}, range raw 0..255}
                UserPncByteMaskEndIdxOfUser: resulting-properties={base-type=uint8, sw-calibration-access=READ-ONLY, compu {255=COMM_NO_USERPNCBYTEMASKENDIDXOFUSER}, range raw 0..255}
                UserPncByteMaskLengthOfUser: resulting-properties={base-type=uint8, sw-calibration-access=READ-ONLY, range raw 0..255}
                UserPncByteMaskStartIdxOfUser: resulting-properties={base-type=uint8, sw-calibration-access=READ-ONLY, compu {255=COMM_NO_USERPNCBYTEMASKSTARTIDXOFUSER}, range raw 0..255}
            Element_32: symbol=[32]
              6 x mc data instance, all with category=VALUE:
                PncUserOfUser: resulting-properties={base-type=boolean, sw-calibration-access=READ-ONLY, compu {0=FALSE, 1..255=TRUE}, range raw 0..1}
                UserByteMaskEndIdxOfUser: resulting-properties={base-type=uint8, sw-calibration-access=READ-ONLY, compu {255=COMM_NO_USERBYTEMASKENDIDXOFUSER}, range raw 0..255}
                UserByteMaskStartIdxOfUser: resulting-properties={base-type=uint8, sw-calibration-access=READ-ONLY, compu {255=COMM_NO_USERBYTEMASKSTARTIDXOFUSER}, range raw 0..255}
                UserPncByteMaskEndIdxOfUser: resulting-properties={base-type=uint8, sw-calibration-access=READ-ONLY, compu {255=COMM_NO_USERPNCBYTEMASKENDIDXOFUSER}, range raw 0..255}
                UserPncByteMaskLengthOfUser: resulting-properties={base-type=uint8, sw-calibration-access=READ-ONLY, range raw 0..255}
                UserPncByteMaskStartIdxOfUser: resulting-properties={base-type=uint8, sw-calibration-access=READ-ONLY, compu {255=COMM_NO_USERPNCBYTEMASKSTARTIDXOFUSER}, range raw 0..255}
            Element_33: symbol=[33]
              6 x mc data instance, all with category=VALUE:
                PncUserOfUser: resulting-properties={base-type=boolean, sw-calibration-access=READ-ONLY, compu {0=FALSE, 1..255=TRUE}, range raw 0..1}
                UserByteMaskEndIdxOfUser: resulting-properties={base-type=uint8, sw-calibration-access=READ-ONLY, compu {255=COMM_NO_USERBYTEMASKENDIDXOFUSER}, range raw 0..255}
                UserByteMaskStartIdxOfUser: resulting-properties={base-type=uint8, sw-calibration-access=READ-ONLY, compu {255=COMM_NO_USERBYTEMASKSTARTIDXOFUSER}, range raw 0..255}
                UserPncByteMaskEndIdxOfUser: resulting-properties={base-type=uint8, sw-calibration-access=READ-ONLY, compu {255=COMM_NO_USERPNCBYTEMASKENDIDXOFUSER}, range raw 0..255}
                UserPncByteMaskLengthOfUser: resulting-properties={base-type=uint8, sw-calibration-access=READ-ONLY, range raw 0..255}
                UserPncByteMaskStartIdxOfUser: resulting-properties={base-type=uint8, sw-calibration-access=READ-ONLY, compu {255=COMM_NO_USERPNCBYTEMASKSTARTIDXOFUSER}, range raw 0..255}
            Element_34: symbol=[34]
              6 x mc data instance, all with category=VALUE:
                PncUserOfUser: resulting-properties={base-type=boolean, sw-calibration-access=READ-ONLY, compu {0=FALSE, 1..255=TRUE}, range raw 0..1}
                UserByteMaskEndIdxOfUser: resulting-properties={base-type=uint8, sw-calibration-access=READ-ONLY, compu {255=COMM_NO_USERBYTEMASKENDIDXOFUSER}, range raw 0..255}
                UserByteMaskStartIdxOfUser: resulting-properties={base-type=uint8, sw-calibration-access=READ-ONLY, compu {255=COMM_NO_USERBYTEMASKSTARTIDXOFUSER}, range raw 0..255}
                UserPncByteMaskEndIdxOfUser: resulting-properties={base-type=uint8, sw-calibration-access=READ-ONLY, compu {255=COMM_NO_USERPNCBYTEMASKENDIDXOFUSER}, range raw 0..255}
                UserPncByteMaskLengthOfUser: resulting-properties={base-type=uint8, sw-calibration-access=READ-ONLY, range raw 0..255}
                UserPncByteMaskStartIdxOfUser: resulting-properties={base-type=uint8, sw-calibration-access=READ-ONLY, compu {255=COMM_NO_USERPNCBYTEMASKSTARTIDXOFUSER}, range raw 0..255}
            Element_35: symbol=[35]
              6 x mc data instance, all with category=VALUE:
                PncUserOfUser: resulting-properties={base-type=boolean, sw-calibration-access=READ-ONLY, compu {0=FALSE, 1..255=TRUE}, range raw 0..1}
                UserByteMaskEndIdxOfUser: resulting-properties={base-type=uint8, sw-calibration-access=READ-ONLY, compu {255=COMM_NO_USERBYTEMASKENDIDXOFUSER}, range raw 0..255}
                UserByteMaskStartIdxOfUser: resulting-properties={base-type=uint8, sw-calibration-access=READ-ONLY, compu {255=COMM_NO_USERBYTEMASKSTARTIDXOFUSER}, range raw 0..255}
                UserPncByteMaskEndIdxOfUser: resulting-properties={base-type=uint8, sw-calibration-access=READ-ONLY, compu {255=COMM_NO_USERPNCBYTEMASKENDIDXOFUSER}, range raw 0..255}
                UserPncByteMaskLengthOfUser: resulting-properties={base-type=uint8, sw-calibration-access=READ-ONLY, range raw 0..255}
                UserPncByteMaskStartIdxOfUser: resulting-properties={base-type=uint8, sw-calibration-access=READ-ONLY, compu {255=COMM_NO_USERPNCBYTEMASKSTARTIDXOFUSER}, range raw 0..255}
            Element_36: symbol=[36]
              6 x mc data instance, all with category=VALUE:
                PncUserOfUser: resulting-properties={base-type=boolean, sw-calibration-access=READ-ONLY, compu {0=FALSE, 1..255=TRUE}, range raw 0..1}
                UserByteMaskEndIdxOfUser: resulting-properties={base-type=uint8, sw-calibration-access=READ-ONLY, compu {255=COMM_NO_USERBYTEMASKENDIDXOFUSER}, range raw 0..255}
                UserByteMaskStartIdxOfUser: resulting-properties={base-type=uint8, sw-calibration-access=READ-ONLY, compu {255=COMM_NO_USERBYTEMASKSTARTIDXOFUSER}, range raw 0..255}
                UserPncByteMaskEndIdxOfUser: resulting-properties={base-type=uint8, sw-calibration-access=READ-ONLY, compu {255=COMM_NO_USERPNCBYTEMASKENDIDXOFUSER}, range raw 0..255}
                UserPncByteMaskLengthOfUser: resulting-properties={base-type=uint8, sw-calibration-access=READ-ONLY, range raw 0..255}
                UserPncByteMaskStartIdxOfUser: resulting-properties={base-type=uint8, sw-calibration-access=READ-ONLY, compu {255=COMM_NO_USERPNCBYTEMASKSTARTIDXOFUSER}, range raw 0..255}
            Element_37: symbol=[37]
              6 x mc data instance, all with category=VALUE:
                PncUserOfUser: resulting-properties={base-type=boolean, sw-calibration-access=READ-ONLY, compu {0=FALSE, 1..255=TRUE}, range raw 0..1}
                UserByteMaskEndIdxOfUser: resulting-properties={base-type=uint8, sw-calibration-access=READ-ONLY, compu {255=COMM_NO_USERBYTEMASKENDIDXOFUSER}, range raw 0..255}
                UserByteMaskStartIdxOfUser: resulting-properties={base-type=uint8, sw-calibration-access=READ-ONLY, compu {255=COMM_NO_USERBYTEMASKSTARTIDXOFUSER}, range raw 0..255}
                UserPncByteMaskEndIdxOfUser: resulting-properties={base-type=uint8, sw-calibration-access=READ-ONLY, compu {255=COMM_NO_USERPNCBYTEMASKENDIDXOFUSER}, range raw 0..255}
                UserPncByteMaskLengthOfUser: resulting-properties={base-type=uint8, sw-calibration-access=READ-ONLY, range raw 0..255}
                UserPncByteMaskStartIdxOfUser: resulting-properties={base-type=uint8, sw-calibration-access=READ-ONLY, compu {255=COMM_NO_USERPNCBYTEMASKSTARTIDXOFUSER}, range raw 0..255}
            Element_38: symbol=[38]
              6 x mc data instance, all with category=VALUE:
                PncUserOfUser: resulting-properties={base-type=boolean, sw-calibration-access=READ-ONLY, compu {0=FALSE, 1..255=TRUE}, range raw 0..1}
                UserByteMaskEndIdxOfUser: resulting-properties={base-type=uint8, sw-calibration-access=READ-ONLY, compu {255=COMM_NO_USERBYTEMASKENDIDXOFUSER}, range raw 0..255}
                UserByteMaskStartIdxOfUser: resulting-properties={base-type=uint8, sw-calibration-access=READ-ONLY, compu {255=COMM_NO_USERBYTEMASKSTARTIDXOFUSER}, range raw 0..255}
                UserPncByteMaskEndIdxOfUser: resulting-properties={base-type=uint8, sw-calibration-access=READ-ONLY, compu {255=COMM_NO_USERPNCBYTEMASKENDIDXOFUSER}, range raw 0..255}
                UserPncByteMaskLengthOfUser: resulting-properties={base-type=uint8, sw-calibration-access=READ-ONLY, range raw 0..255}
                UserPncByteMaskStartIdxOfUser: resulting-properties={base-type=uint8, sw-calibration-access=READ-ONLY, compu {255=COMM_NO_USERPNCBYTEMASKSTARTIDXOFUSER}, range raw 0..255}
            Element_39: symbol=[39]
              6 x mc data instance, all with category=VALUE:
                PncUserOfUser: resulting-properties={base-type=boolean, sw-calibration-access=READ-ONLY, compu {0=FALSE, 1..255=TRUE}, range raw 0..1}
                UserByteMaskEndIdxOfUser: resulting-properties={base-type=uint8, sw-calibration-access=READ-ONLY, compu {255=COMM_NO_USERBYTEMASKENDIDXOFUSER}, range raw 0..255}
                UserByteMaskStartIdxOfUser: resulting-properties={base-type=uint8, sw-calibration-access=READ-ONLY, compu {255=COMM_NO_USERBYTEMASKSTARTIDXOFUSER}, range raw 0..255}
                UserPncByteMaskEndIdxOfUser: resulting-properties={base-type=uint8, sw-calibration-access=READ-ONLY, compu {255=COMM_NO_USERPNCBYTEMASKENDIDXOFUSER}, range raw 0..255}
                UserPncByteMaskLengthOfUser: resulting-properties={base-type=uint8, sw-calibration-access=READ-ONLY, range raw 0..255}
                UserPncByteMaskStartIdxOfUser: resulting-properties={base-type=uint8, sw-calibration-access=READ-ONLY, compu {255=COMM_NO_USERPNCBYTEMASKSTARTIDXOFUSER}, range raw 0..255}
            Element_40: symbol=[40]
              6 x mc data instance, all with category=VALUE:
                PncUserOfUser: resulting-properties={base-type=boolean, sw-calibration-access=READ-ONLY, compu {0=FALSE, 1..255=TRUE}, range raw 0..1}
                UserByteMaskEndIdxOfUser: resulting-properties={base-type=uint8, sw-calibration-access=READ-ONLY, compu {255=COMM_NO_USERBYTEMASKENDIDXOFUSER}, range raw 0..255}
                UserByteMaskStartIdxOfUser: resulting-properties={base-type=uint8, sw-calibration-access=READ-ONLY, compu {255=COMM_NO_USERBYTEMASKSTARTIDXOFUSER}, range raw 0..255}
                UserPncByteMaskEndIdxOfUser: resulting-properties={base-type=uint8, sw-calibration-access=READ-ONLY, compu {255=COMM_NO_USERPNCBYTEMASKENDIDXOFUSER}, range raw 0..255}
                UserPncByteMaskLengthOfUser: resulting-properties={base-type=uint8, sw-calibration-access=READ-ONLY, range raw 0..255}
                UserPncByteMaskStartIdxOfUser: resulting-properties={base-type=uint8, sw-calibration-access=READ-ONLY, compu {255=COMM_NO_USERPNCBYTEMASKSTARTIDXOFUSER}, range raw 0..255}
            Element_41: symbol=[41]
              6 x mc data instance, all with category=VALUE:
                PncUserOfUser: resulting-properties={base-type=boolean, sw-calibration-access=READ-ONLY, compu {0=FALSE, 1..255=TRUE}, range raw 0..1}
                UserByteMaskEndIdxOfUser: resulting-properties={base-type=uint8, sw-calibration-access=READ-ONLY, compu {255=COMM_NO_USERBYTEMASKENDIDXOFUSER}, range raw 0..255}
                UserByteMaskStartIdxOfUser: resulting-properties={base-type=uint8, sw-calibration-access=READ-ONLY, compu {255=COMM_NO_USERBYTEMASKSTARTIDXOFUSER}, range raw 0..255}
                UserPncByteMaskEndIdxOfUser: resulting-properties={base-type=uint8, sw-calibration-access=READ-ONLY, compu {255=COMM_NO_USERPNCBYTEMASKENDIDXOFUSER}, range raw 0..255}
                UserPncByteMaskLengthOfUser: resulting-properties={base-type=uint8, sw-calibration-access=READ-ONLY, range raw 0..255}
                UserPncByteMaskStartIdxOfUser: resulting-properties={base-type=uint8, sw-calibration-access=READ-ONLY, compu {255=COMM_NO_USERPNCBYTEMASKSTARTIDXOFUSER}, range raw 0..255}
            Element_42: symbol=[42]
              6 x mc data instance, all with category=VALUE:
                PncUserOfUser: resulting-properties={base-type=boolean, sw-calibration-access=READ-ONLY, compu {0=FALSE, 1..255=TRUE}, range raw 0..1}
                UserByteMaskEndIdxOfUser: resulting-properties={base-type=uint8, sw-calibration-access=READ-ONLY, compu {255=COMM_NO_USERBYTEMASKENDIDXOFUSER}, range raw 0..255}
                UserByteMaskStartIdxOfUser: resulting-properties={base-type=uint8, sw-calibration-access=READ-ONLY, compu {255=COMM_NO_USERBYTEMASKSTARTIDXOFUSER}, range raw 0..255}
                UserPncByteMaskEndIdxOfUser: resulting-properties={base-type=uint8, sw-calibration-access=READ-ONLY, compu {255=COMM_NO_USERPNCBYTEMASKENDIDXOFUSER}, range raw 0..255}
                UserPncByteMaskLengthOfUser: resulting-properties={base-type=uint8, sw-calibration-access=READ-ONLY, range raw 0..255}
                UserPncByteMaskStartIdxOfUser: resulting-properties={base-type=uint8, sw-calibration-access=READ-ONLY, compu {255=COMM_NO_USERPNCBYTEMASKSTARTIDXOFUSER}, range raw 0..255}
            Element_43: symbol=[43]
              6 x mc data instance, all with category=VALUE:
                PncUserOfUser: resulting-properties={base-type=boolean, sw-calibration-access=READ-ONLY, compu {0=FALSE, 1..255=TRUE}, range raw 0..1}
                UserByteMaskEndIdxOfUser: resulting-properties={base-type=uint8, sw-calibration-access=READ-ONLY, compu {255=COMM_NO_USERBYTEMASKENDIDXOFUSER}, range raw 0..255}
                UserByteMaskStartIdxOfUser: resulting-properties={base-type=uint8, sw-calibration-access=READ-ONLY, compu {255=COMM_NO_USERBYTEMASKSTARTIDXOFUSER}, range raw 0..255}
                UserPncByteMaskEndIdxOfUser: resulting-properties={base-type=uint8, sw-calibration-access=READ-ONLY, compu {255=COMM_NO_USERPNCBYTEMASKENDIDXOFUSER}, range raw 0..255}
                UserPncByteMaskLengthOfUser: resulting-properties={base-type=uint8, sw-calibration-access=READ-ONLY, range raw 0..255}
                UserPncByteMaskStartIdxOfUser: resulting-properties={base-type=uint8, sw-calibration-access=READ-ONLY, compu {255=COMM_NO_USERPNCBYTEMASKSTARTIDXOFUSER}, range raw 0..255}
            Element_44: symbol=[44]
              6 x mc data instance, all with category=VALUE:
                PncUserOfUser: resulting-properties={base-type=boolean, sw-calibration-access=READ-ONLY, compu {0=FALSE, 1..255=TRUE}, range raw 0..1}
                UserByteMaskEndIdxOfUser: resulting-properties={base-type=uint8, sw-calibration-access=READ-ONLY, compu {255=COMM_NO_USERBYTEMASKENDIDXOFUSER}, range raw 0..255}
                UserByteMaskStartIdxOfUser: resulting-properties={base-type=uint8, sw-calibration-access=READ-ONLY, compu {255=COMM_NO_USERBYTEMASKSTARTIDXOFUSER}, range raw 0..255}
                UserPncByteMaskEndIdxOfUser: resulting-properties={base-type=uint8, sw-calibration-access=READ-ONLY, compu {255=COMM_NO_USERPNCBYTEMASKENDIDXOFUSER}, range raw 0..255}
                UserPncByteMaskLengthOfUser: resulting-properties={base-type=uint8, sw-calibration-access=READ-ONLY, range raw 0..255}
                UserPncByteMaskStartIdxOfUser: resulting-properties={base-type=uint8, sw-calibration-access=READ-ONLY, compu {255=COMM_NO_USERPNCBYTEMASKSTARTIDXOFUSER}, range raw 0..255}
            Element_45: symbol=[45]
              6 x mc data instance, all with category=VALUE:
                PncUserOfUser: resulting-properties={base-type=boolean, sw-calibration-access=READ-ONLY, compu {0=FALSE, 1..255=TRUE}, range raw 0..1}
                UserByteMaskEndIdxOfUser: resulting-properties={base-type=uint8, sw-calibration-access=READ-ONLY, compu {255=COMM_NO_USERBYTEMASKENDIDXOFUSER}, range raw 0..255}
                UserByteMaskStartIdxOfUser: resulting-properties={base-type=uint8, sw-calibration-access=READ-ONLY, compu {255=COMM_NO_USERBYTEMASKSTARTIDXOFUSER}, range raw 0..255}
                UserPncByteMaskEndIdxOfUser: resulting-properties={base-type=uint8, sw-calibration-access=READ-ONLY, compu {255=COMM_NO_USERPNCBYTEMASKENDIDXOFUSER}, range raw 0..255}
                UserPncByteMaskLengthOfUser: resulting-properties={base-type=uint8, sw-calibration-access=READ-ONLY, range raw 0..255}
                UserPncByteMaskStartIdxOfUser: resulting-properties={base-type=uint8, sw-calibration-access=READ-ONLY, compu {255=COMM_NO_USERPNCBYTEMASKSTARTIDXOFUSER}, range raw 0..255}
            Element_46: symbol=[46]
              6 x mc data instance, all with category=VALUE:
                PncUserOfUser: resulting-properties={base-type=boolean, sw-calibration-access=READ-ONLY, compu {0=FALSE, 1..255=TRUE}, range raw 0..1}
                UserByteMaskEndIdxOfUser: resulting-properties={base-type=uint8, sw-calibration-access=READ-ONLY, compu {255=COMM_NO_USERBYTEMASKENDIDXOFUSER}, range raw 0..255}
                UserByteMaskStartIdxOfUser: resulting-properties={base-type=uint8, sw-calibration-access=READ-ONLY, compu {255=COMM_NO_USERBYTEMASKSTARTIDXOFUSER}, range raw 0..255}
                UserPncByteMaskEndIdxOfUser: resulting-properties={base-type=uint8, sw-calibration-access=READ-ONLY, compu {255=COMM_NO_USERPNCBYTEMASKENDIDXOFUSER}, range raw 0..255}
                UserPncByteMaskLengthOfUser: resulting-properties={base-type=uint8, sw-calibration-access=READ-ONLY, range raw 0..255}
                UserPncByteMaskStartIdxOfUser: resulting-properties={base-type=uint8, sw-calibration-access=READ-ONLY, compu {255=COMM_NO_USERPNCBYTEMASKSTARTIDXOFUSER}, range raw 0..255}
            Element_47: symbol=[47]
              6 x mc data instance, all with category=VALUE:
                PncUserOfUser: resulting-properties={base-type=boolean, sw-calibration-access=READ-ONLY, compu {0=FALSE, 1..255=TRUE}, range raw 0..1}
                UserByteMaskEndIdxOfUser: resulting-properties={base-type=uint8, sw-calibration-access=READ-ONLY, compu {255=COMM_NO_USERBYTEMASKENDIDXOFUSER}, range raw 0..255}
                UserByteMaskStartIdxOfUser: resulting-properties={base-type=uint8, sw-calibration-access=READ-ONLY, compu {255=COMM_NO_USERBYTEMASKSTARTIDXOFUSER}, range raw 0..255}
                UserPncByteMaskEndIdxOfUser: resulting-properties={base-type=uint8, sw-calibration-access=READ-ONLY, compu {255=COMM_NO_USERPNCBYTEMASKENDIDXOFUSER}, range raw 0..255}
                UserPncByteMaskLengthOfUser: resulting-properties={base-type=uint8, sw-calibration-access=READ-ONLY, range raw 0..255}
                UserPncByteMaskStartIdxOfUser: resulting-properties={base-type=uint8, sw-calibration-access=READ-ONLY, compu {255=COMM_NO_USERPNCBYTEMASKSTARTIDXOFUSER}, range raw 0..255}
            Element_48: symbol=[48]
              6 x mc data instance, all with category=VALUE:
                PncUserOfUser: resulting-properties={base-type=boolean, sw-calibration-access=READ-ONLY, compu {0=FALSE, 1..255=TRUE}, range raw 0..1}
                UserByteMaskEndIdxOfUser: resulting-properties={base-type=uint8, sw-calibration-access=READ-ONLY, compu {255=COMM_NO_USERBYTEMASKENDIDXOFUSER}, range raw 0..255}
                UserByteMaskStartIdxOfUser: resulting-properties={base-type=uint8, sw-calibration-access=READ-ONLY, compu {255=COMM_NO_USERBYTEMASKSTARTIDXOFUSER}, range raw 0..255}
                UserPncByteMaskEndIdxOfUser: resulting-properties={base-type=uint8, sw-calibration-access=READ-ONLY, compu {255=COMM_NO_USERPNCBYTEMASKENDIDXOFUSER}, range raw 0..255}
                UserPncByteMaskLengthOfUser: resulting-properties={base-type=uint8, sw-calibration-access=READ-ONLY, range raw 0..255}
                UserPncByteMaskStartIdxOfUser: resulting-properties={base-type=uint8, sw-calibration-access=READ-ONLY, compu {255=COMM_NO_USERPNCBYTEMASKSTARTIDXOFUSER}, range raw 0..255}
            Element_49: symbol=[49]
              6 x mc data instance, all with category=VALUE:
                PncUserOfUser: resulting-properties={base-type=boolean, sw-calibration-access=READ-ONLY, compu {0=FALSE, 1..255=TRUE}, range raw 0..1}
                UserByteMaskEndIdxOfUser: resulting-properties={base-type=uint8, sw-calibration-access=READ-ONLY, compu {255=COMM_NO_USERBYTEMASKENDIDXOFUSER}, range raw 0..255}
                UserByteMaskStartIdxOfUser: resulting-properties={base-type=uint8, sw-calibration-access=READ-ONLY, compu {255=COMM_NO_USERBYTEMASKSTARTIDXOFUSER}, range raw 0..255}
                UserPncByteMaskEndIdxOfUser: resulting-properties={base-type=uint8, sw-calibration-access=READ-ONLY, compu {255=COMM_NO_USERPNCBYTEMASKENDIDXOFUSER}, range raw 0..255}
                UserPncByteMaskLengthOfUser: resulting-properties={base-type=uint8, sw-calibration-access=READ-ONLY, range raw 0..255}
                UserPncByteMaskStartIdxOfUser: resulting-properties={base-type=uint8, sw-calibration-access=READ-ONLY, compu {255=COMM_NO_USERPNCBYTEMASKSTARTIDXOFUSER}, range raw 0..255}
        ComM_UserByteMask: array-size=50  # Each user has N entries in this array (N = # channels attached to this user, directly or through PNC). Each entry describes a Byte Position and a Mask for storing/clearing the user request in UserReqFullCom
          50 x mc data instance, all with category=STRUCTURE:
            Element_0: symbol=[0]
              4 x mc data instance, all with category=VALUE, resulting-properties={base-type=uint8, sw-calibration-access=READ-ONLY, range raw 0..255}:
                ChannelOfUserByteMask
                ClearMaskOfUserByteMask
                SetMaskOfUserByteMask
                UserReqFullComIdxOfUserByteMask
            Element_1: symbol=[1]
              4 x mc data instance, all with category=VALUE, resulting-properties={base-type=uint8, sw-calibration-access=READ-ONLY, range raw 0..255}:
                ChannelOfUserByteMask
                ClearMaskOfUserByteMask
                SetMaskOfUserByteMask
                UserReqFullComIdxOfUserByteMask
            Element_2: symbol=[2]
              4 x mc data instance, all with category=VALUE, resulting-properties={base-type=uint8, sw-calibration-access=READ-ONLY, range raw 0..255}:
                ChannelOfUserByteMask
                ClearMaskOfUserByteMask
                SetMaskOfUserByteMask
                UserReqFullComIdxOfUserByteMask
            Element_3: symbol=[3]
              4 x mc data instance, all with category=VALUE, resulting-properties={base-type=uint8, sw-calibration-access=READ-ONLY, range raw 0..255}:
                ChannelOfUserByteMask
                ClearMaskOfUserByteMask
                SetMaskOfUserByteMask
                UserReqFullComIdxOfUserByteMask
            Element_4: symbol=[4]
              4 x mc data instance, all with category=VALUE, resulting-properties={base-type=uint8, sw-calibration-access=READ-ONLY, range raw 0..255}:
                ChannelOfUserByteMask
                ClearMaskOfUserByteMask
                SetMaskOfUserByteMask
                UserReqFullComIdxOfUserByteMask
            Element_5: symbol=[5]
              4 x mc data instance, all with category=VALUE, resulting-properties={base-type=uint8, sw-calibration-access=READ-ONLY, range raw 0..255}:
                ChannelOfUserByteMask
                ClearMaskOfUserByteMask
                SetMaskOfUserByteMask
                UserReqFullComIdxOfUserByteMask
            Element_6: symbol=[6]
              4 x mc data instance, all with category=VALUE, resulting-properties={base-type=uint8, sw-calibration-access=READ-ONLY, range raw 0..255}:
                ChannelOfUserByteMask
                ClearMaskOfUserByteMask
                SetMaskOfUserByteMask
                UserReqFullComIdxOfUserByteMask
            Element_7: symbol=[7]
              4 x mc data instance, all with category=VALUE, resulting-properties={base-type=uint8, sw-calibration-access=READ-ONLY, range raw 0..255}:
                ChannelOfUserByteMask
                ClearMaskOfUserByteMask
                SetMaskOfUserByteMask
                UserReqFullComIdxOfUserByteMask
            Element_8: symbol=[8]
              4 x mc data instance, all with category=VALUE, resulting-properties={base-type=uint8, sw-calibration-access=READ-ONLY, range raw 0..255}:
                ChannelOfUserByteMask
                ClearMaskOfUserByteMask
                SetMaskOfUserByteMask
                UserReqFullComIdxOfUserByteMask
            Element_9: symbol=[9]
              4 x mc data instance, all with category=VALUE, resulting-properties={base-type=uint8, sw-calibration-access=READ-ONLY, range raw 0..255}:
                ChannelOfUserByteMask
                ClearMaskOfUserByteMask
                SetMaskOfUserByteMask
                UserReqFullComIdxOfUserByteMask
            Element_10: symbol=[10]
              4 x mc data instance, all with category=VALUE, resulting-properties={base-type=uint8, sw-calibration-access=READ-ONLY, range raw 0..255}:
                ChannelOfUserByteMask
                ClearMaskOfUserByteMask
                SetMaskOfUserByteMask
                UserReqFullComIdxOfUserByteMask
            Element_11: symbol=[11]
              4 x mc data instance, all with category=VALUE, resulting-properties={base-type=uint8, sw-calibration-access=READ-ONLY, range raw 0..255}:
                ChannelOfUserByteMask
                ClearMaskOfUserByteMask
                SetMaskOfUserByteMask
                UserReqFullComIdxOfUserByteMask
            Element_12: symbol=[12]
              4 x mc data instance, all with category=VALUE, resulting-properties={base-type=uint8, sw-calibration-access=READ-ONLY, range raw 0..255}:
                ChannelOfUserByteMask
                ClearMaskOfUserByteMask
                SetMaskOfUserByteMask
                UserReqFullComIdxOfUserByteMask
            Element_13: symbol=[13]
              4 x mc data instance, all with category=VALUE, resulting-properties={base-type=uint8, sw-calibration-access=READ-ONLY, range raw 0..255}:
                ChannelOfUserByteMask
                ClearMaskOfUserByteMask
                SetMaskOfUserByteMask
                UserReqFullComIdxOfUserByteMask
            Element_14: symbol=[14]
              4 x mc data instance, all with category=VALUE, resulting-properties={base-type=uint8, sw-calibration-access=READ-ONLY, range raw 0..255}:
                ChannelOfUserByteMask
                ClearMaskOfUserByteMask
                SetMaskOfUserByteMask
                UserReqFullComIdxOfUserByteMask
            Element_15: symbol=[15]
              4 x mc data instance, all with category=VALUE, resulting-properties={base-type=uint8, sw-calibration-access=READ-ONLY, range raw 0..255}:
                ChannelOfUserByteMask
                ClearMaskOfUserByteMask
                SetMaskOfUserByteMask
                UserReqFullComIdxOfUserByteMask
            Element_16: symbol=[16]
              4 x mc data instance, all with category=VALUE, resulting-properties={base-type=uint8, sw-calibration-access=READ-ONLY, range raw 0..255}:
                ChannelOfUserByteMask
                ClearMaskOfUserByteMask
                SetMaskOfUserByteMask
                UserReqFullComIdxOfUserByteMask
            Element_17: symbol=[17]
              4 x mc data instance, all with category=VALUE, resulting-properties={base-type=uint8, sw-calibration-access=READ-ONLY, range raw 0..255}:
                ChannelOfUserByteMask
                ClearMaskOfUserByteMask
                SetMaskOfUserByteMask
                UserReqFullComIdxOfUserByteMask
            Element_18: symbol=[18]
              4 x mc data instance, all with category=VALUE, resulting-properties={base-type=uint8, sw-calibration-access=READ-ONLY, range raw 0..255}:
                ChannelOfUserByteMask
                ClearMaskOfUserByteMask
                SetMaskOfUserByteMask
                UserReqFullComIdxOfUserByteMask
            Element_19: symbol=[19]
              4 x mc data instance, all with category=VALUE, resulting-properties={base-type=uint8, sw-calibration-access=READ-ONLY, range raw 0..255}:
                ChannelOfUserByteMask
                ClearMaskOfUserByteMask
                SetMaskOfUserByteMask
                UserReqFullComIdxOfUserByteMask
            Element_20: symbol=[20]
              4 x mc data instance, all with category=VALUE, resulting-properties={base-type=uint8, sw-calibration-access=READ-ONLY, range raw 0..255}:
                ChannelOfUserByteMask
                ClearMaskOfUserByteMask
                SetMaskOfUserByteMask
                UserReqFullComIdxOfUserByteMask
            Element_21: symbol=[21]
              4 x mc data instance, all with category=VALUE, resulting-properties={base-type=uint8, sw-calibration-access=READ-ONLY, range raw 0..255}:
                ChannelOfUserByteMask
                ClearMaskOfUserByteMask
                SetMaskOfUserByteMask
                UserReqFullComIdxOfUserByteMask
            Element_22: symbol=[22]
              4 x mc data instance, all with category=VALUE, resulting-properties={base-type=uint8, sw-calibration-access=READ-ONLY, range raw 0..255}:
                ChannelOfUserByteMask
                ClearMaskOfUserByteMask
                SetMaskOfUserByteMask
                UserReqFullComIdxOfUserByteMask
            Element_23: symbol=[23]
              4 x mc data instance, all with category=VALUE, resulting-properties={base-type=uint8, sw-calibration-access=READ-ONLY, range raw 0..255}:
                ChannelOfUserByteMask
                ClearMaskOfUserByteMask
                SetMaskOfUserByteMask
                UserReqFullComIdxOfUserByteMask
            Element_24: symbol=[24]
              4 x mc data instance, all with category=VALUE, resulting-properties={base-type=uint8, sw-calibration-access=READ-ONLY, range raw 0..255}:
                ChannelOfUserByteMask
                ClearMaskOfUserByteMask
                SetMaskOfUserByteMask
                UserReqFullComIdxOfUserByteMask
            Element_25: symbol=[25]
              4 x mc data instance, all with category=VALUE, resulting-properties={base-type=uint8, sw-calibration-access=READ-ONLY, range raw 0..255}:
                ChannelOfUserByteMask
                ClearMaskOfUserByteMask
                SetMaskOfUserByteMask
                UserReqFullComIdxOfUserByteMask
            Element_26: symbol=[26]
              4 x mc data instance, all with category=VALUE, resulting-properties={base-type=uint8, sw-calibration-access=READ-ONLY, range raw 0..255}:
                ChannelOfUserByteMask
                ClearMaskOfUserByteMask
                SetMaskOfUserByteMask
                UserReqFullComIdxOfUserByteMask
            Element_27: symbol=[27]
              4 x mc data instance, all with category=VALUE, resulting-properties={base-type=uint8, sw-calibration-access=READ-ONLY, range raw 0..255}:
                ChannelOfUserByteMask
                ClearMaskOfUserByteMask
                SetMaskOfUserByteMask
                UserReqFullComIdxOfUserByteMask
            Element_28: symbol=[28]
              4 x mc data instance, all with category=VALUE, resulting-properties={base-type=uint8, sw-calibration-access=READ-ONLY, range raw 0..255}:
                ChannelOfUserByteMask
                ClearMaskOfUserByteMask
                SetMaskOfUserByteMask
                UserReqFullComIdxOfUserByteMask
            Element_29: symbol=[29]
              4 x mc data instance, all with category=VALUE, resulting-properties={base-type=uint8, sw-calibration-access=READ-ONLY, range raw 0..255}:
                ChannelOfUserByteMask
                ClearMaskOfUserByteMask
                SetMaskOfUserByteMask
                UserReqFullComIdxOfUserByteMask
            Element_30: symbol=[30]
              4 x mc data instance, all with category=VALUE, resulting-properties={base-type=uint8, sw-calibration-access=READ-ONLY, range raw 0..255}:
                ChannelOfUserByteMask
                ClearMaskOfUserByteMask
                SetMaskOfUserByteMask
                UserReqFullComIdxOfUserByteMask
            Element_31: symbol=[31]
              4 x mc data instance, all with category=VALUE, resulting-properties={base-type=uint8, sw-calibration-access=READ-ONLY, range raw 0..255}:
                ChannelOfUserByteMask
                ClearMaskOfUserByteMask
                SetMaskOfUserByteMask
                UserReqFullComIdxOfUserByteMask
            Element_32: symbol=[32]
              4 x mc data instance, all with category=VALUE, resulting-properties={base-type=uint8, sw-calibration-access=READ-ONLY, range raw 0..255}:
                ChannelOfUserByteMask
                ClearMaskOfUserByteMask
                SetMaskOfUserByteMask
                UserReqFullComIdxOfUserByteMask
            Element_33: symbol=[33]
              4 x mc data instance, all with category=VALUE, resulting-properties={base-type=uint8, sw-calibration-access=READ-ONLY, range raw 0..255}:
                ChannelOfUserByteMask
                ClearMaskOfUserByteMask
                SetMaskOfUserByteMask
                UserReqFullComIdxOfUserByteMask
            Element_34: symbol=[34]
              4 x mc data instance, all with category=VALUE, resulting-properties={base-type=uint8, sw-calibration-access=READ-ONLY, range raw 0..255}:
                ChannelOfUserByteMask
                ClearMaskOfUserByteMask
                SetMaskOfUserByteMask
                UserReqFullComIdxOfUserByteMask
            Element_35: symbol=[35]
              4 x mc data instance, all with category=VALUE, resulting-properties={base-type=uint8, sw-calibration-access=READ-ONLY, range raw 0..255}:
                ChannelOfUserByteMask
                ClearMaskOfUserByteMask
                SetMaskOfUserByteMask
                UserReqFullComIdxOfUserByteMask
            Element_36: symbol=[36]
              4 x mc data instance, all with category=VALUE, resulting-properties={base-type=uint8, sw-calibration-access=READ-ONLY, range raw 0..255}:
                ChannelOfUserByteMask
                ClearMaskOfUserByteMask
                SetMaskOfUserByteMask
                UserReqFullComIdxOfUserByteMask
            Element_37: symbol=[37]
              4 x mc data instance, all with category=VALUE, resulting-properties={base-type=uint8, sw-calibration-access=READ-ONLY, range raw 0..255}:
                ChannelOfUserByteMask
                ClearMaskOfUserByteMask
                SetMaskOfUserByteMask
                UserReqFullComIdxOfUserByteMask
            Element_38: symbol=[38]
              4 x mc data instance, all with category=VALUE, resulting-properties={base-type=uint8, sw-calibration-access=READ-ONLY, range raw 0..255}:
                ChannelOfUserByteMask
                ClearMaskOfUserByteMask
                SetMaskOfUserByteMask
                UserReqFullComIdxOfUserByteMask
            Element_39: symbol=[39]
              4 x mc data instance, all with category=VALUE, resulting-properties={base-type=uint8, sw-calibration-access=READ-ONLY, range raw 0..255}:
                ChannelOfUserByteMask
                ClearMaskOfUserByteMask
                SetMaskOfUserByteMask
                UserReqFullComIdxOfUserByteMask
            Element_40: symbol=[40]
              4 x mc data instance, all with category=VALUE, resulting-properties={base-type=uint8, sw-calibration-access=READ-ONLY, range raw 0..255}:
                ChannelOfUserByteMask
                ClearMaskOfUserByteMask
                SetMaskOfUserByteMask
                UserReqFullComIdxOfUserByteMask
            Element_41: symbol=[41]
              4 x mc data instance, all with category=VALUE, resulting-properties={base-type=uint8, sw-calibration-access=READ-ONLY, range raw 0..255}:
                ChannelOfUserByteMask
                ClearMaskOfUserByteMask
                SetMaskOfUserByteMask
                UserReqFullComIdxOfUserByteMask
            Element_42: symbol=[42]
              4 x mc data instance, all with category=VALUE, resulting-properties={base-type=uint8, sw-calibration-access=READ-ONLY, range raw 0..255}:
                ChannelOfUserByteMask
                ClearMaskOfUserByteMask
                SetMaskOfUserByteMask
                UserReqFullComIdxOfUserByteMask
            Element_43: symbol=[43]
              4 x mc data instance, all with category=VALUE, resulting-properties={base-type=uint8, sw-calibration-access=READ-ONLY, range raw 0..255}:
                ChannelOfUserByteMask
                ClearMaskOfUserByteMask
                SetMaskOfUserByteMask
                UserReqFullComIdxOfUserByteMask
            Element_44: symbol=[44]
              4 x mc data instance, all with category=VALUE, resulting-properties={base-type=uint8, sw-calibration-access=READ-ONLY, range raw 0..255}:
                ChannelOfUserByteMask
                ClearMaskOfUserByteMask
                SetMaskOfUserByteMask
                UserReqFullComIdxOfUserByteMask
            Element_45: symbol=[45]
              4 x mc data instance, all with category=VALUE, resulting-properties={base-type=uint8, sw-calibration-access=READ-ONLY, range raw 0..255}:
                ChannelOfUserByteMask
                ClearMaskOfUserByteMask
                SetMaskOfUserByteMask
                UserReqFullComIdxOfUserByteMask
            Element_46: symbol=[46]
              4 x mc data instance, all with category=VALUE, resulting-properties={base-type=uint8, sw-calibration-access=READ-ONLY, range raw 0..255}:
                ChannelOfUserByteMask
                ClearMaskOfUserByteMask
                SetMaskOfUserByteMask
                UserReqFullComIdxOfUserByteMask
            Element_47: symbol=[47]
              4 x mc data instance, all with category=VALUE, resulting-properties={base-type=uint8, sw-calibration-access=READ-ONLY, range raw 0..255}:
                ChannelOfUserByteMask
                ClearMaskOfUserByteMask
                SetMaskOfUserByteMask
                UserReqFullComIdxOfUserByteMask
            Element_48: symbol=[48]
              4 x mc data instance, all with category=VALUE, resulting-properties={base-type=uint8, sw-calibration-access=READ-ONLY, range raw 0..255}:
                ChannelOfUserByteMask
                ClearMaskOfUserByteMask
                SetMaskOfUserByteMask
                UserReqFullComIdxOfUserByteMask
            Element_49: symbol=[49]
              4 x mc data instance, all with category=VALUE, resulting-properties={base-type=uint8, sw-calibration-access=READ-ONLY, range raw 0..255}:
                ChannelOfUserByteMask
                ClearMaskOfUserByteMask
                SetMaskOfUserByteMask
                UserReqFullComIdxOfUserByteMask
        ComM_UserPncByteMask: array-size=48  # Each partial network user has N entries in this array (N = # pncs attached to this user). Each entry describes a Byte Position and a Mask for storing/clearing the user request in UserReqPncFullCom
          48 x mc data instance, all with category=STRUCTURE:
            Element_0: symbol=[0]
              mc data instance PncIDOfUserPncByteMask: category=VALUE, resulting-properties={base-type=uint8, sw-calibration-access=READ-ONLY, range raw 0..255}
              mc data instance PncIdxOfUserPncByteMask: category=VALUE, resulting-properties={base-type=uint8, sw-calibration-access=READ-ONLY, range raw 0..255}
              mc data instance UserReqPncFullComIdxOfUserPncByteMask: category=VALUE, resulting-properties={base-type=uint8, sw-calibration-access=READ-ONLY, range raw 0..255}
            Element_1: symbol=[1]
              mc data instance PncIDOfUserPncByteMask: category=VALUE, resulting-properties={base-type=uint8, sw-calibration-access=READ-ONLY, range raw 0..255}
              mc data instance PncIdxOfUserPncByteMask: category=VALUE, resulting-properties={base-type=uint8, sw-calibration-access=READ-ONLY, range raw 0..255}
              mc data instance UserReqPncFullComIdxOfUserPncByteMask: category=VALUE, resulting-properties={base-type=uint8, sw-calibration-access=READ-ONLY, range raw 0..255}
            Element_2: symbol=[2]
              mc data instance PncIDOfUserPncByteMask: category=VALUE, resulting-properties={base-type=uint8, sw-calibration-access=READ-ONLY, range raw 0..255}
              mc data instance PncIdxOfUserPncByteMask: category=VALUE, resulting-properties={base-type=uint8, sw-calibration-access=READ-ONLY, range raw 0..255}
              mc data instance UserReqPncFullComIdxOfUserPncByteMask: category=VALUE, resulting-properties={base-type=uint8, sw-calibration-access=READ-ONLY, range raw 0..255}
            Element_3: symbol=[3]
              mc data instance PncIDOfUserPncByteMask: category=VALUE, resulting-properties={base-type=uint8, sw-calibration-access=READ-ONLY, range raw 0..255}
              mc data instance PncIdxOfUserPncByteMask: category=VALUE, resulting-properties={base-type=uint8, sw-calibration-access=READ-ONLY, range raw 0..255}
              mc data instance UserReqPncFullComIdxOfUserPncByteMask: category=VALUE, resulting-properties={base-type=uint8, sw-calibration-access=READ-ONLY, range raw 0..255}
            Element_4: symbol=[4]
              mc data instance PncIDOfUserPncByteMask: category=VALUE, resulting-properties={base-type=uint8, sw-calibration-access=READ-ONLY, range raw 0..255}
              mc data instance PncIdxOfUserPncByteMask: category=VALUE, resulting-properties={base-type=uint8, sw-calibration-access=READ-ONLY, range raw 0..255}
              mc data instance UserReqPncFullComIdxOfUserPncByteMask: category=VALUE, resulting-properties={base-type=uint8, sw-calibration-access=READ-ONLY, range raw 0..255}
            Element_5: symbol=[5]
              mc data instance PncIDOfUserPncByteMask: category=VALUE, resulting-properties={base-type=uint8, sw-calibration-access=READ-ONLY, range raw 0..255}
              mc data instance PncIdxOfUserPncByteMask: category=VALUE, resulting-properties={base-type=uint8, sw-calibration-access=READ-ONLY, range raw 0..255}
              mc data instance UserReqPncFullComIdxOfUserPncByteMask: category=VALUE, resulting-properties={base-type=uint8, sw-calibration-access=READ-ONLY, range raw 0..255}
            Element_6: symbol=[6]
              mc data instance PncIDOfUserPncByteMask: category=VALUE, resulting-properties={base-type=uint8, sw-calibration-access=READ-ONLY, range raw 0..255}
              mc data instance PncIdxOfUserPncByteMask: category=VALUE, resulting-properties={base-type=uint8, sw-calibration-access=READ-ONLY, range raw 0..255}
              mc data instance UserReqPncFullComIdxOfUserPncByteMask: category=VALUE, resulting-properties={base-type=uint8, sw-calibration-access=READ-ONLY, range raw 0..255}
            Element_7: symbol=[7]
              mc data instance PncIDOfUserPncByteMask: category=VALUE, resulting-properties={base-type=uint8, sw-calibration-access=READ-ONLY, range raw 0..255}
              mc data instance PncIdxOfUserPncByteMask: category=VALUE, resulting-properties={base-type=uint8, sw-calibration-access=READ-ONLY, range raw 0..255}
              mc data instance UserReqPncFullComIdxOfUserPncByteMask: category=VALUE, resulting-properties={base-type=uint8, sw-calibration-access=READ-ONLY, range raw 0..255}
            Element_8: symbol=[8]
              mc data instance PncIDOfUserPncByteMask: category=VALUE, resulting-properties={base-type=uint8, sw-calibration-access=READ-ONLY, range raw 0..255}
              mc data instance PncIdxOfUserPncByteMask: category=VALUE, resulting-properties={base-type=uint8, sw-calibration-access=READ-ONLY, range raw 0..255}
              mc data instance UserReqPncFullComIdxOfUserPncByteMask: category=VALUE, resulting-properties={base-type=uint8, sw-calibration-access=READ-ONLY, range raw 0..255}
            Element_9: symbol=[9]
              mc data instance PncIDOfUserPncByteMask: category=VALUE, resulting-properties={base-type=uint8, sw-calibration-access=READ-ONLY, range raw 0..255}
              mc data instance PncIdxOfUserPncByteMask: category=VALUE, resulting-properties={base-type=uint8, sw-calibration-access=READ-ONLY, range raw 0..255}
              mc data instance UserReqPncFullComIdxOfUserPncByteMask: category=VALUE, resulting-properties={base-type=uint8, sw-calibration-access=READ-ONLY, range raw 0..255}
            Element_10: symbol=[10]
              mc data instance PncIDOfUserPncByteMask: category=VALUE, resulting-properties={base-type=uint8, sw-calibration-access=READ-ONLY, range raw 0..255}
              mc data instance PncIdxOfUserPncByteMask: category=VALUE, resulting-properties={base-type=uint8, sw-calibration-access=READ-ONLY, range raw 0..255}
              mc data instance UserReqPncFullComIdxOfUserPncByteMask: category=VALUE, resulting-properties={base-type=uint8, sw-calibration-access=READ-ONLY, range raw 0..255}
            Element_11: symbol=[11]
              mc data instance PncIDOfUserPncByteMask: category=VALUE, resulting-properties={base-type=uint8, sw-calibration-access=READ-ONLY, range raw 0..255}
              mc data instance PncIdxOfUserPncByteMask: category=VALUE, resulting-properties={base-type=uint8, sw-calibration-access=READ-ONLY, range raw 0..255}
              mc data instance UserReqPncFullComIdxOfUserPncByteMask: category=VALUE, resulting-properties={base-type=uint8, sw-calibration-access=READ-ONLY, range raw 0..255}
            Element_12: symbol=[12]
              mc data instance PncIDOfUserPncByteMask: category=VALUE, resulting-properties={base-type=uint8, sw-calibration-access=READ-ONLY, range raw 0..255}
              mc data instance PncIdxOfUserPncByteMask: category=VALUE, resulting-properties={base-type=uint8, sw-calibration-access=READ-ONLY, range raw 0..255}
              mc data instance UserReqPncFullComIdxOfUserPncByteMask: category=VALUE, resulting-properties={base-type=uint8, sw-calibration-access=READ-ONLY, range raw 0..255}
            Element_13: symbol=[13]
              mc data instance PncIDOfUserPncByteMask: category=VALUE, resulting-properties={base-type=uint8, sw-calibration-access=READ-ONLY, range raw 0..255}
              mc data instance PncIdxOfUserPncByteMask: category=VALUE, resulting-properties={base-type=uint8, sw-calibration-access=READ-ONLY, range raw 0..255}
              mc data instance UserReqPncFullComIdxOfUserPncByteMask: category=VALUE, resulting-properties={base-type=uint8, sw-calibration-access=READ-ONLY, range raw 0..255}
            Element_14: symbol=[14]
              mc data instance PncIDOfUserPncByteMask: category=VALUE, resulting-properties={base-type=uint8, sw-calibration-access=READ-ONLY, range raw 0..255}
              mc data instance PncIdxOfUserPncByteMask: category=VALUE, resulting-properties={base-type=uint8, sw-calibration-access=READ-ONLY, range raw 0..255}
              mc data instance UserReqPncFullComIdxOfUserPncByteMask: category=VALUE, resulting-properties={base-type=uint8, sw-calibration-access=READ-ONLY, range raw 0..255}
            Element_15: symbol=[15]
              mc data instance PncIDOfUserPncByteMask: category=VALUE, resulting-properties={base-type=uint8, sw-calibration-access=READ-ONLY, range raw 0..255}
              mc data instance PncIdxOfUserPncByteMask: category=VALUE, resulting-properties={base-type=uint8, sw-calibration-access=READ-ONLY, range raw 0..255}
              mc data instance UserReqPncFullComIdxOfUserPncByteMask: category=VALUE, resulting-properties={base-type=uint8, sw-calibration-access=READ-ONLY, range raw 0..255}
            Element_16: symbol=[16]
              mc data instance PncIDOfUserPncByteMask: category=VALUE, resulting-properties={base-type=uint8, sw-calibration-access=READ-ONLY, range raw 0..255}
              mc data instance PncIdxOfUserPncByteMask: category=VALUE, resulting-properties={base-type=uint8, sw-calibration-access=READ-ONLY, range raw 0..255}
              mc data instance UserReqPncFullComIdxOfUserPncByteMask: category=VALUE, resulting-properties={base-type=uint8, sw-calibration-access=READ-ONLY, range raw 0..255}
            Element_17: symbol=[17]
              mc data instance PncIDOfUserPncByteMask: category=VALUE, resulting-properties={base-type=uint8, sw-calibration-access=READ-ONLY, range raw 0..255}
              mc data instance PncIdxOfUserPncByteMask: category=VALUE, resulting-properties={base-type=uint8, sw-calibration-access=READ-ONLY, range raw 0..255}
              mc data instance UserReqPncFullComIdxOfUserPncByteMask: category=VALUE, resulting-properties={base-type=uint8, sw-calibration-access=READ-ONLY, range raw 0..255}
            Element_18: symbol=[18]
              mc data instance PncIDOfUserPncByteMask: category=VALUE, resulting-properties={base-type=uint8, sw-calibration-access=READ-ONLY, range raw 0..255}
              mc data instance PncIdxOfUserPncByteMask: category=VALUE, resulting-properties={base-type=uint8, sw-calibration-access=READ-ONLY, range raw 0..255}
              mc data instance UserReqPncFullComIdxOfUserPncByteMask: category=VALUE, resulting-properties={base-type=uint8, sw-calibration-access=READ-ONLY, range raw 0..255}
            Element_19: symbol=[19]
              mc data instance PncIDOfUserPncByteMask: category=VALUE, resulting-properties={base-type=uint8, sw-calibration-access=READ-ONLY, range raw 0..255}
              mc data instance PncIdxOfUserPncByteMask: category=VALUE, resulting-properties={base-type=uint8, sw-calibration-access=READ-ONLY, range raw 0..255}
              mc data instance UserReqPncFullComIdxOfUserPncByteMask: category=VALUE, resulting-properties={base-type=uint8, sw-calibration-access=READ-ONLY, range raw 0..255}
            Element_20: symbol=[20]
              mc data instance PncIDOfUserPncByteMask: category=VALUE, resulting-properties={base-type=uint8, sw-calibration-access=READ-ONLY, range raw 0..255}
              mc data instance PncIdxOfUserPncByteMask: category=VALUE, resulting-properties={base-type=uint8, sw-calibration-access=READ-ONLY, range raw 0..255}
              mc data instance UserReqPncFullComIdxOfUserPncByteMask: category=VALUE, resulting-properties={base-type=uint8, sw-calibration-access=READ-ONLY, range raw 0..255}
            Element_21: symbol=[21]
              mc data instance PncIDOfUserPncByteMask: category=VALUE, resulting-properties={base-type=uint8, sw-calibration-access=READ-ONLY, range raw 0..255}
              mc data instance PncIdxOfUserPncByteMask: category=VALUE, resulting-properties={base-type=uint8, sw-calibration-access=READ-ONLY, range raw 0..255}
              mc data instance UserReqPncFullComIdxOfUserPncByteMask: category=VALUE, resulting-properties={base-type=uint8, sw-calibration-access=READ-ONLY, range raw 0..255}
            Element_22: symbol=[22]
              mc data instance PncIDOfUserPncByteMask: category=VALUE, resulting-properties={base-type=uint8, sw-calibration-access=READ-ONLY, range raw 0..255}
              mc data instance PncIdxOfUserPncByteMask: category=VALUE, resulting-properties={base-type=uint8, sw-calibration-access=READ-ONLY, range raw 0..255}
              mc data instance UserReqPncFullComIdxOfUserPncByteMask: category=VALUE, resulting-properties={base-type=uint8, sw-calibration-access=READ-ONLY, range raw 0..255}
            Element_23: symbol=[23]
              mc data instance PncIDOfUserPncByteMask: category=VALUE, resulting-properties={base-type=uint8, sw-calibration-access=READ-ONLY, range raw 0..255}
              mc data instance PncIdxOfUserPncByteMask: category=VALUE, resulting-properties={base-type=uint8, sw-calibration-access=READ-ONLY, range raw 0..255}
              mc data instance UserReqPncFullComIdxOfUserPncByteMask: category=VALUE, resulting-properties={base-type=uint8, sw-calibration-access=READ-ONLY, range raw 0..255}
            Element_24: symbol=[24]
              mc data instance PncIDOfUserPncByteMask: category=VALUE, resulting-properties={base-type=uint8, sw-calibration-access=READ-ONLY, range raw 0..255}
              mc data instance PncIdxOfUserPncByteMask: category=VALUE, resulting-properties={base-type=uint8, sw-calibration-access=READ-ONLY, range raw 0..255}
              mc data instance UserReqPncFullComIdxOfUserPncByteMask: category=VALUE, resulting-properties={base-type=uint8, sw-calibration-access=READ-ONLY, range raw 0..255}
            Element_25: symbol=[25]
              mc data instance PncIDOfUserPncByteMask: category=VALUE, resulting-properties={base-type=uint8, sw-calibration-access=READ-ONLY, range raw 0..255}
              mc data instance PncIdxOfUserPncByteMask: category=VALUE, resulting-properties={base-type=uint8, sw-calibration-access=READ-ONLY, range raw 0..255}
              mc data instance UserReqPncFullComIdxOfUserPncByteMask: category=VALUE, resulting-properties={base-type=uint8, sw-calibration-access=READ-ONLY, range raw 0..255}
            Element_26: symbol=[26]
              mc data instance PncIDOfUserPncByteMask: category=VALUE, resulting-properties={base-type=uint8, sw-calibration-access=READ-ONLY, range raw 0..255}
              mc data instance PncIdxOfUserPncByteMask: category=VALUE, resulting-properties={base-type=uint8, sw-calibration-access=READ-ONLY, range raw 0..255}
              mc data instance UserReqPncFullComIdxOfUserPncByteMask: category=VALUE, resulting-properties={base-type=uint8, sw-calibration-access=READ-ONLY, range raw 0..255}
            Element_27: symbol=[27]
              mc data instance PncIDOfUserPncByteMask: category=VALUE, resulting-properties={base-type=uint8, sw-calibration-access=READ-ONLY, range raw 0..255}
              mc data instance PncIdxOfUserPncByteMask: category=VALUE, resulting-properties={base-type=uint8, sw-calibration-access=READ-ONLY, range raw 0..255}
              mc data instance UserReqPncFullComIdxOfUserPncByteMask: category=VALUE, resulting-properties={base-type=uint8, sw-calibration-access=READ-ONLY, range raw 0..255}
            Element_28: symbol=[28]
              mc data instance PncIDOfUserPncByteMask: category=VALUE, resulting-properties={base-type=uint8, sw-calibration-access=READ-ONLY, range raw 0..255}
              mc data instance PncIdxOfUserPncByteMask: category=VALUE, resulting-properties={base-type=uint8, sw-calibration-access=READ-ONLY, range raw 0..255}
              mc data instance UserReqPncFullComIdxOfUserPncByteMask: category=VALUE, resulting-properties={base-type=uint8, sw-calibration-access=READ-ONLY, range raw 0..255}
            Element_29: symbol=[29]
              mc data instance PncIDOfUserPncByteMask: category=VALUE, resulting-properties={base-type=uint8, sw-calibration-access=READ-ONLY, range raw 0..255}
              mc data instance PncIdxOfUserPncByteMask: category=VALUE, resulting-properties={base-type=uint8, sw-calibration-access=READ-ONLY, range raw 0..255}
              mc data instance UserReqPncFullComIdxOfUserPncByteMask: category=VALUE, resulting-properties={base-type=uint8, sw-calibration-access=READ-ONLY, range raw 0..255}
            Element_30: symbol=[30]
              mc data instance PncIDOfUserPncByteMask: category=VALUE, resulting-properties={base-type=uint8, sw-calibration-access=READ-ONLY, range raw 0..255}
              mc data instance PncIdxOfUserPncByteMask: category=VALUE, resulting-properties={base-type=uint8, sw-calibration-access=READ-ONLY, range raw 0..255}
              mc data instance UserReqPncFullComIdxOfUserPncByteMask: category=VALUE, resulting-properties={base-type=uint8, sw-calibration-access=READ-ONLY, range raw 0..255}
            Element_31: symbol=[31]
              mc data instance PncIDOfUserPncByteMask: category=VALUE, resulting-properties={base-type=uint8, sw-calibration-access=READ-ONLY, range raw 0..255}
              mc data instance PncIdxOfUserPncByteMask: category=VALUE, resulting-properties={base-type=uint8, sw-calibration-access=READ-ONLY, range raw 0..255}
              mc data instance UserReqPncFullComIdxOfUserPncByteMask: category=VALUE, resulting-properties={base-type=uint8, sw-calibration-access=READ-ONLY, range raw 0..255}
            Element_32: symbol=[32]
              mc data instance PncIDOfUserPncByteMask: category=VALUE, resulting-properties={base-type=uint8, sw-calibration-access=READ-ONLY, range raw 0..255}
              mc data instance PncIdxOfUserPncByteMask: category=VALUE, resulting-properties={base-type=uint8, sw-calibration-access=READ-ONLY, range raw 0..255}
              mc data instance UserReqPncFullComIdxOfUserPncByteMask: category=VALUE, resulting-properties={base-type=uint8, sw-calibration-access=READ-ONLY, range raw 0..255}
            Element_33: symbol=[33]
              mc data instance PncIDOfUserPncByteMask: category=VALUE, resulting-properties={base-type=uint8, sw-calibration-access=READ-ONLY, range raw 0..255}
              mc data instance PncIdxOfUserPncByteMask: category=VALUE, resulting-properties={base-type=uint8, sw-calibration-access=READ-ONLY, range raw 0..255}
              mc data instance UserReqPncFullComIdxOfUserPncByteMask: category=VALUE, resulting-properties={base-type=uint8, sw-calibration-access=READ-ONLY, range raw 0..255}
            Element_34: symbol=[34]
              mc data instance PncIDOfUserPncByteMask: category=VALUE, resulting-properties={base-type=uint8, sw-calibration-access=READ-ONLY, range raw 0..255}
              mc data instance PncIdxOfUserPncByteMask: category=VALUE, resulting-properties={base-type=uint8, sw-calibration-access=READ-ONLY, range raw 0..255}
              mc data instance UserReqPncFullComIdxOfUserPncByteMask: category=VALUE, resulting-properties={base-type=uint8, sw-calibration-access=READ-ONLY, range raw 0..255}
            Element_35: symbol=[35]
              mc data instance PncIDOfUserPncByteMask: category=VALUE, resulting-properties={base-type=uint8, sw-calibration-access=READ-ONLY, range raw 0..255}
              mc data instance PncIdxOfUserPncByteMask: category=VALUE, resulting-properties={base-type=uint8, sw-calibration-access=READ-ONLY, range raw 0..255}
              mc data instance UserReqPncFullComIdxOfUserPncByteMask: category=VALUE, resulting-properties={base-type=uint8, sw-calibration-access=READ-ONLY, range raw 0..255}
            Element_36: symbol=[36]
              mc data instance PncIDOfUserPncByteMask: category=VALUE, resulting-properties={base-type=uint8, sw-calibration-access=READ-ONLY, range raw 0..255}
              mc data instance PncIdxOfUserPncByteMask: category=VALUE, resulting-properties={base-type=uint8, sw-calibration-access=READ-ONLY, range raw 0..255}
              mc data instance UserReqPncFullComIdxOfUserPncByteMask: category=VALUE, resulting-properties={base-type=uint8, sw-calibration-access=READ-ONLY, range raw 0..255}
            Element_37: symbol=[37]
              mc data instance PncIDOfUserPncByteMask: category=VALUE, resulting-properties={base-type=uint8, sw-calibration-access=READ-ONLY, range raw 0..255}
              mc data instance PncIdxOfUserPncByteMask: category=VALUE, resulting-properties={base-type=uint8, sw-calibration-access=READ-ONLY, range raw 0..255}
              mc data instance UserReqPncFullComIdxOfUserPncByteMask: category=VALUE, resulting-properties={base-type=uint8, sw-calibration-access=READ-ONLY, range raw 0..255}
            Element_38: symbol=[38]
              mc data instance PncIDOfUserPncByteMask: category=VALUE, resulting-properties={base-type=uint8, sw-calibration-access=READ-ONLY, range raw 0..255}
              mc data instance PncIdxOfUserPncByteMask: category=VALUE, resulting-properties={base-type=uint8, sw-calibration-access=READ-ONLY, range raw 0..255}
              mc data instance UserReqPncFullComIdxOfUserPncByteMask: category=VALUE, resulting-properties={base-type=uint8, sw-calibration-access=READ-ONLY, range raw 0..255}
            Element_39: symbol=[39]
              mc data instance PncIDOfUserPncByteMask: category=VALUE, resulting-properties={base-type=uint8, sw-calibration-access=READ-ONLY, range raw 0..255}
              mc data instance PncIdxOfUserPncByteMask: category=VALUE, resulting-properties={base-type=uint8, sw-calibration-access=READ-ONLY, range raw 0..255}
              mc data instance UserReqPncFullComIdxOfUserPncByteMask: category=VALUE, resulting-properties={base-type=uint8, sw-calibration-access=READ-ONLY, range raw 0..255}
            Element_40: symbol=[40]
              mc data instance PncIDOfUserPncByteMask: category=VALUE, resulting-properties={base-type=uint8, sw-calibration-access=READ-ONLY, range raw 0..255}
              mc data instance PncIdxOfUserPncByteMask: category=VALUE, resulting-properties={base-type=uint8, sw-calibration-access=READ-ONLY, range raw 0..255}
              mc data instance UserReqPncFullComIdxOfUserPncByteMask: category=VALUE, resulting-properties={base-type=uint8, sw-calibration-access=READ-ONLY, range raw 0..255}
            Element_41: symbol=[41]
              mc data instance PncIDOfUserPncByteMask: category=VALUE, resulting-properties={base-type=uint8, sw-calibration-access=READ-ONLY, range raw 0..255}
              mc data instance PncIdxOfUserPncByteMask: category=VALUE, resulting-properties={base-type=uint8, sw-calibration-access=READ-ONLY, range raw 0..255}
              mc data instance UserReqPncFullComIdxOfUserPncByteMask: category=VALUE, resulting-properties={base-type=uint8, sw-calibration-access=READ-ONLY, range raw 0..255}
            Element_42: symbol=[42]
              mc data instance PncIDOfUserPncByteMask: category=VALUE, resulting-properties={base-type=uint8, sw-calibration-access=READ-ONLY, range raw 0..255}
              mc data instance PncIdxOfUserPncByteMask: category=VALUE, resulting-properties={base-type=uint8, sw-calibration-access=READ-ONLY, range raw 0..255}
              mc data instance UserReqPncFullComIdxOfUserPncByteMask: category=VALUE, resulting-properties={base-type=uint8, sw-calibration-access=READ-ONLY, range raw 0..255}
            Element_43: symbol=[43]
              mc data instance PncIDOfUserPncByteMask: category=VALUE, resulting-properties={base-type=uint8, sw-calibration-access=READ-ONLY, range raw 0..255}
              mc data instance PncIdxOfUserPncByteMask: category=VALUE, resulting-properties={base-type=uint8, sw-calibration-access=READ-ONLY, range raw 0..255}
              mc data instance UserReqPncFullComIdxOfUserPncByteMask: category=VALUE, resulting-properties={base-type=uint8, sw-calibration-access=READ-ONLY, range raw 0..255}
            Element_44: symbol=[44]
              mc data instance PncIDOfUserPncByteMask: category=VALUE, resulting-properties={base-type=uint8, sw-calibration-access=READ-ONLY, range raw 0..255}
              mc data instance PncIdxOfUserPncByteMask: category=VALUE, resulting-properties={base-type=uint8, sw-calibration-access=READ-ONLY, range raw 0..255}
              mc data instance UserReqPncFullComIdxOfUserPncByteMask: category=VALUE, resulting-properties={base-type=uint8, sw-calibration-access=READ-ONLY, range raw 0..255}
            Element_45: symbol=[45]
              mc data instance PncIDOfUserPncByteMask: category=VALUE, resulting-properties={base-type=uint8, sw-calibration-access=READ-ONLY, range raw 0..255}
              mc data instance PncIdxOfUserPncByteMask: category=VALUE, resulting-properties={base-type=uint8, sw-calibration-access=READ-ONLY, range raw 0..255}
              mc data instance UserReqPncFullComIdxOfUserPncByteMask: category=VALUE, resulting-properties={base-type=uint8, sw-calibration-access=READ-ONLY, range raw 0..255}
            Element_46: symbol=[46]
              mc data instance PncIDOfUserPncByteMask: category=VALUE, resulting-properties={base-type=uint8, sw-calibration-access=READ-ONLY, range raw 0..255}
              mc data instance PncIdxOfUserPncByteMask: category=VALUE, resulting-properties={base-type=uint8, sw-calibration-access=READ-ONLY, range raw 0..255}
              mc data instance UserReqPncFullComIdxOfUserPncByteMask: category=VALUE, resulting-properties={base-type=uint8, sw-calibration-access=READ-ONLY, range raw 0..255}
            Element_47: symbol=[47]
              mc data instance PncIDOfUserPncByteMask: category=VALUE, resulting-properties={base-type=uint8, sw-calibration-access=READ-ONLY, range raw 0..255}
              mc data instance PncIdxOfUserPncByteMask: category=VALUE, resulting-properties={base-type=uint8, sw-calibration-access=READ-ONLY, range raw 0..255}
              mc data instance UserReqPncFullComIdxOfUserPncByteMask: category=VALUE, resulting-properties={base-type=uint8, sw-calibration-access=READ-ONLY, range raw 0..255}
        ComM_PncPbInd: array-size=48, resulting-properties={base-type=uint8, sw-calibration-access=READ-ONLY, range raw 0..255}  # the indexes of the 1:1 sorted relation pointing to ComM_PncPb
        ComM_ComAllowed: array-size=2, resulting-properties={base-type=boolean, sw-calibration-access=READ-ONLY, compu {0=FALSE, 1..255=TRUE}, range raw 0..1}, symbol=ComM_ComAllowed.raw  # Communication allowed status of a channel
        ComM_ComAllowed_ComMChannel_0: array-size=1, resulting-properties={base-type=boolean, sw-calibration-access=READ-ONLY, compu {0=FALSE, 1..255=TRUE}, range raw 0..1}, symbol=ComM_ComAllowed.raw[0]  # The element: ComMChannel_0 of ComM_ComAllowed
        ComM_ComAllowed_ComMChannel_1: array-size=1, resulting-properties={base-type=boolean, sw-calibration-access=READ-ONLY, compu {0=FALSE, 1..255=TRUE}, range raw 0..1}, symbol=ComM_ComAllowed.raw[1]  # The element: ComMChannel_1 of ComM_ComAllowed
        ComM_DcmRequestActive: array-size=2, resulting-properties={base-type=boolean, sw-calibration-access=READ-ONLY, compu {0=FALSE, 1..255=TRUE}, range raw 0..1}, symbol=ComM_DcmRequestActive.raw  # Status of Dcm active diagnostic request, TRUE if requested, FALSE otherwise
        ComM_DcmRequestActive_ComMChannel_0: array-size=1, resulting-properties={base-type=boolean, sw-calibration-access=READ-ONLY, compu {0=FALSE, 1..255=TRUE}, range raw 0..1}, symbol=ComM_DcmRequestActive.raw[0]  # The element: ComMChannel_0 of ComM_DcmRequestActive
        ComM_DcmRequestActive_ComMChannel_1: array-size=1, resulting-properties={base-type=boolean, sw-calibration-access=READ-ONLY, compu {0=FALSE, 1..255=TRUE}, range raw 0..1}, symbol=ComM_DcmRequestActive.raw[1]  # The element: ComMChannel_1 of ComM_DcmRequestActive
        ComM_FullComRequesters: array-size=50, resulting-properties={base-type=uint16, sw-calibration-access=READ-ONLY, range raw 0..65535}  # Temporarily stores the IDs of users currently requesting FullComm for a channel. It is used as a pseudo-parameter between ComM_CurrentChannelRequestUpdate and the generated ComM_CurrentChannelRequestNotification.
        ComM_PncPSleepTimer: array-size=48, resulting-properties={base-type=uint16, sw-calibration-access=READ-ONLY, range raw 0..65535}, symbol=ComM_PncPSleepTimer.raw  # partial network prepare sleep timer
        ComM_PncPSleepTimer_PNC_01_CarWakeUp_d7102746: array-size=1, resulting-properties={base-type=uint16, sw-calibration-access=READ-ONLY, range raw 0..65535}, symbol=ComM_PncPSleepTimer.raw[0]  # The element: PNC_01_CarWakeUp_d7102746 of ComM_PncPSleepTimer
        ComM_PncPSleepTimer_PNC_02_Basefunction_Powertrain_6b6ac64e: array-size=1, resulting-properties={base-type=uint16, sw-calibration-access=READ-ONLY, range raw 0..65535}, symbol=ComM_PncPSleepTimer.raw[1]  # The element: PNC_02_Basefunction_Powertrain_6b6ac64e of ComM_PncPSleepTimer
        ComM_PncPSleepTimer_PNC_03_Basefunction_Chassis_a155dfc3: array-size=1, resulting-properties={base-type=uint16, sw-calibration-access=READ-ONLY, range raw 0..65535}, symbol=ComM_PncPSleepTimer.raw[2]  # The element: PNC_03_Basefunction_Chassis_a155dfc3 of ComM_PncPSleepTimer
        ComM_PncPSleepTimer_PNC_04_Basefunction_DrivingAssistance_f26b19b4: array-size=1, resulting-properties={base-type=uint16, sw-calibration-access=READ-ONLY, range raw 0..65535}, symbol=ComM_PncPSleepTimer.raw[3]  # The element: PNC_04_Basefunction_DrivingAssistance_f26b19b4 of ComM_PncPSleepTimer
        ComM_PncPSleepTimer_PNC_05_Basefunction_Infotainment_f043623b: array-size=1, resulting-properties={base-type=uint16, sw-calibration-access=READ-ONLY, range raw 0..65535}, symbol=ComM_PncPSleepTimer.raw[4]  # The element: PNC_05_Basefunction_Infotainment_f043623b of ComM_PncPSleepTimer
        ComM_PncPSleepTimer_PNC_06_Basefunction_ComfortLight_d2d0a736: array-size=1, resulting-properties={base-type=uint16, sw-calibration-access=READ-ONLY, range raw 0..65535}, symbol=ComM_PncPSleepTimer.raw[5]  # The element: PNC_06_Basefunction_ComfortLight_d2d0a736 of ComM_PncPSleepTimer
        ComM_PncPSleepTimer_PNC_07_Basefunction_CrossSection_7b625db2: array-size=1, resulting-properties={base-type=uint16, sw-calibration-access=READ-ONLY, range raw 0..65535}, symbol=ComM_PncPSleepTimer.raw[6]  # The element: PNC_07_Basefunction_CrossSection_7b625db2 of ComM_PncPSleepTimer
        ComM_PncPSleepTimer_PNC_08_Basefunction_Connectivity_56f2bd6b: array-size=1, resulting-properties={base-type=uint16, sw-calibration-access=READ-ONLY, range raw 0..65535}, symbol=ComM_PncPSleepTimer.raw[7]  # The element: PNC_08_Basefunction_Connectivity_56f2bd6b of ComM_PncPSleepTimer
        ComM_PncPSleepTimer_PNC_10_Powertrain_b3959ad4: array-size=1, resulting-properties={base-type=uint16, sw-calibration-access=READ-ONLY, range raw 0..65535}, symbol=ComM_PncPSleepTimer.raw[8]  # The element: PNC_10_Powertrain_b3959ad4 of ComM_PncPSleepTimer
        ComM_PncPSleepTimer_PNC_11_Chassis_dce36bbc: array-size=1, resulting-properties={base-type=uint16, sw-calibration-access=READ-ONLY, range raw 0..65535}, symbol=ComM_PncPSleepTimer.raw[9]  # The element: PNC_11_Chassis_dce36bbc of ComM_PncPSleepTimer
        ComM_PncPSleepTimer_PNC_12_GearSelector_9f4a754a: array-size=1, resulting-properties={base-type=uint16, sw-calibration-access=READ-ONLY, range raw 0..65535}, symbol=ComM_PncPSleepTimer.raw[10]  # The element: PNC_12_GearSelector_9f4a754a of ComM_PncPSleepTimer
        ComM_PncPSleepTimer_PNC_13_Airbag_727cecad: array-size=1, resulting-properties={base-type=uint16, sw-calibration-access=READ-ONLY, range raw 0..65535}, symbol=ComM_PncPSleepTimer.raw[11]  # The element: PNC_13_Airbag_727cecad of ComM_PncPSleepTimer
        ComM_PncPSleepTimer_PNC_14_InfotainmentExtensions_ca9cb1f5: array-size=1, resulting-properties={base-type=uint16, sw-calibration-access=READ-ONLY, range raw 0..65535}, symbol=ComM_PncPSleepTimer.raw[12]  # The element: PNC_14_InfotainmentExtensions_ca9cb1f5 of ComM_PncPSleepTimer
        ComM_PncPSleepTimer_PNC_15_InstrumentclusterDisplay_afd3c636: array-size=1, resulting-properties={base-type=uint16, sw-calibration-access=READ-ONLY, range raw 0..65535}, symbol=ComM_PncPSleepTimer.raw[13]  # The element: PNC_15_InstrumentclusterDisplay_afd3c636 of ComM_PncPSleepTimer
        ComM_PncPSleepTimer_PNC_16_InfotainmentDisplay_e8d84b12: array-size=1, resulting-properties={base-type=uint16, sw-calibration-access=READ-ONLY, range raw 0..65535}, symbol=ComM_PncPSleepTimer.raw[14]  # The element: PNC_16_InfotainmentDisplay_e8d84b12 of ComM_PncPSleepTimer
        ComM_PncPSleepTimer_PNC_17_Audio_8cbcad43: array-size=1, resulting-properties={base-type=uint16, sw-calibration-access=READ-ONLY, range raw 0..65535}, symbol=ComM_PncPSleepTimer.raw[15]  # The element: PNC_17_Audio_8cbcad43 of ComM_PncPSleepTimer
        ComM_PncPSleepTimer_PNC_18_VirtualSideMirrors_5814f436: array-size=1, resulting-properties={base-type=uint16, sw-calibration-access=READ-ONLY, range raw 0..65535}, symbol=ComM_PncPSleepTimer.raw[16]  # The element: PNC_18_VirtualSideMirrors_5814f436 of ComM_PncPSleepTimer
        ComM_PncPSleepTimer_PNC_19_Doors_Hatches_6a90831c: array-size=1, resulting-properties={base-type=uint16, sw-calibration-access=READ-ONLY, range raw 0..65535}, symbol=ComM_PncPSleepTimer.raw[17]  # The element: PNC_19_Doors_Hatches_6a90831c of ComM_PncPSleepTimer
        ComM_PncPSleepTimer_PNC_20_OptionalComfort_769509a7: array-size=1, resulting-properties={base-type=uint16, sw-calibration-access=READ-ONLY, range raw 0..65535}, symbol=ComM_PncPSleepTimer.raw[18]  # The element: PNC_20_OptionalComfort_769509a7 of ComM_PncPSleepTimer
        ComM_PncPSleepTimer_PNC_21_AirSuspension_32658f46: array-size=1, resulting-properties={base-type=uint16, sw-calibration-access=READ-ONLY, range raw 0..65535}, symbol=ComM_PncPSleepTimer.raw[19]  # The element: PNC_21_AirSuspension_32658f46 of ComM_PncPSleepTimer
        ComM_PncPSleepTimer_PNC_22_ExteriorLights_ee477910: array-size=1, resulting-properties={base-type=uint16, sw-calibration-access=READ-ONLY, range raw 0..65535}, symbol=ComM_PncPSleepTimer.raw[20]  # The element: PNC_22_ExteriorLights_ee477910 of ComM_PncPSleepTimer
        ComM_PncPSleepTimer_PNC_23_Climate_ab0b2697: array-size=1, resulting-properties={base-type=uint16, sw-calibration-access=READ-ONLY, range raw 0..65535}, symbol=ComM_PncPSleepTimer.raw[21]  # The element: PNC_23_Climate_ab0b2697 of ComM_PncPSleepTimer
        ComM_PncPSleepTimer_PNC_24_ThermoManagement_4f639819: array-size=1, resulting-properties={base-type=uint16, sw-calibration-access=READ-ONLY, range raw 0..65535}, symbol=ComM_PncPSleepTimer.raw[22]  # The element: PNC_24_ThermoManagement_4f639819 of ComM_PncPSleepTimer
        ComM_PncPSleepTimer_PNC_25_AccessSystemSensors_0f593a4b: array-size=1, resulting-properties={base-type=uint16, sw-calibration-access=READ-ONLY, range raw 0..65535}, symbol=ComM_PncPSleepTimer.raw[23]  # The element: PNC_25_AccessSystemSensors_0f593a4b of ComM_PncPSleepTimer
        ComM_PncPSleepTimer_PNC_26_HighVoltage_Charging_24d89ab8: array-size=1, resulting-properties={base-type=uint16, sw-calibration-access=READ-ONLY, range raw 0..65535}, symbol=ComM_PncPSleepTimer.raw[24]  # The element: PNC_26_HighVoltage_Charging_24d89ab8 of ComM_PncPSleepTimer
        ComM_PncPSleepTimer_PNC_27_Timemaster_Timer_8da5bb27: array-size=1, resulting-properties={base-type=uint16, sw-calibration-access=READ-ONLY, range raw 0..65535}, symbol=ComM_PncPSleepTimer.raw[25]  # The element: PNC_27_Timemaster_Timer_8da5bb27 of ComM_PncPSleepTimer
        ComM_PncPSleepTimer_PNC_28_OnboardTester_DataCollector_1afa9561: array-size=1, resulting-properties={base-type=uint16, sw-calibration-access=READ-ONLY, range raw 0..65535}, symbol=ComM_PncPSleepTimer.raw[26]  # The element: PNC_28_OnboardTester_DataCollector_1afa9561 of ComM_PncPSleepTimer
        ComM_PncPSleepTimer_PNC_29_SteeringColumnLock_af7c21af: array-size=1, resulting-properties={base-type=uint16, sw-calibration-access=READ-ONLY, range raw 0..65535}, symbol=ComM_PncPSleepTimer.raw[27]  # The element: PNC_29_SteeringColumnLock_af7c21af of ComM_PncPSleepTimer
        ComM_PncPSleepTimer_PNC_30_EnergyManagement_9072504c: array-size=1, resulting-properties={base-type=uint16, sw-calibration-access=READ-ONLY, range raw 0..65535}, symbol=ComM_PncPSleepTimer.raw[28]  # The element: PNC_30_EnergyManagement_9072504c of ComM_PncPSleepTimer
        ComM_PncPSleepTimer_PNC_31_MultifunctionalSteeringWheel_4e0a8e7c: array-size=1, resulting-properties={base-type=uint16, sw-calibration-access=READ-ONLY, range raw 0..65535}, symbol=ComM_PncPSleepTimer.raw[29]  # The element: PNC_31_MultifunctionalSteeringWheel_4e0a8e7c of ComM_PncPSleepTimer
        ComM_PncPSleepTimer_PNC_32_OnlineAccess_91b6041d: array-size=1, resulting-properties={base-type=uint16, sw-calibration-access=READ-ONLY, range raw 0..65535}, symbol=ComM_PncPSleepTimer.raw[30]  # The element: PNC_32_OnlineAccess_91b6041d of ComM_PncPSleepTimer
        ComM_PncPSleepTimer_PNC_33_ExternalWirelessCommunication_85f99735: array-size=1, resulting-properties={base-type=uint16, sw-calibration-access=READ-ONLY, range raw 0..65535}, symbol=ComM_PncPSleepTimer.raw[31]  # The element: PNC_33_ExternalWirelessCommunication_85f99735 of ComM_PncPSleepTimer
        ComM_PncPSleepTimer_PNC_34_GPS_Lokalization_74821ca8: array-size=1, resulting-properties={base-type=uint16, sw-calibration-access=READ-ONLY, range raw 0..65535}, symbol=ComM_PncPSleepTimer.raw[32]  # The element: PNC_34_GPS_Lokalization_74821ca8 of ComM_PncPSleepTimer
        ComM_PncPSleepTimer_PNC_35_ExteriorSound_90ecdcdb: array-size=1, resulting-properties={base-type=uint16, sw-calibration-access=READ-ONLY, range raw 0..65535}, symbol=ComM_PncPSleepTimer.raw[33]  # The element: PNC_35_ExteriorSound_90ecdcdb of ComM_PncPSleepTimer
        ComM_PncPSleepTimer_PNC_36_Preheater_b14f0d7f: array-size=1, resulting-properties={base-type=uint16, sw-calibration-access=READ-ONLY, range raw 0..65535}, symbol=ComM_PncPSleepTimer.raw[34]  # The element: PNC_36_Preheater_b14f0d7f of ComM_PncPSleepTimer
        ComM_PncPSleepTimer_PNC_37_HighVoltage_WirelessChargingStation_717f15f0: array-size=1, resulting-properties={base-type=uint16, sw-calibration-access=READ-ONLY, range raw 0..65535}, symbol=ComM_PncPSleepTimer.raw[35]  # The element: PNC_37_HighVoltage_WirelessChargingStation_717f15f0 of ComM_PncPSleepTimer
        ComM_PncPSleepTimer_PNC_40_Diagnosis_Energy_40b20ab8: array-size=1, resulting-properties={base-type=uint16, sw-calibration-access=READ-ONLY, range raw 0..65535}, symbol=ComM_PncPSleepTimer.raw[36]  # The element: PNC_40_Diagnosis_Energy_40b20ab8 of ComM_PncPSleepTimer
        ComM_PncPSleepTimer_PNC_41_Diagnosis_Powertrain_d7bd9faf: array-size=1, resulting-properties={base-type=uint16, sw-calibration-access=READ-ONLY, range raw 0..65535}, symbol=ComM_PncPSleepTimer.raw[37]  # The element: PNC_41_Diagnosis_Powertrain_d7bd9faf of ComM_PncPSleepTimer
        ComM_PncPSleepTimer_PNC_42_Diagnosis_FlexRay_e9cd26c7: array-size=1, resulting-properties={base-type=uint16, sw-calibration-access=READ-ONLY, range raw 0..65535}, symbol=ComM_PncPSleepTimer.raw[38]  # The element: PNC_42_Diagnosis_FlexRay_e9cd26c7 of ComM_PncPSleepTimer
        ComM_PncPSleepTimer_PNC_43_Diagnosis_DrivingAssistance_906b6e52: array-size=1, resulting-properties={base-type=uint16, sw-calibration-access=READ-ONLY, range raw 0..65535}, symbol=ComM_PncPSleepTimer.raw[39]  # The element: PNC_43_Diagnosis_DrivingAssistance_906b6e52 of ComM_PncPSleepTimer
        ComM_PncPSleepTimer_PNC_44_Diagnosis_Infotainment_d2af29c0: array-size=1, resulting-properties={base-type=uint16, sw-calibration-access=READ-ONLY, range raw 0..65535}, symbol=ComM_PncPSleepTimer.raw[40]  # The element: PNC_44_Diagnosis_Infotainment_d2af29c0 of ComM_PncPSleepTimer
        ComM_PncPSleepTimer_PNC_45_Diagnosis_Comfort_54b3da15: array-size=1, resulting-properties={base-type=uint16, sw-calibration-access=READ-ONLY, range raw 0..65535}, symbol=ComM_PncPSleepTimer.raw[41]  # The element: PNC_45_Diagnosis_Comfort_54b3da15 of ComM_PncPSleepTimer
        ComM_PncPSleepTimer_PNC_46_Diagnosis_Light_2422ec0e: array-size=1, resulting-properties={base-type=uint16, sw-calibration-access=READ-ONLY, range raw 0..65535}, symbol=ComM_PncPSleepTimer.raw[42]  # The element: PNC_46_Diagnosis_Light_2422ec0e of ComM_PncPSleepTimer
        ComM_PncPSleepTimer_PNC_47_Diagnosis_ComfortLINs_fb22fd75: array-size=1, resulting-properties={base-type=uint16, sw-calibration-access=READ-ONLY, range raw 0..65535}, symbol=ComM_PncPSleepTimer.raw[43]  # The element: PNC_47_Diagnosis_ComfortLINs_fb22fd75 of ComM_PncPSleepTimer
        ComM_PncPSleepTimer_PNC_48_Diagnosis_ClimateTmeLINs_cce3bfb2: array-size=1, resulting-properties={base-type=uint16, sw-calibration-access=READ-ONLY, range raw 0..65535}, symbol=ComM_PncPSleepTimer.raw[44]  # The element: PNC_48_Diagnosis_ClimateTmeLINs_cce3bfb2 of ComM_PncPSleepTimer
        ComM_PncPSleepTimer_PNC_53_Lock_Unlock_51015b9a: array-size=1, resulting-properties={base-type=uint16, sw-calibration-access=READ-ONLY, range raw 0..65535}, symbol=ComM_PncPSleepTimer.raw[45]  # The element: PNC_53_Lock_Unlock_51015b9a of ComM_PncPSleepTimer
        ComM_PncPSleepTimer_PNC_55_Dimming_ea37854f: array-size=1, resulting-properties={base-type=uint16, sw-calibration-access=READ-ONLY, range raw 0..65535}, symbol=ComM_PncPSleepTimer.raw[46]  # The element: PNC_55_Dimming_ea37854f of ComM_PncPSleepTimer
        ComM_PncPSleepTimer_PNC_56_Charging_Status_19bd3663: array-size=1, resulting-properties={base-type=uint16, sw-calibration-access=READ-ONLY, range raw 0..65535}, symbol=ComM_PncPSleepTimer.raw[47]  # The element: PNC_56_Charging_Status_19bd3663 of ComM_PncPSleepTimer
        ComM_PncSignalValues: array-size=14, resulting-properties={base-type=uint8, sw-calibration-access=READ-ONLY, range raw 0..255}, symbol=ComM_PncSignalValues.raw
        ComM_PncSignalValues_ComM_ComConf_ComSignal_ComSignalPnc_EIRA_CAN_Rx: array-size=7, resulting-properties={base-type=uint8, sw-calibration-access=READ-ONLY, range raw 0..255}, symbol=ComM_PncSignalValues.raw[0]  # The element: ComM_ComConf_ComSignal_ComSignalPnc_EIRA_CAN_Rx of ComM_PncSignalValues
        ComM_PncSignalValues_ComM_ComConf_ComSignal_NM_Hybrid_01_FCAB_XIX_NM_Hybrid_01_XIX_HCP5_CANFD01_38c188fa_Tx: array-size=7, resulting-properties={base-type=uint8, sw-calibration-access=READ-ONLY, range raw 0..255}, symbol=ComM_PncSignalValues.raw[7]  # The element: ComM_ComConf_ComSignal_NM_Hybrid_01_FCAB_XIX_NM_Hybrid_01_XIX_HCP5_CANFD01_38c188fa_Tx of ComM_PncSignalValues
        ComM_PncToChannelRoutingState: array-size=2, resulting-properties={base-type=uint8, sw-calibration-access=READ-ONLY, range raw 0..255}, symbol=ComM_PncToChannelRoutingState.raw  # Bit flags describing the current PNC Routing state per channel
        ComM_PncToChannelRoutingState_ComMChannel_0: array-size=1, resulting-properties={base-type=uint8, sw-calibration-access=READ-ONLY, range raw 0..255}, symbol=ComM_PncToChannelRoutingState.raw[0]  # The element: ComMChannel_0 of ComM_PncToChannelRoutingState
        ComM_PncToChannelRoutingState_ComMChannel_1: array-size=1, resulting-properties={base-type=uint8, sw-calibration-access=READ-ONLY, range raw 0..255}, symbol=ComM_PncToChannelRoutingState.raw[1]  # The element: ComMChannel_1 of ComM_PncToChannelRoutingState
        ComM_PostInitialized: array-size=1, resulting-properties={base-type=boolean, sw-calibration-access=READ-ONLY, compu {0=FALSE, 1..255=TRUE}, range raw 0..1}  # Post-Initialized state
        ComM_UserReqFullCom: array-size=8, resulting-properties={base-type=uint8, sw-calibration-access=READ-ONLY, range raw 0..255}  # RAM array used to store user requests for channels as bitmasks. Each channel 'owns' 1..n bytes in this array, depending on the number of users assigned to it.
        ComM_UserReqPncFullCom: array-size=48, resulting-properties={base-type=uint8, sw-calibration-access=READ-ONLY, range raw 0..255}  # RAM array used to store user requests for PNCs as bitmasks. Each PNC 'owns' 1..n bytes in this array, depending on the number of users assigned to it.
        ComM_BusSmState: array-size=2, resulting-properties={base-type=uint8, sw-calibration-access=READ-ONLY, compu {0=COMM_NO_COMMUNICATION, 1=COMM_SILENT_COMMUNICATION, 2=COMM_FULL_COMMUNICATION}, range raw 0..255}, symbol=ComM_BusSmState.raw  # Current BusSM communication state
        ComM_BusComModeReq: array-size=2, resulting-properties={base-type=uint8, sw-calibration-access=READ-ONLY, compu-method=CompuMethod_ComM_ComModeType_Values, range raw 0..255}, symbol=ComM_BusComModeReq.raw  # requested ComM communication channel mode
        ComM_ActiveComMode: array-size=2, resulting-properties={base-type=uint8, sw-calibration-access=READ-ONLY, compu-method=CompuMethod_ComM_ComModeType_Values, range raw 0..255}, symbol=ComM_ActiveComMode.raw  # Current ComM communication state
    resource consumption ResourceConsumption
      73 x memory section:
        VAR_SAVED_ZONE0_8: alignment=8, sw-addrmethod=VAR_SAVED_ZONE
        VAR_NOCACHE_CLEARED_UNSPECIFIED: alignment=UNSPECIFIED, sw-addrmethod=VAR_NOCACHE_CLEARED
        VAR_FAST_INIT_64: alignment=64, sw-addrmethod=VAR_FAST_INIT
        VAR_FAST_CLEARED_UNSPECIFIED: alignment=UNSPECIFIED, sw-addrmethod=VAR_FAST_CLEARED
        VAR_NO_INIT_8: alignment=8, sw-addrmethod=VAR_NO_INIT
        VAR_NOCACHE_CLEARED_16: alignment=16, sw-addrmethod=VAR_NOCACHE_CLEARED
        VAR_NO_INIT_16: alignment=16, sw-addrmethod=VAR_NO_INIT
        VAR_SAVED_ZONE0_16: alignment=16, sw-addrmethod=VAR_SAVED_ZONE
        CONST_16: alignment=16, sw-addrmethod=CONST
        VAR_SAVED_ZONE0_BOOLEAN: alignment=BOOLEAN, sw-addrmethod=VAR_SAVED_ZONE
        VAR_FAST_CLEARED_8: alignment=8, sw-addrmethod=VAR_FAST_CLEARED
        CODE: sw-addrmethod=CODE
        VAR_NOCACHE_SAVED_ZONE0_8: alignment=8, sw-addrmethod=VAR_SAVED_ZONE
        CONST_64: alignment=64, sw-addrmethod=CONST
        VAR_NOCACHE_CLEARED_8: alignment=8, sw-addrmethod=VAR_NOCACHE_CLEARED
        VAR_CLEARED_16: alignment=16, sw-addrmethod=VAR_CLEARED
        VAR_NOCACHE_CLEARED_BOOLEAN: alignment=BOOLEAN, sw-addrmethod=VAR_NOCACHE_CLEARED
        VAR_FAST_NO_INIT_16: alignment=16, sw-addrmethod=VAR_FAST_NO_INIT
        VAR_NO_INIT_64: alignment=64, sw-addrmethod=VAR_NO_INIT
        VAR_NOCACHE_CLEARED_64: alignment=64, sw-addrmethod=VAR_NOCACHE_CLEARED
        VAR_NOCACHE_INIT_32: alignment=32, sw-addrmethod=VAR_NOCACHE_INIT
        VAR_FAST_INIT_32: alignment=32, sw-addrmethod=VAR_FAST_INIT
        VAR_NOCACHE_SAVED_ZONE0_16: alignment=16, sw-addrmethod=VAR_SAVED_ZONE
        VAR_NO_INIT_UNSPECIFIED: alignment=UNSPECIFIED, sw-addrmethod=VAR_NO_INIT
        VAR_CLEARED_8: alignment=8, sw-addrmethod=VAR_CLEARED
        VAR_FAST_CLEARED_16: alignment=16, sw-addrmethod=VAR_FAST_CLEARED
        VAR_NOCACHE_INIT_8: alignment=8, sw-addrmethod=VAR_NOCACHE_INIT
        CONST_UNSPECIFIED: alignment=UNSPECIFIED, sw-addrmethod=CONST
        VAR_NOCACHE_NO_INIT_32: alignment=32, sw-addrmethod=VAR_NOCACHE_NO_INIT
        CONST_32: alignment=32, sw-addrmethod=CONST
        VAR_FAST_CLEARED_64: alignment=64, sw-addrmethod=VAR_FAST_CLEARED
        VAR_INIT_32: alignment=32, sw-addrmethod=VAR_INIT
        VAR_FAST_NO_INIT_64: alignment=64, sw-addrmethod=VAR_FAST_NO_INIT
        VAR_INIT_8: alignment=8, sw-addrmethod=VAR_INIT
        VAR_CLEARED_64: alignment=64, sw-addrmethod=VAR_CLEARED
        VAR_NO_INIT_32: alignment=32, sw-addrmethod=VAR_NO_INIT
        VAR_NOCACHE_INIT_64: alignment=64, sw-addrmethod=VAR_NOCACHE_INIT
        VAR_NOCACHE_CLEARED_32: alignment=32, sw-addrmethod=VAR_NOCACHE_CLEARED
        VAR_NOCACHE_INIT_BOOLEAN: alignment=BOOLEAN, sw-addrmethod=VAR_NOCACHE_INIT
        VAR_FAST_NO_INIT_BOOLEAN: alignment=BOOLEAN, sw-addrmethod=VAR_FAST_NO_INIT
        VAR_SAVED_ZONE0_32: alignment=32, sw-addrmethod=VAR_SAVED_ZONE
        VAR_FAST_CLEARED_BOOLEAN: alignment=BOOLEAN, sw-addrmethod=VAR_FAST_CLEARED
        VAR_SAVED_ZONE0_UNSPECIFIED: alignment=UNSPECIFIED, sw-addrmethod=VAR_SAVED_ZONE
        VAR_CLEARED_BOOLEAN: alignment=BOOLEAN, sw-addrmethod=VAR_CLEARED
        VAR_NOCACHE_SAVED_ZONE0_64: alignment=64, sw-addrmethod=VAR_SAVED_ZONE
        VAR_NO_INIT_BOOLEAN: alignment=BOOLEAN, sw-addrmethod=VAR_NO_INIT
        VAR_NOCACHE_NO_INIT_64: alignment=64, sw-addrmethod=VAR_NOCACHE_NO_INIT
        VAR_FAST_CLEARED_32: alignment=32, sw-addrmethod=VAR_FAST_CLEARED
        VAR_NOCACHE_NO_INIT_UNSPECIFIED: alignment=UNSPECIFIED, sw-addrmethod=VAR_NOCACHE_NO_INIT
        VAR_INIT_64: alignment=64, sw-addrmethod=VAR_INIT
        VAR_NOCACHE_SAVED_ZONE0_BOOLEAN: alignment=BOOLEAN, sw-addrmethod=VAR_SAVED_ZONE
        VAR_CLEARED_UNSPECIFIED: alignment=UNSPECIFIED, sw-addrmethod=VAR_CLEARED
        VAR_INIT_UNSPECIFIED: alignment=UNSPECIFIED, sw-addrmethod=VAR_INIT
        CONST_8: alignment=8, sw-addrmethod=CONST
        VAR_NOCACHE_SAVED_ZONE0_UNSPECIFIED: alignment=UNSPECIFIED, sw-addrmethod=VAR_SAVED_ZONE
        VAR_FAST_NO_INIT_32: alignment=32, sw-addrmethod=VAR_FAST_NO_INIT
        VAR_CLEARED_32: alignment=32, sw-addrmethod=VAR_CLEARED
        VAR_NOCACHE_NO_INIT_BOOLEAN: alignment=BOOLEAN, sw-addrmethod=VAR_NOCACHE_NO_INIT
        VAR_INIT_BOOLEAN: alignment=BOOLEAN, sw-addrmethod=VAR_INIT
        VAR_NOCACHE_INIT_UNSPECIFIED: alignment=UNSPECIFIED, sw-addrmethod=VAR_NOCACHE_INIT
        VAR_FAST_INIT_UNSPECIFIED: alignment=UNSPECIFIED, sw-addrmethod=VAR_FAST_INIT
        VAR_FAST_NO_INIT_8: alignment=8, sw-addrmethod=VAR_FAST_NO_INIT
        VAR_FAST_INIT_8: alignment=8, sw-addrmethod=VAR_FAST_INIT
        VAR_NOCACHE_INIT_16: alignment=16, sw-addrmethod=VAR_NOCACHE_INIT
        VAR_FAST_NO_INIT_UNSPECIFIED: alignment=UNSPECIFIED, sw-addrmethod=VAR_FAST_NO_INIT
        VAR_SAVED_ZONE0_64: alignment=64, sw-addrmethod=VAR_SAVED_ZONE
        VAR_FAST_INIT_BOOLEAN: alignment=BOOLEAN, sw-addrmethod=VAR_FAST_INIT
        VAR_FAST_INIT_16: alignment=16, sw-addrmethod=VAR_FAST_INIT
        VAR_NOCACHE_NO_INIT_8: alignment=8, sw-addrmethod=VAR_NOCACHE_NO_INIT
        CONST_BOOLEAN: alignment=BOOLEAN, sw-addrmethod=CONST
        VAR_NOCACHE_SAVED_ZONE0_32: alignment=32, sw-addrmethod=VAR_SAVED_ZONE
        VAR_INIT_16: alignment=16, sw-addrmethod=VAR_INIT
        VAR_NOCACHE_NO_INIT_16: alignment=16, sw-addrmethod=VAR_NOCACHE_NO_INIT
package /MICROSAR/ComM_ib_bswmd/BswModuleDescriptions
  bsw module description ComM
    provided-entrys:
      ComM_MainFunction_{0..4}
      ComM_MainFunction_7
      ComM_MainFunction_6
      ComM_MainFunction_5
    bsw internal behavior ComMBehavior
      8 x exclusive area:
        COMM_EXCLUSIVE_AREA_0
        COMM_EXCLUSIVE_AREA_1
        COMM_EXCLUSIVE_AREA_{2..7}  # This exclusive area is only used in case of multi-partition. It must be configured as a spinlock to allow access to some variables simultaneously from multiple cores.
      bsw schedulable entity ComM_MainFunction_0: can-enter-exclusive-area=[COMM_EXCLUSIVE_AREA_0, COMM_EXCLUSIVE_AREA_1, COMM_EXCLUSIVE_AREA_2, COMM_EXCLUSIVE_AREA_3, COMM_EXCLUSIVE_AREA_4, COMM_EXCLUSIVE_AREA_5, COMM_EXCLUSIVE_AREA_6, COMM_EXCLUSIVE_AREA_7], implemented-entry=ComM_MainFunction_0
      bsw schedulable entity ComM_MainFunction_1: can-enter-exclusive-area=[COMM_EXCLUSIVE_AREA_0, COMM_EXCLUSIVE_AREA_1, COMM_EXCLUSIVE_AREA_2, COMM_EXCLUSIVE_AREA_3, COMM_EXCLUSIVE_AREA_4, COMM_EXCLUSIVE_AREA_5, COMM_EXCLUSIVE_AREA_6, COMM_EXCLUSIVE_AREA_7], implemented-entry=ComM_MainFunction_1
      bsw timing event ComM_MainFunction_0TimingEvent0: starts-on-event=ComM_MainFunction_0, period=0.02
      bsw timing event ComM_MainFunction_1TimingEvent0: starts-on-event=ComM_MainFunction_1, period=0.02
  8 x bsw module entry, all with call-type=SCHEDULED, execution-context=TASK:
    ComM_MainFunction_{0..4}
    ComM_MainFunction_7
    ComM_MainFunction_6
    ComM_MainFunction_5
package /MICROSAR/ComM_ib_bswmd/DataTypes/CompuMethods
  compu method CompuMethod_ComM_ComModeType_Values: 0=COMM_NO_COM_NO_PENDING_REQUEST, 1=COMM_NO_COM_REQUEST_PENDING, 2=COMM_FULL_COM_NETWORK_REQUESTED, 3=COMM_FULL_COM_READY_SLEEP, 4=COMM_SILENT_COM
