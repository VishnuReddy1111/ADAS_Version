[part 1 of 2: package /MICROSAR]
AUTOSAR XML (schema 4-3-0)
standard types defined: boolean, uint8, uint32, uint16
package /MICROSAR
  bsw implementation ComM_Impl: programming-language=C, sw-version=16.00.01, used-code-generator=DaVinci Configurator, vendor-id=30, ar-release-version=4.00.03
    mc-variable-instances:
      77 x mc data instance, all with category=ARRAY:
        ComM_ChannelPb: array-size=2  # Contains PostBuild configuration parameters of channels
          mc data instance Element_0: category=STRUCTURE, symbol=[0]
            4 x mc data instance, all with category=VALUE:
              PncPbIndEndIdxOfChannelPb: resulting-properties={base-type=uint8, sw-calibration-access=READ-ONLY, compu {255=COMM_NO_PNCPBINDENDIDXOFCHANNELPB}, range raw 0..255}
              PncPbIndStartIdxOfChannelPb: resulting-properties={base-type=uint8, sw-calibration-access=READ-ONLY, compu {255=COMM_NO_PNCPBINDSTARTIDXOFCHANNELPB}, range raw 0..255}
              UserReqFullComEndIdxOfChannelPb: resulting-properties={base-type=uint8, sw-calibration-access=READ-ONLY, compu {255=COMM_NO_USERREQFULLCOMENDIDXOFCHANNELPB}, range raw 0..255}
              UserReqFullComStartIdxOfChannelPb: resulting-properties={base-type=uint8, sw-calibration-access=READ-ONLY, compu {255=COMM_NO_USERREQFULLCOMSTARTIDXOFCHANNELPB}, range raw 0..255}
          mc data instance Element_1: category=STRUCTURE, symbol=[1]
            4 x mc data instance, all with category=VALUE:
              PncPbIndEndIdxOfChannelPb: resulting-properties={base-type=uint8, sw-calibration-access=READ-ONLY, compu {255=COMM_NO_PNCPBINDENDIDXOFCHANNELPB}, range raw 0..255}
              PncPbIndStartIdxOfChannelPb: resulting-properties={base-type=uint8, sw-calibration-access=READ-ONLY, compu {255=COMM_NO_PNCPBINDSTARTIDXOFCHANNELPB}, range raw 0..255}
              UserReqFullComEndIdxOfChannelPb: resulting-properties={base-type=uint8, sw-calibration-access=READ-ONLY, compu {255=COMM_NO_USERREQFULLCOMENDIDXOFCHANNELPB}, range raw 0..255}
              UserReqFullComStartIdxOfChannelPb: resulting-properties={base-type=uint8, sw-calibration-access=READ-ONLY, compu {255=COMM_NO_USERREQFULLCOMSTARTIDXOFCHANNELPB}, range raw 0..255}
        ComM_PartitionIdentifiers: array-size=1  # the partition context in Config
          mc data instance Element_0: category=STRUCTURE, symbol=[0]
            mc data instance PartitionSNVOfPartitionIdentifiers: category=VALUE, resulting-properties={base-type=uint32, sw-calibration-access=READ-ONLY, range raw 0..4294967295}
            mc data instance PCPartitionConfigIdxOfPartitionIdentifiers: category=VALUE, resulting-properties={base-type=uint8, sw-calibration-access=READ-ONLY, range raw 0..255}
        ComM_Pnc: array-size=48  # Contains PreCompile configuration parameters of partial networks
          48 x mc data instance, all with category=STRUCTURE:
            Element_0: symbol=[0]
              mc data instance ClearMaskOfPnc: category=VALUE, resulting-properties={base-type=uint8, sw-calibration-access=READ-ONLY, range raw 0..255}
              mc data instance PncIdOfPnc: category=VALUE, resulting-properties={base-type=uint8, sw-calibration-access=READ-ONLY, range raw 0..255}
              mc data instance SetMaskOfPnc: category=VALUE, resulting-properties={base-type=uint8, sw-calibration-access=READ-ONLY, range raw 0..255}
            Element_1: symbol=[1]
              mc data instance ClearMaskOfPnc: category=VALUE, resulting-properties={base-type=uint8, sw-calibration-access=READ-ONLY, range raw 0..255}
              mc data instance PncIdOfPnc: category=VALUE, resulting-properties={base-type=uint8, sw-calibration-access=READ-ONLY, range raw 0..255}
              mc data instance SetMaskOfPnc: category=VALUE, resulting-properties={base-type=uint8, sw-calibration-access=READ-ONLY, range raw 0..255}
            Element_2: symbol=[2]
              mc data instance ClearMaskOfPnc: category=VALUE, resulting-properties={base-type=uint8, sw-calibration-access=READ-ONLY, range raw 0..255}
              mc data instance PncIdOfPnc: category=VALUE, resulting-properties={base-type=uint8, sw-calibration-access=READ-ONLY, range raw 0..255}
              mc data instance SetMaskOfPnc: category=VALUE, resulting-properties={base-type=uint8, sw-calibration-access=READ-ONLY, range raw 0..255}
            Element_3: symbol=[3]
              mc data instance ClearMaskOfPnc: category=VALUE, resulting-properties={base-type=uint8, sw-calibration-access=READ-ONLY, range raw 0..255}
              mc data instance PncIdOfPnc: category=VALUE, resulting-properties={base-type=uint8, sw-calibration-access=READ-ONLY, range raw 0..255}
              mc data instance SetMaskOfPnc: category=VALUE, resulting-properties={base-type=uint8, sw-calibration-access=READ-ONLY, range raw 0..255}
            Element_4: symbol=[4]
              mc data instance ClearMaskOfPnc: category=VALUE, resulting-properties={base-type=uint8, sw-calibration-access=READ-ONLY, range raw 0..255}
              mc data instance PncIdOfPnc: category=VALUE, resulting-properties={base-type=uint8, sw-calibration-access=READ-ONLY, range raw 0..255}
              mc data instance SetMaskOfPnc: category=VALUE, resulting-properties={base-type=uint8, sw-calibration-access=READ-ONLY, range raw 0..255}
            Element_5: symbol=[5]
              mc data instance ClearMaskOfPnc: category=VALUE, resulting-properties={base-type=uint8, sw-calibration-access=READ-ONLY, range raw 0..255}
              mc data instance PncIdOfPnc: category=VALUE, resulting-properties={base-type=uint8, sw-calibration-access=READ-ONLY, range raw 0..255}
              mc data instance SetMaskOfPnc: category=VALUE, resulting-properties={base-type=uint8, sw-calibration-access=READ-ONLY, range raw 0..255}
            Element_6: symbol=[6]
              mc data instance ClearMaskOfPnc: category=VALUE, resulting-properties={base-type=uint8, sw-calibration-access=READ-ONLY, range raw 0..255}
              mc data instance PncIdOfPnc: category=VALUE, resulting-properties={base-type=uint8, sw-calibration-access=READ-ONLY, range raw 0..255}
              mc data instance SetMaskOfPnc: category=VALUE, resulting-properties={base-type=uint8, sw-calibration-access=READ-ONLY, range raw 0..255}
            Element_7: symbol=[7]
              mc data instance ClearMaskOfPnc: category=VALUE, resulting-properties={base-type=uint8, sw-calibration-access=READ-ONLY, range raw 0..255}
              mc data instance PncIdOfPnc: category=VALUE, resulting-properties={base-type=uint8, sw-calibration-access=READ-ONLY, range raw 0..255}
              mc data instance SetMaskOfPnc: category=VALUE, resulting-properties={base-type=uint8, sw-calibration-access=READ-ONLY, range raw 0..255}
            Element_8: symbol=[8]
              mc data instance ClearMaskOfPnc: category=VALUE, resulting-properties={base-type=uint8, sw-calibration-access=READ-ONLY, range raw 0..255}
              mc data instance PncIdOfPnc: category=VALUE, resulting-properties={base-type=uint8, sw-calibration-access=READ-ONLY, range raw 0..255}
              mc data instance SetMaskOfPnc: category=VALUE, resulting-properties={base-type=uint8, sw-calibration-access=READ-ONLY, range raw 0..255}
            Element_9: symbol=[9]
              mc data instance ClearMaskOfPnc: category=VALUE, resulting-properties={base-type=uint8, sw-calibration-access=READ-ONLY, range raw 0..255}
              mc data instance PncIdOfPnc: category=VALUE, resulting-properties={base-type=uint8, sw-calibration-access=READ-ONLY, range raw 0..255}
              mc data instance SetMaskOfPnc: category=VALUE, resulting-properties={base-type=uint8, sw-calibration-access=READ-ONLY, range raw 0..255}
            Element_10: symbol=[10]
              mc data instance ClearMaskOfPnc: category=VALUE, resulting-properties={base-type=uint8, sw-calibration-access=READ-ONLY, range raw 0..255}
              mc data instance PncIdOfPnc: category=VALUE, resulting-properties={base-type=uint8, sw-calibration-access=READ-ONLY, range raw 0..255}
              mc data instance SetMaskOfPnc: category=VALUE, resulting-properties={base-type=uint8, sw-calibration-access=READ-ONLY, range raw 0..255}
            Element_11: symbol=[11]
              mc data instance ClearMaskOfPnc: category=VALUE, resulting-properties={base-type=uint8, sw-calibration-access=READ-ONLY, range raw 0..255}
              mc data instance PncIdOfPnc: category=VALUE, resulting-properties={base-type=uint8, sw-calibration-access=READ-ONLY, range raw 0..255}
              mc data instance SetMaskOfPnc: category=VALUE, resulting-properties={base-type=uint8, sw-calibration-access=READ-ONLY, range raw 0..255}
            Element_12: symbol=[12]
              mc data instance ClearMaskOfPnc: category=VALUE, resulting-properties={base-type=uint8, sw-calibration-access=READ-ONLY, range raw 0..255}
              mc data instance PncIdOfPnc: category=VALUE, resulting-properties={base-type=uint8, sw-calibration-access=READ-ONLY, range raw 0..255}
              mc data instance SetMaskOfPnc: category=VALUE, resulting-properties={base-type=uint8, sw-calibration-access=READ-ONLY, range raw 0..255}
            Element_13: symbol=[13]
              mc data instance ClearMaskOfPnc: category=VALUE, resulting-properties={base-type=uint8, sw-calibration-access=READ-ONLY, range raw 0..255}
              mc data instance PncIdOfPnc: category=VALUE, resulting-properties={base-type=uint8, sw-calibration-access=READ-ONLY, range raw 0..255}
              mc data instance SetMaskOfPnc: category=VALUE, resulting-properties={base-type=uint8, sw-calibration-access=READ-ONLY, range raw 0..255}
            Element_14: symbol=[14]
              mc data instance ClearMaskOfPnc: category=VALUE, resulting-properties={base-type=uint8, sw-calibration-access=READ-ONLY, range raw 0..255}
              mc data instance PncIdOfPnc: category=VALUE, resulting-properties={base-type=uint8, sw-calibration-access=READ-ONLY, range raw 0..255}
              mc data instance SetMaskOfPnc: category=VALUE, resulting-properties={base-type=uint8, sw-calibration-access=READ-ONLY, range raw 0..255}
            Element_15: symbol=[15]
              mc data instance ClearMaskOfPnc: category=VALUE, resulting-properties={base-type=uint8, sw-calibration-access=READ-ONLY, range raw 0..255}
              mc data instance PncIdOfPnc: category=VALUE, resulting-properties={base-type=uint8, sw-calibration-access=READ-ONLY, range raw 0..255}
              mc data instance SetMaskOfPnc: category=VALUE, resulting-properties={base-type=uint8, sw-calibration-access=READ-ONLY, range raw 0..255}
            Element_16: symbol=[16]
              mc data instance ClearMaskOfPnc: category=VALUE, resulting-properties={base-type=uint8, sw-calibration-access=READ-ONLY, range raw 0..255}
              mc data instance PncIdOfPnc: category=VALUE, resulting-properties={base-type=uint8, sw-calibration-access=READ-ONLY, range raw 0..255}
              mc data instance SetMaskOfPnc: category=VALUE, resulting-properties={base-type=uint8, sw-calibration-access=READ-ONLY, range raw 0..255}
            Element_17: symbol=[17]
              mc data instance ClearMaskOfPnc: category=VALUE, resulting-properties={base-type=uint8, sw-calibration-access=READ-ONLY, range raw 0..255}
              mc data instance PncIdOfPnc: category=VALUE, resulting-properties={base-type=uint8, sw-calibration-access=READ-ONLY, range raw 0..255}
              mc data instance SetMaskOfPnc: category=VALUE, resulting-properties={base-type=uint8, sw-calibration-access=READ-ONLY, range raw 0..255}
            Element_18: symbol=[18]
              mc data instance ClearMaskOfPnc: category=VALUE, resulting-properties={base-type=uint8, sw-calibration-access=READ-ONLY, range raw 0..255}
              mc data instance PncIdOfPnc: category=VALUE, resulting-properties={base-type=uint8, sw-calibration-access=READ-ONLY, range raw 0..255}
              mc data instance SetMaskOfPnc: category=VALUE, resulting-properties={base-type=uint8, sw-calibration-access=READ-ONLY, range raw 0..255}
            Element_19: symbol=[19]
              mc data instance ClearMaskOfPnc: category=VALUE, resulting-properties={base-type=uint8, sw-calibration-access=READ-ONLY, range raw 0..255}
              mc data instance PncIdOfPnc: category=VALUE, resulting-properties={base-type=uint8, sw-calibration-access=READ-ONLY, range raw 0..255}
              mc data instance SetMaskOfPnc: category=VALUE, resulting-properties={base-type=uint8, sw-calibration-access=READ-ONLY, range raw 0..255}
            Element_20: symbol=[20]
              mc data instance ClearMaskOfPnc: category=VALUE, resulting-properties={base-type=uint8, sw-calibration-access=READ-ONLY, range raw 0..255}
              mc data instance PncIdOfPnc: category=VALUE, resulting-properties={base-type=uint8, sw-calibration-access=READ-ONLY, range raw 0..255}
              mc data instance SetMaskOfPnc: category=VALUE, resulting-properties={base-type=uint8, sw-calibration-access=READ-ONLY, range raw 0..255}
            Element_21: symbol=[21]
              mc data instance ClearMaskOfPnc: category=VALUE, resulting-properties={base-type=uint8, sw-calibration-access=READ-ONLY, range raw 0..255}
              mc data instance PncIdOfPnc: category=VALUE, resulting-properties={base-type=uint8, sw-calibration-access=READ-ONLY, range raw 0..255}
              mc data instance SetMaskOfPnc: category=VALUE, resulting-properties={base-type=uint8, sw-calibration-access=READ-ONLY, range raw 0..255}
            Element_22: symbol=[22]
              mc data instance ClearMaskOfPnc: category=VALUE, resulting-properties={base-type=uint8, sw-calibration-access=READ-ONLY, range raw 0..255}
              mc data instance PncIdOfPnc: category=VALUE, resulting-properties={base-type=uint8, sw-calibration-access=READ-ONLY, range raw 0..255}
              mc data instance SetMaskOfPnc: category=VALUE, resulting-properties={base-type=uint8, sw-calibration-access=READ-ONLY, range raw 0..255}
            Element_23: symbol=[23]
              mc data instance ClearMaskOfPnc: category=VALUE, resulting-properties={base-type=uint8, sw-calibration-access=READ-ONLY, range raw 0..255}
              mc data instance PncIdOfPnc: category=VALUE, resulting-properties={base-type=uint8, sw-calibration-access=READ-ONLY, range raw 0..255}
              mc data instance SetMaskOfPnc: category=VALUE, resulting-properties={base-type=uint8, sw-calibration-access=READ-ONLY, range raw 0..255}
            Element_24: symbol=[24]
              mc data instance ClearMaskOfPnc: category=VALUE, resulting-properties={base-type=uint8, sw-calibration-access=READ-ONLY, range raw 0..255}
              mc data instance PncIdOfPnc: category=VALUE, resulting-properties={base-type=uint8, sw-calibration-access=READ-ONLY, range raw 0..255}
              mc data instance SetMaskOfPnc: category=VALUE, resulting-properties={base-type=uint8, sw-calibration-access=READ-ONLY, range raw 0..255}
            Element_25: symbol=[25]
              mc data instance ClearMaskOfPnc: category=VALUE, resulting-properties={base-type=uint8, sw-calibration-access=READ-ONLY, range raw 0..255}
              mc data instance PncIdOfPnc: category=VALUE, resulting-properties={base-type=uint8, sw-calibration-access=READ-ONLY, range raw 0..255}
              mc data instance SetMaskOfPnc: category=VALUE, resulting-properties={base-type=uint8, sw-calibration-access=READ-ONLY, range raw 0..255}
            Element_26: symbol=[26]
              mc data instance ClearMaskOfPnc: category=VALUE, resulting-properties={base-type=uint8, sw-calibration-access=READ-ONLY, range raw 0..255}
              mc data instance PncIdOfPnc: category=VALUE, resulting-properties={base-type=uint8, sw-calibration-access=READ-ONLY, range raw 0..255}
              mc data instance SetMaskOfPnc: category=VALUE, resulting-properties={base-type=uint8, sw-calibration-access=READ-ONLY, range raw 0..255}
            Element_27: symbol=[27]
              mc data instance ClearMaskOfPnc: category=VALUE, resulting-properties={base-type=uint8, sw-calibration-access=READ-ONLY, range raw 0..255}
              mc data instance PncIdOfPnc: category=VALUE, resulting-properties={base-type=uint8, sw-calibration-access=READ-ONLY, range raw 0..255}
              mc data instance SetMaskOfPnc: category=VALUE, resulting-properties={base-type=uint8, sw-calibration-access=READ-ONLY, range raw 0..255}
            Element_28: symbol=[28]
              mc data instance ClearMaskOfPnc: category=VALUE, resulting-properties={base-type=uint8, sw-calibration-access=READ-ONLY, range raw 0..255}
              mc data instance PncIdOfPnc: category=VALUE, resulting-properties={base-type=uint8, sw-calibration-access=READ-ONLY, range raw 0..255}
              mc data instance SetMaskOfPnc: category=VALUE, resulting-properties={base-type=uint8, sw-calibration-access=READ-ONLY, range raw 0..255}
            Element_29: symbol=[29]
              mc data instance ClearMaskOfPnc: category=VALUE, resulting-properties={base-type=uint8, sw-calibration-access=READ-ONLY, range raw 0..255}
              mc data instance PncIdOfPnc: category=VALUE, resulting-properties={base-type=uint8, sw-calibration-access=READ-ONLY, range raw 0..255}
              mc data instance SetMaskOfPnc: category=VALUE, resulting-properties={base-type=uint8, sw-calibration-access=READ-ONLY, range raw 0..255}
            Element_30: symbol=[30]
              mc data instance ClearMaskOfPnc: category=VALUE, resulting-properties={base-type=uint8, sw-calibration-access=READ-ONLY, range raw 0..255}
              mc data instance PncIdOfPnc: category=VALUE, resulting-properties={base-type=uint8, sw-calibration-access=READ-ONLY, range raw 0..255}
              mc data instance SetMaskOfPnc: category=VALUE, resulting-properties={base-type=uint8, sw-calibration-access=READ-ONLY, range raw 0..255}
            Element_31: symbol=[31]
              mc data instance ClearMaskOfPnc: category=VALUE, resulting-properties={base-type=uint8, sw-calibration-access=READ-ONLY, range raw 0..255}
              mc data instance PncIdOfPnc: category=VALUE, resulting-properties={base-type=uint8, sw-calibration-access=READ-ONLY, range raw 0..255}
              mc data instance SetMaskOfPnc: category=VALUE, resulting-properties={base-type=uint8, sw-calibration-access=READ-ONLY, range raw 0..255}
            Element_32: symbol=[32]
              mc data instance ClearMaskOfPnc: category=VALUE, resulting-properties={base-type=uint8, sw-calibration-access=READ-ONLY, range raw 0..255}
              mc data instance PncIdOfPnc: category=VALUE, resulting-properties={base-type=uint8, sw-calibration-access=READ-ONLY, range raw 0..255}
              mc data instance SetMaskOfPnc: category=VALUE, resulting-properties={base-type=uint8, sw-calibration-access=READ-ONLY, range raw 0..255}
            Element_33: symbol=[33]
              mc data instance ClearMaskOfPnc: category=VALUE, resulting-properties={base-type=uint8, sw-calibration-access=READ-ONLY, range raw 0..255}
              mc data instance PncIdOfPnc: category=VALUE, resulting-properties={base-type=uint8, sw-calibration-access=READ-ONLY, range raw 0..255}
              mc data instance SetMaskOfPnc: category=VALUE, resulting-properties={base-type=uint8, sw-calibration-access=READ-ONLY, range raw 0..255}
            Element_34: symbol=[34]
              mc data instance ClearMaskOfPnc: category=VALUE, resulting-properties={base-type=uint8, sw-calibration-access=READ-ONLY, range raw 0..255}
              mc data instance PncIdOfPnc: category=VALUE, resulting-properties={base-type=uint8, sw-calibration-access=READ-ONLY, range raw 0..255}
              mc data instance SetMaskOfPnc: category=VALUE, resulting-properties={base-type=uint8, sw-calibration-access=READ-ONLY, range raw 0..255}
            Element_35: symbol=[35]
              mc data instance ClearMaskOfPnc: category=VALUE, resulting-properties={base-type=uint8, sw-calibration-access=READ-ONLY, range raw 0..255}
              mc data instance PncIdOfPnc: category=VALUE, resulting-properties={base-type=uint8, sw-calibration-access=READ-ONLY, range raw 0..255}
              mc data instance SetMaskOfPnc: category=VALUE, resulting-properties={base-type=uint8, sw-calibration-access=READ-ONLY, range raw 0..255}
            Element_36: symbol=[36]
              mc data instance ClearMaskOfPnc: category=VALUE, resulting-properties={base-type=uint8, sw-calibration-access=READ-ONLY, range raw 0..255}
              mc data instance PncIdOfPnc: category=VALUE, resulting-properties={base-type=uint8, sw-calibration-access=READ-ONLY, range raw 0..255}
              mc data instance SetMaskOfPnc: category=VALUE, resulting-properties={base-type=uint8, sw-calibration-access=READ-ONLY, range raw 0..255}
            Element_37: symbol=[37]
              mc data instance ClearMaskOfPnc: category=VALUE, resulting-properties={base-type=uint8, sw-calibration-access=READ-ONLY, range raw 0..255}
              mc data instance PncIdOfPnc: category=VALUE, resulting-properties={base-type=uint8, sw-calibration-access=READ-ONLY, range raw 0..255}
              mc data instance SetMaskOfPnc: category=VALUE, resulting-properties={base-type=uint8, sw-calibration-access=READ-ONLY, range raw 0..255}
            Element_38: symbol=[38]
              mc data instance ClearMaskOfPnc: category=VALUE, resulting-properties={base-type=uint8, sw-calibration-access=READ-ONLY, range raw 0..255}
              mc data instance PncIdOfPnc: category=VALUE, resulting-properties={base-type=uint8, sw-calibration-access=READ-ONLY, range raw 0..255}
              mc data instance SetMaskOfPnc: category=VALUE, resulting-properties={base-type=uint8, sw-calibration-access=READ-ONLY, range raw 0..255}
            Element_39: symbol=[39]
              mc data instance ClearMaskOfPnc: category=VALUE, resulting-properties={base-type=uint8, sw-calibration-access=READ-ONLY, range raw 0..255}
              mc data instance PncIdOfPnc: category=VALUE, resulting-properties={base-type=uint8, sw-calibration-access=READ-ONLY, range raw 0..255}
              mc data instance SetMaskOfPnc: category=VALUE, resulting-properties={base-type=uint8, sw-calibration-access=READ-ONLY, range raw 0..255}
            Element_40: symbol=[40]
              mc data instance ClearMaskOfPnc: category=VALUE, resulting-properties={base-type=uint8, sw-calibration-access=READ-ONLY, range raw 0..255}
              mc data instance PncIdOfPnc: category=VALUE, resulting-properties={base-type=uint8, sw-calibration-access=READ-ONLY, range raw 0..255}
              mc data instance SetMaskOfPnc: category=VALUE, resulting-properties={base-type=uint8, sw-calibration-access=READ-ONLY, range raw 0..255}
            Element_41: symbol=[41]
              mc data instance ClearMaskOfPnc: category=VALUE, resulting-properties={base-type=uint8, sw-calibration-access=READ-ONLY, range raw 0..255}
              mc data instance PncIdOfPnc: category=VALUE, resulting-properties={base-type=uint8, sw-calibration-access=READ-ONLY, range raw 0..255}
              mc data instance SetMaskOfPnc: category=VALUE, resulting-properties={base-type=uint8, sw-calibration-access=READ-ONLY, range raw 0..255}
            Element_42: symbol=[42]
              mc data instance ClearMaskOfPnc: category=VALUE, resulting-properties={base-type=uint8, sw-calibration-access=READ-ONLY, range raw 0..255}
              mc data instance PncIdOfPnc: category=VALUE, resulting-properties={base-type=uint8, sw-calibration-access=READ-ONLY, range raw 0..255}
              mc data instance SetMaskOfPnc: category=VALUE, resulting-properties={base-type=uint8, sw-calibration-access=READ-ONLY, range raw 0..255}
            Element_43: symbol=[43]
              mc data instance ClearMaskOfPnc: category=VALUE, resulting-properties={base-type=uint8, sw-calibration-access=READ-ONLY, range raw 0..255}
              mc data instance PncIdOfPnc: category=VALUE, resulting-properties={base-type=uint8, sw-calibration-access=READ-ONLY, range raw 0..255}
              mc data instance SetMaskOfPnc: category=VALUE, resulting-properties={base-type=uint8, sw-calibration-access=READ-ONLY, range raw 0..255}
            Element_44: symbol=[44]
              mc data instance ClearMaskOfPnc: category=VALUE, resulting-properties={base-type=uint8, sw-calibration-access=READ-ONLY, range raw 0..255}
              mc data instance PncIdOfPnc: category=VALUE, resulting-properties={base-type=uint8, sw-calibration-access=READ-ONLY, range raw 0..255}
              mc data instance SetMaskOfPnc: category=VALUE, resulting-properties={base-type=uint8, sw-calibration-access=READ-ONLY, range raw 0..255}
            Element_45: symbol=[45]
              mc data instance ClearMaskOfPnc: category=VALUE, resulting-properties={base-type=uint8, sw-calibration-access=READ-ONLY, range raw 0..255}
              mc data instance PncIdOfPnc: category=VALUE, resulting-properties={base-type=uint8, sw-calibration-access=READ-ONLY, range raw 0..255}
              mc data instance SetMaskOfPnc: category=VALUE, resulting-properties={base-type=uint8, sw-calibration-access=READ-ONLY, range raw 0..255}
            Element_46: symbol=[46]
              mc data instance ClearMaskOfPnc: category=VALUE, resulting-properties={base-type=uint8, sw-calibration-access=READ-ONLY, range raw 0..255}
              mc data instance PncIdOfPnc: category=VALUE, resulting-properties={base-type=uint8, sw-calibration-access=READ-ONLY, range raw 0..255}
              mc data instance SetMaskOfPnc: category=VALUE, resulting-properties={base-type=uint8, sw-calibration-access=READ-ONLY, range raw 0..255}
            Element_47: symbol=[47]
              mc data instance ClearMaskOfPnc: category=VALUE, resulting-properties={base-type=uint8, sw-calibration-access=READ-ONLY, range raw 0..255}
              mc data instance PncIdOfPnc: category=VALUE, resulting-properties={base-type=uint8, sw-calibration-access=READ-ONLY, range raw 0..255}
              mc data instance SetMaskOfPnc: category=VALUE, resulting-properties={base-type=uint8, sw-calibration-access=READ-ONLY, range raw 0..255}
        ComM_PncPb: array-size=48  # Contains PostBuild configuration parameters of partial networks
          48 x mc data instance, all with category=STRUCTURE:
            Element_0: symbol=[0]
              7 x mc data instance, all with category=VALUE:
                PncChannelMappingEndIdxOfPncPb: resulting-properties={base-type=uint8, sw-calibration-access=READ-ONLY, compu {255=COMM_NO_PNCCHANNELMAPPINGENDIDXOFPNCPB}, range raw 0..255}
                PncChannelMappingStartIdxOfPncPb: resulting-properties={base-type=uint8, sw-calibration-access=READ-ONLY, compu {255=COMM_NO_PNCCHANNELMAPPINGSTARTIDXOFPNCPB}, range raw 0..255}
                PncSignalIndEndIdxOfPncPb: resulting-properties={base-type=uint8, sw-calibration-access=READ-ONLY, compu {255=COMM_NO_PNCSIGNALINDENDIDXOFPNCPB}, range raw 0..255}
                PncSignalIndStartIdxOfPncPb: resulting-properties={base-type=uint8, sw-calibration-access=READ-ONLY, compu {255=COMM_NO_PNCSIGNALINDSTARTIDXOFPNCPB}, range raw 0..255}
                SignalByteIndexOfPncPb: resulting-properties={base-type=uint8, sw-calibration-access=READ-ONLY, range raw 0..255}
                UserReqPncFullComEndIdxOfPncPb: resulting-properties={base-type=uint8, sw-calibration-access=READ-ONLY, range raw 0..255}
                UserReqPncFullComStartIdxOfPncPb: resulting-properties={base-type=uint8, sw-calibration-access=READ-ONLY, range raw 0..255}
            Element_1: symbol=[1]
              7 x mc data instance, all with category=VALUE:
                PncChannelMappingEndIdxOfPncPb: resulting-properties={base-type=uint8, sw-calibration-access=READ-ONLY, compu {255=COMM_NO_PNCCHANNELMAPPINGENDIDXOFPNCPB}, range raw 0..255}
                PncChannelMappingStartIdxOfPncPb: resulting-properties={base-type=uint8, sw-calibration-access=READ-ONLY, compu {255=COMM_NO_PNCCHANNELMAPPINGSTARTIDXOFPNCPB}, range raw 0..255}
                PncSignalIndEndIdxOfPncPb: resulting-properties={base-type=uint8, sw-calibration-access=READ-ONLY, compu {255=COMM_NO_PNCSIGNALINDENDIDXOFPNCPB}, range raw 0..255}
                PncSignalIndStartIdxOfPncPb: resulting-properties={base-type=uint8, sw-calibration-access=READ-ONLY, compu {255=COMM_NO_PNCSIGNALINDSTARTIDXOFPNCPB}, range raw 0..255}
                SignalByteIndexOfPncPb: resulting-properties={base-type=uint8, sw-calibration-access=READ-ONLY, range raw 0..255}
                UserReqPncFullComEndIdxOfPncPb: resulting-properties={base-type=uint8, sw-calibration-access=READ-ONLY, range raw 0..255}
                UserReqPncFullComStartIdxOfPncPb: resulting-properties={base-type=uint8, sw-calibration-access=READ-ONLY, range raw 0..255}
            Element_2: symbol=[2]
              7 x mc data instance, all with category=VALUE:
                PncChannelMappingEndIdxOfPncPb: resulting-properties={base-type=uint8, sw-calibration-access=READ-ONLY, compu {255=COMM_NO_PNCCHANNELMAPPINGENDIDXOFPNCPB}, range raw 0..255}
                PncChannelMappingStartIdxOfPncPb: resulting-properties={base-type=uint8, sw-calibration-access=READ-ONLY, compu {255=COMM_NO_PNCCHANNELMAPPINGSTARTIDXOFPNCPB}, range raw 0..255}
                PncSignalIndEndIdxOfPncPb: resulting-properties={base-type=uint8, sw-calibration-access=READ-ONLY, compu {255=COMM_NO_PNCSIGNALINDENDIDXOFPNCPB}, range raw 0..255}
                PncSignalIndStartIdxOfPncPb: resulting-properties={base-type=uint8, sw-calibration-access=READ-ONLY, compu {255=COMM_NO_PNCSIGNALINDSTARTIDXOFPNCPB}, range raw 0..255}
                SignalByteIndexOfPncPb: resulting-properties={base-type=uint8, sw-calibration-access=READ-ONLY, range raw 0..255}
                UserReqPncFullComEndIdxOfPncPb: resulting-properties={base-type=uint8, sw-calibration-access=READ-ONLY, range raw 0..255}
                UserReqPncFullComStartIdxOfPncPb: resulting-properties={base-type=uint8, sw-calibration-access=READ-ONLY, range raw 0..255}
            Element_3: symbol=[3]
              7 x mc data instance, all with category=VALUE:
                PncChannelMappingEndIdxOfPncPb: resulting-properties={base-type=uint8, sw-calibration-access=READ-ONLY, compu {255=COMM_NO_PNCCHANNELMAPPINGENDIDXOFPNCPB}, range raw 0..255}
                PncChannelMappingStartIdxOfPncPb: resulting-properties={base-type=uint8, sw-calibration-access=READ-ONLY, compu {255=COMM_NO_PNCCHANNELMAPPINGSTARTIDXOFPNCPB}, range raw 0..255}
                PncSignalIndEndIdxOfPncPb: resulting-properties={base-type=uint8, sw-calibration-access=READ-ONLY, compu {255=COMM_NO_PNCSIGNALINDENDIDXOFPNCPB}, range raw 0..255}
                PncSignalIndStartIdxOfPncPb: resulting-properties={base-type=uint8, sw-calibration-access=READ-ONLY, compu {255=COMM_NO_PNCSIGNALINDSTARTIDXOFPNCPB}, range raw 0..255}
                SignalByteIndexOfPncPb: resulting-properties={base-type=uint8, sw-calibration-access=READ-ONLY, range raw 0..255}
                UserReqPncFullComEndIdxOfPncPb: resulting-properties={base-type=uint8, sw-calibration-access=READ-ONLY, range raw 0..255}
                UserReqPncFullComStartIdxOfPncPb: resulting-properties={base-type=uint8, sw-calibration-access=READ-ONLY, range raw 0..255}
            Element_4: symbol=[4]
              7 x mc data instance, all with category=VALUE:
                PncChannelMappingEndIdxOfPncPb: resulting-properties={base-type=uint8, sw-calibration-access=READ-ONLY, compu {255=COMM_NO_PNCCHANNELMAPPINGENDIDXOFPNCPB}, range raw 0..255}
                PncChannelMappingStartIdxOfPncPb: resulting-properties={base-type=uint8, sw-calibration-access=READ-ONLY, compu {255=COMM_NO_PNCCHANNELMAPPINGSTARTIDXOFPNCPB}, range raw 0..255}
                PncSignalIndEndIdxOfPncPb: resulting-properties={base-type=uint8, sw-calibration-access=READ-ONLY, compu {255=COMM_NO_PNCSIGNALINDENDIDXOFPNCPB}, range raw 0..255}
                PncSignalIndStartIdxOfPncPb: resulting-properties={base-type=uint8, sw-calibration-access=READ-ONLY, compu {255=COMM_NO_PNCSIGNALINDSTARTIDXOFPNCPB}, range raw 0..255}
                SignalByteIndexOfPncPb: resulting-properties={base-type=uint8, sw-calibration-access=READ-ONLY, range raw 0..255}
                UserReqPncFullComEndIdxOfPncPb: resulting-properties={base-type=uint8, sw-calibration-access=READ-ONLY, range raw 0..255}
                UserReqPncFullComStartIdxOfPncPb: resulting-properties={base-type=uint8, sw-calibration-access=READ-ONLY, range raw 0..255}
            Element_5: symbol=[5]
              7 x mc data instance, all with category=VALUE:
                PncChannelMappingEndIdxOfPncPb: resulting-properties={base-type=uint8, sw-calibration-access=READ-ONLY, compu {255=COMM_NO_PNCCHANNELMAPPINGENDIDXOFPNCPB}, range raw 0..255}
                PncChannelMappingStartIdxOfPncPb: resulting-properties={base-type=uint8, sw-calibration-access=READ-ONLY, compu {255=COMM_NO_PNCCHANNELMAPPINGSTARTIDXOFPNCPB}, range raw 0..255}
                PncSignalIndEndIdxOfPncPb: resulting-properties={base-type=uint8, sw-calibration-access=READ-ONLY, compu {255=COMM_NO_PNCSIGNALINDENDIDXOFPNCPB}, range raw 0..255}
                PncSignalIndStartIdxOfPncPb: resulting-properties={base-type=uint8, sw-calibration-access=READ-ONLY, compu {255=COMM_NO_PNCSIGNALINDSTARTIDXOFPNCPB}, range raw 0..255}
                SignalByteIndexOfPncPb: resulting-properties={base-type=uint8, sw-calibration-access=READ-ONLY, range raw 0..255}
                UserReqPncFullComEndIdxOfPncPb: resulting-properties={base-type=uint8, sw-calibration-access=READ-ONLY, range raw 0..255}
                UserReqPncFullComStartIdxOfPncPb: resulting-properties={base-type=uint8, sw-calibration-access=READ-ONLY, range raw 0..255}
            Element_6: symbol=[6]
              7 x mc data instance, all with category=VALUE:
                PncChannelMappingEndIdxOfPncPb: resulting-properties={base-type=uint8, sw-calibration-access=READ-ONLY, compu {255=COMM_NO_PNCCHANNELMAPPINGENDIDXOFPNCPB}, range raw 0..255}
                PncChannelMappingStartIdxOfPncPb: resulting-properties={base-type=uint8, sw-calibration-access=READ-ONLY, compu {255=COMM_NO_PNCCHANNELMAPPINGSTARTIDXOFPNCPB}, range raw 0..255}
                PncSignalIndEndIdxOfPncPb: resulting-properties={base-type=uint8, sw-calibration-access=READ-ONLY, compu {255=COMM_NO_PNCSIGNALINDENDIDXOFPNCPB}, range raw 0..255}
                PncSignalIndStartIdxOfPncPb: resulting-properties={base-type=uint8, sw-calibration-access=READ-ONLY, compu {255=COMM_NO_PNCSIGNALINDSTARTIDXOFPNCPB}, range raw 0..255}
                SignalByteIndexOfPncPb: resulting-properties={base-type=uint8, sw-calibration-access=READ-ONLY, range raw 0..255}
                UserReqPncFullComEndIdxOfPncPb: resulting-properties={base-type=uint8, sw-calibration-access=READ-ONLY, range raw 0..255}
                UserReqPncFullComStartIdxOfPncPb: resulting-properties={base-type=uint8, sw-calibration-access=READ-ONLY, range raw 0..255}
            Element_7: symbol=[7]
              7 x mc data instance, all with category=VALUE:
                PncChannelMappingEndIdxOfPncPb: resulting-properties={base-type=uint8, sw-calibration-access=READ-ONLY, compu {255=COMM_NO_PNCCHANNELMAPPINGENDIDXOFPNCPB}, range raw 0..255}
                PncChannelMappingStartIdxOfPncPb: resulting-properties={base-type=uint8, sw-calibration-access=READ-ONLY, compu {255=COMM_NO_PNCCHANNELMAPPINGSTARTIDXOFPNCPB}, range raw 0..255}
                PncSignalIndEndIdxOfPncPb: resulting-properties={base-type=uint8, sw-calibration-access=READ-ONLY, compu {255=COMM_NO_PNCSIGNALINDENDIDXOFPNCPB}, range raw 0..255}
                PncSignalIndStartIdxOfPncPb: resulting-properties={base-type=uint8, sw-calibration-access=READ-ONLY, compu {255=COMM_NO_PNCSIGNALINDSTARTIDXOFPNCPB}, range raw 0..255}
                SignalByteIndexOfPncPb: resulting-properties={base-type=uint8, sw-calibration-access=READ-ONLY, range raw 0..255}
                UserReqPncFullComEndIdxOfPncPb: resulting-properties={base-type=uint8, sw-calibration-access=READ-ONLY, range raw 0..255}
                UserReqPncFullComStartIdxOfPncPb: resulting-properties={base-type=uint8, sw-calibration-access=READ-ONLY, range raw 0..255}
            Element_8: symbol=[8]
              7 x mc data instance, all with category=VALUE:
                PncChannelMappingEndIdxOfPncPb: resulting-properties={base-type=uint8, sw-calibration-access=READ-ONLY, compu {255=COMM_NO_PNCCHANNELMAPPINGENDIDXOFPNCPB}, range raw 0..255}
                PncChannelMappingStartIdxOfPncPb: resulting-properties={base-type=uint8, sw-calibration-access=READ-ONLY, compu {255=COMM_NO_PNCCHANNELMAPPINGSTARTIDXOFPNCPB}, range raw 0..255}
                PncSignalIndEndIdxOfPncPb: resulting-properties={base-type=uint8, sw-calibration-access=READ-ONLY, compu {255=COMM_NO_PNCSIGNALINDENDIDXOFPNCPB}, range raw 0..255}
                PncSignalIndStartIdxOfPncPb: resulting-properties={base-type=uint8, sw-calibration-access=READ-ONLY, compu {255=COMM_NO_PNCSIGNALINDSTARTIDXOFPNCPB}, range raw 0..255}
                SignalByteIndexOfPncPb: resulting-properties={base-type=uint8, sw-calibration-access=READ-ONLY, range raw 0..255}
                UserReqPncFullComEndIdxOfPncPb: resulting-properties={base-type=uint8, sw-calibration-access=READ-ONLY, range raw 0..255}
                UserReqPncFullComStartIdxOfPncPb: resulting-properties={base-type=uint8, sw-calibration-access=READ-ONLY, range raw 0..255}
            Element_9: symbol=[9]
              7 x mc data instance, all with category=VALUE:
                PncChannelMappingEndIdxOfPncPb: resulting-properties={base-type=uint8, sw-calibration-access=READ-ONLY, compu {255=COMM_NO_PNCCHANNELMAPPINGENDIDXOFPNCPB}, range raw 0..255}
                PncChannelMappingStartIdxOfPncPb: resulting-properties={base-type=uint8, sw-calibration-access=READ-ONLY, compu {255=COMM_NO_PNCCHANNELMAPPINGSTARTIDXOFPNCPB}, range raw 0..255}
                PncSignalIndEndIdxOfPncPb: resulting-properties={base-type=uint8, sw-calibration-access=READ-ONLY, compu {255=COMM_NO_PNCSIGNALINDENDIDXOFPNCPB}, range raw 0..255}
                PncSignalIndStartIdxOfPncPb: resulting-properties={base-type=uint8, sw-calibration-access=READ-ONLY, compu {255=COMM_NO_PNCSIGNALINDSTARTIDXOFPNCPB}, range raw 0..255}
                SignalByteIndexOfPncPb: resulting-properties={base-type=uint8, sw-calibration-access=READ-ONLY, range raw 0..255}
                UserReqPncFullComEndIdxOfPncPb: resulting-properties={base-type=uint8, sw-calibration-access=READ-ONLY, range raw 0..255}
                UserReqPncFullComStartIdxOfPncPb: resulting-properties={base-type=uint8, sw-calibration-access=READ-ONLY, range raw 0..255}
            Element_10: symbol=[10]
              7 x mc data instance, all with category=VALUE:
                PncChannelMappingEndIdxOfPncPb: resulting-properties={base-type=uint8, sw-calibration-access=READ-ONLY, compu {255=COMM_NO_PNCCHANNELMAPPINGENDIDXOFPNCPB}, range raw 0..255}
                PncChannelMappingStartIdxOfPncPb: resulting-properties={base-type=uint8, sw-calibration-access=READ-ONLY, compu {255=COMM_NO_PNCCHANNELMAPPINGSTARTIDXOFPNCPB}, range raw 0..255}
                PncSignalIndEndIdxOfPncPb: resulting-properties={base-type=uint8, sw-calibration-access=READ-ONLY, compu {255=COMM_NO_PNCSIGNALINDENDIDXOFPNCPB}, range raw 0..255}
                PncSignalIndStartIdxOfPncPb: resulting-properties={base-type=uint8, sw-calibration-access=READ-ONLY, compu {255=COMM_NO_PNCSIGNALINDSTARTIDXOFPNCPB}, range raw 0..255}
                SignalByteIndexOfPncPb: resulting-properties={base-type=uint8, sw-calibration-access=READ-ONLY, range raw 0..255}
                UserReqPncFullComEndIdxOfPncPb: resulting-properties={base-type=uint8, sw-calibration-access=READ-ONLY, range raw 0..255}
                UserReqPncFullComStartIdxOfPncPb: resulting-properties={base-type=uint8, sw-calibration-access=READ-ONLY, range raw 0..255}
            Element_11: symbol=[11]
              7 x mc data instance, all with category=VALUE:
                PncChannelMappingEndIdxOfPncPb: resulting-properties={base-type=uint8, sw-calibration-access=READ-ONLY, compu {255=COMM_NO_PNCCHANNELMAPPINGENDIDXOFPNCPB}, range raw 0..255}
                PncChannelMappingStartIdxOfPncPb: resulting-properties={base-type=uint8, sw-calibration-access=READ-ONLY, compu {255=COMM_NO_PNCCHANNELMAPPINGSTARTIDXOFPNCPB}, range raw 0..255}
                PncSignalIndEndIdxOfPncPb: resulting-properties={base-type=uint8, sw-calibration-access=READ-ONLY, compu {255=COMM_NO_PNCSIGNALINDENDIDXOFPNCPB}, range raw 0..255}
                PncSignalIndStartIdxOfPncPb: resulting-properties={base-type=uint8, sw-calibration-access=READ-ONLY, compu {255=COMM_NO_PNCSIGNALINDSTARTIDXOFPNCPB}, range raw 0..255}
                SignalByteIndexOfPncPb: resulting-properties={base-type=uint8, sw-calibration-access=READ-ONLY, range raw 0..255}
                UserReqPncFullComEndIdxOfPncPb: resulting-properties={base-type=uint8, sw-calibration-access=READ-ONLY, range raw 0..255}
                UserReqPncFullComStartIdxOfPncPb: resulting-properties={base-type=uint8, sw-calibration-access=READ-ONLY, range raw 0..255}
            Element_12: symbol=[12]
              7 x mc data instance, all with category=VALUE:
                PncChannelMappingEndIdxOfPncPb: resulting-properties={base-type=uint8, sw-calibration-access=READ-ONLY, compu {255=COMM_NO_PNCCHANNELMAPPINGENDIDXOFPNCPB}, range raw 0..255}
                PncChannelMappingStartIdxOfPncPb: resulting-properties={base-type=uint8, sw-calibration-access=READ-ONLY, compu {255=COMM_NO_PNCCHANNELMAPPINGSTARTIDXOFPNCPB}, range raw 0..255}
                PncSignalIndEndIdxOfPncPb: resulting-properties={base-type=uint8, sw-calibration-access=READ-ONLY, compu {255=COMM_NO_PNCSIGNALINDENDIDXOFPNCPB}, range raw 0..255}
                PncSignalIndStartIdxOfPncPb: resulting-properties={base-type=uint8, sw-calibration-access=READ-ONLY, compu {255=COMM_NO_PNCSIGNALINDSTARTIDXOFPNCPB}, range raw 0..255}
                SignalByteIndexOfPncPb: resulting-properties={base-type=uint8, sw-calibration-access=READ-ONLY, range raw 0..255}
                UserReqPncFullComEndIdxOfPncPb: resulting-properties={base-type=uint8, sw-calibration-access=READ-ONLY, range raw 0..255}
                UserReqPncFullComStartIdxOfPncPb: resulting-properties={base-type=uint8, sw-calibration-access=READ-ONLY, range raw 0..255}
            Element_13: symbol=[13]
              7 x mc data instance, all with category=VALUE:
                PncChannelMappingEndIdxOfPncPb: resulting-properties={base-type=uint8, sw-calibration-access=READ-ONLY, compu {255=COMM_NO_PNCCHANNELMAPPINGENDIDXOFPNCPB}, range raw 0..255}
                PncChannelMappingStartIdxOfPncPb: resulting-properties={base-type=uint8, sw-calibration-access=READ-ONLY, compu {255=COMM_NO_PNCCHANNELMAPPINGSTARTIDXOFPNCPB}, range raw 0..255}
                PncSignalIndEndIdxOfPncPb: resulting-properties={base-type=uint8, sw-calibration-access=READ-ONLY, compu {255=COMM_NO_PNCSIGNALINDENDIDXOFPNCPB}, range raw 0..255}
                PncSignalIndStartIdxOfPncPb: resulting-properties={base-type=uint8, sw-calibration-access=READ-ONLY, compu {255=COMM_NO_PNCSIGNALINDSTARTIDXOFPNCPB}, range raw 0..255}
                SignalByteIndexOfPncPb: resulting-properties={base-type=uint8, sw-calibration-access=READ-ONLY, range raw 0..255}
                UserReqPncFullComEndIdxOfPncPb: resulting-properties={base-type=uint8, sw-calibration-access=READ-ONLY, range raw 0..255}
                UserReqPncFullComStartIdxOfPncPb: resulting-properties={base-type=uint8, sw-calibration-access=READ-ONLY, range raw 0..255}
            Element_14: symbol=[14]
              7 x mc data instance, all with category=VALUE:
                PncChannelMappingEndIdxOfPncPb: resulting-properties={base-type=uint8, sw-calibration-access=READ-ONLY, compu {255=COMM_NO_PNCCHANNELMAPPINGENDIDXOFPNCPB}, range raw 0..255}
                PncChannelMappingStartIdxOfPncPb: resulting-properties={base-type=uint8, sw-calibration-access=READ-ONLY, compu {255=COMM_NO_PNCCHANNELMAPPINGSTARTIDXOFPNCPB}, range raw 0..255}
                PncSignalIndEndIdxOfPncPb: resulting-properties={base-type=uint8, sw-calibration-access=READ-ONLY, compu {255=COMM_NO_PNCSIGNALINDENDIDXOFPNCPB}, range raw 0..255}
                PncSignalIndStartIdxOfPncPb: resulting-properties={base-type=uint8, sw-calibration-access=READ-ONLY, compu {255=COMM_NO_PNCSIGNALINDSTARTIDXOFPNCPB}, range raw 0..255}
                SignalByteIndexOfPncPb: resulting-properties={base-type=uint8, sw-calibration-access=READ-ONLY, range raw 0..255}
                UserReqPncFullComEndIdxOfPncPb: resulting-properties={base-type=uint8, sw-calibration-access=READ-ONLY, range raw 0..255}
                UserReqPncFullComStartIdxOfPncPb: resulting-properties={base-type=uint8, sw-calibration-access=READ-ONLY, range raw 0..255}
            Element_15: symbol=[15]
              7 x mc data instance, all with category=VALUE:
                PncChannelMappingEndIdxOfPncPb: resulting-properties={base-type=uint8, sw-calibration-access=READ-ONLY, compu {255=COMM_NO_PNCCHANNELMAPPINGENDIDXOFPNCPB}, range raw 0..255}
                PncChannelMappingStartIdxOfPncPb: resulting-properties={base-type=uint8, sw-calibration-access=READ-ONLY, compu {255=COMM_NO_PNCCHANNELMAPPINGSTARTIDXOFPNCPB}, range raw 0..255}
                PncSignalIndEndIdxOfPncPb: resulting-properties={base-type=uint8, sw-calibration-access=READ-ONLY, compu {255=COMM_NO_PNCSIGNALINDENDIDXOFPNCPB}, range raw 0..255}
                PncSignalIndStartIdxOfPncPb: resulting-properties={base-type=uint8, sw-calibration-access=READ-ONLY, compu {255=COMM_NO_PNCSIGNALINDSTARTIDXOFPNCPB}, range raw 0..255}
                SignalByteIndexOfPncPb: resulting-properties={base-type=uint8, sw-calibration-access=READ-ONLY, range raw 0..255}
                UserReqPncFullComEndIdxOfPncPb: resulting-properties={base-type=uint8, sw-calibration-access=READ-ONLY, range raw 0..255}
                UserReqPncFullComStartIdxOfPncPb: resulting-properties={base-type=uint8, sw-calibration-access=READ-ONLY, range raw 0..255}
            Element_16: symbol=[16]
              7 x mc data instance, all with category=VALUE:
                PncChannelMappingEndIdxOfPncPb: resulting-properties={base-type=uint8, sw-calibration-access=READ-ONLY, compu {255=COMM_NO_PNCCHANNELMAPPINGENDIDXOFPNCPB}, range raw 0..255}
                PncChannelMappingStartIdxOfPncPb: resulting-properties={base-type=uint8, sw-calibration-access=READ-ONLY, compu {255=COMM_NO_PNCCHANNELMAPPINGSTARTIDXOFPNCPB}, range raw 0..255}
                PncSignalIndEndIdxOfPncPb: resulting-properties={base-type=uint8, sw-calibration-access=READ-ONLY, compu {255=COMM_NO_PNCSIGNALINDENDIDXOFPNCPB}, range raw 0..255}
                PncSignalIndStartIdxOfPncPb: resulting-properties={base-type=uint8, sw-calibration-access=READ-ONLY, compu {255=COMM_NO_PNCSIGNALINDSTARTIDXOFPNCPB}, range raw 0..255}
                SignalByteIndexOfPncPb: resulting-properties={base-type=uint8, sw-calibration-access=READ-ONLY, range raw 0..255}
                UserReqPncFullComEndIdxOfPncPb: resulting-properties={base-type=uint8, sw-calibration-access=READ-ONLY, range raw 0..255}
                UserReqPncFullComStartIdxOfPncPb: resulting-properties={base-type=uint8, sw-calibration-access=READ-ONLY, range raw 0..255}
            Element_17: symbol=[17]
              7 x mc data instance, all with category=VALUE:
                PncChannelMappingEndIdxOfPncPb: resulting-properties={base-type=uint8, sw-calibration-access=READ-ONLY, compu {255=COMM_NO_PNCCHANNELMAPPINGENDIDXOFPNCPB}, range raw 0..255}
                PncChannelMappingStartIdxOfPncPb: resulting-properties={base-type=uint8, sw-calibration-access=READ-ONLY, compu {255=COMM_NO_PNCCHANNELMAPPINGSTARTIDXOFPNCPB}, range raw 0..255}
                PncSignalIndEndIdxOfPncPb: resulting-properties={base-type=uint8, sw-calibration-access=READ-ONLY, compu {255=COMM_NO_PNCSIGNALINDENDIDXOFPNCPB}, range raw 0..255}
                PncSignalIndStartIdxOfPncPb: resulting-properties={base-type=uint8, sw-calibration-access=READ-ONLY, compu {255=COMM_NO_PNCSIGNALINDSTARTIDXOFPNCPB}, range raw 0..255}
                SignalByteIndexOfPncPb: resulting-properties={base-type=uint8, sw-calibration-access=READ-ONLY, range raw 0..255}
                UserReqPncFullComEndIdxOfPncPb: resulting-properties={base-type=uint8, sw-calibration-access=READ-ONLY, range raw 0..255}
                UserReqPncFullComStartIdxOfPncPb: resulting-properties={base-type=uint8, sw-calibration-access=READ-ONLY, range raw 0..255}
            Element_18: symbol=[18]
              7 x mc data instance, all with category=VALUE:
                PncChannelMappingEndIdxOfPncPb: resulting-properties={base-type=uint8, sw-calibration-access=READ-ONLY, compu {255=COMM_NO_PNCCHANNELMAPPINGENDIDXOFPNCPB}, range raw 0..255}
                PncChannelMappingStartIdxOfPncPb: resulting-properties={base-type=uint8, sw-calibration-access=READ-ONLY, compu {255=COMM_NO_PNCCHANNELMAPPINGSTARTIDXOFPNCPB}, range raw 0..255}
                PncSignalIndEndIdxOfPncPb: resulting-properties={base-type=uint8, sw-calibration-access=READ-ONLY, compu {255=COMM_NO_PNCSIGNALINDENDIDXOFPNCPB}, range raw 0..255}
                PncSignalIndStartIdxOfPncPb: resulting-properties={base-type=uint8, sw-calibration-access=READ-ONLY, compu {255=COMM_NO_PNCSIGNALINDSTARTIDXOFPNCPB}, range raw 0..255}
                SignalByteIndexOfPncPb: resulting-properties={base-type=uint8, sw-calibration-access=READ-ONLY, range raw 0..255}
                UserReqPncFullComEndIdxOfPncPb: resulting-properties={base-type=uint8, sw-calibration-access=READ-ONLY, range raw 0..255}
                UserReqPncFullComStartIdxOfPncPb: resulting-properties={base-type=uint8, sw-calibration-access=READ-ONLY, range raw 0..255}
            Element_19: symbol=[19]
              7 x mc data instance, all with category=VALUE:
                PncChannelMappingEndIdxOfPncPb: resulting-properties={base-type=uint8, sw-calibration-access=READ-ONLY, compu {255=COMM_NO_PNCCHANNELMAPPINGENDIDXOFPNCPB}, range raw 0..255}
                PncChannelMappingStartIdxOfPncPb: resulting-properties={base-type=uint8, sw-calibration-access=READ-ONLY, compu {255=COMM_NO_PNCCHANNELMAPPINGSTARTIDXOFPNCPB}, range raw 0..255}
                PncSignalIndEndIdxOfPncPb: resulting-properties={base-type=uint8, sw-calibration-access=READ-ONLY, compu {255=COMM_NO_PNCSIGNALINDENDIDXOFPNCPB}, range raw 0..255}
                PncSignalIndStartIdxOfPncPb: resulting-properties={base-type=uint8, sw-calibration-access=READ-ONLY, compu {255=COMM_NO_PNCSIGNALINDSTARTIDXOFPNCPB}, range raw 0..255}
                SignalByteIndexOfPncPb: resulting-properties={base-type=uint8, sw-calibration-access=READ-ONLY, range raw 0..255}
                UserReqPncFullComEndIdxOfPncPb: resulting-properties={base-type=uint8, sw-calibration-access=READ-ONLY, range raw 0..255}
                UserReqPncFullComStartIdxOfPncPb: resulting-properties={base-type=uint8, sw-calibration-access=READ-ONLY, range raw 0..255}
            Element_20: symbol=[20]
              7 x mc data instance, all with category=VALUE:
                PncChannelMappingEndIdxOfPncPb: resulting-properties={base-type=uint8, sw-calibration-access=READ-ONLY, compu {255=COMM_NO_PNCCHANNELMAPPINGENDIDXOFPNCPB}, range raw 0..255}
                PncChannelMappingStartIdxOfPncPb: resulting-properties={base-type=uint8, sw-calibration-access=READ-ONLY, compu {255=COMM_NO_PNCCHANNELMAPPINGSTARTIDXOFPNCPB}, range raw 0..255}
                PncSignalIndEndIdxOfPncPb: resulting-properties={base-type=uint8, sw-calibration-access=READ-ONLY, compu {255=COMM_NO_PNCSIGNALINDENDIDXOFPNCPB}, range raw 0..255}
                PncSignalIndStartIdxOfPncPb: resulting-properties={base-type=uint8, sw-calibration-access=READ-ONLY, compu {255=COMM_NO_PNCSIGNALINDSTARTIDXOFPNCPB}, range raw 0..255}
                SignalByteIndexOfPncPb: resulting-properties={base-type=uint8, sw-calibration-access=READ-ONLY, range raw 0..255}
                UserReqPncFullComEndIdxOfPncPb: resulting-properties={base-type=uint8, sw-calibration-access=READ-ONLY, range raw 0..255}
                UserReqPncFullComStartIdxOfPncPb: resulting-properties={base-type=uint8, sw-calibration-access=READ-ONLY, range raw 0..255}
            Element_21: symbol=[21]
              7 x mc data instance, all with category=VALUE:
                PncChannelMappingEndIdxOfPncPb: resulting-properties={base-type=uint8, sw-calibration-access=READ-ONLY, compu {255=COMM_NO_PNCCHANNELMAPPINGENDIDXOFPNCPB}, range raw 0..255}
                PncChannelMappingStartIdxOfPncPb: resulting-properties={base-type=uint8, sw-calibration-access=READ-ONLY, compu {255=COMM_NO_PNCCHANNELMAPPINGSTARTIDXOFPNCPB}, range raw 0..255}
                PncSignalIndEndIdxOfPncPb: resulting-properties={base-type=uint8, sw-calibration-access=READ-ONLY, compu {255=COMM_NO_PNCSIGNALINDENDIDXOFPNCPB}, range raw 0..255}
                PncSignalIndStartIdxOfPncPb: resulting-properties={base-type=uint8, sw-calibration-access=READ-ONLY, compu {255=COMM_NO_PNCSIGNALINDSTARTIDXOFPNCPB}, range raw 0..255}
                SignalByteIndexOfPncPb: resulting-properties={base-type=uint8, sw-calibration-access=READ-ONLY, range raw 0..255}
                UserReqPncFullComEndIdxOfPncPb: resulting-properties={base-type=uint8, sw-calibration-access=READ-ONLY, range raw 0..255}
                UserReqPncFullComStartIdxOfPncPb: resulting-properties={base-type=uint8, sw-calibration-access=READ-ONLY, range raw 0..255}
            Element_22: symbol=[22]
              7 x mc data instance, all with category=VALUE:
                PncChannelMappingEndIdxOfPncPb: resulting-properties={base-type=uint8, sw-calibration-access=READ-ONLY, compu {255=COMM_NO_PNCCHANNELMAPPINGENDIDXOFPNCPB}, range raw 0..255}
                PncChannelMappingStartIdxOfPncPb: resulting-properties={base-type=uint8, sw-calibration-access=READ-ONLY, compu {255=COMM_NO_PNCCHANNELMAPPINGSTARTIDXOFPNCPB}, range raw 0..255}
                PncSignalIndEndIdxOfPncPb: resulting-properties={base-type=uint8, sw-calibration-access=READ-ONLY, compu {255=COMM_NO_PNCSIGNALINDENDIDXOFPNCPB}, range raw 0..255}
                PncSignalIndStartIdxOfPncPb: resulting-properties={base-type=uint8, sw-calibration-access=READ-ONLY, compu {255=COMM_NO_PNCSIGNALINDSTARTIDXOFPNCPB}, range raw 0..255}
                SignalByteIndexOfPncPb: resulting-properties={base-type=uint8, sw-calibration-access=READ-ONLY, range raw 0..255}
                UserReqPncFullComEndIdxOfPncPb: resulting-properties={base-type=uint8, sw-calibration-access=READ-ONLY, range raw 0..255}
                UserReqPncFullComStartIdxOfPncPb: resulting-properties={base-type=uint8, sw-calibration-access=READ-ONLY, range raw 0..255}
            Element_23: symbol=[23]
              7 x mc data instance, all with category=VALUE:
                PncChannelMappingEndIdxOfPncPb: resulting-properties={base-type=uint8, sw-calibration-access=READ-ONLY, compu {255=COMM_NO_PNCCHANNELMAPPINGENDIDXOFPNCPB}, range raw 0..255}
                PncChannelMappingStartIdxOfPncPb: resulting-properties={base-type=uint8, sw-calibration-access=READ-ONLY, compu {255=COMM_NO_PNCCHANNELMAPPINGSTARTIDXOFPNCPB}, range raw 0..255}
                PncSignalIndEndIdxOfPncPb: resulting-properties={base-type=uint8, sw-calibration-access=READ-ONLY, compu {255=COMM_NO_PNCSIGNALINDENDIDXOFPNCPB}, range raw 0..255}
                PncSignalIndStartIdxOfPncPb: resulting-properties={base-type=uint8, sw-calibration-access=READ-ONLY, compu {255=COMM_NO_PNCSIGNALINDSTARTIDXOFPNCPB}, range raw 0..255}
                SignalByteIndexOfPncPb: resulting-properties={base-type=uint8, sw-calibration-access=READ-ONLY, range raw 0..255}
                UserReqPncFullComEndIdxOfPncPb: resulting-properties={base-type=uint8, sw-calibration-access=READ-ONLY, range raw 0..255}
                UserReqPncFullComStartIdxOfPncPb: resulting-properties={base-type=uint8, sw-calibration-access=READ-ONLY, range raw 0..255}
            Element_24: symbol=[24]
              7 x mc data instance, all with category=VALUE:
                PncChannelMappingEndIdxOfPncPb: resulting-properties={base-type=uint8, sw-calibration-access=READ-ONLY, compu {255=COMM_NO_PNCCHANNELMAPPINGENDIDXOFPNCPB}, range raw 0..255}
                PncChannelMappingStartIdxOfPncPb: resulting-properties={base-type=uint8, sw-calibration-access=READ-ONLY, compu {255=COMM_NO_PNCCHANNELMAPPINGSTARTIDXOFPNCPB}, range raw 0..255}
                PncSignalIndEndIdxOfPncPb: resulting-properties={base-type=uint8, sw-calibration-access=READ-ONLY, compu {255=COMM_NO_PNCSIGNALINDENDIDXOFPNCPB}, range raw 0..255}
                PncSignalIndStartIdxOfPncPb: resulting-properties={base-type=uint8, sw-calibration-access=READ-ONLY, compu {255=COMM_NO_PNCSIGNALINDSTARTIDXOFPNCPB}, range raw 0..255}
                SignalByteIndexOfPncPb: resulting-properties={base-type=uint8, sw-calibration-access=READ-ONLY, range raw 0..255}
                UserReqPncFullComEndIdxOfPncPb: resulting-properties={base-type=uint8, sw-calibration-access=READ-ONLY, range raw 0..255}
                UserReqPncFullComStartIdxOfPncPb: resulting-properties={base-type=uint8, sw-calibration-access=READ-ONLY, range raw 0..255}
            Element_25: symbol=[25]
              7 x mc data instance, all with category=VALUE:
                PncChannelMappingEndIdxOfPncPb: resulting-properties={base-type=uint8, sw-calibration-access=READ-ONLY, compu {255=COMM_NO_PNCCHANNELMAPPINGENDIDXOFPNCPB}, range raw 0..255}
                PncChannelMappingStartIdxOfPncPb: resulting-properties={base-type=uint8, sw-calibration-access=READ-ONLY, compu {255=COMM_NO_PNCCHANNELMAPPINGSTARTIDXOFPNCPB}, range raw 0..255}
                PncSignalIndEndIdxOfPncPb: resulting-properties={base-type=uint8, sw-calibration-access=READ-ONLY, compu {255=COMM_NO_PNCSIGNALINDENDIDXOFPNCPB}, range raw 0..255}
                PncSignalIndStartIdxOfPncPb: resulting-properties={base-type=uint8, sw-calibration-access=READ-ONLY, compu {255=COMM_NO_PNCSIGNALINDSTARTIDXOFPNCPB}, range raw 0..255}
                SignalByteIndexOfPncPb: resulting-properties={base-type=uint8, sw-calibration-access=READ-ONLY, range raw 0..255}
                UserReqPncFullComEndIdxOfPncPb: resulting-properties={base-type=uint8, sw-calibration-access=READ-ONLY, range raw 0..255}
                UserReqPncFullComStartIdxOfPncPb: resulting-properties={base-type=uint8, sw-calibration-access=READ-ONLY, range raw 0..255}
            Element_26: symbol=[26]
              7 x mc data instance, all with category=VALUE:
                PncChannelMappingEndIdxOfPncPb: resulting-properties={base-type=uint8, sw-calibration-access=READ-ONLY, compu {255=COMM_NO_PNCCHANNELMAPPINGENDIDXOFPNCPB}, range raw 0..255}
                PncChannelMappingStartIdxOfPncPb: resulting-properties={base-type=uint8, sw-calibration-access=READ-ONLY, compu {255=COMM_NO_PNCCHANNELMAPPINGSTARTIDXOFPNCPB}, range raw 0..255}
                PncSignalIndEndIdxOfPncPb: resulting-properties={base-type=uint8, sw-calibration-access=READ-ONLY, compu {255=COMM_NO_PNCSIGNALINDENDIDXOFPNCPB}, range raw 0..255}
                PncSignalIndStartIdxOfPncPb: resulting-properties={base-type=uint8, sw-calibration-access=READ-ONLY, compu {255=COMM_NO_PNCSIGNALINDSTARTIDXOFPNCPB}, range raw 0..255}
                SignalByteIndexOfPncPb: resulting-properties={base-type=uint8, sw-calibration-access=READ-ONLY, range raw 0..255}
                UserReqPncFullComEndIdxOfPncPb: resulting-properties={base-type=uint8, sw-calibration-access=READ-ONLY, range raw 0..255}
                UserReqPncFullComStartIdxOfPncPb: resulting-properties={base-type=uint8, sw-calibration-access=READ-ONLY, range raw 0..255}
            Element_27: symbol=[27]
              7 x mc data instance, all with category=VALUE:
                PncChannelMappingEndIdxOfPncPb: resulting-properties={base-type=uint8, sw-calibration-access=READ-ONLY, compu {255=COMM_NO_PNCCHANNELMAPPINGENDIDXOFPNCPB}, range raw 0..255}
                PncChannelMappingStartIdxOfPncPb: resulting-properties={base-type=uint8, sw-calibration-access=READ-ONLY, compu {255=COMM_NO_PNCCHANNELMAPPINGSTARTIDXOFPNCPB}, range raw 0..255}
                PncSignalIndEndIdxOfPncPb: resulting-properties={base-type=uint8, sw-calibration-access=READ-ONLY, compu {255=COMM_NO_PNCSIGNALINDENDIDXOFPNCPB}, range raw 0..255}
                PncSignalIndStartIdxOfPncPb: resulting-properties={base-type=uint8, sw-calibration-access=READ-ONLY, compu {255=COMM_NO_PNCSIGNALINDSTARTIDXOFPNCPB}, range raw 0..255}
                SignalByteIndexOfPncPb: resulting-properties={base-type=uint8, sw-calibration-access=READ-ONLY, range raw 0..255}
                UserReqPncFullComEndIdxOfPncPb: resulting-properties={base-type=uint8, sw-calibration-access=READ-ONLY, range raw 0..255}
                UserReqPncFullComStartIdxOfPncPb: resulting-properties={base-type=uint8, sw-calibration-access=READ-ONLY, range raw 0..255}
            Element_28: symbol=[28]
              7 x mc data instance, all with category=VALUE:
                PncChannelMappingEndIdxOfPncPb: resulting-properties={base-type=uint8, sw-calibration-access=READ-ONLY, compu {255=COMM_NO_PNCCHANNELMAPPINGENDIDXOFPNCPB}, range raw 0..255}
                PncChannelMappingStartIdxOfPncPb: resulting-properties={base-type=uint8, sw-calibration-access=READ-ONLY, compu {255=COMM_NO_PNCCHANNELMAPPINGSTARTIDXOFPNCPB}, range raw 0..255}
                PncSignalIndEndIdxOfPncPb: resulting-properties={base-type=uint8, sw-calibration-access=READ-ONLY, compu {255=COMM_NO_PNCSIGNALINDENDIDXOFPNCPB}, range raw 0..255}
                PncSignalIndStartIdxOfPncPb: resulting-properties={base-type=uint8, sw-calibration-access=READ-ONLY, compu {255=COMM_NO_PNCSIGNALINDSTARTIDXOFPNCPB}, range raw 0..255}
                SignalByteIndexOfPncPb: resulting-properties={base-type=uint8, sw-calibration-access=READ-ONLY, range raw 0..255}
                UserReqPncFullComEndIdxOfPncPb: resulting-properties={base-type=uint8, sw-calibration-access=READ-ONLY, range raw 0..255}
                UserReqPncFullComStartIdxOfPncPb: resulting-properties={base-type=uint8, sw-calibration-access=READ-ONLY, range raw 0..255}
            Element_29: symbol=[29]
              7 x mc data instance, all with category=VALUE:
                PncChannelMappingEndIdxOfPncPb: resulting-properties={base-type=uint8, sw-calibration-access=READ-ONLY, compu {255=COMM_NO_PNCCHANNELMAPPINGENDIDXOFPNCPB}, range raw 0..255}
                PncChannelMappingStartIdxOfPncPb: resulting-properties={base-type=uint8, sw-calibration-access=READ-ONLY, compu {255=COMM_NO_PNCCHANNELMAPPINGSTARTIDXOFPNCPB}, range raw 0..255}
                PncSignalIndEndIdxOfPncPb: resulting-properties={base-type=uint8, sw-calibration-access=READ-ONLY, compu {255=COMM_NO_PNCSIGNALINDENDIDXOFPNCPB}, range raw 0..255}
                PncSignalIndStartIdxOfPncPb: resulting-properties={base-type=uint8, sw-calibration-access=READ-ONLY, compu {255=COMM_NO_PNCSIGNALINDSTARTIDXOFPNCPB}, range raw 0..255}
                SignalByteIndexOfPncPb: resulting-properties={base-type=uint8, sw-calibration-access=READ-ONLY, range raw 0..255}
                UserReqPncFullComEndIdxOfPncPb: resulting-properties={base-type=uint8, sw-calibration-access=READ-ONLY, range raw 0..255}
                UserReqPncFullComStartIdxOfPncPb: resulting-properties={base-type=uint8, sw-calibration-access=READ-ONLY, range raw 0..255}
            Element_30: symbol=[30]
              7 x mc data instance, all with category=VALUE:
                PncChannelMappingEndIdxOfPncPb: resulting-properties={base-type=uint8, sw-calibration-access=READ-ONLY, compu {255=COMM_NO_PNCCHANNELMAPPINGENDIDXOFPNCPB}, range raw 0..255}
                PncChannelMappingStartIdxOfPncPb: resulting-properties={base-type=uint8, sw-calibration-access=READ-ONLY, compu {255=COMM_NO_PNCCHANNELMAPPINGSTARTIDXOFPNCPB}, range raw 0..255}
                PncSignalIndEndIdxOfPncPb: resulting-properties={base-type=uint8, sw-calibration-access=READ-ONLY, compu {255=COMM_NO_PNCSIGNALINDENDIDXOFPNCPB}, range raw 0..255}
                PncSignalIndStartIdxOfPncPb: resulting-properties={base-type=uint8, sw-calibration-access=READ-ONLY, compu {255=COMM_NO_PNCSIGNALINDSTARTIDXOFPNCPB}, range raw 0..255}
                SignalByteIndexOfPncPb: resulting-properties={base-type=uint8, sw-calibration-access=READ-ONLY, range raw 0..255}
                UserReqPncFullComEndIdxOfPncPb: resulting-properties={base-type=uint8, sw-calibration-access=READ-ONLY, range raw 0..255}
                UserReqPncFullComStartIdxOfPncPb: resulting-properties={base-type=uint8, sw-calibration-access=READ-ONLY, range raw 0..255}
            Element_31: symbol=[31]
              7 x mc data instance, all with category=VALUE:
                PncChannelMappingEndIdxOfPncPb: resulting-properties={base-type=uint8, sw-calibration-access=READ-ONLY, compu {255=COMM_NO_PNCCHANNELMAPPINGENDIDXOFPNCPB}, range raw 0..255}
                PncChannelMappingStartIdxOfPncPb: resulting-properties={base-type=uint8, sw-calibration-access=READ-ONLY, compu {255=COMM_NO_PNCCHANNELMAPPINGSTARTIDXOFPNCPB}, range raw 0..255}
                PncSignalIndEndIdxOfPncPb: resulting-properties={base-type=uint8, sw-calibration-access=READ-ONLY, compu {255=COMM_NO_PNCSIGNALINDENDIDXOFPNCPB}, range raw 0..255}
                PncSignalIndStartIdxOfPncPb: resulting-properties={base-type=uint8, sw-calibration-access=READ-ONLY, compu {255=COMM_NO_PNCSIGNALINDSTARTIDXOFPNCPB}, range raw 0..255}
                SignalByteIndexOfPncPb: resulting-properties={base-type=uint8, sw-calibration-access=READ-ONLY, range raw 0..255}
                UserReqPncFullComEndIdxOfPncPb: resulting-properties={base-type=uint8, sw-calibration-access=READ-ONLY, range raw 0..255}
                UserReqPncFullComStartIdxOfPncPb: resulting-properties={base-type=uint8, sw-calibration-access=READ-ONLY, range raw 0..255}
            Element_32: symbol=[32]
              7 x mc data instance, all with category=VALUE:
                PncChannelMappingEndIdxOfPncPb: resulting-properties={base-type=uint8, sw-calibration-access=READ-ONLY, compu {255=COMM_NO_PNCCHANNELMAPPINGENDIDXOFPNCPB}, range raw 0..255}
                PncChannelMappingStartIdxOfPncPb: resulting-properties={base-type=uint8, sw-calibration-access=READ-ONLY, compu {255=COMM_NO_PNCCHANNELMAPPINGSTARTIDXOFPNCPB}, range raw 0..255}
                PncSignalIndEndIdxOfPncPb: resulting-properties={base-type=uint8, sw-calibration-access=READ-ONLY, compu {255=COMM_NO_PNCSIGNALINDENDIDXOFPNCPB}, range raw 0..255}
                PncSignalIndStartIdxOfPncPb: resulting-properties={base-type=uint8, sw-calibration-access=READ-ONLY, compu {255=COMM_NO_PNCSIGNALINDSTARTIDXOFPNCPB}, range raw 0..255}
                SignalByteIndexOfPncPb: resulting-properties={base-type=uint8, sw-calibration-access=READ-ONLY, range raw 0..255}
                UserReqPncFullComEndIdxOfPncPb: resulting-properties={base-type=uint8, sw-calibration-access=READ-ONLY, range raw 0..255}
                UserReqPncFullComStartIdxOfPncPb: resulting-properties={base-type=uint8, sw-calibration-access=READ-ONLY, range raw 0..255}
            Element_33: symbol=[33]
              7 x mc data instance, all with category=VALUE:
                PncChannelMappingEndIdxOfPncPb: resulting-properties={base-type=uint8, sw-calibration-access=READ-ONLY, compu {255=COMM_NO_PNCCHANNELMAPPINGENDIDXOFPNCPB}, range raw 0..255}
                PncChannelMappingStartIdxOfPncPb: resulting-properties={base-type=uint8, sw-calibration-access=READ-ONLY, compu {255=COMM_NO_PNCCHANNELMAPPINGSTARTIDXOFPNCPB}, range raw 0..255}
                PncSignalIndEndIdxOfPncPb: resulting-properties={base-type=uint8, sw-calibration-access=READ-ONLY, compu {255=COMM_NO_PNCSIGNALINDENDIDXOFPNCPB}, range raw 0..255}
                PncSignalIndStartIdxOfPncPb: resulting-properties={base-type=uint8, sw-calibration-access=READ-ONLY, compu {255=COMM_NO_PNCSIGNALINDSTARTIDXOFPNCPB}, range raw 0..255}
                SignalByteIndexOfPncPb: resulting-properties={base-type=uint8, sw-calibration-access=READ-ONLY, range raw 0..255}
                UserReqPncFullComEndIdxOfPncPb: resulting-properties={base-type=uint8, sw-calibration-access=READ-ONLY, range raw 0..255}
                UserReqPncFullComStartIdxOfPncPb: resulting-properties={base-type=uint8, sw-calibration-access=READ-ONLY, range raw 0..255}
            Element_34: symbol=[34]
              7 x mc data instance, all with category=VALUE:
                PncChannelMappingEndIdxOfPncPb: resulting-properties={base-type=uint8, sw-calibration-access=READ-ONLY, compu {255=COMM_NO_PNCCHANNELMAPPINGENDIDXOFPNCPB}, range raw 0..255}
                PncChannelMappingStartIdxOfPncPb: resulting-properties={base-type=uint8, sw-calibration-access=READ-ONLY, compu {255=COMM_NO_PNCCHANNELMAPPINGSTARTIDXOFPNCPB}, range raw 0..255}
                PncSignalIndEndIdxOfPncPb: resulting-properties={base-type=uint8, sw-calibration-access=READ-ONLY, compu {255=COMM_NO_PNCSIGNALINDENDIDXOFPNCPB}, range raw 0..255}
                PncSignalIndStartIdxOfPncPb: resulting-properties={base-type=uint8, sw-calibration-access=READ-ONLY, compu {255=COMM_NO_PNCSIGNALINDSTARTIDXOFPNCPB}, range raw 0..255}
                SignalByteIndexOfPncPb: resulting-properties={base-type=uint8, sw-calibration-access=READ-ONLY, range raw 0..255}
                UserReqPncFullComEndIdxOfPncPb: resulting-properties={base-type=uint8, sw-calibration-access=READ-ONLY, range raw 0..255}
                UserReqPncFullComStartIdxOfPncPb: resulting-properties={base-type=uint8, sw-calibration-access=READ-ONLY, range raw 0..255}
            Element_35: symbol=[35]
              7 x mc data instance, all with category=VALUE:
                PncChannelMappingEndIdxOfPncPb: resulting-properties={base-type=uint8, sw-calibration-access=READ-ONLY, compu {255=COMM_NO_PNCCHANNELMAPPINGENDIDXOFPNCPB}, range raw 0..255}
                PncChannelMappingStartIdxOfPncPb: resulting-properties={base-type=uint8, sw-calibration-access=READ-ONLY, compu {255=COMM_NO_PNCCHANNELMAPPINGSTARTIDXOFPNCPB}, range raw 0..255}
                PncSignalIndEndIdxOfPncPb: resulting-properties={base-type=uint8, sw-calibration-access=READ-ONLY, compu {255=COMM_NO_PNCSIGNALINDENDIDXOFPNCPB}, range raw 0..255}
                PncSignalIndStartIdxOfPncPb: resulting-properties={base-type=uint8, sw-calibration-access=READ-ONLY, compu {255=COMM_NO_PNCSIGNALINDSTARTIDXOFPNCPB}, range raw 0..255}
                SignalByteIndexOfPncPb: resulting-properties={base-type=uint8, sw-calibration-access=READ-ONLY, range raw 0..255}
                UserReqPncFullComEndIdxOfPncPb: resulting-properties={base-type=uint8, sw-calibration-access=READ-ONLY, range raw 0..255}
                UserReqPncFullComStartIdxOfPncPb: resulting-properties={base-type=uint8, sw-calibration-access=READ-ONLY, range raw 0..255}
            Element_36: symbol=[36]
              7 x mc data instance, all with category=VALUE:
                PncChannelMappingEndIdxOfPncPb: resulting-properties={base-type=uint8, sw-calibration-access=READ-ONLY, compu {255=COMM_NO_PNCCHANNELMAPPINGENDIDXOFPNCPB}, range raw 0..255}
                PncChannelMappingStartIdxOfPncPb: resulting-properties={base-type=uint8, sw-calibration-access=READ-ONLY, compu {255=COMM_NO_PNCCHANNELMAPPINGSTARTIDXOFPNCPB}, range raw 0..255}
                PncSignalIndEndIdxOfPncPb: resulting-properties={base-type=uint8, sw-calibration-access=READ-ONLY, compu {255=COMM_NO_PNCSIGNALINDENDIDXOFPNCPB}, range raw 0..255}
                PncSignalIndStartIdxOfPncPb: resulting-properties={base-type=uint8, sw-calibration-access=READ-ONLY, compu {255=COMM_NO_PNCSIGNALINDSTARTIDXOFPNCPB}, range raw 0..255}
                SignalByteIndexOfPncPb: resulting-properties={base-type=uint8, sw-calibration-access=READ-ONLY, range raw 0..255}
                UserReqPncFullComEndIdxOfPncPb: resulting-properties={base-type=uint8, sw-calibration-access=READ-ONLY, range raw 0..255}
                UserReqPncFullComStartIdxOfPncPb: resulting-properties={base-type=uint8, sw-calibration-access=READ-ONLY, range raw 0..255}
            Element_37: symbol=[37]
              7 x mc data instance, all with category=VALUE:
                PncChannelMappingEndIdxOfPncPb: resulting-properties={base-type=uint8, sw-calibration-access=READ-ONLY, compu {255=COMM_NO_PNCCHANNELMAPPINGENDIDXOFPNCPB}, range raw 0..255}
                PncChannelMappingStartIdxOfPncPb: resulting-properties={base-type=uint8, sw-calibration-access=READ-ONLY, compu {255=COMM_NO_PNCCHANNELMAPPINGSTARTIDXOFPNCPB}, range raw 0..255}
                PncSignalIndEndIdxOfPncPb: resulting-properties={base-type=uint8, sw-calibration-access=READ-ONLY, compu {255=COMM_NO_PNCSIGNALINDENDIDXOFPNCPB}, range raw 0..255}
                PncSignalIndStartIdxOfPncPb: resulting-properties={base-type=uint8, sw-calibration-access=READ-ONLY, compu {255=COMM_NO_PNCSIGNALINDSTARTIDXOFPNCPB}, range raw 0..255}
                SignalByteIndexOfPncPb: resulting-properties={base-type=uint8, sw-calibration-access=READ-ONLY, range raw 0..255}
                UserReqPncFullComEndIdxOfPncPb: resulting-properties={base-type=uint8, sw-calibration-access=READ-ONLY, range raw 0..255}
                UserReqPncFullComStartIdxOfPncPb: resulting-properties={base-type=uint8, sw-calibration-access=READ-ONLY, range raw 0..255}
            Element_38: symbol=[38]
              7 x mc data instance, all with category=VALUE:
                PncChannelMappingEndIdxOfPncPb: resulting-properties={base-type=uint8, sw-calibration-access=READ-ONLY, compu {255=COMM_NO_PNCCHANNELMAPPINGENDIDXOFPNCPB}, range raw 0..255}
                PncChannelMappingStartIdxOfPncPb: resulting-properties={base-type=uint8, sw-calibration-access=READ-ONLY, compu {255=COMM_NO_PNCCHANNELMAPPINGSTARTIDXOFPNCPB}, range raw 0..255}
                PncSignalIndEndIdxOfPncPb: resulting-properties={base-type=uint8, sw-calibration-access=READ-ONLY, compu {255=COMM_NO_PNCSIGNALINDENDIDXOFPNCPB}, range raw 0..255}
                PncSignalIndStartIdxOfPncPb: resulting-properties={base-type=uint8, sw-calibration-access=READ-ONLY, compu {255=COMM_NO_PNCSIGNALINDSTARTIDXOFPNCPB}, range raw 0..255}
                SignalByteIndexOfPncPb: resulting-properties={base-type=uint8, sw-calibration-access=READ-ONLY, range raw 0..255}
                UserReqPncFullComEndIdxOfPncPb: resulting-properties={base-type=uint8, sw-calibration-access=READ-ONLY, range raw 0..255}
                UserReqPncFullComStartIdxOfPncPb: resulting-properties={base-type=uint8, sw-calibration-access=READ-ONLY, range raw 0..255}
            Element_39: symbol=[39]
              7 x mc data instance, all with category=VALUE:
                PncChannelMappingEndIdxOfPncPb: resulting-properties={base-type=uint8, sw-calibration-access=READ-ONLY, compu {255=COMM_NO_PNCCHANNELMAPPINGENDIDXOFPNCPB}, range raw 0..255}
                PncChannelMappingStartIdxOfPncPb: resulting-properties={base-type=uint8, sw-calibration-access=READ-ONLY, compu {255=COMM_NO_PNCCHANNELMAPPINGSTARTIDXOFPNCPB}, range raw 0..255}
                PncSignalIndEndIdxOfPncPb: resulting-properties={base-type=uint8, sw-calibration-access=READ-ONLY, compu {255=COMM_NO_PNCSIGNALINDENDIDXOFPNCPB}, range raw 0..255}
                PncSignalIndStartIdxOfPncPb: resulting-properties={base-type=uint8, sw-calibration-access=READ-ONLY, compu {255=COMM_NO_PNCSIGNALINDSTARTIDXOFPNCPB}, range raw 0..255}
                SignalByteIndexOfPncPb: resulting-properties={base-type=uint8, sw-calibration-access=READ-ONLY, range raw 0..255}
                UserReqPncFullComEndIdxOfPncPb: resulting-properties={base-type=uint8, sw-calibration-access=READ-ONLY, range raw 0..255}
                UserReqPncFullComStartIdxOfPncPb: resulting-properties={base-type=uint8, sw-calibration-access=READ-ONLY, range raw 0..255}
            Element_40: symbol=[40]
              7 x mc data instance, all with category=VALUE:
                PncChannelMappingEndIdxOfPncPb: resulting-properties={base-type=uint8, sw-calibration-access=READ-ONLY, compu {255=COMM_NO_PNCCHANNELMAPPINGENDIDXOFPNCPB}, range raw 0..255}
                PncChannelMappingStartIdxOfPncPb: resulting-properties={base-type=uint8, sw-calibration-access=READ-ONLY, compu {255=COMM_NO_PNCCHANNELMAPPINGSTARTIDXOFPNCPB}, range raw 0..255}
                PncSignalIndEndIdxOfPncPb: resulting-properties={base-type=uint8, sw-calibration-access=READ-ONLY, compu {255=COMM_NO_PNCSIGNALINDENDIDXOFPNCPB}, range raw 0..255}
                PncSignalIndStartIdxOfPncPb: resulting-properties={base-type=uint8, sw-calibration-access=READ-ONLY, compu {255=COMM_NO_PNCSIGNALINDSTARTIDXOFPNCPB}, range raw 0..255}
                SignalByteIndexOfPncPb: resulting-properties={base-type=uint8, sw-calibration-access=READ-ONLY, range raw 0..255}
                UserReqPncFullComEndIdxOfPncPb: resulting-properties={base-type=uint8, sw-calibration-access=READ-ONLY, range raw 0..255}
                UserReqPncFullComStartIdxOfPncPb: resulting-properties={base-type=uint8, sw-calibration-access=READ-ONLY, range raw 0..255}
            Element_41: symbol=[41]
              7 x mc data instance, all with category=VALUE:
                PncChannelMappingEndIdxOfPncPb: resulting-properties={base-type=uint8, sw-calibration-access=READ-ONLY, compu {255=COMM_NO_PNCCHANNELMAPPINGENDIDXOFPNCPB}, range raw 0..255}
                PncChannelMappingStartIdxOfPncPb: resulting-properties={base-type=uint8, sw-calibration-access=READ-ONLY, compu {255=COMM_NO_PNCCHANNELMAPPINGSTARTIDXOFPNCPB}, range raw 0..255}
                PncSignalIndEndIdxOfPncPb: resulting-properties={base-type=uint8, sw-calibration-access=READ-ONLY, compu {255=COMM_NO_PNCSIGNALINDENDIDXOFPNCPB}, range raw 0..255}
                PncSignalIndStartIdxOfPncPb: resulting-properties={base-type=uint8, sw-calibration-access=READ-ONLY, compu {255=COMM_NO_PNCSIGNALINDSTARTIDXOFPNCPB}, range raw 0..255}
                SignalByteIndexOfPncPb: resulting-properties={base-type=uint8, sw-calibration-access=READ-ONLY, range raw 0..255}
                UserReqPncFullComEndIdxOfPncPb: resulting-properties={base-type=uint8, sw-calibration-access=READ-ONLY, range raw 0..255}
                UserReqPncFullComStartIdxOfPncPb: resulting-properties={base-type=uint8, sw-calibration-access=READ-ONLY, range raw 0..255}
            Element_42: symbol=[42]
              7 x mc data instance, all with category=VALUE:
                PncChannelMappingEndIdxOfPncPb: resulting-properties={base-type=uint8, sw-calibration-access=READ-ONLY, compu {255=COMM_NO_PNCCHANNELMAPPINGENDIDXOFPNCPB}, range raw 0..255}
                PncChannelMappingStartIdxOfPncPb: resulting-properties={base-type=uint8, sw-calibration-access=READ-ONLY, compu {255=COMM_NO_PNCCHANNELMAPPINGSTARTIDXOFPNCPB}, range raw 0..255}
                PncSignalIndEndIdxOfPncPb: resulting-properties={base-type=uint8, sw-calibration-access=READ-ONLY, compu {255=COMM_NO_PNCSIGNALINDENDIDXOFPNCPB}, range raw 0..255}
                PncSignalIndStartIdxOfPncPb: resulting-properties={base-type=uint8, sw-calibration-access=READ-ONLY, compu {255=COMM_NO_PNCSIGNALINDSTARTIDXOFPNCPB}, range raw 0..255}
                SignalByteIndexOfPncPb: resulting-properties={base-type=uint8, sw-calibration-access=READ-ONLY, range raw 0..255}
                UserReqPncFullComEndIdxOfPncPb: resulting-properties={base-type=uint8, sw-calibration-access=READ-ONLY, range raw 0..255}
                UserReqPncFullComStartIdxOfPncPb: resulting-properties={base-type=uint8, sw-calibration-access=READ-ONLY, range raw 0..255}
            Element_43: symbol=[43]
              7 x mc data instance, all with category=VALUE:
                PncChannelMappingEndIdxOfPncPb: resulting-properties={base-type=uint8, sw-calibration-access=READ-ONLY, compu {255=COMM_NO_PNCCHANNELMAPPINGENDIDXOFPNCPB}, range raw 0..255}
                PncChannelMappingStartIdxOfPncPb: resulting-properties={base-type=uint8, sw-calibration-access=READ-ONLY, compu {255=COMM_NO_PNCCHANNELMAPPINGSTARTIDXOFPNCPB}, range raw 0..255}
                PncSignalIndEndIdxOfPncPb: resulting-properties={base-type=uint8, sw-calibration-access=READ-ONLY, compu {255=COMM_NO_PNCSIGNALINDENDIDXOFPNCPB}, range raw 0..255}
                PncSignalIndStartIdxOfPncPb: resulting-properties={base-type=uint8, sw-calibration-access=READ-ONLY, compu {255=COMM_NO_PNCSIGNALINDSTARTIDXOFPNCPB}, range raw 0..255}
                SignalByteIndexOfPncPb: resulting-properties={base-type=uint8, sw-calibration-access=READ-ONLY, range raw 0..255}
                UserReqPncFullComEndIdxOfPncPb: resulting-properties={base-type=uint8, sw-calibration-access=READ-ONLY, range raw 0..255}
                UserReqPncFullComStartIdxOfPncPb: resulting-properties={base-type=uint8, sw-calibration-access=READ-ONLY, range raw 0..255}
            Element_44: symbol=[44]
              7 x mc data instance, all with category=VALUE:
                PncChannelMappingEndIdxOfPncPb: resulting-properties={base-type=uint8, sw-calibration-access=READ-ONLY, compu {255=COMM_NO_PNCCHANNELMAPPINGENDIDXOFPNCPB}, range raw 0..255}
                PncChannelMappingStartIdxOfPncPb: resulting-properties={base-type=uint8, sw-calibration-access=READ-ONLY, compu {255=COMM_NO_PNCCHANNELMAPPINGSTARTIDXOFPNCPB}, range raw 0..255}
                PncSignalIndEndIdxOfPncPb: resulting-properties={base-type=uint8, sw-calibration-access=READ-ONLY, compu {255=COMM_NO_PNCSIGNALINDENDIDXOFPNCPB}, range raw 0..255}
                PncSignalIndStartIdxOfPncPb: resulting-properties={base-type=uint8, sw-calibration-access=READ-ONLY, compu {255=COMM_NO_PNCSIGNALINDSTARTIDXOFPNCPB}, range raw 0..255}
                SignalByteIndexOfPncPb: resulting-properties={base-type=uint8, sw-calibration-access=READ-ONLY, range raw 0..255}
                UserReqPncFullComEndIdxOfPncPb: resulting-properties={base-type=uint8, sw-calibration-access=READ-ONLY, range raw 0..255}
                UserReqPncFullComStartIdxOfPncPb: resulting-properties={base-type=uint8, sw-calibration-access=READ-ONLY, range raw 0..255}
            Element_45: symbol=[45]
              7 x mc data instance, all with category=VALUE:
                PncChannelMappingEndIdxOfPncPb: resulting-properties={base-type=uint8, sw-calibration-access=READ-ONLY, compu {255=COMM_NO_PNCCHANNELMAPPINGENDIDXOFPNCPB}, range raw 0..255}
                PncChannelMappingStartIdxOfPncPb: resulting-properties={base-type=uint8, sw-calibration-access=READ-ONLY, compu {255=COMM_NO_PNCCHANNELMAPPINGSTARTIDXOFPNCPB}, range raw 0..255}
                PncSignalIndEndIdxOfPncPb: resulting-properties={base-type=uint8, sw-calibration-access=READ-ONLY, compu {255=COMM_NO_PNCSIGNALINDENDIDXOFPNCPB}, range raw 0..255}
                PncSignalIndStartIdxOfPncPb: resulting-properties={base-type=uint8, sw-calibration-access=READ-ONLY, compu {255=COMM_NO_PNCSIGNALINDSTARTIDXOFPNCPB}, range raw 0..255}
                SignalByteIndexOfPncPb: resulting-properties={base-type=uint8, sw-calibration-access=READ-ONLY, range raw 0..255}
                UserReqPncFullComEndIdxOfPncPb: resulting-properties={base-type=uint8, sw-calibration-access=READ-ONLY, range raw 0..255}
                UserReqPncFullComStartIdxOfPncPb: resulting-properties={base-type=uint8, sw-calibration-access=READ-ONLY, range raw 0..255}
            Element_46: symbol=[46]
              7 x mc data instance, all with category=VALUE:
                PncChannelMappingEndIdxOfPncPb: resulting-properties={base-type=uint8, sw-calibration-access=READ-ONLY, compu {255=COMM_NO_PNCCHANNELMAPPINGENDIDXOFPNCPB}, range raw 0..255}
                PncChannelMappingStartIdxOfPncPb: resulting-properties={base-type=uint8, sw-calibration-access=READ-ONLY, compu {255=COMM_NO_PNCCHANNELMAPPINGSTARTIDXOFPNCPB}, range raw 0..255}
                PncSignalIndEndIdxOfPncPb: resulting-properties={base-type=uint8, sw-calibration-access=READ-ONLY, compu {255=COMM_NO_PNCSIGNALINDENDIDXOFPNCPB}, range raw 0..255}
                PncSignalIndStartIdxOfPncPb: resulting-properties={base-type=uint8, sw-calibration-access=READ-ONLY, compu {255=COMM_NO_PNCSIGNALINDSTARTIDXOFPNCPB}, range raw 0..255}
                SignalByteIndexOfPncPb: resulting-properties={base-type=uint8, sw-calibration-access=READ-ONLY, range raw 0..255}
                UserReqPncFullComEndIdxOfPncPb: resulting-properties={base-type=uint8, sw-calibration-access=READ-ONLY, range raw 0..255}
                UserReqPncFullComStartIdxOfPncPb: resulting-properties={base-type=uint8, sw-calibration-access=READ-ONLY, range raw 0..255}
            Element_47: symbol=[47]
              7 x mc data instance, all with category=VALUE:
                PncChannelMappingEndIdxOfPncPb: resulting-properties={base-type=uint8, sw-calibration-access=READ-ONLY, compu {255=COMM_NO_PNCCHANNELMAPPINGENDIDXOFPNCPB}, range raw 0..255}
                PncChannelMappingStartIdxOfPncPb: resulting-properties={base-type=uint8, sw-calibration-access=READ-ONLY, compu {255=COMM_NO_PNCCHANNELMAPPINGSTARTIDXOFPNCPB}, range raw 0..255}
                PncSignalIndEndIdxOfPncPb: resulting-properties={base-type=uint8, sw-calibration-access=READ-ONLY, compu {255=COMM_NO_PNCSIGNALINDENDIDXOFPNCPB}, range raw 0..255}
                PncSignalIndStartIdxOfPncPb: resulting-properties={base-type=uint8, sw-calibration-access=READ-ONLY, compu {255=COMM_NO_PNCSIGNALINDSTARTIDXOFPNCPB}, range raw 0..255}
                SignalByteIndexOfPncPb: resulting-properties={base-type=uint8, sw-calibration-access=READ-ONLY, range raw 0..255}
                UserReqPncFullComEndIdxOfPncPb: resulting-properties={base-type=uint8, sw-calibration-access=READ-ONLY, range raw 0..255}
                UserReqPncFullComStartIdxOfPncPb: resulting-properties={base-type=uint8, sw-calibration-access=READ-ONLY, range raw 0..255}
        ComM_PncSignal: array-size=2  # Information about partial network signals (EIRA, ERA)
          mc data instance Element_0: category=STRUCTURE, symbol=[0]
            4 x mc data instance, all with category=VALUE:
              ChannelIdxOfPncSignal: resulting-properties={base-type=uint8, sw-calibration-access=READ-ONLY, compu {255=COMM_NO_CHANNELIDXOFPNCSIGNAL}, range raw 0..255}
              PncSignalValuesEndIdxOfPncSignal: resulting-properties={base-type=uint8, sw-calibration-access=READ-ONLY, compu {255=COMM_NO_PNCSIGNALVALUESENDIDXOFPNCSIGNAL}, range raw 0..255}
              PncSignalValuesStartIdxOfPncSignal: resulting-properties={base-type=uint8, sw-calibration-access=READ-ONLY, compu {255=COMM_NO_PNCSIGNALVALUESSTARTIDXOFPNCSIGNAL}, range raw 0..255}
              TypeOfPncSignal: resulting-properties={base-type=uint8, sw-calibration-access=READ-ONLY, compu {0=COMM_EIRA_RX_TYPEOFPNCSIGNAL, 1=COMM_EIRA_TX_TYPEOFPNCSIGNAL}, range raw 0..255}
          mc data instance Element_1: category=STRUCTURE, symbol=[1]
            4 x mc data instance, all with category=VALUE:
              ChannelIdxOfPncSignal: resulting-properties={base-type=uint8, sw-calibration-access=READ-ONLY, compu {255=COMM_NO_CHANNELIDXOFPNCSIGNAL}, range raw 0..255}
              PncSignalValuesEndIdxOfPncSignal: resulting-properties={base-type=uint8, sw-calibration-access=READ-ONLY, compu {255=COMM_NO_PNCSIGNALVALUESENDIDXOFPNCSIGNAL}, range raw 0..255}
              PncSignalValuesStartIdxOfPncSignal: resulting-properties={base-type=uint8, sw-calibration-access=READ-ONLY, compu {255=COMM_NO_PNCSIGNALVALUESSTARTIDXOFPNCSIGNAL}, range raw 0..255}
              TypeOfPncSignal: resulting-properties={base-type=uint8, sw-calibration-access=READ-ONLY, compu {0=COMM_EIRA_RX_TYPEOFPNCSIGNAL, 1=COMM_EIRA_TX_TYPEOFPNCSIGNAL}, range raw 0..255}
