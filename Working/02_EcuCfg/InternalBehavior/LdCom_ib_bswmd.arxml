AUTOSAR XML (schema 00048)
standard types defined: boolean, uint8
package /MICROSAR
  bsw implementation LdCom_Impl: programming-language=C, sw-version=4.00.00, used-code-generator=DaVinci Configurator, vendor-id=30, ar-release-version=4.02.02
    mc-variable-instances:
      mc data instance LdCom_RxTxPduInfo: category=ARRAY, array-size=10  # Table containing mapping data from Input handles to PduR Tx handles/RTE callbacks.
        10 x mc data instance, all with category=STRUCTURE:
          Element_0: symbol=[0]
            4 x mc data instance, all with category=VALUE:
              IfPduOfRxTxPduInfo: resulting-properties={base-type=boolean, sw-calibration-access=READ-ONLY, compu {0=FALSE, 1..255=TRUE}, range raw 0..1}
              IfRxIndicationFctPtrIdxOfRxTxPduInfo: resulting-properties={base-type=uint8, sw-calibration-access=READ-ONLY, compu {255=LDCOM_NO_IFRXINDICATIONFCTPTRIDXOFRXTXPDUINFO}, range raw 0..255}
              IfTxTriggerTransmitFctPtrIdxOfRxTxPduInfo: resulting-properties={base-type=uint8, sw-calibration-access=READ-ONLY, compu {255=LDCOM_NO_IFTXTRIGGERTRANSMITFCTPTRIDXOFRXTXPDUINFO}, range raw 0..255}
              PduRTxHandleIdOfRxTxPduInfo: resulting-properties={base-type=uint8, sw-calibration-access=READ-ONLY, range raw 0..255}
          Element_1: symbol=[1]
            4 x mc data instance, all with category=VALUE:
              IfPduOfRxTxPduInfo: resulting-properties={base-type=boolean, sw-calibration-access=READ-ONLY, compu {0=FALSE, 1..255=TRUE}, range raw 0..1}
              IfRxIndicationFctPtrIdxOfRxTxPduInfo: resulting-properties={base-type=uint8, sw-calibration-access=READ-ONLY, compu {255=LDCOM_NO_IFRXINDICATIONFCTPTRIDXOFRXTXPDUINFO}, range raw 0..255}
              IfTxTriggerTransmitFctPtrIdxOfRxTxPduInfo: resulting-properties={base-type=uint8, sw-calibration-access=READ-ONLY, compu {255=LDCOM_NO_IFTXTRIGGERTRANSMITFCTPTRIDXOFRXTXPDUINFO}, range raw 0..255}
              PduRTxHandleIdOfRxTxPduInfo: resulting-properties={base-type=uint8, sw-calibration-access=READ-ONLY, range raw 0..255}
          Element_2: symbol=[2]
            4 x mc data instance, all with category=VALUE:
              IfPduOfRxTxPduInfo: resulting-properties={base-type=boolean, sw-calibration-access=READ-ONLY, compu {0=FALSE, 1..255=TRUE}, range raw 0..1}
              IfRxIndicationFctPtrIdxOfRxTxPduInfo: resulting-properties={base-type=uint8, sw-calibration-access=READ-ONLY, compu {255=LDCOM_NO_IFRXINDICATIONFCTPTRIDXOFRXTXPDUINFO}, range raw 0..255}
              IfTxTriggerTransmitFctPtrIdxOfRxTxPduInfo: resulting-properties={base-type=uint8, sw-calibration-access=READ-ONLY, compu {255=LDCOM_NO_IFTXTRIGGERTRANSMITFCTPTRIDXOFRXTXPDUINFO}, range raw 0..255}
              PduRTxHandleIdOfRxTxPduInfo: resulting-properties={base-type=uint8, sw-calibration-access=READ-ONLY, range raw 0..255}
          Element_3: symbol=[3]
            4 x mc data instance, all with category=VALUE:
              IfPduOfRxTxPduInfo: resulting-properties={base-type=boolean, sw-calibration-access=READ-ONLY, compu {0=FALSE, 1..255=TRUE}, range raw 0..1}
              IfRxIndicationFctPtrIdxOfRxTxPduInfo: resulting-properties={base-type=uint8, sw-calibration-access=READ-ONLY, compu {255=LDCOM_NO_IFRXINDICATIONFCTPTRIDXOFRXTXPDUINFO}, range raw 0..255}
              IfTxTriggerTransmitFctPtrIdxOfRxTxPduInfo: resulting-properties={base-type=uint8, sw-calibration-access=READ-ONLY, compu {255=LDCOM_NO_IFTXTRIGGERTRANSMITFCTPTRIDXOFRXTXPDUINFO}, range raw 0..255}
              PduRTxHandleIdOfRxTxPduInfo: resulting-properties={base-type=uint8, sw-calibration-access=READ-ONLY, range raw 0..255}
          Element_4: symbol=[4]
            4 x mc data instance, all with category=VALUE:
              IfPduOfRxTxPduInfo: resulting-properties={base-type=boolean, sw-calibration-access=READ-ONLY, compu {0=FALSE, 1..255=TRUE}, range raw 0..1}
              IfRxIndicationFctPtrIdxOfRxTxPduInfo: resulting-properties={base-type=uint8, sw-calibration-access=READ-ONLY, compu {255=LDCOM_NO_IFRXINDICATIONFCTPTRIDXOFRXTXPDUINFO}, range raw 0..255}
              IfTxTriggerTransmitFctPtrIdxOfRxTxPduInfo: resulting-properties={base-type=uint8, sw-calibration-access=READ-ONLY, compu {255=LDCOM_NO_IFTXTRIGGERTRANSMITFCTPTRIDXOFRXTXPDUINFO}, range raw 0..255}
              PduRTxHandleIdOfRxTxPduInfo: resulting-properties={base-type=uint8, sw-calibration-access=READ-ONLY, range raw 0..255}
          Element_5: symbol=[5]
            4 x mc data instance, all with category=VALUE:
              IfPduOfRxTxPduInfo: resulting-properties={base-type=boolean, sw-calibration-access=READ-ONLY, compu {0=FALSE, 1..255=TRUE}, range raw 0..1}
              IfRxIndicationFctPtrIdxOfRxTxPduInfo: resulting-properties={base-type=uint8, sw-calibration-access=READ-ONLY, compu {255=LDCOM_NO_IFRXINDICATIONFCTPTRIDXOFRXTXPDUINFO}, range raw 0..255}
              IfTxTriggerTransmitFctPtrIdxOfRxTxPduInfo: resulting-properties={base-type=uint8, sw-calibration-access=READ-ONLY, compu {255=LDCOM_NO_IFTXTRIGGERTRANSMITFCTPTRIDXOFRXTXPDUINFO}, range raw 0..255}
              PduRTxHandleIdOfRxTxPduInfo: resulting-properties={base-type=uint8, sw-calibration-access=READ-ONLY, range raw 0..255}
          Element_6: symbol=[6]
            4 x mc data instance, all with category=VALUE:
              IfPduOfRxTxPduInfo: resulting-properties={base-type=boolean, sw-calibration-access=READ-ONLY, compu {0=FALSE, 1..255=TRUE}, range raw 0..1}
              IfRxIndicationFctPtrIdxOfRxTxPduInfo: resulting-properties={base-type=uint8, sw-calibration-access=READ-ONLY, compu {255=LDCOM_NO_IFRXINDICATIONFCTPTRIDXOFRXTXPDUINFO}, range raw 0..255}
              IfTxTriggerTransmitFctPtrIdxOfRxTxPduInfo: resulting-properties={base-type=uint8, sw-calibration-access=READ-ONLY, compu {255=LDCOM_NO_IFTXTRIGGERTRANSMITFCTPTRIDXOFRXTXPDUINFO}, range raw 0..255}
              PduRTxHandleIdOfRxTxPduInfo: resulting-properties={base-type=uint8, sw-calibration-access=READ-ONLY, range raw 0..255}
          Element_7: symbol=[7]
            4 x mc data instance, all with category=VALUE:
              IfPduOfRxTxPduInfo: resulting-properties={base-type=boolean, sw-calibration-access=READ-ONLY, compu {0=FALSE, 1..255=TRUE}, range raw 0..1}
              IfRxIndicationFctPtrIdxOfRxTxPduInfo: resulting-properties={base-type=uint8, sw-calibration-access=READ-ONLY, compu {255=LDCOM_NO_IFRXINDICATIONFCTPTRIDXOFRXTXPDUINFO}, range raw 0..255}
              IfTxTriggerTransmitFctPtrIdxOfRxTxPduInfo: resulting-properties={base-type=uint8, sw-calibration-access=READ-ONLY, compu {255=LDCOM_NO_IFTXTRIGGERTRANSMITFCTPTRIDXOFRXTXPDUINFO}, range raw 0..255}
              PduRTxHandleIdOfRxTxPduInfo: resulting-properties={base-type=uint8, sw-calibration-access=READ-ONLY, range raw 0..255}
          Element_8: symbol=[8]
            4 x mc data instance, all with category=VALUE:
              IfPduOfRxTxPduInfo: resulting-properties={base-type=boolean, sw-calibration-access=READ-ONLY, compu {0=FALSE, 1..255=TRUE}, range raw 0..1}
              IfRxIndicationFctPtrIdxOfRxTxPduInfo: resulting-properties={base-type=uint8, sw-calibration-access=READ-ONLY, compu {255=LDCOM_NO_IFRXINDICATIONFCTPTRIDXOFRXTXPDUINFO}, range raw 0..255}
              IfTxTriggerTransmitFctPtrIdxOfRxTxPduInfo: resulting-properties={base-type=uint8, sw-calibration-access=READ-ONLY, compu {255=LDCOM_NO_IFTXTRIGGERTRANSMITFCTPTRIDXOFRXTXPDUINFO}, range raw 0..255}
              PduRTxHandleIdOfRxTxPduInfo: resulting-properties={base-type=uint8, sw-calibration-access=READ-ONLY, range raw 0..255}
          Element_9: symbol=[9]
            4 x mc data instance, all with category=VALUE:
              IfPduOfRxTxPduInfo: resulting-properties={base-type=boolean, sw-calibration-access=READ-ONLY, compu {0=FALSE, 1..255=TRUE}, range raw 0..1}
              IfRxIndicationFctPtrIdxOfRxTxPduInfo: resulting-properties={base-type=uint8, sw-calibration-access=READ-ONLY, compu {255=LDCOM_NO_IFRXINDICATIONFCTPTRIDXOFRXTXPDUINFO}, range raw 0..255}
              IfTxTriggerTransmitFctPtrIdxOfRxTxPduInfo: resulting-properties={base-type=uint8, sw-calibration-access=READ-ONLY, compu {255=LDCOM_NO_IFTXTRIGGERTRANSMITFCTPTRIDXOFRXTXPDUINFO}, range raw 0..255}
              PduRTxHandleIdOfRxTxPduInfo: resulting-properties={base-type=uint8, sw-calibration-access=READ-ONLY, range raw 0..255}
      mc data instance LdCom_Initialized: category=VALUE, resulting-properties={base-type=boolean, sw-calibration-access=READ-ONLY, compu {0=FALSE, 1..255=TRUE}, range raw 0..1}  # Initialization state of LdCom. TRUE, if initialized.
