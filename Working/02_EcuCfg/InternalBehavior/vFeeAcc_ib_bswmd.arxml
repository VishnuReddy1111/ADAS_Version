AUTOSAR XML (schema 00048)
package /MICROSAR/vFeeAcc_ib_bswmd/BswModuleDescriptions
  bsw module description vFeeAcc: provided-entrys=vFeeAcc_MainFunction
    bsw internal behavior vFeeAccBehavior
      bsw schedulable entity vFeeAcc_MainFunction: implemented-entry=vFeeAcc_MainFunction
      bsw timing event vFeeAcc_MainFunctionTimingEvent0: starts-on-event=vFeeAcc_MainFunction, period=0.005
  bsw module entry vFeeAcc_MainFunction: call-type=SCHEDULED, execution-context=TASK
