AUTOSAR XML (schema 4-3-0)
standard types defined: boolean, uint16, uint32, uint8
package /MICROSAR
  bsw implementation SecOC_Impl: programming-language=C, sw-version=12.00.01, used-code-generator=DaVinci Configurator, vendor-id=30, ar-release-version=4.03.00
    mc-variable-instances:
      92 x mc data instance:
        SecOC_RxPduInfo: category=ARRAY, array-size=3
          mc data instance Element_0: category=STRUCTURE, symbol=[0]
            49 x mc data instance, all with category=VALUE:
              AuthenticationLayerIdOfRxPduInfo: resulting-properties={base-type=uint16, sw-calibration-access=READ-ONLY, range raw 0..65535}
              DataIdOfRxPduInfo: resulting-properties={base-type=uint16, sw-calibration-access=READ-ONLY, range raw 0..65535}
              AuthDataFreshnessOfRxPduInfo: resulting-properties={base-type=uint8, sw-calibration-access=READ-ONLY, compu-method=SecOC_AuthDataFreshnessOfRxPduInfoType, range raw 0..255}
              AuthDataFreshnessLenOfRxPduInfo: resulting-properties={base-type=uint8, sw-calibration-access=READ-ONLY, range raw 0..255}
              AuthDataFreshnessStartBytePositionOfRxPduInfo: resulting-properties={base-type=uint8, sw-calibration-access=READ-ONLY, range raw 0..255}
              AuthenticExternalIdOfRxPduInfo: resulting-properties={base-type=uint8, sw-calibration-access=READ-ONLY, compu {255=SECOC_NO_AUTHENTICEXTERNALIDOFRXPDUINFO}, range raw 0..255}
              AuthenticPduDataContainerAuthenticPduEndIdxOfRxPduInfo: resulting-properties={base-type=uint8, sw-calibration-access=READ-ONLY, compu {255=SECOC_NO_AUTHENTICPDUDATACONTAINERAUTHENTICPDUENDIDXOFRXPDUINFO}, range raw 0..255}
              AuthenticPduDataContainerAuthenticPduLengthOfRxPduInfo: resulting-properties={base-type=uint8, sw-calibration-access=READ-ONLY, range raw 0..255}
              AuthenticPduDataContainerAuthenticPduStartIdxOfRxPduInfo: resulting-properties={base-type=uint8, sw-calibration-access=READ-ONLY, compu {255=SECOC_NO_AUTHENTICPDUDATACONTAINERAUTHENTICPDUSTARTIDXOFRXPDUINFO}, range raw 0..255}
              AuthenticPduDataContainerDataToAuthenticateEndIdxOfRxPduInfo: resulting-properties={base-type=uint8, sw-calibration-access=READ-ONLY, range raw 0..255}
              AuthenticPduDataContainerDataToAuthenticateLengthOfRxPduInfo: resulting-properties={base-type=uint8, sw-calibration-access=READ-ONLY, range raw 0..255}
              AuthenticPduDataContainerDataToAuthenticateStartIdxOfRxPduInfo: resulting-properties={base-type=uint8, sw-calibration-access=READ-ONLY, range raw 0..255}
              AuthenticPduDataContainerFreshnessVerifyValueEndIdxOfRxPduInfo: resulting-properties={base-type=uint8, sw-calibration-access=READ-ONLY, compu-method=SecOC_AuthenticPduDataContainerFreshnessVerifyValueEndIdxOfRxPduInfoType, range raw 0..255}
              AuthenticPduDataContainerFreshnessVerifyValueLengthOfRxPduInfo: resulting-properties={base-type=uint8, sw-calibration-access=READ-ONLY, range raw 0..255}
              AuthenticPduDataContainerFreshnessVerifyValueStartIdxOfRxPduInfo: resulting-properties={base-type=uint8, sw-calibration-access=READ-ONLY, compu-method=SecOC_AuthenticPduDataContainerFreshnessVerifyValueStartIdxOfRxPduInfoType, range raw 0..255}
              AuthenticatorCacheEndIdxOfRxPduInfo: resulting-properties={base-type=uint8, sw-calibration-access=READ-ONLY, range raw 0..255}
              AuthenticatorCacheLengthOfRxPduInfo: resulting-properties={base-type=uint8, sw-calibration-access=READ-ONLY, range raw 0..255}
              AuthenticatorCacheStartIdxOfRxPduInfo: resulting-properties={base-type=uint8, sw-calibration-access=READ-ONLY, range raw 0..255}
              BuildAttemptsOfRxPduInfo: resulting-properties={base-type=uint8, sw-calibration-access=READ-ONLY, range raw 0..255}
              ClientServerVerificationStatusPropagationModeOfRxPduInfo: resulting-properties={base-type=uint8, sw-calibration-access=READ-ONLY, compu {2=SECOC_NONE_CLIENTSERVERVERIFICATIONSTATUSPROPAGATIONMODEOFRXPDUINFO}, range raw 0..255}
              DataIdFirstByteOfRxPduInfo: resulting-properties={base-type=uint8, sw-calibration-access=READ-ONLY, range raw 0..255}
              DataIdSecondByteOfRxPduInfo: resulting-properties={base-type=uint8, sw-calibration-access=READ-ONLY, range raw 0..255}
              ExternalFreshnessIdOfRxPduInfo: resulting-properties={base-type=uint8, sw-calibration-access=READ-ONLY, range raw 0..255}
              NumberOfMessagesToOverrideIdxOfRxPduInfo: resulting-properties={base-type=uint8, sw-calibration-access=READ-ONLY, range raw 0..255}
              PduProcessingOfRxPduInfo: resulting-properties={base-type=uint8, sw-calibration-access=READ-ONLY, compu {1=SECOC_DEFERRED_PDUPROCESSINGOFRXPDUINFO}, range raw 0..255}
              PduTypeOfRxPduInfo: resulting-properties={base-type=uint8, sw-calibration-access=READ-ONLY, compu {0=SECOC_IFPDU_PDUTYPEOFRXPDUINFO}, range raw 0..255}
              RxSecuredPduInfoIdxOfRxPduInfo: resulting-properties={base-type=uint8, sw-calibration-access=READ-ONLY, range raw 0..255}
              SecuredPduDataContainerAuthenticPduEndIdxOfRxPduInfo: resulting-properties={base-type=uint8, sw-calibration-access=READ-ONLY, compu {255=SECOC_NO_SECUREDPDUDATACONTAINERAUTHENTICPDUENDIDXOFRXPDUINFO}, range raw 0..255}
              SecuredPduDataContainerAuthenticPduLengthOfRxPduInfo: resulting-properties={base-type=uint8, sw-calibration-access=READ-ONLY, range raw 0..255}
              SecuredPduDataContainerAuthenticPduStartIdxOfRxPduInfo: resulting-properties={base-type=uint8, sw-calibration-access=READ-ONLY, compu {255=SECOC_NO_SECUREDPDUDATACONTAINERAUTHENTICPDUSTARTIDXOFRXPDUINFO}, range raw 0..255}
              SecuredPduDataContainerSecuredPduEndIdxOfRxPduInfo: resulting-properties={base-type=uint8, sw-calibration-access=READ-ONLY, compu {255=SECOC_NO_SECUREDPDUDATACONTAINERSECUREDPDUENDIDXOFRXPDUINFO}, range raw 0..255}
              SecuredPduDataContainerSecuredPduLengthOfRxPduInfo: resulting-properties={base-type=uint8, sw-calibration-access=READ-ONLY, range raw 0..255}
              SecuredPduDataContainerSecuredPduStartIdxOfRxPduInfo: resulting-properties={base-type=uint8, sw-calibration-access=READ-ONLY, compu {255=SECOC_NO_SECUREDPDUDATACONTAINERSECUREDPDUSTARTIDXOFRXPDUINFO}, range raw 0..255}
              SecuredPduDataContainerTpSecuredPduEndIdxOfRxPduInfo: resulting-properties={base-type=uint8, sw-calibration-access=READ-ONLY, compu {255=SECOC_NO_SECUREDPDUDATACONTAINERTPSECUREDPDUENDIDXOFRXPDUINFO}, range raw 0..255}
              SecuredPduDataContainerTpSecuredPduLengthOfRxPduInfo: resulting-properties={base-type=uint8, sw-calibration-access=READ-ONLY, range raw 0..255}
              SecuredPduDataContainerTpSecuredPduStartIdxOfRxPduInfo: resulting-properties={base-type=uint8, sw-calibration-access=READ-ONLY, compu {255=SECOC_NO_SECUREDPDUDATACONTAINERTPSECUREDPDUSTARTIDXOFRXPDUINFO}, range raw 0..255}
              SecuredPduDataContainerTruncatedAuthenticatorEndIdxOfRxPduInfo: resulting-properties={base-type=uint8, sw-calibration-access=READ-ONLY, compu-method=SecOC_SecuredPduDataContainerTruncatedAuthenticatorEndIdxOfRxPduInfoType, range raw 0..255}
              SecuredPduDataContainerTruncatedAuthenticatorLengthOfRxPduInfo: resulting-properties={base-type=uint8, sw-calibration-access=READ-ONLY, range raw 0..255}
              SecuredPduDataContainerTruncatedAuthenticatorStartIdxOfRxPduInfo: resulting-properties={base-type=uint8, sw-calibration-access=READ-ONLY, compu-method=SecOC_SecuredPduDataContainerTruncatedAuthenticatorStartIdxOfRxPduInfoType, range raw 0..255}
              TruncAuthStartBitInByteOfRxPduInfo: resulting-properties={base-type=uint8, sw-calibration-access=READ-ONLY, range raw 0..255}
              TruncFreshnessValueFirstByteShiftOfRxPduInfo: resulting-properties={base-type=uint8, sw-calibration-access=READ-ONLY, range raw 0..255}
              TruncFreshnessValueSecondByteShiftOfRxPduInfo: resulting-properties={base-type=uint8, sw-calibration-access=READ-ONLY, range raw 0..255}
              VerificationStatusPropagationModeOfRxPduInfo: resulting-properties={base-type=uint8, sw-calibration-access=READ-ONLY, compu {2=SECOC_NONE_VERIFICATIONSTATUSPROPAGATIONMODEOFRXPDUINFO}, range raw 0..255}
              VerificationStatusWithSecuredPduPropagationModeOfRxPduInfo: resulting-properties={base-type=uint8, sw-calibration-access=READ-ONLY, compu-method=SecOC_VerificationStatusWithSecuredPduPropagationModeOfRxPduInfoType, range raw 0..255}
              VerifyAttemptsOfRxPduInfo: resulting-properties={base-type=uint8, sw-calibration-access=READ-ONLY, range raw 0..255}
              VerifyOverrideStatusIdxOfRxPduInfo: resulting-properties={base-type=uint8, sw-calibration-access=READ-ONLY, range raw 0..255}
              VerifyResultIdxOfRxPduInfo: resulting-properties={base-type=uint8, sw-calibration-access=READ-ONLY, range raw 0..255}
              truncatedAuthenticationLengthOfRxPduInfo: resulting-properties={base-type=uint8, sw-calibration-access=READ-ONLY, range raw 0..255}
              truncatedFreshnessValueLengthOfRxPduInfo: resulting-properties={base-type=uint8, sw-calibration-access=READ-ONLY, range raw 0..255}
          mc data instance Element_1: category=STRUCTURE, symbol=[1]
            49 x mc data instance, all with category=VALUE:
              AuthenticationLayerIdOfRxPduInfo: resulting-properties={base-type=uint16, sw-calibration-access=READ-ONLY, range raw 0..65535}
              DataIdOfRxPduInfo: resulting-properties={base-type=uint16, sw-calibration-access=READ-ONLY, range raw 0..65535}
              AuthDataFreshnessOfRxPduInfo: resulting-properties={base-type=uint8, sw-calibration-access=READ-ONLY, compu-method=SecOC_AuthDataFreshnessOfRxPduInfoType, range raw 0..255}
              AuthDataFreshnessLenOfRxPduInfo: resulting-properties={base-type=uint8, sw-calibration-access=READ-ONLY, range raw 0..255}
              AuthDataFreshnessStartBytePositionOfRxPduInfo: resulting-properties={base-type=uint8, sw-calibration-access=READ-ONLY, range raw 0..255}
              AuthenticExternalIdOfRxPduInfo: resulting-properties={base-type=uint8, sw-calibration-access=READ-ONLY, compu {255=SECOC_NO_AUTHENTICEXTERNALIDOFRXPDUINFO}, range raw 0..255}
              AuthenticPduDataContainerAuthenticPduEndIdxOfRxPduInfo: resulting-properties={base-type=uint8, sw-calibration-access=READ-ONLY, compu {255=SECOC_NO_AUTHENTICPDUDATACONTAINERAUTHENTICPDUENDIDXOFRXPDUINFO}, range raw 0..255}
              AuthenticPduDataContainerAuthenticPduLengthOfRxPduInfo: resulting-properties={base-type=uint8, sw-calibration-access=READ-ONLY, range raw 0..255}
              AuthenticPduDataContainerAuthenticPduStartIdxOfRxPduInfo: resulting-properties={base-type=uint8, sw-calibration-access=READ-ONLY, compu {255=SECOC_NO_AUTHENTICPDUDATACONTAINERAUTHENTICPDUSTARTIDXOFRXPDUINFO}, range raw 0..255}
              AuthenticPduDataContainerDataToAuthenticateEndIdxOfRxPduInfo: resulting-properties={base-type=uint8, sw-calibration-access=READ-ONLY, range raw 0..255}
              AuthenticPduDataContainerDataToAuthenticateLengthOfRxPduInfo: resulting-properties={base-type=uint8, sw-calibration-access=READ-ONLY, range raw 0..255}
              AuthenticPduDataContainerDataToAuthenticateStartIdxOfRxPduInfo: resulting-properties={base-type=uint8, sw-calibration-access=READ-ONLY, range raw 0..255}
              AuthenticPduDataContainerFreshnessVerifyValueEndIdxOfRxPduInfo: resulting-properties={base-type=uint8, sw-calibration-access=READ-ONLY, compu-method=SecOC_AuthenticPduDataContainerFreshnessVerifyValueEndIdxOfRxPduInfoType, range raw 0..255}
              AuthenticPduDataContainerFreshnessVerifyValueLengthOfRxPduInfo: resulting-properties={base-type=uint8, sw-calibration-access=READ-ONLY, range raw 0..255}
              AuthenticPduDataContainerFreshnessVerifyValueStartIdxOfRxPduInfo: resulting-properties={base-type=uint8, sw-calibration-access=READ-ONLY, compu-method=SecOC_AuthenticPduDataContainerFreshnessVerifyValueStartIdxOfRxPduInfoType, range raw 0..255}
              AuthenticatorCacheEndIdxOfRxPduInfo: resulting-properties={base-type=uint8, sw-calibration-access=READ-ONLY, range raw 0..255}
              AuthenticatorCacheLengthOfRxPduInfo: resulting-properties={base-type=uint8, sw-calibration-access=READ-ONLY, range raw 0..255}
              AuthenticatorCacheStartIdxOfRxPduInfo: resulting-properties={base-type=uint8, sw-calibration-access=READ-ONLY, range raw 0..255}
              BuildAttemptsOfRxPduInfo: resulting-properties={base-type=uint8, sw-calibration-access=READ-ONLY, range raw 0..255}
              ClientServerVerificationStatusPropagationModeOfRxPduInfo: resulting-properties={base-type=uint8, sw-calibration-access=READ-ONLY, compu {2=SECOC_NONE_CLIENTSERVERVERIFICATIONSTATUSPROPAGATIONMODEOFRXPDUINFO}, range raw 0..255}
              DataIdFirstByteOfRxPduInfo: resulting-properties={base-type=uint8, sw-calibration-access=READ-ONLY, range raw 0..255}
              DataIdSecondByteOfRxPduInfo: resulting-properties={base-type=uint8, sw-calibration-access=READ-ONLY, range raw 0..255}
              ExternalFreshnessIdOfRxPduInfo: resulting-properties={base-type=uint8, sw-calibration-access=READ-ONLY, range raw 0..255}
              NumberOfMessagesToOverrideIdxOfRxPduInfo: resulting-properties={base-type=uint8, sw-calibration-access=READ-ONLY, range raw 0..255}
              PduProcessingOfRxPduInfo: resulting-properties={base-type=uint8, sw-calibration-access=READ-ONLY, compu {1=SECOC_DEFERRED_PDUPROCESSINGOFRXPDUINFO}, range raw 0..255}
              PduTypeOfRxPduInfo: resulting-properties={base-type=uint8, sw-calibration-access=READ-ONLY, compu {0=SECOC_IFPDU_PDUTYPEOFRXPDUINFO}, range raw 0..255}
              RxSecuredPduInfoIdxOfRxPduInfo: resulting-properties={base-type=uint8, sw-calibration-access=READ-ONLY, range raw 0..255}
              SecuredPduDataContainerAuthenticPduEndIdxOfRxPduInfo: resulting-properties={base-type=uint8, sw-calibration-access=READ-ONLY, compu {255=SECOC_NO_SECUREDPDUDATACONTAINERAUTHENTICPDUENDIDXOFRXPDUINFO}, range raw 0..255}
              SecuredPduDataContainerAuthenticPduLengthOfRxPduInfo: resulting-properties={base-type=uint8, sw-calibration-access=READ-ONLY, range raw 0..255}
              SecuredPduDataContainerAuthenticPduStartIdxOfRxPduInfo: resulting-properties={base-type=uint8, sw-calibration-access=READ-ONLY, compu {255=SECOC_NO_SECUREDPDUDATACONTAINERAUTHENTICPDUSTARTIDXOFRXPDUINFO}, range raw 0..255}
              SecuredPduDataContainerSecuredPduEndIdxOfRxPduInfo: resulting-properties={base-type=uint8, sw-calibration-access=READ-ONLY, compu {255=SECOC_NO_SECUREDPDUDATACONTAINERSECUREDPDUENDIDXOFRXPDUINFO}, range raw 0..255}
              SecuredPduDataContainerSecuredPduLengthOfRxPduInfo: resulting-properties={base-type=uint8, sw-calibration-access=READ-ONLY, range raw 0..255}
              SecuredPduDataContainerSecuredPduStartIdxOfRxPduInfo: resulting-properties={base-type=uint8, sw-calibration-access=READ-ONLY, compu {255=SECOC_NO_SECUREDPDUDATACONTAINERSECUREDPDUSTARTIDXOFRXPDUINFO}, range raw 0..255}
              SecuredPduDataContainerTpSecuredPduEndIdxOfRxPduInfo: resulting-properties={base-type=uint8, sw-calibration-access=READ-ONLY, compu {255=SECOC_NO_SECUREDPDUDATACONTAINERTPSECUREDPDUENDIDXOFRXPDUINFO}, range raw 0..255}
              SecuredPduDataContainerTpSecuredPduLengthOfRxPduInfo: resulting-properties={base-type=uint8, sw-calibration-access=READ-ONLY, range raw 0..255}
              SecuredPduDataContainerTpSecuredPduStartIdxOfRxPduInfo: resulting-properties={base-type=uint8, sw-calibration-access=READ-ONLY, compu {255=SECOC_NO_SECUREDPDUDATACONTAINERTPSECUREDPDUSTARTIDXOFRXPDUINFO}, range raw 0..255}
              SecuredPduDataContainerTruncatedAuthenticatorEndIdxOfRxPduInfo: resulting-properties={base-type=uint8, sw-calibration-access=READ-ONLY, compu-method=SecOC_SecuredPduDataContainerTruncatedAuthenticatorEndIdxOfRxPduInfoType, range raw 0..255}
              SecuredPduDataContainerTruncatedAuthenticatorLengthOfRxPduInfo: resulting-properties={base-type=uint8, sw-calibration-access=READ-ONLY, range raw 0..255}
              SecuredPduDataContainerTruncatedAuthenticatorStartIdxOfRxPduInfo: resulting-properties={base-type=uint8, sw-calibration-access=READ-ONLY, compu-method=SecOC_SecuredPduDataContainerTruncatedAuthenticatorStartIdxOfRxPduInfoType, range raw 0..255}
              TruncAuthStartBitInByteOfRxPduInfo: resulting-properties={base-type=uint8, sw-calibration-access=READ-ONLY, range raw 0..255}
              TruncFreshnessValueFirstByteShiftOfRxPduInfo: resulting-properties={base-type=uint8, sw-calibration-access=READ-ONLY, range raw 0..255}
              TruncFreshnessValueSecondByteShiftOfRxPduInfo: resulting-properties={base-type=uint8, sw-calibration-access=READ-ONLY, range raw 0..255}
              VerificationStatusPropagationModeOfRxPduInfo: resulting-properties={base-type=uint8, sw-calibration-access=READ-ONLY, compu {2=SECOC_NONE_VERIFICATIONSTATUSPROPAGATIONMODEOFRXPDUINFO}, range raw 0..255}
              VerificationStatusWithSecuredPduPropagationModeOfRxPduInfo: resulting-properties={base-type=uint8, sw-calibration-access=READ-ONLY, compu-method=SecOC_VerificationStatusWithSecuredPduPropagationModeOfRxPduInfoType, range raw 0..255}
              VerifyAttemptsOfRxPduInfo: resulting-properties={base-type=uint8, sw-calibration-access=READ-ONLY, range raw 0..255}
              VerifyOverrideStatusIdxOfRxPduInfo: resulting-properties={base-type=uint8, sw-calibration-access=READ-ONLY, range raw 0..255}
              VerifyResultIdxOfRxPduInfo: resulting-properties={base-type=uint8, sw-calibration-access=READ-ONLY, range raw 0..255}
              truncatedAuthenticationLengthOfRxPduInfo: resulting-properties={base-type=uint8, sw-calibration-access=READ-ONLY, range raw 0..255}
              truncatedFreshnessValueLengthOfRxPduInfo: resulting-properties={base-type=uint8, sw-calibration-access=READ-ONLY, range raw 0..255}
          mc data instance Element_2: category=STRUCTURE, symbol=[2]
            49 x mc data instance, all with category=VALUE:
              AuthenticationLayerIdOfRxPduInfo: resulting-properties={base-type=uint16, sw-calibration-access=READ-ONLY, range raw 0..65535}
              DataIdOfRxPduInfo: resulting-properties={base-type=uint16, sw-calibration-access=READ-ONLY, range raw 0..65535}
              AuthDataFreshnessOfRxPduInfo: resulting-properties={base-type=uint8, sw-calibration-access=READ-ONLY, compu-method=SecOC_AuthDataFreshnessOfRxPduInfoType, range raw 0..255}
              AuthDataFreshnessLenOfRxPduInfo: resulting-properties={base-type=uint8, sw-calibration-access=READ-ONLY, range raw 0..255}
              AuthDataFreshnessStartBytePositionOfRxPduInfo: resulting-properties={base-type=uint8, sw-calibration-access=READ-ONLY, range raw 0..255}
              AuthenticExternalIdOfRxPduInfo: resulting-properties={base-type=uint8, sw-calibration-access=READ-ONLY, compu {255=SECOC_NO_AUTHENTICEXTERNALIDOFRXPDUINFO}, range raw 0..255}
              AuthenticPduDataContainerAuthenticPduEndIdxOfRxPduInfo: resulting-properties={base-type=uint8, sw-calibration-access=READ-ONLY, compu {255=SECOC_NO_AUTHENTICPDUDATACONTAINERAUTHENTICPDUENDIDXOFRXPDUINFO}, range raw 0..255}
              AuthenticPduDataContainerAuthenticPduLengthOfRxPduInfo: resulting-properties={base-type=uint8, sw-calibration-access=READ-ONLY, range raw 0..255}
              AuthenticPduDataContainerAuthenticPduStartIdxOfRxPduInfo: resulting-properties={base-type=uint8, sw-calibration-access=READ-ONLY, compu {255=SECOC_NO_AUTHENTICPDUDATACONTAINERAUTHENTICPDUSTARTIDXOFRXPDUINFO}, range raw 0..255}
              AuthenticPduDataContainerDataToAuthenticateEndIdxOfRxPduInfo: resulting-properties={base-type=uint8, sw-calibration-access=READ-ONLY, range raw 0..255}
              AuthenticPduDataContainerDataToAuthenticateLengthOfRxPduInfo: resulting-properties={base-type=uint8, sw-calibration-access=READ-ONLY, range raw 0..255}
              AuthenticPduDataContainerDataToAuthenticateStartIdxOfRxPduInfo: resulting-properties={base-type=uint8, sw-calibration-access=READ-ONLY, range raw 0..255}
              AuthenticPduDataContainerFreshnessVerifyValueEndIdxOfRxPduInfo: resulting-properties={base-type=uint8, sw-calibration-access=READ-ONLY, compu-method=SecOC_AuthenticPduDataContainerFreshnessVerifyValueEndIdxOfRxPduInfoType, range raw 0..255}
              AuthenticPduDataContainerFreshnessVerifyValueLengthOfRxPduInfo: resulting-properties={base-type=uint8, sw-calibration-access=READ-ONLY, range raw 0..255}
              AuthenticPduDataContainerFreshnessVerifyValueStartIdxOfRxPduInfo: resulting-properties={base-type=uint8, sw-calibration-access=READ-ONLY, compu-method=SecOC_AuthenticPduDataContainerFreshnessVerifyValueStartIdxOfRxPduInfoType, range raw 0..255}
              AuthenticatorCacheEndIdxOfRxPduInfo: resulting-properties={base-type=uint8, sw-calibration-access=READ-ONLY, range raw 0..255}
              AuthenticatorCacheLengthOfRxPduInfo: resulting-properties={base-type=uint8, sw-calibration-access=READ-ONLY, range raw 0..255}
              AuthenticatorCacheStartIdxOfRxPduInfo: resulting-properties={base-type=uint8, sw-calibration-access=READ-ONLY, range raw 0..255}
              BuildAttemptsOfRxPduInfo: resulting-properties={base-type=uint8, sw-calibration-access=READ-ONLY, range raw 0..255}
              ClientServerVerificationStatusPropagationModeOfRxPduInfo: resulting-properties={base-type=uint8, sw-calibration-access=READ-ONLY, compu {2=SECOC_NONE_CLIENTSERVERVERIFICATIONSTATUSPROPAGATIONMODEOFRXPDUINFO}, range raw 0..255}
              DataIdFirstByteOfRxPduInfo: resulting-properties={base-type=uint8, sw-calibration-access=READ-ONLY, range raw 0..255}
              DataIdSecondByteOfRxPduInfo: resulting-properties={base-type=uint8, sw-calibration-access=READ-ONLY, range raw 0..255}
              ExternalFreshnessIdOfRxPduInfo: resulting-properties={base-type=uint8, sw-calibration-access=READ-ONLY, range raw 0..255}
              NumberOfMessagesToOverrideIdxOfRxPduInfo: resulting-properties={base-type=uint8, sw-calibration-access=READ-ONLY, range raw 0..255}
              PduProcessingOfRxPduInfo: resulting-properties={base-type=uint8, sw-calibration-access=READ-ONLY, compu {1=SECOC_DEFERRED_PDUPROCESSINGOFRXPDUINFO}, range raw 0..255}
              PduTypeOfRxPduInfo: resulting-properties={base-type=uint8, sw-calibration-access=READ-ONLY, compu {0=SECOC_IFPDU_PDUTYPEOFRXPDUINFO}, range raw 0..255}
              RxSecuredPduInfoIdxOfRxPduInfo: resulting-properties={base-type=uint8, sw-calibration-access=READ-ONLY, range raw 0..255}
              SecuredPduDataContainerAuthenticPduEndIdxOfRxPduInfo: resulting-properties={base-type=uint8, sw-calibration-access=READ-ONLY, compu {255=SECOC_NO_SECUREDPDUDATACONTAINERAUTHENTICPDUENDIDXOFRXPDUINFO}, range raw 0..255}
              SecuredPduDataContainerAuthenticPduLengthOfRxPduInfo: resulting-properties={base-type=uint8, sw-calibration-access=READ-ONLY, range raw 0..255}
              SecuredPduDataContainerAuthenticPduStartIdxOfRxPduInfo: resulting-properties={base-type=uint8, sw-calibration-access=READ-ONLY, compu {255=SECOC_NO_SECUREDPDUDATACONTAINERAUTHENTICPDUSTARTIDXOFRXPDUINFO}, range raw 0..255}
              SecuredPduDataContainerSecuredPduEndIdxOfRxPduInfo: resulting-properties={base-type=uint8, sw-calibration-access=READ-ONLY, compu {255=SECOC_NO_SECUREDPDUDATACONTAINERSECUREDPDUENDIDXOFRXPDUINFO}, range raw 0..255}
              SecuredPduDataContainerSecuredPduLengthOfRxPduInfo: resulting-properties={base-type=uint8, sw-calibration-access=READ-ONLY, range raw 0..255}
              SecuredPduDataContainerSecuredPduStartIdxOfRxPduInfo: resulting-properties={base-type=uint8, sw-calibration-access=READ-ONLY, compu {255=SECOC_NO_SECUREDPDUDATACONTAINERSECUREDPDUSTARTIDXOFRXPDUINFO}, range raw 0..255}
              SecuredPduDataContainerTpSecuredPduEndIdxOfRxPduInfo: resulting-properties={base-type=uint8, sw-calibration-access=READ-ONLY, compu {255=SECOC_NO_SECUREDPDUDATACONTAINERTPSECUREDPDUENDIDXOFRXPDUINFO}, range raw 0..255}
              SecuredPduDataContainerTpSecuredPduLengthOfRxPduInfo: resulting-properties={base-type=uint8, sw-calibration-access=READ-ONLY, range raw 0..255}
              SecuredPduDataContainerTpSecuredPduStartIdxOfRxPduInfo: resulting-properties={base-type=uint8, sw-calibration-access=READ-ONLY, compu {255=SECOC_NO_SECUREDPDUDATACONTAINERTPSECUREDPDUSTARTIDXOFRXPDUINFO}, range raw 0..255}
              SecuredPduDataContainerTruncatedAuthenticatorEndIdxOfRxPduInfo: resulting-properties={base-type=uint8, sw-calibration-access=READ-ONLY, compu-method=SecOC_SecuredPduDataContainerTruncatedAuthenticatorEndIdxOfRxPduInfoType, range raw 0..255}
              SecuredPduDataContainerTruncatedAuthenticatorLengthOfRxPduInfo: resulting-properties={base-type=uint8, sw-calibration-access=READ-ONLY, range raw 0..255}
              SecuredPduDataContainerTruncatedAuthenticatorStartIdxOfRxPduInfo: resulting-properties={base-type=uint8, sw-calibration-access=READ-ONLY, compu-method=SecOC_SecuredPduDataContainerTruncatedAuthenticatorStartIdxOfRxPduInfoType, range raw 0..255}
              TruncAuthStartBitInByteOfRxPduInfo: resulting-properties={base-type=uint8, sw-calibration-access=READ-ONLY, range raw 0..255}
              TruncFreshnessValueFirstByteShiftOfRxPduInfo: resulting-properties={base-type=uint8, sw-calibration-access=READ-ONLY, range raw 0..255}
              TruncFreshnessValueSecondByteShiftOfRxPduInfo: resulting-properties={base-type=uint8, sw-calibration-access=READ-ONLY, range raw 0..255}
              VerificationStatusPropagationModeOfRxPduInfo: resulting-properties={base-type=uint8, sw-calibration-access=READ-ONLY, compu {2=SECOC_NONE_VERIFICATIONSTATUSPROPAGATIONMODEOFRXPDUINFO}, range raw 0..255}
              VerificationStatusWithSecuredPduPropagationModeOfRxPduInfo: resulting-properties={base-type=uint8, sw-calibration-access=READ-ONLY, compu-method=SecOC_VerificationStatusWithSecuredPduPropagationModeOfRxPduInfoType, range raw 0..255}
              VerifyAttemptsOfRxPduInfo: resulting-properties={base-type=uint8, sw-calibration-access=READ-ONLY, range raw 0..255}
              VerifyOverrideStatusIdxOfRxPduInfo: resulting-properties={base-type=uint8, sw-calibration-access=READ-ONLY, range raw 0..255}
              VerifyResultIdxOfRxPduInfo: resulting-properties={base-type=uint8, sw-calibration-access=READ-ONLY, range raw 0..255}
              truncatedAuthenticationLengthOfRxPduInfo: resulting-properties={base-type=uint8, sw-calibration-access=READ-ONLY, range raw 0..255}
              truncatedFreshnessValueLengthOfRxPduInfo: resulting-properties={base-type=uint8, sw-calibration-access=READ-ONLY, range raw 0..255}
        SecOC_RxSecuredPduInfo: category=ARRAY, array-size=3
          mc data instance Element_0: category=STRUCTURE, symbol=[0]
            11 x mc data instance, all with category=VALUE:
              MessageLinkLenOfRxSecuredPduInfo: resulting-properties={base-type=uint8, sw-calibration-access=READ-ONLY, range raw 0..255}
              MessageLinkPosOfRxSecuredPduInfo: resulting-properties={base-type=uint8, sw-calibration-access=READ-ONLY, range raw 0..255}
              MessageLinkerStartByteInCryptoPduOfRxSecuredPduInfo: resulting-properties={base-type=uint8, sw-calibration-access=READ-ONLY, range raw 0..255}
              MessageTypeOfRxSecuredPduInfo: resulting-properties={base-type=uint8, sw-calibration-access=READ-ONLY, compu {0=SECOC_NORMAL_MESSAGETYPEOFRXSECUREDPDUINFO}, range raw 0..255}
              MessagesLinkCryptoPduSrcBitOffsetOfRxSecuredPduInfo: resulting-properties={base-type=uint8, sw-calibration-access=READ-ONLY, range raw 0..255}
              MinimumPduLengthOfRxSecuredPduInfo: resulting-properties={base-type=uint8, sw-calibration-access=READ-ONLY, range raw 0..255}
              PduFixLengthOfRxSecuredPduInfo: resulting-properties={base-type=uint8, sw-calibration-access=READ-ONLY, range raw 0..255}
              RxPduInfoIdxOfRxSecuredPduInfo: resulting-properties={base-type=uint8, sw-calibration-access=READ-ONLY, range raw 0..255}
              SecuredPduDataContainerEndIdxOfRxSecuredPduInfo: resulting-properties={base-type=uint8, sw-calibration-access=READ-ONLY, range raw 0..255}
              SecuredPduDataContainerLengthOfRxSecuredPduInfo: resulting-properties={base-type=uint8, sw-calibration-access=READ-ONLY, range raw 0..255}
              SecuredPduDataContainerStartIdxOfRxSecuredPduInfo: resulting-properties={base-type=uint8, sw-calibration-access=READ-ONLY, range raw 0..255}
          mc data instance Element_1: category=STRUCTURE, symbol=[1]
            11 x mc data instance, all with category=VALUE:
              MessageLinkLenOfRxSecuredPduInfo: resulting-properties={base-type=uint8, sw-calibration-access=READ-ONLY, range raw 0..255}
              MessageLinkPosOfRxSecuredPduInfo: resulting-properties={base-type=uint8, sw-calibration-access=READ-ONLY, range raw 0..255}
              MessageLinkerStartByteInCryptoPduOfRxSecuredPduInfo: resulting-properties={base-type=uint8, sw-calibration-access=READ-ONLY, range raw 0..255}
              MessageTypeOfRxSecuredPduInfo: resulting-properties={base-type=uint8, sw-calibration-access=READ-ONLY, compu {0=SECOC_NORMAL_MESSAGETYPEOFRXSECUREDPDUINFO}, range raw 0..255}
              MessagesLinkCryptoPduSrcBitOffsetOfRxSecuredPduInfo: resulting-properties={base-type=uint8, sw-calibration-access=READ-ONLY, range raw 0..255}
              MinimumPduLengthOfRxSecuredPduInfo: resulting-properties={base-type=uint8, sw-calibration-access=READ-ONLY, range raw 0..255}
              PduFixLengthOfRxSecuredPduInfo: resulting-properties={base-type=uint8, sw-calibration-access=READ-ONLY, range raw 0..255}
              RxPduInfoIdxOfRxSecuredPduInfo: resulting-properties={base-type=uint8, sw-calibration-access=READ-ONLY, range raw 0..255}
              SecuredPduDataContainerEndIdxOfRxSecuredPduInfo: resulting-properties={base-type=uint8, sw-calibration-access=READ-ONLY, range raw 0..255}
              SecuredPduDataContainerLengthOfRxSecuredPduInfo: resulting-properties={base-type=uint8, sw-calibration-access=READ-ONLY, range raw 0..255}
              SecuredPduDataContainerStartIdxOfRxSecuredPduInfo: resulting-properties={base-type=uint8, sw-calibration-access=READ-ONLY, range raw 0..255}
          mc data instance Element_2: category=STRUCTURE, symbol=[2]
            11 x mc data instance, all with category=VALUE:
              MessageLinkLenOfRxSecuredPduInfo: resulting-properties={base-type=uint8, sw-calibration-access=READ-ONLY, range raw 0..255}
              MessageLinkPosOfRxSecuredPduInfo: resulting-properties={base-type=uint8, sw-calibration-access=READ-ONLY, range raw 0..255}
              MessageLinkerStartByteInCryptoPduOfRxSecuredPduInfo: resulting-properties={base-type=uint8, sw-calibration-access=READ-ONLY, range raw 0..255}
              MessageTypeOfRxSecuredPduInfo: resulting-properties={base-type=uint8, sw-calibration-access=READ-ONLY, compu {0=SECOC_NORMAL_MESSAGETYPEOFRXSECUREDPDUINFO}, range raw 0..255}
              MessagesLinkCryptoPduSrcBitOffsetOfRxSecuredPduInfo: resulting-properties={base-type=uint8, sw-calibration-access=READ-ONLY, range raw 0..255}
              MinimumPduLengthOfRxSecuredPduInfo: resulting-properties={base-type=uint8, sw-calibration-access=READ-ONLY, range raw 0..255}
              PduFixLengthOfRxSecuredPduInfo: resulting-properties={base-type=uint8, sw-calibration-access=READ-ONLY, range raw 0..255}
              RxPduInfoIdxOfRxSecuredPduInfo: resulting-properties={base-type=uint8, sw-calibration-access=READ-ONLY, range raw 0..255}
              SecuredPduDataContainerEndIdxOfRxSecuredPduInfo: resulting-properties={base-type=uint8, sw-calibration-access=READ-ONLY, range raw 0..255}
              SecuredPduDataContainerLengthOfRxSecuredPduInfo: resulting-properties={base-type=uint8, sw-calibration-access=READ-ONLY, range raw 0..255}
              SecuredPduDataContainerStartIdxOfRxSecuredPduInfo: resulting-properties={base-type=uint8, sw-calibration-access=READ-ONLY, range raw 0..255}
        SecOC_TxAuthenticPduInfo: category=ARRAY, array-size=8
          8 x mc data instance, all with category=STRUCTURE:
            Element_0: symbol=[0]
              mc data instance MinimumPduLengthOfTxAuthenticPduInfo: category=VALUE, resulting-properties={base-type=uint8, sw-calibration-access=READ-ONLY, range raw 0..255}
              mc data instance TxPduInfoIdxOfTxAuthenticPduInfo: category=VALUE, resulting-properties={base-type=uint8, sw-calibration-access=READ-ONLY, range raw 0..255}
            Element_1: symbol=[1]
              mc data instance MinimumPduLengthOfTxAuthenticPduInfo: category=VALUE, resulting-properties={base-type=uint8, sw-calibration-access=READ-ONLY, range raw 0..255}
              mc data instance TxPduInfoIdxOfTxAuthenticPduInfo: category=VALUE, resulting-properties={base-type=uint8, sw-calibration-access=READ-ONLY, range raw 0..255}
            Element_2: symbol=[2]
              mc data instance MinimumPduLengthOfTxAuthenticPduInfo: category=VALUE, resulting-properties={base-type=uint8, sw-calibration-access=READ-ONLY, range raw 0..255}
              mc data instance TxPduInfoIdxOfTxAuthenticPduInfo: category=VALUE, resulting-properties={base-type=uint8, sw-calibration-access=READ-ONLY, range raw 0..255}
            Element_3: symbol=[3]
              mc data instance MinimumPduLengthOfTxAuthenticPduInfo: category=VALUE, resulting-properties={base-type=uint8, sw-calibration-access=READ-ONLY, range raw 0..255}
              mc data instance TxPduInfoIdxOfTxAuthenticPduInfo: category=VALUE, resulting-properties={base-type=uint8, sw-calibration-access=READ-ONLY, range raw 0..255}
            Element_4: symbol=[4]
              mc data instance MinimumPduLengthOfTxAuthenticPduInfo: category=VALUE, resulting-properties={base-type=uint8, sw-calibration-access=READ-ONLY, range raw 0..255}
              mc data instance TxPduInfoIdxOfTxAuthenticPduInfo: category=VALUE, resulting-properties={base-type=uint8, sw-calibration-access=READ-ONLY, range raw 0..255}
            Element_5: symbol=[5]
              mc data instance MinimumPduLengthOfTxAuthenticPduInfo: category=VALUE, resulting-properties={base-type=uint8, sw-calibration-access=READ-ONLY, range raw 0..255}
              mc data instance TxPduInfoIdxOfTxAuthenticPduInfo: category=VALUE, resulting-properties={base-type=uint8, sw-calibration-access=READ-ONLY, range raw 0..255}
            Element_6: symbol=[6]
              mc data instance MinimumPduLengthOfTxAuthenticPduInfo: category=VALUE, resulting-properties={base-type=uint8, sw-calibration-access=READ-ONLY, range raw 0..255}
              mc data instance TxPduInfoIdxOfTxAuthenticPduInfo: category=VALUE, resulting-properties={base-type=uint8, sw-calibration-access=READ-ONLY, range raw 0..255}
            Element_7: symbol=[7]
              mc data instance MinimumPduLengthOfTxAuthenticPduInfo: category=VALUE, resulting-properties={base-type=uint8, sw-calibration-access=READ-ONLY, range raw 0..255}
              mc data instance TxPduInfoIdxOfTxAuthenticPduInfo: category=VALUE, resulting-properties={base-type=uint8, sw-calibration-access=READ-ONLY, range raw 0..255}
        SecOC_TxPduInfo: category=ARRAY, array-size=8
          8 x mc data instance, all with category=STRUCTURE:
            Element_0: symbol=[0]
              44 x mc data instance, all with category=VALUE:
                AuthenticPduDataContainerAuthenticPduEndIdxOfTxPduInfo: resulting-properties={base-type=uint16, sw-calibration-access=READ-ONLY, compu {65535=SECOC_NO_AUTHENTICPDUDATACONTAINERAUTHENTICPDUENDIDXOFTXPDUINFO}, range raw 0..65535}
                AuthenticPduDataContainerAuthenticPduStartIdxOfTxPduInfo: resulting-properties={base-type=uint16, sw-calibration-access=READ-ONLY, compu-method=SecOC_AuthenticPduDataContainerAuthenticPduStartIdxOfTxPduInfoType, range raw 0..65535}
                AuthenticPduDataContainerDataToAuthenticateEndIdxOfTxPduInfo: resulting-properties={base-type=uint16, sw-calibration-access=READ-ONLY, range raw 0..65535}
                AuthenticPduDataContainerDataToAuthenticateStartIdxOfTxPduInfo: resulting-properties={base-type=uint16, sw-calibration-access=READ-ONLY, range raw 0..65535}
                AuthenticPduDataContainerFreshnessVerifyValueEndIdxOfTxPduInfo: resulting-properties={base-type=uint16, sw-calibration-access=READ-ONLY, compu-method=SecOC_AuthenticPduDataContainerFreshnessVerifyValueEndIdxOfTxPduInfoType, range raw 0..65535}
                AuthenticPduDataContainerFreshnessVerifyValueStartIdxOfTxPduInfo: resulting-properties={base-type=uint16, sw-calibration-access=READ-ONLY, compu-method=SecOC_AuthenticPduDataContainerFreshnessVerifyValueStartIdxOfTxPduInfoType, range raw 0..65535}
                AuthenticPduDataContainerFullAuthenticPduEndIdxOfTxPduInfo: resulting-properties={base-type=uint16, sw-calibration-access=READ-ONLY, compu-method=SecOC_AuthenticPduDataContainerFullAuthenticPduEndIdxOfTxPduInfoType, range raw 0..65535}
                AuthenticPduDataContainerFullAuthenticPduStartIdxOfTxPduInfo: resulting-properties={base-type=uint16, sw-calibration-access=READ-ONLY, compu-method=SecOC_AuthenticPduDataContainerFullAuthenticPduStartIdxOfTxPduInfoType, range raw 0..65535}
                AuthenticationLayerIdOfTxPduInfo: resulting-properties={base-type=uint16, sw-calibration-access=READ-ONLY, range raw 0..65535}
                ConfirmationNeededOfTxPduInfo: resulting-properties={base-type=boolean, sw-calibration-access=READ-ONLY, compu {0=FALSE, 1..255=TRUE}, range raw 0..1}
                AuthenticExternalIdOfTxPduInfo: resulting-properties={base-type=uint8, sw-calibration-access=READ-ONLY, compu {255=SECOC_NO_AUTHENTICEXTERNALIDOFTXPDUINFO}, range raw 0..255}
                AuthenticPduDataContainerAuthenticPduLengthOfTxPduInfo: resulting-properties={base-type=uint8, sw-calibration-access=READ-ONLY, range raw 0..255}
                AuthenticPduDataContainerDataToAuthenticateLengthOfTxPduInfo: resulting-properties={base-type=uint8, sw-calibration-access=READ-ONLY, range raw 0..255}
                AuthenticPduDataContainerFreshnessVerifyValueLengthOfTxPduInfo: resulting-properties={base-type=uint8, sw-calibration-access=READ-ONLY, range raw 0..255}
                AuthenticPduDataContainerFullAuthenticPduLengthOfTxPduInfo: resulting-properties={base-type=uint8, sw-calibration-access=READ-ONLY, range raw 0..255}
                AuthenticatorCacheEndIdxOfTxPduInfo: resulting-properties={base-type=uint8, sw-calibration-access=READ-ONLY, range raw 0..255}
                AuthenticatorCacheLengthOfTxPduInfo: resulting-properties={base-type=uint8, sw-calibration-access=READ-ONLY, range raw 0..255}
                AuthenticatorCacheStartIdxOfTxPduInfo: resulting-properties={base-type=uint8, sw-calibration-access=READ-ONLY, range raw 0..255}
                BuildAttemptsOfTxPduInfo: resulting-properties={base-type=uint8, sw-calibration-access=READ-ONLY, range raw 0..255}
                DataIdFirstByteOfTxPduInfo: resulting-properties={base-type=uint8, sw-calibration-access=READ-ONLY, range raw 0..255}
                DataIdSecondByteOfTxPduInfo: resulting-properties={base-type=uint8, sw-calibration-access=READ-ONLY, range raw 0..255}
                ExternalFreshnessIdOfTxPduInfo: resulting-properties={base-type=uint8, sw-calibration-access=READ-ONLY, range raw 0..255}
                LowerLayerPduTypeOfTxPduInfo: resulting-properties={base-type=uint8, sw-calibration-access=READ-ONLY, compu {0=SECOC_IFPDU_LOWERLAYERPDUTYPEOFTXPDUINFO}, range raw 0..255}
                PduProcessingOfTxPduInfo: resulting-properties={base-type=uint8, sw-calibration-access=READ-ONLY, compu {1=SECOC_DEFERRED_PDUPROCESSINGOFTXPDUINFO}, range raw 0..255}
                PduTypeOfTxPduInfo: resulting-properties={base-type=uint8, sw-calibration-access=READ-ONLY, compu {0=SECOC_IFPDU_PDUTYPEOFTXPDUINFO}, range raw 0..255}
                ProvideTruncTxFreshnessOfTxPduInfo: resulting-properties={base-type=uint8, sw-calibration-access=READ-ONLY, compu {1=SECOC_DONT_PROVIDE_PROVIDETRUNCTXFRESHNESSOFTXPDUINFO}, range raw 0..255}
                SecuredExternalIdOfTxPduInfo: resulting-properties={base-type=uint8, sw-calibration-access=READ-ONLY, compu {255=SECOC_NO_SECUREDEXTERNALIDOFTXPDUINFO}, range raw 0..255}
                SecuredPduDataContainerAuthInfoDataEndIdxOfTxPduInfo: resulting-properties={base-type=uint8, sw-calibration-access=READ-ONLY, compu {255=SECOC_NO_SECUREDPDUDATACONTAINERAUTHINFODATAENDIDXOFTXPDUINFO}, range raw 0..255}
                SecuredPduDataContainerAuthInfoDataLengthOfTxPduInfo: resulting-properties={base-type=uint8, sw-calibration-access=READ-ONLY, range raw 0..255}
                SecuredPduDataContainerAuthInfoDataStartIdxOfTxPduInfo: resulting-properties={base-type=uint8, sw-calibration-access=READ-ONLY, compu {255=SECOC_NO_SECUREDPDUDATACONTAINERAUTHINFODATASTARTIDXOFTXPDUINFO}, range raw 0..255}
                SecuredPduDataContainerAuthenticPduEndIdxOfTxPduInfo: resulting-properties={base-type=uint8, sw-calibration-access=READ-ONLY, compu {255=SECOC_NO_SECUREDPDUDATACONTAINERAUTHENTICPDUENDIDXOFTXPDUINFO}, range raw 0..255}
                SecuredPduDataContainerAuthenticPduLengthOfTxPduInfo: resulting-properties={base-type=uint8, sw-calibration-access=READ-ONLY, range raw 0..255}
                SecuredPduDataContainerAuthenticPduStartIdxOfTxPduInfo: resulting-properties={base-type=uint8, sw-calibration-access=READ-ONLY, compu {255=SECOC_NO_SECUREDPDUDATACONTAINERAUTHENTICPDUSTARTIDXOFTXPDUINFO}, range raw 0..255}
                SecuredPduDataContainerSecuredPduEndIdxOfTxPduInfo: resulting-properties={base-type=uint8, sw-calibration-access=READ-ONLY, compu {255=SECOC_NO_SECUREDPDUDATACONTAINERSECUREDPDUENDIDXOFTXPDUINFO}, range raw 0..255}
                SecuredPduDataContainerSecuredPduLengthOfTxPduInfo: resulting-properties={base-type=uint8, sw-calibration-access=READ-ONLY, range raw 0..255}
                SecuredPduDataContainerSecuredPduStartIdxOfTxPduInfo: resulting-properties={base-type=uint8, sw-calibration-access=READ-ONLY, compu {255=SECOC_NO_SECUREDPDUDATACONTAINERSECUREDPDUSTARTIDXOFTXPDUINFO}, range raw 0..255}
                SecuredPduDataContainerTruncatedAuthenticatorEndIdxOfTxPduInfo: resulting-properties={base-type=uint8, sw-calibration-access=READ-ONLY, compu-method=SecOC_SecuredPduDataContainerTruncatedAuthenticatorEndIdxOfTxPduInfoType, range raw 0..255}
                SecuredPduDataContainerTruncatedAuthenticatorLengthOfTxPduInfo: resulting-properties={base-type=uint8, sw-calibration-access=READ-ONLY, range raw 0..255}
                SecuredPduDataContainerTruncatedAuthenticatorStartIdxOfTxPduInfo: resulting-properties={base-type=uint8, sw-calibration-access=READ-ONLY, compu-method=SecOC_SecuredPduDataContainerTruncatedAuthenticatorStartIdxOfTxPduInfoType, range raw 0..255}
                TruncAuthStartBitInByteOfTxPduInfo: resulting-properties={base-type=uint8, sw-calibration-access=READ-ONLY, range raw 0..255}
                TruncFreshnessValueFirstByteShiftOfTxPduInfo: resulting-properties={base-type=uint8, sw-calibration-access=READ-ONLY, range raw 0..255}
                TruncFreshnessValueSecondByteShiftOfTxPduInfo: resulting-properties={base-type=uint8, sw-calibration-access=READ-ONLY, range raw 0..255}
                truncatedAuthenticationLengthOfTxPduInfo: resulting-properties={base-type=uint8, sw-calibration-access=READ-ONLY, range raw 0..255}
                truncatedFreshnessValueLengthOfTxPduInfo: resulting-properties={base-type=uint8, sw-calibration-access=READ-ONLY, range raw 0..255}
            Element_1: symbol=[1]
              44 x mc data instance, all with category=VALUE:
                AuthenticPduDataContainerAuthenticPduEndIdxOfTxPduInfo: resulting-properties={base-type=uint16, sw-calibration-access=READ-ONLY, compu {65535=SECOC_NO_AUTHENTICPDUDATACONTAINERAUTHENTICPDUENDIDXOFTXPDUINFO}, range raw 0..65535}
                AuthenticPduDataContainerAuthenticPduStartIdxOfTxPduInfo: resulting-properties={base-type=uint16, sw-calibration-access=READ-ONLY, compu-method=SecOC_AuthenticPduDataContainerAuthenticPduStartIdxOfTxPduInfoType, range raw 0..65535}
                AuthenticPduDataContainerDataToAuthenticateEndIdxOfTxPduInfo: resulting-properties={base-type=uint16, sw-calibration-access=READ-ONLY, range raw 0..65535}
                AuthenticPduDataContainerDataToAuthenticateStartIdxOfTxPduInfo: resulting-properties={base-type=uint16, sw-calibration-access=READ-ONLY, range raw 0..65535}
                AuthenticPduDataContainerFreshnessVerifyValueEndIdxOfTxPduInfo: resulting-properties={base-type=uint16, sw-calibration-access=READ-ONLY, compu-method=SecOC_AuthenticPduDataContainerFreshnessVerifyValueEndIdxOfTxPduInfoType, range raw 0..65535}
                AuthenticPduDataContainerFreshnessVerifyValueStartIdxOfTxPduInfo: resulting-properties={base-type=uint16, sw-calibration-access=READ-ONLY, compu-method=SecOC_AuthenticPduDataContainerFreshnessVerifyValueStartIdxOfTxPduInfoType, range raw 0..65535}
                AuthenticPduDataContainerFullAuthenticPduEndIdxOfTxPduInfo: resulting-properties={base-type=uint16, sw-calibration-access=READ-ONLY, compu-method=SecOC_AuthenticPduDataContainerFullAuthenticPduEndIdxOfTxPduInfoType, range raw 0..65535}
                AuthenticPduDataContainerFullAuthenticPduStartIdxOfTxPduInfo: resulting-properties={base-type=uint16, sw-calibration-access=READ-ONLY, compu-method=SecOC_AuthenticPduDataContainerFullAuthenticPduStartIdxOfTxPduInfoType, range raw 0..65535}
                AuthenticationLayerIdOfTxPduInfo: resulting-properties={base-type=uint16, sw-calibration-access=READ-ONLY, range raw 0..65535}
                ConfirmationNeededOfTxPduInfo: resulting-properties={base-type=boolean, sw-calibration-access=READ-ONLY, compu {0=FALSE, 1..255=TRUE}, range raw 0..1}
                AuthenticExternalIdOfTxPduInfo: resulting-properties={base-type=uint8, sw-calibration-access=READ-ONLY, compu {255=SECOC_NO_AUTHENTICEXTERNALIDOFTXPDUINFO}, range raw 0..255}
                AuthenticPduDataContainerAuthenticPduLengthOfTxPduInfo: resulting-properties={base-type=uint8, sw-calibration-access=READ-ONLY, range raw 0..255}
                AuthenticPduDataContainerDataToAuthenticateLengthOfTxPduInfo: resulting-properties={base-type=uint8, sw-calibration-access=READ-ONLY, range raw 0..255}
                AuthenticPduDataContainerFreshnessVerifyValueLengthOfTxPduInfo: resulting-properties={base-type=uint8, sw-calibration-access=READ-ONLY, range raw 0..255}
                AuthenticPduDataContainerFullAuthenticPduLengthOfTxPduInfo: resulting-properties={base-type=uint8, sw-calibration-access=READ-ONLY, range raw 0..255}
                AuthenticatorCacheEndIdxOfTxPduInfo: resulting-properties={base-type=uint8, sw-calibration-access=READ-ONLY, range raw 0..255}
                AuthenticatorCacheLengthOfTxPduInfo: resulting-properties={base-type=uint8, sw-calibration-access=READ-ONLY, range raw 0..255}
                AuthenticatorCacheStartIdxOfTxPduInfo: resulting-properties={base-type=uint8, sw-calibration-access=READ-ONLY, range raw 0..255}
                BuildAttemptsOfTxPduInfo: resulting-properties={base-type=uint8, sw-calibration-access=READ-ONLY, range raw 0..255}
                DataIdFirstByteOfTxPduInfo: resulting-properties={base-type=uint8, sw-calibration-access=READ-ONLY, range raw 0..255}
                DataIdSecondByteOfTxPduInfo: resulting-properties={base-type=uint8, sw-calibration-access=READ-ONLY, range raw 0..255}
                ExternalFreshnessIdOfTxPduInfo: resulting-properties={base-type=uint8, sw-calibration-access=READ-ONLY, range raw 0..255}
                LowerLayerPduTypeOfTxPduInfo: resulting-properties={base-type=uint8, sw-calibration-access=READ-ONLY, compu {0=SECOC_IFPDU_LOWERLAYERPDUTYPEOFTXPDUINFO}, range raw 0..255}
                PduProcessingOfTxPduInfo: resulting-properties={base-type=uint8, sw-calibration-access=READ-ONLY, compu {1=SECOC_DEFERRED_PDUPROCESSINGOFTXPDUINFO}, range raw 0..255}
                PduTypeOfTxPduInfo: resulting-properties={base-type=uint8, sw-calibration-access=READ-ONLY, compu {0=SECOC_IFPDU_PDUTYPEOFTXPDUINFO}, range raw 0..255}
                ProvideTruncTxFreshnessOfTxPduInfo: resulting-properties={base-type=uint8, sw-calibration-access=READ-ONLY, compu {1=SECOC_DONT_PROVIDE_PROVIDETRUNCTXFRESHNESSOFTXPDUINFO}, range raw 0..255}
                SecuredExternalIdOfTxPduInfo: resulting-properties={base-type=uint8, sw-calibration-access=READ-ONLY, compu {255=SECOC_NO_SECUREDEXTERNALIDOFTXPDUINFO}, range raw 0..255}
                SecuredPduDataContainerAuthInfoDataEndIdxOfTxPduInfo: resulting-properties={base-type=uint8, sw-calibration-access=READ-ONLY, compu {255=SECOC_NO_SECUREDPDUDATACONTAINERAUTHINFODATAENDIDXOFTXPDUINFO}, range raw 0..255}
                SecuredPduDataContainerAuthInfoDataLengthOfTxPduInfo: resulting-properties={base-type=uint8, sw-calibration-access=READ-ONLY, range raw 0..255}
                SecuredPduDataContainerAuthInfoDataStartIdxOfTxPduInfo: resulting-properties={base-type=uint8, sw-calibration-access=READ-ONLY, compu {255=SECOC_NO_SECUREDPDUDATACONTAINERAUTHINFODATASTARTIDXOFTXPDUINFO}, range raw 0..255}
                SecuredPduDataContainerAuthenticPduEndIdxOfTxPduInfo: resulting-properties={base-type=uint8, sw-calibration-access=READ-ONLY, compu {255=SECOC_NO_SECUREDPDUDATACONTAINERAUTHENTICPDUENDIDXOFTXPDUINFO}, range raw 0..255}
                SecuredPduDataContainerAuthenticPduLengthOfTxPduInfo: resulting-properties={base-type=uint8, sw-calibration-access=READ-ONLY, range raw 0..255}
                SecuredPduDataContainerAuthenticPduStartIdxOfTxPduInfo: resulting-properties={base-type=uint8, sw-calibration-access=READ-ONLY, compu {255=SECOC_NO_SECUREDPDUDATACONTAINERAUTHENTICPDUSTARTIDXOFTXPDUINFO}, range raw 0..255}
                SecuredPduDataContainerSecuredPduEndIdxOfTxPduInfo: resulting-properties={base-type=uint8, sw-calibration-access=READ-ONLY, compu {255=SECOC_NO_SECUREDPDUDATACONTAINERSECUREDPDUENDIDXOFTXPDUINFO}, range raw 0..255}
                SecuredPduDataContainerSecuredPduLengthOfTxPduInfo: resulting-properties={base-type=uint8, sw-calibration-access=READ-ONLY, range raw 0..255}
                SecuredPduDataContainerSecuredPduStartIdxOfTxPduInfo: resulting-properties={base-type=uint8, sw-calibration-access=READ-ONLY, compu {255=SECOC_NO_SECUREDPDUDATACONTAINERSECUREDPDUSTARTIDXOFTXPDUINFO}, range raw 0..255}
                SecuredPduDataContainerTruncatedAuthenticatorEndIdxOfTxPduInfo: resulting-properties={base-type=uint8, sw-calibration-access=READ-ONLY, compu-method=SecOC_SecuredPduDataContainerTruncatedAuthenticatorEndIdxOfTxPduInfoType, range raw 0..255}
                SecuredPduDataContainerTruncatedAuthenticatorLengthOfTxPduInfo: resulting-properties={base-type=uint8, sw-calibration-access=READ-ONLY, range raw 0..255}
                SecuredPduDataContainerTruncatedAuthenticatorStartIdxOfTxPduInfo: resulting-properties={base-type=uint8, sw-calibration-access=READ-ONLY, compu-method=SecOC_SecuredPduDataContainerTruncatedAuthenticatorStartIdxOfTxPduInfoType, range raw 0..255}
                TruncAuthStartBitInByteOfTxPduInfo: resulting-properties={base-type=uint8, sw-calibration-access=READ-ONLY, range raw 0..255}
                TruncFreshnessValueFirstByteShiftOfTxPduInfo: resulting-properties={base-type=uint8, sw-calibration-access=READ-ONLY, range raw 0..255}
                TruncFreshnessValueSecondByteShiftOfTxPduInfo: resulting-properties={base-type=uint8, sw-calibration-access=READ-ONLY, range raw 0..255}
                truncatedAuthenticationLengthOfTxPduInfo: resulting-properties={base-type=uint8, sw-calibration-access=READ-ONLY, range raw 0..255}
                truncatedFreshnessValueLengthOfTxPduInfo: resulting-properties={base-type=uint8, sw-calibration-access=READ-ONLY, range raw 0..255}
            Element_2: symbol=[2]
              44 x mc data instance, all with category=VALUE:
                AuthenticPduDataContainerAuthenticPduEndIdxOfTxPduInfo: resulting-properties={base-type=uint16, sw-calibration-access=READ-ONLY, compu {65535=SECOC_NO_AUTHENTICPDUDATACONTAINERAUTHENTICPDUENDIDXOFTXPDUINFO}, range raw 0..65535}
                AuthenticPduDataContainerAuthenticPduStartIdxOfTxPduInfo: resulting-properties={base-type=uint16, sw-calibration-access=READ-ONLY, compu-method=SecOC_AuthenticPduDataContainerAuthenticPduStartIdxOfTxPduInfoType, range raw 0..65535}
                AuthenticPduDataContainerDataToAuthenticateEndIdxOfTxPduInfo: resulting-properties={base-type=uint16, sw-calibration-access=READ-ONLY, range raw 0..65535}
                AuthenticPduDataContainerDataToAuthenticateStartIdxOfTxPduInfo: resulting-properties={base-type=uint16, sw-calibration-access=READ-ONLY, range raw 0..65535}
                AuthenticPduDataContainerFreshnessVerifyValueEndIdxOfTxPduInfo: resulting-properties={base-type=uint16, sw-calibration-access=READ-ONLY, compu-method=SecOC_AuthenticPduDataContainerFreshnessVerifyValueEndIdxOfTxPduInfoType, range raw 0..65535}
                AuthenticPduDataContainerFreshnessVerifyValueStartIdxOfTxPduInfo: resulting-properties={base-type=uint16, sw-calibration-access=READ-ONLY, compu-method=SecOC_AuthenticPduDataContainerFreshnessVerifyValueStartIdxOfTxPduInfoType, range raw 0..65535}
                AuthenticPduDataContainerFullAuthenticPduEndIdxOfTxPduInfo: resulting-properties={base-type=uint16, sw-calibration-access=READ-ONLY, compu-method=SecOC_AuthenticPduDataContainerFullAuthenticPduEndIdxOfTxPduInfoType, range raw 0..65535}
                AuthenticPduDataContainerFullAuthenticPduStartIdxOfTxPduInfo: resulting-properties={base-type=uint16, sw-calibration-access=READ-ONLY, compu-method=SecOC_AuthenticPduDataContainerFullAuthenticPduStartIdxOfTxPduInfoType, range raw 0..65535}
                AuthenticationLayerIdOfTxPduInfo: resulting-properties={base-type=uint16, sw-calibration-access=READ-ONLY, range raw 0..65535}
                ConfirmationNeededOfTxPduInfo: resulting-properties={base-type=boolean, sw-calibration-access=READ-ONLY, compu {0=FALSE, 1..255=TRUE}, range raw 0..1}
                AuthenticExternalIdOfTxPduInfo: resulting-properties={base-type=uint8, sw-calibration-access=READ-ONLY, compu {255=SECOC_NO_AUTHENTICEXTERNALIDOFTXPDUINFO}, range raw 0..255}
                AuthenticPduDataContainerAuthenticPduLengthOfTxPduInfo: resulting-properties={base-type=uint8, sw-calibration-access=READ-ONLY, range raw 0..255}
                AuthenticPduDataContainerDataToAuthenticateLengthOfTxPduInfo: resulting-properties={base-type=uint8, sw-calibration-access=READ-ONLY, range raw 0..255}
                AuthenticPduDataContainerFreshnessVerifyValueLengthOfTxPduInfo: resulting-properties={base-type=uint8, sw-calibration-access=READ-ONLY, range raw 0..255}
                AuthenticPduDataContainerFullAuthenticPduLengthOfTxPduInfo: resulting-properties={base-type=uint8, sw-calibration-access=READ-ONLY, range raw 0..255}
                AuthenticatorCacheEndIdxOfTxPduInfo: resulting-properties={base-type=uint8, sw-calibration-access=READ-ONLY, range raw 0..255}
                AuthenticatorCacheLengthOfTxPduInfo: resulting-properties={base-type=uint8, sw-calibration-access=READ-ONLY, range raw 0..255}
                AuthenticatorCacheStartIdxOfTxPduInfo: resulting-properties={base-type=uint8, sw-calibration-access=READ-ONLY, range raw 0..255}
                BuildAttemptsOfTxPduInfo: resulting-properties={base-type=uint8, sw-calibration-access=READ-ONLY, range raw 0..255}
                DataIdFirstByteOfTxPduInfo: resulting-properties={base-type=uint8, sw-calibration-access=READ-ONLY, range raw 0..255}
                DataIdSecondByteOfTxPduInfo: resulting-properties={base-type=uint8, sw-calibration-access=READ-ONLY, range raw 0..255}
                ExternalFreshnessIdOfTxPduInfo: resulting-properties={base-type=uint8, sw-calibration-access=READ-ONLY, range raw 0..255}
                LowerLayerPduTypeOfTxPduInfo: resulting-properties={base-type=uint8, sw-calibration-access=READ-ONLY, compu {0=SECOC_IFPDU_LOWERLAYERPDUTYPEOFTXPDUINFO}, range raw 0..255}
                PduProcessingOfTxPduInfo: resulting-properties={base-type=uint8, sw-calibration-access=READ-ONLY, compu {1=SECOC_DEFERRED_PDUPROCESSINGOFTXPDUINFO}, range raw 0..255}
                PduTypeOfTxPduInfo: resulting-properties={base-type=uint8, sw-calibration-access=READ-ONLY, compu {0=SECOC_IFPDU_PDUTYPEOFTXPDUINFO}, range raw 0..255}
                ProvideTruncTxFreshnessOfTxPduInfo: resulting-properties={base-type=uint8, sw-calibration-access=READ-ONLY, compu {1=SECOC_DONT_PROVIDE_PROVIDETRUNCTXFRESHNESSOFTXPDUINFO}, range raw 0..255}
                SecuredExternalIdOfTxPduInfo: resulting-properties={base-type=uint8, sw-calibration-access=READ-ONLY, compu {255=SECOC_NO_SECUREDEXTERNALIDOFTXPDUINFO}, range raw 0..255}
                SecuredPduDataContainerAuthInfoDataEndIdxOfTxPduInfo: resulting-properties={base-type=uint8, sw-calibration-access=READ-ONLY, compu {255=SECOC_NO_SECUREDPDUDATACONTAINERAUTHINFODATAENDIDXOFTXPDUINFO}, range raw 0..255}
                SecuredPduDataContainerAuthInfoDataLengthOfTxPduInfo: resulting-properties={base-type=uint8, sw-calibration-access=READ-ONLY, range raw 0..255}
                SecuredPduDataContainerAuthInfoDataStartIdxOfTxPduInfo: resulting-properties={base-type=uint8, sw-calibration-access=READ-ONLY, compu {255=SECOC_NO_SECUREDPDUDATACONTAINERAUTHINFODATASTARTIDXOFTXPDUINFO}, range raw 0..255}
                SecuredPduDataContainerAuthenticPduEndIdxOfTxPduInfo: resulting-properties={base-type=uint8, sw-calibration-access=READ-ONLY, compu {255=SECOC_NO_SECUREDPDUDATACONTAINERAUTHENTICPDUENDIDXOFTXPDUINFO}, range raw 0..255}
                SecuredPduDataContainerAuthenticPduLengthOfTxPduInfo: resulting-properties={base-type=uint8, sw-calibration-access=READ-ONLY, range raw 0..255}
                SecuredPduDataContainerAuthenticPduStartIdxOfTxPduInfo: resulting-properties={base-type=uint8, sw-calibration-access=READ-ONLY, compu {255=SECOC_NO_SECUREDPDUDATACONTAINERAUTHENTICPDUSTARTIDXOFTXPDUINFO}, range raw 0..255}
                SecuredPduDataContainerSecuredPduEndIdxOfTxPduInfo: resulting-properties={base-type=uint8, sw-calibration-access=READ-ONLY, compu {255=SECOC_NO_SECUREDPDUDATACONTAINERSECUREDPDUENDIDXOFTXPDUINFO}, range raw 0..255}
                SecuredPduDataContainerSecuredPduLengthOfTxPduInfo: resulting-properties={base-type=uint8, sw-calibration-access=READ-ONLY, range raw 0..255}
                SecuredPduDataContainerSecuredPduStartIdxOfTxPduInfo: resulting-properties={base-type=uint8, sw-calibration-access=READ-ONLY, compu {255=SECOC_NO_SECUREDPDUDATACONTAINERSECUREDPDUSTARTIDXOFTXPDUINFO}, range raw 0..255}
                SecuredPduDataContainerTruncatedAuthenticatorEndIdxOfTxPduInfo: resulting-properties={base-type=uint8, sw-calibration-access=READ-ONLY, compu-method=SecOC_SecuredPduDataContainerTruncatedAuthenticatorEndIdxOfTxPduInfoType, range raw 0..255}
                SecuredPduDataContainerTruncatedAuthenticatorLengthOfTxPduInfo: resulting-properties={base-type=uint8, sw-calibration-access=READ-ONLY, range raw 0..255}
                SecuredPduDataContainerTruncatedAuthenticatorStartIdxOfTxPduInfo: resulting-properties={base-type=uint8, sw-calibration-access=READ-ONLY, compu-method=SecOC_SecuredPduDataContainerTruncatedAuthenticatorStartIdxOfTxPduInfoType, range raw 0..255}
                TruncAuthStartBitInByteOfTxPduInfo: resulting-properties={base-type=uint8, sw-calibration-access=READ-ONLY, range raw 0..255}
                TruncFreshnessValueFirstByteShiftOfTxPduInfo: resulting-properties={base-type=uint8, sw-calibration-access=READ-ONLY, range raw 0..255}
                TruncFreshnessValueSecondByteShiftOfTxPduInfo: resulting-properties={base-type=uint8, sw-calibration-access=READ-ONLY, range raw 0..255}
                truncatedAuthenticationLengthOfTxPduInfo: resulting-properties={base-type=uint8, sw-calibration-access=READ-ONLY, range raw 0..255}
                truncatedFreshnessValueLengthOfTxPduInfo: resulting-properties={base-type=uint8, sw-calibration-access=READ-ONLY, range raw 0..255}
            Element_3: symbol=[3]
              44 x mc data instance, all with category=VALUE:
                AuthenticPduDataContainerAuthenticPduEndIdxOfTxPduInfo: resulting-properties={base-type=uint16, sw-calibration-access=READ-ONLY, compu {65535=SECOC_NO_AUTHENTICPDUDATACONTAINERAUTHENTICPDUENDIDXOFTXPDUINFO}, range raw 0..65535}
                AuthenticPduDataContainerAuthenticPduStartIdxOfTxPduInfo: resulting-properties={base-type=uint16, sw-calibration-access=READ-ONLY, compu-method=SecOC_AuthenticPduDataContainerAuthenticPduStartIdxOfTxPduInfoType, range raw 0..65535}
                AuthenticPduDataContainerDataToAuthenticateEndIdxOfTxPduInfo: resulting-properties={base-type=uint16, sw-calibration-access=READ-ONLY, range raw 0..65535}
                AuthenticPduDataContainerDataToAuthenticateStartIdxOfTxPduInfo: resulting-properties={base-type=uint16, sw-calibration-access=READ-ONLY, range raw 0..65535}
                AuthenticPduDataContainerFreshnessVerifyValueEndIdxOfTxPduInfo: resulting-properties={base-type=uint16, sw-calibration-access=READ-ONLY, compu-method=SecOC_AuthenticPduDataContainerFreshnessVerifyValueEndIdxOfTxPduInfoType, range raw 0..65535}
                AuthenticPduDataContainerFreshnessVerifyValueStartIdxOfTxPduInfo: resulting-properties={base-type=uint16, sw-calibration-access=READ-ONLY, compu-method=SecOC_AuthenticPduDataContainerFreshnessVerifyValueStartIdxOfTxPduInfoType, range raw 0..65535}
                AuthenticPduDataContainerFullAuthenticPduEndIdxOfTxPduInfo: resulting-properties={base-type=uint16, sw-calibration-access=READ-ONLY, compu-method=SecOC_AuthenticPduDataContainerFullAuthenticPduEndIdxOfTxPduInfoType, range raw 0..65535}
                AuthenticPduDataContainerFullAuthenticPduStartIdxOfTxPduInfo: resulting-properties={base-type=uint16, sw-calibration-access=READ-ONLY, compu-method=SecOC_AuthenticPduDataContainerFullAuthenticPduStartIdxOfTxPduInfoType, range raw 0..65535}
                AuthenticationLayerIdOfTxPduInfo: resulting-properties={base-type=uint16, sw-calibration-access=READ-ONLY, range raw 0..65535}
                ConfirmationNeededOfTxPduInfo: resulting-properties={base-type=boolean, sw-calibration-access=READ-ONLY, compu {0=FALSE, 1..255=TRUE}, range raw 0..1}
                AuthenticExternalIdOfTxPduInfo: resulting-properties={base-type=uint8, sw-calibration-access=READ-ONLY, compu {255=SECOC_NO_AUTHENTICEXTERNALIDOFTXPDUINFO}, range raw 0..255}
                AuthenticPduDataContainerAuthenticPduLengthOfTxPduInfo: resulting-properties={base-type=uint8, sw-calibration-access=READ-ONLY, range raw 0..255}
                AuthenticPduDataContainerDataToAuthenticateLengthOfTxPduInfo: resulting-properties={base-type=uint8, sw-calibration-access=READ-ONLY, range raw 0..255}
                AuthenticPduDataContainerFreshnessVerifyValueLengthOfTxPduInfo: resulting-properties={base-type=uint8, sw-calibration-access=READ-ONLY, range raw 0..255}
                AuthenticPduDataContainerFullAuthenticPduLengthOfTxPduInfo: resulting-properties={base-type=uint8, sw-calibration-access=READ-ONLY, range raw 0..255}
                AuthenticatorCacheEndIdxOfTxPduInfo: resulting-properties={base-type=uint8, sw-calibration-access=READ-ONLY, range raw 0..255}
                AuthenticatorCacheLengthOfTxPduInfo: resulting-properties={base-type=uint8, sw-calibration-access=READ-ONLY, range raw 0..255}
                AuthenticatorCacheStartIdxOfTxPduInfo: resulting-properties={base-type=uint8, sw-calibration-access=READ-ONLY, range raw 0..255}
                BuildAttemptsOfTxPduInfo: resulting-properties={base-type=uint8, sw-calibration-access=READ-ONLY, range raw 0..255}
                DataIdFirstByteOfTxPduInfo: resulting-properties={base-type=uint8, sw-calibration-access=READ-ONLY, range raw 0..255}
                DataIdSecondByteOfTxPduInfo: resulting-properties={base-type=uint8, sw-calibration-access=READ-ONLY, range raw 0..255}
                ExternalFreshnessIdOfTxPduInfo: resulting-properties={base-type=uint8, sw-calibration-access=READ-ONLY, range raw 0..255}
                LowerLayerPduTypeOfTxPduInfo: resulting-properties={base-type=uint8, sw-calibration-access=READ-ONLY, compu {0=SECOC_IFPDU_LOWERLAYERPDUTYPEOFTXPDUINFO}, range raw 0..255}
                PduProcessingOfTxPduInfo: resulting-properties={base-type=uint8, sw-calibration-access=READ-ONLY, compu {1=SECOC_DEFERRED_PDUPROCESSINGOFTXPDUINFO}, range raw 0..255}
                PduTypeOfTxPduInfo: resulting-properties={base-type=uint8, sw-calibration-access=READ-ONLY, compu {0=SECOC_IFPDU_PDUTYPEOFTXPDUINFO}, range raw 0..255}
                ProvideTruncTxFreshnessOfTxPduInfo: resulting-properties={base-type=uint8, sw-calibration-access=READ-ONLY, compu {1=SECOC_DONT_PROVIDE_PROVIDETRUNCTXFRESHNESSOFTXPDUINFO}, range raw 0..255}
                SecuredExternalIdOfTxPduInfo: resulting-properties={base-type=uint8, sw-calibration-access=READ-ONLY, compu {255=SECOC_NO_SECUREDEXTERNALIDOFTXPDUINFO}, range raw 0..255}
                SecuredPduDataContainerAuthInfoDataEndIdxOfTxPduInfo: resulting-properties={base-type=uint8, sw-calibration-access=READ-ONLY, compu {255=SECOC_NO_SECUREDPDUDATACONTAINERAUTHINFODATAENDIDXOFTXPDUINFO}, range raw 0..255}
                SecuredPduDataContainerAuthInfoDataLengthOfTxPduInfo: resulting-properties={base-type=uint8, sw-calibration-access=READ-ONLY, range raw 0..255}
                SecuredPduDataContainerAuthInfoDataStartIdxOfTxPduInfo: resulting-properties={base-type=uint8, sw-calibration-access=READ-ONLY, compu {255=SECOC_NO_SECUREDPDUDATACONTAINERAUTHINFODATASTARTIDXOFTXPDUINFO}, range raw 0..255}
                SecuredPduDataContainerAuthenticPduEndIdxOfTxPduInfo: resulting-properties={base-type=uint8, sw-calibration-access=READ-ONLY, compu {255=SECOC_NO_SECUREDPDUDATACONTAINERAUTHENTICPDUENDIDXOFTXPDUINFO}, range raw 0..255}
                SecuredPduDataContainerAuthenticPduLengthOfTxPduInfo: resulting-properties={base-type=uint8, sw-calibration-access=READ-ONLY, range raw 0..255}
                SecuredPduDataContainerAuthenticPduStartIdxOfTxPduInfo: resulting-properties={base-type=uint8, sw-calibration-access=READ-ONLY, compu {255=SECOC_NO_SECUREDPDUDATACONTAINERAUTHENTICPDUSTARTIDXOFTXPDUINFO}, range raw 0..255}
                SecuredPduDataContainerSecuredPduEndIdxOfTxPduInfo: resulting-properties={base-type=uint8, sw-calibration-access=READ-ONLY, compu {255=SECOC_NO_SECUREDPDUDATACONTAINERSECUREDPDUENDIDXOFTXPDUINFO}, range raw 0..255}
                SecuredPduDataContainerSecuredPduLengthOfTxPduInfo: resulting-properties={base-type=uint8, sw-calibration-access=READ-ONLY, range raw 0..255}
                SecuredPduDataContainerSecuredPduStartIdxOfTxPduInfo: resulting-properties={base-type=uint8, sw-calibration-access=READ-ONLY, compu {255=SECOC_NO_SECUREDPDUDATACONTAINERSECUREDPDUSTARTIDXOFTXPDUINFO}, range raw 0..255}
                SecuredPduDataContainerTruncatedAuthenticatorEndIdxOfTxPduInfo: resulting-properties={base-type=uint8, sw-calibration-access=READ-ONLY, compu-method=SecOC_SecuredPduDataContainerTruncatedAuthenticatorEndIdxOfTxPduInfoType, range raw 0..255}
                SecuredPduDataContainerTruncatedAuthenticatorLengthOfTxPduInfo: resulting-properties={base-type=uint8, sw-calibration-access=READ-ONLY, range raw 0..255}
                SecuredPduDataContainerTruncatedAuthenticatorStartIdxOfTxPduInfo: resulting-properties={base-type=uint8, sw-calibration-access=READ-ONLY, compu-method=SecOC_SecuredPduDataContainerTruncatedAuthenticatorStartIdxOfTxPduInfoType, range raw 0..255}
                TruncAuthStartBitInByteOfTxPduInfo: resulting-properties={base-type=uint8, sw-calibration-access=READ-ONLY, range raw 0..255}
                TruncFreshnessValueFirstByteShiftOfTxPduInfo: resulting-properties={base-type=uint8, sw-calibration-access=READ-ONLY, range raw 0..255}
                TruncFreshnessValueSecondByteShiftOfTxPduInfo: resulting-properties={base-type=uint8, sw-calibration-access=READ-ONLY, range raw 0..255}
                truncatedAuthenticationLengthOfTxPduInfo: resulting-properties={base-type=uint8, sw-calibration-access=READ-ONLY, range raw 0..255}
                truncatedFreshnessValueLengthOfTxPduInfo: resulting-properties={base-type=uint8, sw-calibration-access=READ-ONLY, range raw 0..255}
            Element_4: symbol=[4]
              44 x mc data instance, all with category=VALUE:
                AuthenticPduDataContainerAuthenticPduEndIdxOfTxPduInfo: resulting-properties={base-type=uint16, sw-calibration-access=READ-ONLY, compu {65535=SECOC_NO_AUTHENTICPDUDATACONTAINERAUTHENTICPDUENDIDXOFTXPDUINFO}, range raw 0..65535}
                AuthenticPduDataContainerAuthenticPduStartIdxOfTxPduInfo: resulting-properties={base-type=uint16, sw-calibration-access=READ-ONLY, compu-method=SecOC_AuthenticPduDataContainerAuthenticPduStartIdxOfTxPduInfoType, range raw 0..65535}
                AuthenticPduDataContainerDataToAuthenticateEndIdxOfTxPduInfo: resulting-properties={base-type=uint16, sw-calibration-access=READ-ONLY, range raw 0..65535}
                AuthenticPduDataContainerDataToAuthenticateStartIdxOfTxPduInfo: resulting-properties={base-type=uint16, sw-calibration-access=READ-ONLY, range raw 0..65535}
                AuthenticPduDataContainerFreshnessVerifyValueEndIdxOfTxPduInfo: resulting-properties={base-type=uint16, sw-calibration-access=READ-ONLY, compu-method=SecOC_AuthenticPduDataContainerFreshnessVerifyValueEndIdxOfTxPduInfoType, range raw 0..65535}
                AuthenticPduDataContainerFreshnessVerifyValueStartIdxOfTxPduInfo: resulting-properties={base-type=uint16, sw-calibration-access=READ-ONLY, compu-method=SecOC_AuthenticPduDataContainerFreshnessVerifyValueStartIdxOfTxPduInfoType, range raw 0..65535}
                AuthenticPduDataContainerFullAuthenticPduEndIdxOfTxPduInfo: resulting-properties={base-type=uint16, sw-calibration-access=READ-ONLY, compu-method=SecOC_AuthenticPduDataContainerFullAuthenticPduEndIdxOfTxPduInfoType, range raw 0..65535}
                AuthenticPduDataContainerFullAuthenticPduStartIdxOfTxPduInfo: resulting-properties={base-type=uint16, sw-calibration-access=READ-ONLY, compu-method=SecOC_AuthenticPduDataContainerFullAuthenticPduStartIdxOfTxPduInfoType, range raw 0..65535}
                AuthenticationLayerIdOfTxPduInfo: resulting-properties={base-type=uint16, sw-calibration-access=READ-ONLY, range raw 0..65535}
                ConfirmationNeededOfTxPduInfo: resulting-properties={base-type=boolean, sw-calibration-access=READ-ONLY, compu {0=FALSE, 1..255=TRUE}, range raw 0..1}
                AuthenticExternalIdOfTxPduInfo: resulting-properties={base-type=uint8, sw-calibration-access=READ-ONLY, compu {255=SECOC_NO_AUTHENTICEXTERNALIDOFTXPDUINFO}, range raw 0..255}
                AuthenticPduDataContainerAuthenticPduLengthOfTxPduInfo: resulting-properties={base-type=uint8, sw-calibration-access=READ-ONLY, range raw 0..255}
                AuthenticPduDataContainerDataToAuthenticateLengthOfTxPduInfo: resulting-properties={base-type=uint8, sw-calibration-access=READ-ONLY, range raw 0..255}
                AuthenticPduDataContainerFreshnessVerifyValueLengthOfTxPduInfo: resulting-properties={base-type=uint8, sw-calibration-access=READ-ONLY, range raw 0..255}
                AuthenticPduDataContainerFullAuthenticPduLengthOfTxPduInfo: resulting-properties={base-type=uint8, sw-calibration-access=READ-ONLY, range raw 0..255}
                AuthenticatorCacheEndIdxOfTxPduInfo: resulting-properties={base-type=uint8, sw-calibration-access=READ-ONLY, range raw 0..255}
                AuthenticatorCacheLengthOfTxPduInfo: resulting-properties={base-type=uint8, sw-calibration-access=READ-ONLY, range raw 0..255}
                AuthenticatorCacheStartIdxOfTxPduInfo: resulting-properties={base-type=uint8, sw-calibration-access=READ-ONLY, range raw 0..255}
                BuildAttemptsOfTxPduInfo: resulting-properties={base-type=uint8, sw-calibration-access=READ-ONLY, range raw 0..255}
                DataIdFirstByteOfTxPduInfo: resulting-properties={base-type=uint8, sw-calibration-access=READ-ONLY, range raw 0..255}
                DataIdSecondByteOfTxPduInfo: resulting-properties={base-type=uint8, sw-calibration-access=READ-ONLY, range raw 0..255}
                ExternalFreshnessIdOfTxPduInfo: resulting-properties={base-type=uint8, sw-calibration-access=READ-ONLY, range raw 0..255}
                LowerLayerPduTypeOfTxPduInfo: resulting-properties={base-type=uint8, sw-calibration-access=READ-ONLY, compu {0=SECOC_IFPDU_LOWERLAYERPDUTYPEOFTXPDUINFO}, range raw 0..255}
                PduProcessingOfTxPduInfo: resulting-properties={base-type=uint8, sw-calibration-access=READ-ONLY, compu {1=SECOC_DEFERRED_PDUPROCESSINGOFTXPDUINFO}, range raw 0..255}
                PduTypeOfTxPduInfo: resulting-properties={base-type=uint8, sw-calibration-access=READ-ONLY, compu {0=SECOC_IFPDU_PDUTYPEOFTXPDUINFO}, range raw 0..255}
                ProvideTruncTxFreshnessOfTxPduInfo: resulting-properties={base-type=uint8, sw-calibration-access=READ-ONLY, compu {1=SECOC_DONT_PROVIDE_PROVIDETRUNCTXFRESHNESSOFTXPDUINFO}, range raw 0..255}
                SecuredExternalIdOfTxPduInfo: resulting-properties={base-type=uint8, sw-calibration-access=READ-ONLY, compu {255=SECOC_NO_SECUREDEXTERNALIDOFTXPDUINFO}, range raw 0..255}
                SecuredPduDataContainerAuthInfoDataEndIdxOfTxPduInfo: resulting-properties={base-type=uint8, sw-calibration-access=READ-ONLY, compu {255=SECOC_NO_SECUREDPDUDATACONTAINERAUTHINFODATAENDIDXOFTXPDUINFO}, range raw 0..255}
                SecuredPduDataContainerAuthInfoDataLengthOfTxPduInfo: resulting-properties={base-type=uint8, sw-calibration-access=READ-ONLY, range raw 0..255}
                SecuredPduDataContainerAuthInfoDataStartIdxOfTxPduInfo: resulting-properties={base-type=uint8, sw-calibration-access=READ-ONLY, compu {255=SECOC_NO_SECUREDPDUDATACONTAINERAUTHINFODATASTARTIDXOFTXPDUINFO}, range raw 0..255}
                SecuredPduDataContainerAuthenticPduEndIdxOfTxPduInfo: resulting-properties={base-type=uint8, sw-calibration-access=READ-ONLY, compu {255=SECOC_NO_SECUREDPDUDATACONTAINERAUTHENTICPDUENDIDXOFTXPDUINFO}, range raw 0..255}
                SecuredPduDataContainerAuthenticPduLengthOfTxPduInfo: resulting-properties={base-type=uint8, sw-calibration-access=READ-ONLY, range raw 0..255}
                SecuredPduDataContainerAuthenticPduStartIdxOfTxPduInfo: resulting-properties={base-type=uint8, sw-calibration-access=READ-ONLY, compu {255=SECOC_NO_SECUREDPDUDATACONTAINERAUTHENTICPDUSTARTIDXOFTXPDUINFO}, range raw 0..255}
                SecuredPduDataContainerSecuredPduEndIdxOfTxPduInfo: resulting-properties={base-type=uint8, sw-calibration-access=READ-ONLY, compu {255=SECOC_NO_SECUREDPDUDATACONTAINERSECUREDPDUENDIDXOFTXPDUINFO}, range raw 0..255}
                SecuredPduDataContainerSecuredPduLengthOfTxPduInfo: resulting-properties={base-type=uint8, sw-calibration-access=READ-ONLY, range raw 0..255}
                SecuredPduDataContainerSecuredPduStartIdxOfTxPduInfo: resulting-properties={base-type=uint8, sw-calibration-access=READ-ONLY, compu {255=SECOC_NO_SECUREDPDUDATACONTAINERSECUREDPDUSTARTIDXOFTXPDUINFO}, range raw 0..255}
                SecuredPduDataContainerTruncatedAuthenticatorEndIdxOfTxPduInfo: resulting-properties={base-type=uint8, sw-calibration-access=READ-ONLY, compu-method=SecOC_SecuredPduDataContainerTruncatedAuthenticatorEndIdxOfTxPduInfoType, range raw 0..255}
                SecuredPduDataContainerTruncatedAuthenticatorLengthOfTxPduInfo: resulting-properties={base-type=uint8, sw-calibration-access=READ-ONLY, range raw 0..255}
                SecuredPduDataContainerTruncatedAuthenticatorStartIdxOfTxPduInfo: resulting-properties={base-type=uint8, sw-calibration-access=READ-ONLY, compu-method=SecOC_SecuredPduDataContainerTruncatedAuthenticatorStartIdxOfTxPduInfoType, range raw 0..255}
                TruncAuthStartBitInByteOfTxPduInfo: resulting-properties={base-type=uint8, sw-calibration-access=READ-ONLY, range raw 0..255}
                TruncFreshnessValueFirstByteShiftOfTxPduInfo: resulting-properties={base-type=uint8, sw-calibration-access=READ-ONLY, range raw 0..255}
                TruncFreshnessValueSecondByteShiftOfTxPduInfo: resulting-properties={base-type=uint8, sw-calibration-access=READ-ONLY, range raw 0..255}
                truncatedAuthenticationLengthOfTxPduInfo: resulting-properties={base-type=uint8, sw-calibration-access=READ-ONLY, range raw 0..255}
                truncatedFreshnessValueLengthOfTxPduInfo: resulting-properties={base-type=uint8, sw-calibration-access=READ-ONLY, range raw 0..255}
            Element_5: symbol=[5]
              44 x mc data instance, all with category=VALUE:
                AuthenticPduDataContainerAuthenticPduEndIdxOfTxPduInfo: resulting-properties={base-type=uint16, sw-calibration-access=READ-ONLY, compu {65535=SECOC_NO_AUTHENTICPDUDATACONTAINERAUTHENTICPDUENDIDXOFTXPDUINFO}, range raw 0..65535}
                AuthenticPduDataContainerAuthenticPduStartIdxOfTxPduInfo: resulting-properties={base-type=uint16, sw-calibration-access=READ-ONLY, compu-method=SecOC_AuthenticPduDataContainerAuthenticPduStartIdxOfTxPduInfoType, range raw 0..65535}
                AuthenticPduDataContainerDataToAuthenticateEndIdxOfTxPduInfo: resulting-properties={base-type=uint16, sw-calibration-access=READ-ONLY, range raw 0..65535}
                AuthenticPduDataContainerDataToAuthenticateStartIdxOfTxPduInfo: resulting-properties={base-type=uint16, sw-calibration-access=READ-ONLY, range raw 0..65535}
                AuthenticPduDataContainerFreshnessVerifyValueEndIdxOfTxPduInfo: resulting-properties={base-type=uint16, sw-calibration-access=READ-ONLY, compu-method=SecOC_AuthenticPduDataContainerFreshnessVerifyValueEndIdxOfTxPduInfoType, range raw 0..65535}
                AuthenticPduDataContainerFreshnessVerifyValueStartIdxOfTxPduInfo: resulting-properties={base-type=uint16, sw-calibration-access=READ-ONLY, compu-method=SecOC_AuthenticPduDataContainerFreshnessVerifyValueStartIdxOfTxPduInfoType, range raw 0..65535}
                AuthenticPduDataContainerFullAuthenticPduEndIdxOfTxPduInfo: resulting-properties={base-type=uint16, sw-calibration-access=READ-ONLY, compu-method=SecOC_AuthenticPduDataContainerFullAuthenticPduEndIdxOfTxPduInfoType, range raw 0..65535}
                AuthenticPduDataContainerFullAuthenticPduStartIdxOfTxPduInfo: resulting-properties={base-type=uint16, sw-calibration-access=READ-ONLY, compu-method=SecOC_AuthenticPduDataContainerFullAuthenticPduStartIdxOfTxPduInfoType, range raw 0..65535}
                AuthenticationLayerIdOfTxPduInfo: resulting-properties={base-type=uint16, sw-calibration-access=READ-ONLY, range raw 0..65535}
                ConfirmationNeededOfTxPduInfo: resulting-properties={base-type=boolean, sw-calibration-access=READ-ONLY, compu {0=FALSE, 1..255=TRUE}, range raw 0..1}
                AuthenticExternalIdOfTxPduInfo: resulting-properties={base-type=uint8, sw-calibration-access=READ-ONLY, compu {255=SECOC_NO_AUTHENTICEXTERNALIDOFTXPDUINFO}, range raw 0..255}
                AuthenticPduDataContainerAuthenticPduLengthOfTxPduInfo: resulting-properties={base-type=uint8, sw-calibration-access=READ-ONLY, range raw 0..255}
                AuthenticPduDataContainerDataToAuthenticateLengthOfTxPduInfo: resulting-properties={base-type=uint8, sw-calibration-access=READ-ONLY, range raw 0..255}
                AuthenticPduDataContainerFreshnessVerifyValueLengthOfTxPduInfo: resulting-properties={base-type=uint8, sw-calibration-access=READ-ONLY, range raw 0..255}
                AuthenticPduDataContainerFullAuthenticPduLengthOfTxPduInfo: resulting-properties={base-type=uint8, sw-calibration-access=READ-ONLY, range raw 0..255}
                AuthenticatorCacheEndIdxOfTxPduInfo: resulting-properties={base-type=uint8, sw-calibration-access=READ-ONLY, range raw 0..255}
                AuthenticatorCacheLengthOfTxPduInfo: resulting-properties={base-type=uint8, sw-calibration-access=READ-ONLY, range raw 0..255}
                AuthenticatorCacheStartIdxOfTxPduInfo: resulting-properties={base-type=uint8, sw-calibration-access=READ-ONLY, range raw 0..255}
                BuildAttemptsOfTxPduInfo: resulting-properties={base-type=uint8, sw-calibration-access=READ-ONLY, range raw 0..255}
                DataIdFirstByteOfTxPduInfo: resulting-properties={base-type=uint8, sw-calibration-access=READ-ONLY, range raw 0..255}
                DataIdSecondByteOfTxPduInfo: resulting-properties={base-type=uint8, sw-calibration-access=READ-ONLY, range raw 0..255}
                ExternalFreshnessIdOfTxPduInfo: resulting-properties={base-type=uint8, sw-calibration-access=READ-ONLY, range raw 0..255}
                LowerLayerPduTypeOfTxPduInfo: resulting-properties={base-type=uint8, sw-calibration-access=READ-ONLY, compu {0=SECOC_IFPDU_LOWERLAYERPDUTYPEOFTXPDUINFO}, range raw 0..255}
                PduProcessingOfTxPduInfo: resulting-properties={base-type=uint8, sw-calibration-access=READ-ONLY, compu {1=SECOC_DEFERRED_PDUPROCESSINGOFTXPDUINFO}, range raw 0..255}
                PduTypeOfTxPduInfo: resulting-properties={base-type=uint8, sw-calibration-access=READ-ONLY, compu {0=SECOC_IFPDU_PDUTYPEOFTXPDUINFO}, range raw 0..255}
                ProvideTruncTxFreshnessOfTxPduInfo: resulting-properties={base-type=uint8, sw-calibration-access=READ-ONLY, compu {1=SECOC_DONT_PROVIDE_PROVIDETRUNCTXFRESHNESSOFTXPDUINFO}, range raw 0..255}
                SecuredExternalIdOfTxPduInfo: resulting-properties={base-type=uint8, sw-calibration-access=READ-ONLY, compu {255=SECOC_NO_SECUREDEXTERNALIDOFTXPDUINFO}, range raw 0..255}
                SecuredPduDataContainerAuthInfoDataEndIdxOfTxPduInfo: resulting-properties={base-type=uint8, sw-calibration-access=READ-ONLY, compu {255=SECOC_NO_SECUREDPDUDATACONTAINERAUTHINFODATAENDIDXOFTXPDUINFO}, range raw 0..255}
                SecuredPduDataContainerAuthInfoDataLengthOfTxPduInfo: resulting-properties={base-type=uint8, sw-calibration-access=READ-ONLY, range raw 0..255}
                SecuredPduDataContainerAuthInfoDataStartIdxOfTxPduInfo: resulting-properties={base-type=uint8, sw-calibration-access=READ-ONLY, compu {255=SECOC_NO_SECUREDPDUDATACONTAINERAUTHINFODATASTARTIDXOFTXPDUINFO}, range raw 0..255}
                SecuredPduDataContainerAuthenticPduEndIdxOfTxPduInfo: resulting-properties={base-type=uint8, sw-calibration-access=READ-ONLY, compu {255=SECOC_NO_SECUREDPDUDATACONTAINERAUTHENTICPDUENDIDXOFTXPDUINFO}, range raw 0..255}
                SecuredPduDataContainerAuthenticPduLengthOfTxPduInfo: resulting-properties={base-type=uint8, sw-calibration-access=READ-ONLY, range raw 0..255}
                SecuredPduDataContainerAuthenticPduStartIdxOfTxPduInfo: resulting-properties={base-type=uint8, sw-calibration-access=READ-ONLY, compu {255=SECOC_NO_SECUREDPDUDATACONTAINERAUTHENTICPDUSTARTIDXOFTXPDUINFO}, range raw 0..255}
                SecuredPduDataContainerSecuredPduEndIdxOfTxPduInfo: resulting-properties={base-type=uint8, sw-calibration-access=READ-ONLY, compu {255=SECOC_NO_SECUREDPDUDATACONTAINERSECUREDPDUENDIDXOFTXPDUINFO}, range raw 0..255}
                SecuredPduDataContainerSecuredPduLengthOfTxPduInfo: resulting-properties={base-type=uint8, sw-calibration-access=READ-ONLY, range raw 0..255}
                SecuredPduDataContainerSecuredPduStartIdxOfTxPduInfo: resulting-properties={base-type=uint8, sw-calibration-access=READ-ONLY, compu {255=SECOC_NO_SECUREDPDUDATACONTAINERSECUREDPDUSTARTIDXOFTXPDUINFO}, range raw 0..255}
                SecuredPduDataContainerTruncatedAuthenticatorEndIdxOfTxPduInfo: resulting-properties={base-type=uint8, sw-calibration-access=READ-ONLY, compu-method=SecOC_SecuredPduDataContainerTruncatedAuthenticatorEndIdxOfTxPduInfoType, range raw 0..255}
                SecuredPduDataContainerTruncatedAuthenticatorLengthOfTxPduInfo: resulting-properties={base-type=uint8, sw-calibration-access=READ-ONLY, range raw 0..255}
                SecuredPduDataContainerTruncatedAuthenticatorStartIdxOfTxPduInfo: resulting-properties={base-type=uint8, sw-calibration-access=READ-ONLY, compu-method=SecOC_SecuredPduDataContainerTruncatedAuthenticatorStartIdxOfTxPduInfoType, range raw 0..255}
                TruncAuthStartBitInByteOfTxPduInfo: resulting-properties={base-type=uint8, sw-calibration-access=READ-ONLY, range raw 0..255}
                TruncFreshnessValueFirstByteShiftOfTxPduInfo: resulting-properties={base-type=uint8, sw-calibration-access=READ-ONLY, range raw 0..255}
                TruncFreshnessValueSecondByteShiftOfTxPduInfo: resulting-properties={base-type=uint8, sw-calibration-access=READ-ONLY, range raw 0..255}
                truncatedAuthenticationLengthOfTxPduInfo: resulting-properties={base-type=uint8, sw-calibration-access=READ-ONLY, range raw 0..255}
                truncatedFreshnessValueLengthOfTxPduInfo: resulting-properties={base-type=uint8, sw-calibration-access=READ-ONLY, range raw 0..255}
            Element_6: symbol=[6]
              44 x mc data instance, all with category=VALUE:
                AuthenticPduDataContainerAuthenticPduEndIdxOfTxPduInfo: resulting-properties={base-type=uint16, sw-calibration-access=READ-ONLY, compu {65535=SECOC_NO_AUTHENTICPDUDATACONTAINERAUTHENTICPDUENDIDXOFTXPDUINFO}, range raw 0..65535}
                AuthenticPduDataContainerAuthenticPduStartIdxOfTxPduInfo: resulting-properties={base-type=uint16, sw-calibration-access=READ-ONLY, compu-method=SecOC_AuthenticPduDataContainerAuthenticPduStartIdxOfTxPduInfoType, range raw 0..65535}
                AuthenticPduDataContainerDataToAuthenticateEndIdxOfTxPduInfo: resulting-properties={base-type=uint16, sw-calibration-access=READ-ONLY, range raw 0..65535}
                AuthenticPduDataContainerDataToAuthenticateStartIdxOfTxPduInfo: resulting-properties={base-type=uint16, sw-calibration-access=READ-ONLY, range raw 0..65535}
                AuthenticPduDataContainerFreshnessVerifyValueEndIdxOfTxPduInfo: resulting-properties={base-type=uint16, sw-calibration-access=READ-ONLY, compu-method=SecOC_AuthenticPduDataContainerFreshnessVerifyValueEndIdxOfTxPduInfoType, range raw 0..65535}
                AuthenticPduDataContainerFreshnessVerifyValueStartIdxOfTxPduInfo: resulting-properties={base-type=uint16, sw-calibration-access=READ-ONLY, compu-method=SecOC_AuthenticPduDataContainerFreshnessVerifyValueStartIdxOfTxPduInfoType, range raw 0..65535}
                AuthenticPduDataContainerFullAuthenticPduEndIdxOfTxPduInfo: resulting-properties={base-type=uint16, sw-calibration-access=READ-ONLY, compu-method=SecOC_AuthenticPduDataContainerFullAuthenticPduEndIdxOfTxPduInfoType, range raw 0..65535}
                AuthenticPduDataContainerFullAuthenticPduStartIdxOfTxPduInfo: resulting-properties={base-type=uint16, sw-calibration-access=READ-ONLY, compu-method=SecOC_AuthenticPduDataContainerFullAuthenticPduStartIdxOfTxPduInfoType, range raw 0..65535}
                AuthenticationLayerIdOfTxPduInfo: resulting-properties={base-type=uint16, sw-calibration-access=READ-ONLY, range raw 0..65535}
                ConfirmationNeededOfTxPduInfo: resulting-properties={base-type=boolean, sw-calibration-access=READ-ONLY, compu {0=FALSE, 1..255=TRUE}, range raw 0..1}
                AuthenticExternalIdOfTxPduInfo: resulting-properties={base-type=uint8, sw-calibration-access=READ-ONLY, compu {255=SECOC_NO_AUTHENTICEXTERNALIDOFTXPDUINFO}, range raw 0..255}
                AuthenticPduDataContainerAuthenticPduLengthOfTxPduInfo: resulting-properties={base-type=uint8, sw-calibration-access=READ-ONLY, range raw 0..255}
                AuthenticPduDataContainerDataToAuthenticateLengthOfTxPduInfo: resulting-properties={base-type=uint8, sw-calibration-access=READ-ONLY, range raw 0..255}
                AuthenticPduDataContainerFreshnessVerifyValueLengthOfTxPduInfo: resulting-properties={base-type=uint8, sw-calibration-access=READ-ONLY, range raw 0..255}
                AuthenticPduDataContainerFullAuthenticPduLengthOfTxPduInfo: resulting-properties={base-type=uint8, sw-calibration-access=READ-ONLY, range raw 0..255}
                AuthenticatorCacheEndIdxOfTxPduInfo: resulting-properties={base-type=uint8, sw-calibration-access=READ-ONLY, range raw 0..255}
                AuthenticatorCacheLengthOfTxPduInfo: resulting-properties={base-type=uint8, sw-calibration-access=READ-ONLY, range raw 0..255}
                AuthenticatorCacheStartIdxOfTxPduInfo: resulting-properties={base-type=uint8, sw-calibration-access=READ-ONLY, range raw 0..255}
                BuildAttemptsOfTxPduInfo: resulting-properties={base-type=uint8, sw-calibration-access=READ-ONLY, range raw 0..255}
                DataIdFirstByteOfTxPduInfo: resulting-properties={base-type=uint8, sw-calibration-access=READ-ONLY, range raw 0..255}
                DataIdSecondByteOfTxPduInfo: resulting-properties={base-type=uint8, sw-calibration-access=READ-ONLY, range raw 0..255}
                ExternalFreshnessIdOfTxPduInfo: resulting-properties={base-type=uint8, sw-calibration-access=READ-ONLY, range raw 0..255}
                LowerLayerPduTypeOfTxPduInfo: resulting-properties={base-type=uint8, sw-calibration-access=READ-ONLY, compu {0=SECOC_IFPDU_LOWERLAYERPDUTYPEOFTXPDUINFO}, range raw 0..255}
                PduProcessingOfTxPduInfo: resulting-properties={base-type=uint8, sw-calibration-access=READ-ONLY, compu {1=SECOC_DEFERRED_PDUPROCESSINGOFTXPDUINFO}, range raw 0..255}
                PduTypeOfTxPduInfo: resulting-properties={base-type=uint8, sw-calibration-access=READ-ONLY, compu {0=SECOC_IFPDU_PDUTYPEOFTXPDUINFO}, range raw 0..255}
                ProvideTruncTxFreshnessOfTxPduInfo: resulting-properties={base-type=uint8, sw-calibration-access=READ-ONLY, compu {1=SECOC_DONT_PROVIDE_PROVIDETRUNCTXFRESHNESSOFTXPDUINFO}, range raw 0..255}
                SecuredExternalIdOfTxPduInfo: resulting-properties={base-type=uint8, sw-calibration-access=READ-ONLY, compu {255=SECOC_NO_SECUREDEXTERNALIDOFTXPDUINFO}, range raw 0..255}
                SecuredPduDataContainerAuthInfoDataEndIdxOfTxPduInfo: resulting-properties={base-type=uint8, sw-calibration-access=READ-ONLY, compu {255=SECOC_NO_SECUREDPDUDATACONTAINERAUTHINFODATAENDIDXOFTXPDUINFO}, range raw 0..255}
                SecuredPduDataContainerAuthInfoDataLengthOfTxPduInfo: resulting-properties={base-type=uint8, sw-calibration-access=READ-ONLY, range raw 0..255}
                SecuredPduDataContainerAuthInfoDataStartIdxOfTxPduInfo: resulting-properties={base-type=uint8, sw-calibration-access=READ-ONLY, compu {255=SECOC_NO_SECUREDPDUDATACONTAINERAUTHINFODATASTARTIDXOFTXPDUINFO}, range raw 0..255}
                SecuredPduDataContainerAuthenticPduEndIdxOfTxPduInfo: resulting-properties={base-type=uint8, sw-calibration-access=READ-ONLY, compu {255=SECOC_NO_SECUREDPDUDATACONTAINERAUTHENTICPDUENDIDXOFTXPDUINFO}, range raw 0..255}
                SecuredPduDataContainerAuthenticPduLengthOfTxPduInfo: resulting-properties={base-type=uint8, sw-calibration-access=READ-ONLY, range raw 0..255}
                SecuredPduDataContainerAuthenticPduStartIdxOfTxPduInfo: resulting-properties={base-type=uint8, sw-calibration-access=READ-ONLY, compu {255=SECOC_NO_SECUREDPDUDATACONTAINERAUTHENTICPDUSTARTIDXOFTXPDUINFO}, range raw 0..255}
                SecuredPduDataContainerSecuredPduEndIdxOfTxPduInfo: resulting-properties={base-type=uint8, sw-calibration-access=READ-ONLY, compu {255=SECOC_NO_SECUREDPDUDATACONTAINERSECUREDPDUENDIDXOFTXPDUINFO}, range raw 0..255}
                SecuredPduDataContainerSecuredPduLengthOfTxPduInfo: resulting-properties={base-type=uint8, sw-calibration-access=READ-ONLY, range raw 0..255}
                SecuredPduDataContainerSecuredPduStartIdxOfTxPduInfo: resulting-properties={base-type=uint8, sw-calibration-access=READ-ONLY, compu {255=SECOC_NO_SECUREDPDUDATACONTAINERSECUREDPDUSTARTIDXOFTXPDUINFO}, range raw 0..255}
                SecuredPduDataContainerTruncatedAuthenticatorEndIdxOfTxPduInfo: resulting-properties={base-type=uint8, sw-calibration-access=READ-ONLY, compu-method=SecOC_SecuredPduDataContainerTruncatedAuthenticatorEndIdxOfTxPduInfoType, range raw 0..255}
                SecuredPduDataContainerTruncatedAuthenticatorLengthOfTxPduInfo: resulting-properties={base-type=uint8, sw-calibration-access=READ-ONLY, range raw 0..255}
                SecuredPduDataContainerTruncatedAuthenticatorStartIdxOfTxPduInfo: resulting-properties={base-type=uint8, sw-calibration-access=READ-ONLY, compu-method=SecOC_SecuredPduDataContainerTruncatedAuthenticatorStartIdxOfTxPduInfoType, range raw 0..255}
                TruncAuthStartBitInByteOfTxPduInfo: resulting-properties={base-type=uint8, sw-calibration-access=READ-ONLY, range raw 0..255}
                TruncFreshnessValueFirstByteShiftOfTxPduInfo: resulting-properties={base-type=uint8, sw-calibration-access=READ-ONLY, range raw 0..255}
                TruncFreshnessValueSecondByteShiftOfTxPduInfo: resulting-properties={base-type=uint8, sw-calibration-access=READ-ONLY, range raw 0..255}
                truncatedAuthenticationLengthOfTxPduInfo: resulting-properties={base-type=uint8, sw-calibration-access=READ-ONLY, range raw 0..255}
                truncatedFreshnessValueLengthOfTxPduInfo: resulting-properties={base-type=uint8, sw-calibration-access=READ-ONLY, range raw 0..255}
            Element_7: symbol=[7]
              44 x mc data instance, all with category=VALUE:
                AuthenticPduDataContainerAuthenticPduEndIdxOfTxPduInfo: resulting-properties={base-type=uint16, sw-calibration-access=READ-ONLY, compu {65535=SECOC_NO_AUTHENTICPDUDATACONTAINERAUTHENTICPDUENDIDXOFTXPDUINFO}, range raw 0..65535}
                AuthenticPduDataContainerAuthenticPduStartIdxOfTxPduInfo: resulting-properties={base-type=uint16, sw-calibration-access=READ-ONLY, compu-method=SecOC_AuthenticPduDataContainerAuthenticPduStartIdxOfTxPduInfoType, range raw 0..65535}
                AuthenticPduDataContainerDataToAuthenticateEndIdxOfTxPduInfo: resulting-properties={base-type=uint16, sw-calibration-access=READ-ONLY, range raw 0..65535}
                AuthenticPduDataContainerDataToAuthenticateStartIdxOfTxPduInfo: resulting-properties={base-type=uint16, sw-calibration-access=READ-ONLY, range raw 0..65535}
                AuthenticPduDataContainerFreshnessVerifyValueEndIdxOfTxPduInfo: resulting-properties={base-type=uint16, sw-calibration-access=READ-ONLY, compu-method=SecOC_AuthenticPduDataContainerFreshnessVerifyValueEndIdxOfTxPduInfoType, range raw 0..65535}
                AuthenticPduDataContainerFreshnessVerifyValueStartIdxOfTxPduInfo: resulting-properties={base-type=uint16, sw-calibration-access=READ-ONLY, compu-method=SecOC_AuthenticPduDataContainerFreshnessVerifyValueStartIdxOfTxPduInfoType, range raw 0..65535}
                AuthenticPduDataContainerFullAuthenticPduEndIdxOfTxPduInfo: resulting-properties={base-type=uint16, sw-calibration-access=READ-ONLY, compu-method=SecOC_AuthenticPduDataContainerFullAuthenticPduEndIdxOfTxPduInfoType, range raw 0..65535}
                AuthenticPduDataContainerFullAuthenticPduStartIdxOfTxPduInfo: resulting-properties={base-type=uint16, sw-calibration-access=READ-ONLY, compu-method=SecOC_AuthenticPduDataContainerFullAuthenticPduStartIdxOfTxPduInfoType, range raw 0..65535}
                AuthenticationLayerIdOfTxPduInfo: resulting-properties={base-type=uint16, sw-calibration-access=READ-ONLY, range raw 0..65535}
                ConfirmationNeededOfTxPduInfo: resulting-properties={base-type=boolean, sw-calibration-access=READ-ONLY, compu {0=FALSE, 1..255=TRUE}, range raw 0..1}
                AuthenticExternalIdOfTxPduInfo: resulting-properties={base-type=uint8, sw-calibration-access=READ-ONLY, compu {255=SECOC_NO_AUTHENTICEXTERNALIDOFTXPDUINFO}, range raw 0..255}
                AuthenticPduDataContainerAuthenticPduLengthOfTxPduInfo: resulting-properties={base-type=uint8, sw-calibration-access=READ-ONLY, range raw 0..255}
                AuthenticPduDataContainerDataToAuthenticateLengthOfTxPduInfo: resulting-properties={base-type=uint8, sw-calibration-access=READ-ONLY, range raw 0..255}
                AuthenticPduDataContainerFreshnessVerifyValueLengthOfTxPduInfo: resulting-properties={base-type=uint8, sw-calibration-access=READ-ONLY, range raw 0..255}
                AuthenticPduDataContainerFullAuthenticPduLengthOfTxPduInfo: resulting-properties={base-type=uint8, sw-calibration-access=READ-ONLY, range raw 0..255}
                AuthenticatorCacheEndIdxOfTxPduInfo: resulting-properties={base-type=uint8, sw-calibration-access=READ-ONLY, range raw 0..255}
                AuthenticatorCacheLengthOfTxPduInfo: resulting-properties={base-type=uint8, sw-calibration-access=READ-ONLY, range raw 0..255}
                AuthenticatorCacheStartIdxOfTxPduInfo: resulting-properties={base-type=uint8, sw-calibration-access=READ-ONLY, range raw 0..255}
                BuildAttemptsOfTxPduInfo: resulting-properties={base-type=uint8, sw-calibration-access=READ-ONLY, range raw 0..255}
                DataIdFirstByteOfTxPduInfo: resulting-properties={base-type=uint8, sw-calibration-access=READ-ONLY, range raw 0..255}
                DataIdSecondByteOfTxPduInfo: resulting-properties={base-type=uint8, sw-calibration-access=READ-ONLY, range raw 0..255}
                ExternalFreshnessIdOfTxPduInfo: resulting-properties={base-type=uint8, sw-calibration-access=READ-ONLY, range raw 0..255}
                LowerLayerPduTypeOfTxPduInfo: resulting-properties={base-type=uint8, sw-calibration-access=READ-ONLY, compu {0=SECOC_IFPDU_LOWERLAYERPDUTYPEOFTXPDUINFO}, range raw 0..255}
                PduProcessingOfTxPduInfo: resulting-properties={base-type=uint8, sw-calibration-access=READ-ONLY, compu {1=SECOC_DEFERRED_PDUPROCESSINGOFTXPDUINFO}, range raw 0..255}
                PduTypeOfTxPduInfo: resulting-properties={base-type=uint8, sw-calibration-access=READ-ONLY, compu {0=SECOC_IFPDU_PDUTYPEOFTXPDUINFO}, range raw 0..255}
                ProvideTruncTxFreshnessOfTxPduInfo: resulting-properties={base-type=uint8, sw-calibration-access=READ-ONLY, compu {1=SECOC_DONT_PROVIDE_PROVIDETRUNCTXFRESHNESSOFTXPDUINFO}, range raw 0..255}
                SecuredExternalIdOfTxPduInfo: resulting-properties={base-type=uint8, sw-calibration-access=READ-ONLY, compu {255=SECOC_NO_SECUREDEXTERNALIDOFTXPDUINFO}, range raw 0..255}
                SecuredPduDataContainerAuthInfoDataEndIdxOfTxPduInfo: resulting-properties={base-type=uint8, sw-calibration-access=READ-ONLY, compu {255=SECOC_NO_SECUREDPDUDATACONTAINERAUTHINFODATAENDIDXOFTXPDUINFO}, range raw 0..255}
                SecuredPduDataContainerAuthInfoDataLengthOfTxPduInfo: resulting-properties={base-type=uint8, sw-calibration-access=READ-ONLY, range raw 0..255}
                SecuredPduDataContainerAuthInfoDataStartIdxOfTxPduInfo: resulting-properties={base-type=uint8, sw-calibration-access=READ-ONLY, compu {255=SECOC_NO_SECUREDPDUDATACONTAINERAUTHINFODATASTARTIDXOFTXPDUINFO}, range raw 0..255}
                SecuredPduDataContainerAuthenticPduEndIdxOfTxPduInfo: resulting-properties={base-type=uint8, sw-calibration-access=READ-ONLY, compu {255=SECOC_NO_SECUREDPDUDATACONTAINERAUTHENTICPDUENDIDXOFTXPDUINFO}, range raw 0..255}
                SecuredPduDataContainerAuthenticPduLengthOfTxPduInfo: resulting-properties={base-type=uint8, sw-calibration-access=READ-ONLY, range raw 0..255}
                SecuredPduDataContainerAuthenticPduStartIdxOfTxPduInfo: resulting-properties={base-type=uint8, sw-calibration-access=READ-ONLY, compu {255=SECOC_NO_SECUREDPDUDATACONTAINERAUTHENTICPDUSTARTIDXOFTXPDUINFO}, range raw 0..255}
                SecuredPduDataContainerSecuredPduEndIdxOfTxPduInfo: resulting-properties={base-type=uint8, sw-calibration-access=READ-ONLY, compu {255=SECOC_NO_SECUREDPDUDATACONTAINERSECUREDPDUENDIDXOFTXPDUINFO}, range raw 0..255}
                SecuredPduDataContainerSecuredPduLengthOfTxPduInfo: resulting-properties={base-type=uint8, sw-calibration-access=READ-ONLY, range raw 0..255}
                SecuredPduDataContainerSecuredPduStartIdxOfTxPduInfo: resulting-properties={base-type=uint8, sw-calibration-access=READ-ONLY, compu {255=SECOC_NO_SECUREDPDUDATACONTAINERSECUREDPDUSTARTIDXOFTXPDUINFO}, range raw 0..255}
                SecuredPduDataContainerTruncatedAuthenticatorEndIdxOfTxPduInfo: resulting-properties={base-type=uint8, sw-calibration-access=READ-ONLY, compu-method=SecOC_SecuredPduDataContainerTruncatedAuthenticatorEndIdxOfTxPduInfoType, range raw 0..255}
                SecuredPduDataContainerTruncatedAuthenticatorLengthOfTxPduInfo: resulting-properties={base-type=uint8, sw-calibration-access=READ-ONLY, range raw 0..255}
                SecuredPduDataContainerTruncatedAuthenticatorStartIdxOfTxPduInfo: resulting-properties={base-type=uint8, sw-calibration-access=READ-ONLY, compu-method=SecOC_SecuredPduDataContainerTruncatedAuthenticatorStartIdxOfTxPduInfoType, range raw 0..255}
                TruncAuthStartBitInByteOfTxPduInfo: resulting-properties={base-type=uint8, sw-calibration-access=READ-ONLY, range raw 0..255}
                TruncFreshnessValueFirstByteShiftOfTxPduInfo: resulting-properties={base-type=uint8, sw-calibration-access=READ-ONLY, range raw 0..255}
                TruncFreshnessValueSecondByteShiftOfTxPduInfo: resulting-properties={base-type=uint8, sw-calibration-access=READ-ONLY, range raw 0..255}
                truncatedAuthenticationLengthOfTxPduInfo: resulting-properties={base-type=uint8, sw-calibration-access=READ-ONLY, range raw 0..255}
                truncatedFreshnessValueLengthOfTxPduInfo: resulting-properties={base-type=uint8, sw-calibration-access=READ-ONLY, range raw 0..255}
        SecOC_TxSecuredPduInfo: category=ARRAY, array-size=8
          8 x mc data instance, all with category=STRUCTURE:
            Element_0: symbol=[0]
              mc data instance TxPduInfoIdxOfTxSecuredPduInfo: category=VALUE, resulting-properties={base-type=uint8, sw-calibration-access=READ-ONLY, range raw 0..255}
              mc data instance TxSecuredPduTypeOfTxSecuredPduInfo: category=VALUE, resulting-properties={base-type=uint8, sw-calibration-access=READ-ONLY, compu {4=SECOC_NORMAL_TXSECUREDPDUTYPEOFTXSECUREDPDUINFO}, range raw 0..255}
            Element_1: symbol=[1]
              mc data instance TxPduInfoIdxOfTxSecuredPduInfo: category=VALUE, resulting-properties={base-type=uint8, sw-calibration-access=READ-ONLY, range raw 0..255}
              mc data instance TxSecuredPduTypeOfTxSecuredPduInfo: category=VALUE, resulting-properties={base-type=uint8, sw-calibration-access=READ-ONLY, compu {4=SECOC_NORMAL_TXSECUREDPDUTYPEOFTXSECUREDPDUINFO}, range raw 0..255}
            Element_2: symbol=[2]
              mc data instance TxPduInfoIdxOfTxSecuredPduInfo: category=VALUE, resulting-properties={base-type=uint8, sw-calibration-access=READ-ONLY, range raw 0..255}
              mc data instance TxSecuredPduTypeOfTxSecuredPduInfo: category=VALUE, resulting-properties={base-type=uint8, sw-calibration-access=READ-ONLY, compu {4=SECOC_NORMAL_TXSECUREDPDUTYPEOFTXSECUREDPDUINFO}, range raw 0..255}
            Element_3: symbol=[3]
              mc data instance TxPduInfoIdxOfTxSecuredPduInfo: category=VALUE, resulting-properties={base-type=uint8, sw-calibration-access=READ-ONLY, range raw 0..255}
              mc data instance TxSecuredPduTypeOfTxSecuredPduInfo: category=VALUE, resulting-properties={base-type=uint8, sw-calibration-access=READ-ONLY, compu {4=SECOC_NORMAL_TXSECUREDPDUTYPEOFTXSECUREDPDUINFO}, range raw 0..255}
            Element_4: symbol=[4]
              mc data instance TxPduInfoIdxOfTxSecuredPduInfo: category=VALUE, resulting-properties={base-type=uint8, sw-calibration-access=READ-ONLY, range raw 0..255}
              mc data instance TxSecuredPduTypeOfTxSecuredPduInfo: category=VALUE, resulting-properties={base-type=uint8, sw-calibration-access=READ-ONLY, compu {4=SECOC_NORMAL_TXSECUREDPDUTYPEOFTXSECUREDPDUINFO}, range raw 0..255}
            Element_5: symbol=[5]
              mc data instance TxPduInfoIdxOfTxSecuredPduInfo: category=VALUE, resulting-properties={base-type=uint8, sw-calibration-access=READ-ONLY, range raw 0..255}
              mc data instance TxSecuredPduTypeOfTxSecuredPduInfo: category=VALUE, resulting-properties={base-type=uint8, sw-calibration-access=READ-ONLY, compu {4=SECOC_NORMAL_TXSECUREDPDUTYPEOFTXSECUREDPDUINFO}, range raw 0..255}
            Element_6: symbol=[6]
              mc data instance TxPduInfoIdxOfTxSecuredPduInfo: category=VALUE, resulting-properties={base-type=uint8, sw-calibration-access=READ-ONLY, range raw 0..255}
              mc data instance TxSecuredPduTypeOfTxSecuredPduInfo: category=VALUE, resulting-properties={base-type=uint8, sw-calibration-access=READ-ONLY, compu {4=SECOC_NORMAL_TXSECUREDPDUTYPEOFTXSECUREDPDUINFO}, range raw 0..255}
            Element_7: symbol=[7]
              mc data instance TxPduInfoIdxOfTxSecuredPduInfo: category=VALUE, resulting-properties={base-type=uint8, sw-calibration-access=READ-ONLY, range raw 0..255}
              mc data instance TxSecuredPduTypeOfTxSecuredPduInfo: category=VALUE, resulting-properties={base-type=uint8, sw-calibration-access=READ-ONLY, compu {4=SECOC_NORMAL_TXSECUREDPDUTYPEOFTXSECUREDPDUINFO}, range raw 0..255}
        SecOC_AuthenticPduDataContainer: category=ARRAY, array-size=296, resulting-properties={base-type=uint8, sw-calibration-access=READ-ONLY, range raw 0..255}
        SecOC_AuthenticatorCache: category=ARRAY, array-size=48, resulting-properties={base-type=uint8, sw-calibration-access=READ-ONLY, range raw 0..255}, symbol=SecOC_AuthenticatorCache.raw
        SecOC_AuthenticatorCache_OBD_HCP1_SOK_XIX_HCP5_CANFD01_499f5f1b_RxOBD_HCP1_SOK_XIX_HCP5_CANFD01_499f5f1b_RxAuthenticatorCache: category=ARRAY, array-size=4, resulting-properties={base-type=uint8, sw-calibration-access=READ-ONLY, range raw 0..255}, symbol=SecOC_AuthenticatorCache.raw[4]  # The element: OBD_HCP1_SOK_XIX_HCP5_CANFD01_499f5f1b_RxOBD_HCP1_SOK_XIX_HCP5_CANFD01_499f5f1b_RxAuthenticatorCache of SecOC_AuthenticatorCache
        SecOC_NumberOfMessagesToOverride: category=ARRAY, array-size=3, resulting-properties={base-type=uint8, sw-calibration-access=READ-ONLY, range raw 0..255}, symbol=SecOC_NumberOfMessagesToOverride.raw
        SecOC_NumberOfMessagesToOverride_SOK_Zeit_Hybrid_01_Resp_01_SOK_XIX_HCP5_CANFD01_92adacdc_Rx: category=ARRAY, array-size=1, resulting-properties={base-type=uint8, sw-calibration-access=READ-ONLY, range raw 0..255}, symbol=SecOC_NumberOfMessagesToOverride.raw[0]  # The element: SOK_Zeit_Hybrid_01_Resp_01_SOK_XIX_HCP5_CANFD01_92adacdc_Rx of SecOC_NumberOfMessagesToOverride
        SecOC_NumberOfMessagesToOverride_HVK_03_E2E_SOK_XIX_HCP5_CANFD01_32c3c9b9_Rx: category=ARRAY, array-size=1, resulting-properties={base-type=uint8, sw-calibration-access=READ-ONLY, range raw 0..255}, symbol=SecOC_NumberOfMessagesToOverride.raw[1]  # The element: HVK_03_E2E_SOK_XIX_HCP5_CANFD01_32c3c9b9_Rx of SecOC_NumberOfMessagesToOverride
        SecOC_NumberOfMessagesToOverride_OBD_HCP1_SOK_XIX_HCP5_CANFD01_499f5f1b_Rx: category=ARRAY, array-size=1, resulting-properties={base-type=uint8, sw-calibration-access=READ-ONLY, range raw 0..255}, symbol=SecOC_NumberOfMessagesToOverride.raw[2]  # The element: OBD_HCP1_SOK_XIX_HCP5_CANFD01_499f5f1b_Rx of SecOC_NumberOfMessagesToOverride
        SecOC_RxAuthenticPduSizeOffset: category=ARRAY, array-size=3, resulting-properties={base-type=uint16, sw-calibration-access=READ-ONLY, range raw 0..65535}, symbol=SecOC_RxAuthenticPduSizeOffset.raw
        SecOC_RxAuthenticPduSizeOffset_HVK_03_E2E_SOK_XIX_HCP5_CANFD01_32c3c9b9_Rx: category=ARRAY, array-size=1, resulting-properties={base-type=uint16, sw-calibration-access=READ-ONLY, range raw 0..65535}, symbol=SecOC_RxAuthenticPduSizeOffset.raw[0]  # The element: HVK_03_E2E_SOK_XIX_HCP5_CANFD01_32c3c9b9_Rx of SecOC_RxAuthenticPduSizeOffset
        SecOC_RxAuthenticPduSizeOffset_OBD_HCP1_SOK_XIX_HCP5_CANFD01_499f5f1b_Rx: category=ARRAY, array-size=1, resulting-properties={base-type=uint16, sw-calibration-access=READ-ONLY, range raw 0..65535}, symbol=SecOC_RxAuthenticPduSizeOffset.raw[1]  # The element: OBD_HCP1_SOK_XIX_HCP5_CANFD01_499f5f1b_Rx of SecOC_RxAuthenticPduSizeOffset
        SecOC_RxAuthenticPduSizeOffset_SOK_Zeit_Hybrid_01_Resp_01_SOK_XIX_HCP5_CANFD01_92adacdc_Rx: category=ARRAY, array-size=1, resulting-properties={base-type=uint16, sw-calibration-access=READ-ONLY, range raw 0..65535}, symbol=SecOC_RxAuthenticPduSizeOffset.raw[2]  # The element: SOK_Zeit_Hybrid_01_Resp_01_SOK_XIX_HCP5_CANFD01_92adacdc_Rx of SecOC_RxAuthenticPduSizeOffset
        SecOC_RxBuildAttemptsCounter: category=ARRAY, array-size=3, resulting-properties={base-type=uint16, sw-calibration-access=READ-ONLY, range raw 0..65535}, symbol=SecOC_RxBuildAttemptsCounter.raw
        SecOC_RxBuildAttemptsCounter_HVK_03_E2E_SOK_XIX_HCP5_CANFD01_32c3c9b9_Rx: category=ARRAY, array-size=1, resulting-properties={base-type=uint16, sw-calibration-access=READ-ONLY, range raw 0..65535}, symbol=SecOC_RxBuildAttemptsCounter.raw[0]  # The element: HVK_03_E2E_SOK_XIX_HCP5_CANFD01_32c3c9b9_Rx of SecOC_RxBuildAttemptsCounter
        SecOC_RxBuildAttemptsCounter_OBD_HCP1_SOK_XIX_HCP5_CANFD01_499f5f1b_Rx: category=ARRAY, array-size=1, resulting-properties={base-type=uint16, sw-calibration-access=READ-ONLY, range raw 0..65535}, symbol=SecOC_RxBuildAttemptsCounter.raw[1]  # The element: OBD_HCP1_SOK_XIX_HCP5_CANFD01_499f5f1b_Rx of SecOC_RxBuildAttemptsCounter
        SecOC_RxBuildAttemptsCounter_SOK_Zeit_Hybrid_01_Resp_01_SOK_XIX_HCP5_CANFD01_92adacdc_Rx: category=ARRAY, array-size=1, resulting-properties={base-type=uint16, sw-calibration-access=READ-ONLY, range raw 0..65535}, symbol=SecOC_RxBuildAttemptsCounter.raw[2]  # The element: SOK_Zeit_Hybrid_01_Resp_01_SOK_XIX_HCP5_CANFD01_92adacdc_Rx of SecOC_RxBuildAttemptsCounter
        SecOC_RxPduState: category=ARRAY, array-size=3, resulting-properties={base-type=uint8, sw-calibration-access=READ-ONLY, compu-method=SecOC_RxPduStateType, range raw 0..255}, symbol=SecOC_RxPduState.raw  # The state variable is volatile because it is used to ensure data consistency
        SecOC_RxPduState_HVK_03_E2E_SOK_XIX_HCP5_CANFD01_32c3c9b9_Rx: category=ARRAY, array-size=1, resulting-properties={base-type=uint8, sw-calibration-access=READ-ONLY, compu-method=SecOC_RxPduStateType, range raw 0..255}, symbol=SecOC_RxPduState.raw[0]  # The element: HVK_03_E2E_SOK_XIX_HCP5_CANFD01_32c3c9b9_Rx of SecOC_RxPduState
        SecOC_RxPduState_OBD_HCP1_SOK_XIX_HCP5_CANFD01_499f5f1b_Rx: category=ARRAY, array-size=1, resulting-properties={base-type=uint8, sw-calibration-access=READ-ONLY, compu-method=SecOC_RxPduStateType, range raw 0..255}, symbol=SecOC_RxPduState.raw[1]  # The element: OBD_HCP1_SOK_XIX_HCP5_CANFD01_499f5f1b_Rx of SecOC_RxPduState
        SecOC_RxPduState_SOK_Zeit_Hybrid_01_Resp_01_SOK_XIX_HCP5_CANFD01_92adacdc_Rx: category=ARRAY, array-size=1, resulting-properties={base-type=uint8, sw-calibration-access=READ-ONLY, compu-method=SecOC_RxPduStateType, range raw 0..255}, symbol=SecOC_RxPduState.raw[2]  # The element: SOK_Zeit_Hybrid_01_Resp_01_SOK_XIX_HCP5_CANFD01_92adacdc_Rx of SecOC_RxPduState
        SecOC_RxTpWrittenBytesCounter: category=ARRAY, array-size=3, resulting-properties={base-type=uint16, sw-calibration-access=READ-ONLY, range raw 0..65535}, symbol=SecOC_RxTpWrittenBytesCounter.raw
        SecOC_RxTpWrittenBytesCounter_HVK_03_E2E_SOK_XIX_HCP5_CANFD01_32c3c9b9_Rx: category=ARRAY, array-size=1, resulting-properties={base-type=uint16, sw-calibration-access=READ-ONLY, range raw 0..65535}, symbol=SecOC_RxTpWrittenBytesCounter.raw[0]  # The element: HVK_03_E2E_SOK_XIX_HCP5_CANFD01_32c3c9b9_Rx of SecOC_RxTpWrittenBytesCounter
        SecOC_RxTpWrittenBytesCounter_OBD_HCP1_SOK_XIX_HCP5_CANFD01_499f5f1b_Rx: category=ARRAY, array-size=1, resulting-properties={base-type=uint16, sw-calibration-access=READ-ONLY, range raw 0..65535}, symbol=SecOC_RxTpWrittenBytesCounter.raw[1]  # The element: OBD_HCP1_SOK_XIX_HCP5_CANFD01_499f5f1b_Rx of SecOC_RxTpWrittenBytesCounter
        SecOC_RxTpWrittenBytesCounter_SOK_Zeit_Hybrid_01_Resp_01_SOK_XIX_HCP5_CANFD01_92adacdc_Rx: category=ARRAY, array-size=1, resulting-properties={base-type=uint16, sw-calibration-access=READ-ONLY, range raw 0..65535}, symbol=SecOC_RxTpWrittenBytesCounter.raw[2]  # The element: SOK_Zeit_Hybrid_01_Resp_01_SOK_XIX_HCP5_CANFD01_92adacdc_Rx of SecOC_RxTpWrittenBytesCounter
        SecOC_SecuredPduDataContainer: category=ARRAY, array-size=216, resulting-properties={base-type=uint8, sw-calibration-access=READ-ONLY, range raw 0..255}
        SecOC_TransmitRequest: category=ARRAY, array-size=8, resulting-properties={base-type=uint8, sw-calibration-access=READ-ONLY, compu {0=SECOC_IDLE_TRANSMITREQUEST, 1=SECOC_TRANSMIT_TRANSMITREQUEST}, range raw 0..255}, symbol=SecOC_TransmitRequest.raw
        SecOC_TransmitRequest_BMC_HV_01_E2E_SOK_XIX_HCP5_CANFD01_ad756307_Tx: category=ARRAY, array-size=1, resulting-properties={base-type=uint8, sw-calibration-access=READ-ONLY, compu {0=SECOC_IDLE_TRANSMITREQUEST, 1=SECOC_TRANSMIT_TRANSMITREQUEST}, range raw 0..255}, symbol=SecOC_TransmitRequest.raw[0]  # The element: BMC_HV_01_E2E_SOK_XIX_HCP5_CANFD01_ad756307_Tx of SecOC_TransmitRequest
        SecOC_TransmitRequest_BMC_HV_02_E2E_SOK_XIX_HCP5_CANFD01_5f228eff_Tx: category=ARRAY, array-size=1, resulting-properties={base-type=uint8, sw-calibration-access=READ-ONLY, compu {0=SECOC_IDLE_TRANSMITREQUEST, 1=SECOC_TRANSMIT_TRANSMITREQUEST}, range raw 0..255}, symbol=SecOC_TransmitRequest.raw[1]  # The element: BMC_HV_02_E2E_SOK_XIX_HCP5_CANFD01_5f228eff_Tx of SecOC_TransmitRequest
        SecOC_TransmitRequest_BMC_HV_06_SOK_XIX_HCP5_CANFD01_e20cafa8_Tx: category=ARRAY, array-size=1, resulting-properties={base-type=uint8, sw-calibration-access=READ-ONLY, compu {0=SECOC_IDLE_TRANSMITREQUEST, 1=SECOC_TRANSMIT_TRANSMITREQUEST}, range raw 0..255}, symbol=SecOC_TransmitRequest.raw[2]  # The element: BMC_HV_06_SOK_XIX_HCP5_CANFD01_e20cafa8_Tx of SecOC_TransmitRequest
        SecOC_TransmitRequest_BMC_HV_07_SOK_XIX_HCP5_CANFD01_f524cb68_Tx: category=ARRAY, array-size=1, resulting-properties={base-type=uint8, sw-calibration-access=READ-ONLY, compu {0=SECOC_IDLE_TRANSMITREQUEST, 1=SECOC_TRANSMIT_TRANSMITREQUEST}, range raw 0..255}, symbol=SecOC_TransmitRequest.raw[3]  # The element: BMC_HV_07_SOK_XIX_HCP5_CANFD01_f524cb68_Tx of SecOC_TransmitRequest
        SecOC_TransmitRequest_BMC_HV_08_SOK_XIX_HCP5_CANFD01_29bed328_Tx: category=ARRAY, array-size=1, resulting-properties={base-type=uint8, sw-calibration-access=READ-ONLY, compu {0=SECOC_IDLE_TRANSMITREQUEST, 1=SECOC_TRANSMIT_TRANSMITREQUEST}, range raw 0..255}, symbol=SecOC_TransmitRequest.raw[4]  # The element: BMC_HV_08_SOK_XIX_HCP5_CANFD01_29bed328_Tx of SecOC_TransmitRequest
        SecOC_TransmitRequest_BMC_HV_09_SOK_XIX_HCP5_CANFD01_3e96b7e8_Tx: category=ARRAY, array-size=1, resulting-properties={base-type=uint8, sw-calibration-access=READ-ONLY, compu {0=SECOC_IDLE_TRANSMITREQUEST, 1=SECOC_TRANSMIT_TRANSMITREQUEST}, range raw 0..255}, symbol=SecOC_TransmitRequest.raw[5]  # The element: BMC_HV_09_SOK_XIX_HCP5_CANFD01_3e96b7e8_Tx of SecOC_TransmitRequest
        SecOC_TransmitRequest_BMC_HV_14_SOK_XIX_HCP5_CANFD01_572f8cfc_Tx: category=ARRAY, array-size=1, resulting-properties={base-type=uint8, sw-calibration-access=READ-ONLY, compu {0=SECOC_IDLE_TRANSMITREQUEST, 1=SECOC_TRANSMIT_TRANSMITREQUEST}, range raw 0..255}, symbol=SecOC_TransmitRequest.raw[6]  # The element: BMC_HV_14_SOK_XIX_HCP5_CANFD01_572f8cfc_Tx of SecOC_TransmitRequest
        SecOC_TransmitRequest_OBD_Hybrid_01_SOK_XIX_HCP5_CANFD01_86ce2f2e_Tx: category=ARRAY, array-size=1, resulting-properties={base-type=uint8, sw-calibration-access=READ-ONLY, compu {0=SECOC_IDLE_TRANSMITREQUEST, 1=SECOC_TRANSMIT_TRANSMITREQUEST}, range raw 0..255}, symbol=SecOC_TransmitRequest.raw[7]  # The element: OBD_Hybrid_01_SOK_XIX_HCP5_CANFD01_86ce2f2e_Tx of SecOC_TransmitRequest
        SecOC_TxAuthenticPduSizeOffset: category=ARRAY, array-size=8, resulting-properties={base-type=uint16, sw-calibration-access=READ-ONLY, range raw 0..65535}, symbol=SecOC_TxAuthenticPduSizeOffset.raw
        SecOC_TxAuthenticPduSizeOffset_BMC_HV_01_E2E_SOK_XIX_HCP5_CANFD01_ad756307_Tx: category=ARRAY, array-size=1, resulting-properties={base-type=uint16, sw-calibration-access=READ-ONLY, range raw 0..65535}, symbol=SecOC_TxAuthenticPduSizeOffset.raw[0]  # The element: BMC_HV_01_E2E_SOK_XIX_HCP5_CANFD01_ad756307_Tx of SecOC_TxAuthenticPduSizeOffset
        SecOC_TxAuthenticPduSizeOffset_BMC_HV_02_E2E_SOK_XIX_HCP5_CANFD01_5f228eff_Tx: category=ARRAY, array-size=1, resulting-properties={base-type=uint16, sw-calibration-access=READ-ONLY, range raw 0..65535}, symbol=SecOC_TxAuthenticPduSizeOffset.raw[1]  # The element: BMC_HV_02_E2E_SOK_XIX_HCP5_CANFD01_5f228eff_Tx of SecOC_TxAuthenticPduSizeOffset
        SecOC_TxAuthenticPduSizeOffset_BMC_HV_06_SOK_XIX_HCP5_CANFD01_e20cafa8_Tx: category=ARRAY, array-size=1, resulting-properties={base-type=uint16, sw-calibration-access=READ-ONLY, range raw 0..65535}, symbol=SecOC_TxAuthenticPduSizeOffset.raw[2]  # The element: BMC_HV_06_SOK_XIX_HCP5_CANFD01_e20cafa8_Tx of SecOC_TxAuthenticPduSizeOffset
        SecOC_TxAuthenticPduSizeOffset_BMC_HV_07_SOK_XIX_HCP5_CANFD01_f524cb68_Tx: category=ARRAY, array-size=1, resulting-properties={base-type=uint16, sw-calibration-access=READ-ONLY, range raw 0..65535}, symbol=SecOC_TxAuthenticPduSizeOffset.raw[3]  # The element: BMC_HV_07_SOK_XIX_HCP5_CANFD01_f524cb68_Tx of SecOC_TxAuthenticPduSizeOffset
        SecOC_TxAuthenticPduSizeOffset_BMC_HV_08_SOK_XIX_HCP5_CANFD01_29bed328_Tx: category=ARRAY, array-size=1, resulting-properties={base-type=uint16, sw-calibration-access=READ-ONLY, range raw 0..65535}, symbol=SecOC_TxAuthenticPduSizeOffset.raw[4]  # The element: BMC_HV_08_SOK_XIX_HCP5_CANFD01_29bed328_Tx of SecOC_TxAuthenticPduSizeOffset
        SecOC_TxAuthenticPduSizeOffset_BMC_HV_09_SOK_XIX_HCP5_CANFD01_3e96b7e8_Tx: category=ARRAY, array-size=1, resulting-properties={base-type=uint16, sw-calibration-access=READ-ONLY, range raw 0..65535}, symbol=SecOC_TxAuthenticPduSizeOffset.raw[5]  # The element: BMC_HV_09_SOK_XIX_HCP5_CANFD01_3e96b7e8_Tx of SecOC_TxAuthenticPduSizeOffset
        SecOC_TxAuthenticPduSizeOffset_BMC_HV_14_SOK_XIX_HCP5_CANFD01_572f8cfc_Tx: category=ARRAY, array-size=1, resulting-properties={base-type=uint16, sw-calibration-access=READ-ONLY, range raw 0..65535}, symbol=SecOC_TxAuthenticPduSizeOffset.raw[6]  # The element: BMC_HV_14_SOK_XIX_HCP5_CANFD01_572f8cfc_Tx of SecOC_TxAuthenticPduSizeOffset
        SecOC_TxAuthenticPduSizeOffset_OBD_Hybrid_01_SOK_XIX_HCP5_CANFD01_86ce2f2e_Tx: category=ARRAY, array-size=1, resulting-properties={base-type=uint16, sw-calibration-access=READ-ONLY, range raw 0..65535}, symbol=SecOC_TxAuthenticPduSizeOffset.raw[7]  # The element: OBD_Hybrid_01_SOK_XIX_HCP5_CANFD01_86ce2f2e_Tx of SecOC_TxAuthenticPduSizeOffset
        SecOC_TxBuildAttemptsCounter: category=ARRAY, array-size=8, resulting-properties={base-type=uint16, sw-calibration-access=READ-ONLY, range raw 0..65535}, symbol=SecOC_TxBuildAttemptsCounter.raw
        SecOC_TxBuildAttemptsCounter_BMC_HV_01_E2E_SOK_XIX_HCP5_CANFD01_ad756307_Tx: category=ARRAY, array-size=1, resulting-properties={base-type=uint16, sw-calibration-access=READ-ONLY, range raw 0..65535}, symbol=SecOC_TxBuildAttemptsCounter.raw[0]  # The element: BMC_HV_01_E2E_SOK_XIX_HCP5_CANFD01_ad756307_Tx of SecOC_TxBuildAttemptsCounter
        SecOC_TxBuildAttemptsCounter_BMC_HV_02_E2E_SOK_XIX_HCP5_CANFD01_5f228eff_Tx: category=ARRAY, array-size=1, resulting-properties={base-type=uint16, sw-calibration-access=READ-ONLY, range raw 0..65535}, symbol=SecOC_TxBuildAttemptsCounter.raw[1]  # The element: BMC_HV_02_E2E_SOK_XIX_HCP5_CANFD01_5f228eff_Tx of SecOC_TxBuildAttemptsCounter
        SecOC_TxBuildAttemptsCounter_BMC_HV_06_SOK_XIX_HCP5_CANFD01_e20cafa8_Tx: category=ARRAY, array-size=1, resulting-properties={base-type=uint16, sw-calibration-access=READ-ONLY, range raw 0..65535}, symbol=SecOC_TxBuildAttemptsCounter.raw[2]  # The element: BMC_HV_06_SOK_XIX_HCP5_CANFD01_e20cafa8_Tx of SecOC_TxBuildAttemptsCounter
        SecOC_TxBuildAttemptsCounter_BMC_HV_07_SOK_XIX_HCP5_CANFD01_f524cb68_Tx: category=ARRAY, array-size=1, resulting-properties={base-type=uint16, sw-calibration-access=READ-ONLY, range raw 0..65535}, symbol=SecOC_TxBuildAttemptsCounter.raw[3]  # The element: BMC_HV_07_SOK_XIX_HCP5_CANFD01_f524cb68_Tx of SecOC_TxBuildAttemptsCounter
        SecOC_TxBuildAttemptsCounter_BMC_HV_08_SOK_XIX_HCP5_CANFD01_29bed328_Tx: category=ARRAY, array-size=1, resulting-properties={base-type=uint16, sw-calibration-access=READ-ONLY, range raw 0..65535}, symbol=SecOC_TxBuildAttemptsCounter.raw[4]  # The element: BMC_HV_08_SOK_XIX_HCP5_CANFD01_29bed328_Tx of SecOC_TxBuildAttemptsCounter
        SecOC_TxBuildAttemptsCounter_BMC_HV_09_SOK_XIX_HCP5_CANFD01_3e96b7e8_Tx: category=ARRAY, array-size=1, resulting-properties={base-type=uint16, sw-calibration-access=READ-ONLY, range raw 0..65535}, symbol=SecOC_TxBuildAttemptsCounter.raw[5]  # The element: BMC_HV_09_SOK_XIX_HCP5_CANFD01_3e96b7e8_Tx of SecOC_TxBuildAttemptsCounter
        SecOC_TxBuildAttemptsCounter_BMC_HV_14_SOK_XIX_HCP5_CANFD01_572f8cfc_Tx: category=ARRAY, array-size=1, resulting-properties={base-type=uint16, sw-calibration-access=READ-ONLY, range raw 0..65535}, symbol=SecOC_TxBuildAttemptsCounter.raw[6]  # The element: BMC_HV_14_SOK_XIX_HCP5_CANFD01_572f8cfc_Tx of SecOC_TxBuildAttemptsCounter
        SecOC_TxBuildAttemptsCounter_OBD_Hybrid_01_SOK_XIX_HCP5_CANFD01_86ce2f2e_Tx: category=ARRAY, array-size=1, resulting-properties={base-type=uint16, sw-calibration-access=READ-ONLY, range raw 0..65535}, symbol=SecOC_TxBuildAttemptsCounter.raw[7]  # The element: OBD_Hybrid_01_SOK_XIX_HCP5_CANFD01_86ce2f2e_Tx of SecOC_TxBuildAttemptsCounter
        SecOC_TxPduState: category=ARRAY, array-size=8, resulting-properties={base-type=uint8, sw-calibration-access=READ-ONLY, compu-method=SecOC_TxPduStateType, range raw 0..255}, symbol=SecOC_TxPduState.raw  # The state variable is volatile because it is used to ensure data consistency
        SecOC_TxPduState_BMC_HV_01_E2E_SOK_XIX_HCP5_CANFD01_ad756307_Tx: category=ARRAY, array-size=1, resulting-properties={base-type=uint8, sw-calibration-access=READ-ONLY, compu-method=SecOC_TxPduStateType, range raw 0..255}, symbol=SecOC_TxPduState.raw[0]  # The element: BMC_HV_01_E2E_SOK_XIX_HCP5_CANFD01_ad756307_Tx of SecOC_TxPduState
        SecOC_TxPduState_BMC_HV_02_E2E_SOK_XIX_HCP5_CANFD01_5f228eff_Tx: category=ARRAY, array-size=1, resulting-properties={base-type=uint8, sw-calibration-access=READ-ONLY, compu-method=SecOC_TxPduStateType, range raw 0..255}, symbol=SecOC_TxPduState.raw[1]  # The element: BMC_HV_02_E2E_SOK_XIX_HCP5_CANFD01_5f228eff_Tx of SecOC_TxPduState
        SecOC_TxPduState_BMC_HV_06_SOK_XIX_HCP5_CANFD01_e20cafa8_Tx: category=ARRAY, array-size=1, resulting-properties={base-type=uint8, sw-calibration-access=READ-ONLY, compu-method=SecOC_TxPduStateType, range raw 0..255}, symbol=SecOC_TxPduState.raw[2]  # The element: BMC_HV_06_SOK_XIX_HCP5_CANFD01_e20cafa8_Tx of SecOC_TxPduState
        SecOC_TxPduState_BMC_HV_07_SOK_XIX_HCP5_CANFD01_f524cb68_Tx: category=ARRAY, array-size=1, resulting-properties={base-type=uint8, sw-calibration-access=READ-ONLY, compu-method=SecOC_TxPduStateType, range raw 0..255}, symbol=SecOC_TxPduState.raw[3]  # The element: BMC_HV_07_SOK_XIX_HCP5_CANFD01_f524cb68_Tx of SecOC_TxPduState
        SecOC_TxPduState_BMC_HV_08_SOK_XIX_HCP5_CANFD01_29bed328_Tx: category=ARRAY, array-size=1, resulting-properties={base-type=uint8, sw-calibration-access=READ-ONLY, compu-method=SecOC_TxPduStateType, range raw 0..255}, symbol=SecOC_TxPduState.raw[4]  # The element: BMC_HV_08_SOK_XIX_HCP5_CANFD01_29bed328_Tx of SecOC_TxPduState
        SecOC_TxPduState_BMC_HV_09_SOK_XIX_HCP5_CANFD01_3e96b7e8_Tx: category=ARRAY, array-size=1, resulting-properties={base-type=uint8, sw-calibration-access=READ-ONLY, compu-method=SecOC_TxPduStateType, range raw 0..255}, symbol=SecOC_TxPduState.raw[5]  # The element: BMC_HV_09_SOK_XIX_HCP5_CANFD01_3e96b7e8_Tx of SecOC_TxPduState
        SecOC_TxPduState_BMC_HV_14_SOK_XIX_HCP5_CANFD01_572f8cfc_Tx: category=ARRAY, array-size=1, resulting-properties={base-type=uint8, sw-calibration-access=READ-ONLY, compu-method=SecOC_TxPduStateType, range raw 0..255}, symbol=SecOC_TxPduState.raw[6]  # The element: BMC_HV_14_SOK_XIX_HCP5_CANFD01_572f8cfc_Tx of SecOC_TxPduState
        SecOC_TxPduState_OBD_Hybrid_01_SOK_XIX_HCP5_CANFD01_86ce2f2e_Tx: category=ARRAY, array-size=1, resulting-properties={base-type=uint8, sw-calibration-access=READ-ONLY, compu-method=SecOC_TxPduStateType, range raw 0..255}, symbol=SecOC_TxPduState.raw[7]  # The element: OBD_Hybrid_01_SOK_XIX_HCP5_CANFD01_86ce2f2e_Tx of SecOC_TxPduState
        SecOC_TxResultLength: category=ARRAY, array-size=8, resulting-properties={base-type=uint32, sw-calibration-access=READ-ONLY, range raw 0..4294967295}, symbol=SecOC_TxResultLength.raw
        SecOC_TxResultLength_BMC_HV_01_E2E_SOK_XIX_HCP5_CANFD01_ad756307_Tx: category=ARRAY, array-size=1, resulting-properties={base-type=uint32, sw-calibration-access=READ-ONLY, range raw 0..4294967295}, symbol=SecOC_TxResultLength.raw[0]  # The element: BMC_HV_01_E2E_SOK_XIX_HCP5_CANFD01_ad756307_Tx of SecOC_TxResultLength
        SecOC_TxResultLength_BMC_HV_02_E2E_SOK_XIX_HCP5_CANFD01_5f228eff_Tx: category=ARRAY, array-size=1, resulting-properties={base-type=uint32, sw-calibration-access=READ-ONLY, range raw 0..4294967295}, symbol=SecOC_TxResultLength.raw[1]  # The element: BMC_HV_02_E2E_SOK_XIX_HCP5_CANFD01_5f228eff_Tx of SecOC_TxResultLength
        SecOC_TxResultLength_BMC_HV_06_SOK_XIX_HCP5_CANFD01_e20cafa8_Tx: category=ARRAY, array-size=1, resulting-properties={base-type=uint32, sw-calibration-access=READ-ONLY, range raw 0..4294967295}, symbol=SecOC_TxResultLength.raw[2]  # The element: BMC_HV_06_SOK_XIX_HCP5_CANFD01_e20cafa8_Tx of SecOC_TxResultLength
        SecOC_TxResultLength_BMC_HV_07_SOK_XIX_HCP5_CANFD01_f524cb68_Tx: category=ARRAY, array-size=1, resulting-properties={base-type=uint32, sw-calibration-access=READ-ONLY, range raw 0..4294967295}, symbol=SecOC_TxResultLength.raw[3]  # The element: BMC_HV_07_SOK_XIX_HCP5_CANFD01_f524cb68_Tx of SecOC_TxResultLength
        SecOC_TxResultLength_BMC_HV_08_SOK_XIX_HCP5_CANFD01_29bed328_Tx: category=ARRAY, array-size=1, resulting-properties={base-type=uint32, sw-calibration-access=READ-ONLY, range raw 0..4294967295}, symbol=SecOC_TxResultLength.raw[4]  # The element: BMC_HV_08_SOK_XIX_HCP5_CANFD01_29bed328_Tx of SecOC_TxResultLength
        SecOC_TxResultLength_BMC_HV_09_SOK_XIX_HCP5_CANFD01_3e96b7e8_Tx: category=ARRAY, array-size=1, resulting-properties={base-type=uint32, sw-calibration-access=READ-ONLY, range raw 0..4294967295}, symbol=SecOC_TxResultLength.raw[5]  # The element: BMC_HV_09_SOK_XIX_HCP5_CANFD01_3e96b7e8_Tx of SecOC_TxResultLength
        SecOC_TxResultLength_BMC_HV_14_SOK_XIX_HCP5_CANFD01_572f8cfc_Tx: category=ARRAY, array-size=1, resulting-properties={base-type=uint32, sw-calibration-access=READ-ONLY, range raw 0..4294967295}, symbol=SecOC_TxResultLength.raw[6]  # The element: BMC_HV_14_SOK_XIX_HCP5_CANFD01_572f8cfc_Tx of SecOC_TxResultLength
        SecOC_TxResultLength_OBD_Hybrid_01_SOK_XIX_HCP5_CANFD01_86ce2f2e_Tx: category=ARRAY, array-size=1, resulting-properties={base-type=uint32, sw-calibration-access=READ-ONLY, range raw 0..4294967295}, symbol=SecOC_TxResultLength.raw[7]  # The element: OBD_Hybrid_01_SOK_XIX_HCP5_CANFD01_86ce2f2e_Tx of SecOC_TxResultLength
        SecOC_TxTpWrittenBytesCounter: category=ARRAY, array-size=8, resulting-properties={base-type=uint16, sw-calibration-access=READ-ONLY, range raw 0..65535}, symbol=SecOC_TxTpWrittenBytesCounter.raw
        SecOC_TxTpWrittenBytesCounter_BMC_HV_01_E2E_SOK_XIX_HCP5_CANFD01_ad756307_Tx: category=ARRAY, array-size=1, resulting-properties={base-type=uint16, sw-calibration-access=READ-ONLY, range raw 0..65535}, symbol=SecOC_TxTpWrittenBytesCounter.raw[0]  # The element: BMC_HV_01_E2E_SOK_XIX_HCP5_CANFD01_ad756307_Tx of SecOC_TxTpWrittenBytesCounter
        SecOC_TxTpWrittenBytesCounter_BMC_HV_02_E2E_SOK_XIX_HCP5_CANFD01_5f228eff_Tx: category=ARRAY, array-size=1, resulting-properties={base-type=uint16, sw-calibration-access=READ-ONLY, range raw 0..65535}, symbol=SecOC_TxTpWrittenBytesCounter.raw[1]  # The element: BMC_HV_02_E2E_SOK_XIX_HCP5_CANFD01_5f228eff_Tx of SecOC_TxTpWrittenBytesCounter
        SecOC_TxTpWrittenBytesCounter_BMC_HV_06_SOK_XIX_HCP5_CANFD01_e20cafa8_Tx: category=ARRAY, array-size=1, resulting-properties={base-type=uint16, sw-calibration-access=READ-ONLY, range raw 0..65535}, symbol=SecOC_TxTpWrittenBytesCounter.raw[2]  # The element: BMC_HV_06_SOK_XIX_HCP5_CANFD01_e20cafa8_Tx of SecOC_TxTpWrittenBytesCounter
        SecOC_TxTpWrittenBytesCounter_BMC_HV_07_SOK_XIX_HCP5_CANFD01_f524cb68_Tx: category=ARRAY, array-size=1, resulting-properties={base-type=uint16, sw-calibration-access=READ-ONLY, range raw 0..65535}, symbol=SecOC_TxTpWrittenBytesCounter.raw[3]  # The element: BMC_HV_07_SOK_XIX_HCP5_CANFD01_f524cb68_Tx of SecOC_TxTpWrittenBytesCounter
        SecOC_TxTpWrittenBytesCounter_BMC_HV_08_SOK_XIX_HCP5_CANFD01_29bed328_Tx: category=ARRAY, array-size=1, resulting-properties={base-type=uint16, sw-calibration-access=READ-ONLY, range raw 0..65535}, symbol=SecOC_TxTpWrittenBytesCounter.raw[4]  # The element: BMC_HV_08_SOK_XIX_HCP5_CANFD01_29bed328_Tx of SecOC_TxTpWrittenBytesCounter
        SecOC_TxTpWrittenBytesCounter_BMC_HV_09_SOK_XIX_HCP5_CANFD01_3e96b7e8_Tx: category=ARRAY, array-size=1, resulting-properties={base-type=uint16, sw-calibration-access=READ-ONLY, range raw 0..65535}, symbol=SecOC_TxTpWrittenBytesCounter.raw[5]  # The element: BMC_HV_09_SOK_XIX_HCP5_CANFD01_3e96b7e8_Tx of SecOC_TxTpWrittenBytesCounter
        SecOC_TxTpWrittenBytesCounter_BMC_HV_14_SOK_XIX_HCP5_CANFD01_572f8cfc_Tx: category=ARRAY, array-size=1, resulting-properties={base-type=uint16, sw-calibration-access=READ-ONLY, range raw 0..65535}, symbol=SecOC_TxTpWrittenBytesCounter.raw[6]  # The element: BMC_HV_14_SOK_XIX_HCP5_CANFD01_572f8cfc_Tx of SecOC_TxTpWrittenBytesCounter
        SecOC_TxTpWrittenBytesCounter_OBD_Hybrid_01_SOK_XIX_HCP5_CANFD01_86ce2f2e_Tx: category=ARRAY, array-size=1, resulting-properties={base-type=uint16, sw-calibration-access=READ-ONLY, range raw 0..65535}, symbol=SecOC_TxTpWrittenBytesCounter.raw[7]  # The element: OBD_Hybrid_01_SOK_XIX_HCP5_CANFD01_86ce2f2e_Tx of SecOC_TxTpWrittenBytesCounter
        SecOC_VerifyAttemptsCounter: category=ARRAY, array-size=3, resulting-properties={base-type=uint16, sw-calibration-access=READ-ONLY, range raw 0..65535}, symbol=SecOC_VerifyAttemptsCounter.raw
        SecOC_VerifyAttemptsCounter_HVK_03_E2E_SOK_XIX_HCP5_CANFD01_32c3c9b9_Rx: category=ARRAY, array-size=1, resulting-properties={base-type=uint16, sw-calibration-access=READ-ONLY, range raw 0..65535}, symbol=SecOC_VerifyAttemptsCounter.raw[0]  # The element: HVK_03_E2E_SOK_XIX_HCP5_CANFD01_32c3c9b9_Rx of SecOC_VerifyAttemptsCounter
        SecOC_VerifyAttemptsCounter_OBD_HCP1_SOK_XIX_HCP5_CANFD01_499f5f1b_Rx: category=ARRAY, array-size=1, resulting-properties={base-type=uint16, sw-calibration-access=READ-ONLY, range raw 0..65535}, symbol=SecOC_VerifyAttemptsCounter.raw[1]  # The element: OBD_HCP1_SOK_XIX_HCP5_CANFD01_499f5f1b_Rx of SecOC_VerifyAttemptsCounter
        SecOC_VerifyAttemptsCounter_SOK_Zeit_Hybrid_01_Resp_01_SOK_XIX_HCP5_CANFD01_92adacdc_Rx: category=ARRAY, array-size=1, resulting-properties={base-type=uint16, sw-calibration-access=READ-ONLY, range raw 0..65535}, symbol=SecOC_VerifyAttemptsCounter.raw[2]  # The element: SOK_Zeit_Hybrid_01_Resp_01_SOK_XIX_HCP5_CANFD01_92adacdc_Rx of SecOC_VerifyAttemptsCounter
        SecOC_VerifyOverrideStatus: category=ARRAY, array-size=3, resulting-properties={base-type=uint8, sw-calibration-access=READ-ONLY, compu-method=SecOC_VerifyOverrideStatusType, range raw 0..255}, symbol=SecOC_VerifyOverrideStatus.raw
        SecOC_VerifyOverrideStatus_SOK_Zeit_Hybrid_01_Resp_01_SOK_XIX_HCP5_CANFD01_92adacdc_Rx: category=ARRAY, array-size=1, resulting-properties={base-type=uint8, sw-calibration-access=READ-ONLY, compu-method=SecOC_VerifyOverrideStatusType, range raw 0..255}, symbol=SecOC_VerifyOverrideStatus.raw[0]  # The element: SOK_Zeit_Hybrid_01_Resp_01_SOK_XIX_HCP5_CANFD01_92adacdc_Rx of SecOC_VerifyOverrideStatus
        SecOC_VerifyOverrideStatus_HVK_03_E2E_SOK_XIX_HCP5_CANFD01_32c3c9b9_Rx: category=ARRAY, array-size=1, resulting-properties={base-type=uint8, sw-calibration-access=READ-ONLY, compu-method=SecOC_VerifyOverrideStatusType, range raw 0..255}, symbol=SecOC_VerifyOverrideStatus.raw[1]  # The element: HVK_03_E2E_SOK_XIX_HCP5_CANFD01_32c3c9b9_Rx of SecOC_VerifyOverrideStatus
        SecOC_VerifyOverrideStatus_OBD_HCP1_SOK_XIX_HCP5_CANFD01_499f5f1b_Rx: category=ARRAY, array-size=1, resulting-properties={base-type=uint8, sw-calibration-access=READ-ONLY, compu-method=SecOC_VerifyOverrideStatusType, range raw 0..255}, symbol=SecOC_VerifyOverrideStatus.raw[2]  # The element: OBD_HCP1_SOK_XIX_HCP5_CANFD01_499f5f1b_Rx of SecOC_VerifyOverrideStatus
        SecOC_Initialized: category=VALUE, resulting-properties={base-type=boolean, sw-calibration-access=READ-ONLY, compu {0=FALSE, 1..255=TRUE}, range raw 0..1}  # Initialization state of SecOC. TRUE, if SecOC_Init() has been called, else FALSE.
    resource consumption ResourceConsumption
      122 x memory section:
        CRYPTO_DRV_ALIGNED_VAR_NOCACHE_INIT_32: alignment=32, sw-addrmethod=VAR_NOCACHE_INIT
        VAR_NOCACHE_CLEARED_UNSPECIFIED: alignment=UNSPECIFIED, sw-addrmethod=VAR_NOCACHE_CLEARED
        CRYPTO_DRV_ALIGNED_VAR_FAST_INIT_BOOLEAN: alignment=BOOLEAN, sw-addrmethod=VAR_FAST_INIT
        VAR_FAST_INIT_64: alignment=64, sw-addrmethod=VAR_FAST_INIT
        VAR_FAST_CLEARED_UNSPECIFIED: alignment=UNSPECIFIED, sw-addrmethod=VAR_FAST_CLEARED
        VAR_NOCACHE_CLEARED_16: alignment=16, sw-addrmethod=VAR_NOCACHE_CLEARED
        VAR_NO_INIT_16: alignment=16, sw-addrmethod=VAR_NO_INIT
        CRYPTO_DRV_ALIGNED_VAR_FAST_CLEARED_8: alignment=8, sw-addrmethod=VAR_FAST_CLEARED
        CRYPTO_DRV_ALIGNED_VAR_NOCACHE_NO_INIT_32: alignment=32, sw-addrmethod=VAR_NOCACHE_NO_INIT
        CONST_16: alignment=16, sw-addrmethod=CONST
        VAR_FAST_CLEARED_8: alignment=8, sw-addrmethod=VAR_FAST_CLEARED
        CRYPTO_DRV_ALIGNED_CONST_BOOLEAN: alignment=BOOLEAN, sw-addrmethod=CONST
        CODE: sw-addrmethod=CODE
        CRYPTO_DRV_ALIGNED_VAR_FAST_INIT_UNSPECIFIED: alignment=UNSPECIFIED, sw-addrmethod=VAR_FAST_INIT
        CRYPTO_DRV_ALIGNED_VAR_INIT_8: alignment=8, sw-addrmethod=VAR_INIT
        CRYPTO_DRV_ALIGNED_VAR_INIT_32: alignment=32, sw-addrmethod=VAR_INIT
        VAR_CLEARED_16: alignment=16, sw-addrmethod=VAR_CLEARED
        VAR_FAST_NO_INIT_16: alignment=16, sw-addrmethod=VAR_FAST_NO_INIT
        VAR_NOCACHE_INIT_32: alignment=32, sw-addrmethod=VAR_NOCACHE_INIT
        CRYPTO_DRV_ALIGNED_VAR_CLEARED_64: alignment=64, sw-addrmethod=VAR_CLEARED
        CRYPTO_DRV_ALIGNED_VAR_NOCACHE_INIT_BOOLEAN: alignment=BOOLEAN, sw-addrmethod=VAR_NOCACHE_INIT
        VAR_CLEARED_8: alignment=8, sw-addrmethod=VAR_CLEARED
        VAR_FAST_CLEARED_16: alignment=16, sw-addrmethod=VAR_FAST_CLEARED
        CRYPTO_DRV_ALIGNED_VAR_NO_INIT_BOOLEAN: alignment=BOOLEAN, sw-addrmethod=VAR_NO_INIT
        CRYPTO_DRV_ALIGNED_VAR_INIT_UNSPECIFIED: alignment=UNSPECIFIED, sw-addrmethod=VAR_INIT
        CONST_32: alignment=32, sw-addrmethod=CONST
        CRYPTO_DRV_ALIGNED_VAR_FAST_CLEARED_64: alignment=64, sw-addrmethod=VAR_FAST_CLEARED
        VAR_INIT_32: alignment=32, sw-addrmethod=VAR_INIT
        CRYPTO_DRV_ALIGNED_VAR_NO_INIT_64: alignment=64, sw-addrmethod=VAR_NO_INIT
        CRYPTO_DRV_ALIGNED_VAR_FAST_NO_INIT_64: alignment=64, sw-addrmethod=VAR_FAST_NO_INIT
        SecOC_CODE: prefix=SecOC, sw-addrmethod=CODE, symbol=CODE
        VAR_NO_INIT_32: alignment=32, sw-addrmethod=VAR_NO_INIT
        VAR_NOCACHE_INIT_BOOLEAN: alignment=BOOLEAN, sw-addrmethod=VAR_NOCACHE_INIT
        VAR_FAST_NO_INIT_BOOLEAN: alignment=BOOLEAN, sw-addrmethod=VAR_FAST_NO_INIT
        VAR_FAST_CLEARED_BOOLEAN: alignment=BOOLEAN, sw-addrmethod=VAR_FAST_CLEARED
        CRYPTO_DRV_ALIGNED_VAR_NOCACHE_NO_INIT_8: alignment=8, sw-addrmethod=VAR_NOCACHE_NO_INIT
        CRYPTO_DRV_ALIGNED_CONST_UNSPECIFIED: alignment=UNSPECIFIED, sw-addrmethod=CONST
        VAR_CLEARED_UNSPECIFIED: alignment=UNSPECIFIED, sw-addrmethod=VAR_CLEARED
        CRYPTO_DRV_ALIGNED_VAR_CLEARED_8: alignment=8, sw-addrmethod=VAR_CLEARED
        VAR_CLEARED_32: alignment=32, sw-addrmethod=VAR_CLEARED
        CRYPTO_DRV_ALIGNED_VAR_FAST_NO_INIT_8: alignment=8, sw-addrmethod=VAR_FAST_NO_INIT
        VAR_INIT_BOOLEAN: alignment=BOOLEAN, sw-addrmethod=VAR_INIT
        CRYPTO_DRV_ALIGNED_VAR_NOCACHE_INIT_UNSPECIFIED: alignment=UNSPECIFIED, sw-addrmethod=VAR_NOCACHE_INIT
        VAR_NOCACHE_INIT_UNSPECIFIED: alignment=UNSPECIFIED, sw-addrmethod=VAR_NOCACHE_INIT
        CRYPTO_DRV_ALIGNED_VAR_FAST_INIT_8: alignment=8, sw-addrmethod=VAR_FAST_INIT
        VAR_FAST_INIT_8: alignment=8, sw-addrmethod=VAR_FAST_INIT
        VAR_NOCACHE_INIT_16: alignment=16, sw-addrmethod=VAR_NOCACHE_INIT
        CRYPTO_DRV_ALIGNED_CONST_32: alignment=32, sw-addrmethod=CONST
        CONST_BOOLEAN: alignment=BOOLEAN, sw-addrmethod=CONST
        CRYPTO_DRV_ALIGNED_VAR_NOCACHE_CLEARED_32: alignment=32, sw-addrmethod=VAR_NOCACHE_CLEARED
        CRYPTO_DRV_ALIGNED_VAR_FAST_INIT_16: alignment=16, sw-addrmethod=VAR_FAST_INIT
        VAR_INIT_16: alignment=16, sw-addrmethod=VAR_INIT
        VAR_NOCACHE_NO_INIT_16: alignment=16, sw-addrmethod=VAR_NOCACHE_NO_INIT
        CRYPTO_DRV_ALIGNED_VAR_CLEARED_32: alignment=32, sw-addrmethod=VAR_CLEARED
        VAR_NO_INIT_8: alignment=8, sw-addrmethod=VAR_NO_INIT
        CRYPTO_DRV_ALIGNED_VAR_FAST_CLEARED_32: alignment=32, sw-addrmethod=VAR_FAST_CLEARED
        CONST_64: alignment=64, sw-addrmethod=CONST
        VAR_NOCACHE_CLEARED_8: alignment=8, sw-addrmethod=VAR_NOCACHE_CLEARED
        CRYPTO_DRV_ALIGNED_VAR_NO_INIT_32: alignment=32, sw-addrmethod=VAR_NO_INIT
        CRYPTO_DRV_ALIGNED_VAR_FAST_NO_INIT_32: alignment=32, sw-addrmethod=VAR_FAST_NO_INIT
        CRYPTO_DRV_ALIGNED_VAR_FAST_CLEARED_UNSPECIFIED: alignment=UNSPECIFIED, sw-addrmethod=VAR_FAST_CLEARED
        VAR_NOCACHE_CLEARED_BOOLEAN: alignment=BOOLEAN, sw-addrmethod=VAR_NOCACHE_CLEARED
        VAR_NO_INIT_64: alignment=64, sw-addrmethod=VAR_NO_INIT
        VAR_NOCACHE_CLEARED_64: alignment=64, sw-addrmethod=VAR_NOCACHE_CLEARED
        CRYPTO_DRV_ALIGNED_VAR_NOCACHE_INIT_64: alignment=64, sw-addrmethod=VAR_NOCACHE_INIT
        VAR_FAST_INIT_32: alignment=32, sw-addrmethod=VAR_FAST_INIT
        CRYPTO_DRV_ALIGNED_VAR_CLEARED_BOOLEAN: alignment=BOOLEAN, sw-addrmethod=VAR_CLEARED
        VAR_NO_INIT_UNSPECIFIED: alignment=UNSPECIFIED, sw-addrmethod=VAR_NO_INIT
        CRYPTO_DRV_ALIGNED_VAR_NOCACHE_INIT_8: alignment=8, sw-addrmethod=VAR_NOCACHE_INIT
        CRYPTO_DRV_ALIGNED_VAR_NOCACHE_NO_INIT_64: alignment=64, sw-addrmethod=VAR_NOCACHE_NO_INIT
        VAR_NOCACHE_INIT_8: alignment=8, sw-addrmethod=VAR_NOCACHE_INIT
        CONST_UNSPECIFIED: alignment=UNSPECIFIED, sw-addrmethod=CONST
        CRYPTO_DRV_ALIGNED_CONST_16: alignment=16, sw-addrmethod=CONST
        CRYPTO_DRV_ALIGNED_VAR_NO_INIT_UNSPECIFIED: alignment=UNSPECIFIED, sw-addrmethod=VAR_NO_INIT
        VAR_NOCACHE_NO_INIT_32: alignment=32, sw-addrmethod=VAR_NOCACHE_NO_INIT
        CRYPTO_DRV_ALIGNED_CONST_8: alignment=8, sw-addrmethod=CONST
        VAR_FAST_CLEARED_64: alignment=64, sw-addrmethod=VAR_FAST_CLEARED
        CRYPTO_DRV_ALIGNED_VAR_NO_INIT_8: alignment=8, sw-addrmethod=VAR_NO_INIT
        CRYPTO_DRV_ALIGNED_VAR_INIT_64: alignment=64, sw-addrmethod=VAR_INIT
        VAR_FAST_NO_INIT_64: alignment=64, sw-addrmethod=VAR_FAST_NO_INIT
        CRYPTO_DRV_ALIGNED_VAR_NOCACHE_CLEARED_16: alignment=16, sw-addrmethod=VAR_NOCACHE_CLEARED
        VAR_INIT_8: alignment=8, sw-addrmethod=VAR_INIT
        VAR_CLEARED_64: alignment=64, sw-addrmethod=VAR_CLEARED
        CRYPTO_DRV_ALIGNED_VAR_FAST_INIT_32: alignment=32, sw-addrmethod=VAR_FAST_INIT
        CRYPTO_DRV_ALIGNED_VAR_NOCACHE_CLEARED_UNSPECIFIED: alignment=UNSPECIFIED, sw-addrmethod=VAR_NOCACHE_CLEARED
        CRYPTO_DRV_ALIGNED_VAR_FAST_NO_INIT_16: alignment=16, sw-addrmethod=VAR_FAST_NO_INIT
        VAR_NOCACHE_INIT_64: alignment=64, sw-addrmethod=VAR_NOCACHE_INIT
        CRYPTO_DRV_ALIGNED_VAR_CLEARED_16: alignment=16, sw-addrmethod=VAR_CLEARED
        VAR_NOCACHE_CLEARED_32: alignment=32, sw-addrmethod=VAR_NOCACHE_CLEARED
        CRYPTO_DRV_ALIGNED_VAR_NOCACHE_NO_INIT_16: alignment=16, sw-addrmethod=VAR_NOCACHE_NO_INIT
        CRYPTO_DRV_ALIGNED_VAR_CLEARED_UNSPECIFIED: alignment=UNSPECIFIED, sw-addrmethod=VAR_CLEARED
        CRYPTO_DRV_ALIGNED_VAR_NOCACHE_INIT_16: alignment=16, sw-addrmethod=VAR_NOCACHE_INIT
        CRYPTO_DRV_ALIGNED_CONST_64: alignment=64, sw-addrmethod=CONST
        CRYPTO_DRV_ALIGNED_VAR_FAST_CLEARED_16: alignment=16, sw-addrmethod=VAR_FAST_CLEARED
        VAR_CLEARED_BOOLEAN: alignment=BOOLEAN, sw-addrmethod=VAR_CLEARED
        VAR_NO_INIT_BOOLEAN: alignment=BOOLEAN, sw-addrmethod=VAR_NO_INIT
        CRYPTO_DRV_ALIGNED_VAR_NOCACHE_CLEARED_64: alignment=64, sw-addrmethod=VAR_NOCACHE_CLEARED
        VAR_NOCACHE_NO_INIT_64: alignment=64, sw-addrmethod=VAR_NOCACHE_NO_INIT
        VAR_FAST_CLEARED_32: alignment=32, sw-addrmethod=VAR_FAST_CLEARED
        CRYPTO_DRV_ALIGNED_VAR_NO_INIT_16: alignment=16, sw-addrmethod=VAR_NO_INIT
        VAR_NOCACHE_NO_INIT_UNSPECIFIED: alignment=UNSPECIFIED, sw-addrmethod=VAR_NOCACHE_NO_INIT
        VAR_INIT_64: alignment=64, sw-addrmethod=VAR_INIT
        CRYPTO_DRV_ALIGNED_VAR_INIT_16: alignment=16, sw-addrmethod=VAR_INIT
        VAR_INIT_UNSPECIFIED: alignment=UNSPECIFIED, sw-addrmethod=VAR_INIT
        CONST_8: alignment=8, sw-addrmethod=CONST
        CRYPTO_DRV_ALIGNED_VAR_NOCACHE_CLEARED_8: alignment=8, sw-addrmethod=VAR_NOCACHE_CLEARED
        VAR_FAST_NO_INIT_32: alignment=32, sw-addrmethod=VAR_FAST_NO_INIT
        CRYPTO_DRV_ALIGNED_VAR_INIT_BOOLEAN: alignment=BOOLEAN, sw-addrmethod=VAR_INIT
        VAR_NOCACHE_NO_INIT_BOOLEAN: alignment=BOOLEAN, sw-addrmethod=VAR_NOCACHE_NO_INIT
        CRYPTO_DRV_ALIGNED_VAR_FAST_INIT_64: alignment=64, sw-addrmethod=VAR_FAST_INIT
        VAR_FAST_INIT_UNSPECIFIED: alignment=UNSPECIFIED, sw-addrmethod=VAR_FAST_INIT
        VAR_FAST_NO_INIT_8: alignment=8, sw-addrmethod=VAR_FAST_NO_INIT
        CRYPTO_DRV_ALIGNED_VAR_NOCACHE_NO_INIT_BOOLEAN: alignment=BOOLEAN, sw-addrmethod=VAR_NOCACHE_NO_INIT
        CRYPTO_DRV_ALIGNED_VAR_FAST_NO_INIT_BOOLEAN: alignment=BOOLEAN, sw-addrmethod=VAR_FAST_NO_INIT
        VAR_FAST_NO_INIT_UNSPECIFIED: alignment=UNSPECIFIED, sw-addrmethod=VAR_FAST_NO_INIT
        CRYPTO_DRV_ALIGNED_VAR_NOCACHE_NO_INIT_UNSPECIFIED: alignment=UNSPECIFIED, sw-addrmethod=VAR_NOCACHE_NO_INIT
        VAR_FAST_INIT_BOOLEAN: alignment=BOOLEAN, sw-addrmethod=VAR_FAST_INIT
        CRYPTO_DRV_ALIGNED_VAR_FAST_NO_INIT_UNSPECIFIED: alignment=UNSPECIFIED, sw-addrmethod=VAR_FAST_NO_INIT
        VAR_FAST_INIT_16: alignment=16, sw-addrmethod=VAR_FAST_INIT
        VAR_NOCACHE_NO_INIT_8: alignment=8, sw-addrmethod=VAR_NOCACHE_NO_INIT
        CRYPTO_DRV_ALIGNED_VAR_FAST_CLEARED_BOOLEAN: alignment=BOOLEAN, sw-addrmethod=VAR_FAST_CLEARED
        CRYPTO_DRV_ALIGNED_VAR_NOCACHE_CLEARED_BOOLEAN: alignment=BOOLEAN, sw-addrmethod=VAR_NOCACHE_CLEARED
      section name prefix SecOC
package /MICROSAR/SecOC_ib_bswmd/BswModuleDescriptions
  bsw module description SecOC: provided-entrys=[SecOC_MainFunctionRx, SecOC_MainFunctionTx]
    bsw internal behavior SecOCBehavior
      exclusive area SECOC_EXCLUSIVE_AREA_RXSTATE
      exclusive area SECOC_EXCLUSIVE_AREA_TXSTATE
      bsw schedulable entity SecOC_MainFunctionRx: can-enter-exclusive-area=[SECOC_EXCLUSIVE_AREA_RXSTATE, SECOC_EXCLUSIVE_AREA_TXSTATE], implemented-entry=SecOC_MainFunctionRx
      bsw schedulable entity SecOC_MainFunctionTx: can-enter-exclusive-area=[SECOC_EXCLUSIVE_AREA_RXSTATE, SECOC_EXCLUSIVE_AREA_TXSTATE], implemented-entry=SecOC_MainFunctionTx
      bsw timing event SecOC_MainFunctionRxTimingEvent0: starts-on-event=SecOC_MainFunctionRx, period=0.005
      bsw timing event SecOC_MainFunctionTxTimingEvent0: starts-on-event=SecOC_MainFunctionTx, period=0.005
  bsw module entry SecOC_MainFunctionRx: call-type=SCHEDULED, execution-context=TASK
  bsw module entry SecOC_MainFunctionTx: call-type=SCHEDULED, execution-context=TASK
package /MICROSAR/SecOC_ib_bswmd/DataTypes/CompuMethods
  compu method SecOC_AuthDataFreshnessOfRxPduInfoType: 0=SECOC_USE_AUTHDATAFRESHNESSOFRXPDUINFO, 1=SECOC_DONT_USE_AUTHDATAFRESHNESSOFRXPDUINFO
  compu method SecOC_AuthenticPduDataContainerAuthenticPduStartIdxOfTxPduInfoType: 65535=SECOC_NO_AUTHENTICPDUDATACONTAINERAUTHENTICPDUSTARTIDXOFTXPDUINFO
  compu method SecOC_AuthenticPduDataContainerFreshnessVerifyValueEndIdxOfRxPduInfoType: 255=SECOC_NO_AUTHENTICPDUDATACONTAINERFRESHNESSVERIFYVALUEENDIDXOFRXPDUINFO
  compu method SecOC_AuthenticPduDataContainerFreshnessVerifyValueEndIdxOfTxPduInfoType: 65535=SECOC_NO_AUTHENTICPDUDATACONTAINERFRESHNESSVERIFYVALUEENDIDXOFTXPDUINFO
  compu method SecOC_AuthenticPduDataContainerFreshnessVerifyValueStartIdxOfRxPduInfoType: 255=SECOC_NO_AUTHENTICPDUDATACONTAINERFRESHNESSVERIFYVALUESTARTIDXOFRXPDUINFO
  compu method SecOC_AuthenticPduDataContainerFreshnessVerifyValueStartIdxOfTxPduInfoType: 65535=SECOC_NO_AUTHENTICPDUDATACONTAINERFRESHNESSVERIFYVALUESTARTIDXOFTXPDUINFO
  compu method SecOC_AuthenticPduDataContainerFullAuthenticPduEndIdxOfTxPduInfoType: 65535=SECOC_NO_AUTHENTICPDUDATACONTAINERFULLAUTHENTICPDUENDIDXOFTXPDUINFO
  compu method SecOC_AuthenticPduDataContainerFullAuthenticPduStartIdxOfTxPduInfoType: 65535=SECOC_NO_AUTHENTICPDUDATACONTAINERFULLAUTHENTICPDUSTARTIDXOFTXPDUINFO
  compu method SecOC_RxPduStateType: 0=SECOC_IDLE_RXPDUSTATE, 1=SECOC_COPYING_RXPDUSTATE, 2=SECOC_VERIFIED_RXPDUSTATE, 6=SECOC_PRE_VERIFY_START_RXPDUSTATE, 3=SECOC_COPY_AUTHENTIC_PDU_TO_DATA_TO_AUTHENTICATE_RXPDUSTATE, 4=SECOC_FRESHNESS_VALUE_NEEDED_RXPDUSTATE, 5=SECOC_ABORTED_RXPDUSTATE, 16=SECOC_UNVERIFIED_RXPDUSTATE, 16=SECOC_UNVERIFIED_VERIFICATION_TO_BE_STARTED_RXPDUSTATE, 7=SECOC_UNVERIFIED_VERIFICATION_FINISHED_WAIT_FOR_CALLBACK_RXPDUSTATE, 22=SECOC_UNVERIFIED_VERIFICATION_FINISHED_VERIFICATION_RESULT_READY_RXPDUSTATE, 23=SECOC_UNVERIFIED_VERIFICATION_FINISHED_RXPDUSTATE
  compu method SecOC_SecuredPduDataContainerTruncatedAuthenticatorEndIdxOfRxPduInfoType: 255=SECOC_NO_SECUREDPDUDATACONTAINERTRUNCATEDAUTHENTICATORENDIDXOFRXPDUINFO
  compu method SecOC_SecuredPduDataContainerTruncatedAuthenticatorEndIdxOfTxPduInfoType: 255=SECOC_NO_SECUREDPDUDATACONTAINERTRUNCATEDAUTHENTICATORENDIDXOFTXPDUINFO
  compu method SecOC_SecuredPduDataContainerTruncatedAuthenticatorStartIdxOfRxPduInfoType: 255=SECOC_NO_SECUREDPDUDATACONTAINERTRUNCATEDAUTHENTICATORSTARTIDXOFRXPDUINFO
  compu method SecOC_SecuredPduDataContainerTruncatedAuthenticatorStartIdxOfTxPduInfoType: 255=SECOC_NO_SECUREDPDUDATACONTAINERTRUNCATEDAUTHENTICATORSTARTIDXOFTXPDUINFO
  compu method SecOC_TxPduStateType: 0=SECOC_INVALID_SECURED_PDU_TXPDUSTATE, 8=SECOC_PRE_REAUTHENTICATION_NEEDED_TXPDUSTATE, 1=SECOC_REAUTHENTICATION_NEEDED_TXPDUSTATE, 2=SECOC_AUTHENTICATED_TXPDUSTATE, 3=SECOC_TRANSMISSION_INITIATED_TXPDUSTATE, 4=SECOC_COPYING_TXPDUSTATE, 6=SECOC_GET_DATA_TXPDUSTATE, 7=SECOC_DEVMODE_AUTHENTICATION_PATTERN_NEEDED_TXPDUSTATE, 16=SECOC_UNAUTHENTICATED_TXPDUSTATE, 16=SECOC_UNAUTHENTICATED_TO_BE_STARTED_TXPDUSTATE, 21=SECOC_UNAUTHENTICATED_FINISHED_WAIT_FOR_CALLBACK_TXPDUSTATE, 22=SECOC_UNAUTHENTICATED_FINISHED_TXPDUSTATE
  compu method SecOC_VerificationStatusWithSecuredPduPropagationModeOfRxPduInfoType: 2=SECOC_NONE_VERIFICATIONSTATUSWITHSECUREDPDUPROPAGATIONMODEOFRXPDUINFO
  compu method SecOC_VerifyOverrideStatusType: 2=SECOC_CANCEL_VERIFYOVERRIDESTATUS, 1=SECOC_FAIL_N_TIMES_VERIFYOVERRIDESTATUS, 0=SECOC_FAIL_INFINETE_VERIFYOVERRIDESTATUS
