AUTOSAR XML (schema 00048)
package /MICROSAR/EthTrcv_30_Ethmii_ib_bswmd/BswModuleDescriptions
  bsw module description EthTrcv: provided-entrys=EthTrcv_30_Ethmii_MainFunction
    bsw internal behavior EthTrcv_30_EthmiiBehavior
      exclusive area ETHTRCV_30_ETHMII_EXCLUSIVE_AREA_SEQUENCE
      bsw schedulable entity EthTrcv_30_Ethmii_MainFunction: can-enter-exclusive-area=ETHTRCV_30_ETHMII_EXCLUSIVE_AREA_SEQUENCE, implemented-entry=EthTrcv_30_Ethmii_MainFunction
      bsw timing event EthTrcv_30_Ethmii_MainFunctionTimingEvent0: starts-on-event=EthTrcv_30_Ethmii_MainFunction, period=1
  bsw module entry EthTrcv_30_Ethmii_MainFunction: call-type=SCHEDULED, execution-context=TASK
