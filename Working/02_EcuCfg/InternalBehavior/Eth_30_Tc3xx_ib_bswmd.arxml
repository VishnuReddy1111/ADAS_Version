AUTOSAR XML (schema 00048)
package /MICROSAR/Eth_30_Tc3xx_ib_bswmd/BswModuleDescriptions
  bsw module description Eth: provided-entrys=Eth_30_Tc3xx_MainFunction
    bsw internal behavior EthBehavior
      5 x exclusive area:
        ETH_30_TC3XX_EXCLUSIVE_AREA_DATA
        ETH_30_TC3XX_EXCLUSIVE_AREA_MII
        ETH_30_TC3XX_EXCLUSIVE_AREA_DATA_MULTI_CORE
        ETH_30_TC3XX_EXCLUSIVE_AREA_MULTICAST_FILTER
        ETH_30_TC3XX_EXCLUSIVE_AREA_DISABLE_MAC
      bsw schedulable entity Eth_30_Tc3xx_MainFunction: can-enter-exclusive-area=[ETH_30_TC3XX_EXCLUSIVE_AREA_DATA, ETH_30_TC3XX_EXCLUSIVE_AREA_MII, ETH_30_TC3XX_EXCLUSIVE_AREA_DATA_MULTI_CORE, ETH_30_TC3XX_EXCLUSIVE_AREA_MULTICAST_FILTER, ETH_30_TC3XX_EXCLUSIVE_AREA_DISABLE_MAC], implemented-entry=Eth_30_Tc3xx_MainFunction
      bsw timing event Eth_30_Tc3xx_MainFunctionTimingEvent0: starts-on-event=Eth_30_Tc3xx_MainFunction, period=0.02
  bsw module entry Eth_30_Tc3xx_MainFunction: call-type=SCHEDULED, execution-context=TASK
