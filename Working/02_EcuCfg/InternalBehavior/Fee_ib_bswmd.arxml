AUTOSAR XML (schema 00048)
standard types defined: boolean, sint32
package /MICROSAR
  bsw implementation Fee_Impl: programming-language=C, sw-version=10.00.04, used-code-generator=DaVinci Configurator, vendor-id=30, ar-release-version=4.00.03
package /MICROSAR/Fee_ib_bswmd/DataTypes/CompuMethods
  compu method Fee_MemIfResultType_Values: 0=MEMIF_JOB_OK, 1=MEMIF_JOB_FAILED, 2=MEMIF_JOB_PENDING, 3=MEMIF_JOB_CANCELED, 4=MEMIF_BLOCK_INCONSISTENT, 5=MEMIF_BLOCK_INVALID
  compu method Fee_MemIfStatusType_Values: 0=MEMIF_UNINIT, 1=MEMIF_IDLE, 2=MEMIF_BUSY, 3=MEMIF_BUSY_INTERNAL
  compu method Fee_cmBoolean: 1=TRUE, 0=FALSE
package /MICROSAR/Fee_ib_bswmd/DataTypes/DataConstrs
  range Fee_Bool_BOOLEAN: raw 0..1
  range Fee_MemIfResultType_ENUM: raw -2147483648..2147483647
  range Fee_MemIfStatusType_ENUM: raw -2147483648..2147483647
package /AURIX2G/EcucDefs/Fee_ib_bswmd/BswModuleDescriptions
  bsw module description Fee: provided-entrys=Fee_MainFunction
    bsw internal behavior FeeBehavior
      bsw schedulable entity Fee_MainFunction: implemented-entry=Fee_MainFunction
      bsw timing event Fee_MainFunctionTimingEvent0: starts-on-event=Fee_MainFunction, period=0.01
  bsw module entry Fee_MainFunction: call-type=SCHEDULED, execution-context=TASK
