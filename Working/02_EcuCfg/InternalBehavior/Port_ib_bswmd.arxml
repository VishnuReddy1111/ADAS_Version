AUTOSAR XML (schema 00048)
package /AURIX2G/EcucDefs/Port_ib_bswmd/BswModuleDescriptions
  bsw module description Port
    bsw internal behavior PortBehavior
