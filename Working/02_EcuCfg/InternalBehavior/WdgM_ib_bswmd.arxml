AUTOSAR XML (schema 00048)
package /MICROSAR/WdgM_ib_bswmd/BswModuleDescriptions
  bsw module description WdgM: provided-entrys=WdgM_MainFunction
    bsw internal behavior WdgMBehavior
      exclusive area WDGM_EXCLUSIVE_AREA_0
      bsw schedulable entity WdgM_MainFunction: can-enter-exclusive-area=WDGM_EXCLUSIVE_AREA_0, implemented-entry=WdgM_MainFunction
      bsw timing event WdgM_MainFunctionTimingEvent0: starts-on-event=WdgM_MainFunction, period=0.01
      bsw timing event WdgM_MainFunctionTimingEvent1: starts-on-event=WdgM_MainFunction, period=0.01
  bsw module entry WdgM_MainFunction: call-type=SCHEDULED, execution-context=TASK
