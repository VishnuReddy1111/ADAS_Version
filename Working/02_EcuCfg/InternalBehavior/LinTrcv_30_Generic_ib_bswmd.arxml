AUTOSAR XML (schema 00048)
package /MICROSAR/LinTrcv_GenericLin_ib_bswmd/BswModuleDescriptions
  bsw module description LinTrcv: provided-entrys=LinTrcv_30_Generic_Virtual
    bsw internal behavior LinTrcv_GenericLin_Behavior
      exclusive area LINTRCV_30_GENERIC_EXCLUSIVE_AREA_0  # Using to secure atomic Hardware access. this Area should be protected with global interrupt locks.
      bsw called entity LinTrcv_30_Generic_Virtual: can-enter-exclusive-area=LINTRCV_30_GENERIC_EXCLUSIVE_AREA_0, implemented-entry=LinTrcv_30_Generic_Virtual
  bsw module entry LinTrcv_30_Generic_Virtual: call-type=REGULAR, execution-context=TASK
