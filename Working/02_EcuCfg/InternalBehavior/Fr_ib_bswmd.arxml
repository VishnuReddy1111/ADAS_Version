AUTOSAR XML (schema 00048)
package /MICROSAR/Fr_CanoeemuEray_ib_bsmwd/BswModuleDescriptions
  bsw module description Fr: provided-entrys=Fr_Virtual
    bsw internal behavior Fr_CanoeemuErayBehavior
      exclusive area FR_EXCLUSIVE_AREA_0
      exclusive area FR_EXCLUSIVE_AREA_1
      bsw called entity Fr_Virtual: can-enter-exclusive-area=[FR_EXCLUSIVE_AREA_0, FR_EXCLUSIVE_AREA_1], implemented-entry=Fr_Virtual
  bsw module entry Fr_Virtual: call-type=REGULAR, execution-context=TASK
