AUTOSAR XML (schema 00048)
package /MICROSAR/vFotaH_ib_bswmd/BswModuleDescriptions
  bsw module description vFotaH: provided-entrys=vFotaH_MainFunction
    bsw internal behavior vFotaHBehavior
      exclusive area VFOTAH_EXCLUSIVE_AREA_0
      bsw schedulable entity vFotaH_MainFunction: can-enter-exclusive-area=VFOTAH_EXCLUSIVE_AREA_0, implemented-entry=vFotaH_MainFunction
      bsw timing event vFotaH_MainFunctionTimingEvent0: starts-on-event=vFotaH_MainFunction, period=0.005
  bsw module entry vFotaH_MainFunction: call-type=SCHEDULED, execution-context=TASK
