AUTOSAR XML (schema 00048)
standard types defined: boolean, uint16, uint32, uint8
package /MICROSAR
  bsw implementation DoIP_Impl: programming-language=C, sw-version=13.03.00, used-code-generator=DaVinci Configurator, vendor-id=30, ar-release-version=4.05.00
    mc-variable-instances:
      24 x mc data instance:
        DoIP_Connection: category=ARRAY, array-size=4  # contains static TCP connection Data. List of DoIPConnections. The RxPduId as well as the TxPduId can be used to access the array.
          4 x mc data instance, all with category=STRUCTURE:
            Element_0: symbol=[0]
              mc data instance ConnectionTypeOfConnection: category=VALUE, resulting-properties={base-type=uint8, sw-calibration-access=READ-ONLY, compu-method=DoIP_ConnectionTypeOfConnectionType, range raw 0..255}
              mc data instance ConnectionTypeIdxOfConnection: category=VALUE, resulting-properties={base-type=uint8, sw-calibration-access=READ-ONLY, range raw 0..255}
              mc data instance LocalAddrIdxOfConnection: category=VALUE, resulting-properties={base-type=uint8, sw-calibration-access=READ-ONLY, range raw 0..255}
            Element_1: symbol=[1]
              mc data instance ConnectionTypeOfConnection: category=VALUE, resulting-properties={base-type=uint8, sw-calibration-access=READ-ONLY, compu-method=DoIP_ConnectionTypeOfConnectionType, range raw 0..255}
              mc data instance ConnectionTypeIdxOfConnection: category=VALUE, resulting-properties={base-type=uint8, sw-calibration-access=READ-ONLY, range raw 0..255}
              mc data instance LocalAddrIdxOfConnection: category=VALUE, resulting-properties={base-type=uint8, sw-calibration-access=READ-ONLY, range raw 0..255}
            Element_2: symbol=[2]
              mc data instance ConnectionTypeOfConnection: category=VALUE, resulting-properties={base-type=uint8, sw-calibration-access=READ-ONLY, compu-method=DoIP_ConnectionTypeOfConnectionType, range raw 0..255}
              mc data instance ConnectionTypeIdxOfConnection: category=VALUE, resulting-properties={base-type=uint8, sw-calibration-access=READ-ONLY, range raw 0..255}
              mc data instance LocalAddrIdxOfConnection: category=VALUE, resulting-properties={base-type=uint8, sw-calibration-access=READ-ONLY, range raw 0..255}
            Element_3: symbol=[3]
              mc data instance ConnectionTypeOfConnection: category=VALUE, resulting-properties={base-type=uint8, sw-calibration-access=READ-ONLY, compu-method=DoIP_ConnectionTypeOfConnectionType, range raw 0..255}
              mc data instance ConnectionTypeIdxOfConnection: category=VALUE, resulting-properties={base-type=uint8, sw-calibration-access=READ-ONLY, range raw 0..255}
              mc data instance LocalAddrIdxOfConnection: category=VALUE, resulting-properties={base-type=uint8, sw-calibration-access=READ-ONLY, range raw 0..255}
        DoIP_ConnectionGroup: category=ARRAY, array-size=1  # represents the group of connections on a local port/IP address (i.e. socket connection group)
          mc data instance Element_0: category=STRUCTURE, symbol=[0]
            mc data instance PlusOneSocketUsedOfConnectionGroup: category=VALUE, resulting-properties={base-type=boolean, sw-calibration-access=READ-ONLY, compu {0=FALSE, 1..255=TRUE}, range raw 0..1}
        DoIP_ConnectionTcp: category=ARRAY, array-size=2  # contains static TCP connection data
          mc data instance Element_0: category=STRUCTURE, symbol=[0]
            4 x mc data instance, all with category=VALUE:
              SecurityRequiredOfConnectionTcp: resulting-properties={base-type=boolean, sw-calibration-access=READ-ONLY, compu {0=FALSE, 1..255=TRUE}, range raw 0..1}
              ConnectionGroupIdxOfConnectionTcp: resulting-properties={base-type=uint8, sw-calibration-access=READ-ONLY, range raw 0..255}
              RxHdrBufStartIdxOfConnectionTcp: resulting-properties={base-type=uint8, sw-calibration-access=READ-ONLY, range raw 0..255}
              TxTcpMgtStartIdxOfConnectionTcp: resulting-properties={base-type=uint8, sw-calibration-access=READ-ONLY, range raw 0..255}
          mc data instance Element_1: category=STRUCTURE, symbol=[1]
            4 x mc data instance, all with category=VALUE:
              SecurityRequiredOfConnectionTcp: resulting-properties={base-type=boolean, sw-calibration-access=READ-ONLY, compu {0=FALSE, 1..255=TRUE}, range raw 0..1}
              ConnectionGroupIdxOfConnectionTcp: resulting-properties={base-type=uint8, sw-calibration-access=READ-ONLY, range raw 0..255}
              RxHdrBufStartIdxOfConnectionTcp: resulting-properties={base-type=uint8, sw-calibration-access=READ-ONLY, range raw 0..255}
              TxTcpMgtStartIdxOfConnectionTcp: resulting-properties={base-type=uint8, sw-calibration-access=READ-ONLY, range raw 0..255}
        DoIP_PCConfig: category=STRUCTURE
          62 x mc data instance, all with category=VALUE:
            AliveCheckListOfPCConfig: resulting-properties={base-type=DoIP_AliveCheckListOfPCConfigType, sw-calibration-access=READ-ONLY, compu {0=NULL_PTR}, data-constr=DoIP_AliveCheckListOfPCConfigType}
            ChannelOfPCConfig: resulting-properties={base-type=DoIP_ChannelOfPCConfigType, sw-calibration-access=READ-ONLY, compu {0=NULL_PTR}, data-constr=DoIP_ChannelOfPCConfigType}
            ChannelDynOfPCConfig: resulting-properties={base-type=DoIP_ChannelDynOfPCConfigType, sw-calibration-access=READ-ONLY, compu {0=NULL_PTR}, data-constr=DoIP_ChannelDynOfPCConfigType}
            ChannelIndOfPCConfig: resulting-properties={base-type=DoIP_ChannelIndOfPCConfigType, sw-calibration-access=READ-ONLY, compu {0=NULL_PTR}, data-constr=DoIP_ChannelIndOfPCConfigType}
            ConnectionOfPCConfig: resulting-properties={base-type=DoIP_ConnectionOfPCConfigType, sw-calibration-access=READ-ONLY, compu {0=NULL_PTR}, data-constr=DoIP_ConnectionOfPCConfigType}
            ConnectionDynOfPCConfig: resulting-properties={base-type=DoIP_ConnectionDynOfPCConfigType, sw-calibration-access=READ-ONLY, compu {0=NULL_PTR}, data-constr=DoIP_ConnectionDynOfPCConfigType}
            ConnectionGroupOfPCConfig: resulting-properties={base-type=DoIP_ConnectionGroupOfPCConfigType, sw-calibration-access=READ-ONLY, compu {0=NULL_PTR}, data-constr=DoIP_ConnectionGroupOfPCConfigType}
            ConnectionIndOfPCConfig: resulting-properties={base-type=DoIP_ConnectionIndOfPCConfigType, sw-calibration-access=READ-ONLY, compu {0=NULL_PTR}, data-constr=DoIP_ConnectionIndOfPCConfigType}
            ConnectionTcpOfPCConfig: resulting-properties={base-type=DoIP_ConnectionTcpOfPCConfigType, sw-calibration-access=READ-ONLY, compu {0=NULL_PTR}, data-constr=DoIP_ConnectionTcpOfPCConfigType}
            ConnectionTcpDynOfPCConfig: resulting-properties={base-type=DoIP_ConnectionTcpDynOfPCConfigType, sw-calibration-access=READ-ONLY, compu {0=NULL_PTR}, data-constr=DoIP_ConnectionTcpDynOfPCConfigType}
            ConnectionTcpIndOfPCConfig: resulting-properties={base-type=DoIP_ConnectionTcpIndOfPCConfigType, sw-calibration-access=READ-ONLY, compu {0=NULL_PTR}, data-constr=DoIP_ConnectionTcpIndOfPCConfigType}
            ConnectionUdpOfPCConfig: resulting-properties={base-type=DoIP_ConnectionUdpOfPCConfigType, sw-calibration-access=READ-ONLY, compu {0=NULL_PTR}, data-constr=DoIP_ConnectionUdpOfPCConfigType}
            ConnectionUdpVehAnOfPCConfig: resulting-properties={base-type=DoIP_ConnectionUdpVehAnOfPCConfigType, sw-calibration-access=READ-ONLY, compu {0=NULL_PTR}, data-constr=DoIP_ConnectionUdpVehAnOfPCConfigType}
            ConnectionUdpVehAnDynOfPCConfig: resulting-properties={base-type=DoIP_ConnectionUdpVehAnDynOfPCConfigType, sw-calibration-access=READ-ONLY, compu {0=NULL_PTR}, data-constr=DoIP_ConnectionUdpVehAnDynOfPCConfigType}
            DiagNAckBufOfPCConfig: resulting-properties={base-type=DoIP_DiagNAckBufOfPCConfigType, sw-calibration-access=READ-ONLY, compu {0=NULL_PTR}, data-constr=DoIP_DiagNAckBufOfPCConfigType}
            GIdOfPCConfig: resulting-properties={base-type=DoIP_GIdOfPCConfigType, sw-calibration-access=READ-ONLY, compu {0=NULL_PTR}, data-constr=DoIP_GIdOfPCConfigType}
            InterfaceOfPCConfig: resulting-properties={base-type=DoIP_InterfaceOfPCConfigType, sw-calibration-access=READ-ONLY, compu {0=NULL_PTR}, data-constr=DoIP_InterfaceOfPCConfigType}
            InterfaceDynOfPCConfig: resulting-properties={base-type=DoIP_InterfaceDynOfPCConfigType, sw-calibration-access=READ-ONLY, compu {0=NULL_PTR}, data-constr=DoIP_InterfaceDynOfPCConfigType}
            IpAddrAssignmentOfPCConfig: resulting-properties={base-type=DoIP_IpAddrAssignmentOfPCConfigType, sw-calibration-access=READ-ONLY, compu {0=NULL_PTR}, data-constr=DoIP_IpAddrAssignmentOfPCConfigType}
            IpAddrAssignmentDynOfPCConfig: resulting-properties={base-type=DoIP_IpAddrAssignmentDynOfPCConfigType, sw-calibration-access=READ-ONLY, compu {0=NULL_PTR}, data-constr=DoIP_IpAddrAssignmentDynOfPCConfigType}
            LocalAddrOfPCConfig: resulting-properties={base-type=DoIP_LocalAddrOfPCConfigType, sw-calibration-access=READ-ONLY, compu {0=NULL_PTR}, data-constr=DoIP_LocalAddrOfPCConfigType}
            PduRRxCancelPduIdOfPCConfig: resulting-properties={base-type=DoIP_PduRRxCancelPduIdOfPCConfigType, sw-calibration-access=READ-ONLY, compu {0=NULL_PTR}, data-constr=DoIP_PduRRxCancelPduIdOfPCConfigType}
            PduRTxPduIdOfPCConfig: resulting-properties={base-type=DoIP_PduRTxPduIdOfPCConfigType, sw-calibration-access=READ-ONLY, compu {0=NULL_PTR}, data-constr=DoIP_PduRTxPduIdOfPCConfigType}
            RoutActivHandlerOfPCConfig: resulting-properties={base-type=DoIP_RoutActivHandlerOfPCConfigType, sw-calibration-access=READ-ONLY, compu {0=NULL_PTR}, data-constr=DoIP_RoutActivHandlerOfPCConfigType}
            RoutingActivationOfPCConfig: resulting-properties={base-type=DoIP_RoutingActivationOfPCConfigType, sw-calibration-access=READ-ONLY, compu {0=NULL_PTR}, data-constr=DoIP_RoutingActivationOfPCConfigType}
            RoutingActivationIndOfPCConfig: resulting-properties={base-type=DoIP_RoutingActivationIndOfPCConfigType, sw-calibration-access=READ-ONLY, compu {0=NULL_PTR}, data-constr=DoIP_RoutingActivationIndOfPCConfigType}
            RxHdrBufOfPCConfig: resulting-properties={base-type=DoIP_RxHdrBufOfPCConfigType, sw-calibration-access=READ-ONLY, compu {0=NULL_PTR}, data-constr=DoIP_RxHdrBufOfPCConfigType}
            SoAdRxPduIdOfPCConfig: resulting-properties={base-type=DoIP_SoAdRxPduIdOfPCConfigType, sw-calibration-access=READ-ONLY, compu {0=NULL_PTR}, data-constr=DoIP_SoAdRxPduIdOfPCConfigType}
            SoAdTxPduIdOfPCConfig: resulting-properties={base-type=DoIP_SoAdTxPduIdOfPCConfigType, sw-calibration-access=READ-ONLY, compu {0=NULL_PTR}, data-constr=DoIP_SoAdTxPduIdOfPCConfigType}
            TesterOfPCConfig: resulting-properties={base-type=DoIP_TesterOfPCConfigType, sw-calibration-access=READ-ONLY, compu {0=NULL_PTR}, data-constr=DoIP_TesterOfPCConfigType}
            TesterDynOfPCConfig: resulting-properties={base-type=DoIP_TesterDynOfPCConfigType, sw-calibration-access=READ-ONLY, compu {0=NULL_PTR}, data-constr=DoIP_TesterDynOfPCConfigType}
            TxHdrBufOfPCConfig: resulting-properties={base-type=DoIP_TxHdrBufOfPCConfigType, sw-calibration-access=READ-ONLY, compu {0=NULL_PTR}, data-constr=DoIP_TxHdrBufOfPCConfigType}
            TxTcpMgtOfPCConfig: resulting-properties={base-type=DoIP_TxTcpMgtOfPCConfigType, sw-calibration-access=READ-ONLY, compu {0=NULL_PTR}, data-constr=DoIP_TxTcpMgtOfPCConfigType}
            TxTcpMgtDynOfPCConfig: resulting-properties={base-type=DoIP_TxTcpMgtDynOfPCConfigType, sw-calibration-access=READ-ONLY, compu {0=NULL_PTR}, data-constr=DoIP_TxTcpMgtDynOfPCConfigType}
            TxUdpMgtListOfPCConfig: resulting-properties={base-type=DoIP_TxUdpMgtListOfPCConfigType, sw-calibration-access=READ-ONLY, compu {0=NULL_PTR}, data-constr=DoIP_TxUdpMgtListOfPCConfigType}
            SizeOfDiagNAckBufOfPCConfig: resulting-properties={base-type=uint16, sw-calibration-access=READ-ONLY, range raw 0..65535}
            SizeOfAliveCheckListOfPCConfig: resulting-properties={base-type=uint8, sw-calibration-access=READ-ONLY, range raw 0..255}
            SizeOfChannelOfPCConfig: resulting-properties={base-type=uint8, sw-calibration-access=READ-ONLY, range raw 0..255}
            SizeOfChannelIndOfPCConfig: resulting-properties={base-type=uint8, sw-calibration-access=READ-ONLY, range raw 0..255}
            SizeOfConnectionOfPCConfig: resulting-properties={base-type=uint8, sw-calibration-access=READ-ONLY, range raw 0..255}
            SizeOfConnectionGroupOfPCConfig: resulting-properties={base-type=uint8, sw-calibration-access=READ-ONLY, range raw 0..255}
            SizeOfConnectionIndOfPCConfig: resulting-properties={base-type=uint8, sw-calibration-access=READ-ONLY, range raw 0..255}
            SizeOfConnectionTcpOfPCConfig: resulting-properties={base-type=uint8, sw-calibration-access=READ-ONLY, range raw 0..255}
            SizeOfConnectionTcpIndOfPCConfig: resulting-properties={base-type=uint8, sw-calibration-access=READ-ONLY, range raw 0..255}
            SizeOfConnectionUdpOfPCConfig: resulting-properties={base-type=uint8, sw-calibration-access=READ-ONLY, range raw 0..255}
            SizeOfConnectionUdpVehAnOfPCConfig: resulting-properties={base-type=uint8, sw-calibration-access=READ-ONLY, range raw 0..255}
            SizeOfGIdOfPCConfig: resulting-properties={base-type=uint8, sw-calibration-access=READ-ONLY, range raw 0..255}
            SizeOfInterfaceOfPCConfig: resulting-properties={base-type=uint8, sw-calibration-access=READ-ONLY, range raw 0..255}
            SizeOfIpAddrAssignmentOfPCConfig: resulting-properties={base-type=uint8, sw-calibration-access=READ-ONLY, range raw 0..255}
            SizeOfLocalAddrOfPCConfig: resulting-properties={base-type=uint8, sw-calibration-access=READ-ONLY, range raw 0..255}
            SizeOfPduRRxCancelPduIdOfPCConfig: resulting-properties={base-type=uint8, sw-calibration-access=READ-ONLY, range raw 0..255}
            SizeOfPduRTxPduIdOfPCConfig: resulting-properties={base-type=uint8, sw-calibration-access=READ-ONLY, range raw 0..255}
            SizeOfRoutActivHandlerOfPCConfig: resulting-properties={base-type=uint8, sw-calibration-access=READ-ONLY, range raw 0..255}
            SizeOfRoutingActivationOfPCConfig: resulting-properties={base-type=uint8, sw-calibration-access=READ-ONLY, range raw 0..255}
            SizeOfRoutingActivationIndOfPCConfig: resulting-properties={base-type=uint8, sw-calibration-access=READ-ONLY, range raw 0..255}
            SizeOfRxHdrBufOfPCConfig: resulting-properties={base-type=uint8, sw-calibration-access=READ-ONLY, range raw 0..255}
            SizeOfSoAdRxPduIdOfPCConfig: resulting-properties={base-type=uint8, sw-calibration-access=READ-ONLY, range raw 0..255}
            SizeOfSoAdTxPduIdOfPCConfig: resulting-properties={base-type=uint8, sw-calibration-access=READ-ONLY, range raw 0..255}
            SizeOfTesterOfPCConfig: resulting-properties={base-type=uint8, sw-calibration-access=READ-ONLY, range raw 0..255}
            SizeOfTxHdrBufOfPCConfig: resulting-properties={base-type=uint8, sw-calibration-access=READ-ONLY, range raw 0..255}
            SizeOfTxTcpMgtOfPCConfig: resulting-properties={base-type=uint8, sw-calibration-access=READ-ONLY, range raw 0..255}
            SizeOfTxUdpMgtListOfPCConfig: resulting-properties={base-type=uint8, sw-calibration-access=READ-ONLY, range raw 0..255}
        DoIP_PduRRxCancelPduId: category=ARRAY, array-size=4  # PduR PduId for reception cancelation
          4 x mc data instance, all with category=STRUCTURE:
            Element_0: symbol=[0]
              mc data instance ChannelIdxOfPduRRxCancelPduId: category=VALUE, resulting-properties={base-type=uint8, sw-calibration-access=READ-ONLY, range raw 0..255}
            Element_1: symbol=[1]
              mc data instance ChannelIdxOfPduRRxCancelPduId: category=VALUE, resulting-properties={base-type=uint8, sw-calibration-access=READ-ONLY, range raw 0..255}
            Element_2: symbol=[2]
              mc data instance ChannelIdxOfPduRRxCancelPduId: category=VALUE, resulting-properties={base-type=uint8, sw-calibration-access=READ-ONLY, range raw 0..255}
            Element_3: symbol=[3]
              mc data instance ChannelIdxOfPduRRxCancelPduId: category=VALUE, resulting-properties={base-type=uint8, sw-calibration-access=READ-ONLY, range raw 0..255}
        DoIP_Tester: category=ARRAY, array-size=2  # contains static tester data
          mc data instance Element_0: category=STRUCTURE, symbol=[0]
            mc data instance DiagNAckBufStartIdxOfTester: category=VALUE, resulting-properties={base-type=uint16, sw-calibration-access=READ-ONLY, compu {65535=DOIP_NO_DIAGNACKBUFSTARTIDXOFTESTER}, range raw 0..65535}
            mc data instance TesterAddrOfTester: category=VALUE, resulting-properties={base-type=uint16, sw-calibration-access=READ-ONLY, range raw 0..65535}
            mc data instance CentralSecurityOfTester: category=VALUE, resulting-properties={base-type=boolean, sw-calibration-access=READ-ONLY, compu {0=FALSE, 1..255=TRUE}, range raw 0..1}
          mc data instance Element_1: category=STRUCTURE, symbol=[1]
            mc data instance DiagNAckBufStartIdxOfTester: category=VALUE, resulting-properties={base-type=uint16, sw-calibration-access=READ-ONLY, compu {65535=DOIP_NO_DIAGNACKBUFSTARTIDXOFTESTER}, range raw 0..65535}
            mc data instance TesterAddrOfTester: category=VALUE, resulting-properties={base-type=uint16, sw-calibration-access=READ-ONLY, range raw 0..65535}
            mc data instance CentralSecurityOfTester: category=VALUE, resulting-properties={base-type=boolean, sw-calibration-access=READ-ONLY, compu {0=FALSE, 1..255=TRUE}, range raw 0..1}
        DoIP_TxTcpMgt: category=ARRAY, array-size=4  # contains static TCP transmission queue management data
          4 x mc data instance, all with category=STRUCTURE:
            Element_0: symbol=[0]
              mc data instance TxHdrBufStartIdxOfTxTcpMgt: category=VALUE, resulting-properties={base-type=uint8, sw-calibration-access=READ-ONLY, range raw 0..255}
            Element_1: symbol=[1]
              mc data instance TxHdrBufStartIdxOfTxTcpMgt: category=VALUE, resulting-properties={base-type=uint8, sw-calibration-access=READ-ONLY, range raw 0..255}
            Element_2: symbol=[2]
              mc data instance TxHdrBufStartIdxOfTxTcpMgt: category=VALUE, resulting-properties={base-type=uint8, sw-calibration-access=READ-ONLY, range raw 0..255}
            Element_3: symbol=[3]
              mc data instance TxHdrBufStartIdxOfTxTcpMgt: category=VALUE, resulting-properties={base-type=uint8, sw-calibration-access=READ-ONLY, range raw 0..255}
        DoIP_ChannelInd: category=ARRAY, array-size=4, resulting-properties={base-type=uint8, sw-calibration-access=READ-ONLY, range raw 0..255}  # the indexes of the 1:1 sorted relation pointing to DoIP_Channel
        DoIP_GId: category=ARRAY, array-size=6, resulting-properties={base-type=uint8, sw-calibration-access=READ-ONLY, range raw 0..255}  # the GID
        DoIP_RoutingActivationInd: category=ARRAY, array-size=2, resulting-properties={base-type=uint8, sw-calibration-access=READ-ONLY, range raw 0..255}  # the indexes of the 1:1 sorted relation pointing to DoIP_RoutingActivation
        DoIP_AliveCheckList: category=ARRAY, array-size=2  # list of connections with pending alive checks
          mc data instance Element_0: category=STRUCTURE, symbol=[0]
            mc data instance ConnectionTcpIdxOfAliveCheckList: category=VALUE, resulting-properties={base-type=uint8, sw-calibration-access=READ-ONLY, range raw 0..255}
          mc data instance Element_1: category=STRUCTURE, symbol=[1]
            mc data instance ConnectionTcpIdxOfAliveCheckList: category=VALUE, resulting-properties={base-type=uint8, sw-calibration-access=READ-ONLY, range raw 0..255}
        DoIP_ChannelDyn: category=ARRAY, array-size=4  # contains dynamic channel data
          4 x mc data instance, all with category=STRUCTURE:
            Element_0: symbol=[0]
              mc data instance TxMsgLenOfChannelDyn: category=VALUE, resulting-properties={base-type=uint16, sw-calibration-access=READ-ONLY, range raw 0..65535}
            Element_1: symbol=[1]
              mc data instance TxMsgLenOfChannelDyn: category=VALUE, resulting-properties={base-type=uint16, sw-calibration-access=READ-ONLY, range raw 0..65535}
            Element_2: symbol=[2]
              mc data instance TxMsgLenOfChannelDyn: category=VALUE, resulting-properties={base-type=uint16, sw-calibration-access=READ-ONLY, range raw 0..65535}
            Element_3: symbol=[3]
              mc data instance TxMsgLenOfChannelDyn: category=VALUE, resulting-properties={base-type=uint16, sw-calibration-access=READ-ONLY, range raw 0..65535}
        DoIP_ConnectionUdpVehAnDyn: category=ARRAY, array-size=1  # contains dynamic UDP vehicle announcement connection data
          mc data instance Element_0: category=STRUCTURE, symbol=[0]
            mc data instance PendingVehAnOfConnectionUdpVehAnDyn: category=VALUE, resulting-properties={base-type=boolean, sw-calibration-access=READ-ONLY, compu {0=FALSE, 1..255=TRUE}, range raw 0..1}
        DoIP_InterfaceDyn: category=ARRAY, array-size=1, symbol=DoIP_InterfaceDyn.raw  # contains dynamic interface data
          mc data instance Element_0: category=STRUCTURE, symbol=[0]
            4 x mc data instance, all with category=VALUE:
              ActLineActiveRequestCounterOfInterfaceDyn: resulting-properties={base-type=uint32, sw-calibration-access=READ-ONLY, range raw 0..4294967295}
              ActLineInactiveRequestCounterOfInterfaceDyn: resulting-properties={base-type=uint32, sw-calibration-access=READ-ONLY, range raw 0..4294967295}
              ActLineInactiveTimeOfInterfaceDyn: resulting-properties={base-type=uint32, sw-calibration-access=READ-ONLY, range raw 0..4294967295}
              ActLineActiveOfInterfaceDyn: resulting-properties={base-type=boolean, sw-calibration-access=READ-ONLY, compu {0=FALSE, 1..255=TRUE}, range raw 0..1}
        DoIP_InterfaceDyn_DoIPConfigSet_96e5a5d4: category=ARRAY, array-size=1, symbol=DoIP_InterfaceDyn.raw[0]  # The element: DoIPConfigSet_96e5a5d4 of DoIP_InterfaceDyn
          mc data instance Element_0: category=STRUCTURE, symbol=[0]
            4 x mc data instance, all with category=VALUE:
              ActLineActiveRequestCounterOfInterfaceDyn: resulting-properties={base-type=uint32, sw-calibration-access=READ-ONLY, range raw 0..4294967295}
              ActLineInactiveRequestCounterOfInterfaceDyn: resulting-properties={base-type=uint32, sw-calibration-access=READ-ONLY, range raw 0..4294967295}
              ActLineInactiveTimeOfInterfaceDyn: resulting-properties={base-type=uint32, sw-calibration-access=READ-ONLY, range raw 0..4294967295}
              ActLineActiveOfInterfaceDyn: resulting-properties={base-type=boolean, sw-calibration-access=READ-ONLY, compu {0=FALSE, 1..255=TRUE}, range raw 0..1}
        DoIP_RoutActivHandler: category=ARRAY, array-size=1  # single routing activation handler
          mc data instance Element_0: category=STRUCTURE, symbol=[0]
            9 x mc data instance, all with category=VALUE:
              OemSpecReqOfRoutActivHandler: resulting-properties={base-type=uint32, sw-calibration-access=READ-ONLY, range raw 0..4294967295}
              OemSpecResOfRoutActivHandler: resulting-properties={base-type=uint32, sw-calibration-access=READ-ONLY, range raw 0..4294967295}
              AliveCheckCntOfRoutActivHandler: resulting-properties={base-type=uint16, sw-calibration-access=READ-ONLY, range raw 0..65535}
              TesterAddrOfRoutActivHandler: resulting-properties={base-type=uint16, sw-calibration-access=READ-ONLY, range raw 0..65535}
              AliveCheckElemNumOfRoutActivHandler: resulting-properties={base-type=uint8, sw-calibration-access=READ-ONLY, range raw 0..255}
              ConnectionTcpIdxOfRoutActivHandler: resulting-properties={base-type=uint8, sw-calibration-access=READ-ONLY, range raw 0..255}
              OemSpecUsedOfRoutActivHandler: resulting-properties={base-type=boolean, sw-calibration-access=READ-ONLY, compu {0=FALSE, 1..255=TRUE}, range raw 0..1}
              RoutingActivationIdxOfRoutActivHandler: resulting-properties={base-type=uint8, sw-calibration-access=READ-ONLY, range raw 0..255}
              TesterIdxOfRoutActivHandler: resulting-properties={base-type=uint8, sw-calibration-access=READ-ONLY, range raw 0..255}
        DoIP_TesterDyn: category=ARRAY, array-size=2  # contains static dynamic data
          mc data instance Element_0: category=STRUCTURE, symbol=[0]
            mc data instance DiagNAckOffsetOfTesterDyn: category=VALUE, resulting-properties={base-type=uint32, sw-calibration-access=READ-ONLY, range raw 0..4294967295}
            mc data instance ConnectionTcpIdxOfTesterDyn: category=VALUE, resulting-properties={base-type=uint8, sw-calibration-access=READ-ONLY, range raw 0..255}
          mc data instance Element_1: category=STRUCTURE, symbol=[1]
            mc data instance DiagNAckOffsetOfTesterDyn: category=VALUE, resulting-properties={base-type=uint32, sw-calibration-access=READ-ONLY, range raw 0..4294967295}
            mc data instance ConnectionTcpIdxOfTesterDyn: category=VALUE, resulting-properties={base-type=uint8, sw-calibration-access=READ-ONLY, range raw 0..255}
        DoIP_DiagNAckBuf: category=ARRAY, array-size=512, resulting-properties={base-type=uint8, sw-calibration-access=READ-ONLY, range raw 0..255}, symbol=DoIP_DiagNAckBuf.raw  # diagnostic nack data buffer
        DoIP_DiagNAckBuf_DoIP_SA_Flasher_010ddfd1: category=ARRAY, array-size=256, resulting-properties={base-type=uint8, sw-calibration-access=READ-ONLY, range raw 0..255}, symbol=DoIP_DiagNAckBuf.raw[0]  # The element: DoIP_SA_Flasher_010ddfd1 of DoIP_DiagNAckBuf
        DoIP_DiagNAckBuf_DoIP_SA_Tester_53e814ef: category=ARRAY, array-size=256, resulting-properties={base-type=uint8, sw-calibration-access=READ-ONLY, range raw 0..255}, symbol=DoIP_DiagNAckBuf.raw[256]  # The element: DoIP_SA_Tester_53e814ef of DoIP_DiagNAckBuf
        DoIP_RxHdrBuf: category=ARRAY, array-size=38, resulting-properties={base-type=uint8, sw-calibration-access=READ-ONLY, range raw 0..255}, symbol=DoIP_RxHdrBuf.raw  # buffer which stores the received message header
        DoIP_RxHdrBuf_SCB_DoIP_TCP_14c6c034: category=ARRAY, array-size=19, resulting-properties={base-type=uint8, sw-calibration-access=READ-ONLY, range raw 0..255}, symbol=DoIP_RxHdrBuf.raw[0]  # The element: SCB_DoIP_TCP_14c6c034 of DoIP_RxHdrBuf
        DoIP_RxHdrBuf_SCB_DoIP_TCP_b2b1cb80: category=ARRAY, array-size=19, resulting-properties={base-type=uint8, sw-calibration-access=READ-ONLY, range raw 0..255}, symbol=DoIP_RxHdrBuf.raw[19]  # The element: SCB_DoIP_TCP_b2b1cb80 of DoIP_RxHdrBuf
        DoIP_TxHdrBuf: category=ARRAY, array-size=84, resulting-properties={base-type=uint8, sw-calibration-access=READ-ONLY, range raw 0..255}  # buffer which stores the message header for transmission
package /MICROSAR/DoIP_ib_bswmd/DataTypes/BaseTypes
  35 x base type, all with category=FIXED_LENGTH, base-type-size=32, base-type-encoding=NONE:
    DoIP_AliveCheckListOfPCConfigType
    DoIP_ChannelDynOfPCConfigType
    DoIP_ChannelIndOfPCConfigType
    DoIP_ChannelOfPCConfigType
    DoIP_ConnectionDynOfPCConfigType
    DoIP_ConnectionGroupOfPCConfigType
    DoIP_ConnectionIndOfPCConfigType
    DoIP_ConnectionOfPCConfigType
    DoIP_ConnectionTcpDynOfPCConfigType
    DoIP_ConnectionTcpIndOfPCConfigType
    DoIP_ConnectionTcpOfPCConfigType
    DoIP_DiagNAckBufOfPCConfigType
    DoIP_GIdOfPCConfigType
    DoIP_IpAddrAssignmentDynOfPCConfigType
    DoIP_IpAddrAssignmentOfPCConfigType
    DoIP_LocalAddrOfPCConfigType
    DoIP_PduRRxCancelPduIdOfPCConfigType
    DoIP_PduRTxPduIdOfPCConfigType
    DoIP_RoutActivHandlerOfPCConfigType
    DoIP_RoutingActivationIndOfPCConfigType
    DoIP_RoutingActivationOfPCConfigType
    DoIP_RxHdrBufOfPCConfigType
    DoIP_TesterDynOfPCConfigType
    DoIP_TesterOfPCConfigType
    DoIP_TxHdrBufOfPCConfigType
    DoIP_TxTcpMgtDynOfPCConfigType
    DoIP_TxTcpMgtOfPCConfigType
    DoIP_TxUdpMgtListOfPCConfigType
    DoIP_InterfaceOfPCConfigType
    DoIP_ConnectionUdpOfPCConfigType
    DoIP_ConnectionUdpVehAnOfPCConfigType
    DoIP_InterfaceDynOfPCConfigType
    DoIP_SoAdRxPduIdOfPCConfigType
    DoIP_SoAdTxPduIdOfPCConfigType
    DoIP_ConnectionUdpVehAnDynOfPCConfigType
package /MICROSAR/DoIP_ib_bswmd/DataTypes/CompuMethods
  compu method DoIP_ConnectionTypeOfConnectionType: 0=DOIP_CONNECTIONTCP_CONNECTIONTYPEOFCONNECTION, 1=DOIP_CONNECTIONUDP_CONNECTIONTYPEOFCONNECTION, 2=DOIP_CONNECTIONUDPVEHAN_CONNECTIONTYPEOFCONNECTION
package /MICROSAR/DoIP_ib_bswmd/DataTypes/DataConstrs
  data constr DoIP_AliveCheckListOfPCConfigType
  data constr DoIP_ChannelDynOfPCConfigType
  data constr DoIP_ChannelIndOfPCConfigType
  data constr DoIP_ChannelOfPCConfigType
  data constr DoIP_ConnectionDynOfPCConfigType
  data constr DoIP_ConnectionGroupOfPCConfigType
  data constr DoIP_ConnectionIndOfPCConfigType
  data constr DoIP_ConnectionOfPCConfigType
  data constr DoIP_ConnectionTcpDynOfPCConfigType
  data constr DoIP_ConnectionTcpIndOfPCConfigType
  data constr DoIP_ConnectionTcpOfPCConfigType
  data constr DoIP_ConnectionUdpOfPCConfigType
  data constr DoIP_ConnectionUdpVehAnDynOfPCConfigType
  data constr DoIP_ConnectionUdpVehAnOfPCConfigType
  data constr DoIP_DiagNAckBufOfPCConfigType
  data constr DoIP_GIdOfPCConfigType
  data constr DoIP_InterfaceDynOfPCConfigType
  data constr DoIP_InterfaceOfPCConfigType
  data constr DoIP_IpAddrAssignmentDynOfPCConfigType
  data constr DoIP_IpAddrAssignmentOfPCConfigType
  data constr DoIP_LocalAddrOfPCConfigType
  data constr DoIP_PduRRxCancelPduIdOfPCConfigType
  data constr DoIP_PduRTxPduIdOfPCConfigType
  data constr DoIP_RoutActivHandlerOfPCConfigType
  data constr DoIP_RoutingActivationIndOfPCConfigType
  data constr DoIP_RoutingActivationOfPCConfigType
  data constr DoIP_RxHdrBufOfPCConfigType
  data constr DoIP_SoAdRxPduIdOfPCConfigType
  data constr DoIP_SoAdTxPduIdOfPCConfigType
  data constr DoIP_TesterDynOfPCConfigType
  data constr DoIP_TesterOfPCConfigType
  data constr DoIP_TxHdrBufOfPCConfigType
  data constr DoIP_TxTcpMgtDynOfPCConfigType
  data constr DoIP_TxTcpMgtOfPCConfigType
  data constr DoIP_TxUdpMgtListOfPCConfigType
