AUTOSAR XML (schema 4-3-0)
standard types defined: boolean, uint16, uint8
package /MICROSAR
  bsw implementation CanNm_Impl: programming-language=C, sw-version=11.00.01, used-code-generator=DaVinci Configurator, vendor-id=30, ar-release-version=4.00.03
    mc-variable-instances:
      81 x mc data instance, all with category=ARRAY:
        CanNm_ChannelConfig: array-size=2
          mc data instance Element_0: category=STRUCTURE, symbol=[0]
            12 x mc data instance, all with category=VALUE:
              RepeatMessageTimeOfChannelConfig: resulting-properties={base-type=uint16, sw-calibration-access=READ-ONLY, range raw 0..65535}
              ComControlEnabledOfChannelConfig: resulting-properties={base-type=boolean, sw-calibration-access=READ-ONLY, compu {0=FALSE, 1..255=TRUE}, range raw 0..1}
              ChannelIdOfChannelConfig: resulting-properties={base-type=uint8, sw-calibration-access=READ-ONLY, range raw 0..255}
              ImmediateNmCycleTimeOfChannelConfig: resulting-properties={base-type=uint8, sw-calibration-access=READ-ONLY, range raw 0..255}
              ImmediateNmTransmissionsOfChannelConfig: resulting-properties={base-type=uint8, sw-calibration-access=READ-ONLY, range raw 0..255}
              MsgCycleTimeOfChannelConfig: resulting-properties={base-type=uint8, sw-calibration-access=READ-ONLY, range raw 0..255}
              MsgTimeoutTimeOfChannelConfig: resulting-properties={base-type=uint8, sw-calibration-access=READ-ONLY, range raw 0..255}
              PduCbvPositionOfChannelConfig: resulting-properties={base-type=uint8, sw-calibration-access=READ-ONLY, range raw 0..255}
              PduNidPositionOfChannelConfig: resulting-properties={base-type=uint8, sw-calibration-access=READ-ONLY, range raw 0..255}
              RemoteSleepIndTimeOfChannelConfig: resulting-properties={base-type=uint8, sw-calibration-access=READ-ONLY, range raw 0..255}
              TimeoutTimeOfChannelConfig: resulting-properties={base-type=uint8, sw-calibration-access=READ-ONLY, range raw 0..255}
              WaitBusSleepTimeOfChannelConfig: resulting-properties={base-type=uint8, sw-calibration-access=READ-ONLY, range raw 0..255}
          mc data instance Element_1: category=STRUCTURE, symbol=[1]
            12 x mc data instance, all with category=VALUE:
              RepeatMessageTimeOfChannelConfig: resulting-properties={base-type=uint16, sw-calibration-access=READ-ONLY, range raw 0..65535}
              ComControlEnabledOfChannelConfig: resulting-properties={base-type=boolean, sw-calibration-access=READ-ONLY, compu {0=FALSE, 1..255=TRUE}, range raw 0..1}
              ChannelIdOfChannelConfig: resulting-properties={base-type=uint8, sw-calibration-access=READ-ONLY, range raw 0..255}
              ImmediateNmCycleTimeOfChannelConfig: resulting-properties={base-type=uint8, sw-calibration-access=READ-ONLY, range raw 0..255}
              ImmediateNmTransmissionsOfChannelConfig: resulting-properties={base-type=uint8, sw-calibration-access=READ-ONLY, range raw 0..255}
              MsgCycleTimeOfChannelConfig: resulting-properties={base-type=uint8, sw-calibration-access=READ-ONLY, range raw 0..255}
              MsgTimeoutTimeOfChannelConfig: resulting-properties={base-type=uint8, sw-calibration-access=READ-ONLY, range raw 0..255}
              PduCbvPositionOfChannelConfig: resulting-properties={base-type=uint8, sw-calibration-access=READ-ONLY, range raw 0..255}
              PduNidPositionOfChannelConfig: resulting-properties={base-type=uint8, sw-calibration-access=READ-ONLY, range raw 0..255}
              RemoteSleepIndTimeOfChannelConfig: resulting-properties={base-type=uint8, sw-calibration-access=READ-ONLY, range raw 0..255}
              TimeoutTimeOfChannelConfig: resulting-properties={base-type=uint8, sw-calibration-access=READ-ONLY, range raw 0..255}
              WaitBusSleepTimeOfChannelConfig: resulting-properties={base-type=uint8, sw-calibration-access=READ-ONLY, range raw 0..255}
        CanNm_PbChannelConfig: array-size=2
          mc data instance Element_0: category=STRUCTURE, symbol=[0]
            22 x mc data instance, all with category=VALUE:
              PnEnabledOfPbChannelConfig: resulting-properties={base-type=boolean, sw-calibration-access=READ-ONLY, compu {0=FALSE, 1..255=TRUE}, range raw 0..1}
              MsgCycleOffsetOfPbChannelConfig: resulting-properties={base-type=uint8, sw-calibration-access=READ-ONLY, range raw 0..255}
              RxMessageDataEndIdxOfPbChannelConfig: resulting-properties={base-type=uint8, sw-calibration-access=READ-ONLY, compu {255=CANNM_NO_RXMESSAGEDATAENDIDXOFPBCHANNELCONFIG}, range raw 0..255}
              RxMessageDataLengthOfPbChannelConfig: resulting-properties={base-type=uint8, sw-calibration-access=READ-ONLY, range raw 0..255}
              RxMessageDataStartIdxOfPbChannelConfig: resulting-properties={base-type=uint8, sw-calibration-access=READ-ONLY, compu {255=CANNM_NO_RXMESSAGEDATASTARTIDXOFPBCHANNELCONFIG}, range raw 0..255}
              RxMessageData_CBVIdxOfPbChannelConfig: resulting-properties={base-type=uint8, sw-calibration-access=READ-ONLY, compu {255=CANNM_NO_RXMESSAGEDATA_CBVIDXOFPBCHANNELCONFIG}, range raw 0..255}
              RxMessageData_NIDIdxOfPbChannelConfig: resulting-properties={base-type=uint8, sw-calibration-access=READ-ONLY, compu {255=CANNM_NO_RXMESSAGEDATA_NIDIDXOFPBCHANNELCONFIG}, range raw 0..255}
              RxMessageData_UserDataEndIdxOfPbChannelConfig: resulting-properties={base-type=uint8, sw-calibration-access=READ-ONLY, compu {255=CANNM_NO_RXMESSAGEDATA_USERDATAENDIDXOFPBCHANNELCONFIG}, range raw 0..255}
              RxMessageData_UserDataLengthOfPbChannelConfig: resulting-properties={base-type=uint8, sw-calibration-access=READ-ONLY, range raw 0..255}
              RxMessageData_UserDataStartIdxOfPbChannelConfig: resulting-properties={base-type=uint8, sw-calibration-access=READ-ONLY, compu {255=CANNM_NO_RXMESSAGEDATA_USERDATASTARTIDXOFPBCHANNELCONFIG}, range raw 0..255}
              TxMessageDataEndIdxOfPbChannelConfig: resulting-properties={base-type=uint8, sw-calibration-access=READ-ONLY, compu {255=CANNM_NO_TXMESSAGEDATAENDIDXOFPBCHANNELCONFIG}, range raw 0..255}
              TxMessageDataLengthOfPbChannelConfig: resulting-properties={base-type=uint8, sw-calibration-access=READ-ONLY, range raw 0..255}
              TxMessageDataStartIdxOfPbChannelConfig: resulting-properties={base-type=uint8, sw-calibration-access=READ-ONLY, compu {255=CANNM_NO_TXMESSAGEDATASTARTIDXOFPBCHANNELCONFIG}, range raw 0..255}
              TxMessageData_CBVIdxOfPbChannelConfig: resulting-properties={base-type=uint8, sw-calibration-access=READ-ONLY, compu {255=CANNM_NO_TXMESSAGEDATA_CBVIDXOFPBCHANNELCONFIG}, range raw 0..255}
              TxMessageData_NIDIdxOfPbChannelConfig: resulting-properties={base-type=uint8, sw-calibration-access=READ-ONLY, compu {255=CANNM_NO_TXMESSAGEDATA_NIDIDXOFPBCHANNELCONFIG}, range raw 0..255}
              TxMessageData_PnFilterMaskEndIdxOfPbChannelConfig: resulting-properties={base-type=uint8, sw-calibration-access=READ-ONLY, compu {255=CANNM_NO_TXMESSAGEDATA_PNFILTERMASKENDIDXOFPBCHANNELCONFIG}, range raw 0..255}
              TxMessageData_PnFilterMaskStartIdxOfPbChannelConfig: resulting-properties={base-type=uint8, sw-calibration-access=READ-ONLY, compu {255=CANNM_NO_TXMESSAGEDATA_PNFILTERMASKSTARTIDXOFPBCHANNELCONFIG}, range raw 0..255}
              TxMessageData_UserDataEndIdxOfPbChannelConfig: resulting-properties={base-type=uint8, sw-calibration-access=READ-ONLY, compu {255=CANNM_NO_TXMESSAGEDATA_USERDATAENDIDXOFPBCHANNELCONFIG}, range raw 0..255}
              TxMessageData_UserDataLengthOfPbChannelConfig: resulting-properties={base-type=uint8, sw-calibration-access=READ-ONLY, range raw 0..255}
              TxMessageData_UserDataStartIdxOfPbChannelConfig: resulting-properties={base-type=uint8, sw-calibration-access=READ-ONLY, compu {255=CANNM_NO_TXMESSAGEDATA_USERDATASTARTIDXOFPBCHANNELCONFIG}, range raw 0..255}
              TxPduIdOfPbChannelConfig: resulting-properties={base-type=uint8, sw-calibration-access=READ-ONLY, compu {255=CANNM_NO_TXPDUIDOFPBCHANNELCONFIG}, range raw 0..255}
              TxUserDataPduIdOfPbChannelConfig: resulting-properties={base-type=uint8, sw-calibration-access=READ-ONLY, compu {255=CANNM_NO_TXUSERDATAPDUIDOFPBCHANNELCONFIG}, range raw 0..255}
          mc data instance Element_1: category=STRUCTURE, symbol=[1]
            22 x mc data instance, all with category=VALUE:
              PnEnabledOfPbChannelConfig: resulting-properties={base-type=boolean, sw-calibration-access=READ-ONLY, compu {0=FALSE, 1..255=TRUE}, range raw 0..1}
              MsgCycleOffsetOfPbChannelConfig: resulting-properties={base-type=uint8, sw-calibration-access=READ-ONLY, range raw 0..255}
              RxMessageDataEndIdxOfPbChannelConfig: resulting-properties={base-type=uint8, sw-calibration-access=READ-ONLY, compu {255=CANNM_NO_RXMESSAGEDATAENDIDXOFPBCHANNELCONFIG}, range raw 0..255}
              RxMessageDataLengthOfPbChannelConfig: resulting-properties={base-type=uint8, sw-calibration-access=READ-ONLY, range raw 0..255}
              RxMessageDataStartIdxOfPbChannelConfig: resulting-properties={base-type=uint8, sw-calibration-access=READ-ONLY, compu {255=CANNM_NO_RXMESSAGEDATASTARTIDXOFPBCHANNELCONFIG}, range raw 0..255}
              RxMessageData_CBVIdxOfPbChannelConfig: resulting-properties={base-type=uint8, sw-calibration-access=READ-ONLY, compu {255=CANNM_NO_RXMESSAGEDATA_CBVIDXOFPBCHANNELCONFIG}, range raw 0..255}
              RxMessageData_NIDIdxOfPbChannelConfig: resulting-properties={base-type=uint8, sw-calibration-access=READ-ONLY, compu {255=CANNM_NO_RXMESSAGEDATA_NIDIDXOFPBCHANNELCONFIG}, range raw 0..255}
              RxMessageData_UserDataEndIdxOfPbChannelConfig: resulting-properties={base-type=uint8, sw-calibration-access=READ-ONLY, compu {255=CANNM_NO_RXMESSAGEDATA_USERDATAENDIDXOFPBCHANNELCONFIG}, range raw 0..255}
              RxMessageData_UserDataLengthOfPbChannelConfig: resulting-properties={base-type=uint8, sw-calibration-access=READ-ONLY, range raw 0..255}
              RxMessageData_UserDataStartIdxOfPbChannelConfig: resulting-properties={base-type=uint8, sw-calibration-access=READ-ONLY, compu {255=CANNM_NO_RXMESSAGEDATA_USERDATASTARTIDXOFPBCHANNELCONFIG}, range raw 0..255}
              TxMessageDataEndIdxOfPbChannelConfig: resulting-properties={base-type=uint8, sw-calibration-access=READ-ONLY, compu {255=CANNM_NO_TXMESSAGEDATAENDIDXOFPBCHANNELCONFIG}, range raw 0..255}
              TxMessageDataLengthOfPbChannelConfig: resulting-properties={base-type=uint8, sw-calibration-access=READ-ONLY, range raw 0..255}
              TxMessageDataStartIdxOfPbChannelConfig: resulting-properties={base-type=uint8, sw-calibration-access=READ-ONLY, compu {255=CANNM_NO_TXMESSAGEDATASTARTIDXOFPBCHANNELCONFIG}, range raw 0..255}
              TxMessageData_CBVIdxOfPbChannelConfig: resulting-properties={base-type=uint8, sw-calibration-access=READ-ONLY, compu {255=CANNM_NO_TXMESSAGEDATA_CBVIDXOFPBCHANNELCONFIG}, range raw 0..255}
              TxMessageData_NIDIdxOfPbChannelConfig: resulting-properties={base-type=uint8, sw-calibration-access=READ-ONLY, compu {255=CANNM_NO_TXMESSAGEDATA_NIDIDXOFPBCHANNELCONFIG}, range raw 0..255}
              TxMessageData_PnFilterMaskEndIdxOfPbChannelConfig: resulting-properties={base-type=uint8, sw-calibration-access=READ-ONLY, compu {255=CANNM_NO_TXMESSAGEDATA_PNFILTERMASKENDIDXOFPBCHANNELCONFIG}, range raw 0..255}
              TxMessageData_PnFilterMaskStartIdxOfPbChannelConfig: resulting-properties={base-type=uint8, sw-calibration-access=READ-ONLY, compu {255=CANNM_NO_TXMESSAGEDATA_PNFILTERMASKSTARTIDXOFPBCHANNELCONFIG}, range raw 0..255}
              TxMessageData_UserDataEndIdxOfPbChannelConfig: resulting-properties={base-type=uint8, sw-calibration-access=READ-ONLY, compu {255=CANNM_NO_TXMESSAGEDATA_USERDATAENDIDXOFPBCHANNELCONFIG}, range raw 0..255}
              TxMessageData_UserDataLengthOfPbChannelConfig: resulting-properties={base-type=uint8, sw-calibration-access=READ-ONLY, range raw 0..255}
              TxMessageData_UserDataStartIdxOfPbChannelConfig: resulting-properties={base-type=uint8, sw-calibration-access=READ-ONLY, compu {255=CANNM_NO_TXMESSAGEDATA_USERDATASTARTIDXOFPBCHANNELCONFIG}, range raw 0..255}
              TxPduIdOfPbChannelConfig: resulting-properties={base-type=uint8, sw-calibration-access=READ-ONLY, compu {255=CANNM_NO_TXPDUIDOFPBCHANNELCONFIG}, range raw 0..255}
              TxUserDataPduIdOfPbChannelConfig: resulting-properties={base-type=uint8, sw-calibration-access=READ-ONLY, compu {255=CANNM_NO_TXUSERDATAPDUIDOFPBCHANNELCONFIG}, range raw 0..255}
        CanNm_PnInfoByteConfig: array-size=7
          7 x mc data instance, all with category=STRUCTURE:
            Element_0: symbol=[0]
              mc data instance PnClusterResetTimerEndIdxOfPnInfoByteConfig: category=VALUE, resulting-properties={base-type=uint8, sw-calibration-access=READ-ONLY, compu {255=CANNM_NO_PNCLUSTERRESETTIMERENDIDXOFPNINFOBYTECONFIG}, range raw 0..255}
              mc data instance PnClusterResetTimerStartIdxOfPnInfoByteConfig: category=VALUE, resulting-properties={base-type=uint8, sw-calibration-access=READ-ONLY, compu {255=CANNM_NO_PNCLUSTERRESETTIMERSTARTIDXOFPNINFOBYTECONFIG}, range raw 0..255}
              mc data instance PnFilterMaskOfPnInfoByteConfig: category=VALUE, resulting-properties={base-type=uint8, sw-calibration-access=READ-ONLY, range raw 0..255}
            Element_1: symbol=[1]
              mc data instance PnClusterResetTimerEndIdxOfPnInfoByteConfig: category=VALUE, resulting-properties={base-type=uint8, sw-calibration-access=READ-ONLY, compu {255=CANNM_NO_PNCLUSTERRESETTIMERENDIDXOFPNINFOBYTECONFIG}, range raw 0..255}
              mc data instance PnClusterResetTimerStartIdxOfPnInfoByteConfig: category=VALUE, resulting-properties={base-type=uint8, sw-calibration-access=READ-ONLY, compu {255=CANNM_NO_PNCLUSTERRESETTIMERSTARTIDXOFPNINFOBYTECONFIG}, range raw 0..255}
              mc data instance PnFilterMaskOfPnInfoByteConfig: category=VALUE, resulting-properties={base-type=uint8, sw-calibration-access=READ-ONLY, range raw 0..255}
            Element_2: symbol=[2]
              mc data instance PnClusterResetTimerEndIdxOfPnInfoByteConfig: category=VALUE, resulting-properties={base-type=uint8, sw-calibration-access=READ-ONLY, compu {255=CANNM_NO_PNCLUSTERRESETTIMERENDIDXOFPNINFOBYTECONFIG}, range raw 0..255}
              mc data instance PnClusterResetTimerStartIdxOfPnInfoByteConfig: category=VALUE, resulting-properties={base-type=uint8, sw-calibration-access=READ-ONLY, compu {255=CANNM_NO_PNCLUSTERRESETTIMERSTARTIDXOFPNINFOBYTECONFIG}, range raw 0..255}
              mc data instance PnFilterMaskOfPnInfoByteConfig: category=VALUE, resulting-properties={base-type=uint8, sw-calibration-access=READ-ONLY, range raw 0..255}
            Element_3: symbol=[3]
              mc data instance PnClusterResetTimerEndIdxOfPnInfoByteConfig: category=VALUE, resulting-properties={base-type=uint8, sw-calibration-access=READ-ONLY, compu {255=CANNM_NO_PNCLUSTERRESETTIMERENDIDXOFPNINFOBYTECONFIG}, range raw 0..255}
              mc data instance PnClusterResetTimerStartIdxOfPnInfoByteConfig: category=VALUE, resulting-properties={base-type=uint8, sw-calibration-access=READ-ONLY, compu {255=CANNM_NO_PNCLUSTERRESETTIMERSTARTIDXOFPNINFOBYTECONFIG}, range raw 0..255}
              mc data instance PnFilterMaskOfPnInfoByteConfig: category=VALUE, resulting-properties={base-type=uint8, sw-calibration-access=READ-ONLY, range raw 0..255}
            Element_4: symbol=[4]
              mc data instance PnClusterResetTimerEndIdxOfPnInfoByteConfig: category=VALUE, resulting-properties={base-type=uint8, sw-calibration-access=READ-ONLY, compu {255=CANNM_NO_PNCLUSTERRESETTIMERENDIDXOFPNINFOBYTECONFIG}, range raw 0..255}
              mc data instance PnClusterResetTimerStartIdxOfPnInfoByteConfig: category=VALUE, resulting-properties={base-type=uint8, sw-calibration-access=READ-ONLY, compu {255=CANNM_NO_PNCLUSTERRESETTIMERSTARTIDXOFPNINFOBYTECONFIG}, range raw 0..255}
              mc data instance PnFilterMaskOfPnInfoByteConfig: category=VALUE, resulting-properties={base-type=uint8, sw-calibration-access=READ-ONLY, range raw 0..255}
            Element_5: symbol=[5]
              mc data instance PnClusterResetTimerEndIdxOfPnInfoByteConfig: category=VALUE, resulting-properties={base-type=uint8, sw-calibration-access=READ-ONLY, compu {255=CANNM_NO_PNCLUSTERRESETTIMERENDIDXOFPNINFOBYTECONFIG}, range raw 0..255}
              mc data instance PnClusterResetTimerStartIdxOfPnInfoByteConfig: category=VALUE, resulting-properties={base-type=uint8, sw-calibration-access=READ-ONLY, compu {255=CANNM_NO_PNCLUSTERRESETTIMERSTARTIDXOFPNINFOBYTECONFIG}, range raw 0..255}
              mc data instance PnFilterMaskOfPnInfoByteConfig: category=VALUE, resulting-properties={base-type=uint8, sw-calibration-access=READ-ONLY, range raw 0..255}
            Element_6: symbol=[6]
              mc data instance PnClusterResetTimerEndIdxOfPnInfoByteConfig: category=VALUE, resulting-properties={base-type=uint8, sw-calibration-access=READ-ONLY, compu {255=CANNM_NO_PNCLUSTERRESETTIMERENDIDXOFPNINFOBYTECONFIG}, range raw 0..255}
              mc data instance PnClusterResetTimerStartIdxOfPnInfoByteConfig: category=VALUE, resulting-properties={base-type=uint8, sw-calibration-access=READ-ONLY, compu {255=CANNM_NO_PNCLUSTERRESETTIMERSTARTIDXOFPNINFOBYTECONFIG}, range raw 0..255}
              mc data instance PnFilterMaskOfPnInfoByteConfig: category=VALUE, resulting-properties={base-type=uint8, sw-calibration-access=READ-ONLY, range raw 0..255}
        CanNm_SysToNmChInd: array-size=2, resulting-properties={base-type=uint8, sw-calibration-access=READ-ONLY, compu {255=CANNM_NO_SYSTONMCHIND}, range raw 0..255}  # Channel indirection: System Channel handle to NM channel handle
        CanNm_TxMessageData: array-size=32, resulting-properties={base-type=uint8, sw-calibration-access=READ-ONLY, range raw 0..255}
        CanNm_RxMessageData: array-size=32, resulting-properties={base-type=uint8, sw-calibration-access=READ-ONLY, range raw 0..255}
        CanNm_TimeoutTimer: array-size=2, resulting-properties={base-type=uint16, sw-calibration-access=READ-ONLY, range raw 0..65535}, symbol=CanNm_TimeoutTimer.raw  # Timer for NM Algorithm.
        CanNm_TimeoutTimer_CN_BMC_CAN01_78a85e89: array-size=1, resulting-properties={base-type=uint16, sw-calibration-access=READ-ONLY, range raw 0..65535}, symbol=CanNm_TimeoutTimer.raw[0]  # The element: CN_BMC_CAN01_78a85e89 of CanNm_TimeoutTimer
        CanNm_TimeoutTimer_CN_HCP5_CANFD01_54d90215: array-size=1, resulting-properties={base-type=uint16, sw-calibration-access=READ-ONLY, range raw 0..65535}, symbol=CanNm_TimeoutTimer.raw[1]  # The element: CN_HCP5_CANFD01_54d90215 of CanNm_TimeoutTimer
        CanNm_WaitBusSleepTimer: array-size=2, resulting-properties={base-type=uint16, sw-calibration-access=READ-ONLY, range raw 0..65535}, symbol=CanNm_WaitBusSleepTimer.raw
        CanNm_WaitBusSleepTimer_CN_BMC_CAN01_78a85e89: array-size=1, resulting-properties={base-type=uint16, sw-calibration-access=READ-ONLY, range raw 0..65535}, symbol=CanNm_WaitBusSleepTimer.raw[0]  # The element: CN_BMC_CAN01_78a85e89 of CanNm_WaitBusSleepTimer
        CanNm_WaitBusSleepTimer_CN_HCP5_CANFD01_54d90215: array-size=1, resulting-properties={base-type=uint16, sw-calibration-access=READ-ONLY, range raw 0..65535}, symbol=CanNm_WaitBusSleepTimer.raw[1]  # The element: CN_HCP5_CANFD01_54d90215 of CanNm_WaitBusSleepTimer
        CanNm_RepeatMsgTimer: array-size=2, resulting-properties={base-type=uint16, sw-calibration-access=READ-ONLY, range raw 0..65535}, symbol=CanNm_RepeatMsgTimer.raw
        CanNm_RepeatMsgTimer_CN_BMC_CAN01_78a85e89: array-size=1, resulting-properties={base-type=uint16, sw-calibration-access=READ-ONLY, range raw 0..65535}, symbol=CanNm_RepeatMsgTimer.raw[0]  # The element: CN_BMC_CAN01_78a85e89 of CanNm_RepeatMsgTimer
        CanNm_RepeatMsgTimer_CN_HCP5_CANFD01_54d90215: array-size=1, resulting-properties={base-type=uint16, sw-calibration-access=READ-ONLY, range raw 0..65535}, symbol=CanNm_RepeatMsgTimer.raw[1]  # The element: CN_HCP5_CANFD01_54d90215 of CanNm_RepeatMsgTimer
        CanNm_MsgTimer: array-size=2, resulting-properties={base-type=uint16, sw-calibration-access=READ-ONLY, range raw 0..65535}, symbol=CanNm_MsgTimer.raw  # Timer for NM message transmission.
        CanNm_MsgTimer_CN_BMC_CAN01_78a85e89: array-size=1, resulting-properties={base-type=uint16, sw-calibration-access=READ-ONLY, range raw 0..65535}, symbol=CanNm_MsgTimer.raw[0]  # The element: CN_BMC_CAN01_78a85e89 of CanNm_MsgTimer
        CanNm_MsgTimer_CN_HCP5_CANFD01_54d90215: array-size=1, resulting-properties={base-type=uint16, sw-calibration-access=READ-ONLY, range raw 0..65535}, symbol=CanNm_MsgTimer.raw[1]  # The element: CN_HCP5_CANFD01_54d90215 of CanNm_MsgTimer
        CanNm_MsgTimeoutTimer: array-size=2, resulting-properties={base-type=uint16, sw-calibration-access=READ-ONLY, range raw 0..65535}, symbol=CanNm_MsgTimeoutTimer.raw
        CanNm_MsgTimeoutTimer_CN_BMC_CAN01_78a85e89: array-size=1, resulting-properties={base-type=uint16, sw-calibration-access=READ-ONLY, range raw 0..65535}, symbol=CanNm_MsgTimeoutTimer.raw[0]  # The element: CN_BMC_CAN01_78a85e89 of CanNm_MsgTimeoutTimer
        CanNm_MsgTimeoutTimer_CN_HCP5_CANFD01_54d90215: array-size=1, resulting-properties={base-type=uint16, sw-calibration-access=READ-ONLY, range raw 0..65535}, symbol=CanNm_MsgTimeoutTimer.raw[1]  # The element: CN_HCP5_CANFD01_54d90215 of CanNm_MsgTimeoutTimer
        CanNm_NmState: array-size=2, resulting-properties={base-type=uint8, sw-calibration-access=READ-ONLY, range raw 0..255}, symbol=CanNm_NmState.raw  # Current state of the state machine
        CanNm_NmState_CN_BMC_CAN01_78a85e89: array-size=1, resulting-properties={base-type=uint8, sw-calibration-access=READ-ONLY, range raw 0..255}, symbol=CanNm_NmState.raw[0]  # The element: CN_BMC_CAN01_78a85e89 of CanNm_NmState
        CanNm_NmState_CN_HCP5_CANFD01_54d90215: array-size=1, resulting-properties={base-type=uint8, sw-calibration-access=READ-ONLY, range raw 0..255}, symbol=CanNm_NmState.raw[1]  # The element: CN_HCP5_CANFD01_54d90215 of CanNm_NmState
        CanNm_MsgRequest: array-size=2, resulting-properties={base-type=uint8, sw-calibration-access=READ-ONLY, range raw 0..255}, symbol=CanNm_MsgRequest.raw  # Internal Message Request Variable
        CanNm_MsgRequest_CN_BMC_CAN01_78a85e89: array-size=1, resulting-properties={base-type=uint8, sw-calibration-access=READ-ONLY, range raw 0..255}, symbol=CanNm_MsgRequest.raw[0]  # The element: CN_BMC_CAN01_78a85e89 of CanNm_MsgRequest
        CanNm_MsgRequest_CN_HCP5_CANFD01_54d90215: array-size=1, resulting-properties={base-type=uint8, sw-calibration-access=READ-ONLY, range raw 0..255}, symbol=CanNm_MsgRequest.raw[1]  # The element: CN_HCP5_CANFD01_54d90215 of CanNm_MsgRequest
        CanNm_CommState: array-size=2, resulting-properties={base-type=uint8, sw-calibration-access=READ-ONLY, range raw 0..255}, symbol=CanNm_CommState.raw  # Internal state for the application's need for communication.
        CanNm_CommState_CN_BMC_CAN01_78a85e89: array-size=1, resulting-properties={base-type=uint8, sw-calibration-access=READ-ONLY, range raw 0..255}, symbol=CanNm_CommState.raw[0]  # The element: CN_BMC_CAN01_78a85e89 of CanNm_CommState
        CanNm_CommState_CN_HCP5_CANFD01_54d90215: array-size=1, resulting-properties={base-type=uint8, sw-calibration-access=READ-ONLY, range raw 0..255}, symbol=CanNm_CommState.raw[1]  # The element: CN_HCP5_CANFD01_54d90215 of CanNm_CommState
        CanNm_NetworkRestartFlag: array-size=2, resulting-properties={base-type=uint8, sw-calibration-access=READ-ONLY, range raw 0..255}, symbol=CanNm_NetworkRestartFlag.raw
        CanNm_NetworkRestartFlag_CN_BMC_CAN01_78a85e89: array-size=1, resulting-properties={base-type=uint8, sw-calibration-access=READ-ONLY, range raw 0..255}, symbol=CanNm_NetworkRestartFlag.raw[0]  # The element: CN_BMC_CAN01_78a85e89 of CanNm_NetworkRestartFlag
        CanNm_NetworkRestartFlag_CN_HCP5_CANFD01_54d90215: array-size=1, resulting-properties={base-type=uint8, sw-calibration-access=READ-ONLY, range raw 0..255}, symbol=CanNm_NetworkRestartFlag.raw[1]  # The element: CN_HCP5_CANFD01_54d90215 of CanNm_NetworkRestartFlag
        CanNm_ImmediateNmMsgCount: array-size=2, resulting-properties={base-type=uint8, sw-calibration-access=READ-ONLY, range raw 0..255}, symbol=CanNm_ImmediateNmMsgCount.raw
        CanNm_ImmediateNmMsgCount_CN_BMC_CAN01_78a85e89: array-size=1, resulting-properties={base-type=uint8, sw-calibration-access=READ-ONLY, range raw 0..255}, symbol=CanNm_ImmediateNmMsgCount.raw[0]  # The element: CN_BMC_CAN01_78a85e89 of CanNm_ImmediateNmMsgCount
        CanNm_ImmediateNmMsgCount_CN_HCP5_CANFD01_54d90215: array-size=1, resulting-properties={base-type=uint8, sw-calibration-access=READ-ONLY, range raw 0..255}, symbol=CanNm_ImmediateNmMsgCount.raw[1]  # The element: CN_HCP5_CANFD01_54d90215 of CanNm_ImmediateNmMsgCount
        CanNm_TxControlStateRequest: array-size=2, resulting-properties={base-type=uint8, sw-calibration-access=READ-ONLY, range raw 0..255}, symbol=CanNm_TxControlStateRequest.raw  # Message transmission control state request.
        CanNm_TxControlStateRequest_CN_BMC_CAN01_78a85e89: array-size=1, resulting-properties={base-type=uint8, sw-calibration-access=READ-ONLY, range raw 0..255}, symbol=CanNm_TxControlStateRequest.raw[0]  # The element: CN_BMC_CAN01_78a85e89 of CanNm_TxControlStateRequest
        CanNm_TxControlStateRequest_CN_HCP5_CANFD01_54d90215: array-size=1, resulting-properties={base-type=uint8, sw-calibration-access=READ-ONLY, range raw 0..255}, symbol=CanNm_TxControlStateRequest.raw[1]  # The element: CN_HCP5_CANFD01_54d90215 of CanNm_TxControlStateRequest
        CanNm_TxControlState: array-size=2, resulting-properties={base-type=uint8, sw-calibration-access=READ-ONLY, range raw 0..255}, symbol=CanNm_TxControlState.raw  # Message transmission control state.
        CanNm_TxControlState_CN_BMC_CAN01_78a85e89: array-size=1, resulting-properties={base-type=uint8, sw-calibration-access=READ-ONLY, range raw 0..255}, symbol=CanNm_TxControlState.raw[0]  # The element: CN_BMC_CAN01_78a85e89 of CanNm_TxControlState
        CanNm_TxControlState_CN_HCP5_CANFD01_54d90215: array-size=1, resulting-properties={base-type=uint8, sw-calibration-access=READ-ONLY, range raw 0..255}, symbol=CanNm_TxControlState.raw[1]  # The element: CN_HCP5_CANFD01_54d90215 of CanNm_TxControlState
        CanNm_CoordReadyToSleepState: array-size=2, resulting-properties={base-type=uint8, sw-calibration-access=READ-ONLY, range raw 0..255}, symbol=CanNm_CoordReadyToSleepState.raw  # State for Rx of Coordinator Sleep Ready Bit:
        CanNm_CoordReadyToSleepState_CN_BMC_CAN01_78a85e89: array-size=1, resulting-properties={base-type=uint8, sw-calibration-access=READ-ONLY, range raw 0..255}, symbol=CanNm_CoordReadyToSleepState.raw[0]  # The element: CN_BMC_CAN01_78a85e89 of CanNm_CoordReadyToSleepState
        CanNm_CoordReadyToSleepState_CN_HCP5_CANFD01_54d90215: array-size=1, resulting-properties={base-type=uint8, sw-calibration-access=READ-ONLY, range raw 0..255}, symbol=CanNm_CoordReadyToSleepState.raw[1]  # The element: CN_HCP5_CANFD01_54d90215 of CanNm_CoordReadyToSleepState
        CanNm_PnMessageFilterEnabled: array-size=2, resulting-properties={base-type=boolean, sw-calibration-access=READ-ONLY, compu {0=FALSE, 1..255=TRUE}, range raw 0..1}, symbol=CanNm_PnMessageFilterEnabled.raw  # Partial Networking: Message Reception Filter is enabled.
        CanNm_PnMessageFilterEnabled_CN_BMC_CAN01_78a85e89: array-size=1, resulting-properties={base-type=boolean, sw-calibration-access=READ-ONLY, compu {0=FALSE, 1..255=TRUE}, range raw 0..1}, symbol=CanNm_PnMessageFilterEnabled.raw[0]  # The element: CN_BMC_CAN01_78a85e89 of CanNm_PnMessageFilterEnabled
        CanNm_PnMessageFilterEnabled_CN_HCP5_CANFD01_54d90215: array-size=1, resulting-properties={base-type=boolean, sw-calibration-access=READ-ONLY, compu {0=FALSE, 1..255=TRUE}, range raw 0..1}, symbol=CanNm_PnMessageFilterEnabled.raw[1]  # The element: CN_HCP5_CANFD01_54d90215 of CanNm_PnMessageFilterEnabled
        CanNm_PnMessageFilterDeactivationIndicated: array-size=2, resulting-properties={base-type=boolean, sw-calibration-access=READ-ONLY, compu {0=FALSE, 1..255=TRUE}, range raw 0..1}, symbol=CanNm_PnMessageFilterDeactivationIndicated.raw  # Partial Networking: Message Reception Filter shall be disabled.
        CanNm_PnMessageFilterDeactivationIndicated_CN_BMC_CAN01_78a85e89: array-size=1, resulting-properties={base-type=boolean, sw-calibration-access=READ-ONLY, compu {0=FALSE, 1..255=TRUE}, range raw 0..1}, symbol=CanNm_PnMessageFilterDeactivationIndicated.raw[0]  # The element: CN_BMC_CAN01_78a85e89 of CanNm_PnMessageFilterDeactivationIndicated
        CanNm_PnMessageFilterDeactivationIndicated_CN_HCP5_CANFD01_54d90215: array-size=1, resulting-properties={base-type=boolean, sw-calibration-access=READ-ONLY, compu {0=FALSE, 1..255=TRUE}, range raw 0..1}, symbol=CanNm_PnMessageFilterDeactivationIndicated.raw[1]  # The element: CN_HCP5_CANFD01_54d90215 of CanNm_PnMessageFilterDeactivationIndicated
        CanNm_MsgIndicationFlag: array-size=2, resulting-properties={base-type=boolean, sw-calibration-access=READ-ONLY, compu {0=FALSE, 1..255=TRUE}, range raw 0..1}, symbol=CanNm_MsgIndicationFlag.raw  # Message Indication Flag
        CanNm_MsgIndicationFlag_CN_BMC_CAN01_78a85e89: array-size=1, resulting-properties={base-type=boolean, sw-calibration-access=READ-ONLY, compu {0=FALSE, 1..255=TRUE}, range raw 0..1}, symbol=CanNm_MsgIndicationFlag.raw[0]  # The element: CN_BMC_CAN01_78a85e89 of CanNm_MsgIndicationFlag
        CanNm_MsgIndicationFlag_CN_HCP5_CANFD01_54d90215: array-size=1, resulting-properties={base-type=boolean, sw-calibration-access=READ-ONLY, compu {0=FALSE, 1..255=TRUE}, range raw 0..1}, symbol=CanNm_MsgIndicationFlag.raw[1]  # The element: CN_HCP5_CANFD01_54d90215 of CanNm_MsgIndicationFlag
        CanNm_MsgConfirmationFlag: array-size=2, resulting-properties={base-type=boolean, sw-calibration-access=READ-ONLY, compu {0=FALSE, 1..255=TRUE}, range raw 0..1}, symbol=CanNm_MsgConfirmationFlag.raw  # Message Confirmation Flag
        CanNm_MsgConfirmationFlag_CN_BMC_CAN01_78a85e89: array-size=1, resulting-properties={base-type=boolean, sw-calibration-access=READ-ONLY, compu {0=FALSE, 1..255=TRUE}, range raw 0..1}, symbol=CanNm_MsgConfirmationFlag.raw[0]  # The element: CN_BMC_CAN01_78a85e89 of CanNm_MsgConfirmationFlag
        CanNm_MsgConfirmationFlag_CN_HCP5_CANFD01_54d90215: array-size=1, resulting-properties={base-type=boolean, sw-calibration-access=READ-ONLY, compu {0=FALSE, 1..255=TRUE}, range raw 0..1}, symbol=CanNm_MsgConfirmationFlag.raw[1]  # The element: CN_HCP5_CANFD01_54d90215 of CanNm_MsgConfirmationFlag
        CanNm_PnClusterReq: array-size=7, resulting-properties={base-type=uint8, sw-calibration-access=READ-ONLY, range raw 0..255}, symbol=CanNm_PnClusterReq.raw  # Internal Cluster Request Buffer
        CanNm_PnClusterReq_CanNmPnFilterMaskByte_2: array-size=1, resulting-properties={base-type=uint8, sw-calibration-access=READ-ONLY, range raw 0..255}, symbol=CanNm_PnClusterReq.raw[0]  # The element: CanNmPnFilterMaskByte_2 of CanNm_PnClusterReq
        CanNm_PnClusterReq_CanNmPnFilterMaskByte_3: array-size=1, resulting-properties={base-type=uint8, sw-calibration-access=READ-ONLY, range raw 0..255}, symbol=CanNm_PnClusterReq.raw[1]  # The element: CanNmPnFilterMaskByte_3 of CanNm_PnClusterReq
        CanNm_PnClusterReq_CanNmPnFilterMaskByte_4: array-size=1, resulting-properties={base-type=uint8, sw-calibration-access=READ-ONLY, range raw 0..255}, symbol=CanNm_PnClusterReq.raw[2]  # The element: CanNmPnFilterMaskByte_4 of CanNm_PnClusterReq
        CanNm_PnClusterReq_CanNmPnFilterMaskByte_5: array-size=1, resulting-properties={base-type=uint8, sw-calibration-access=READ-ONLY, range raw 0..255}, symbol=CanNm_PnClusterReq.raw[3]  # The element: CanNmPnFilterMaskByte_5 of CanNm_PnClusterReq
        CanNm_PnClusterReq_CanNmPnFilterMaskByte_0: array-size=1, resulting-properties={base-type=uint8, sw-calibration-access=READ-ONLY, range raw 0..255}, symbol=CanNm_PnClusterReq.raw[4]  # The element: CanNmPnFilterMaskByte_0 of CanNm_PnClusterReq
        CanNm_PnClusterReq_CanNmPnFilterMaskByte_1: array-size=1, resulting-properties={base-type=uint8, sw-calibration-access=READ-ONLY, range raw 0..255}, symbol=CanNm_PnClusterReq.raw[5]  # The element: CanNmPnFilterMaskByte_1 of CanNm_PnClusterReq
        CanNm_PnClusterReq_CanNmPnFilterMaskByte_6: array-size=1, resulting-properties={base-type=uint8, sw-calibration-access=READ-ONLY, range raw 0..255}, symbol=CanNm_PnClusterReq.raw[6]  # The element: CanNmPnFilterMaskByte_6 of CanNm_PnClusterReq
        CanNm_PnClusterReqNew: array-size=7, resulting-properties={base-type=uint8, sw-calibration-access=READ-ONLY, range raw 0..255}, symbol=CanNm_PnClusterReqNew.raw  # Internal Cluster Request Buffer
        CanNm_PnClusterReqNew_CanNmPnFilterMaskByte_2: array-size=1, resulting-properties={base-type=uint8, sw-calibration-access=READ-ONLY, range raw 0..255}, symbol=CanNm_PnClusterReqNew.raw[0]  # The element: CanNmPnFilterMaskByte_2 of CanNm_PnClusterReqNew
        CanNm_PnClusterReqNew_CanNmPnFilterMaskByte_3: array-size=1, resulting-properties={base-type=uint8, sw-calibration-access=READ-ONLY, range raw 0..255}, symbol=CanNm_PnClusterReqNew.raw[1]  # The element: CanNmPnFilterMaskByte_3 of CanNm_PnClusterReqNew
        CanNm_PnClusterReqNew_CanNmPnFilterMaskByte_4: array-size=1, resulting-properties={base-type=uint8, sw-calibration-access=READ-ONLY, range raw 0..255}, symbol=CanNm_PnClusterReqNew.raw[2]  # The element: CanNmPnFilterMaskByte_4 of CanNm_PnClusterReqNew
        CanNm_PnClusterReqNew_CanNmPnFilterMaskByte_5: array-size=1, resulting-properties={base-type=uint8, sw-calibration-access=READ-ONLY, range raw 0..255}, symbol=CanNm_PnClusterReqNew.raw[3]  # The element: CanNmPnFilterMaskByte_5 of CanNm_PnClusterReqNew
        CanNm_PnClusterReqNew_CanNmPnFilterMaskByte_0: array-size=1, resulting-properties={base-type=uint8, sw-calibration-access=READ-ONLY, range raw 0..255}, symbol=CanNm_PnClusterReqNew.raw[4]  # The element: CanNmPnFilterMaskByte_0 of CanNm_PnClusterReqNew
        CanNm_PnClusterReqNew_CanNmPnFilterMaskByte_1: array-size=1, resulting-properties={base-type=uint8, sw-calibration-access=READ-ONLY, range raw 0..255}, symbol=CanNm_PnClusterReqNew.raw[5]  # The element: CanNmPnFilterMaskByte_1 of CanNm_PnClusterReqNew
        CanNm_PnClusterReqNew_CanNmPnFilterMaskByte_6: array-size=1, resulting-properties={base-type=uint8, sw-calibration-access=READ-ONLY, range raw 0..255}, symbol=CanNm_PnClusterReqNew.raw[6]  # The element: CanNmPnFilterMaskByte_6 of CanNm_PnClusterReqNew
        CanNm_PnClusterResetTimer: array-size=56, resulting-properties={base-type=uint16, sw-calibration-access=READ-ONLY, range raw 0..65535}, symbol=CanNm_PnClusterResetTimer.raw  # Pn Cluster Reset Timer
        CanNm_PnClusterResetTimer_CanNmPnFilterMaskByte_2: array-size=8, resulting-properties={base-type=uint16, sw-calibration-access=READ-ONLY, range raw 0..65535}, symbol=CanNm_PnClusterResetTimer.raw[0]  # The element: CanNmPnFilterMaskByte_2 of CanNm_PnClusterResetTimer
        CanNm_PnClusterResetTimer_CanNmPnFilterMaskByte_3: array-size=8, resulting-properties={base-type=uint16, sw-calibration-access=READ-ONLY, range raw 0..65535}, symbol=CanNm_PnClusterResetTimer.raw[8]  # The element: CanNmPnFilterMaskByte_3 of CanNm_PnClusterResetTimer
        CanNm_PnClusterResetTimer_CanNmPnFilterMaskByte_4: array-size=8, resulting-properties={base-type=uint16, sw-calibration-access=READ-ONLY, range raw 0..65535}, symbol=CanNm_PnClusterResetTimer.raw[16]  # The element: CanNmPnFilterMaskByte_4 of CanNm_PnClusterResetTimer
        CanNm_PnClusterResetTimer_CanNmPnFilterMaskByte_5: array-size=8, resulting-properties={base-type=uint16, sw-calibration-access=READ-ONLY, range raw 0..65535}, symbol=CanNm_PnClusterResetTimer.raw[24]  # The element: CanNmPnFilterMaskByte_5 of CanNm_PnClusterResetTimer
        CanNm_PnClusterResetTimer_CanNmPnFilterMaskByte_0: array-size=8, resulting-properties={base-type=uint16, sw-calibration-access=READ-ONLY, range raw 0..65535}, symbol=CanNm_PnClusterResetTimer.raw[32]  # The element: CanNmPnFilterMaskByte_0 of CanNm_PnClusterResetTimer
        CanNm_PnClusterResetTimer_CanNmPnFilterMaskByte_1: array-size=8, resulting-properties={base-type=uint16, sw-calibration-access=READ-ONLY, range raw 0..65535}, symbol=CanNm_PnClusterResetTimer.raw[40]  # The element: CanNmPnFilterMaskByte_1 of CanNm_PnClusterResetTimer
        CanNm_PnClusterResetTimer_CanNmPnFilterMaskByte_6: array-size=8, resulting-properties={base-type=uint16, sw-calibration-access=READ-ONLY, range raw 0..65535}, symbol=CanNm_PnClusterResetTimer.raw[48]  # The element: CanNmPnFilterMaskByte_6 of CanNm_PnClusterResetTimer
package /MICROSAR/CanNm_ib_bswmd/BswModuleDescriptions
  bsw module description CanNm: provided-entrys=CanNm_MainFunction
    bsw internal behavior CanNmBehavior
      8 x exclusive area:
        CANNM_EXCLUSIVE_AREA_0  # No interruption by any interrupt allowed (i.e. global interrupt locks).
        CANNM_EXCLUSIVE_AREA_1  # No interruption of CanNm_MainFunction or CanNm_RequestBusSynchronization by CanNm_SetUserData or CanNm_SetSleepReadyBit allowed.
        CANNM_EXCLUSIVE_AREA_2  # No interruption of CanNm_SetUserData by CanNm_MainFunction or CanNm_RequestBusSynchronization allowed.
        CANNM_EXCLUSIVE_AREA_3  # No interruption of CanNm_SetSleepReadyBit by CanNm_MainFunction or CanNm_RequestBusSynchronization allowed.
        CANNM_EXCLUSIVE_AREA_4  # No interruption of CanNm_RxIndication by CanNm_GetUserData or CanNm_GetPduData allowed.
        CANNM_EXCLUSIVE_AREA_5  # No interruption of CanNm_GetUserData or CanNm_GetPduData by CanNm_RxIndication allowed.
        CANNM_EXCLUSIVE_AREA_6  # No interruption of CanNm_MainFunction by CanNm_RequestBusSynchronization allowed. Note: This critical section can be left empty when CanNm_MainFunction and Nm_MainFunction have the same task.
        CANNM_EXCLUSIVE_AREA_7  # No interruption of CanNm_MainFunction by CanNm_RequestSynchronizedPncShutdown allowed.
      bsw schedulable entity CanNm_MainFunction: can-enter-exclusive-area=[CANNM_EXCLUSIVE_AREA_0, CANNM_EXCLUSIVE_AREA_1, CANNM_EXCLUSIVE_AREA_2, CANNM_EXCLUSIVE_AREA_3, CANNM_EXCLUSIVE_AREA_4, CANNM_EXCLUSIVE_AREA_5, CANNM_EXCLUSIVE_AREA_6, CANNM_EXCLUSIVE_AREA_7], implemented-entry=CanNm_MainFunction
      bsw timing event CanNm_MainFunctionTimingEvent0: starts-on-event=CanNm_MainFunction, period=0.01
  bsw module entry CanNm_MainFunction: call-type=SCHEDULED, execution-context=TASK
