AUTOSAR XML (schema 00048)
standard types defined: uint16, uint8
package /MICROSAR
  bsw implementation Rte_Impl: programming-language=C, sw-version=4.31.00, used-code-generator=DaVinci Configurator, vendor-id=30, ar-release-version=4.03.01
    mc-variable-instances:
      5 x mc data instance, all with category=VALUE:
        StartApplication_XcpPimDownload: flat-map-entry=StartApplication_XcpPimDownload, resulting-properties={base-type=uint16, sw-calibration-access=READ-WRITE, data-constr=uint16_DataConstr}, symbol=Rte_StartApplication_XcpPimDownload
        StartApplication_XcpPimUpload: flat-map-entry=StartApplication_XcpPimUpload, resulting-properties={base-type=uint16, sw-calibration-access=READ-WRITE, data-constr=uint16_DataConstr}, symbol=Rte_StartApplication_XcpPimUpload
        BswM_OsApplication_SystemApplication_Core0_Notification_ESH_ModeNotification_BswM_MDGP_ESH_Mode: flat-map-entry=BswM_OsApplication_SystemApplication_Core0_Notification_ESH_ModeNotification_BswM_MDGP_ESH_Mode, resulting-properties={base-type=uint8, sw-calibration-access=READ-ONLY, range raw 0..255}, symbol=Rte_ModeMachine_BswM_OsApplication_SystemApplication_Core0_Switch_ESH_ModeSwitch_BswM_MDGP_ESH_Mode
        BswM_OsApplication_SystemApplication_Core0_Switch_ESH_ModeSwitch_BswM_MDGP_ESH_Mode: flat-map-entry=BswM_OsApplication_SystemApplication_Core0_Switch_ESH_ModeSwitch_BswM_MDGP_ESH_Mode, resulting-properties={base-type=uint8, sw-calibration-access=READ-ONLY, range raw 0..255}, symbol=Rte_ModeMachine_BswM_OsApplication_SystemApplication_Core0_Switch_ESH_ModeSwitch_BswM_MDGP_ESH_Mode
        Dcm_DcmEcuReset_DcmEcuReset: flat-map-entry=Dcm_DcmEcuReset_DcmEcuReset, resulting-properties={base-type=uint8, sw-calibration-access=READ-ONLY, range raw 0..255}, symbol=Rte_ModeMachine_Dcm_DcmEcuReset_DcmEcuReset
    resource consumption ResourceConsumption
      74 x memory section:
        CODE: sw-addrmethod=CODE
        VAR_NOINIT_UNSPECIFIED: sw-addrmethod=OsApplication_SystemApplication_Core0_VAR_NO_INIT
        VAR_ZERO_INIT_UNSPECIFIED: sw-addrmethod=OsApplication_SystemApplication_Core0_VAR_CLEARED
        VAR_ZERO_INIT_8BIT: sw-addrmethod=OsApplication_SystemApplication_Core0_VAR_CLEARED
        VAR_INIT_UNSPECIFIED: sw-addrmethod=OsApplication_SystemApplication_Core0_VAR_INIT
        CONST_UNSPECIFIED: sw-addrmethod=CONST
        APPL_CODE: sw-addrmethod=CODE
        COMM_APPL_CODE: sw-addrmethod=CODE
        CSM_APPL_CODE: sw-addrmethod=CODE
        DCM_APPL_CODE: sw-addrmethod=CODE
        DEMMASTER_0_APPL_CODE: sw-addrmethod=CODE
        DEMSATELLITE_0_APPL_CODE: sw-addrmethod=CODE
        DET_APPL_CODE: sw-addrmethod=CODE
        ECUM_APPL_CODE: sw-addrmethod=CODE
        NVM_APPL_CODE: sw-addrmethod=CODE
        SECOC_APPL_CODE: sw-addrmethod=CODE
        SERVICECONTROL_APPL_CODE: sw-addrmethod=CODE
        STARTAPPLICATION_APPL_CODE: sw-addrmethod=CODE
        VAR_DEFAULT_RTE_PIM_GROUP_UNSPECIFIED: sw-addrmethod=OsApplication_SystemApplication_Core0_VAR_NO_INIT
        BSWBACKGROUNDTASK_CODE: sw-addrmethod=CODE
        DEFAULT_APPL_INIT_TASK_CODE: sw-addrmethod=CODE
        DEFAULT_BSW_ASYNC_TASK_CODE: sw-addrmethod=CODE
        DEFAULT_BSW_SYNC_TASK_CODE: sw-addrmethod=CODE
        DEFAULT_INIT_TASK_CODE: sw-addrmethod=CODE
        DEFAULT_RTE_MODE_SWITCH_TASK_CODE: sw-addrmethod=CODE
        IDLETASK_OSCORE0_CODE: sw-addrmethod=CODE
        STARTAPPLICATION_APPL_INIT_TASK_CODE: sw-addrmethod=CODE
        STARTAPPLICATION_APPL_TASK_CODE: sw-addrmethod=CODE
        STARTAPPLICATION_NOSWC_APPL_TASK_CODE: sw-addrmethod=CODE
        STARTAPPLICATION_NOSWC_INIT_TASK_CODE: sw-addrmethod=CODE
        OS_OSCORE0_SWC_APPL_CODE: sw-addrmethod=CODE
        DEFAULT_INIT_TASK_TRUSTED_CODE: sw-addrmethod=CODE
        VAR_NOCACHE_NOINIT_UNSPECIFIED: sw-addrmethod=OsApplication_SystemApplication_Core0_VAR_NOCACHE_NO_INIT
        VAR_NOCACHE_ZERO_INIT_UNSPECIFIED: sw-addrmethod=OsApplication_SystemApplication_Core0_VAR_NOCACHE_CLEARED
        VAR_NOCACHE_ZERO_INIT_8BIT: sw-addrmethod=OsApplication_SystemApplication_Core0_VAR_NOCACHE_CLEARED
        VAR_GLOBALSHARED_NOCACHE_ZERO_INIT_8BIT: sw-addrmethod=GLOBALSHARED_VAR_NOCACHE_CLEARED
        VAR_NOCACHE_INIT_UNSPECIFIED: sw-addrmethod=OsApplication_SystemApplication_Core0_VAR_NOCACHE_INIT
        OS_OSCORE1_SWC_APPL_CODE: sw-addrmethod=CODE
        DEFAULT_BSW_TASK_CORE1_CODE: sw-addrmethod=CODE
        DEFAULT_INIT_TASK_CORE1_CODE: sw-addrmethod=CODE
        DEFAULT_INIT_TASK_CORE1_TRUSTED_CODE: sw-addrmethod=CODE
        IDLETASK_OSCORE1_CODE: sw-addrmethod=CODE
        WDGM_OSAPPLICATION_SYSTEMAPPLICATION_CORE0_APPL_CODE: sw-addrmethod=CODE
        OSAPPLICATION_SYSTEMAPPLICATION_CORE0_CODE: sw-addrmethod=CODE
        VAR_OsApplication_SystemApplication_Core0_NOINIT_UNSPECIFIED: sw-addrmethod=OsApplication_SystemApplication_Core0_VAR_NO_INIT
        VAR_OsApplication_SystemApplication_Core0_NOCACHE_NOINIT_UNSPECIFIED: sw-addrmethod=OsApplication_SystemApplication_Core0_VAR_NOCACHE_NO_INIT
        VAR_OsApplication_SystemApplication_Core0_ZERO_INIT_UNSPECIFIED: sw-addrmethod=OsApplication_SystemApplication_Core0_VAR_CLEARED
        VAR_OsApplication_SystemApplication_Core0_NOCACHE_ZERO_INIT_UNSPECIFIED: sw-addrmethod=OsApplication_SystemApplication_Core0_VAR_NOCACHE_CLEARED
        VAR_OsApplication_SystemApplication_Core0_NOCACHE_ZERO_INIT_8BIT: sw-addrmethod=OsApplication_SystemApplication_Core0_VAR_NOCACHE_CLEARED
        VAR_OsApplication_SystemApplication_Core0_INIT_UNSPECIFIED: sw-addrmethod=OsApplication_SystemApplication_Core0_VAR_INIT
        VAR_OsApplication_SystemApplication_Core0_NOCACHE_INIT_UNSPECIFIED: sw-addrmethod=OsApplication_SystemApplication_Core0_VAR_NOCACHE_INIT
        OSAPPLICATION_SYSTEMAPPLICATION_CORE1_CODE: sw-addrmethod=CODE
        VAR_OsApplication_SystemApplication_Core1_NOINIT_UNSPECIFIED: sw-addrmethod=OsApplication_SystemApplication_Core1_VAR_NO_INIT
        VAR_OsApplication_SystemApplication_Core1_NOCACHE_NOINIT_UNSPECIFIED: sw-addrmethod=OsApplication_SystemApplication_Core1_VAR_NOCACHE_NO_INIT
        VAR_OsApplication_SystemApplication_Core1_ZERO_INIT_UNSPECIFIED: sw-addrmethod=OsApplication_SystemApplication_Core1_VAR_CLEARED
        VAR_OsApplication_SystemApplication_Core1_NOCACHE_ZERO_INIT_UNSPECIFIED: sw-addrmethod=OsApplication_SystemApplication_Core1_VAR_NOCACHE_CLEARED
        VAR_OsApplication_SystemApplication_Core1_NOCACHE_ZERO_INIT_8BIT: sw-addrmethod=OsApplication_SystemApplication_Core1_VAR_NOCACHE_CLEARED
        VAR_OsApplication_SystemApplication_Core1_INIT_UNSPECIFIED: sw-addrmethod=OsApplication_SystemApplication_Core1_VAR_INIT
        VAR_OsApplication_SystemApplication_Core1_NOCACHE_INIT_UNSPECIFIED: sw-addrmethod=OsApplication_SystemApplication_Core1_VAR_NOCACHE_INIT
        DEFAULT_APPL_TASK_CODE: sw-addrmethod=CODE
        WDGM_OSAPPLICATION_SYSTEMAPPLICATION_CORE1_APPL_CODE: sw-addrmethod=CODE
        BSWM_OSAPPLICATION_SYSTEMAPPLICATION_CORE0_APPL_CODE: sw-addrmethod=CODE
        BSWM_OSAPPLICATION_SYSTEMAPPLICATION_CORE1_APPL_CODE: sw-addrmethod=CODE
        STARTAPPLICATIONSLAVECORE_APPL_CODE: sw-addrmethod=CODE
        RT_VEHCOMM_APPL_CODE: sw-addrmethod=CODE
        SHA_APPL_CODE: sw-addrmethod=CODE
        NVA_APPL_CODE: sw-addrmethod=CODE
        DIAGA_APPL_CODE: sw-addrmethod=CODE
        APPDATAA_APPL_CODE: sw-addrmethod=CODE
        CDDNPMGEN2_APPL_CODE: sw-addrmethod=CODE
        BAP_APPL_CODE: sw-addrmethod=CODE
        BAPCONFIG_APPL_CODE: sw-addrmethod=CODE
        CTASG_LSG1_APPL_CODE: sw-addrmethod=CODE
        RT_VISHNU_APPL_CODE: sw-addrmethod=CODE
package /MICROSAR/Rte_ib_bswmd/BswModuleDescriptions
  bsw module description Rte: provided-entrys=Rte_ComSendSignalProxyPeriodic
    bsw internal behavior RteBehavior
      bsw schedulable entity Rte_ComSendSignalProxyPeriodic: implemented-entry=Rte_ComSendSignalProxyPeriodic
      bsw timing event Rte_ComSendSignalProxyPeriodicTimingEvent0: starts-on-event=Rte_ComSendSignalProxyPeriodic, period=0.005
  bsw module entry Rte_ComSendSignalProxyPeriodic: call-type=SCHEDULED, execution-context=TASK
