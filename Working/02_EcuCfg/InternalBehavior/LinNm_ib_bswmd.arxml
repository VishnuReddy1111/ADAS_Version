AUTOSAR XML (schema 00048)
standard types defined: uint8
package /MICROSAR
  bsw implementation LinNm_Impl: programming-language=C, sw-version=2.03.00, used-code-generator=DaVinci Configurator, vendor-id=30, ar-release-version=4.00.03
package /MICROSAR/LinNm_ib_bswmd/DataTypes/CompuMethods
  compu method LinNm_ModeType_Values: 0=NM_MODE_BUS_SLEEP, 1=NM_MODE_PREPARE_BUS_SLEEP, 2=NM_MODE_SYNCHRONIZE, 3=NM_MODE_NETWORK
  compu method LinNm_StateType_Values: 0=NM_STATE_UNINIT, 1=NM_STATE_BUS_SLEEP, 2=NM_STATE_PREPARE_BUS_SLEEP, 3=NM_STATE_READY_SLEEP, 4=NM_STATE_NORMAL_OPERATION, 5=NM_STATE_REPEAT_MESSAGE, 6=NM_STATE_SYNCHRONIZE
package /MICROSAR/LinNm_ib_bswmd/DataTypes/DataConstrs
  range Nm_ModeType: raw 0..255
  range Nm_StateType: raw 0..255
