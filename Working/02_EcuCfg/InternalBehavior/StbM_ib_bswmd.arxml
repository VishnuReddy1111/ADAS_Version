AUTOSAR XML (schema 00048)
standard types defined: boolean, uint32, uint8, uint16, sint32
package /MICROSAR
  bsw implementation StbM_Impl: programming-language=C, sw-version=9.04.00, used-code-generator=DaVinci Configurator, vendor-id=30, ar-release-version=4.07.00
    mc-variable-instances:
      12 x mc data instance:
        StbM_LocalClockConfig: category=ARRAY, array-size=2
          mc data instance Element_0: category=STRUCTURE, symbol=[0]
            7 x mc data instance, all with category=VALUE:
              NumeratorOfFactorClockTicksToLocalTimeOfLocalClockConfig: resulting-properties={base-type=uint32, sw-calibration-access=READ-ONLY, range raw 0..4294967295}
              HwFrequencyOfLocalClockConfig: resulting-properties={base-type=uint16, sw-calibration-access=READ-ONLY, range raw 0..65535}
              ClockTypeOfLocalClockConfig: resulting-properties={base-type=uint8, sw-calibration-access=READ-ONLY, compu {1=STBM_OS_LOCALCLOCK_CLOCKTYPEOFLOCALCLOCKCONFIG}, range raw 0..255}
              DenominatorOfFactorClockTicksToLocalTimeOfLocalClockConfig: resulting-properties={base-type=uint8, sw-calibration-access=READ-ONLY, range raw 0..255}
              HwPrescalerOfLocalClockConfig: resulting-properties={base-type=uint8, sw-calibration-access=READ-ONLY, range raw 0..255}
              OsClockConfigIdxOfLocalClockConfig: resulting-properties={base-type=uint8, sw-calibration-access=READ-ONLY, compu {255=STBM_NO_OSCLOCKCONFIGIDXOFLOCALCLOCKCONFIG}, range raw 0..255}
              TimeBasePartitionMappingIdxOfLocalClockConfig: resulting-properties={base-type=uint8, sw-calibration-access=READ-ONLY, range raw 0..255}
          mc data instance Element_1: category=STRUCTURE, symbol=[1]
            7 x mc data instance, all with category=VALUE:
              NumeratorOfFactorClockTicksToLocalTimeOfLocalClockConfig: resulting-properties={base-type=uint32, sw-calibration-access=READ-ONLY, range raw 0..4294967295}
              HwFrequencyOfLocalClockConfig: resulting-properties={base-type=uint16, sw-calibration-access=READ-ONLY, range raw 0..65535}
              ClockTypeOfLocalClockConfig: resulting-properties={base-type=uint8, sw-calibration-access=READ-ONLY, compu {1=STBM_OS_LOCALCLOCK_CLOCKTYPEOFLOCALCLOCKCONFIG}, range raw 0..255}
              DenominatorOfFactorClockTicksToLocalTimeOfLocalClockConfig: resulting-properties={base-type=uint8, sw-calibration-access=READ-ONLY, range raw 0..255}
              HwPrescalerOfLocalClockConfig: resulting-properties={base-type=uint8, sw-calibration-access=READ-ONLY, range raw 0..255}
              OsClockConfigIdxOfLocalClockConfig: resulting-properties={base-type=uint8, sw-calibration-access=READ-ONLY, compu {255=STBM_NO_OSCLOCKCONFIGIDXOFLOCALCLOCKCONFIG}, range raw 0..255}
              TimeBasePartitionMappingIdxOfLocalClockConfig: resulting-properties={base-type=uint8, sw-calibration-access=READ-ONLY, range raw 0..255}
        StbM_LocalTimeConfig: category=ARRAY, array-size=2  # This table contains the local time information of all timebases.
          mc data instance Element_0: category=STRUCTURE, symbol=[0]
            mc data instance LocalClockConfigIdxOfLocalTimeConfig: category=VALUE, resulting-properties={base-type=uint8, sw-calibration-access=READ-ONLY, compu {255=STBM_NO_LOCALCLOCKCONFIGIDXOFLOCALTIMECONFIG}, range raw 0..255}
            mc data instance TimeBaseConfigIdxOfLocalTimeConfig: category=VALUE, resulting-properties={base-type=uint8, sw-calibration-access=READ-ONLY, range raw 0..255}
            mc data instance TimeBasePartitionMappingIdxOfLocalTimeConfig: category=VALUE, resulting-properties={base-type=uint8, sw-calibration-access=READ-ONLY, range raw 0..255}
          mc data instance Element_1: category=STRUCTURE, symbol=[1]
            mc data instance LocalClockConfigIdxOfLocalTimeConfig: category=VALUE, resulting-properties={base-type=uint8, sw-calibration-access=READ-ONLY, compu {255=STBM_NO_LOCALCLOCKCONFIGIDXOFLOCALTIMECONFIG}, range raw 0..255}
            mc data instance TimeBaseConfigIdxOfLocalTimeConfig: category=VALUE, resulting-properties={base-type=uint8, sw-calibration-access=READ-ONLY, range raw 0..255}
            mc data instance TimeBasePartitionMappingIdxOfLocalTimeConfig: category=VALUE, resulting-properties={base-type=uint8, sw-calibration-access=READ-ONLY, range raw 0..255}
        StbM_PartitionIdentifiers: category=ARRAY, array-size=1  # the partition context in Config
          mc data instance Element_0: category=STRUCTURE, symbol=[0]
            mc data instance PartitionSNVOfPartitionIdentifiers: category=VALUE, resulting-properties={base-type=uint32, sw-calibration-access=READ-ONLY, range raw 0..4294967295}
            mc data instance PCPartitionConfigIdxOfPartitionIdentifiers: category=VALUE, resulting-properties={base-type=uint8, sw-calibration-access=READ-ONLY, range raw 0..255}
        StbM_TimeBaseConfig: category=ARRAY, array-size=2  # Configuration data from timebase. Contains all indirections to other tables.
          mc data instance Element_0: category=STRUCTURE, symbol=[0]
            8 x mc data instance, all with category=VALUE:
              GlobalTimeMasterOfTimeBaseConfig: resulting-properties={base-type=boolean, sw-calibration-access=READ-ONLY, compu {0=FALSE, 1..255=TRUE}, range raw 0..1}
              SynchronizedTimeBaseOfTimeBaseConfig: resulting-properties={base-type=boolean, sw-calibration-access=READ-ONLY, compu {0=FALSE, 1..255=TRUE}, range raw 0..1}
              TimeSlaveOfTimeBaseConfig: resulting-properties={base-type=boolean, sw-calibration-access=READ-ONLY, compu {0=FALSE, 1..255=TRUE}, range raw 0..1}
              LocalTimeConfigIdxOfTimeBaseConfig: resulting-properties={base-type=uint8, sw-calibration-access=READ-ONLY, range raw 0..255}
              PartitionConfigIdxOfTimeBaseConfig: resulting-properties={base-type=uint8, sw-calibration-access=READ-ONLY, range raw 0..255}
              StatusIdxOfTimeBaseConfig: resulting-properties={base-type=uint8, sw-calibration-access=READ-ONLY, range raw 0..255}
              TimeBaseIdOfTimeBaseConfig: resulting-properties={base-type=uint8, sw-calibration-access=READ-ONLY, compu {255=STBM_NO_TIMEBASEIDOFTIMEBASECONFIG}, range raw 0..255}
              UserDataStateIdxOfTimeBaseConfig: resulting-properties={base-type=uint8, sw-calibration-access=READ-ONLY, range raw 0..255}
          mc data instance Element_1: category=STRUCTURE, symbol=[1]
            8 x mc data instance, all with category=VALUE:
              GlobalTimeMasterOfTimeBaseConfig: resulting-properties={base-type=boolean, sw-calibration-access=READ-ONLY, compu {0=FALSE, 1..255=TRUE}, range raw 0..1}
              SynchronizedTimeBaseOfTimeBaseConfig: resulting-properties={base-type=boolean, sw-calibration-access=READ-ONLY, compu {0=FALSE, 1..255=TRUE}, range raw 0..1}
              TimeSlaveOfTimeBaseConfig: resulting-properties={base-type=boolean, sw-calibration-access=READ-ONLY, compu {0=FALSE, 1..255=TRUE}, range raw 0..1}
              LocalTimeConfigIdxOfTimeBaseConfig: resulting-properties={base-type=uint8, sw-calibration-access=READ-ONLY, range raw 0..255}
              PartitionConfigIdxOfTimeBaseConfig: resulting-properties={base-type=uint8, sw-calibration-access=READ-ONLY, range raw 0..255}
              StatusIdxOfTimeBaseConfig: resulting-properties={base-type=uint8, sw-calibration-access=READ-ONLY, range raw 0..255}
              TimeBaseIdOfTimeBaseConfig: resulting-properties={base-type=uint8, sw-calibration-access=READ-ONLY, compu {255=STBM_NO_TIMEBASEIDOFTIMEBASECONFIG}, range raw 0..255}
              UserDataStateIdxOfTimeBaseConfig: resulting-properties={base-type=uint8, sw-calibration-access=READ-ONLY, range raw 0..255}
        StbM_TimeBasePartitionMapping: category=ARRAY, array-size=2  # Time base to partition mapping
          mc data instance Element_0: category=STRUCTURE, symbol=[0]
            10 x mc data instance, all with category=VALUE:
              IndirectionToLocalClockStateIdxOfTimeBasePartitionMapping: resulting-properties={base-type=uint8, sw-calibration-access=READ-ONLY, compu {255=STBM_NO_INDIRECTIONTOLOCALCLOCKSTATEIDXOFTIMEBASEPARTITIONMAPPING}, range raw 0..255}
              IndirectionToLocalClockStatePartitionIdxOfTimeBasePartitionMapping: resulting-properties={base-type=uint8, sw-calibration-access=READ-ONLY, compu-method=StbM_IndirectionToLocalClockStatePartitionIdxOfTimeBasePartitionMappingType, range raw 0..255}
              IndirectionToLocalTimeStateIdxOfTimeBasePartitionMapping: resulting-properties={base-type=uint8, sw-calibration-access=READ-ONLY, range raw 0..255}
              IndirectionToLocalTimeStatePartitionIdxOfTimeBasePartitionMapping: resulting-properties={base-type=uint8, sw-calibration-access=READ-ONLY, compu-method=StbM_IndirectionToLocalTimeStatePartitionIdxOfTimeBasePartitionMappingType, range raw 0..255}
              IndirectionToMainTimeStateIdxOfTimeBasePartitionMapping: resulting-properties={base-type=uint8, sw-calibration-access=READ-ONLY, range raw 0..255}
              IndirectionToMainTimeStatePartitionIdxOfTimeBasePartitionMapping: resulting-properties={base-type=uint8, sw-calibration-access=READ-ONLY, compu-method=StbM_IndirectionToMainTimeStatePartitionIdxOfTimeBasePartitionMappingType, range raw 0..255}
              IndirectionToTimeBaseConfigIdxOfTimeBasePartitionMapping: resulting-properties={base-type=uint8, sw-calibration-access=READ-ONLY, range raw 0..255}
              IndirectionToTimeBaseConfigPartitionIdxOfTimeBasePartitionMapping: resulting-properties={base-type=uint8, sw-calibration-access=READ-ONLY, compu-method=StbM_IndirectionToTimeBaseConfigPartitionIdxOfTimeBasePartitionMappingType, range raw 0..255}
              IndirectionToVirtualLocalTimeStateIdxOfTimeBasePartitionMapping: resulting-properties={base-type=uint8, sw-calibration-access=READ-ONLY, range raw 0..255}
              IndirectionToVirtualLocalTimeStatePartitionIdxOfTimeBasePartitionMapping: resulting-properties={base-type=uint8, sw-calibration-access=READ-ONLY, compu-method=StbM_IndirectionToVirtualLocalTimeStatePartitionIdxOfTimeBasePartitionMappingType, range raw 0..255}
          mc data instance Element_1: category=STRUCTURE, symbol=[1]
            10 x mc data instance, all with category=VALUE:
              IndirectionToLocalClockStateIdxOfTimeBasePartitionMapping: resulting-properties={base-type=uint8, sw-calibration-access=READ-ONLY, compu {255=STBM_NO_INDIRECTIONTOLOCALCLOCKSTATEIDXOFTIMEBASEPARTITIONMAPPING}, range raw 0..255}
              IndirectionToLocalClockStatePartitionIdxOfTimeBasePartitionMapping: resulting-properties={base-type=uint8, sw-calibration-access=READ-ONLY, compu-method=StbM_IndirectionToLocalClockStatePartitionIdxOfTimeBasePartitionMappingType, range raw 0..255}
              IndirectionToLocalTimeStateIdxOfTimeBasePartitionMapping: resulting-properties={base-type=uint8, sw-calibration-access=READ-ONLY, range raw 0..255}
              IndirectionToLocalTimeStatePartitionIdxOfTimeBasePartitionMapping: resulting-properties={base-type=uint8, sw-calibration-access=READ-ONLY, compu-method=StbM_IndirectionToLocalTimeStatePartitionIdxOfTimeBasePartitionMappingType, range raw 0..255}
              IndirectionToMainTimeStateIdxOfTimeBasePartitionMapping: resulting-properties={base-type=uint8, sw-calibration-access=READ-ONLY, range raw 0..255}
              IndirectionToMainTimeStatePartitionIdxOfTimeBasePartitionMapping: resulting-properties={base-type=uint8, sw-calibration-access=READ-ONLY, compu-method=StbM_IndirectionToMainTimeStatePartitionIdxOfTimeBasePartitionMappingType, range raw 0..255}
              IndirectionToTimeBaseConfigIdxOfTimeBasePartitionMapping: resulting-properties={base-type=uint8, sw-calibration-access=READ-ONLY, range raw 0..255}
              IndirectionToTimeBaseConfigPartitionIdxOfTimeBasePartitionMapping: resulting-properties={base-type=uint8, sw-calibration-access=READ-ONLY, compu-method=StbM_IndirectionToTimeBaseConfigPartitionIdxOfTimeBasePartitionMappingType, range raw 0..255}
              IndirectionToVirtualLocalTimeStateIdxOfTimeBasePartitionMapping: resulting-properties={base-type=uint8, sw-calibration-access=READ-ONLY, range raw 0..255}
              IndirectionToVirtualLocalTimeStatePartitionIdxOfTimeBasePartitionMapping: resulting-properties={base-type=uint8, sw-calibration-access=READ-ONLY, compu-method=StbM_IndirectionToVirtualLocalTimeStatePartitionIdxOfTimeBasePartitionMappingType, range raw 0..255}
        StbM_TimeBaseState: category=ARRAY, array-size=2, symbol=StbM_TimeBaseState.raw  # Internal state of the Time Bases.
          mc data instance Element_0: category=STRUCTURE, symbol=[0]
            mc data instance UpdateCounterOfTimeBaseState: category=VALUE, resulting-properties={base-type=uint8, sw-calibration-access=READ-ONLY, range raw 0..255}
          mc data instance Element_1: category=STRUCTURE, symbol=[1]
            mc data instance UpdateCounterOfTimeBaseState: category=VALUE, resulting-properties={base-type=uint8, sw-calibration-access=READ-ONLY, range raw 0..255}
        StbM_TimeBaseState_GlobalTimeDomain_2b08dc4b: category=ARRAY, array-size=1, symbol=StbM_TimeBaseState.raw[0]  # The element: GlobalTimeDomain_2b08dc4b of StbM_TimeBaseState
          mc data instance Element_0: category=STRUCTURE, symbol=[0]
            mc data instance UpdateCounterOfTimeBaseState: category=VALUE, resulting-properties={base-type=uint8, sw-calibration-access=READ-ONLY, range raw 0..255}
        StbM_TimeBaseState_StbMSynchronizedTimeBase_CAN: category=ARRAY, array-size=1, symbol=StbM_TimeBaseState.raw[1]  # The element: StbMSynchronizedTimeBase_CAN of StbM_TimeBaseState
          mc data instance Element_0: category=STRUCTURE, symbol=[0]
            mc data instance UpdateCounterOfTimeBaseState: category=VALUE, resulting-properties={base-type=uint8, sw-calibration-access=READ-ONLY, range raw 0..255}
        StbM_TimeLeapState: category=ARRAY, array-size=2, symbol=StbM_TimeLeapState.raw  # Time leap state table.
          mc data instance Element_0: category=STRUCTURE, symbol=[0]
            mc data instance TimeLeapOfTimeLeapState: category=VALUE, resulting-properties={base-type=sint32, sw-calibration-access=READ-ONLY, range raw -2147483648..2147483647}
            mc data instance TimeLeapValidOfTimeLeapState: category=VALUE, resulting-properties={base-type=boolean, sw-calibration-access=READ-ONLY, compu {0=FALSE, 1..255=TRUE}, range raw 0..1}
          mc data instance Element_1: category=STRUCTURE, symbol=[1]
            mc data instance TimeLeapOfTimeLeapState: category=VALUE, resulting-properties={base-type=sint32, sw-calibration-access=READ-ONLY, range raw -2147483648..2147483647}
            mc data instance TimeLeapValidOfTimeLeapState: category=VALUE, resulting-properties={base-type=boolean, sw-calibration-access=READ-ONLY, compu {0=FALSE, 1..255=TRUE}, range raw 0..1}
        StbM_TimeLeapState_GlobalTimeDomain_2b08dc4b: category=ARRAY, array-size=1, symbol=StbM_TimeLeapState.raw[0]  # The element: GlobalTimeDomain_2b08dc4b of StbM_TimeLeapState
          mc data instance Element_0: category=STRUCTURE, symbol=[0]
            mc data instance TimeLeapOfTimeLeapState: category=VALUE, resulting-properties={base-type=sint32, sw-calibration-access=READ-ONLY, range raw -2147483648..2147483647}
            mc data instance TimeLeapValidOfTimeLeapState: category=VALUE, resulting-properties={base-type=boolean, sw-calibration-access=READ-ONLY, compu {0=FALSE, 1..255=TRUE}, range raw 0..1}
        StbM_TimeLeapState_StbMSynchronizedTimeBase_CAN: category=ARRAY, array-size=1, symbol=StbM_TimeLeapState.raw[1]  # The element: StbMSynchronizedTimeBase_CAN of StbM_TimeLeapState
          mc data instance Element_0: category=STRUCTURE, symbol=[0]
            mc data instance TimeLeapOfTimeLeapState: category=VALUE, resulting-properties={base-type=sint32, sw-calibration-access=READ-ONLY, range raw -2147483648..2147483647}
            mc data instance TimeLeapValidOfTimeLeapState: category=VALUE, resulting-properties={base-type=boolean, sw-calibration-access=READ-ONLY, compu {0=FALSE, 1..255=TRUE}, range raw 0..1}
        StbM_Initialized: category=VALUE, resulting-properties={base-type=boolean, sw-calibration-access=READ-ONLY, compu {0=FALSE, 1..255=TRUE}, range raw 0..1}  # Initialization state of the StbM. TRUE, if StbM_Init() has been called, else FALSE.
package /MICROSAR/StbM_ib_bswmd/DataTypes/CompuMethods
  compu method StbM_IndirectionToLocalClockStatePartitionIdxOfTimeBasePartitionMappingType: 255=STBM_NO_INDIRECTIONTOLOCALCLOCKSTATEPARTITIONIDXOFTIMEBASEPARTITIONMAPPING
  compu method StbM_IndirectionToLocalTimeStatePartitionIdxOfTimeBasePartitionMappingType: 255=STBM_NO_INDIRECTIONTOLOCALTIMESTATEPARTITIONIDXOFTIMEBASEPARTITIONMAPPING
  compu method StbM_IndirectionToMainTimeStatePartitionIdxOfTimeBasePartitionMappingType: 255=STBM_NO_INDIRECTIONTOMAINTIMESTATEPARTITIONIDXOFTIMEBASEPARTITIONMAPPING
  compu method StbM_IndirectionToTimeBaseConfigPartitionIdxOfTimeBasePartitionMappingType: 255=STBM_NO_INDIRECTIONTOTIMEBASECONFIGPARTITIONIDXOFTIMEBASEPARTITIONMAPPING
  compu method StbM_IndirectionToVirtualLocalTimeStatePartitionIdxOfTimeBasePartitionMappingType: 255=STBM_NO_INDIRECTIONTOVIRTUALLOCALTIMESTATEPARTITIONIDXOFTIMEBASEPARTITIONMAPPING
