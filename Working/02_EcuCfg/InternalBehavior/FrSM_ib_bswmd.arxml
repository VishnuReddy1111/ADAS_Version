AUTOSAR XML (schema 00048)
standard types defined: uint16, uint8
package /MICROSAR
  bsw implementation FrSM_Impl: programming-language=C, sw-version=4.00.00, used-code-generator=DaVinci Configurator, vendor-id=30, ar-release-version=4.00.03
package /MICROSAR/FrSM_ib_bswmd/DataTypes/CompuMethods
  compu method CompuMethodEnum_ComM_Mode: 0=COMM_NO_COMMUNICATION, 1=COMM_SILENT_COMMUNICATION, 2=COMM_FULL_COMMUNICATION
  compu method CompuMethodEnum_FrSM_State: 0=FRSM_BSWM_READY, 2=FRSM_BSWM_STARTUP, 4=FRSM_BSWM_WAKEUP, 6=FRSM_BSWM_HALT_REQ, 8=FRSM_BSWM_KEYSLOT_ONLY, 10=FRSM_BSWM_ONLINE, 12=FRSM_BSWM_ONLINE_PASSIVE
package /MICROSAR/FrSM_ib_bswmd/DataTypes/DataConstrs
  range ComM_ModeType: raw 0..2
  range FrSM_State_Type: raw 0..255
