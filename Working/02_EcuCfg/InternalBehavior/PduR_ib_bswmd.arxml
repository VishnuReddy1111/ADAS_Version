[part 4 of 4: packages /MICROSAR to /MICROSAR/PduR_ib_bswmd/DataTypes/CompuMethods]
AUTOSAR XML (schema 4-3-0)
package /MICROSAR  (continued)
  bsw implementation PduR_Impl: programming-language=C, sw-version=17.02.01, used-code-generator=DaVinci Configurator, vendor-id=30, ar-release-version=4.01.02  (continued)
    mc-variable-instances:  (continued)
      41 x mc data instance, all with category=ARRAY:  (continued)
        PduR_Tx2Lo: array-size=142  # Contains all information to route a Pdu from a upper layer to a lower layer module, or to cancel a transmission
          142 x mc data instance, all with category=STRUCTURE:
            Element_0: symbol=[0]
              mc data instance MaskedBitsOfTx2Lo: category=VALUE, resulting-properties={base-type=uint8, sw-calibration-access=READ-ONLY, range raw 0..255}
              mc data instance RmSrcRomIdxOfTx2Lo: category=VALUE, resulting-properties={base-type=uint8, sw-calibration-access=READ-ONLY, compu {255=PDUR_NO_RMSRCROMIDXOFTX2LO}, range raw 0..255}
              mc data instance RmTransmitFctPtrIdxOfTx2Lo: category=VALUE, resulting-properties={base-type=uint8, sw-calibration-access=READ-ONLY, range raw 0..255}
            Element_1: symbol=[1]
              mc data instance MaskedBitsOfTx2Lo: category=VALUE, resulting-properties={base-type=uint8, sw-calibration-access=READ-ONLY, range raw 0..255}
              mc data instance RmSrcRomIdxOfTx2Lo: category=VALUE, resulting-properties={base-type=uint8, sw-calibration-access=READ-ONLY, compu {255=PDUR_NO_RMSRCROMIDXOFTX2LO}, range raw 0..255}
              mc data instance RmTransmitFctPtrIdxOfTx2Lo: category=VALUE, resulting-properties={base-type=uint8, sw-calibration-access=READ-ONLY, range raw 0..255}
            Element_2: symbol=[2]
              mc data instance MaskedBitsOfTx2Lo: category=VALUE, resulting-properties={base-type=uint8, sw-calibration-access=READ-ONLY, range raw 0..255}
              mc data instance RmSrcRomIdxOfTx2Lo: category=VALUE, resulting-properties={base-type=uint8, sw-calibration-access=READ-ONLY, compu {255=PDUR_NO_RMSRCROMIDXOFTX2LO}, range raw 0..255}
              mc data instance RmTransmitFctPtrIdxOfTx2Lo: category=VALUE, resulting-properties={base-type=uint8, sw-calibration-access=READ-ONLY, range raw 0..255}
            Element_3: symbol=[3]
              mc data instance MaskedBitsOfTx2Lo: category=VALUE, resulting-properties={base-type=uint8, sw-calibration-access=READ-ONLY, range raw 0..255}
              mc data instance RmSrcRomIdxOfTx2Lo: category=VALUE, resulting-properties={base-type=uint8, sw-calibration-access=READ-ONLY, compu {255=PDUR_NO_RMSRCROMIDXOFTX2LO}, range raw 0..255}
              mc data instance RmTransmitFctPtrIdxOfTx2Lo: category=VALUE, resulting-properties={base-type=uint8, sw-calibration-access=READ-ONLY, range raw 0..255}
            Element_4: symbol=[4]
              mc data instance MaskedBitsOfTx2Lo: category=VALUE, resulting-properties={base-type=uint8, sw-calibration-access=READ-ONLY, range raw 0..255}
              mc data instance RmSrcRomIdxOfTx2Lo: category=VALUE, resulting-properties={base-type=uint8, sw-calibration-access=READ-ONLY, compu {255=PDUR_NO_RMSRCROMIDXOFTX2LO}, range raw 0..255}
              mc data instance RmTransmitFctPtrIdxOfTx2Lo: category=VALUE, resulting-properties={base-type=uint8, sw-calibration-access=READ-ONLY, range raw 0..255}
            Element_5: symbol=[5]
              mc data instance MaskedBitsOfTx2Lo: category=VALUE, resulting-properties={base-type=uint8, sw-calibration-access=READ-ONLY, range raw 0..255}
              mc data instance RmSrcRomIdxOfTx2Lo: category=VALUE, resulting-properties={base-type=uint8, sw-calibration-access=READ-ONLY, compu {255=PDUR_NO_RMSRCROMIDXOFTX2LO}, range raw 0..255}
              mc data instance RmTransmitFctPtrIdxOfTx2Lo: category=VALUE, resulting-properties={base-type=uint8, sw-calibration-access=READ-ONLY, range raw 0..255}
            Element_6: symbol=[6]
              mc data instance MaskedBitsOfTx2Lo: category=VALUE, resulting-properties={base-type=uint8, sw-calibration-access=READ-ONLY, range raw 0..255}
              mc data instance RmSrcRomIdxOfTx2Lo: category=VALUE, resulting-properties={base-type=uint8, sw-calibration-access=READ-ONLY, compu {255=PDUR_NO_RMSRCROMIDXOFTX2LO}, range raw 0..255}
              mc data instance RmTransmitFctPtrIdxOfTx2Lo: category=VALUE, resulting-properties={base-type=uint8, sw-calibration-access=READ-ONLY, range raw 0..255}
            Element_7: symbol=[7]
              mc data instance MaskedBitsOfTx2Lo: category=VALUE, resulting-properties={base-type=uint8, sw-calibration-access=READ-ONLY, range raw 0..255}
              mc data instance RmSrcRomIdxOfTx2Lo: category=VALUE, resulting-properties={base-type=uint8, sw-calibration-access=READ-ONLY, compu {255=PDUR_NO_RMSRCROMIDXOFTX2LO}, range raw 0..255}
              mc data instance RmTransmitFctPtrIdxOfTx2Lo: category=VALUE, resulting-properties={base-type=uint8, sw-calibration-access=READ-ONLY, range raw 0..255}
            Element_8: symbol=[8]
              mc data instance MaskedBitsOfTx2Lo: category=VALUE, resulting-properties={base-type=uint8, sw-calibration-access=READ-ONLY, range raw 0..255}
              mc data instance RmSrcRomIdxOfTx2Lo: category=VALUE, resulting-properties={base-type=uint8, sw-calibration-access=READ-ONLY, compu {255=PDUR_NO_RMSRCROMIDXOFTX2LO}, range raw 0..255}
              mc data instance RmTransmitFctPtrIdxOfTx2Lo: category=VALUE, resulting-properties={base-type=uint8, sw-calibration-access=READ-ONLY, range raw 0..255}
            Element_9: symbol=[9]
              mc data instance MaskedBitsOfTx2Lo: category=VALUE, resulting-properties={base-type=uint8, sw-calibration-access=READ-ONLY, range raw 0..255}
              mc data instance RmSrcRomIdxOfTx2Lo: category=VALUE, resulting-properties={base-type=uint8, sw-calibration-access=READ-ONLY, compu {255=PDUR_NO_RMSRCROMIDXOFTX2LO}, range raw 0..255}
              mc data instance RmTransmitFctPtrIdxOfTx2Lo: category=VALUE, resulting-properties={base-type=uint8, sw-calibration-access=READ-ONLY, range raw 0..255}
            Element_10: symbol=[10]
              mc data instance MaskedBitsOfTx2Lo: category=VALUE, resulting-properties={base-type=uint8, sw-calibration-access=READ-ONLY, range raw 0..255}
              mc data instance RmSrcRomIdxOfTx2Lo: category=VALUE, resulting-properties={base-type=uint8, sw-calibration-access=READ-ONLY, compu {255=PDUR_NO_RMSRCROMIDXOFTX2LO}, range raw 0..255}
              mc data instance RmTransmitFctPtrIdxOfTx2Lo: category=VALUE, resulting-properties={base-type=uint8, sw-calibration-access=READ-ONLY, range raw 0..255}
            Element_11: symbol=[11]
              mc data instance MaskedBitsOfTx2Lo: category=VALUE, resulting-properties={base-type=uint8, sw-calibration-access=READ-ONLY, range raw 0..255}
              mc data instance RmSrcRomIdxOfTx2Lo: category=VALUE, resulting-properties={base-type=uint8, sw-calibration-access=READ-ONLY, compu {255=PDUR_NO_RMSRCROMIDXOFTX2LO}, range raw 0..255}
              mc data instance RmTransmitFctPtrIdxOfTx2Lo: category=VALUE, resulting-properties={base-type=uint8, sw-calibration-access=READ-ONLY, range raw 0..255}
            Element_12: symbol=[12]
              mc data instance MaskedBitsOfTx2Lo: category=VALUE, resulting-properties={base-type=uint8, sw-calibration-access=READ-ONLY, range raw 0..255}
              mc data instance RmSrcRomIdxOfTx2Lo: category=VALUE, resulting-properties={base-type=uint8, sw-calibration-access=READ-ONLY, compu {255=PDUR_NO_RMSRCROMIDXOFTX2LO}, range raw 0..255}
              mc data instance RmTransmitFctPtrIdxOfTx2Lo: category=VALUE, resulting-properties={base-type=uint8, sw-calibration-access=READ-ONLY, range raw 0..255}
            Element_13: symbol=[13]
              mc data instance MaskedBitsOfTx2Lo: category=VALUE, resulting-properties={base-type=uint8, sw-calibration-access=READ-ONLY, range raw 0..255}
              mc data instance RmSrcRomIdxOfTx2Lo: category=VALUE, resulting-properties={base-type=uint8, sw-calibration-access=READ-ONLY, compu {255=PDUR_NO_RMSRCROMIDXOFTX2LO}, range raw 0..255}
              mc data instance RmTransmitFctPtrIdxOfTx2Lo: category=VALUE, resulting-properties={base-type=uint8, sw-calibration-access=READ-ONLY, range raw 0..255}
            Element_14: symbol=[14]
              mc data instance MaskedBitsOfTx2Lo: category=VALUE, resulting-properties={base-type=uint8, sw-calibration-access=READ-ONLY, range raw 0..255}
              mc data instance RmSrcRomIdxOfTx2Lo: category=VALUE, resulting-properties={base-type=uint8, sw-calibration-access=READ-ONLY, compu {255=PDUR_NO_RMSRCROMIDXOFTX2LO}, range raw 0..255}
              mc data instance RmTransmitFctPtrIdxOfTx2Lo: category=VALUE, resulting-properties={base-type=uint8, sw-calibration-access=READ-ONLY, range raw 0..255}
            Element_15: symbol=[15]
              mc data instance MaskedBitsOfTx2Lo: category=VALUE, resulting-properties={base-type=uint8, sw-calibration-access=READ-ONLY, range raw 0..255}
              mc data instance RmSrcRomIdxOfTx2Lo: category=VALUE, resulting-properties={base-type=uint8, sw-calibration-access=READ-ONLY, compu {255=PDUR_NO_RMSRCROMIDXOFTX2LO}, range raw 0..255}
              mc data instance RmTransmitFctPtrIdxOfTx2Lo: category=VALUE, resulting-properties={base-type=uint8, sw-calibration-access=READ-ONLY, range raw 0..255}
            Element_16: symbol=[16]
              mc data instance MaskedBitsOfTx2Lo: category=VALUE, resulting-properties={base-type=uint8, sw-calibration-access=READ-ONLY, range raw 0..255}
              mc data instance RmSrcRomIdxOfTx2Lo: category=VALUE, resulting-properties={base-type=uint8, sw-calibration-access=READ-ONLY, compu {255=PDUR_NO_RMSRCROMIDXOFTX2LO}, range raw 0..255}
              mc data instance RmTransmitFctPtrIdxOfTx2Lo: category=VALUE, resulting-properties={base-type=uint8, sw-calibration-access=READ-ONLY, range raw 0..255}
            Element_17: symbol=[17]
              mc data instance MaskedBitsOfTx2Lo: category=VALUE, resulting-properties={base-type=uint8, sw-calibration-access=READ-ONLY, range raw 0..255}
              mc data instance RmSrcRomIdxOfTx2Lo: category=VALUE, resulting-properties={base-type=uint8, sw-calibration-access=READ-ONLY, compu {255=PDUR_NO_RMSRCROMIDXOFTX2LO}, range raw 0..255}
              mc data instance RmTransmitFctPtrIdxOfTx2Lo: category=VALUE, resulting-properties={base-type=uint8, sw-calibration-access=READ-ONLY, range raw 0..255}
            Element_18: symbol=[18]
              mc data instance MaskedBitsOfTx2Lo: category=VALUE, resulting-properties={base-type=uint8, sw-calibration-access=READ-ONLY, range raw 0..255}
              mc data instance RmSrcRomIdxOfTx2Lo: category=VALUE, resulting-properties={base-type=uint8, sw-calibration-access=READ-ONLY, compu {255=PDUR_NO_RMSRCROMIDXOFTX2LO}, range raw 0..255}
              mc data instance RmTransmitFctPtrIdxOfTx2Lo: category=VALUE, resulting-properties={base-type=uint8, sw-calibration-access=READ-ONLY, range raw 0..255}
            Element_19: symbol=[19]
              mc data instance MaskedBitsOfTx2Lo: category=VALUE, resulting-properties={base-type=uint8, sw-calibration-access=READ-ONLY, range raw 0..255}
              mc data instance RmSrcRomIdxOfTx2Lo: category=VALUE, resulting-properties={base-type=uint8, sw-calibration-access=READ-ONLY, compu {255=PDUR_NO_RMSRCROMIDXOFTX2LO}, range raw 0..255}
              mc data instance RmTransmitFctPtrIdxOfTx2Lo: category=VALUE, resulting-properties={base-type=uint8, sw-calibration-access=READ-ONLY, range raw 0..255}
            Element_20: symbol=[20]
              mc data instance MaskedBitsOfTx2Lo: category=VALUE, resulting-properties={base-type=uint8, sw-calibration-access=READ-ONLY, range raw 0..255}
              mc data instance RmSrcRomIdxOfTx2Lo: category=VALUE, resulting-properties={base-type=uint8, sw-calibration-access=READ-ONLY, compu {255=PDUR_NO_RMSRCROMIDXOFTX2LO}, range raw 0..255}
              mc data instance RmTransmitFctPtrIdxOfTx2Lo: category=VALUE, resulting-properties={base-type=uint8, sw-calibration-access=READ-ONLY, range raw 0..255}
            Element_21: symbol=[21]
              mc data instance MaskedBitsOfTx2Lo: category=VALUE, resulting-properties={base-type=uint8, sw-calibration-access=READ-ONLY, range raw 0..255}
              mc data instance RmSrcRomIdxOfTx2Lo: category=VALUE, resulting-properties={base-type=uint8, sw-calibration-access=READ-ONLY, compu {255=PDUR_NO_RMSRCROMIDXOFTX2LO}, range raw 0..255}
              mc data instance RmTransmitFctPtrIdxOfTx2Lo: category=VALUE, resulting-properties={base-type=uint8, sw-calibration-access=READ-ONLY, range raw 0..255}
            Element_22: symbol=[22]
              mc data instance MaskedBitsOfTx2Lo: category=VALUE, resulting-properties={base-type=uint8, sw-calibration-access=READ-ONLY, range raw 0..255}
              mc data instance RmSrcRomIdxOfTx2Lo: category=VALUE, resulting-properties={base-type=uint8, sw-calibration-access=READ-ONLY, compu {255=PDUR_NO_RMSRCROMIDXOFTX2LO}, range raw 0..255}
              mc data instance RmTransmitFctPtrIdxOfTx2Lo: category=VALUE, resulting-properties={base-type=uint8, sw-calibration-access=READ-ONLY, range raw 0..255}
            Element_23: symbol=[23]
              mc data instance MaskedBitsOfTx2Lo: category=VALUE, resulting-properties={base-type=uint8, sw-calibration-access=READ-ONLY, range raw 0..255}
              mc data instance RmSrcRomIdxOfTx2Lo: category=VALUE, resulting-properties={base-type=uint8, sw-calibration-access=READ-ONLY, compu {255=PDUR_NO_RMSRCROMIDXOFTX2LO}, range raw 0..255}
              mc data instance RmTransmitFctPtrIdxOfTx2Lo: category=VALUE, resulting-properties={base-type=uint8, sw-calibration-access=READ-ONLY, range raw 0..255}
            Element_24: symbol=[24]
              mc data instance MaskedBitsOfTx2Lo: category=VALUE, resulting-properties={base-type=uint8, sw-calibration-access=READ-ONLY, range raw 0..255}
              mc data instance RmSrcRomIdxOfTx2Lo: category=VALUE, resulting-properties={base-type=uint8, sw-calibration-access=READ-ONLY, compu {255=PDUR_NO_RMSRCROMIDXOFTX2LO}, range raw 0..255}
              mc data instance RmTransmitFctPtrIdxOfTx2Lo: category=VALUE, resulting-properties={base-type=uint8, sw-calibration-access=READ-ONLY, range raw 0..255}
            Element_25: symbol=[25]
              mc data instance MaskedBitsOfTx2Lo: category=VALUE, resulting-properties={base-type=uint8, sw-calibration-access=READ-ONLY, range raw 0..255}
              mc data instance RmSrcRomIdxOfTx2Lo: category=VALUE, resulting-properties={base-type=uint8, sw-calibration-access=READ-ONLY, compu {255=PDUR_NO_RMSRCROMIDXOFTX2LO}, range raw 0..255}
              mc data instance RmTransmitFctPtrIdxOfTx2Lo: category=VALUE, resulting-properties={base-type=uint8, sw-calibration-access=READ-ONLY, range raw 0..255}
            Element_26: symbol=[26]
              mc data instance MaskedBitsOfTx2Lo: category=VALUE, resulting-properties={base-type=uint8, sw-calibration-access=READ-ONLY, range raw 0..255}
              mc data instance RmSrcRomIdxOfTx2Lo: category=VALUE, resulting-properties={base-type=uint8, sw-calibration-access=READ-ONLY, compu {255=PDUR_NO_RMSRCROMIDXOFTX2LO}, range raw 0..255}
              mc data instance RmTransmitFctPtrIdxOfTx2Lo: category=VALUE, resulting-properties={base-type=uint8, sw-calibration-access=READ-ONLY, range raw 0..255}
            Element_27: symbol=[27]
              mc data instance MaskedBitsOfTx2Lo: category=VALUE, resulting-properties={base-type=uint8, sw-calibration-access=READ-ONLY, range raw 0..255}
              mc data instance RmSrcRomIdxOfTx2Lo: category=VALUE, resulting-properties={base-type=uint8, sw-calibration-access=READ-ONLY, compu {255=PDUR_NO_RMSRCROMIDXOFTX2LO}, range raw 0..255}
              mc data instance RmTransmitFctPtrIdxOfTx2Lo: category=VALUE, resulting-properties={base-type=uint8, sw-calibration-access=READ-ONLY, range raw 0..255}
            Element_28: symbol=[28]
              mc data instance MaskedBitsOfTx2Lo: category=VALUE, resulting-properties={base-type=uint8, sw-calibration-access=READ-ONLY, range raw 0..255}
              mc data instance RmSrcRomIdxOfTx2Lo: category=VALUE, resulting-properties={base-type=uint8, sw-calibration-access=READ-ONLY, compu {255=PDUR_NO_RMSRCROMIDXOFTX2LO}, range raw 0..255}
              mc data instance RmTransmitFctPtrIdxOfTx2Lo: category=VALUE, resulting-properties={base-type=uint8, sw-calibration-access=READ-ONLY, range raw 0..255}
            Element_29: symbol=[29]
              mc data instance MaskedBitsOfTx2Lo: category=VALUE, resulting-properties={base-type=uint8, sw-calibration-access=READ-ONLY, range raw 0..255}
              mc data instance RmSrcRomIdxOfTx2Lo: category=VALUE, resulting-properties={base-type=uint8, sw-calibration-access=READ-ONLY, compu {255=PDUR_NO_RMSRCROMIDXOFTX2LO}, range raw 0..255}
              mc data instance RmTransmitFctPtrIdxOfTx2Lo: category=VALUE, resulting-properties={base-type=uint8, sw-calibration-access=READ-ONLY, range raw 0..255}
            Element_30: symbol=[30]
              mc data instance MaskedBitsOfTx2Lo: category=VALUE, resulting-properties={base-type=uint8, sw-calibration-access=READ-ONLY, range raw 0..255}
              mc data instance RmSrcRomIdxOfTx2Lo: category=VALUE, resulting-properties={base-type=uint8, sw-calibration-access=READ-ONLY, compu {255=PDUR_NO_RMSRCROMIDXOFTX2LO}, range raw 0..255}
              mc data instance RmTransmitFctPtrIdxOfTx2Lo: category=VALUE, resulting-properties={base-type=uint8, sw-calibration-access=READ-ONLY, range raw 0..255}
            Element_31: symbol=[31]
              mc data instance MaskedBitsOfTx2Lo: category=VALUE, resulting-properties={base-type=uint8, sw-calibration-access=READ-ONLY, range raw 0..255}
              mc data instance RmSrcRomIdxOfTx2Lo: category=VALUE, resulting-properties={base-type=uint8, sw-calibration-access=READ-ONLY, compu {255=PDUR_NO_RMSRCROMIDXOFTX2LO}, range raw 0..255}
              mc data instance RmTransmitFctPtrIdxOfTx2Lo: category=VALUE, resulting-properties={base-type=uint8, sw-calibration-access=READ-ONLY, range raw 0..255}
            Element_32: symbol=[32]
              mc data instance MaskedBitsOfTx2Lo: category=VALUE, resulting-properties={base-type=uint8, sw-calibration-access=READ-ONLY, range raw 0..255}
              mc data instance RmSrcRomIdxOfTx2Lo: category=VALUE, resulting-properties={base-type=uint8, sw-calibration-access=READ-ONLY, compu {255=PDUR_NO_RMSRCROMIDXOFTX2LO}, range raw 0..255}
              mc data instance RmTransmitFctPtrIdxOfTx2Lo: category=VALUE, resulting-properties={base-type=uint8, sw-calibration-access=READ-ONLY, range raw 0..255}
            Element_33: symbol=[33]
              mc data instance MaskedBitsOfTx2Lo: category=VALUE, resulting-properties={base-type=uint8, sw-calibration-access=READ-ONLY, range raw 0..255}
              mc data instance RmSrcRomIdxOfTx2Lo: category=VALUE, resulting-properties={base-type=uint8, sw-calibration-access=READ-ONLY, compu {255=PDUR_NO_RMSRCROMIDXOFTX2LO}, range raw 0..255}
              mc data instance RmTransmitFctPtrIdxOfTx2Lo: category=VALUE, resulting-properties={base-type=uint8, sw-calibration-access=READ-ONLY, range raw 0..255}
            Element_34: symbol=[34]
              mc data instance MaskedBitsOfTx2Lo: category=VALUE, resulting-properties={base-type=uint8, sw-calibration-access=READ-ONLY, range raw 0..255}
              mc data instance RmSrcRomIdxOfTx2Lo: category=VALUE, resulting-properties={base-type=uint8, sw-calibration-access=READ-ONLY, compu {255=PDUR_NO_RMSRCROMIDXOFTX2LO}, range raw 0..255}
              mc data instance RmTransmitFctPtrIdxOfTx2Lo: category=VALUE, resulting-properties={base-type=uint8, sw-calibration-access=READ-ONLY, range raw 0..255}
            Element_35: symbol=[35]
              mc data instance MaskedBitsOfTx2Lo: category=VALUE, resulting-properties={base-type=uint8, sw-calibration-access=READ-ONLY, range raw 0..255}
              mc data instance RmSrcRomIdxOfTx2Lo: category=VALUE, resulting-properties={base-type=uint8, sw-calibration-access=READ-ONLY, compu {255=PDUR_NO_RMSRCROMIDXOFTX2LO}, range raw 0..255}
              mc data instance RmTransmitFctPtrIdxOfTx2Lo: category=VALUE, resulting-properties={base-type=uint8, sw-calibration-access=READ-ONLY, range raw 0..255}
            Element_36: symbol=[36]
              mc data instance MaskedBitsOfTx2Lo: category=VALUE, resulting-properties={base-type=uint8, sw-calibration-access=READ-ONLY, range raw 0..255}
              mc data instance RmSrcRomIdxOfTx2Lo: category=VALUE, resulting-properties={base-type=uint8, sw-calibration-access=READ-ONLY, compu {255=PDUR_NO_RMSRCROMIDXOFTX2LO}, range raw 0..255}
              mc data instance RmTransmitFctPtrIdxOfTx2Lo: category=VALUE, resulting-properties={base-type=uint8, sw-calibration-access=READ-ONLY, range raw 0..255}
            Element_37: symbol=[37]
              mc data instance MaskedBitsOfTx2Lo: category=VALUE, resulting-properties={base-type=uint8, sw-calibration-access=READ-ONLY, range raw 0..255}
              mc data instance RmSrcRomIdxOfTx2Lo: category=VALUE, resulting-properties={base-type=uint8, sw-calibration-access=READ-ONLY, compu {255=PDUR_NO_RMSRCROMIDXOFTX2LO}, range raw 0..255}
              mc data instance RmTransmitFctPtrIdxOfTx2Lo: category=VALUE, resulting-properties={base-type=uint8, sw-calibration-access=READ-ONLY, range raw 0..255}
            Element_38: symbol=[38]
              mc data instance MaskedBitsOfTx2Lo: category=VALUE, resulting-properties={base-type=uint8, sw-calibration-access=READ-ONLY, range raw 0..255}
              mc data instance RmSrcRomIdxOfTx2Lo: category=VALUE, resulting-properties={base-type=uint8, sw-calibration-access=READ-ONLY, compu {255=PDUR_NO_RMSRCROMIDXOFTX2LO}, range raw 0..255}
              mc data instance RmTransmitFctPtrIdxOfTx2Lo: category=VALUE, resulting-properties={base-type=uint8, sw-calibration-access=READ-ONLY, range raw 0..255}
            Element_39: symbol=[39]
              mc data instance MaskedBitsOfTx2Lo: category=VALUE, resulting-properties={base-type=uint8, sw-calibration-access=READ-ONLY, range raw 0..255}
              mc data instance RmSrcRomIdxOfTx2Lo: category=VALUE, resulting-properties={base-type=uint8, sw-calibration-access=READ-ONLY, compu {255=PDUR_NO_RMSRCROMIDXOFTX2LO}, range raw 0..255}
              mc data instance RmTransmitFctPtrIdxOfTx2Lo: category=VALUE, resulting-properties={base-type=uint8, sw-calibration-access=READ-ONLY, range raw 0..255}
            Element_40: symbol=[40]
              mc data instance MaskedBitsOfTx2Lo: category=VALUE, resulting-properties={base-type=uint8, sw-calibration-access=READ-ONLY, range raw 0..255}
              mc data instance RmSrcRomIdxOfTx2Lo: category=VALUE, resulting-properties={base-type=uint8, sw-calibration-access=READ-ONLY, compu {255=PDUR_NO_RMSRCROMIDXOFTX2LO}, range raw 0..255}
              mc data instance RmTransmitFctPtrIdxOfTx2Lo: category=VALUE, resulting-properties={base-type=uint8, sw-calibration-access=READ-ONLY, range raw 0..255}
            Element_41: symbol=[41]
              mc data instance MaskedBitsOfTx2Lo: category=VALUE, resulting-properties={base-type=uint8, sw-calibration-access=READ-ONLY, range raw 0..255}
              mc data instance RmSrcRomIdxOfTx2Lo: category=VALUE, resulting-properties={base-type=uint8, sw-calibration-access=READ-ONLY, compu {255=PDUR_NO_RMSRCROMIDXOFTX2LO}, range raw 0..255}
              mc data instance RmTransmitFctPtrIdxOfTx2Lo: category=VALUE, resulting-properties={base-type=uint8, sw-calibration-access=READ-ONLY, range raw 0..255}
            Element_42: symbol=[42]
              mc data instance MaskedBitsOfTx2Lo: category=VALUE, resulting-properties={base-type=uint8, sw-calibration-access=READ-ONLY, range raw 0..255}
              mc data instance RmSrcRomIdxOfTx2Lo: category=VALUE, resulting-properties={base-type=uint8, sw-calibration-access=READ-ONLY, compu {255=PDUR_NO_RMSRCROMIDXOFTX2LO}, range raw 0..255}
              mc data instance RmTransmitFctPtrIdxOfTx2Lo: category=VALUE, resulting-properties={base-type=uint8, sw-calibration-access=READ-ONLY, range raw 0..255}
            Element_43: symbol=[43]
              mc data instance MaskedBitsOfTx2Lo: category=VALUE, resulting-properties={base-type=uint8, sw-calibration-access=READ-ONLY, range raw 0..255}
              mc data instance RmSrcRomIdxOfTx2Lo: category=VALUE, resulting-properties={base-type=uint8, sw-calibration-access=READ-ONLY, compu {255=PDUR_NO_RMSRCROMIDXOFTX2LO}, range raw 0..255}
              mc data instance RmTransmitFctPtrIdxOfTx2Lo: category=VALUE, resulting-properties={base-type=uint8, sw-calibration-access=READ-ONLY, range raw 0..255}
            Element_44: symbol=[44]
              mc data instance MaskedBitsOfTx2Lo: category=VALUE, resulting-properties={base-type=uint8, sw-calibration-access=READ-ONLY, range raw 0..255}
              mc data instance RmSrcRomIdxOfTx2Lo: category=VALUE, resulting-properties={base-type=uint8, sw-calibration-access=READ-ONLY, compu {255=PDUR_NO_RMSRCROMIDXOFTX2LO}, range raw 0..255}
              mc data instance RmTransmitFctPtrIdxOfTx2Lo: category=VALUE, resulting-properties={base-type=uint8, sw-calibration-access=READ-ONLY, range raw 0..255}
            Element_45: symbol=[45]
              mc data instance MaskedBitsOfTx2Lo: category=VALUE, resulting-properties={base-type=uint8, sw-calibration-access=READ-ONLY, range raw 0..255}
              mc data instance RmSrcRomIdxOfTx2Lo: category=VALUE, resulting-properties={base-type=uint8, sw-calibration-access=READ-ONLY, compu {255=PDUR_NO_RMSRCROMIDXOFTX2LO}, range raw 0..255}
              mc data instance RmTransmitFctPtrIdxOfTx2Lo: category=VALUE, resulting-properties={base-type=uint8, sw-calibration-access=READ-ONLY, range raw 0..255}
            Element_46: symbol=[46]
              mc data instance MaskedBitsOfTx2Lo: category=VALUE, resulting-properties={base-type=uint8, sw-calibration-access=READ-ONLY, range raw 0..255}
              mc data instance RmSrcRomIdxOfTx2Lo: category=VALUE, resulting-properties={base-type=uint8, sw-calibration-access=READ-ONLY, compu {255=PDUR_NO_RMSRCROMIDXOFTX2LO}, range raw 0..255}
              mc data instance RmTransmitFctPtrIdxOfTx2Lo: category=VALUE, resulting-properties={base-type=uint8, sw-calibration-access=READ-ONLY, range raw 0..255}
            Element_47: symbol=[47]
              mc data instance MaskedBitsOfTx2Lo: category=VALUE, resulting-properties={base-type=uint8, sw-calibration-access=READ-ONLY, range raw 0..255}
              mc data instance RmSrcRomIdxOfTx2Lo: category=VALUE, resulting-properties={base-type=uint8, sw-calibration-access=READ-ONLY, compu {255=PDUR_NO_RMSRCROMIDXOFTX2LO}, range raw 0..255}
              mc data instance RmTransmitFctPtrIdxOfTx2Lo: category=VALUE, resulting-properties={base-type=uint8, sw-calibration-access=READ-ONLY, range raw 0..255}
            Element_48: symbol=[48]
              mc data instance MaskedBitsOfTx2Lo: category=VALUE, resulting-properties={base-type=uint8, sw-calibration-access=READ-ONLY, range raw 0..255}
              mc data instance RmSrcRomIdxOfTx2Lo: category=VALUE, resulting-properties={base-type=uint8, sw-calibration-access=READ-ONLY, compu {255=PDUR_NO_RMSRCROMIDXOFTX2LO}, range raw 0..255}
              mc data instance RmTransmitFctPtrIdxOfTx2Lo: category=VALUE, resulting-properties={base-type=uint8, sw-calibration-access=READ-ONLY, range raw 0..255}
            Element_49: symbol=[49]
              mc data instance MaskedBitsOfTx2Lo: category=VALUE, resulting-properties={base-type=uint8, sw-calibration-access=READ-ONLY, range raw 0..255}
              mc data instance RmSrcRomIdxOfTx2Lo: category=VALUE, resulting-properties={base-type=uint8, sw-calibration-access=READ-ONLY, compu {255=PDUR_NO_RMSRCROMIDXOFTX2LO}, range raw 0..255}
              mc data instance RmTransmitFctPtrIdxOfTx2Lo: category=VALUE, resulting-properties={base-type=uint8, sw-calibration-access=READ-ONLY, range raw 0..255}
            Element_50: symbol=[50]
              mc data instance MaskedBitsOfTx2Lo: category=VALUE, resulting-properties={base-type=uint8, sw-calibration-access=READ-ONLY, range raw 0..255}
              mc data instance RmSrcRomIdxOfTx2Lo: category=VALUE, resulting-properties={base-type=uint8, sw-calibration-access=READ-ONLY, compu {255=PDUR_NO_RMSRCROMIDXOFTX2LO}, range raw 0..255}
              mc data instance RmTransmitFctPtrIdxOfTx2Lo: category=VALUE, resulting-properties={base-type=uint8, sw-calibration-access=READ-ONLY, range raw 0..255}
            Element_51: symbol=[51]
              mc data instance MaskedBitsOfTx2Lo: category=VALUE, resulting-properties={base-type=uint8, sw-calibration-access=READ-ONLY, range raw 0..255}
              mc data instance RmSrcRomIdxOfTx2Lo: category=VALUE, resulting-properties={base-type=uint8, sw-calibration-access=READ-ONLY, compu {255=PDUR_NO_RMSRCROMIDXOFTX2LO}, range raw 0..255}
              mc data instance RmTransmitFctPtrIdxOfTx2Lo: category=VALUE, resulting-properties={base-type=uint8, sw-calibration-access=READ-ONLY, range raw 0..255}
            Element_52: symbol=[52]
              mc data instance MaskedBitsOfTx2Lo: category=VALUE, resulting-properties={base-type=uint8, sw-calibration-access=READ-ONLY, range raw 0..255}
              mc data instance RmSrcRomIdxOfTx2Lo: category=VALUE, resulting-properties={base-type=uint8, sw-calibration-access=READ-ONLY, compu {255=PDUR_NO_RMSRCROMIDXOFTX2LO}, range raw 0..255}
              mc data instance RmTransmitFctPtrIdxOfTx2Lo: category=VALUE, resulting-properties={base-type=uint8, sw-calibration-access=READ-ONLY, range raw 0..255}
            Element_53: symbol=[53]
              mc data instance MaskedBitsOfTx2Lo: category=VALUE, resulting-properties={base-type=uint8, sw-calibration-access=READ-ONLY, range raw 0..255}
              mc data instance RmSrcRomIdxOfTx2Lo: category=VALUE, resulting-properties={base-type=uint8, sw-calibration-access=READ-ONLY, compu {255=PDUR_NO_RMSRCROMIDXOFTX2LO}, range raw 0..255}
              mc data instance RmTransmitFctPtrIdxOfTx2Lo: category=VALUE, resulting-properties={base-type=uint8, sw-calibration-access=READ-ONLY, range raw 0..255}
            Element_54: symbol=[54]
              mc data instance MaskedBitsOfTx2Lo: category=VALUE, resulting-properties={base-type=uint8, sw-calibration-access=READ-ONLY, range raw 0..255}
              mc data instance RmSrcRomIdxOfTx2Lo: category=VALUE, resulting-properties={base-type=uint8, sw-calibration-access=READ-ONLY, compu {255=PDUR_NO_RMSRCROMIDXOFTX2LO}, range raw 0..255}
              mc data instance RmTransmitFctPtrIdxOfTx2Lo: category=VALUE, resulting-properties={base-type=uint8, sw-calibration-access=READ-ONLY, range raw 0..255}
            Element_55: symbol=[55]
              mc data instance MaskedBitsOfTx2Lo: category=VALUE, resulting-properties={base-type=uint8, sw-calibration-access=READ-ONLY, range raw 0..255}
              mc data instance RmSrcRomIdxOfTx2Lo: category=VALUE, resulting-properties={base-type=uint8, sw-calibration-access=READ-ONLY, compu {255=PDUR_NO_RMSRCROMIDXOFTX2LO}, range raw 0..255}
              mc data instance RmTransmitFctPtrIdxOfTx2Lo: category=VALUE, resulting-properties={base-type=uint8, sw-calibration-access=READ-ONLY, range raw 0..255}
            Element_56: symbol=[56]
              mc data instance MaskedBitsOfTx2Lo: category=VALUE, resulting-properties={base-type=uint8, sw-calibration-access=READ-ONLY, range raw 0..255}
              mc data instance RmSrcRomIdxOfTx2Lo: category=VALUE, resulting-properties={base-type=uint8, sw-calibration-access=READ-ONLY, compu {255=PDUR_NO_RMSRCROMIDXOFTX2LO}, range raw 0..255}
              mc data instance RmTransmitFctPtrIdxOfTx2Lo: category=VALUE, resulting-properties={base-type=uint8, sw-calibration-access=READ-ONLY, range raw 0..255}
            Element_57: symbol=[57]
              mc data instance MaskedBitsOfTx2Lo: category=VALUE, resulting-properties={base-type=uint8, sw-calibration-access=READ-ONLY, range raw 0..255}
              mc data instance RmSrcRomIdxOfTx2Lo: category=VALUE, resulting-properties={base-type=uint8, sw-calibration-access=READ-ONLY, compu {255=PDUR_NO_RMSRCROMIDXOFTX2LO}, range raw 0..255}
              mc data instance RmTransmitFctPtrIdxOfTx2Lo: category=VALUE, resulting-properties={base-type=uint8, sw-calibration-access=READ-ONLY, range raw 0..255}
            Element_58: symbol=[58]
              mc data instance MaskedBitsOfTx2Lo: category=VALUE, resulting-properties={base-type=uint8, sw-calibration-access=READ-ONLY, range raw 0..255}
              mc data instance RmSrcRomIdxOfTx2Lo: category=VALUE, resulting-properties={base-type=uint8, sw-calibration-access=READ-ONLY, compu {255=PDUR_NO_RMSRCROMIDXOFTX2LO}, range raw 0..255}
              mc data instance RmTransmitFctPtrIdxOfTx2Lo: category=VALUE, resulting-properties={base-type=uint8, sw-calibration-access=READ-ONLY, range raw 0..255}
            Element_59: symbol=[59]
              mc data instance MaskedBitsOfTx2Lo: category=VALUE, resulting-properties={base-type=uint8, sw-calibration-access=READ-ONLY, range raw 0..255}
              mc data instance RmSrcRomIdxOfTx2Lo: category=VALUE, resulting-properties={base-type=uint8, sw-calibration-access=READ-ONLY, compu {255=PDUR_NO_RMSRCROMIDXOFTX2LO}, range raw 0..255}
              mc data instance RmTransmitFctPtrIdxOfTx2Lo: category=VALUE, resulting-properties={base-type=uint8, sw-calibration-access=READ-ONLY, range raw 0..255}
            Element_60: symbol=[60]
              mc data instance MaskedBitsOfTx2Lo: category=VALUE, resulting-properties={base-type=uint8, sw-calibration-access=READ-ONLY, range raw 0..255}
              mc data instance RmSrcRomIdxOfTx2Lo: category=VALUE, resulting-properties={base-type=uint8, sw-calibration-access=READ-ONLY, compu {255=PDUR_NO_RMSRCROMIDXOFTX2LO}, range raw 0..255}
              mc data instance RmTransmitFctPtrIdxOfTx2Lo: category=VALUE, resulting-properties={base-type=uint8, sw-calibration-access=READ-ONLY, range raw 0..255}
            Element_61: symbol=[61]
              mc data instance MaskedBitsOfTx2Lo: category=VALUE, resulting-properties={base-type=uint8, sw-calibration-access=READ-ONLY, range raw 0..255}
              mc data instance RmSrcRomIdxOfTx2Lo: category=VALUE, resulting-properties={base-type=uint8, sw-calibration-access=READ-ONLY, compu {255=PDUR_NO_RMSRCROMIDXOFTX2LO}, range raw 0..255}
              mc data instance RmTransmitFctPtrIdxOfTx2Lo: category=VALUE, resulting-properties={base-type=uint8, sw-calibration-access=READ-ONLY, range raw 0..255}
            Element_62: symbol=[62]
              mc data instance MaskedBitsOfTx2Lo: category=VALUE, resulting-properties={base-type=uint8, sw-calibration-access=READ-ONLY, range raw 0..255}
              mc data instance RmSrcRomIdxOfTx2Lo: category=VALUE, resulting-properties={base-type=uint8, sw-calibration-access=READ-ONLY, compu {255=PDUR_NO_RMSRCROMIDXOFTX2LO}, range raw 0..255}
              mc data instance RmTransmitFctPtrIdxOfTx2Lo: category=VALUE, resulting-properties={base-type=uint8, sw-calibration-access=READ-ONLY, range raw 0..255}
            Element_63: symbol=[63]
              mc data instance MaskedBitsOfTx2Lo: category=VALUE, resulting-properties={base-type=uint8, sw-calibration-access=READ-ONLY, range raw 0..255}
              mc data instance RmSrcRomIdxOfTx2Lo: category=VALUE, resulting-properties={base-type=uint8, sw-calibration-access=READ-ONLY, compu {255=PDUR_NO_RMSRCROMIDXOFTX2LO}, range raw 0..255}
              mc data instance RmTransmitFctPtrIdxOfTx2Lo: category=VALUE, resulting-properties={base-type=uint8, sw-calibration-access=READ-ONLY, range raw 0..255}
            Element_64: symbol=[64]
              mc data instance MaskedBitsOfTx2Lo: category=VALUE, resulting-properties={base-type=uint8, sw-calibration-access=READ-ONLY, range raw 0..255}
              mc data instance RmSrcRomIdxOfTx2Lo: category=VALUE, resulting-properties={base-type=uint8, sw-calibration-access=READ-ONLY, compu {255=PDUR_NO_RMSRCROMIDXOFTX2LO}, range raw 0..255}
              mc data instance RmTransmitFctPtrIdxOfTx2Lo: category=VALUE, resulting-properties={base-type=uint8, sw-calibration-access=READ-ONLY, range raw 0..255}
            Element_65: symbol=[65]
              mc data instance MaskedBitsOfTx2Lo: category=VALUE, resulting-properties={base-type=uint8, sw-calibration-access=READ-ONLY, range raw 0..255}
              mc data instance RmSrcRomIdxOfTx2Lo: category=VALUE, resulting-properties={base-type=uint8, sw-calibration-access=READ-ONLY, compu {255=PDUR_NO_RMSRCROMIDXOFTX2LO}, range raw 0..255}
              mc data instance RmTransmitFctPtrIdxOfTx2Lo: category=VALUE, resulting-properties={base-type=uint8, sw-calibration-access=READ-ONLY, range raw 0..255}
            Element_66: symbol=[66]
              mc data instance MaskedBitsOfTx2Lo: category=VALUE, resulting-properties={base-type=uint8, sw-calibration-access=READ-ONLY, range raw 0..255}
              mc data instance RmSrcRomIdxOfTx2Lo: category=VALUE, resulting-properties={base-type=uint8, sw-calibration-access=READ-ONLY, compu {255=PDUR_NO_RMSRCROMIDXOFTX2LO}, range raw 0..255}
              mc data instance RmTransmitFctPtrIdxOfTx2Lo: category=VALUE, resulting-properties={base-type=uint8, sw-calibration-access=READ-ONLY, range raw 0..255}
            Element_67: symbol=[67]
              mc data instance MaskedBitsOfTx2Lo: category=VALUE, resulting-properties={base-type=uint8, sw-calibration-access=READ-ONLY, range raw 0..255}
              mc data instance RmSrcRomIdxOfTx2Lo: category=VALUE, resulting-properties={base-type=uint8, sw-calibration-access=READ-ONLY, compu {255=PDUR_NO_RMSRCROMIDXOFTX2LO}, range raw 0..255}
              mc data instance RmTransmitFctPtrIdxOfTx2Lo: category=VALUE, resulting-properties={base-type=uint8, sw-calibration-access=READ-ONLY, range raw 0..255}
            Element_68: symbol=[68]
              mc data instance MaskedBitsOfTx2Lo: category=VALUE, resulting-properties={base-type=uint8, sw-calibration-access=READ-ONLY, range raw 0..255}
              mc data instance RmSrcRomIdxOfTx2Lo: category=VALUE, resulting-properties={base-type=uint8, sw-calibration-access=READ-ONLY, compu {255=PDUR_NO_RMSRCROMIDXOFTX2LO}, range raw 0..255}
              mc data instance RmTransmitFctPtrIdxOfTx2Lo: category=VALUE, resulting-properties={base-type=uint8, sw-calibration-access=READ-ONLY, range raw 0..255}
            Element_69: symbol=[69]
              mc data instance MaskedBitsOfTx2Lo: category=VALUE, resulting-properties={base-type=uint8, sw-calibration-access=READ-ONLY, range raw 0..255}
              mc data instance RmSrcRomIdxOfTx2Lo: category=VALUE, resulting-properties={base-type=uint8, sw-calibration-access=READ-ONLY, compu {255=PDUR_NO_RMSRCROMIDXOFTX2LO}, range raw 0..255}
              mc data instance RmTransmitFctPtrIdxOfTx2Lo: category=VALUE, resulting-properties={base-type=uint8, sw-calibration-access=READ-ONLY, range raw 0..255}
            Element_70: symbol=[70]
              mc data instance MaskedBitsOfTx2Lo: category=VALUE, resulting-properties={base-type=uint8, sw-calibration-access=READ-ONLY, range raw 0..255}
              mc data instance RmSrcRomIdxOfTx2Lo: category=VALUE, resulting-properties={base-type=uint8, sw-calibration-access=READ-ONLY, compu {255=PDUR_NO_RMSRCROMIDXOFTX2LO}, range raw 0..255}
              mc data instance RmTransmitFctPtrIdxOfTx2Lo: category=VALUE, resulting-properties={base-type=uint8, sw-calibration-access=READ-ONLY, range raw 0..255}
            Element_71: symbol=[71]
              mc data instance MaskedBitsOfTx2Lo: category=VALUE, resulting-properties={base-type=uint8, sw-calibration-access=READ-ONLY, range raw 0..255}
              mc data instance RmSrcRomIdxOfTx2Lo: category=VALUE, resulting-properties={base-type=uint8, sw-calibration-access=READ-ONLY, compu {255=PDUR_NO_RMSRCROMIDXOFTX2LO}, range raw 0..255}
              mc data instance RmTransmitFctPtrIdxOfTx2Lo: category=VALUE, resulting-properties={base-type=uint8, sw-calibration-access=READ-ONLY, range raw 0..255}
            Element_72: symbol=[72]
              mc data instance MaskedBitsOfTx2Lo: category=VALUE, resulting-properties={base-type=uint8, sw-calibration-access=READ-ONLY, range raw 0..255}
              mc data instance RmSrcRomIdxOfTx2Lo: category=VALUE, resulting-properties={base-type=uint8, sw-calibration-access=READ-ONLY, compu {255=PDUR_NO_RMSRCROMIDXOFTX2LO}, range raw 0..255}
              mc data instance RmTransmitFctPtrIdxOfTx2Lo: category=VALUE, resulting-properties={base-type=uint8, sw-calibration-access=READ-ONLY, range raw 0..255}
            Element_73: symbol=[73]
              mc data instance MaskedBitsOfTx2Lo: category=VALUE, resulting-properties={base-type=uint8, sw-calibration-access=READ-ONLY, range raw 0..255}
              mc data instance RmSrcRomIdxOfTx2Lo: category=VALUE, resulting-properties={base-type=uint8, sw-calibration-access=READ-ONLY, compu {255=PDUR_NO_RMSRCROMIDXOFTX2LO}, range raw 0..255}
              mc data instance RmTransmitFctPtrIdxOfTx2Lo: category=VALUE, resulting-properties={base-type=uint8, sw-calibration-access=READ-ONLY, range raw 0..255}
            Element_74: symbol=[74]
              mc data instance MaskedBitsOfTx2Lo: category=VALUE, resulting-properties={base-type=uint8, sw-calibration-access=READ-ONLY, range raw 0..255}
              mc data instance RmSrcRomIdxOfTx2Lo: category=VALUE, resulting-properties={base-type=uint8, sw-calibration-access=READ-ONLY, compu {255=PDUR_NO_RMSRCROMIDXOFTX2LO}, range raw 0..255}
              mc data instance RmTransmitFctPtrIdxOfTx2Lo: category=VALUE, resulting-properties={base-type=uint8, sw-calibration-access=READ-ONLY, range raw 0..255}
            Element_75: symbol=[75]
              mc data instance MaskedBitsOfTx2Lo: category=VALUE, resulting-properties={base-type=uint8, sw-calibration-access=READ-ONLY, range raw 0..255}
              mc data instance RmSrcRomIdxOfTx2Lo: category=VALUE, resulting-properties={base-type=uint8, sw-calibration-access=READ-ONLY, compu {255=PDUR_NO_RMSRCROMIDXOFTX2LO}, range raw 0..255}
              mc data instance RmTransmitFctPtrIdxOfTx2Lo: category=VALUE, resulting-properties={base-type=uint8, sw-calibration-access=READ-ONLY, range raw 0..255}
            Element_76: symbol=[76]
              mc data instance MaskedBitsOfTx2Lo: category=VALUE, resulting-properties={base-type=uint8, sw-calibration-access=READ-ONLY, range raw 0..255}
              mc data instance RmSrcRomIdxOfTx2Lo: category=VALUE, resulting-properties={base-type=uint8, sw-calibration-access=READ-ONLY, compu {255=PDUR_NO_RMSRCROMIDXOFTX2LO}, range raw 0..255}
              mc data instance RmTransmitFctPtrIdxOfTx2Lo: category=VALUE, resulting-properties={base-type=uint8, sw-calibration-access=READ-ONLY, range raw 0..255}
            Element_77: symbol=[77]
              mc data instance MaskedBitsOfTx2Lo: category=VALUE, resulting-properties={base-type=uint8, sw-calibration-access=READ-ONLY, range raw 0..255}
              mc data instance RmSrcRomIdxOfTx2Lo: category=VALUE, resulting-properties={base-type=uint8, sw-calibration-access=READ-ONLY, compu {255=PDUR_NO_RMSRCROMIDXOFTX2LO}, range raw 0..255}
              mc data instance RmTransmitFctPtrIdxOfTx2Lo: category=VALUE, resulting-properties={base-type=uint8, sw-calibration-access=READ-ONLY, range raw 0..255}
            Element_78: symbol=[78]
              mc data instance MaskedBitsOfTx2Lo: category=VALUE, resulting-properties={base-type=uint8, sw-calibration-access=READ-ONLY, range raw 0..255}
              mc data instance RmSrcRomIdxOfTx2Lo: category=VALUE, resulting-properties={base-type=uint8, sw-calibration-access=READ-ONLY, compu {255=PDUR_NO_RMSRCROMIDXOFTX2LO}, range raw 0..255}
              mc data instance RmTransmitFctPtrIdxOfTx2Lo: category=VALUE, resulting-properties={base-type=uint8, sw-calibration-access=READ-ONLY, range raw 0..255}
            Element_79: symbol=[79]
              mc data instance MaskedBitsOfTx2Lo: category=VALUE, resulting-properties={base-type=uint8, sw-calibration-access=READ-ONLY, range raw 0..255}
              mc data instance RmSrcRomIdxOfTx2Lo: category=VALUE, resulting-properties={base-type=uint8, sw-calibration-access=READ-ONLY, compu {255=PDUR_NO_RMSRCROMIDXOFTX2LO}, range raw 0..255}
              mc data instance RmTransmitFctPtrIdxOfTx2Lo: category=VALUE, resulting-properties={base-type=uint8, sw-calibration-access=READ-ONLY, range raw 0..255}
            Element_80: symbol=[80]
              mc data instance MaskedBitsOfTx2Lo: category=VALUE, resulting-properties={base-type=uint8, sw-calibration-access=READ-ONLY, range raw 0..255}
              mc data instance RmSrcRomIdxOfTx2Lo: category=VALUE, resulting-properties={base-type=uint8, sw-calibration-access=READ-ONLY, compu {255=PDUR_NO_RMSRCROMIDXOFTX2LO}, range raw 0..255}
              mc data instance RmTransmitFctPtrIdxOfTx2Lo: category=VALUE, resulting-properties={base-type=uint8, sw-calibration-access=READ-ONLY, range raw 0..255}
            Element_81: symbol=[81]
              mc data instance MaskedBitsOfTx2Lo: category=VALUE, resulting-properties={base-type=uint8, sw-calibration-access=READ-ONLY, range raw 0..255}
              mc data instance RmSrcRomIdxOfTx2Lo: category=VALUE, resulting-properties={base-type=uint8, sw-calibration-access=READ-ONLY, compu {255=PDUR_NO_RMSRCROMIDXOFTX2LO}, range raw 0..255}
              mc data instance RmTransmitFctPtrIdxOfTx2Lo: category=VALUE, resulting-properties={base-type=uint8, sw-calibration-access=READ-ONLY, range raw 0..255}
            Element_82: symbol=[82]
              mc data instance MaskedBitsOfTx2Lo: category=VALUE, resulting-properties={base-type=uint8, sw-calibration-access=READ-ONLY, range raw 0..255}
              mc data instance RmSrcRomIdxOfTx2Lo: category=VALUE, resulting-properties={base-type=uint8, sw-calibration-access=READ-ONLY, compu {255=PDUR_NO_RMSRCROMIDXOFTX2LO}, range raw 0..255}
              mc data instance RmTransmitFctPtrIdxOfTx2Lo: category=VALUE, resulting-properties={base-type=uint8, sw-calibration-access=READ-ONLY, range raw 0..255}
            Element_83: symbol=[83]
              mc data instance MaskedBitsOfTx2Lo: category=VALUE, resulting-properties={base-type=uint8, sw-calibration-access=READ-ONLY, range raw 0..255}
              mc data instance RmSrcRomIdxOfTx2Lo: category=VALUE, resulting-properties={base-type=uint8, sw-calibration-access=READ-ONLY, compu {255=PDUR_NO_RMSRCROMIDXOFTX2LO}, range raw 0..255}
              mc data instance RmTransmitFctPtrIdxOfTx2Lo: category=VALUE, resulting-properties={base-type=uint8, sw-calibration-access=READ-ONLY, range raw 0..255}
            Element_84: symbol=[84]
              mc data instance MaskedBitsOfTx2Lo: category=VALUE, resulting-properties={base-type=uint8, sw-calibration-access=READ-ONLY, range raw 0..255}
              mc data instance RmSrcRomIdxOfTx2Lo: category=VALUE, resulting-properties={base-type=uint8, sw-calibration-access=READ-ONLY, compu {255=PDUR_NO_RMSRCROMIDXOFTX2LO}, range raw 0..255}
              mc data instance RmTransmitFctPtrIdxOfTx2Lo: category=VALUE, resulting-properties={base-type=uint8, sw-calibration-access=READ-ONLY, range raw 0..255}
            Element_85: symbol=[85]
              mc data instance MaskedBitsOfTx2Lo: category=VALUE, resulting-properties={base-type=uint8, sw-calibration-access=READ-ONLY, range raw 0..255}
              mc data instance RmSrcRomIdxOfTx2Lo: category=VALUE, resulting-properties={base-type=uint8, sw-calibration-access=READ-ONLY, compu {255=PDUR_NO_RMSRCROMIDXOFTX2LO}, range raw 0..255}
              mc data instance RmTransmitFctPtrIdxOfTx2Lo: category=VALUE, resulting-properties={base-type=uint8, sw-calibration-access=READ-ONLY, range raw 0..255}
            Element_86: symbol=[86]
              mc data instance MaskedBitsOfTx2Lo: category=VALUE, resulting-properties={base-type=uint8, sw-calibration-access=READ-ONLY, range raw 0..255}
              mc data instance RmSrcRomIdxOfTx2Lo: category=VALUE, resulting-properties={base-type=uint8, sw-calibration-access=READ-ONLY, compu {255=PDUR_NO_RMSRCROMIDXOFTX2LO}, range raw 0..255}
              mc data instance RmTransmitFctPtrIdxOfTx2Lo: category=VALUE, resulting-properties={base-type=uint8, sw-calibration-access=READ-ONLY, range raw 0..255}
            Element_87: symbol=[87]
              mc data instance MaskedBitsOfTx2Lo: category=VALUE, resulting-properties={base-type=uint8, sw-calibration-access=READ-ONLY, range raw 0..255}
              mc data instance RmSrcRomIdxOfTx2Lo: category=VALUE, resulting-properties={base-type=uint8, sw-calibration-access=READ-ONLY, compu {255=PDUR_NO_RMSRCROMIDXOFTX2LO}, range raw 0..255}
              mc data instance RmTransmitFctPtrIdxOfTx2Lo: category=VALUE, resulting-properties={base-type=uint8, sw-calibration-access=READ-ONLY, range raw 0..255}
            Element_88: symbol=[88]
              mc data instance MaskedBitsOfTx2Lo: category=VALUE, resulting-properties={base-type=uint8, sw-calibration-access=READ-ONLY, range raw 0..255}
              mc data instance RmSrcRomIdxOfTx2Lo: category=VALUE, resulting-properties={base-type=uint8, sw-calibration-access=READ-ONLY, compu {255=PDUR_NO_RMSRCROMIDXOFTX2LO}, range raw 0..255}
              mc data instance RmTransmitFctPtrIdxOfTx2Lo: category=VALUE, resulting-properties={base-type=uint8, sw-calibration-access=READ-ONLY, range raw 0..255}
            Element_89: symbol=[89]
              mc data instance MaskedBitsOfTx2Lo: category=VALUE, resulting-properties={base-type=uint8, sw-calibration-access=READ-ONLY, range raw 0..255}
              mc data instance RmSrcRomIdxOfTx2Lo: category=VALUE, resulting-properties={base-type=uint8, sw-calibration-access=READ-ONLY, compu {255=PDUR_NO_RMSRCROMIDXOFTX2LO}, range raw 0..255}
              mc data instance RmTransmitFctPtrIdxOfTx2Lo: category=VALUE, resulting-properties={base-type=uint8, sw-calibration-access=READ-ONLY, range raw 0..255}
            Element_90: symbol=[90]
              mc data instance MaskedBitsOfTx2Lo: category=VALUE, resulting-properties={base-type=uint8, sw-calibration-access=READ-ONLY, range raw 0..255}
              mc data instance RmSrcRomIdxOfTx2Lo: category=VALUE, resulting-properties={base-type=uint8, sw-calibration-access=READ-ONLY, compu {255=PDUR_NO_RMSRCROMIDXOFTX2LO}, range raw 0..255}
              mc data instance RmTransmitFctPtrIdxOfTx2Lo: category=VALUE, resulting-properties={base-type=uint8, sw-calibration-access=READ-ONLY, range raw 0..255}
            Element_91: symbol=[91]
              mc data instance MaskedBitsOfTx2Lo: category=VALUE, resulting-properties={base-type=uint8, sw-calibration-access=READ-ONLY, range raw 0..255}
              mc data instance RmSrcRomIdxOfTx2Lo: category=VALUE, resulting-properties={base-type=uint8, sw-calibration-access=READ-ONLY, compu {255=PDUR_NO_RMSRCROMIDXOFTX2LO}, range raw 0..255}
              mc data instance RmTransmitFctPtrIdxOfTx2Lo: category=VALUE, resulting-properties={base-type=uint8, sw-calibration-access=READ-ONLY, range raw 0..255}
            Element_92: symbol=[92]
              mc data instance MaskedBitsOfTx2Lo: category=VALUE, resulting-properties={base-type=uint8, sw-calibration-access=READ-ONLY, range raw 0..255}
              mc data instance RmSrcRomIdxOfTx2Lo: category=VALUE, resulting-properties={base-type=uint8, sw-calibration-access=READ-ONLY, compu {255=PDUR_NO_RMSRCROMIDXOFTX2LO}, range raw 0..255}
              mc data instance RmTransmitFctPtrIdxOfTx2Lo: category=VALUE, resulting-properties={base-type=uint8, sw-calibration-access=READ-ONLY, range raw 0..255}
            Element_93: symbol=[93]
              mc data instance MaskedBitsOfTx2Lo: category=VALUE, resulting-properties={base-type=uint8, sw-calibration-access=READ-ONLY, range raw 0..255}
              mc data instance RmSrcRomIdxOfTx2Lo: category=VALUE, resulting-properties={base-type=uint8, sw-calibration-access=READ-ONLY, compu {255=PDUR_NO_RMSRCROMIDXOFTX2LO}, range raw 0..255}
              mc data instance RmTransmitFctPtrIdxOfTx2Lo: category=VALUE, resulting-properties={base-type=uint8, sw-calibration-access=READ-ONLY, range raw 0..255}
            Element_94: symbol=[94]
              mc data instance MaskedBitsOfTx2Lo: category=VALUE, resulting-properties={base-type=uint8, sw-calibration-access=READ-ONLY, range raw 0..255}
              mc data instance RmSrcRomIdxOfTx2Lo: category=VALUE, resulting-properties={base-type=uint8, sw-calibration-access=READ-ONLY, compu {255=PDUR_NO_RMSRCROMIDXOFTX2LO}, range raw 0..255}
              mc data instance RmTransmitFctPtrIdxOfTx2Lo: category=VALUE, resulting-properties={base-type=uint8, sw-calibration-access=READ-ONLY, range raw 0..255}
            Element_95: symbol=[95]
              mc data instance MaskedBitsOfTx2Lo: category=VALUE, resulting-properties={base-type=uint8, sw-calibration-access=READ-ONLY, range raw 0..255}
              mc data instance RmSrcRomIdxOfTx2Lo: category=VALUE, resulting-properties={base-type=uint8, sw-calibration-access=READ-ONLY, compu {255=PDUR_NO_RMSRCROMIDXOFTX2LO}, range raw 0..255}
              mc data instance RmTransmitFctPtrIdxOfTx2Lo: category=VALUE, resulting-properties={base-type=uint8, sw-calibration-access=READ-ONLY, range raw 0..255}
            Element_96: symbol=[96]
              mc data instance MaskedBitsOfTx2Lo: category=VALUE, resulting-properties={base-type=uint8, sw-calibration-access=READ-ONLY, range raw 0..255}
              mc data instance RmSrcRomIdxOfTx2Lo: category=VALUE, resulting-properties={base-type=uint8, sw-calibration-access=READ-ONLY, compu {255=PDUR_NO_RMSRCROMIDXOFTX2LO}, range raw 0..255}
              mc data instance RmTransmitFctPtrIdxOfTx2Lo: category=VALUE, resulting-properties={base-type=uint8, sw-calibration-access=READ-ONLY, range raw 0..255}
            Element_97: symbol=[97]
              mc data instance MaskedBitsOfTx2Lo: category=VALUE, resulting-properties={base-type=uint8, sw-calibration-access=READ-ONLY, range raw 0..255}
              mc data instance RmSrcRomIdxOfTx2Lo: category=VALUE, resulting-properties={base-type=uint8, sw-calibration-access=READ-ONLY, compu {255=PDUR_NO_RMSRCROMIDXOFTX2LO}, range raw 0..255}
              mc data instance RmTransmitFctPtrIdxOfTx2Lo: category=VALUE, resulting-properties={base-type=uint8, sw-calibration-access=READ-ONLY, range raw 0..255}
            Element_98: symbol=[98]
              mc data instance MaskedBitsOfTx2Lo: category=VALUE, resulting-properties={base-type=uint8, sw-calibration-access=READ-ONLY, range raw 0..255}
              mc data instance RmSrcRomIdxOfTx2Lo: category=VALUE, resulting-properties={base-type=uint8, sw-calibration-access=READ-ONLY, compu {255=PDUR_NO_RMSRCROMIDXOFTX2LO}, range raw 0..255}
              mc data instance RmTransmitFctPtrIdxOfTx2Lo: category=VALUE, resulting-properties={base-type=uint8, sw-calibration-access=READ-ONLY, range raw 0..255}
            Element_99: symbol=[99]
              mc data instance MaskedBitsOfTx2Lo: category=VALUE, resulting-properties={base-type=uint8, sw-calibration-access=READ-ONLY, range raw 0..255}
              mc data instance RmSrcRomIdxOfTx2Lo: category=VALUE, resulting-properties={base-type=uint8, sw-calibration-access=READ-ONLY, compu {255=PDUR_NO_RMSRCROMIDXOFTX2LO}, range raw 0..255}
              mc data instance RmTransmitFctPtrIdxOfTx2Lo: category=VALUE, resulting-properties={base-type=uint8, sw-calibration-access=READ-ONLY, range raw 0..255}
            Element_100: symbol=[100]
              mc data instance MaskedBitsOfTx2Lo: category=VALUE, resulting-properties={base-type=uint8, sw-calibration-access=READ-ONLY, range raw 0..255}
              mc data instance RmSrcRomIdxOfTx2Lo: category=VALUE, resulting-properties={base-type=uint8, sw-calibration-access=READ-ONLY, compu {255=PDUR_NO_RMSRCROMIDXOFTX2LO}, range raw 0..255}
              mc data instance RmTransmitFctPtrIdxOfTx2Lo: category=VALUE, resulting-properties={base-type=uint8, sw-calibration-access=READ-ONLY, range raw 0..255}
            Element_101: symbol=[101]
              mc data instance MaskedBitsOfTx2Lo: category=VALUE, resulting-properties={base-type=uint8, sw-calibration-access=READ-ONLY, range raw 0..255}
              mc data instance RmSrcRomIdxOfTx2Lo: category=VALUE, resulting-properties={base-type=uint8, sw-calibration-access=READ-ONLY, compu {255=PDUR_NO_RMSRCROMIDXOFTX2LO}, range raw 0..255}
              mc data instance RmTransmitFctPtrIdxOfTx2Lo: category=VALUE, resulting-properties={base-type=uint8, sw-calibration-access=READ-ONLY, range raw 0..255}
            Element_102: symbol=[102]
              mc data instance MaskedBitsOfTx2Lo: category=VALUE, resulting-properties={base-type=uint8, sw-calibration-access=READ-ONLY, range raw 0..255}
              mc data instance RmSrcRomIdxOfTx2Lo: category=VALUE, resulting-properties={base-type=uint8, sw-calibration-access=READ-ONLY, compu {255=PDUR_NO_RMSRCROMIDXOFTX2LO}, range raw 0..255}
              mc data instance RmTransmitFctPtrIdxOfTx2Lo: category=VALUE, resulting-properties={base-type=uint8, sw-calibration-access=READ-ONLY, range raw 0..255}
            Element_103: symbol=[103]
              mc data instance MaskedBitsOfTx2Lo: category=VALUE, resulting-properties={base-type=uint8, sw-calibration-access=READ-ONLY, range raw 0..255}
              mc data instance RmSrcRomIdxOfTx2Lo: category=VALUE, resulting-properties={base-type=uint8, sw-calibration-access=READ-ONLY, compu {255=PDUR_NO_RMSRCROMIDXOFTX2LO}, range raw 0..255}
              mc data instance RmTransmitFctPtrIdxOfTx2Lo: category=VALUE, resulting-properties={base-type=uint8, sw-calibration-access=READ-ONLY, range raw 0..255}
            Element_104: symbol=[104]
              mc data instance MaskedBitsOfTx2Lo: category=VALUE, resulting-properties={base-type=uint8, sw-calibration-access=READ-ONLY, range raw 0..255}
              mc data instance RmSrcRomIdxOfTx2Lo: category=VALUE, resulting-properties={base-type=uint8, sw-calibration-access=READ-ONLY, compu {255=PDUR_NO_RMSRCROMIDXOFTX2LO}, range raw 0..255}
              mc data instance RmTransmitFctPtrIdxOfTx2Lo: category=VALUE, resulting-properties={base-type=uint8, sw-calibration-access=READ-ONLY, range raw 0..255}
            Element_105: symbol=[105]
              mc data instance MaskedBitsOfTx2Lo: category=VALUE, resulting-properties={base-type=uint8, sw-calibration-access=READ-ONLY, range raw 0..255}
              mc data instance RmSrcRomIdxOfTx2Lo: category=VALUE, resulting-properties={base-type=uint8, sw-calibration-access=READ-ONLY, compu {255=PDUR_NO_RMSRCROMIDXOFTX2LO}, range raw 0..255}
              mc data instance RmTransmitFctPtrIdxOfTx2Lo: category=VALUE, resulting-properties={base-type=uint8, sw-calibration-access=READ-ONLY, range raw 0..255}
            Element_106: symbol=[106]
              mc data instance MaskedBitsOfTx2Lo: category=VALUE, resulting-properties={base-type=uint8, sw-calibration-access=READ-ONLY, range raw 0..255}
              mc data instance RmSrcRomIdxOfTx2Lo: category=VALUE, resulting-properties={base-type=uint8, sw-calibration-access=READ-ONLY, compu {255=PDUR_NO_RMSRCROMIDXOFTX2LO}, range raw 0..255}
              mc data instance RmTransmitFctPtrIdxOfTx2Lo: category=VALUE, resulting-properties={base-type=uint8, sw-calibration-access=READ-ONLY, range raw 0..255}
            Element_107: symbol=[107]
              mc data instance MaskedBitsOfTx2Lo: category=VALUE, resulting-properties={base-type=uint8, sw-calibration-access=READ-ONLY, range raw 0..255}
              mc data instance RmSrcRomIdxOfTx2Lo: category=VALUE, resulting-properties={base-type=uint8, sw-calibration-access=READ-ONLY, compu {255=PDUR_NO_RMSRCROMIDXOFTX2LO}, range raw 0..255}
              mc data instance RmTransmitFctPtrIdxOfTx2Lo: category=VALUE, resulting-properties={base-type=uint8, sw-calibration-access=READ-ONLY, range raw 0..255}
            Element_108: symbol=[108]
              mc data instance MaskedBitsOfTx2Lo: category=VALUE, resulting-properties={base-type=uint8, sw-calibration-access=READ-ONLY, range raw 0..255}
              mc data instance RmSrcRomIdxOfTx2Lo: category=VALUE, resulting-properties={base-type=uint8, sw-calibration-access=READ-ONLY, compu {255=PDUR_NO_RMSRCROMIDXOFTX2LO}, range raw 0..255}
              mc data instance RmTransmitFctPtrIdxOfTx2Lo: category=VALUE, resulting-properties={base-type=uint8, sw-calibration-access=READ-ONLY, range raw 0..255}
            Element_109: symbol=[109]
              mc data instance MaskedBitsOfTx2Lo: category=VALUE, resulting-properties={base-type=uint8, sw-calibration-access=READ-ONLY, range raw 0..255}
              mc data instance RmSrcRomIdxOfTx2Lo: category=VALUE, resulting-properties={base-type=uint8, sw-calibration-access=READ-ONLY, compu {255=PDUR_NO_RMSRCROMIDXOFTX2LO}, range raw 0..255}
              mc data instance RmTransmitFctPtrIdxOfTx2Lo: category=VALUE, resulting-properties={base-type=uint8, sw-calibration-access=READ-ONLY, range raw 0..255}
            Element_110: symbol=[110]
              mc data instance MaskedBitsOfTx2Lo: category=VALUE, resulting-properties={base-type=uint8, sw-calibration-access=READ-ONLY, range raw 0..255}
              mc data instance RmSrcRomIdxOfTx2Lo: category=VALUE, resulting-properties={base-type=uint8, sw-calibration-access=READ-ONLY, compu {255=PDUR_NO_RMSRCROMIDXOFTX2LO}, range raw 0..255}
              mc data instance RmTransmitFctPtrIdxOfTx2Lo: category=VALUE, resulting-properties={base-type=uint8, sw-calibration-access=READ-ONLY, range raw 0..255}
            Element_111: symbol=[111]
              mc data instance MaskedBitsOfTx2Lo: category=VALUE, resulting-properties={base-type=uint8, sw-calibration-access=READ-ONLY, range raw 0..255}
              mc data instance RmSrcRomIdxOfTx2Lo: category=VALUE, resulting-properties={base-type=uint8, sw-calibration-access=READ-ONLY, compu {255=PDUR_NO_RMSRCROMIDXOFTX2LO}, range raw 0..255}
              mc data instance RmTransmitFctPtrIdxOfTx2Lo: category=VALUE, resulting-properties={base-type=uint8, sw-calibration-access=READ-ONLY, range raw 0..255}
            Element_112: symbol=[112]
              mc data instance MaskedBitsOfTx2Lo: category=VALUE, resulting-properties={base-type=uint8, sw-calibration-access=READ-ONLY, range raw 0..255}
              mc data instance RmSrcRomIdxOfTx2Lo: category=VALUE, resulting-properties={base-type=uint8, sw-calibration-access=READ-ONLY, compu {255=PDUR_NO_RMSRCROMIDXOFTX2LO}, range raw 0..255}
              mc data instance RmTransmitFctPtrIdxOfTx2Lo: category=VALUE, resulting-properties={base-type=uint8, sw-calibration-access=READ-ONLY, range raw 0..255}
            Element_113: symbol=[113]
              mc data instance MaskedBitsOfTx2Lo: category=VALUE, resulting-properties={base-type=uint8, sw-calibration-access=READ-ONLY, range raw 0..255}
              mc data instance RmSrcRomIdxOfTx2Lo: category=VALUE, resulting-properties={base-type=uint8, sw-calibration-access=READ-ONLY, compu {255=PDUR_NO_RMSRCROMIDXOFTX2LO}, range raw 0..255}
              mc data instance RmTransmitFctPtrIdxOfTx2Lo: category=VALUE, resulting-properties={base-type=uint8, sw-calibration-access=READ-ONLY, range raw 0..255}
            Element_114: symbol=[114]
              mc data instance MaskedBitsOfTx2Lo: category=VALUE, resulting-properties={base-type=uint8, sw-calibration-access=READ-ONLY, range raw 0..255}
              mc data instance RmSrcRomIdxOfTx2Lo: category=VALUE, resulting-properties={base-type=uint8, sw-calibration-access=READ-ONLY, compu {255=PDUR_NO_RMSRCROMIDXOFTX2LO}, range raw 0..255}
              mc data instance RmTransmitFctPtrIdxOfTx2Lo: category=VALUE, resulting-properties={base-type=uint8, sw-calibration-access=READ-ONLY, range raw 0..255}
            Element_115: symbol=[115]
              mc data instance MaskedBitsOfTx2Lo: category=VALUE, resulting-properties={base-type=uint8, sw-calibration-access=READ-ONLY, range raw 0..255}
              mc data instance RmSrcRomIdxOfTx2Lo: category=VALUE, resulting-properties={base-type=uint8, sw-calibration-access=READ-ONLY, compu {255=PDUR_NO_RMSRCROMIDXOFTX2LO}, range raw 0..255}
              mc data instance RmTransmitFctPtrIdxOfTx2Lo: category=VALUE, resulting-properties={base-type=uint8, sw-calibration-access=READ-ONLY, range raw 0..255}
            Element_116: symbol=[116]
              mc data instance MaskedBitsOfTx2Lo: category=VALUE, resulting-properties={base-type=uint8, sw-calibration-access=READ-ONLY, range raw 0..255}
              mc data instance RmSrcRomIdxOfTx2Lo: category=VALUE, resulting-properties={base-type=uint8, sw-calibration-access=READ-ONLY, compu {255=PDUR_NO_RMSRCROMIDXOFTX2LO}, range raw 0..255}
              mc data instance RmTransmitFctPtrIdxOfTx2Lo: category=VALUE, resulting-properties={base-type=uint8, sw-calibration-access=READ-ONLY, range raw 0..255}
            Element_117: symbol=[117]
              mc data instance MaskedBitsOfTx2Lo: category=VALUE, resulting-properties={base-type=uint8, sw-calibration-access=READ-ONLY, range raw 0..255}
              mc data instance RmSrcRomIdxOfTx2Lo: category=VALUE, resulting-properties={base-type=uint8, sw-calibration-access=READ-ONLY, compu {255=PDUR_NO_RMSRCROMIDXOFTX2LO}, range raw 0..255}
              mc data instance RmTransmitFctPtrIdxOfTx2Lo: category=VALUE, resulting-properties={base-type=uint8, sw-calibration-access=READ-ONLY, range raw 0..255}
            Element_118: symbol=[118]
              mc data instance MaskedBitsOfTx2Lo: category=VALUE, resulting-properties={base-type=uint8, sw-calibration-access=READ-ONLY, range raw 0..255}
              mc data instance RmSrcRomIdxOfTx2Lo: category=VALUE, resulting-properties={base-type=uint8, sw-calibration-access=READ-ONLY, compu {255=PDUR_NO_RMSRCROMIDXOFTX2LO}, range raw 0..255}
              mc data instance RmTransmitFctPtrIdxOfTx2Lo: category=VALUE, resulting-properties={base-type=uint8, sw-calibration-access=READ-ONLY, range raw 0..255}
            Element_119: symbol=[119]
              mc data instance MaskedBitsOfTx2Lo: category=VALUE, resulting-properties={base-type=uint8, sw-calibration-access=READ-ONLY, range raw 0..255}
              mc data instance RmSrcRomIdxOfTx2Lo: category=VALUE, resulting-properties={base-type=uint8, sw-calibration-access=READ-ONLY, compu {255=PDUR_NO_RMSRCROMIDXOFTX2LO}, range raw 0..255}
              mc data instance RmTransmitFctPtrIdxOfTx2Lo: category=VALUE, resulting-properties={base-type=uint8, sw-calibration-access=READ-ONLY, range raw 0..255}
            Element_120: symbol=[120]
              mc data instance MaskedBitsOfTx2Lo: category=VALUE, resulting-properties={base-type=uint8, sw-calibration-access=READ-ONLY, range raw 0..255}
              mc data instance RmSrcRomIdxOfTx2Lo: category=VALUE, resulting-properties={base-type=uint8, sw-calibration-access=READ-ONLY, compu {255=PDUR_NO_RMSRCROMIDXOFTX2LO}, range raw 0..255}
              mc data instance RmTransmitFctPtrIdxOfTx2Lo: category=VALUE, resulting-properties={base-type=uint8, sw-calibration-access=READ-ONLY, range raw 0..255}
            Element_121: symbol=[121]
              mc data instance MaskedBitsOfTx2Lo: category=VALUE, resulting-properties={base-type=uint8, sw-calibration-access=READ-ONLY, range raw 0..255}
              mc data instance RmSrcRomIdxOfTx2Lo: category=VALUE, resulting-properties={base-type=uint8, sw-calibration-access=READ-ONLY, compu {255=PDUR_NO_RMSRCROMIDXOFTX2LO}, range raw 0..255}
              mc data instance RmTransmitFctPtrIdxOfTx2Lo: category=VALUE, resulting-properties={base-type=uint8, sw-calibration-access=READ-ONLY, range raw 0..255}
            Element_122: symbol=[122]
              mc data instance MaskedBitsOfTx2Lo: category=VALUE, resulting-properties={base-type=uint8, sw-calibration-access=READ-ONLY, range raw 0..255}
              mc data instance RmSrcRomIdxOfTx2Lo: category=VALUE, resulting-properties={base-type=uint8, sw-calibration-access=READ-ONLY, compu {255=PDUR_NO_RMSRCROMIDXOFTX2LO}, range raw 0..255}
              mc data instance RmTransmitFctPtrIdxOfTx2Lo: category=VALUE, resulting-properties={base-type=uint8, sw-calibration-access=READ-ONLY, range raw 0..255}
            Element_123: symbol=[123]
              mc data instance MaskedBitsOfTx2Lo: category=VALUE, resulting-properties={base-type=uint8, sw-calibration-access=READ-ONLY, range raw 0..255}
              mc data instance RmSrcRomIdxOfTx2Lo: category=VALUE, resulting-properties={base-type=uint8, sw-calibration-access=READ-ONLY, compu {255=PDUR_NO_RMSRCROMIDXOFTX2LO}, range raw 0..255}
              mc data instance RmTransmitFctPtrIdxOfTx2Lo: category=VALUE, resulting-properties={base-type=uint8, sw-calibration-access=READ-ONLY, range raw 0..255}
            Element_124: symbol=[124]
              mc data instance MaskedBitsOfTx2Lo: category=VALUE, resulting-properties={base-type=uint8, sw-calibration-access=READ-ONLY, range raw 0..255}
              mc data instance RmSrcRomIdxOfTx2Lo: category=VALUE, resulting-properties={base-type=uint8, sw-calibration-access=READ-ONLY, compu {255=PDUR_NO_RMSRCROMIDXOFTX2LO}, range raw 0..255}
              mc data instance RmTransmitFctPtrIdxOfTx2Lo: category=VALUE, resulting-properties={base-type=uint8, sw-calibration-access=READ-ONLY, range raw 0..255}
            Element_125: symbol=[125]
              mc data instance MaskedBitsOfTx2Lo: category=VALUE, resulting-properties={base-type=uint8, sw-calibration-access=READ-ONLY, range raw 0..255}
              mc data instance RmSrcRomIdxOfTx2Lo: category=VALUE, resulting-properties={base-type=uint8, sw-calibration-access=READ-ONLY, compu {255=PDUR_NO_RMSRCROMIDXOFTX2LO}, range raw 0..255}
              mc data instance RmTransmitFctPtrIdxOfTx2Lo: category=VALUE, resulting-properties={base-type=uint8, sw-calibration-access=READ-ONLY, range raw 0..255}
            Element_126: symbol=[126]
              mc data instance MaskedBitsOfTx2Lo: category=VALUE, resulting-properties={base-type=uint8, sw-calibration-access=READ-ONLY, range raw 0..255}
              mc data instance RmSrcRomIdxOfTx2Lo: category=VALUE, resulting-properties={base-type=uint8, sw-calibration-access=READ-ONLY, compu {255=PDUR_NO_RMSRCROMIDXOFTX2LO}, range raw 0..255}
              mc data instance RmTransmitFctPtrIdxOfTx2Lo: category=VALUE, resulting-properties={base-type=uint8, sw-calibration-access=READ-ONLY, range raw 0..255}
            Element_127: symbol=[127]
              mc data instance MaskedBitsOfTx2Lo: category=VALUE, resulting-properties={base-type=uint8, sw-calibration-access=READ-ONLY, range raw 0..255}
              mc data instance RmSrcRomIdxOfTx2Lo: category=VALUE, resulting-properties={base-type=uint8, sw-calibration-access=READ-ONLY, compu {255=PDUR_NO_RMSRCROMIDXOFTX2LO}, range raw 0..255}
              mc data instance RmTransmitFctPtrIdxOfTx2Lo: category=VALUE, resulting-properties={base-type=uint8, sw-calibration-access=READ-ONLY, range raw 0..255}
            Element_128: symbol=[128]
              mc data instance MaskedBitsOfTx2Lo: category=VALUE, resulting-properties={base-type=uint8, sw-calibration-access=READ-ONLY, range raw 0..255}
              mc data instance RmSrcRomIdxOfTx2Lo: category=VALUE, resulting-properties={base-type=uint8, sw-calibration-access=READ-ONLY, compu {255=PDUR_NO_RMSRCROMIDXOFTX2LO}, range raw 0..255}
              mc data instance RmTransmitFctPtrIdxOfTx2Lo: category=VALUE, resulting-properties={base-type=uint8, sw-calibration-access=READ-ONLY, range raw 0..255}
            Element_129: symbol=[129]
              mc data instance MaskedBitsOfTx2Lo: category=VALUE, resulting-properties={base-type=uint8, sw-calibration-access=READ-ONLY, range raw 0..255}
              mc data instance RmSrcRomIdxOfTx2Lo: category=VALUE, resulting-properties={base-type=uint8, sw-calibration-access=READ-ONLY, compu {255=PDUR_NO_RMSRCROMIDXOFTX2LO}, range raw 0..255}
              mc data instance RmTransmitFctPtrIdxOfTx2Lo: category=VALUE, resulting-properties={base-type=uint8, sw-calibration-access=READ-ONLY, range raw 0..255}
            Element_130: symbol=[130]
              mc data instance MaskedBitsOfTx2Lo: category=VALUE, resulting-properties={base-type=uint8, sw-calibration-access=READ-ONLY, range raw 0..255}
              mc data instance RmSrcRomIdxOfTx2Lo: category=VALUE, resulting-properties={base-type=uint8, sw-calibration-access=READ-ONLY, compu {255=PDUR_NO_RMSRCROMIDXOFTX2LO}, range raw 0..255}
              mc data instance RmTransmitFctPtrIdxOfTx2Lo: category=VALUE, resulting-properties={base-type=uint8, sw-calibration-access=READ-ONLY, range raw 0..255}
            Element_131: symbol=[131]
              mc data instance MaskedBitsOfTx2Lo: category=VALUE, resulting-properties={base-type=uint8, sw-calibration-access=READ-ONLY, range raw 0..255}
              mc data instance RmSrcRomIdxOfTx2Lo: category=VALUE, resulting-properties={base-type=uint8, sw-calibration-access=READ-ONLY, compu {255=PDUR_NO_RMSRCROMIDXOFTX2LO}, range raw 0..255}
              mc data instance RmTransmitFctPtrIdxOfTx2Lo: category=VALUE, resulting-properties={base-type=uint8, sw-calibration-access=READ-ONLY, range raw 0..255}
            Element_132: symbol=[132]
              mc data instance MaskedBitsOfTx2Lo: category=VALUE, resulting-properties={base-type=uint8, sw-calibration-access=READ-ONLY, range raw 0..255}
              mc data instance RmSrcRomIdxOfTx2Lo: category=VALUE, resulting-properties={base-type=uint8, sw-calibration-access=READ-ONLY, compu {255=PDUR_NO_RMSRCROMIDXOFTX2LO}, range raw 0..255}
              mc data instance RmTransmitFctPtrIdxOfTx2Lo: category=VALUE, resulting-properties={base-type=uint8, sw-calibration-access=READ-ONLY, range raw 0..255}
            Element_133: symbol=[133]
              mc data instance MaskedBitsOfTx2Lo: category=VALUE, resulting-properties={base-type=uint8, sw-calibration-access=READ-ONLY, range raw 0..255}
              mc data instance RmSrcRomIdxOfTx2Lo: category=VALUE, resulting-properties={base-type=uint8, sw-calibration-access=READ-ONLY, compu {255=PDUR_NO_RMSRCROMIDXOFTX2LO}, range raw 0..255}
              mc data instance RmTransmitFctPtrIdxOfTx2Lo: category=VALUE, resulting-properties={base-type=uint8, sw-calibration-access=READ-ONLY, range raw 0..255}
            Element_134: symbol=[134]
              mc data instance MaskedBitsOfTx2Lo: category=VALUE, resulting-properties={base-type=uint8, sw-calibration-access=READ-ONLY, range raw 0..255}
              mc data instance RmSrcRomIdxOfTx2Lo: category=VALUE, resulting-properties={base-type=uint8, sw-calibration-access=READ-ONLY, compu {255=PDUR_NO_RMSRCROMIDXOFTX2LO}, range raw 0..255}
              mc data instance RmTransmitFctPtrIdxOfTx2Lo: category=VALUE, resulting-properties={base-type=uint8, sw-calibration-access=READ-ONLY, range raw 0..255}
            Element_135: symbol=[135]
              mc data instance MaskedBitsOfTx2Lo: category=VALUE, resulting-properties={base-type=uint8, sw-calibration-access=READ-ONLY, range raw 0..255}
              mc data instance RmSrcRomIdxOfTx2Lo: category=VALUE, resulting-properties={base-type=uint8, sw-calibration-access=READ-ONLY, compu {255=PDUR_NO_RMSRCROMIDXOFTX2LO}, range raw 0..255}
              mc data instance RmTransmitFctPtrIdxOfTx2Lo: category=VALUE, resulting-properties={base-type=uint8, sw-calibration-access=READ-ONLY, range raw 0..255}
            Element_136: symbol=[136]
              mc data instance MaskedBitsOfTx2Lo: category=VALUE, resulting-properties={base-type=uint8, sw-calibration-access=READ-ONLY, range raw 0..255}
              mc data instance RmSrcRomIdxOfTx2Lo: category=VALUE, resulting-properties={base-type=uint8, sw-calibration-access=READ-ONLY, compu {255=PDUR_NO_RMSRCROMIDXOFTX2LO}, range raw 0..255}
              mc data instance RmTransmitFctPtrIdxOfTx2Lo: category=VALUE, resulting-properties={base-type=uint8, sw-calibration-access=READ-ONLY, range raw 0..255}
            Element_137: symbol=[137]
              mc data instance MaskedBitsOfTx2Lo: category=VALUE, resulting-properties={base-type=uint8, sw-calibration-access=READ-ONLY, range raw 0..255}
              mc data instance RmSrcRomIdxOfTx2Lo: category=VALUE, resulting-properties={base-type=uint8, sw-calibration-access=READ-ONLY, compu {255=PDUR_NO_RMSRCROMIDXOFTX2LO}, range raw 0..255}
              mc data instance RmTransmitFctPtrIdxOfTx2Lo: category=VALUE, resulting-properties={base-type=uint8, sw-calibration-access=READ-ONLY, range raw 0..255}
            Element_138: symbol=[138]
              mc data instance MaskedBitsOfTx2Lo: category=VALUE, resulting-properties={base-type=uint8, sw-calibration-access=READ-ONLY, range raw 0..255}
              mc data instance RmSrcRomIdxOfTx2Lo: category=VALUE, resulting-properties={base-type=uint8, sw-calibration-access=READ-ONLY, compu {255=PDUR_NO_RMSRCROMIDXOFTX2LO}, range raw 0..255}
              mc data instance RmTransmitFctPtrIdxOfTx2Lo: category=VALUE, resulting-properties={base-type=uint8, sw-calibration-access=READ-ONLY, range raw 0..255}
            Element_139: symbol=[139]
              mc data instance MaskedBitsOfTx2Lo: category=VALUE, resulting-properties={base-type=uint8, sw-calibration-access=READ-ONLY, range raw 0..255}
              mc data instance RmSrcRomIdxOfTx2Lo: category=VALUE, resulting-properties={base-type=uint8, sw-calibration-access=READ-ONLY, compu {255=PDUR_NO_RMSRCROMIDXOFTX2LO}, range raw 0..255}
              mc data instance RmTransmitFctPtrIdxOfTx2Lo: category=VALUE, resulting-properties={base-type=uint8, sw-calibration-access=READ-ONLY, range raw 0..255}
            Element_140: symbol=[140]
              mc data instance MaskedBitsOfTx2Lo: category=VALUE, resulting-properties={base-type=uint8, sw-calibration-access=READ-ONLY, range raw 0..255}
              mc data instance RmSrcRomIdxOfTx2Lo: category=VALUE, resulting-properties={base-type=uint8, sw-calibration-access=READ-ONLY, compu {255=PDUR_NO_RMSRCROMIDXOFTX2LO}, range raw 0..255}
              mc data instance RmTransmitFctPtrIdxOfTx2Lo: category=VALUE, resulting-properties={base-type=uint8, sw-calibration-access=READ-ONLY, range raw 0..255}
            Element_141: symbol=[141]
              mc data instance MaskedBitsOfTx2Lo: category=VALUE, resulting-properties={base-type=uint8, sw-calibration-access=READ-ONLY, range raw 0..255}
              mc data instance RmSrcRomIdxOfTx2Lo: category=VALUE, resulting-properties={base-type=uint8, sw-calibration-access=READ-ONLY, compu {255=PDUR_NO_RMSRCROMIDXOFTX2LO}, range raw 0..255}
              mc data instance RmTransmitFctPtrIdxOfTx2Lo: category=VALUE, resulting-properties={base-type=uint8, sw-calibration-access=READ-ONLY, range raw 0..255}
        PduR_TxIf2Up: array-size=67  # This table contains all routing information to perform the Tx handling of an interface routing. Used in the &lt;LLIf&gt;_TriggerTransmit and &lt;LLIf&gt;_TxConfirmation
          67 x mc data instance, all with category=STRUCTURE:
            Element_0: symbol=[0]
              mc data instance TxConfirmationUsedOfTxIf2Up: category=VALUE, resulting-properties={base-type=boolean, sw-calibration-access=READ-ONLY, compu {0=FALSE, 1..255=TRUE}, range raw 0..1}
              mc data instance RmGDestRomIdxOfTxIf2Up: category=VALUE, resulting-properties={base-type=uint8, sw-calibration-access=READ-ONLY, range raw 0..255}
            Element_1: symbol=[1]
              mc data instance TxConfirmationUsedOfTxIf2Up: category=VALUE, resulting-properties={base-type=boolean, sw-calibration-access=READ-ONLY, compu {0=FALSE, 1..255=TRUE}, range raw 0..1}
              mc data instance RmGDestRomIdxOfTxIf2Up: category=VALUE, resulting-properties={base-type=uint8, sw-calibration-access=READ-ONLY, range raw 0..255}
            Element_2: symbol=[2]
              mc data instance TxConfirmationUsedOfTxIf2Up: category=VALUE, resulting-properties={base-type=boolean, sw-calibration-access=READ-ONLY, compu {0=FALSE, 1..255=TRUE}, range raw 0..1}
              mc data instance RmGDestRomIdxOfTxIf2Up: category=VALUE, resulting-properties={base-type=uint8, sw-calibration-access=READ-ONLY, range raw 0..255}
            Element_3: symbol=[3]
              mc data instance TxConfirmationUsedOfTxIf2Up: category=VALUE, resulting-properties={base-type=boolean, sw-calibration-access=READ-ONLY, compu {0=FALSE, 1..255=TRUE}, range raw 0..1}
              mc data instance RmGDestRomIdxOfTxIf2Up: category=VALUE, resulting-properties={base-type=uint8, sw-calibration-access=READ-ONLY, range raw 0..255}
            Element_4: symbol=[4]
              mc data instance TxConfirmationUsedOfTxIf2Up: category=VALUE, resulting-properties={base-type=boolean, sw-calibration-access=READ-ONLY, compu {0=FALSE, 1..255=TRUE}, range raw 0..1}
              mc data instance RmGDestRomIdxOfTxIf2Up: category=VALUE, resulting-properties={base-type=uint8, sw-calibration-access=READ-ONLY, range raw 0..255}
            Element_5: symbol=[5]
              mc data instance TxConfirmationUsedOfTxIf2Up: category=VALUE, resulting-properties={base-type=boolean, sw-calibration-access=READ-ONLY, compu {0=FALSE, 1..255=TRUE}, range raw 0..1}
              mc data instance RmGDestRomIdxOfTxIf2Up: category=VALUE, resulting-properties={base-type=uint8, sw-calibration-access=READ-ONLY, range raw 0..255}
            Element_6: symbol=[6]
              mc data instance TxConfirmationUsedOfTxIf2Up: category=VALUE, resulting-properties={base-type=boolean, sw-calibration-access=READ-ONLY, compu {0=FALSE, 1..255=TRUE}, range raw 0..1}
              mc data instance RmGDestRomIdxOfTxIf2Up: category=VALUE, resulting-properties={base-type=uint8, sw-calibration-access=READ-ONLY, range raw 0..255}
            Element_7: symbol=[7]
              mc data instance TxConfirmationUsedOfTxIf2Up: category=VALUE, resulting-properties={base-type=boolean, sw-calibration-access=READ-ONLY, compu {0=FALSE, 1..255=TRUE}, range raw 0..1}
              mc data instance RmGDestRomIdxOfTxIf2Up: category=VALUE, resulting-properties={base-type=uint8, sw-calibration-access=READ-ONLY, range raw 0..255}
            Element_8: symbol=[8]
              mc data instance TxConfirmationUsedOfTxIf2Up: category=VALUE, resulting-properties={base-type=boolean, sw-calibration-access=READ-ONLY, compu {0=FALSE, 1..255=TRUE}, range raw 0..1}
              mc data instance RmGDestRomIdxOfTxIf2Up: category=VALUE, resulting-properties={base-type=uint8, sw-calibration-access=READ-ONLY, range raw 0..255}
            Element_9: symbol=[9]
              mc data instance TxConfirmationUsedOfTxIf2Up: category=VALUE, resulting-properties={base-type=boolean, sw-calibration-access=READ-ONLY, compu {0=FALSE, 1..255=TRUE}, range raw 0..1}
              mc data instance RmGDestRomIdxOfTxIf2Up: category=VALUE, resulting-properties={base-type=uint8, sw-calibration-access=READ-ONLY, range raw 0..255}
            Element_10: symbol=[10]
              mc data instance TxConfirmationUsedOfTxIf2Up: category=VALUE, resulting-properties={base-type=boolean, sw-calibration-access=READ-ONLY, compu {0=FALSE, 1..255=TRUE}, range raw 0..1}
              mc data instance RmGDestRomIdxOfTxIf2Up: category=VALUE, resulting-properties={base-type=uint8, sw-calibration-access=READ-ONLY, range raw 0..255}
            Element_11: symbol=[11]
              mc data instance TxConfirmationUsedOfTxIf2Up: category=VALUE, resulting-properties={base-type=boolean, sw-calibration-access=READ-ONLY, compu {0=FALSE, 1..255=TRUE}, range raw 0..1}
              mc data instance RmGDestRomIdxOfTxIf2Up: category=VALUE, resulting-properties={base-type=uint8, sw-calibration-access=READ-ONLY, range raw 0..255}
            Element_12: symbol=[12]
              mc data instance TxConfirmationUsedOfTxIf2Up: category=VALUE, resulting-properties={base-type=boolean, sw-calibration-access=READ-ONLY, compu {0=FALSE, 1..255=TRUE}, range raw 0..1}
              mc data instance RmGDestRomIdxOfTxIf2Up: category=VALUE, resulting-properties={base-type=uint8, sw-calibration-access=READ-ONLY, range raw 0..255}
            Element_13: symbol=[13]
              mc data instance TxConfirmationUsedOfTxIf2Up: category=VALUE, resulting-properties={base-type=boolean, sw-calibration-access=READ-ONLY, compu {0=FALSE, 1..255=TRUE}, range raw 0..1}
              mc data instance RmGDestRomIdxOfTxIf2Up: category=VALUE, resulting-properties={base-type=uint8, sw-calibration-access=READ-ONLY, range raw 0..255}
            Element_14: symbol=[14]
              mc data instance TxConfirmationUsedOfTxIf2Up: category=VALUE, resulting-properties={base-type=boolean, sw-calibration-access=READ-ONLY, compu {0=FALSE, 1..255=TRUE}, range raw 0..1}
              mc data instance RmGDestRomIdxOfTxIf2Up: category=VALUE, resulting-properties={base-type=uint8, sw-calibration-access=READ-ONLY, range raw 0..255}
            Element_15: symbol=[15]
              mc data instance TxConfirmationUsedOfTxIf2Up: category=VALUE, resulting-properties={base-type=boolean, sw-calibration-access=READ-ONLY, compu {0=FALSE, 1..255=TRUE}, range raw 0..1}
              mc data instance RmGDestRomIdxOfTxIf2Up: category=VALUE, resulting-properties={base-type=uint8, sw-calibration-access=READ-ONLY, range raw 0..255}
            Element_16: symbol=[16]
              mc data instance TxConfirmationUsedOfTxIf2Up: category=VALUE, resulting-properties={base-type=boolean, sw-calibration-access=READ-ONLY, compu {0=FALSE, 1..255=TRUE}, range raw 0..1}
              mc data instance RmGDestRomIdxOfTxIf2Up: category=VALUE, resulting-properties={base-type=uint8, sw-calibration-access=READ-ONLY, range raw 0..255}
            Element_17: symbol=[17]
              mc data instance TxConfirmationUsedOfTxIf2Up: category=VALUE, resulting-properties={base-type=boolean, sw-calibration-access=READ-ONLY, compu {0=FALSE, 1..255=TRUE}, range raw 0..1}
              mc data instance RmGDestRomIdxOfTxIf2Up: category=VALUE, resulting-properties={base-type=uint8, sw-calibration-access=READ-ONLY, range raw 0..255}
            Element_18: symbol=[18]
              mc data instance TxConfirmationUsedOfTxIf2Up: category=VALUE, resulting-properties={base-type=boolean, sw-calibration-access=READ-ONLY, compu {0=FALSE, 1..255=TRUE}, range raw 0..1}
              mc data instance RmGDestRomIdxOfTxIf2Up: category=VALUE, resulting-properties={base-type=uint8, sw-calibration-access=READ-ONLY, range raw 0..255}
            Element_19: symbol=[19]
              mc data instance TxConfirmationUsedOfTxIf2Up: category=VALUE, resulting-properties={base-type=boolean, sw-calibration-access=READ-ONLY, compu {0=FALSE, 1..255=TRUE}, range raw 0..1}
              mc data instance RmGDestRomIdxOfTxIf2Up: category=VALUE, resulting-properties={base-type=uint8, sw-calibration-access=READ-ONLY, range raw 0..255}
            Element_20: symbol=[20]
              mc data instance TxConfirmationUsedOfTxIf2Up: category=VALUE, resulting-properties={base-type=boolean, sw-calibration-access=READ-ONLY, compu {0=FALSE, 1..255=TRUE}, range raw 0..1}
              mc data instance RmGDestRomIdxOfTxIf2Up: category=VALUE, resulting-properties={base-type=uint8, sw-calibration-access=READ-ONLY, range raw 0..255}
            Element_21: symbol=[21]
              mc data instance TxConfirmationUsedOfTxIf2Up: category=VALUE, resulting-properties={base-type=boolean, sw-calibration-access=READ-ONLY, compu {0=FALSE, 1..255=TRUE}, range raw 0..1}
              mc data instance RmGDestRomIdxOfTxIf2Up: category=VALUE, resulting-properties={base-type=uint8, sw-calibration-access=READ-ONLY, range raw 0..255}
            Element_22: symbol=[22]
              mc data instance TxConfirmationUsedOfTxIf2Up: category=VALUE, resulting-properties={base-type=boolean, sw-calibration-access=READ-ONLY, compu {0=FALSE, 1..255=TRUE}, range raw 0..1}
              mc data instance RmGDestRomIdxOfTxIf2Up: category=VALUE, resulting-properties={base-type=uint8, sw-calibration-access=READ-ONLY, range raw 0..255}
            Element_23: symbol=[23]
              mc data instance TxConfirmationUsedOfTxIf2Up: category=VALUE, resulting-properties={base-type=boolean, sw-calibration-access=READ-ONLY, compu {0=FALSE, 1..255=TRUE}, range raw 0..1}
              mc data instance RmGDestRomIdxOfTxIf2Up: category=VALUE, resulting-properties={base-type=uint8, sw-calibration-access=READ-ONLY, range raw 0..255}
            Element_24: symbol=[24]
              mc data instance TxConfirmationUsedOfTxIf2Up: category=VALUE, resulting-properties={base-type=boolean, sw-calibration-access=READ-ONLY, compu {0=FALSE, 1..255=TRUE}, range raw 0..1}
              mc data instance RmGDestRomIdxOfTxIf2Up: category=VALUE, resulting-properties={base-type=uint8, sw-calibration-access=READ-ONLY, range raw 0..255}
            Element_25: symbol=[25]
              mc data instance TxConfirmationUsedOfTxIf2Up: category=VALUE, resulting-properties={base-type=boolean, sw-calibration-access=READ-ONLY, compu {0=FALSE, 1..255=TRUE}, range raw 0..1}
              mc data instance RmGDestRomIdxOfTxIf2Up: category=VALUE, resulting-properties={base-type=uint8, sw-calibration-access=READ-ONLY, range raw 0..255}
            Element_26: symbol=[26]
              mc data instance TxConfirmationUsedOfTxIf2Up: category=VALUE, resulting-properties={base-type=boolean, sw-calibration-access=READ-ONLY, compu {0=FALSE, 1..255=TRUE}, range raw 0..1}
              mc data instance RmGDestRomIdxOfTxIf2Up: category=VALUE, resulting-properties={base-type=uint8, sw-calibration-access=READ-ONLY, range raw 0..255}
            Element_27: symbol=[27]
              mc data instance TxConfirmationUsedOfTxIf2Up: category=VALUE, resulting-properties={base-type=boolean, sw-calibration-access=READ-ONLY, compu {0=FALSE, 1..255=TRUE}, range raw 0..1}
              mc data instance RmGDestRomIdxOfTxIf2Up: category=VALUE, resulting-properties={base-type=uint8, sw-calibration-access=READ-ONLY, range raw 0..255}
            Element_28: symbol=[28]
              mc data instance TxConfirmationUsedOfTxIf2Up: category=VALUE, resulting-properties={base-type=boolean, sw-calibration-access=READ-ONLY, compu {0=FALSE, 1..255=TRUE}, range raw 0..1}
              mc data instance RmGDestRomIdxOfTxIf2Up: category=VALUE, resulting-properties={base-type=uint8, sw-calibration-access=READ-ONLY, range raw 0..255}
            Element_29: symbol=[29]
              mc data instance TxConfirmationUsedOfTxIf2Up: category=VALUE, resulting-properties={base-type=boolean, sw-calibration-access=READ-ONLY, compu {0=FALSE, 1..255=TRUE}, range raw 0..1}
              mc data instance RmGDestRomIdxOfTxIf2Up: category=VALUE, resulting-properties={base-type=uint8, sw-calibration-access=READ-ONLY, range raw 0..255}
            Element_30: symbol=[30]
              mc data instance TxConfirmationUsedOfTxIf2Up: category=VALUE, resulting-properties={base-type=boolean, sw-calibration-access=READ-ONLY, compu {0=FALSE, 1..255=TRUE}, range raw 0..1}
              mc data instance RmGDestRomIdxOfTxIf2Up: category=VALUE, resulting-properties={base-type=uint8, sw-calibration-access=READ-ONLY, range raw 0..255}
            Element_31: symbol=[31]
              mc data instance TxConfirmationUsedOfTxIf2Up: category=VALUE, resulting-properties={base-type=boolean, sw-calibration-access=READ-ONLY, compu {0=FALSE, 1..255=TRUE}, range raw 0..1}
              mc data instance RmGDestRomIdxOfTxIf2Up: category=VALUE, resulting-properties={base-type=uint8, sw-calibration-access=READ-ONLY, range raw 0..255}
            Element_32: symbol=[32]
              mc data instance TxConfirmationUsedOfTxIf2Up: category=VALUE, resulting-properties={base-type=boolean, sw-calibration-access=READ-ONLY, compu {0=FALSE, 1..255=TRUE}, range raw 0..1}
              mc data instance RmGDestRomIdxOfTxIf2Up: category=VALUE, resulting-properties={base-type=uint8, sw-calibration-access=READ-ONLY, range raw 0..255}
            Element_33: symbol=[33]
              mc data instance TxConfirmationUsedOfTxIf2Up: category=VALUE, resulting-properties={base-type=boolean, sw-calibration-access=READ-ONLY, compu {0=FALSE, 1..255=TRUE}, range raw 0..1}
              mc data instance RmGDestRomIdxOfTxIf2Up: category=VALUE, resulting-properties={base-type=uint8, sw-calibration-access=READ-ONLY, range raw 0..255}
            Element_34: symbol=[34]
              mc data instance TxConfirmationUsedOfTxIf2Up: category=VALUE, resulting-properties={base-type=boolean, sw-calibration-access=READ-ONLY, compu {0=FALSE, 1..255=TRUE}, range raw 0..1}
              mc data instance RmGDestRomIdxOfTxIf2Up: category=VALUE, resulting-properties={base-type=uint8, sw-calibration-access=READ-ONLY, range raw 0..255}
            Element_35: symbol=[35]
              mc data instance TxConfirmationUsedOfTxIf2Up: category=VALUE, resulting-properties={base-type=boolean, sw-calibration-access=READ-ONLY, compu {0=FALSE, 1..255=TRUE}, range raw 0..1}
              mc data instance RmGDestRomIdxOfTxIf2Up: category=VALUE, resulting-properties={base-type=uint8, sw-calibration-access=READ-ONLY, range raw 0..255}
            Element_36: symbol=[36]
              mc data instance TxConfirmationUsedOfTxIf2Up: category=VALUE, resulting-properties={base-type=boolean, sw-calibration-access=READ-ONLY, compu {0=FALSE, 1..255=TRUE}, range raw 0..1}
              mc data instance RmGDestRomIdxOfTxIf2Up: category=VALUE, resulting-properties={base-type=uint8, sw-calibration-access=READ-ONLY, range raw 0..255}
            Element_37: symbol=[37]
              mc data instance TxConfirmationUsedOfTxIf2Up: category=VALUE, resulting-properties={base-type=boolean, sw-calibration-access=READ-ONLY, compu {0=FALSE, 1..255=TRUE}, range raw 0..1}
              mc data instance RmGDestRomIdxOfTxIf2Up: category=VALUE, resulting-properties={base-type=uint8, sw-calibration-access=READ-ONLY, range raw 0..255}
            Element_38: symbol=[38]
              mc data instance TxConfirmationUsedOfTxIf2Up: category=VALUE, resulting-properties={base-type=boolean, sw-calibration-access=READ-ONLY, compu {0=FALSE, 1..255=TRUE}, range raw 0..1}
              mc data instance RmGDestRomIdxOfTxIf2Up: category=VALUE, resulting-properties={base-type=uint8, sw-calibration-access=READ-ONLY, range raw 0..255}
            Element_39: symbol=[39]
              mc data instance TxConfirmationUsedOfTxIf2Up: category=VALUE, resulting-properties={base-type=boolean, sw-calibration-access=READ-ONLY, compu {0=FALSE, 1..255=TRUE}, range raw 0..1}
              mc data instance RmGDestRomIdxOfTxIf2Up: category=VALUE, resulting-properties={base-type=uint8, sw-calibration-access=READ-ONLY, range raw 0..255}
            Element_40: symbol=[40]
              mc data instance TxConfirmationUsedOfTxIf2Up: category=VALUE, resulting-properties={base-type=boolean, sw-calibration-access=READ-ONLY, compu {0=FALSE, 1..255=TRUE}, range raw 0..1}
              mc data instance RmGDestRomIdxOfTxIf2Up: category=VALUE, resulting-properties={base-type=uint8, sw-calibration-access=READ-ONLY, range raw 0..255}
            Element_41: symbol=[41]
              mc data instance TxConfirmationUsedOfTxIf2Up: category=VALUE, resulting-properties={base-type=boolean, sw-calibration-access=READ-ONLY, compu {0=FALSE, 1..255=TRUE}, range raw 0..1}
              mc data instance RmGDestRomIdxOfTxIf2Up: category=VALUE, resulting-properties={base-type=uint8, sw-calibration-access=READ-ONLY, range raw 0..255}
            Element_42: symbol=[42]
              mc data instance TxConfirmationUsedOfTxIf2Up: category=VALUE, resulting-properties={base-type=boolean, sw-calibration-access=READ-ONLY, compu {0=FALSE, 1..255=TRUE}, range raw 0..1}
              mc data instance RmGDestRomIdxOfTxIf2Up: category=VALUE, resulting-properties={base-type=uint8, sw-calibration-access=READ-ONLY, range raw 0..255}
            Element_43: symbol=[43]
              mc data instance TxConfirmationUsedOfTxIf2Up: category=VALUE, resulting-properties={base-type=boolean, sw-calibration-access=READ-ONLY, compu {0=FALSE, 1..255=TRUE}, range raw 0..1}
              mc data instance RmGDestRomIdxOfTxIf2Up: category=VALUE, resulting-properties={base-type=uint8, sw-calibration-access=READ-ONLY, range raw 0..255}
            Element_44: symbol=[44]
              mc data instance TxConfirmationUsedOfTxIf2Up: category=VALUE, resulting-properties={base-type=boolean, sw-calibration-access=READ-ONLY, compu {0=FALSE, 1..255=TRUE}, range raw 0..1}
              mc data instance RmGDestRomIdxOfTxIf2Up: category=VALUE, resulting-properties={base-type=uint8, sw-calibration-access=READ-ONLY, range raw 0..255}
            Element_45: symbol=[45]
              mc data instance TxConfirmationUsedOfTxIf2Up: category=VALUE, resulting-properties={base-type=boolean, sw-calibration-access=READ-ONLY, compu {0=FALSE, 1..255=TRUE}, range raw 0..1}
              mc data instance RmGDestRomIdxOfTxIf2Up: category=VALUE, resulting-properties={base-type=uint8, sw-calibration-access=READ-ONLY, range raw 0..255}
            Element_46: symbol=[46]
              mc data instance TxConfirmationUsedOfTxIf2Up: category=VALUE, resulting-properties={base-type=boolean, sw-calibration-access=READ-ONLY, compu {0=FALSE, 1..255=TRUE}, range raw 0..1}
              mc data instance RmGDestRomIdxOfTxIf2Up: category=VALUE, resulting-properties={base-type=uint8, sw-calibration-access=READ-ONLY, range raw 0..255}
            Element_47: symbol=[47]
              mc data instance TxConfirmationUsedOfTxIf2Up: category=VALUE, resulting-properties={base-type=boolean, sw-calibration-access=READ-ONLY, compu {0=FALSE, 1..255=TRUE}, range raw 0..1}
              mc data instance RmGDestRomIdxOfTxIf2Up: category=VALUE, resulting-properties={base-type=uint8, sw-calibration-access=READ-ONLY, range raw 0..255}
            Element_48: symbol=[48]
              mc data instance TxConfirmationUsedOfTxIf2Up: category=VALUE, resulting-properties={base-type=boolean, sw-calibration-access=READ-ONLY, compu {0=FALSE, 1..255=TRUE}, range raw 0..1}
              mc data instance RmGDestRomIdxOfTxIf2Up: category=VALUE, resulting-properties={base-type=uint8, sw-calibration-access=READ-ONLY, range raw 0..255}
            Element_49: symbol=[49]
              mc data instance TxConfirmationUsedOfTxIf2Up: category=VALUE, resulting-properties={base-type=boolean, sw-calibration-access=READ-ONLY, compu {0=FALSE, 1..255=TRUE}, range raw 0..1}
              mc data instance RmGDestRomIdxOfTxIf2Up: category=VALUE, resulting-properties={base-type=uint8, sw-calibration-access=READ-ONLY, range raw 0..255}
            Element_50: symbol=[50]
              mc data instance TxConfirmationUsedOfTxIf2Up: category=VALUE, resulting-properties={base-type=boolean, sw-calibration-access=READ-ONLY, compu {0=FALSE, 1..255=TRUE}, range raw 0..1}
              mc data instance RmGDestRomIdxOfTxIf2Up: category=VALUE, resulting-properties={base-type=uint8, sw-calibration-access=READ-ONLY, range raw 0..255}
            Element_51: symbol=[51]
              mc data instance TxConfirmationUsedOfTxIf2Up: category=VALUE, resulting-properties={base-type=boolean, sw-calibration-access=READ-ONLY, compu {0=FALSE, 1..255=TRUE}, range raw 0..1}
              mc data instance RmGDestRomIdxOfTxIf2Up: category=VALUE, resulting-properties={base-type=uint8, sw-calibration-access=READ-ONLY, range raw 0..255}
            Element_52: symbol=[52]
              mc data instance TxConfirmationUsedOfTxIf2Up: category=VALUE, resulting-properties={base-type=boolean, sw-calibration-access=READ-ONLY, compu {0=FALSE, 1..255=TRUE}, range raw 0..1}
              mc data instance RmGDestRomIdxOfTxIf2Up: category=VALUE, resulting-properties={base-type=uint8, sw-calibration-access=READ-ONLY, range raw 0..255}
            Element_53: symbol=[53]
              mc data instance TxConfirmationUsedOfTxIf2Up: category=VALUE, resulting-properties={base-type=boolean, sw-calibration-access=READ-ONLY, compu {0=FALSE, 1..255=TRUE}, range raw 0..1}
              mc data instance RmGDestRomIdxOfTxIf2Up: category=VALUE, resulting-properties={base-type=uint8, sw-calibration-access=READ-ONLY, range raw 0..255}
            Element_54: symbol=[54]
              mc data instance TxConfirmationUsedOfTxIf2Up: category=VALUE, resulting-properties={base-type=boolean, sw-calibration-access=READ-ONLY, compu {0=FALSE, 1..255=TRUE}, range raw 0..1}
              mc data instance RmGDestRomIdxOfTxIf2Up: category=VALUE, resulting-properties={base-type=uint8, sw-calibration-access=READ-ONLY, range raw 0..255}
            Element_55: symbol=[55]
              mc data instance TxConfirmationUsedOfTxIf2Up: category=VALUE, resulting-properties={base-type=boolean, sw-calibration-access=READ-ONLY, compu {0=FALSE, 1..255=TRUE}, range raw 0..1}
              mc data instance RmGDestRomIdxOfTxIf2Up: category=VALUE, resulting-properties={base-type=uint8, sw-calibration-access=READ-ONLY, range raw 0..255}
            Element_56: symbol=[56]
              mc data instance TxConfirmationUsedOfTxIf2Up: category=VALUE, resulting-properties={base-type=boolean, sw-calibration-access=READ-ONLY, compu {0=FALSE, 1..255=TRUE}, range raw 0..1}
              mc data instance RmGDestRomIdxOfTxIf2Up: category=VALUE, resulting-properties={base-type=uint8, sw-calibration-access=READ-ONLY, range raw 0..255}
            Element_57: symbol=[57]
              mc data instance TxConfirmationUsedOfTxIf2Up: category=VALUE, resulting-properties={base-type=boolean, sw-calibration-access=READ-ONLY, compu {0=FALSE, 1..255=TRUE}, range raw 0..1}
              mc data instance RmGDestRomIdxOfTxIf2Up: category=VALUE, resulting-properties={base-type=uint8, sw-calibration-access=READ-ONLY, range raw 0..255}
            Element_58: symbol=[58]
              mc data instance TxConfirmationUsedOfTxIf2Up: category=VALUE, resulting-properties={base-type=boolean, sw-calibration-access=READ-ONLY, compu {0=FALSE, 1..255=TRUE}, range raw 0..1}
              mc data instance RmGDestRomIdxOfTxIf2Up: category=VALUE, resulting-properties={base-type=uint8, sw-calibration-access=READ-ONLY, range raw 0..255}
            Element_59: symbol=[59]
              mc data instance TxConfirmationUsedOfTxIf2Up: category=VALUE, resulting-properties={base-type=boolean, sw-calibration-access=READ-ONLY, compu {0=FALSE, 1..255=TRUE}, range raw 0..1}
              mc data instance RmGDestRomIdxOfTxIf2Up: category=VALUE, resulting-properties={base-type=uint8, sw-calibration-access=READ-ONLY, range raw 0..255}
            Element_60: symbol=[60]
              mc data instance TxConfirmationUsedOfTxIf2Up: category=VALUE, resulting-properties={base-type=boolean, sw-calibration-access=READ-ONLY, compu {0=FALSE, 1..255=TRUE}, range raw 0..1}
              mc data instance RmGDestRomIdxOfTxIf2Up: category=VALUE, resulting-properties={base-type=uint8, sw-calibration-access=READ-ONLY, range raw 0..255}
            Element_61: symbol=[61]
              mc data instance TxConfirmationUsedOfTxIf2Up: category=VALUE, resulting-properties={base-type=boolean, sw-calibration-access=READ-ONLY, compu {0=FALSE, 1..255=TRUE}, range raw 0..1}
              mc data instance RmGDestRomIdxOfTxIf2Up: category=VALUE, resulting-properties={base-type=uint8, sw-calibration-access=READ-ONLY, range raw 0..255}
            Element_62: symbol=[62]
              mc data instance TxConfirmationUsedOfTxIf2Up: category=VALUE, resulting-properties={base-type=boolean, sw-calibration-access=READ-ONLY, compu {0=FALSE, 1..255=TRUE}, range raw 0..1}
              mc data instance RmGDestRomIdxOfTxIf2Up: category=VALUE, resulting-properties={base-type=uint8, sw-calibration-access=READ-ONLY, range raw 0..255}
            Element_63: symbol=[63]
              mc data instance TxConfirmationUsedOfTxIf2Up: category=VALUE, resulting-properties={base-type=boolean, sw-calibration-access=READ-ONLY, compu {0=FALSE, 1..255=TRUE}, range raw 0..1}
              mc data instance RmGDestRomIdxOfTxIf2Up: category=VALUE, resulting-properties={base-type=uint8, sw-calibration-access=READ-ONLY, range raw 0..255}
            Element_64: symbol=[64]
              mc data instance TxConfirmationUsedOfTxIf2Up: category=VALUE, resulting-properties={base-type=boolean, sw-calibration-access=READ-ONLY, compu {0=FALSE, 1..255=TRUE}, range raw 0..1}
              mc data instance RmGDestRomIdxOfTxIf2Up: category=VALUE, resulting-properties={base-type=uint8, sw-calibration-access=READ-ONLY, range raw 0..255}
            Element_65: symbol=[65]
              mc data instance TxConfirmationUsedOfTxIf2Up: category=VALUE, resulting-properties={base-type=boolean, sw-calibration-access=READ-ONLY, compu {0=FALSE, 1..255=TRUE}, range raw 0..1}
              mc data instance RmGDestRomIdxOfTxIf2Up: category=VALUE, resulting-properties={base-type=uint8, sw-calibration-access=READ-ONLY, range raw 0..255}
            Element_66: symbol=[66]
              mc data instance TxConfirmationUsedOfTxIf2Up: category=VALUE, resulting-properties={base-type=boolean, sw-calibration-access=READ-ONLY, compu {0=FALSE, 1..255=TRUE}, range raw 0..1}
              mc data instance RmGDestRomIdxOfTxIf2Up: category=VALUE, resulting-properties={base-type=uint8, sw-calibration-access=READ-ONLY, range raw 0..255}
        PduR_TxTp2Src: array-size=6  # This table contains all routing information to perform the Tx handling of a transport protocol routing, Used in the &lt;LoTp&gt;_CopyTxData and &lt;LoTp&gt;_TxConfirmation
          6 x mc data instance, all with category=STRUCTURE:
            Element_0: symbol=[0]
              mc data instance RmGDestRomIdxOfTxTp2Src: category=VALUE, resulting-properties={base-type=uint8, sw-calibration-access=READ-ONLY, range raw 0..255}
            Element_1: symbol=[1]
              mc data instance RmGDestRomIdxOfTxTp2Src: category=VALUE, resulting-properties={base-type=uint8, sw-calibration-access=READ-ONLY, range raw 0..255}
            Element_2: symbol=[2]
              mc data instance RmGDestRomIdxOfTxTp2Src: category=VALUE, resulting-properties={base-type=uint8, sw-calibration-access=READ-ONLY, range raw 0..255}
            Element_3: symbol=[3]
              mc data instance RmGDestRomIdxOfTxTp2Src: category=VALUE, resulting-properties={base-type=uint8, sw-calibration-access=READ-ONLY, range raw 0..255}
            Element_4: symbol=[4]
              mc data instance RmGDestRomIdxOfTxTp2Src: category=VALUE, resulting-properties={base-type=uint8, sw-calibration-access=READ-ONLY, range raw 0..255}
            Element_5: symbol=[5]
              mc data instance RmGDestRomIdxOfTxTp2Src: category=VALUE, resulting-properties={base-type=uint8, sw-calibration-access=READ-ONLY, range raw 0..255}
        PduR_BmTxBufferInstanceRam: array-size=10, symbol=PduR_BmTxBufferInstanceRam.raw  # PduR BufferManager TxBufferInstance Table
          10 x mc data instance, all with category=STRUCTURE:
            Element_0: symbol=[0]
              mc data instance BmTxBufferArrayRamReadIdxOfBmTxBufferInstanceRam: category=VALUE, resulting-properties={base-type=uint32, sw-calibration-access=READ-ONLY, range raw 0..4294967295}
            Element_1: symbol=[1]
              mc data instance BmTxBufferArrayRamReadIdxOfBmTxBufferInstanceRam: category=VALUE, resulting-properties={base-type=uint32, sw-calibration-access=READ-ONLY, range raw 0..4294967295}
            Element_2: symbol=[2]
              mc data instance BmTxBufferArrayRamReadIdxOfBmTxBufferInstanceRam: category=VALUE, resulting-properties={base-type=uint32, sw-calibration-access=READ-ONLY, range raw 0..4294967295}
            Element_3: symbol=[3]
              mc data instance BmTxBufferArrayRamReadIdxOfBmTxBufferInstanceRam: category=VALUE, resulting-properties={base-type=uint32, sw-calibration-access=READ-ONLY, range raw 0..4294967295}
            Element_4: symbol=[4]
              mc data instance BmTxBufferArrayRamReadIdxOfBmTxBufferInstanceRam: category=VALUE, resulting-properties={base-type=uint32, sw-calibration-access=READ-ONLY, range raw 0..4294967295}
            Element_5: symbol=[5]
              mc data instance BmTxBufferArrayRamReadIdxOfBmTxBufferInstanceRam: category=VALUE, resulting-properties={base-type=uint32, sw-calibration-access=READ-ONLY, range raw 0..4294967295}
            Element_6: symbol=[6]
              mc data instance BmTxBufferArrayRamReadIdxOfBmTxBufferInstanceRam: category=VALUE, resulting-properties={base-type=uint32, sw-calibration-access=READ-ONLY, range raw 0..4294967295}
            Element_7: symbol=[7]
              mc data instance BmTxBufferArrayRamReadIdxOfBmTxBufferInstanceRam: category=VALUE, resulting-properties={base-type=uint32, sw-calibration-access=READ-ONLY, range raw 0..4294967295}
            Element_8: symbol=[8]
              mc data instance BmTxBufferArrayRamReadIdxOfBmTxBufferInstanceRam: category=VALUE, resulting-properties={base-type=uint32, sw-calibration-access=READ-ONLY, range raw 0..4294967295}
            Element_9: symbol=[9]
              mc data instance BmTxBufferArrayRamReadIdxOfBmTxBufferInstanceRam: category=VALUE, resulting-properties={base-type=uint32, sw-calibration-access=READ-ONLY, range raw 0..4294967295}
        PduR_BmTxBufferInstanceRam_PduRTxBuffer_8: array-size=2, symbol=PduR_BmTxBufferInstanceRam.raw[0]  # The element: PduRTxBuffer_8 of PduR_BmTxBufferInstanceRam
          mc data instance Element_0: category=STRUCTURE, symbol=[0]
            mc data instance BmTxBufferArrayRamReadIdxOfBmTxBufferInstanceRam: category=VALUE, resulting-properties={base-type=uint32, sw-calibration-access=READ-ONLY, range raw 0..4294967295}
          mc data instance Element_1: category=STRUCTURE, symbol=[1]
            mc data instance BmTxBufferArrayRamReadIdxOfBmTxBufferInstanceRam: category=VALUE, resulting-properties={base-type=uint32, sw-calibration-access=READ-ONLY, range raw 0..4294967295}
        PduR_BmTxBufferInstanceRam_PduRTxBuffer_32: array-size=2, symbol=PduR_BmTxBufferInstanceRam.raw[2]  # The element: PduRTxBuffer_32 of PduR_BmTxBufferInstanceRam
          mc data instance Element_0: category=STRUCTURE, symbol=[0]
            mc data instance BmTxBufferArrayRamReadIdxOfBmTxBufferInstanceRam: category=VALUE, resulting-properties={base-type=uint32, sw-calibration-access=READ-ONLY, range raw 0..4294967295}
          mc data instance Element_1: category=STRUCTURE, symbol=[1]
            mc data instance BmTxBufferArrayRamReadIdxOfBmTxBufferInstanceRam: category=VALUE, resulting-properties={base-type=uint32, sw-calibration-access=READ-ONLY, range raw 0..4294967295}
        PduR_BmTxBufferInstanceRam_PduRTxBuffer_33: array-size=2, symbol=PduR_BmTxBufferInstanceRam.raw[4]  # The element: PduRTxBuffer_33 of PduR_BmTxBufferInstanceRam
          mc data instance Element_0: category=STRUCTURE, symbol=[0]
            mc data instance BmTxBufferArrayRamReadIdxOfBmTxBufferInstanceRam: category=VALUE, resulting-properties={base-type=uint32, sw-calibration-access=READ-ONLY, range raw 0..4294967295}
          mc data instance Element_1: category=STRUCTURE, symbol=[1]
            mc data instance BmTxBufferArrayRamReadIdxOfBmTxBufferInstanceRam: category=VALUE, resulting-properties={base-type=uint32, sw-calibration-access=READ-ONLY, range raw 0..4294967295}
        PduR_BmTxBufferInstanceRam_PduRTxBuffer_34: array-size=2, symbol=PduR_BmTxBufferInstanceRam.raw[6]  # The element: PduRTxBuffer_34 of PduR_BmTxBufferInstanceRam
          mc data instance Element_0: category=STRUCTURE, symbol=[0]
            mc data instance BmTxBufferArrayRamReadIdxOfBmTxBufferInstanceRam: category=VALUE, resulting-properties={base-type=uint32, sw-calibration-access=READ-ONLY, range raw 0..4294967295}
          mc data instance Element_1: category=STRUCTURE, symbol=[1]
            mc data instance BmTxBufferArrayRamReadIdxOfBmTxBufferInstanceRam: category=VALUE, resulting-properties={base-type=uint32, sw-calibration-access=READ-ONLY, range raw 0..4294967295}
        PduR_BmTxBufferInstanceRam_PduRTxBuffer_72: array-size=2, symbol=PduR_BmTxBufferInstanceRam.raw[8]  # The element: PduRTxBuffer_72 of PduR_BmTxBufferInstanceRam
          mc data instance Element_0: category=STRUCTURE, symbol=[0]
            mc data instance BmTxBufferArrayRamReadIdxOfBmTxBufferInstanceRam: category=VALUE, resulting-properties={base-type=uint32, sw-calibration-access=READ-ONLY, range raw 0..4294967295}
          mc data instance Element_1: category=STRUCTURE, symbol=[1]
            mc data instance BmTxBufferArrayRamReadIdxOfBmTxBufferInstanceRam: category=VALUE, resulting-properties={base-type=uint32, sw-calibration-access=READ-ONLY, range raw 0..4294967295}
        PduR_BmTxBufferRam: array-size=5, symbol=PduR_BmTxBufferRam.raw  # PduR BufferManager TxBuffer Table
          5 x mc data instance, all with category=STRUCTURE:
            Element_0: symbol=[0]
              mc data instance BmTxBufferArrayRamWriteIdxOfBmTxBufferRam: category=VALUE, resulting-properties={base-type=uint32, sw-calibration-access=READ-ONLY, range raw 0..4294967295}
              mc data instance RxLengthOfBmTxBufferRam: category=VALUE, resulting-properties={base-type=uint16, sw-calibration-access=READ-ONLY, range raw 0..65535}
              mc data instance AllocatedOfBmTxBufferRam: category=VALUE, resulting-properties={base-type=boolean, sw-calibration-access=READ-ONLY, compu {0=FALSE, 1..255=TRUE}, range raw 0..1}
            Element_1: symbol=[1]
              mc data instance BmTxBufferArrayRamWriteIdxOfBmTxBufferRam: category=VALUE, resulting-properties={base-type=uint32, sw-calibration-access=READ-ONLY, range raw 0..4294967295}
              mc data instance RxLengthOfBmTxBufferRam: category=VALUE, resulting-properties={base-type=uint16, sw-calibration-access=READ-ONLY, range raw 0..65535}
              mc data instance AllocatedOfBmTxBufferRam: category=VALUE, resulting-properties={base-type=boolean, sw-calibration-access=READ-ONLY, compu {0=FALSE, 1..255=TRUE}, range raw 0..1}
            Element_2: symbol=[2]
              mc data instance BmTxBufferArrayRamWriteIdxOfBmTxBufferRam: category=VALUE, resulting-properties={base-type=uint32, sw-calibration-access=READ-ONLY, range raw 0..4294967295}
              mc data instance RxLengthOfBmTxBufferRam: category=VALUE, resulting-properties={base-type=uint16, sw-calibration-access=READ-ONLY, range raw 0..65535}
              mc data instance AllocatedOfBmTxBufferRam: category=VALUE, resulting-properties={base-type=boolean, sw-calibration-access=READ-ONLY, compu {0=FALSE, 1..255=TRUE}, range raw 0..1}
            Element_3: symbol=[3]
              mc data instance BmTxBufferArrayRamWriteIdxOfBmTxBufferRam: category=VALUE, resulting-properties={base-type=uint32, sw-calibration-access=READ-ONLY, range raw 0..4294967295}
              mc data instance RxLengthOfBmTxBufferRam: category=VALUE, resulting-properties={base-type=uint16, sw-calibration-access=READ-ONLY, range raw 0..65535}
              mc data instance AllocatedOfBmTxBufferRam: category=VALUE, resulting-properties={base-type=boolean, sw-calibration-access=READ-ONLY, compu {0=FALSE, 1..255=TRUE}, range raw 0..1}
            Element_4: symbol=[4]
              mc data instance BmTxBufferArrayRamWriteIdxOfBmTxBufferRam: category=VALUE, resulting-properties={base-type=uint32, sw-calibration-access=READ-ONLY, range raw 0..4294967295}
              mc data instance RxLengthOfBmTxBufferRam: category=VALUE, resulting-properties={base-type=uint16, sw-calibration-access=READ-ONLY, range raw 0..65535}
              mc data instance AllocatedOfBmTxBufferRam: category=VALUE, resulting-properties={base-type=boolean, sw-calibration-access=READ-ONLY, compu {0=FALSE, 1..255=TRUE}, range raw 0..1}
        PduR_BmTxBufferRam_PduRTxBuffer_8: array-size=1, symbol=PduR_BmTxBufferRam.raw[0]  # The element: PduRTxBuffer_8 of PduR_BmTxBufferRam
          mc data instance Element_0: category=STRUCTURE, symbol=[0]
            mc data instance BmTxBufferArrayRamWriteIdxOfBmTxBufferRam: category=VALUE, resulting-properties={base-type=uint32, sw-calibration-access=READ-ONLY, range raw 0..4294967295}
            mc data instance RxLengthOfBmTxBufferRam: category=VALUE, resulting-properties={base-type=uint16, sw-calibration-access=READ-ONLY, range raw 0..65535}
            mc data instance AllocatedOfBmTxBufferRam: category=VALUE, resulting-properties={base-type=boolean, sw-calibration-access=READ-ONLY, compu {0=FALSE, 1..255=TRUE}, range raw 0..1}
        PduR_BmTxBufferRam_PduRTxBuffer_32: array-size=1, symbol=PduR_BmTxBufferRam.raw[1]  # The element: PduRTxBuffer_32 of PduR_BmTxBufferRam
          mc data instance Element_0: category=STRUCTURE, symbol=[0]
            mc data instance BmTxBufferArrayRamWriteIdxOfBmTxBufferRam: category=VALUE, resulting-properties={base-type=uint32, sw-calibration-access=READ-ONLY, range raw 0..4294967295}
            mc data instance RxLengthOfBmTxBufferRam: category=VALUE, resulting-properties={base-type=uint16, sw-calibration-access=READ-ONLY, range raw 0..65535}
            mc data instance AllocatedOfBmTxBufferRam: category=VALUE, resulting-properties={base-type=boolean, sw-calibration-access=READ-ONLY, compu {0=FALSE, 1..255=TRUE}, range raw 0..1}
        PduR_BmTxBufferRam_PduRTxBuffer_33: array-size=1, symbol=PduR_BmTxBufferRam.raw[2]  # The element: PduRTxBuffer_33 of PduR_BmTxBufferRam
          mc data instance Element_0: category=STRUCTURE, symbol=[0]
            mc data instance BmTxBufferArrayRamWriteIdxOfBmTxBufferRam: category=VALUE, resulting-properties={base-type=uint32, sw-calibration-access=READ-ONLY, range raw 0..4294967295}
            mc data instance RxLengthOfBmTxBufferRam: category=VALUE, resulting-properties={base-type=uint16, sw-calibration-access=READ-ONLY, range raw 0..65535}
            mc data instance AllocatedOfBmTxBufferRam: category=VALUE, resulting-properties={base-type=boolean, sw-calibration-access=READ-ONLY, compu {0=FALSE, 1..255=TRUE}, range raw 0..1}
        PduR_BmTxBufferRam_PduRTxBuffer_34: array-size=1, symbol=PduR_BmTxBufferRam.raw[3]  # The element: PduRTxBuffer_34 of PduR_BmTxBufferRam
          mc data instance Element_0: category=STRUCTURE, symbol=[0]
            mc data instance BmTxBufferArrayRamWriteIdxOfBmTxBufferRam: category=VALUE, resulting-properties={base-type=uint32, sw-calibration-access=READ-ONLY, range raw 0..4294967295}
            mc data instance RxLengthOfBmTxBufferRam: category=VALUE, resulting-properties={base-type=uint16, sw-calibration-access=READ-ONLY, range raw 0..65535}
            mc data instance AllocatedOfBmTxBufferRam: category=VALUE, resulting-properties={base-type=boolean, sw-calibration-access=READ-ONLY, compu {0=FALSE, 1..255=TRUE}, range raw 0..1}
        PduR_BmTxBufferRam_PduRTxBuffer_72: array-size=1, symbol=PduR_BmTxBufferRam.raw[4]  # The element: PduRTxBuffer_72 of PduR_BmTxBufferRam
          mc data instance Element_0: category=STRUCTURE, symbol=[0]
            mc data instance BmTxBufferArrayRamWriteIdxOfBmTxBufferRam: category=VALUE, resulting-properties={base-type=uint32, sw-calibration-access=READ-ONLY, range raw 0..4294967295}
            mc data instance RxLengthOfBmTxBufferRam: category=VALUE, resulting-properties={base-type=uint16, sw-calibration-access=READ-ONLY, range raw 0..65535}
            mc data instance AllocatedOfBmTxBufferRam: category=VALUE, resulting-properties={base-type=boolean, sw-calibration-access=READ-ONLY, compu {0=FALSE, 1..255=TRUE}, range raw 0..1}
        PduR_FmFifoElementRam: array-size=2, symbol=PduR_FmFifoElementRam.raw  # PduR FiFoManager FIFO element table
          mc data instance Element_0: category=STRUCTURE, symbol=[0]
            mc data instance BmTxBufferRomIdxOfFmFifoElementRam: category=VALUE, resulting-properties={base-type=uint8, sw-calibration-access=READ-ONLY, range raw 0..255}
            mc data instance RmDestRomIdxOfFmFifoElementRam: category=VALUE, resulting-properties={base-type=uint8, sw-calibration-access=READ-ONLY, range raw 0..255}
          mc data instance Element_1: category=STRUCTURE, symbol=[1]
            mc data instance BmTxBufferRomIdxOfFmFifoElementRam: category=VALUE, resulting-properties={base-type=uint8, sw-calibration-access=READ-ONLY, range raw 0..255}
            mc data instance RmDestRomIdxOfFmFifoElementRam: category=VALUE, resulting-properties={base-type=uint8, sw-calibration-access=READ-ONLY, range raw 0..255}
        PduR_FmFifoElementRam_PduRQueue: array-size=2, symbol=PduR_FmFifoElementRam.raw[0]  # The element: PduRQueue of PduR_FmFifoElementRam
          mc data instance Element_0: category=STRUCTURE, symbol=[0]
            mc data instance BmTxBufferRomIdxOfFmFifoElementRam: category=VALUE, resulting-properties={base-type=uint8, sw-calibration-access=READ-ONLY, range raw 0..255}
            mc data instance RmDestRomIdxOfFmFifoElementRam: category=VALUE, resulting-properties={base-type=uint8, sw-calibration-access=READ-ONLY, range raw 0..255}
          mc data instance Element_1: category=STRUCTURE, symbol=[1]
            mc data instance BmTxBufferRomIdxOfFmFifoElementRam: category=VALUE, resulting-properties={base-type=uint8, sw-calibration-access=READ-ONLY, range raw 0..255}
            mc data instance RmDestRomIdxOfFmFifoElementRam: category=VALUE, resulting-properties={base-type=uint8, sw-calibration-access=READ-ONLY, range raw 0..255}
        PduR_FmFifoInstanceRam: array-size=1, symbol=PduR_FmFifoInstanceRam.raw  # Instance of the PduRDestPdus using a single Fifo
          mc data instance Element_0: category=STRUCTURE, symbol=[0]
            mc data instance BmTxBufferInstanceRomIdxOfFmFifoInstanceRam: category=VALUE, resulting-properties={base-type=uint8, sw-calibration-access=READ-ONLY, range raw 0..255}
        PduR_FmFifoInstanceRam_DCM_BMC_CAN01_XIX_TPCHType_CANHS_OBDC_Diagnose_XIX_0x17FD0200_XIX_Functional_e9b636f2_Tx: array-size=1, symbol=PduR_FmFifoInstanceRam.raw[0]  # The element: DCM_BMC_CAN01_XIX_TPCHType_CANHS_OBDC_Diagnose_XIX_0x17FD0200_XIX_Functional_e9b636f2_Tx of PduR_FmFifoInstanceRam
          mc data instance Element_0: category=STRUCTURE, symbol=[0]
            mc data instance BmTxBufferInstanceRomIdxOfFmFifoInstanceRam: category=VALUE, resulting-properties={base-type=uint8, sw-calibration-access=READ-ONLY, range raw 0..255}
        PduR_RmBufferedTpPropertiesRam: array-size=1, symbol=PduR_RmBufferedTpPropertiesRam.raw  # PduR RoutiongManager Properties of buffered Tp routing paths.
          mc data instance Element_0: category=STRUCTURE, symbol=[0]
            mc data instance FmFifoElementRamIdxOfRmBufferedTpPropertiesRam: category=VALUE, resulting-properties={base-type=uint8, sw-calibration-access=READ-ONLY, range raw 0..255}
            mc data instance TpRxSmStateOfRmBufferedTpPropertiesRam: category=VALUE, resulting-properties={base-type=uint8, sw-calibration-access=READ-ONLY, compu-method=PduR_TpRxSmStateOfRmBufferedTpPropertiesRamType, range raw 0..255}
        PduR_RmBufferedTpPropertiesRam_PduRSrcPdu_31fc5fb2: array-size=1, symbol=PduR_RmBufferedTpPropertiesRam.raw[0]  # The element: PduRSrcPdu_31fc5fb2 of PduR_RmBufferedTpPropertiesRam
          mc data instance Element_0: category=STRUCTURE, symbol=[0]
            mc data instance FmFifoElementRamIdxOfRmBufferedTpPropertiesRam: category=VALUE, resulting-properties={base-type=uint8, sw-calibration-access=READ-ONLY, range raw 0..255}
            mc data instance TpRxSmStateOfRmBufferedTpPropertiesRam: category=VALUE, resulting-properties={base-type=uint8, sw-calibration-access=READ-ONLY, compu-method=PduR_TpRxSmStateOfRmBufferedTpPropertiesRamType, range raw 0..255}
        PduR_RmGDestTpTxStateRam: array-size=2, symbol=PduR_RmGDestTpTxStateRam.raw  # PduR RoutingPathManager global destPdu Tp Tx State
          mc data instance Element_0: category=STRUCTURE, symbol=[0]
            mc data instance TpTxInstSmStateOfRmGDestTpTxStateRam: category=VALUE, resulting-properties={base-type=uint8, sw-calibration-access=READ-ONLY, compu-method=PduR_TpTxInstSmStateOfRmGDestTpTxStateRamType, range raw 0..255}
          mc data instance Element_1: category=STRUCTURE, symbol=[1]
            mc data instance TpTxInstSmStateOfRmGDestTpTxStateRam: category=VALUE, resulting-properties={base-type=uint8, sw-calibration-access=READ-ONLY, compu-method=PduR_TpTxInstSmStateOfRmGDestTpTxStateRamType, range raw 0..255}
        PduR_RmGDestTpTxStateRam_DCM_BMC_CAN01_XIX_TPCHType_CANHS_OBDC_Diagnose_XIX_0x17FD0200_XIX_Functional_e9b636f2_Tx: array-size=1, symbol=PduR_RmGDestTpTxStateRam.raw[0]  # The element: DCM_BMC_CAN01_XIX_TPCHType_CANHS_OBDC_Diagnose_XIX_0x17FD0200_XIX_Functional_e9b636f2_Tx of PduR_RmGDestTpTxStateRam
          mc data instance Element_0: category=STRUCTURE, symbol=[0]
            mc data instance TpTxInstSmStateOfRmGDestTpTxStateRam: category=VALUE, resulting-properties={base-type=uint8, sw-calibration-access=READ-ONLY, compu-method=PduR_TpTxInstSmStateOfRmGDestTpTxStateRamType, range raw 0..255}
        PduR_RmGDestTpTxStateRam_DCM_HCP5_CANFD01_XIX_TPCHType_CANFD_OBDC_Diagnose_XIX_0x1C410200_XIX_Functional_967cb818_Rx: array-size=1, symbol=PduR_RmGDestTpTxStateRam.raw[1]  # The element: DCM_HCP5_CANFD01_XIX_TPCHType_CANFD_OBDC_Diagnose_XIX_0x1C410200_XIX_Functional_967cb818_Rx of PduR_RmGDestTpTxStateRam
          mc data instance Element_0: category=STRUCTURE, symbol=[0]
            mc data instance TpTxInstSmStateOfRmGDestTpTxStateRam: category=VALUE, resulting-properties={base-type=uint8, sw-calibration-access=READ-ONLY, compu-method=PduR_TpTxInstSmStateOfRmGDestTpTxStateRamType, range raw 0..255}
        PduR_BmTxBufferArrayRam: array-size=181, resulting-properties={base-type=uint8, sw-calibration-access=READ-ONLY, range raw 0..255}, symbol=PduR_BmTxBufferArrayRam.raw  # PduR BufferManagere TxBufferArray Table
        PduR_BmTxBufferArrayRam_PduRTxBuffer_8: array-size=9, resulting-properties={base-type=uint8, sw-calibration-access=READ-ONLY, range raw 0..255}, symbol=PduR_BmTxBufferArrayRam.raw[0]  # The element: PduRTxBuffer_8 of PduR_BmTxBufferArrayRam
        PduR_BmTxBufferArrayRam_PduRTxBuffer_32: array-size=33, resulting-properties={base-type=uint8, sw-calibration-access=READ-ONLY, range raw 0..255}, symbol=PduR_BmTxBufferArrayRam.raw[9]  # The element: PduRTxBuffer_32 of PduR_BmTxBufferArrayRam
        PduR_BmTxBufferArrayRam_PduRTxBuffer_33: array-size=33, resulting-properties={base-type=uint8, sw-calibration-access=READ-ONLY, range raw 0..255}, symbol=PduR_BmTxBufferArrayRam.raw[42]  # The element: PduRTxBuffer_33 of PduR_BmTxBufferArrayRam
        PduR_BmTxBufferArrayRam_PduRTxBuffer_34: array-size=33, resulting-properties={base-type=uint8, sw-calibration-access=READ-ONLY, range raw 0..255}, symbol=PduR_BmTxBufferArrayRam.raw[75]  # The element: PduRTxBuffer_34 of PduR_BmTxBufferArrayRam
        PduR_BmTxBufferArrayRam_PduRTxBuffer_72: array-size=73, resulting-properties={base-type=uint8, sw-calibration-access=READ-ONLY, range raw 0..255}, symbol=PduR_BmTxBufferArrayRam.raw[108]  # The element: PduRTxBuffer_72 of PduR_BmTxBufferArrayRam
        PduR_InitializedRam: array-size=1, resulting-properties={base-type=boolean, sw-calibration-access=READ-ONLY, compu {0=FALSE, 1..255=TRUE}, range raw 0..1}, symbol=PduR_InitializedRam.raw  # Initialized status of each partition the PduR runs on.
        PduR_InitializedRam_PduRSinglePartitionDummy: array-size=1, resulting-properties={base-type=boolean, sw-calibration-access=READ-ONLY, compu {0=FALSE, 1..255=TRUE}, range raw 0..1}, symbol=PduR_InitializedRam.raw[0]  # The element: PduRSinglePartitionDummy of PduR_InitializedRam
    resource consumption ResourceConsumption
      121 x memory section:
        BUFFER_VAR_FAST_CLEARED_8: alignment=8, sw-addrmethod=VAR_FAST_CLEARED
        VAR_NOCACHE_CLEARED_UNSPECIFIED: alignment=UNSPECIFIED, sw-addrmethod=VAR_NOCACHE_CLEARED
        BUFFER_VAR_NOCACHE_INIT_16: alignment=16, sw-addrmethod=VAR_NOCACHE_INIT
        VAR_FAST_INIT_64: alignment=64, sw-addrmethod=VAR_FAST_INIT
        VAR_FAST_CLEARED_UNSPECIFIED: alignment=UNSPECIFIED, sw-addrmethod=VAR_FAST_CLEARED
        BUFFER_VAR_INIT_BOOLEAN: alignment=BOOLEAN, sw-addrmethod=VAR_INIT
        BUFFER_VAR_FAST_CLEARED_64: alignment=64, sw-addrmethod=VAR_FAST_CLEARED
        VAR_NOCACHE_CLEARED_16: alignment=16, sw-addrmethod=VAR_NOCACHE_CLEARED
        VAR_NO_INIT_16: alignment=16, sw-addrmethod=VAR_NO_INIT
        BUFFER_VAR_NOCACHE_CLEARED_64: alignment=64, sw-addrmethod=VAR_NOCACHE_CLEARED
        CONST_16: alignment=16, sw-addrmethod=CONST
        VAR_FAST_CLEARED_8: alignment=8, sw-addrmethod=VAR_FAST_CLEARED
        BUFFER_VAR_NOCACHE_NO_INIT_UNSPECIFIED: alignment=UNSPECIFIED, sw-addrmethod=VAR_NOCACHE_NO_INIT
        CODE: sw-addrmethod=CODE
        VAR_CLEARED_16: alignment=16, sw-addrmethod=VAR_CLEARED
        BUFFER_VAR_FAST_NO_INIT_64: alignment=64, sw-addrmethod=VAR_FAST_NO_INIT
        BUFFER_VAR_NO_INIT_64: alignment=64, sw-addrmethod=VAR_NO_INIT
        VAR_FAST_NO_INIT_16: alignment=16, sw-addrmethod=VAR_FAST_NO_INIT
        BUFFER_VAR_NOCACHE_CLEARED_UNSPECIFIED: alignment=UNSPECIFIED, sw-addrmethod=VAR_NOCACHE_CLEARED
        VAR_NOCACHE_INIT_32: alignment=32, sw-addrmethod=VAR_NOCACHE_INIT
        BUFFER_VAR_INIT_32: alignment=32, sw-addrmethod=VAR_INIT
        BUFFER_CONST_16: alignment=16, sw-addrmethod=CONST
        BUFFER_VAR_NO_INIT_BOOLEAN: alignment=BOOLEAN, sw-addrmethod=VAR_NO_INIT
        VAR_CLEARED_8: alignment=8, sw-addrmethod=VAR_CLEARED
        VAR_FAST_CLEARED_16: alignment=16, sw-addrmethod=VAR_FAST_CLEARED
        BUFFER_VAR_CLEARED_64: alignment=64, sw-addrmethod=VAR_CLEARED
        CONST_32: alignment=32, sw-addrmethod=CONST
        VAR_INIT_32: alignment=32, sw-addrmethod=VAR_INIT
        BUFFER_VAR_FAST_INIT_32: alignment=32, sw-addrmethod=VAR_FAST_INIT
        VAR_NO_INIT_32: alignment=32, sw-addrmethod=VAR_NO_INIT
        BUFFER_VAR_NOCACHE_CLEARED_BOOLEAN: alignment=BOOLEAN, sw-addrmethod=VAR_NOCACHE_CLEARED
        BUFFER_VAR_NOCACHE_INIT_32: alignment=32, sw-addrmethod=VAR_NOCACHE_INIT
        BUFFER_VAR_CLEARED_16: alignment=16, sw-addrmethod=VAR_CLEARED
        VAR_NOCACHE_INIT_BOOLEAN: alignment=BOOLEAN, sw-addrmethod=VAR_NOCACHE_INIT
        VAR_FAST_NO_INIT_BOOLEAN: alignment=BOOLEAN, sw-addrmethod=VAR_FAST_NO_INIT
        VAR_FAST_CLEARED_BOOLEAN: alignment=BOOLEAN, sw-addrmethod=VAR_FAST_CLEARED
        BUFFER_VAR_NOCACHE_NO_INIT_8: alignment=8, sw-addrmethod=VAR_NOCACHE_NO_INIT
        BUFFER_VAR_INIT_UNSPECIFIED: alignment=UNSPECIFIED, sw-addrmethod=VAR_INIT
        VAR_CLEARED_UNSPECIFIED: alignment=UNSPECIFIED, sw-addrmethod=VAR_CLEARED
        BUFFER_VAR_FAST_CLEARED_UNSPECIFIED: alignment=UNSPECIFIED, sw-addrmethod=VAR_FAST_CLEARED
        BUFFER_VAR_FAST_INIT_64: alignment=64, sw-addrmethod=VAR_FAST_INIT
        VAR_CLEARED_32: alignment=32, sw-addrmethod=VAR_CLEARED
        BUFFER_VAR_CLEARED_UNSPECIFIED: alignment=UNSPECIFIED, sw-addrmethod=VAR_CLEARED
        BUFFER_VAR_FAST_INIT_UNSPECIFIED: alignment=UNSPECIFIED, sw-addrmethod=VAR_FAST_INIT
        VAR_INIT_BOOLEAN: alignment=BOOLEAN, sw-addrmethod=VAR_INIT
        VAR_NOCACHE_INIT_UNSPECIFIED: alignment=UNSPECIFIED, sw-addrmethod=VAR_NOCACHE_INIT
        BUFFER_VAR_FAST_INIT_8: alignment=8, sw-addrmethod=VAR_FAST_INIT
        VAR_FAST_INIT_8: alignment=8, sw-addrmethod=VAR_FAST_INIT
        VAR_NOCACHE_INIT_16: alignment=16, sw-addrmethod=VAR_NOCACHE_INIT
        BUFFER_VAR_FAST_CLEARED_32: alignment=32, sw-addrmethod=VAR_FAST_CLEARED
        CONST_BOOLEAN: alignment=BOOLEAN, sw-addrmethod=CONST
        BUFFER_VAR_INIT_16: alignment=16, sw-addrmethod=VAR_INIT
        BUFFER_VAR_NOCACHE_INIT_BOOLEAN: alignment=BOOLEAN, sw-addrmethod=VAR_NOCACHE_INIT
        BUFFER_VAR_NO_INIT_16: alignment=16, sw-addrmethod=VAR_NO_INIT
        VAR_INIT_16: alignment=16, sw-addrmethod=VAR_INIT
        BUFFER_VAR_NOCACHE_NO_INIT_64: alignment=64, sw-addrmethod=VAR_NOCACHE_NO_INIT
        BUFFER_VAR_NOCACHE_CLEARED_8: alignment=8, sw-addrmethod=VAR_NOCACHE_CLEARED
        BUFFER_VAR_NOCACHE_INIT_UNSPECIFIED: alignment=UNSPECIFIED, sw-addrmethod=VAR_NOCACHE_INIT
        VAR_NOCACHE_NO_INIT_16: alignment=16, sw-addrmethod=VAR_NOCACHE_NO_INIT
        BUFFER_VAR_FAST_NO_INIT_32: alignment=32, sw-addrmethod=VAR_FAST_NO_INIT
        BUFFER_VAR_CLEARED_32: alignment=32, sw-addrmethod=VAR_CLEARED
        BUFFER_CONST_64: alignment=64, sw-addrmethod=CONST
        BUFFER_VAR_FAST_INIT_BOOLEAN: alignment=BOOLEAN, sw-addrmethod=VAR_FAST_INIT
        BUFFER_VAR_FAST_NO_INIT_UNSPECIFIED: alignment=UNSPECIFIED, sw-addrmethod=VAR_FAST_NO_INIT
        BUFFER_VAR_FAST_NO_INIT_16: alignment=16, sw-addrmethod=VAR_FAST_NO_INIT
        VAR_NO_INIT_8: alignment=8, sw-addrmethod=VAR_NO_INIT
        BUFFER_VAR_NOCACHE_NO_INIT_16: alignment=16, sw-addrmethod=VAR_NOCACHE_NO_INIT
        CONST_64: alignment=64, sw-addrmethod=CONST
        BUFFER_VAR_FAST_CLEARED_16: alignment=16, sw-addrmethod=VAR_FAST_CLEARED
        VAR_NOCACHE_CLEARED_8: alignment=8, sw-addrmethod=VAR_NOCACHE_CLEARED
        VAR_NOCACHE_CLEARED_BOOLEAN: alignment=BOOLEAN, sw-addrmethod=VAR_NOCACHE_CLEARED
        VAR_NO_INIT_64: alignment=64, sw-addrmethod=VAR_NO_INIT
        VAR_NOCACHE_CLEARED_64: alignment=64, sw-addrmethod=VAR_NOCACHE_CLEARED
        BUFFER_CONST_BOOLEAN: alignment=BOOLEAN, sw-addrmethod=CONST
        VAR_FAST_INIT_32: alignment=32, sw-addrmethod=VAR_FAST_INIT
        BUFFER_VAR_CLEARED_BOOLEAN: alignment=BOOLEAN, sw-addrmethod=VAR_CLEARED
        VAR_NO_INIT_UNSPECIFIED: alignment=UNSPECIFIED, sw-addrmethod=VAR_NO_INIT
        BUFFER_VAR_FAST_CLEARED_BOOLEAN: alignment=BOOLEAN, sw-addrmethod=VAR_FAST_CLEARED
        BUFFER_VAR_NO_INIT_UNSPECIFIED: alignment=UNSPECIFIED, sw-addrmethod=VAR_NO_INIT
        VAR_NOCACHE_INIT_8: alignment=8, sw-addrmethod=VAR_NOCACHE_INIT
        BUFFER_VAR_NOCACHE_INIT_64: alignment=64, sw-addrmethod=VAR_NOCACHE_INIT
        BUFFER_VAR_NOCACHE_CLEARED_32: alignment=32, sw-addrmethod=VAR_NOCACHE_CLEARED
        CONST_UNSPECIFIED: alignment=UNSPECIFIED, sw-addrmethod=CONST
        VAR_NOCACHE_NO_INIT_32: alignment=32, sw-addrmethod=VAR_NOCACHE_NO_INIT
        VAR_FAST_CLEARED_64: alignment=64, sw-addrmethod=VAR_FAST_CLEARED
        VAR_FAST_NO_INIT_64: alignment=64, sw-addrmethod=VAR_FAST_NO_INIT
        VAR_INIT_8: alignment=8, sw-addrmethod=VAR_INIT
        VAR_CLEARED_64: alignment=64, sw-addrmethod=VAR_CLEARED
        BUFFER_VAR_NOCACHE_NO_INIT_BOOLEAN: alignment=BOOLEAN, sw-addrmethod=VAR_NOCACHE_NO_INIT
        BUFFER_VAR_NO_INIT_32: alignment=32, sw-addrmethod=VAR_NO_INIT
        VAR_NOCACHE_INIT_64: alignment=64, sw-addrmethod=VAR_NOCACHE_INIT
        VAR_NOCACHE_CLEARED_32: alignment=32, sw-addrmethod=VAR_NOCACHE_CLEARED
        BUFFER_VAR_INIT_64: alignment=64, sw-addrmethod=VAR_INIT
        BUFFER_CONST_8: alignment=8, sw-addrmethod=CONST
        VAR_CLEARED_BOOLEAN: alignment=BOOLEAN, sw-addrmethod=VAR_CLEARED
        VAR_NO_INIT_BOOLEAN: alignment=BOOLEAN, sw-addrmethod=VAR_NO_INIT
        VAR_NOCACHE_NO_INIT_64: alignment=64, sw-addrmethod=VAR_NOCACHE_NO_INIT
        VAR_FAST_CLEARED_32: alignment=32, sw-addrmethod=VAR_FAST_CLEARED
        BUFFER_VAR_FAST_NO_INIT_BOOLEAN: alignment=BOOLEAN, sw-addrmethod=VAR_FAST_NO_INIT
        VAR_NOCACHE_NO_INIT_UNSPECIFIED: alignment=UNSPECIFIED, sw-addrmethod=VAR_NOCACHE_NO_INIT
        VAR_INIT_64: alignment=64, sw-addrmethod=VAR_INIT
        BUFFER_CONST_UNSPECIFIED: alignment=UNSPECIFIED, sw-addrmethod=CONST
        VAR_INIT_UNSPECIFIED: alignment=UNSPECIFIED, sw-addrmethod=VAR_INIT
        CONST_8: alignment=8, sw-addrmethod=CONST
        VAR_FAST_NO_INIT_32: alignment=32, sw-addrmethod=VAR_FAST_NO_INIT
        BUFFER_VAR_FAST_NO_INIT_8: alignment=8, sw-addrmethod=VAR_FAST_NO_INIT
        VAR_NOCACHE_NO_INIT_BOOLEAN: alignment=BOOLEAN, sw-addrmethod=VAR_NOCACHE_NO_INIT
        BUFFER_VAR_NOCACHE_NO_INIT_32: alignment=32, sw-addrmethod=VAR_NOCACHE_NO_INIT
        BUFFER_VAR_NO_INIT_8: alignment=8, sw-addrmethod=VAR_NO_INIT
        BUFFER_CONST_32: alignment=32, sw-addrmethod=CONST
        BUFFER_VAR_CLEARED_8: alignment=8, sw-addrmethod=VAR_CLEARED
        BUFFER_VAR_NOCACHE_CLEARED_16: alignment=16, sw-addrmethod=VAR_NOCACHE_CLEARED
        VAR_FAST_INIT_UNSPECIFIED: alignment=UNSPECIFIED, sw-addrmethod=VAR_FAST_INIT
        VAR_FAST_NO_INIT_8: alignment=8, sw-addrmethod=VAR_FAST_NO_INIT
        VAR_FAST_NO_INIT_UNSPECIFIED: alignment=UNSPECIFIED, sw-addrmethod=VAR_FAST_NO_INIT
        BUFFER_VAR_NOCACHE_INIT_8: alignment=8, sw-addrmethod=VAR_NOCACHE_INIT
        VAR_FAST_INIT_BOOLEAN: alignment=BOOLEAN, sw-addrmethod=VAR_FAST_INIT
        VAR_FAST_INIT_16: alignment=16, sw-addrmethod=VAR_FAST_INIT
        VAR_NOCACHE_NO_INIT_8: alignment=8, sw-addrmethod=VAR_NOCACHE_NO_INIT
        BUFFER_VAR_INIT_8: alignment=8, sw-addrmethod=VAR_INIT
        BUFFER_VAR_FAST_INIT_16: alignment=16, sw-addrmethod=VAR_FAST_INIT
package /MICROSAR/PduR_ib_bswmd/BswModuleDescriptions
  bsw module description PduR: provided-entrys=PduR_Virtual
    bsw internal behavior PduRBehavior
      exclusive area PDUR_EXCLUSIVE_AREA_0
      bsw called entity PduR_Virtual: can-enter-exclusive-area=PDUR_EXCLUSIVE_AREA_0, implemented-entry=PduR_Virtual
  bsw module entry PduR_Virtual: call-type=REGULAR, execution-context=TASK
package /MICROSAR/PduR_ib_bswmd/DataTypes/CompuMethods
  compu method PduR_RoutingTypeOfRmDestRomType: 0=PDUR_IF_UNBUFFERED_RX_API_FWD_ROUTINGTYPEOFRMDESTROM, 1=PDUR_IF_UNBUFFERED_TX_API_FWD_ROUTINGTYPEOFRMDESTROM, 3=PDUR_IF_NOBUFFER_GATEWAY_ROUTINGTYPEOFRMDESTROM, 5=PDUR_TP_UNBUFFERED_RX_API_FWD_ROUTINGTYPEOFRMDESTROM, 6=PDUR_TP_UNBUFFERED_TX_API_FWD_ROUTINGTYPEOFRMDESTROM, 7=PDUR_TP_BUFFERED_ROUTINGTYPEOFRMDESTROM
  compu method PduR_TpRxSmStateOfRmBufferedTpPropertiesRamType: 0=PDUR_RM_RX_IDLE_TPRXSMSTATEOFRMBUFFEREDTPPROPERTIESRAM, 1=PDUR_RM_RX_ACTIVE_TPRXSMSTATEOFRMBUFFEREDTPPROPERTIESRAM, 2=PDUR_RM_RX_ABORTED_TPRXSMSTATEOFRMBUFFEREDTPPROPERTIESRAM
  compu method PduR_TpTxInstSmStateOfRmGDestTpTxStateRamType: 0=PDUR_RM_TXINST_IDLE_TPTXINSTSMSTATEOFRMGDESTTPTXSTATERAM, 1=PDUR_RM_TXINST_ACTIVE_TPTXINSTSMSTATEOFRMGDESTTPTXSTATERAM, 2=PDUR_RM_TXINST_WAITING_TPTXINSTSMSTATEOFRMGDESTTPTXSTATERAM, 3=PDUR_RM_TXINST_ABORTED_TPTXINSTSMSTATEOFRMGDESTTPTXSTATERAM
  compu method PduR_PduLengthHandlingStrategyOfRmDestRomType: 2=PDUR_IGNORE_PDULENGTHHANDLINGSTRATEGYOFRMDESTROM, 3=PDUR_UNUSED_PDULENGTHHANDLINGSTRATEGYOFRMDESTROM
