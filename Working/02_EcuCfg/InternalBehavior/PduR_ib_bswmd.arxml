[part 2 of 4: package /MICROSAR]
AUTOSAR XML (schema 4-3-0)
package /MICROSAR  (continued)
  bsw implementation PduR_Impl: programming-language=C, sw-version=17.02.01, used-code-generator=DaVinci Configurator, vendor-id=30, ar-release-version=4.01.02  (continued)
    mc-variable-instances:  (continued)
      41 x mc data instance, all with category=ARRAY:  (continued)
        PduR_RmGDestRom: array-size=151  (continued)
          151 x mc data instance, all with category=STRUCTURE:  (continued)
            Element_42: symbol=[42]
              10 x mc data instance, all with category=VALUE:
                MaxPduLengthOfRmGDestRom: resulting-properties={base-type=uint16, sw-calibration-access=READ-ONLY, range raw 0..65535}
                DestHndOfRmGDestRom: resulting-properties={base-type=uint8, sw-calibration-access=READ-ONLY, compu {255=PDUR_NO_DESTHNDOFRMGDESTROM}, range raw 0..255}
                DirectionOfRmGDestRom: resulting-properties={base-type=uint8, sw-calibration-access=READ-ONLY, compu {0=PDUR_RX_DIRECTIONOFRMGDESTROM, 1=PDUR_TX_DIRECTIONOFRMGDESTROM}, range raw 0..255}
                FmFifoInstanceRomIdxOfRmGDestRom: resulting-properties={base-type=uint8, sw-calibration-access=READ-ONLY, compu {255=PDUR_NO_FMFIFOINSTANCEROMIDXOFRMGDESTROM}, range raw 0..255}
                FmFifoInstanceRomPartitionIdxOfRmGDestRom: resulting-properties={base-type=uint8, sw-calibration-access=READ-ONLY, compu {255=PDUR_NO_FMFIFOINSTANCEROMPARTITIONIDXOFRMGDESTROM}, range raw 0..255}
                LockRomIdxOfRmGDestRom: resulting-properties={base-type=uint8, sw-calibration-access=READ-ONLY, range raw 0..255}
                MmRomIdxOfRmGDestRom: resulting-properties={base-type=uint8, sw-calibration-access=READ-ONLY, range raw 0..255}
                RmDestRomIdxOfRmGDestRom: resulting-properties={base-type=uint8, sw-calibration-access=READ-ONLY, range raw 0..255}
                RmGDestTpTxStateRamIdxOfRmGDestRom: resulting-properties={base-type=uint8, sw-calibration-access=READ-ONLY, compu {255=PDUR_NO_RMGDESTTPTXSTATERAMIDXOFRMGDESTROM}, range raw 0..255}
                RmGDestTpTxStateRamPartitionIdxOfRmGDestRom: resulting-properties={base-type=uint8, sw-calibration-access=READ-ONLY, compu {255=PDUR_NO_RMGDESTTPTXSTATERAMPARTITIONIDXOFRMGDESTROM}, range raw 0..255}
            Element_43: symbol=[43]
              10 x mc data instance, all with category=VALUE:
                MaxPduLengthOfRmGDestRom: resulting-properties={base-type=uint16, sw-calibration-access=READ-ONLY, range raw 0..65535}
                DestHndOfRmGDestRom: resulting-properties={base-type=uint8, sw-calibration-access=READ-ONLY, compu {255=PDUR_NO_DESTHNDOFRMGDESTROM}, range raw 0..255}
                DirectionOfRmGDestRom: resulting-properties={base-type=uint8, sw-calibration-access=READ-ONLY, compu {0=PDUR_RX_DIRECTIONOFRMGDESTROM, 1=PDUR_TX_DIRECTIONOFRMGDESTROM}, range raw 0..255}
                FmFifoInstanceRomIdxOfRmGDestRom: resulting-properties={base-type=uint8, sw-calibration-access=READ-ONLY, compu {255=PDUR_NO_FMFIFOINSTANCEROMIDXOFRMGDESTROM}, range raw 0..255}
                FmFifoInstanceRomPartitionIdxOfRmGDestRom: resulting-properties={base-type=uint8, sw-calibration-access=READ-ONLY, compu {255=PDUR_NO_FMFIFOINSTANCEROMPARTITIONIDXOFRMGDESTROM}, range raw 0..255}
                LockRomIdxOfRmGDestRom: resulting-properties={base-type=uint8, sw-calibration-access=READ-ONLY, range raw 0..255}
                MmRomIdxOfRmGDestRom: resulting-properties={base-type=uint8, sw-calibration-access=READ-ONLY, range raw 0..255}
                RmDestRomIdxOfRmGDestRom: resulting-properties={base-type=uint8, sw-calibration-access=READ-ONLY, range raw 0..255}
                RmGDestTpTxStateRamIdxOfRmGDestRom: resulting-properties={base-type=uint8, sw-calibration-access=READ-ONLY, compu {255=PDUR_NO_RMGDESTTPTXSTATERAMIDXOFRMGDESTROM}, range raw 0..255}
                RmGDestTpTxStateRamPartitionIdxOfRmGDestRom: resulting-properties={base-type=uint8, sw-calibration-access=READ-ONLY, compu {255=PDUR_NO_RMGDESTTPTXSTATERAMPARTITIONIDXOFRMGDESTROM}, range raw 0..255}
            Element_44: symbol=[44]
              10 x mc data instance, all with category=VALUE:
                MaxPduLengthOfRmGDestRom: resulting-properties={base-type=uint16, sw-calibration-access=READ-ONLY, range raw 0..65535}
                DestHndOfRmGDestRom: resulting-properties={base-type=uint8, sw-calibration-access=READ-ONLY, compu {255=PDUR_NO_DESTHNDOFRMGDESTROM}, range raw 0..255}
                DirectionOfRmGDestRom: resulting-properties={base-type=uint8, sw-calibration-access=READ-ONLY, compu {0=PDUR_RX_DIRECTIONOFRMGDESTROM, 1=PDUR_TX_DIRECTIONOFRMGDESTROM}, range raw 0..255}
                FmFifoInstanceRomIdxOfRmGDestRom: resulting-properties={base-type=uint8, sw-calibration-access=READ-ONLY, compu {255=PDUR_NO_FMFIFOINSTANCEROMIDXOFRMGDESTROM}, range raw 0..255}
                FmFifoInstanceRomPartitionIdxOfRmGDestRom: resulting-properties={base-type=uint8, sw-calibration-access=READ-ONLY, compu {255=PDUR_NO_FMFIFOINSTANCEROMPARTITIONIDXOFRMGDESTROM}, range raw 0..255}
                LockRomIdxOfRmGDestRom: resulting-properties={base-type=uint8, sw-calibration-access=READ-ONLY, range raw 0..255}
                MmRomIdxOfRmGDestRom: resulting-properties={base-type=uint8, sw-calibration-access=READ-ONLY, range raw 0..255}
                RmDestRomIdxOfRmGDestRom: resulting-properties={base-type=uint8, sw-calibration-access=READ-ONLY, range raw 0..255}
                RmGDestTpTxStateRamIdxOfRmGDestRom: resulting-properties={base-type=uint8, sw-calibration-access=READ-ONLY, compu {255=PDUR_NO_RMGDESTTPTXSTATERAMIDXOFRMGDESTROM}, range raw 0..255}
                RmGDestTpTxStateRamPartitionIdxOfRmGDestRom: resulting-properties={base-type=uint8, sw-calibration-access=READ-ONLY, compu {255=PDUR_NO_RMGDESTTPTXSTATERAMPARTITIONIDXOFRMGDESTROM}, range raw 0..255}
            Element_45: symbol=[45]
              10 x mc data instance, all with category=VALUE:
                MaxPduLengthOfRmGDestRom: resulting-properties={base-type=uint16, sw-calibration-access=READ-ONLY, range raw 0..65535}
                DestHndOfRmGDestRom: resulting-properties={base-type=uint8, sw-calibration-access=READ-ONLY, compu {255=PDUR_NO_DESTHNDOFRMGDESTROM}, range raw 0..255}
                DirectionOfRmGDestRom: resulting-properties={base-type=uint8, sw-calibration-access=READ-ONLY, compu {0=PDUR_RX_DIRECTIONOFRMGDESTROM, 1=PDUR_TX_DIRECTIONOFRMGDESTROM}, range raw 0..255}
                FmFifoInstanceRomIdxOfRmGDestRom: resulting-properties={base-type=uint8, sw-calibration-access=READ-ONLY, compu {255=PDUR_NO_FMFIFOINSTANCEROMIDXOFRMGDESTROM}, range raw 0..255}
                FmFifoInstanceRomPartitionIdxOfRmGDestRom: resulting-properties={base-type=uint8, sw-calibration-access=READ-ONLY, compu {255=PDUR_NO_FMFIFOINSTANCEROMPARTITIONIDXOFRMGDESTROM}, range raw 0..255}
                LockRomIdxOfRmGDestRom: resulting-properties={base-type=uint8, sw-calibration-access=READ-ONLY, range raw 0..255}
                MmRomIdxOfRmGDestRom: resulting-properties={base-type=uint8, sw-calibration-access=READ-ONLY, range raw 0..255}
                RmDestRomIdxOfRmGDestRom: resulting-properties={base-type=uint8, sw-calibration-access=READ-ONLY, range raw 0..255}
                RmGDestTpTxStateRamIdxOfRmGDestRom: resulting-properties={base-type=uint8, sw-calibration-access=READ-ONLY, compu {255=PDUR_NO_RMGDESTTPTXSTATERAMIDXOFRMGDESTROM}, range raw 0..255}
                RmGDestTpTxStateRamPartitionIdxOfRmGDestRom: resulting-properties={base-type=uint8, sw-calibration-access=READ-ONLY, compu {255=PDUR_NO_RMGDESTTPTXSTATERAMPARTITIONIDXOFRMGDESTROM}, range raw 0..255}
            Element_46: symbol=[46]
              10 x mc data instance, all with category=VALUE:
                MaxPduLengthOfRmGDestRom: resulting-properties={base-type=uint16, sw-calibration-access=READ-ONLY, range raw 0..65535}
                DestHndOfRmGDestRom: resulting-properties={base-type=uint8, sw-calibration-access=READ-ONLY, compu {255=PDUR_NO_DESTHNDOFRMGDESTROM}, range raw 0..255}
                DirectionOfRmGDestRom: resulting-properties={base-type=uint8, sw-calibration-access=READ-ONLY, compu {0=PDUR_RX_DIRECTIONOFRMGDESTROM, 1=PDUR_TX_DIRECTIONOFRMGDESTROM}, range raw 0..255}
                FmFifoInstanceRomIdxOfRmGDestRom: resulting-properties={base-type=uint8, sw-calibration-access=READ-ONLY, compu {255=PDUR_NO_FMFIFOINSTANCEROMIDXOFRMGDESTROM}, range raw 0..255}
                FmFifoInstanceRomPartitionIdxOfRmGDestRom: resulting-properties={base-type=uint8, sw-calibration-access=READ-ONLY, compu {255=PDUR_NO_FMFIFOINSTANCEROMPARTITIONIDXOFRMGDESTROM}, range raw 0..255}
                LockRomIdxOfRmGDestRom: resulting-properties={base-type=uint8, sw-calibration-access=READ-ONLY, range raw 0..255}
                MmRomIdxOfRmGDestRom: resulting-properties={base-type=uint8, sw-calibration-access=READ-ONLY, range raw 0..255}
                RmDestRomIdxOfRmGDestRom: resulting-properties={base-type=uint8, sw-calibration-access=READ-ONLY, range raw 0..255}
                RmGDestTpTxStateRamIdxOfRmGDestRom: resulting-properties={base-type=uint8, sw-calibration-access=READ-ONLY, compu {255=PDUR_NO_RMGDESTTPTXSTATERAMIDXOFRMGDESTROM}, range raw 0..255}
                RmGDestTpTxStateRamPartitionIdxOfRmGDestRom: resulting-properties={base-type=uint8, sw-calibration-access=READ-ONLY, compu {255=PDUR_NO_RMGDESTTPTXSTATERAMPARTITIONIDXOFRMGDESTROM}, range raw 0..255}
            Element_47: symbol=[47]
              10 x mc data instance, all with category=VALUE:
                MaxPduLengthOfRmGDestRom: resulting-properties={base-type=uint16, sw-calibration-access=READ-ONLY, range raw 0..65535}
                DestHndOfRmGDestRom: resulting-properties={base-type=uint8, sw-calibration-access=READ-ONLY, compu {255=PDUR_NO_DESTHNDOFRMGDESTROM}, range raw 0..255}
                DirectionOfRmGDestRom: resulting-properties={base-type=uint8, sw-calibration-access=READ-ONLY, compu {0=PDUR_RX_DIRECTIONOFRMGDESTROM, 1=PDUR_TX_DIRECTIONOFRMGDESTROM}, range raw 0..255}
                FmFifoInstanceRomIdxOfRmGDestRom: resulting-properties={base-type=uint8, sw-calibration-access=READ-ONLY, compu {255=PDUR_NO_FMFIFOINSTANCEROMIDXOFRMGDESTROM}, range raw 0..255}
                FmFifoInstanceRomPartitionIdxOfRmGDestRom: resulting-properties={base-type=uint8, sw-calibration-access=READ-ONLY, compu {255=PDUR_NO_FMFIFOINSTANCEROMPARTITIONIDXOFRMGDESTROM}, range raw 0..255}
                LockRomIdxOfRmGDestRom: resulting-properties={base-type=uint8, sw-calibration-access=READ-ONLY, range raw 0..255}
                MmRomIdxOfRmGDestRom: resulting-properties={base-type=uint8, sw-calibration-access=READ-ONLY, range raw 0..255}
                RmDestRomIdxOfRmGDestRom: resulting-properties={base-type=uint8, sw-calibration-access=READ-ONLY, range raw 0..255}
                RmGDestTpTxStateRamIdxOfRmGDestRom: resulting-properties={base-type=uint8, sw-calibration-access=READ-ONLY, compu {255=PDUR_NO_RMGDESTTPTXSTATERAMIDXOFRMGDESTROM}, range raw 0..255}
                RmGDestTpTxStateRamPartitionIdxOfRmGDestRom: resulting-properties={base-type=uint8, sw-calibration-access=READ-ONLY, compu {255=PDUR_NO_RMGDESTTPTXSTATERAMPARTITIONIDXOFRMGDESTROM}, range raw 0..255}
            Element_48: symbol=[48]
              10 x mc data instance, all with category=VALUE:
                MaxPduLengthOfRmGDestRom: resulting-properties={base-type=uint16, sw-calibration-access=READ-ONLY, range raw 0..65535}
                DestHndOfRmGDestRom: resulting-properties={base-type=uint8, sw-calibration-access=READ-ONLY, compu {255=PDUR_NO_DESTHNDOFRMGDESTROM}, range raw 0..255}
                DirectionOfRmGDestRom: resulting-properties={base-type=uint8, sw-calibration-access=READ-ONLY, compu {0=PDUR_RX_DIRECTIONOFRMGDESTROM, 1=PDUR_TX_DIRECTIONOFRMGDESTROM}, range raw 0..255}
                FmFifoInstanceRomIdxOfRmGDestRom: resulting-properties={base-type=uint8, sw-calibration-access=READ-ONLY, compu {255=PDUR_NO_FMFIFOINSTANCEROMIDXOFRMGDESTROM}, range raw 0..255}
                FmFifoInstanceRomPartitionIdxOfRmGDestRom: resulting-properties={base-type=uint8, sw-calibration-access=READ-ONLY, compu {255=PDUR_NO_FMFIFOINSTANCEROMPARTITIONIDXOFRMGDESTROM}, range raw 0..255}
                LockRomIdxOfRmGDestRom: resulting-properties={base-type=uint8, sw-calibration-access=READ-ONLY, range raw 0..255}
                MmRomIdxOfRmGDestRom: resulting-properties={base-type=uint8, sw-calibration-access=READ-ONLY, range raw 0..255}
                RmDestRomIdxOfRmGDestRom: resulting-properties={base-type=uint8, sw-calibration-access=READ-ONLY, range raw 0..255}
                RmGDestTpTxStateRamIdxOfRmGDestRom: resulting-properties={base-type=uint8, sw-calibration-access=READ-ONLY, compu {255=PDUR_NO_RMGDESTTPTXSTATERAMIDXOFRMGDESTROM}, range raw 0..255}
                RmGDestTpTxStateRamPartitionIdxOfRmGDestRom: resulting-properties={base-type=uint8, sw-calibration-access=READ-ONLY, compu {255=PDUR_NO_RMGDESTTPTXSTATERAMPARTITIONIDXOFRMGDESTROM}, range raw 0..255}
            Element_49: symbol=[49]
              10 x mc data instance, all with category=VALUE:
                MaxPduLengthOfRmGDestRom: resulting-properties={base-type=uint16, sw-calibration-access=READ-ONLY, range raw 0..65535}
                DestHndOfRmGDestRom: resulting-properties={base-type=uint8, sw-calibration-access=READ-ONLY, compu {255=PDUR_NO_DESTHNDOFRMGDESTROM}, range raw 0..255}
                DirectionOfRmGDestRom: resulting-properties={base-type=uint8, sw-calibration-access=READ-ONLY, compu {0=PDUR_RX_DIRECTIONOFRMGDESTROM, 1=PDUR_TX_DIRECTIONOFRMGDESTROM}, range raw 0..255}
                FmFifoInstanceRomIdxOfRmGDestRom: resulting-properties={base-type=uint8, sw-calibration-access=READ-ONLY, compu {255=PDUR_NO_FMFIFOINSTANCEROMIDXOFRMGDESTROM}, range raw 0..255}
                FmFifoInstanceRomPartitionIdxOfRmGDestRom: resulting-properties={base-type=uint8, sw-calibration-access=READ-ONLY, compu {255=PDUR_NO_FMFIFOINSTANCEROMPARTITIONIDXOFRMGDESTROM}, range raw 0..255}
                LockRomIdxOfRmGDestRom: resulting-properties={base-type=uint8, sw-calibration-access=READ-ONLY, range raw 0..255}
                MmRomIdxOfRmGDestRom: resulting-properties={base-type=uint8, sw-calibration-access=READ-ONLY, range raw 0..255}
                RmDestRomIdxOfRmGDestRom: resulting-properties={base-type=uint8, sw-calibration-access=READ-ONLY, range raw 0..255}
                RmGDestTpTxStateRamIdxOfRmGDestRom: resulting-properties={base-type=uint8, sw-calibration-access=READ-ONLY, compu {255=PDUR_NO_RMGDESTTPTXSTATERAMIDXOFRMGDESTROM}, range raw 0..255}
                RmGDestTpTxStateRamPartitionIdxOfRmGDestRom: resulting-properties={base-type=uint8, sw-calibration-access=READ-ONLY, compu {255=PDUR_NO_RMGDESTTPTXSTATERAMPARTITIONIDXOFRMGDESTROM}, range raw 0..255}
            Element_50: symbol=[50]
              10 x mc data instance, all with category=VALUE:
                MaxPduLengthOfRmGDestRom: resulting-properties={base-type=uint16, sw-calibration-access=READ-ONLY, range raw 0..65535}
                DestHndOfRmGDestRom: resulting-properties={base-type=uint8, sw-calibration-access=READ-ONLY, compu {255=PDUR_NO_DESTHNDOFRMGDESTROM}, range raw 0..255}
                DirectionOfRmGDestRom: resulting-properties={base-type=uint8, sw-calibration-access=READ-ONLY, compu {0=PDUR_RX_DIRECTIONOFRMGDESTROM, 1=PDUR_TX_DIRECTIONOFRMGDESTROM}, range raw 0..255}
                FmFifoInstanceRomIdxOfRmGDestRom: resulting-properties={base-type=uint8, sw-calibration-access=READ-ONLY, compu {255=PDUR_NO_FMFIFOINSTANCEROMIDXOFRMGDESTROM}, range raw 0..255}
                FmFifoInstanceRomPartitionIdxOfRmGDestRom: resulting-properties={base-type=uint8, sw-calibration-access=READ-ONLY, compu {255=PDUR_NO_FMFIFOINSTANCEROMPARTITIONIDXOFRMGDESTROM}, range raw 0..255}
                LockRomIdxOfRmGDestRom: resulting-properties={base-type=uint8, sw-calibration-access=READ-ONLY, range raw 0..255}
                MmRomIdxOfRmGDestRom: resulting-properties={base-type=uint8, sw-calibration-access=READ-ONLY, range raw 0..255}
                RmDestRomIdxOfRmGDestRom: resulting-properties={base-type=uint8, sw-calibration-access=READ-ONLY, range raw 0..255}
                RmGDestTpTxStateRamIdxOfRmGDestRom: resulting-properties={base-type=uint8, sw-calibration-access=READ-ONLY, compu {255=PDUR_NO_RMGDESTTPTXSTATERAMIDXOFRMGDESTROM}, range raw 0..255}
                RmGDestTpTxStateRamPartitionIdxOfRmGDestRom: resulting-properties={base-type=uint8, sw-calibration-access=READ-ONLY, compu {255=PDUR_NO_RMGDESTTPTXSTATERAMPARTITIONIDXOFRMGDESTROM}, range raw 0..255}
            Element_51: symbol=[51]
              10 x mc data instance, all with category=VALUE:
                MaxPduLengthOfRmGDestRom: resulting-properties={base-type=uint16, sw-calibration-access=READ-ONLY, range raw 0..65535}
                DestHndOfRmGDestRom: resulting-properties={base-type=uint8, sw-calibration-access=READ-ONLY, compu {255=PDUR_NO_DESTHNDOFRMGDESTROM}, range raw 0..255}
                DirectionOfRmGDestRom: resulting-properties={base-type=uint8, sw-calibration-access=READ-ONLY, compu {0=PDUR_RX_DIRECTIONOFRMGDESTROM, 1=PDUR_TX_DIRECTIONOFRMGDESTROM}, range raw 0..255}
                FmFifoInstanceRomIdxOfRmGDestRom: resulting-properties={base-type=uint8, sw-calibration-access=READ-ONLY, compu {255=PDUR_NO_FMFIFOINSTANCEROMIDXOFRMGDESTROM}, range raw 0..255}
                FmFifoInstanceRomPartitionIdxOfRmGDestRom: resulting-properties={base-type=uint8, sw-calibration-access=READ-ONLY, compu {255=PDUR_NO_FMFIFOINSTANCEROMPARTITIONIDXOFRMGDESTROM}, range raw 0..255}
                LockRomIdxOfRmGDestRom: resulting-properties={base-type=uint8, sw-calibration-access=READ-ONLY, range raw 0..255}
                MmRomIdxOfRmGDestRom: resulting-properties={base-type=uint8, sw-calibration-access=READ-ONLY, range raw 0..255}
                RmDestRomIdxOfRmGDestRom: resulting-properties={base-type=uint8, sw-calibration-access=READ-ONLY, range raw 0..255}
                RmGDestTpTxStateRamIdxOfRmGDestRom: resulting-properties={base-type=uint8, sw-calibration-access=READ-ONLY, compu {255=PDUR_NO_RMGDESTTPTXSTATERAMIDXOFRMGDESTROM}, range raw 0..255}
                RmGDestTpTxStateRamPartitionIdxOfRmGDestRom: resulting-properties={base-type=uint8, sw-calibration-access=READ-ONLY, compu {255=PDUR_NO_RMGDESTTPTXSTATERAMPARTITIONIDXOFRMGDESTROM}, range raw 0..255}
            Element_52: symbol=[52]
              10 x mc data instance, all with category=VALUE:
                MaxPduLengthOfRmGDestRom: resulting-properties={base-type=uint16, sw-calibration-access=READ-ONLY, range raw 0..65535}
                DestHndOfRmGDestRom: resulting-properties={base-type=uint8, sw-calibration-access=READ-ONLY, compu {255=PDUR_NO_DESTHNDOFRMGDESTROM}, range raw 0..255}
                DirectionOfRmGDestRom: resulting-properties={base-type=uint8, sw-calibration-access=READ-ONLY, compu {0=PDUR_RX_DIRECTIONOFRMGDESTROM, 1=PDUR_TX_DIRECTIONOFRMGDESTROM}, range raw 0..255}
                FmFifoInstanceRomIdxOfRmGDestRom: resulting-properties={base-type=uint8, sw-calibration-access=READ-ONLY, compu {255=PDUR_NO_FMFIFOINSTANCEROMIDXOFRMGDESTROM}, range raw 0..255}
                FmFifoInstanceRomPartitionIdxOfRmGDestRom: resulting-properties={base-type=uint8, sw-calibration-access=READ-ONLY, compu {255=PDUR_NO_FMFIFOINSTANCEROMPARTITIONIDXOFRMGDESTROM}, range raw 0..255}
                LockRomIdxOfRmGDestRom: resulting-properties={base-type=uint8, sw-calibration-access=READ-ONLY, range raw 0..255}
                MmRomIdxOfRmGDestRom: resulting-properties={base-type=uint8, sw-calibration-access=READ-ONLY, range raw 0..255}
                RmDestRomIdxOfRmGDestRom: resulting-properties={base-type=uint8, sw-calibration-access=READ-ONLY, range raw 0..255}
                RmGDestTpTxStateRamIdxOfRmGDestRom: resulting-properties={base-type=uint8, sw-calibration-access=READ-ONLY, compu {255=PDUR_NO_RMGDESTTPTXSTATERAMIDXOFRMGDESTROM}, range raw 0..255}
                RmGDestTpTxStateRamPartitionIdxOfRmGDestRom: resulting-properties={base-type=uint8, sw-calibration-access=READ-ONLY, compu {255=PDUR_NO_RMGDESTTPTXSTATERAMPARTITIONIDXOFRMGDESTROM}, range raw 0..255}
            Element_53: symbol=[53]
              10 x mc data instance, all with category=VALUE:
                MaxPduLengthOfRmGDestRom: resulting-properties={base-type=uint16, sw-calibration-access=READ-ONLY, range raw 0..65535}
                DestHndOfRmGDestRom: resulting-properties={base-type=uint8, sw-calibration-access=READ-ONLY, compu {255=PDUR_NO_DESTHNDOFRMGDESTROM}, range raw 0..255}
                DirectionOfRmGDestRom: resulting-properties={base-type=uint8, sw-calibration-access=READ-ONLY, compu {0=PDUR_RX_DIRECTIONOFRMGDESTROM, 1=PDUR_TX_DIRECTIONOFRMGDESTROM}, range raw 0..255}
                FmFifoInstanceRomIdxOfRmGDestRom: resulting-properties={base-type=uint8, sw-calibration-access=READ-ONLY, compu {255=PDUR_NO_FMFIFOINSTANCEROMIDXOFRMGDESTROM}, range raw 0..255}
                FmFifoInstanceRomPartitionIdxOfRmGDestRom: resulting-properties={base-type=uint8, sw-calibration-access=READ-ONLY, compu {255=PDUR_NO_FMFIFOINSTANCEROMPARTITIONIDXOFRMGDESTROM}, range raw 0..255}
                LockRomIdxOfRmGDestRom: resulting-properties={base-type=uint8, sw-calibration-access=READ-ONLY, range raw 0..255}
                MmRomIdxOfRmGDestRom: resulting-properties={base-type=uint8, sw-calibration-access=READ-ONLY, range raw 0..255}
                RmDestRomIdxOfRmGDestRom: resulting-properties={base-type=uint8, sw-calibration-access=READ-ONLY, range raw 0..255}
                RmGDestTpTxStateRamIdxOfRmGDestRom: resulting-properties={base-type=uint8, sw-calibration-access=READ-ONLY, compu {255=PDUR_NO_RMGDESTTPTXSTATERAMIDXOFRMGDESTROM}, range raw 0..255}
                RmGDestTpTxStateRamPartitionIdxOfRmGDestRom: resulting-properties={base-type=uint8, sw-calibration-access=READ-ONLY, compu {255=PDUR_NO_RMGDESTTPTXSTATERAMPARTITIONIDXOFRMGDESTROM}, range raw 0..255}
            Element_54: symbol=[54]
              10 x mc data instance, all with category=VALUE:
                MaxPduLengthOfRmGDestRom: resulting-properties={base-type=uint16, sw-calibration-access=READ-ONLY, range raw 0..65535}
                DestHndOfRmGDestRom: resulting-properties={base-type=uint8, sw-calibration-access=READ-ONLY, compu {255=PDUR_NO_DESTHNDOFRMGDESTROM}, range raw 0..255}
                DirectionOfRmGDestRom: resulting-properties={base-type=uint8, sw-calibration-access=READ-ONLY, compu {0=PDUR_RX_DIRECTIONOFRMGDESTROM, 1=PDUR_TX_DIRECTIONOFRMGDESTROM}, range raw 0..255}
                FmFifoInstanceRomIdxOfRmGDestRom: resulting-properties={base-type=uint8, sw-calibration-access=READ-ONLY, compu {255=PDUR_NO_FMFIFOINSTANCEROMIDXOFRMGDESTROM}, range raw 0..255}
                FmFifoInstanceRomPartitionIdxOfRmGDestRom: resulting-properties={base-type=uint8, sw-calibration-access=READ-ONLY, compu {255=PDUR_NO_FMFIFOINSTANCEROMPARTITIONIDXOFRMGDESTROM}, range raw 0..255}
                LockRomIdxOfRmGDestRom: resulting-properties={base-type=uint8, sw-calibration-access=READ-ONLY, range raw 0..255}
                MmRomIdxOfRmGDestRom: resulting-properties={base-type=uint8, sw-calibration-access=READ-ONLY, range raw 0..255}
                RmDestRomIdxOfRmGDestRom: resulting-properties={base-type=uint8, sw-calibration-access=READ-ONLY, range raw 0..255}
                RmGDestTpTxStateRamIdxOfRmGDestRom: resulting-properties={base-type=uint8, sw-calibration-access=READ-ONLY, compu {255=PDUR_NO_RMGDESTTPTXSTATERAMIDXOFRMGDESTROM}, range raw 0..255}
                RmGDestTpTxStateRamPartitionIdxOfRmGDestRom: resulting-properties={base-type=uint8, sw-calibration-access=READ-ONLY, compu {255=PDUR_NO_RMGDESTTPTXSTATERAMPARTITIONIDXOFRMGDESTROM}, range raw 0..255}
            Element_55: symbol=[55]
              10 x mc data instance, all with category=VALUE:
                MaxPduLengthOfRmGDestRom: resulting-properties={base-type=uint16, sw-calibration-access=READ-ONLY, range raw 0..65535}
                DestHndOfRmGDestRom: resulting-properties={base-type=uint8, sw-calibration-access=READ-ONLY, compu {255=PDUR_NO_DESTHNDOFRMGDESTROM}, range raw 0..255}
                DirectionOfRmGDestRom: resulting-properties={base-type=uint8, sw-calibration-access=READ-ONLY, compu {0=PDUR_RX_DIRECTIONOFRMGDESTROM, 1=PDUR_TX_DIRECTIONOFRMGDESTROM}, range raw 0..255}
                FmFifoInstanceRomIdxOfRmGDestRom: resulting-properties={base-type=uint8, sw-calibration-access=READ-ONLY, compu {255=PDUR_NO_FMFIFOINSTANCEROMIDXOFRMGDESTROM}, range raw 0..255}
                FmFifoInstanceRomPartitionIdxOfRmGDestRom: resulting-properties={base-type=uint8, sw-calibration-access=READ-ONLY, compu {255=PDUR_NO_FMFIFOINSTANCEROMPARTITIONIDXOFRMGDESTROM}, range raw 0..255}
                LockRomIdxOfRmGDestRom: resulting-properties={base-type=uint8, sw-calibration-access=READ-ONLY, range raw 0..255}
                MmRomIdxOfRmGDestRom: resulting-properties={base-type=uint8, sw-calibration-access=READ-ONLY, range raw 0..255}
                RmDestRomIdxOfRmGDestRom: resulting-properties={base-type=uint8, sw-calibration-access=READ-ONLY, range raw 0..255}
                RmGDestTpTxStateRamIdxOfRmGDestRom: resulting-properties={base-type=uint8, sw-calibration-access=READ-ONLY, compu {255=PDUR_NO_RMGDESTTPTXSTATERAMIDXOFRMGDESTROM}, range raw 0..255}
                RmGDestTpTxStateRamPartitionIdxOfRmGDestRom: resulting-properties={base-type=uint8, sw-calibration-access=READ-ONLY, compu {255=PDUR_NO_RMGDESTTPTXSTATERAMPARTITIONIDXOFRMGDESTROM}, range raw 0..255}
            Element_56: symbol=[56]
              10 x mc data instance, all with category=VALUE:
                MaxPduLengthOfRmGDestRom: resulting-properties={base-type=uint16, sw-calibration-access=READ-ONLY, range raw 0..65535}
                DestHndOfRmGDestRom: resulting-properties={base-type=uint8, sw-calibration-access=READ-ONLY, compu {255=PDUR_NO_DESTHNDOFRMGDESTROM}, range raw 0..255}
                DirectionOfRmGDestRom: resulting-properties={base-type=uint8, sw-calibration-access=READ-ONLY, compu {0=PDUR_RX_DIRECTIONOFRMGDESTROM, 1=PDUR_TX_DIRECTIONOFRMGDESTROM}, range raw 0..255}
                FmFifoInstanceRomIdxOfRmGDestRom: resulting-properties={base-type=uint8, sw-calibration-access=READ-ONLY, compu {255=PDUR_NO_FMFIFOINSTANCEROMIDXOFRMGDESTROM}, range raw 0..255}
                FmFifoInstanceRomPartitionIdxOfRmGDestRom: resulting-properties={base-type=uint8, sw-calibration-access=READ-ONLY, compu {255=PDUR_NO_FMFIFOINSTANCEROMPARTITIONIDXOFRMGDESTROM}, range raw 0..255}
                LockRomIdxOfRmGDestRom: resulting-properties={base-type=uint8, sw-calibration-access=READ-ONLY, range raw 0..255}
                MmRomIdxOfRmGDestRom: resulting-properties={base-type=uint8, sw-calibration-access=READ-ONLY, range raw 0..255}
                RmDestRomIdxOfRmGDestRom: resulting-properties={base-type=uint8, sw-calibration-access=READ-ONLY, range raw 0..255}
                RmGDestTpTxStateRamIdxOfRmGDestRom: resulting-properties={base-type=uint8, sw-calibration-access=READ-ONLY, compu {255=PDUR_NO_RMGDESTTPTXSTATERAMIDXOFRMGDESTROM}, range raw 0..255}
                RmGDestTpTxStateRamPartitionIdxOfRmGDestRom: resulting-properties={base-type=uint8, sw-calibration-access=READ-ONLY, compu {255=PDUR_NO_RMGDESTTPTXSTATERAMPARTITIONIDXOFRMGDESTROM}, range raw 0..255}
            Element_57: symbol=[57]
              10 x mc data instance, all with category=VALUE:
                MaxPduLengthOfRmGDestRom: resulting-properties={base-type=uint16, sw-calibration-access=READ-ONLY, range raw 0..65535}
                DestHndOfRmGDestRom: resulting-properties={base-type=uint8, sw-calibration-access=READ-ONLY, compu {255=PDUR_NO_DESTHNDOFRMGDESTROM}, range raw 0..255}
                DirectionOfRmGDestRom: resulting-properties={base-type=uint8, sw-calibration-access=READ-ONLY, compu {0=PDUR_RX_DIRECTIONOFRMGDESTROM, 1=PDUR_TX_DIRECTIONOFRMGDESTROM}, range raw 0..255}
                FmFifoInstanceRomIdxOfRmGDestRom: resulting-properties={base-type=uint8, sw-calibration-access=READ-ONLY, compu {255=PDUR_NO_FMFIFOINSTANCEROMIDXOFRMGDESTROM}, range raw 0..255}
                FmFifoInstanceRomPartitionIdxOfRmGDestRom: resulting-properties={base-type=uint8, sw-calibration-access=READ-ONLY, compu {255=PDUR_NO_FMFIFOINSTANCEROMPARTITIONIDXOFRMGDESTROM}, range raw 0..255}
                LockRomIdxOfRmGDestRom: resulting-properties={base-type=uint8, sw-calibration-access=READ-ONLY, range raw 0..255}
                MmRomIdxOfRmGDestRom: resulting-properties={base-type=uint8, sw-calibration-access=READ-ONLY, range raw 0..255}
                RmDestRomIdxOfRmGDestRom: resulting-properties={base-type=uint8, sw-calibration-access=READ-ONLY, range raw 0..255}
                RmGDestTpTxStateRamIdxOfRmGDestRom: resulting-properties={base-type=uint8, sw-calibration-access=READ-ONLY, compu {255=PDUR_NO_RMGDESTTPTXSTATERAMIDXOFRMGDESTROM}, range raw 0..255}
                RmGDestTpTxStateRamPartitionIdxOfRmGDestRom: resulting-properties={base-type=uint8, sw-calibration-access=READ-ONLY, compu {255=PDUR_NO_RMGDESTTPTXSTATERAMPARTITIONIDXOFRMGDESTROM}, range raw 0..255}
            Element_58: symbol=[58]
              10 x mc data instance, all with category=VALUE:
                MaxPduLengthOfRmGDestRom: resulting-properties={base-type=uint16, sw-calibration-access=READ-ONLY, range raw 0..65535}
                DestHndOfRmGDestRom: resulting-properties={base-type=uint8, sw-calibration-access=READ-ONLY, compu {255=PDUR_NO_DESTHNDOFRMGDESTROM}, range raw 0..255}
                DirectionOfRmGDestRom: resulting-properties={base-type=uint8, sw-calibration-access=READ-ONLY, compu {0=PDUR_RX_DIRECTIONOFRMGDESTROM, 1=PDUR_TX_DIRECTIONOFRMGDESTROM}, range raw 0..255}
                FmFifoInstanceRomIdxOfRmGDestRom: resulting-properties={base-type=uint8, sw-calibration-access=READ-ONLY, compu {255=PDUR_NO_FMFIFOINSTANCEROMIDXOFRMGDESTROM}, range raw 0..255}
                FmFifoInstanceRomPartitionIdxOfRmGDestRom: resulting-properties={base-type=uint8, sw-calibration-access=READ-ONLY, compu {255=PDUR_NO_FMFIFOINSTANCEROMPARTITIONIDXOFRMGDESTROM}, range raw 0..255}
                LockRomIdxOfRmGDestRom: resulting-properties={base-type=uint8, sw-calibration-access=READ-ONLY, range raw 0..255}
                MmRomIdxOfRmGDestRom: resulting-properties={base-type=uint8, sw-calibration-access=READ-ONLY, range raw 0..255}
                RmDestRomIdxOfRmGDestRom: resulting-properties={base-type=uint8, sw-calibration-access=READ-ONLY, range raw 0..255}
                RmGDestTpTxStateRamIdxOfRmGDestRom: resulting-properties={base-type=uint8, sw-calibration-access=READ-ONLY, compu {255=PDUR_NO_RMGDESTTPTXSTATERAMIDXOFRMGDESTROM}, range raw 0..255}
                RmGDestTpTxStateRamPartitionIdxOfRmGDestRom: resulting-properties={base-type=uint8, sw-calibration-access=READ-ONLY, compu {255=PDUR_NO_RMGDESTTPTXSTATERAMPARTITIONIDXOFRMGDESTROM}, range raw 0..255}
            Element_59: symbol=[59]
              10 x mc data instance, all with category=VALUE:
                MaxPduLengthOfRmGDestRom: resulting-properties={base-type=uint16, sw-calibration-access=READ-ONLY, range raw 0..65535}
                DestHndOfRmGDestRom: resulting-properties={base-type=uint8, sw-calibration-access=READ-ONLY, compu {255=PDUR_NO_DESTHNDOFRMGDESTROM}, range raw 0..255}
                DirectionOfRmGDestRom: resulting-properties={base-type=uint8, sw-calibration-access=READ-ONLY, compu {0=PDUR_RX_DIRECTIONOFRMGDESTROM, 1=PDUR_TX_DIRECTIONOFRMGDESTROM}, range raw 0..255}
                FmFifoInstanceRomIdxOfRmGDestRom: resulting-properties={base-type=uint8, sw-calibration-access=READ-ONLY, compu {255=PDUR_NO_FMFIFOINSTANCEROMIDXOFRMGDESTROM}, range raw 0..255}
                FmFifoInstanceRomPartitionIdxOfRmGDestRom: resulting-properties={base-type=uint8, sw-calibration-access=READ-ONLY, compu {255=PDUR_NO_FMFIFOINSTANCEROMPARTITIONIDXOFRMGDESTROM}, range raw 0..255}
                LockRomIdxOfRmGDestRom: resulting-properties={base-type=uint8, sw-calibration-access=READ-ONLY, range raw 0..255}
                MmRomIdxOfRmGDestRom: resulting-properties={base-type=uint8, sw-calibration-access=READ-ONLY, range raw 0..255}
                RmDestRomIdxOfRmGDestRom: resulting-properties={base-type=uint8, sw-calibration-access=READ-ONLY, range raw 0..255}
                RmGDestTpTxStateRamIdxOfRmGDestRom: resulting-properties={base-type=uint8, sw-calibration-access=READ-ONLY, compu {255=PDUR_NO_RMGDESTTPTXSTATERAMIDXOFRMGDESTROM}, range raw 0..255}
                RmGDestTpTxStateRamPartitionIdxOfRmGDestRom: resulting-properties={base-type=uint8, sw-calibration-access=READ-ONLY, compu {255=PDUR_NO_RMGDESTTPTXSTATERAMPARTITIONIDXOFRMGDESTROM}, range raw 0..255}
            Element_60: symbol=[60]
              10 x mc data instance, all with category=VALUE:
                MaxPduLengthOfRmGDestRom: resulting-properties={base-type=uint16, sw-calibration-access=READ-ONLY, range raw 0..65535}
                DestHndOfRmGDestRom: resulting-properties={base-type=uint8, sw-calibration-access=READ-ONLY, compu {255=PDUR_NO_DESTHNDOFRMGDESTROM}, range raw 0..255}
                DirectionOfRmGDestRom: resulting-properties={base-type=uint8, sw-calibration-access=READ-ONLY, compu {0=PDUR_RX_DIRECTIONOFRMGDESTROM, 1=PDUR_TX_DIRECTIONOFRMGDESTROM}, range raw 0..255}
                FmFifoInstanceRomIdxOfRmGDestRom: resulting-properties={base-type=uint8, sw-calibration-access=READ-ONLY, compu {255=PDUR_NO_FMFIFOINSTANCEROMIDXOFRMGDESTROM}, range raw 0..255}
                FmFifoInstanceRomPartitionIdxOfRmGDestRom: resulting-properties={base-type=uint8, sw-calibration-access=READ-ONLY, compu {255=PDUR_NO_FMFIFOINSTANCEROMPARTITIONIDXOFRMGDESTROM}, range raw 0..255}
                LockRomIdxOfRmGDestRom: resulting-properties={base-type=uint8, sw-calibration-access=READ-ONLY, range raw 0..255}
                MmRomIdxOfRmGDestRom: resulting-properties={base-type=uint8, sw-calibration-access=READ-ONLY, range raw 0..255}
                RmDestRomIdxOfRmGDestRom: resulting-properties={base-type=uint8, sw-calibration-access=READ-ONLY, range raw 0..255}
                RmGDestTpTxStateRamIdxOfRmGDestRom: resulting-properties={base-type=uint8, sw-calibration-access=READ-ONLY, compu {255=PDUR_NO_RMGDESTTPTXSTATERAMIDXOFRMGDESTROM}, range raw 0..255}
                RmGDestTpTxStateRamPartitionIdxOfRmGDestRom: resulting-properties={base-type=uint8, sw-calibration-access=READ-ONLY, compu {255=PDUR_NO_RMGDESTTPTXSTATERAMPARTITIONIDXOFRMGDESTROM}, range raw 0..255}
            Element_61: symbol=[61]
              10 x mc data instance, all with category=VALUE:
                MaxPduLengthOfRmGDestRom: resulting-properties={base-type=uint16, sw-calibration-access=READ-ONLY, range raw 0..65535}
                DestHndOfRmGDestRom: resulting-properties={base-type=uint8, sw-calibration-access=READ-ONLY, compu {255=PDUR_NO_DESTHNDOFRMGDESTROM}, range raw 0..255}
                DirectionOfRmGDestRom: resulting-properties={base-type=uint8, sw-calibration-access=READ-ONLY, compu {0=PDUR_RX_DIRECTIONOFRMGDESTROM, 1=PDUR_TX_DIRECTIONOFRMGDESTROM}, range raw 0..255}
                FmFifoInstanceRomIdxOfRmGDestRom: resulting-properties={base-type=uint8, sw-calibration-access=READ-ONLY, compu {255=PDUR_NO_FMFIFOINSTANCEROMIDXOFRMGDESTROM}, range raw 0..255}
                FmFifoInstanceRomPartitionIdxOfRmGDestRom: resulting-properties={base-type=uint8, sw-calibration-access=READ-ONLY, compu {255=PDUR_NO_FMFIFOINSTANCEROMPARTITIONIDXOFRMGDESTROM}, range raw 0..255}
                LockRomIdxOfRmGDestRom: resulting-properties={base-type=uint8, sw-calibration-access=READ-ONLY, range raw 0..255}
                MmRomIdxOfRmGDestRom: resulting-properties={base-type=uint8, sw-calibration-access=READ-ONLY, range raw 0..255}
                RmDestRomIdxOfRmGDestRom: resulting-properties={base-type=uint8, sw-calibration-access=READ-ONLY, range raw 0..255}
                RmGDestTpTxStateRamIdxOfRmGDestRom: resulting-properties={base-type=uint8, sw-calibration-access=READ-ONLY, compu {255=PDUR_NO_RMGDESTTPTXSTATERAMIDXOFRMGDESTROM}, range raw 0..255}
                RmGDestTpTxStateRamPartitionIdxOfRmGDestRom: resulting-properties={base-type=uint8, sw-calibration-access=READ-ONLY, compu {255=PDUR_NO_RMGDESTTPTXSTATERAMPARTITIONIDXOFRMGDESTROM}, range raw 0..255}
            Element_62: symbol=[62]
              10 x mc data instance, all with category=VALUE:
                MaxPduLengthOfRmGDestRom: resulting-properties={base-type=uint16, sw-calibration-access=READ-ONLY, range raw 0..65535}
                DestHndOfRmGDestRom: resulting-properties={base-type=uint8, sw-calibration-access=READ-ONLY, compu {255=PDUR_NO_DESTHNDOFRMGDESTROM}, range raw 0..255}
                DirectionOfRmGDestRom: resulting-properties={base-type=uint8, sw-calibration-access=READ-ONLY, compu {0=PDUR_RX_DIRECTIONOFRMGDESTROM, 1=PDUR_TX_DIRECTIONOFRMGDESTROM}, range raw 0..255}
                FmFifoInstanceRomIdxOfRmGDestRom: resulting-properties={base-type=uint8, sw-calibration-access=READ-ONLY, compu {255=PDUR_NO_FMFIFOINSTANCEROMIDXOFRMGDESTROM}, range raw 0..255}
                FmFifoInstanceRomPartitionIdxOfRmGDestRom: resulting-properties={base-type=uint8, sw-calibration-access=READ-ONLY, compu {255=PDUR_NO_FMFIFOINSTANCEROMPARTITIONIDXOFRMGDESTROM}, range raw 0..255}
                LockRomIdxOfRmGDestRom: resulting-properties={base-type=uint8, sw-calibration-access=READ-ONLY, range raw 0..255}
                MmRomIdxOfRmGDestRom: resulting-properties={base-type=uint8, sw-calibration-access=READ-ONLY, range raw 0..255}
                RmDestRomIdxOfRmGDestRom: resulting-properties={base-type=uint8, sw-calibration-access=READ-ONLY, range raw 0..255}
                RmGDestTpTxStateRamIdxOfRmGDestRom: resulting-properties={base-type=uint8, sw-calibration-access=READ-ONLY, compu {255=PDUR_NO_RMGDESTTPTXSTATERAMIDXOFRMGDESTROM}, range raw 0..255}
                RmGDestTpTxStateRamPartitionIdxOfRmGDestRom: resulting-properties={base-type=uint8, sw-calibration-access=READ-ONLY, compu {255=PDUR_NO_RMGDESTTPTXSTATERAMPARTITIONIDXOFRMGDESTROM}, range raw 0..255}
            Element_63: symbol=[63]
              10 x mc data instance, all with category=VALUE:
                MaxPduLengthOfRmGDestRom: resulting-properties={base-type=uint16, sw-calibration-access=READ-ONLY, range raw 0..65535}
                DestHndOfRmGDestRom: resulting-properties={base-type=uint8, sw-calibration-access=READ-ONLY, compu {255=PDUR_NO_DESTHNDOFRMGDESTROM}, range raw 0..255}
                DirectionOfRmGDestRom: resulting-properties={base-type=uint8, sw-calibration-access=READ-ONLY, compu {0=PDUR_RX_DIRECTIONOFRMGDESTROM, 1=PDUR_TX_DIRECTIONOFRMGDESTROM}, range raw 0..255}
                FmFifoInstanceRomIdxOfRmGDestRom: resulting-properties={base-type=uint8, sw-calibration-access=READ-ONLY, compu {255=PDUR_NO_FMFIFOINSTANCEROMIDXOFRMGDESTROM}, range raw 0..255}
                FmFifoInstanceRomPartitionIdxOfRmGDestRom: resulting-properties={base-type=uint8, sw-calibration-access=READ-ONLY, compu {255=PDUR_NO_FMFIFOINSTANCEROMPARTITIONIDXOFRMGDESTROM}, range raw 0..255}
                LockRomIdxOfRmGDestRom: resulting-properties={base-type=uint8, sw-calibration-access=READ-ONLY, range raw 0..255}
                MmRomIdxOfRmGDestRom: resulting-properties={base-type=uint8, sw-calibration-access=READ-ONLY, range raw 0..255}
                RmDestRomIdxOfRmGDestRom: resulting-properties={base-type=uint8, sw-calibration-access=READ-ONLY, range raw 0..255}
                RmGDestTpTxStateRamIdxOfRmGDestRom: resulting-properties={base-type=uint8, sw-calibration-access=READ-ONLY, compu {255=PDUR_NO_RMGDESTTPTXSTATERAMIDXOFRMGDESTROM}, range raw 0..255}
                RmGDestTpTxStateRamPartitionIdxOfRmGDestRom: resulting-properties={base-type=uint8, sw-calibration-access=READ-ONLY, compu {255=PDUR_NO_RMGDESTTPTXSTATERAMPARTITIONIDXOFRMGDESTROM}, range raw 0..255}
            Element_64: symbol=[64]
              10 x mc data instance, all with category=VALUE:
                MaxPduLengthOfRmGDestRom: resulting-properties={base-type=uint16, sw-calibration-access=READ-ONLY, range raw 0..65535}
                DestHndOfRmGDestRom: resulting-properties={base-type=uint8, sw-calibration-access=READ-ONLY, compu {255=PDUR_NO_DESTHNDOFRMGDESTROM}, range raw 0..255}
                DirectionOfRmGDestRom: resulting-properties={base-type=uint8, sw-calibration-access=READ-ONLY, compu {0=PDUR_RX_DIRECTIONOFRMGDESTROM, 1=PDUR_TX_DIRECTIONOFRMGDESTROM}, range raw 0..255}
                FmFifoInstanceRomIdxOfRmGDestRom: resulting-properties={base-type=uint8, sw-calibration-access=READ-ONLY, compu {255=PDUR_NO_FMFIFOINSTANCEROMIDXOFRMGDESTROM}, range raw 0..255}
                FmFifoInstanceRomPartitionIdxOfRmGDestRom: resulting-properties={base-type=uint8, sw-calibration-access=READ-ONLY, compu {255=PDUR_NO_FMFIFOINSTANCEROMPARTITIONIDXOFRMGDESTROM}, range raw 0..255}
                LockRomIdxOfRmGDestRom: resulting-properties={base-type=uint8, sw-calibration-access=READ-ONLY, range raw 0..255}
                MmRomIdxOfRmGDestRom: resulting-properties={base-type=uint8, sw-calibration-access=READ-ONLY, range raw 0..255}
                RmDestRomIdxOfRmGDestRom: resulting-properties={base-type=uint8, sw-calibration-access=READ-ONLY, range raw 0..255}
                RmGDestTpTxStateRamIdxOfRmGDestRom: resulting-properties={base-type=uint8, sw-calibration-access=READ-ONLY, compu {255=PDUR_NO_RMGDESTTPTXSTATERAMIDXOFRMGDESTROM}, range raw 0..255}
                RmGDestTpTxStateRamPartitionIdxOfRmGDestRom: resulting-properties={base-type=uint8, sw-calibration-access=READ-ONLY, compu {255=PDUR_NO_RMGDESTTPTXSTATERAMPARTITIONIDXOFRMGDESTROM}, range raw 0..255}
            Element_65: symbol=[65]
              10 x mc data instance, all with category=VALUE:
                MaxPduLengthOfRmGDestRom: resulting-properties={base-type=uint16, sw-calibration-access=READ-ONLY, range raw 0..65535}
                DestHndOfRmGDestRom: resulting-properties={base-type=uint8, sw-calibration-access=READ-ONLY, compu {255=PDUR_NO_DESTHNDOFRMGDESTROM}, range raw 0..255}
                DirectionOfRmGDestRom: resulting-properties={base-type=uint8, sw-calibration-access=READ-ONLY, compu {0=PDUR_RX_DIRECTIONOFRMGDESTROM, 1=PDUR_TX_DIRECTIONOFRMGDESTROM}, range raw 0..255}
                FmFifoInstanceRomIdxOfRmGDestRom: resulting-properties={base-type=uint8, sw-calibration-access=READ-ONLY, compu {255=PDUR_NO_FMFIFOINSTANCEROMIDXOFRMGDESTROM}, range raw 0..255}
                FmFifoInstanceRomPartitionIdxOfRmGDestRom: resulting-properties={base-type=uint8, sw-calibration-access=READ-ONLY, compu {255=PDUR_NO_FMFIFOINSTANCEROMPARTITIONIDXOFRMGDESTROM}, range raw 0..255}
                LockRomIdxOfRmGDestRom: resulting-properties={base-type=uint8, sw-calibration-access=READ-ONLY, range raw 0..255}
                MmRomIdxOfRmGDestRom: resulting-properties={base-type=uint8, sw-calibration-access=READ-ONLY, range raw 0..255}
                RmDestRomIdxOfRmGDestRom: resulting-properties={base-type=uint8, sw-calibration-access=READ-ONLY, range raw 0..255}
                RmGDestTpTxStateRamIdxOfRmGDestRom: resulting-properties={base-type=uint8, sw-calibration-access=READ-ONLY, compu {255=PDUR_NO_RMGDESTTPTXSTATERAMIDXOFRMGDESTROM}, range raw 0..255}
                RmGDestTpTxStateRamPartitionIdxOfRmGDestRom: resulting-properties={base-type=uint8, sw-calibration-access=READ-ONLY, compu {255=PDUR_NO_RMGDESTTPTXSTATERAMPARTITIONIDXOFRMGDESTROM}, range raw 0..255}
            Element_66: symbol=[66]
              10 x mc data instance, all with category=VALUE:
                MaxPduLengthOfRmGDestRom: resulting-properties={base-type=uint16, sw-calibration-access=READ-ONLY, range raw 0..65535}
                DestHndOfRmGDestRom: resulting-properties={base-type=uint8, sw-calibration-access=READ-ONLY, compu {255=PDUR_NO_DESTHNDOFRMGDESTROM}, range raw 0..255}
                DirectionOfRmGDestRom: resulting-properties={base-type=uint8, sw-calibration-access=READ-ONLY, compu {0=PDUR_RX_DIRECTIONOFRMGDESTROM, 1=PDUR_TX_DIRECTIONOFRMGDESTROM}, range raw 0..255}
                FmFifoInstanceRomIdxOfRmGDestRom: resulting-properties={base-type=uint8, sw-calibration-access=READ-ONLY, compu {255=PDUR_NO_FMFIFOINSTANCEROMIDXOFRMGDESTROM}, range raw 0..255}
                FmFifoInstanceRomPartitionIdxOfRmGDestRom: resulting-properties={base-type=uint8, sw-calibration-access=READ-ONLY, compu {255=PDUR_NO_FMFIFOINSTANCEROMPARTITIONIDXOFRMGDESTROM}, range raw 0..255}
                LockRomIdxOfRmGDestRom: resulting-properties={base-type=uint8, sw-calibration-access=READ-ONLY, range raw 0..255}
                MmRomIdxOfRmGDestRom: resulting-properties={base-type=uint8, sw-calibration-access=READ-ONLY, range raw 0..255}
                RmDestRomIdxOfRmGDestRom: resulting-properties={base-type=uint8, sw-calibration-access=READ-ONLY, range raw 0..255}
                RmGDestTpTxStateRamIdxOfRmGDestRom: resulting-properties={base-type=uint8, sw-calibration-access=READ-ONLY, compu {255=PDUR_NO_RMGDESTTPTXSTATERAMIDXOFRMGDESTROM}, range raw 0..255}
                RmGDestTpTxStateRamPartitionIdxOfRmGDestRom: resulting-properties={base-type=uint8, sw-calibration-access=READ-ONLY, compu {255=PDUR_NO_RMGDESTTPTXSTATERAMPARTITIONIDXOFRMGDESTROM}, range raw 0..255}
            Element_67: symbol=[67]
              10 x mc data instance, all with category=VALUE:
                MaxPduLengthOfRmGDestRom: resulting-properties={base-type=uint16, sw-calibration-access=READ-ONLY, range raw 0..65535}
                DestHndOfRmGDestRom: resulting-properties={base-type=uint8, sw-calibration-access=READ-ONLY, compu {255=PDUR_NO_DESTHNDOFRMGDESTROM}, range raw 0..255}
                DirectionOfRmGDestRom: resulting-properties={base-type=uint8, sw-calibration-access=READ-ONLY, compu {0=PDUR_RX_DIRECTIONOFRMGDESTROM, 1=PDUR_TX_DIRECTIONOFRMGDESTROM}, range raw 0..255}
                FmFifoInstanceRomIdxOfRmGDestRom: resulting-properties={base-type=uint8, sw-calibration-access=READ-ONLY, compu {255=PDUR_NO_FMFIFOINSTANCEROMIDXOFRMGDESTROM}, range raw 0..255}
                FmFifoInstanceRomPartitionIdxOfRmGDestRom: resulting-properties={base-type=uint8, sw-calibration-access=READ-ONLY, compu {255=PDUR_NO_FMFIFOINSTANCEROMPARTITIONIDXOFRMGDESTROM}, range raw 0..255}
                LockRomIdxOfRmGDestRom: resulting-properties={base-type=uint8, sw-calibration-access=READ-ONLY, range raw 0..255}
                MmRomIdxOfRmGDestRom: resulting-properties={base-type=uint8, sw-calibration-access=READ-ONLY, range raw 0..255}
                RmDestRomIdxOfRmGDestRom: resulting-properties={base-type=uint8, sw-calibration-access=READ-ONLY, range raw 0..255}
                RmGDestTpTxStateRamIdxOfRmGDestRom: resulting-properties={base-type=uint8, sw-calibration-access=READ-ONLY, compu {255=PDUR_NO_RMGDESTTPTXSTATERAMIDXOFRMGDESTROM}, range raw 0..255}
                RmGDestTpTxStateRamPartitionIdxOfRmGDestRom: resulting-properties={base-type=uint8, sw-calibration-access=READ-ONLY, compu {255=PDUR_NO_RMGDESTTPTXSTATERAMPARTITIONIDXOFRMGDESTROM}, range raw 0..255}
            Element_68: symbol=[68]
              10 x mc data instance, all with category=VALUE:
                MaxPduLengthOfRmGDestRom: resulting-properties={base-type=uint16, sw-calibration-access=READ-ONLY, range raw 0..65535}
                DestHndOfRmGDestRom: resulting-properties={base-type=uint8, sw-calibration-access=READ-ONLY, compu {255=PDUR_NO_DESTHNDOFRMGDESTROM}, range raw 0..255}
                DirectionOfRmGDestRom: resulting-properties={base-type=uint8, sw-calibration-access=READ-ONLY, compu {0=PDUR_RX_DIRECTIONOFRMGDESTROM, 1=PDUR_TX_DIRECTIONOFRMGDESTROM}, range raw 0..255}
                FmFifoInstanceRomIdxOfRmGDestRom: resulting-properties={base-type=uint8, sw-calibration-access=READ-ONLY, compu {255=PDUR_NO_FMFIFOINSTANCEROMIDXOFRMGDESTROM}, range raw 0..255}
                FmFifoInstanceRomPartitionIdxOfRmGDestRom: resulting-properties={base-type=uint8, sw-calibration-access=READ-ONLY, compu {255=PDUR_NO_FMFIFOINSTANCEROMPARTITIONIDXOFRMGDESTROM}, range raw 0..255}
                LockRomIdxOfRmGDestRom: resulting-properties={base-type=uint8, sw-calibration-access=READ-ONLY, range raw 0..255}
                MmRomIdxOfRmGDestRom: resulting-properties={base-type=uint8, sw-calibration-access=READ-ONLY, range raw 0..255}
                RmDestRomIdxOfRmGDestRom: resulting-properties={base-type=uint8, sw-calibration-access=READ-ONLY, range raw 0..255}
                RmGDestTpTxStateRamIdxOfRmGDestRom: resulting-properties={base-type=uint8, sw-calibration-access=READ-ONLY, compu {255=PDUR_NO_RMGDESTTPTXSTATERAMIDXOFRMGDESTROM}, range raw 0..255}
                RmGDestTpTxStateRamPartitionIdxOfRmGDestRom: resulting-properties={base-type=uint8, sw-calibration-access=READ-ONLY, compu {255=PDUR_NO_RMGDESTTPTXSTATERAMPARTITIONIDXOFRMGDESTROM}, range raw 0..255}
            Element_69: symbol=[69]
              10 x mc data instance, all with category=VALUE:
                MaxPduLengthOfRmGDestRom: resulting-properties={base-type=uint16, sw-calibration-access=READ-ONLY, range raw 0..65535}
                DestHndOfRmGDestRom: resulting-properties={base-type=uint8, sw-calibration-access=READ-ONLY, compu {255=PDUR_NO_DESTHNDOFRMGDESTROM}, range raw 0..255}
                DirectionOfRmGDestRom: resulting-properties={base-type=uint8, sw-calibration-access=READ-ONLY, compu {0=PDUR_RX_DIRECTIONOFRMGDESTROM, 1=PDUR_TX_DIRECTIONOFRMGDESTROM}, range raw 0..255}
                FmFifoInstanceRomIdxOfRmGDestRom: resulting-properties={base-type=uint8, sw-calibration-access=READ-ONLY, compu {255=PDUR_NO_FMFIFOINSTANCEROMIDXOFRMGDESTROM}, range raw 0..255}
                FmFifoInstanceRomPartitionIdxOfRmGDestRom: resulting-properties={base-type=uint8, sw-calibration-access=READ-ONLY, compu {255=PDUR_NO_FMFIFOINSTANCEROMPARTITIONIDXOFRMGDESTROM}, range raw 0..255}
                LockRomIdxOfRmGDestRom: resulting-properties={base-type=uint8, sw-calibration-access=READ-ONLY, range raw 0..255}
                MmRomIdxOfRmGDestRom: resulting-properties={base-type=uint8, sw-calibration-access=READ-ONLY, range raw 0..255}
                RmDestRomIdxOfRmGDestRom: resulting-properties={base-type=uint8, sw-calibration-access=READ-ONLY, range raw 0..255}
                RmGDestTpTxStateRamIdxOfRmGDestRom: resulting-properties={base-type=uint8, sw-calibration-access=READ-ONLY, compu {255=PDUR_NO_RMGDESTTPTXSTATERAMIDXOFRMGDESTROM}, range raw 0..255}
                RmGDestTpTxStateRamPartitionIdxOfRmGDestRom: resulting-properties={base-type=uint8, sw-calibration-access=READ-ONLY, compu {255=PDUR_NO_RMGDESTTPTXSTATERAMPARTITIONIDXOFRMGDESTROM}, range raw 0..255}
            Element_70: symbol=[70]
              10 x mc data instance, all with category=VALUE:
                MaxPduLengthOfRmGDestRom: resulting-properties={base-type=uint16, sw-calibration-access=READ-ONLY, range raw 0..65535}
                DestHndOfRmGDestRom: resulting-properties={base-type=uint8, sw-calibration-access=READ-ONLY, compu {255=PDUR_NO_DESTHNDOFRMGDESTROM}, range raw 0..255}
                DirectionOfRmGDestRom: resulting-properties={base-type=uint8, sw-calibration-access=READ-ONLY, compu {0=PDUR_RX_DIRECTIONOFRMGDESTROM, 1=PDUR_TX_DIRECTIONOFRMGDESTROM}, range raw 0..255}
                FmFifoInstanceRomIdxOfRmGDestRom: resulting-properties={base-type=uint8, sw-calibration-access=READ-ONLY, compu {255=PDUR_NO_FMFIFOINSTANCEROMIDXOFRMGDESTROM}, range raw 0..255}
                FmFifoInstanceRomPartitionIdxOfRmGDestRom: resulting-properties={base-type=uint8, sw-calibration-access=READ-ONLY, compu {255=PDUR_NO_FMFIFOINSTANCEROMPARTITIONIDXOFRMGDESTROM}, range raw 0..255}
                LockRomIdxOfRmGDestRom: resulting-properties={base-type=uint8, sw-calibration-access=READ-ONLY, range raw 0..255}
                MmRomIdxOfRmGDestRom: resulting-properties={base-type=uint8, sw-calibration-access=READ-ONLY, range raw 0..255}
                RmDestRomIdxOfRmGDestRom: resulting-properties={base-type=uint8, sw-calibration-access=READ-ONLY, range raw 0..255}
                RmGDestTpTxStateRamIdxOfRmGDestRom: resulting-properties={base-type=uint8, sw-calibration-access=READ-ONLY, compu {255=PDUR_NO_RMGDESTTPTXSTATERAMIDXOFRMGDESTROM}, range raw 0..255}
                RmGDestTpTxStateRamPartitionIdxOfRmGDestRom: resulting-properties={base-type=uint8, sw-calibration-access=READ-ONLY, compu {255=PDUR_NO_RMGDESTTPTXSTATERAMPARTITIONIDXOFRMGDESTROM}, range raw 0..255}
            Element_71: symbol=[71]
              10 x mc data instance, all with category=VALUE:
                MaxPduLengthOfRmGDestRom: resulting-properties={base-type=uint16, sw-calibration-access=READ-ONLY, range raw 0..65535}
                DestHndOfRmGDestRom: resulting-properties={base-type=uint8, sw-calibration-access=READ-ONLY, compu {255=PDUR_NO_DESTHNDOFRMGDESTROM}, range raw 0..255}
                DirectionOfRmGDestRom: resulting-properties={base-type=uint8, sw-calibration-access=READ-ONLY, compu {0=PDUR_RX_DIRECTIONOFRMGDESTROM, 1=PDUR_TX_DIRECTIONOFRMGDESTROM}, range raw 0..255}
                FmFifoInstanceRomIdxOfRmGDestRom: resulting-properties={base-type=uint8, sw-calibration-access=READ-ONLY, compu {255=PDUR_NO_FMFIFOINSTANCEROMIDXOFRMGDESTROM}, range raw 0..255}
                FmFifoInstanceRomPartitionIdxOfRmGDestRom: resulting-properties={base-type=uint8, sw-calibration-access=READ-ONLY, compu {255=PDUR_NO_FMFIFOINSTANCEROMPARTITIONIDXOFRMGDESTROM}, range raw 0..255}
                LockRomIdxOfRmGDestRom: resulting-properties={base-type=uint8, sw-calibration-access=READ-ONLY, range raw 0..255}
                MmRomIdxOfRmGDestRom: resulting-properties={base-type=uint8, sw-calibration-access=READ-ONLY, range raw 0..255}
                RmDestRomIdxOfRmGDestRom: resulting-properties={base-type=uint8, sw-calibration-access=READ-ONLY, range raw 0..255}
                RmGDestTpTxStateRamIdxOfRmGDestRom: resulting-properties={base-type=uint8, sw-calibration-access=READ-ONLY, compu {255=PDUR_NO_RMGDESTTPTXSTATERAMIDXOFRMGDESTROM}, range raw 0..255}
                RmGDestTpTxStateRamPartitionIdxOfRmGDestRom: resulting-properties={base-type=uint8, sw-calibration-access=READ-ONLY, compu {255=PDUR_NO_RMGDESTTPTXSTATERAMPARTITIONIDXOFRMGDESTROM}, range raw 0..255}
            Element_72: symbol=[72]
              10 x mc data instance, all with category=VALUE:
                MaxPduLengthOfRmGDestRom: resulting-properties={base-type=uint16, sw-calibration-access=READ-ONLY, range raw 0..65535}
                DestHndOfRmGDestRom: resulting-properties={base-type=uint8, sw-calibration-access=READ-ONLY, compu {255=PDUR_NO_DESTHNDOFRMGDESTROM}, range raw 0..255}
                DirectionOfRmGDestRom: resulting-properties={base-type=uint8, sw-calibration-access=READ-ONLY, compu {0=PDUR_RX_DIRECTIONOFRMGDESTROM, 1=PDUR_TX_DIRECTIONOFRMGDESTROM}, range raw 0..255}
                FmFifoInstanceRomIdxOfRmGDestRom: resulting-properties={base-type=uint8, sw-calibration-access=READ-ONLY, compu {255=PDUR_NO_FMFIFOINSTANCEROMIDXOFRMGDESTROM}, range raw 0..255}
                FmFifoInstanceRomPartitionIdxOfRmGDestRom: resulting-properties={base-type=uint8, sw-calibration-access=READ-ONLY, compu {255=PDUR_NO_FMFIFOINSTANCEROMPARTITIONIDXOFRMGDESTROM}, range raw 0..255}
                LockRomIdxOfRmGDestRom: resulting-properties={base-type=uint8, sw-calibration-access=READ-ONLY, range raw 0..255}
                MmRomIdxOfRmGDestRom: resulting-properties={base-type=uint8, sw-calibration-access=READ-ONLY, range raw 0..255}
                RmDestRomIdxOfRmGDestRom: resulting-properties={base-type=uint8, sw-calibration-access=READ-ONLY, range raw 0..255}
                RmGDestTpTxStateRamIdxOfRmGDestRom: resulting-properties={base-type=uint8, sw-calibration-access=READ-ONLY, compu {255=PDUR_NO_RMGDESTTPTXSTATERAMIDXOFRMGDESTROM}, range raw 0..255}
                RmGDestTpTxStateRamPartitionIdxOfRmGDestRom: resulting-properties={base-type=uint8, sw-calibration-access=READ-ONLY, compu {255=PDUR_NO_RMGDESTTPTXSTATERAMPARTITIONIDXOFRMGDESTROM}, range raw 0..255}
            Element_73: symbol=[73]
              10 x mc data instance, all with category=VALUE:
                MaxPduLengthOfRmGDestRom: resulting-properties={base-type=uint16, sw-calibration-access=READ-ONLY, range raw 0..65535}
                DestHndOfRmGDestRom: resulting-properties={base-type=uint8, sw-calibration-access=READ-ONLY, compu {255=PDUR_NO_DESTHNDOFRMGDESTROM}, range raw 0..255}
                DirectionOfRmGDestRom: resulting-properties={base-type=uint8, sw-calibration-access=READ-ONLY, compu {0=PDUR_RX_DIRECTIONOFRMGDESTROM, 1=PDUR_TX_DIRECTIONOFRMGDESTROM}, range raw 0..255}
                FmFifoInstanceRomIdxOfRmGDestRom: resulting-properties={base-type=uint8, sw-calibration-access=READ-ONLY, compu {255=PDUR_NO_FMFIFOINSTANCEROMIDXOFRMGDESTROM}, range raw 0..255}
                FmFifoInstanceRomPartitionIdxOfRmGDestRom: resulting-properties={base-type=uint8, sw-calibration-access=READ-ONLY, compu {255=PDUR_NO_FMFIFOINSTANCEROMPARTITIONIDXOFRMGDESTROM}, range raw 0..255}
                LockRomIdxOfRmGDestRom: resulting-properties={base-type=uint8, sw-calibration-access=READ-ONLY, range raw 0..255}
                MmRomIdxOfRmGDestRom: resulting-properties={base-type=uint8, sw-calibration-access=READ-ONLY, range raw 0..255}
                RmDestRomIdxOfRmGDestRom: resulting-properties={base-type=uint8, sw-calibration-access=READ-ONLY, range raw 0..255}
                RmGDestTpTxStateRamIdxOfRmGDestRom: resulting-properties={base-type=uint8, sw-calibration-access=READ-ONLY, compu {255=PDUR_NO_RMGDESTTPTXSTATERAMIDXOFRMGDESTROM}, range raw 0..255}
                RmGDestTpTxStateRamPartitionIdxOfRmGDestRom: resulting-properties={base-type=uint8, sw-calibration-access=READ-ONLY, compu {255=PDUR_NO_RMGDESTTPTXSTATERAMPARTITIONIDXOFRMGDESTROM}, range raw 0..255}
            Element_74: symbol=[74]
              10 x mc data instance, all with category=VALUE:
                MaxPduLengthOfRmGDestRom: resulting-properties={base-type=uint16, sw-calibration-access=READ-ONLY, range raw 0..65535}
                DestHndOfRmGDestRom: resulting-properties={base-type=uint8, sw-calibration-access=READ-ONLY, compu {255=PDUR_NO_DESTHNDOFRMGDESTROM}, range raw 0..255}
                DirectionOfRmGDestRom: resulting-properties={base-type=uint8, sw-calibration-access=READ-ONLY, compu {0=PDUR_RX_DIRECTIONOFRMGDESTROM, 1=PDUR_TX_DIRECTIONOFRMGDESTROM}, range raw 0..255}
                FmFifoInstanceRomIdxOfRmGDestRom: resulting-properties={base-type=uint8, sw-calibration-access=READ-ONLY, compu {255=PDUR_NO_FMFIFOINSTANCEROMIDXOFRMGDESTROM}, range raw 0..255}
                FmFifoInstanceRomPartitionIdxOfRmGDestRom: resulting-properties={base-type=uint8, sw-calibration-access=READ-ONLY, compu {255=PDUR_NO_FMFIFOINSTANCEROMPARTITIONIDXOFRMGDESTROM}, range raw 0..255}
                LockRomIdxOfRmGDestRom: resulting-properties={base-type=uint8, sw-calibration-access=READ-ONLY, range raw 0..255}
                MmRomIdxOfRmGDestRom: resulting-properties={base-type=uint8, sw-calibration-access=READ-ONLY, range raw 0..255}
                RmDestRomIdxOfRmGDestRom: resulting-properties={base-type=uint8, sw-calibration-access=READ-ONLY, range raw 0..255}
                RmGDestTpTxStateRamIdxOfRmGDestRom: resulting-properties={base-type=uint8, sw-calibration-access=READ-ONLY, compu {255=PDUR_NO_RMGDESTTPTXSTATERAMIDXOFRMGDESTROM}, range raw 0..255}
                RmGDestTpTxStateRamPartitionIdxOfRmGDestRom: resulting-properties={base-type=uint8, sw-calibration-access=READ-ONLY, compu {255=PDUR_NO_RMGDESTTPTXSTATERAMPARTITIONIDXOFRMGDESTROM}, range raw 0..255}
            Element_75: symbol=[75]
              10 x mc data instance, all with category=VALUE:
                MaxPduLengthOfRmGDestRom: resulting-properties={base-type=uint16, sw-calibration-access=READ-ONLY, range raw 0..65535}
                DestHndOfRmGDestRom: resulting-properties={base-type=uint8, sw-calibration-access=READ-ONLY, compu {255=PDUR_NO_DESTHNDOFRMGDESTROM}, range raw 0..255}
                DirectionOfRmGDestRom: resulting-properties={base-type=uint8, sw-calibration-access=READ-ONLY, compu {0=PDUR_RX_DIRECTIONOFRMGDESTROM, 1=PDUR_TX_DIRECTIONOFRMGDESTROM}, range raw 0..255}
                FmFifoInstanceRomIdxOfRmGDestRom: resulting-properties={base-type=uint8, sw-calibration-access=READ-ONLY, compu {255=PDUR_NO_FMFIFOINSTANCEROMIDXOFRMGDESTROM}, range raw 0..255}
                FmFifoInstanceRomPartitionIdxOfRmGDestRom: resulting-properties={base-type=uint8, sw-calibration-access=READ-ONLY, compu {255=PDUR_NO_FMFIFOINSTANCEROMPARTITIONIDXOFRMGDESTROM}, range raw 0..255}
                LockRomIdxOfRmGDestRom: resulting-properties={base-type=uint8, sw-calibration-access=READ-ONLY, range raw 0..255}
                MmRomIdxOfRmGDestRom: resulting-properties={base-type=uint8, sw-calibration-access=READ-ONLY, range raw 0..255}
                RmDestRomIdxOfRmGDestRom: resulting-properties={base-type=uint8, sw-calibration-access=READ-ONLY, range raw 0..255}
                RmGDestTpTxStateRamIdxOfRmGDestRom: resulting-properties={base-type=uint8, sw-calibration-access=READ-ONLY, compu {255=PDUR_NO_RMGDESTTPTXSTATERAMIDXOFRMGDESTROM}, range raw 0..255}
                RmGDestTpTxStateRamPartitionIdxOfRmGDestRom: resulting-properties={base-type=uint8, sw-calibration-access=READ-ONLY, compu {255=PDUR_NO_RMGDESTTPTXSTATERAMPARTITIONIDXOFRMGDESTROM}, range raw 0..255}
            Element_76: symbol=[76]
              10 x mc data instance, all with category=VALUE:
                MaxPduLengthOfRmGDestRom: resulting-properties={base-type=uint16, sw-calibration-access=READ-ONLY, range raw 0..65535}
                DestHndOfRmGDestRom: resulting-properties={base-type=uint8, sw-calibration-access=READ-ONLY, compu {255=PDUR_NO_DESTHNDOFRMGDESTROM}, range raw 0..255}
                DirectionOfRmGDestRom: resulting-properties={base-type=uint8, sw-calibration-access=READ-ONLY, compu {0=PDUR_RX_DIRECTIONOFRMGDESTROM, 1=PDUR_TX_DIRECTIONOFRMGDESTROM}, range raw 0..255}
                FmFifoInstanceRomIdxOfRmGDestRom: resulting-properties={base-type=uint8, sw-calibration-access=READ-ONLY, compu {255=PDUR_NO_FMFIFOINSTANCEROMIDXOFRMGDESTROM}, range raw 0..255}
                FmFifoInstanceRomPartitionIdxOfRmGDestRom: resulting-properties={base-type=uint8, sw-calibration-access=READ-ONLY, compu {255=PDUR_NO_FMFIFOINSTANCEROMPARTITIONIDXOFRMGDESTROM}, range raw 0..255}
                LockRomIdxOfRmGDestRom: resulting-properties={base-type=uint8, sw-calibration-access=READ-ONLY, range raw 0..255}
                MmRomIdxOfRmGDestRom: resulting-properties={base-type=uint8, sw-calibration-access=READ-ONLY, range raw 0..255}
                RmDestRomIdxOfRmGDestRom: resulting-properties={base-type=uint8, sw-calibration-access=READ-ONLY, range raw 0..255}
                RmGDestTpTxStateRamIdxOfRmGDestRom: resulting-properties={base-type=uint8, sw-calibration-access=READ-ONLY, compu {255=PDUR_NO_RMGDESTTPTXSTATERAMIDXOFRMGDESTROM}, range raw 0..255}
                RmGDestTpTxStateRamPartitionIdxOfRmGDestRom: resulting-properties={base-type=uint8, sw-calibration-access=READ-ONLY, compu {255=PDUR_NO_RMGDESTTPTXSTATERAMPARTITIONIDXOFRMGDESTROM}, range raw 0..255}
            Element_77: symbol=[77]
              10 x mc data instance, all with category=VALUE:
                MaxPduLengthOfRmGDestRom: resulting-properties={base-type=uint16, sw-calibration-access=READ-ONLY, range raw 0..65535}
                DestHndOfRmGDestRom: resulting-properties={base-type=uint8, sw-calibration-access=READ-ONLY, compu {255=PDUR_NO_DESTHNDOFRMGDESTROM}, range raw 0..255}
                DirectionOfRmGDestRom: resulting-properties={base-type=uint8, sw-calibration-access=READ-ONLY, compu {0=PDUR_RX_DIRECTIONOFRMGDESTROM, 1=PDUR_TX_DIRECTIONOFRMGDESTROM}, range raw 0..255}
                FmFifoInstanceRomIdxOfRmGDestRom: resulting-properties={base-type=uint8, sw-calibration-access=READ-ONLY, compu {255=PDUR_NO_FMFIFOINSTANCEROMIDXOFRMGDESTROM}, range raw 0..255}
                FmFifoInstanceRomPartitionIdxOfRmGDestRom: resulting-properties={base-type=uint8, sw-calibration-access=READ-ONLY, compu {255=PDUR_NO_FMFIFOINSTANCEROMPARTITIONIDXOFRMGDESTROM}, range raw 0..255}
                LockRomIdxOfRmGDestRom: resulting-properties={base-type=uint8, sw-calibration-access=READ-ONLY, range raw 0..255}
                MmRomIdxOfRmGDestRom: resulting-properties={base-type=uint8, sw-calibration-access=READ-ONLY, range raw 0..255}
                RmDestRomIdxOfRmGDestRom: resulting-properties={base-type=uint8, sw-calibration-access=READ-ONLY, range raw 0..255}
                RmGDestTpTxStateRamIdxOfRmGDestRom: resulting-properties={base-type=uint8, sw-calibration-access=READ-ONLY, compu {255=PDUR_NO_RMGDESTTPTXSTATERAMIDXOFRMGDESTROM}, range raw 0..255}
                RmGDestTpTxStateRamPartitionIdxOfRmGDestRom: resulting-properties={base-type=uint8, sw-calibration-access=READ-ONLY, compu {255=PDUR_NO_RMGDESTTPTXSTATERAMPARTITIONIDXOFRMGDESTROM}, range raw 0..255}
            Element_78: symbol=[78]
              10 x mc data instance, all with category=VALUE:
                MaxPduLengthOfRmGDestRom: resulting-properties={base-type=uint16, sw-calibration-access=READ-ONLY, range raw 0..65535}
                DestHndOfRmGDestRom: resulting-properties={base-type=uint8, sw-calibration-access=READ-ONLY, compu {255=PDUR_NO_DESTHNDOFRMGDESTROM}, range raw 0..255}
                DirectionOfRmGDestRom: resulting-properties={base-type=uint8, sw-calibration-access=READ-ONLY, compu {0=PDUR_RX_DIRECTIONOFRMGDESTROM, 1=PDUR_TX_DIRECTIONOFRMGDESTROM}, range raw 0..255}
                FmFifoInstanceRomIdxOfRmGDestRom: resulting-properties={base-type=uint8, sw-calibration-access=READ-ONLY, compu {255=PDUR_NO_FMFIFOINSTANCEROMIDXOFRMGDESTROM}, range raw 0..255}
                FmFifoInstanceRomPartitionIdxOfRmGDestRom: resulting-properties={base-type=uint8, sw-calibration-access=READ-ONLY, compu {255=PDUR_NO_FMFIFOINSTANCEROMPARTITIONIDXOFRMGDESTROM}, range raw 0..255}
                LockRomIdxOfRmGDestRom: resulting-properties={base-type=uint8, sw-calibration-access=READ-ONLY, range raw 0..255}
                MmRomIdxOfRmGDestRom: resulting-properties={base-type=uint8, sw-calibration-access=READ-ONLY, range raw 0..255}
                RmDestRomIdxOfRmGDestRom: resulting-properties={base-type=uint8, sw-calibration-access=READ-ONLY, range raw 0..255}
                RmGDestTpTxStateRamIdxOfRmGDestRom: resulting-properties={base-type=uint8, sw-calibration-access=READ-ONLY, compu {255=PDUR_NO_RMGDESTTPTXSTATERAMIDXOFRMGDESTROM}, range raw 0..255}
                RmGDestTpTxStateRamPartitionIdxOfRmGDestRom: resulting-properties={base-type=uint8, sw-calibration-access=READ-ONLY, compu {255=PDUR_NO_RMGDESTTPTXSTATERAMPARTITIONIDXOFRMGDESTROM}, range raw 0..255}
            Element_79: symbol=[79]
              10 x mc data instance, all with category=VALUE:
                MaxPduLengthOfRmGDestRom: resulting-properties={base-type=uint16, sw-calibration-access=READ-ONLY, range raw 0..65535}
                DestHndOfRmGDestRom: resulting-properties={base-type=uint8, sw-calibration-access=READ-ONLY, compu {255=PDUR_NO_DESTHNDOFRMGDESTROM}, range raw 0..255}
                DirectionOfRmGDestRom: resulting-properties={base-type=uint8, sw-calibration-access=READ-ONLY, compu {0=PDUR_RX_DIRECTIONOFRMGDESTROM, 1=PDUR_TX_DIRECTIONOFRMGDESTROM}, range raw 0..255}
                FmFifoInstanceRomIdxOfRmGDestRom: resulting-properties={base-type=uint8, sw-calibration-access=READ-ONLY, compu {255=PDUR_NO_FMFIFOINSTANCEROMIDXOFRMGDESTROM}, range raw 0..255}
                FmFifoInstanceRomPartitionIdxOfRmGDestRom: resulting-properties={base-type=uint8, sw-calibration-access=READ-ONLY, compu {255=PDUR_NO_FMFIFOINSTANCEROMPARTITIONIDXOFRMGDESTROM}, range raw 0..255}
                LockRomIdxOfRmGDestRom: resulting-properties={base-type=uint8, sw-calibration-access=READ-ONLY, range raw 0..255}
                MmRomIdxOfRmGDestRom: resulting-properties={base-type=uint8, sw-calibration-access=READ-ONLY, range raw 0..255}
                RmDestRomIdxOfRmGDestRom: resulting-properties={base-type=uint8, sw-calibration-access=READ-ONLY, range raw 0..255}
                RmGDestTpTxStateRamIdxOfRmGDestRom: resulting-properties={base-type=uint8, sw-calibration-access=READ-ONLY, compu {255=PDUR_NO_RMGDESTTPTXSTATERAMIDXOFRMGDESTROM}, range raw 0..255}
                RmGDestTpTxStateRamPartitionIdxOfRmGDestRom: resulting-properties={base-type=uint8, sw-calibration-access=READ-ONLY, compu {255=PDUR_NO_RMGDESTTPTXSTATERAMPARTITIONIDXOFRMGDESTROM}, range raw 0..255}
            Element_80: symbol=[80]
              10 x mc data instance, all with category=VALUE:
                MaxPduLengthOfRmGDestRom: resulting-properties={base-type=uint16, sw-calibration-access=READ-ONLY, range raw 0..65535}
                DestHndOfRmGDestRom: resulting-properties={base-type=uint8, sw-calibration-access=READ-ONLY, compu {255=PDUR_NO_DESTHNDOFRMGDESTROM}, range raw 0..255}
                DirectionOfRmGDestRom: resulting-properties={base-type=uint8, sw-calibration-access=READ-ONLY, compu {0=PDUR_RX_DIRECTIONOFRMGDESTROM, 1=PDUR_TX_DIRECTIONOFRMGDESTROM}, range raw 0..255}
                FmFifoInstanceRomIdxOfRmGDestRom: resulting-properties={base-type=uint8, sw-calibration-access=READ-ONLY, compu {255=PDUR_NO_FMFIFOINSTANCEROMIDXOFRMGDESTROM}, range raw 0..255}
                FmFifoInstanceRomPartitionIdxOfRmGDestRom: resulting-properties={base-type=uint8, sw-calibration-access=READ-ONLY, compu {255=PDUR_NO_FMFIFOINSTANCEROMPARTITIONIDXOFRMGDESTROM}, range raw 0..255}
                LockRomIdxOfRmGDestRom: resulting-properties={base-type=uint8, sw-calibration-access=READ-ONLY, range raw 0..255}
                MmRomIdxOfRmGDestRom: resulting-properties={base-type=uint8, sw-calibration-access=READ-ONLY, range raw 0..255}
                RmDestRomIdxOfRmGDestRom: resulting-properties={base-type=uint8, sw-calibration-access=READ-ONLY, range raw 0..255}
                RmGDestTpTxStateRamIdxOfRmGDestRom: resulting-properties={base-type=uint8, sw-calibration-access=READ-ONLY, compu {255=PDUR_NO_RMGDESTTPTXSTATERAMIDXOFRMGDESTROM}, range raw 0..255}
                RmGDestTpTxStateRamPartitionIdxOfRmGDestRom: resulting-properties={base-type=uint8, sw-calibration-access=READ-ONLY, compu {255=PDUR_NO_RMGDESTTPTXSTATERAMPARTITIONIDXOFRMGDESTROM}, range raw 0..255}
            Element_81: symbol=[81]
              10 x mc data instance, all with category=VALUE:
                MaxPduLengthOfRmGDestRom: resulting-properties={base-type=uint16, sw-calibration-access=READ-ONLY, range raw 0..65535}
                DestHndOfRmGDestRom: resulting-properties={base-type=uint8, sw-calibration-access=READ-ONLY, compu {255=PDUR_NO_DESTHNDOFRMGDESTROM}, range raw 0..255}
                DirectionOfRmGDestRom: resulting-properties={base-type=uint8, sw-calibration-access=READ-ONLY, compu {0=PDUR_RX_DIRECTIONOFRMGDESTROM, 1=PDUR_TX_DIRECTIONOFRMGDESTROM}, range raw 0..255}
                FmFifoInstanceRomIdxOfRmGDestRom: resulting-properties={base-type=uint8, sw-calibration-access=READ-ONLY, compu {255=PDUR_NO_FMFIFOINSTANCEROMIDXOFRMGDESTROM}, range raw 0..255}
                FmFifoInstanceRomPartitionIdxOfRmGDestRom: resulting-properties={base-type=uint8, sw-calibration-access=READ-ONLY, compu {255=PDUR_NO_FMFIFOINSTANCEROMPARTITIONIDXOFRMGDESTROM}, range raw 0..255}
                LockRomIdxOfRmGDestRom: resulting-properties={base-type=uint8, sw-calibration-access=READ-ONLY, range raw 0..255}
                MmRomIdxOfRmGDestRom: resulting-properties={base-type=uint8, sw-calibration-access=READ-ONLY, range raw 0..255}
                RmDestRomIdxOfRmGDestRom: resulting-properties={base-type=uint8, sw-calibration-access=READ-ONLY, range raw 0..255}
                RmGDestTpTxStateRamIdxOfRmGDestRom: resulting-properties={base-type=uint8, sw-calibration-access=READ-ONLY, compu {255=PDUR_NO_RMGDESTTPTXSTATERAMIDXOFRMGDESTROM}, range raw 0..255}
                RmGDestTpTxStateRamPartitionIdxOfRmGDestRom: resulting-properties={base-type=uint8, sw-calibration-access=READ-ONLY, compu {255=PDUR_NO_RMGDESTTPTXSTATERAMPARTITIONIDXOFRMGDESTROM}, range raw 0..255}
            Element_82: symbol=[82]
              10 x mc data instance, all with category=VALUE:
                MaxPduLengthOfRmGDestRom: resulting-properties={base-type=uint16, sw-calibration-access=READ-ONLY, range raw 0..65535}
                DestHndOfRmGDestRom: resulting-properties={base-type=uint8, sw-calibration-access=READ-ONLY, compu {255=PDUR_NO_DESTHNDOFRMGDESTROM}, range raw 0..255}
                DirectionOfRmGDestRom: resulting-properties={base-type=uint8, sw-calibration-access=READ-ONLY, compu {0=PDUR_RX_DIRECTIONOFRMGDESTROM, 1=PDUR_TX_DIRECTIONOFRMGDESTROM}, range raw 0..255}
                FmFifoInstanceRomIdxOfRmGDestRom: resulting-properties={base-type=uint8, sw-calibration-access=READ-ONLY, compu {255=PDUR_NO_FMFIFOINSTANCEROMIDXOFRMGDESTROM}, range raw 0..255}
                FmFifoInstanceRomPartitionIdxOfRmGDestRom: resulting-properties={base-type=uint8, sw-calibration-access=READ-ONLY, compu {255=PDUR_NO_FMFIFOINSTANCEROMPARTITIONIDXOFRMGDESTROM}, range raw 0..255}
                LockRomIdxOfRmGDestRom: resulting-properties={base-type=uint8, sw-calibration-access=READ-ONLY, range raw 0..255}
                MmRomIdxOfRmGDestRom: resulting-properties={base-type=uint8, sw-calibration-access=READ-ONLY, range raw 0..255}
                RmDestRomIdxOfRmGDestRom: resulting-properties={base-type=uint8, sw-calibration-access=READ-ONLY, range raw 0..255}
                RmGDestTpTxStateRamIdxOfRmGDestRom: resulting-properties={base-type=uint8, sw-calibration-access=READ-ONLY, compu {255=PDUR_NO_RMGDESTTPTXSTATERAMIDXOFRMGDESTROM}, range raw 0..255}
                RmGDestTpTxStateRamPartitionIdxOfRmGDestRom: resulting-properties={base-type=uint8, sw-calibration-access=READ-ONLY, compu {255=PDUR_NO_RMGDESTTPTXSTATERAMPARTITIONIDXOFRMGDESTROM}, range raw 0..255}
            Element_83: symbol=[83]
              10 x mc data instance, all with category=VALUE:
                MaxPduLengthOfRmGDestRom: resulting-properties={base-type=uint16, sw-calibration-access=READ-ONLY, range raw 0..65535}
                DestHndOfRmGDestRom: resulting-properties={base-type=uint8, sw-calibration-access=READ-ONLY, compu {255=PDUR_NO_DESTHNDOFRMGDESTROM}, range raw 0..255}
                DirectionOfRmGDestRom: resulting-properties={base-type=uint8, sw-calibration-access=READ-ONLY, compu {0=PDUR_RX_DIRECTIONOFRMGDESTROM, 1=PDUR_TX_DIRECTIONOFRMGDESTROM}, range raw 0..255}
                FmFifoInstanceRomIdxOfRmGDestRom: resulting-properties={base-type=uint8, sw-calibration-access=READ-ONLY, compu {255=PDUR_NO_FMFIFOINSTANCEROMIDXOFRMGDESTROM}, range raw 0..255}
                FmFifoInstanceRomPartitionIdxOfRmGDestRom: resulting-properties={base-type=uint8, sw-calibration-access=READ-ONLY, compu {255=PDUR_NO_FMFIFOINSTANCEROMPARTITIONIDXOFRMGDESTROM}, range raw 0..255}
                LockRomIdxOfRmGDestRom: resulting-properties={base-type=uint8, sw-calibration-access=READ-ONLY, range raw 0..255}
                MmRomIdxOfRmGDestRom: resulting-properties={base-type=uint8, sw-calibration-access=READ-ONLY, range raw 0..255}
                RmDestRomIdxOfRmGDestRom: resulting-properties={base-type=uint8, sw-calibration-access=READ-ONLY, range raw 0..255}
                RmGDestTpTxStateRamIdxOfRmGDestRom: resulting-properties={base-type=uint8, sw-calibration-access=READ-ONLY, compu {255=PDUR_NO_RMGDESTTPTXSTATERAMIDXOFRMGDESTROM}, range raw 0..255}
                RmGDestTpTxStateRamPartitionIdxOfRmGDestRom: resulting-properties={base-type=uint8, sw-calibration-access=READ-ONLY, compu {255=PDUR_NO_RMGDESTTPTXSTATERAMPARTITIONIDXOFRMGDESTROM}, range raw 0..255}
            Element_84: symbol=[84]
              10 x mc data instance, all with category=VALUE:
                MaxPduLengthOfRmGDestRom: resulting-properties={base-type=uint16, sw-calibration-access=READ-ONLY, range raw 0..65535}
                DestHndOfRmGDestRom: resulting-properties={base-type=uint8, sw-calibration-access=READ-ONLY, compu {255=PDUR_NO_DESTHNDOFRMGDESTROM}, range raw 0..255}
                DirectionOfRmGDestRom: resulting-properties={base-type=uint8, sw-calibration-access=READ-ONLY, compu {0=PDUR_RX_DIRECTIONOFRMGDESTROM, 1=PDUR_TX_DIRECTIONOFRMGDESTROM}, range raw 0..255}
                FmFifoInstanceRomIdxOfRmGDestRom: resulting-properties={base-type=uint8, sw-calibration-access=READ-ONLY, compu {255=PDUR_NO_FMFIFOINSTANCEROMIDXOFRMGDESTROM}, range raw 0..255}
                FmFifoInstanceRomPartitionIdxOfRmGDestRom: resulting-properties={base-type=uint8, sw-calibration-access=READ-ONLY, compu {255=PDUR_NO_FMFIFOINSTANCEROMPARTITIONIDXOFRMGDESTROM}, range raw 0..255}
                LockRomIdxOfRmGDestRom: resulting-properties={base-type=uint8, sw-calibration-access=READ-ONLY, range raw 0..255}
                MmRomIdxOfRmGDestRom: resulting-properties={base-type=uint8, sw-calibration-access=READ-ONLY, range raw 0..255}
                RmDestRomIdxOfRmGDestRom: resulting-properties={base-type=uint8, sw-calibration-access=READ-ONLY, range raw 0..255}
                RmGDestTpTxStateRamIdxOfRmGDestRom: resulting-properties={base-type=uint8, sw-calibration-access=READ-ONLY, compu {255=PDUR_NO_RMGDESTTPTXSTATERAMIDXOFRMGDESTROM}, range raw 0..255}
                RmGDestTpTxStateRamPartitionIdxOfRmGDestRom: resulting-properties={base-type=uint8, sw-calibration-access=READ-ONLY, compu {255=PDUR_NO_RMGDESTTPTXSTATERAMPARTITIONIDXOFRMGDESTROM}, range raw 0..255}
            Element_85: symbol=[85]
              10 x mc data instance, all with category=VALUE:
                MaxPduLengthOfRmGDestRom: resulting-properties={base-type=uint16, sw-calibration-access=READ-ONLY, range raw 0..65535}
                DestHndOfRmGDestRom: resulting-properties={base-type=uint8, sw-calibration-access=READ-ONLY, compu {255=PDUR_NO_DESTHNDOFRMGDESTROM}, range raw 0..255}
                DirectionOfRmGDestRom: resulting-properties={base-type=uint8, sw-calibration-access=READ-ONLY, compu {0=PDUR_RX_DIRECTIONOFRMGDESTROM, 1=PDUR_TX_DIRECTIONOFRMGDESTROM}, range raw 0..255}
                FmFifoInstanceRomIdxOfRmGDestRom: resulting-properties={base-type=uint8, sw-calibration-access=READ-ONLY, compu {255=PDUR_NO_FMFIFOINSTANCEROMIDXOFRMGDESTROM}, range raw 0..255}
                FmFifoInstanceRomPartitionIdxOfRmGDestRom: resulting-properties={base-type=uint8, sw-calibration-access=READ-ONLY, compu {255=PDUR_NO_FMFIFOINSTANCEROMPARTITIONIDXOFRMGDESTROM}, range raw 0..255}
                LockRomIdxOfRmGDestRom: resulting-properties={base-type=uint8, sw-calibration-access=READ-ONLY, range raw 0..255}
                MmRomIdxOfRmGDestRom: resulting-properties={base-type=uint8, sw-calibration-access=READ-ONLY, range raw 0..255}
                RmDestRomIdxOfRmGDestRom: resulting-properties={base-type=uint8, sw-calibration-access=READ-ONLY, range raw 0..255}
                RmGDestTpTxStateRamIdxOfRmGDestRom: resulting-properties={base-type=uint8, sw-calibration-access=READ-ONLY, compu {255=PDUR_NO_RMGDESTTPTXSTATERAMIDXOFRMGDESTROM}, range raw 0..255}
                RmGDestTpTxStateRamPartitionIdxOfRmGDestRom: resulting-properties={base-type=uint8, sw-calibration-access=READ-ONLY, compu {255=PDUR_NO_RMGDESTTPTXSTATERAMPARTITIONIDXOFRMGDESTROM}, range raw 0..255}
            Element_86: symbol=[86]
              10 x mc data instance, all with category=VALUE:
                MaxPduLengthOfRmGDestRom: resulting-properties={base-type=uint16, sw-calibration-access=READ-ONLY, range raw 0..65535}
                DestHndOfRmGDestRom: resulting-properties={base-type=uint8, sw-calibration-access=READ-ONLY, compu {255=PDUR_NO_DESTHNDOFRMGDESTROM}, range raw 0..255}
                DirectionOfRmGDestRom: resulting-properties={base-type=uint8, sw-calibration-access=READ-ONLY, compu {0=PDUR_RX_DIRECTIONOFRMGDESTROM, 1=PDUR_TX_DIRECTIONOFRMGDESTROM}, range raw 0..255}
                FmFifoInstanceRomIdxOfRmGDestRom: resulting-properties={base-type=uint8, sw-calibration-access=READ-ONLY, compu {255=PDUR_NO_FMFIFOINSTANCEROMIDXOFRMGDESTROM}, range raw 0..255}
                FmFifoInstanceRomPartitionIdxOfRmGDestRom: resulting-properties={base-type=uint8, sw-calibration-access=READ-ONLY, compu {255=PDUR_NO_FMFIFOINSTANCEROMPARTITIONIDXOFRMGDESTROM}, range raw 0..255}
                LockRomIdxOfRmGDestRom: resulting-properties={base-type=uint8, sw-calibration-access=READ-ONLY, range raw 0..255}
                MmRomIdxOfRmGDestRom: resulting-properties={base-type=uint8, sw-calibration-access=READ-ONLY, range raw 0..255}
                RmDestRomIdxOfRmGDestRom: resulting-properties={base-type=uint8, sw-calibration-access=READ-ONLY, range raw 0..255}
                RmGDestTpTxStateRamIdxOfRmGDestRom: resulting-properties={base-type=uint8, sw-calibration-access=READ-ONLY, compu {255=PDUR_NO_RMGDESTTPTXSTATERAMIDXOFRMGDESTROM}, range raw 0..255}
                RmGDestTpTxStateRamPartitionIdxOfRmGDestRom: resulting-properties={base-type=uint8, sw-calibration-access=READ-ONLY, compu {255=PDUR_NO_RMGDESTTPTXSTATERAMPARTITIONIDXOFRMGDESTROM}, range raw 0..255}
            Element_87: symbol=[87]
              10 x mc data instance, all with category=VALUE:
                MaxPduLengthOfRmGDestRom: resulting-properties={base-type=uint16, sw-calibration-access=READ-ONLY, range raw 0..65535}
                DestHndOfRmGDestRom: resulting-properties={base-type=uint8, sw-calibration-access=READ-ONLY, compu {255=PDUR_NO_DESTHNDOFRMGDESTROM}, range raw 0..255}
                DirectionOfRmGDestRom: resulting-properties={base-type=uint8, sw-calibration-access=READ-ONLY, compu {0=PDUR_RX_DIRECTIONOFRMGDESTROM, 1=PDUR_TX_DIRECTIONOFRMGDESTROM}, range raw 0..255}
                FmFifoInstanceRomIdxOfRmGDestRom: resulting-properties={base-type=uint8, sw-calibration-access=READ-ONLY, compu {255=PDUR_NO_FMFIFOINSTANCEROMIDXOFRMGDESTROM}, range raw 0..255}
                FmFifoInstanceRomPartitionIdxOfRmGDestRom: resulting-properties={base-type=uint8, sw-calibration-access=READ-ONLY, compu {255=PDUR_NO_FMFIFOINSTANCEROMPARTITIONIDXOFRMGDESTROM}, range raw 0..255}
                LockRomIdxOfRmGDestRom: resulting-properties={base-type=uint8, sw-calibration-access=READ-ONLY, range raw 0..255}
                MmRomIdxOfRmGDestRom: resulting-properties={base-type=uint8, sw-calibration-access=READ-ONLY, range raw 0..255}
                RmDestRomIdxOfRmGDestRom: resulting-properties={base-type=uint8, sw-calibration-access=READ-ONLY, range raw 0..255}
                RmGDestTpTxStateRamIdxOfRmGDestRom: resulting-properties={base-type=uint8, sw-calibration-access=READ-ONLY, compu {255=PDUR_NO_RMGDESTTPTXSTATERAMIDXOFRMGDESTROM}, range raw 0..255}
                RmGDestTpTxStateRamPartitionIdxOfRmGDestRom: resulting-properties={base-type=uint8, sw-calibration-access=READ-ONLY, compu {255=PDUR_NO_RMGDESTTPTXSTATERAMPARTITIONIDXOFRMGDESTROM}, range raw 0..255}
            Element_88: symbol=[88]
              10 x mc data instance, all with category=VALUE:
                MaxPduLengthOfRmGDestRom: resulting-properties={base-type=uint16, sw-calibration-access=READ-ONLY, range raw 0..65535}
                DestHndOfRmGDestRom: resulting-properties={base-type=uint8, sw-calibration-access=READ-ONLY, compu {255=PDUR_NO_DESTHNDOFRMGDESTROM}, range raw 0..255}
                DirectionOfRmGDestRom: resulting-properties={base-type=uint8, sw-calibration-access=READ-ONLY, compu {0=PDUR_RX_DIRECTIONOFRMGDESTROM, 1=PDUR_TX_DIRECTIONOFRMGDESTROM}, range raw 0..255}
                FmFifoInstanceRomIdxOfRmGDestRom: resulting-properties={base-type=uint8, sw-calibration-access=READ-ONLY, compu {255=PDUR_NO_FMFIFOINSTANCEROMIDXOFRMGDESTROM}, range raw 0..255}
                FmFifoInstanceRomPartitionIdxOfRmGDestRom: resulting-properties={base-type=uint8, sw-calibration-access=READ-ONLY, compu {255=PDUR_NO_FMFIFOINSTANCEROMPARTITIONIDXOFRMGDESTROM}, range raw 0..255}
                LockRomIdxOfRmGDestRom: resulting-properties={base-type=uint8, sw-calibration-access=READ-ONLY, range raw 0..255}
                MmRomIdxOfRmGDestRom: resulting-properties={base-type=uint8, sw-calibration-access=READ-ONLY, range raw 0..255}
                RmDestRomIdxOfRmGDestRom: resulting-properties={base-type=uint8, sw-calibration-access=READ-ONLY, range raw 0..255}
                RmGDestTpTxStateRamIdxOfRmGDestRom: resulting-properties={base-type=uint8, sw-calibration-access=READ-ONLY, compu {255=PDUR_NO_RMGDESTTPTXSTATERAMIDXOFRMGDESTROM}, range raw 0..255}
                RmGDestTpTxStateRamPartitionIdxOfRmGDestRom: resulting-properties={base-type=uint8, sw-calibration-access=READ-ONLY, compu {255=PDUR_NO_RMGDESTTPTXSTATERAMPARTITIONIDXOFRMGDESTROM}, range raw 0..255}
            Element_89: symbol=[89]
              10 x mc data instance, all with category=VALUE:
                MaxPduLengthOfRmGDestRom: resulting-properties={base-type=uint16, sw-calibration-access=READ-ONLY, range raw 0..65535}
                DestHndOfRmGDestRom: resulting-properties={base-type=uint8, sw-calibration-access=READ-ONLY, compu {255=PDUR_NO_DESTHNDOFRMGDESTROM}, range raw 0..255}
                DirectionOfRmGDestRom: resulting-properties={base-type=uint8, sw-calibration-access=READ-ONLY, compu {0=PDUR_RX_DIRECTIONOFRMGDESTROM, 1=PDUR_TX_DIRECTIONOFRMGDESTROM}, range raw 0..255}
                FmFifoInstanceRomIdxOfRmGDestRom: resulting-properties={base-type=uint8, sw-calibration-access=READ-ONLY, compu {255=PDUR_NO_FMFIFOINSTANCEROMIDXOFRMGDESTROM}, range raw 0..255}
                FmFifoInstanceRomPartitionIdxOfRmGDestRom: resulting-properties={base-type=uint8, sw-calibration-access=READ-ONLY, compu {255=PDUR_NO_FMFIFOINSTANCEROMPARTITIONIDXOFRMGDESTROM}, range raw 0..255}
                LockRomIdxOfRmGDestRom: resulting-properties={base-type=uint8, sw-calibration-access=READ-ONLY, range raw 0..255}
                MmRomIdxOfRmGDestRom: resulting-properties={base-type=uint8, sw-calibration-access=READ-ONLY, range raw 0..255}
                RmDestRomIdxOfRmGDestRom: resulting-properties={base-type=uint8, sw-calibration-access=READ-ONLY, range raw 0..255}
                RmGDestTpTxStateRamIdxOfRmGDestRom: resulting-properties={base-type=uint8, sw-calibration-access=READ-ONLY, compu {255=PDUR_NO_RMGDESTTPTXSTATERAMIDXOFRMGDESTROM}, range raw 0..255}
                RmGDestTpTxStateRamPartitionIdxOfRmGDestRom: resulting-properties={base-type=uint8, sw-calibration-access=READ-ONLY, compu {255=PDUR_NO_RMGDESTTPTXSTATERAMPARTITIONIDXOFRMGDESTROM}, range raw 0..255}
            Element_90: symbol=[90]
              10 x mc data instance, all with category=VALUE:
                MaxPduLengthOfRmGDestRom: resulting-properties={base-type=uint16, sw-calibration-access=READ-ONLY, range raw 0..65535}
                DestHndOfRmGDestRom: resulting-properties={base-type=uint8, sw-calibration-access=READ-ONLY, compu {255=PDUR_NO_DESTHNDOFRMGDESTROM}, range raw 0..255}
                DirectionOfRmGDestRom: resulting-properties={base-type=uint8, sw-calibration-access=READ-ONLY, compu {0=PDUR_RX_DIRECTIONOFRMGDESTROM, 1=PDUR_TX_DIRECTIONOFRMGDESTROM}, range raw 0..255}
                FmFifoInstanceRomIdxOfRmGDestRom: resulting-properties={base-type=uint8, sw-calibration-access=READ-ONLY, compu {255=PDUR_NO_FMFIFOINSTANCEROMIDXOFRMGDESTROM}, range raw 0..255}
                FmFifoInstanceRomPartitionIdxOfRmGDestRom: resulting-properties={base-type=uint8, sw-calibration-access=READ-ONLY, compu {255=PDUR_NO_FMFIFOINSTANCEROMPARTITIONIDXOFRMGDESTROM}, range raw 0..255}
                LockRomIdxOfRmGDestRom: resulting-properties={base-type=uint8, sw-calibration-access=READ-ONLY, range raw 0..255}
                MmRomIdxOfRmGDestRom: resulting-properties={base-type=uint8, sw-calibration-access=READ-ONLY, range raw 0..255}
                RmDestRomIdxOfRmGDestRom: resulting-properties={base-type=uint8, sw-calibration-access=READ-ONLY, range raw 0..255}
                RmGDestTpTxStateRamIdxOfRmGDestRom: resulting-properties={base-type=uint8, sw-calibration-access=READ-ONLY, compu {255=PDUR_NO_RMGDESTTPTXSTATERAMIDXOFRMGDESTROM}, range raw 0..255}
                RmGDestTpTxStateRamPartitionIdxOfRmGDestRom: resulting-properties={base-type=uint8, sw-calibration-access=READ-ONLY, compu {255=PDUR_NO_RMGDESTTPTXSTATERAMPARTITIONIDXOFRMGDESTROM}, range raw 0..255}
            Element_91: symbol=[91]
              10 x mc data instance, all with category=VALUE:
                MaxPduLengthOfRmGDestRom: resulting-properties={base-type=uint16, sw-calibration-access=READ-ONLY, range raw 0..65535}
                DestHndOfRmGDestRom: resulting-properties={base-type=uint8, sw-calibration-access=READ-ONLY, compu {255=PDUR_NO_DESTHNDOFRMGDESTROM}, range raw 0..255}
                DirectionOfRmGDestRom: resulting-properties={base-type=uint8, sw-calibration-access=READ-ONLY, compu {0=PDUR_RX_DIRECTIONOFRMGDESTROM, 1=PDUR_TX_DIRECTIONOFRMGDESTROM}, range raw 0..255}
                FmFifoInstanceRomIdxOfRmGDestRom: resulting-properties={base-type=uint8, sw-calibration-access=READ-ONLY, compu {255=PDUR_NO_FMFIFOINSTANCEROMIDXOFRMGDESTROM}, range raw 0..255}
                FmFifoInstanceRomPartitionIdxOfRmGDestRom: resulting-properties={base-type=uint8, sw-calibration-access=READ-ONLY, compu {255=PDUR_NO_FMFIFOINSTANCEROMPARTITIONIDXOFRMGDESTROM}, range raw 0..255}
                LockRomIdxOfRmGDestRom: resulting-properties={base-type=uint8, sw-calibration-access=READ-ONLY, range raw 0..255}
                MmRomIdxOfRmGDestRom: resulting-properties={base-type=uint8, sw-calibration-access=READ-ONLY, range raw 0..255}
                RmDestRomIdxOfRmGDestRom: resulting-properties={base-type=uint8, sw-calibration-access=READ-ONLY, range raw 0..255}
                RmGDestTpTxStateRamIdxOfRmGDestRom: resulting-properties={base-type=uint8, sw-calibration-access=READ-ONLY, compu {255=PDUR_NO_RMGDESTTPTXSTATERAMIDXOFRMGDESTROM}, range raw 0..255}
                RmGDestTpTxStateRamPartitionIdxOfRmGDestRom: resulting-properties={base-type=uint8, sw-calibration-access=READ-ONLY, compu {255=PDUR_NO_RMGDESTTPTXSTATERAMPARTITIONIDXOFRMGDESTROM}, range raw 0..255}
            Element_92: symbol=[92]
              10 x mc data instance, all with category=VALUE:
                MaxPduLengthOfRmGDestRom: resulting-properties={base-type=uint16, sw-calibration-access=READ-ONLY, range raw 0..65535}
                DestHndOfRmGDestRom: resulting-properties={base-type=uint8, sw-calibration-access=READ-ONLY, compu {255=PDUR_NO_DESTHNDOFRMGDESTROM}, range raw 0..255}
                DirectionOfRmGDestRom: resulting-properties={base-type=uint8, sw-calibration-access=READ-ONLY, compu {0=PDUR_RX_DIRECTIONOFRMGDESTROM, 1=PDUR_TX_DIRECTIONOFRMGDESTROM}, range raw 0..255}
                FmFifoInstanceRomIdxOfRmGDestRom: resulting-properties={base-type=uint8, sw-calibration-access=READ-ONLY, compu {255=PDUR_NO_FMFIFOINSTANCEROMIDXOFRMGDESTROM}, range raw 0..255}
                FmFifoInstanceRomPartitionIdxOfRmGDestRom: resulting-properties={base-type=uint8, sw-calibration-access=READ-ONLY, compu {255=PDUR_NO_FMFIFOINSTANCEROMPARTITIONIDXOFRMGDESTROM}, range raw 0..255}
                LockRomIdxOfRmGDestRom: resulting-properties={base-type=uint8, sw-calibration-access=READ-ONLY, range raw 0..255}
                MmRomIdxOfRmGDestRom: resulting-properties={base-type=uint8, sw-calibration-access=READ-ONLY, range raw 0..255}
                RmDestRomIdxOfRmGDestRom: resulting-properties={base-type=uint8, sw-calibration-access=READ-ONLY, range raw 0..255}
                RmGDestTpTxStateRamIdxOfRmGDestRom: resulting-properties={base-type=uint8, sw-calibration-access=READ-ONLY, compu {255=PDUR_NO_RMGDESTTPTXSTATERAMIDXOFRMGDESTROM}, range raw 0..255}
                RmGDestTpTxStateRamPartitionIdxOfRmGDestRom: resulting-properties={base-type=uint8, sw-calibration-access=READ-ONLY, compu {255=PDUR_NO_RMGDESTTPTXSTATERAMPARTITIONIDXOFRMGDESTROM}, range raw 0..255}
            Element_93: symbol=[93]
              10 x mc data instance, all with category=VALUE:
                MaxPduLengthOfRmGDestRom: resulting-properties={base-type=uint16, sw-calibration-access=READ-ONLY, range raw 0..65535}
                DestHndOfRmGDestRom: resulting-properties={base-type=uint8, sw-calibration-access=READ-ONLY, compu {255=PDUR_NO_DESTHNDOFRMGDESTROM}, range raw 0..255}
                DirectionOfRmGDestRom: resulting-properties={base-type=uint8, sw-calibration-access=READ-ONLY, compu {0=PDUR_RX_DIRECTIONOFRMGDESTROM, 1=PDUR_TX_DIRECTIONOFRMGDESTROM}, range raw 0..255}
                FmFifoInstanceRomIdxOfRmGDestRom: resulting-properties={base-type=uint8, sw-calibration-access=READ-ONLY, compu {255=PDUR_NO_FMFIFOINSTANCEROMIDXOFRMGDESTROM}, range raw 0..255}
                FmFifoInstanceRomPartitionIdxOfRmGDestRom: resulting-properties={base-type=uint8, sw-calibration-access=READ-ONLY, compu {255=PDUR_NO_FMFIFOINSTANCEROMPARTITIONIDXOFRMGDESTROM}, range raw 0..255}
                LockRomIdxOfRmGDestRom: resulting-properties={base-type=uint8, sw-calibration-access=READ-ONLY, range raw 0..255}
                MmRomIdxOfRmGDestRom: resulting-properties={base-type=uint8, sw-calibration-access=READ-ONLY, range raw 0..255}
                RmDestRomIdxOfRmGDestRom: resulting-properties={base-type=uint8, sw-calibration-access=READ-ONLY, range raw 0..255}
                RmGDestTpTxStateRamIdxOfRmGDestRom: resulting-properties={base-type=uint8, sw-calibration-access=READ-ONLY, compu {255=PDUR_NO_RMGDESTTPTXSTATERAMIDXOFRMGDESTROM}, range raw 0..255}
                RmGDestTpTxStateRamPartitionIdxOfRmGDestRom: resulting-properties={base-type=uint8, sw-calibration-access=READ-ONLY, compu {255=PDUR_NO_RMGDESTTPTXSTATERAMPARTITIONIDXOFRMGDESTROM}, range raw 0..255}
            Element_94: symbol=[94]
              10 x mc data instance, all with category=VALUE:
                MaxPduLengthOfRmGDestRom: resulting-properties={base-type=uint16, sw-calibration-access=READ-ONLY, range raw 0..65535}
                DestHndOfRmGDestRom: resulting-properties={base-type=uint8, sw-calibration-access=READ-ONLY, compu {255=PDUR_NO_DESTHNDOFRMGDESTROM}, range raw 0..255}
                DirectionOfRmGDestRom: resulting-properties={base-type=uint8, sw-calibration-access=READ-ONLY, compu {0=PDUR_RX_DIRECTIONOFRMGDESTROM, 1=PDUR_TX_DIRECTIONOFRMGDESTROM}, range raw 0..255}
                FmFifoInstanceRomIdxOfRmGDestRom: resulting-properties={base-type=uint8, sw-calibration-access=READ-ONLY, compu {255=PDUR_NO_FMFIFOINSTANCEROMIDXOFRMGDESTROM}, range raw 0..255}
                FmFifoInstanceRomPartitionIdxOfRmGDestRom: resulting-properties={base-type=uint8, sw-calibration-access=READ-ONLY, compu {255=PDUR_NO_FMFIFOINSTANCEROMPARTITIONIDXOFRMGDESTROM}, range raw 0..255}
                LockRomIdxOfRmGDestRom: resulting-properties={base-type=uint8, sw-calibration-access=READ-ONLY, range raw 0..255}
                MmRomIdxOfRmGDestRom: resulting-properties={base-type=uint8, sw-calibration-access=READ-ONLY, range raw 0..255}
                RmDestRomIdxOfRmGDestRom: resulting-properties={base-type=uint8, sw-calibration-access=READ-ONLY, range raw 0..255}
                RmGDestTpTxStateRamIdxOfRmGDestRom: resulting-properties={base-type=uint8, sw-calibration-access=READ-ONLY, compu {255=PDUR_NO_RMGDESTTPTXSTATERAMIDXOFRMGDESTROM}, range raw 0..255}
                RmGDestTpTxStateRamPartitionIdxOfRmGDestRom: resulting-properties={base-type=uint8, sw-calibration-access=READ-ONLY, compu {255=PDUR_NO_RMGDESTTPTXSTATERAMPARTITIONIDXOFRMGDESTROM}, range raw 0..255}
            Element_95: symbol=[95]
              10 x mc data instance, all with category=VALUE:
                MaxPduLengthOfRmGDestRom: resulting-properties={base-type=uint16, sw-calibration-access=READ-ONLY, range raw 0..65535}
                DestHndOfRmGDestRom: resulting-properties={base-type=uint8, sw-calibration-access=READ-ONLY, compu {255=PDUR_NO_DESTHNDOFRMGDESTROM}, range raw 0..255}
                DirectionOfRmGDestRom: resulting-properties={base-type=uint8, sw-calibration-access=READ-ONLY, compu {0=PDUR_RX_DIRECTIONOFRMGDESTROM, 1=PDUR_TX_DIRECTIONOFRMGDESTROM}, range raw 0..255}
                FmFifoInstanceRomIdxOfRmGDestRom: resulting-properties={base-type=uint8, sw-calibration-access=READ-ONLY, compu {255=PDUR_NO_FMFIFOINSTANCEROMIDXOFRMGDESTROM}, range raw 0..255}
                FmFifoInstanceRomPartitionIdxOfRmGDestRom: resulting-properties={base-type=uint8, sw-calibration-access=READ-ONLY, compu {255=PDUR_NO_FMFIFOINSTANCEROMPARTITIONIDXOFRMGDESTROM}, range raw 0..255}
                LockRomIdxOfRmGDestRom: resulting-properties={base-type=uint8, sw-calibration-access=READ-ONLY, range raw 0..255}
                MmRomIdxOfRmGDestRom: resulting-properties={base-type=uint8, sw-calibration-access=READ-ONLY, range raw 0..255}
                RmDestRomIdxOfRmGDestRom: resulting-properties={base-type=uint8, sw-calibration-access=READ-ONLY, range raw 0..255}
                RmGDestTpTxStateRamIdxOfRmGDestRom: resulting-properties={base-type=uint8, sw-calibration-access=READ-ONLY, compu {255=PDUR_NO_RMGDESTTPTXSTATERAMIDXOFRMGDESTROM}, range raw 0..255}
                RmGDestTpTxStateRamPartitionIdxOfRmGDestRom: resulting-properties={base-type=uint8, sw-calibration-access=READ-ONLY, compu {255=PDUR_NO_RMGDESTTPTXSTATERAMPARTITIONIDXOFRMGDESTROM}, range raw 0..255}
            Element_96: symbol=[96]
              10 x mc data instance, all with category=VALUE:
                MaxPduLengthOfRmGDestRom: resulting-properties={base-type=uint16, sw-calibration-access=READ-ONLY, range raw 0..65535}
                DestHndOfRmGDestRom: resulting-properties={base-type=uint8, sw-calibration-access=READ-ONLY, compu {255=PDUR_NO_DESTHNDOFRMGDESTROM}, range raw 0..255}
                DirectionOfRmGDestRom: resulting-properties={base-type=uint8, sw-calibration-access=READ-ONLY, compu {0=PDUR_RX_DIRECTIONOFRMGDESTROM, 1=PDUR_TX_DIRECTIONOFRMGDESTROM}, range raw 0..255}
                FmFifoInstanceRomIdxOfRmGDestRom: resulting-properties={base-type=uint8, sw-calibration-access=READ-ONLY, compu {255=PDUR_NO_FMFIFOINSTANCEROMIDXOFRMGDESTROM}, range raw 0..255}
                FmFifoInstanceRomPartitionIdxOfRmGDestRom: resulting-properties={base-type=uint8, sw-calibration-access=READ-ONLY, compu {255=PDUR_NO_FMFIFOINSTANCEROMPARTITIONIDXOFRMGDESTROM}, range raw 0..255}
                LockRomIdxOfRmGDestRom: resulting-properties={base-type=uint8, sw-calibration-access=READ-ONLY, range raw 0..255}
                MmRomIdxOfRmGDestRom: resulting-properties={base-type=uint8, sw-calibration-access=READ-ONLY, range raw 0..255}
                RmDestRomIdxOfRmGDestRom: resulting-properties={base-type=uint8, sw-calibration-access=READ-ONLY, range raw 0..255}
                RmGDestTpTxStateRamIdxOfRmGDestRom: resulting-properties={base-type=uint8, sw-calibration-access=READ-ONLY, compu {255=PDUR_NO_RMGDESTTPTXSTATERAMIDXOFRMGDESTROM}, range raw 0..255}
                RmGDestTpTxStateRamPartitionIdxOfRmGDestRom: resulting-properties={base-type=uint8, sw-calibration-access=READ-ONLY, compu {255=PDUR_NO_RMGDESTTPTXSTATERAMPARTITIONIDXOFRMGDESTROM}, range raw 0..255}
            Element_97: symbol=[97]
              10 x mc data instance, all with category=VALUE:
                MaxPduLengthOfRmGDestRom: resulting-properties={base-type=uint16, sw-calibration-access=READ-ONLY, range raw 0..65535}
                DestHndOfRmGDestRom: resulting-properties={base-type=uint8, sw-calibration-access=READ-ONLY, compu {255=PDUR_NO_DESTHNDOFRMGDESTROM}, range raw 0..255}
                DirectionOfRmGDestRom: resulting-properties={base-type=uint8, sw-calibration-access=READ-ONLY, compu {0=PDUR_RX_DIRECTIONOFRMGDESTROM, 1=PDUR_TX_DIRECTIONOFRMGDESTROM}, range raw 0..255}
                FmFifoInstanceRomIdxOfRmGDestRom: resulting-properties={base-type=uint8, sw-calibration-access=READ-ONLY, compu {255=PDUR_NO_FMFIFOINSTANCEROMIDXOFRMGDESTROM}, range raw 0..255}
                FmFifoInstanceRomPartitionIdxOfRmGDestRom: resulting-properties={base-type=uint8, sw-calibration-access=READ-ONLY, compu {255=PDUR_NO_FMFIFOINSTANCEROMPARTITIONIDXOFRMGDESTROM}, range raw 0..255}
                LockRomIdxOfRmGDestRom: resulting-properties={base-type=uint8, sw-calibration-access=READ-ONLY, range raw 0..255}
                MmRomIdxOfRmGDestRom: resulting-properties={base-type=uint8, sw-calibration-access=READ-ONLY, range raw 0..255}
                RmDestRomIdxOfRmGDestRom: resulting-properties={base-type=uint8, sw-calibration-access=READ-ONLY, range raw 0..255}
                RmGDestTpTxStateRamIdxOfRmGDestRom: resulting-properties={base-type=uint8, sw-calibration-access=READ-ONLY, compu {255=PDUR_NO_RMGDESTTPTXSTATERAMIDXOFRMGDESTROM}, range raw 0..255}
                RmGDestTpTxStateRamPartitionIdxOfRmGDestRom: resulting-properties={base-type=uint8, sw-calibration-access=READ-ONLY, compu {255=PDUR_NO_RMGDESTTPTXSTATERAMPARTITIONIDXOFRMGDESTROM}, range raw 0..255}
            Element_98: symbol=[98]
              10 x mc data instance, all with category=VALUE:
                MaxPduLengthOfRmGDestRom: resulting-properties={base-type=uint16, sw-calibration-access=READ-ONLY, range raw 0..65535}
                DestHndOfRmGDestRom: resulting-properties={base-type=uint8, sw-calibration-access=READ-ONLY, compu {255=PDUR_NO_DESTHNDOFRMGDESTROM}, range raw 0..255}
                DirectionOfRmGDestRom: resulting-properties={base-type=uint8, sw-calibration-access=READ-ONLY, compu {0=PDUR_RX_DIRECTIONOFRMGDESTROM, 1=PDUR_TX_DIRECTIONOFRMGDESTROM}, range raw 0..255}
                FmFifoInstanceRomIdxOfRmGDestRom: resulting-properties={base-type=uint8, sw-calibration-access=READ-ONLY, compu {255=PDUR_NO_FMFIFOINSTANCEROMIDXOFRMGDESTROM}, range raw 0..255}
                FmFifoInstanceRomPartitionIdxOfRmGDestRom: resulting-properties={base-type=uint8, sw-calibration-access=READ-ONLY, compu {255=PDUR_NO_FMFIFOINSTANCEROMPARTITIONIDXOFRMGDESTROM}, range raw 0..255}
                LockRomIdxOfRmGDestRom: resulting-properties={base-type=uint8, sw-calibration-access=READ-ONLY, range raw 0..255}
                MmRomIdxOfRmGDestRom: resulting-properties={base-type=uint8, sw-calibration-access=READ-ONLY, range raw 0..255}
                RmDestRomIdxOfRmGDestRom: resulting-properties={base-type=uint8, sw-calibration-access=READ-ONLY, range raw 0..255}
                RmGDestTpTxStateRamIdxOfRmGDestRom: resulting-properties={base-type=uint8, sw-calibration-access=READ-ONLY, compu {255=PDUR_NO_RMGDESTTPTXSTATERAMIDXOFRMGDESTROM}, range raw 0..255}
                RmGDestTpTxStateRamPartitionIdxOfRmGDestRom: resulting-properties={base-type=uint8, sw-calibration-access=READ-ONLY, compu {255=PDUR_NO_RMGDESTTPTXSTATERAMPARTITIONIDXOFRMGDESTROM}, range raw 0..255}
            Element_99: symbol=[99]
              10 x mc data instance, all with category=VALUE:
                MaxPduLengthOfRmGDestRom: resulting-properties={base-type=uint16, sw-calibration-access=READ-ONLY, range raw 0..65535}
                DestHndOfRmGDestRom: resulting-properties={base-type=uint8, sw-calibration-access=READ-ONLY, compu {255=PDUR_NO_DESTHNDOFRMGDESTROM}, range raw 0..255}
                DirectionOfRmGDestRom: resulting-properties={base-type=uint8, sw-calibration-access=READ-ONLY, compu {0=PDUR_RX_DIRECTIONOFRMGDESTROM, 1=PDUR_TX_DIRECTIONOFRMGDESTROM}, range raw 0..255}
                FmFifoInstanceRomIdxOfRmGDestRom: resulting-properties={base-type=uint8, sw-calibration-access=READ-ONLY, compu {255=PDUR_NO_FMFIFOINSTANCEROMIDXOFRMGDESTROM}, range raw 0..255}
                FmFifoInstanceRomPartitionIdxOfRmGDestRom: resulting-properties={base-type=uint8, sw-calibration-access=READ-ONLY, compu {255=PDUR_NO_FMFIFOINSTANCEROMPARTITIONIDXOFRMGDESTROM}, range raw 0..255}
                LockRomIdxOfRmGDestRom: resulting-properties={base-type=uint8, sw-calibration-access=READ-ONLY, range raw 0..255}
                MmRomIdxOfRmGDestRom: resulting-properties={base-type=uint8, sw-calibration-access=READ-ONLY, range raw 0..255}
                RmDestRomIdxOfRmGDestRom: resulting-properties={base-type=uint8, sw-calibration-access=READ-ONLY, range raw 0..255}
                RmGDestTpTxStateRamIdxOfRmGDestRom: resulting-properties={base-type=uint8, sw-calibration-access=READ-ONLY, compu {255=PDUR_NO_RMGDESTTPTXSTATERAMIDXOFRMGDESTROM}, range raw 0..255}
                RmGDestTpTxStateRamPartitionIdxOfRmGDestRom: resulting-properties={base-type=uint8, sw-calibration-access=READ-ONLY, compu {255=PDUR_NO_RMGDESTTPTXSTATERAMPARTITIONIDXOFRMGDESTROM}, range raw 0..255}
            Element_100: symbol=[100]
              10 x mc data instance, all with category=VALUE:
                MaxPduLengthOfRmGDestRom: resulting-properties={base-type=uint16, sw-calibration-access=READ-ONLY, range raw 0..65535}
                DestHndOfRmGDestRom: resulting-properties={base-type=uint8, sw-calibration-access=READ-ONLY, compu {255=PDUR_NO_DESTHNDOFRMGDESTROM}, range raw 0..255}
                DirectionOfRmGDestRom: resulting-properties={base-type=uint8, sw-calibration-access=READ-ONLY, compu {0=PDUR_RX_DIRECTIONOFRMGDESTROM, 1=PDUR_TX_DIRECTIONOFRMGDESTROM}, range raw 0..255}
                FmFifoInstanceRomIdxOfRmGDestRom: resulting-properties={base-type=uint8, sw-calibration-access=READ-ONLY, compu {255=PDUR_NO_FMFIFOINSTANCEROMIDXOFRMGDESTROM}, range raw 0..255}
                FmFifoInstanceRomPartitionIdxOfRmGDestRom: resulting-properties={base-type=uint8, sw-calibration-access=READ-ONLY, compu {255=PDUR_NO_FMFIFOINSTANCEROMPARTITIONIDXOFRMGDESTROM}, range raw 0..255}
                LockRomIdxOfRmGDestRom: resulting-properties={base-type=uint8, sw-calibration-access=READ-ONLY, range raw 0..255}
                MmRomIdxOfRmGDestRom: resulting-properties={base-type=uint8, sw-calibration-access=READ-ONLY, range raw 0..255}
                RmDestRomIdxOfRmGDestRom: resulting-properties={base-type=uint8, sw-calibration-access=READ-ONLY, range raw 0..255}
                RmGDestTpTxStateRamIdxOfRmGDestRom: resulting-properties={base-type=uint8, sw-calibration-access=READ-ONLY, compu {255=PDUR_NO_RMGDESTTPTXSTATERAMIDXOFRMGDESTROM}, range raw 0..255}
                RmGDestTpTxStateRamPartitionIdxOfRmGDestRom: resulting-properties={base-type=uint8, sw-calibration-access=READ-ONLY, compu {255=PDUR_NO_RMGDESTTPTXSTATERAMPARTITIONIDXOFRMGDESTROM}, range raw 0..255}
            Element_101: symbol=[101]
              10 x mc data instance, all with category=VALUE:
                MaxPduLengthOfRmGDestRom: resulting-properties={base-type=uint16, sw-calibration-access=READ-ONLY, range raw 0..65535}
                DestHndOfRmGDestRom: resulting-properties={base-type=uint8, sw-calibration-access=READ-ONLY, compu {255=PDUR_NO_DESTHNDOFRMGDESTROM}, range raw 0..255}
                DirectionOfRmGDestRom: resulting-properties={base-type=uint8, sw-calibration-access=READ-ONLY, compu {0=PDUR_RX_DIRECTIONOFRMGDESTROM, 1=PDUR_TX_DIRECTIONOFRMGDESTROM}, range raw 0..255}
                FmFifoInstanceRomIdxOfRmGDestRom: resulting-properties={base-type=uint8, sw-calibration-access=READ-ONLY, compu {255=PDUR_NO_FMFIFOINSTANCEROMIDXOFRMGDESTROM}, range raw 0..255}
                FmFifoInstanceRomPartitionIdxOfRmGDestRom: resulting-properties={base-type=uint8, sw-calibration-access=READ-ONLY, compu {255=PDUR_NO_FMFIFOINSTANCEROMPARTITIONIDXOFRMGDESTROM}, range raw 0..255}
                LockRomIdxOfRmGDestRom: resulting-properties={base-type=uint8, sw-calibration-access=READ-ONLY, range raw 0..255}
                MmRomIdxOfRmGDestRom: resulting-properties={base-type=uint8, sw-calibration-access=READ-ONLY, range raw 0..255}
                RmDestRomIdxOfRmGDestRom: resulting-properties={base-type=uint8, sw-calibration-access=READ-ONLY, range raw 0..255}
                RmGDestTpTxStateRamIdxOfRmGDestRom: resulting-properties={base-type=uint8, sw-calibration-access=READ-ONLY, compu {255=PDUR_NO_RMGDESTTPTXSTATERAMIDXOFRMGDESTROM}, range raw 0..255}
                RmGDestTpTxStateRamPartitionIdxOfRmGDestRom: resulting-properties={base-type=uint8, sw-calibration-access=READ-ONLY, compu {255=PDUR_NO_RMGDESTTPTXSTATERAMPARTITIONIDXOFRMGDESTROM}, range raw 0..255}
            Element_102: symbol=[102]
              10 x mc data instance, all with category=VALUE:
                MaxPduLengthOfRmGDestRom: resulting-properties={base-type=uint16, sw-calibration-access=READ-ONLY, range raw 0..65535}
                DestHndOfRmGDestRom: resulting-properties={base-type=uint8, sw-calibration-access=READ-ONLY, compu {255=PDUR_NO_DESTHNDOFRMGDESTROM}, range raw 0..255}
                DirectionOfRmGDestRom: resulting-properties={base-type=uint8, sw-calibration-access=READ-ONLY, compu {0=PDUR_RX_DIRECTIONOFRMGDESTROM, 1=PDUR_TX_DIRECTIONOFRMGDESTROM}, range raw 0..255}
                FmFifoInstanceRomIdxOfRmGDestRom: resulting-properties={base-type=uint8, sw-calibration-access=READ-ONLY, compu {255=PDUR_NO_FMFIFOINSTANCEROMIDXOFRMGDESTROM}, range raw 0..255}
                FmFifoInstanceRomPartitionIdxOfRmGDestRom: resulting-properties={base-type=uint8, sw-calibration-access=READ-ONLY, compu {255=PDUR_NO_FMFIFOINSTANCEROMPARTITIONIDXOFRMGDESTROM}, range raw 0..255}
                LockRomIdxOfRmGDestRom: resulting-properties={base-type=uint8, sw-calibration-access=READ-ONLY, range raw 0..255}
                MmRomIdxOfRmGDestRom: resulting-properties={base-type=uint8, sw-calibration-access=READ-ONLY, range raw 0..255}
                RmDestRomIdxOfRmGDestRom: resulting-properties={base-type=uint8, sw-calibration-access=READ-ONLY, range raw 0..255}
                RmGDestTpTxStateRamIdxOfRmGDestRom: resulting-properties={base-type=uint8, sw-calibration-access=READ-ONLY, compu {255=PDUR_NO_RMGDESTTPTXSTATERAMIDXOFRMGDESTROM}, range raw 0..255}
                RmGDestTpTxStateRamPartitionIdxOfRmGDestRom: resulting-properties={base-type=uint8, sw-calibration-access=READ-ONLY, compu {255=PDUR_NO_RMGDESTTPTXSTATERAMPARTITIONIDXOFRMGDESTROM}, range raw 0..255}
            Element_103: symbol=[103]
              10 x mc data instance, all with category=VALUE:
                MaxPduLengthOfRmGDestRom: resulting-properties={base-type=uint16, sw-calibration-access=READ-ONLY, range raw 0..65535}
                DestHndOfRmGDestRom: resulting-properties={base-type=uint8, sw-calibration-access=READ-ONLY, compu {255=PDUR_NO_DESTHNDOFRMGDESTROM}, range raw 0..255}
                DirectionOfRmGDestRom: resulting-properties={base-type=uint8, sw-calibration-access=READ-ONLY, compu {0=PDUR_RX_DIRECTIONOFRMGDESTROM, 1=PDUR_TX_DIRECTIONOFRMGDESTROM}, range raw 0..255}
                FmFifoInstanceRomIdxOfRmGDestRom: resulting-properties={base-type=uint8, sw-calibration-access=READ-ONLY, compu {255=PDUR_NO_FMFIFOINSTANCEROMIDXOFRMGDESTROM}, range raw 0..255}
                FmFifoInstanceRomPartitionIdxOfRmGDestRom: resulting-properties={base-type=uint8, sw-calibration-access=READ-ONLY, compu {255=PDUR_NO_FMFIFOINSTANCEROMPARTITIONIDXOFRMGDESTROM}, range raw 0..255}
                LockRomIdxOfRmGDestRom: resulting-properties={base-type=uint8, sw-calibration-access=READ-ONLY, range raw 0..255}
                MmRomIdxOfRmGDestRom: resulting-properties={base-type=uint8, sw-calibration-access=READ-ONLY, range raw 0..255}
                RmDestRomIdxOfRmGDestRom: resulting-properties={base-type=uint8, sw-calibration-access=READ-ONLY, range raw 0..255}
                RmGDestTpTxStateRamIdxOfRmGDestRom: resulting-properties={base-type=uint8, sw-calibration-access=READ-ONLY, compu {255=PDUR_NO_RMGDESTTPTXSTATERAMIDXOFRMGDESTROM}, range raw 0..255}
                RmGDestTpTxStateRamPartitionIdxOfRmGDestRom: resulting-properties={base-type=uint8, sw-calibration-access=READ-ONLY, compu {255=PDUR_NO_RMGDESTTPTXSTATERAMPARTITIONIDXOFRMGDESTROM}, range raw 0..255}
            Element_104: symbol=[104]
              10 x mc data instance, all with category=VALUE:
                MaxPduLengthOfRmGDestRom: resulting-properties={base-type=uint16, sw-calibration-access=READ-ONLY, range raw 0..65535}
                DestHndOfRmGDestRom: resulting-properties={base-type=uint8, sw-calibration-access=READ-ONLY, compu {255=PDUR_NO_DESTHNDOFRMGDESTROM}, range raw 0..255}
                DirectionOfRmGDestRom: resulting-properties={base-type=uint8, sw-calibration-access=READ-ONLY, compu {0=PDUR_RX_DIRECTIONOFRMGDESTROM, 1=PDUR_TX_DIRECTIONOFRMGDESTROM}, range raw 0..255}
                FmFifoInstanceRomIdxOfRmGDestRom: resulting-properties={base-type=uint8, sw-calibration-access=READ-ONLY, compu {255=PDUR_NO_FMFIFOINSTANCEROMIDXOFRMGDESTROM}, range raw 0..255}
                FmFifoInstanceRomPartitionIdxOfRmGDestRom: resulting-properties={base-type=uint8, sw-calibration-access=READ-ONLY, compu {255=PDUR_NO_FMFIFOINSTANCEROMPARTITIONIDXOFRMGDESTROM}, range raw 0..255}
                LockRomIdxOfRmGDestRom: resulting-properties={base-type=uint8, sw-calibration-access=READ-ONLY, range raw 0..255}
                MmRomIdxOfRmGDestRom: resulting-properties={base-type=uint8, sw-calibration-access=READ-ONLY, range raw 0..255}
                RmDestRomIdxOfRmGDestRom: resulting-properties={base-type=uint8, sw-calibration-access=READ-ONLY, range raw 0..255}
                RmGDestTpTxStateRamIdxOfRmGDestRom: resulting-properties={base-type=uint8, sw-calibration-access=READ-ONLY, compu {255=PDUR_NO_RMGDESTTPTXSTATERAMIDXOFRMGDESTROM}, range raw 0..255}
                RmGDestTpTxStateRamPartitionIdxOfRmGDestRom: resulting-properties={base-type=uint8, sw-calibration-access=READ-ONLY, compu {255=PDUR_NO_RMGDESTTPTXSTATERAMPARTITIONIDXOFRMGDESTROM}, range raw 0..255}
            Element_105: symbol=[105]
              10 x mc data instance, all with category=VALUE:
                MaxPduLengthOfRmGDestRom: resulting-properties={base-type=uint16, sw-calibration-access=READ-ONLY, range raw 0..65535}
                DestHndOfRmGDestRom: resulting-properties={base-type=uint8, sw-calibration-access=READ-ONLY, compu {255=PDUR_NO_DESTHNDOFRMGDESTROM}, range raw 0..255}
                DirectionOfRmGDestRom: resulting-properties={base-type=uint8, sw-calibration-access=READ-ONLY, compu {0=PDUR_RX_DIRECTIONOFRMGDESTROM, 1=PDUR_TX_DIRECTIONOFRMGDESTROM}, range raw 0..255}
                FmFifoInstanceRomIdxOfRmGDestRom: resulting-properties={base-type=uint8, sw-calibration-access=READ-ONLY, compu {255=PDUR_NO_FMFIFOINSTANCEROMIDXOFRMGDESTROM}, range raw 0..255}
                FmFifoInstanceRomPartitionIdxOfRmGDestRom: resulting-properties={base-type=uint8, sw-calibration-access=READ-ONLY, compu {255=PDUR_NO_FMFIFOINSTANCEROMPARTITIONIDXOFRMGDESTROM}, range raw 0..255}
                LockRomIdxOfRmGDestRom: resulting-properties={base-type=uint8, sw-calibration-access=READ-ONLY, range raw 0..255}
                MmRomIdxOfRmGDestRom: resulting-properties={base-type=uint8, sw-calibration-access=READ-ONLY, range raw 0..255}
                RmDestRomIdxOfRmGDestRom: resulting-properties={base-type=uint8, sw-calibration-access=READ-ONLY, range raw 0..255}
                RmGDestTpTxStateRamIdxOfRmGDestRom: resulting-properties={base-type=uint8, sw-calibration-access=READ-ONLY, compu {255=PDUR_NO_RMGDESTTPTXSTATERAMIDXOFRMGDESTROM}, range raw 0..255}
                RmGDestTpTxStateRamPartitionIdxOfRmGDestRom: resulting-properties={base-type=uint8, sw-calibration-access=READ-ONLY, compu {255=PDUR_NO_RMGDESTTPTXSTATERAMPARTITIONIDXOFRMGDESTROM}, range raw 0..255}
            Element_106: symbol=[106]
              10 x mc data instance, all with category=VALUE:
                MaxPduLengthOfRmGDestRom: resulting-properties={base-type=uint16, sw-calibration-access=READ-ONLY, range raw 0..65535}
                DestHndOfRmGDestRom: resulting-properties={base-type=uint8, sw-calibration-access=READ-ONLY, compu {255=PDUR_NO_DESTHNDOFRMGDESTROM}, range raw 0..255}
                DirectionOfRmGDestRom: resulting-properties={base-type=uint8, sw-calibration-access=READ-ONLY, compu {0=PDUR_RX_DIRECTIONOFRMGDESTROM, 1=PDUR_TX_DIRECTIONOFRMGDESTROM}, range raw 0..255}
                FmFifoInstanceRomIdxOfRmGDestRom: resulting-properties={base-type=uint8, sw-calibration-access=READ-ONLY, compu {255=PDUR_NO_FMFIFOINSTANCEROMIDXOFRMGDESTROM}, range raw 0..255}
                FmFifoInstanceRomPartitionIdxOfRmGDestRom: resulting-properties={base-type=uint8, sw-calibration-access=READ-ONLY, compu {255=PDUR_NO_FMFIFOINSTANCEROMPARTITIONIDXOFRMGDESTROM}, range raw 0..255}
                LockRomIdxOfRmGDestRom: resulting-properties={base-type=uint8, sw-calibration-access=READ-ONLY, range raw 0..255}
                MmRomIdxOfRmGDestRom: resulting-properties={base-type=uint8, sw-calibration-access=READ-ONLY, range raw 0..255}
                RmDestRomIdxOfRmGDestRom: resulting-properties={base-type=uint8, sw-calibration-access=READ-ONLY, range raw 0..255}
                RmGDestTpTxStateRamIdxOfRmGDestRom: resulting-properties={base-type=uint8, sw-calibration-access=READ-ONLY, compu {255=PDUR_NO_RMGDESTTPTXSTATERAMIDXOFRMGDESTROM}, range raw 0..255}
                RmGDestTpTxStateRamPartitionIdxOfRmGDestRom: resulting-properties={base-type=uint8, sw-calibration-access=READ-ONLY, compu {255=PDUR_NO_RMGDESTTPTXSTATERAMPARTITIONIDXOFRMGDESTROM}, range raw 0..255}
            Element_107: symbol=[107]
              10 x mc data instance, all with category=VALUE:
                MaxPduLengthOfRmGDestRom: resulting-properties={base-type=uint16, sw-calibration-access=READ-ONLY, range raw 0..65535}
                DestHndOfRmGDestRom: resulting-properties={base-type=uint8, sw-calibration-access=READ-ONLY, compu {255=PDUR_NO_DESTHNDOFRMGDESTROM}, range raw 0..255}
                DirectionOfRmGDestRom: resulting-properties={base-type=uint8, sw-calibration-access=READ-ONLY, compu {0=PDUR_RX_DIRECTIONOFRMGDESTROM, 1=PDUR_TX_DIRECTIONOFRMGDESTROM}, range raw 0..255}
                FmFifoInstanceRomIdxOfRmGDestRom: resulting-properties={base-type=uint8, sw-calibration-access=READ-ONLY, compu {255=PDUR_NO_FMFIFOINSTANCEROMIDXOFRMGDESTROM}, range raw 0..255}
                FmFifoInstanceRomPartitionIdxOfRmGDestRom: resulting-properties={base-type=uint8, sw-calibration-access=READ-ONLY, compu {255=PDUR_NO_FMFIFOINSTANCEROMPARTITIONIDXOFRMGDESTROM}, range raw 0..255}
                LockRomIdxOfRmGDestRom: resulting-properties={base-type=uint8, sw-calibration-access=READ-ONLY, range raw 0..255}
                MmRomIdxOfRmGDestRom: resulting-properties={base-type=uint8, sw-calibration-access=READ-ONLY, range raw 0..255}
                RmDestRomIdxOfRmGDestRom: resulting-properties={base-type=uint8, sw-calibration-access=READ-ONLY, range raw 0..255}
                RmGDestTpTxStateRamIdxOfRmGDestRom: resulting-properties={base-type=uint8, sw-calibration-access=READ-ONLY, compu {255=PDUR_NO_RMGDESTTPTXSTATERAMIDXOFRMGDESTROM}, range raw 0..255}
                RmGDestTpTxStateRamPartitionIdxOfRmGDestRom: resulting-properties={base-type=uint8, sw-calibration-access=READ-ONLY, compu {255=PDUR_NO_RMGDESTTPTXSTATERAMPARTITIONIDXOFRMGDESTROM}, range raw 0..255}
            Element_108: symbol=[108]
              10 x mc data instance, all with category=VALUE:
                MaxPduLengthOfRmGDestRom: resulting-properties={base-type=uint16, sw-calibration-access=READ-ONLY, range raw 0..65535}
                DestHndOfRmGDestRom: resulting-properties={base-type=uint8, sw-calibration-access=READ-ONLY, compu {255=PDUR_NO_DESTHNDOFRMGDESTROM}, range raw 0..255}
                DirectionOfRmGDestRom: resulting-properties={base-type=uint8, sw-calibration-access=READ-ONLY, compu {0=PDUR_RX_DIRECTIONOFRMGDESTROM, 1=PDUR_TX_DIRECTIONOFRMGDESTROM}, range raw 0..255}
                FmFifoInstanceRomIdxOfRmGDestRom: resulting-properties={base-type=uint8, sw-calibration-access=READ-ONLY, compu {255=PDUR_NO_FMFIFOINSTANCEROMIDXOFRMGDESTROM}, range raw 0..255}
                FmFifoInstanceRomPartitionIdxOfRmGDestRom: resulting-properties={base-type=uint8, sw-calibration-access=READ-ONLY, compu {255=PDUR_NO_FMFIFOINSTANCEROMPARTITIONIDXOFRMGDESTROM}, range raw 0..255}
                LockRomIdxOfRmGDestRom: resulting-properties={base-type=uint8, sw-calibration-access=READ-ONLY, range raw 0..255}
                MmRomIdxOfRmGDestRom: resulting-properties={base-type=uint8, sw-calibration-access=READ-ONLY, range raw 0..255}
                RmDestRomIdxOfRmGDestRom: resulting-properties={base-type=uint8, sw-calibration-access=READ-ONLY, range raw 0..255}
                RmGDestTpTxStateRamIdxOfRmGDestRom: resulting-properties={base-type=uint8, sw-calibration-access=READ-ONLY, compu {255=PDUR_NO_RMGDESTTPTXSTATERAMIDXOFRMGDESTROM}, range raw 0..255}
                RmGDestTpTxStateRamPartitionIdxOfRmGDestRom: resulting-properties={base-type=uint8, sw-calibration-access=READ-ONLY, compu {255=PDUR_NO_RMGDESTTPTXSTATERAMPARTITIONIDXOFRMGDESTROM}, range raw 0..255}
            Element_109: symbol=[109]
              10 x mc data instance, all with category=VALUE:
                MaxPduLengthOfRmGDestRom: resulting-properties={base-type=uint16, sw-calibration-access=READ-ONLY, range raw 0..65535}
                DestHndOfRmGDestRom: resulting-properties={base-type=uint8, sw-calibration-access=READ-ONLY, compu {255=PDUR_NO_DESTHNDOFRMGDESTROM}, range raw 0..255}
                DirectionOfRmGDestRom: resulting-properties={base-type=uint8, sw-calibration-access=READ-ONLY, compu {0=PDUR_RX_DIRECTIONOFRMGDESTROM, 1=PDUR_TX_DIRECTIONOFRMGDESTROM}, range raw 0..255}
                FmFifoInstanceRomIdxOfRmGDestRom: resulting-properties={base-type=uint8, sw-calibration-access=READ-ONLY, compu {255=PDUR_NO_FMFIFOINSTANCEROMIDXOFRMGDESTROM}, range raw 0..255}
                FmFifoInstanceRomPartitionIdxOfRmGDestRom: resulting-properties={base-type=uint8, sw-calibration-access=READ-ONLY, compu {255=PDUR_NO_FMFIFOINSTANCEROMPARTITIONIDXOFRMGDESTROM}, range raw 0..255}
                LockRomIdxOfRmGDestRom: resulting-properties={base-type=uint8, sw-calibration-access=READ-ONLY, range raw 0..255}
                MmRomIdxOfRmGDestRom: resulting-properties={base-type=uint8, sw-calibration-access=READ-ONLY, range raw 0..255}
                RmDestRomIdxOfRmGDestRom: resulting-properties={base-type=uint8, sw-calibration-access=READ-ONLY, range raw 0..255}
                RmGDestTpTxStateRamIdxOfRmGDestRom: resulting-properties={base-type=uint8, sw-calibration-access=READ-ONLY, compu {255=PDUR_NO_RMGDESTTPTXSTATERAMIDXOFRMGDESTROM}, range raw 0..255}
                RmGDestTpTxStateRamPartitionIdxOfRmGDestRom: resulting-properties={base-type=uint8, sw-calibration-access=READ-ONLY, compu {255=PDUR_NO_RMGDESTTPTXSTATERAMPARTITIONIDXOFRMGDESTROM}, range raw 0..255}
            Element_110: symbol=[110]
              10 x mc data instance, all with category=VALUE:
                MaxPduLengthOfRmGDestRom: resulting-properties={base-type=uint16, sw-calibration-access=READ-ONLY, range raw 0..65535}
                DestHndOfRmGDestRom: resulting-properties={base-type=uint8, sw-calibration-access=READ-ONLY, compu {255=PDUR_NO_DESTHNDOFRMGDESTROM}, range raw 0..255}
                DirectionOfRmGDestRom: resulting-properties={base-type=uint8, sw-calibration-access=READ-ONLY, compu {0=PDUR_RX_DIRECTIONOFRMGDESTROM, 1=PDUR_TX_DIRECTIONOFRMGDESTROM}, range raw 0..255}
                FmFifoInstanceRomIdxOfRmGDestRom: resulting-properties={base-type=uint8, sw-calibration-access=READ-ONLY, compu {255=PDUR_NO_FMFIFOINSTANCEROMIDXOFRMGDESTROM}, range raw 0..255}
                FmFifoInstanceRomPartitionIdxOfRmGDestRom: resulting-properties={base-type=uint8, sw-calibration-access=READ-ONLY, compu {255=PDUR_NO_FMFIFOINSTANCEROMPARTITIONIDXOFRMGDESTROM}, range raw 0..255}
                LockRomIdxOfRmGDestRom: resulting-properties={base-type=uint8, sw-calibration-access=READ-ONLY, range raw 0..255}
                MmRomIdxOfRmGDestRom: resulting-properties={base-type=uint8, sw-calibration-access=READ-ONLY, range raw 0..255}
                RmDestRomIdxOfRmGDestRom: resulting-properties={base-type=uint8, sw-calibration-access=READ-ONLY, range raw 0..255}
                RmGDestTpTxStateRamIdxOfRmGDestRom: resulting-properties={base-type=uint8, sw-calibration-access=READ-ONLY, compu {255=PDUR_NO_RMGDESTTPTXSTATERAMIDXOFRMGDESTROM}, range raw 0..255}
                RmGDestTpTxStateRamPartitionIdxOfRmGDestRom: resulting-properties={base-type=uint8, sw-calibration-access=READ-ONLY, compu {255=PDUR_NO_RMGDESTTPTXSTATERAMPARTITIONIDXOFRMGDESTROM}, range raw 0..255}
            Element_111: symbol=[111]
              10 x mc data instance, all with category=VALUE:
                MaxPduLengthOfRmGDestRom: resulting-properties={base-type=uint16, sw-calibration-access=READ-ONLY, range raw 0..65535}
                DestHndOfRmGDestRom: resulting-properties={base-type=uint8, sw-calibration-access=READ-ONLY, compu {255=PDUR_NO_DESTHNDOFRMGDESTROM}, range raw 0..255}
                DirectionOfRmGDestRom: resulting-properties={base-type=uint8, sw-calibration-access=READ-ONLY, compu {0=PDUR_RX_DIRECTIONOFRMGDESTROM, 1=PDUR_TX_DIRECTIONOFRMGDESTROM}, range raw 0..255}
                FmFifoInstanceRomIdxOfRmGDestRom: resulting-properties={base-type=uint8, sw-calibration-access=READ-ONLY, compu {255=PDUR_NO_FMFIFOINSTANCEROMIDXOFRMGDESTROM}, range raw 0..255}
                FmFifoInstanceRomPartitionIdxOfRmGDestRom: resulting-properties={base-type=uint8, sw-calibration-access=READ-ONLY, compu {255=PDUR_NO_FMFIFOINSTANCEROMPARTITIONIDXOFRMGDESTROM}, range raw 0..255}
                LockRomIdxOfRmGDestRom: resulting-properties={base-type=uint8, sw-calibration-access=READ-ONLY, range raw 0..255}
                MmRomIdxOfRmGDestRom: resulting-properties={base-type=uint8, sw-calibration-access=READ-ONLY, range raw 0..255}
                RmDestRomIdxOfRmGDestRom: resulting-properties={base-type=uint8, sw-calibration-access=READ-ONLY, range raw 0..255}
                RmGDestTpTxStateRamIdxOfRmGDestRom: resulting-properties={base-type=uint8, sw-calibration-access=READ-ONLY, compu {255=PDUR_NO_RMGDESTTPTXSTATERAMIDXOFRMGDESTROM}, range raw 0..255}
                RmGDestTpTxStateRamPartitionIdxOfRmGDestRom: resulting-properties={base-type=uint8, sw-calibration-access=READ-ONLY, compu {255=PDUR_NO_RMGDESTTPTXSTATERAMPARTITIONIDXOFRMGDESTROM}, range raw 0..255}
            Element_112: symbol=[112]
              10 x mc data instance, all with category=VALUE:
                MaxPduLengthOfRmGDestRom: resulting-properties={base-type=uint16, sw-calibration-access=READ-ONLY, range raw 0..65535}
                DestHndOfRmGDestRom: resulting-properties={base-type=uint8, sw-calibration-access=READ-ONLY, compu {255=PDUR_NO_DESTHNDOFRMGDESTROM}, range raw 0..255}
                DirectionOfRmGDestRom: resulting-properties={base-type=uint8, sw-calibration-access=READ-ONLY, compu {0=PDUR_RX_DIRECTIONOFRMGDESTROM, 1=PDUR_TX_DIRECTIONOFRMGDESTROM}, range raw 0..255}
                FmFifoInstanceRomIdxOfRmGDestRom: resulting-properties={base-type=uint8, sw-calibration-access=READ-ONLY, compu {255=PDUR_NO_FMFIFOINSTANCEROMIDXOFRMGDESTROM}, range raw 0..255}
                FmFifoInstanceRomPartitionIdxOfRmGDestRom: resulting-properties={base-type=uint8, sw-calibration-access=READ-ONLY, compu {255=PDUR_NO_FMFIFOINSTANCEROMPARTITIONIDXOFRMGDESTROM}, range raw 0..255}
                LockRomIdxOfRmGDestRom: resulting-properties={base-type=uint8, sw-calibration-access=READ-ONLY, range raw 0..255}
                MmRomIdxOfRmGDestRom: resulting-properties={base-type=uint8, sw-calibration-access=READ-ONLY, range raw 0..255}
                RmDestRomIdxOfRmGDestRom: resulting-properties={base-type=uint8, sw-calibration-access=READ-ONLY, range raw 0..255}
                RmGDestTpTxStateRamIdxOfRmGDestRom: resulting-properties={base-type=uint8, sw-calibration-access=READ-ONLY, compu {255=PDUR_NO_RMGDESTTPTXSTATERAMIDXOFRMGDESTROM}, range raw 0..255}
                RmGDestTpTxStateRamPartitionIdxOfRmGDestRom: resulting-properties={base-type=uint8, sw-calibration-access=READ-ONLY, compu {255=PDUR_NO_RMGDESTTPTXSTATERAMPARTITIONIDXOFRMGDESTROM}, range raw 0..255}
            Element_113: symbol=[113]
              10 x mc data instance, all with category=VALUE:
                MaxPduLengthOfRmGDestRom: resulting-properties={base-type=uint16, sw-calibration-access=READ-ONLY, range raw 0..65535}
                DestHndOfRmGDestRom: resulting-properties={base-type=uint8, sw-calibration-access=READ-ONLY, compu {255=PDUR_NO_DESTHNDOFRMGDESTROM}, range raw 0..255}
                DirectionOfRmGDestRom: resulting-properties={base-type=uint8, sw-calibration-access=READ-ONLY, compu {0=PDUR_RX_DIRECTIONOFRMGDESTROM, 1=PDUR_TX_DIRECTIONOFRMGDESTROM}, range raw 0..255}
                FmFifoInstanceRomIdxOfRmGDestRom: resulting-properties={base-type=uint8, sw-calibration-access=READ-ONLY, compu {255=PDUR_NO_FMFIFOINSTANCEROMIDXOFRMGDESTROM}, range raw 0..255}
                FmFifoInstanceRomPartitionIdxOfRmGDestRom: resulting-properties={base-type=uint8, sw-calibration-access=READ-ONLY, compu {255=PDUR_NO_FMFIFOINSTANCEROMPARTITIONIDXOFRMGDESTROM}, range raw 0..255}
                LockRomIdxOfRmGDestRom: resulting-properties={base-type=uint8, sw-calibration-access=READ-ONLY, range raw 0..255}
                MmRomIdxOfRmGDestRom: resulting-properties={base-type=uint8, sw-calibration-access=READ-ONLY, range raw 0..255}
                RmDestRomIdxOfRmGDestRom: resulting-properties={base-type=uint8, sw-calibration-access=READ-ONLY, range raw 0..255}
                RmGDestTpTxStateRamIdxOfRmGDestRom: resulting-properties={base-type=uint8, sw-calibration-access=READ-ONLY, compu {255=PDUR_NO_RMGDESTTPTXSTATERAMIDXOFRMGDESTROM}, range raw 0..255}
                RmGDestTpTxStateRamPartitionIdxOfRmGDestRom: resulting-properties={base-type=uint8, sw-calibration-access=READ-ONLY, compu {255=PDUR_NO_RMGDESTTPTXSTATERAMPARTITIONIDXOFRMGDESTROM}, range raw 0..255}
            Element_114: symbol=[114]
              10 x mc data instance, all with category=VALUE:
                MaxPduLengthOfRmGDestRom: resulting-properties={base-type=uint16, sw-calibration-access=READ-ONLY, range raw 0..65535}
                DestHndOfRmGDestRom: resulting-properties={base-type=uint8, sw-calibration-access=READ-ONLY, compu {255=PDUR_NO_DESTHNDOFRMGDESTROM}, range raw 0..255}
                DirectionOfRmGDestRom: resulting-properties={base-type=uint8, sw-calibration-access=READ-ONLY, compu {0=PDUR_RX_DIRECTIONOFRMGDESTROM, 1=PDUR_TX_DIRECTIONOFRMGDESTROM}, range raw 0..255}
                FmFifoInstanceRomIdxOfRmGDestRom: resulting-properties={base-type=uint8, sw-calibration-access=READ-ONLY, compu {255=PDUR_NO_FMFIFOINSTANCEROMIDXOFRMGDESTROM}, range raw 0..255}
                FmFifoInstanceRomPartitionIdxOfRmGDestRom: resulting-properties={base-type=uint8, sw-calibration-access=READ-ONLY, compu {255=PDUR_NO_FMFIFOINSTANCEROMPARTITIONIDXOFRMGDESTROM}, range raw 0..255}
                LockRomIdxOfRmGDestRom: resulting-properties={base-type=uint8, sw-calibration-access=READ-ONLY, range raw 0..255}
                MmRomIdxOfRmGDestRom: resulting-properties={base-type=uint8, sw-calibration-access=READ-ONLY, range raw 0..255}
                RmDestRomIdxOfRmGDestRom: resulting-properties={base-type=uint8, sw-calibration-access=READ-ONLY, range raw 0..255}
                RmGDestTpTxStateRamIdxOfRmGDestRom: resulting-properties={base-type=uint8, sw-calibration-access=READ-ONLY, compu {255=PDUR_NO_RMGDESTTPTXSTATERAMIDXOFRMGDESTROM}, range raw 0..255}
                RmGDestTpTxStateRamPartitionIdxOfRmGDestRom: resulting-properties={base-type=uint8, sw-calibration-access=READ-ONLY, compu {255=PDUR_NO_RMGDESTTPTXSTATERAMPARTITIONIDXOFRMGDESTROM}, range raw 0..255}
            Element_115: symbol=[115]
              10 x mc data instance, all with category=VALUE:
                MaxPduLengthOfRmGDestRom: resulting-properties={base-type=uint16, sw-calibration-access=READ-ONLY, range raw 0..65535}
                DestHndOfRmGDestRom: resulting-properties={base-type=uint8, sw-calibration-access=READ-ONLY, compu {255=PDUR_NO_DESTHNDOFRMGDESTROM}, range raw 0..255}
                DirectionOfRmGDestRom: resulting-properties={base-type=uint8, sw-calibration-access=READ-ONLY, compu {0=PDUR_RX_DIRECTIONOFRMGDESTROM, 1=PDUR_TX_DIRECTIONOFRMGDESTROM}, range raw 0..255}
                FmFifoInstanceRomIdxOfRmGDestRom: resulting-properties={base-type=uint8, sw-calibration-access=READ-ONLY, compu {255=PDUR_NO_FMFIFOINSTANCEROMIDXOFRMGDESTROM}, range raw 0..255}
                FmFifoInstanceRomPartitionIdxOfRmGDestRom: resulting-properties={base-type=uint8, sw-calibration-access=READ-ONLY, compu {255=PDUR_NO_FMFIFOINSTANCEROMPARTITIONIDXOFRMGDESTROM}, range raw 0..255}
                LockRomIdxOfRmGDestRom: resulting-properties={base-type=uint8, sw-calibration-access=READ-ONLY, range raw 0..255}
                MmRomIdxOfRmGDestRom: resulting-properties={base-type=uint8, sw-calibration-access=READ-ONLY, range raw 0..255}
                RmDestRomIdxOfRmGDestRom: resulting-properties={base-type=uint8, sw-calibration-access=READ-ONLY, range raw 0..255}
                RmGDestTpTxStateRamIdxOfRmGDestRom: resulting-properties={base-type=uint8, sw-calibration-access=READ-ONLY, compu {255=PDUR_NO_RMGDESTTPTXSTATERAMIDXOFRMGDESTROM}, range raw 0..255}
                RmGDestTpTxStateRamPartitionIdxOfRmGDestRom: resulting-properties={base-type=uint8, sw-calibration-access=READ-ONLY, compu {255=PDUR_NO_RMGDESTTPTXSTATERAMPARTITIONIDXOFRMGDESTROM}, range raw 0..255}
            Element_116: symbol=[116]
              10 x mc data instance, all with category=VALUE:
                MaxPduLengthOfRmGDestRom: resulting-properties={base-type=uint16, sw-calibration-access=READ-ONLY, range raw 0..65535}
                DestHndOfRmGDestRom: resulting-properties={base-type=uint8, sw-calibration-access=READ-ONLY, compu {255=PDUR_NO_DESTHNDOFRMGDESTROM}, range raw 0..255}
                DirectionOfRmGDestRom: resulting-properties={base-type=uint8, sw-calibration-access=READ-ONLY, compu {0=PDUR_RX_DIRECTIONOFRMGDESTROM, 1=PDUR_TX_DIRECTIONOFRMGDESTROM}, range raw 0..255}
                FmFifoInstanceRomIdxOfRmGDestRom: resulting-properties={base-type=uint8, sw-calibration-access=READ-ONLY, compu {255=PDUR_NO_FMFIFOINSTANCEROMIDXOFRMGDESTROM}, range raw 0..255}
                FmFifoInstanceRomPartitionIdxOfRmGDestRom: resulting-properties={base-type=uint8, sw-calibration-access=READ-ONLY, compu {255=PDUR_NO_FMFIFOINSTANCEROMPARTITIONIDXOFRMGDESTROM}, range raw 0..255}
                LockRomIdxOfRmGDestRom: resulting-properties={base-type=uint8, sw-calibration-access=READ-ONLY, range raw 0..255}
                MmRomIdxOfRmGDestRom: resulting-properties={base-type=uint8, sw-calibration-access=READ-ONLY, range raw 0..255}
                RmDestRomIdxOfRmGDestRom: resulting-properties={base-type=uint8, sw-calibration-access=READ-ONLY, range raw 0..255}
                RmGDestTpTxStateRamIdxOfRmGDestRom: resulting-properties={base-type=uint8, sw-calibration-access=READ-ONLY, compu {255=PDUR_NO_RMGDESTTPTXSTATERAMIDXOFRMGDESTROM}, range raw 0..255}
                RmGDestTpTxStateRamPartitionIdxOfRmGDestRom: resulting-properties={base-type=uint8, sw-calibration-access=READ-ONLY, compu {255=PDUR_NO_RMGDESTTPTXSTATERAMPARTITIONIDXOFRMGDESTROM}, range raw 0..255}
            Element_117: symbol=[117]
              10 x mc data instance, all with category=VALUE:
                MaxPduLengthOfRmGDestRom: resulting-properties={base-type=uint16, sw-calibration-access=READ-ONLY, range raw 0..65535}
                DestHndOfRmGDestRom: resulting-properties={base-type=uint8, sw-calibration-access=READ-ONLY, compu {255=PDUR_NO_DESTHNDOFRMGDESTROM}, range raw 0..255}
                DirectionOfRmGDestRom: resulting-properties={base-type=uint8, sw-calibration-access=READ-ONLY, compu {0=PDUR_RX_DIRECTIONOFRMGDESTROM, 1=PDUR_TX_DIRECTIONOFRMGDESTROM}, range raw 0..255}
                FmFifoInstanceRomIdxOfRmGDestRom: resulting-properties={base-type=uint8, sw-calibration-access=READ-ONLY, compu {255=PDUR_NO_FMFIFOINSTANCEROMIDXOFRMGDESTROM}, range raw 0..255}
                FmFifoInstanceRomPartitionIdxOfRmGDestRom: resulting-properties={base-type=uint8, sw-calibration-access=READ-ONLY, compu {255=PDUR_NO_FMFIFOINSTANCEROMPARTITIONIDXOFRMGDESTROM}, range raw 0..255}
                LockRomIdxOfRmGDestRom: resulting-properties={base-type=uint8, sw-calibration-access=READ-ONLY, range raw 0..255}
                MmRomIdxOfRmGDestRom: resulting-properties={base-type=uint8, sw-calibration-access=READ-ONLY, range raw 0..255}
                RmDestRomIdxOfRmGDestRom: resulting-properties={base-type=uint8, sw-calibration-access=READ-ONLY, range raw 0..255}
                RmGDestTpTxStateRamIdxOfRmGDestRom: resulting-properties={base-type=uint8, sw-calibration-access=READ-ONLY, compu {255=PDUR_NO_RMGDESTTPTXSTATERAMIDXOFRMGDESTROM}, range raw 0..255}
                RmGDestTpTxStateRamPartitionIdxOfRmGDestRom: resulting-properties={base-type=uint8, sw-calibration-access=READ-ONLY, compu {255=PDUR_NO_RMGDESTTPTXSTATERAMPARTITIONIDXOFRMGDESTROM}, range raw 0..255}
            Element_118: symbol=[118]
              10 x mc data instance, all with category=VALUE:
                MaxPduLengthOfRmGDestRom: resulting-properties={base-type=uint16, sw-calibration-access=READ-ONLY, range raw 0..65535}
                DestHndOfRmGDestRom: resulting-properties={base-type=uint8, sw-calibration-access=READ-ONLY, compu {255=PDUR_NO_DESTHNDOFRMGDESTROM}, range raw 0..255}
                DirectionOfRmGDestRom: resulting-properties={base-type=uint8, sw-calibration-access=READ-ONLY, compu {0=PDUR_RX_DIRECTIONOFRMGDESTROM, 1=PDUR_TX_DIRECTIONOFRMGDESTROM}, range raw 0..255}
                FmFifoInstanceRomIdxOfRmGDestRom: resulting-properties={base-type=uint8, sw-calibration-access=READ-ONLY, compu {255=PDUR_NO_FMFIFOINSTANCEROMIDXOFRMGDESTROM}, range raw 0..255}
                FmFifoInstanceRomPartitionIdxOfRmGDestRom: resulting-properties={base-type=uint8, sw-calibration-access=READ-ONLY, compu {255=PDUR_NO_FMFIFOINSTANCEROMPARTITIONIDXOFRMGDESTROM}, range raw 0..255}
                LockRomIdxOfRmGDestRom: resulting-properties={base-type=uint8, sw-calibration-access=READ-ONLY, range raw 0..255}
                MmRomIdxOfRmGDestRom: resulting-properties={base-type=uint8, sw-calibration-access=READ-ONLY, range raw 0..255}
                RmDestRomIdxOfRmGDestRom: resulting-properties={base-type=uint8, sw-calibration-access=READ-ONLY, range raw 0..255}
                RmGDestTpTxStateRamIdxOfRmGDestRom: resulting-properties={base-type=uint8, sw-calibration-access=READ-ONLY, compu {255=PDUR_NO_RMGDESTTPTXSTATERAMIDXOFRMGDESTROM}, range raw 0..255}
                RmGDestTpTxStateRamPartitionIdxOfRmGDestRom: resulting-properties={base-type=uint8, sw-calibration-access=READ-ONLY, compu {255=PDUR_NO_RMGDESTTPTXSTATERAMPARTITIONIDXOFRMGDESTROM}, range raw 0..255}
            Element_119: symbol=[119]
              10 x mc data instance, all with category=VALUE:
                MaxPduLengthOfRmGDestRom: resulting-properties={base-type=uint16, sw-calibration-access=READ-ONLY, range raw 0..65535}
                DestHndOfRmGDestRom: resulting-properties={base-type=uint8, sw-calibration-access=READ-ONLY, compu {255=PDUR_NO_DESTHNDOFRMGDESTROM}, range raw 0..255}
                DirectionOfRmGDestRom: resulting-properties={base-type=uint8, sw-calibration-access=READ-ONLY, compu {0=PDUR_RX_DIRECTIONOFRMGDESTROM, 1=PDUR_TX_DIRECTIONOFRMGDESTROM}, range raw 0..255}
                FmFifoInstanceRomIdxOfRmGDestRom: resulting-properties={base-type=uint8, sw-calibration-access=READ-ONLY, compu {255=PDUR_NO_FMFIFOINSTANCEROMIDXOFRMGDESTROM}, range raw 0..255}
                FmFifoInstanceRomPartitionIdxOfRmGDestRom: resulting-properties={base-type=uint8, sw-calibration-access=READ-ONLY, compu {255=PDUR_NO_FMFIFOINSTANCEROMPARTITIONIDXOFRMGDESTROM}, range raw 0..255}
                LockRomIdxOfRmGDestRom: resulting-properties={base-type=uint8, sw-calibration-access=READ-ONLY, range raw 0..255}
                MmRomIdxOfRmGDestRom: resulting-properties={base-type=uint8, sw-calibration-access=READ-ONLY, range raw 0..255}
                RmDestRomIdxOfRmGDestRom: resulting-properties={base-type=uint8, sw-calibration-access=READ-ONLY, range raw 0..255}
                RmGDestTpTxStateRamIdxOfRmGDestRom: resulting-properties={base-type=uint8, sw-calibration-access=READ-ONLY, compu {255=PDUR_NO_RMGDESTTPTXSTATERAMIDXOFRMGDESTROM}, range raw 0..255}
                RmGDestTpTxStateRamPartitionIdxOfRmGDestRom: resulting-properties={base-type=uint8, sw-calibration-access=READ-ONLY, compu {255=PDUR_NO_RMGDESTTPTXSTATERAMPARTITIONIDXOFRMGDESTROM}, range raw 0..255}
            Element_120: symbol=[120]
              10 x mc data instance, all with category=VALUE:
                MaxPduLengthOfRmGDestRom: resulting-properties={base-type=uint16, sw-calibration-access=READ-ONLY, range raw 0..65535}
                DestHndOfRmGDestRom: resulting-properties={base-type=uint8, sw-calibration-access=READ-ONLY, compu {255=PDUR_NO_DESTHNDOFRMGDESTROM}, range raw 0..255}
                DirectionOfRmGDestRom: resulting-properties={base-type=uint8, sw-calibration-access=READ-ONLY, compu {0=PDUR_RX_DIRECTIONOFRMGDESTROM, 1=PDUR_TX_DIRECTIONOFRMGDESTROM}, range raw 0..255}
                FmFifoInstanceRomIdxOfRmGDestRom: resulting-properties={base-type=uint8, sw-calibration-access=READ-ONLY, compu {255=PDUR_NO_FMFIFOINSTANCEROMIDXOFRMGDESTROM}, range raw 0..255}
                FmFifoInstanceRomPartitionIdxOfRmGDestRom: resulting-properties={base-type=uint8, sw-calibration-access=READ-ONLY, compu {255=PDUR_NO_FMFIFOINSTANCEROMPARTITIONIDXOFRMGDESTROM}, range raw 0..255}
                LockRomIdxOfRmGDestRom: resulting-properties={base-type=uint8, sw-calibration-access=READ-ONLY, range raw 0..255}
                MmRomIdxOfRmGDestRom: resulting-properties={base-type=uint8, sw-calibration-access=READ-ONLY, range raw 0..255}
                RmDestRomIdxOfRmGDestRom: resulting-properties={base-type=uint8, sw-calibration-access=READ-ONLY, range raw 0..255}
                RmGDestTpTxStateRamIdxOfRmGDestRom: resulting-properties={base-type=uint8, sw-calibration-access=READ-ONLY, compu {255=PDUR_NO_RMGDESTTPTXSTATERAMIDXOFRMGDESTROM}, range raw 0..255}
                RmGDestTpTxStateRamPartitionIdxOfRmGDestRom: resulting-properties={base-type=uint8, sw-calibration-access=READ-ONLY, compu {255=PDUR_NO_RMGDESTTPTXSTATERAMPARTITIONIDXOFRMGDESTROM}, range raw 0..255}
            Element_121: symbol=[121]
              10 x mc data instance, all with category=VALUE:
                MaxPduLengthOfRmGDestRom: resulting-properties={base-type=uint16, sw-calibration-access=READ-ONLY, range raw 0..65535}
                DestHndOfRmGDestRom: resulting-properties={base-type=uint8, sw-calibration-access=READ-ONLY, compu {255=PDUR_NO_DESTHNDOFRMGDESTROM}, range raw 0..255}
                DirectionOfRmGDestRom: resulting-properties={base-type=uint8, sw-calibration-access=READ-ONLY, compu {0=PDUR_RX_DIRECTIONOFRMGDESTROM, 1=PDUR_TX_DIRECTIONOFRMGDESTROM}, range raw 0..255}
                FmFifoInstanceRomIdxOfRmGDestRom: resulting-properties={base-type=uint8, sw-calibration-access=READ-ONLY, compu {255=PDUR_NO_FMFIFOINSTANCEROMIDXOFRMGDESTROM}, range raw 0..255}
                FmFifoInstanceRomPartitionIdxOfRmGDestRom: resulting-properties={base-type=uint8, sw-calibration-access=READ-ONLY, compu {255=PDUR_NO_FMFIFOINSTANCEROMPARTITIONIDXOFRMGDESTROM}, range raw 0..255}
                LockRomIdxOfRmGDestRom: resulting-properties={base-type=uint8, sw-calibration-access=READ-ONLY, range raw 0..255}
                MmRomIdxOfRmGDestRom: resulting-properties={base-type=uint8, sw-calibration-access=READ-ONLY, range raw 0..255}
                RmDestRomIdxOfRmGDestRom: resulting-properties={base-type=uint8, sw-calibration-access=READ-ONLY, range raw 0..255}
                RmGDestTpTxStateRamIdxOfRmGDestRom: resulting-properties={base-type=uint8, sw-calibration-access=READ-ONLY, compu {255=PDUR_NO_RMGDESTTPTXSTATERAMIDXOFRMGDESTROM}, range raw 0..255}
                RmGDestTpTxStateRamPartitionIdxOfRmGDestRom: resulting-properties={base-type=uint8, sw-calibration-access=READ-ONLY, compu {255=PDUR_NO_RMGDESTTPTXSTATERAMPARTITIONIDXOFRMGDESTROM}, range raw 0..255}
            Element_122: symbol=[122]
              10 x mc data instance, all with category=VALUE:
                MaxPduLengthOfRmGDestRom: resulting-properties={base-type=uint16, sw-calibration-access=READ-ONLY, range raw 0..65535}
                DestHndOfRmGDestRom: resulting-properties={base-type=uint8, sw-calibration-access=READ-ONLY, compu {255=PDUR_NO_DESTHNDOFRMGDESTROM}, range raw 0..255}
                DirectionOfRmGDestRom: resulting-properties={base-type=uint8, sw-calibration-access=READ-ONLY, compu {0=PDUR_RX_DIRECTIONOFRMGDESTROM, 1=PDUR_TX_DIRECTIONOFRMGDESTROM}, range raw 0..255}
                FmFifoInstanceRomIdxOfRmGDestRom: resulting-properties={base-type=uint8, sw-calibration-access=READ-ONLY, compu {255=PDUR_NO_FMFIFOINSTANCEROMIDXOFRMGDESTROM}, range raw 0..255}
                FmFifoInstanceRomPartitionIdxOfRmGDestRom: resulting-properties={base-type=uint8, sw-calibration-access=READ-ONLY, compu {255=PDUR_NO_FMFIFOINSTANCEROMPARTITIONIDXOFRMGDESTROM}, range raw 0..255}
                LockRomIdxOfRmGDestRom: resulting-properties={base-type=uint8, sw-calibration-access=READ-ONLY, range raw 0..255}
                MmRomIdxOfRmGDestRom: resulting-properties={base-type=uint8, sw-calibration-access=READ-ONLY, range raw 0..255}
                RmDestRomIdxOfRmGDestRom: resulting-properties={base-type=uint8, sw-calibration-access=READ-ONLY, range raw 0..255}
                RmGDestTpTxStateRamIdxOfRmGDestRom: resulting-properties={base-type=uint8, sw-calibration-access=READ-ONLY, compu {255=PDUR_NO_RMGDESTTPTXSTATERAMIDXOFRMGDESTROM}, range raw 0..255}
                RmGDestTpTxStateRamPartitionIdxOfRmGDestRom: resulting-properties={base-type=uint8, sw-calibration-access=READ-ONLY, compu {255=PDUR_NO_RMGDESTTPTXSTATERAMPARTITIONIDXOFRMGDESTROM}, range raw 0..255}
            Element_123: symbol=[123]
              10 x mc data instance, all with category=VALUE:
                MaxPduLengthOfRmGDestRom: resulting-properties={base-type=uint16, sw-calibration-access=READ-ONLY, range raw 0..65535}
                DestHndOfRmGDestRom: resulting-properties={base-type=uint8, sw-calibration-access=READ-ONLY, compu {255=PDUR_NO_DESTHNDOFRMGDESTROM}, range raw 0..255}
                DirectionOfRmGDestRom: resulting-properties={base-type=uint8, sw-calibration-access=READ-ONLY, compu {0=PDUR_RX_DIRECTIONOFRMGDESTROM, 1=PDUR_TX_DIRECTIONOFRMGDESTROM}, range raw 0..255}
                FmFifoInstanceRomIdxOfRmGDestRom: resulting-properties={base-type=uint8, sw-calibration-access=READ-ONLY, compu {255=PDUR_NO_FMFIFOINSTANCEROMIDXOFRMGDESTROM}, range raw 0..255}
                FmFifoInstanceRomPartitionIdxOfRmGDestRom: resulting-properties={base-type=uint8, sw-calibration-access=READ-ONLY, compu {255=PDUR_NO_FMFIFOINSTANCEROMPARTITIONIDXOFRMGDESTROM}, range raw 0..255}
                LockRomIdxOfRmGDestRom: resulting-properties={base-type=uint8, sw-calibration-access=READ-ONLY, range raw 0..255}
                MmRomIdxOfRmGDestRom: resulting-properties={base-type=uint8, sw-calibration-access=READ-ONLY, range raw 0..255}
                RmDestRomIdxOfRmGDestRom: resulting-properties={base-type=uint8, sw-calibration-access=READ-ONLY, range raw 0..255}
                RmGDestTpTxStateRamIdxOfRmGDestRom: resulting-properties={base-type=uint8, sw-calibration-access=READ-ONLY, compu {255=PDUR_NO_RMGDESTTPTXSTATERAMIDXOFRMGDESTROM}, range raw 0..255}
                RmGDestTpTxStateRamPartitionIdxOfRmGDestRom: resulting-properties={base-type=uint8, sw-calibration-access=READ-ONLY, compu {255=PDUR_NO_RMGDESTTPTXSTATERAMPARTITIONIDXOFRMGDESTROM}, range raw 0..255}
            Element_124: symbol=[124]
              10 x mc data instance, all with category=VALUE:
                MaxPduLengthOfRmGDestRom: resulting-properties={base-type=uint16, sw-calibration-access=READ-ONLY, range raw 0..65535}
                DestHndOfRmGDestRom: resulting-properties={base-type=uint8, sw-calibration-access=READ-ONLY, compu {255=PDUR_NO_DESTHNDOFRMGDESTROM}, range raw 0..255}
                DirectionOfRmGDestRom: resulting-properties={base-type=uint8, sw-calibration-access=READ-ONLY, compu {0=PDUR_RX_DIRECTIONOFRMGDESTROM, 1=PDUR_TX_DIRECTIONOFRMGDESTROM}, range raw 0..255}
                FmFifoInstanceRomIdxOfRmGDestRom: resulting-properties={base-type=uint8, sw-calibration-access=READ-ONLY, compu {255=PDUR_NO_FMFIFOINSTANCEROMIDXOFRMGDESTROM}, range raw 0..255}
                FmFifoInstanceRomPartitionIdxOfRmGDestRom: resulting-properties={base-type=uint8, sw-calibration-access=READ-ONLY, compu {255=PDUR_NO_FMFIFOINSTANCEROMPARTITIONIDXOFRMGDESTROM}, range raw 0..255}
                LockRomIdxOfRmGDestRom: resulting-properties={base-type=uint8, sw-calibration-access=READ-ONLY, range raw 0..255}
                MmRomIdxOfRmGDestRom: resulting-properties={base-type=uint8, sw-calibration-access=READ-ONLY, range raw 0..255}
                RmDestRomIdxOfRmGDestRom: resulting-properties={base-type=uint8, sw-calibration-access=READ-ONLY, range raw 0..255}
                RmGDestTpTxStateRamIdxOfRmGDestRom: resulting-properties={base-type=uint8, sw-calibration-access=READ-ONLY, compu {255=PDUR_NO_RMGDESTTPTXSTATERAMIDXOFRMGDESTROM}, range raw 0..255}
                RmGDestTpTxStateRamPartitionIdxOfRmGDestRom: resulting-properties={base-type=uint8, sw-calibration-access=READ-ONLY, compu {255=PDUR_NO_RMGDESTTPTXSTATERAMPARTITIONIDXOFRMGDESTROM}, range raw 0..255}
            Element_125: symbol=[125]
              10 x mc data instance, all with category=VALUE:
                MaxPduLengthOfRmGDestRom: resulting-properties={base-type=uint16, sw-calibration-access=READ-ONLY, range raw 0..65535}
                DestHndOfRmGDestRom: resulting-properties={base-type=uint8, sw-calibration-access=READ-ONLY, compu {255=PDUR_NO_DESTHNDOFRMGDESTROM}, range raw 0..255}
                DirectionOfRmGDestRom: resulting-properties={base-type=uint8, sw-calibration-access=READ-ONLY, compu {0=PDUR_RX_DIRECTIONOFRMGDESTROM, 1=PDUR_TX_DIRECTIONOFRMGDESTROM}, range raw 0..255}
                FmFifoInstanceRomIdxOfRmGDestRom: resulting-properties={base-type=uint8, sw-calibration-access=READ-ONLY, compu {255=PDUR_NO_FMFIFOINSTANCEROMIDXOFRMGDESTROM}, range raw 0..255}
                FmFifoInstanceRomPartitionIdxOfRmGDestRom: resulting-properties={base-type=uint8, sw-calibration-access=READ-ONLY, compu {255=PDUR_NO_FMFIFOINSTANCEROMPARTITIONIDXOFRMGDESTROM}, range raw 0..255}
                LockRomIdxOfRmGDestRom: resulting-properties={base-type=uint8, sw-calibration-access=READ-ONLY, range raw 0..255}
                MmRomIdxOfRmGDestRom: resulting-properties={base-type=uint8, sw-calibration-access=READ-ONLY, range raw 0..255}
                RmDestRomIdxOfRmGDestRom: resulting-properties={base-type=uint8, sw-calibration-access=READ-ONLY, range raw 0..255}
                RmGDestTpTxStateRamIdxOfRmGDestRom: resulting-properties={base-type=uint8, sw-calibration-access=READ-ONLY, compu {255=PDUR_NO_RMGDESTTPTXSTATERAMIDXOFRMGDESTROM}, range raw 0..255}
                RmGDestTpTxStateRamPartitionIdxOfRmGDestRom: resulting-properties={base-type=uint8, sw-calibration-access=READ-ONLY, compu {255=PDUR_NO_RMGDESTTPTXSTATERAMPARTITIONIDXOFRMGDESTROM}, range raw 0..255}
            Element_126: symbol=[126]
              10 x mc data instance, all with category=VALUE:
                MaxPduLengthOfRmGDestRom: resulting-properties={base-type=uint16, sw-calibration-access=READ-ONLY, range raw 0..65535}
                DestHndOfRmGDestRom: resulting-properties={base-type=uint8, sw-calibration-access=READ-ONLY, compu {255=PDUR_NO_DESTHNDOFRMGDESTROM}, range raw 0..255}
                DirectionOfRmGDestRom: resulting-properties={base-type=uint8, sw-calibration-access=READ-ONLY, compu {0=PDUR_RX_DIRECTIONOFRMGDESTROM, 1=PDUR_TX_DIRECTIONOFRMGDESTROM}, range raw 0..255}
                FmFifoInstanceRomIdxOfRmGDestRom: resulting-properties={base-type=uint8, sw-calibration-access=READ-ONLY, compu {255=PDUR_NO_FMFIFOINSTANCEROMIDXOFRMGDESTROM}, range raw 0..255}
                FmFifoInstanceRomPartitionIdxOfRmGDestRom: resulting-properties={base-type=uint8, sw-calibration-access=READ-ONLY, compu {255=PDUR_NO_FMFIFOINSTANCEROMPARTITIONIDXOFRMGDESTROM}, range raw 0..255}
                LockRomIdxOfRmGDestRom: resulting-properties={base-type=uint8, sw-calibration-access=READ-ONLY, range raw 0..255}
                MmRomIdxOfRmGDestRom: resulting-properties={base-type=uint8, sw-calibration-access=READ-ONLY, range raw 0..255}
                RmDestRomIdxOfRmGDestRom: resulting-properties={base-type=uint8, sw-calibration-access=READ-ONLY, range raw 0..255}
                RmGDestTpTxStateRamIdxOfRmGDestRom: resulting-properties={base-type=uint8, sw-calibration-access=READ-ONLY, compu {255=PDUR_NO_RMGDESTTPTXSTATERAMIDXOFRMGDESTROM}, range raw 0..255}
                RmGDestTpTxStateRamPartitionIdxOfRmGDestRom: resulting-properties={base-type=uint8, sw-calibration-access=READ-ONLY, compu {255=PDUR_NO_RMGDESTTPTXSTATERAMPARTITIONIDXOFRMGDESTROM}, range raw 0..255}
            Element_127: symbol=[127]
              10 x mc data instance, all with category=VALUE:
                MaxPduLengthOfRmGDestRom: resulting-properties={base-type=uint16, sw-calibration-access=READ-ONLY, range raw 0..65535}
                DestHndOfRmGDestRom: resulting-properties={base-type=uint8, sw-calibration-access=READ-ONLY, compu {255=PDUR_NO_DESTHNDOFRMGDESTROM}, range raw 0..255}
                DirectionOfRmGDestRom: resulting-properties={base-type=uint8, sw-calibration-access=READ-ONLY, compu {0=PDUR_RX_DIRECTIONOFRMGDESTROM, 1=PDUR_TX_DIRECTIONOFRMGDESTROM}, range raw 0..255}
                FmFifoInstanceRomIdxOfRmGDestRom: resulting-properties={base-type=uint8, sw-calibration-access=READ-ONLY, compu {255=PDUR_NO_FMFIFOINSTANCEROMIDXOFRMGDESTROM}, range raw 0..255}
                FmFifoInstanceRomPartitionIdxOfRmGDestRom: resulting-properties={base-type=uint8, sw-calibration-access=READ-ONLY, compu {255=PDUR_NO_FMFIFOINSTANCEROMPARTITIONIDXOFRMGDESTROM}, range raw 0..255}
                LockRomIdxOfRmGDestRom: resulting-properties={base-type=uint8, sw-calibration-access=READ-ONLY, range raw 0..255}
                MmRomIdxOfRmGDestRom: resulting-properties={base-type=uint8, sw-calibration-access=READ-ONLY, range raw 0..255}
                RmDestRomIdxOfRmGDestRom: resulting-properties={base-type=uint8, sw-calibration-access=READ-ONLY, range raw 0..255}
                RmGDestTpTxStateRamIdxOfRmGDestRom: resulting-properties={base-type=uint8, sw-calibration-access=READ-ONLY, compu {255=PDUR_NO_RMGDESTTPTXSTATERAMIDXOFRMGDESTROM}, range raw 0..255}
                RmGDestTpTxStateRamPartitionIdxOfRmGDestRom: resulting-properties={base-type=uint8, sw-calibration-access=READ-ONLY, compu {255=PDUR_NO_RMGDESTTPTXSTATERAMPARTITIONIDXOFRMGDESTROM}, range raw 0..255}
            Element_128: symbol=[128]
              10 x mc data instance, all with category=VALUE:
                MaxPduLengthOfRmGDestRom: resulting-properties={base-type=uint16, sw-calibration-access=READ-ONLY, range raw 0..65535}
                DestHndOfRmGDestRom: resulting-properties={base-type=uint8, sw-calibration-access=READ-ONLY, compu {255=PDUR_NO_DESTHNDOFRMGDESTROM}, range raw 0..255}
                DirectionOfRmGDestRom: resulting-properties={base-type=uint8, sw-calibration-access=READ-ONLY, compu {0=PDUR_RX_DIRECTIONOFRMGDESTROM, 1=PDUR_TX_DIRECTIONOFRMGDESTROM}, range raw 0..255}
                FmFifoInstanceRomIdxOfRmGDestRom: resulting-properties={base-type=uint8, sw-calibration-access=READ-ONLY, compu {255=PDUR_NO_FMFIFOINSTANCEROMIDXOFRMGDESTROM}, range raw 0..255}
                FmFifoInstanceRomPartitionIdxOfRmGDestRom: resulting-properties={base-type=uint8, sw-calibration-access=READ-ONLY, compu {255=PDUR_NO_FMFIFOINSTANCEROMPARTITIONIDXOFRMGDESTROM}, range raw 0..255}
                LockRomIdxOfRmGDestRom: resulting-properties={base-type=uint8, sw-calibration-access=READ-ONLY, range raw 0..255}
                MmRomIdxOfRmGDestRom: resulting-properties={base-type=uint8, sw-calibration-access=READ-ONLY, range raw 0..255}
                RmDestRomIdxOfRmGDestRom: resulting-properties={base-type=uint8, sw-calibration-access=READ-ONLY, range raw 0..255}
                RmGDestTpTxStateRamIdxOfRmGDestRom: resulting-properties={base-type=uint8, sw-calibration-access=READ-ONLY, compu {255=PDUR_NO_RMGDESTTPTXSTATERAMIDXOFRMGDESTROM}, range raw 0..255}
                RmGDestTpTxStateRamPartitionIdxOfRmGDestRom: resulting-properties={base-type=uint8, sw-calibration-access=READ-ONLY, compu {255=PDUR_NO_RMGDESTTPTXSTATERAMPARTITIONIDXOFRMGDESTROM}, range raw 0..255}
            Element_129: symbol=[129]
              10 x mc data instance, all with category=VALUE:
                MaxPduLengthOfRmGDestRom: resulting-properties={base-type=uint16, sw-calibration-access=READ-ONLY, range raw 0..65535}
                DestHndOfRmGDestRom: resulting-properties={base-type=uint8, sw-calibration-access=READ-ONLY, compu {255=PDUR_NO_DESTHNDOFRMGDESTROM}, range raw 0..255}
                DirectionOfRmGDestRom: resulting-properties={base-type=uint8, sw-calibration-access=READ-ONLY, compu {0=PDUR_RX_DIRECTIONOFRMGDESTROM, 1=PDUR_TX_DIRECTIONOFRMGDESTROM}, range raw 0..255}
                FmFifoInstanceRomIdxOfRmGDestRom: resulting-properties={base-type=uint8, sw-calibration-access=READ-ONLY, compu {255=PDUR_NO_FMFIFOINSTANCEROMIDXOFRMGDESTROM}, range raw 0..255}
                FmFifoInstanceRomPartitionIdxOfRmGDestRom: resulting-properties={base-type=uint8, sw-calibration-access=READ-ONLY, compu {255=PDUR_NO_FMFIFOINSTANCEROMPARTITIONIDXOFRMGDESTROM}, range raw 0..255}
                LockRomIdxOfRmGDestRom: resulting-properties={base-type=uint8, sw-calibration-access=READ-ONLY, range raw 0..255}
                MmRomIdxOfRmGDestRom: resulting-properties={base-type=uint8, sw-calibration-access=READ-ONLY, range raw 0..255}
                RmDestRomIdxOfRmGDestRom: resulting-properties={base-type=uint8, sw-calibration-access=READ-ONLY, range raw 0..255}
                RmGDestTpTxStateRamIdxOfRmGDestRom: resulting-properties={base-type=uint8, sw-calibration-access=READ-ONLY, compu {255=PDUR_NO_RMGDESTTPTXSTATERAMIDXOFRMGDESTROM}, range raw 0..255}
                RmGDestTpTxStateRamPartitionIdxOfRmGDestRom: resulting-properties={base-type=uint8, sw-calibration-access=READ-ONLY, compu {255=PDUR_NO_RMGDESTTPTXSTATERAMPARTITIONIDXOFRMGDESTROM}, range raw 0..255}
            Element_130: symbol=[130]
              10 x mc data instance, all with category=VALUE:
                MaxPduLengthOfRmGDestRom: resulting-properties={base-type=uint16, sw-calibration-access=READ-ONLY, range raw 0..65535}
                DestHndOfRmGDestRom: resulting-properties={base-type=uint8, sw-calibration-access=READ-ONLY, compu {255=PDUR_NO_DESTHNDOFRMGDESTROM}, range raw 0..255}
                DirectionOfRmGDestRom: resulting-properties={base-type=uint8, sw-calibration-access=READ-ONLY, compu {0=PDUR_RX_DIRECTIONOFRMGDESTROM, 1=PDUR_TX_DIRECTIONOFRMGDESTROM}, range raw 0..255}
                FmFifoInstanceRomIdxOfRmGDestRom: resulting-properties={base-type=uint8, sw-calibration-access=READ-ONLY, compu {255=PDUR_NO_FMFIFOINSTANCEROMIDXOFRMGDESTROM}, range raw 0..255}
                FmFifoInstanceRomPartitionIdxOfRmGDestRom: resulting-properties={base-type=uint8, sw-calibration-access=READ-ONLY, compu {255=PDUR_NO_FMFIFOINSTANCEROMPARTITIONIDXOFRMGDESTROM}, range raw 0..255}
                LockRomIdxOfRmGDestRom: resulting-properties={base-type=uint8, sw-calibration-access=READ-ONLY, range raw 0..255}
                MmRomIdxOfRmGDestRom: resulting-properties={base-type=uint8, sw-calibration-access=READ-ONLY, range raw 0..255}
                RmDestRomIdxOfRmGDestRom: resulting-properties={base-type=uint8, sw-calibration-access=READ-ONLY, range raw 0..255}
                RmGDestTpTxStateRamIdxOfRmGDestRom: resulting-properties={base-type=uint8, sw-calibration-access=READ-ONLY, compu {255=PDUR_NO_RMGDESTTPTXSTATERAMIDXOFRMGDESTROM}, range raw 0..255}
                RmGDestTpTxStateRamPartitionIdxOfRmGDestRom: resulting-properties={base-type=uint8, sw-calibration-access=READ-ONLY, compu {255=PDUR_NO_RMGDESTTPTXSTATERAMPARTITIONIDXOFRMGDESTROM}, range raw 0..255}
            Element_131: symbol=[131]
              10 x mc data instance, all with category=VALUE:
                MaxPduLengthOfRmGDestRom: resulting-properties={base-type=uint16, sw-calibration-access=READ-ONLY, range raw 0..65535}
                DestHndOfRmGDestRom: resulting-properties={base-type=uint8, sw-calibration-access=READ-ONLY, compu {255=PDUR_NO_DESTHNDOFRMGDESTROM}, range raw 0..255}
                DirectionOfRmGDestRom: resulting-properties={base-type=uint8, sw-calibration-access=READ-ONLY, compu {0=PDUR_RX_DIRECTIONOFRMGDESTROM, 1=PDUR_TX_DIRECTIONOFRMGDESTROM}, range raw 0..255}
                FmFifoInstanceRomIdxOfRmGDestRom: resulting-properties={base-type=uint8, sw-calibration-access=READ-ONLY, compu {255=PDUR_NO_FMFIFOINSTANCEROMIDXOFRMGDESTROM}, range raw 0..255}
                FmFifoInstanceRomPartitionIdxOfRmGDestRom: resulting-properties={base-type=uint8, sw-calibration-access=READ-ONLY, compu {255=PDUR_NO_FMFIFOINSTANCEROMPARTITIONIDXOFRMGDESTROM}, range raw 0..255}
                LockRomIdxOfRmGDestRom: resulting-properties={base-type=uint8, sw-calibration-access=READ-ONLY, range raw 0..255}
                MmRomIdxOfRmGDestRom: resulting-properties={base-type=uint8, sw-calibration-access=READ-ONLY, range raw 0..255}
                RmDestRomIdxOfRmGDestRom: resulting-properties={base-type=uint8, sw-calibration-access=READ-ONLY, range raw 0..255}
                RmGDestTpTxStateRamIdxOfRmGDestRom: resulting-properties={base-type=uint8, sw-calibration-access=READ-ONLY, compu {255=PDUR_NO_RMGDESTTPTXSTATERAMIDXOFRMGDESTROM}, range raw 0..255}
                RmGDestTpTxStateRamPartitionIdxOfRmGDestRom: resulting-properties={base-type=uint8, sw-calibration-access=READ-ONLY, compu {255=PDUR_NO_RMGDESTTPTXSTATERAMPARTITIONIDXOFRMGDESTROM}, range raw 0..255}
            Element_132: symbol=[132]
              10 x mc data instance, all with category=VALUE:
                MaxPduLengthOfRmGDestRom: resulting-properties={base-type=uint16, sw-calibration-access=READ-ONLY, range raw 0..65535}
                DestHndOfRmGDestRom: resulting-properties={base-type=uint8, sw-calibration-access=READ-ONLY, compu {255=PDUR_NO_DESTHNDOFRMGDESTROM}, range raw 0..255}
                DirectionOfRmGDestRom: resulting-properties={base-type=uint8, sw-calibration-access=READ-ONLY, compu {0=PDUR_RX_DIRECTIONOFRMGDESTROM, 1=PDUR_TX_DIRECTIONOFRMGDESTROM}, range raw 0..255}
                FmFifoInstanceRomIdxOfRmGDestRom: resulting-properties={base-type=uint8, sw-calibration-access=READ-ONLY, compu {255=PDUR_NO_FMFIFOINSTANCEROMIDXOFRMGDESTROM}, range raw 0..255}
                FmFifoInstanceRomPartitionIdxOfRmGDestRom: resulting-properties={base-type=uint8, sw-calibration-access=READ-ONLY, compu {255=PDUR_NO_FMFIFOINSTANCEROMPARTITIONIDXOFRMGDESTROM}, range raw 0..255}
                LockRomIdxOfRmGDestRom: resulting-properties={base-type=uint8, sw-calibration-access=READ-ONLY, range raw 0..255}
                MmRomIdxOfRmGDestRom: resulting-properties={base-type=uint8, sw-calibration-access=READ-ONLY, range raw 0..255}
                RmDestRomIdxOfRmGDestRom: resulting-properties={base-type=uint8, sw-calibration-access=READ-ONLY, range raw 0..255}
                RmGDestTpTxStateRamIdxOfRmGDestRom: resulting-properties={base-type=uint8, sw-calibration-access=READ-ONLY, compu {255=PDUR_NO_RMGDESTTPTXSTATERAMIDXOFRMGDESTROM}, range raw 0..255}
                RmGDestTpTxStateRamPartitionIdxOfRmGDestRom: resulting-properties={base-type=uint8, sw-calibration-access=READ-ONLY, compu {255=PDUR_NO_RMGDESTTPTXSTATERAMPARTITIONIDXOFRMGDESTROM}, range raw 0..255}
            Element_133: symbol=[133]
              10 x mc data instance, all with category=VALUE:
                MaxPduLengthOfRmGDestRom: resulting-properties={base-type=uint16, sw-calibration-access=READ-ONLY, range raw 0..65535}
                DestHndOfRmGDestRom: resulting-properties={base-type=uint8, sw-calibration-access=READ-ONLY, compu {255=PDUR_NO_DESTHNDOFRMGDESTROM}, range raw 0..255}
                DirectionOfRmGDestRom: resulting-properties={base-type=uint8, sw-calibration-access=READ-ONLY, compu {0=PDUR_RX_DIRECTIONOFRMGDESTROM, 1=PDUR_TX_DIRECTIONOFRMGDESTROM}, range raw 0..255}
                FmFifoInstanceRomIdxOfRmGDestRom: resulting-properties={base-type=uint8, sw-calibration-access=READ-ONLY, compu {255=PDUR_NO_FMFIFOINSTANCEROMIDXOFRMGDESTROM}, range raw 0..255}
                FmFifoInstanceRomPartitionIdxOfRmGDestRom: resulting-properties={base-type=uint8, sw-calibration-access=READ-ONLY, compu {255=PDUR_NO_FMFIFOINSTANCEROMPARTITIONIDXOFRMGDESTROM}, range raw 0..255}
                LockRomIdxOfRmGDestRom: resulting-properties={base-type=uint8, sw-calibration-access=READ-ONLY, range raw 0..255}
                MmRomIdxOfRmGDestRom: resulting-properties={base-type=uint8, sw-calibration-access=READ-ONLY, range raw 0..255}
                RmDestRomIdxOfRmGDestRom: resulting-properties={base-type=uint8, sw-calibration-access=READ-ONLY, range raw 0..255}
                RmGDestTpTxStateRamIdxOfRmGDestRom: resulting-properties={base-type=uint8, sw-calibration-access=READ-ONLY, compu {255=PDUR_NO_RMGDESTTPTXSTATERAMIDXOFRMGDESTROM}, range raw 0..255}
                RmGDestTpTxStateRamPartitionIdxOfRmGDestRom: resulting-properties={base-type=uint8, sw-calibration-access=READ-ONLY, compu {255=PDUR_NO_RMGDESTTPTXSTATERAMPARTITIONIDXOFRMGDESTROM}, range raw 0..255}
            Element_134: symbol=[134]
              10 x mc data instance, all with category=VALUE:
                MaxPduLengthOfRmGDestRom: resulting-properties={base-type=uint16, sw-calibration-access=READ-ONLY, range raw 0..65535}
                DestHndOfRmGDestRom: resulting-properties={base-type=uint8, sw-calibration-access=READ-ONLY, compu {255=PDUR_NO_DESTHNDOFRMGDESTROM}, range raw 0..255}
                DirectionOfRmGDestRom: resulting-properties={base-type=uint8, sw-calibration-access=READ-ONLY, compu {0=PDUR_RX_DIRECTIONOFRMGDESTROM, 1=PDUR_TX_DIRECTIONOFRMGDESTROM}, range raw 0..255}
                FmFifoInstanceRomIdxOfRmGDestRom: resulting-properties={base-type=uint8, sw-calibration-access=READ-ONLY, compu {255=PDUR_NO_FMFIFOINSTANCEROMIDXOFRMGDESTROM}, range raw 0..255}
                FmFifoInstanceRomPartitionIdxOfRmGDestRom: resulting-properties={base-type=uint8, sw-calibration-access=READ-ONLY, compu {255=PDUR_NO_FMFIFOINSTANCEROMPARTITIONIDXOFRMGDESTROM}, range raw 0..255}
                LockRomIdxOfRmGDestRom: resulting-properties={base-type=uint8, sw-calibration-access=READ-ONLY, range raw 0..255}
                MmRomIdxOfRmGDestRom: resulting-properties={base-type=uint8, sw-calibration-access=READ-ONLY, range raw 0..255}
                RmDestRomIdxOfRmGDestRom: resulting-properties={base-type=uint8, sw-calibration-access=READ-ONLY, range raw 0..255}
                RmGDestTpTxStateRamIdxOfRmGDestRom: resulting-properties={base-type=uint8, sw-calibration-access=READ-ONLY, compu {255=PDUR_NO_RMGDESTTPTXSTATERAMIDXOFRMGDESTROM}, range raw 0..255}
                RmGDestTpTxStateRamPartitionIdxOfRmGDestRom: resulting-properties={base-type=uint8, sw-calibration-access=READ-ONLY, compu {255=PDUR_NO_RMGDESTTPTXSTATERAMPARTITIONIDXOFRMGDESTROM}, range raw 0..255}
            Element_135: symbol=[135]
              10 x mc data instance, all with category=VALUE:
                MaxPduLengthOfRmGDestRom: resulting-properties={base-type=uint16, sw-calibration-access=READ-ONLY, range raw 0..65535}
                DestHndOfRmGDestRom: resulting-properties={base-type=uint8, sw-calibration-access=READ-ONLY, compu {255=PDUR_NO_DESTHNDOFRMGDESTROM}, range raw 0..255}
                DirectionOfRmGDestRom: resulting-properties={base-type=uint8, sw-calibration-access=READ-ONLY, compu {0=PDUR_RX_DIRECTIONOFRMGDESTROM, 1=PDUR_TX_DIRECTIONOFRMGDESTROM}, range raw 0..255}
                FmFifoInstanceRomIdxOfRmGDestRom: resulting-properties={base-type=uint8, sw-calibration-access=READ-ONLY, compu {255=PDUR_NO_FMFIFOINSTANCEROMIDXOFRMGDESTROM}, range raw 0..255}
                FmFifoInstanceRomPartitionIdxOfRmGDestRom: resulting-properties={base-type=uint8, sw-calibration-access=READ-ONLY, compu {255=PDUR_NO_FMFIFOINSTANCEROMPARTITIONIDXOFRMGDESTROM}, range raw 0..255}
                LockRomIdxOfRmGDestRom: resulting-properties={base-type=uint8, sw-calibration-access=READ-ONLY, range raw 0..255}
                MmRomIdxOfRmGDestRom: resulting-properties={base-type=uint8, sw-calibration-access=READ-ONLY, range raw 0..255}
                RmDestRomIdxOfRmGDestRom: resulting-properties={base-type=uint8, sw-calibration-access=READ-ONLY, range raw 0..255}
                RmGDestTpTxStateRamIdxOfRmGDestRom: resulting-properties={base-type=uint8, sw-calibration-access=READ-ONLY, compu {255=PDUR_NO_RMGDESTTPTXSTATERAMIDXOFRMGDESTROM}, range raw 0..255}
                RmGDestTpTxStateRamPartitionIdxOfRmGDestRom: resulting-properties={base-type=uint8, sw-calibration-access=READ-ONLY, compu {255=PDUR_NO_RMGDESTTPTXSTATERAMPARTITIONIDXOFRMGDESTROM}, range raw 0..255}
            Element_136: symbol=[136]
              10 x mc data instance, all with category=VALUE:
                MaxPduLengthOfRmGDestRom: resulting-properties={base-type=uint16, sw-calibration-access=READ-ONLY, range raw 0..65535}
                DestHndOfRmGDestRom: resulting-properties={base-type=uint8, sw-calibration-access=READ-ONLY, compu {255=PDUR_NO_DESTHNDOFRMGDESTROM}, range raw 0..255}
                DirectionOfRmGDestRom: resulting-properties={base-type=uint8, sw-calibration-access=READ-ONLY, compu {0=PDUR_RX_DIRECTIONOFRMGDESTROM, 1=PDUR_TX_DIRECTIONOFRMGDESTROM}, range raw 0..255}
                FmFifoInstanceRomIdxOfRmGDestRom: resulting-properties={base-type=uint8, sw-calibration-access=READ-ONLY, compu {255=PDUR_NO_FMFIFOINSTANCEROMIDXOFRMGDESTROM}, range raw 0..255}
                FmFifoInstanceRomPartitionIdxOfRmGDestRom: resulting-properties={base-type=uint8, sw-calibration-access=READ-ONLY, compu {255=PDUR_NO_FMFIFOINSTANCEROMPARTITIONIDXOFRMGDESTROM}, range raw 0..255}
                LockRomIdxOfRmGDestRom: resulting-properties={base-type=uint8, sw-calibration-access=READ-ONLY, range raw 0..255}
                MmRomIdxOfRmGDestRom: resulting-properties={base-type=uint8, sw-calibration-access=READ-ONLY, range raw 0..255}
                RmDestRomIdxOfRmGDestRom: resulting-properties={base-type=uint8, sw-calibration-access=READ-ONLY, range raw 0..255}
                RmGDestTpTxStateRamIdxOfRmGDestRom: resulting-properties={base-type=uint8, sw-calibration-access=READ-ONLY, compu {255=PDUR_NO_RMGDESTTPTXSTATERAMIDXOFRMGDESTROM}, range raw 0..255}
                RmGDestTpTxStateRamPartitionIdxOfRmGDestRom: resulting-properties={base-type=uint8, sw-calibration-access=READ-ONLY, compu {255=PDUR_NO_RMGDESTTPTXSTATERAMPARTITIONIDXOFRMGDESTROM}, range raw 0..255}
            Element_137: symbol=[137]
              10 x mc data instance, all with category=VALUE:
                MaxPduLengthOfRmGDestRom: resulting-properties={base-type=uint16, sw-calibration-access=READ-ONLY, range raw 0..65535}
                DestHndOfRmGDestRom: resulting-properties={base-type=uint8, sw-calibration-access=READ-ONLY, compu {255=PDUR_NO_DESTHNDOFRMGDESTROM}, range raw 0..255}
                DirectionOfRmGDestRom: resulting-properties={base-type=uint8, sw-calibration-access=READ-ONLY, compu {0=PDUR_RX_DIRECTIONOFRMGDESTROM, 1=PDUR_TX_DIRECTIONOFRMGDESTROM}, range raw 0..255}
                FmFifoInstanceRomIdxOfRmGDestRom: resulting-properties={base-type=uint8, sw-calibration-access=READ-ONLY, compu {255=PDUR_NO_FMFIFOINSTANCEROMIDXOFRMGDESTROM}, range raw 0..255}
                FmFifoInstanceRomPartitionIdxOfRmGDestRom: resulting-properties={base-type=uint8, sw-calibration-access=READ-ONLY, compu {255=PDUR_NO_FMFIFOINSTANCEROMPARTITIONIDXOFRMGDESTROM}, range raw 0..255}
                LockRomIdxOfRmGDestRom: resulting-properties={base-type=uint8, sw-calibration-access=READ-ONLY, range raw 0..255}
                MmRomIdxOfRmGDestRom: resulting-properties={base-type=uint8, sw-calibration-access=READ-ONLY, range raw 0..255}
                RmDestRomIdxOfRmGDestRom: resulting-properties={base-type=uint8, sw-calibration-access=READ-ONLY, range raw 0..255}
                RmGDestTpTxStateRamIdxOfRmGDestRom: resulting-properties={base-type=uint8, sw-calibration-access=READ-ONLY, compu {255=PDUR_NO_RMGDESTTPTXSTATERAMIDXOFRMGDESTROM}, range raw 0..255}
                RmGDestTpTxStateRamPartitionIdxOfRmGDestRom: resulting-properties={base-type=uint8, sw-calibration-access=READ-ONLY, compu {255=PDUR_NO_RMGDESTTPTXSTATERAMPARTITIONIDXOFRMGDESTROM}, range raw 0..255}
            Element_138: symbol=[138]
              10 x mc data instance, all with category=VALUE:
                MaxPduLengthOfRmGDestRom: resulting-properties={base-type=uint16, sw-calibration-access=READ-ONLY, range raw 0..65535}
                DestHndOfRmGDestRom: resulting-properties={base-type=uint8, sw-calibration-access=READ-ONLY, compu {255=PDUR_NO_DESTHNDOFRMGDESTROM}, range raw 0..255}
                DirectionOfRmGDestRom: resulting-properties={base-type=uint8, sw-calibration-access=READ-ONLY, compu {0=PDUR_RX_DIRECTIONOFRMGDESTROM, 1=PDUR_TX_DIRECTIONOFRMGDESTROM}, range raw 0..255}
                FmFifoInstanceRomIdxOfRmGDestRom: resulting-properties={base-type=uint8, sw-calibration-access=READ-ONLY, compu {255=PDUR_NO_FMFIFOINSTANCEROMIDXOFRMGDESTROM}, range raw 0..255}
                FmFifoInstanceRomPartitionIdxOfRmGDestRom: resulting-properties={base-type=uint8, sw-calibration-access=READ-ONLY, compu {255=PDUR_NO_FMFIFOINSTANCEROMPARTITIONIDXOFRMGDESTROM}, range raw 0..255}
                LockRomIdxOfRmGDestRom: resulting-properties={base-type=uint8, sw-calibration-access=READ-ONLY, range raw 0..255}
                MmRomIdxOfRmGDestRom: resulting-properties={base-type=uint8, sw-calibration-access=READ-ONLY, range raw 0..255}
                RmDestRomIdxOfRmGDestRom: resulting-properties={base-type=uint8, sw-calibration-access=READ-ONLY, range raw 0..255}
                RmGDestTpTxStateRamIdxOfRmGDestRom: resulting-properties={base-type=uint8, sw-calibration-access=READ-ONLY, compu {255=PDUR_NO_RMGDESTTPTXSTATERAMIDXOFRMGDESTROM}, range raw 0..255}
                RmGDestTpTxStateRamPartitionIdxOfRmGDestRom: resulting-properties={base-type=uint8, sw-calibration-access=READ-ONLY, compu {255=PDUR_NO_RMGDESTTPTXSTATERAMPARTITIONIDXOFRMGDESTROM}, range raw 0..255}
            Element_139: symbol=[139]
              10 x mc data instance, all with category=VALUE:
                MaxPduLengthOfRmGDestRom: resulting-properties={base-type=uint16, sw-calibration-access=READ-ONLY, range raw 0..65535}
                DestHndOfRmGDestRom: resulting-properties={base-type=uint8, sw-calibration-access=READ-ONLY, compu {255=PDUR_NO_DESTHNDOFRMGDESTROM}, range raw 0..255}
                DirectionOfRmGDestRom: resulting-properties={base-type=uint8, sw-calibration-access=READ-ONLY, compu {0=PDUR_RX_DIRECTIONOFRMGDESTROM, 1=PDUR_TX_DIRECTIONOFRMGDESTROM}, range raw 0..255}
                FmFifoInstanceRomIdxOfRmGDestRom: resulting-properties={base-type=uint8, sw-calibration-access=READ-ONLY, compu {255=PDUR_NO_FMFIFOINSTANCEROMIDXOFRMGDESTROM}, range raw 0..255}
                FmFifoInstanceRomPartitionIdxOfRmGDestRom: resulting-properties={base-type=uint8, sw-calibration-access=READ-ONLY, compu {255=PDUR_NO_FMFIFOINSTANCEROMPARTITIONIDXOFRMGDESTROM}, range raw 0..255}
                LockRomIdxOfRmGDestRom: resulting-properties={base-type=uint8, sw-calibration-access=READ-ONLY, range raw 0..255}
                MmRomIdxOfRmGDestRom: resulting-properties={base-type=uint8, sw-calibration-access=READ-ONLY, range raw 0..255}
                RmDestRomIdxOfRmGDestRom: resulting-properties={base-type=uint8, sw-calibration-access=READ-ONLY, range raw 0..255}
                RmGDestTpTxStateRamIdxOfRmGDestRom: resulting-properties={base-type=uint8, sw-calibration-access=READ-ONLY, compu {255=PDUR_NO_RMGDESTTPTXSTATERAMIDXOFRMGDESTROM}, range raw 0..255}
                RmGDestTpTxStateRamPartitionIdxOfRmGDestRom: resulting-properties={base-type=uint8, sw-calibration-access=READ-ONLY, compu {255=PDUR_NO_RMGDESTTPTXSTATERAMPARTITIONIDXOFRMGDESTROM}, range raw 0..255}
            Element_140: symbol=[140]
              10 x mc data instance, all with category=VALUE:
                MaxPduLengthOfRmGDestRom: resulting-properties={base-type=uint16, sw-calibration-access=READ-ONLY, range raw 0..65535}
                DestHndOfRmGDestRom: resulting-properties={base-type=uint8, sw-calibration-access=READ-ONLY, compu {255=PDUR_NO_DESTHNDOFRMGDESTROM}, range raw 0..255}
                DirectionOfRmGDestRom: resulting-properties={base-type=uint8, sw-calibration-access=READ-ONLY, compu {0=PDUR_RX_DIRECTIONOFRMGDESTROM, 1=PDUR_TX_DIRECTIONOFRMGDESTROM}, range raw 0..255}
                FmFifoInstanceRomIdxOfRmGDestRom: resulting-properties={base-type=uint8, sw-calibration-access=READ-ONLY, compu {255=PDUR_NO_FMFIFOINSTANCEROMIDXOFRMGDESTROM}, range raw 0..255}
                FmFifoInstanceRomPartitionIdxOfRmGDestRom: resulting-properties={base-type=uint8, sw-calibration-access=READ-ONLY, compu {255=PDUR_NO_FMFIFOINSTANCEROMPARTITIONIDXOFRMGDESTROM}, range raw 0..255}
                LockRomIdxOfRmGDestRom: resulting-properties={base-type=uint8, sw-calibration-access=READ-ONLY, range raw 0..255}
                MmRomIdxOfRmGDestRom: resulting-properties={base-type=uint8, sw-calibration-access=READ-ONLY, range raw 0..255}
                RmDestRomIdxOfRmGDestRom: resulting-properties={base-type=uint8, sw-calibration-access=READ-ONLY, range raw 0..255}
                RmGDestTpTxStateRamIdxOfRmGDestRom: resulting-properties={base-type=uint8, sw-calibration-access=READ-ONLY, compu {255=PDUR_NO_RMGDESTTPTXSTATERAMIDXOFRMGDESTROM}, range raw 0..255}
                RmGDestTpTxStateRamPartitionIdxOfRmGDestRom: resulting-properties={base-type=uint8, sw-calibration-access=READ-ONLY, compu {255=PDUR_NO_RMGDESTTPTXSTATERAMPARTITIONIDXOFRMGDESTROM}, range raw 0..255}
            Element_141: symbol=[141]
              10 x mc data instance, all with category=VALUE:
                MaxPduLengthOfRmGDestRom: resulting-properties={base-type=uint16, sw-calibration-access=READ-ONLY, range raw 0..65535}
                DestHndOfRmGDestRom: resulting-properties={base-type=uint8, sw-calibration-access=READ-ONLY, compu {255=PDUR_NO_DESTHNDOFRMGDESTROM}, range raw 0..255}
                DirectionOfRmGDestRom: resulting-properties={base-type=uint8, sw-calibration-access=READ-ONLY, compu {0=PDUR_RX_DIRECTIONOFRMGDESTROM, 1=PDUR_TX_DIRECTIONOFRMGDESTROM}, range raw 0..255}
                FmFifoInstanceRomIdxOfRmGDestRom: resulting-properties={base-type=uint8, sw-calibration-access=READ-ONLY, compu {255=PDUR_NO_FMFIFOINSTANCEROMIDXOFRMGDESTROM}, range raw 0..255}
                FmFifoInstanceRomPartitionIdxOfRmGDestRom: resulting-properties={base-type=uint8, sw-calibration-access=READ-ONLY, compu {255=PDUR_NO_FMFIFOINSTANCEROMPARTITIONIDXOFRMGDESTROM}, range raw 0..255}
                LockRomIdxOfRmGDestRom: resulting-properties={base-type=uint8, sw-calibration-access=READ-ONLY, range raw 0..255}
                MmRomIdxOfRmGDestRom: resulting-properties={base-type=uint8, sw-calibration-access=READ-ONLY, range raw 0..255}
                RmDestRomIdxOfRmGDestRom: resulting-properties={base-type=uint8, sw-calibration-access=READ-ONLY, range raw 0..255}
                RmGDestTpTxStateRamIdxOfRmGDestRom: resulting-properties={base-type=uint8, sw-calibration-access=READ-ONLY, compu {255=PDUR_NO_RMGDESTTPTXSTATERAMIDXOFRMGDESTROM}, range raw 0..255}
                RmGDestTpTxStateRamPartitionIdxOfRmGDestRom: resulting-properties={base-type=uint8, sw-calibration-access=READ-ONLY, compu {255=PDUR_NO_RMGDESTTPTXSTATERAMPARTITIONIDXOFRMGDESTROM}, range raw 0..255}
            Element_142: symbol=[142]
              10 x mc data instance, all with category=VALUE:
                MaxPduLengthOfRmGDestRom: resulting-properties={base-type=uint16, sw-calibration-access=READ-ONLY, range raw 0..65535}
                DestHndOfRmGDestRom: resulting-properties={base-type=uint8, sw-calibration-access=READ-ONLY, compu {255=PDUR_NO_DESTHNDOFRMGDESTROM}, range raw 0..255}
                DirectionOfRmGDestRom: resulting-properties={base-type=uint8, sw-calibration-access=READ-ONLY, compu {0=PDUR_RX_DIRECTIONOFRMGDESTROM, 1=PDUR_TX_DIRECTIONOFRMGDESTROM}, range raw 0..255}
                FmFifoInstanceRomIdxOfRmGDestRom: resulting-properties={base-type=uint8, sw-calibration-access=READ-ONLY, compu {255=PDUR_NO_FMFIFOINSTANCEROMIDXOFRMGDESTROM}, range raw 0..255}
                FmFifoInstanceRomPartitionIdxOfRmGDestRom: resulting-properties={base-type=uint8, sw-calibration-access=READ-ONLY, compu {255=PDUR_NO_FMFIFOINSTANCEROMPARTITIONIDXOFRMGDESTROM}, range raw 0..255}
                LockRomIdxOfRmGDestRom: resulting-properties={base-type=uint8, sw-calibration-access=READ-ONLY, range raw 0..255}
                MmRomIdxOfRmGDestRom: resulting-properties={base-type=uint8, sw-calibration-access=READ-ONLY, range raw 0..255}
                RmDestRomIdxOfRmGDestRom: resulting-properties={base-type=uint8, sw-calibration-access=READ-ONLY, range raw 0..255}
                RmGDestTpTxStateRamIdxOfRmGDestRom: resulting-properties={base-type=uint8, sw-calibration-access=READ-ONLY, compu {255=PDUR_NO_RMGDESTTPTXSTATERAMIDXOFRMGDESTROM}, range raw 0..255}
                RmGDestTpTxStateRamPartitionIdxOfRmGDestRom: resulting-properties={base-type=uint8, sw-calibration-access=READ-ONLY, compu {255=PDUR_NO_RMGDESTTPTXSTATERAMPARTITIONIDXOFRMGDESTROM}, range raw 0..255}
            Element_143: symbol=[143]
              10 x mc data instance, all with category=VALUE:
                MaxPduLengthOfRmGDestRom: resulting-properties={base-type=uint16, sw-calibration-access=READ-ONLY, range raw 0..65535}
                DestHndOfRmGDestRom: resulting-properties={base-type=uint8, sw-calibration-access=READ-ONLY, compu {255=PDUR_NO_DESTHNDOFRMGDESTROM}, range raw 0..255}
                DirectionOfRmGDestRom: resulting-properties={base-type=uint8, sw-calibration-access=READ-ONLY, compu {0=PDUR_RX_DIRECTIONOFRMGDESTROM, 1=PDUR_TX_DIRECTIONOFRMGDESTROM}, range raw 0..255}
                FmFifoInstanceRomIdxOfRmGDestRom: resulting-properties={base-type=uint8, sw-calibration-access=READ-ONLY, compu {255=PDUR_NO_FMFIFOINSTANCEROMIDXOFRMGDESTROM}, range raw 0..255}
                FmFifoInstanceRomPartitionIdxOfRmGDestRom: resulting-properties={base-type=uint8, sw-calibration-access=READ-ONLY, compu {255=PDUR_NO_FMFIFOINSTANCEROMPARTITIONIDXOFRMGDESTROM}, range raw 0..255}
                LockRomIdxOfRmGDestRom: resulting-properties={base-type=uint8, sw-calibration-access=READ-ONLY, range raw 0..255}
                MmRomIdxOfRmGDestRom: resulting-properties={base-type=uint8, sw-calibration-access=READ-ONLY, range raw 0..255}
                RmDestRomIdxOfRmGDestRom: resulting-properties={base-type=uint8, sw-calibration-access=READ-ONLY, range raw 0..255}
                RmGDestTpTxStateRamIdxOfRmGDestRom: resulting-properties={base-type=uint8, sw-calibration-access=READ-ONLY, compu {255=PDUR_NO_RMGDESTTPTXSTATERAMIDXOFRMGDESTROM}, range raw 0..255}
                RmGDestTpTxStateRamPartitionIdxOfRmGDestRom: resulting-properties={base-type=uint8, sw-calibration-access=READ-ONLY, compu {255=PDUR_NO_RMGDESTTPTXSTATERAMPARTITIONIDXOFRMGDESTROM}, range raw 0..255}
            Element_144: symbol=[144]
              10 x mc data instance, all with category=VALUE:
                MaxPduLengthOfRmGDestRom: resulting-properties={base-type=uint16, sw-calibration-access=READ-ONLY, range raw 0..65535}
                DestHndOfRmGDestRom: resulting-properties={base-type=uint8, sw-calibration-access=READ-ONLY, compu {255=PDUR_NO_DESTHNDOFRMGDESTROM}, range raw 0..255}
                DirectionOfRmGDestRom: resulting-properties={base-type=uint8, sw-calibration-access=READ-ONLY, compu {0=PDUR_RX_DIRECTIONOFRMGDESTROM, 1=PDUR_TX_DIRECTIONOFRMGDESTROM}, range raw 0..255}
                FmFifoInstanceRomIdxOfRmGDestRom: resulting-properties={base-type=uint8, sw-calibration-access=READ-ONLY, compu {255=PDUR_NO_FMFIFOINSTANCEROMIDXOFRMGDESTROM}, range raw 0..255}
                FmFifoInstanceRomPartitionIdxOfRmGDestRom: resulting-properties={base-type=uint8, sw-calibration-access=READ-ONLY, compu {255=PDUR_NO_FMFIFOINSTANCEROMPARTITIONIDXOFRMGDESTROM}, range raw 0..255}
                LockRomIdxOfRmGDestRom: resulting-properties={base-type=uint8, sw-calibration-access=READ-ONLY, range raw 0..255}
                MmRomIdxOfRmGDestRom: resulting-properties={base-type=uint8, sw-calibration-access=READ-ONLY, range raw 0..255}
                RmDestRomIdxOfRmGDestRom: resulting-properties={base-type=uint8, sw-calibration-access=READ-ONLY, range raw 0..255}
                RmGDestTpTxStateRamIdxOfRmGDestRom: resulting-properties={base-type=uint8, sw-calibration-access=READ-ONLY, compu {255=PDUR_NO_RMGDESTTPTXSTATERAMIDXOFRMGDESTROM}, range raw 0..255}
                RmGDestTpTxStateRamPartitionIdxOfRmGDestRom: resulting-properties={base-type=uint8, sw-calibration-access=READ-ONLY, compu {255=PDUR_NO_RMGDESTTPTXSTATERAMPARTITIONIDXOFRMGDESTROM}, range raw 0..255}
            Element_145: symbol=[145]
              10 x mc data instance, all with category=VALUE:
                MaxPduLengthOfRmGDestRom: resulting-properties={base-type=uint16, sw-calibration-access=READ-ONLY, range raw 0..65535}
                DestHndOfRmGDestRom: resulting-properties={base-type=uint8, sw-calibration-access=READ-ONLY, compu {255=PDUR_NO_DESTHNDOFRMGDESTROM}, range raw 0..255}
                DirectionOfRmGDestRom: resulting-properties={base-type=uint8, sw-calibration-access=READ-ONLY, compu {0=PDUR_RX_DIRECTIONOFRMGDESTROM, 1=PDUR_TX_DIRECTIONOFRMGDESTROM}, range raw 0..255}
                FmFifoInstanceRomIdxOfRmGDestRom: resulting-properties={base-type=uint8, sw-calibration-access=READ-ONLY, compu {255=PDUR_NO_FMFIFOINSTANCEROMIDXOFRMGDESTROM}, range raw 0..255}
                FmFifoInstanceRomPartitionIdxOfRmGDestRom: resulting-properties={base-type=uint8, sw-calibration-access=READ-ONLY, compu {255=PDUR_NO_FMFIFOINSTANCEROMPARTITIONIDXOFRMGDESTROM}, range raw 0..255}
                LockRomIdxOfRmGDestRom: resulting-properties={base-type=uint8, sw-calibration-access=READ-ONLY, range raw 0..255}
                MmRomIdxOfRmGDestRom: resulting-properties={base-type=uint8, sw-calibration-access=READ-ONLY, range raw 0..255}
                RmDestRomIdxOfRmGDestRom: resulting-properties={base-type=uint8, sw-calibration-access=READ-ONLY, range raw 0..255}
                RmGDestTpTxStateRamIdxOfRmGDestRom: resulting-properties={base-type=uint8, sw-calibration-access=READ-ONLY, compu {255=PDUR_NO_RMGDESTTPTXSTATERAMIDXOFRMGDESTROM}, range raw 0..255}
                RmGDestTpTxStateRamPartitionIdxOfRmGDestRom: resulting-properties={base-type=uint8, sw-calibration-access=READ-ONLY, compu {255=PDUR_NO_RMGDESTTPTXSTATERAMPARTITIONIDXOFRMGDESTROM}, range raw 0..255}
            Element_146: symbol=[146]
              10 x mc data instance, all with category=VALUE:
                MaxPduLengthOfRmGDestRom: resulting-properties={base-type=uint16, sw-calibration-access=READ-ONLY, range raw 0..65535}
                DestHndOfRmGDestRom: resulting-properties={base-type=uint8, sw-calibration-access=READ-ONLY, compu {255=PDUR_NO_DESTHNDOFRMGDESTROM}, range raw 0..255}
                DirectionOfRmGDestRom: resulting-properties={base-type=uint8, sw-calibration-access=READ-ONLY, compu {0=PDUR_RX_DIRECTIONOFRMGDESTROM, 1=PDUR_TX_DIRECTIONOFRMGDESTROM}, range raw 0..255}
                FmFifoInstanceRomIdxOfRmGDestRom: resulting-properties={base-type=uint8, sw-calibration-access=READ-ONLY, compu {255=PDUR_NO_FMFIFOINSTANCEROMIDXOFRMGDESTROM}, range raw 0..255}
                FmFifoInstanceRomPartitionIdxOfRmGDestRom: resulting-properties={base-type=uint8, sw-calibration-access=READ-ONLY, compu {255=PDUR_NO_FMFIFOINSTANCEROMPARTITIONIDXOFRMGDESTROM}, range raw 0..255}
                LockRomIdxOfRmGDestRom: resulting-properties={base-type=uint8, sw-calibration-access=READ-ONLY, range raw 0..255}
                MmRomIdxOfRmGDestRom: resulting-properties={base-type=uint8, sw-calibration-access=READ-ONLY, range raw 0..255}
                RmDestRomIdxOfRmGDestRom: resulting-properties={base-type=uint8, sw-calibration-access=READ-ONLY, range raw 0..255}
                RmGDestTpTxStateRamIdxOfRmGDestRom: resulting-properties={base-type=uint8, sw-calibration-access=READ-ONLY, compu {255=PDUR_NO_RMGDESTTPTXSTATERAMIDXOFRMGDESTROM}, range raw 0..255}
                RmGDestTpTxStateRamPartitionIdxOfRmGDestRom: resulting-properties={base-type=uint8, sw-calibration-access=READ-ONLY, compu {255=PDUR_NO_RMGDESTTPTXSTATERAMPARTITIONIDXOFRMGDESTROM}, range raw 0..255}
            Element_147: symbol=[147]
              10 x mc data instance, all with category=VALUE:
                MaxPduLengthOfRmGDestRom: resulting-properties={base-type=uint16, sw-calibration-access=READ-ONLY, range raw 0..65535}
                DestHndOfRmGDestRom: resulting-properties={base-type=uint8, sw-calibration-access=READ-ONLY, compu {255=PDUR_NO_DESTHNDOFRMGDESTROM}, range raw 0..255}
                DirectionOfRmGDestRom: resulting-properties={base-type=uint8, sw-calibration-access=READ-ONLY, compu {0=PDUR_RX_DIRECTIONOFRMGDESTROM, 1=PDUR_TX_DIRECTIONOFRMGDESTROM}, range raw 0..255}
                FmFifoInstanceRomIdxOfRmGDestRom: resulting-properties={base-type=uint8, sw-calibration-access=READ-ONLY, compu {255=PDUR_NO_FMFIFOINSTANCEROMIDXOFRMGDESTROM}, range raw 0..255}
                FmFifoInstanceRomPartitionIdxOfRmGDestRom: resulting-properties={base-type=uint8, sw-calibration-access=READ-ONLY, compu {255=PDUR_NO_FMFIFOINSTANCEROMPARTITIONIDXOFRMGDESTROM}, range raw 0..255}
                LockRomIdxOfRmGDestRom: resulting-properties={base-type=uint8, sw-calibration-access=READ-ONLY, range raw 0..255}
                MmRomIdxOfRmGDestRom: resulting-properties={base-type=uint8, sw-calibration-access=READ-ONLY, range raw 0..255}
                RmDestRomIdxOfRmGDestRom: resulting-properties={base-type=uint8, sw-calibration-access=READ-ONLY, range raw 0..255}
                RmGDestTpTxStateRamIdxOfRmGDestRom: resulting-properties={base-type=uint8, sw-calibration-access=READ-ONLY, compu {255=PDUR_NO_RMGDESTTPTXSTATERAMIDXOFRMGDESTROM}, range raw 0..255}
                RmGDestTpTxStateRamPartitionIdxOfRmGDestRom: resulting-properties={base-type=uint8, sw-calibration-access=READ-ONLY, compu {255=PDUR_NO_RMGDESTTPTXSTATERAMPARTITIONIDXOFRMGDESTROM}, range raw 0..255}
            Element_148: symbol=[148]
              10 x mc data instance, all with category=VALUE:
                MaxPduLengthOfRmGDestRom: resulting-properties={base-type=uint16, sw-calibration-access=READ-ONLY, range raw 0..65535}
                DestHndOfRmGDestRom: resulting-properties={base-type=uint8, sw-calibration-access=READ-ONLY, compu {255=PDUR_NO_DESTHNDOFRMGDESTROM}, range raw 0..255}
                DirectionOfRmGDestRom: resulting-properties={base-type=uint8, sw-calibration-access=READ-ONLY, compu {0=PDUR_RX_DIRECTIONOFRMGDESTROM, 1=PDUR_TX_DIRECTIONOFRMGDESTROM}, range raw 0..255}
                FmFifoInstanceRomIdxOfRmGDestRom: resulting-properties={base-type=uint8, sw-calibration-access=READ-ONLY, compu {255=PDUR_NO_FMFIFOINSTANCEROMIDXOFRMGDESTROM}, range raw 0..255}
                FmFifoInstanceRomPartitionIdxOfRmGDestRom: resulting-properties={base-type=uint8, sw-calibration-access=READ-ONLY, compu {255=PDUR_NO_FMFIFOINSTANCEROMPARTITIONIDXOFRMGDESTROM}, range raw 0..255}
                LockRomIdxOfRmGDestRom: resulting-properties={base-type=uint8, sw-calibration-access=READ-ONLY, range raw 0..255}
                MmRomIdxOfRmGDestRom: resulting-properties={base-type=uint8, sw-calibration-access=READ-ONLY, range raw 0..255}
                RmDestRomIdxOfRmGDestRom: resulting-properties={base-type=uint8, sw-calibration-access=READ-ONLY, range raw 0..255}
                RmGDestTpTxStateRamIdxOfRmGDestRom: resulting-properties={base-type=uint8, sw-calibration-access=READ-ONLY, compu {255=PDUR_NO_RMGDESTTPTXSTATERAMIDXOFRMGDESTROM}, range raw 0..255}
                RmGDestTpTxStateRamPartitionIdxOfRmGDestRom: resulting-properties={base-type=uint8, sw-calibration-access=READ-ONLY, compu {255=PDUR_NO_RMGDESTTPTXSTATERAMPARTITIONIDXOFRMGDESTROM}, range raw 0..255}
