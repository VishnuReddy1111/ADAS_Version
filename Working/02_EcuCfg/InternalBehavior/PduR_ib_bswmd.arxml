[part 3 of 4: package /MICROSAR]
AUTOSAR XML (schema 4-3-0)
package /MICROSAR  (continued)
  bsw implementation PduR_Impl: programming-language=C, sw-version=17.02.01, used-code-generator=DaVinci Configurator, vendor-id=30, ar-release-version=4.01.02  (continued)
    mc-variable-instances:  (continued)
      41 x mc data instance, all with category=ARRAY:  (continued)
        PduR_RmGDestRom: array-size=151  (continued)
          151 x mc data instance, all with category=STRUCTURE:  (continued)
            Element_149: symbol=[149]
              10 x mc data instance, all with category=VALUE:
                MaxPduLengthOfRmGDestRom: resulting-properties={base-type=uint16, sw-calibration-access=READ-ONLY, range raw 0..65535}
                DestHndOfRmGDestRom: resulting-properties={base-type=uint8, sw-calibration-access=READ-ONLY, compu {255=PDUR_NO_DESTHNDOFRMGDESTROM}, range raw 0..255}
                DirectionOfRmGDestRom: resulting-properties={base-type=uint8, sw-calibration-access=READ-ONLY, compu {0=PDUR_RX_DIRECTIONOFRMGDESTROM, 1=PDUR_TX_DIRECTIONOFRMGDESTROM}, range raw 0..255}
                FmFifoInstanceRomIdxOfRmGDestRom: resulting-properties={base-type=uint8, sw-calibration-access=READ-ONLY, compu {255=PDUR_NO_FMFIFOINSTANCEROMIDXOFRMGDESTROM}, range raw 0..255}
                FmFifoInstanceRomPartitionIdxOfRmGDestRom: resulting-properties={base-type=uint8, sw-calibration-access=READ-ONLY, compu {255=PDUR_NO_FMFIFOINSTANCEROMPARTITIONIDXOFRMGDESTROM}, range raw 0..255}
                LockRomIdxOfRmGDestRom: resulting-properties={base-type=uint8, sw-calibration-access=READ-ONLY, range raw 0..255}
                MmRomIdxOfRmGDestRom: resulting-properties={base-type=uint8, sw-calibration-access=READ-ONLY, range raw 0..255}
                RmDestRomIdxOfRmGDestRom: resulting-properties={base-type=uint8, sw-calibration-access=READ-ONLY, range raw 0..255}
                RmGDestTpTxStateRamIdxOfRmGDestRom: resulting-properties={base-type=uint8, sw-calibration-access=READ-ONLY, compu {255=PDUR_NO_RMGDESTTPTXSTATERAMIDXOFRMGDESTROM}, range raw 0..255}
                RmGDestTpTxStateRamPartitionIdxOfRmGDestRom: resulting-properties={base-type=uint8, sw-calibration-access=READ-ONLY, compu {255=PDUR_NO_RMGDESTTPTXSTATERAMPARTITIONIDXOFRMGDESTROM}, range raw 0..255}
            Element_150: symbol=[150]
              10 x mc data instance, all with category=VALUE:
                MaxPduLengthOfRmGDestRom: resulting-properties={base-type=uint16, sw-calibration-access=READ-ONLY, range raw 0..65535}
                DestHndOfRmGDestRom: resulting-properties={base-type=uint8, sw-calibration-access=READ-ONLY, compu {255=PDUR_NO_DESTHNDOFRMGDESTROM}, range raw 0..255}
                DirectionOfRmGDestRom: resulting-properties={base-type=uint8, sw-calibration-access=READ-ONLY, compu {0=PDUR_RX_DIRECTIONOFRMGDESTROM, 1=PDUR_TX_DIRECTIONOFRMGDESTROM}, range raw 0..255}
                FmFifoInstanceRomIdxOfRmGDestRom: resulting-properties={base-type=uint8, sw-calibration-access=READ-ONLY, compu {255=PDUR_NO_FMFIFOINSTANCEROMIDXOFRMGDESTROM}, range raw 0..255}
                FmFifoInstanceRomPartitionIdxOfRmGDestRom: resulting-properties={base-type=uint8, sw-calibration-access=READ-ONLY, compu {255=PDUR_NO_FMFIFOINSTANCEROMPARTITIONIDXOFRMGDESTROM}, range raw 0..255}
                LockRomIdxOfRmGDestRom: resulting-properties={base-type=uint8, sw-calibration-access=READ-ONLY, range raw 0..255}
                MmRomIdxOfRmGDestRom: resulting-properties={base-type=uint8, sw-calibration-access=READ-ONLY, range raw 0..255}
                RmDestRomIdxOfRmGDestRom: resulting-properties={base-type=uint8, sw-calibration-access=READ-ONLY, range raw 0..255}
                RmGDestTpTxStateRamIdxOfRmGDestRom: resulting-properties={base-type=uint8, sw-calibration-access=READ-ONLY, compu {255=PDUR_NO_RMGDESTTPTXSTATERAMIDXOFRMGDESTROM}, range raw 0..255}
                RmGDestTpTxStateRamPartitionIdxOfRmGDestRom: resulting-properties={base-type=uint8, sw-calibration-access=READ-ONLY, compu {255=PDUR_NO_RMGDESTTPTXSTATERAMPARTITIONIDXOFRMGDESTROM}, range raw 0..255}
        PduR_RmSrcRom: array-size=142  # PduR RoutiongManager SrcPdu Table
          142 x mc data instance, all with category=STRUCTURE:
            Element_0: symbol=[0]
              8 x mc data instance, all with category=VALUE:
                LockRomIdxOfRmSrcRom: resulting-properties={base-type=uint8, sw-calibration-access=READ-ONLY, range raw 0..255}
                MaskedBitsOfRmSrcRom: resulting-properties={base-type=uint8, sw-calibration-access=READ-ONLY, range raw 0..255}
                MmRomIdxOfRmSrcRom: resulting-properties={base-type=uint8, sw-calibration-access=READ-ONLY, range raw 0..255}
                RmBufferedTpPropertiesRomIdxOfRmSrcRom: resulting-properties={base-type=uint8, sw-calibration-access=READ-ONLY, compu {255=PDUR_NO_RMBUFFEREDTPPROPERTIESROMIDXOFRMSRCROM}, range raw 0..255}
                RmBufferedTpPropertiesRomPartitionIdxOfRmSrcRom: resulting-properties={base-type=uint8, sw-calibration-access=READ-ONLY, compu {255=PDUR_NO_RMBUFFEREDTPPROPERTIESROMPARTITIONIDXOFRMSRCROM}, range raw 0..255}
                RmDestRomEndIdxOfRmSrcRom: resulting-properties={base-type=uint8, sw-calibration-access=READ-ONLY, range raw 0..255}
                RmDestRomStartIdxOfRmSrcRom: resulting-properties={base-type=uint8, sw-calibration-access=READ-ONLY, range raw 0..255}
                SrcHndOfRmSrcRom: resulting-properties={base-type=uint8, sw-calibration-access=READ-ONLY, compu {255=PDUR_NO_SRCHNDOFRMSRCROM}, range raw 0..255}
            Element_1: symbol=[1]
              8 x mc data instance, all with category=VALUE:
                LockRomIdxOfRmSrcRom: resulting-properties={base-type=uint8, sw-calibration-access=READ-ONLY, range raw 0..255}
                MaskedBitsOfRmSrcRom: resulting-properties={base-type=uint8, sw-calibration-access=READ-ONLY, range raw 0..255}
                MmRomIdxOfRmSrcRom: resulting-properties={base-type=uint8, sw-calibration-access=READ-ONLY, range raw 0..255}
                RmBufferedTpPropertiesRomIdxOfRmSrcRom: resulting-properties={base-type=uint8, sw-calibration-access=READ-ONLY, compu {255=PDUR_NO_RMBUFFEREDTPPROPERTIESROMIDXOFRMSRCROM}, range raw 0..255}
                RmBufferedTpPropertiesRomPartitionIdxOfRmSrcRom: resulting-properties={base-type=uint8, sw-calibration-access=READ-ONLY, compu {255=PDUR_NO_RMBUFFEREDTPPROPERTIESROMPARTITIONIDXOFRMSRCROM}, range raw 0..255}
                RmDestRomEndIdxOfRmSrcRom: resulting-properties={base-type=uint8, sw-calibration-access=READ-ONLY, range raw 0..255}
                RmDestRomStartIdxOfRmSrcRom: resulting-properties={base-type=uint8, sw-calibration-access=READ-ONLY, range raw 0..255}
                SrcHndOfRmSrcRom: resulting-properties={base-type=uint8, sw-calibration-access=READ-ONLY, compu {255=PDUR_NO_SRCHNDOFRMSRCROM}, range raw 0..255}
            Element_2: symbol=[2]
              8 x mc data instance, all with category=VALUE:
                LockRomIdxOfRmSrcRom: resulting-properties={base-type=uint8, sw-calibration-access=READ-ONLY, range raw 0..255}
                MaskedBitsOfRmSrcRom: resulting-properties={base-type=uint8, sw-calibration-access=READ-ONLY, range raw 0..255}
                MmRomIdxOfRmSrcRom: resulting-properties={base-type=uint8, sw-calibration-access=READ-ONLY, range raw 0..255}
                RmBufferedTpPropertiesRomIdxOfRmSrcRom: resulting-properties={base-type=uint8, sw-calibration-access=READ-ONLY, compu {255=PDUR_NO_RMBUFFEREDTPPROPERTIESROMIDXOFRMSRCROM}, range raw 0..255}
                RmBufferedTpPropertiesRomPartitionIdxOfRmSrcRom: resulting-properties={base-type=uint8, sw-calibration-access=READ-ONLY, compu {255=PDUR_NO_RMBUFFEREDTPPROPERTIESROMPARTITIONIDXOFRMSRCROM}, range raw 0..255}
                RmDestRomEndIdxOfRmSrcRom: resulting-properties={base-type=uint8, sw-calibration-access=READ-ONLY, range raw 0..255}
                RmDestRomStartIdxOfRmSrcRom: resulting-properties={base-type=uint8, sw-calibration-access=READ-ONLY, range raw 0..255}
                SrcHndOfRmSrcRom: resulting-properties={base-type=uint8, sw-calibration-access=READ-ONLY, compu {255=PDUR_NO_SRCHNDOFRMSRCROM}, range raw 0..255}
            Element_3: symbol=[3]
              8 x mc data instance, all with category=VALUE:
                LockRomIdxOfRmSrcRom: resulting-properties={base-type=uint8, sw-calibration-access=READ-ONLY, range raw 0..255}
                MaskedBitsOfRmSrcRom: resulting-properties={base-type=uint8, sw-calibration-access=READ-ONLY, range raw 0..255}
                MmRomIdxOfRmSrcRom: resulting-properties={base-type=uint8, sw-calibration-access=READ-ONLY, range raw 0..255}
                RmBufferedTpPropertiesRomIdxOfRmSrcRom: resulting-properties={base-type=uint8, sw-calibration-access=READ-ONLY, compu {255=PDUR_NO_RMBUFFEREDTPPROPERTIESROMIDXOFRMSRCROM}, range raw 0..255}
                RmBufferedTpPropertiesRomPartitionIdxOfRmSrcRom: resulting-properties={base-type=uint8, sw-calibration-access=READ-ONLY, compu {255=PDUR_NO_RMBUFFEREDTPPROPERTIESROMPARTITIONIDXOFRMSRCROM}, range raw 0..255}
                RmDestRomEndIdxOfRmSrcRom: resulting-properties={base-type=uint8, sw-calibration-access=READ-ONLY, range raw 0..255}
                RmDestRomStartIdxOfRmSrcRom: resulting-properties={base-type=uint8, sw-calibration-access=READ-ONLY, range raw 0..255}
                SrcHndOfRmSrcRom: resulting-properties={base-type=uint8, sw-calibration-access=READ-ONLY, compu {255=PDUR_NO_SRCHNDOFRMSRCROM}, range raw 0..255}
            Element_4: symbol=[4]
              8 x mc data instance, all with category=VALUE:
                LockRomIdxOfRmSrcRom: resulting-properties={base-type=uint8, sw-calibration-access=READ-ONLY, range raw 0..255}
                MaskedBitsOfRmSrcRom: resulting-properties={base-type=uint8, sw-calibration-access=READ-ONLY, range raw 0..255}
                MmRomIdxOfRmSrcRom: resulting-properties={base-type=uint8, sw-calibration-access=READ-ONLY, range raw 0..255}
                RmBufferedTpPropertiesRomIdxOfRmSrcRom: resulting-properties={base-type=uint8, sw-calibration-access=READ-ONLY, compu {255=PDUR_NO_RMBUFFEREDTPPROPERTIESROMIDXOFRMSRCROM}, range raw 0..255}
                RmBufferedTpPropertiesRomPartitionIdxOfRmSrcRom: resulting-properties={base-type=uint8, sw-calibration-access=READ-ONLY, compu {255=PDUR_NO_RMBUFFEREDTPPROPERTIESROMPARTITIONIDXOFRMSRCROM}, range raw 0..255}
                RmDestRomEndIdxOfRmSrcRom: resulting-properties={base-type=uint8, sw-calibration-access=READ-ONLY, range raw 0..255}
                RmDestRomStartIdxOfRmSrcRom: resulting-properties={base-type=uint8, sw-calibration-access=READ-ONLY, range raw 0..255}
                SrcHndOfRmSrcRom: resulting-properties={base-type=uint8, sw-calibration-access=READ-ONLY, compu {255=PDUR_NO_SRCHNDOFRMSRCROM}, range raw 0..255}
            Element_5: symbol=[5]
              8 x mc data instance, all with category=VALUE:
                LockRomIdxOfRmSrcRom: resulting-properties={base-type=uint8, sw-calibration-access=READ-ONLY, range raw 0..255}
                MaskedBitsOfRmSrcRom: resulting-properties={base-type=uint8, sw-calibration-access=READ-ONLY, range raw 0..255}
                MmRomIdxOfRmSrcRom: resulting-properties={base-type=uint8, sw-calibration-access=READ-ONLY, range raw 0..255}
                RmBufferedTpPropertiesRomIdxOfRmSrcRom: resulting-properties={base-type=uint8, sw-calibration-access=READ-ONLY, compu {255=PDUR_NO_RMBUFFEREDTPPROPERTIESROMIDXOFRMSRCROM}, range raw 0..255}
                RmBufferedTpPropertiesRomPartitionIdxOfRmSrcRom: resulting-properties={base-type=uint8, sw-calibration-access=READ-ONLY, compu {255=PDUR_NO_RMBUFFEREDTPPROPERTIESROMPARTITIONIDXOFRMSRCROM}, range raw 0..255}
                RmDestRomEndIdxOfRmSrcRom: resulting-properties={base-type=uint8, sw-calibration-access=READ-ONLY, range raw 0..255}
                RmDestRomStartIdxOfRmSrcRom: resulting-properties={base-type=uint8, sw-calibration-access=READ-ONLY, range raw 0..255}
                SrcHndOfRmSrcRom: resulting-properties={base-type=uint8, sw-calibration-access=READ-ONLY, compu {255=PDUR_NO_SRCHNDOFRMSRCROM}, range raw 0..255}
            Element_6: symbol=[6]
              8 x mc data instance, all with category=VALUE:
                LockRomIdxOfRmSrcRom: resulting-properties={base-type=uint8, sw-calibration-access=READ-ONLY, range raw 0..255}
                MaskedBitsOfRmSrcRom: resulting-properties={base-type=uint8, sw-calibration-access=READ-ONLY, range raw 0..255}
                MmRomIdxOfRmSrcRom: resulting-properties={base-type=uint8, sw-calibration-access=READ-ONLY, range raw 0..255}
                RmBufferedTpPropertiesRomIdxOfRmSrcRom: resulting-properties={base-type=uint8, sw-calibration-access=READ-ONLY, compu {255=PDUR_NO_RMBUFFEREDTPPROPERTIESROMIDXOFRMSRCROM}, range raw 0..255}
                RmBufferedTpPropertiesRomPartitionIdxOfRmSrcRom: resulting-properties={base-type=uint8, sw-calibration-access=READ-ONLY, compu {255=PDUR_NO_RMBUFFEREDTPPROPERTIESROMPARTITIONIDXOFRMSRCROM}, range raw 0..255}
                RmDestRomEndIdxOfRmSrcRom: resulting-properties={base-type=uint8, sw-calibration-access=READ-ONLY, range raw 0..255}
                RmDestRomStartIdxOfRmSrcRom: resulting-properties={base-type=uint8, sw-calibration-access=READ-ONLY, range raw 0..255}
                SrcHndOfRmSrcRom: resulting-properties={base-type=uint8, sw-calibration-access=READ-ONLY, compu {255=PDUR_NO_SRCHNDOFRMSRCROM}, range raw 0..255}
            Element_7: symbol=[7]
              8 x mc data instance, all with category=VALUE:
                LockRomIdxOfRmSrcRom: resulting-properties={base-type=uint8, sw-calibration-access=READ-ONLY, range raw 0..255}
                MaskedBitsOfRmSrcRom: resulting-properties={base-type=uint8, sw-calibration-access=READ-ONLY, range raw 0..255}
                MmRomIdxOfRmSrcRom: resulting-properties={base-type=uint8, sw-calibration-access=READ-ONLY, range raw 0..255}
                RmBufferedTpPropertiesRomIdxOfRmSrcRom: resulting-properties={base-type=uint8, sw-calibration-access=READ-ONLY, compu {255=PDUR_NO_RMBUFFEREDTPPROPERTIESROMIDXOFRMSRCROM}, range raw 0..255}
                RmBufferedTpPropertiesRomPartitionIdxOfRmSrcRom: resulting-properties={base-type=uint8, sw-calibration-access=READ-ONLY, compu {255=PDUR_NO_RMBUFFEREDTPPROPERTIESROMPARTITIONIDXOFRMSRCROM}, range raw 0..255}
                RmDestRomEndIdxOfRmSrcRom: resulting-properties={base-type=uint8, sw-calibration-access=READ-ONLY, range raw 0..255}
                RmDestRomStartIdxOfRmSrcRom: resulting-properties={base-type=uint8, sw-calibration-access=READ-ONLY, range raw 0..255}
                SrcHndOfRmSrcRom: resulting-properties={base-type=uint8, sw-calibration-access=READ-ONLY, compu {255=PDUR_NO_SRCHNDOFRMSRCROM}, range raw 0..255}
            Element_8: symbol=[8]
              8 x mc data instance, all with category=VALUE:
                LockRomIdxOfRmSrcRom: resulting-properties={base-type=uint8, sw-calibration-access=READ-ONLY, range raw 0..255}
                MaskedBitsOfRmSrcRom: resulting-properties={base-type=uint8, sw-calibration-access=READ-ONLY, range raw 0..255}
                MmRomIdxOfRmSrcRom: resulting-properties={base-type=uint8, sw-calibration-access=READ-ONLY, range raw 0..255}
                RmBufferedTpPropertiesRomIdxOfRmSrcRom: resulting-properties={base-type=uint8, sw-calibration-access=READ-ONLY, compu {255=PDUR_NO_RMBUFFEREDTPPROPERTIESROMIDXOFRMSRCROM}, range raw 0..255}
                RmBufferedTpPropertiesRomPartitionIdxOfRmSrcRom: resulting-properties={base-type=uint8, sw-calibration-access=READ-ONLY, compu {255=PDUR_NO_RMBUFFEREDTPPROPERTIESROMPARTITIONIDXOFRMSRCROM}, range raw 0..255}
                RmDestRomEndIdxOfRmSrcRom: resulting-properties={base-type=uint8, sw-calibration-access=READ-ONLY, range raw 0..255}
                RmDestRomStartIdxOfRmSrcRom: resulting-properties={base-type=uint8, sw-calibration-access=READ-ONLY, range raw 0..255}
                SrcHndOfRmSrcRom: resulting-properties={base-type=uint8, sw-calibration-access=READ-ONLY, compu {255=PDUR_NO_SRCHNDOFRMSRCROM}, range raw 0..255}
            Element_9: symbol=[9]
              8 x mc data instance, all with category=VALUE:
                LockRomIdxOfRmSrcRom: resulting-properties={base-type=uint8, sw-calibration-access=READ-ONLY, range raw 0..255}
                MaskedBitsOfRmSrcRom: resulting-properties={base-type=uint8, sw-calibration-access=READ-ONLY, range raw 0..255}
                MmRomIdxOfRmSrcRom: resulting-properties={base-type=uint8, sw-calibration-access=READ-ONLY, range raw 0..255}
                RmBufferedTpPropertiesRomIdxOfRmSrcRom: resulting-properties={base-type=uint8, sw-calibration-access=READ-ONLY, compu {255=PDUR_NO_RMBUFFEREDTPPROPERTIESROMIDXOFRMSRCROM}, range raw 0..255}
                RmBufferedTpPropertiesRomPartitionIdxOfRmSrcRom: resulting-properties={base-type=uint8, sw-calibration-access=READ-ONLY, compu {255=PDUR_NO_RMBUFFEREDTPPROPERTIESROMPARTITIONIDXOFRMSRCROM}, range raw 0..255}
                RmDestRomEndIdxOfRmSrcRom: resulting-properties={base-type=uint8, sw-calibration-access=READ-ONLY, range raw 0..255}
                RmDestRomStartIdxOfRmSrcRom: resulting-properties={base-type=uint8, sw-calibration-access=READ-ONLY, range raw 0..255}
                SrcHndOfRmSrcRom: resulting-properties={base-type=uint8, sw-calibration-access=READ-ONLY, compu {255=PDUR_NO_SRCHNDOFRMSRCROM}, range raw 0..255}
            Element_10: symbol=[10]
              8 x mc data instance, all with category=VALUE:
                LockRomIdxOfRmSrcRom: resulting-properties={base-type=uint8, sw-calibration-access=READ-ONLY, range raw 0..255}
                MaskedBitsOfRmSrcRom: resulting-properties={base-type=uint8, sw-calibration-access=READ-ONLY, range raw 0..255}
                MmRomIdxOfRmSrcRom: resulting-properties={base-type=uint8, sw-calibration-access=READ-ONLY, range raw 0..255}
                RmBufferedTpPropertiesRomIdxOfRmSrcRom: resulting-properties={base-type=uint8, sw-calibration-access=READ-ONLY, compu {255=PDUR_NO_RMBUFFEREDTPPROPERTIESROMIDXOFRMSRCROM}, range raw 0..255}
                RmBufferedTpPropertiesRomPartitionIdxOfRmSrcRom: resulting-properties={base-type=uint8, sw-calibration-access=READ-ONLY, compu {255=PDUR_NO_RMBUFFEREDTPPROPERTIESROMPARTITIONIDXOFRMSRCROM}, range raw 0..255}
                RmDestRomEndIdxOfRmSrcRom: resulting-properties={base-type=uint8, sw-calibration-access=READ-ONLY, range raw 0..255}
                RmDestRomStartIdxOfRmSrcRom: resulting-properties={base-type=uint8, sw-calibration-access=READ-ONLY, range raw 0..255}
                SrcHndOfRmSrcRom: resulting-properties={base-type=uint8, sw-calibration-access=READ-ONLY, compu {255=PDUR_NO_SRCHNDOFRMSRCROM}, range raw 0..255}
            Element_11: symbol=[11]
              8 x mc data instance, all with category=VALUE:
                LockRomIdxOfRmSrcRom: resulting-properties={base-type=uint8, sw-calibration-access=READ-ONLY, range raw 0..255}
                MaskedBitsOfRmSrcRom: resulting-properties={base-type=uint8, sw-calibration-access=READ-ONLY, range raw 0..255}
                MmRomIdxOfRmSrcRom: resulting-properties={base-type=uint8, sw-calibration-access=READ-ONLY, range raw 0..255}
                RmBufferedTpPropertiesRomIdxOfRmSrcRom: resulting-properties={base-type=uint8, sw-calibration-access=READ-ONLY, compu {255=PDUR_NO_RMBUFFEREDTPPROPERTIESROMIDXOFRMSRCROM}, range raw 0..255}
                RmBufferedTpPropertiesRomPartitionIdxOfRmSrcRom: resulting-properties={base-type=uint8, sw-calibration-access=READ-ONLY, compu {255=PDUR_NO_RMBUFFEREDTPPROPERTIESROMPARTITIONIDXOFRMSRCROM}, range raw 0..255}
                RmDestRomEndIdxOfRmSrcRom: resulting-properties={base-type=uint8, sw-calibration-access=READ-ONLY, range raw 0..255}
                RmDestRomStartIdxOfRmSrcRom: resulting-properties={base-type=uint8, sw-calibration-access=READ-ONLY, range raw 0..255}
                SrcHndOfRmSrcRom: resulting-properties={base-type=uint8, sw-calibration-access=READ-ONLY, compu {255=PDUR_NO_SRCHNDOFRMSRCROM}, range raw 0..255}
            Element_12: symbol=[12]
              8 x mc data instance, all with category=VALUE:
                LockRomIdxOfRmSrcRom: resulting-properties={base-type=uint8, sw-calibration-access=READ-ONLY, range raw 0..255}
                MaskedBitsOfRmSrcRom: resulting-properties={base-type=uint8, sw-calibration-access=READ-ONLY, range raw 0..255}
                MmRomIdxOfRmSrcRom: resulting-properties={base-type=uint8, sw-calibration-access=READ-ONLY, range raw 0..255}
                RmBufferedTpPropertiesRomIdxOfRmSrcRom: resulting-properties={base-type=uint8, sw-calibration-access=READ-ONLY, compu {255=PDUR_NO_RMBUFFEREDTPPROPERTIESROMIDXOFRMSRCROM}, range raw 0..255}
                RmBufferedTpPropertiesRomPartitionIdxOfRmSrcRom: resulting-properties={base-type=uint8, sw-calibration-access=READ-ONLY, compu {255=PDUR_NO_RMBUFFEREDTPPROPERTIESROMPARTITIONIDXOFRMSRCROM}, range raw 0..255}
                RmDestRomEndIdxOfRmSrcRom: resulting-properties={base-type=uint8, sw-calibration-access=READ-ONLY, range raw 0..255}
                RmDestRomStartIdxOfRmSrcRom: resulting-properties={base-type=uint8, sw-calibration-access=READ-ONLY, range raw 0..255}
                SrcHndOfRmSrcRom: resulting-properties={base-type=uint8, sw-calibration-access=READ-ONLY, compu {255=PDUR_NO_SRCHNDOFRMSRCROM}, range raw 0..255}
            Element_13: symbol=[13]
              8 x mc data instance, all with category=VALUE:
                LockRomIdxOfRmSrcRom: resulting-properties={base-type=uint8, sw-calibration-access=READ-ONLY, range raw 0..255}
                MaskedBitsOfRmSrcRom: resulting-properties={base-type=uint8, sw-calibration-access=READ-ONLY, range raw 0..255}
                MmRomIdxOfRmSrcRom: resulting-properties={base-type=uint8, sw-calibration-access=READ-ONLY, range raw 0..255}
                RmBufferedTpPropertiesRomIdxOfRmSrcRom: resulting-properties={base-type=uint8, sw-calibration-access=READ-ONLY, compu {255=PDUR_NO_RMBUFFEREDTPPROPERTIESROMIDXOFRMSRCROM}, range raw 0..255}
                RmBufferedTpPropertiesRomPartitionIdxOfRmSrcRom: resulting-properties={base-type=uint8, sw-calibration-access=READ-ONLY, compu {255=PDUR_NO_RMBUFFEREDTPPROPERTIESROMPARTITIONIDXOFRMSRCROM}, range raw 0..255}
                RmDestRomEndIdxOfRmSrcRom: resulting-properties={base-type=uint8, sw-calibration-access=READ-ONLY, range raw 0..255}
                RmDestRomStartIdxOfRmSrcRom: resulting-properties={base-type=uint8, sw-calibration-access=READ-ONLY, range raw 0..255}
                SrcHndOfRmSrcRom: resulting-properties={base-type=uint8, sw-calibration-access=READ-ONLY, compu {255=PDUR_NO_SRCHNDOFRMSRCROM}, range raw 0..255}
            Element_14: symbol=[14]
              8 x mc data instance, all with category=VALUE:
                LockRomIdxOfRmSrcRom: resulting-properties={base-type=uint8, sw-calibration-access=READ-ONLY, range raw 0..255}
                MaskedBitsOfRmSrcRom: resulting-properties={base-type=uint8, sw-calibration-access=READ-ONLY, range raw 0..255}
                MmRomIdxOfRmSrcRom: resulting-properties={base-type=uint8, sw-calibration-access=READ-ONLY, range raw 0..255}
                RmBufferedTpPropertiesRomIdxOfRmSrcRom: resulting-properties={base-type=uint8, sw-calibration-access=READ-ONLY, compu {255=PDUR_NO_RMBUFFEREDTPPROPERTIESROMIDXOFRMSRCROM}, range raw 0..255}
                RmBufferedTpPropertiesRomPartitionIdxOfRmSrcRom: resulting-properties={base-type=uint8, sw-calibration-access=READ-ONLY, compu {255=PDUR_NO_RMBUFFEREDTPPROPERTIESROMPARTITIONIDXOFRMSRCROM}, range raw 0..255}
                RmDestRomEndIdxOfRmSrcRom: resulting-properties={base-type=uint8, sw-calibration-access=READ-ONLY, range raw 0..255}
                RmDestRomStartIdxOfRmSrcRom: resulting-properties={base-type=uint8, sw-calibration-access=READ-ONLY, range raw 0..255}
                SrcHndOfRmSrcRom: resulting-properties={base-type=uint8, sw-calibration-access=READ-ONLY, compu {255=PDUR_NO_SRCHNDOFRMSRCROM}, range raw 0..255}
            Element_15: symbol=[15]
              8 x mc data instance, all with category=VALUE:
                LockRomIdxOfRmSrcRom: resulting-properties={base-type=uint8, sw-calibration-access=READ-ONLY, range raw 0..255}
                MaskedBitsOfRmSrcRom: resulting-properties={base-type=uint8, sw-calibration-access=READ-ONLY, range raw 0..255}
                MmRomIdxOfRmSrcRom: resulting-properties={base-type=uint8, sw-calibration-access=READ-ONLY, range raw 0..255}
                RmBufferedTpPropertiesRomIdxOfRmSrcRom: resulting-properties={base-type=uint8, sw-calibration-access=READ-ONLY, compu {255=PDUR_NO_RMBUFFEREDTPPROPERTIESROMIDXOFRMSRCROM}, range raw 0..255}
                RmBufferedTpPropertiesRomPartitionIdxOfRmSrcRom: resulting-properties={base-type=uint8, sw-calibration-access=READ-ONLY, compu {255=PDUR_NO_RMBUFFEREDTPPROPERTIESROMPARTITIONIDXOFRMSRCROM}, range raw 0..255}
                RmDestRomEndIdxOfRmSrcRom: resulting-properties={base-type=uint8, sw-calibration-access=READ-ONLY, range raw 0..255}
                RmDestRomStartIdxOfRmSrcRom: resulting-properties={base-type=uint8, sw-calibration-access=READ-ONLY, range raw 0..255}
                SrcHndOfRmSrcRom: resulting-properties={base-type=uint8, sw-calibration-access=READ-ONLY, compu {255=PDUR_NO_SRCHNDOFRMSRCROM}, range raw 0..255}
            Element_16: symbol=[16]
              8 x mc data instance, all with category=VALUE:
                LockRomIdxOfRmSrcRom: resulting-properties={base-type=uint8, sw-calibration-access=READ-ONLY, range raw 0..255}
                MaskedBitsOfRmSrcRom: resulting-properties={base-type=uint8, sw-calibration-access=READ-ONLY, range raw 0..255}
                MmRomIdxOfRmSrcRom: resulting-properties={base-type=uint8, sw-calibration-access=READ-ONLY, range raw 0..255}
                RmBufferedTpPropertiesRomIdxOfRmSrcRom: resulting-properties={base-type=uint8, sw-calibration-access=READ-ONLY, compu {255=PDUR_NO_RMBUFFEREDTPPROPERTIESROMIDXOFRMSRCROM}, range raw 0..255}
                RmBufferedTpPropertiesRomPartitionIdxOfRmSrcRom: resulting-properties={base-type=uint8, sw-calibration-access=READ-ONLY, compu {255=PDUR_NO_RMBUFFEREDTPPROPERTIESROMPARTITIONIDXOFRMSRCROM}, range raw 0..255}
                RmDestRomEndIdxOfRmSrcRom: resulting-properties={base-type=uint8, sw-calibration-access=READ-ONLY, range raw 0..255}
                RmDestRomStartIdxOfRmSrcRom: resulting-properties={base-type=uint8, sw-calibration-access=READ-ONLY, range raw 0..255}
                SrcHndOfRmSrcRom: resulting-properties={base-type=uint8, sw-calibration-access=READ-ONLY, compu {255=PDUR_NO_SRCHNDOFRMSRCROM}, range raw 0..255}
            Element_17: symbol=[17]
              8 x mc data instance, all with category=VALUE:
                LockRomIdxOfRmSrcRom: resulting-properties={base-type=uint8, sw-calibration-access=READ-ONLY, range raw 0..255}
                MaskedBitsOfRmSrcRom: resulting-properties={base-type=uint8, sw-calibration-access=READ-ONLY, range raw 0..255}
                MmRomIdxOfRmSrcRom: resulting-properties={base-type=uint8, sw-calibration-access=READ-ONLY, range raw 0..255}
                RmBufferedTpPropertiesRomIdxOfRmSrcRom: resulting-properties={base-type=uint8, sw-calibration-access=READ-ONLY, compu {255=PDUR_NO_RMBUFFEREDTPPROPERTIESROMIDXOFRMSRCROM}, range raw 0..255}
                RmBufferedTpPropertiesRomPartitionIdxOfRmSrcRom: resulting-properties={base-type=uint8, sw-calibration-access=READ-ONLY, compu {255=PDUR_NO_RMBUFFEREDTPPROPERTIESROMPARTITIONIDXOFRMSRCROM}, range raw 0..255}
                RmDestRomEndIdxOfRmSrcRom: resulting-properties={base-type=uint8, sw-calibration-access=READ-ONLY, range raw 0..255}
                RmDestRomStartIdxOfRmSrcRom: resulting-properties={base-type=uint8, sw-calibration-access=READ-ONLY, range raw 0..255}
                SrcHndOfRmSrcRom: resulting-properties={base-type=uint8, sw-calibration-access=READ-ONLY, compu {255=PDUR_NO_SRCHNDOFRMSRCROM}, range raw 0..255}
            Element_18: symbol=[18]
              8 x mc data instance, all with category=VALUE:
                LockRomIdxOfRmSrcRom: resulting-properties={base-type=uint8, sw-calibration-access=READ-ONLY, range raw 0..255}
                MaskedBitsOfRmSrcRom: resulting-properties={base-type=uint8, sw-calibration-access=READ-ONLY, range raw 0..255}
                MmRomIdxOfRmSrcRom: resulting-properties={base-type=uint8, sw-calibration-access=READ-ONLY, range raw 0..255}
                RmBufferedTpPropertiesRomIdxOfRmSrcRom: resulting-properties={base-type=uint8, sw-calibration-access=READ-ONLY, compu {255=PDUR_NO_RMBUFFEREDTPPROPERTIESROMIDXOFRMSRCROM}, range raw 0..255}
                RmBufferedTpPropertiesRomPartitionIdxOfRmSrcRom: resulting-properties={base-type=uint8, sw-calibration-access=READ-ONLY, compu {255=PDUR_NO_RMBUFFEREDTPPROPERTIESROMPARTITIONIDXOFRMSRCROM}, range raw 0..255}
                RmDestRomEndIdxOfRmSrcRom: resulting-properties={base-type=uint8, sw-calibration-access=READ-ONLY, range raw 0..255}
                RmDestRomStartIdxOfRmSrcRom: resulting-properties={base-type=uint8, sw-calibration-access=READ-ONLY, range raw 0..255}
                SrcHndOfRmSrcRom: resulting-properties={base-type=uint8, sw-calibration-access=READ-ONLY, compu {255=PDUR_NO_SRCHNDOFRMSRCROM}, range raw 0..255}
            Element_19: symbol=[19]
              8 x mc data instance, all with category=VALUE:
                LockRomIdxOfRmSrcRom: resulting-properties={base-type=uint8, sw-calibration-access=READ-ONLY, range raw 0..255}
                MaskedBitsOfRmSrcRom: resulting-properties={base-type=uint8, sw-calibration-access=READ-ONLY, range raw 0..255}
                MmRomIdxOfRmSrcRom: resulting-properties={base-type=uint8, sw-calibration-access=READ-ONLY, range raw 0..255}
                RmBufferedTpPropertiesRomIdxOfRmSrcRom: resulting-properties={base-type=uint8, sw-calibration-access=READ-ONLY, compu {255=PDUR_NO_RMBUFFEREDTPPROPERTIESROMIDXOFRMSRCROM}, range raw 0..255}
                RmBufferedTpPropertiesRomPartitionIdxOfRmSrcRom: resulting-properties={base-type=uint8, sw-calibration-access=READ-ONLY, compu {255=PDUR_NO_RMBUFFEREDTPPROPERTIESROMPARTITIONIDXOFRMSRCROM}, range raw 0..255}
                RmDestRomEndIdxOfRmSrcRom: resulting-properties={base-type=uint8, sw-calibration-access=READ-ONLY, range raw 0..255}
                RmDestRomStartIdxOfRmSrcRom: resulting-properties={base-type=uint8, sw-calibration-access=READ-ONLY, range raw 0..255}
                SrcHndOfRmSrcRom: resulting-properties={base-type=uint8, sw-calibration-access=READ-ONLY, compu {255=PDUR_NO_SRCHNDOFRMSRCROM}, range raw 0..255}
            Element_20: symbol=[20]
              8 x mc data instance, all with category=VALUE:
                LockRomIdxOfRmSrcRom: resulting-properties={base-type=uint8, sw-calibration-access=READ-ONLY, range raw 0..255}
                MaskedBitsOfRmSrcRom: resulting-properties={base-type=uint8, sw-calibration-access=READ-ONLY, range raw 0..255}
                MmRomIdxOfRmSrcRom: resulting-properties={base-type=uint8, sw-calibration-access=READ-ONLY, range raw 0..255}
                RmBufferedTpPropertiesRomIdxOfRmSrcRom: resulting-properties={base-type=uint8, sw-calibration-access=READ-ONLY, compu {255=PDUR_NO_RMBUFFEREDTPPROPERTIESROMIDXOFRMSRCROM}, range raw 0..255}
                RmBufferedTpPropertiesRomPartitionIdxOfRmSrcRom: resulting-properties={base-type=uint8, sw-calibration-access=READ-ONLY, compu {255=PDUR_NO_RMBUFFEREDTPPROPERTIESROMPARTITIONIDXOFRMSRCROM}, range raw 0..255}
                RmDestRomEndIdxOfRmSrcRom: resulting-properties={base-type=uint8, sw-calibration-access=READ-ONLY, range raw 0..255}
                RmDestRomStartIdxOfRmSrcRom: resulting-properties={base-type=uint8, sw-calibration-access=READ-ONLY, range raw 0..255}
                SrcHndOfRmSrcRom: resulting-properties={base-type=uint8, sw-calibration-access=READ-ONLY, compu {255=PDUR_NO_SRCHNDOFRMSRCROM}, range raw 0..255}
            Element_21: symbol=[21]
              8 x mc data instance, all with category=VALUE:
                LockRomIdxOfRmSrcRom: resulting-properties={base-type=uint8, sw-calibration-access=READ-ONLY, range raw 0..255}
                MaskedBitsOfRmSrcRom: resulting-properties={base-type=uint8, sw-calibration-access=READ-ONLY, range raw 0..255}
                MmRomIdxOfRmSrcRom: resulting-properties={base-type=uint8, sw-calibration-access=READ-ONLY, range raw 0..255}
                RmBufferedTpPropertiesRomIdxOfRmSrcRom: resulting-properties={base-type=uint8, sw-calibration-access=READ-ONLY, compu {255=PDUR_NO_RMBUFFEREDTPPROPERTIESROMIDXOFRMSRCROM}, range raw 0..255}
                RmBufferedTpPropertiesRomPartitionIdxOfRmSrcRom: resulting-properties={base-type=uint8, sw-calibration-access=READ-ONLY, compu {255=PDUR_NO_RMBUFFEREDTPPROPERTIESROMPARTITIONIDXOFRMSRCROM}, range raw 0..255}
                RmDestRomEndIdxOfRmSrcRom: resulting-properties={base-type=uint8, sw-calibration-access=READ-ONLY, range raw 0..255}
                RmDestRomStartIdxOfRmSrcRom: resulting-properties={base-type=uint8, sw-calibration-access=READ-ONLY, range raw 0..255}
                SrcHndOfRmSrcRom: resulting-properties={base-type=uint8, sw-calibration-access=READ-ONLY, compu {255=PDUR_NO_SRCHNDOFRMSRCROM}, range raw 0..255}
            Element_22: symbol=[22]
              8 x mc data instance, all with category=VALUE:
                LockRomIdxOfRmSrcRom: resulting-properties={base-type=uint8, sw-calibration-access=READ-ONLY, range raw 0..255}
                MaskedBitsOfRmSrcRom: resulting-properties={base-type=uint8, sw-calibration-access=READ-ONLY, range raw 0..255}
                MmRomIdxOfRmSrcRom: resulting-properties={base-type=uint8, sw-calibration-access=READ-ONLY, range raw 0..255}
                RmBufferedTpPropertiesRomIdxOfRmSrcRom: resulting-properties={base-type=uint8, sw-calibration-access=READ-ONLY, compu {255=PDUR_NO_RMBUFFEREDTPPROPERTIESROMIDXOFRMSRCROM}, range raw 0..255}
                RmBufferedTpPropertiesRomPartitionIdxOfRmSrcRom: resulting-properties={base-type=uint8, sw-calibration-access=READ-ONLY, compu {255=PDUR_NO_RMBUFFEREDTPPROPERTIESROMPARTITIONIDXOFRMSRCROM}, range raw 0..255}
                RmDestRomEndIdxOfRmSrcRom: resulting-properties={base-type=uint8, sw-calibration-access=READ-ONLY, range raw 0..255}
                RmDestRomStartIdxOfRmSrcRom: resulting-properties={base-type=uint8, sw-calibration-access=READ-ONLY, range raw 0..255}
                SrcHndOfRmSrcRom: resulting-properties={base-type=uint8, sw-calibration-access=READ-ONLY, compu {255=PDUR_NO_SRCHNDOFRMSRCROM}, range raw 0..255}
            Element_23: symbol=[23]
              8 x mc data instance, all with category=VALUE:
                LockRomIdxOfRmSrcRom: resulting-properties={base-type=uint8, sw-calibration-access=READ-ONLY, range raw 0..255}
                MaskedBitsOfRmSrcRom: resulting-properties={base-type=uint8, sw-calibration-access=READ-ONLY, range raw 0..255}
                MmRomIdxOfRmSrcRom: resulting-properties={base-type=uint8, sw-calibration-access=READ-ONLY, range raw 0..255}
                RmBufferedTpPropertiesRomIdxOfRmSrcRom: resulting-properties={base-type=uint8, sw-calibration-access=READ-ONLY, compu {255=PDUR_NO_RMBUFFEREDTPPROPERTIESROMIDXOFRMSRCROM}, range raw 0..255}
                RmBufferedTpPropertiesRomPartitionIdxOfRmSrcRom: resulting-properties={base-type=uint8, sw-calibration-access=READ-ONLY, compu {255=PDUR_NO_RMBUFFEREDTPPROPERTIESROMPARTITIONIDXOFRMSRCROM}, range raw 0..255}
                RmDestRomEndIdxOfRmSrcRom: resulting-properties={base-type=uint8, sw-calibration-access=READ-ONLY, range raw 0..255}
                RmDestRomStartIdxOfRmSrcRom: resulting-properties={base-type=uint8, sw-calibration-access=READ-ONLY, range raw 0..255}
                SrcHndOfRmSrcRom: resulting-properties={base-type=uint8, sw-calibration-access=READ-ONLY, compu {255=PDUR_NO_SRCHNDOFRMSRCROM}, range raw 0..255}
            Element_24: symbol=[24]
              8 x mc data instance, all with category=VALUE:
                LockRomIdxOfRmSrcRom: resulting-properties={base-type=uint8, sw-calibration-access=READ-ONLY, range raw 0..255}
                MaskedBitsOfRmSrcRom: resulting-properties={base-type=uint8, sw-calibration-access=READ-ONLY, range raw 0..255}
                MmRomIdxOfRmSrcRom: resulting-properties={base-type=uint8, sw-calibration-access=READ-ONLY, range raw 0..255}
                RmBufferedTpPropertiesRomIdxOfRmSrcRom: resulting-properties={base-type=uint8, sw-calibration-access=READ-ONLY, compu {255=PDUR_NO_RMBUFFEREDTPPROPERTIESROMIDXOFRMSRCROM}, range raw 0..255}
                RmBufferedTpPropertiesRomPartitionIdxOfRmSrcRom: resulting-properties={base-type=uint8, sw-calibration-access=READ-ONLY, compu {255=PDUR_NO_RMBUFFEREDTPPROPERTIESROMPARTITIONIDXOFRMSRCROM}, range raw 0..255}
                RmDestRomEndIdxOfRmSrcRom: resulting-properties={base-type=uint8, sw-calibration-access=READ-ONLY, range raw 0..255}
                RmDestRomStartIdxOfRmSrcRom: resulting-properties={base-type=uint8, sw-calibration-access=READ-ONLY, range raw 0..255}
                SrcHndOfRmSrcRom: resulting-properties={base-type=uint8, sw-calibration-access=READ-ONLY, compu {255=PDUR_NO_SRCHNDOFRMSRCROM}, range raw 0..255}
            Element_25: symbol=[25]
              8 x mc data instance, all with category=VALUE:
                LockRomIdxOfRmSrcRom: resulting-properties={base-type=uint8, sw-calibration-access=READ-ONLY, range raw 0..255}
                MaskedBitsOfRmSrcRom: resulting-properties={base-type=uint8, sw-calibration-access=READ-ONLY, range raw 0..255}
                MmRomIdxOfRmSrcRom: resulting-properties={base-type=uint8, sw-calibration-access=READ-ONLY, range raw 0..255}
                RmBufferedTpPropertiesRomIdxOfRmSrcRom: resulting-properties={base-type=uint8, sw-calibration-access=READ-ONLY, compu {255=PDUR_NO_RMBUFFEREDTPPROPERTIESROMIDXOFRMSRCROM}, range raw 0..255}
                RmBufferedTpPropertiesRomPartitionIdxOfRmSrcRom: resulting-properties={base-type=uint8, sw-calibration-access=READ-ONLY, compu {255=PDUR_NO_RMBUFFEREDTPPROPERTIESROMPARTITIONIDXOFRMSRCROM}, range raw 0..255}
                RmDestRomEndIdxOfRmSrcRom: resulting-properties={base-type=uint8, sw-calibration-access=READ-ONLY, range raw 0..255}
                RmDestRomStartIdxOfRmSrcRom: resulting-properties={base-type=uint8, sw-calibration-access=READ-ONLY, range raw 0..255}
                SrcHndOfRmSrcRom: resulting-properties={base-type=uint8, sw-calibration-access=READ-ONLY, compu {255=PDUR_NO_SRCHNDOFRMSRCROM}, range raw 0..255}
            Element_26: symbol=[26]
              8 x mc data instance, all with category=VALUE:
                LockRomIdxOfRmSrcRom: resulting-properties={base-type=uint8, sw-calibration-access=READ-ONLY, range raw 0..255}
                MaskedBitsOfRmSrcRom: resulting-properties={base-type=uint8, sw-calibration-access=READ-ONLY, range raw 0..255}
                MmRomIdxOfRmSrcRom: resulting-properties={base-type=uint8, sw-calibration-access=READ-ONLY, range raw 0..255}
                RmBufferedTpPropertiesRomIdxOfRmSrcRom: resulting-properties={base-type=uint8, sw-calibration-access=READ-ONLY, compu {255=PDUR_NO_RMBUFFEREDTPPROPERTIESROMIDXOFRMSRCROM}, range raw 0..255}
                RmBufferedTpPropertiesRomPartitionIdxOfRmSrcRom: resulting-properties={base-type=uint8, sw-calibration-access=READ-ONLY, compu {255=PDUR_NO_RMBUFFEREDTPPROPERTIESROMPARTITIONIDXOFRMSRCROM}, range raw 0..255}
                RmDestRomEndIdxOfRmSrcRom: resulting-properties={base-type=uint8, sw-calibration-access=READ-ONLY, range raw 0..255}
                RmDestRomStartIdxOfRmSrcRom: resulting-properties={base-type=uint8, sw-calibration-access=READ-ONLY, range raw 0..255}
                SrcHndOfRmSrcRom: resulting-properties={base-type=uint8, sw-calibration-access=READ-ONLY, compu {255=PDUR_NO_SRCHNDOFRMSRCROM}, range raw 0..255}
            Element_27: symbol=[27]
              8 x mc data instance, all with category=VALUE:
                LockRomIdxOfRmSrcRom: resulting-properties={base-type=uint8, sw-calibration-access=READ-ONLY, range raw 0..255}
                MaskedBitsOfRmSrcRom: resulting-properties={base-type=uint8, sw-calibration-access=READ-ONLY, range raw 0..255}
                MmRomIdxOfRmSrcRom: resulting-properties={base-type=uint8, sw-calibration-access=READ-ONLY, range raw 0..255}
                RmBufferedTpPropertiesRomIdxOfRmSrcRom: resulting-properties={base-type=uint8, sw-calibration-access=READ-ONLY, compu {255=PDUR_NO_RMBUFFEREDTPPROPERTIESROMIDXOFRMSRCROM}, range raw 0..255}
                RmBufferedTpPropertiesRomPartitionIdxOfRmSrcRom: resulting-properties={base-type=uint8, sw-calibration-access=READ-ONLY, compu {255=PDUR_NO_RMBUFFEREDTPPROPERTIESROMPARTITIONIDXOFRMSRCROM}, range raw 0..255}
                RmDestRomEndIdxOfRmSrcRom: resulting-properties={base-type=uint8, sw-calibration-access=READ-ONLY, range raw 0..255}
                RmDestRomStartIdxOfRmSrcRom: resulting-properties={base-type=uint8, sw-calibration-access=READ-ONLY, range raw 0..255}
                SrcHndOfRmSrcRom: resulting-properties={base-type=uint8, sw-calibration-access=READ-ONLY, compu {255=PDUR_NO_SRCHNDOFRMSRCROM}, range raw 0..255}
            Element_28: symbol=[28]
              8 x mc data instance, all with category=VALUE:
                LockRomIdxOfRmSrcRom: resulting-properties={base-type=uint8, sw-calibration-access=READ-ONLY, range raw 0..255}
                MaskedBitsOfRmSrcRom: resulting-properties={base-type=uint8, sw-calibration-access=READ-ONLY, range raw 0..255}
                MmRomIdxOfRmSrcRom: resulting-properties={base-type=uint8, sw-calibration-access=READ-ONLY, range raw 0..255}
                RmBufferedTpPropertiesRomIdxOfRmSrcRom: resulting-properties={base-type=uint8, sw-calibration-access=READ-ONLY, compu {255=PDUR_NO_RMBUFFEREDTPPROPERTIESROMIDXOFRMSRCROM}, range raw 0..255}
                RmBufferedTpPropertiesRomPartitionIdxOfRmSrcRom: resulting-properties={base-type=uint8, sw-calibration-access=READ-ONLY, compu {255=PDUR_NO_RMBUFFEREDTPPROPERTIESROMPARTITIONIDXOFRMSRCROM}, range raw 0..255}
                RmDestRomEndIdxOfRmSrcRom: resulting-properties={base-type=uint8, sw-calibration-access=READ-ONLY, range raw 0..255}
                RmDestRomStartIdxOfRmSrcRom: resulting-properties={base-type=uint8, sw-calibration-access=READ-ONLY, range raw 0..255}
                SrcHndOfRmSrcRom: resulting-properties={base-type=uint8, sw-calibration-access=READ-ONLY, compu {255=PDUR_NO_SRCHNDOFRMSRCROM}, range raw 0..255}
            Element_29: symbol=[29]
              8 x mc data instance, all with category=VALUE:
                LockRomIdxOfRmSrcRom: resulting-properties={base-type=uint8, sw-calibration-access=READ-ONLY, range raw 0..255}
                MaskedBitsOfRmSrcRom: resulting-properties={base-type=uint8, sw-calibration-access=READ-ONLY, range raw 0..255}
                MmRomIdxOfRmSrcRom: resulting-properties={base-type=uint8, sw-calibration-access=READ-ONLY, range raw 0..255}
                RmBufferedTpPropertiesRomIdxOfRmSrcRom: resulting-properties={base-type=uint8, sw-calibration-access=READ-ONLY, compu {255=PDUR_NO_RMBUFFEREDTPPROPERTIESROMIDXOFRMSRCROM}, range raw 0..255}
                RmBufferedTpPropertiesRomPartitionIdxOfRmSrcRom: resulting-properties={base-type=uint8, sw-calibration-access=READ-ONLY, compu {255=PDUR_NO_RMBUFFEREDTPPROPERTIESROMPARTITIONIDXOFRMSRCROM}, range raw 0..255}
                RmDestRomEndIdxOfRmSrcRom: resulting-properties={base-type=uint8, sw-calibration-access=READ-ONLY, range raw 0..255}
                RmDestRomStartIdxOfRmSrcRom: resulting-properties={base-type=uint8, sw-calibration-access=READ-ONLY, range raw 0..255}
                SrcHndOfRmSrcRom: resulting-properties={base-type=uint8, sw-calibration-access=READ-ONLY, compu {255=PDUR_NO_SRCHNDOFRMSRCROM}, range raw 0..255}
            Element_30: symbol=[30]
              8 x mc data instance, all with category=VALUE:
                LockRomIdxOfRmSrcRom: resulting-properties={base-type=uint8, sw-calibration-access=READ-ONLY, range raw 0..255}
                MaskedBitsOfRmSrcRom: resulting-properties={base-type=uint8, sw-calibration-access=READ-ONLY, range raw 0..255}
                MmRomIdxOfRmSrcRom: resulting-properties={base-type=uint8, sw-calibration-access=READ-ONLY, range raw 0..255}
                RmBufferedTpPropertiesRomIdxOfRmSrcRom: resulting-properties={base-type=uint8, sw-calibration-access=READ-ONLY, compu {255=PDUR_NO_RMBUFFEREDTPPROPERTIESROMIDXOFRMSRCROM}, range raw 0..255}
                RmBufferedTpPropertiesRomPartitionIdxOfRmSrcRom: resulting-properties={base-type=uint8, sw-calibration-access=READ-ONLY, compu {255=PDUR_NO_RMBUFFEREDTPPROPERTIESROMPARTITIONIDXOFRMSRCROM}, range raw 0..255}
                RmDestRomEndIdxOfRmSrcRom: resulting-properties={base-type=uint8, sw-calibration-access=READ-ONLY, range raw 0..255}
                RmDestRomStartIdxOfRmSrcRom: resulting-properties={base-type=uint8, sw-calibration-access=READ-ONLY, range raw 0..255}
                SrcHndOfRmSrcRom: resulting-properties={base-type=uint8, sw-calibration-access=READ-ONLY, compu {255=PDUR_NO_SRCHNDOFRMSRCROM}, range raw 0..255}
            Element_31: symbol=[31]
              8 x mc data instance, all with category=VALUE:
                LockRomIdxOfRmSrcRom: resulting-properties={base-type=uint8, sw-calibration-access=READ-ONLY, range raw 0..255}
                MaskedBitsOfRmSrcRom: resulting-properties={base-type=uint8, sw-calibration-access=READ-ONLY, range raw 0..255}
                MmRomIdxOfRmSrcRom: resulting-properties={base-type=uint8, sw-calibration-access=READ-ONLY, range raw 0..255}
                RmBufferedTpPropertiesRomIdxOfRmSrcRom: resulting-properties={base-type=uint8, sw-calibration-access=READ-ONLY, compu {255=PDUR_NO_RMBUFFEREDTPPROPERTIESROMIDXOFRMSRCROM}, range raw 0..255}
                RmBufferedTpPropertiesRomPartitionIdxOfRmSrcRom: resulting-properties={base-type=uint8, sw-calibration-access=READ-ONLY, compu {255=PDUR_NO_RMBUFFEREDTPPROPERTIESROMPARTITIONIDXOFRMSRCROM}, range raw 0..255}
                RmDestRomEndIdxOfRmSrcRom: resulting-properties={base-type=uint8, sw-calibration-access=READ-ONLY, range raw 0..255}
                RmDestRomStartIdxOfRmSrcRom: resulting-properties={base-type=uint8, sw-calibration-access=READ-ONLY, range raw 0..255}
                SrcHndOfRmSrcRom: resulting-properties={base-type=uint8, sw-calibration-access=READ-ONLY, compu {255=PDUR_NO_SRCHNDOFRMSRCROM}, range raw 0..255}
            Element_32: symbol=[32]
              8 x mc data instance, all with category=VALUE:
                LockRomIdxOfRmSrcRom: resulting-properties={base-type=uint8, sw-calibration-access=READ-ONLY, range raw 0..255}
                MaskedBitsOfRmSrcRom: resulting-properties={base-type=uint8, sw-calibration-access=READ-ONLY, range raw 0..255}
                MmRomIdxOfRmSrcRom: resulting-properties={base-type=uint8, sw-calibration-access=READ-ONLY, range raw 0..255}
                RmBufferedTpPropertiesRomIdxOfRmSrcRom: resulting-properties={base-type=uint8, sw-calibration-access=READ-ONLY, compu {255=PDUR_NO_RMBUFFEREDTPPROPERTIESROMIDXOFRMSRCROM}, range raw 0..255}
                RmBufferedTpPropertiesRomPartitionIdxOfRmSrcRom: resulting-properties={base-type=uint8, sw-calibration-access=READ-ONLY, compu {255=PDUR_NO_RMBUFFEREDTPPROPERTIESROMPARTITIONIDXOFRMSRCROM}, range raw 0..255}
                RmDestRomEndIdxOfRmSrcRom: resulting-properties={base-type=uint8, sw-calibration-access=READ-ONLY, range raw 0..255}
                RmDestRomStartIdxOfRmSrcRom: resulting-properties={base-type=uint8, sw-calibration-access=READ-ONLY, range raw 0..255}
                SrcHndOfRmSrcRom: resulting-properties={base-type=uint8, sw-calibration-access=READ-ONLY, compu {255=PDUR_NO_SRCHNDOFRMSRCROM}, range raw 0..255}
            Element_33: symbol=[33]
              8 x mc data instance, all with category=VALUE:
                LockRomIdxOfRmSrcRom: resulting-properties={base-type=uint8, sw-calibration-access=READ-ONLY, range raw 0..255}
                MaskedBitsOfRmSrcRom: resulting-properties={base-type=uint8, sw-calibration-access=READ-ONLY, range raw 0..255}
                MmRomIdxOfRmSrcRom: resulting-properties={base-type=uint8, sw-calibration-access=READ-ONLY, range raw 0..255}
                RmBufferedTpPropertiesRomIdxOfRmSrcRom: resulting-properties={base-type=uint8, sw-calibration-access=READ-ONLY, compu {255=PDUR_NO_RMBUFFEREDTPPROPERTIESROMIDXOFRMSRCROM}, range raw 0..255}
                RmBufferedTpPropertiesRomPartitionIdxOfRmSrcRom: resulting-properties={base-type=uint8, sw-calibration-access=READ-ONLY, compu {255=PDUR_NO_RMBUFFEREDTPPROPERTIESROMPARTITIONIDXOFRMSRCROM}, range raw 0..255}
                RmDestRomEndIdxOfRmSrcRom: resulting-properties={base-type=uint8, sw-calibration-access=READ-ONLY, range raw 0..255}
                RmDestRomStartIdxOfRmSrcRom: resulting-properties={base-type=uint8, sw-calibration-access=READ-ONLY, range raw 0..255}
                SrcHndOfRmSrcRom: resulting-properties={base-type=uint8, sw-calibration-access=READ-ONLY, compu {255=PDUR_NO_SRCHNDOFRMSRCROM}, range raw 0..255}
            Element_34: symbol=[34]
              8 x mc data instance, all with category=VALUE:
                LockRomIdxOfRmSrcRom: resulting-properties={base-type=uint8, sw-calibration-access=READ-ONLY, range raw 0..255}
                MaskedBitsOfRmSrcRom: resulting-properties={base-type=uint8, sw-calibration-access=READ-ONLY, range raw 0..255}
                MmRomIdxOfRmSrcRom: resulting-properties={base-type=uint8, sw-calibration-access=READ-ONLY, range raw 0..255}
                RmBufferedTpPropertiesRomIdxOfRmSrcRom: resulting-properties={base-type=uint8, sw-calibration-access=READ-ONLY, compu {255=PDUR_NO_RMBUFFEREDTPPROPERTIESROMIDXOFRMSRCROM}, range raw 0..255}
                RmBufferedTpPropertiesRomPartitionIdxOfRmSrcRom: resulting-properties={base-type=uint8, sw-calibration-access=READ-ONLY, compu {255=PDUR_NO_RMBUFFEREDTPPROPERTIESROMPARTITIONIDXOFRMSRCROM}, range raw 0..255}
                RmDestRomEndIdxOfRmSrcRom: resulting-properties={base-type=uint8, sw-calibration-access=READ-ONLY, range raw 0..255}
                RmDestRomStartIdxOfRmSrcRom: resulting-properties={base-type=uint8, sw-calibration-access=READ-ONLY, range raw 0..255}
                SrcHndOfRmSrcRom: resulting-properties={base-type=uint8, sw-calibration-access=READ-ONLY, compu {255=PDUR_NO_SRCHNDOFRMSRCROM}, range raw 0..255}
            Element_35: symbol=[35]
              8 x mc data instance, all with category=VALUE:
                LockRomIdxOfRmSrcRom: resulting-properties={base-type=uint8, sw-calibration-access=READ-ONLY, range raw 0..255}
                MaskedBitsOfRmSrcRom: resulting-properties={base-type=uint8, sw-calibration-access=READ-ONLY, range raw 0..255}
                MmRomIdxOfRmSrcRom: resulting-properties={base-type=uint8, sw-calibration-access=READ-ONLY, range raw 0..255}
                RmBufferedTpPropertiesRomIdxOfRmSrcRom: resulting-properties={base-type=uint8, sw-calibration-access=READ-ONLY, compu {255=PDUR_NO_RMBUFFEREDTPPROPERTIESROMIDXOFRMSRCROM}, range raw 0..255}
                RmBufferedTpPropertiesRomPartitionIdxOfRmSrcRom: resulting-properties={base-type=uint8, sw-calibration-access=READ-ONLY, compu {255=PDUR_NO_RMBUFFEREDTPPROPERTIESROMPARTITIONIDXOFRMSRCROM}, range raw 0..255}
                RmDestRomEndIdxOfRmSrcRom: resulting-properties={base-type=uint8, sw-calibration-access=READ-ONLY, range raw 0..255}
                RmDestRomStartIdxOfRmSrcRom: resulting-properties={base-type=uint8, sw-calibration-access=READ-ONLY, range raw 0..255}
                SrcHndOfRmSrcRom: resulting-properties={base-type=uint8, sw-calibration-access=READ-ONLY, compu {255=PDUR_NO_SRCHNDOFRMSRCROM}, range raw 0..255}
            Element_36: symbol=[36]
              8 x mc data instance, all with category=VALUE:
                LockRomIdxOfRmSrcRom: resulting-properties={base-type=uint8, sw-calibration-access=READ-ONLY, range raw 0..255}
                MaskedBitsOfRmSrcRom: resulting-properties={base-type=uint8, sw-calibration-access=READ-ONLY, range raw 0..255}
                MmRomIdxOfRmSrcRom: resulting-properties={base-type=uint8, sw-calibration-access=READ-ONLY, range raw 0..255}
                RmBufferedTpPropertiesRomIdxOfRmSrcRom: resulting-properties={base-type=uint8, sw-calibration-access=READ-ONLY, compu {255=PDUR_NO_RMBUFFEREDTPPROPERTIESROMIDXOFRMSRCROM}, range raw 0..255}
                RmBufferedTpPropertiesRomPartitionIdxOfRmSrcRom: resulting-properties={base-type=uint8, sw-calibration-access=READ-ONLY, compu {255=PDUR_NO_RMBUFFEREDTPPROPERTIESROMPARTITIONIDXOFRMSRCROM}, range raw 0..255}
                RmDestRomEndIdxOfRmSrcRom: resulting-properties={base-type=uint8, sw-calibration-access=READ-ONLY, range raw 0..255}
                RmDestRomStartIdxOfRmSrcRom: resulting-properties={base-type=uint8, sw-calibration-access=READ-ONLY, range raw 0..255}
                SrcHndOfRmSrcRom: resulting-properties={base-type=uint8, sw-calibration-access=READ-ONLY, compu {255=PDUR_NO_SRCHNDOFRMSRCROM}, range raw 0..255}
            Element_37: symbol=[37]
              8 x mc data instance, all with category=VALUE:
                LockRomIdxOfRmSrcRom: resulting-properties={base-type=uint8, sw-calibration-access=READ-ONLY, range raw 0..255}
                MaskedBitsOfRmSrcRom: resulting-properties={base-type=uint8, sw-calibration-access=READ-ONLY, range raw 0..255}
                MmRomIdxOfRmSrcRom: resulting-properties={base-type=uint8, sw-calibration-access=READ-ONLY, range raw 0..255}
                RmBufferedTpPropertiesRomIdxOfRmSrcRom: resulting-properties={base-type=uint8, sw-calibration-access=READ-ONLY, compu {255=PDUR_NO_RMBUFFEREDTPPROPERTIESROMIDXOFRMSRCROM}, range raw 0..255}
                RmBufferedTpPropertiesRomPartitionIdxOfRmSrcRom: resulting-properties={base-type=uint8, sw-calibration-access=READ-ONLY, compu {255=PDUR_NO_RMBUFFEREDTPPROPERTIESROMPARTITIONIDXOFRMSRCROM}, range raw 0..255}
                RmDestRomEndIdxOfRmSrcRom: resulting-properties={base-type=uint8, sw-calibration-access=READ-ONLY, range raw 0..255}
                RmDestRomStartIdxOfRmSrcRom: resulting-properties={base-type=uint8, sw-calibration-access=READ-ONLY, range raw 0..255}
                SrcHndOfRmSrcRom: resulting-properties={base-type=uint8, sw-calibration-access=READ-ONLY, compu {255=PDUR_NO_SRCHNDOFRMSRCROM}, range raw 0..255}
            Element_38: symbol=[38]
              8 x mc data instance, all with category=VALUE:
                LockRomIdxOfRmSrcRom: resulting-properties={base-type=uint8, sw-calibration-access=READ-ONLY, range raw 0..255}
                MaskedBitsOfRmSrcRom: resulting-properties={base-type=uint8, sw-calibration-access=READ-ONLY, range raw 0..255}
                MmRomIdxOfRmSrcRom: resulting-properties={base-type=uint8, sw-calibration-access=READ-ONLY, range raw 0..255}
                RmBufferedTpPropertiesRomIdxOfRmSrcRom: resulting-properties={base-type=uint8, sw-calibration-access=READ-ONLY, compu {255=PDUR_NO_RMBUFFEREDTPPROPERTIESROMIDXOFRMSRCROM}, range raw 0..255}
                RmBufferedTpPropertiesRomPartitionIdxOfRmSrcRom: resulting-properties={base-type=uint8, sw-calibration-access=READ-ONLY, compu {255=PDUR_NO_RMBUFFEREDTPPROPERTIESROMPARTITIONIDXOFRMSRCROM}, range raw 0..255}
                RmDestRomEndIdxOfRmSrcRom: resulting-properties={base-type=uint8, sw-calibration-access=READ-ONLY, range raw 0..255}
                RmDestRomStartIdxOfRmSrcRom: resulting-properties={base-type=uint8, sw-calibration-access=READ-ONLY, range raw 0..255}
                SrcHndOfRmSrcRom: resulting-properties={base-type=uint8, sw-calibration-access=READ-ONLY, compu {255=PDUR_NO_SRCHNDOFRMSRCROM}, range raw 0..255}
            Element_39: symbol=[39]
              8 x mc data instance, all with category=VALUE:
                LockRomIdxOfRmSrcRom: resulting-properties={base-type=uint8, sw-calibration-access=READ-ONLY, range raw 0..255}
                MaskedBitsOfRmSrcRom: resulting-properties={base-type=uint8, sw-calibration-access=READ-ONLY, range raw 0..255}
                MmRomIdxOfRmSrcRom: resulting-properties={base-type=uint8, sw-calibration-access=READ-ONLY, range raw 0..255}
                RmBufferedTpPropertiesRomIdxOfRmSrcRom: resulting-properties={base-type=uint8, sw-calibration-access=READ-ONLY, compu {255=PDUR_NO_RMBUFFEREDTPPROPERTIESROMIDXOFRMSRCROM}, range raw 0..255}
                RmBufferedTpPropertiesRomPartitionIdxOfRmSrcRom: resulting-properties={base-type=uint8, sw-calibration-access=READ-ONLY, compu {255=PDUR_NO_RMBUFFEREDTPPROPERTIESROMPARTITIONIDXOFRMSRCROM}, range raw 0..255}
                RmDestRomEndIdxOfRmSrcRom: resulting-properties={base-type=uint8, sw-calibration-access=READ-ONLY, range raw 0..255}
                RmDestRomStartIdxOfRmSrcRom: resulting-properties={base-type=uint8, sw-calibration-access=READ-ONLY, range raw 0..255}
                SrcHndOfRmSrcRom: resulting-properties={base-type=uint8, sw-calibration-access=READ-ONLY, compu {255=PDUR_NO_SRCHNDOFRMSRCROM}, range raw 0..255}
            Element_40: symbol=[40]
              8 x mc data instance, all with category=VALUE:
                LockRomIdxOfRmSrcRom: resulting-properties={base-type=uint8, sw-calibration-access=READ-ONLY, range raw 0..255}
                MaskedBitsOfRmSrcRom: resulting-properties={base-type=uint8, sw-calibration-access=READ-ONLY, range raw 0..255}
                MmRomIdxOfRmSrcRom: resulting-properties={base-type=uint8, sw-calibration-access=READ-ONLY, range raw 0..255}
                RmBufferedTpPropertiesRomIdxOfRmSrcRom: resulting-properties={base-type=uint8, sw-calibration-access=READ-ONLY, compu {255=PDUR_NO_RMBUFFEREDTPPROPERTIESROMIDXOFRMSRCROM}, range raw 0..255}
                RmBufferedTpPropertiesRomPartitionIdxOfRmSrcRom: resulting-properties={base-type=uint8, sw-calibration-access=READ-ONLY, compu {255=PDUR_NO_RMBUFFEREDTPPROPERTIESROMPARTITIONIDXOFRMSRCROM}, range raw 0..255}
                RmDestRomEndIdxOfRmSrcRom: resulting-properties={base-type=uint8, sw-calibration-access=READ-ONLY, range raw 0..255}
                RmDestRomStartIdxOfRmSrcRom: resulting-properties={base-type=uint8, sw-calibration-access=READ-ONLY, range raw 0..255}
                SrcHndOfRmSrcRom: resulting-properties={base-type=uint8, sw-calibration-access=READ-ONLY, compu {255=PDUR_NO_SRCHNDOFRMSRCROM}, range raw 0..255}
            Element_41: symbol=[41]
              8 x mc data instance, all with category=VALUE:
                LockRomIdxOfRmSrcRom: resulting-properties={base-type=uint8, sw-calibration-access=READ-ONLY, range raw 0..255}
                MaskedBitsOfRmSrcRom: resulting-properties={base-type=uint8, sw-calibration-access=READ-ONLY, range raw 0..255}
                MmRomIdxOfRmSrcRom: resulting-properties={base-type=uint8, sw-calibration-access=READ-ONLY, range raw 0..255}
                RmBufferedTpPropertiesRomIdxOfRmSrcRom: resulting-properties={base-type=uint8, sw-calibration-access=READ-ONLY, compu {255=PDUR_NO_RMBUFFEREDTPPROPERTIESROMIDXOFRMSRCROM}, range raw 0..255}
                RmBufferedTpPropertiesRomPartitionIdxOfRmSrcRom: resulting-properties={base-type=uint8, sw-calibration-access=READ-ONLY, compu {255=PDUR_NO_RMBUFFEREDTPPROPERTIESROMPARTITIONIDXOFRMSRCROM}, range raw 0..255}
                RmDestRomEndIdxOfRmSrcRom: resulting-properties={base-type=uint8, sw-calibration-access=READ-ONLY, range raw 0..255}
                RmDestRomStartIdxOfRmSrcRom: resulting-properties={base-type=uint8, sw-calibration-access=READ-ONLY, range raw 0..255}
                SrcHndOfRmSrcRom: resulting-properties={base-type=uint8, sw-calibration-access=READ-ONLY, compu {255=PDUR_NO_SRCHNDOFRMSRCROM}, range raw 0..255}
            Element_42: symbol=[42]
              8 x mc data instance, all with category=VALUE:
                LockRomIdxOfRmSrcRom: resulting-properties={base-type=uint8, sw-calibration-access=READ-ONLY, range raw 0..255}
                MaskedBitsOfRmSrcRom: resulting-properties={base-type=uint8, sw-calibration-access=READ-ONLY, range raw 0..255}
                MmRomIdxOfRmSrcRom: resulting-properties={base-type=uint8, sw-calibration-access=READ-ONLY, range raw 0..255}
                RmBufferedTpPropertiesRomIdxOfRmSrcRom: resulting-properties={base-type=uint8, sw-calibration-access=READ-ONLY, compu {255=PDUR_NO_RMBUFFEREDTPPROPERTIESROMIDXOFRMSRCROM}, range raw 0..255}
                RmBufferedTpPropertiesRomPartitionIdxOfRmSrcRom: resulting-properties={base-type=uint8, sw-calibration-access=READ-ONLY, compu {255=PDUR_NO_RMBUFFEREDTPPROPERTIESROMPARTITIONIDXOFRMSRCROM}, range raw 0..255}
                RmDestRomEndIdxOfRmSrcRom: resulting-properties={base-type=uint8, sw-calibration-access=READ-ONLY, range raw 0..255}
                RmDestRomStartIdxOfRmSrcRom: resulting-properties={base-type=uint8, sw-calibration-access=READ-ONLY, range raw 0..255}
                SrcHndOfRmSrcRom: resulting-properties={base-type=uint8, sw-calibration-access=READ-ONLY, compu {255=PDUR_NO_SRCHNDOFRMSRCROM}, range raw 0..255}
            Element_43: symbol=[43]
              8 x mc data instance, all with category=VALUE:
                LockRomIdxOfRmSrcRom: resulting-properties={base-type=uint8, sw-calibration-access=READ-ONLY, range raw 0..255}
                MaskedBitsOfRmSrcRom: resulting-properties={base-type=uint8, sw-calibration-access=READ-ONLY, range raw 0..255}
                MmRomIdxOfRmSrcRom: resulting-properties={base-type=uint8, sw-calibration-access=READ-ONLY, range raw 0..255}
                RmBufferedTpPropertiesRomIdxOfRmSrcRom: resulting-properties={base-type=uint8, sw-calibration-access=READ-ONLY, compu {255=PDUR_NO_RMBUFFEREDTPPROPERTIESROMIDXOFRMSRCROM}, range raw 0..255}
                RmBufferedTpPropertiesRomPartitionIdxOfRmSrcRom: resulting-properties={base-type=uint8, sw-calibration-access=READ-ONLY, compu {255=PDUR_NO_RMBUFFEREDTPPROPERTIESROMPARTITIONIDXOFRMSRCROM}, range raw 0..255}
                RmDestRomEndIdxOfRmSrcRom: resulting-properties={base-type=uint8, sw-calibration-access=READ-ONLY, range raw 0..255}
                RmDestRomStartIdxOfRmSrcRom: resulting-properties={base-type=uint8, sw-calibration-access=READ-ONLY, range raw 0..255}
                SrcHndOfRmSrcRom: resulting-properties={base-type=uint8, sw-calibration-access=READ-ONLY, compu {255=PDUR_NO_SRCHNDOFRMSRCROM}, range raw 0..255}
            Element_44: symbol=[44]
              8 x mc data instance, all with category=VALUE:
                LockRomIdxOfRmSrcRom: resulting-properties={base-type=uint8, sw-calibration-access=READ-ONLY, range raw 0..255}
                MaskedBitsOfRmSrcRom: resulting-properties={base-type=uint8, sw-calibration-access=READ-ONLY, range raw 0..255}
                MmRomIdxOfRmSrcRom: resulting-properties={base-type=uint8, sw-calibration-access=READ-ONLY, range raw 0..255}
                RmBufferedTpPropertiesRomIdxOfRmSrcRom: resulting-properties={base-type=uint8, sw-calibration-access=READ-ONLY, compu {255=PDUR_NO_RMBUFFEREDTPPROPERTIESROMIDXOFRMSRCROM}, range raw 0..255}
                RmBufferedTpPropertiesRomPartitionIdxOfRmSrcRom: resulting-properties={base-type=uint8, sw-calibration-access=READ-ONLY, compu {255=PDUR_NO_RMBUFFEREDTPPROPERTIESROMPARTITIONIDXOFRMSRCROM}, range raw 0..255}
                RmDestRomEndIdxOfRmSrcRom: resulting-properties={base-type=uint8, sw-calibration-access=READ-ONLY, range raw 0..255}
                RmDestRomStartIdxOfRmSrcRom: resulting-properties={base-type=uint8, sw-calibration-access=READ-ONLY, range raw 0..255}
                SrcHndOfRmSrcRom: resulting-properties={base-type=uint8, sw-calibration-access=READ-ONLY, compu {255=PDUR_NO_SRCHNDOFRMSRCROM}, range raw 0..255}
            Element_45: symbol=[45]
              8 x mc data instance, all with category=VALUE:
                LockRomIdxOfRmSrcRom: resulting-properties={base-type=uint8, sw-calibration-access=READ-ONLY, range raw 0..255}
                MaskedBitsOfRmSrcRom: resulting-properties={base-type=uint8, sw-calibration-access=READ-ONLY, range raw 0..255}
                MmRomIdxOfRmSrcRom: resulting-properties={base-type=uint8, sw-calibration-access=READ-ONLY, range raw 0..255}
                RmBufferedTpPropertiesRomIdxOfRmSrcRom: resulting-properties={base-type=uint8, sw-calibration-access=READ-ONLY, compu {255=PDUR_NO_RMBUFFEREDTPPROPERTIESROMIDXOFRMSRCROM}, range raw 0..255}
                RmBufferedTpPropertiesRomPartitionIdxOfRmSrcRom: resulting-properties={base-type=uint8, sw-calibration-access=READ-ONLY, compu {255=PDUR_NO_RMBUFFEREDTPPROPERTIESROMPARTITIONIDXOFRMSRCROM}, range raw 0..255}
                RmDestRomEndIdxOfRmSrcRom: resulting-properties={base-type=uint8, sw-calibration-access=READ-ONLY, range raw 0..255}
                RmDestRomStartIdxOfRmSrcRom: resulting-properties={base-type=uint8, sw-calibration-access=READ-ONLY, range raw 0..255}
                SrcHndOfRmSrcRom: resulting-properties={base-type=uint8, sw-calibration-access=READ-ONLY, compu {255=PDUR_NO_SRCHNDOFRMSRCROM}, range raw 0..255}
            Element_46: symbol=[46]
              8 x mc data instance, all with category=VALUE:
                LockRomIdxOfRmSrcRom: resulting-properties={base-type=uint8, sw-calibration-access=READ-ONLY, range raw 0..255}
                MaskedBitsOfRmSrcRom: resulting-properties={base-type=uint8, sw-calibration-access=READ-ONLY, range raw 0..255}
                MmRomIdxOfRmSrcRom: resulting-properties={base-type=uint8, sw-calibration-access=READ-ONLY, range raw 0..255}
                RmBufferedTpPropertiesRomIdxOfRmSrcRom: resulting-properties={base-type=uint8, sw-calibration-access=READ-ONLY, compu {255=PDUR_NO_RMBUFFEREDTPPROPERTIESROMIDXOFRMSRCROM}, range raw 0..255}
                RmBufferedTpPropertiesRomPartitionIdxOfRmSrcRom: resulting-properties={base-type=uint8, sw-calibration-access=READ-ONLY, compu {255=PDUR_NO_RMBUFFEREDTPPROPERTIESROMPARTITIONIDXOFRMSRCROM}, range raw 0..255}
                RmDestRomEndIdxOfRmSrcRom: resulting-properties={base-type=uint8, sw-calibration-access=READ-ONLY, range raw 0..255}
                RmDestRomStartIdxOfRmSrcRom: resulting-properties={base-type=uint8, sw-calibration-access=READ-ONLY, range raw 0..255}
                SrcHndOfRmSrcRom: resulting-properties={base-type=uint8, sw-calibration-access=READ-ONLY, compu {255=PDUR_NO_SRCHNDOFRMSRCROM}, range raw 0..255}
            Element_47: symbol=[47]
              8 x mc data instance, all with category=VALUE:
                LockRomIdxOfRmSrcRom: resulting-properties={base-type=uint8, sw-calibration-access=READ-ONLY, range raw 0..255}
                MaskedBitsOfRmSrcRom: resulting-properties={base-type=uint8, sw-calibration-access=READ-ONLY, range raw 0..255}
                MmRomIdxOfRmSrcRom: resulting-properties={base-type=uint8, sw-calibration-access=READ-ONLY, range raw 0..255}
                RmBufferedTpPropertiesRomIdxOfRmSrcRom: resulting-properties={base-type=uint8, sw-calibration-access=READ-ONLY, compu {255=PDUR_NO_RMBUFFEREDTPPROPERTIESROMIDXOFRMSRCROM}, range raw 0..255}
                RmBufferedTpPropertiesRomPartitionIdxOfRmSrcRom: resulting-properties={base-type=uint8, sw-calibration-access=READ-ONLY, compu {255=PDUR_NO_RMBUFFEREDTPPROPERTIESROMPARTITIONIDXOFRMSRCROM}, range raw 0..255}
                RmDestRomEndIdxOfRmSrcRom: resulting-properties={base-type=uint8, sw-calibration-access=READ-ONLY, range raw 0..255}
                RmDestRomStartIdxOfRmSrcRom: resulting-properties={base-type=uint8, sw-calibration-access=READ-ONLY, range raw 0..255}
                SrcHndOfRmSrcRom: resulting-properties={base-type=uint8, sw-calibration-access=READ-ONLY, compu {255=PDUR_NO_SRCHNDOFRMSRCROM}, range raw 0..255}
            Element_48: symbol=[48]
              8 x mc data instance, all with category=VALUE:
                LockRomIdxOfRmSrcRom: resulting-properties={base-type=uint8, sw-calibration-access=READ-ONLY, range raw 0..255}
                MaskedBitsOfRmSrcRom: resulting-properties={base-type=uint8, sw-calibration-access=READ-ONLY, range raw 0..255}
                MmRomIdxOfRmSrcRom: resulting-properties={base-type=uint8, sw-calibration-access=READ-ONLY, range raw 0..255}
                RmBufferedTpPropertiesRomIdxOfRmSrcRom: resulting-properties={base-type=uint8, sw-calibration-access=READ-ONLY, compu {255=PDUR_NO_RMBUFFEREDTPPROPERTIESROMIDXOFRMSRCROM}, range raw 0..255}
                RmBufferedTpPropertiesRomPartitionIdxOfRmSrcRom: resulting-properties={base-type=uint8, sw-calibration-access=READ-ONLY, compu {255=PDUR_NO_RMBUFFEREDTPPROPERTIESROMPARTITIONIDXOFRMSRCROM}, range raw 0..255}
                RmDestRomEndIdxOfRmSrcRom: resulting-properties={base-type=uint8, sw-calibration-access=READ-ONLY, range raw 0..255}
                RmDestRomStartIdxOfRmSrcRom: resulting-properties={base-type=uint8, sw-calibration-access=READ-ONLY, range raw 0..255}
                SrcHndOfRmSrcRom: resulting-properties={base-type=uint8, sw-calibration-access=READ-ONLY, compu {255=PDUR_NO_SRCHNDOFRMSRCROM}, range raw 0..255}
            Element_49: symbol=[49]
              8 x mc data instance, all with category=VALUE:
                LockRomIdxOfRmSrcRom: resulting-properties={base-type=uint8, sw-calibration-access=READ-ONLY, range raw 0..255}
                MaskedBitsOfRmSrcRom: resulting-properties={base-type=uint8, sw-calibration-access=READ-ONLY, range raw 0..255}
                MmRomIdxOfRmSrcRom: resulting-properties={base-type=uint8, sw-calibration-access=READ-ONLY, range raw 0..255}
                RmBufferedTpPropertiesRomIdxOfRmSrcRom: resulting-properties={base-type=uint8, sw-calibration-access=READ-ONLY, compu {255=PDUR_NO_RMBUFFEREDTPPROPERTIESROMIDXOFRMSRCROM}, range raw 0..255}
                RmBufferedTpPropertiesRomPartitionIdxOfRmSrcRom: resulting-properties={base-type=uint8, sw-calibration-access=READ-ONLY, compu {255=PDUR_NO_RMBUFFEREDTPPROPERTIESROMPARTITIONIDXOFRMSRCROM}, range raw 0..255}
                RmDestRomEndIdxOfRmSrcRom: resulting-properties={base-type=uint8, sw-calibration-access=READ-ONLY, range raw 0..255}
                RmDestRomStartIdxOfRmSrcRom: resulting-properties={base-type=uint8, sw-calibration-access=READ-ONLY, range raw 0..255}
                SrcHndOfRmSrcRom: resulting-properties={base-type=uint8, sw-calibration-access=READ-ONLY, compu {255=PDUR_NO_SRCHNDOFRMSRCROM}, range raw 0..255}
            Element_50: symbol=[50]
              8 x mc data instance, all with category=VALUE:
                LockRomIdxOfRmSrcRom: resulting-properties={base-type=uint8, sw-calibration-access=READ-ONLY, range raw 0..255}
                MaskedBitsOfRmSrcRom: resulting-properties={base-type=uint8, sw-calibration-access=READ-ONLY, range raw 0..255}
                MmRomIdxOfRmSrcRom: resulting-properties={base-type=uint8, sw-calibration-access=READ-ONLY, range raw 0..255}
                RmBufferedTpPropertiesRomIdxOfRmSrcRom: resulting-properties={base-type=uint8, sw-calibration-access=READ-ONLY, compu {255=PDUR_NO_RMBUFFEREDTPPROPERTIESROMIDXOFRMSRCROM}, range raw 0..255}
                RmBufferedTpPropertiesRomPartitionIdxOfRmSrcRom: resulting-properties={base-type=uint8, sw-calibration-access=READ-ONLY, compu {255=PDUR_NO_RMBUFFEREDTPPROPERTIESROMPARTITIONIDXOFRMSRCROM}, range raw 0..255}
                RmDestRomEndIdxOfRmSrcRom: resulting-properties={base-type=uint8, sw-calibration-access=READ-ONLY, range raw 0..255}
                RmDestRomStartIdxOfRmSrcRom: resulting-properties={base-type=uint8, sw-calibration-access=READ-ONLY, range raw 0..255}
                SrcHndOfRmSrcRom: resulting-properties={base-type=uint8, sw-calibration-access=READ-ONLY, compu {255=PDUR_NO_SRCHNDOFRMSRCROM}, range raw 0..255}
            Element_51: symbol=[51]
              8 x mc data instance, all with category=VALUE:
                LockRomIdxOfRmSrcRom: resulting-properties={base-type=uint8, sw-calibration-access=READ-ONLY, range raw 0..255}
                MaskedBitsOfRmSrcRom: resulting-properties={base-type=uint8, sw-calibration-access=READ-ONLY, range raw 0..255}
                MmRomIdxOfRmSrcRom: resulting-properties={base-type=uint8, sw-calibration-access=READ-ONLY, range raw 0..255}
                RmBufferedTpPropertiesRomIdxOfRmSrcRom: resulting-properties={base-type=uint8, sw-calibration-access=READ-ONLY, compu {255=PDUR_NO_RMBUFFEREDTPPROPERTIESROMIDXOFRMSRCROM}, range raw 0..255}
                RmBufferedTpPropertiesRomPartitionIdxOfRmSrcRom: resulting-properties={base-type=uint8, sw-calibration-access=READ-ONLY, compu {255=PDUR_NO_RMBUFFEREDTPPROPERTIESROMPARTITIONIDXOFRMSRCROM}, range raw 0..255}
                RmDestRomEndIdxOfRmSrcRom: resulting-properties={base-type=uint8, sw-calibration-access=READ-ONLY, range raw 0..255}
                RmDestRomStartIdxOfRmSrcRom: resulting-properties={base-type=uint8, sw-calibration-access=READ-ONLY, range raw 0..255}
                SrcHndOfRmSrcRom: resulting-properties={base-type=uint8, sw-calibration-access=READ-ONLY, compu {255=PDUR_NO_SRCHNDOFRMSRCROM}, range raw 0..255}
            Element_52: symbol=[52]
              8 x mc data instance, all with category=VALUE:
                LockRomIdxOfRmSrcRom: resulting-properties={base-type=uint8, sw-calibration-access=READ-ONLY, range raw 0..255}
                MaskedBitsOfRmSrcRom: resulting-properties={base-type=uint8, sw-calibration-access=READ-ONLY, range raw 0..255}
                MmRomIdxOfRmSrcRom: resulting-properties={base-type=uint8, sw-calibration-access=READ-ONLY, range raw 0..255}
                RmBufferedTpPropertiesRomIdxOfRmSrcRom: resulting-properties={base-type=uint8, sw-calibration-access=READ-ONLY, compu {255=PDUR_NO_RMBUFFEREDTPPROPERTIESROMIDXOFRMSRCROM}, range raw 0..255}
                RmBufferedTpPropertiesRomPartitionIdxOfRmSrcRom: resulting-properties={base-type=uint8, sw-calibration-access=READ-ONLY, compu {255=PDUR_NO_RMBUFFEREDTPPROPERTIESROMPARTITIONIDXOFRMSRCROM}, range raw 0..255}
                RmDestRomEndIdxOfRmSrcRom: resulting-properties={base-type=uint8, sw-calibration-access=READ-ONLY, range raw 0..255}
                RmDestRomStartIdxOfRmSrcRom: resulting-properties={base-type=uint8, sw-calibration-access=READ-ONLY, range raw 0..255}
                SrcHndOfRmSrcRom: resulting-properties={base-type=uint8, sw-calibration-access=READ-ONLY, compu {255=PDUR_NO_SRCHNDOFRMSRCROM}, range raw 0..255}
            Element_53: symbol=[53]
              8 x mc data instance, all with category=VALUE:
                LockRomIdxOfRmSrcRom: resulting-properties={base-type=uint8, sw-calibration-access=READ-ONLY, range raw 0..255}
                MaskedBitsOfRmSrcRom: resulting-properties={base-type=uint8, sw-calibration-access=READ-ONLY, range raw 0..255}
                MmRomIdxOfRmSrcRom: resulting-properties={base-type=uint8, sw-calibration-access=READ-ONLY, range raw 0..255}
                RmBufferedTpPropertiesRomIdxOfRmSrcRom: resulting-properties={base-type=uint8, sw-calibration-access=READ-ONLY, compu {255=PDUR_NO_RMBUFFEREDTPPROPERTIESROMIDXOFRMSRCROM}, range raw 0..255}
                RmBufferedTpPropertiesRomPartitionIdxOfRmSrcRom: resulting-properties={base-type=uint8, sw-calibration-access=READ-ONLY, compu {255=PDUR_NO_RMBUFFEREDTPPROPERTIESROMPARTITIONIDXOFRMSRCROM}, range raw 0..255}
                RmDestRomEndIdxOfRmSrcRom: resulting-properties={base-type=uint8, sw-calibration-access=READ-ONLY, range raw 0..255}
                RmDestRomStartIdxOfRmSrcRom: resulting-properties={base-type=uint8, sw-calibration-access=READ-ONLY, range raw 0..255}
                SrcHndOfRmSrcRom: resulting-properties={base-type=uint8, sw-calibration-access=READ-ONLY, compu {255=PDUR_NO_SRCHNDOFRMSRCROM}, range raw 0..255}
            Element_54: symbol=[54]
              8 x mc data instance, all with category=VALUE:
                LockRomIdxOfRmSrcRom: resulting-properties={base-type=uint8, sw-calibration-access=READ-ONLY, range raw 0..255}
                MaskedBitsOfRmSrcRom: resulting-properties={base-type=uint8, sw-calibration-access=READ-ONLY, range raw 0..255}
                MmRomIdxOfRmSrcRom: resulting-properties={base-type=uint8, sw-calibration-access=READ-ONLY, range raw 0..255}
                RmBufferedTpPropertiesRomIdxOfRmSrcRom: resulting-properties={base-type=uint8, sw-calibration-access=READ-ONLY, compu {255=PDUR_NO_RMBUFFEREDTPPROPERTIESROMIDXOFRMSRCROM}, range raw 0..255}
                RmBufferedTpPropertiesRomPartitionIdxOfRmSrcRom: resulting-properties={base-type=uint8, sw-calibration-access=READ-ONLY, compu {255=PDUR_NO_RMBUFFEREDTPPROPERTIESROMPARTITIONIDXOFRMSRCROM}, range raw 0..255}
                RmDestRomEndIdxOfRmSrcRom: resulting-properties={base-type=uint8, sw-calibration-access=READ-ONLY, range raw 0..255}
                RmDestRomStartIdxOfRmSrcRom: resulting-properties={base-type=uint8, sw-calibration-access=READ-ONLY, range raw 0..255}
                SrcHndOfRmSrcRom: resulting-properties={base-type=uint8, sw-calibration-access=READ-ONLY, compu {255=PDUR_NO_SRCHNDOFRMSRCROM}, range raw 0..255}
            Element_55: symbol=[55]
              8 x mc data instance, all with category=VALUE:
                LockRomIdxOfRmSrcRom: resulting-properties={base-type=uint8, sw-calibration-access=READ-ONLY, range raw 0..255}
                MaskedBitsOfRmSrcRom: resulting-properties={base-type=uint8, sw-calibration-access=READ-ONLY, range raw 0..255}
                MmRomIdxOfRmSrcRom: resulting-properties={base-type=uint8, sw-calibration-access=READ-ONLY, range raw 0..255}
                RmBufferedTpPropertiesRomIdxOfRmSrcRom: resulting-properties={base-type=uint8, sw-calibration-access=READ-ONLY, compu {255=PDUR_NO_RMBUFFEREDTPPROPERTIESROMIDXOFRMSRCROM}, range raw 0..255}
                RmBufferedTpPropertiesRomPartitionIdxOfRmSrcRom: resulting-properties={base-type=uint8, sw-calibration-access=READ-ONLY, compu {255=PDUR_NO_RMBUFFEREDTPPROPERTIESROMPARTITIONIDXOFRMSRCROM}, range raw 0..255}
                RmDestRomEndIdxOfRmSrcRom: resulting-properties={base-type=uint8, sw-calibration-access=READ-ONLY, range raw 0..255}
                RmDestRomStartIdxOfRmSrcRom: resulting-properties={base-type=uint8, sw-calibration-access=READ-ONLY, range raw 0..255}
                SrcHndOfRmSrcRom: resulting-properties={base-type=uint8, sw-calibration-access=READ-ONLY, compu {255=PDUR_NO_SRCHNDOFRMSRCROM}, range raw 0..255}
            Element_56: symbol=[56]
              8 x mc data instance, all with category=VALUE:
                LockRomIdxOfRmSrcRom: resulting-properties={base-type=uint8, sw-calibration-access=READ-ONLY, range raw 0..255}
                MaskedBitsOfRmSrcRom: resulting-properties={base-type=uint8, sw-calibration-access=READ-ONLY, range raw 0..255}
                MmRomIdxOfRmSrcRom: resulting-properties={base-type=uint8, sw-calibration-access=READ-ONLY, range raw 0..255}
                RmBufferedTpPropertiesRomIdxOfRmSrcRom: resulting-properties={base-type=uint8, sw-calibration-access=READ-ONLY, compu {255=PDUR_NO_RMBUFFEREDTPPROPERTIESROMIDXOFRMSRCROM}, range raw 0..255}
                RmBufferedTpPropertiesRomPartitionIdxOfRmSrcRom: resulting-properties={base-type=uint8, sw-calibration-access=READ-ONLY, compu {255=PDUR_NO_RMBUFFEREDTPPROPERTIESROMPARTITIONIDXOFRMSRCROM}, range raw 0..255}
                RmDestRomEndIdxOfRmSrcRom: resulting-properties={base-type=uint8, sw-calibration-access=READ-ONLY, range raw 0..255}
                RmDestRomStartIdxOfRmSrcRom: resulting-properties={base-type=uint8, sw-calibration-access=READ-ONLY, range raw 0..255}
                SrcHndOfRmSrcRom: resulting-properties={base-type=uint8, sw-calibration-access=READ-ONLY, compu {255=PDUR_NO_SRCHNDOFRMSRCROM}, range raw 0..255}
            Element_57: symbol=[57]
              8 x mc data instance, all with category=VALUE:
                LockRomIdxOfRmSrcRom: resulting-properties={base-type=uint8, sw-calibration-access=READ-ONLY, range raw 0..255}
                MaskedBitsOfRmSrcRom: resulting-properties={base-type=uint8, sw-calibration-access=READ-ONLY, range raw 0..255}
                MmRomIdxOfRmSrcRom: resulting-properties={base-type=uint8, sw-calibration-access=READ-ONLY, range raw 0..255}
                RmBufferedTpPropertiesRomIdxOfRmSrcRom: resulting-properties={base-type=uint8, sw-calibration-access=READ-ONLY, compu {255=PDUR_NO_RMBUFFEREDTPPROPERTIESROMIDXOFRMSRCROM}, range raw 0..255}
                RmBufferedTpPropertiesRomPartitionIdxOfRmSrcRom: resulting-properties={base-type=uint8, sw-calibration-access=READ-ONLY, compu {255=PDUR_NO_RMBUFFEREDTPPROPERTIESROMPARTITIONIDXOFRMSRCROM}, range raw 0..255}
                RmDestRomEndIdxOfRmSrcRom: resulting-properties={base-type=uint8, sw-calibration-access=READ-ONLY, range raw 0..255}
                RmDestRomStartIdxOfRmSrcRom: resulting-properties={base-type=uint8, sw-calibration-access=READ-ONLY, range raw 0..255}
                SrcHndOfRmSrcRom: resulting-properties={base-type=uint8, sw-calibration-access=READ-ONLY, compu {255=PDUR_NO_SRCHNDOFRMSRCROM}, range raw 0..255}
            Element_58: symbol=[58]
              8 x mc data instance, all with category=VALUE:
                LockRomIdxOfRmSrcRom: resulting-properties={base-type=uint8, sw-calibration-access=READ-ONLY, range raw 0..255}
                MaskedBitsOfRmSrcRom: resulting-properties={base-type=uint8, sw-calibration-access=READ-ONLY, range raw 0..255}
                MmRomIdxOfRmSrcRom: resulting-properties={base-type=uint8, sw-calibration-access=READ-ONLY, range raw 0..255}
                RmBufferedTpPropertiesRomIdxOfRmSrcRom: resulting-properties={base-type=uint8, sw-calibration-access=READ-ONLY, compu {255=PDUR_NO_RMBUFFEREDTPPROPERTIESROMIDXOFRMSRCROM}, range raw 0..255}
                RmBufferedTpPropertiesRomPartitionIdxOfRmSrcRom: resulting-properties={base-type=uint8, sw-calibration-access=READ-ONLY, compu {255=PDUR_NO_RMBUFFEREDTPPROPERTIESROMPARTITIONIDXOFRMSRCROM}, range raw 0..255}
                RmDestRomEndIdxOfRmSrcRom: resulting-properties={base-type=uint8, sw-calibration-access=READ-ONLY, range raw 0..255}
                RmDestRomStartIdxOfRmSrcRom: resulting-properties={base-type=uint8, sw-calibration-access=READ-ONLY, range raw 0..255}
                SrcHndOfRmSrcRom: resulting-properties={base-type=uint8, sw-calibration-access=READ-ONLY, compu {255=PDUR_NO_SRCHNDOFRMSRCROM}, range raw 0..255}
            Element_59: symbol=[59]
              8 x mc data instance, all with category=VALUE:
                LockRomIdxOfRmSrcRom: resulting-properties={base-type=uint8, sw-calibration-access=READ-ONLY, range raw 0..255}
                MaskedBitsOfRmSrcRom: resulting-properties={base-type=uint8, sw-calibration-access=READ-ONLY, range raw 0..255}
                MmRomIdxOfRmSrcRom: resulting-properties={base-type=uint8, sw-calibration-access=READ-ONLY, range raw 0..255}
                RmBufferedTpPropertiesRomIdxOfRmSrcRom: resulting-properties={base-type=uint8, sw-calibration-access=READ-ONLY, compu {255=PDUR_NO_RMBUFFEREDTPPROPERTIESROMIDXOFRMSRCROM}, range raw 0..255}
                RmBufferedTpPropertiesRomPartitionIdxOfRmSrcRom: resulting-properties={base-type=uint8, sw-calibration-access=READ-ONLY, compu {255=PDUR_NO_RMBUFFEREDTPPROPERTIESROMPARTITIONIDXOFRMSRCROM}, range raw 0..255}
                RmDestRomEndIdxOfRmSrcRom: resulting-properties={base-type=uint8, sw-calibration-access=READ-ONLY, range raw 0..255}
                RmDestRomStartIdxOfRmSrcRom: resulting-properties={base-type=uint8, sw-calibration-access=READ-ONLY, range raw 0..255}
                SrcHndOfRmSrcRom: resulting-properties={base-type=uint8, sw-calibration-access=READ-ONLY, compu {255=PDUR_NO_SRCHNDOFRMSRCROM}, range raw 0..255}
            Element_60: symbol=[60]
              8 x mc data instance, all with category=VALUE:
                LockRomIdxOfRmSrcRom: resulting-properties={base-type=uint8, sw-calibration-access=READ-ONLY, range raw 0..255}
                MaskedBitsOfRmSrcRom: resulting-properties={base-type=uint8, sw-calibration-access=READ-ONLY, range raw 0..255}
                MmRomIdxOfRmSrcRom: resulting-properties={base-type=uint8, sw-calibration-access=READ-ONLY, range raw 0..255}
                RmBufferedTpPropertiesRomIdxOfRmSrcRom: resulting-properties={base-type=uint8, sw-calibration-access=READ-ONLY, compu {255=PDUR_NO_RMBUFFEREDTPPROPERTIESROMIDXOFRMSRCROM}, range raw 0..255}
                RmBufferedTpPropertiesRomPartitionIdxOfRmSrcRom: resulting-properties={base-type=uint8, sw-calibration-access=READ-ONLY, compu {255=PDUR_NO_RMBUFFEREDTPPROPERTIESROMPARTITIONIDXOFRMSRCROM}, range raw 0..255}
                RmDestRomEndIdxOfRmSrcRom: resulting-properties={base-type=uint8, sw-calibration-access=READ-ONLY, range raw 0..255}
                RmDestRomStartIdxOfRmSrcRom: resulting-properties={base-type=uint8, sw-calibration-access=READ-ONLY, range raw 0..255}
                SrcHndOfRmSrcRom: resulting-properties={base-type=uint8, sw-calibration-access=READ-ONLY, compu {255=PDUR_NO_SRCHNDOFRMSRCROM}, range raw 0..255}
            Element_61: symbol=[61]
              8 x mc data instance, all with category=VALUE:
                LockRomIdxOfRmSrcRom: resulting-properties={base-type=uint8, sw-calibration-access=READ-ONLY, range raw 0..255}
                MaskedBitsOfRmSrcRom: resulting-properties={base-type=uint8, sw-calibration-access=READ-ONLY, range raw 0..255}
                MmRomIdxOfRmSrcRom: resulting-properties={base-type=uint8, sw-calibration-access=READ-ONLY, range raw 0..255}
                RmBufferedTpPropertiesRomIdxOfRmSrcRom: resulting-properties={base-type=uint8, sw-calibration-access=READ-ONLY, compu {255=PDUR_NO_RMBUFFEREDTPPROPERTIESROMIDXOFRMSRCROM}, range raw 0..255}
                RmBufferedTpPropertiesRomPartitionIdxOfRmSrcRom: resulting-properties={base-type=uint8, sw-calibration-access=READ-ONLY, compu {255=PDUR_NO_RMBUFFEREDTPPROPERTIESROMPARTITIONIDXOFRMSRCROM}, range raw 0..255}
                RmDestRomEndIdxOfRmSrcRom: resulting-properties={base-type=uint8, sw-calibration-access=READ-ONLY, range raw 0..255}
                RmDestRomStartIdxOfRmSrcRom: resulting-properties={base-type=uint8, sw-calibration-access=READ-ONLY, range raw 0..255}
                SrcHndOfRmSrcRom: resulting-properties={base-type=uint8, sw-calibration-access=READ-ONLY, compu {255=PDUR_NO_SRCHNDOFRMSRCROM}, range raw 0..255}
            Element_62: symbol=[62]
              8 x mc data instance, all with category=VALUE:
                LockRomIdxOfRmSrcRom: resulting-properties={base-type=uint8, sw-calibration-access=READ-ONLY, range raw 0..255}
                MaskedBitsOfRmSrcRom: resulting-properties={base-type=uint8, sw-calibration-access=READ-ONLY, range raw 0..255}
                MmRomIdxOfRmSrcRom: resulting-properties={base-type=uint8, sw-calibration-access=READ-ONLY, range raw 0..255}
                RmBufferedTpPropertiesRomIdxOfRmSrcRom: resulting-properties={base-type=uint8, sw-calibration-access=READ-ONLY, compu {255=PDUR_NO_RMBUFFEREDTPPROPERTIESROMIDXOFRMSRCROM}, range raw 0..255}
                RmBufferedTpPropertiesRomPartitionIdxOfRmSrcRom: resulting-properties={base-type=uint8, sw-calibration-access=READ-ONLY, compu {255=PDUR_NO_RMBUFFEREDTPPROPERTIESROMPARTITIONIDXOFRMSRCROM}, range raw 0..255}
                RmDestRomEndIdxOfRmSrcRom: resulting-properties={base-type=uint8, sw-calibration-access=READ-ONLY, range raw 0..255}
                RmDestRomStartIdxOfRmSrcRom: resulting-properties={base-type=uint8, sw-calibration-access=READ-ONLY, range raw 0..255}
                SrcHndOfRmSrcRom: resulting-properties={base-type=uint8, sw-calibration-access=READ-ONLY, compu {255=PDUR_NO_SRCHNDOFRMSRCROM}, range raw 0..255}
            Element_63: symbol=[63]
              8 x mc data instance, all with category=VALUE:
                LockRomIdxOfRmSrcRom: resulting-properties={base-type=uint8, sw-calibration-access=READ-ONLY, range raw 0..255}
                MaskedBitsOfRmSrcRom: resulting-properties={base-type=uint8, sw-calibration-access=READ-ONLY, range raw 0..255}
                MmRomIdxOfRmSrcRom: resulting-properties={base-type=uint8, sw-calibration-access=READ-ONLY, range raw 0..255}
                RmBufferedTpPropertiesRomIdxOfRmSrcRom: resulting-properties={base-type=uint8, sw-calibration-access=READ-ONLY, compu {255=PDUR_NO_RMBUFFEREDTPPROPERTIESROMIDXOFRMSRCROM}, range raw 0..255}
                RmBufferedTpPropertiesRomPartitionIdxOfRmSrcRom: resulting-properties={base-type=uint8, sw-calibration-access=READ-ONLY, compu {255=PDUR_NO_RMBUFFEREDTPPROPERTIESROMPARTITIONIDXOFRMSRCROM}, range raw 0..255}
                RmDestRomEndIdxOfRmSrcRom: resulting-properties={base-type=uint8, sw-calibration-access=READ-ONLY, range raw 0..255}
                RmDestRomStartIdxOfRmSrcRom: resulting-properties={base-type=uint8, sw-calibration-access=READ-ONLY, range raw 0..255}
                SrcHndOfRmSrcRom: resulting-properties={base-type=uint8, sw-calibration-access=READ-ONLY, compu {255=PDUR_NO_SRCHNDOFRMSRCROM}, range raw 0..255}
            Element_64: symbol=[64]
              8 x mc data instance, all with category=VALUE:
                LockRomIdxOfRmSrcRom: resulting-properties={base-type=uint8, sw-calibration-access=READ-ONLY, range raw 0..255}
                MaskedBitsOfRmSrcRom: resulting-properties={base-type=uint8, sw-calibration-access=READ-ONLY, range raw 0..255}
                MmRomIdxOfRmSrcRom: resulting-properties={base-type=uint8, sw-calibration-access=READ-ONLY, range raw 0..255}
                RmBufferedTpPropertiesRomIdxOfRmSrcRom: resulting-properties={base-type=uint8, sw-calibration-access=READ-ONLY, compu {255=PDUR_NO_RMBUFFEREDTPPROPERTIESROMIDXOFRMSRCROM}, range raw 0..255}
                RmBufferedTpPropertiesRomPartitionIdxOfRmSrcRom: resulting-properties={base-type=uint8, sw-calibration-access=READ-ONLY, compu {255=PDUR_NO_RMBUFFEREDTPPROPERTIESROMPARTITIONIDXOFRMSRCROM}, range raw 0..255}
                RmDestRomEndIdxOfRmSrcRom: resulting-properties={base-type=uint8, sw-calibration-access=READ-ONLY, range raw 0..255}
                RmDestRomStartIdxOfRmSrcRom: resulting-properties={base-type=uint8, sw-calibration-access=READ-ONLY, range raw 0..255}
                SrcHndOfRmSrcRom: resulting-properties={base-type=uint8, sw-calibration-access=READ-ONLY, compu {255=PDUR_NO_SRCHNDOFRMSRCROM}, range raw 0..255}
            Element_65: symbol=[65]
              8 x mc data instance, all with category=VALUE:
                LockRomIdxOfRmSrcRom: resulting-properties={base-type=uint8, sw-calibration-access=READ-ONLY, range raw 0..255}
                MaskedBitsOfRmSrcRom: resulting-properties={base-type=uint8, sw-calibration-access=READ-ONLY, range raw 0..255}
                MmRomIdxOfRmSrcRom: resulting-properties={base-type=uint8, sw-calibration-access=READ-ONLY, range raw 0..255}
                RmBufferedTpPropertiesRomIdxOfRmSrcRom: resulting-properties={base-type=uint8, sw-calibration-access=READ-ONLY, compu {255=PDUR_NO_RMBUFFEREDTPPROPERTIESROMIDXOFRMSRCROM}, range raw 0..255}
                RmBufferedTpPropertiesRomPartitionIdxOfRmSrcRom: resulting-properties={base-type=uint8, sw-calibration-access=READ-ONLY, compu {255=PDUR_NO_RMBUFFEREDTPPROPERTIESROMPARTITIONIDXOFRMSRCROM}, range raw 0..255}
                RmDestRomEndIdxOfRmSrcRom: resulting-properties={base-type=uint8, sw-calibration-access=READ-ONLY, range raw 0..255}
                RmDestRomStartIdxOfRmSrcRom: resulting-properties={base-type=uint8, sw-calibration-access=READ-ONLY, range raw 0..255}
                SrcHndOfRmSrcRom: resulting-properties={base-type=uint8, sw-calibration-access=READ-ONLY, compu {255=PDUR_NO_SRCHNDOFRMSRCROM}, range raw 0..255}
            Element_66: symbol=[66]
              8 x mc data instance, all with category=VALUE:
                LockRomIdxOfRmSrcRom: resulting-properties={base-type=uint8, sw-calibration-access=READ-ONLY, range raw 0..255}
                MaskedBitsOfRmSrcRom: resulting-properties={base-type=uint8, sw-calibration-access=READ-ONLY, range raw 0..255}
                MmRomIdxOfRmSrcRom: resulting-properties={base-type=uint8, sw-calibration-access=READ-ONLY, range raw 0..255}
                RmBufferedTpPropertiesRomIdxOfRmSrcRom: resulting-properties={base-type=uint8, sw-calibration-access=READ-ONLY, compu {255=PDUR_NO_RMBUFFEREDTPPROPERTIESROMIDXOFRMSRCROM}, range raw 0..255}
                RmBufferedTpPropertiesRomPartitionIdxOfRmSrcRom: resulting-properties={base-type=uint8, sw-calibration-access=READ-ONLY, compu {255=PDUR_NO_RMBUFFEREDTPPROPERTIESROMPARTITIONIDXOFRMSRCROM}, range raw 0..255}
                RmDestRomEndIdxOfRmSrcRom: resulting-properties={base-type=uint8, sw-calibration-access=READ-ONLY, range raw 0..255}
                RmDestRomStartIdxOfRmSrcRom: resulting-properties={base-type=uint8, sw-calibration-access=READ-ONLY, range raw 0..255}
                SrcHndOfRmSrcRom: resulting-properties={base-type=uint8, sw-calibration-access=READ-ONLY, compu {255=PDUR_NO_SRCHNDOFRMSRCROM}, range raw 0..255}
            Element_67: symbol=[67]
              8 x mc data instance, all with category=VALUE:
                LockRomIdxOfRmSrcRom: resulting-properties={base-type=uint8, sw-calibration-access=READ-ONLY, range raw 0..255}
                MaskedBitsOfRmSrcRom: resulting-properties={base-type=uint8, sw-calibration-access=READ-ONLY, range raw 0..255}
                MmRomIdxOfRmSrcRom: resulting-properties={base-type=uint8, sw-calibration-access=READ-ONLY, range raw 0..255}
                RmBufferedTpPropertiesRomIdxOfRmSrcRom: resulting-properties={base-type=uint8, sw-calibration-access=READ-ONLY, compu {255=PDUR_NO_RMBUFFEREDTPPROPERTIESROMIDXOFRMSRCROM}, range raw 0..255}
                RmBufferedTpPropertiesRomPartitionIdxOfRmSrcRom: resulting-properties={base-type=uint8, sw-calibration-access=READ-ONLY, compu {255=PDUR_NO_RMBUFFEREDTPPROPERTIESROMPARTITIONIDXOFRMSRCROM}, range raw 0..255}
                RmDestRomEndIdxOfRmSrcRom: resulting-properties={base-type=uint8, sw-calibration-access=READ-ONLY, range raw 0..255}
                RmDestRomStartIdxOfRmSrcRom: resulting-properties={base-type=uint8, sw-calibration-access=READ-ONLY, range raw 0..255}
                SrcHndOfRmSrcRom: resulting-properties={base-type=uint8, sw-calibration-access=READ-ONLY, compu {255=PDUR_NO_SRCHNDOFRMSRCROM}, range raw 0..255}
            Element_68: symbol=[68]
              8 x mc data instance, all with category=VALUE:
                LockRomIdxOfRmSrcRom: resulting-properties={base-type=uint8, sw-calibration-access=READ-ONLY, range raw 0..255}
                MaskedBitsOfRmSrcRom: resulting-properties={base-type=uint8, sw-calibration-access=READ-ONLY, range raw 0..255}
                MmRomIdxOfRmSrcRom: resulting-properties={base-type=uint8, sw-calibration-access=READ-ONLY, range raw 0..255}
                RmBufferedTpPropertiesRomIdxOfRmSrcRom: resulting-properties={base-type=uint8, sw-calibration-access=READ-ONLY, compu {255=PDUR_NO_RMBUFFEREDTPPROPERTIESROMIDXOFRMSRCROM}, range raw 0..255}
                RmBufferedTpPropertiesRomPartitionIdxOfRmSrcRom: resulting-properties={base-type=uint8, sw-calibration-access=READ-ONLY, compu {255=PDUR_NO_RMBUFFEREDTPPROPERTIESROMPARTITIONIDXOFRMSRCROM}, range raw 0..255}
                RmDestRomEndIdxOfRmSrcRom: resulting-properties={base-type=uint8, sw-calibration-access=READ-ONLY, range raw 0..255}
                RmDestRomStartIdxOfRmSrcRom: resulting-properties={base-type=uint8, sw-calibration-access=READ-ONLY, range raw 0..255}
                SrcHndOfRmSrcRom: resulting-properties={base-type=uint8, sw-calibration-access=READ-ONLY, compu {255=PDUR_NO_SRCHNDOFRMSRCROM}, range raw 0..255}
            Element_69: symbol=[69]
              8 x mc data instance, all with category=VALUE:
                LockRomIdxOfRmSrcRom: resulting-properties={base-type=uint8, sw-calibration-access=READ-ONLY, range raw 0..255}
                MaskedBitsOfRmSrcRom: resulting-properties={base-type=uint8, sw-calibration-access=READ-ONLY, range raw 0..255}
                MmRomIdxOfRmSrcRom: resulting-properties={base-type=uint8, sw-calibration-access=READ-ONLY, range raw 0..255}
                RmBufferedTpPropertiesRomIdxOfRmSrcRom: resulting-properties={base-type=uint8, sw-calibration-access=READ-ONLY, compu {255=PDUR_NO_RMBUFFEREDTPPROPERTIESROMIDXOFRMSRCROM}, range raw 0..255}
                RmBufferedTpPropertiesRomPartitionIdxOfRmSrcRom: resulting-properties={base-type=uint8, sw-calibration-access=READ-ONLY, compu {255=PDUR_NO_RMBUFFEREDTPPROPERTIESROMPARTITIONIDXOFRMSRCROM}, range raw 0..255}
                RmDestRomEndIdxOfRmSrcRom: resulting-properties={base-type=uint8, sw-calibration-access=READ-ONLY, range raw 0..255}
                RmDestRomStartIdxOfRmSrcRom: resulting-properties={base-type=uint8, sw-calibration-access=READ-ONLY, range raw 0..255}
                SrcHndOfRmSrcRom: resulting-properties={base-type=uint8, sw-calibration-access=READ-ONLY, compu {255=PDUR_NO_SRCHNDOFRMSRCROM}, range raw 0..255}
            Element_70: symbol=[70]
              8 x mc data instance, all with category=VALUE:
                LockRomIdxOfRmSrcRom: resulting-properties={base-type=uint8, sw-calibration-access=READ-ONLY, range raw 0..255}
                MaskedBitsOfRmSrcRom: resulting-properties={base-type=uint8, sw-calibration-access=READ-ONLY, range raw 0..255}
                MmRomIdxOfRmSrcRom: resulting-properties={base-type=uint8, sw-calibration-access=READ-ONLY, range raw 0..255}
                RmBufferedTpPropertiesRomIdxOfRmSrcRom: resulting-properties={base-type=uint8, sw-calibration-access=READ-ONLY, compu {255=PDUR_NO_RMBUFFEREDTPPROPERTIESROMIDXOFRMSRCROM}, range raw 0..255}
                RmBufferedTpPropertiesRomPartitionIdxOfRmSrcRom: resulting-properties={base-type=uint8, sw-calibration-access=READ-ONLY, compu {255=PDUR_NO_RMBUFFEREDTPPROPERTIESROMPARTITIONIDXOFRMSRCROM}, range raw 0..255}
                RmDestRomEndIdxOfRmSrcRom: resulting-properties={base-type=uint8, sw-calibration-access=READ-ONLY, range raw 0..255}
                RmDestRomStartIdxOfRmSrcRom: resulting-properties={base-type=uint8, sw-calibration-access=READ-ONLY, range raw 0..255}
                SrcHndOfRmSrcRom: resulting-properties={base-type=uint8, sw-calibration-access=READ-ONLY, compu {255=PDUR_NO_SRCHNDOFRMSRCROM}, range raw 0..255}
            Element_71: symbol=[71]
              8 x mc data instance, all with category=VALUE:
                LockRomIdxOfRmSrcRom: resulting-properties={base-type=uint8, sw-calibration-access=READ-ONLY, range raw 0..255}
                MaskedBitsOfRmSrcRom: resulting-properties={base-type=uint8, sw-calibration-access=READ-ONLY, range raw 0..255}
                MmRomIdxOfRmSrcRom: resulting-properties={base-type=uint8, sw-calibration-access=READ-ONLY, range raw 0..255}
                RmBufferedTpPropertiesRomIdxOfRmSrcRom: resulting-properties={base-type=uint8, sw-calibration-access=READ-ONLY, compu {255=PDUR_NO_RMBUFFEREDTPPROPERTIESROMIDXOFRMSRCROM}, range raw 0..255}
                RmBufferedTpPropertiesRomPartitionIdxOfRmSrcRom: resulting-properties={base-type=uint8, sw-calibration-access=READ-ONLY, compu {255=PDUR_NO_RMBUFFEREDTPPROPERTIESROMPARTITIONIDXOFRMSRCROM}, range raw 0..255}
                RmDestRomEndIdxOfRmSrcRom: resulting-properties={base-type=uint8, sw-calibration-access=READ-ONLY, range raw 0..255}
                RmDestRomStartIdxOfRmSrcRom: resulting-properties={base-type=uint8, sw-calibration-access=READ-ONLY, range raw 0..255}
                SrcHndOfRmSrcRom: resulting-properties={base-type=uint8, sw-calibration-access=READ-ONLY, compu {255=PDUR_NO_SRCHNDOFRMSRCROM}, range raw 0..255}
            Element_72: symbol=[72]
              8 x mc data instance, all with category=VALUE:
                LockRomIdxOfRmSrcRom: resulting-properties={base-type=uint8, sw-calibration-access=READ-ONLY, range raw 0..255}
                MaskedBitsOfRmSrcRom: resulting-properties={base-type=uint8, sw-calibration-access=READ-ONLY, range raw 0..255}
                MmRomIdxOfRmSrcRom: resulting-properties={base-type=uint8, sw-calibration-access=READ-ONLY, range raw 0..255}
                RmBufferedTpPropertiesRomIdxOfRmSrcRom: resulting-properties={base-type=uint8, sw-calibration-access=READ-ONLY, compu {255=PDUR_NO_RMBUFFEREDTPPROPERTIESROMIDXOFRMSRCROM}, range raw 0..255}
                RmBufferedTpPropertiesRomPartitionIdxOfRmSrcRom: resulting-properties={base-type=uint8, sw-calibration-access=READ-ONLY, compu {255=PDUR_NO_RMBUFFEREDTPPROPERTIESROMPARTITIONIDXOFRMSRCROM}, range raw 0..255}
                RmDestRomEndIdxOfRmSrcRom: resulting-properties={base-type=uint8, sw-calibration-access=READ-ONLY, range raw 0..255}
                RmDestRomStartIdxOfRmSrcRom: resulting-properties={base-type=uint8, sw-calibration-access=READ-ONLY, range raw 0..255}
                SrcHndOfRmSrcRom: resulting-properties={base-type=uint8, sw-calibration-access=READ-ONLY, compu {255=PDUR_NO_SRCHNDOFRMSRCROM}, range raw 0..255}
            Element_73: symbol=[73]
              8 x mc data instance, all with category=VALUE:
                LockRomIdxOfRmSrcRom: resulting-properties={base-type=uint8, sw-calibration-access=READ-ONLY, range raw 0..255}
                MaskedBitsOfRmSrcRom: resulting-properties={base-type=uint8, sw-calibration-access=READ-ONLY, range raw 0..255}
                MmRomIdxOfRmSrcRom: resulting-properties={base-type=uint8, sw-calibration-access=READ-ONLY, range raw 0..255}
                RmBufferedTpPropertiesRomIdxOfRmSrcRom: resulting-properties={base-type=uint8, sw-calibration-access=READ-ONLY, compu {255=PDUR_NO_RMBUFFEREDTPPROPERTIESROMIDXOFRMSRCROM}, range raw 0..255}
                RmBufferedTpPropertiesRomPartitionIdxOfRmSrcRom: resulting-properties={base-type=uint8, sw-calibration-access=READ-ONLY, compu {255=PDUR_NO_RMBUFFEREDTPPROPERTIESROMPARTITIONIDXOFRMSRCROM}, range raw 0..255}
                RmDestRomEndIdxOfRmSrcRom: resulting-properties={base-type=uint8, sw-calibration-access=READ-ONLY, range raw 0..255}
                RmDestRomStartIdxOfRmSrcRom: resulting-properties={base-type=uint8, sw-calibration-access=READ-ONLY, range raw 0..255}
                SrcHndOfRmSrcRom: resulting-properties={base-type=uint8, sw-calibration-access=READ-ONLY, compu {255=PDUR_NO_SRCHNDOFRMSRCROM}, range raw 0..255}
            Element_74: symbol=[74]
              8 x mc data instance, all with category=VALUE:
                LockRomIdxOfRmSrcRom: resulting-properties={base-type=uint8, sw-calibration-access=READ-ONLY, range raw 0..255}
                MaskedBitsOfRmSrcRom: resulting-properties={base-type=uint8, sw-calibration-access=READ-ONLY, range raw 0..255}
                MmRomIdxOfRmSrcRom: resulting-properties={base-type=uint8, sw-calibration-access=READ-ONLY, range raw 0..255}
                RmBufferedTpPropertiesRomIdxOfRmSrcRom: resulting-properties={base-type=uint8, sw-calibration-access=READ-ONLY, compu {255=PDUR_NO_RMBUFFEREDTPPROPERTIESROMIDXOFRMSRCROM}, range raw 0..255}
                RmBufferedTpPropertiesRomPartitionIdxOfRmSrcRom: resulting-properties={base-type=uint8, sw-calibration-access=READ-ONLY, compu {255=PDUR_NO_RMBUFFEREDTPPROPERTIESROMPARTITIONIDXOFRMSRCROM}, range raw 0..255}
                RmDestRomEndIdxOfRmSrcRom: resulting-properties={base-type=uint8, sw-calibration-access=READ-ONLY, range raw 0..255}
                RmDestRomStartIdxOfRmSrcRom: resulting-properties={base-type=uint8, sw-calibration-access=READ-ONLY, range raw 0..255}
                SrcHndOfRmSrcRom: resulting-properties={base-type=uint8, sw-calibration-access=READ-ONLY, compu {255=PDUR_NO_SRCHNDOFRMSRCROM}, range raw 0..255}
            Element_75: symbol=[75]
              8 x mc data instance, all with category=VALUE:
                LockRomIdxOfRmSrcRom: resulting-properties={base-type=uint8, sw-calibration-access=READ-ONLY, range raw 0..255}
                MaskedBitsOfRmSrcRom: resulting-properties={base-type=uint8, sw-calibration-access=READ-ONLY, range raw 0..255}
                MmRomIdxOfRmSrcRom: resulting-properties={base-type=uint8, sw-calibration-access=READ-ONLY, range raw 0..255}
                RmBufferedTpPropertiesRomIdxOfRmSrcRom: resulting-properties={base-type=uint8, sw-calibration-access=READ-ONLY, compu {255=PDUR_NO_RMBUFFEREDTPPROPERTIESROMIDXOFRMSRCROM}, range raw 0..255}
                RmBufferedTpPropertiesRomPartitionIdxOfRmSrcRom: resulting-properties={base-type=uint8, sw-calibration-access=READ-ONLY, compu {255=PDUR_NO_RMBUFFEREDTPPROPERTIESROMPARTITIONIDXOFRMSRCROM}, range raw 0..255}
                RmDestRomEndIdxOfRmSrcRom: resulting-properties={base-type=uint8, sw-calibration-access=READ-ONLY, range raw 0..255}
                RmDestRomStartIdxOfRmSrcRom: resulting-properties={base-type=uint8, sw-calibration-access=READ-ONLY, range raw 0..255}
                SrcHndOfRmSrcRom: resulting-properties={base-type=uint8, sw-calibration-access=READ-ONLY, compu {255=PDUR_NO_SRCHNDOFRMSRCROM}, range raw 0..255}
            Element_76: symbol=[76]
              8 x mc data instance, all with category=VALUE:
                LockRomIdxOfRmSrcRom: resulting-properties={base-type=uint8, sw-calibration-access=READ-ONLY, range raw 0..255}
                MaskedBitsOfRmSrcRom: resulting-properties={base-type=uint8, sw-calibration-access=READ-ONLY, range raw 0..255}
                MmRomIdxOfRmSrcRom: resulting-properties={base-type=uint8, sw-calibration-access=READ-ONLY, range raw 0..255}
                RmBufferedTpPropertiesRomIdxOfRmSrcRom: resulting-properties={base-type=uint8, sw-calibration-access=READ-ONLY, compu {255=PDUR_NO_RMBUFFEREDTPPROPERTIESROMIDXOFRMSRCROM}, range raw 0..255}
                RmBufferedTpPropertiesRomPartitionIdxOfRmSrcRom: resulting-properties={base-type=uint8, sw-calibration-access=READ-ONLY, compu {255=PDUR_NO_RMBUFFEREDTPPROPERTIESROMPARTITIONIDXOFRMSRCROM}, range raw 0..255}
                RmDestRomEndIdxOfRmSrcRom: resulting-properties={base-type=uint8, sw-calibration-access=READ-ONLY, range raw 0..255}
                RmDestRomStartIdxOfRmSrcRom: resulting-properties={base-type=uint8, sw-calibration-access=READ-ONLY, range raw 0..255}
                SrcHndOfRmSrcRom: resulting-properties={base-type=uint8, sw-calibration-access=READ-ONLY, compu {255=PDUR_NO_SRCHNDOFRMSRCROM}, range raw 0..255}
            Element_77: symbol=[77]
              8 x mc data instance, all with category=VALUE:
                LockRomIdxOfRmSrcRom: resulting-properties={base-type=uint8, sw-calibration-access=READ-ONLY, range raw 0..255}
                MaskedBitsOfRmSrcRom: resulting-properties={base-type=uint8, sw-calibration-access=READ-ONLY, range raw 0..255}
                MmRomIdxOfRmSrcRom: resulting-properties={base-type=uint8, sw-calibration-access=READ-ONLY, range raw 0..255}
                RmBufferedTpPropertiesRomIdxOfRmSrcRom: resulting-properties={base-type=uint8, sw-calibration-access=READ-ONLY, compu {255=PDUR_NO_RMBUFFEREDTPPROPERTIESROMIDXOFRMSRCROM}, range raw 0..255}
                RmBufferedTpPropertiesRomPartitionIdxOfRmSrcRom: resulting-properties={base-type=uint8, sw-calibration-access=READ-ONLY, compu {255=PDUR_NO_RMBUFFEREDTPPROPERTIESROMPARTITIONIDXOFRMSRCROM}, range raw 0..255}
                RmDestRomEndIdxOfRmSrcRom: resulting-properties={base-type=uint8, sw-calibration-access=READ-ONLY, range raw 0..255}
                RmDestRomStartIdxOfRmSrcRom: resulting-properties={base-type=uint8, sw-calibration-access=READ-ONLY, range raw 0..255}
                SrcHndOfRmSrcRom: resulting-properties={base-type=uint8, sw-calibration-access=READ-ONLY, compu {255=PDUR_NO_SRCHNDOFRMSRCROM}, range raw 0..255}
            Element_78: symbol=[78]
              8 x mc data instance, all with category=VALUE:
                LockRomIdxOfRmSrcRom: resulting-properties={base-type=uint8, sw-calibration-access=READ-ONLY, range raw 0..255}
                MaskedBitsOfRmSrcRom: resulting-properties={base-type=uint8, sw-calibration-access=READ-ONLY, range raw 0..255}
                MmRomIdxOfRmSrcRom: resulting-properties={base-type=uint8, sw-calibration-access=READ-ONLY, range raw 0..255}
                RmBufferedTpPropertiesRomIdxOfRmSrcRom: resulting-properties={base-type=uint8, sw-calibration-access=READ-ONLY, compu {255=PDUR_NO_RMBUFFEREDTPPROPERTIESROMIDXOFRMSRCROM}, range raw 0..255}
                RmBufferedTpPropertiesRomPartitionIdxOfRmSrcRom: resulting-properties={base-type=uint8, sw-calibration-access=READ-ONLY, compu {255=PDUR_NO_RMBUFFEREDTPPROPERTIESROMPARTITIONIDXOFRMSRCROM}, range raw 0..255}
                RmDestRomEndIdxOfRmSrcRom: resulting-properties={base-type=uint8, sw-calibration-access=READ-ONLY, range raw 0..255}
                RmDestRomStartIdxOfRmSrcRom: resulting-properties={base-type=uint8, sw-calibration-access=READ-ONLY, range raw 0..255}
                SrcHndOfRmSrcRom: resulting-properties={base-type=uint8, sw-calibration-access=READ-ONLY, compu {255=PDUR_NO_SRCHNDOFRMSRCROM}, range raw 0..255}
            Element_79: symbol=[79]
              8 x mc data instance, all with category=VALUE:
                LockRomIdxOfRmSrcRom: resulting-properties={base-type=uint8, sw-calibration-access=READ-ONLY, range raw 0..255}
                MaskedBitsOfRmSrcRom: resulting-properties={base-type=uint8, sw-calibration-access=READ-ONLY, range raw 0..255}
                MmRomIdxOfRmSrcRom: resulting-properties={base-type=uint8, sw-calibration-access=READ-ONLY, range raw 0..255}
                RmBufferedTpPropertiesRomIdxOfRmSrcRom: resulting-properties={base-type=uint8, sw-calibration-access=READ-ONLY, compu {255=PDUR_NO_RMBUFFEREDTPPROPERTIESROMIDXOFRMSRCROM}, range raw 0..255}
                RmBufferedTpPropertiesRomPartitionIdxOfRmSrcRom: resulting-properties={base-type=uint8, sw-calibration-access=READ-ONLY, compu {255=PDUR_NO_RMBUFFEREDTPPROPERTIESROMPARTITIONIDXOFRMSRCROM}, range raw 0..255}
                RmDestRomEndIdxOfRmSrcRom: resulting-properties={base-type=uint8, sw-calibration-access=READ-ONLY, range raw 0..255}
                RmDestRomStartIdxOfRmSrcRom: resulting-properties={base-type=uint8, sw-calibration-access=READ-ONLY, range raw 0..255}
                SrcHndOfRmSrcRom: resulting-properties={base-type=uint8, sw-calibration-access=READ-ONLY, compu {255=PDUR_NO_SRCHNDOFRMSRCROM}, range raw 0..255}
            Element_80: symbol=[80]
              8 x mc data instance, all with category=VALUE:
                LockRomIdxOfRmSrcRom: resulting-properties={base-type=uint8, sw-calibration-access=READ-ONLY, range raw 0..255}
                MaskedBitsOfRmSrcRom: resulting-properties={base-type=uint8, sw-calibration-access=READ-ONLY, range raw 0..255}
                MmRomIdxOfRmSrcRom: resulting-properties={base-type=uint8, sw-calibration-access=READ-ONLY, range raw 0..255}
                RmBufferedTpPropertiesRomIdxOfRmSrcRom: resulting-properties={base-type=uint8, sw-calibration-access=READ-ONLY, compu {255=PDUR_NO_RMBUFFEREDTPPROPERTIESROMIDXOFRMSRCROM}, range raw 0..255}
                RmBufferedTpPropertiesRomPartitionIdxOfRmSrcRom: resulting-properties={base-type=uint8, sw-calibration-access=READ-ONLY, compu {255=PDUR_NO_RMBUFFEREDTPPROPERTIESROMPARTITIONIDXOFRMSRCROM}, range raw 0..255}
                RmDestRomEndIdxOfRmSrcRom: resulting-properties={base-type=uint8, sw-calibration-access=READ-ONLY, range raw 0..255}
                RmDestRomStartIdxOfRmSrcRom: resulting-properties={base-type=uint8, sw-calibration-access=READ-ONLY, range raw 0..255}
                SrcHndOfRmSrcRom: resulting-properties={base-type=uint8, sw-calibration-access=READ-ONLY, compu {255=PDUR_NO_SRCHNDOFRMSRCROM}, range raw 0..255}
            Element_81: symbol=[81]
              8 x mc data instance, all with category=VALUE:
                LockRomIdxOfRmSrcRom: resulting-properties={base-type=uint8, sw-calibration-access=READ-ONLY, range raw 0..255}
                MaskedBitsOfRmSrcRom: resulting-properties={base-type=uint8, sw-calibration-access=READ-ONLY, range raw 0..255}
                MmRomIdxOfRmSrcRom: resulting-properties={base-type=uint8, sw-calibration-access=READ-ONLY, range raw 0..255}
                RmBufferedTpPropertiesRomIdxOfRmSrcRom: resulting-properties={base-type=uint8, sw-calibration-access=READ-ONLY, compu {255=PDUR_NO_RMBUFFEREDTPPROPERTIESROMIDXOFRMSRCROM}, range raw 0..255}
                RmBufferedTpPropertiesRomPartitionIdxOfRmSrcRom: resulting-properties={base-type=uint8, sw-calibration-access=READ-ONLY, compu {255=PDUR_NO_RMBUFFEREDTPPROPERTIESROMPARTITIONIDXOFRMSRCROM}, range raw 0..255}
                RmDestRomEndIdxOfRmSrcRom: resulting-properties={base-type=uint8, sw-calibration-access=READ-ONLY, range raw 0..255}
                RmDestRomStartIdxOfRmSrcRom: resulting-properties={base-type=uint8, sw-calibration-access=READ-ONLY, range raw 0..255}
                SrcHndOfRmSrcRom: resulting-properties={base-type=uint8, sw-calibration-access=READ-ONLY, compu {255=PDUR_NO_SRCHNDOFRMSRCROM}, range raw 0..255}
            Element_82: symbol=[82]
              8 x mc data instance, all with category=VALUE:
                LockRomIdxOfRmSrcRom: resulting-properties={base-type=uint8, sw-calibration-access=READ-ONLY, range raw 0..255}
                MaskedBitsOfRmSrcRom: resulting-properties={base-type=uint8, sw-calibration-access=READ-ONLY, range raw 0..255}
                MmRomIdxOfRmSrcRom: resulting-properties={base-type=uint8, sw-calibration-access=READ-ONLY, range raw 0..255}
                RmBufferedTpPropertiesRomIdxOfRmSrcRom: resulting-properties={base-type=uint8, sw-calibration-access=READ-ONLY, compu {255=PDUR_NO_RMBUFFEREDTPPROPERTIESROMIDXOFRMSRCROM}, range raw 0..255}
                RmBufferedTpPropertiesRomPartitionIdxOfRmSrcRom: resulting-properties={base-type=uint8, sw-calibration-access=READ-ONLY, compu {255=PDUR_NO_RMBUFFEREDTPPROPERTIESROMPARTITIONIDXOFRMSRCROM}, range raw 0..255}
                RmDestRomEndIdxOfRmSrcRom: resulting-properties={base-type=uint8, sw-calibration-access=READ-ONLY, range raw 0..255}
                RmDestRomStartIdxOfRmSrcRom: resulting-properties={base-type=uint8, sw-calibration-access=READ-ONLY, range raw 0..255}
                SrcHndOfRmSrcRom: resulting-properties={base-type=uint8, sw-calibration-access=READ-ONLY, compu {255=PDUR_NO_SRCHNDOFRMSRCROM}, range raw 0..255}
            Element_83: symbol=[83]
              8 x mc data instance, all with category=VALUE:
                LockRomIdxOfRmSrcRom: resulting-properties={base-type=uint8, sw-calibration-access=READ-ONLY, range raw 0..255}
                MaskedBitsOfRmSrcRom: resulting-properties={base-type=uint8, sw-calibration-access=READ-ONLY, range raw 0..255}
                MmRomIdxOfRmSrcRom: resulting-properties={base-type=uint8, sw-calibration-access=READ-ONLY, range raw 0..255}
                RmBufferedTpPropertiesRomIdxOfRmSrcRom: resulting-properties={base-type=uint8, sw-calibration-access=READ-ONLY, compu {255=PDUR_NO_RMBUFFEREDTPPROPERTIESROMIDXOFRMSRCROM}, range raw 0..255}
                RmBufferedTpPropertiesRomPartitionIdxOfRmSrcRom: resulting-properties={base-type=uint8, sw-calibration-access=READ-ONLY, compu {255=PDUR_NO_RMBUFFEREDTPPROPERTIESROMPARTITIONIDXOFRMSRCROM}, range raw 0..255}
                RmDestRomEndIdxOfRmSrcRom: resulting-properties={base-type=uint8, sw-calibration-access=READ-ONLY, range raw 0..255}
                RmDestRomStartIdxOfRmSrcRom: resulting-properties={base-type=uint8, sw-calibration-access=READ-ONLY, range raw 0..255}
                SrcHndOfRmSrcRom: resulting-properties={base-type=uint8, sw-calibration-access=READ-ONLY, compu {255=PDUR_NO_SRCHNDOFRMSRCROM}, range raw 0..255}
            Element_84: symbol=[84]
              8 x mc data instance, all with category=VALUE:
                LockRomIdxOfRmSrcRom: resulting-properties={base-type=uint8, sw-calibration-access=READ-ONLY, range raw 0..255}
                MaskedBitsOfRmSrcRom: resulting-properties={base-type=uint8, sw-calibration-access=READ-ONLY, range raw 0..255}
                MmRomIdxOfRmSrcRom: resulting-properties={base-type=uint8, sw-calibration-access=READ-ONLY, range raw 0..255}
                RmBufferedTpPropertiesRomIdxOfRmSrcRom: resulting-properties={base-type=uint8, sw-calibration-access=READ-ONLY, compu {255=PDUR_NO_RMBUFFEREDTPPROPERTIESROMIDXOFRMSRCROM}, range raw 0..255}
                RmBufferedTpPropertiesRomPartitionIdxOfRmSrcRom: resulting-properties={base-type=uint8, sw-calibration-access=READ-ONLY, compu {255=PDUR_NO_RMBUFFEREDTPPROPERTIESROMPARTITIONIDXOFRMSRCROM}, range raw 0..255}
                RmDestRomEndIdxOfRmSrcRom: resulting-properties={base-type=uint8, sw-calibration-access=READ-ONLY, range raw 0..255}
                RmDestRomStartIdxOfRmSrcRom: resulting-properties={base-type=uint8, sw-calibration-access=READ-ONLY, range raw 0..255}
                SrcHndOfRmSrcRom: resulting-properties={base-type=uint8, sw-calibration-access=READ-ONLY, compu {255=PDUR_NO_SRCHNDOFRMSRCROM}, range raw 0..255}
            Element_85: symbol=[85]
              8 x mc data instance, all with category=VALUE:
                LockRomIdxOfRmSrcRom: resulting-properties={base-type=uint8, sw-calibration-access=READ-ONLY, range raw 0..255}
                MaskedBitsOfRmSrcRom: resulting-properties={base-type=uint8, sw-calibration-access=READ-ONLY, range raw 0..255}
                MmRomIdxOfRmSrcRom: resulting-properties={base-type=uint8, sw-calibration-access=READ-ONLY, range raw 0..255}
                RmBufferedTpPropertiesRomIdxOfRmSrcRom: resulting-properties={base-type=uint8, sw-calibration-access=READ-ONLY, compu {255=PDUR_NO_RMBUFFEREDTPPROPERTIESROMIDXOFRMSRCROM}, range raw 0..255}
                RmBufferedTpPropertiesRomPartitionIdxOfRmSrcRom: resulting-properties={base-type=uint8, sw-calibration-access=READ-ONLY, compu {255=PDUR_NO_RMBUFFEREDTPPROPERTIESROMPARTITIONIDXOFRMSRCROM}, range raw 0..255}
                RmDestRomEndIdxOfRmSrcRom: resulting-properties={base-type=uint8, sw-calibration-access=READ-ONLY, range raw 0..255}
                RmDestRomStartIdxOfRmSrcRom: resulting-properties={base-type=uint8, sw-calibration-access=READ-ONLY, range raw 0..255}
                SrcHndOfRmSrcRom: resulting-properties={base-type=uint8, sw-calibration-access=READ-ONLY, compu {255=PDUR_NO_SRCHNDOFRMSRCROM}, range raw 0..255}
            Element_86: symbol=[86]
              8 x mc data instance, all with category=VALUE:
                LockRomIdxOfRmSrcRom: resulting-properties={base-type=uint8, sw-calibration-access=READ-ONLY, range raw 0..255}
                MaskedBitsOfRmSrcRom: resulting-properties={base-type=uint8, sw-calibration-access=READ-ONLY, range raw 0..255}
                MmRomIdxOfRmSrcRom: resulting-properties={base-type=uint8, sw-calibration-access=READ-ONLY, range raw 0..255}
                RmBufferedTpPropertiesRomIdxOfRmSrcRom: resulting-properties={base-type=uint8, sw-calibration-access=READ-ONLY, compu {255=PDUR_NO_RMBUFFEREDTPPROPERTIESROMIDXOFRMSRCROM}, range raw 0..255}
                RmBufferedTpPropertiesRomPartitionIdxOfRmSrcRom: resulting-properties={base-type=uint8, sw-calibration-access=READ-ONLY, compu {255=PDUR_NO_RMBUFFEREDTPPROPERTIESROMPARTITIONIDXOFRMSRCROM}, range raw 0..255}
                RmDestRomEndIdxOfRmSrcRom: resulting-properties={base-type=uint8, sw-calibration-access=READ-ONLY, range raw 0..255}
                RmDestRomStartIdxOfRmSrcRom: resulting-properties={base-type=uint8, sw-calibration-access=READ-ONLY, range raw 0..255}
                SrcHndOfRmSrcRom: resulting-properties={base-type=uint8, sw-calibration-access=READ-ONLY, compu {255=PDUR_NO_SRCHNDOFRMSRCROM}, range raw 0..255}
            Element_87: symbol=[87]
              8 x mc data instance, all with category=VALUE:
                LockRomIdxOfRmSrcRom: resulting-properties={base-type=uint8, sw-calibration-access=READ-ONLY, range raw 0..255}
                MaskedBitsOfRmSrcRom: resulting-properties={base-type=uint8, sw-calibration-access=READ-ONLY, range raw 0..255}
                MmRomIdxOfRmSrcRom: resulting-properties={base-type=uint8, sw-calibration-access=READ-ONLY, range raw 0..255}
                RmBufferedTpPropertiesRomIdxOfRmSrcRom: resulting-properties={base-type=uint8, sw-calibration-access=READ-ONLY, compu {255=PDUR_NO_RMBUFFEREDTPPROPERTIESROMIDXOFRMSRCROM}, range raw 0..255}
                RmBufferedTpPropertiesRomPartitionIdxOfRmSrcRom: resulting-properties={base-type=uint8, sw-calibration-access=READ-ONLY, compu {255=PDUR_NO_RMBUFFEREDTPPROPERTIESROMPARTITIONIDXOFRMSRCROM}, range raw 0..255}
                RmDestRomEndIdxOfRmSrcRom: resulting-properties={base-type=uint8, sw-calibration-access=READ-ONLY, range raw 0..255}
                RmDestRomStartIdxOfRmSrcRom: resulting-properties={base-type=uint8, sw-calibration-access=READ-ONLY, range raw 0..255}
                SrcHndOfRmSrcRom: resulting-properties={base-type=uint8, sw-calibration-access=READ-ONLY, compu {255=PDUR_NO_SRCHNDOFRMSRCROM}, range raw 0..255}
            Element_88: symbol=[88]
              8 x mc data instance, all with category=VALUE:
                LockRomIdxOfRmSrcRom: resulting-properties={base-type=uint8, sw-calibration-access=READ-ONLY, range raw 0..255}
                MaskedBitsOfRmSrcRom: resulting-properties={base-type=uint8, sw-calibration-access=READ-ONLY, range raw 0..255}
                MmRomIdxOfRmSrcRom: resulting-properties={base-type=uint8, sw-calibration-access=READ-ONLY, range raw 0..255}
                RmBufferedTpPropertiesRomIdxOfRmSrcRom: resulting-properties={base-type=uint8, sw-calibration-access=READ-ONLY, compu {255=PDUR_NO_RMBUFFEREDTPPROPERTIESROMIDXOFRMSRCROM}, range raw 0..255}
                RmBufferedTpPropertiesRomPartitionIdxOfRmSrcRom: resulting-properties={base-type=uint8, sw-calibration-access=READ-ONLY, compu {255=PDUR_NO_RMBUFFEREDTPPROPERTIESROMPARTITIONIDXOFRMSRCROM}, range raw 0..255}
                RmDestRomEndIdxOfRmSrcRom: resulting-properties={base-type=uint8, sw-calibration-access=READ-ONLY, range raw 0..255}
                RmDestRomStartIdxOfRmSrcRom: resulting-properties={base-type=uint8, sw-calibration-access=READ-ONLY, range raw 0..255}
                SrcHndOfRmSrcRom: resulting-properties={base-type=uint8, sw-calibration-access=READ-ONLY, compu {255=PDUR_NO_SRCHNDOFRMSRCROM}, range raw 0..255}
            Element_89: symbol=[89]
              8 x mc data instance, all with category=VALUE:
                LockRomIdxOfRmSrcRom: resulting-properties={base-type=uint8, sw-calibration-access=READ-ONLY, range raw 0..255}
                MaskedBitsOfRmSrcRom: resulting-properties={base-type=uint8, sw-calibration-access=READ-ONLY, range raw 0..255}
                MmRomIdxOfRmSrcRom: resulting-properties={base-type=uint8, sw-calibration-access=READ-ONLY, range raw 0..255}
                RmBufferedTpPropertiesRomIdxOfRmSrcRom: resulting-properties={base-type=uint8, sw-calibration-access=READ-ONLY, compu {255=PDUR_NO_RMBUFFEREDTPPROPERTIESROMIDXOFRMSRCROM}, range raw 0..255}
                RmBufferedTpPropertiesRomPartitionIdxOfRmSrcRom: resulting-properties={base-type=uint8, sw-calibration-access=READ-ONLY, compu {255=PDUR_NO_RMBUFFEREDTPPROPERTIESROMPARTITIONIDXOFRMSRCROM}, range raw 0..255}
                RmDestRomEndIdxOfRmSrcRom: resulting-properties={base-type=uint8, sw-calibration-access=READ-ONLY, range raw 0..255}
                RmDestRomStartIdxOfRmSrcRom: resulting-properties={base-type=uint8, sw-calibration-access=READ-ONLY, range raw 0..255}
                SrcHndOfRmSrcRom: resulting-properties={base-type=uint8, sw-calibration-access=READ-ONLY, compu {255=PDUR_NO_SRCHNDOFRMSRCROM}, range raw 0..255}
            Element_90: symbol=[90]
              8 x mc data instance, all with category=VALUE:
                LockRomIdxOfRmSrcRom: resulting-properties={base-type=uint8, sw-calibration-access=READ-ONLY, range raw 0..255}
                MaskedBitsOfRmSrcRom: resulting-properties={base-type=uint8, sw-calibration-access=READ-ONLY, range raw 0..255}
                MmRomIdxOfRmSrcRom: resulting-properties={base-type=uint8, sw-calibration-access=READ-ONLY, range raw 0..255}
                RmBufferedTpPropertiesRomIdxOfRmSrcRom: resulting-properties={base-type=uint8, sw-calibration-access=READ-ONLY, compu {255=PDUR_NO_RMBUFFEREDTPPROPERTIESROMIDXOFRMSRCROM}, range raw 0..255}
                RmBufferedTpPropertiesRomPartitionIdxOfRmSrcRom: resulting-properties={base-type=uint8, sw-calibration-access=READ-ONLY, compu {255=PDUR_NO_RMBUFFEREDTPPROPERTIESROMPARTITIONIDXOFRMSRCROM}, range raw 0..255}
                RmDestRomEndIdxOfRmSrcRom: resulting-properties={base-type=uint8, sw-calibration-access=READ-ONLY, range raw 0..255}
                RmDestRomStartIdxOfRmSrcRom: resulting-properties={base-type=uint8, sw-calibration-access=READ-ONLY, range raw 0..255}
                SrcHndOfRmSrcRom: resulting-properties={base-type=uint8, sw-calibration-access=READ-ONLY, compu {255=PDUR_NO_SRCHNDOFRMSRCROM}, range raw 0..255}
            Element_91: symbol=[91]
              8 x mc data instance, all with category=VALUE:
                LockRomIdxOfRmSrcRom: resulting-properties={base-type=uint8, sw-calibration-access=READ-ONLY, range raw 0..255}
                MaskedBitsOfRmSrcRom: resulting-properties={base-type=uint8, sw-calibration-access=READ-ONLY, range raw 0..255}
                MmRomIdxOfRmSrcRom: resulting-properties={base-type=uint8, sw-calibration-access=READ-ONLY, range raw 0..255}
                RmBufferedTpPropertiesRomIdxOfRmSrcRom: resulting-properties={base-type=uint8, sw-calibration-access=READ-ONLY, compu {255=PDUR_NO_RMBUFFEREDTPPROPERTIESROMIDXOFRMSRCROM}, range raw 0..255}
                RmBufferedTpPropertiesRomPartitionIdxOfRmSrcRom: resulting-properties={base-type=uint8, sw-calibration-access=READ-ONLY, compu {255=PDUR_NO_RMBUFFEREDTPPROPERTIESROMPARTITIONIDXOFRMSRCROM}, range raw 0..255}
                RmDestRomEndIdxOfRmSrcRom: resulting-properties={base-type=uint8, sw-calibration-access=READ-ONLY, range raw 0..255}
                RmDestRomStartIdxOfRmSrcRom: resulting-properties={base-type=uint8, sw-calibration-access=READ-ONLY, range raw 0..255}
                SrcHndOfRmSrcRom: resulting-properties={base-type=uint8, sw-calibration-access=READ-ONLY, compu {255=PDUR_NO_SRCHNDOFRMSRCROM}, range raw 0..255}
            Element_92: symbol=[92]
              8 x mc data instance, all with category=VALUE:
                LockRomIdxOfRmSrcRom: resulting-properties={base-type=uint8, sw-calibration-access=READ-ONLY, range raw 0..255}
                MaskedBitsOfRmSrcRom: resulting-properties={base-type=uint8, sw-calibration-access=READ-ONLY, range raw 0..255}
                MmRomIdxOfRmSrcRom: resulting-properties={base-type=uint8, sw-calibration-access=READ-ONLY, range raw 0..255}
                RmBufferedTpPropertiesRomIdxOfRmSrcRom: resulting-properties={base-type=uint8, sw-calibration-access=READ-ONLY, compu {255=PDUR_NO_RMBUFFEREDTPPROPERTIESROMIDXOFRMSRCROM}, range raw 0..255}
                RmBufferedTpPropertiesRomPartitionIdxOfRmSrcRom: resulting-properties={base-type=uint8, sw-calibration-access=READ-ONLY, compu {255=PDUR_NO_RMBUFFEREDTPPROPERTIESROMPARTITIONIDXOFRMSRCROM}, range raw 0..255}
                RmDestRomEndIdxOfRmSrcRom: resulting-properties={base-type=uint8, sw-calibration-access=READ-ONLY, range raw 0..255}
                RmDestRomStartIdxOfRmSrcRom: resulting-properties={base-type=uint8, sw-calibration-access=READ-ONLY, range raw 0..255}
                SrcHndOfRmSrcRom: resulting-properties={base-type=uint8, sw-calibration-access=READ-ONLY, compu {255=PDUR_NO_SRCHNDOFRMSRCROM}, range raw 0..255}
            Element_93: symbol=[93]
              8 x mc data instance, all with category=VALUE:
                LockRomIdxOfRmSrcRom: resulting-properties={base-type=uint8, sw-calibration-access=READ-ONLY, range raw 0..255}
                MaskedBitsOfRmSrcRom: resulting-properties={base-type=uint8, sw-calibration-access=READ-ONLY, range raw 0..255}
                MmRomIdxOfRmSrcRom: resulting-properties={base-type=uint8, sw-calibration-access=READ-ONLY, range raw 0..255}
                RmBufferedTpPropertiesRomIdxOfRmSrcRom: resulting-properties={base-type=uint8, sw-calibration-access=READ-ONLY, compu {255=PDUR_NO_RMBUFFEREDTPPROPERTIESROMIDXOFRMSRCROM}, range raw 0..255}
                RmBufferedTpPropertiesRomPartitionIdxOfRmSrcRom: resulting-properties={base-type=uint8, sw-calibration-access=READ-ONLY, compu {255=PDUR_NO_RMBUFFEREDTPPROPERTIESROMPARTITIONIDXOFRMSRCROM}, range raw 0..255}
                RmDestRomEndIdxOfRmSrcRom: resulting-properties={base-type=uint8, sw-calibration-access=READ-ONLY, range raw 0..255}
                RmDestRomStartIdxOfRmSrcRom: resulting-properties={base-type=uint8, sw-calibration-access=READ-ONLY, range raw 0..255}
                SrcHndOfRmSrcRom: resulting-properties={base-type=uint8, sw-calibration-access=READ-ONLY, compu {255=PDUR_NO_SRCHNDOFRMSRCROM}, range raw 0..255}
            Element_94: symbol=[94]
              8 x mc data instance, all with category=VALUE:
                LockRomIdxOfRmSrcRom: resulting-properties={base-type=uint8, sw-calibration-access=READ-ONLY, range raw 0..255}
                MaskedBitsOfRmSrcRom: resulting-properties={base-type=uint8, sw-calibration-access=READ-ONLY, range raw 0..255}
                MmRomIdxOfRmSrcRom: resulting-properties={base-type=uint8, sw-calibration-access=READ-ONLY, range raw 0..255}
                RmBufferedTpPropertiesRomIdxOfRmSrcRom: resulting-properties={base-type=uint8, sw-calibration-access=READ-ONLY, compu {255=PDUR_NO_RMBUFFEREDTPPROPERTIESROMIDXOFRMSRCROM}, range raw 0..255}
                RmBufferedTpPropertiesRomPartitionIdxOfRmSrcRom: resulting-properties={base-type=uint8, sw-calibration-access=READ-ONLY, compu {255=PDUR_NO_RMBUFFEREDTPPROPERTIESROMPARTITIONIDXOFRMSRCROM}, range raw 0..255}
                RmDestRomEndIdxOfRmSrcRom: resulting-properties={base-type=uint8, sw-calibration-access=READ-ONLY, range raw 0..255}
                RmDestRomStartIdxOfRmSrcRom: resulting-properties={base-type=uint8, sw-calibration-access=READ-ONLY, range raw 0..255}
                SrcHndOfRmSrcRom: resulting-properties={base-type=uint8, sw-calibration-access=READ-ONLY, compu {255=PDUR_NO_SRCHNDOFRMSRCROM}, range raw 0..255}
            Element_95: symbol=[95]
              8 x mc data instance, all with category=VALUE:
                LockRomIdxOfRmSrcRom: resulting-properties={base-type=uint8, sw-calibration-access=READ-ONLY, range raw 0..255}
                MaskedBitsOfRmSrcRom: resulting-properties={base-type=uint8, sw-calibration-access=READ-ONLY, range raw 0..255}
                MmRomIdxOfRmSrcRom: resulting-properties={base-type=uint8, sw-calibration-access=READ-ONLY, range raw 0..255}
                RmBufferedTpPropertiesRomIdxOfRmSrcRom: resulting-properties={base-type=uint8, sw-calibration-access=READ-ONLY, compu {255=PDUR_NO_RMBUFFEREDTPPROPERTIESROMIDXOFRMSRCROM}, range raw 0..255}
                RmBufferedTpPropertiesRomPartitionIdxOfRmSrcRom: resulting-properties={base-type=uint8, sw-calibration-access=READ-ONLY, compu {255=PDUR_NO_RMBUFFEREDTPPROPERTIESROMPARTITIONIDXOFRMSRCROM}, range raw 0..255}
                RmDestRomEndIdxOfRmSrcRom: resulting-properties={base-type=uint8, sw-calibration-access=READ-ONLY, range raw 0..255}
                RmDestRomStartIdxOfRmSrcRom: resulting-properties={base-type=uint8, sw-calibration-access=READ-ONLY, range raw 0..255}
                SrcHndOfRmSrcRom: resulting-properties={base-type=uint8, sw-calibration-access=READ-ONLY, compu {255=PDUR_NO_SRCHNDOFRMSRCROM}, range raw 0..255}
            Element_96: symbol=[96]
              8 x mc data instance, all with category=VALUE:
                LockRomIdxOfRmSrcRom: resulting-properties={base-type=uint8, sw-calibration-access=READ-ONLY, range raw 0..255}
                MaskedBitsOfRmSrcRom: resulting-properties={base-type=uint8, sw-calibration-access=READ-ONLY, range raw 0..255}
                MmRomIdxOfRmSrcRom: resulting-properties={base-type=uint8, sw-calibration-access=READ-ONLY, range raw 0..255}
                RmBufferedTpPropertiesRomIdxOfRmSrcRom: resulting-properties={base-type=uint8, sw-calibration-access=READ-ONLY, compu {255=PDUR_NO_RMBUFFEREDTPPROPERTIESROMIDXOFRMSRCROM}, range raw 0..255}
                RmBufferedTpPropertiesRomPartitionIdxOfRmSrcRom: resulting-properties={base-type=uint8, sw-calibration-access=READ-ONLY, compu {255=PDUR_NO_RMBUFFEREDTPPROPERTIESROMPARTITIONIDXOFRMSRCROM}, range raw 0..255}
                RmDestRomEndIdxOfRmSrcRom: resulting-properties={base-type=uint8, sw-calibration-access=READ-ONLY, range raw 0..255}
                RmDestRomStartIdxOfRmSrcRom: resulting-properties={base-type=uint8, sw-calibration-access=READ-ONLY, range raw 0..255}
                SrcHndOfRmSrcRom: resulting-properties={base-type=uint8, sw-calibration-access=READ-ONLY, compu {255=PDUR_NO_SRCHNDOFRMSRCROM}, range raw 0..255}
            Element_97: symbol=[97]
              8 x mc data instance, all with category=VALUE:
                LockRomIdxOfRmSrcRom: resulting-properties={base-type=uint8, sw-calibration-access=READ-ONLY, range raw 0..255}
                MaskedBitsOfRmSrcRom: resulting-properties={base-type=uint8, sw-calibration-access=READ-ONLY, range raw 0..255}
                MmRomIdxOfRmSrcRom: resulting-properties={base-type=uint8, sw-calibration-access=READ-ONLY, range raw 0..255}
                RmBufferedTpPropertiesRomIdxOfRmSrcRom: resulting-properties={base-type=uint8, sw-calibration-access=READ-ONLY, compu {255=PDUR_NO_RMBUFFEREDTPPROPERTIESROMIDXOFRMSRCROM}, range raw 0..255}
                RmBufferedTpPropertiesRomPartitionIdxOfRmSrcRom: resulting-properties={base-type=uint8, sw-calibration-access=READ-ONLY, compu {255=PDUR_NO_RMBUFFEREDTPPROPERTIESROMPARTITIONIDXOFRMSRCROM}, range raw 0..255}
                RmDestRomEndIdxOfRmSrcRom: resulting-properties={base-type=uint8, sw-calibration-access=READ-ONLY, range raw 0..255}
                RmDestRomStartIdxOfRmSrcRom: resulting-properties={base-type=uint8, sw-calibration-access=READ-ONLY, range raw 0..255}
                SrcHndOfRmSrcRom: resulting-properties={base-type=uint8, sw-calibration-access=READ-ONLY, compu {255=PDUR_NO_SRCHNDOFRMSRCROM}, range raw 0..255}
            Element_98: symbol=[98]
              8 x mc data instance, all with category=VALUE:
                LockRomIdxOfRmSrcRom: resulting-properties={base-type=uint8, sw-calibration-access=READ-ONLY, range raw 0..255}
                MaskedBitsOfRmSrcRom: resulting-properties={base-type=uint8, sw-calibration-access=READ-ONLY, range raw 0..255}
                MmRomIdxOfRmSrcRom: resulting-properties={base-type=uint8, sw-calibration-access=READ-ONLY, range raw 0..255}
                RmBufferedTpPropertiesRomIdxOfRmSrcRom: resulting-properties={base-type=uint8, sw-calibration-access=READ-ONLY, compu {255=PDUR_NO_RMBUFFEREDTPPROPERTIESROMIDXOFRMSRCROM}, range raw 0..255}
                RmBufferedTpPropertiesRomPartitionIdxOfRmSrcRom: resulting-properties={base-type=uint8, sw-calibration-access=READ-ONLY, compu {255=PDUR_NO_RMBUFFEREDTPPROPERTIESROMPARTITIONIDXOFRMSRCROM}, range raw 0..255}
                RmDestRomEndIdxOfRmSrcRom: resulting-properties={base-type=uint8, sw-calibration-access=READ-ONLY, range raw 0..255}
                RmDestRomStartIdxOfRmSrcRom: resulting-properties={base-type=uint8, sw-calibration-access=READ-ONLY, range raw 0..255}
                SrcHndOfRmSrcRom: resulting-properties={base-type=uint8, sw-calibration-access=READ-ONLY, compu {255=PDUR_NO_SRCHNDOFRMSRCROM}, range raw 0..255}
            Element_99: symbol=[99]
              8 x mc data instance, all with category=VALUE:
                LockRomIdxOfRmSrcRom: resulting-properties={base-type=uint8, sw-calibration-access=READ-ONLY, range raw 0..255}
                MaskedBitsOfRmSrcRom: resulting-properties={base-type=uint8, sw-calibration-access=READ-ONLY, range raw 0..255}
                MmRomIdxOfRmSrcRom: resulting-properties={base-type=uint8, sw-calibration-access=READ-ONLY, range raw 0..255}
                RmBufferedTpPropertiesRomIdxOfRmSrcRom: resulting-properties={base-type=uint8, sw-calibration-access=READ-ONLY, compu {255=PDUR_NO_RMBUFFEREDTPPROPERTIESROMIDXOFRMSRCROM}, range raw 0..255}
                RmBufferedTpPropertiesRomPartitionIdxOfRmSrcRom: resulting-properties={base-type=uint8, sw-calibration-access=READ-ONLY, compu {255=PDUR_NO_RMBUFFEREDTPPROPERTIESROMPARTITIONIDXOFRMSRCROM}, range raw 0..255}
                RmDestRomEndIdxOfRmSrcRom: resulting-properties={base-type=uint8, sw-calibration-access=READ-ONLY, range raw 0..255}
                RmDestRomStartIdxOfRmSrcRom: resulting-properties={base-type=uint8, sw-calibration-access=READ-ONLY, range raw 0..255}
                SrcHndOfRmSrcRom: resulting-properties={base-type=uint8, sw-calibration-access=READ-ONLY, compu {255=PDUR_NO_SRCHNDOFRMSRCROM}, range raw 0..255}
            Element_100: symbol=[100]
              8 x mc data instance, all with category=VALUE:
                LockRomIdxOfRmSrcRom: resulting-properties={base-type=uint8, sw-calibration-access=READ-ONLY, range raw 0..255}
                MaskedBitsOfRmSrcRom: resulting-properties={base-type=uint8, sw-calibration-access=READ-ONLY, range raw 0..255}
                MmRomIdxOfRmSrcRom: resulting-properties={base-type=uint8, sw-calibration-access=READ-ONLY, range raw 0..255}
                RmBufferedTpPropertiesRomIdxOfRmSrcRom: resulting-properties={base-type=uint8, sw-calibration-access=READ-ONLY, compu {255=PDUR_NO_RMBUFFEREDTPPROPERTIESROMIDXOFRMSRCROM}, range raw 0..255}
                RmBufferedTpPropertiesRomPartitionIdxOfRmSrcRom: resulting-properties={base-type=uint8, sw-calibration-access=READ-ONLY, compu {255=PDUR_NO_RMBUFFEREDTPPROPERTIESROMPARTITIONIDXOFRMSRCROM}, range raw 0..255}
                RmDestRomEndIdxOfRmSrcRom: resulting-properties={base-type=uint8, sw-calibration-access=READ-ONLY, range raw 0..255}
                RmDestRomStartIdxOfRmSrcRom: resulting-properties={base-type=uint8, sw-calibration-access=READ-ONLY, range raw 0..255}
                SrcHndOfRmSrcRom: resulting-properties={base-type=uint8, sw-calibration-access=READ-ONLY, compu {255=PDUR_NO_SRCHNDOFRMSRCROM}, range raw 0..255}
            Element_101: symbol=[101]
              8 x mc data instance, all with category=VALUE:
                LockRomIdxOfRmSrcRom: resulting-properties={base-type=uint8, sw-calibration-access=READ-ONLY, range raw 0..255}
                MaskedBitsOfRmSrcRom: resulting-properties={base-type=uint8, sw-calibration-access=READ-ONLY, range raw 0..255}
                MmRomIdxOfRmSrcRom: resulting-properties={base-type=uint8, sw-calibration-access=READ-ONLY, range raw 0..255}
                RmBufferedTpPropertiesRomIdxOfRmSrcRom: resulting-properties={base-type=uint8, sw-calibration-access=READ-ONLY, compu {255=PDUR_NO_RMBUFFEREDTPPROPERTIESROMIDXOFRMSRCROM}, range raw 0..255}
                RmBufferedTpPropertiesRomPartitionIdxOfRmSrcRom: resulting-properties={base-type=uint8, sw-calibration-access=READ-ONLY, compu {255=PDUR_NO_RMBUFFEREDTPPROPERTIESROMPARTITIONIDXOFRMSRCROM}, range raw 0..255}
                RmDestRomEndIdxOfRmSrcRom: resulting-properties={base-type=uint8, sw-calibration-access=READ-ONLY, range raw 0..255}
                RmDestRomStartIdxOfRmSrcRom: resulting-properties={base-type=uint8, sw-calibration-access=READ-ONLY, range raw 0..255}
                SrcHndOfRmSrcRom: resulting-properties={base-type=uint8, sw-calibration-access=READ-ONLY, compu {255=PDUR_NO_SRCHNDOFRMSRCROM}, range raw 0..255}
            Element_102: symbol=[102]
              8 x mc data instance, all with category=VALUE:
                LockRomIdxOfRmSrcRom: resulting-properties={base-type=uint8, sw-calibration-access=READ-ONLY, range raw 0..255}
                MaskedBitsOfRmSrcRom: resulting-properties={base-type=uint8, sw-calibration-access=READ-ONLY, range raw 0..255}
                MmRomIdxOfRmSrcRom: resulting-properties={base-type=uint8, sw-calibration-access=READ-ONLY, range raw 0..255}
                RmBufferedTpPropertiesRomIdxOfRmSrcRom: resulting-properties={base-type=uint8, sw-calibration-access=READ-ONLY, compu {255=PDUR_NO_RMBUFFEREDTPPROPERTIESROMIDXOFRMSRCROM}, range raw 0..255}
                RmBufferedTpPropertiesRomPartitionIdxOfRmSrcRom: resulting-properties={base-type=uint8, sw-calibration-access=READ-ONLY, compu {255=PDUR_NO_RMBUFFEREDTPPROPERTIESROMPARTITIONIDXOFRMSRCROM}, range raw 0..255}
                RmDestRomEndIdxOfRmSrcRom: resulting-properties={base-type=uint8, sw-calibration-access=READ-ONLY, range raw 0..255}
                RmDestRomStartIdxOfRmSrcRom: resulting-properties={base-type=uint8, sw-calibration-access=READ-ONLY, range raw 0..255}
                SrcHndOfRmSrcRom: resulting-properties={base-type=uint8, sw-calibration-access=READ-ONLY, compu {255=PDUR_NO_SRCHNDOFRMSRCROM}, range raw 0..255}
            Element_103: symbol=[103]
              8 x mc data instance, all with category=VALUE:
                LockRomIdxOfRmSrcRom: resulting-properties={base-type=uint8, sw-calibration-access=READ-ONLY, range raw 0..255}
                MaskedBitsOfRmSrcRom: resulting-properties={base-type=uint8, sw-calibration-access=READ-ONLY, range raw 0..255}
                MmRomIdxOfRmSrcRom: resulting-properties={base-type=uint8, sw-calibration-access=READ-ONLY, range raw 0..255}
                RmBufferedTpPropertiesRomIdxOfRmSrcRom: resulting-properties={base-type=uint8, sw-calibration-access=READ-ONLY, compu {255=PDUR_NO_RMBUFFEREDTPPROPERTIESROMIDXOFRMSRCROM}, range raw 0..255}
                RmBufferedTpPropertiesRomPartitionIdxOfRmSrcRom: resulting-properties={base-type=uint8, sw-calibration-access=READ-ONLY, compu {255=PDUR_NO_RMBUFFEREDTPPROPERTIESROMPARTITIONIDXOFRMSRCROM}, range raw 0..255}
                RmDestRomEndIdxOfRmSrcRom: resulting-properties={base-type=uint8, sw-calibration-access=READ-ONLY, range raw 0..255}
                RmDestRomStartIdxOfRmSrcRom: resulting-properties={base-type=uint8, sw-calibration-access=READ-ONLY, range raw 0..255}
                SrcHndOfRmSrcRom: resulting-properties={base-type=uint8, sw-calibration-access=READ-ONLY, compu {255=PDUR_NO_SRCHNDOFRMSRCROM}, range raw 0..255}
            Element_104: symbol=[104]
              8 x mc data instance, all with category=VALUE:
                LockRomIdxOfRmSrcRom: resulting-properties={base-type=uint8, sw-calibration-access=READ-ONLY, range raw 0..255}
                MaskedBitsOfRmSrcRom: resulting-properties={base-type=uint8, sw-calibration-access=READ-ONLY, range raw 0..255}
                MmRomIdxOfRmSrcRom: resulting-properties={base-type=uint8, sw-calibration-access=READ-ONLY, range raw 0..255}
                RmBufferedTpPropertiesRomIdxOfRmSrcRom: resulting-properties={base-type=uint8, sw-calibration-access=READ-ONLY, compu {255=PDUR_NO_RMBUFFEREDTPPROPERTIESROMIDXOFRMSRCROM}, range raw 0..255}
                RmBufferedTpPropertiesRomPartitionIdxOfRmSrcRom: resulting-properties={base-type=uint8, sw-calibration-access=READ-ONLY, compu {255=PDUR_NO_RMBUFFEREDTPPROPERTIESROMPARTITIONIDXOFRMSRCROM}, range raw 0..255}
                RmDestRomEndIdxOfRmSrcRom: resulting-properties={base-type=uint8, sw-calibration-access=READ-ONLY, range raw 0..255}
                RmDestRomStartIdxOfRmSrcRom: resulting-properties={base-type=uint8, sw-calibration-access=READ-ONLY, range raw 0..255}
                SrcHndOfRmSrcRom: resulting-properties={base-type=uint8, sw-calibration-access=READ-ONLY, compu {255=PDUR_NO_SRCHNDOFRMSRCROM}, range raw 0..255}
            Element_105: symbol=[105]
              8 x mc data instance, all with category=VALUE:
                LockRomIdxOfRmSrcRom: resulting-properties={base-type=uint8, sw-calibration-access=READ-ONLY, range raw 0..255}
                MaskedBitsOfRmSrcRom: resulting-properties={base-type=uint8, sw-calibration-access=READ-ONLY, range raw 0..255}
                MmRomIdxOfRmSrcRom: resulting-properties={base-type=uint8, sw-calibration-access=READ-ONLY, range raw 0..255}
                RmBufferedTpPropertiesRomIdxOfRmSrcRom: resulting-properties={base-type=uint8, sw-calibration-access=READ-ONLY, compu {255=PDUR_NO_RMBUFFEREDTPPROPERTIESROMIDXOFRMSRCROM}, range raw 0..255}
                RmBufferedTpPropertiesRomPartitionIdxOfRmSrcRom: resulting-properties={base-type=uint8, sw-calibration-access=READ-ONLY, compu {255=PDUR_NO_RMBUFFEREDTPPROPERTIESROMPARTITIONIDXOFRMSRCROM}, range raw 0..255}
                RmDestRomEndIdxOfRmSrcRom: resulting-properties={base-type=uint8, sw-calibration-access=READ-ONLY, range raw 0..255}
                RmDestRomStartIdxOfRmSrcRom: resulting-properties={base-type=uint8, sw-calibration-access=READ-ONLY, range raw 0..255}
                SrcHndOfRmSrcRom: resulting-properties={base-type=uint8, sw-calibration-access=READ-ONLY, compu {255=PDUR_NO_SRCHNDOFRMSRCROM}, range raw 0..255}
            Element_106: symbol=[106]
              8 x mc data instance, all with category=VALUE:
                LockRomIdxOfRmSrcRom: resulting-properties={base-type=uint8, sw-calibration-access=READ-ONLY, range raw 0..255}
                MaskedBitsOfRmSrcRom: resulting-properties={base-type=uint8, sw-calibration-access=READ-ONLY, range raw 0..255}
                MmRomIdxOfRmSrcRom: resulting-properties={base-type=uint8, sw-calibration-access=READ-ONLY, range raw 0..255}
                RmBufferedTpPropertiesRomIdxOfRmSrcRom: resulting-properties={base-type=uint8, sw-calibration-access=READ-ONLY, compu {255=PDUR_NO_RMBUFFEREDTPPROPERTIESROMIDXOFRMSRCROM}, range raw 0..255}
                RmBufferedTpPropertiesRomPartitionIdxOfRmSrcRom: resulting-properties={base-type=uint8, sw-calibration-access=READ-ONLY, compu {255=PDUR_NO_RMBUFFEREDTPPROPERTIESROMPARTITIONIDXOFRMSRCROM}, range raw 0..255}
                RmDestRomEndIdxOfRmSrcRom: resulting-properties={base-type=uint8, sw-calibration-access=READ-ONLY, range raw 0..255}
                RmDestRomStartIdxOfRmSrcRom: resulting-properties={base-type=uint8, sw-calibration-access=READ-ONLY, range raw 0..255}
                SrcHndOfRmSrcRom: resulting-properties={base-type=uint8, sw-calibration-access=READ-ONLY, compu {255=PDUR_NO_SRCHNDOFRMSRCROM}, range raw 0..255}
            Element_107: symbol=[107]
              8 x mc data instance, all with category=VALUE:
                LockRomIdxOfRmSrcRom: resulting-properties={base-type=uint8, sw-calibration-access=READ-ONLY, range raw 0..255}
                MaskedBitsOfRmSrcRom: resulting-properties={base-type=uint8, sw-calibration-access=READ-ONLY, range raw 0..255}
                MmRomIdxOfRmSrcRom: resulting-properties={base-type=uint8, sw-calibration-access=READ-ONLY, range raw 0..255}
                RmBufferedTpPropertiesRomIdxOfRmSrcRom: resulting-properties={base-type=uint8, sw-calibration-access=READ-ONLY, compu {255=PDUR_NO_RMBUFFEREDTPPROPERTIESROMIDXOFRMSRCROM}, range raw 0..255}
                RmBufferedTpPropertiesRomPartitionIdxOfRmSrcRom: resulting-properties={base-type=uint8, sw-calibration-access=READ-ONLY, compu {255=PDUR_NO_RMBUFFEREDTPPROPERTIESROMPARTITIONIDXOFRMSRCROM}, range raw 0..255}
                RmDestRomEndIdxOfRmSrcRom: resulting-properties={base-type=uint8, sw-calibration-access=READ-ONLY, range raw 0..255}
                RmDestRomStartIdxOfRmSrcRom: resulting-properties={base-type=uint8, sw-calibration-access=READ-ONLY, range raw 0..255}
                SrcHndOfRmSrcRom: resulting-properties={base-type=uint8, sw-calibration-access=READ-ONLY, compu {255=PDUR_NO_SRCHNDOFRMSRCROM}, range raw 0..255}
            Element_108: symbol=[108]
              8 x mc data instance, all with category=VALUE:
                LockRomIdxOfRmSrcRom: resulting-properties={base-type=uint8, sw-calibration-access=READ-ONLY, range raw 0..255}
                MaskedBitsOfRmSrcRom: resulting-properties={base-type=uint8, sw-calibration-access=READ-ONLY, range raw 0..255}
                MmRomIdxOfRmSrcRom: resulting-properties={base-type=uint8, sw-calibration-access=READ-ONLY, range raw 0..255}
                RmBufferedTpPropertiesRomIdxOfRmSrcRom: resulting-properties={base-type=uint8, sw-calibration-access=READ-ONLY, compu {255=PDUR_NO_RMBUFFEREDTPPROPERTIESROMIDXOFRMSRCROM}, range raw 0..255}
                RmBufferedTpPropertiesRomPartitionIdxOfRmSrcRom: resulting-properties={base-type=uint8, sw-calibration-access=READ-ONLY, compu {255=PDUR_NO_RMBUFFEREDTPPROPERTIESROMPARTITIONIDXOFRMSRCROM}, range raw 0..255}
                RmDestRomEndIdxOfRmSrcRom: resulting-properties={base-type=uint8, sw-calibration-access=READ-ONLY, range raw 0..255}
                RmDestRomStartIdxOfRmSrcRom: resulting-properties={base-type=uint8, sw-calibration-access=READ-ONLY, range raw 0..255}
                SrcHndOfRmSrcRom: resulting-properties={base-type=uint8, sw-calibration-access=READ-ONLY, compu {255=PDUR_NO_SRCHNDOFRMSRCROM}, range raw 0..255}
            Element_109: symbol=[109]
              8 x mc data instance, all with category=VALUE:
                LockRomIdxOfRmSrcRom: resulting-properties={base-type=uint8, sw-calibration-access=READ-ONLY, range raw 0..255}
                MaskedBitsOfRmSrcRom: resulting-properties={base-type=uint8, sw-calibration-access=READ-ONLY, range raw 0..255}
                MmRomIdxOfRmSrcRom: resulting-properties={base-type=uint8, sw-calibration-access=READ-ONLY, range raw 0..255}
                RmBufferedTpPropertiesRomIdxOfRmSrcRom: resulting-properties={base-type=uint8, sw-calibration-access=READ-ONLY, compu {255=PDUR_NO_RMBUFFEREDTPPROPERTIESROMIDXOFRMSRCROM}, range raw 0..255}
                RmBufferedTpPropertiesRomPartitionIdxOfRmSrcRom: resulting-properties={base-type=uint8, sw-calibration-access=READ-ONLY, compu {255=PDUR_NO_RMBUFFEREDTPPROPERTIESROMPARTITIONIDXOFRMSRCROM}, range raw 0..255}
                RmDestRomEndIdxOfRmSrcRom: resulting-properties={base-type=uint8, sw-calibration-access=READ-ONLY, range raw 0..255}
                RmDestRomStartIdxOfRmSrcRom: resulting-properties={base-type=uint8, sw-calibration-access=READ-ONLY, range raw 0..255}
                SrcHndOfRmSrcRom: resulting-properties={base-type=uint8, sw-calibration-access=READ-ONLY, compu {255=PDUR_NO_SRCHNDOFRMSRCROM}, range raw 0..255}
            Element_110: symbol=[110]
              8 x mc data instance, all with category=VALUE:
                LockRomIdxOfRmSrcRom: resulting-properties={base-type=uint8, sw-calibration-access=READ-ONLY, range raw 0..255}
                MaskedBitsOfRmSrcRom: resulting-properties={base-type=uint8, sw-calibration-access=READ-ONLY, range raw 0..255}
                MmRomIdxOfRmSrcRom: resulting-properties={base-type=uint8, sw-calibration-access=READ-ONLY, range raw 0..255}
                RmBufferedTpPropertiesRomIdxOfRmSrcRom: resulting-properties={base-type=uint8, sw-calibration-access=READ-ONLY, compu {255=PDUR_NO_RMBUFFEREDTPPROPERTIESROMIDXOFRMSRCROM}, range raw 0..255}
                RmBufferedTpPropertiesRomPartitionIdxOfRmSrcRom: resulting-properties={base-type=uint8, sw-calibration-access=READ-ONLY, compu {255=PDUR_NO_RMBUFFEREDTPPROPERTIESROMPARTITIONIDXOFRMSRCROM}, range raw 0..255}
                RmDestRomEndIdxOfRmSrcRom: resulting-properties={base-type=uint8, sw-calibration-access=READ-ONLY, range raw 0..255}
                RmDestRomStartIdxOfRmSrcRom: resulting-properties={base-type=uint8, sw-calibration-access=READ-ONLY, range raw 0..255}
                SrcHndOfRmSrcRom: resulting-properties={base-type=uint8, sw-calibration-access=READ-ONLY, compu {255=PDUR_NO_SRCHNDOFRMSRCROM}, range raw 0..255}
            Element_111: symbol=[111]
              8 x mc data instance, all with category=VALUE:
                LockRomIdxOfRmSrcRom: resulting-properties={base-type=uint8, sw-calibration-access=READ-ONLY, range raw 0..255}
                MaskedBitsOfRmSrcRom: resulting-properties={base-type=uint8, sw-calibration-access=READ-ONLY, range raw 0..255}
                MmRomIdxOfRmSrcRom: resulting-properties={base-type=uint8, sw-calibration-access=READ-ONLY, range raw 0..255}
                RmBufferedTpPropertiesRomIdxOfRmSrcRom: resulting-properties={base-type=uint8, sw-calibration-access=READ-ONLY, compu {255=PDUR_NO_RMBUFFEREDTPPROPERTIESROMIDXOFRMSRCROM}, range raw 0..255}
                RmBufferedTpPropertiesRomPartitionIdxOfRmSrcRom: resulting-properties={base-type=uint8, sw-calibration-access=READ-ONLY, compu {255=PDUR_NO_RMBUFFEREDTPPROPERTIESROMPARTITIONIDXOFRMSRCROM}, range raw 0..255}
                RmDestRomEndIdxOfRmSrcRom: resulting-properties={base-type=uint8, sw-calibration-access=READ-ONLY, range raw 0..255}
                RmDestRomStartIdxOfRmSrcRom: resulting-properties={base-type=uint8, sw-calibration-access=READ-ONLY, range raw 0..255}
                SrcHndOfRmSrcRom: resulting-properties={base-type=uint8, sw-calibration-access=READ-ONLY, compu {255=PDUR_NO_SRCHNDOFRMSRCROM}, range raw 0..255}
            Element_112: symbol=[112]
              8 x mc data instance, all with category=VALUE:
                LockRomIdxOfRmSrcRom: resulting-properties={base-type=uint8, sw-calibration-access=READ-ONLY, range raw 0..255}
                MaskedBitsOfRmSrcRom: resulting-properties={base-type=uint8, sw-calibration-access=READ-ONLY, range raw 0..255}
                MmRomIdxOfRmSrcRom: resulting-properties={base-type=uint8, sw-calibration-access=READ-ONLY, range raw 0..255}
                RmBufferedTpPropertiesRomIdxOfRmSrcRom: resulting-properties={base-type=uint8, sw-calibration-access=READ-ONLY, compu {255=PDUR_NO_RMBUFFEREDTPPROPERTIESROMIDXOFRMSRCROM}, range raw 0..255}
                RmBufferedTpPropertiesRomPartitionIdxOfRmSrcRom: resulting-properties={base-type=uint8, sw-calibration-access=READ-ONLY, compu {255=PDUR_NO_RMBUFFEREDTPPROPERTIESROMPARTITIONIDXOFRMSRCROM}, range raw 0..255}
                RmDestRomEndIdxOfRmSrcRom: resulting-properties={base-type=uint8, sw-calibration-access=READ-ONLY, range raw 0..255}
                RmDestRomStartIdxOfRmSrcRom: resulting-properties={base-type=uint8, sw-calibration-access=READ-ONLY, range raw 0..255}
                SrcHndOfRmSrcRom: resulting-properties={base-type=uint8, sw-calibration-access=READ-ONLY, compu {255=PDUR_NO_SRCHNDOFRMSRCROM}, range raw 0..255}
            Element_113: symbol=[113]
              8 x mc data instance, all with category=VALUE:
                LockRomIdxOfRmSrcRom: resulting-properties={base-type=uint8, sw-calibration-access=READ-ONLY, range raw 0..255}
                MaskedBitsOfRmSrcRom: resulting-properties={base-type=uint8, sw-calibration-access=READ-ONLY, range raw 0..255}
                MmRomIdxOfRmSrcRom: resulting-properties={base-type=uint8, sw-calibration-access=READ-ONLY, range raw 0..255}
                RmBufferedTpPropertiesRomIdxOfRmSrcRom: resulting-properties={base-type=uint8, sw-calibration-access=READ-ONLY, compu {255=PDUR_NO_RMBUFFEREDTPPROPERTIESROMIDXOFRMSRCROM}, range raw 0..255}
                RmBufferedTpPropertiesRomPartitionIdxOfRmSrcRom: resulting-properties={base-type=uint8, sw-calibration-access=READ-ONLY, compu {255=PDUR_NO_RMBUFFEREDTPPROPERTIESROMPARTITIONIDXOFRMSRCROM}, range raw 0..255}
                RmDestRomEndIdxOfRmSrcRom: resulting-properties={base-type=uint8, sw-calibration-access=READ-ONLY, range raw 0..255}
                RmDestRomStartIdxOfRmSrcRom: resulting-properties={base-type=uint8, sw-calibration-access=READ-ONLY, range raw 0..255}
                SrcHndOfRmSrcRom: resulting-properties={base-type=uint8, sw-calibration-access=READ-ONLY, compu {255=PDUR_NO_SRCHNDOFRMSRCROM}, range raw 0..255}
            Element_114: symbol=[114]
              8 x mc data instance, all with category=VALUE:
                LockRomIdxOfRmSrcRom: resulting-properties={base-type=uint8, sw-calibration-access=READ-ONLY, range raw 0..255}
                MaskedBitsOfRmSrcRom: resulting-properties={base-type=uint8, sw-calibration-access=READ-ONLY, range raw 0..255}
                MmRomIdxOfRmSrcRom: resulting-properties={base-type=uint8, sw-calibration-access=READ-ONLY, range raw 0..255}
                RmBufferedTpPropertiesRomIdxOfRmSrcRom: resulting-properties={base-type=uint8, sw-calibration-access=READ-ONLY, compu {255=PDUR_NO_RMBUFFEREDTPPROPERTIESROMIDXOFRMSRCROM}, range raw 0..255}
                RmBufferedTpPropertiesRomPartitionIdxOfRmSrcRom: resulting-properties={base-type=uint8, sw-calibration-access=READ-ONLY, compu {255=PDUR_NO_RMBUFFEREDTPPROPERTIESROMPARTITIONIDXOFRMSRCROM}, range raw 0..255}
                RmDestRomEndIdxOfRmSrcRom: resulting-properties={base-type=uint8, sw-calibration-access=READ-ONLY, range raw 0..255}
                RmDestRomStartIdxOfRmSrcRom: resulting-properties={base-type=uint8, sw-calibration-access=READ-ONLY, range raw 0..255}
                SrcHndOfRmSrcRom: resulting-properties={base-type=uint8, sw-calibration-access=READ-ONLY, compu {255=PDUR_NO_SRCHNDOFRMSRCROM}, range raw 0..255}
            Element_115: symbol=[115]
              8 x mc data instance, all with category=VALUE:
                LockRomIdxOfRmSrcRom: resulting-properties={base-type=uint8, sw-calibration-access=READ-ONLY, range raw 0..255}
                MaskedBitsOfRmSrcRom: resulting-properties={base-type=uint8, sw-calibration-access=READ-ONLY, range raw 0..255}
                MmRomIdxOfRmSrcRom: resulting-properties={base-type=uint8, sw-calibration-access=READ-ONLY, range raw 0..255}
                RmBufferedTpPropertiesRomIdxOfRmSrcRom: resulting-properties={base-type=uint8, sw-calibration-access=READ-ONLY, compu {255=PDUR_NO_RMBUFFEREDTPPROPERTIESROMIDXOFRMSRCROM}, range raw 0..255}
                RmBufferedTpPropertiesRomPartitionIdxOfRmSrcRom: resulting-properties={base-type=uint8, sw-calibration-access=READ-ONLY, compu {255=PDUR_NO_RMBUFFEREDTPPROPERTIESROMPARTITIONIDXOFRMSRCROM}, range raw 0..255}
                RmDestRomEndIdxOfRmSrcRom: resulting-properties={base-type=uint8, sw-calibration-access=READ-ONLY, range raw 0..255}
                RmDestRomStartIdxOfRmSrcRom: resulting-properties={base-type=uint8, sw-calibration-access=READ-ONLY, range raw 0..255}
                SrcHndOfRmSrcRom: resulting-properties={base-type=uint8, sw-calibration-access=READ-ONLY, compu {255=PDUR_NO_SRCHNDOFRMSRCROM}, range raw 0..255}
            Element_116: symbol=[116]
              8 x mc data instance, all with category=VALUE:
                LockRomIdxOfRmSrcRom: resulting-properties={base-type=uint8, sw-calibration-access=READ-ONLY, range raw 0..255}
                MaskedBitsOfRmSrcRom: resulting-properties={base-type=uint8, sw-calibration-access=READ-ONLY, range raw 0..255}
                MmRomIdxOfRmSrcRom: resulting-properties={base-type=uint8, sw-calibration-access=READ-ONLY, range raw 0..255}
                RmBufferedTpPropertiesRomIdxOfRmSrcRom: resulting-properties={base-type=uint8, sw-calibration-access=READ-ONLY, compu {255=PDUR_NO_RMBUFFEREDTPPROPERTIESROMIDXOFRMSRCROM}, range raw 0..255}
                RmBufferedTpPropertiesRomPartitionIdxOfRmSrcRom: resulting-properties={base-type=uint8, sw-calibration-access=READ-ONLY, compu {255=PDUR_NO_RMBUFFEREDTPPROPERTIESROMPARTITIONIDXOFRMSRCROM}, range raw 0..255}
                RmDestRomEndIdxOfRmSrcRom: resulting-properties={base-type=uint8, sw-calibration-access=READ-ONLY, range raw 0..255}
                RmDestRomStartIdxOfRmSrcRom: resulting-properties={base-type=uint8, sw-calibration-access=READ-ONLY, range raw 0..255}
                SrcHndOfRmSrcRom: resulting-properties={base-type=uint8, sw-calibration-access=READ-ONLY, compu {255=PDUR_NO_SRCHNDOFRMSRCROM}, range raw 0..255}
            Element_117: symbol=[117]
              8 x mc data instance, all with category=VALUE:
                LockRomIdxOfRmSrcRom: resulting-properties={base-type=uint8, sw-calibration-access=READ-ONLY, range raw 0..255}
                MaskedBitsOfRmSrcRom: resulting-properties={base-type=uint8, sw-calibration-access=READ-ONLY, range raw 0..255}
                MmRomIdxOfRmSrcRom: resulting-properties={base-type=uint8, sw-calibration-access=READ-ONLY, range raw 0..255}
                RmBufferedTpPropertiesRomIdxOfRmSrcRom: resulting-properties={base-type=uint8, sw-calibration-access=READ-ONLY, compu {255=PDUR_NO_RMBUFFEREDTPPROPERTIESROMIDXOFRMSRCROM}, range raw 0..255}
                RmBufferedTpPropertiesRomPartitionIdxOfRmSrcRom: resulting-properties={base-type=uint8, sw-calibration-access=READ-ONLY, compu {255=PDUR_NO_RMBUFFEREDTPPROPERTIESROMPARTITIONIDXOFRMSRCROM}, range raw 0..255}
                RmDestRomEndIdxOfRmSrcRom: resulting-properties={base-type=uint8, sw-calibration-access=READ-ONLY, range raw 0..255}
                RmDestRomStartIdxOfRmSrcRom: resulting-properties={base-type=uint8, sw-calibration-access=READ-ONLY, range raw 0..255}
                SrcHndOfRmSrcRom: resulting-properties={base-type=uint8, sw-calibration-access=READ-ONLY, compu {255=PDUR_NO_SRCHNDOFRMSRCROM}, range raw 0..255}
            Element_118: symbol=[118]
              8 x mc data instance, all with category=VALUE:
                LockRomIdxOfRmSrcRom: resulting-properties={base-type=uint8, sw-calibration-access=READ-ONLY, range raw 0..255}
                MaskedBitsOfRmSrcRom: resulting-properties={base-type=uint8, sw-calibration-access=READ-ONLY, range raw 0..255}
                MmRomIdxOfRmSrcRom: resulting-properties={base-type=uint8, sw-calibration-access=READ-ONLY, range raw 0..255}
                RmBufferedTpPropertiesRomIdxOfRmSrcRom: resulting-properties={base-type=uint8, sw-calibration-access=READ-ONLY, compu {255=PDUR_NO_RMBUFFEREDTPPROPERTIESROMIDXOFRMSRCROM}, range raw 0..255}
                RmBufferedTpPropertiesRomPartitionIdxOfRmSrcRom: resulting-properties={base-type=uint8, sw-calibration-access=READ-ONLY, compu {255=PDUR_NO_RMBUFFEREDTPPROPERTIESROMPARTITIONIDXOFRMSRCROM}, range raw 0..255}
                RmDestRomEndIdxOfRmSrcRom: resulting-properties={base-type=uint8, sw-calibration-access=READ-ONLY, range raw 0..255}
                RmDestRomStartIdxOfRmSrcRom: resulting-properties={base-type=uint8, sw-calibration-access=READ-ONLY, range raw 0..255}
                SrcHndOfRmSrcRom: resulting-properties={base-type=uint8, sw-calibration-access=READ-ONLY, compu {255=PDUR_NO_SRCHNDOFRMSRCROM}, range raw 0..255}
            Element_119: symbol=[119]
              8 x mc data instance, all with category=VALUE:
                LockRomIdxOfRmSrcRom: resulting-properties={base-type=uint8, sw-calibration-access=READ-ONLY, range raw 0..255}
                MaskedBitsOfRmSrcRom: resulting-properties={base-type=uint8, sw-calibration-access=READ-ONLY, range raw 0..255}
                MmRomIdxOfRmSrcRom: resulting-properties={base-type=uint8, sw-calibration-access=READ-ONLY, range raw 0..255}
                RmBufferedTpPropertiesRomIdxOfRmSrcRom: resulting-properties={base-type=uint8, sw-calibration-access=READ-ONLY, compu {255=PDUR_NO_RMBUFFEREDTPPROPERTIESROMIDXOFRMSRCROM}, range raw 0..255}
                RmBufferedTpPropertiesRomPartitionIdxOfRmSrcRom: resulting-properties={base-type=uint8, sw-calibration-access=READ-ONLY, compu {255=PDUR_NO_RMBUFFEREDTPPROPERTIESROMPARTITIONIDXOFRMSRCROM}, range raw 0..255}
                RmDestRomEndIdxOfRmSrcRom: resulting-properties={base-type=uint8, sw-calibration-access=READ-ONLY, range raw 0..255}
                RmDestRomStartIdxOfRmSrcRom: resulting-properties={base-type=uint8, sw-calibration-access=READ-ONLY, range raw 0..255}
                SrcHndOfRmSrcRom: resulting-properties={base-type=uint8, sw-calibration-access=READ-ONLY, compu {255=PDUR_NO_SRCHNDOFRMSRCROM}, range raw 0..255}
            Element_120: symbol=[120]
              8 x mc data instance, all with category=VALUE:
                LockRomIdxOfRmSrcRom: resulting-properties={base-type=uint8, sw-calibration-access=READ-ONLY, range raw 0..255}
                MaskedBitsOfRmSrcRom: resulting-properties={base-type=uint8, sw-calibration-access=READ-ONLY, range raw 0..255}
                MmRomIdxOfRmSrcRom: resulting-properties={base-type=uint8, sw-calibration-access=READ-ONLY, range raw 0..255}
                RmBufferedTpPropertiesRomIdxOfRmSrcRom: resulting-properties={base-type=uint8, sw-calibration-access=READ-ONLY, compu {255=PDUR_NO_RMBUFFEREDTPPROPERTIESROMIDXOFRMSRCROM}, range raw 0..255}
                RmBufferedTpPropertiesRomPartitionIdxOfRmSrcRom: resulting-properties={base-type=uint8, sw-calibration-access=READ-ONLY, compu {255=PDUR_NO_RMBUFFEREDTPPROPERTIESROMPARTITIONIDXOFRMSRCROM}, range raw 0..255}
                RmDestRomEndIdxOfRmSrcRom: resulting-properties={base-type=uint8, sw-calibration-access=READ-ONLY, range raw 0..255}
                RmDestRomStartIdxOfRmSrcRom: resulting-properties={base-type=uint8, sw-calibration-access=READ-ONLY, range raw 0..255}
                SrcHndOfRmSrcRom: resulting-properties={base-type=uint8, sw-calibration-access=READ-ONLY, compu {255=PDUR_NO_SRCHNDOFRMSRCROM}, range raw 0..255}
            Element_121: symbol=[121]
              8 x mc data instance, all with category=VALUE:
                LockRomIdxOfRmSrcRom: resulting-properties={base-type=uint8, sw-calibration-access=READ-ONLY, range raw 0..255}
                MaskedBitsOfRmSrcRom: resulting-properties={base-type=uint8, sw-calibration-access=READ-ONLY, range raw 0..255}
                MmRomIdxOfRmSrcRom: resulting-properties={base-type=uint8, sw-calibration-access=READ-ONLY, range raw 0..255}
                RmBufferedTpPropertiesRomIdxOfRmSrcRom: resulting-properties={base-type=uint8, sw-calibration-access=READ-ONLY, compu {255=PDUR_NO_RMBUFFEREDTPPROPERTIESROMIDXOFRMSRCROM}, range raw 0..255}
                RmBufferedTpPropertiesRomPartitionIdxOfRmSrcRom: resulting-properties={base-type=uint8, sw-calibration-access=READ-ONLY, compu {255=PDUR_NO_RMBUFFEREDTPPROPERTIESROMPARTITIONIDXOFRMSRCROM}, range raw 0..255}
                RmDestRomEndIdxOfRmSrcRom: resulting-properties={base-type=uint8, sw-calibration-access=READ-ONLY, range raw 0..255}
                RmDestRomStartIdxOfRmSrcRom: resulting-properties={base-type=uint8, sw-calibration-access=READ-ONLY, range raw 0..255}
                SrcHndOfRmSrcRom: resulting-properties={base-type=uint8, sw-calibration-access=READ-ONLY, compu {255=PDUR_NO_SRCHNDOFRMSRCROM}, range raw 0..255}
            Element_122: symbol=[122]
              8 x mc data instance, all with category=VALUE:
                LockRomIdxOfRmSrcRom: resulting-properties={base-type=uint8, sw-calibration-access=READ-ONLY, range raw 0..255}
                MaskedBitsOfRmSrcRom: resulting-properties={base-type=uint8, sw-calibration-access=READ-ONLY, range raw 0..255}
                MmRomIdxOfRmSrcRom: resulting-properties={base-type=uint8, sw-calibration-access=READ-ONLY, range raw 0..255}
                RmBufferedTpPropertiesRomIdxOfRmSrcRom: resulting-properties={base-type=uint8, sw-calibration-access=READ-ONLY, compu {255=PDUR_NO_RMBUFFEREDTPPROPERTIESROMIDXOFRMSRCROM}, range raw 0..255}
                RmBufferedTpPropertiesRomPartitionIdxOfRmSrcRom: resulting-properties={base-type=uint8, sw-calibration-access=READ-ONLY, compu {255=PDUR_NO_RMBUFFEREDTPPROPERTIESROMPARTITIONIDXOFRMSRCROM}, range raw 0..255}
                RmDestRomEndIdxOfRmSrcRom: resulting-properties={base-type=uint8, sw-calibration-access=READ-ONLY, range raw 0..255}
                RmDestRomStartIdxOfRmSrcRom: resulting-properties={base-type=uint8, sw-calibration-access=READ-ONLY, range raw 0..255}
                SrcHndOfRmSrcRom: resulting-properties={base-type=uint8, sw-calibration-access=READ-ONLY, compu {255=PDUR_NO_SRCHNDOFRMSRCROM}, range raw 0..255}
            Element_123: symbol=[123]
              8 x mc data instance, all with category=VALUE:
                LockRomIdxOfRmSrcRom: resulting-properties={base-type=uint8, sw-calibration-access=READ-ONLY, range raw 0..255}
                MaskedBitsOfRmSrcRom: resulting-properties={base-type=uint8, sw-calibration-access=READ-ONLY, range raw 0..255}
                MmRomIdxOfRmSrcRom: resulting-properties={base-type=uint8, sw-calibration-access=READ-ONLY, range raw 0..255}
                RmBufferedTpPropertiesRomIdxOfRmSrcRom: resulting-properties={base-type=uint8, sw-calibration-access=READ-ONLY, compu {255=PDUR_NO_RMBUFFEREDTPPROPERTIESROMIDXOFRMSRCROM}, range raw 0..255}
                RmBufferedTpPropertiesRomPartitionIdxOfRmSrcRom: resulting-properties={base-type=uint8, sw-calibration-access=READ-ONLY, compu {255=PDUR_NO_RMBUFFEREDTPPROPERTIESROMPARTITIONIDXOFRMSRCROM}, range raw 0..255}
                RmDestRomEndIdxOfRmSrcRom: resulting-properties={base-type=uint8, sw-calibration-access=READ-ONLY, range raw 0..255}
                RmDestRomStartIdxOfRmSrcRom: resulting-properties={base-type=uint8, sw-calibration-access=READ-ONLY, range raw 0..255}
                SrcHndOfRmSrcRom: resulting-properties={base-type=uint8, sw-calibration-access=READ-ONLY, compu {255=PDUR_NO_SRCHNDOFRMSRCROM}, range raw 0..255}
            Element_124: symbol=[124]
              8 x mc data instance, all with category=VALUE:
                LockRomIdxOfRmSrcRom: resulting-properties={base-type=uint8, sw-calibration-access=READ-ONLY, range raw 0..255}
                MaskedBitsOfRmSrcRom: resulting-properties={base-type=uint8, sw-calibration-access=READ-ONLY, range raw 0..255}
                MmRomIdxOfRmSrcRom: resulting-properties={base-type=uint8, sw-calibration-access=READ-ONLY, range raw 0..255}
                RmBufferedTpPropertiesRomIdxOfRmSrcRom: resulting-properties={base-type=uint8, sw-calibration-access=READ-ONLY, compu {255=PDUR_NO_RMBUFFEREDTPPROPERTIESROMIDXOFRMSRCROM}, range raw 0..255}
                RmBufferedTpPropertiesRomPartitionIdxOfRmSrcRom: resulting-properties={base-type=uint8, sw-calibration-access=READ-ONLY, compu {255=PDUR_NO_RMBUFFEREDTPPROPERTIESROMPARTITIONIDXOFRMSRCROM}, range raw 0..255}
                RmDestRomEndIdxOfRmSrcRom: resulting-properties={base-type=uint8, sw-calibration-access=READ-ONLY, range raw 0..255}
                RmDestRomStartIdxOfRmSrcRom: resulting-properties={base-type=uint8, sw-calibration-access=READ-ONLY, range raw 0..255}
                SrcHndOfRmSrcRom: resulting-properties={base-type=uint8, sw-calibration-access=READ-ONLY, compu {255=PDUR_NO_SRCHNDOFRMSRCROM}, range raw 0..255}
            Element_125: symbol=[125]
              8 x mc data instance, all with category=VALUE:
                LockRomIdxOfRmSrcRom: resulting-properties={base-type=uint8, sw-calibration-access=READ-ONLY, range raw 0..255}
                MaskedBitsOfRmSrcRom: resulting-properties={base-type=uint8, sw-calibration-access=READ-ONLY, range raw 0..255}
                MmRomIdxOfRmSrcRom: resulting-properties={base-type=uint8, sw-calibration-access=READ-ONLY, range raw 0..255}
                RmBufferedTpPropertiesRomIdxOfRmSrcRom: resulting-properties={base-type=uint8, sw-calibration-access=READ-ONLY, compu {255=PDUR_NO_RMBUFFEREDTPPROPERTIESROMIDXOFRMSRCROM}, range raw 0..255}
                RmBufferedTpPropertiesRomPartitionIdxOfRmSrcRom: resulting-properties={base-type=uint8, sw-calibration-access=READ-ONLY, compu {255=PDUR_NO_RMBUFFEREDTPPROPERTIESROMPARTITIONIDXOFRMSRCROM}, range raw 0..255}
                RmDestRomEndIdxOfRmSrcRom: resulting-properties={base-type=uint8, sw-calibration-access=READ-ONLY, range raw 0..255}
                RmDestRomStartIdxOfRmSrcRom: resulting-properties={base-type=uint8, sw-calibration-access=READ-ONLY, range raw 0..255}
                SrcHndOfRmSrcRom: resulting-properties={base-type=uint8, sw-calibration-access=READ-ONLY, compu {255=PDUR_NO_SRCHNDOFRMSRCROM}, range raw 0..255}
            Element_126: symbol=[126]
              8 x mc data instance, all with category=VALUE:
                LockRomIdxOfRmSrcRom: resulting-properties={base-type=uint8, sw-calibration-access=READ-ONLY, range raw 0..255}
                MaskedBitsOfRmSrcRom: resulting-properties={base-type=uint8, sw-calibration-access=READ-ONLY, range raw 0..255}
                MmRomIdxOfRmSrcRom: resulting-properties={base-type=uint8, sw-calibration-access=READ-ONLY, range raw 0..255}
                RmBufferedTpPropertiesRomIdxOfRmSrcRom: resulting-properties={base-type=uint8, sw-calibration-access=READ-ONLY, compu {255=PDUR_NO_RMBUFFEREDTPPROPERTIESROMIDXOFRMSRCROM}, range raw 0..255}
                RmBufferedTpPropertiesRomPartitionIdxOfRmSrcRom: resulting-properties={base-type=uint8, sw-calibration-access=READ-ONLY, compu {255=PDUR_NO_RMBUFFEREDTPPROPERTIESROMPARTITIONIDXOFRMSRCROM}, range raw 0..255}
                RmDestRomEndIdxOfRmSrcRom: resulting-properties={base-type=uint8, sw-calibration-access=READ-ONLY, range raw 0..255}
                RmDestRomStartIdxOfRmSrcRom: resulting-properties={base-type=uint8, sw-calibration-access=READ-ONLY, range raw 0..255}
                SrcHndOfRmSrcRom: resulting-properties={base-type=uint8, sw-calibration-access=READ-ONLY, compu {255=PDUR_NO_SRCHNDOFRMSRCROM}, range raw 0..255}
            Element_127: symbol=[127]
              8 x mc data instance, all with category=VALUE:
                LockRomIdxOfRmSrcRom: resulting-properties={base-type=uint8, sw-calibration-access=READ-ONLY, range raw 0..255}
                MaskedBitsOfRmSrcRom: resulting-properties={base-type=uint8, sw-calibration-access=READ-ONLY, range raw 0..255}
                MmRomIdxOfRmSrcRom: resulting-properties={base-type=uint8, sw-calibration-access=READ-ONLY, range raw 0..255}
                RmBufferedTpPropertiesRomIdxOfRmSrcRom: resulting-properties={base-type=uint8, sw-calibration-access=READ-ONLY, compu {255=PDUR_NO_RMBUFFEREDTPPROPERTIESROMIDXOFRMSRCROM}, range raw 0..255}
                RmBufferedTpPropertiesRomPartitionIdxOfRmSrcRom: resulting-properties={base-type=uint8, sw-calibration-access=READ-ONLY, compu {255=PDUR_NO_RMBUFFEREDTPPROPERTIESROMPARTITIONIDXOFRMSRCROM}, range raw 0..255}
                RmDestRomEndIdxOfRmSrcRom: resulting-properties={base-type=uint8, sw-calibration-access=READ-ONLY, range raw 0..255}
                RmDestRomStartIdxOfRmSrcRom: resulting-properties={base-type=uint8, sw-calibration-access=READ-ONLY, range raw 0..255}
                SrcHndOfRmSrcRom: resulting-properties={base-type=uint8, sw-calibration-access=READ-ONLY, compu {255=PDUR_NO_SRCHNDOFRMSRCROM}, range raw 0..255}
            Element_128: symbol=[128]
              8 x mc data instance, all with category=VALUE:
                LockRomIdxOfRmSrcRom: resulting-properties={base-type=uint8, sw-calibration-access=READ-ONLY, range raw 0..255}
                MaskedBitsOfRmSrcRom: resulting-properties={base-type=uint8, sw-calibration-access=READ-ONLY, range raw 0..255}
                MmRomIdxOfRmSrcRom: resulting-properties={base-type=uint8, sw-calibration-access=READ-ONLY, range raw 0..255}
                RmBufferedTpPropertiesRomIdxOfRmSrcRom: resulting-properties={base-type=uint8, sw-calibration-access=READ-ONLY, compu {255=PDUR_NO_RMBUFFEREDTPPROPERTIESROMIDXOFRMSRCROM}, range raw 0..255}
                RmBufferedTpPropertiesRomPartitionIdxOfRmSrcRom: resulting-properties={base-type=uint8, sw-calibration-access=READ-ONLY, compu {255=PDUR_NO_RMBUFFEREDTPPROPERTIESROMPARTITIONIDXOFRMSRCROM}, range raw 0..255}
                RmDestRomEndIdxOfRmSrcRom: resulting-properties={base-type=uint8, sw-calibration-access=READ-ONLY, range raw 0..255}
                RmDestRomStartIdxOfRmSrcRom: resulting-properties={base-type=uint8, sw-calibration-access=READ-ONLY, range raw 0..255}
                SrcHndOfRmSrcRom: resulting-properties={base-type=uint8, sw-calibration-access=READ-ONLY, compu {255=PDUR_NO_SRCHNDOFRMSRCROM}, range raw 0..255}
            Element_129: symbol=[129]
              8 x mc data instance, all with category=VALUE:
                LockRomIdxOfRmSrcRom: resulting-properties={base-type=uint8, sw-calibration-access=READ-ONLY, range raw 0..255}
                MaskedBitsOfRmSrcRom: resulting-properties={base-type=uint8, sw-calibration-access=READ-ONLY, range raw 0..255}
                MmRomIdxOfRmSrcRom: resulting-properties={base-type=uint8, sw-calibration-access=READ-ONLY, range raw 0..255}
                RmBufferedTpPropertiesRomIdxOfRmSrcRom: resulting-properties={base-type=uint8, sw-calibration-access=READ-ONLY, compu {255=PDUR_NO_RMBUFFEREDTPPROPERTIESROMIDXOFRMSRCROM}, range raw 0..255}
                RmBufferedTpPropertiesRomPartitionIdxOfRmSrcRom: resulting-properties={base-type=uint8, sw-calibration-access=READ-ONLY, compu {255=PDUR_NO_RMBUFFEREDTPPROPERTIESROMPARTITIONIDXOFRMSRCROM}, range raw 0..255}
                RmDestRomEndIdxOfRmSrcRom: resulting-properties={base-type=uint8, sw-calibration-access=READ-ONLY, range raw 0..255}
                RmDestRomStartIdxOfRmSrcRom: resulting-properties={base-type=uint8, sw-calibration-access=READ-ONLY, range raw 0..255}
                SrcHndOfRmSrcRom: resulting-properties={base-type=uint8, sw-calibration-access=READ-ONLY, compu {255=PDUR_NO_SRCHNDOFRMSRCROM}, range raw 0..255}
            Element_130: symbol=[130]
              8 x mc data instance, all with category=VALUE:
                LockRomIdxOfRmSrcRom: resulting-properties={base-type=uint8, sw-calibration-access=READ-ONLY, range raw 0..255}
                MaskedBitsOfRmSrcRom: resulting-properties={base-type=uint8, sw-calibration-access=READ-ONLY, range raw 0..255}
                MmRomIdxOfRmSrcRom: resulting-properties={base-type=uint8, sw-calibration-access=READ-ONLY, range raw 0..255}
                RmBufferedTpPropertiesRomIdxOfRmSrcRom: resulting-properties={base-type=uint8, sw-calibration-access=READ-ONLY, compu {255=PDUR_NO_RMBUFFEREDTPPROPERTIESROMIDXOFRMSRCROM}, range raw 0..255}
                RmBufferedTpPropertiesRomPartitionIdxOfRmSrcRom: resulting-properties={base-type=uint8, sw-calibration-access=READ-ONLY, compu {255=PDUR_NO_RMBUFFEREDTPPROPERTIESROMPARTITIONIDXOFRMSRCROM}, range raw 0..255}
                RmDestRomEndIdxOfRmSrcRom: resulting-properties={base-type=uint8, sw-calibration-access=READ-ONLY, range raw 0..255}
                RmDestRomStartIdxOfRmSrcRom: resulting-properties={base-type=uint8, sw-calibration-access=READ-ONLY, range raw 0..255}
                SrcHndOfRmSrcRom: resulting-properties={base-type=uint8, sw-calibration-access=READ-ONLY, compu {255=PDUR_NO_SRCHNDOFRMSRCROM}, range raw 0..255}
            Element_131: symbol=[131]
              8 x mc data instance, all with category=VALUE:
                LockRomIdxOfRmSrcRom: resulting-properties={base-type=uint8, sw-calibration-access=READ-ONLY, range raw 0..255}
                MaskedBitsOfRmSrcRom: resulting-properties={base-type=uint8, sw-calibration-access=READ-ONLY, range raw 0..255}
                MmRomIdxOfRmSrcRom: resulting-properties={base-type=uint8, sw-calibration-access=READ-ONLY, range raw 0..255}
                RmBufferedTpPropertiesRomIdxOfRmSrcRom: resulting-properties={base-type=uint8, sw-calibration-access=READ-ONLY, compu {255=PDUR_NO_RMBUFFEREDTPPROPERTIESROMIDXOFRMSRCROM}, range raw 0..255}
                RmBufferedTpPropertiesRomPartitionIdxOfRmSrcRom: resulting-properties={base-type=uint8, sw-calibration-access=READ-ONLY, compu {255=PDUR_NO_RMBUFFEREDTPPROPERTIESROMPARTITIONIDXOFRMSRCROM}, range raw 0..255}
                RmDestRomEndIdxOfRmSrcRom: resulting-properties={base-type=uint8, sw-calibration-access=READ-ONLY, range raw 0..255}
                RmDestRomStartIdxOfRmSrcRom: resulting-properties={base-type=uint8, sw-calibration-access=READ-ONLY, range raw 0..255}
                SrcHndOfRmSrcRom: resulting-properties={base-type=uint8, sw-calibration-access=READ-ONLY, compu {255=PDUR_NO_SRCHNDOFRMSRCROM}, range raw 0..255}
            Element_132: symbol=[132]
              8 x mc data instance, all with category=VALUE:
                LockRomIdxOfRmSrcRom: resulting-properties={base-type=uint8, sw-calibration-access=READ-ONLY, range raw 0..255}
                MaskedBitsOfRmSrcRom: resulting-properties={base-type=uint8, sw-calibration-access=READ-ONLY, range raw 0..255}
                MmRomIdxOfRmSrcRom: resulting-properties={base-type=uint8, sw-calibration-access=READ-ONLY, range raw 0..255}
                RmBufferedTpPropertiesRomIdxOfRmSrcRom: resulting-properties={base-type=uint8, sw-calibration-access=READ-ONLY, compu {255=PDUR_NO_RMBUFFEREDTPPROPERTIESROMIDXOFRMSRCROM}, range raw 0..255}
                RmBufferedTpPropertiesRomPartitionIdxOfRmSrcRom: resulting-properties={base-type=uint8, sw-calibration-access=READ-ONLY, compu {255=PDUR_NO_RMBUFFEREDTPPROPERTIESROMPARTITIONIDXOFRMSRCROM}, range raw 0..255}
                RmDestRomEndIdxOfRmSrcRom: resulting-properties={base-type=uint8, sw-calibration-access=READ-ONLY, range raw 0..255}
                RmDestRomStartIdxOfRmSrcRom: resulting-properties={base-type=uint8, sw-calibration-access=READ-ONLY, range raw 0..255}
                SrcHndOfRmSrcRom: resulting-properties={base-type=uint8, sw-calibration-access=READ-ONLY, compu {255=PDUR_NO_SRCHNDOFRMSRCROM}, range raw 0..255}
            Element_133: symbol=[133]
              8 x mc data instance, all with category=VALUE:
                LockRomIdxOfRmSrcRom: resulting-properties={base-type=uint8, sw-calibration-access=READ-ONLY, range raw 0..255}
                MaskedBitsOfRmSrcRom: resulting-properties={base-type=uint8, sw-calibration-access=READ-ONLY, range raw 0..255}
                MmRomIdxOfRmSrcRom: resulting-properties={base-type=uint8, sw-calibration-access=READ-ONLY, range raw 0..255}
                RmBufferedTpPropertiesRomIdxOfRmSrcRom: resulting-properties={base-type=uint8, sw-calibration-access=READ-ONLY, compu {255=PDUR_NO_RMBUFFEREDTPPROPERTIESROMIDXOFRMSRCROM}, range raw 0..255}
                RmBufferedTpPropertiesRomPartitionIdxOfRmSrcRom: resulting-properties={base-type=uint8, sw-calibration-access=READ-ONLY, compu {255=PDUR_NO_RMBUFFEREDTPPROPERTIESROMPARTITIONIDXOFRMSRCROM}, range raw 0..255}
                RmDestRomEndIdxOfRmSrcRom: resulting-properties={base-type=uint8, sw-calibration-access=READ-ONLY, range raw 0..255}
                RmDestRomStartIdxOfRmSrcRom: resulting-properties={base-type=uint8, sw-calibration-access=READ-ONLY, range raw 0..255}
                SrcHndOfRmSrcRom: resulting-properties={base-type=uint8, sw-calibration-access=READ-ONLY, compu {255=PDUR_NO_SRCHNDOFRMSRCROM}, range raw 0..255}
            Element_134: symbol=[134]
              8 x mc data instance, all with category=VALUE:
                LockRomIdxOfRmSrcRom: resulting-properties={base-type=uint8, sw-calibration-access=READ-ONLY, range raw 0..255}
                MaskedBitsOfRmSrcRom: resulting-properties={base-type=uint8, sw-calibration-access=READ-ONLY, range raw 0..255}
                MmRomIdxOfRmSrcRom: resulting-properties={base-type=uint8, sw-calibration-access=READ-ONLY, range raw 0..255}
                RmBufferedTpPropertiesRomIdxOfRmSrcRom: resulting-properties={base-type=uint8, sw-calibration-access=READ-ONLY, compu {255=PDUR_NO_RMBUFFEREDTPPROPERTIESROMIDXOFRMSRCROM}, range raw 0..255}
                RmBufferedTpPropertiesRomPartitionIdxOfRmSrcRom: resulting-properties={base-type=uint8, sw-calibration-access=READ-ONLY, compu {255=PDUR_NO_RMBUFFEREDTPPROPERTIESROMPARTITIONIDXOFRMSRCROM}, range raw 0..255}
                RmDestRomEndIdxOfRmSrcRom: resulting-properties={base-type=uint8, sw-calibration-access=READ-ONLY, range raw 0..255}
                RmDestRomStartIdxOfRmSrcRom: resulting-properties={base-type=uint8, sw-calibration-access=READ-ONLY, range raw 0..255}
                SrcHndOfRmSrcRom: resulting-properties={base-type=uint8, sw-calibration-access=READ-ONLY, compu {255=PDUR_NO_SRCHNDOFRMSRCROM}, range raw 0..255}
            Element_135: symbol=[135]
              8 x mc data instance, all with category=VALUE:
                LockRomIdxOfRmSrcRom: resulting-properties={base-type=uint8, sw-calibration-access=READ-ONLY, range raw 0..255}
                MaskedBitsOfRmSrcRom: resulting-properties={base-type=uint8, sw-calibration-access=READ-ONLY, range raw 0..255}
                MmRomIdxOfRmSrcRom: resulting-properties={base-type=uint8, sw-calibration-access=READ-ONLY, range raw 0..255}
                RmBufferedTpPropertiesRomIdxOfRmSrcRom: resulting-properties={base-type=uint8, sw-calibration-access=READ-ONLY, compu {255=PDUR_NO_RMBUFFEREDTPPROPERTIESROMIDXOFRMSRCROM}, range raw 0..255}
                RmBufferedTpPropertiesRomPartitionIdxOfRmSrcRom: resulting-properties={base-type=uint8, sw-calibration-access=READ-ONLY, compu {255=PDUR_NO_RMBUFFEREDTPPROPERTIESROMPARTITIONIDXOFRMSRCROM}, range raw 0..255}
                RmDestRomEndIdxOfRmSrcRom: resulting-properties={base-type=uint8, sw-calibration-access=READ-ONLY, range raw 0..255}
                RmDestRomStartIdxOfRmSrcRom: resulting-properties={base-type=uint8, sw-calibration-access=READ-ONLY, range raw 0..255}
                SrcHndOfRmSrcRom: resulting-properties={base-type=uint8, sw-calibration-access=READ-ONLY, compu {255=PDUR_NO_SRCHNDOFRMSRCROM}, range raw 0..255}
            Element_136: symbol=[136]
              8 x mc data instance, all with category=VALUE:
                LockRomIdxOfRmSrcRom: resulting-properties={base-type=uint8, sw-calibration-access=READ-ONLY, range raw 0..255}
                MaskedBitsOfRmSrcRom: resulting-properties={base-type=uint8, sw-calibration-access=READ-ONLY, range raw 0..255}
                MmRomIdxOfRmSrcRom: resulting-properties={base-type=uint8, sw-calibration-access=READ-ONLY, range raw 0..255}
                RmBufferedTpPropertiesRomIdxOfRmSrcRom: resulting-properties={base-type=uint8, sw-calibration-access=READ-ONLY, compu {255=PDUR_NO_RMBUFFEREDTPPROPERTIESROMIDXOFRMSRCROM}, range raw 0..255}
                RmBufferedTpPropertiesRomPartitionIdxOfRmSrcRom: resulting-properties={base-type=uint8, sw-calibration-access=READ-ONLY, compu {255=PDUR_NO_RMBUFFEREDTPPROPERTIESROMPARTITIONIDXOFRMSRCROM}, range raw 0..255}
                RmDestRomEndIdxOfRmSrcRom: resulting-properties={base-type=uint8, sw-calibration-access=READ-ONLY, range raw 0..255}
                RmDestRomStartIdxOfRmSrcRom: resulting-properties={base-type=uint8, sw-calibration-access=READ-ONLY, range raw 0..255}
                SrcHndOfRmSrcRom: resulting-properties={base-type=uint8, sw-calibration-access=READ-ONLY, compu {255=PDUR_NO_SRCHNDOFRMSRCROM}, range raw 0..255}
            Element_137: symbol=[137]
              8 x mc data instance, all with category=VALUE:
                LockRomIdxOfRmSrcRom: resulting-properties={base-type=uint8, sw-calibration-access=READ-ONLY, range raw 0..255}
                MaskedBitsOfRmSrcRom: resulting-properties={base-type=uint8, sw-calibration-access=READ-ONLY, range raw 0..255}
                MmRomIdxOfRmSrcRom: resulting-properties={base-type=uint8, sw-calibration-access=READ-ONLY, range raw 0..255}
                RmBufferedTpPropertiesRomIdxOfRmSrcRom: resulting-properties={base-type=uint8, sw-calibration-access=READ-ONLY, compu {255=PDUR_NO_RMBUFFEREDTPPROPERTIESROMIDXOFRMSRCROM}, range raw 0..255}
                RmBufferedTpPropertiesRomPartitionIdxOfRmSrcRom: resulting-properties={base-type=uint8, sw-calibration-access=READ-ONLY, compu {255=PDUR_NO_RMBUFFEREDTPPROPERTIESROMPARTITIONIDXOFRMSRCROM}, range raw 0..255}
                RmDestRomEndIdxOfRmSrcRom: resulting-properties={base-type=uint8, sw-calibration-access=READ-ONLY, range raw 0..255}
                RmDestRomStartIdxOfRmSrcRom: resulting-properties={base-type=uint8, sw-calibration-access=READ-ONLY, range raw 0..255}
                SrcHndOfRmSrcRom: resulting-properties={base-type=uint8, sw-calibration-access=READ-ONLY, compu {255=PDUR_NO_SRCHNDOFRMSRCROM}, range raw 0..255}
            Element_138: symbol=[138]
              8 x mc data instance, all with category=VALUE:
                LockRomIdxOfRmSrcRom: resulting-properties={base-type=uint8, sw-calibration-access=READ-ONLY, range raw 0..255}
                MaskedBitsOfRmSrcRom: resulting-properties={base-type=uint8, sw-calibration-access=READ-ONLY, range raw 0..255}
                MmRomIdxOfRmSrcRom: resulting-properties={base-type=uint8, sw-calibration-access=READ-ONLY, range raw 0..255}
                RmBufferedTpPropertiesRomIdxOfRmSrcRom: resulting-properties={base-type=uint8, sw-calibration-access=READ-ONLY, compu {255=PDUR_NO_RMBUFFEREDTPPROPERTIESROMIDXOFRMSRCROM}, range raw 0..255}
                RmBufferedTpPropertiesRomPartitionIdxOfRmSrcRom: resulting-properties={base-type=uint8, sw-calibration-access=READ-ONLY, compu {255=PDUR_NO_RMBUFFEREDTPPROPERTIESROMPARTITIONIDXOFRMSRCROM}, range raw 0..255}
                RmDestRomEndIdxOfRmSrcRom: resulting-properties={base-type=uint8, sw-calibration-access=READ-ONLY, range raw 0..255}
                RmDestRomStartIdxOfRmSrcRom: resulting-properties={base-type=uint8, sw-calibration-access=READ-ONLY, range raw 0..255}
                SrcHndOfRmSrcRom: resulting-properties={base-type=uint8, sw-calibration-access=READ-ONLY, compu {255=PDUR_NO_SRCHNDOFRMSRCROM}, range raw 0..255}
            Element_139: symbol=[139]
              8 x mc data instance, all with category=VALUE:
                LockRomIdxOfRmSrcRom: resulting-properties={base-type=uint8, sw-calibration-access=READ-ONLY, range raw 0..255}
                MaskedBitsOfRmSrcRom: resulting-properties={base-type=uint8, sw-calibration-access=READ-ONLY, range raw 0..255}
                MmRomIdxOfRmSrcRom: resulting-properties={base-type=uint8, sw-calibration-access=READ-ONLY, range raw 0..255}
                RmBufferedTpPropertiesRomIdxOfRmSrcRom: resulting-properties={base-type=uint8, sw-calibration-access=READ-ONLY, compu {255=PDUR_NO_RMBUFFEREDTPPROPERTIESROMIDXOFRMSRCROM}, range raw 0..255}
                RmBufferedTpPropertiesRomPartitionIdxOfRmSrcRom: resulting-properties={base-type=uint8, sw-calibration-access=READ-ONLY, compu {255=PDUR_NO_RMBUFFEREDTPPROPERTIESROMPARTITIONIDXOFRMSRCROM}, range raw 0..255}
                RmDestRomEndIdxOfRmSrcRom: resulting-properties={base-type=uint8, sw-calibration-access=READ-ONLY, range raw 0..255}
                RmDestRomStartIdxOfRmSrcRom: resulting-properties={base-type=uint8, sw-calibration-access=READ-ONLY, range raw 0..255}
                SrcHndOfRmSrcRom: resulting-properties={base-type=uint8, sw-calibration-access=READ-ONLY, compu {255=PDUR_NO_SRCHNDOFRMSRCROM}, range raw 0..255}
            Element_140: symbol=[140]
              8 x mc data instance, all with category=VALUE:
                LockRomIdxOfRmSrcRom: resulting-properties={base-type=uint8, sw-calibration-access=READ-ONLY, range raw 0..255}
                MaskedBitsOfRmSrcRom: resulting-properties={base-type=uint8, sw-calibration-access=READ-ONLY, range raw 0..255}
                MmRomIdxOfRmSrcRom: resulting-properties={base-type=uint8, sw-calibration-access=READ-ONLY, range raw 0..255}
                RmBufferedTpPropertiesRomIdxOfRmSrcRom: resulting-properties={base-type=uint8, sw-calibration-access=READ-ONLY, compu {255=PDUR_NO_RMBUFFEREDTPPROPERTIESROMIDXOFRMSRCROM}, range raw 0..255}
                RmBufferedTpPropertiesRomPartitionIdxOfRmSrcRom: resulting-properties={base-type=uint8, sw-calibration-access=READ-ONLY, compu {255=PDUR_NO_RMBUFFEREDTPPROPERTIESROMPARTITIONIDXOFRMSRCROM}, range raw 0..255}
                RmDestRomEndIdxOfRmSrcRom: resulting-properties={base-type=uint8, sw-calibration-access=READ-ONLY, range raw 0..255}
                RmDestRomStartIdxOfRmSrcRom: resulting-properties={base-type=uint8, sw-calibration-access=READ-ONLY, range raw 0..255}
                SrcHndOfRmSrcRom: resulting-properties={base-type=uint8, sw-calibration-access=READ-ONLY, compu {255=PDUR_NO_SRCHNDOFRMSRCROM}, range raw 0..255}
            Element_141: symbol=[141]
              8 x mc data instance, all with category=VALUE:
                LockRomIdxOfRmSrcRom: resulting-properties={base-type=uint8, sw-calibration-access=READ-ONLY, range raw 0..255}
                MaskedBitsOfRmSrcRom: resulting-properties={base-type=uint8, sw-calibration-access=READ-ONLY, range raw 0..255}
                MmRomIdxOfRmSrcRom: resulting-properties={base-type=uint8, sw-calibration-access=READ-ONLY, range raw 0..255}
                RmBufferedTpPropertiesRomIdxOfRmSrcRom: resulting-properties={base-type=uint8, sw-calibration-access=READ-ONLY, compu {255=PDUR_NO_RMBUFFEREDTPPROPERTIESROMIDXOFRMSRCROM}, range raw 0..255}
                RmBufferedTpPropertiesRomPartitionIdxOfRmSrcRom: resulting-properties={base-type=uint8, sw-calibration-access=READ-ONLY, compu {255=PDUR_NO_RMBUFFEREDTPPROPERTIESROMPARTITIONIDXOFRMSRCROM}, range raw 0..255}
                RmDestRomEndIdxOfRmSrcRom: resulting-properties={base-type=uint8, sw-calibration-access=READ-ONLY, range raw 0..255}
                RmDestRomStartIdxOfRmSrcRom: resulting-properties={base-type=uint8, sw-calibration-access=READ-ONLY, range raw 0..255}
                SrcHndOfRmSrcRom: resulting-properties={base-type=uint8, sw-calibration-access=READ-ONLY, compu {255=PDUR_NO_SRCHNDOFRMSRCROM}, range raw 0..255}
