AUTOSAR XML (schema 00048)
package /MICROSAR/vSwUpdM_ib_bswmd/BswModuleDescriptions
  bsw module description vSwUpdM: provided-entrys=vSwUpdM_MainFunction
    bsw internal behavior vSwUpdMBehavior
      exclusive area VSWUPDM_EXCLUSIVE_AREA_0
      bsw schedulable entity vSwUpdM_MainFunction: can-enter-exclusive-area=VSWUPDM_EXCLUSIVE_AREA_0, implemented-entry=vSwUpdM_MainFunction
      bsw timing event vSwUpdM_MainFunctionTimingEvent0: starts-on-event=vSwUpdM_MainFunction, period=0.005
  bsw module entry vSwUpdM_MainFunction: call-type=SCHEDULED, execution-context=TASK
