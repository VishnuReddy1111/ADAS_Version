AUTOSAR XML (schema 4-3-0)
package /MICROSAR/CddNpmGen2_ib_bswmd/BswModuleDescriptions
  bsw module description CddNpmGen2: provided-entrys=CddNpmGen2_MainFunction
    bsw internal behavior CddNpmGen2Behavior
      exclusive area CDDNPMGEN2_EXCLUSIVE_AREA_0  # Ensures data consistency between the main function and the Bus KnockOut, ECU Knock Out and NvM writing algorithms. It is used in the functions CddNpmGen2_ECU_Knock_Out(), CddNpmGen2_Bus_Knock_Out(), CddNpmGen2_CheckNvMResult(), CddNpmGen2_SetVetoState(), CddNpmGen2_MainFunction(), CddNpmGen2_Read_Ident_KnockoutCounter(), CddNpmGen2_Write_Ident_KnockoutCounter(), CddNpmGen2_Write_Ident_KnockoutTimer(), CddNpmGen2_Write_Ident_KnockoutTestMode(), CddNpmGen2_EcuShutdownIndication() and CddNpmGen2_EcuRestartIndication(). It must be configured in a way that these functions cannot interrupt each other.
      bsw schedulable entity CddNpmGen2_MainFunction: can-enter-exclusive-area=CDDNPMGEN2_EXCLUSIVE_AREA_0, implemented-entry=CddNpmGen2_MainFunction
      bsw timing event CddNpmGen2_MainFunctionTimingEvent0: starts-on-event=CddNpmGen2_MainFunction, period=0.1
  bsw module entry CddNpmGen2_MainFunction: call-type=SCHEDULED, execution-context=TASK
