AUTOSAR XML (schema 4-3-0)
standard types defined: boolean, uint32, uint8
package /MICROSAR
  bsw implementation BswM_Impl: programming-language=C, sw-version=16.00.00, used-code-generator=DaVinci Configurator, vendor-id=30, ar-release-version=4.00.03
    mc-variable-instances:
      97 x mc data instance:
        BswM_DeferredRulesOsApplication_SystemApplication_Core0: category=ARRAY, array-size=8, symbol=BswM_DeferredRules
          8 x mc data instance, all with category=STRUCTURE:
            Element_0: symbol=[0]
              mc data instance RulesIdxOfDeferredRules: category=VALUE, resulting-properties={base-type=uint8, sw-calibration-access=READ-ONLY, range raw 0..255}
            Element_1: symbol=[1]
              mc data instance RulesIdxOfDeferredRules: category=VALUE, resulting-properties={base-type=uint8, sw-calibration-access=READ-ONLY, range raw 0..255}
            Element_2: symbol=[2]
              mc data instance RulesIdxOfDeferredRules: category=VALUE, resulting-properties={base-type=uint8, sw-calibration-access=READ-ONLY, range raw 0..255}
            Element_3: symbol=[3]
              mc data instance RulesIdxOfDeferredRules: category=VALUE, resulting-properties={base-type=uint8, sw-calibration-access=READ-ONLY, range raw 0..255}
            Element_4: symbol=[4]
              mc data instance RulesIdxOfDeferredRules: category=VALUE, resulting-properties={base-type=uint8, sw-calibration-access=READ-ONLY, range raw 0..255}
            Element_5: symbol=[5]
              mc data instance RulesIdxOfDeferredRules: category=VALUE, resulting-properties={base-type=uint8, sw-calibration-access=READ-ONLY, range raw 0..255}
            Element_6: symbol=[6]
              mc data instance RulesIdxOfDeferredRules: category=VALUE, resulting-properties={base-type=uint8, sw-calibration-access=READ-ONLY, range raw 0..255}
            Element_7: symbol=[7]
              mc data instance RulesIdxOfDeferredRules: category=VALUE, resulting-properties={base-type=uint8, sw-calibration-access=READ-ONLY, range raw 0..255}
        BswM_ImmediateUserOsApplication_SystemApplication_Core0: category=ARRAY, array-size=15, symbol=BswM_ImmediateUser  # Contains all immediate request ports.
          15 x mc data instance, all with category=STRUCTURE:
            Element_0: symbol=[0]
              mc data instance OnInitOfImmediateUser: category=VALUE, resulting-properties={base-type=boolean, sw-calibration-access=READ-ONLY, compu {0=FALSE, 1..255=TRUE}, range raw 0..1}
              mc data instance RulesIndEndIdxOfImmediateUser: category=VALUE, resulting-properties={base-type=uint8, sw-calibration-access=READ-ONLY, compu {255=BSWM_NO_RULESINDENDIDXOFIMMEDIATEUSER}, range raw 0..255}
              mc data instance RulesIndStartIdxOfImmediateUser: category=VALUE, resulting-properties={base-type=uint8, sw-calibration-access=READ-ONLY, compu {255=BSWM_NO_RULESINDSTARTIDXOFIMMEDIATEUSER}, range raw 0..255}
            Element_1: symbol=[1]
              mc data instance OnInitOfImmediateUser: category=VALUE, resulting-properties={base-type=boolean, sw-calibration-access=READ-ONLY, compu {0=FALSE, 1..255=TRUE}, range raw 0..1}
              mc data instance RulesIndEndIdxOfImmediateUser: category=VALUE, resulting-properties={base-type=uint8, sw-calibration-access=READ-ONLY, compu {255=BSWM_NO_RULESINDENDIDXOFIMMEDIATEUSER}, range raw 0..255}
              mc data instance RulesIndStartIdxOfImmediateUser: category=VALUE, resulting-properties={base-type=uint8, sw-calibration-access=READ-ONLY, compu {255=BSWM_NO_RULESINDSTARTIDXOFIMMEDIATEUSER}, range raw 0..255}
            Element_2: symbol=[2]
              mc data instance OnInitOfImmediateUser: category=VALUE, resulting-properties={base-type=boolean, sw-calibration-access=READ-ONLY, compu {0=FALSE, 1..255=TRUE}, range raw 0..1}
              mc data instance RulesIndEndIdxOfImmediateUser: category=VALUE, resulting-properties={base-type=uint8, sw-calibration-access=READ-ONLY, compu {255=BSWM_NO_RULESINDENDIDXOFIMMEDIATEUSER}, range raw 0..255}
              mc data instance RulesIndStartIdxOfImmediateUser: category=VALUE, resulting-properties={base-type=uint8, sw-calibration-access=READ-ONLY, compu {255=BSWM_NO_RULESINDSTARTIDXOFIMMEDIATEUSER}, range raw 0..255}
            Element_3: symbol=[3]
              mc data instance OnInitOfImmediateUser: category=VALUE, resulting-properties={base-type=boolean, sw-calibration-access=READ-ONLY, compu {0=FALSE, 1..255=TRUE}, range raw 0..1}
              mc data instance RulesIndEndIdxOfImmediateUser: category=VALUE, resulting-properties={base-type=uint8, sw-calibration-access=READ-ONLY, compu {255=BSWM_NO_RULESINDENDIDXOFIMMEDIATEUSER}, range raw 0..255}
              mc data instance RulesIndStartIdxOfImmediateUser: category=VALUE, resulting-properties={base-type=uint8, sw-calibration-access=READ-ONLY, compu {255=BSWM_NO_RULESINDSTARTIDXOFIMMEDIATEUSER}, range raw 0..255}
            Element_4: symbol=[4]
              mc data instance OnInitOfImmediateUser: category=VALUE, resulting-properties={base-type=boolean, sw-calibration-access=READ-ONLY, compu {0=FALSE, 1..255=TRUE}, range raw 0..1}
              mc data instance RulesIndEndIdxOfImmediateUser: category=VALUE, resulting-properties={base-type=uint8, sw-calibration-access=READ-ONLY, compu {255=BSWM_NO_RULESINDENDIDXOFIMMEDIATEUSER}, range raw 0..255}
              mc data instance RulesIndStartIdxOfImmediateUser: category=VALUE, resulting-properties={base-type=uint8, sw-calibration-access=READ-ONLY, compu {255=BSWM_NO_RULESINDSTARTIDXOFIMMEDIATEUSER}, range raw 0..255}
            Element_5: symbol=[5]
              mc data instance OnInitOfImmediateUser: category=VALUE, resulting-properties={base-type=boolean, sw-calibration-access=READ-ONLY, compu {0=FALSE, 1..255=TRUE}, range raw 0..1}
              mc data instance RulesIndEndIdxOfImmediateUser: category=VALUE, resulting-properties={base-type=uint8, sw-calibration-access=READ-ONLY, compu {255=BSWM_NO_RULESINDENDIDXOFIMMEDIATEUSER}, range raw 0..255}
              mc data instance RulesIndStartIdxOfImmediateUser: category=VALUE, resulting-properties={base-type=uint8, sw-calibration-access=READ-ONLY, compu {255=BSWM_NO_RULESINDSTARTIDXOFIMMEDIATEUSER}, range raw 0..255}
            Element_6: symbol=[6]
              mc data instance OnInitOfImmediateUser: category=VALUE, resulting-properties={base-type=boolean, sw-calibration-access=READ-ONLY, compu {0=FALSE, 1..255=TRUE}, range raw 0..1}
              mc data instance RulesIndEndIdxOfImmediateUser: category=VALUE, resulting-properties={base-type=uint8, sw-calibration-access=READ-ONLY, compu {255=BSWM_NO_RULESINDENDIDXOFIMMEDIATEUSER}, range raw 0..255}
              mc data instance RulesIndStartIdxOfImmediateUser: category=VALUE, resulting-properties={base-type=uint8, sw-calibration-access=READ-ONLY, compu {255=BSWM_NO_RULESINDSTARTIDXOFIMMEDIATEUSER}, range raw 0..255}
            Element_7: symbol=[7]
              mc data instance OnInitOfImmediateUser: category=VALUE, resulting-properties={base-type=boolean, sw-calibration-access=READ-ONLY, compu {0=FALSE, 1..255=TRUE}, range raw 0..1}
              mc data instance RulesIndEndIdxOfImmediateUser: category=VALUE, resulting-properties={base-type=uint8, sw-calibration-access=READ-ONLY, compu {255=BSWM_NO_RULESINDENDIDXOFIMMEDIATEUSER}, range raw 0..255}
              mc data instance RulesIndStartIdxOfImmediateUser: category=VALUE, resulting-properties={base-type=uint8, sw-calibration-access=READ-ONLY, compu {255=BSWM_NO_RULESINDSTARTIDXOFIMMEDIATEUSER}, range raw 0..255}
            Element_8: symbol=[8]
              mc data instance OnInitOfImmediateUser: category=VALUE, resulting-properties={base-type=boolean, sw-calibration-access=READ-ONLY, compu {0=FALSE, 1..255=TRUE}, range raw 0..1}
              mc data instance RulesIndEndIdxOfImmediateUser: category=VALUE, resulting-properties={base-type=uint8, sw-calibration-access=READ-ONLY, compu {255=BSWM_NO_RULESINDENDIDXOFIMMEDIATEUSER}, range raw 0..255}
              mc data instance RulesIndStartIdxOfImmediateUser: category=VALUE, resulting-properties={base-type=uint8, sw-calibration-access=READ-ONLY, compu {255=BSWM_NO_RULESINDSTARTIDXOFIMMEDIATEUSER}, range raw 0..255}
            Element_9: symbol=[9]
              mc data instance OnInitOfImmediateUser: category=VALUE, resulting-properties={base-type=boolean, sw-calibration-access=READ-ONLY, compu {0=FALSE, 1..255=TRUE}, range raw 0..1}
              mc data instance RulesIndEndIdxOfImmediateUser: category=VALUE, resulting-properties={base-type=uint8, sw-calibration-access=READ-ONLY, compu {255=BSWM_NO_RULESINDENDIDXOFIMMEDIATEUSER}, range raw 0..255}
              mc data instance RulesIndStartIdxOfImmediateUser: category=VALUE, resulting-properties={base-type=uint8, sw-calibration-access=READ-ONLY, compu {255=BSWM_NO_RULESINDSTARTIDXOFIMMEDIATEUSER}, range raw 0..255}
            Element_10: symbol=[10]
              mc data instance OnInitOfImmediateUser: category=VALUE, resulting-properties={base-type=boolean, sw-calibration-access=READ-ONLY, compu {0=FALSE, 1..255=TRUE}, range raw 0..1}
              mc data instance RulesIndEndIdxOfImmediateUser: category=VALUE, resulting-properties={base-type=uint8, sw-calibration-access=READ-ONLY, compu {255=BSWM_NO_RULESINDENDIDXOFIMMEDIATEUSER}, range raw 0..255}
              mc data instance RulesIndStartIdxOfImmediateUser: category=VALUE, resulting-properties={base-type=uint8, sw-calibration-access=READ-ONLY, compu {255=BSWM_NO_RULESINDSTARTIDXOFIMMEDIATEUSER}, range raw 0..255}
            Element_11: symbol=[11]
              mc data instance OnInitOfImmediateUser: category=VALUE, resulting-properties={base-type=boolean, sw-calibration-access=READ-ONLY, compu {0=FALSE, 1..255=TRUE}, range raw 0..1}
              mc data instance RulesIndEndIdxOfImmediateUser: category=VALUE, resulting-properties={base-type=uint8, sw-calibration-access=READ-ONLY, compu {255=BSWM_NO_RULESINDENDIDXOFIMMEDIATEUSER}, range raw 0..255}
              mc data instance RulesIndStartIdxOfImmediateUser: category=VALUE, resulting-properties={base-type=uint8, sw-calibration-access=READ-ONLY, compu {255=BSWM_NO_RULESINDSTARTIDXOFIMMEDIATEUSER}, range raw 0..255}
            Element_12: symbol=[12]
              mc data instance OnInitOfImmediateUser: category=VALUE, resulting-properties={base-type=boolean, sw-calibration-access=READ-ONLY, compu {0=FALSE, 1..255=TRUE}, range raw 0..1}
              mc data instance RulesIndEndIdxOfImmediateUser: category=VALUE, resulting-properties={base-type=uint8, sw-calibration-access=READ-ONLY, compu {255=BSWM_NO_RULESINDENDIDXOFIMMEDIATEUSER}, range raw 0..255}
              mc data instance RulesIndStartIdxOfImmediateUser: category=VALUE, resulting-properties={base-type=uint8, sw-calibration-access=READ-ONLY, compu {255=BSWM_NO_RULESINDSTARTIDXOFIMMEDIATEUSER}, range raw 0..255}
            Element_13: symbol=[13]
              mc data instance OnInitOfImmediateUser: category=VALUE, resulting-properties={base-type=boolean, sw-calibration-access=READ-ONLY, compu {0=FALSE, 1..255=TRUE}, range raw 0..1}
              mc data instance RulesIndEndIdxOfImmediateUser: category=VALUE, resulting-properties={base-type=uint8, sw-calibration-access=READ-ONLY, compu {255=BSWM_NO_RULESINDENDIDXOFIMMEDIATEUSER}, range raw 0..255}
              mc data instance RulesIndStartIdxOfImmediateUser: category=VALUE, resulting-properties={base-type=uint8, sw-calibration-access=READ-ONLY, compu {255=BSWM_NO_RULESINDSTARTIDXOFIMMEDIATEUSER}, range raw 0..255}
            Element_14: symbol=[14]
              mc data instance OnInitOfImmediateUser: category=VALUE, resulting-properties={base-type=boolean, sw-calibration-access=READ-ONLY, compu {0=FALSE, 1..255=TRUE}, range raw 0..1}
              mc data instance RulesIndEndIdxOfImmediateUser: category=VALUE, resulting-properties={base-type=uint8, sw-calibration-access=READ-ONLY, compu {255=BSWM_NO_RULESINDENDIDXOFIMMEDIATEUSER}, range raw 0..255}
              mc data instance RulesIndStartIdxOfImmediateUser: category=VALUE, resulting-properties={base-type=uint8, sw-calibration-access=READ-ONLY, compu {255=BSWM_NO_RULESINDSTARTIDXOFIMMEDIATEUSER}, range raw 0..255}
        BswM_PCPartitionConfig: category=STRUCTURE
          49 x mc data instance, all with category=VALUE:
            ActionListQueueOfPCPartitionConfig: resulting-properties={base-type=BswM_ActionListQueueOfPCPartitionConfigType, sw-calibration-access=READ-ONLY, compu {0=NULL_PTR}, data-constr=BswM_ActionListQueueOfPCPartitionConfigType}
            ActionListsOfPCPartitionConfig: resulting-properties={base-type=BswM_ActionListsOfPCPartitionConfigType, sw-calibration-access=READ-ONLY, compu {0=NULL_PTR}, data-constr=BswM_ActionListsOfPCPartitionConfigType}
            CanSMChannelMappingOfPCPartitionConfig: resulting-properties={base-type=BswM_CanSMChannelMappingOfPCPartitionConfigType, sw-calibration-access=READ-ONLY, compu {0=NULL_PTR}, data-constr=BswM_CanSMChannelMappingOfPCPartitionConfigType}
            CanSMChannelStateOfPCPartitionConfig: resulting-properties={base-type=BswM_CanSMChannelStateOfPCPartitionConfigType, sw-calibration-access=READ-ONLY, compu {0=NULL_PTR}, data-constr=BswM_CanSMChannelStateOfPCPartitionConfigType}
            ComMChannelMappingOfPCPartitionConfig: resulting-properties={base-type=BswM_ComMChannelMappingOfPCPartitionConfigType, sw-calibration-access=READ-ONLY, compu {0=NULL_PTR}, data-constr=BswM_ComMChannelMappingOfPCPartitionConfigType}
            ComMChannelStateOfPCPartitionConfig: resulting-properties={base-type=BswM_ComMChannelStateOfPCPartitionConfigType, sw-calibration-access=READ-ONLY, compu {0=NULL_PTR}, data-constr=BswM_ComMChannelStateOfPCPartitionConfigType}
            ComMPncMappingOfPCPartitionConfig: resulting-properties={base-type=BswM_ComMPncMappingOfPCPartitionConfigType, sw-calibration-access=READ-ONLY, compu {0=NULL_PTR}, data-constr=BswM_ComMPncMappingOfPCPartitionConfigType}
            ComMPncStateOfPCPartitionConfig: resulting-properties={base-type=BswM_ComMPncStateOfPCPartitionConfigType, sw-calibration-access=READ-ONLY, compu {0=NULL_PTR}, data-constr=BswM_ComMPncStateOfPCPartitionConfigType}
            CoreSyncValueOfPCPartitionConfig: resulting-properties={base-type=BswM_CoreSyncValueOfPCPartitionConfigType, sw-calibration-access=READ-ONLY, compu {0=NULL_PTR}, data-constr=BswM_CoreSyncValueOfPCPartitionConfigType}
            DeferredRulesOfPCPartitionConfig: resulting-properties={base-type=BswM_DeferredRulesOfPCPartitionConfigType, sw-calibration-access=READ-ONLY, compu {0=NULL_PTR}, data-constr=BswM_DeferredRulesOfPCPartitionConfigType}
            ForcedActionListPriorityOfPCPartitionConfig: resulting-properties={base-type=BswM_ForcedActionListPriorityOfPCPartitionConfigType, sw-calibration-access=READ-ONLY, compu {0=NULL_PTR}, data-constr=BswM_ForcedActionListPriorityOfPCPartitionConfigType}
            GenericMappingOfPCPartitionConfig: resulting-properties={base-type=BswM_GenericMappingOfPCPartitionConfigType, sw-calibration-access=READ-ONLY, compu {0=NULL_PTR}, data-constr=BswM_GenericMappingOfPCPartitionConfigType}
            GenericStateOfPCPartitionConfig: resulting-properties={base-type=BswM_GenericStateOfPCPartitionConfigType, sw-calibration-access=READ-ONLY, compu {0=NULL_PTR}, data-constr=BswM_GenericStateOfPCPartitionConfigType}
            ImmediateUserOfPCPartitionConfig: resulting-properties={base-type=BswM_ImmediateUserOfPCPartitionConfigType, sw-calibration-access=READ-ONLY, compu {0=NULL_PTR}, data-constr=BswM_ImmediateUserOfPCPartitionConfigType}
            InitGenVarAndInitALOfPCPartitionConfig: resulting-properties={base-type=BswM_InitGenVarAndInitALOfPCPartitionConfigType, sw-calibration-access=READ-ONLY, compu {0=NULL_PTR}, data-constr=BswM_InitGenVarAndInitALOfPCPartitionConfigType}
            InitSyncCalloutOfPCPartitionConfig: resulting-properties={base-type=BswM_InitSyncCalloutOfPCPartitionConfigType, sw-calibration-access=READ-ONLY, compu {0=NULL_PTR}, data-constr=BswM_InitSyncCalloutOfPCPartitionConfigType}
            InitializedOfPCPartitionConfig: resulting-properties={base-type=BswM_InitializedOfPCPartitionConfigType, sw-calibration-access=READ-ONLY, compu {0=NULL_PTR}, data-constr=BswM_InitializedOfPCPartitionConfigType}
            ModeNotificationFctOfPCPartitionConfig: resulting-properties={base-type=BswM_ModeNotificationFctOfPCPartitionConfigType, sw-calibration-access=READ-ONLY, compu {0=NULL_PTR}, data-constr=BswM_ModeNotificationFctOfPCPartitionConfigType}
            ModeRequestQueueOfPCPartitionConfig: resulting-properties={base-type=BswM_ModeRequestQueueOfPCPartitionConfigType, sw-calibration-access=READ-ONLY, compu {0=NULL_PTR}, data-constr=BswM_ModeRequestQueueOfPCPartitionConfigType}
            NvMJobMappingOfPCPartitionConfig: resulting-properties={base-type=BswM_NvMJobMappingOfPCPartitionConfigType, sw-calibration-access=READ-ONLY, compu {0=NULL_PTR}, data-constr=BswM_NvMJobMappingOfPCPartitionConfigType}
            NvMJobStateOfPCPartitionConfig: resulting-properties={base-type=BswM_NvMJobStateOfPCPartitionConfigType, sw-calibration-access=READ-ONLY, compu {0=NULL_PTR}, data-constr=BswM_NvMJobStateOfPCPartitionConfigType}
            QueueSemaphoreOfPCPartitionConfig: resulting-properties={base-type=BswM_QueueSemaphoreOfPCPartitionConfigType, sw-calibration-access=READ-ONLY, compu {0=NULL_PTR}, data-constr=BswM_QueueSemaphoreOfPCPartitionConfigType}
            QueueWrittenOfPCPartitionConfig: resulting-properties={base-type=BswM_QueueWrittenOfPCPartitionConfigType, sw-calibration-access=READ-ONLY, compu {0=NULL_PTR}, data-constr=BswM_QueueWrittenOfPCPartitionConfigType}
            RuleStatesOfPCPartitionConfig: resulting-properties={base-type=BswM_RuleStatesOfPCPartitionConfigType, sw-calibration-access=READ-ONLY, compu {0=NULL_PTR}, data-constr=BswM_RuleStatesOfPCPartitionConfigType}
            RulesOfPCPartitionConfig: resulting-properties={base-type=BswM_RulesOfPCPartitionConfigType, sw-calibration-access=READ-ONLY, compu {0=NULL_PTR}, data-constr=BswM_RulesOfPCPartitionConfigType}
            RulesIndOfPCPartitionConfig: resulting-properties={base-type=BswM_RulesIndOfPCPartitionConfigType, sw-calibration-access=READ-ONLY, compu {0=NULL_PTR}, data-constr=BswM_RulesIndOfPCPartitionConfigType}
            SwcModeRequestUpdateFctOfPCPartitionConfig: resulting-properties={base-type=BswM_SwcModeRequestUpdateFctOfPCPartitionConfigType, sw-calibration-access=READ-ONLY, compu {0=NULL_PTR}, data-constr=BswM_SwcModeRequestUpdateFctOfPCPartitionConfigType}
            TimerStateOfPCPartitionConfig: resulting-properties={base-type=BswM_TimerStateOfPCPartitionConfigType, sw-calibration-access=READ-ONLY, compu {0=NULL_PTR}, data-constr=BswM_TimerStateOfPCPartitionConfigType}
            TimerValueOfPCPartitionConfig: resulting-properties={base-type=BswM_TimerValueOfPCPartitionConfigType, sw-calibration-access=READ-ONLY, compu {0=NULL_PTR}, data-constr=BswM_TimerValueOfPCPartitionConfigType}
            SizeOfActionListsOfPCPartitionConfig: resulting-properties={base-type=uint8, sw-calibration-access=READ-ONLY, range raw 0..255}
            SizeOfCanSMChannelMappingOfPCPartitionConfig: resulting-properties={base-type=uint8, sw-calibration-access=READ-ONLY, range raw 0..255}
            SizeOfCanSMChannelStateOfPCPartitionConfig: resulting-properties={base-type=uint8, sw-calibration-access=READ-ONLY, range raw 0..255}
            SizeOfComMChannelMappingOfPCPartitionConfig: resulting-properties={base-type=uint8, sw-calibration-access=READ-ONLY, range raw 0..255}
            SizeOfComMChannelStateOfPCPartitionConfig: resulting-properties={base-type=uint8, sw-calibration-access=READ-ONLY, range raw 0..255}
            SizeOfComMPncMappingOfPCPartitionConfig: resulting-properties={base-type=uint8, sw-calibration-access=READ-ONLY, range raw 0..255}
            SizeOfComMPncStateOfPCPartitionConfig: resulting-properties={base-type=uint8, sw-calibration-access=READ-ONLY, range raw 0..255}
            SizeOfDeferredRulesOfPCPartitionConfig: resulting-properties={base-type=uint8, sw-calibration-access=READ-ONLY, range raw 0..255}
            SizeOfGenericMappingOfPCPartitionConfig: resulting-properties={base-type=uint8, sw-calibration-access=READ-ONLY, range raw 0..255}
            SizeOfGenericStateOfPCPartitionConfig: resulting-properties={base-type=uint8, sw-calibration-access=READ-ONLY, range raw 0..255}
            SizeOfImmediateUserOfPCPartitionConfig: resulting-properties={base-type=uint8, sw-calibration-access=READ-ONLY, range raw 0..255}
            SizeOfModeNotificationFctOfPCPartitionConfig: resulting-properties={base-type=uint8, sw-calibration-access=READ-ONLY, range raw 0..255}
            SizeOfNvMJobMappingOfPCPartitionConfig: resulting-properties={base-type=uint8, sw-calibration-access=READ-ONLY, range raw 0..255}
            SizeOfNvMJobStateOfPCPartitionConfig: resulting-properties={base-type=uint8, sw-calibration-access=READ-ONLY, range raw 0..255}
            SizeOfRuleStatesOfPCPartitionConfig: resulting-properties={base-type=uint8, sw-calibration-access=READ-ONLY, range raw 0..255}
            SizeOfRulesOfPCPartitionConfig: resulting-properties={base-type=uint8, sw-calibration-access=READ-ONLY, range raw 0..255}
            SizeOfRulesIndOfPCPartitionConfig: resulting-properties={base-type=uint8, sw-calibration-access=READ-ONLY, range raw 0..255}
            SizeOfSwcModeRequestUpdateFctOfPCPartitionConfig: resulting-properties={base-type=uint8, sw-calibration-access=READ-ONLY, range raw 0..255}
            SizeOfTimerStateOfPCPartitionConfig: resulting-properties={base-type=uint8, sw-calibration-access=READ-ONLY, range raw 0..255}
            SizeOfTimerValueOfPCPartitionConfig: resulting-properties={base-type=uint8, sw-calibration-access=READ-ONLY, range raw 0..255}
        BswM_RulesIndOsApplication_SystemApplication_Core0: category=ARRAY, array-size=66, resulting-properties={base-type=uint8, sw-calibration-access=READ-ONLY, range raw 0..255}, symbol=BswM_RulesInd  # the indexes of the 1:1 sorted relation pointing to BswM_Rules
        BswM_ActionListQueueOsApplication_SystemApplication_Core0: category=ARRAY, array-size=77, resulting-properties={base-type=uint8, sw-calibration-access=READ-ONLY, range raw 0..255}, symbol=BswM_ActionListQueueOsApplication_SystemApplication_Core0.raw  # Variable to store action lists which shall be executed.
        BswM_ActionListQueueOsApplication_SystemApplication_Core0_AL_ESH_AL_ExitRun: category=ARRAY, array-size=1, resulting-properties={base-type=uint8, sw-calibration-access=READ-ONLY, range raw 0..255}, symbol=BswM_ActionListQueueOsApplication_SystemApplication_Core0.raw[1]  # The element: AL_ESH_AL_ExitRun of BswM_ActionListQueueOsApplication_SystemApplication_Core0
        BswM_ActionListQueueOsApplication_SystemApplication_Core0_AL_ESH_AL_RunToPostRun: category=ARRAY, array-size=1, resulting-properties={base-type=uint8, sw-calibration-access=READ-ONLY, range raw 0..255}, symbol=BswM_ActionListQueueOsApplication_SystemApplication_Core0.raw[2]  # The element: AL_ESH_AL_RunToPostRun of BswM_ActionListQueueOsApplication_SystemApplication_Core0
        BswM_ActionListQueueOsApplication_SystemApplication_Core0_AL_ESH_AL_WaitForNvMToShutdown: category=ARRAY, array-size=1, resulting-properties={base-type=uint8, sw-calibration-access=READ-ONLY, range raw 0..255}, symbol=BswM_ActionListQueueOsApplication_SystemApplication_Core0.raw[3]  # The element: AL_ESH_AL_WaitForNvMToShutdown of BswM_ActionListQueueOsApplication_SystemApplication_Core0
        BswM_ActionListQueueOsApplication_SystemApplication_Core0_AL_ESH_AL_WakeupToPrep: category=ARRAY, array-size=1, resulting-properties={base-type=uint8, sw-calibration-access=READ-ONLY, range raw 0..255}, symbol=BswM_ActionListQueueOsApplication_SystemApplication_Core0.raw[4]  # The element: AL_ESH_AL_WakeupToPrep of BswM_ActionListQueueOsApplication_SystemApplication_Core0
        BswM_ActionListQueueOsApplication_SystemApplication_Core0_AL_ESH_AL_WaitForNvMWakeup: category=ARRAY, array-size=1, resulting-properties={base-type=uint8, sw-calibration-access=READ-ONLY, range raw 0..255}, symbol=BswM_ActionListQueueOsApplication_SystemApplication_Core0.raw[5]  # The element: AL_ESH_AL_WaitForNvMWakeup of BswM_ActionListQueueOsApplication_SystemApplication_Core0
        BswM_ActionListQueueOsApplication_SystemApplication_Core0_AL_ESH_AL_WakeupToRun: category=ARRAY, array-size=1, resulting-properties={base-type=uint8, sw-calibration-access=READ-ONLY, range raw 0..255}, symbol=BswM_ActionListQueueOsApplication_SystemApplication_Core0.raw[6]  # The element: AL_ESH_AL_WakeupToRun of BswM_ActionListQueueOsApplication_SystemApplication_Core0
        BswM_ActionListQueueOsApplication_SystemApplication_Core0_AL_ESH_AL_InitToWakeup: category=ARRAY, array-size=1, resulting-properties={base-type=uint8, sw-calibration-access=READ-ONLY, range raw 0..255}, symbol=BswM_ActionListQueueOsApplication_SystemApplication_Core0.raw[7]  # The element: AL_ESH_AL_InitToWakeup of BswM_ActionListQueueOsApplication_SystemApplication_Core0
        BswM_ActionListQueueOsApplication_SystemApplication_Core0_AL_ESH_AL_PostRunToPrepShutdown: category=ARRAY, array-size=1, resulting-properties={base-type=uint8, sw-calibration-access=READ-ONLY, range raw 0..255}, symbol=BswM_ActionListQueueOsApplication_SystemApplication_Core0.raw[8]  # The element: AL_ESH_AL_PostRunToPrepShutdown of BswM_ActionListQueueOsApplication_SystemApplication_Core0
        BswM_ActionListQueueOsApplication_SystemApplication_Core0_AL_ESH_AL_PostRunToRun: category=ARRAY, array-size=1, resulting-properties={base-type=uint8, sw-calibration-access=READ-ONLY, range raw 0..255}, symbol=BswM_ActionListQueueOsApplication_SystemApplication_Core0.raw[9]  # The element: AL_ESH_AL_PostRunToRun of BswM_ActionListQueueOsApplication_SystemApplication_Core0
        BswM_ActionListQueueOsApplication_SystemApplication_Core0_AL_ESH_AL_ExitPostRun: category=ARRAY, array-size=1, resulting-properties={base-type=uint8, sw-calibration-access=READ-ONLY, range raw 0..255}, symbol=BswM_ActionListQueueOsApplication_SystemApplication_Core0.raw[10]  # The element: AL_ESH_AL_ExitPostRun of BswM_ActionListQueueOsApplication_SystemApplication_Core0
        BswM_ActionListQueueOsApplication_SystemApplication_Core0_AL_ESH_AL_PrepShutdownToWaitForNvM: category=ARRAY, array-size=1, resulting-properties={base-type=uint8, sw-calibration-access=READ-ONLY, range raw 0..255}, symbol=BswM_ActionListQueueOsApplication_SystemApplication_Core0.raw[11]  # The element: AL_ESH_AL_PrepShutdownToWaitForNvM of BswM_ActionListQueueOsApplication_SystemApplication_Core0
        BswM_ActionListQueueOsApplication_SystemApplication_Core0_AL_CC_AL_CN_BMC_CAN01_78a85e89_Disable_DM: category=ARRAY, array-size=1, resulting-properties={base-type=uint8, sw-calibration-access=READ-ONLY, range raw 0..255}, symbol=BswM_ActionListQueueOsApplication_SystemApplication_Core0.raw[12]  # The element: AL_CC_AL_CN_BMC_CAN01_78a85e89_Disable_DM of BswM_ActionListQueueOsApplication_SystemApplication_Core0
        BswM_ActionListQueueOsApplication_SystemApplication_Core0_AL_CC_AL_CN_BMC_CAN01_78a85e89_Enable_DM: category=ARRAY, array-size=1, resulting-properties={base-type=uint8, sw-calibration-access=READ-ONLY, range raw 0..255}, symbol=BswM_ActionListQueueOsApplication_SystemApplication_Core0.raw[13]  # The element: AL_CC_AL_CN_BMC_CAN01_78a85e89_Enable_DM of BswM_ActionListQueueOsApplication_SystemApplication_Core0
        BswM_ActionListQueueOsApplication_SystemApplication_Core0_AL_CC_AL_CN_BMC_CAN01_78a85e89_TX_Disable: category=ARRAY, array-size=1, resulting-properties={base-type=uint8, sw-calibration-access=READ-ONLY, range raw 0..255}, symbol=BswM_ActionListQueueOsApplication_SystemApplication_Core0.raw[14]  # The element: AL_CC_AL_CN_BMC_CAN01_78a85e89_TX_Disable of BswM_ActionListQueueOsApplication_SystemApplication_Core0
        BswM_ActionListQueueOsApplication_SystemApplication_Core0_AL_CC_AL_CN_BMC_CAN01_78a85e89_TX_EnableNoinit: category=ARRAY, array-size=1, resulting-properties={base-type=uint8, sw-calibration-access=READ-ONLY, range raw 0..255}, symbol=BswM_ActionListQueueOsApplication_SystemApplication_Core0.raw[15]  # The element: AL_CC_AL_CN_BMC_CAN01_78a85e89_TX_EnableNoinit of BswM_ActionListQueueOsApplication_SystemApplication_Core0
        BswM_ActionListQueueOsApplication_SystemApplication_Core0_AL_CC_AL_CN_BMC_CAN01_78a85e89_RX_Disable: category=ARRAY, array-size=1, resulting-properties={base-type=uint8, sw-calibration-access=READ-ONLY, range raw 0..255}, symbol=BswM_ActionListQueueOsApplication_SystemApplication_Core0.raw[16]  # The element: AL_CC_AL_CN_BMC_CAN01_78a85e89_RX_Disable of BswM_ActionListQueueOsApplication_SystemApplication_Core0
        BswM_ActionListQueueOsApplication_SystemApplication_Core0_AL_CC_AL_CN_BMC_CAN01_78a85e89_RX_EnableNoinit: category=ARRAY, array-size=1, resulting-properties={base-type=uint8, sw-calibration-access=READ-ONLY, range raw 0..255}, symbol=BswM_ActionListQueueOsApplication_SystemApplication_Core0.raw[17]  # The element: AL_CC_AL_CN_BMC_CAN01_78a85e89_RX_EnableNoinit of BswM_ActionListQueueOsApplication_SystemApplication_Core0
        BswM_ActionListQueueOsApplication_SystemApplication_Core0_AL_CC_AL_CN_HCP5_CANFD01_54d90215_PNC_13_Airbag_727cecad_RX_Disable: category=ARRAY, array-size=1, resulting-properties={base-type=uint8, sw-calibration-access=READ-ONLY, range raw 0..255}, symbol=BswM_ActionListQueueOsApplication_SystemApplication_Core0.raw[26]  # The element: AL_CC_AL_CN_HCP5_CANFD01_54d90215_PNC_13_Airbag_727cecad_RX_Disable of BswM_ActionListQueueOsApplication_SystemApplication_Core0
        BswM_ActionListQueueOsApplication_SystemApplication_Core0_AL_CC_AL_CN_HCP5_CANFD01_54d90215_TX_Disable: category=ARRAY, array-size=1, resulting-properties={base-type=uint8, sw-calibration-access=READ-ONLY, range raw 0..255}, symbol=BswM_ActionListQueueOsApplication_SystemApplication_Core0.raw[32]  # The element: AL_CC_AL_CN_HCP5_CANFD01_54d90215_TX_Disable of BswM_ActionListQueueOsApplication_SystemApplication_Core0
        BswM_ActionListQueueOsApplication_SystemApplication_Core0_AL_CC_AL_CN_HCP5_CANFD01_54d90215_TX_EnableNoinit: category=ARRAY, array-size=1, resulting-properties={base-type=uint8, sw-calibration-access=READ-ONLY, range raw 0..255}, symbol=BswM_ActionListQueueOsApplication_SystemApplication_Core0.raw[33]  # The element: AL_CC_AL_CN_HCP5_CANFD01_54d90215_TX_EnableNoinit of BswM_ActionListQueueOsApplication_SystemApplication_Core0
        BswM_ActionListQueueOsApplication_SystemApplication_Core0_AL_CC_AL_CN_HCP5_CANFD01_54d90215_Disable_DM: category=ARRAY, array-size=1, resulting-properties={base-type=uint8, sw-calibration-access=READ-ONLY, range raw 0..255}, symbol=BswM_ActionListQueueOsApplication_SystemApplication_Core0.raw[44]  # The element: AL_CC_AL_CN_HCP5_CANFD01_54d90215_Disable_DM of BswM_ActionListQueueOsApplication_SystemApplication_Core0
        BswM_ActionListQueueOsApplication_SystemApplication_Core0_AL_CC_AL_CN_HCP5_CANFD01_54d90215_Enable_DM: category=ARRAY, array-size=1, resulting-properties={base-type=uint8, sw-calibration-access=READ-ONLY, range raw 0..255}, symbol=BswM_ActionListQueueOsApplication_SystemApplication_Core0.raw[45]  # The element: AL_CC_AL_CN_HCP5_CANFD01_54d90215_Enable_DM of BswM_ActionListQueueOsApplication_SystemApplication_Core0
        BswM_ActionListQueueOsApplication_SystemApplication_Core0_AL_CC_AL_CN_HCP5_CANFD01_54d90215_PNC_11_Chassis_dce36bbc_Enable_DM: category=ARRAY, array-size=1, resulting-properties={base-type=uint8, sw-calibration-access=READ-ONLY, range raw 0..255}, symbol=BswM_ActionListQueueOsApplication_SystemApplication_Core0.raw[49]  # The element: AL_CC_AL_CN_HCP5_CANFD01_54d90215_PNC_11_Chassis_dce36bbc_Enable_DM of BswM_ActionListQueueOsApplication_SystemApplication_Core0
        BswM_ActionListQueueOsApplication_SystemApplication_Core0_AL_CC_AL_CN_HCP5_CANFD01_54d90215_RX_Disable: category=ARRAY, array-size=1, resulting-properties={base-type=uint8, sw-calibration-access=READ-ONLY, range raw 0..255}, symbol=BswM_ActionListQueueOsApplication_SystemApplication_Core0.raw[58]  # The element: AL_CC_AL_CN_HCP5_CANFD01_54d90215_RX_Disable of BswM_ActionListQueueOsApplication_SystemApplication_Core0
        BswM_ActionListQueueOsApplication_SystemApplication_Core0_AL_CC_AL_CN_HCP5_CANFD01_54d90215_RX_EnableNoinit: category=ARRAY, array-size=1, resulting-properties={base-type=uint8, sw-calibration-access=READ-ONLY, range raw 0..255}, symbol=BswM_ActionListQueueOsApplication_SystemApplication_Core0.raw[59]  # The element: AL_CC_AL_CN_HCP5_CANFD01_54d90215_RX_EnableNoinit of BswM_ActionListQueueOsApplication_SystemApplication_Core0
        BswM_ActionListQueueOsApplication_SystemApplication_Core0_AL_CC_AL_CN_HCP5_CANFD01_54d90215_PNC_13_Airbag_727cecad_Disable_DM: category=ARRAY, array-size=1, resulting-properties={base-type=uint8, sw-calibration-access=READ-ONLY, range raw 0..255}, symbol=BswM_ActionListQueueOsApplication_SystemApplication_Core0.raw[60]  # The element: AL_CC_AL_CN_HCP5_CANFD01_54d90215_PNC_13_Airbag_727cecad_Disable_DM of BswM_ActionListQueueOsApplication_SystemApplication_Core0
        BswM_ActionListQueueOsApplication_SystemApplication_Core0_AL_CC_AL_CN_HCP5_CANFD01_54d90215_PNC_13_Airbag_727cecad_Enable_DM: category=ARRAY, array-size=1, resulting-properties={base-type=uint8, sw-calibration-access=READ-ONLY, range raw 0..255}, symbol=BswM_ActionListQueueOsApplication_SystemApplication_Core0.raw[61]  # The element: AL_CC_AL_CN_HCP5_CANFD01_54d90215_PNC_13_Airbag_727cecad_Enable_DM of BswM_ActionListQueueOsApplication_SystemApplication_Core0
        BswM_ActionListQueueOsApplication_SystemApplication_Core0_AL_AL_Dcm_Reset: category=ARRAY, array-size=1, resulting-properties={base-type=uint8, sw-calibration-access=READ-ONLY, range raw 0..255}, symbol=BswM_ActionListQueueOsApplication_SystemApplication_Core0.raw[76]  # The element: AL_AL_Dcm_Reset of BswM_ActionListQueueOsApplication_SystemApplication_Core0
        BswM_ActionListQueueOsApplication_SystemApplication_Core1: category=ARRAY, array-size=1, resulting-properties={base-type=uint8, sw-calibration-access=READ-ONLY, range raw 0..255}, symbol=BswM_ActionListQueueOsApplication_SystemApplication_Core1.raw  # Variable to store action lists which shall be executed.
        BswM_ModeRequestQueueOsApplication_SystemApplication_Core0: category=ARRAY, array-size=15, resulting-properties={base-type=uint8, sw-calibration-access=READ-ONLY, range raw 0..255}, symbol=BswM_ModeRequestQueue  # Variable to store an immediate mode request which must be queued because of a current active arbitration.
        BswM_RuleStatesOsApplication_SystemApplication_Core0: category=ARRAY, array-size=43, resulting-properties={base-type=uint8, sw-calibration-access=READ-ONLY, range raw 0..255}, symbol=BswM_RuleStates.raw  # Stores the last execution state of the rule.
        BswM_RuleStatesOsApplication_SystemApplication_Core0_R_ESH_RunToPostRun: category=ARRAY, array-size=1, resulting-properties={base-type=uint8, sw-calibration-access=READ-ONLY, range raw 0..255}, symbol=BswM_RuleStates.raw[0]  # The element: R_ESH_RunToPostRun of BswM_RuleStates
        BswM_RuleStatesOsApplication_SystemApplication_Core0_R_ESH_RunToPostRunNested: category=ARRAY, array-size=1, resulting-properties={base-type=uint8, sw-calibration-access=READ-ONLY, range raw 0..255}, symbol=BswM_RuleStates.raw[1]  # The element: R_ESH_RunToPostRunNested of BswM_RuleStates
        BswM_RuleStatesOsApplication_SystemApplication_Core0_R_ESH_WaitToShutdown: category=ARRAY, array-size=1, resulting-properties={base-type=uint8, sw-calibration-access=READ-ONLY, range raw 0..255}, symbol=BswM_RuleStates.raw[2]  # The element: R_ESH_WaitToShutdown of BswM_RuleStates
        BswM_RuleStatesOsApplication_SystemApplication_Core0_R_ESH_WakeupToPrep: category=ARRAY, array-size=1, resulting-properties={base-type=uint8, sw-calibration-access=READ-ONLY, range raw 0..255}, symbol=BswM_RuleStates.raw[3]  # The element: R_ESH_WakeupToPrep of BswM_RuleStates
        BswM_RuleStatesOsApplication_SystemApplication_Core0_R_ESH_WaitToWakeup: category=ARRAY, array-size=1, resulting-properties={base-type=uint8, sw-calibration-access=READ-ONLY, range raw 0..255}, symbol=BswM_RuleStates.raw[4]  # The element: R_ESH_WaitToWakeup of BswM_RuleStates
        BswM_RuleStatesOsApplication_SystemApplication_Core0_R_ESH_WakeupToRun: category=ARRAY, array-size=1, resulting-properties={base-type=uint8, sw-calibration-access=READ-ONLY, range raw 0..255}, symbol=BswM_RuleStates.raw[5]  # The element: R_ESH_WakeupToRun of BswM_RuleStates
        BswM_RuleStatesOsApplication_SystemApplication_Core0_R_ESH_InitToWakeup: category=ARRAY, array-size=1, resulting-properties={base-type=uint8, sw-calibration-access=READ-ONLY, range raw 0..255}, symbol=BswM_RuleStates.raw[6]  # The element: R_ESH_InitToWakeup of BswM_RuleStates
        BswM_RuleStatesOsApplication_SystemApplication_Core0_R_ESH_PostRunNested: category=ARRAY, array-size=1, resulting-properties={base-type=uint8, sw-calibration-access=READ-ONLY, range raw 0..255}, symbol=BswM_RuleStates.raw[7]  # The element: R_ESH_PostRunNested of BswM_RuleStates
        BswM_RuleStatesOsApplication_SystemApplication_Core0_R_ESH_PostRun: category=ARRAY, array-size=1, resulting-properties={base-type=uint8, sw-calibration-access=READ-ONLY, range raw 0..255}, symbol=BswM_RuleStates.raw[8]  # The element: R_ESH_PostRun of BswM_RuleStates
        BswM_RuleStatesOsApplication_SystemApplication_Core0_R_ESH_PrepToWait: category=ARRAY, array-size=1, resulting-properties={base-type=uint8, sw-calibration-access=READ-ONLY, range raw 0..255}, symbol=BswM_RuleStates.raw[9]  # The element: R_ESH_PrepToWait of BswM_RuleStates
        BswM_RuleStatesOsApplication_SystemApplication_Core0_R_CC_CN_BMC_CAN01_78a85e89_RX_DM: category=ARRAY, array-size=1, resulting-properties={base-type=uint8, sw-calibration-access=READ-ONLY, range raw 0..255}, symbol=BswM_RuleStates.raw[10]  # The element: R_CC_CN_BMC_CAN01_78a85e89_RX_DM of BswM_RuleStates
        BswM_RuleStatesOsApplication_SystemApplication_Core0_R_CC_CN_BMC_CAN01_78a85e89_TX: category=ARRAY, array-size=1, resulting-properties={base-type=uint8, sw-calibration-access=READ-ONLY, range raw 0..255}, symbol=BswM_RuleStates.raw[11]  # The element: R_CC_CN_BMC_CAN01_78a85e89_TX of BswM_RuleStates
        BswM_RuleStatesOsApplication_SystemApplication_Core0_R_CC_CN_BMC_CAN01_78a85e89_RX: category=ARRAY, array-size=1, resulting-properties={base-type=uint8, sw-calibration-access=READ-ONLY, range raw 0..255}, symbol=BswM_RuleStates.raw[12]  # The element: R_CC_CN_BMC_CAN01_78a85e89_RX of BswM_RuleStates
        BswM_RuleStatesOsApplication_SystemApplication_Core0_R_CC_CN_HCP5_CANFD01_PNC_24_ThermoManagement_RX: category=ARRAY, array-size=1, resulting-properties={base-type=uint8, sw-calibration-access=READ-ONLY, range raw 0..255}, symbol=BswM_RuleStates.raw[13]  # The element: R_CC_CN_HCP5_CANFD01_PNC_24_ThermoManagement_RX of BswM_RuleStates
        BswM_RuleStatesOsApplication_SystemApplication_Core0_R_CC_CN_HCP5_CANFD01_PNC_30_EnergyManagement_RX_DM: category=ARRAY, array-size=1, resulting-properties={base-type=uint8, sw-calibration-access=READ-ONLY, range raw 0..255}, symbol=BswM_RuleStates.raw[14]  # The element: R_CC_CN_HCP5_CANFD01_PNC_30_EnergyManagement_RX_DM of BswM_RuleStates
        BswM_RuleStatesOsApplication_SystemApplication_Core0_R_CC_CN_HCP5_CANFD01_PNC_27_Timemaster_Timer_RX_DM: category=ARRAY, array-size=1, resulting-properties={base-type=uint8, sw-calibration-access=READ-ONLY, range raw 0..255}, symbol=BswM_RuleStates.raw[15]  # The element: R_CC_CN_HCP5_CANFD01_PNC_27_Timemaster_Timer_RX_DM of BswM_RuleStates
        BswM_RuleStatesOsApplication_SystemApplication_Core0_R_CC_CN_HCP5_CANFD01_PNC_40_Diagnosis_Energy_RX: category=ARRAY, array-size=1, resulting-properties={base-type=uint8, sw-calibration-access=READ-ONLY, range raw 0..255}, symbol=BswM_RuleStates.raw[16]  # The element: R_CC_CN_HCP5_CANFD01_PNC_40_Diagnosis_Energy_RX of BswM_RuleStates
        BswM_RuleStatesOsApplication_SystemApplication_Core0_R_CC_CN_HCP5_CANFD01_PNC_13_Airbag_RX: category=ARRAY, array-size=1, resulting-properties={base-type=uint8, sw-calibration-access=READ-ONLY, range raw 0..255}, symbol=BswM_RuleStates.raw[17]  # The element: R_CC_CN_HCP5_CANFD01_PNC_13_Airbag_RX of BswM_RuleStates
        BswM_RuleStatesOsApplication_SystemApplication_Core0_R_CC_CN_HCP5_CANFD01_PNC_10_Powertrain_RX_DM: category=ARRAY, array-size=1, resulting-properties={base-type=uint8, sw-calibration-access=READ-ONLY, range raw 0..255}, symbol=BswM_RuleStates.raw[18]  # The element: R_CC_CN_HCP5_CANFD01_PNC_10_Powertrain_RX_DM of BswM_RuleStates
        BswM_RuleStatesOsApplication_SystemApplication_Core0_R_CC_CN_HCP5_CANFD01_PNC_40_Diagnosis_Energy_TX: category=ARRAY, array-size=1, resulting-properties={base-type=uint8, sw-calibration-access=READ-ONLY, range raw 0..255}, symbol=BswM_RuleStates.raw[19]  # The element: R_CC_CN_HCP5_CANFD01_PNC_40_Diagnosis_Energy_TX of BswM_RuleStates
        BswM_RuleStatesOsApplication_SystemApplication_Core0_R_CC_CN_HCP5_CANFD01_54d90215_TX: category=ARRAY, array-size=1, resulting-properties={base-type=uint8, sw-calibration-access=READ-ONLY, range raw 0..255}, symbol=BswM_RuleStates.raw[20]  # The element: R_CC_CN_HCP5_CANFD01_54d90215_TX of BswM_RuleStates
        BswM_RuleStatesOsApplication_SystemApplication_Core0_R_CC_CN_HCP5_CANFD01_PNC_02_Basefunction_Powertrain_RX: category=ARRAY, array-size=1, resulting-properties={base-type=uint8, sw-calibration-access=READ-ONLY, range raw 0..255}, symbol=BswM_RuleStates.raw[21]  # The element: R_CC_CN_HCP5_CANFD01_PNC_02_Basefunction_Powertrain_RX of BswM_RuleStates
        BswM_RuleStatesOsApplication_SystemApplication_Core0_R_CC_CN_HCP5_CANFD01_PNC_30_EnergyManagement_TX: category=ARRAY, array-size=1, resulting-properties={base-type=uint8, sw-calibration-access=READ-ONLY, range raw 0..255}, symbol=BswM_RuleStates.raw[22]  # The element: R_CC_CN_HCP5_CANFD01_PNC_30_EnergyManagement_TX of BswM_RuleStates
        BswM_RuleStatesOsApplication_SystemApplication_Core0_R_CC_CN_HCP5_CANFD01_PNC_06_Basefunction_ComfortLight_RX_DM: category=ARRAY, array-size=1, resulting-properties={base-type=uint8, sw-calibration-access=READ-ONLY, range raw 0..255}, symbol=BswM_RuleStates.raw[23]  # The element: R_CC_CN_HCP5_CANFD01_PNC_06_Basefunction_ComfortLight_RX_DM of BswM_RuleStates
        BswM_RuleStatesOsApplication_SystemApplication_Core0_R_CC_CN_HCP5_CANFD01_PNC_02_Basefunction_Powertrain_RX_DM: category=ARRAY, array-size=1, resulting-properties={base-type=uint8, sw-calibration-access=READ-ONLY, range raw 0..255}, symbol=BswM_RuleStates.raw[24]  # The element: R_CC_CN_HCP5_CANFD01_PNC_02_Basefunction_Powertrain_RX_DM of BswM_RuleStates
        BswM_RuleStatesOsApplication_SystemApplication_Core0_R_CC_CN_HCP5_CANFD01_PNC_30_EnergyManagement_RX: category=ARRAY, array-size=1, resulting-properties={base-type=uint8, sw-calibration-access=READ-ONLY, range raw 0..255}, symbol=BswM_RuleStates.raw[25]  # The element: R_CC_CN_HCP5_CANFD01_PNC_30_EnergyManagement_RX of BswM_RuleStates
        BswM_RuleStatesOsApplication_SystemApplication_Core0_R_CC_CN_HCP5_CANFD01_54d90215_RX_DM: category=ARRAY, array-size=1, resulting-properties={base-type=uint8, sw-calibration-access=READ-ONLY, range raw 0..255}, symbol=BswM_RuleStates.raw[26]  # The element: R_CC_CN_HCP5_CANFD01_54d90215_RX_DM of BswM_RuleStates
        BswM_RuleStatesOsApplication_SystemApplication_Core0_R_CC_CN_HCP5_CANFD01_PNC_26_HighVoltage_Charging_RX_DM: category=ARRAY, array-size=1, resulting-properties={base-type=uint8, sw-calibration-access=READ-ONLY, range raw 0..255}, symbol=BswM_RuleStates.raw[27]  # The element: R_CC_CN_HCP5_CANFD01_PNC_26_HighVoltage_Charging_RX_DM of BswM_RuleStates
        BswM_RuleStatesOsApplication_SystemApplication_Core0_R_CC_CN_HCP5_CANFD01_PNC_11_Chassis_RX_DM: category=ARRAY, array-size=1, resulting-properties={base-type=uint8, sw-calibration-access=READ-ONLY, range raw 0..255}, symbol=BswM_RuleStates.raw[28]  # The element: R_CC_CN_HCP5_CANFD01_PNC_11_Chassis_RX_DM of BswM_RuleStates
        BswM_RuleStatesOsApplication_SystemApplication_Core0_R_CC_CN_HCP5_CANFD01_PNC_11_Chassis_RX: category=ARRAY, array-size=1, resulting-properties={base-type=uint8, sw-calibration-access=READ-ONLY, range raw 0..255}, symbol=BswM_RuleStates.raw[29]  # The element: R_CC_CN_HCP5_CANFD01_PNC_11_Chassis_RX of BswM_RuleStates
        BswM_RuleStatesOsApplication_SystemApplication_Core0_R_CC_CN_HCP5_CANFD01_54d90215_PNC_26_HighVoltage_Charging_24d89ab8_TX: category=ARRAY, array-size=1, resulting-properties={base-type=uint8, sw-calibration-access=READ-ONLY, range raw 0..255}, symbol=BswM_RuleStates.raw[30]  # The element: R_CC_CN_HCP5_CANFD01_54d90215_PNC_26_HighVoltage_Charging_24d89ab8_TX of BswM_RuleStates
        BswM_RuleStatesOsApplication_SystemApplication_Core0_R_CC_CN_HCP5_CANFD01_PNC_10_Powertrain_RX: category=ARRAY, array-size=1, resulting-properties={base-type=uint8, sw-calibration-access=READ-ONLY, range raw 0..255}, symbol=BswM_RuleStates.raw[31]  # The element: R_CC_CN_HCP5_CANFD01_PNC_10_Powertrain_RX of BswM_RuleStates
        BswM_RuleStatesOsApplication_SystemApplication_Core0_R_CC_CN_HCP5_CANFD01_PNC_01_CarWakeUp_TX: category=ARRAY, array-size=1, resulting-properties={base-type=uint8, sw-calibration-access=READ-ONLY, range raw 0..255}, symbol=BswM_RuleStates.raw[32]  # The element: R_CC_CN_HCP5_CANFD01_PNC_01_CarWakeUp_TX of BswM_RuleStates
        BswM_RuleStatesOsApplication_SystemApplication_Core0_R_CC_CN_HCP5_CANFD01_54d90215_RX: category=ARRAY, array-size=1, resulting-properties={base-type=uint8, sw-calibration-access=READ-ONLY, range raw 0..255}, symbol=BswM_RuleStates.raw[33]  # The element: R_CC_CN_HCP5_CANFD01_54d90215_RX of BswM_RuleStates
        BswM_RuleStatesOsApplication_SystemApplication_Core0_R_CC_CN_HCP5_CANFD01_PNC_13_Airbag_RX_DM: category=ARRAY, array-size=1, resulting-properties={base-type=uint8, sw-calibration-access=READ-ONLY, range raw 0..255}, symbol=BswM_RuleStates.raw[34]  # The element: R_CC_CN_HCP5_CANFD01_PNC_13_Airbag_RX_DM of BswM_RuleStates
        BswM_RuleStatesOsApplication_SystemApplication_Core0_R_CC_CN_HCP5_CANFD01_PNC_27_Timemaster_Timer_RX: category=ARRAY, array-size=1, resulting-properties={base-type=uint8, sw-calibration-access=READ-ONLY, range raw 0..255}, symbol=BswM_RuleStates.raw[35]  # The element: R_CC_CN_HCP5_CANFD01_PNC_27_Timemaster_Timer_RX of BswM_RuleStates
        BswM_RuleStatesOsApplication_SystemApplication_Core0_R_CC_CN_HCP5_CANFD01_PNC_26_HighVoltage_Charging_RX: category=ARRAY, array-size=1, resulting-properties={base-type=uint8, sw-calibration-access=READ-ONLY, range raw 0..255}, symbol=BswM_RuleStates.raw[36]  # The element: R_CC_CN_HCP5_CANFD01_PNC_26_HighVoltage_Charging_RX of BswM_RuleStates
        BswM_RuleStatesOsApplication_SystemApplication_Core0_R_CC_CN_HCP5_CANFD01_PNC_07_Basefunction_CrossSection_RX: category=ARRAY, array-size=1, resulting-properties={base-type=uint8, sw-calibration-access=READ-ONLY, range raw 0..255}, symbol=BswM_RuleStates.raw[37]  # The element: R_CC_CN_HCP5_CANFD01_PNC_07_Basefunction_CrossSection_RX of BswM_RuleStates
        BswM_RuleStatesOsApplication_SystemApplication_Core0_R_CC_CN_HCP5_CANFD01_PNC_24_ThermoManagement_RX_DM: category=ARRAY, array-size=1, resulting-properties={base-type=uint8, sw-calibration-access=READ-ONLY, range raw 0..255}, symbol=BswM_RuleStates.raw[38]  # The element: R_CC_CN_HCP5_CANFD01_PNC_24_ThermoManagement_RX_DM of BswM_RuleStates
        BswM_RuleStatesOsApplication_SystemApplication_Core0_R_CC_CN_HCP5_CANFD01_PNC_07_Basefunction_CrossSection_RX_DM: category=ARRAY, array-size=1, resulting-properties={base-type=uint8, sw-calibration-access=READ-ONLY, range raw 0..255}, symbol=BswM_RuleStates.raw[39]  # The element: R_CC_CN_HCP5_CANFD01_PNC_07_Basefunction_CrossSection_RX_DM of BswM_RuleStates
        BswM_RuleStatesOsApplication_SystemApplication_Core0_R_CC_CN_HCP5_CANFD01_PNC_40_Diagnosis_Energy_RX_DM: category=ARRAY, array-size=1, resulting-properties={base-type=uint8, sw-calibration-access=READ-ONLY, range raw 0..255}, symbol=BswM_RuleStates.raw[40]  # The element: R_CC_CN_HCP5_CANFD01_PNC_40_Diagnosis_Energy_RX_DM of BswM_RuleStates
        BswM_RuleStatesOsApplication_SystemApplication_Core0_R_CC_CN_HCP5_CANFD01_PNC_06_Basefunction_ComfortLight_RX: category=ARRAY, array-size=1, resulting-properties={base-type=uint8, sw-calibration-access=READ-ONLY, range raw 0..255}, symbol=BswM_RuleStates.raw[41]  # The element: R_CC_CN_HCP5_CANFD01_PNC_06_Basefunction_ComfortLight_RX of BswM_RuleStates
        BswM_RuleStatesOsApplication_SystemApplication_Core0_R_BswMRule_DCMRESET: category=ARRAY, array-size=1, resulting-properties={base-type=uint8, sw-calibration-access=READ-ONLY, range raw 0..255}, symbol=BswM_RuleStates.raw[42]  # The element: R_BswMRule_DCMRESET of BswM_RuleStates
        BswM_TimerStateOsApplication_SystemApplication_Core0: category=ARRAY, array-size=3, resulting-properties={base-type=uint8, sw-calibration-access=READ-ONLY, range raw 0..255}, symbol=BswM_TimerState.raw  # Variable to store current state of BswMTimer (STARTED, STOPPER OR EXPIRED).
        BswM_TimerStateOsApplication_SystemApplication_Core0_MRP_ESH_NvM_CancelWriteAllTimer: category=ARRAY, array-size=1, resulting-properties={base-type=uint8, sw-calibration-access=READ-ONLY, range raw 0..255}, symbol=BswM_TimerState.raw[0]  # The element: MRP_ESH_NvM_CancelWriteAllTimer of BswM_TimerState
        BswM_TimerStateOsApplication_SystemApplication_Core0_MRP_ESH_NvM_WriteAllTimer: category=ARRAY, array-size=1, resulting-properties={base-type=uint8, sw-calibration-access=READ-ONLY, range raw 0..255}, symbol=BswM_TimerState.raw[1]  # The element: MRP_ESH_NvM_WriteAllTimer of BswM_TimerState
        BswM_TimerStateOsApplication_SystemApplication_Core0_MRP_ESH_SelfRunRequestTimer: category=ARRAY, array-size=1, resulting-properties={base-type=uint8, sw-calibration-access=READ-ONLY, range raw 0..255}, symbol=BswM_TimerState.raw[2]  # The element: MRP_ESH_SelfRunRequestTimer of BswM_TimerState
        BswM_TimerValueOsApplication_SystemApplication_Core0: category=ARRAY, array-size=3, resulting-properties={base-type=uint32, sw-calibration-access=READ-ONLY, range raw 0..4294967295}, symbol=BswM_TimerValue.raw  # Variable to store current timer values.
        BswM_TimerValueOsApplication_SystemApplication_Core0_MRP_ESH_NvM_CancelWriteAllTimer: category=ARRAY, array-size=1, resulting-properties={base-type=uint32, sw-calibration-access=READ-ONLY, range raw 0..4294967295}, symbol=BswM_TimerValue.raw[0]  # The element: MRP_ESH_NvM_CancelWriteAllTimer of BswM_TimerValue
        BswM_TimerValueOsApplication_SystemApplication_Core0_MRP_ESH_NvM_WriteAllTimer: category=ARRAY, array-size=1, resulting-properties={base-type=uint32, sw-calibration-access=READ-ONLY, range raw 0..4294967295}, symbol=BswM_TimerValue.raw[1]  # The element: MRP_ESH_NvM_WriteAllTimer of BswM_TimerValue
        BswM_TimerValueOsApplication_SystemApplication_Core0_MRP_ESH_SelfRunRequestTimer: category=ARRAY, array-size=1, resulting-properties={base-type=uint32, sw-calibration-access=READ-ONLY, range raw 0..4294967295}, symbol=BswM_TimerValue.raw[2]  # The element: MRP_ESH_SelfRunRequestTimer of BswM_TimerValue
        BswM_CoreSyncValueOsApplication_SystemApplication_Core0: category=VALUE, resulting-properties={base-type=uint8, sw-calibration-access=READ-ONLY, range raw 0..255}
        BswM_CoreSyncValueOsApplication_SystemApplication_Core1: category=VALUE, resulting-properties={base-type=uint8, sw-calibration-access=READ-ONLY, range raw 0..255}
        BswM_ForcedActionListPriorityOsApplication_SystemApplication_Core0: category=VALUE, resulting-properties={base-type=uint8, sw-calibration-access=READ-ONLY, range raw 0..255}
        BswM_ForcedActionListPriorityOsApplication_SystemApplication_Core1: category=VALUE, resulting-properties={base-type=uint8, sw-calibration-access=READ-ONLY, range raw 0..255}
        BswM_InitializedOsApplication_SystemApplication_Core0: category=VALUE, resulting-properties={base-type=boolean, sw-calibration-access=READ-ONLY, compu {0=FALSE, 1..255=TRUE}, range raw 0..1}
        BswM_InitializedOsApplication_SystemApplication_Core1: category=VALUE, resulting-properties={base-type=boolean, sw-calibration-access=READ-ONLY, compu {0=FALSE, 1..255=TRUE}, range raw 0..1}
        BswM_QueueSemaphoreOsApplication_SystemApplication_Core0: category=VALUE, resulting-properties={base-type=uint8, sw-calibration-access=READ-ONLY, range raw 0..255}
        BswM_QueueSemaphoreOsApplication_SystemApplication_Core1: category=VALUE, resulting-properties={base-type=uint8, sw-calibration-access=READ-ONLY, range raw 0..255}
        BswM_QueueWrittenOsApplication_SystemApplication_Core0: category=VALUE, resulting-properties={base-type=boolean, sw-calibration-access=READ-ONLY, compu {0=FALSE, 1..255=TRUE}, range raw 0..1}
        BswM_QueueWrittenOsApplication_SystemApplication_Core1: category=VALUE, resulting-properties={base-type=boolean, sw-calibration-access=READ-ONLY, compu {0=FALSE, 1..255=TRUE}, range raw 0..1}
    resource consumption ResourceConsumption
      181 x memory section:
        VAR_NOCACHE_CLEARED_UNSPECIFIED: alignment=UNSPECIFIED, sw-addrmethod=VAR_NOCACHE_CLEARED
        VAR_FAST_INIT_64: alignment=64, sw-addrmethod=VAR_FAST_INIT
        VAR_FAST_CLEARED_UNSPECIFIED: alignment=UNSPECIFIED, sw-addrmethod=VAR_FAST_CLEARED
        VAR_NO_INIT_8: alignment=8, sw-addrmethod=VAR_NO_INIT
        VAR_NOCACHE_CLEARED_16: alignment=16, sw-addrmethod=VAR_NOCACHE_CLEARED
        VAR_NO_INIT_16: alignment=16, sw-addrmethod=VAR_NO_INIT
        CONST_16: alignment=16, sw-addrmethod=CONST
        VAR_FAST_CLEARED_8: alignment=8, sw-addrmethod=VAR_FAST_CLEARED
        CODE: sw-addrmethod=CODE
        CONST_64: alignment=64, sw-addrmethod=CONST
        VAR_NOCACHE_CLEARED_8: alignment=8, sw-addrmethod=VAR_NOCACHE_CLEARED
        VAR_CLEARED_16: alignment=16, sw-addrmethod=VAR_CLEARED
        VAR_NOCACHE_CLEARED_BOOLEAN: alignment=BOOLEAN, sw-addrmethod=VAR_NOCACHE_CLEARED
        VAR_FAST_NO_INIT_16: alignment=16, sw-addrmethod=VAR_FAST_NO_INIT
        VAR_NO_INIT_64: alignment=64, sw-addrmethod=VAR_NO_INIT
        VAR_NOCACHE_CLEARED_64: alignment=64, sw-addrmethod=VAR_NOCACHE_CLEARED
        VAR_NOCACHE_INIT_32: alignment=32, sw-addrmethod=VAR_NOCACHE_INIT
        VAR_FAST_INIT_32: alignment=32, sw-addrmethod=VAR_FAST_INIT
        VAR_NO_INIT_UNSPECIFIED: alignment=UNSPECIFIED, sw-addrmethod=VAR_NO_INIT
        VAR_CLEARED_8: alignment=8, sw-addrmethod=VAR_CLEARED
        VAR_FAST_CLEARED_16: alignment=16, sw-addrmethod=VAR_FAST_CLEARED
        VAR_NOCACHE_INIT_8: alignment=8, sw-addrmethod=VAR_NOCACHE_INIT
        CONST_UNSPECIFIED: alignment=UNSPECIFIED, sw-addrmethod=CONST
        VAR_NOCACHE_NO_INIT_32: alignment=32, sw-addrmethod=VAR_NOCACHE_NO_INIT
        CONST_32: alignment=32, sw-addrmethod=CONST
        VAR_FAST_CLEARED_64: alignment=64, sw-addrmethod=VAR_FAST_CLEARED
        VAR_INIT_32: alignment=32, sw-addrmethod=VAR_INIT
        VAR_FAST_NO_INIT_64: alignment=64, sw-addrmethod=VAR_FAST_NO_INIT
        VAR_INIT_8: alignment=8, sw-addrmethod=VAR_INIT
        VAR_CLEARED_64: alignment=64, sw-addrmethod=VAR_CLEARED
        VAR_NO_INIT_32: alignment=32, sw-addrmethod=VAR_NO_INIT
        VAR_NOCACHE_INIT_64: alignment=64, sw-addrmethod=VAR_NOCACHE_INIT
        VAR_NOCACHE_CLEARED_32: alignment=32, sw-addrmethod=VAR_NOCACHE_CLEARED
        VAR_NOCACHE_INIT_BOOLEAN: alignment=BOOLEAN, sw-addrmethod=VAR_NOCACHE_INIT
        VAR_FAST_NO_INIT_BOOLEAN: alignment=BOOLEAN, sw-addrmethod=VAR_FAST_NO_INIT
        VAR_FAST_CLEARED_BOOLEAN: alignment=BOOLEAN, sw-addrmethod=VAR_FAST_CLEARED
        VAR_CLEARED_BOOLEAN: alignment=BOOLEAN, sw-addrmethod=VAR_CLEARED
        VAR_NO_INIT_BOOLEAN: alignment=BOOLEAN, sw-addrmethod=VAR_NO_INIT
        VAR_NOCACHE_NO_INIT_64: alignment=64, sw-addrmethod=VAR_NOCACHE_NO_INIT
        VAR_FAST_CLEARED_32: alignment=32, sw-addrmethod=VAR_FAST_CLEARED
        VAR_NOCACHE_NO_INIT_UNSPECIFIED: alignment=UNSPECIFIED, sw-addrmethod=VAR_NOCACHE_NO_INIT
        VAR_INIT_64: alignment=64, sw-addrmethod=VAR_INIT
        VAR_CLEARED_UNSPECIFIED: alignment=UNSPECIFIED, sw-addrmethod=VAR_CLEARED
        VAR_INIT_UNSPECIFIED: alignment=UNSPECIFIED, sw-addrmethod=VAR_INIT
        CONST_8: alignment=8, sw-addrmethod=CONST
        VAR_FAST_NO_INIT_32: alignment=32, sw-addrmethod=VAR_FAST_NO_INIT
        VAR_CLEARED_32: alignment=32, sw-addrmethod=VAR_CLEARED
        VAR_NOCACHE_NO_INIT_BOOLEAN: alignment=BOOLEAN, sw-addrmethod=VAR_NOCACHE_NO_INIT
        VAR_INIT_BOOLEAN: alignment=BOOLEAN, sw-addrmethod=VAR_INIT
        VAR_NOCACHE_INIT_UNSPECIFIED: alignment=UNSPECIFIED, sw-addrmethod=VAR_NOCACHE_INIT
        VAR_FAST_INIT_UNSPECIFIED: alignment=UNSPECIFIED, sw-addrmethod=VAR_FAST_INIT
        VAR_FAST_NO_INIT_8: alignment=8, sw-addrmethod=VAR_FAST_NO_INIT
        VAR_FAST_INIT_8: alignment=8, sw-addrmethod=VAR_FAST_INIT
        VAR_NOCACHE_INIT_16: alignment=16, sw-addrmethod=VAR_NOCACHE_INIT
        VAR_FAST_NO_INIT_UNSPECIFIED: alignment=UNSPECIFIED, sw-addrmethod=VAR_FAST_NO_INIT
        VAR_FAST_INIT_BOOLEAN: alignment=BOOLEAN, sw-addrmethod=VAR_FAST_INIT
        VAR_FAST_INIT_16: alignment=16, sw-addrmethod=VAR_FAST_INIT
        VAR_NOCACHE_NO_INIT_8: alignment=8, sw-addrmethod=VAR_NOCACHE_NO_INIT
        CONST_BOOLEAN: alignment=BOOLEAN, sw-addrmethod=CONST
        VAR_INIT_16: alignment=16, sw-addrmethod=VAR_INIT
        VAR_NOCACHE_NO_INIT_16: alignment=16, sw-addrmethod=VAR_NOCACHE_NO_INIT
        OsApplication_SystemApplication_Core1_VAR_CLEARED_BOOLEAN: alignment=BOOLEAN, sw-addrmethod=OsApplication_SystemApplication_Core1_VAR_CLEARED
        OsApplication_SystemApplication_Core0_VAR_NOCACHE_INIT_8: alignment=8, sw-addrmethod=OsApplication_SystemApplication_Core0_VAR_NOCACHE_INIT
        OsApplication_SystemApplication_Core0_VAR_FAST_INIT_64: alignment=64, sw-addrmethod=OsApplication_SystemApplication_Core0_VAR_FAST_INIT
        OsApplication_SystemApplication_Core0_CONST_32: alignment=32, sw-addrmethod=OsApplication_SystemApplication_Core0_CONST
        OsApplication_SystemApplication_Core0_VAR_FAST_INIT_BOOLEAN: alignment=BOOLEAN, sw-addrmethod=OsApplication_SystemApplication_Core0_VAR_FAST_INIT
        OsApplication_SystemApplication_Core1_VAR_NO_INIT_64: alignment=64, sw-addrmethod=OsApplication_SystemApplication_Core1_VAR_NO_INIT
        OsApplication_SystemApplication_Core1_VAR_NOCACHE_INIT_BOOLEAN: alignment=BOOLEAN, sw-addrmethod=OsApplication_SystemApplication_Core1_VAR_NOCACHE_INIT
        OsApplication_SystemApplication_Core1_VAR_INIT_32: alignment=32, sw-addrmethod=OsApplication_SystemApplication_Core1_VAR_INIT
        OsApplication_SystemApplication_Core1_VAR_NOCACHE_INIT_64: alignment=64, sw-addrmethod=OsApplication_SystemApplication_Core1_VAR_NOCACHE_INIT
        OsApplication_SystemApplication_Core1_VAR_FAST_CLEARED_32: alignment=32, sw-addrmethod=OsApplication_SystemApplication_Core1_VAR_FAST_CLEARED
        OsApplication_SystemApplication_Core1_VAR_CLEARED_64: alignment=64, sw-addrmethod=OsApplication_SystemApplication_Core1_VAR_CLEARED
        OsApplication_SystemApplication_Core1_VAR_NOCACHE_NO_INIT_BOOLEAN: alignment=BOOLEAN, sw-addrmethod=OsApplication_SystemApplication_Core1_VAR_NOCACHE_NO_INIT
        OsApplication_SystemApplication_Core1_VAR_FAST_CLEARED_BOOLEAN: alignment=BOOLEAN, sw-addrmethod=OsApplication_SystemApplication_Core1_VAR_FAST_CLEARED
        OsApplication_SystemApplication_Core0_CONST_UNSPECIFIED: alignment=UNSPECIFIED, sw-addrmethod=OsApplication_SystemApplication_Core0_CONST
        OsApplication_SystemApplication_Core1_CONST_BOOLEAN: alignment=BOOLEAN, sw-addrmethod=OsApplication_SystemApplication_Core1_CONST
        OsApplication_SystemApplication_Core0_VAR_NOCACHE_INIT_64: alignment=64, sw-addrmethod=OsApplication_SystemApplication_Core0_VAR_NOCACHE_INIT
        OsApplication_SystemApplication_Core1_VAR_FAST_INIT_16: alignment=16, sw-addrmethod=OsApplication_SystemApplication_Core1_VAR_FAST_INIT
        OsApplication_SystemApplication_Core0_VAR_FAST_NO_INIT_16: alignment=16, sw-addrmethod=OsApplication_SystemApplication_Core0_VAR_FAST_NO_INIT
        OsApplication_SystemApplication_Core1_VAR_NOCACHE_NO_INIT_UNSPECIFIED: alignment=UNSPECIFIED, sw-addrmethod=OsApplication_SystemApplication_Core1_VAR_NOCACHE_NO_INIT
        OsApplication_SystemApplication_Core1_VAR_FAST_NO_INIT_32: alignment=32, sw-addrmethod=OsApplication_SystemApplication_Core1_VAR_FAST_NO_INIT
        OsApplication_SystemApplication_Core0_VAR_CLEARED_BOOLEAN: alignment=BOOLEAN, sw-addrmethod=OsApplication_SystemApplication_Core0_VAR_CLEARED
        OsApplication_SystemApplication_Core0_VAR_INIT_32: alignment=32, sw-addrmethod=OsApplication_SystemApplication_Core0_VAR_INIT
        OsApplication_SystemApplication_Core0_VAR_FAST_CLEARED_32: alignment=32, sw-addrmethod=OsApplication_SystemApplication_Core0_VAR_FAST_CLEARED
        OsApplication_SystemApplication_Core0_VAR_INIT_BOOLEAN: alignment=BOOLEAN, sw-addrmethod=OsApplication_SystemApplication_Core0_VAR_INIT
        OsApplication_SystemApplication_Core0_VAR_NO_INIT_16: alignment=16, sw-addrmethod=OsApplication_SystemApplication_Core0_VAR_NO_INIT
        OsApplication_SystemApplication_Core1_CONST_UNSPECIFIED: alignment=UNSPECIFIED, sw-addrmethod=OsApplication_SystemApplication_Core1_CONST
        OsApplication_SystemApplication_Core1_VAR_NOCACHE_NO_INIT_64: alignment=64, sw-addrmethod=OsApplication_SystemApplication_Core1_VAR_NOCACHE_NO_INIT
        OsApplication_SystemApplication_Core0_VAR_FAST_INIT_8: alignment=8, sw-addrmethod=OsApplication_SystemApplication_Core0_VAR_FAST_INIT
        OsApplication_SystemApplication_Core0_VAR_NO_INIT_UNSPECIFIED: alignment=UNSPECIFIED, sw-addrmethod=OsApplication_SystemApplication_Core0_VAR_NO_INIT
        OsApplication_SystemApplication_Core1_VAR_NOCACHE_CLEARED_64: alignment=64, sw-addrmethod=OsApplication_SystemApplication_Core1_VAR_NOCACHE_CLEARED
        OsApplication_SystemApplication_Core0_VAR_FAST_NO_INIT_8: alignment=8, sw-addrmethod=OsApplication_SystemApplication_Core0_VAR_FAST_NO_INIT
        OsApplication_SystemApplication_Core0_VAR_CLEARED_16: alignment=16, sw-addrmethod=OsApplication_SystemApplication_Core0_VAR_CLEARED
        OsApplication_SystemApplication_Core0_VAR_NOCACHE_NO_INIT_BOOLEAN: alignment=BOOLEAN, sw-addrmethod=OsApplication_SystemApplication_Core0_VAR_NOCACHE_NO_INIT
        OsApplication_SystemApplication_Core1_VAR_NOCACHE_CLEARED_UNSPECIFIED: alignment=UNSPECIFIED, sw-addrmethod=OsApplication_SystemApplication_Core1_VAR_NOCACHE_CLEARED
        OsApplication_SystemApplication_Core0_VAR_NOCACHE_NO_INIT_UNSPECIFIED: alignment=UNSPECIFIED, sw-addrmethod=OsApplication_SystemApplication_Core0_VAR_NOCACHE_NO_INIT
        OsApplication_SystemApplication_Core0_VAR_FAST_CLEARED_UNSPECIFIED: alignment=UNSPECIFIED, sw-addrmethod=OsApplication_SystemApplication_Core0_VAR_FAST_CLEARED
        OsApplication_SystemApplication_Core0_VAR_NOCACHE_CLEARED_BOOLEAN: alignment=BOOLEAN, sw-addrmethod=OsApplication_SystemApplication_Core0_VAR_NOCACHE_CLEARED
        OsApplication_SystemApplication_Core1_VAR_NOCACHE_NO_INIT_32: alignment=32, sw-addrmethod=OsApplication_SystemApplication_Core1_VAR_NOCACHE_NO_INIT
        OsApplication_SystemApplication_Core0_CONST_16: alignment=16, sw-addrmethod=OsApplication_SystemApplication_Core0_CONST
        OsApplication_SystemApplication_Core0_VAR_NOCACHE_NO_INIT_8: alignment=8, sw-addrmethod=OsApplication_SystemApplication_Core0_VAR_NOCACHE_NO_INIT
        OsApplication_SystemApplication_Core0_VAR_NO_INIT_8: alignment=8, sw-addrmethod=OsApplication_SystemApplication_Core0_VAR_NO_INIT
        OsApplication_SystemApplication_Core0_VAR_FAST_NO_INIT_BOOLEAN: alignment=BOOLEAN, sw-addrmethod=OsApplication_SystemApplication_Core0_VAR_FAST_NO_INIT
        OsApplication_SystemApplication_Core1_VAR_NOCACHE_CLEARED_32: alignment=32, sw-addrmethod=OsApplication_SystemApplication_Core1_VAR_NOCACHE_CLEARED
        OsApplication_SystemApplication_Core0_VAR_NOCACHE_CLEARED_UNSPECIFIED: alignment=UNSPECIFIED, sw-addrmethod=OsApplication_SystemApplication_Core0_VAR_NOCACHE_CLEARED
        OsApplication_SystemApplication_Core1_VAR_FAST_INIT_32: alignment=32, sw-addrmethod=OsApplication_SystemApplication_Core1_VAR_FAST_INIT
        OsApplication_SystemApplication_Core1_VAR_FAST_CLEARED_8: alignment=8, sw-addrmethod=OsApplication_SystemApplication_Core1_VAR_FAST_CLEARED
        OsApplication_SystemApplication_Core0_VAR_FAST_CLEARED_BOOLEAN: alignment=BOOLEAN, sw-addrmethod=OsApplication_SystemApplication_Core0_VAR_FAST_CLEARED
        OsApplication_SystemApplication_Core0_VAR_NOCACHE_NO_INIT_32: alignment=32, sw-addrmethod=OsApplication_SystemApplication_Core0_VAR_NOCACHE_NO_INIT
        OsApplication_SystemApplication_Core0_VAR_CLEARED_UNSPECIFIED: alignment=UNSPECIFIED, sw-addrmethod=OsApplication_SystemApplication_Core0_VAR_CLEARED
        OsApplication_SystemApplication_Core0_VAR_FAST_NO_INIT_UNSPECIFIED: alignment=UNSPECIFIED, sw-addrmethod=OsApplication_SystemApplication_Core0_VAR_FAST_NO_INIT
        OsApplication_SystemApplication_Core0_VAR_FAST_CLEARED_16: alignment=16, sw-addrmethod=OsApplication_SystemApplication_Core0_VAR_FAST_CLEARED
        OsApplication_SystemApplication_Core1_VAR_FAST_CLEARED_UNSPECIFIED: alignment=UNSPECIFIED, sw-addrmethod=OsApplication_SystemApplication_Core1_VAR_FAST_CLEARED
        OsApplication_SystemApplication_Core1_VAR_NOCACHE_INIT_32: alignment=32, sw-addrmethod=OsApplication_SystemApplication_Core1_VAR_NOCACHE_INIT
        OsApplication_SystemApplication_Core1_VAR_INIT_64: alignment=64, sw-addrmethod=OsApplication_SystemApplication_Core1_VAR_INIT
        OsApplication_SystemApplication_Core0_VAR_NO_INIT_32: alignment=32, sw-addrmethod=OsApplication_SystemApplication_Core0_VAR_NO_INIT
        OsApplication_SystemApplication_Core0_VAR_FAST_NO_INIT_32: alignment=32, sw-addrmethod=OsApplication_SystemApplication_Core0_VAR_FAST_NO_INIT
        OsApplication_SystemApplication_Core1_VAR_FAST_NO_INIT_16: alignment=16, sw-addrmethod=OsApplication_SystemApplication_Core1_VAR_FAST_NO_INIT
        OsApplication_SystemApplication_Core0_VAR_CLEARED_8: alignment=8, sw-addrmethod=OsApplication_SystemApplication_Core0_VAR_CLEARED
        OsApplication_SystemApplication_Core1_VAR_CLEARED_8: alignment=8, sw-addrmethod=OsApplication_SystemApplication_Core1_VAR_CLEARED
        OsApplication_SystemApplication_Core1_CONST_64: alignment=64, sw-addrmethod=OsApplication_SystemApplication_Core1_CONST
        OsApplication_SystemApplication_Core0_VAR_NOCACHE_CLEARED_32: alignment=32, sw-addrmethod=OsApplication_SystemApplication_Core0_VAR_NOCACHE_CLEARED
        OsApplication_SystemApplication_Core0_VAR_CLEARED_32: alignment=32, sw-addrmethod=OsApplication_SystemApplication_Core0_VAR_CLEARED
        OsApplication_SystemApplication_Core0_VAR_INIT_64: alignment=64, sw-addrmethod=OsApplication_SystemApplication_Core0_VAR_INIT
        OsApplication_SystemApplication_Core1_VAR_FAST_CLEARED_16: alignment=16, sw-addrmethod=OsApplication_SystemApplication_Core1_VAR_FAST_CLEARED
        OsApplication_SystemApplication_Core0_VAR_NOCACHE_INIT_32: alignment=32, sw-addrmethod=OsApplication_SystemApplication_Core0_VAR_NOCACHE_INIT
        OsApplication_SystemApplication_Core0_VAR_NOCACHE_CLEARED_8: alignment=8, sw-addrmethod=OsApplication_SystemApplication_Core0_VAR_NOCACHE_CLEARED
        OsApplication_SystemApplication_Core0_VAR_FAST_NO_INIT_64: alignment=64, sw-addrmethod=OsApplication_SystemApplication_Core0_VAR_FAST_NO_INIT
        OsApplication_SystemApplication_Core1_VAR_FAST_INIT_64: alignment=64, sw-addrmethod=OsApplication_SystemApplication_Core1_VAR_FAST_INIT
        OsApplication_SystemApplication_Core1_VAR_NOCACHE_CLEARED_BOOLEAN: alignment=BOOLEAN, sw-addrmethod=OsApplication_SystemApplication_Core1_VAR_NOCACHE_CLEARED
        OsApplication_SystemApplication_Core1_VAR_NOCACHE_NO_INIT_16: alignment=16, sw-addrmethod=OsApplication_SystemApplication_Core1_VAR_NOCACHE_NO_INIT
        OsApplication_SystemApplication_Core1_VAR_FAST_NO_INIT_BOOLEAN: alignment=BOOLEAN, sw-addrmethod=OsApplication_SystemApplication_Core1_VAR_FAST_NO_INIT
        OsApplication_SystemApplication_Core1_VAR_CLEARED_UNSPECIFIED: alignment=UNSPECIFIED, sw-addrmethod=OsApplication_SystemApplication_Core1_VAR_CLEARED
        OsApplication_SystemApplication_Core0_CONST_8: alignment=8, sw-addrmethod=OsApplication_SystemApplication_Core0_CONST
        OsApplication_SystemApplication_Core1_VAR_NOCACHE_INIT_UNSPECIFIED: alignment=UNSPECIFIED, sw-addrmethod=OsApplication_SystemApplication_Core1_VAR_NOCACHE_INIT
        OsApplication_SystemApplication_Core0_VAR_FAST_CLEARED_8: alignment=8, sw-addrmethod=OsApplication_SystemApplication_Core0_VAR_FAST_CLEARED
        OsApplication_SystemApplication_Core1_CONST_16: alignment=16, sw-addrmethod=OsApplication_SystemApplication_Core1_CONST
        OsApplication_SystemApplication_Core0_VAR_NO_INIT_BOOLEAN: alignment=BOOLEAN, sw-addrmethod=OsApplication_SystemApplication_Core0_VAR_NO_INIT
        OsApplication_SystemApplication_Core0_VAR_NOCACHE_INIT_UNSPECIFIED: alignment=UNSPECIFIED, sw-addrmethod=OsApplication_SystemApplication_Core0_VAR_NOCACHE_INIT
        OsApplication_SystemApplication_Core1_VAR_NOCACHE_CLEARED_16: alignment=16, sw-addrmethod=OsApplication_SystemApplication_Core1_VAR_NOCACHE_CLEARED
        OsApplication_SystemApplication_Core1_VAR_NOCACHE_INIT_16: alignment=16, sw-addrmethod=OsApplication_SystemApplication_Core1_VAR_NOCACHE_INIT
        OsApplication_SystemApplication_Core1_VAR_CLEARED_16: alignment=16, sw-addrmethod=OsApplication_SystemApplication_Core1_VAR_CLEARED
        OsApplication_SystemApplication_Core0_CONST_BOOLEAN: alignment=BOOLEAN, sw-addrmethod=OsApplication_SystemApplication_Core0_CONST
        OsApplication_SystemApplication_Core0_VAR_FAST_INIT_16: alignment=16, sw-addrmethod=OsApplication_SystemApplication_Core0_VAR_FAST_INIT
        OsApplication_SystemApplication_Core1_VAR_NO_INIT_16: alignment=16, sw-addrmethod=OsApplication_SystemApplication_Core1_VAR_NO_INIT
        OsApplication_SystemApplication_Core1_VAR_INIT_8: alignment=8, sw-addrmethod=OsApplication_SystemApplication_Core1_VAR_INIT
        OsApplication_SystemApplication_Core0_VAR_NOCACHE_NO_INIT_16: alignment=16, sw-addrmethod=OsApplication_SystemApplication_Core0_VAR_NOCACHE_NO_INIT
        OsApplication_SystemApplication_Core1_VAR_FAST_NO_INIT_8: alignment=8, sw-addrmethod=OsApplication_SystemApplication_Core1_VAR_FAST_NO_INIT
        OsApplication_SystemApplication_Core1_VAR_NO_INIT_8: alignment=8, sw-addrmethod=OsApplication_SystemApplication_Core1_VAR_NO_INIT
        OsApplication_SystemApplication_Core0_VAR_NOCACHE_INIT_16: alignment=16, sw-addrmethod=OsApplication_SystemApplication_Core0_VAR_NOCACHE_INIT
        OsApplication_SystemApplication_Core0_VAR_INIT_8: alignment=8, sw-addrmethod=OsApplication_SystemApplication_Core0_VAR_INIT
        OsApplication_SystemApplication_Core0_VAR_NOCACHE_CLEARED_16: alignment=16, sw-addrmethod=OsApplication_SystemApplication_Core0_VAR_NOCACHE_CLEARED
        OsApplication_SystemApplication_Core0_VAR_NOCACHE_NO_INIT_64: alignment=64, sw-addrmethod=OsApplication_SystemApplication_Core0_VAR_NOCACHE_NO_INIT
        OsApplication_SystemApplication_Core0_VAR_NO_INIT_64: alignment=64, sw-addrmethod=OsApplication_SystemApplication_Core0_VAR_NO_INIT
        OsApplication_SystemApplication_Core1_VAR_INIT_16: alignment=16, sw-addrmethod=OsApplication_SystemApplication_Core1_VAR_INIT
        OsApplication_SystemApplication_Core1_CONST_8: alignment=8, sw-addrmethod=OsApplication_SystemApplication_Core1_CONST
        OsApplication_SystemApplication_Core0_VAR_INIT_16: alignment=16, sw-addrmethod=OsApplication_SystemApplication_Core0_VAR_INIT
        OsApplication_SystemApplication_Core0_VAR_NOCACHE_CLEARED_64: alignment=64, sw-addrmethod=OsApplication_SystemApplication_Core0_VAR_NOCACHE_CLEARED
        OsApplication_SystemApplication_Core0_VAR_CLEARED_64: alignment=64, sw-addrmethod=OsApplication_SystemApplication_Core0_VAR_CLEARED
        OsApplication_SystemApplication_Core1_VAR_NOCACHE_NO_INIT_8: alignment=8, sw-addrmethod=OsApplication_SystemApplication_Core1_VAR_NOCACHE_NO_INIT
        OsApplication_SystemApplication_Core0_VAR_NOCACHE_INIT_BOOLEAN: alignment=BOOLEAN, sw-addrmethod=OsApplication_SystemApplication_Core0_VAR_NOCACHE_INIT
        OsApplication_SystemApplication_Core0_VAR_INIT_UNSPECIFIED: alignment=UNSPECIFIED, sw-addrmethod=OsApplication_SystemApplication_Core0_VAR_INIT
        OsApplication_SystemApplication_Core1_CONST_32: alignment=32, sw-addrmethod=OsApplication_SystemApplication_Core1_CONST
        OsApplication_SystemApplication_Core1_VAR_FAST_NO_INIT_UNSPECIFIED: alignment=UNSPECIFIED, sw-addrmethod=OsApplication_SystemApplication_Core1_VAR_FAST_NO_INIT
        OsApplication_SystemApplication_Core1_VAR_NO_INIT_UNSPECIFIED: alignment=UNSPECIFIED, sw-addrmethod=OsApplication_SystemApplication_Core1_VAR_NO_INIT
        OsApplication_SystemApplication_Core0_CONST_64: alignment=64, sw-addrmethod=OsApplication_SystemApplication_Core0_CONST
        OsApplication_SystemApplication_Core1_VAR_FAST_INIT_UNSPECIFIED: alignment=UNSPECIFIED, sw-addrmethod=OsApplication_SystemApplication_Core1_VAR_FAST_INIT
        OsApplication_SystemApplication_Core0_VAR_FAST_INIT_32: alignment=32, sw-addrmethod=OsApplication_SystemApplication_Core0_VAR_FAST_INIT
        OsApplication_SystemApplication_Core1_VAR_NO_INIT_32: alignment=32, sw-addrmethod=OsApplication_SystemApplication_Core1_VAR_NO_INIT
        OsApplication_SystemApplication_Core1_VAR_FAST_CLEARED_64: alignment=64, sw-addrmethod=OsApplication_SystemApplication_Core1_VAR_FAST_CLEARED
        OsApplication_SystemApplication_Core1_VAR_CLEARED_32: alignment=32, sw-addrmethod=OsApplication_SystemApplication_Core1_VAR_CLEARED
        OsApplication_SystemApplication_Core1_VAR_INIT_BOOLEAN: alignment=BOOLEAN, sw-addrmethod=OsApplication_SystemApplication_Core1_VAR_INIT
        OsApplication_SystemApplication_Core1_VAR_FAST_NO_INIT_64: alignment=64, sw-addrmethod=OsApplication_SystemApplication_Core1_VAR_FAST_NO_INIT
        OsApplication_SystemApplication_Core1_VAR_FAST_INIT_8: alignment=8, sw-addrmethod=OsApplication_SystemApplication_Core1_VAR_FAST_INIT
        OsApplication_SystemApplication_Core1_VAR_NOCACHE_CLEARED_8: alignment=8, sw-addrmethod=OsApplication_SystemApplication_Core1_VAR_NOCACHE_CLEARED
        OsApplication_SystemApplication_Core0_VAR_FAST_INIT_UNSPECIFIED: alignment=UNSPECIFIED, sw-addrmethod=OsApplication_SystemApplication_Core0_VAR_FAST_INIT
        OsApplication_SystemApplication_Core1_VAR_FAST_INIT_BOOLEAN: alignment=BOOLEAN, sw-addrmethod=OsApplication_SystemApplication_Core1_VAR_FAST_INIT
        OsApplication_SystemApplication_Core1_VAR_INIT_UNSPECIFIED: alignment=UNSPECIFIED, sw-addrmethod=OsApplication_SystemApplication_Core1_VAR_INIT
        OsApplication_SystemApplication_Core1_VAR_NO_INIT_BOOLEAN: alignment=BOOLEAN, sw-addrmethod=OsApplication_SystemApplication_Core1_VAR_NO_INIT
        OsApplication_SystemApplication_Core0_VAR_FAST_CLEARED_64: alignment=64, sw-addrmethod=OsApplication_SystemApplication_Core0_VAR_FAST_CLEARED
        OsApplication_SystemApplication_Core1_VAR_NOCACHE_INIT_8: alignment=8, sw-addrmethod=OsApplication_SystemApplication_Core1_VAR_NOCACHE_INIT
package /MICROSAR/BswM_ib_bswmd/BswModuleDescriptions
  bsw module description BswM
    provided-entrys:
      BswM_MainFunction
      BswM_MainFunction_OsApplication_SystemApplication_Core1
      BswM_MainFunction_OsApplication_SystemApplication_Core0
    bsw internal behavior BswMBehavior
      exclusive area BSWM_EXCLUSIVE_AREA_0
      bsw schedulable entity BswM_MainFunction_OsApplication_SystemApplication_Core1: can-enter-exclusive-area=BSWM_EXCLUSIVE_AREA_0, implemented-entry=BswM_MainFunction_OsApplication_SystemApplication_Core1
      bsw schedulable entity BswM_MainFunction_OsApplication_SystemApplication_Core0: can-enter-exclusive-area=BSWM_EXCLUSIVE_AREA_0, implemented-entry=BswM_MainFunction_OsApplication_SystemApplication_Core0
      bsw timing event BswM_MainFunction_OsApplication_SystemApplication_Core1TimingEvent0: starts-on-event=BswM_MainFunction_OsApplication_SystemApplication_Core1, period=0.01
      bsw timing event BswM_MainFunction_OsApplication_SystemApplication_Core0TimingEvent0: starts-on-event=BswM_MainFunction_OsApplication_SystemApplication_Core0, period=0.01
  bsw module entry BswM_MainFunction: call-type=SCHEDULED, execution-context=TASK
  bsw module entry BswM_MainFunction_OsApplication_SystemApplication_Core1: call-type=SCHEDULED, execution-context=TASK
  bsw module entry BswM_MainFunction_OsApplication_SystemApplication_Core0: call-type=SCHEDULED, execution-context=TASK
package /MICROSAR/BswM_ib_bswmd/DataTypes/BaseTypes
  29 x base type, all with category=FIXED_LENGTH, base-type-size=32, base-type-encoding=NONE:
    BswM_ActionListQueueOfPCPartitionConfigType
    BswM_ActionListsOfPCPartitionConfigType
    BswM_CanSMChannelMappingOfPCPartitionConfigType
    BswM_CanSMChannelStateOfPCPartitionConfigType
    BswM_ComMChannelMappingOfPCPartitionConfigType
    BswM_ComMChannelStateOfPCPartitionConfigType
    BswM_CoreSyncValueOfPCPartitionConfigType
    BswM_DeferredRulesOfPCPartitionConfigType
    BswM_ForcedActionListPriorityOfPCPartitionConfigType
    BswM_GenericMappingOfPCPartitionConfigType
    BswM_GenericStateOfPCPartitionConfigType
    BswM_ImmediateUserOfPCPartitionConfigType
    BswM_InitGenVarAndInitALOfPCPartitionConfigType
    BswM_InitSyncCalloutOfPCPartitionConfigType
    BswM_InitializedOfPCPartitionConfigType
    BswM_ModeNotificationFctOfPCPartitionConfigType
    BswM_ModeRequestQueueOfPCPartitionConfigType
    BswM_NvMJobMappingOfPCPartitionConfigType
    BswM_NvMJobStateOfPCPartitionConfigType
    BswM_QueueSemaphoreOfPCPartitionConfigType
    BswM_QueueWrittenOfPCPartitionConfigType
    BswM_RuleStatesOfPCPartitionConfigType
    BswM_RulesIndOfPCPartitionConfigType
    BswM_RulesOfPCPartitionConfigType
    BswM_SwcModeRequestUpdateFctOfPCPartitionConfigType
    BswM_TimerStateOfPCPartitionConfigType
    BswM_TimerValueOfPCPartitionConfigType
    BswM_ComMPncMappingOfPCPartitionConfigType
    BswM_ComMPncStateOfPCPartitionConfigType
package /MICROSAR/BswM_ib_bswmd/DataTypes/DataConstrs
  data constr BswM_ActionListQueueOfPCPartitionConfigType
  data constr BswM_ActionListsOfPCPartitionConfigType
  data constr BswM_CanSMChannelMappingOfPCPartitionConfigType
  data constr BswM_CanSMChannelStateOfPCPartitionConfigType
  data constr BswM_ComMChannelMappingOfPCPartitionConfigType
  data constr BswM_ComMChannelStateOfPCPartitionConfigType
  data constr BswM_CoreSyncValueOfPCPartitionConfigType
  data constr BswM_DeferredRulesOfPCPartitionConfigType
  data constr BswM_ForcedActionListPriorityOfPCPartitionConfigType
  data constr BswM_GenericMappingOfPCPartitionConfigType
  data constr BswM_GenericStateOfPCPartitionConfigType
  data constr BswM_ImmediateUserOfPCPartitionConfigType
  data constr BswM_InitGenVarAndInitALOfPCPartitionConfigType
  data constr BswM_InitSyncCalloutOfPCPartitionConfigType
  data constr BswM_InitializedOfPCPartitionConfigType
  data constr BswM_ModeNotificationFctOfPCPartitionConfigType
  data constr BswM_ModeRequestQueueOfPCPartitionConfigType
  data constr BswM_NvMJobMappingOfPCPartitionConfigType
  data constr BswM_NvMJobStateOfPCPartitionConfigType
  data constr BswM_QueueSemaphoreOfPCPartitionConfigType
  data constr BswM_QueueWrittenOfPCPartitionConfigType
  data constr BswM_RuleStatesOfPCPartitionConfigType
  data constr BswM_RulesIndOfPCPartitionConfigType
  data constr BswM_RulesOfPCPartitionConfigType
  data constr BswM_SwcModeRequestUpdateFctOfPCPartitionConfigType
  data constr BswM_TimerStateOfPCPartitionConfigType
  data constr BswM_TimerValueOfPCPartitionConfigType
  data constr BswM_ComMPncMappingOfPCPartitionConfigType
  data constr BswM_ComMPncStateOfPCPartitionConfigType
