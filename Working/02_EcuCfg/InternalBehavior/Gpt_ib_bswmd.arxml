AUTOSAR XML (schema 00048)
package /AURIX2G/EcucDefs/Gpt_ib_bswmd/BswModuleDescriptions
  bsw module description Gpt: provided-entrys=Gpt_Virtual
    bsw internal behavior GptBehavior
      4 x exclusive area:
        Get1UsPredefTimerValue
        Get100UsPredefTimerValue
        GtmStartTimer
        Gpt12StartTimer
      bsw called entity Gpt_Virtual: can-enter-exclusive-area=[Get1UsPredefTimerValue, Get100UsPredefTimerValue, GtmStartTimer, Gpt12StartTimer], implemented-entry=Gpt_Virtual
  bsw module entry Gpt_Virtual: call-type=REGULAR, execution-context=TASK
