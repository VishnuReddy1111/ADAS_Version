AUTOSAR XML (schema 00048)
package /AURIX2G/EcucDefs/McalLib_ib_bswmd/BswModuleDescriptions
  bsw module description McalLib: provided-entrys=McalLib_Virtual
    bsw internal behavior McalLibBehavior
      4 x exclusive area:
        PeripheralEndInit
        SafetyEndInit
        CpuEndInit
        StmTimerResolution
      bsw called entity McalLib_Virtual: can-enter-exclusive-area=[PeripheralEndInit, SafetyEndInit, CpuEndInit, StmTimerResolution], implemented-entry=McalLib_Virtual
  bsw module entry McalLib_Virtual: call-type=REGULAR, execution-context=TASK
