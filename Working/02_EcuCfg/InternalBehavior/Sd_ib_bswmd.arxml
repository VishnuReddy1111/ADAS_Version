AUTOSAR XML (schema 00048)
standard types defined: boolean, uint16, uint8
package /MICROSAR
  bsw implementation Sd_Impl: programming-language=C, sw-version=13.01.00, used-code-generator=DaVinci Configurator, vendor-id=30, ar-release-version=4.02.01
    mc-variable-instances:
      18 x mc data instance:
        Sd_ClientMap: category=ARRAY, array-size=1  # Handle ID map for SdClientServices
          mc data instance Element_0: category=STRUCTURE, symbol=[0]
            mc data instance InvalidHndOfClientMap: category=VALUE, resulting-properties={base-type=boolean, sw-calibration-access=READ-ONLY, compu {0=FALSE, 1..255=TRUE}, range raw 0..1}
            mc data instance ClientIdxOfClientMap: category=VALUE, resulting-properties={base-type=uint8, sw-calibration-access=READ-ONLY, compu {255=SD_NO_CLIENTIDXOFCLIENTMAP}, range raw 0..255}
        Sd_ClientTimer: category=ARRAY, array-size=2  # Timer parameter for SdClientService and SdConsumedEventgroup
          mc data instance Element_0: category=STRUCTURE, symbol=[0]
            7 x mc data instance, all with category=VALUE:
              InitialFindDelayMaxOfClientTimer: resulting-properties={base-type=uint16, sw-calibration-access=READ-ONLY, range raw 0..65535}
              InitialFindRepetitionBaseDelayOfClientTimer: resulting-properties={base-type=uint16, sw-calibration-access=READ-ONLY, range raw 0..65535}
              InitialFindDelayMinOfClientTimer: resulting-properties={base-type=uint8, sw-calibration-access=READ-ONLY, range raw 0..255}
              InitialFindRepetitionsMaxOfClientTimer: resulting-properties={base-type=uint8, sw-calibration-access=READ-ONLY, range raw 0..255}
              RequestResponseMaxDelayOfClientTimer: resulting-properties={base-type=uint8, sw-calibration-access=READ-ONLY, range raw 0..255}
              RequestResponseMinDelayOfClientTimer: resulting-properties={base-type=uint8, sw-calibration-access=READ-ONLY, range raw 0..255}
              TTLOfClientTimer: resulting-properties={base-type=uint8, sw-calibration-access=READ-ONLY, range raw 0..255}
          mc data instance Element_1: category=STRUCTURE, symbol=[1]
            7 x mc data instance, all with category=VALUE:
              InitialFindDelayMaxOfClientTimer: resulting-properties={base-type=uint16, sw-calibration-access=READ-ONLY, range raw 0..65535}
              InitialFindRepetitionBaseDelayOfClientTimer: resulting-properties={base-type=uint16, sw-calibration-access=READ-ONLY, range raw 0..65535}
              InitialFindDelayMinOfClientTimer: resulting-properties={base-type=uint8, sw-calibration-access=READ-ONLY, range raw 0..255}
              InitialFindRepetitionsMaxOfClientTimer: resulting-properties={base-type=uint8, sw-calibration-access=READ-ONLY, range raw 0..255}
              RequestResponseMaxDelayOfClientTimer: resulting-properties={base-type=uint8, sw-calibration-access=READ-ONLY, range raw 0..255}
              RequestResponseMinDelayOfClientTimer: resulting-properties={base-type=uint8, sw-calibration-access=READ-ONLY, range raw 0..255}
              TTLOfClientTimer: resulting-properties={base-type=uint8, sw-calibration-access=READ-ONLY, range raw 0..255}
        Sd_ConsumedEventgroup: category=ARRAY, array-size=1  # Configuration data of SdConsumedEventgroup
          mc data instance Element_0: category=STRUCTURE, symbol=[0]
            11 x mc data instance, all with category=VALUE:
              AutoRequireOfConsumedEventgroup: resulting-properties={base-type=boolean, sw-calibration-access=READ-ONLY, compu {0=FALSE, 1..255=TRUE}, range raw 0..1}
              ClientIdxOfConsumedEventgroup: resulting-properties={base-type=uint8, sw-calibration-access=READ-ONLY, range raw 0..255}
              ClientTimerIdxOfConsumedEventgroup: resulting-properties={base-type=uint8, sw-calibration-access=READ-ONLY, range raw 0..255}
              EventGroupIdOfConsumedEventgroup: resulting-properties={base-type=uint8, sw-calibration-access=READ-ONLY, range raw 0..255}
              HandleIdOfConsumedEventgroup: resulting-properties={base-type=uint8, sw-calibration-access=READ-ONLY, range raw 0..255}
              MulticastEndpointAddrIdxOfConsumedEventgroup: resulting-properties={base-type=uint8, sw-calibration-access=READ-ONLY, compu {255=SD_NO_MULTICASTENDPOINTADDRIDXOFCONSUMEDEVENTGROUP}, range raw 0..255}
              MulticastSoConIdEndIdxOfConsumedEventgroup: resulting-properties={base-type=uint8, sw-calibration-access=READ-ONLY, compu {255=SD_NO_MULTICASTSOCONIDENDIDXOFCONSUMEDEVENTGROUP}, range raw 0..255}
              MulticastSoConIdStartIdxOfConsumedEventgroup: resulting-properties={base-type=uint8, sw-calibration-access=READ-ONLY, compu {255=SD_NO_MULTICASTSOCONIDSTARTIDXOFCONSUMEDEVENTGROUP}, range raw 0..255}
              RoutingGroupMulticastActRefIdxOfConsumedEventgroup: resulting-properties={base-type=uint8, sw-calibration-access=READ-ONLY, compu {255=SD_NO_ROUTINGGROUPMULTICASTACTREFIDXOFCONSUMEDEVENTGROUP}, range raw 0..255}
              RoutingGroupTcpActRefIdxOfConsumedEventgroup: resulting-properties={base-type=uint8, sw-calibration-access=READ-ONLY, compu {255=SD_NO_ROUTINGGROUPTCPACTREFIDXOFCONSUMEDEVENTGROUP}, range raw 0..255}
              RoutingGroupUdpActRefIdxOfConsumedEventgroup: resulting-properties={base-type=uint8, sw-calibration-access=READ-ONLY, compu {255=SD_NO_ROUTINGGROUPUDPACTREFIDXOFCONSUMEDEVENTGROUP}, range raw 0..255}
        Sd_ConsumedEventgroupMap: category=ARRAY, array-size=1  # Handle ID map for SdConsumedEventgroups
          mc data instance Element_0: category=STRUCTURE, symbol=[0]
            mc data instance InvalidHndOfConsumedEventgroupMap: category=VALUE, resulting-properties={base-type=boolean, sw-calibration-access=READ-ONLY, compu {0=FALSE, 1..255=TRUE}, range raw 0..1}
            mc data instance ConsumedEventgroupIdxOfConsumedEventgroupMap: category=VALUE, resulting-properties={base-type=uint8, sw-calibration-access=READ-ONLY, compu {255=SD_NO_CONSUMEDEVENTGROUPIDXOFCONSUMEDEVENTGROUPMAP}, range raw 0..255}
        Sd_EventHandler: category=ARRAY, array-size=1  # Configuration data of SdEventHandler
          mc data instance Element_0: category=STRUCTURE, symbol=[0]
            12 x mc data instance, all with category=VALUE:
              ClientListEndIdxOfEventHandler: resulting-properties={base-type=uint8, sw-calibration-access=READ-ONLY, range raw 0..255}
              ClientListStartIdxOfEventHandler: resulting-properties={base-type=uint8, sw-calibration-access=READ-ONLY, range raw 0..255}
              EventGroupIdOfEventHandler: resulting-properties={base-type=uint8, sw-calibration-access=READ-ONLY, range raw 0..255}
              EventHandlerMulticastIdxOfEventHandler: resulting-properties={base-type=uint8, sw-calibration-access=READ-ONLY, compu {255=SD_NO_EVENTHANDLERMULTICASTIDXOFEVENTHANDLER}, range raw 0..255}
              EventHandlerTcpIdxOfEventHandler: resulting-properties={base-type=uint8, sw-calibration-access=READ-ONLY, compu {255=SD_NO_EVENTHANDLERTCPIDXOFEVENTHANDLER}, range raw 0..255}
              EventHandlerUdpIdxOfEventHandler: resulting-properties={base-type=uint8, sw-calibration-access=READ-ONLY, compu {255=SD_NO_EVENTHANDLERUDPIDXOFEVENTHANDLER}, range raw 0..255}
              HandleIdOfEventHandler: resulting-properties={base-type=uint8, sw-calibration-access=READ-ONLY, range raw 0..255}
              MulticastThresholdOfEventHandler: resulting-properties={base-type=uint8, sw-calibration-access=READ-ONLY, range raw 0..255}
              ServerIdxOfEventHandler: resulting-properties={base-type=uint8, sw-calibration-access=READ-ONLY, range raw 0..255}
              ServerTimerIdxOfEventHandler: resulting-properties={base-type=uint8, sw-calibration-access=READ-ONLY, range raw 0..255}
              SoConActivationMapEndIdxOfEventHandler: resulting-properties={base-type=uint8, sw-calibration-access=READ-ONLY, compu {255=SD_NO_SOCONACTIVATIONMAPENDIDXOFEVENTHANDLER}, range raw 0..255}
              SoConActivationMapStartIdxOfEventHandler: resulting-properties={base-type=uint8, sw-calibration-access=READ-ONLY, compu {255=SD_NO_SOCONACTIVATIONMAPSTARTIDXOFEVENTHANDLER}, range raw 0..255}
        Sd_EventHandlerUdp: category=ARRAY, array-size=1  # Configuration of SdEventHandlerUdp
          mc data instance Element_0: category=STRUCTURE, symbol=[0]
            mc data instance RoutingGroupActRefIdxOfEventHandlerUdp: category=VALUE, resulting-properties={base-type=uint8, sw-calibration-access=READ-ONLY, compu {255=SD_NO_ROUTINGGROUPACTREFIDXOFEVENTHANDLERUDP}, range raw 0..255}
            mc data instance RoutingGroupTriggerIdxOfEventHandlerUdp: category=VALUE, resulting-properties={base-type=uint8, sw-calibration-access=READ-ONLY, compu {255=SD_NO_ROUTINGGROUPTRIGGERIDXOFEVENTHANDLERUDP}, range raw 0..255}
        Sd_Method: category=ARRAY, array-size=1  # Configuration of SdProvidedMethods and SdConsumedMethods
          mc data instance Element_0: category=STRUCTURE, symbol=[0]
            mc data instance TcpConfiguredOfMethod: category=VALUE, resulting-properties={base-type=boolean, sw-calibration-access=READ-ONLY, compu {0=FALSE, 1..255=TRUE}, range raw 0..1}
            mc data instance UdpConfiguredOfMethod: category=VALUE, resulting-properties={base-type=boolean, sw-calibration-access=READ-ONLY, compu {0=FALSE, 1..255=TRUE}, range raw 0..1}
            mc data instance RoutingGroupActRefIdxOfMethod: category=VALUE, resulting-properties={base-type=uint8, sw-calibration-access=READ-ONLY, compu {255=SD_NO_ROUTINGGROUPACTREFIDXOFMETHOD}, range raw 0..255}
        Sd_PCConfig: category=STRUCTURE
          88 x mc data instance, all with category=VALUE:
            AddressStorageOfPCConfig: resulting-properties={base-type=Sd_AddressStorageOfPCConfigType, sw-calibration-access=READ-ONLY, compu {0=NULL_PTR}, data-constr=Sd_AddressStorageOfPCConfigType}
            CapabilityRecordOfPCConfig: resulting-properties={base-type=Sd_CapabilityRecordOfPCConfigType, sw-calibration-access=READ-ONLY, compu {0=NULL_PTR}, data-constr=Sd_CapabilityRecordOfPCConfigType}
            CapabilityRecordFunctionCalloutPtrOfPCConfig: resulting-properties={base-type=Sd_CapabilityRecordFunctionCalloutPtrOfPCConfigType, sw-calibration-access=READ-ONLY, compu {0=NULL_PTR}, data-constr=Sd_CapabilityRecordFunctionCalloutPtrOfPCConfigType}
            ClientOfPCConfig: resulting-properties={base-type=Sd_ClientOfPCConfigType, sw-calibration-access=READ-ONLY, compu {0=NULL_PTR}, data-constr=Sd_ClientOfPCConfigType}
            ClientDynOfPCConfig: resulting-properties={base-type=Sd_ClientDynOfPCConfigType, sw-calibration-access=READ-ONLY, compu {0=NULL_PTR}, data-constr=Sd_ClientDynOfPCConfigType}
            ClientListOfPCConfig: resulting-properties={base-type=Sd_ClientListOfPCConfigType, sw-calibration-access=READ-ONLY, compu {0=NULL_PTR}, data-constr=Sd_ClientListOfPCConfigType}
            ClientMapOfPCConfig: resulting-properties={base-type=Sd_ClientMapOfPCConfigType, sw-calibration-access=READ-ONLY, compu {0=NULL_PTR}, data-constr=Sd_ClientMapOfPCConfigType}
            ClientTimerOfPCConfig: resulting-properties={base-type=Sd_ClientTimerOfPCConfigType, sw-calibration-access=READ-ONLY, compu {0=NULL_PTR}, data-constr=Sd_ClientTimerOfPCConfigType}
            CommonInitialDelayOfPCConfig: resulting-properties={base-type=Sd_CommonInitialDelayOfPCConfigType, sw-calibration-access=READ-ONLY, compu {0=NULL_PTR}, data-constr=Sd_CommonInitialDelayOfPCConfigType}
            ConsumedEventgroupOfPCConfig: resulting-properties={base-type=Sd_ConsumedEventgroupOfPCConfigType, sw-calibration-access=READ-ONLY, compu {0=NULL_PTR}, data-constr=Sd_ConsumedEventgroupOfPCConfigType}
            ConsumedEventgroupDynOfPCConfig: resulting-properties={base-type=Sd_ConsumedEventgroupDynOfPCConfigType, sw-calibration-access=READ-ONLY, compu {0=NULL_PTR}, data-constr=Sd_ConsumedEventgroupDynOfPCConfigType}
            ConsumedEventgroupMapOfPCConfig: resulting-properties={base-type=Sd_ConsumedEventgroupMapOfPCConfigType, sw-calibration-access=READ-ONLY, compu {0=NULL_PTR}, data-constr=Sd_ConsumedEventgroupMapOfPCConfigType}
            EndpointStorageOfPCConfig: resulting-properties={base-type=Sd_EndpointStorageOfPCConfigType, sw-calibration-access=READ-ONLY, compu {0=NULL_PTR}, data-constr=Sd_EndpointStorageOfPCConfigType}
            EventHandlerOfPCConfig: resulting-properties={base-type=Sd_EventHandlerOfPCConfigType, sw-calibration-access=READ-ONLY, compu {0=NULL_PTR}, data-constr=Sd_EventHandlerOfPCConfigType}
            EventHandlerDynOfPCConfig: resulting-properties={base-type=Sd_EventHandlerDynOfPCConfigType, sw-calibration-access=READ-ONLY, compu {0=NULL_PTR}, data-constr=Sd_EventHandlerDynOfPCConfigType}
            EventHandlerMulticastOfPCConfig: resulting-properties={base-type=Sd_EventHandlerMulticastOfPCConfigType, sw-calibration-access=READ-ONLY, compu {0=NULL_PTR}, data-constr=Sd_EventHandlerMulticastOfPCConfigType}
            EventHandlerTcpOfPCConfig: resulting-properties={base-type=Sd_EventHandlerTcpOfPCConfigType, sw-calibration-access=READ-ONLY, compu {0=NULL_PTR}, data-constr=Sd_EventHandlerTcpOfPCConfigType}
            EventHandlerUdpOfPCConfig: resulting-properties={base-type=Sd_EventHandlerUdpOfPCConfigType, sw-calibration-access=READ-ONLY, compu {0=NULL_PTR}, data-constr=Sd_EventHandlerUdpOfPCConfigType}
            InstanceOfPCConfig: resulting-properties={base-type=Sd_InstanceOfPCConfigType, sw-calibration-access=READ-ONLY, compu {0=NULL_PTR}, data-constr=Sd_InstanceOfPCConfigType}
            InstanceDynOfPCConfig: resulting-properties={base-type=Sd_InstanceDynOfPCConfigType, sw-calibration-access=READ-ONLY, compu {0=NULL_PTR}, data-constr=Sd_InstanceDynOfPCConfigType}
            IpAddrRequestOfPCConfig: resulting-properties={base-type=Sd_IpAddrRequestOfPCConfigType, sw-calibration-access=READ-ONLY, compu {0=NULL_PTR}, data-constr=Sd_IpAddrRequestOfPCConfigType}
            MethodOfPCConfig: resulting-properties={base-type=Sd_MethodOfPCConfigType, sw-calibration-access=READ-ONLY, compu {0=NULL_PTR}, data-constr=Sd_MethodOfPCConfigType}
            MulticastEndpointAddrOfPCConfig: resulting-properties={base-type=Sd_MulticastEndpointAddrOfPCConfigType, sw-calibration-access=READ-ONLY, compu {0=NULL_PTR}, data-constr=Sd_MulticastEndpointAddrOfPCConfigType}
            MulticastSoConIdOfPCConfig: resulting-properties={base-type=Sd_MulticastSoConIdOfPCConfigType, sw-calibration-access=READ-ONLY, compu {0=NULL_PTR}, data-constr=Sd_MulticastSoConIdOfPCConfigType}
            NrOfOptionsOfPCConfig: resulting-properties={base-type=Sd_NrOfOptionsOfPCConfigType, sw-calibration-access=READ-ONLY, compu {0=NULL_PTR}, data-constr=Sd_NrOfOptionsOfPCConfigType}
            OptionIndexOfPCConfig: resulting-properties={base-type=Sd_OptionIndexOfPCConfigType, sw-calibration-access=READ-ONLY, compu {0=NULL_PTR}, data-constr=Sd_OptionIndexOfPCConfigType}
            PayloadOfPCConfig: resulting-properties={base-type=Sd_PayloadOfPCConfigType, sw-calibration-access=READ-ONLY, compu {0=NULL_PTR}, data-constr=Sd_PayloadOfPCConfigType}
            PortSetOfPCConfig: resulting-properties={base-type=Sd_PortSetOfPCConfigType, sw-calibration-access=READ-ONLY, compu {0=NULL_PTR}, data-constr=Sd_PortSetOfPCConfigType}
            RequestCntOfPCConfig: resulting-properties={base-type=Sd_RequestCntOfPCConfigType, sw-calibration-access=READ-ONLY, compu {0=NULL_PTR}, data-constr=Sd_RequestCntOfPCConfigType}
            RoutingGroupOfPCConfig: resulting-properties={base-type=Sd_RoutingGroupOfPCConfigType, sw-calibration-access=READ-ONLY, compu {0=NULL_PTR}, data-constr=Sd_RoutingGroupOfPCConfigType}
            RoutingGroupDynOfPCConfig: resulting-properties={base-type=Sd_RoutingGroupDynOfPCConfigType, sw-calibration-access=READ-ONLY, compu {0=NULL_PTR}, data-constr=Sd_RoutingGroupDynOfPCConfigType}
            RxEventOfPCConfig: resulting-properties={base-type=Sd_RxEventOfPCConfigType, sw-calibration-access=READ-ONLY, compu {0=NULL_PTR}, data-constr=Sd_RxEventOfPCConfigType}
            SendEntryOfPCConfig: resulting-properties={base-type=Sd_SendEntryOfPCConfigType, sw-calibration-access=READ-ONLY, compu {0=NULL_PTR}, data-constr=Sd_SendEntryOfPCConfigType}
            ServerOfPCConfig: resulting-properties={base-type=Sd_ServerOfPCConfigType, sw-calibration-access=READ-ONLY, compu {0=NULL_PTR}, data-constr=Sd_ServerOfPCConfigType}
            ServerDynOfPCConfig: resulting-properties={base-type=Sd_ServerDynOfPCConfigType, sw-calibration-access=READ-ONLY, compu {0=NULL_PTR}, data-constr=Sd_ServerDynOfPCConfigType}
            ServerMapOfPCConfig: resulting-properties={base-type=Sd_ServerMapOfPCConfigType, sw-calibration-access=READ-ONLY, compu {0=NULL_PTR}, data-constr=Sd_ServerMapOfPCConfigType}
            ServerTimerOfPCConfig: resulting-properties={base-type=Sd_ServerTimerOfPCConfigType, sw-calibration-access=READ-ONLY, compu {0=NULL_PTR}, data-constr=Sd_ServerTimerOfPCConfigType}
            ServiceGroupOfPCConfig: resulting-properties={base-type=Sd_ServiceGroupOfPCConfigType, sw-calibration-access=READ-ONLY, compu {0=NULL_PTR}, data-constr=Sd_ServiceGroupOfPCConfigType}
            ServiceGroupMapOfPCConfig: resulting-properties={base-type=Sd_ServiceGroupMapOfPCConfigType, sw-calibration-access=READ-ONLY, compu {0=NULL_PTR}, data-constr=Sd_ServiceGroupMapOfPCConfigType}
            ServiceGroupMemberOfPCConfig: resulting-properties={base-type=Sd_ServiceGroupMemberOfPCConfigType, sw-calibration-access=READ-ONLY, compu {0=NULL_PTR}, data-constr=Sd_ServiceGroupMemberOfPCConfigType}
            SoConActivationMapOfPCConfig: resulting-properties={base-type=Sd_SoConActivationMapOfPCConfigType, sw-calibration-access=READ-ONLY, compu {0=NULL_PTR}, data-constr=Sd_SoConActivationMapOfPCConfigType}
            SoConModeOfPCConfig: resulting-properties={base-type=Sd_SoConModeOfPCConfigType, sw-calibration-access=READ-ONLY, compu {0=NULL_PTR}, data-constr=Sd_SoConModeOfPCConfigType}
            SoConModeMapOfPCConfig: resulting-properties={base-type=Sd_SoConModeMapOfPCConfigType, sw-calibration-access=READ-ONLY, compu {0=NULL_PTR}, data-constr=Sd_SoConModeMapOfPCConfigType}
            TcpSoConIdOfPCConfig: resulting-properties={base-type=Sd_TcpSoConIdOfPCConfigType, sw-calibration-access=READ-ONLY, compu {0=NULL_PTR}, data-constr=Sd_TcpSoConIdOfPCConfigType}
            TriggerTransmitOfPCConfig: resulting-properties={base-type=Sd_TriggerTransmitOfPCConfigType, sw-calibration-access=READ-ONLY, compu {0=NULL_PTR}, data-constr=Sd_TriggerTransmitOfPCConfigType}
            TriggerTransmitEndIdxOfPCConfig: resulting-properties={base-type=Sd_TriggerTransmitEndIdxOfPCConfigType, sw-calibration-access=READ-ONLY, compu {0=NULL_PTR}, data-constr=Sd_TriggerTransmitEndIdxOfPCConfigType}
            TriggerTransmitFullOfPCConfig: resulting-properties={base-type=Sd_TriggerTransmitFullOfPCConfigType, sw-calibration-access=READ-ONLY, compu {0=NULL_PTR}, data-constr=Sd_TriggerTransmitFullOfPCConfigType}
            TriggerTransmitStartIdxOfPCConfig: resulting-properties={base-type=Sd_TriggerTransmitStartIdxOfPCConfigType, sw-calibration-access=READ-ONLY, compu {0=NULL_PTR}, data-constr=Sd_TriggerTransmitStartIdxOfPCConfigType}
            UdpSoConOfPCConfig: resulting-properties={base-type=Sd_UdpSoConOfPCConfigType, sw-calibration-access=READ-ONLY, compu {0=NULL_PTR}, data-constr=Sd_UdpSoConOfPCConfigType}
            SizeOfPayloadOfPCConfig: resulting-properties={base-type=uint16, sw-calibration-access=READ-ONLY, range raw 0..65535}
            SizeOfAddressStorageOfPCConfig: resulting-properties={base-type=uint8, sw-calibration-access=READ-ONLY, range raw 0..255}
            SizeOfCapabilityRecordOfPCConfig: resulting-properties={base-type=uint8, sw-calibration-access=READ-ONLY, range raw 0..255}
            SizeOfCapabilityRecordFunctionCalloutPtrOfPCConfig: resulting-properties={base-type=uint8, sw-calibration-access=READ-ONLY, range raw 0..255}
            SizeOfClientOfPCConfig: resulting-properties={base-type=uint8, sw-calibration-access=READ-ONLY, range raw 0..255}
            SizeOfClientListOfPCConfig: resulting-properties={base-type=uint8, sw-calibration-access=READ-ONLY, range raw 0..255}
            SizeOfClientMapOfPCConfig: resulting-properties={base-type=uint8, sw-calibration-access=READ-ONLY, range raw 0..255}
            SizeOfClientTimerOfPCConfig: resulting-properties={base-type=uint8, sw-calibration-access=READ-ONLY, range raw 0..255}
            SizeOfCommonInitialDelayOfPCConfig: resulting-properties={base-type=uint8, sw-calibration-access=READ-ONLY, range raw 0..255}
            SizeOfConsumedEventgroupOfPCConfig: resulting-properties={base-type=uint8, sw-calibration-access=READ-ONLY, range raw 0..255}
            SizeOfConsumedEventgroupMapOfPCConfig: resulting-properties={base-type=uint8, sw-calibration-access=READ-ONLY, range raw 0..255}
            SizeOfEndpointStorageOfPCConfig: resulting-properties={base-type=uint8, sw-calibration-access=READ-ONLY, range raw 0..255}
            SizeOfEventHandlerOfPCConfig: resulting-properties={base-type=uint8, sw-calibration-access=READ-ONLY, range raw 0..255}
            SizeOfEventHandlerMulticastOfPCConfig: resulting-properties={base-type=uint8, sw-calibration-access=READ-ONLY, range raw 0..255}
            SizeOfEventHandlerTcpOfPCConfig: resulting-properties={base-type=uint8, sw-calibration-access=READ-ONLY, range raw 0..255}
            SizeOfEventHandlerUdpOfPCConfig: resulting-properties={base-type=uint8, sw-calibration-access=READ-ONLY, range raw 0..255}
            SizeOfInstanceOfPCConfig: resulting-properties={base-type=uint8, sw-calibration-access=READ-ONLY, range raw 0..255}
            SizeOfIpAddrRequestOfPCConfig: resulting-properties={base-type=uint8, sw-calibration-access=READ-ONLY, range raw 0..255}
            SizeOfMethodOfPCConfig: resulting-properties={base-type=uint8, sw-calibration-access=READ-ONLY, range raw 0..255}
            SizeOfMulticastEndpointAddrOfPCConfig: resulting-properties={base-type=uint8, sw-calibration-access=READ-ONLY, range raw 0..255}
            SizeOfMulticastSoConIdOfPCConfig: resulting-properties={base-type=uint8, sw-calibration-access=READ-ONLY, range raw 0..255}
            SizeOfOptionIndexOfPCConfig: resulting-properties={base-type=uint8, sw-calibration-access=READ-ONLY, range raw 0..255}
            SizeOfPortSetOfPCConfig: resulting-properties={base-type=uint8, sw-calibration-access=READ-ONLY, range raw 0..255}
            SizeOfRequestCntOfPCConfig: resulting-properties={base-type=uint8, sw-calibration-access=READ-ONLY, range raw 0..255}
            SizeOfRoutingGroupOfPCConfig: resulting-properties={base-type=uint8, sw-calibration-access=READ-ONLY, range raw 0..255}
            SizeOfRxEventOfPCConfig: resulting-properties={base-type=uint8, sw-calibration-access=READ-ONLY, range raw 0..255}
            SizeOfSendEntryOfPCConfig: resulting-properties={base-type=uint8, sw-calibration-access=READ-ONLY, range raw 0..255}
            SizeOfServerOfPCConfig: resulting-properties={base-type=uint8, sw-calibration-access=READ-ONLY, range raw 0..255}
            SizeOfServerMapOfPCConfig: resulting-properties={base-type=uint8, sw-calibration-access=READ-ONLY, range raw 0..255}
            SizeOfServerTimerOfPCConfig: resulting-properties={base-type=uint8, sw-calibration-access=READ-ONLY, range raw 0..255}
            SizeOfServiceGroupOfPCConfig: resulting-properties={base-type=uint8, sw-calibration-access=READ-ONLY, range raw 0..255}
            SizeOfServiceGroupMapOfPCConfig: resulting-properties={base-type=uint8, sw-calibration-access=READ-ONLY, range raw 0..255}
            SizeOfServiceGroupMemberOfPCConfig: resulting-properties={base-type=uint8, sw-calibration-access=READ-ONLY, range raw 0..255}
            SizeOfSoConActivationMapOfPCConfig: resulting-properties={base-type=uint8, sw-calibration-access=READ-ONLY, range raw 0..255}
            SizeOfSoConModeOfPCConfig: resulting-properties={base-type=uint8, sw-calibration-access=READ-ONLY, range raw 0..255}
            SizeOfSoConModeMapOfPCConfig: resulting-properties={base-type=uint8, sw-calibration-access=READ-ONLY, range raw 0..255}
            SizeOfTcpSoConIdOfPCConfig: resulting-properties={base-type=uint8, sw-calibration-access=READ-ONLY, range raw 0..255}
            SizeOfTriggerTransmitOfPCConfig: resulting-properties={base-type=uint8, sw-calibration-access=READ-ONLY, range raw 0..255}
            SizeOfUdpSoConOfPCConfig: resulting-properties={base-type=uint8, sw-calibration-access=READ-ONLY, range raw 0..255}
        Sd_Server: category=ARRAY, array-size=1  # Configuration data of SdServerService. List is sorted by ServiceId (and HandleId if ServiceId is not unique) per SdInstance.
          mc data instance Element_0: category=STRUCTURE, symbol=[0]
            20 x mc data instance, all with category=VALUE:
              AutoAvailableOfServer: resulting-properties={base-type=boolean, sw-calibration-access=READ-ONLY, compu {0=FALSE, 1..255=TRUE}, range raw 0..1}
              ServiceGroupMemberOfServer: resulting-properties={base-type=boolean, sw-calibration-access=READ-ONLY, compu {0=FALSE, 1..255=TRUE}, range raw 0..1}
              CapabilityRecordEndIdxOfServer: resulting-properties={base-type=uint8, sw-calibration-access=READ-ONLY, compu {255=SD_NO_CAPABILITYRECORDENDIDXOFSERVER}, range raw 0..255}
              CapabilityRecordFunctionCalloutPtrIdxOfServer: resulting-properties={base-type=uint8, sw-calibration-access=READ-ONLY, compu {255=SD_NO_CAPABILITYRECORDFUNCTIONCALLOUTPTRIDXOFSERVER}, range raw 0..255}
              CapabilityRecordStartIdxOfServer: resulting-properties={base-type=uint8, sw-calibration-access=READ-ONLY, compu {255=SD_NO_CAPABILITYRECORDSTARTIDXOFSERVER}, range raw 0..255}
              CommonInitialDelayIdxOfServer: resulting-properties={base-type=uint8, sw-calibration-access=READ-ONLY, compu {255=SD_NO_COMMONINITIALDELAYIDXOFSERVER}, range raw 0..255}
              EventHandlerEndIdxOfServer: resulting-properties={base-type=uint8, sw-calibration-access=READ-ONLY, compu {255=SD_NO_EVENTHANDLERENDIDXOFSERVER}, range raw 0..255}
              EventHandlerStartIdxOfServer: resulting-properties={base-type=uint8, sw-calibration-access=READ-ONLY, compu {255=SD_NO_EVENTHANDLERSTARTIDXOFSERVER}, range raw 0..255}
              HandleIdOfServer: resulting-properties={base-type=uint8, sw-calibration-access=READ-ONLY, range raw 0..255}
              InitialInstanceIdOfServer: resulting-properties={base-type=uint8, sw-calibration-access=READ-ONLY, range raw 0..255}
              InstanceIdxOfServer: resulting-properties={base-type=uint8, sw-calibration-access=READ-ONLY, range raw 0..255}
              MajorVersionOfServer: resulting-properties={base-type=uint8, sw-calibration-access=READ-ONLY, range raw 0..255}
              MethodIdxOfServer: resulting-properties={base-type=uint8, sw-calibration-access=READ-ONLY, compu {255=SD_NO_METHODIDXOFSERVER}, range raw 0..255}
              MinorVersionOfServer: resulting-properties={base-type=uint8, sw-calibration-access=READ-ONLY, range raw 0..255}
              ServerTimerIdxOfServer: resulting-properties={base-type=uint8, sw-calibration-access=READ-ONLY, range raw 0..255}
              ServiceIdOfServer: resulting-properties={base-type=uint8, sw-calibration-access=READ-ONLY, range raw 0..255}
              TcpSoConIdEndIdxOfServer: resulting-properties={base-type=uint8, sw-calibration-access=READ-ONLY, compu {255=SD_NO_TCPSOCONIDENDIDXOFSERVER}, range raw 0..255}
              TcpSoConIdStartIdxOfServer: resulting-properties={base-type=uint8, sw-calibration-access=READ-ONLY, compu {255=SD_NO_TCPSOCONIDSTARTIDXOFSERVER}, range raw 0..255}
              UdpSoConEndIdxOfServer: resulting-properties={base-type=uint8, sw-calibration-access=READ-ONLY, compu {255=SD_NO_UDPSOCONENDIDXOFSERVER}, range raw 0..255}
              UdpSoConStartIdxOfServer: resulting-properties={base-type=uint8, sw-calibration-access=READ-ONLY, compu {255=SD_NO_UDPSOCONSTARTIDXOFSERVER}, range raw 0..255}
        Sd_ServerMap: category=ARRAY, array-size=1  # Handle ID map for SdServerServices
          mc data instance Element_0: category=STRUCTURE, symbol=[0]
            mc data instance InvalidHndOfServerMap: category=VALUE, resulting-properties={base-type=boolean, sw-calibration-access=READ-ONLY, compu {0=FALSE, 1..255=TRUE}, range raw 0..1}
            mc data instance ServerIdxOfServerMap: category=VALUE, resulting-properties={base-type=uint8, sw-calibration-access=READ-ONLY, compu {255=SD_NO_SERVERIDXOFSERVERMAP}, range raw 0..255}
        Sd_ServerTimer: category=ARRAY, array-size=2  # Timer parameter for SdServerService and SdEventHandler
          mc data instance Element_0: category=STRUCTURE, symbol=[0]
            8 x mc data instance, all with category=VALUE:
              InitialOfferDelayMaxOfServerTimer: resulting-properties={base-type=uint16, sw-calibration-access=READ-ONLY, range raw 0..65535}
              InitialOfferDelayMinOfServerTimer: resulting-properties={base-type=uint16, sw-calibration-access=READ-ONLY, range raw 0..65535}
              OfferCyclicDelayOfServerTimer: resulting-properties={base-type=uint16, sw-calibration-access=READ-ONLY, range raw 0..65535}
              RequestResponseMaxDelayOfServerTimer: resulting-properties={base-type=uint16, sw-calibration-access=READ-ONLY, range raw 0..65535}
              InitialOfferRepetitionBaseDelayOfServerTimer: resulting-properties={base-type=uint8, sw-calibration-access=READ-ONLY, range raw 0..255}
              InitialOfferRepetitionsMaxOfServerTimer: resulting-properties={base-type=uint8, sw-calibration-access=READ-ONLY, range raw 0..255}
              RequestResponseMinDelayOfServerTimer: resulting-properties={base-type=uint8, sw-calibration-access=READ-ONLY, range raw 0..255}
              TTLOfServerTimer: resulting-properties={base-type=uint8, sw-calibration-access=READ-ONLY, range raw 0..255}
          mc data instance Element_1: category=STRUCTURE, symbol=[1]
            8 x mc data instance, all with category=VALUE:
              InitialOfferDelayMaxOfServerTimer: resulting-properties={base-type=uint16, sw-calibration-access=READ-ONLY, range raw 0..65535}
              InitialOfferDelayMinOfServerTimer: resulting-properties={base-type=uint16, sw-calibration-access=READ-ONLY, range raw 0..65535}
              OfferCyclicDelayOfServerTimer: resulting-properties={base-type=uint16, sw-calibration-access=READ-ONLY, range raw 0..65535}
              RequestResponseMaxDelayOfServerTimer: resulting-properties={base-type=uint16, sw-calibration-access=READ-ONLY, range raw 0..65535}
              InitialOfferRepetitionBaseDelayOfServerTimer: resulting-properties={base-type=uint8, sw-calibration-access=READ-ONLY, range raw 0..255}
              InitialOfferRepetitionsMaxOfServerTimer: resulting-properties={base-type=uint8, sw-calibration-access=READ-ONLY, range raw 0..255}
              RequestResponseMinDelayOfServerTimer: resulting-properties={base-type=uint8, sw-calibration-access=READ-ONLY, range raw 0..255}
              TTLOfServerTimer: resulting-properties={base-type=uint8, sw-calibration-access=READ-ONLY, range raw 0..255}
        Sd_SoConModeMap: category=ARRAY, array-size=6  # Map of SoConIds to Sd_SoConMode
          6 x mc data instance, all with category=STRUCTURE:
            Element_0: symbol=[0]
              mc data instance InvalidHndOfSoConModeMap: category=VALUE, resulting-properties={base-type=boolean, sw-calibration-access=READ-ONLY, compu {0=FALSE, 1..255=TRUE}, range raw 0..1}
              mc data instance SoConModeIdxOfSoConModeMap: category=VALUE, resulting-properties={base-type=uint8, sw-calibration-access=READ-ONLY, compu {255=SD_NO_SOCONMODEIDXOFSOCONMODEMAP}, range raw 0..255}
            Element_1: symbol=[1]
              mc data instance InvalidHndOfSoConModeMap: category=VALUE, resulting-properties={base-type=boolean, sw-calibration-access=READ-ONLY, compu {0=FALSE, 1..255=TRUE}, range raw 0..1}
              mc data instance SoConModeIdxOfSoConModeMap: category=VALUE, resulting-properties={base-type=uint8, sw-calibration-access=READ-ONLY, compu {255=SD_NO_SOCONMODEIDXOFSOCONMODEMAP}, range raw 0..255}
            Element_2: symbol=[2]
              mc data instance InvalidHndOfSoConModeMap: category=VALUE, resulting-properties={base-type=boolean, sw-calibration-access=READ-ONLY, compu {0=FALSE, 1..255=TRUE}, range raw 0..1}
              mc data instance SoConModeIdxOfSoConModeMap: category=VALUE, resulting-properties={base-type=uint8, sw-calibration-access=READ-ONLY, compu {255=SD_NO_SOCONMODEIDXOFSOCONMODEMAP}, range raw 0..255}
            Element_3: symbol=[3]
              mc data instance InvalidHndOfSoConModeMap: category=VALUE, resulting-properties={base-type=boolean, sw-calibration-access=READ-ONLY, compu {0=FALSE, 1..255=TRUE}, range raw 0..1}
              mc data instance SoConModeIdxOfSoConModeMap: category=VALUE, resulting-properties={base-type=uint8, sw-calibration-access=READ-ONLY, compu {255=SD_NO_SOCONMODEIDXOFSOCONMODEMAP}, range raw 0..255}
            Element_4: symbol=[4]
              mc data instance InvalidHndOfSoConModeMap: category=VALUE, resulting-properties={base-type=boolean, sw-calibration-access=READ-ONLY, compu {0=FALSE, 1..255=TRUE}, range raw 0..1}
              mc data instance SoConModeIdxOfSoConModeMap: category=VALUE, resulting-properties={base-type=uint8, sw-calibration-access=READ-ONLY, compu {255=SD_NO_SOCONMODEIDXOFSOCONMODEMAP}, range raw 0..255}
            Element_5: symbol=[5]
              mc data instance InvalidHndOfSoConModeMap: category=VALUE, resulting-properties={base-type=boolean, sw-calibration-access=READ-ONLY, compu {0=FALSE, 1..255=TRUE}, range raw 0..1}
              mc data instance SoConModeIdxOfSoConModeMap: category=VALUE, resulting-properties={base-type=uint8, sw-calibration-access=READ-ONLY, compu {255=SD_NO_SOCONMODEIDXOFSOCONMODEMAP}, range raw 0..255}
        Sd_OptionIndex: category=ARRAY, array-size=10, resulting-properties={base-type=uint16, sw-calibration-access=READ-ONLY, range raw 0..65535}  # Payload offset of options
        Sd_Payload: category=ARRAY, array-size=1500, resulting-properties={base-type=uint8, sw-calibration-access=READ-ONLY, range raw 0..255}  # Buffer used for message transmission
        Sd_NrOfOptions: category=VALUE, resulting-properties={base-type=uint16, sw-calibration-access=READ-ONLY, range raw 0..65535}  # Number of options saved in the OptionIndex
        Sd_TriggerTransmitEndIdx: category=VALUE, resulting-properties={base-type=uint8, sw-calibration-access=READ-ONLY, range raw 0..255}  # the index of the 1:1 relation pointing to Sd_TriggerTransmit
        Sd_TriggerTransmitFull: category=VALUE, resulting-properties={base-type=boolean, sw-calibration-access=READ-ONLY, compu {0=FALSE, 1..255=TRUE}, range raw 0..1}
        Sd_TriggerTransmitStartIdx: category=VALUE, resulting-properties={base-type=uint8, sw-calibration-access=READ-ONLY, range raw 0..255}  # the index of the 1:1 relation pointing to Sd_TriggerTransmit
package /MICROSAR/Sd_ib_bswmd/DataTypes/BaseTypes
  49 x base type, all with category=FIXED_LENGTH, base-type-size=32, base-type-encoding=NONE:
    Sd_EventHandlerMulticastOfPCConfigType
    Sd_EventHandlerTcpOfPCConfigType
    Sd_EventHandlerUdpOfPCConfigType
    Sd_SoConActivationMapOfPCConfigType
    Sd_TcpSoConIdOfPCConfigType
    Sd_AddressStorageOfPCConfigType
    Sd_CapabilityRecordFunctionCalloutPtrOfPCConfigType
    Sd_CapabilityRecordOfPCConfigType
    Sd_ClientDynOfPCConfigType
    Sd_ClientListOfPCConfigType
    Sd_ClientMapOfPCConfigType
    Sd_ClientOfPCConfigType
    Sd_ClientTimerOfPCConfigType
    Sd_ConsumedEventgroupDynOfPCConfigType
    Sd_ConsumedEventgroupMapOfPCConfigType
    Sd_ConsumedEventgroupOfPCConfigType
    Sd_EndpointStorageOfPCConfigType
    Sd_EventHandlerDynOfPCConfigType
    Sd_EventHandlerOfPCConfigType
    Sd_InstanceDynOfPCConfigType
    Sd_InstanceOfPCConfigType
    Sd_IpAddrRequestOfPCConfigType
    Sd_MethodOfPCConfigType
    Sd_MulticastEndpointAddrOfPCConfigType
    Sd_MulticastSoConIdOfPCConfigType
    Sd_NrOfOptionsOfPCConfigType
    Sd_OptionIndexOfPCConfigType
    Sd_PayloadOfPCConfigType
    Sd_PortSetOfPCConfigType
    Sd_RequestCntOfPCConfigType
    Sd_RxEventOfPCConfigType
    Sd_SendEntryOfPCConfigType
    Sd_ServerDynOfPCConfigType
    Sd_ServerMapOfPCConfigType
    Sd_ServerOfPCConfigType
    Sd_ServerTimerOfPCConfigType
    Sd_TriggerTransmitEndIdxOfPCConfigType
    Sd_TriggerTransmitFullOfPCConfigType
    Sd_TriggerTransmitOfPCConfigType
    Sd_TriggerTransmitStartIdxOfPCConfigType
    Sd_RoutingGroupDynOfPCConfigType
    Sd_RoutingGroupOfPCConfigType
    Sd_UdpSoConOfPCConfigType
    Sd_CommonInitialDelayOfPCConfigType
    Sd_ServiceGroupMapOfPCConfigType
    Sd_ServiceGroupMemberOfPCConfigType
    Sd_ServiceGroupOfPCConfigType
    Sd_SoConModeMapOfPCConfigType
    Sd_SoConModeOfPCConfigType
package /MICROSAR/Sd_ib_bswmd/DataTypes/DataConstrs
  data constr Sd_AddressStorageOfPCConfigType
  data constr Sd_CapabilityRecordFunctionCalloutPtrOfPCConfigType
  data constr Sd_CapabilityRecordOfPCConfigType
  data constr Sd_ClientDynOfPCConfigType
  data constr Sd_ClientListOfPCConfigType
  data constr Sd_ClientMapOfPCConfigType
  data constr Sd_ClientOfPCConfigType
  data constr Sd_ClientTimerOfPCConfigType
  data constr Sd_CommonInitialDelayOfPCConfigType
  data constr Sd_ConsumedEventgroupDynOfPCConfigType
  data constr Sd_ConsumedEventgroupMapOfPCConfigType
  data constr Sd_ConsumedEventgroupOfPCConfigType
  data constr Sd_EndpointStorageOfPCConfigType
  data constr Sd_EventHandlerDynOfPCConfigType
  data constr Sd_EventHandlerMulticastOfPCConfigType
  data constr Sd_EventHandlerOfPCConfigType
  data constr Sd_EventHandlerTcpOfPCConfigType
  data constr Sd_EventHandlerUdpOfPCConfigType
  data constr Sd_InstanceDynOfPCConfigType
  data constr Sd_InstanceOfPCConfigType
  data constr Sd_IpAddrRequestOfPCConfigType
  data constr Sd_MethodOfPCConfigType
  data constr Sd_MulticastEndpointAddrOfPCConfigType
  data constr Sd_MulticastSoConIdOfPCConfigType
  data constr Sd_NrOfOptionsOfPCConfigType
  data constr Sd_OptionIndexOfPCConfigType
  data constr Sd_PayloadOfPCConfigType
  data constr Sd_PortSetOfPCConfigType
  data constr Sd_RequestCntOfPCConfigType
  data constr Sd_RoutingGroupDynOfPCConfigType
  data constr Sd_RoutingGroupOfPCConfigType
  data constr Sd_RxEventOfPCConfigType
  data constr Sd_SendEntryOfPCConfigType
  data constr Sd_ServerDynOfPCConfigType
  data constr Sd_ServerMapOfPCConfigType
  data constr Sd_ServerOfPCConfigType
  data constr Sd_ServerTimerOfPCConfigType
  data constr Sd_ServiceGroupMapOfPCConfigType
  data constr Sd_ServiceGroupMemberOfPCConfigType
  data constr Sd_ServiceGroupOfPCConfigType
  data constr Sd_SoConActivationMapOfPCConfigType
  data constr Sd_SoConModeMapOfPCConfigType
  data constr Sd_SoConModeOfPCConfigType
  data constr Sd_TcpSoConIdOfPCConfigType
  data constr Sd_TriggerTransmitEndIdxOfPCConfigType
  data constr Sd_TriggerTransmitFullOfPCConfigType
  data constr Sd_TriggerTransmitOfPCConfigType
  data constr Sd_TriggerTransmitStartIdxOfPCConfigType
  data constr Sd_UdpSoConOfPCConfigType
