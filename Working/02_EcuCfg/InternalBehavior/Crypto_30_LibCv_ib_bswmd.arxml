AUTOSAR XML (schema 00048)
package /MICROSAR/Crypto_30_LibCv_ib_bswmd/BswModuleDescriptions
  bsw module description Crypto: provided-entrys=Crypto_30_LibCv_MainFunction
    bsw internal behavior Crypto_30_LibCv
      exclusive area CRYPTO_30_LIBCV_EXCLUSIVE_AREA_0  # This critical section protects workspace locking resources. Therefore the critical section enclosed with CRYPTO_30_LIBCV_EXCLUSIVE_AREA_0 should never be interrupted by any other API. For more details, see DocTechRef.
      exclusive area CRYPTO_30_LIBCV_EXCLUSIVE_AREA_1  # This critical section protects 32 Bit accesses and is only necessary in case of HW doesn't offer an atomic access. If needed, the critical section enclosed with CRYPTO_30_LIBCV_EXCLUSIVE_AREA_1 should never be interrupted by any other API. For more details, see DocTechRef.
      bsw schedulable entity Crypto_30_LibCv_MainFunction: can-enter-exclusive-area=[CRYPTO_30_LIBCV_EXCLUSIVE_AREA_0, CRYPTO_30_LIBCV_EXCLUSIVE_AREA_1], implemented-entry=Crypto_30_LibCv_MainFunction
      bsw timing event Crypto_30_LibCv_MainFunctionTimingEvent0: starts-on-event=Crypto_30_LibCv_MainFunction, period=0.01
  bsw module entry Crypto_30_LibCv_MainFunction: call-type=SCHEDULED, execution-context=TASK
