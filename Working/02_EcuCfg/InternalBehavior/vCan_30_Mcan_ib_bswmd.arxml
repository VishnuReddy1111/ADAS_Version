AUTOSAR XML (schema 00048)
package /MICROSAR/vCan_30_Mcan_ib_bswmd/BswModuleDescriptions
  bsw module description vCan: provided-entrys=vCan_30_Mcan_Virtual
    bsw internal behavior vCan_30_McanBehavior
      exclusive area VCAN_30_MCAN_EXCLUSIVE_AREA_0
      bsw called entity vCan_30_Mcan_Virtual: can-enter-exclusive-area=VCAN_30_MCAN_EXCLUSIVE_AREA_0, implemented-entry=vCan_30_Mcan_Virtual
  bsw module entry vCan_30_Mcan_Virtual: call-type=REGULAR, execution-context=TASK
