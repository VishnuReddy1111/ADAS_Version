AUTOSAR XML (schema 4-3-0)
standard types defined: uint16, uint8
package /MICROSAR
  bsw implementation CanTp_Impl: programming-language=C, sw-version=5.01.00, used-code-generator=DaVinci Configurator, vendor-id=30, ar-release-version=4.00.03
    mc-variable-instances:
      mc data instance CanTp_RxState: category=ARRAY, array-size=8
        8 x mc data instance, all with category=STRUCTURE:
          Element_0: symbol=[0]
            8 x mc data instance, all with category=VALUE:
              Timer: resulting-properties={base-type=uint16, sw-calibration-access=READ-ONLY, range raw 0..65535}
              ChannelState: resulting-properties={base-type=uint8, sw-calibration-access=READ-ONLY, range raw 0..255}
              BufferState: resulting-properties={base-type=uint8, sw-calibration-access=READ-ONLY, range raw 0..255}
              DataIndex: resulting-properties={base-type=uint16, sw-calibration-access=READ-ONLY, range raw 0..65535}
              DataLength: resulting-properties={base-type=uint16, sw-calibration-access=READ-ONLY, range raw 0..65535}
              ProvidedBufferSize: resulting-properties={base-type=uint16, sw-calibration-access=READ-ONLY, range raw 0..65535}
              ExpectedSN: resulting-properties={base-type=uint8, sw-calibration-access=READ-ONLY, range raw 0..255}
              FrameType: resulting-properties={base-type=uint8, sw-calibration-access=READ-ONLY, range raw 0..255}
          Element_1: symbol=[1]
            8 x mc data instance, all with category=VALUE:
              Timer: resulting-properties={base-type=uint16, sw-calibration-access=READ-ONLY, range raw 0..65535}
              ChannelState: resulting-properties={base-type=uint8, sw-calibration-access=READ-ONLY, range raw 0..255}
              BufferState: resulting-properties={base-type=uint8, sw-calibration-access=READ-ONLY, range raw 0..255}
              DataIndex: resulting-properties={base-type=uint16, sw-calibration-access=READ-ONLY, range raw 0..65535}
              DataLength: resulting-properties={base-type=uint16, sw-calibration-access=READ-ONLY, range raw 0..65535}
              ProvidedBufferSize: resulting-properties={base-type=uint16, sw-calibration-access=READ-ONLY, range raw 0..65535}
              ExpectedSN: resulting-properties={base-type=uint8, sw-calibration-access=READ-ONLY, range raw 0..255}
              FrameType: resulting-properties={base-type=uint8, sw-calibration-access=READ-ONLY, range raw 0..255}
          Element_2: symbol=[2]
            8 x mc data instance, all with category=VALUE:
              Timer: resulting-properties={base-type=uint16, sw-calibration-access=READ-ONLY, range raw 0..65535}
              ChannelState: resulting-properties={base-type=uint8, sw-calibration-access=READ-ONLY, range raw 0..255}
              BufferState: resulting-properties={base-type=uint8, sw-calibration-access=READ-ONLY, range raw 0..255}
              DataIndex: resulting-properties={base-type=uint16, sw-calibration-access=READ-ONLY, range raw 0..65535}
              DataLength: resulting-properties={base-type=uint16, sw-calibration-access=READ-ONLY, range raw 0..65535}
              ProvidedBufferSize: resulting-properties={base-type=uint16, sw-calibration-access=READ-ONLY, range raw 0..65535}
              ExpectedSN: resulting-properties={base-type=uint8, sw-calibration-access=READ-ONLY, range raw 0..255}
              FrameType: resulting-properties={base-type=uint8, sw-calibration-access=READ-ONLY, range raw 0..255}
          Element_3: symbol=[3]
            8 x mc data instance, all with category=VALUE:
              Timer: resulting-properties={base-type=uint16, sw-calibration-access=READ-ONLY, range raw 0..65535}
              ChannelState: resulting-properties={base-type=uint8, sw-calibration-access=READ-ONLY, range raw 0..255}
              BufferState: resulting-properties={base-type=uint8, sw-calibration-access=READ-ONLY, range raw 0..255}
              DataIndex: resulting-properties={base-type=uint16, sw-calibration-access=READ-ONLY, range raw 0..65535}
              DataLength: resulting-properties={base-type=uint16, sw-calibration-access=READ-ONLY, range raw 0..65535}
              ProvidedBufferSize: resulting-properties={base-type=uint16, sw-calibration-access=READ-ONLY, range raw 0..65535}
              ExpectedSN: resulting-properties={base-type=uint8, sw-calibration-access=READ-ONLY, range raw 0..255}
              FrameType: resulting-properties={base-type=uint8, sw-calibration-access=READ-ONLY, range raw 0..255}
          Element_4: symbol=[4]
            8 x mc data instance, all with category=VALUE:
              Timer: resulting-properties={base-type=uint16, sw-calibration-access=READ-ONLY, range raw 0..65535}
              ChannelState: resulting-properties={base-type=uint8, sw-calibration-access=READ-ONLY, range raw 0..255}
              BufferState: resulting-properties={base-type=uint8, sw-calibration-access=READ-ONLY, range raw 0..255}
              DataIndex: resulting-properties={base-type=uint16, sw-calibration-access=READ-ONLY, range raw 0..65535}
              DataLength: resulting-properties={base-type=uint16, sw-calibration-access=READ-ONLY, range raw 0..65535}
              ProvidedBufferSize: resulting-properties={base-type=uint16, sw-calibration-access=READ-ONLY, range raw 0..65535}
              ExpectedSN: resulting-properties={base-type=uint8, sw-calibration-access=READ-ONLY, range raw 0..255}
              FrameType: resulting-properties={base-type=uint8, sw-calibration-access=READ-ONLY, range raw 0..255}
          Element_5: symbol=[5]
            8 x mc data instance, all with category=VALUE:
              Timer: resulting-properties={base-type=uint16, sw-calibration-access=READ-ONLY, range raw 0..65535}
              ChannelState: resulting-properties={base-type=uint8, sw-calibration-access=READ-ONLY, range raw 0..255}
              BufferState: resulting-properties={base-type=uint8, sw-calibration-access=READ-ONLY, range raw 0..255}
              DataIndex: resulting-properties={base-type=uint16, sw-calibration-access=READ-ONLY, range raw 0..65535}
              DataLength: resulting-properties={base-type=uint16, sw-calibration-access=READ-ONLY, range raw 0..65535}
              ProvidedBufferSize: resulting-properties={base-type=uint16, sw-calibration-access=READ-ONLY, range raw 0..65535}
              ExpectedSN: resulting-properties={base-type=uint8, sw-calibration-access=READ-ONLY, range raw 0..255}
              FrameType: resulting-properties={base-type=uint8, sw-calibration-access=READ-ONLY, range raw 0..255}
          Element_6: symbol=[6]
            8 x mc data instance, all with category=VALUE:
              Timer: resulting-properties={base-type=uint16, sw-calibration-access=READ-ONLY, range raw 0..65535}
              ChannelState: resulting-properties={base-type=uint8, sw-calibration-access=READ-ONLY, range raw 0..255}
              BufferState: resulting-properties={base-type=uint8, sw-calibration-access=READ-ONLY, range raw 0..255}
              DataIndex: resulting-properties={base-type=uint16, sw-calibration-access=READ-ONLY, range raw 0..65535}
              DataLength: resulting-properties={base-type=uint16, sw-calibration-access=READ-ONLY, range raw 0..65535}
              ProvidedBufferSize: resulting-properties={base-type=uint16, sw-calibration-access=READ-ONLY, range raw 0..65535}
              ExpectedSN: resulting-properties={base-type=uint8, sw-calibration-access=READ-ONLY, range raw 0..255}
              FrameType: resulting-properties={base-type=uint8, sw-calibration-access=READ-ONLY, range raw 0..255}
          Element_7: symbol=[7]
            8 x mc data instance, all with category=VALUE:
              Timer: resulting-properties={base-type=uint16, sw-calibration-access=READ-ONLY, range raw 0..65535}
              ChannelState: resulting-properties={base-type=uint8, sw-calibration-access=READ-ONLY, range raw 0..255}
              BufferState: resulting-properties={base-type=uint8, sw-calibration-access=READ-ONLY, range raw 0..255}
              DataIndex: resulting-properties={base-type=uint16, sw-calibration-access=READ-ONLY, range raw 0..65535}
              DataLength: resulting-properties={base-type=uint16, sw-calibration-access=READ-ONLY, range raw 0..65535}
              ProvidedBufferSize: resulting-properties={base-type=uint16, sw-calibration-access=READ-ONLY, range raw 0..65535}
              ExpectedSN: resulting-properties={base-type=uint8, sw-calibration-access=READ-ONLY, range raw 0..255}
              FrameType: resulting-properties={base-type=uint8, sw-calibration-access=READ-ONLY, range raw 0..255}
      mc data instance CanTp_TxState: category=ARRAY, array-size=6
        6 x mc data instance, all with category=STRUCTURE:
          Element_0: symbol=[0]
            8 x mc data instance, all with category=VALUE:
              Timer: resulting-properties={base-type=uint16, sw-calibration-access=READ-ONLY, range raw 0..65535}
              ChannelState: resulting-properties={base-type=uint8, sw-calibration-access=READ-ONLY, range raw 0..255}
              BufferState: resulting-properties={base-type=uint8, sw-calibration-access=READ-ONLY, range raw 0..255}
              DataIndex: resulting-properties={base-type=uint16, sw-calibration-access=READ-ONLY, range raw 0..65535}
              DataLength: resulting-properties={base-type=uint16, sw-calibration-access=READ-ONLY, range raw 0..65535}
              SeqNumber: resulting-properties={base-type=uint8, sw-calibration-access=READ-ONLY, range raw 0..255}
              STminTimer: resulting-properties={base-type=uint8, sw-calibration-access=READ-ONLY, range raw 0..255}
              BlocksizeCounter: resulting-properties={base-type=uint8, sw-calibration-access=READ-ONLY, range raw 0..255}
          Element_1: symbol=[1]
            8 x mc data instance, all with category=VALUE:
              Timer: resulting-properties={base-type=uint16, sw-calibration-access=READ-ONLY, range raw 0..65535}
              ChannelState: resulting-properties={base-type=uint8, sw-calibration-access=READ-ONLY, range raw 0..255}
              BufferState: resulting-properties={base-type=uint8, sw-calibration-access=READ-ONLY, range raw 0..255}
              DataIndex: resulting-properties={base-type=uint16, sw-calibration-access=READ-ONLY, range raw 0..65535}
              DataLength: resulting-properties={base-type=uint16, sw-calibration-access=READ-ONLY, range raw 0..65535}
              SeqNumber: resulting-properties={base-type=uint8, sw-calibration-access=READ-ONLY, range raw 0..255}
              STminTimer: resulting-properties={base-type=uint8, sw-calibration-access=READ-ONLY, range raw 0..255}
              BlocksizeCounter: resulting-properties={base-type=uint8, sw-calibration-access=READ-ONLY, range raw 0..255}
          Element_2: symbol=[2]
            8 x mc data instance, all with category=VALUE:
              Timer: resulting-properties={base-type=uint16, sw-calibration-access=READ-ONLY, range raw 0..65535}
              ChannelState: resulting-properties={base-type=uint8, sw-calibration-access=READ-ONLY, range raw 0..255}
              BufferState: resulting-properties={base-type=uint8, sw-calibration-access=READ-ONLY, range raw 0..255}
              DataIndex: resulting-properties={base-type=uint16, sw-calibration-access=READ-ONLY, range raw 0..65535}
              DataLength: resulting-properties={base-type=uint16, sw-calibration-access=READ-ONLY, range raw 0..65535}
              SeqNumber: resulting-properties={base-type=uint8, sw-calibration-access=READ-ONLY, range raw 0..255}
              STminTimer: resulting-properties={base-type=uint8, sw-calibration-access=READ-ONLY, range raw 0..255}
              BlocksizeCounter: resulting-properties={base-type=uint8, sw-calibration-access=READ-ONLY, range raw 0..255}
          Element_3: symbol=[3]
            8 x mc data instance, all with category=VALUE:
              Timer: resulting-properties={base-type=uint16, sw-calibration-access=READ-ONLY, range raw 0..65535}
              ChannelState: resulting-properties={base-type=uint8, sw-calibration-access=READ-ONLY, range raw 0..255}
              BufferState: resulting-properties={base-type=uint8, sw-calibration-access=READ-ONLY, range raw 0..255}
              DataIndex: resulting-properties={base-type=uint16, sw-calibration-access=READ-ONLY, range raw 0..65535}
              DataLength: resulting-properties={base-type=uint16, sw-calibration-access=READ-ONLY, range raw 0..65535}
              SeqNumber: resulting-properties={base-type=uint8, sw-calibration-access=READ-ONLY, range raw 0..255}
              STminTimer: resulting-properties={base-type=uint8, sw-calibration-access=READ-ONLY, range raw 0..255}
              BlocksizeCounter: resulting-properties={base-type=uint8, sw-calibration-access=READ-ONLY, range raw 0..255}
          Element_4: symbol=[4]
            8 x mc data instance, all with category=VALUE:
              Timer: resulting-properties={base-type=uint16, sw-calibration-access=READ-ONLY, range raw 0..65535}
              ChannelState: resulting-properties={base-type=uint8, sw-calibration-access=READ-ONLY, range raw 0..255}
              BufferState: resulting-properties={base-type=uint8, sw-calibration-access=READ-ONLY, range raw 0..255}
              DataIndex: resulting-properties={base-type=uint16, sw-calibration-access=READ-ONLY, range raw 0..65535}
              DataLength: resulting-properties={base-type=uint16, sw-calibration-access=READ-ONLY, range raw 0..65535}
              SeqNumber: resulting-properties={base-type=uint8, sw-calibration-access=READ-ONLY, range raw 0..255}
              STminTimer: resulting-properties={base-type=uint8, sw-calibration-access=READ-ONLY, range raw 0..255}
              BlocksizeCounter: resulting-properties={base-type=uint8, sw-calibration-access=READ-ONLY, range raw 0..255}
          Element_5: symbol=[5]
            8 x mc data instance, all with category=VALUE:
              Timer: resulting-properties={base-type=uint16, sw-calibration-access=READ-ONLY, range raw 0..65535}
              ChannelState: resulting-properties={base-type=uint8, sw-calibration-access=READ-ONLY, range raw 0..255}
              BufferState: resulting-properties={base-type=uint8, sw-calibration-access=READ-ONLY, range raw 0..255}
              DataIndex: resulting-properties={base-type=uint16, sw-calibration-access=READ-ONLY, range raw 0..65535}
              DataLength: resulting-properties={base-type=uint16, sw-calibration-access=READ-ONLY, range raw 0..65535}
              SeqNumber: resulting-properties={base-type=uint8, sw-calibration-access=READ-ONLY, range raw 0..255}
              STminTimer: resulting-properties={base-type=uint8, sw-calibration-access=READ-ONLY, range raw 0..255}
              BlocksizeCounter: resulting-properties={base-type=uint8, sw-calibration-access=READ-ONLY, range raw 0..255}
      mc data instance CanTp_TxSemaphores: category=ARRAY, array-size=6
        6 x mc data instance, all with category=STRUCTURE:
          Element_0: symbol=[0]
            mc data instance Direction: category=VALUE, resulting-properties={base-type=uint8, sw-calibration-access=READ-ONLY, range raw 0..255}
            mc data instance Handle: category=VALUE, resulting-properties={base-type=uint16, sw-calibration-access=READ-ONLY, range raw 0..65535}
          Element_1: symbol=[1]
            mc data instance Direction: category=VALUE, resulting-properties={base-type=uint8, sw-calibration-access=READ-ONLY, range raw 0..255}
            mc data instance Handle: category=VALUE, resulting-properties={base-type=uint16, sw-calibration-access=READ-ONLY, range raw 0..65535}
          Element_2: symbol=[2]
            mc data instance Direction: category=VALUE, resulting-properties={base-type=uint8, sw-calibration-access=READ-ONLY, range raw 0..255}
            mc data instance Handle: category=VALUE, resulting-properties={base-type=uint16, sw-calibration-access=READ-ONLY, range raw 0..65535}
          Element_3: symbol=[3]
            mc data instance Direction: category=VALUE, resulting-properties={base-type=uint8, sw-calibration-access=READ-ONLY, range raw 0..255}
            mc data instance Handle: category=VALUE, resulting-properties={base-type=uint16, sw-calibration-access=READ-ONLY, range raw 0..65535}
          Element_4: symbol=[4]
            mc data instance Direction: category=VALUE, resulting-properties={base-type=uint8, sw-calibration-access=READ-ONLY, range raw 0..255}
            mc data instance Handle: category=VALUE, resulting-properties={base-type=uint16, sw-calibration-access=READ-ONLY, range raw 0..65535}
          Element_5: symbol=[5]
            mc data instance Direction: category=VALUE, resulting-properties={base-type=uint8, sw-calibration-access=READ-ONLY, range raw 0..255}
            mc data instance Handle: category=VALUE, resulting-properties={base-type=uint16, sw-calibration-access=READ-ONLY, range raw 0..65535}
package /MICROSAR/CanTp_ib_bswmd/BswModuleDescriptions
  bsw module description CanTp: provided-entrys=[CanTp_MainFunction, CanTp_MainFunctionRx, CanTp_MainFunctionTx]
    bsw internal behavior CanTpBehavior
      exclusive area CANTP_EXCLUSIVE_AREA_0
      bsw schedulable entity CanTp_MainFunctionRx: can-enter-exclusive-area=CANTP_EXCLUSIVE_AREA_0, implemented-entry=CanTp_MainFunctionRx
      bsw schedulable entity CanTp_MainFunctionTx: can-enter-exclusive-area=CANTP_EXCLUSIVE_AREA_0, implemented-entry=CanTp_MainFunctionTx
      bsw timing event CanTp_MainFunctionRxTimingEvent0: starts-on-event=CanTp_MainFunctionRx, period=0.01
      bsw timing event CanTp_MainFunctionTxTimingEvent0: starts-on-event=CanTp_MainFunctionTx, period=0.01
  bsw module entry CanTp_MainFunction: call-type=SCHEDULED, execution-context=TASK
  bsw module entry CanTp_MainFunctionRx: call-type=SCHEDULED, execution-context=TASK
  bsw module entry CanTp_MainFunctionTx: call-type=SCHEDULED, execution-context=TASK
