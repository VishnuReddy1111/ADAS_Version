AUTOSAR XML (schema 00048)
standard types defined: uint16, uint32, uint8
package /MICROSAR
  bsw implementation EthFw_Impl: programming-language=C, sw-version=2.00.00, used-code-generator=DaVinci Configurator, vendor-id=30, ar-release-version=4.02.01
package /MICROSAR/EthFw_ib_bswmd/DataTypes/BaseTypes
  15 x base type, all with category=FIXED_LENGTH, base-type-size=32, base-type-encoding=NONE:
    EthFw_AvbRuleOfPCConfigType
    EthFw_AvbStreamIdOfPCConfigType
    EthFw_FramePriorityOfPCConfigType
    EthFw_IpRangeOfPCConfigType
    EthFw_IpRuleOfPCConfigType
    EthFw_IpV4AddrOfPCConfigType
    EthFw_IpV6AddrOfPCConfigType
    EthFw_MacAddrOfPCConfigType
    EthFw_MacAddrRangeOfPCConfigType
    EthFw_PortOfPCConfigType
    EthFw_PortRangeOfPCConfigType
    EthFw_RawProtocolOfPCConfigType
    EthFw_RuleOfPCConfigType
    EthFw_TcpRuleOfPCConfigType
    EthFw_UdpRuleOfPCConfigType
package /MICROSAR/EthFw_ib_bswmd/DataTypes/CompuMethods
  compu method EthFw_IpRuleEndIdxOfRuleType: 255=ETHFW_NO_IPRULEENDIDXOFRULE
  compu method EthFw_IpRuleStartIdxOfRuleType: 255=ETHFW_NO_IPRULESTARTIDXOFRULE
  compu method EthFw_IpV4AddrLocalFromIdxOfIpRangeType: 255=ETHFW_NO_IPV4ADDRLOCALFROMIDXOFIPRANGE
  compu method EthFw_IpV4AddrLocalTillIdxOfIpRangeType: 255=ETHFW_NO_IPV4ADDRLOCALTILLIDXOFIPRANGE
  compu method EthFw_IpV4AddrRemoteFromIdxOfIpRangeType: 255=ETHFW_NO_IPV4ADDRREMOTEFROMIDXOFIPRANGE
  compu method EthFw_IpV4AddrRemoteTillIdxOfIpRangeType: 255=ETHFW_NO_IPV4ADDRREMOTETILLIDXOFIPRANGE
  compu method EthFw_IpV6AddrLocalFromIdxOfIpRangeType: 255=ETHFW_NO_IPV6ADDRLOCALFROMIDXOFIPRANGE
  compu method EthFw_IpV6AddrLocalTillIdxOfIpRangeType: 255=ETHFW_NO_IPV6ADDRLOCALTILLIDXOFIPRANGE
  compu method EthFw_IpV6AddrRemoteFromIdxOfIpRangeType: 255=ETHFW_NO_IPV6ADDRREMOTEFROMIDXOFIPRANGE
  compu method EthFw_IpV6AddrRemoteTillIdxOfIpRangeType: 255=ETHFW_NO_IPV6ADDRREMOTETILLIDXOFIPRANGE
  compu method EthFw_MacAddrLocalFromIdxOfMacAddrRangeType: 255=ETHFW_NO_MACADDRLOCALFROMIDXOFMACADDRRANGE
  compu method EthFw_MacAddrLocalTillIdxOfMacAddrRangeType: 255=ETHFW_NO_MACADDRLOCALTILLIDXOFMACADDRRANGE
  compu method EthFw_MacAddrRemoteFromIdxOfMacAddrRangeType: 255=ETHFW_NO_MACADDRREMOTEFROMIDXOFMACADDRRANGE
  compu method EthFw_MacAddrRemoteTillIdxOfMacAddrRangeType: 255=ETHFW_NO_MACADDRREMOTETILLIDXOFMACADDRRANGE
  compu method EthFw_PortLocalFromIdxOfPortRangeType: 255=ETHFW_NO_PORTLOCALFROMIDXOFPORTRANGE
  compu method EthFw_PortLocalTillIdxOfPortRangeType: 255=ETHFW_NO_PORTLOCALTILLIDXOFPORTRANGE
  compu method EthFw_PortRemoteFromIdxOfPortRangeType: 255=ETHFW_NO_PORTREMOTEFROMIDXOFPORTRANGE
  compu method EthFw_PortRemoteTillIdxOfPortRangeType: 255=ETHFW_NO_PORTREMOTETILLIDXOFPORTRANGE
  compu method EthFw_TcpRuleIdxOfIpRuleType: 255=ETHFW_NO_TCPRULEIDXOFIPRULE
  compu method EthFw_UdpRuleIdxOfIpRuleType: 255=ETHFW_NO_UDPRULEIDXOFIPRULE
  compu method EthFw_VlanIdIdxOfRuleType: 255=ETHFW_NO_VLANIDIDXOFRULE
  compu method EthFw_AvbRuleIdxOfRuleType: 255=ETHFW_NO_AVBRULEIDXOFRULE
  compu method EthFw_AvbRuleOfPCConfigType: 0=NULL_PTR
  compu method EthFw_AvbStreamIdOfPCConfigType: 0=NULL_PTR
  compu method EthFw_FramePriorityEndIdxOfRuleType: 255=ETHFW_NO_FRAMEPRIORITYENDIDXOFRULE
  compu method EthFw_FramePriorityOfPCConfigType: 0=NULL_PTR
  compu method EthFw_FramePriorityStartIdxOfRuleType: 255=ETHFW_NO_FRAMEPRIORITYSTARTIDXOFRULE
  compu method EthFw_IpRangeOfPCConfigType: 0=NULL_PTR
  compu method EthFw_IpRuleOfPCConfigType: 0=NULL_PTR
  compu method EthFw_IpV4AddrOfPCConfigType: 0=NULL_PTR
  compu method EthFw_IpV6AddrOfPCConfigType: 0=NULL_PTR
  compu method EthFw_MacAddrOfPCConfigType: 0=NULL_PTR
  compu method EthFw_MacAddrRangeOfPCConfigType: 0=NULL_PTR
  compu method EthFw_PortOfPCConfigType: 0=NULL_PTR
  compu method EthFw_PortRangeOfPCConfigType: 0=NULL_PTR
  compu method EthFw_RawProtocolEndIdxOfIpRuleType: 255=ETHFW_NO_RAWPROTOCOLENDIDXOFIPRULE
  compu method EthFw_RawProtocolOfPCConfigType: 0=NULL_PTR
  compu method EthFw_RawProtocolStartIdxOfIpRuleType: 255=ETHFW_NO_RAWPROTOCOLSTARTIDXOFIPRULE
  compu method EthFw_RuleOfPCConfigType: 0=NULL_PTR
  compu method EthFw_TcpRuleOfPCConfigType: 0=NULL_PTR
  compu method EthFw_UdpRuleOfPCConfigType: 0=NULL_PTR
package /MICROSAR/EthFw_ib_bswmd/DataTypes/DataConstrs
  range EthFw_AvbRuleIdxOfRuleType: raw 0..255
  data constr EthFw_AvbRuleOfPCConfigType
  data constr EthFw_AvbStreamIdOfPCConfigType
  range EthFw_CtrlIdxOfRuleType: raw 0..4294967295
  range EthFw_EthertypeOfRuleType: raw 0..65535
  range EthFw_FramePriorityEndIdxOfRuleType: raw 0..255
  data constr EthFw_FramePriorityOfPCConfigType
  range EthFw_FramePriorityStartIdxOfRuleType: raw 0..255
  range EthFw_IpRangeEndIdxOfIpRuleType: raw 0..255
  data constr EthFw_IpRangeOfPCConfigType
  range EthFw_IpRangeStartIdxOfIpRuleType: raw 0..255
  range EthFw_IpRuleEndIdxOfRuleType: raw 0..255
  data constr EthFw_IpRuleOfPCConfigType
  range EthFw_IpRuleStartIdxOfRuleType: raw 0..255
  range EthFw_IpV4AddrLocalFromIdxOfIpRangeType: raw 0..255
  range EthFw_IpV4AddrLocalTillIdxOfIpRangeType: raw 0..255
  data constr EthFw_IpV4AddrOfPCConfigType
  range EthFw_IpV4AddrRemoteFromIdxOfIpRangeType: raw 0..255
  range EthFw_IpV4AddrRemoteTillIdxOfIpRangeType: raw 0..255
  range EthFw_IpV6AddrLocalFromIdxOfIpRangeType: raw 0..255
  range EthFw_IpV6AddrLocalTillIdxOfIpRangeType: raw 0..255
  data constr EthFw_IpV6AddrOfPCConfigType
  range EthFw_IpV6AddrRemoteFromIdxOfIpRangeType: raw 0..255
  range EthFw_IpV6AddrRemoteTillIdxOfIpRangeType: raw 0..255
  range EthFw_MacAddrLocalFromIdxOfMacAddrRangeType: raw 0..255
  range EthFw_MacAddrLocalTillIdxOfMacAddrRangeType: raw 0..255
  data constr EthFw_MacAddrOfPCConfigType
  range EthFw_MacAddrRangeEndIdxOfRuleType: raw 0..255
  data constr EthFw_MacAddrRangeOfPCConfigType
  range EthFw_MacAddrRangeStartIdxOfRuleType: raw 0..255
  range EthFw_MacAddrRemoteFromIdxOfMacAddrRangeType: raw 0..255
  range EthFw_MacAddrRemoteTillIdxOfMacAddrRangeType: raw 0..255
  range EthFw_MaskedBitsOfIpRangeType: raw 0..255
  range EthFw_MaskedBitsOfIpRuleType: raw 0..255
  range EthFw_MaskedBitsOfMacAddrRangeType: raw 0..255
  range EthFw_MaskedBitsOfPortRangeType: raw 0..255
  range EthFw_MaskedBitsOfRuleType: raw 0..255
  range EthFw_PortLocalFromIdxOfPortRangeType: raw 0..255
  range EthFw_PortLocalTillIdxOfPortRangeType: raw 0..255
  data constr EthFw_PortOfPCConfigType
  range EthFw_PortRangeEndIdxOfTcpRuleType: raw 0..255
  range EthFw_PortRangeEndIdxOfUdpRuleType: raw 0..255
  data constr EthFw_PortRangeOfPCConfigType
  range EthFw_PortRangeStartIdxOfTcpRuleType: raw 0..255
  range EthFw_PortRangeStartIdxOfUdpRuleType: raw 0..255
  range EthFw_PortRemoteFromIdxOfPortRangeType: raw 0..255
  range EthFw_PortRemoteTillIdxOfPortRangeType: raw 0..255
  range EthFw_PortType: raw 0..65535
  range EthFw_RawProtocolEndIdxOfIpRuleType: raw 0..255
  data constr EthFw_RawProtocolOfPCConfigType
  range EthFw_RawProtocolStartIdxOfIpRuleType: raw 0..255
  range EthFw_RawProtocolType: raw 0..255
  data constr EthFw_RuleOfPCConfigType
  range EthFw_SizeOfAvbRuleType: raw 0..255
  range EthFw_SizeOfAvbStreamIdType: raw 0..255
  range EthFw_SizeOfFramePriorityType: raw 0..255
  range EthFw_SizeOfIpRangeType: raw 0..255
  range EthFw_SizeOfIpRuleType: raw 0..255
  range EthFw_SizeOfIpV4AddrType: raw 0..255
  range EthFw_SizeOfIpV6AddrType: raw 0..255
  range EthFw_SizeOfMacAddrRangeType: raw 0..255
  range EthFw_SizeOfMacAddrType: raw 0..255
  range EthFw_SizeOfPortRangeType: raw 0..255
  range EthFw_SizeOfPortType: raw 0..255
  range EthFw_SizeOfRawProtocolType: raw 0..255
  range EthFw_SizeOfRuleType: raw 0..255
  range EthFw_SizeOfTcpRuleType: raw 0..255
  range EthFw_SizeOfUdpRuleType: raw 0..255
  range EthFw_TcpRuleIdxOfIpRuleType: raw 0..255
  data constr EthFw_TcpRuleOfPCConfigType
  range EthFw_UdpRuleIdxOfIpRuleType: raw 0..255
  data constr EthFw_UdpRuleOfPCConfigType
  range EthFw_VlanIdIdxOfRuleType: raw 0..255
  range EthFw_VlanIdType: raw 0..255
