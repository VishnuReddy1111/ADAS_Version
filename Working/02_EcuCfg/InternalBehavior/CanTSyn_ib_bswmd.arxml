AUTOSAR XML (schema 4-3-1)
standard types defined: boolean, uint8, uint32
package /MICROSAR
  bsw implementation CanTSyn_Impl: programming-language=C, sw-version=6.01.00, used-code-generator=DaVinci Configurator, vendor-id=30, ar-release-version=4.04.00
    mc-variable-instances:
      mc data instance CanTSyn_PartitionIdentifiers: category=ARRAY, array-size=1  # the partition context in Config
        mc data instance Element_0: category=STRUCTURE, symbol=[0]
          mc data instance PartitionSNVOfPartitionIdentifiers: category=VALUE, resulting-properties={base-type=uint32, sw-calibration-access=READ-ONLY, range raw 0..4294967295}
          mc data instance PCPartitionConfigIdxOfPartitionIdentifiers: category=VALUE, resulting-properties={base-type=uint8, sw-calibration-access=READ-ONLY, range raw 0..255}
      mc data instance CanTSyn_SlaveConfig: category=ARRAY, array-size=1  # Contains configuration parameters of slave.
        mc data instance Element_0: category=STRUCTURE, symbol=[0]
          6 x mc data instance, all with category=VALUE:
            DomainConfigIdxOfSlaveConfig: resulting-properties={base-type=uint8, sw-calibration-access=READ-ONLY, range raw 0..255}
            FollowUpTimeoutOfSlaveConfig: resulting-properties={base-type=uint8, sw-calibration-access=READ-ONLY, range raw 0..255}
            PartitionConfigIdxOfSlaveConfig: resulting-properties={base-type=uint8, sw-calibration-access=READ-ONLY, range raw 0..255}
            RxCrcValidatedOfSlaveConfig: resulting-properties={base-type=uint8, sw-calibration-access=READ-ONLY, compu {0=CANTSYN_IGNORED_RXCRCVALIDATEDOFSLAVECONFIG}, range raw 0..255}
            SequenceCounterJumpWidthOfSlaveConfig: resulting-properties={base-type=uint8, sw-calibration-access=READ-ONLY, range raw 0..255}
            SlaveHandleIdOfSlaveConfig: resulting-properties={base-type=uint8, sw-calibration-access=READ-ONLY, range raw 0..255}
      mc data instance CanTSyn_Initialized: category=VALUE, resulting-properties={base-type=boolean, sw-calibration-access=READ-ONLY, compu {0=FALSE, 1..255=TRUE}, range raw 0..1}  # Initialization state of the CanTSyn. TRUE, if CanTSyn_Init() has been called, else FALSE.
