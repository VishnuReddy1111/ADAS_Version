AUTOSAR XML (schema 00048)
package /MICROSAR/Xcp_ib_bswmd/BswModuleDescriptions
  bsw module description Xcp: provided-entrys=[Xcp_MainFunction, CanXcp_MainFunction, FrXcp_MainFunctionRx, FrXcp_MainFunctionTx, TcpIpXcp_MainFunction]
    bsw internal behavior XcpBehavior
      8 x exclusive area:
        XCP_EXCLUSIVE_AREA_{0..2}
        CANXCP_EXCLUSIVE_AREA_0
        FRXCP_EXCLUSIVE_AREA_{0..2}
        TCPIPXCP_EXCLUSIVE_AREA_0
      bsw schedulable entity Xcp_MainFunction: can-enter-exclusive-area=[XCP_EXCLUSIVE_AREA_0, XCP_EXCLUSIVE_AREA_1, XCP_EXCLUSIVE_AREA_2, CANXCP_EXCLUSIVE_AREA_0, FRXCP_EXCLUSIVE_AREA_0, FRXCP_EXCLUSIVE_AREA_1, FRXCP_EXCLUSIVE_AREA_2, TCPIPXCP_EXCLUSIVE_AREA_0], implemented-entry=Xcp_MainFunction
      bsw schedulable entity CanXcp_MainFunction: can-enter-exclusive-area=[XCP_EXCLUSIVE_AREA_0, XCP_EXCLUSIVE_AREA_1, XCP_EXCLUSIVE_AREA_2, CANXCP_EXCLUSIVE_AREA_0, FRXCP_EXCLUSIVE_AREA_0, FRXCP_EXCLUSIVE_AREA_1, FRXCP_EXCLUSIVE_AREA_2, TCPIPXCP_EXCLUSIVE_AREA_0], implemented-entry=CanXcp_MainFunction
      bsw timing event Xcp_MainFunctionTimingEvent0: starts-on-event=Xcp_MainFunction, period=0.005
      bsw timing event CanXcp_MainFunctionTimingEvent0: starts-on-event=CanXcp_MainFunction, period=0.005
  5 x bsw module entry, all with call-type=SCHEDULED, execution-context=TASK:
    Xcp_MainFunction
    CanXcp_MainFunction
    FrXcp_MainFunctionRx
    FrXcp_MainFunctionTx
    TcpIpXcp_MainFunction
