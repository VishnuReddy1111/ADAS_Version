AUTOSAR XML (schema 00048)
package /MICROSAR/vMemAccM_ib_bswmd/BswModuleDescriptions
  bsw module description vMemAccM: provided-entrys=vMemAccM_MainFunction
    bsw internal behavior vMemAccMBehavior
      exclusive area VMEMACCM_EXCLUSIVE_AREA_0
      bsw schedulable entity vMemAccM_MainFunction: can-enter-exclusive-area=VMEMACCM_EXCLUSIVE_AREA_0, implemented-entry=vMemAccM_MainFunction
      bsw timing event vMemAccM_MainFunctionTimingEvent0: starts-on-event=vMemAccM_MainFunction, period=0.005
  bsw module entry vMemAccM_MainFunction: call-type=SCHEDULED, execution-context=TASK
