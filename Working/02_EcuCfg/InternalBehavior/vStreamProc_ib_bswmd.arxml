AUTOSAR XML (schema 00048)
package /MICROSAR/vStreamProc_ib_bswmd/BswModuleDescriptions
  bsw module description vStreamProc
    bsw internal behavior vStreamProcBehavior
