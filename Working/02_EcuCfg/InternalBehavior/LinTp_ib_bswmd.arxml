AUTOSAR XML (schema 00048)
standard types defined: uint16, uint8
package /MICROSAR
  bsw implementation LinTp_Impl: programming-language=C, sw-version=10.00.00, used-code-generator=DaVinci Configurator, vendor-id=30, ar-release-version=4.00.03
    mc-variable-instances:
      5 x mc data instance, all with category=VALUE:
        LinTp_InitState: resulting-properties={base-type=uint8, sw-calibration-access=READ-ONLY, compu {0=LINTP_UNINIT, 165=LINTP_INIT}, range raw 0..255}, symbol=LinTp_Dev_InitDetect  # LinTp initialization state. If it has been initialized, this value is not equal to zero.
        LinTp_ChannelState_0: resulting-properties={base-type=uint8, sw-calibration-access=READ-ONLY, compu {0=LINTP_CHSTATE_IDLE, 16=LINTP_CHSTATE_TX_WAITING, 17=LINTP_CHSTATE_TX_BUSY, 32=LINTP_CHSTATE_RX_BUSY, 33=LINTP_CHSTATE_RX_SUSPENDED, 34=LINTP_CHSTATE_RX_WAITFORSTART, 35=LINTP_CHSTATE_RX_POLLBUFFER}, range raw 0..255}, symbol=LinTp_Ctrl.raw[0].LinTp_Ch_State  # LinTp channel state for channel 0
        LinTp_Timer_0: resulting-properties={base-type=uint16, sw-calibration-access=READ-ONLY, range raw 0..65535}, symbol=LinTp_Ctrl.raw[0].LinTp_Timer  # LinTp Timer for channel 0
        LinTp_P2Timer_0: resulting-properties={base-type=uint16, sw-calibration-access=READ-ONLY, range raw 0..65535}, symbol=LinTp_Ctrl.raw[0].LinTp_P2Timer  # LinTp P2 Timer for channel 0
        LinTp_NAD_0: resulting-properties={base-type=uint8, sw-calibration-access=READ-ONLY, range raw 0..255}, symbol=LinTp_Ctrl.raw[0].LinTp_NAD_Requested  # LinTp NAD of current connection
