AUTOSAR XML (schema 00048)
package /AURIX2G/EcucDefs/Mcu_ib_bswmd/BswModuleDescriptions
  bsw module description Mcu: provided-entrys=Mcu_Virtual
    bsw internal behavior McuBehavior
      exclusive area TomTgcReg
      exclusive area AtomAgcReg
      bsw called entity Mcu_Virtual: can-enter-exclusive-area=[TomTgcReg, AtomAgcReg], implemented-entry=Mcu_Virtual
  bsw module entry Mcu_Virtual: call-type=REGULAR, execution-context=TASK
