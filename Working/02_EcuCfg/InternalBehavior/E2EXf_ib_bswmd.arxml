AUTOSAR XML (schema 00048)
package /MICROSAR
  bsw implementation E2EXf_Impl: programming-language=C, sw-version=4.31.00, used-code-generator=DaVinci Configurator, vendor-id=30, ar-release-version=4.03.01
    resource consumption ResourceConsumption
      13 x memory section:
        CODE: sw-addrmethod=CODE
        CONST_UNSPECIFIED: sw-addrmethod=CONST
        VAR_INIT_UNSPECIFIED: sw-addrmethod=OsApplication_SystemApplication_Core0_VAR_INIT
        VAR_NOINIT_UNSPECIFIED: sw-addrmethod=OsApplication_SystemApplication_Core0_VAR_NO_INIT
        VAR_ZERO_INIT_8BIT: sw-addrmethod=OsApplication_SystemApplication_Core0_VAR_CLEARED
        VAR_NOCACHE_ZERO_INIT_8BIT: sw-addrmethod=OsApplication_SystemApplication_Core0_VAR_NOCACHE_CLEARED
        VAR_ZERO_INIT_UNSPECIFIED: sw-addrmethod=OsApplication_SystemApplication_Core0_VAR_CLEARED
        CODE_OsApplication_SystemApplication_Core0: sw-addrmethod=CODE
        CODE_OsApplication_SystemApplication_Core1: sw-addrmethod=CODE
        VAR_OsApplication_SystemApplication_Core0_INIT_UNSPECIFIED: sw-addrmethod=OsApplication_SystemApplication_Core0_VAR_INIT
        VAR_OsApplication_SystemApplication_Core0_NOINIT_UNSPECIFIED: sw-addrmethod=OsApplication_SystemApplication_Core0_VAR_NO_INIT
        VAR_OsApplication_SystemApplication_Core1_INIT_UNSPECIFIED: sw-addrmethod=OsApplication_SystemApplication_Core1_VAR_INIT
        VAR_OsApplication_SystemApplication_Core1_NOINIT_UNSPECIFIED: sw-addrmethod=OsApplication_SystemApplication_Core1_VAR_NO_INIT
package /MICROSAR/E2EXf_ib_bswmd/BswModuleDescriptions
  bsw module description E2EXf
    bsw internal behavior E2EXfBehavior
