AUTOSAR XML (schema 00048)
standard types defined: boolean, sint32, uint8
package /MICROSAR
  bsw implementation FrIf_Impl: programming-language=C, sw-version=5.05.00, used-code-generator=cMSR, vendor-id=30, ar-release-version=4.00.03
package /MICROSAR/FrIf_ib_bswmd/DataTypes/CompuMethods
  compu method CompuMethod_FrIfStateType: 0=FRIF_STATE_OFFLINE, 1=FRIF_STATE_ONLINE
  compu method FrIf_cmBoolean: 1=TRUE, 0=FALSE
package /MICROSAR/FrIf_ib_bswmd/DataTypes/DataConstrs
  range FrIf_StateType: raw -2147483648..2147483647
