AUTOSAR XML (schema 00048)
package /AURIX2G/EcucDefs/Wdg_ib_bswmd/BswModuleDescriptions
  bsw module entry Wdg_17_Scu_Virtual: call-type=REGULAR, execution-context=TASK
