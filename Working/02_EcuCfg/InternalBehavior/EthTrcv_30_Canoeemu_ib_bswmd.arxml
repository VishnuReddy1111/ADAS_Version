AUTOSAR XML (schema 00048)
package /MICROSAR/EthTrcv_30_Canoeemu_ib_bswmd/BswModuleDescriptions
  bsw module description EthTrcv: provided-entrys=EthTrcv_30_Canoeemu_Virtual
    bsw internal behavior EthTrcv_30_CanoeemuBehavior
      exclusive area ETHTRCV_30_CANOEEMU_EXCLUSIVE_AREA_0
      bsw called entity EthTrcv_30_Canoeemu_Virtual: can-enter-exclusive-area=ETHTRCV_30_CANOEEMU_EXCLUSIVE_AREA_0, implemented-entry=EthTrcv_30_Canoeemu_Virtual
  bsw module entry EthTrcv_30_Canoeemu_Virtual: call-type=REGULAR, execution-context=TASK
