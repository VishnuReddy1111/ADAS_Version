AUTOSAR XML (schema 00048)
standard types defined: uint32
package /MICROSAR
  bsw implementation CanIf_Impl: programming-language=C, sw-version=8.05.00, used-code-generator=cMSR, vendor-id=30, ar-release-version=4.00.03
    mc-variable-instances:
      mc data instance CanIf_CtrlStates: category=STRUCTURE  # This struct-variable stores of each CAN controller: "CtrlModeOfCtrlStates": controller mode, "PduModeOfCtrlStates": PDU mode and optional "WakeUpValidationStateOfCtrlStates": wake-up validation state.
        mc data instance CtrlModeOfCtrlStates: category=ARRAY, array-size=2, resulting-properties={base-type=uint32, sw-calibration-access=READ-ONLY, compu {0=CANIF_CS_UNINIT, 1=CANIF_CS_STOPPED, 2=CANIF_CS_STARTED, 3=CANIF_CS_SLEEP}, range raw 0..4294967295}
        mc data instance PduModeOfCtrlStates: category=ARRAY, array-size=2, resulting-properties={base-type=uint32, sw-calibration-access=READ-ONLY, compu {0=CANIF_GET_OFFLINE, 1=CANIF_GET_RX_ONLINE, 2=CANIF_GET_TX_ONLINE, 3=CANIF_GET_ONLINE, 4=CANIF_GET_OFFLINE_ACTIVE, 5=CANIF_GET_OFFLINE_ACTIVE_RX_ONLINE}, range raw 0..4294967295}
package /MICROSAR/CanIf_ib_bswmd/BswModuleDescriptions
  bsw module description CanIf: provided-entrys=CanIf_Virtual
    bsw internal behavior CanIf_Behavior
      8 x exclusive area:
        CANIF_EXCLUSIVE_AREA_{0..7}
      bsw called entity CanIf_Virtual: can-enter-exclusive-area=[CANIF_EXCLUSIVE_AREA_0, CANIF_EXCLUSIVE_AREA_1, CANIF_EXCLUSIVE_AREA_2, CANIF_EXCLUSIVE_AREA_3, CANIF_EXCLUSIVE_AREA_4, CANIF_EXCLUSIVE_AREA_5, CANIF_EXCLUSIVE_AREA_6, CANIF_EXCLUSIVE_AREA_7], implemented-entry=CanIf_Virtual
  bsw module entry CanIf_Virtual: call-type=REGULAR, execution-context=TASK
