AUTOSAR XML (schema 00048)
standard types defined: sint32, uint16, uint32, uint8
package /MICROSAR
  bsw implementation FrTp_Impl: programming-language=C, sw-version=5.00.01, used-code-generator=cMSR, vendor-id=30, ar-release-version=4.03.00
package /MICROSAR/FrTp_ib_bswmd/DataTypes/CompuMethods
  compu method CompuMethod_FrTp_RxStateType: 0=FrTp_RxSm_Idle, 1=FrTp_RxSm_WaitForSegmPdu, 2=FrTp_RxSm_WaitForSTFsegmBuffer, 3=FrTp_RxSm_WaitForSTFunsegmBuffer, 4=FrTp_RxSm_WaitForCFbuffer, 5=FrTp_RxSm_WaitForCF_EOBbuffer, 6=FrTp_RxSm_WaitForLFbuffer, 7=FrTp_RxSm_WaitForNxtFC_WT, 8=FrTp_RxSm_WaitForTxnNonBurstFC_CTS, 9=FrTp_RxSm_WaitForTxnNonBurstFC_WT, 10=FrTp_RxSm_WaitForTxnNonBurstFC_ABT, 11=FrTp_RxSm_WaitForTxnNonBurstFC_OVER, 12=FrTp_RxSm_WaitForTxConfFC_CTS, 13=FrTp_RxSm_WaitForTxConfFC_WT, 14=FrTp_RxSm_WaitForTxConfFC_ABT, 15=FrTp_RxSm_WaitForTxConfFC_OVER
  compu method CompuMethod_FrTp_TxStateType: 0=FrTp_TxSm_Idle, 1=FrTp_TxSm_WaitFC, 2=FrTp_TxSm_WaitForDataSTF, 3=FrTp_TxSm_WaitForDataCF, 4=FrTp_TxSm_WaitForTxnNonBurstSTFunseg, 5=FrTp_TxSm_WaitForTxnNonBurstSTFseg, 6=FrTp_TxSm_WaitForTxConfNonBurstSTFunseg, 7=FrTp_TxSm_WaitForTxConfNonBurstSTFseg, 8=FrTp_TxSm_WaitForTxConfBurstCF, 9=FrTp_TxSm_WaitForTxConfBurstCFIntrnl, 10=FrTp_TxSm_WaitForEndOfBurstCF, 11=FrTp_TxSm_WaitForBCexpiry
package /MICROSAR/FrTp_ib_bswmd/DataTypes/DataConstrs
  range FrTp_RxStateType_FrTp_ChannelStateType: raw -2147483648..2147483647
  range FrTp_TxStateType_FrTp_ChannelStateType: raw -2147483648..2147483647
