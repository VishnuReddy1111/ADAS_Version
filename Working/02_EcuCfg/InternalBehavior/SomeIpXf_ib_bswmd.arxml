AUTOSAR XML (schema 00048)
package /MICROSAR
  bsw implementation SomeIpXf_Impl: programming-language=C, sw-version=4.31.00, used-code-generator=DaVinci Configurator, vendor-id=30, ar-release-version=4.03.01
    resource consumption ResourceConsumption
      4 x memory section:
        CODE: sw-addrmethod=CODE
        VAR_INIT_UNSPECIFIED: sw-addrmethod=OsApplication_SystemApplication_Core0_VAR_INIT
        VAR_OsApplication_SystemApplication_Core0_INIT_UNSPECIFIED: sw-addrmethod=OsApplication_SystemApplication_Core0_VAR_INIT
        VAR_OsApplication_SystemApplication_Core1_INIT_UNSPECIFIED: sw-addrmethod=OsApplication_SystemApplication_Core1_VAR_INIT
package /MICROSAR/SomeIpXf_ib_bswmd/BswModuleDescriptions
  bsw module description SomeIpXf
    bsw internal behavior SomeIpXfBehavior
