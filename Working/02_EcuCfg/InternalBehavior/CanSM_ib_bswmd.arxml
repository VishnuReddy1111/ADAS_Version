AUTOSAR XML (schema 00048)
standard types defined: uint16, uint8
package /MICROSAR
  bsw implementation CanSM_Impl: programming-language=C, sw-version=4.00.00, used-code-generator=DaVinci Configurator, vendor-id=30, ar-release-version=4.00.03
    mc-variable-instances:
      mc data instance CanSM_ChannelVarRecord: category=ARRAY, array-size=1  # CanSM_variables
        mc data instance Element_0: category=STRUCTURE, symbol=[0]
          8 x mc data instance, all with category=VALUE:
            CanSM_UniversalTimer: resulting-properties={base-type=uint16, sw-calibration-access=READ-ONLY, range raw 0..65535}
            CanSM_LastValidBaudRate: resulting-properties={base-type=uint16, sw-calibration-access=READ-ONLY, range raw 0..65535}
            CanSM_CurrentState: resulting-properties={base-type=uint8, sw-calibration-access=READ-ONLY, compu {1=CANSM_StartUp_TRCV_NORMAL, 2=CANSM_StartUp_CC_STOPPED, 3=CANSM_StartUp_CC_STARTED, 17=CANSM_BusOff_CHECK, 16=CANSM_S_FULLCOM_ENSURED_NO_BUS_OFF, 20=CANSM_BusOff_TX_OFFLINE, 32=CANSM_S_SILENTCOM, 33=CANSM_ShutDown_PN_CLEAR_WUF, 34=CANSM_ShutDown_CC_STOPPED, 35=CANSM_ShutDown_CC_SLEEP, 36=CANSM_ShutDown_TRCV_NORMAL, 37=CANSM_ShutDown_TRCV_STANDBY, 38=CANSM_ShutDown_CC_SLEEP_PN, 39=CANSM_ShutDown_CHK_WUF_CC_SLEEP, 40=CANSM_ShutDown_CHK_WUF_NOT_CC_SLEEP, 64=CANSM_S_NOCOM}, range raw 0..255}
            CanSM_RequestedComMode: resulting-properties={base-type=uint8, sw-calibration-access=READ-ONLY, compu-method=CompuMethodEnum_ComModeTypes, range raw 0..2}
            CanSM_IndicatedComMode: resulting-properties={base-type=uint8, sw-calibration-access=READ-ONLY, compu-method=CompuMethodEnum_ComModeTypes, range raw 0..2}
            CanSM_ModeRequestRepetitionCounter: resulting-properties={base-type=uint8, sw-calibration-access=READ-ONLY, range raw 0..255}
            CanSM_BusOffCounter: resulting-properties={base-type=uint8, sw-calibration-access=READ-ONLY, range raw 0..255}
            CanSM_BusOffFlag: resulting-properties={base-type=uint8, sw-calibration-access=READ-ONLY, range raw 0..255}
package /MICROSAR/CanSM_ib_bswmd/BswModuleDescriptions
  bsw module description CanSM: provided-entrys=CanSM_MainFunction
    bsw internal behavior CanSMBehavior
      6 x exclusive area:
        CANSM_EXCLUSIVE_AREA_{1..6}
      bsw schedulable entity CanSM_MainFunction: can-enter-exclusive-area=[CANSM_EXCLUSIVE_AREA_1, CANSM_EXCLUSIVE_AREA_2, CANSM_EXCLUSIVE_AREA_3, CANSM_EXCLUSIVE_AREA_4, CANSM_EXCLUSIVE_AREA_5, CANSM_EXCLUSIVE_AREA_6], implemented-entry=CanSM_MainFunction
      bsw timing event CanSM_MainFunctionTimingEvent0: starts-on-event=CanSM_MainFunction, period=0.01
  bsw module entry CanSM_MainFunction: call-type=SCHEDULED, execution-context=TASK
package /MICROSAR/CanSM_ib_bswmd/DataTypes/CompuMethods
  compu method CompuMethodEnum_ComModeTypes: 0=COMM_NO_COMMUNICATION, 1=COMM_SILENT_COMMUNICATION, 2=COMM_FULL_COMMUNICATION
