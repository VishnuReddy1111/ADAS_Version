AUTOSAR XML (schema 00048)
standard types defined: boolean, uint16, uint32, uint8
package /MICROSAR
  bsw implementation SoAd_Impl: programming-language=C, sw-version=20.02.00, used-code-generator=DaVinci Configurator, vendor-id=30, ar-release-version=4.05.00
    mc-variable-instances:
      78 x mc data instance:
        SoAd_EventQueueIdent: category=ARRAY, array-size=1  # the event queue identification to get the index of a specific event queue
          mc data instance Element_0: category=STRUCTURE, symbol=[0]
            4 x mc data instance, all with category=VALUE:
              EventQueueIfTxRouteGrpConfigIdxOfEventQueueIdent: resulting-properties={base-type=uint8, sw-calibration-access=READ-ONLY, compu {255=SOAD_NO_EVENTQUEUEIFTXROUTEGRPCONFIGIDXOFEVENTQUEUEIDENT}, range raw 0..255}
              EventQueueIfUdpPduRouteConfigIdxOfEventQueueIdent: resulting-properties={base-type=uint8, sw-calibration-access=READ-ONLY, compu {255=SOAD_NO_EVENTQUEUEIFUDPPDUROUTECONFIGIDXOFEVENTQUEUEIDENT}, range raw 0..255}
              EventQueueTpRxSoConConfigIdxOfEventQueueIdent: resulting-properties={base-type=uint8, sw-calibration-access=READ-ONLY, compu {255=SOAD_NO_EVENTQUEUETPRXSOCONCONFIGIDXOFEVENTQUEUEIDENT}, range raw 0..255}
              EventQueueTpTxSoConConfigIdxOfEventQueueIdent: resulting-properties={base-type=uint8, sw-calibration-access=READ-ONLY, compu {255=SOAD_NO_EVENTQUEUETPTXSOCONCONFIGIDXOFEVENTQUEUEIDENT}, range raw 0..255}
        SoAd_Instance: category=ARRAY, array-size=1  # contains the event queue and timeout list indexes
          mc data instance Element_0: category=STRUCTURE, symbol=[0]
            mc data instance IpFragBufConfigStartIdxOfInstance: category=VALUE, resulting-properties={base-type=uint8, sw-calibration-access=READ-ONLY, compu {255=SOAD_NO_IPFRAGBUFCONFIGSTARTIDXOFINSTANCE}, range raw 0..255}
            mc data instance MetaDataRxBufConfigStartIdxOfInstance: category=VALUE, resulting-properties={base-type=uint8, sw-calibration-access=READ-ONLY, compu {255=SOAD_NO_METADATARXBUFCONFIGSTARTIDXOFINSTANCE}, range raw 0..255}
            mc data instance TriggerBufConfigStartIdxOfInstance: category=VALUE, resulting-properties={base-type=uint8, sw-calibration-access=READ-ONLY, compu {255=SOAD_NO_TRIGGERBUFCONFIGSTARTIDXOFINSTANCE}, range raw 0..255}
        SoAd_LocalAddrIdMap: category=ARRAY, array-size=7  # the partition-unspecific LocalAddrId mapping to partition-specific LocalAddr
          7 x mc data instance, all with category=STRUCTURE:
            Element_0: symbol=[0]
              mc data instance InvalidHndOfLocalAddrIdMap: category=VALUE, resulting-properties={base-type=boolean, sw-calibration-access=READ-ONLY, compu {0=FALSE, 1..255=TRUE}, range raw 0..1}
              mc data instance PartitionSpecificLocalAddrIdxOfLocalAddrIdMap: category=VALUE, resulting-properties={base-type=uint8, sw-calibration-access=READ-ONLY, compu {255=SOAD_NO_PARTITIONSPECIFICLOCALADDRIDXOFLOCALADDRIDMAP}, range raw 0..255}
              mc data instance PartitionSpecificLocalAddrPartitionIdxOfLocalAddrIdMap: category=VALUE, resulting-properties={base-type=uint8, sw-calibration-access=READ-ONLY, compu {255=SOAD_NO_PARTITIONSPECIFICLOCALADDRPARTITIONIDXOFLOCALADDRIDMAP}, range raw 0..255}
            Element_1: symbol=[1]
              mc data instance InvalidHndOfLocalAddrIdMap: category=VALUE, resulting-properties={base-type=boolean, sw-calibration-access=READ-ONLY, compu {0=FALSE, 1..255=TRUE}, range raw 0..1}
              mc data instance PartitionSpecificLocalAddrIdxOfLocalAddrIdMap: category=VALUE, resulting-properties={base-type=uint8, sw-calibration-access=READ-ONLY, compu {255=SOAD_NO_PARTITIONSPECIFICLOCALADDRIDXOFLOCALADDRIDMAP}, range raw 0..255}
              mc data instance PartitionSpecificLocalAddrPartitionIdxOfLocalAddrIdMap: category=VALUE, resulting-properties={base-type=uint8, sw-calibration-access=READ-ONLY, compu {255=SOAD_NO_PARTITIONSPECIFICLOCALADDRPARTITIONIDXOFLOCALADDRIDMAP}, range raw 0..255}
            Element_2: symbol=[2]
              mc data instance InvalidHndOfLocalAddrIdMap: category=VALUE, resulting-properties={base-type=boolean, sw-calibration-access=READ-ONLY, compu {0=FALSE, 1..255=TRUE}, range raw 0..1}
              mc data instance PartitionSpecificLocalAddrIdxOfLocalAddrIdMap: category=VALUE, resulting-properties={base-type=uint8, sw-calibration-access=READ-ONLY, compu {255=SOAD_NO_PARTITIONSPECIFICLOCALADDRIDXOFLOCALADDRIDMAP}, range raw 0..255}
              mc data instance PartitionSpecificLocalAddrPartitionIdxOfLocalAddrIdMap: category=VALUE, resulting-properties={base-type=uint8, sw-calibration-access=READ-ONLY, compu {255=SOAD_NO_PARTITIONSPECIFICLOCALADDRPARTITIONIDXOFLOCALADDRIDMAP}, range raw 0..255}
            Element_3: symbol=[3]
              mc data instance InvalidHndOfLocalAddrIdMap: category=VALUE, resulting-properties={base-type=boolean, sw-calibration-access=READ-ONLY, compu {0=FALSE, 1..255=TRUE}, range raw 0..1}
              mc data instance PartitionSpecificLocalAddrIdxOfLocalAddrIdMap: category=VALUE, resulting-properties={base-type=uint8, sw-calibration-access=READ-ONLY, compu {255=SOAD_NO_PARTITIONSPECIFICLOCALADDRIDXOFLOCALADDRIDMAP}, range raw 0..255}
              mc data instance PartitionSpecificLocalAddrPartitionIdxOfLocalAddrIdMap: category=VALUE, resulting-properties={base-type=uint8, sw-calibration-access=READ-ONLY, compu {255=SOAD_NO_PARTITIONSPECIFICLOCALADDRPARTITIONIDXOFLOCALADDRIDMAP}, range raw 0..255}
            Element_4: symbol=[4]
              mc data instance InvalidHndOfLocalAddrIdMap: category=VALUE, resulting-properties={base-type=boolean, sw-calibration-access=READ-ONLY, compu {0=FALSE, 1..255=TRUE}, range raw 0..1}
              mc data instance PartitionSpecificLocalAddrIdxOfLocalAddrIdMap: category=VALUE, resulting-properties={base-type=uint8, sw-calibration-access=READ-ONLY, compu {255=SOAD_NO_PARTITIONSPECIFICLOCALADDRIDXOFLOCALADDRIDMAP}, range raw 0..255}
              mc data instance PartitionSpecificLocalAddrPartitionIdxOfLocalAddrIdMap: category=VALUE, resulting-properties={base-type=uint8, sw-calibration-access=READ-ONLY, compu {255=SOAD_NO_PARTITIONSPECIFICLOCALADDRPARTITIONIDXOFLOCALADDRIDMAP}, range raw 0..255}
            Element_5: symbol=[5]
              mc data instance InvalidHndOfLocalAddrIdMap: category=VALUE, resulting-properties={base-type=boolean, sw-calibration-access=READ-ONLY, compu {0=FALSE, 1..255=TRUE}, range raw 0..1}
              mc data instance PartitionSpecificLocalAddrIdxOfLocalAddrIdMap: category=VALUE, resulting-properties={base-type=uint8, sw-calibration-access=READ-ONLY, compu {255=SOAD_NO_PARTITIONSPECIFICLOCALADDRIDXOFLOCALADDRIDMAP}, range raw 0..255}
              mc data instance PartitionSpecificLocalAddrPartitionIdxOfLocalAddrIdMap: category=VALUE, resulting-properties={base-type=uint8, sw-calibration-access=READ-ONLY, compu {255=SOAD_NO_PARTITIONSPECIFICLOCALADDRPARTITIONIDXOFLOCALADDRIDMAP}, range raw 0..255}
            Element_6: symbol=[6]
              mc data instance InvalidHndOfLocalAddrIdMap: category=VALUE, resulting-properties={base-type=boolean, sw-calibration-access=READ-ONLY, compu {0=FALSE, 1..255=TRUE}, range raw 0..1}
              mc data instance PartitionSpecificLocalAddrIdxOfLocalAddrIdMap: category=VALUE, resulting-properties={base-type=uint8, sw-calibration-access=READ-ONLY, compu {255=SOAD_NO_PARTITIONSPECIFICLOCALADDRIDXOFLOCALADDRIDMAP}, range raw 0..255}
              mc data instance PartitionSpecificLocalAddrPartitionIdxOfLocalAddrIdMap: category=VALUE, resulting-properties={base-type=uint8, sw-calibration-access=READ-ONLY, compu {255=SOAD_NO_PARTITIONSPECIFICLOCALADDRPARTITIONIDXOFLOCALADDRIDMAP}, range raw 0..255}
        SoAd_PCConfig: category=STRUCTURE
          mc data instance PCPartitionConfigOfPCConfig: category=VALUE, resulting-properties={base-type=SoAd_PCPartitionConfigOfPCConfigType, sw-calibration-access=READ-ONLY, compu {0=NULL_PTR}, data-constr=SoAd_PCPartitionConfigOfPCConfigType}
          mc data instance PartitionIdentifiersOfPCConfig: category=VALUE, resulting-properties={base-type=SoAd_PartitionIdentifiersOfPCConfigType, sw-calibration-access=READ-ONLY, compu {0=NULL_PTR}, data-constr=SoAd_PartitionIdentifiersOfPCConfigType}
          mc data instance SizeOfPartitionIdentifiersOfPCConfig: category=VALUE, resulting-properties={base-type=uint8, sw-calibration-access=READ-ONLY, range raw 0..255}
        SoAd_PCPartitionConfig: category=STRUCTURE
          178 x mc data instance, all with category=VALUE:
            BestMatchSoConIdxListOfPCPartitionConfig: resulting-properties={base-type=SoAd_BestMatchSoConIdxListOfPCPartitionConfigType, sw-calibration-access=READ-ONLY, compu {0=NULL_PTR}, data-constr=SoAd_BestMatchSoConIdxListOfPCPartitionConfigType}
            DhcpEventCbkOfPCPartitionConfig: resulting-properties={base-type=SoAd_DhcpEventCbkOfPCPartitionConfigType, sw-calibration-access=READ-ONLY, compu {0=NULL_PTR}, data-constr=SoAd_DhcpEventCbkOfPCPartitionConfigType}
            EventQueueFlagOfPCPartitionConfig: resulting-properties={base-type=SoAd_EventQueueFlagOfPCPartitionConfigType, sw-calibration-access=READ-ONLY, compu {0=NULL_PTR}, data-constr=SoAd_EventQueueFlagOfPCPartitionConfigType}
            EventQueueIdentOfPCPartitionConfig: resulting-properties={base-type=SoAd_EventQueueIdentOfPCPartitionConfigType, sw-calibration-access=READ-ONLY, compu {0=NULL_PTR}, data-constr=SoAd_EventQueueIdentOfPCPartitionConfigType}
            EventQueueIfTxRouteGrpOfPCPartitionConfig: resulting-properties={base-type=SoAd_EventQueueIfTxRouteGrpOfPCPartitionConfigType, sw-calibration-access=READ-ONLY, compu {0=NULL_PTR}, data-constr=SoAd_EventQueueIfTxRouteGrpOfPCPartitionConfigType}
            EventQueueIfTxRouteGrpConfigOfPCPartitionConfig: resulting-properties={base-type=SoAd_EventQueueIfTxRouteGrpConfigOfPCPartitionConfigType, sw-calibration-access=READ-ONLY, compu {0=NULL_PTR}, data-constr=SoAd_EventQueueIfTxRouteGrpConfigOfPCPartitionConfigType}
            EventQueueIfUdpPduRouteOfPCPartitionConfig: resulting-properties={base-type=SoAd_EventQueueIfUdpPduRouteOfPCPartitionConfigType, sw-calibration-access=READ-ONLY, compu {0=NULL_PTR}, data-constr=SoAd_EventQueueIfUdpPduRouteOfPCPartitionConfigType}
            EventQueueIfUdpPduRouteConfigOfPCPartitionConfig: resulting-properties={base-type=SoAd_EventQueueIfUdpPduRouteConfigOfPCPartitionConfigType, sw-calibration-access=READ-ONLY, compu {0=NULL_PTR}, data-constr=SoAd_EventQueueIfUdpPduRouteConfigOfPCPartitionConfigType}
            EventQueueMgmtOfPCPartitionConfig: resulting-properties={base-type=SoAd_EventQueueMgmtOfPCPartitionConfigType, sw-calibration-access=READ-ONLY, compu {0=NULL_PTR}, data-constr=SoAd_EventQueueMgmtOfPCPartitionConfigType}
            EventQueueStateSoConOfPCPartitionConfig: resulting-properties={base-type=SoAd_EventQueueStateSoConOfPCPartitionConfigType, sw-calibration-access=READ-ONLY, compu {0=NULL_PTR}, data-constr=SoAd_EventQueueStateSoConOfPCPartitionConfigType}
            EventQueueStateSoConConfigOfPCPartitionConfig: resulting-properties={base-type=SoAd_EventQueueStateSoConConfigOfPCPartitionConfigType, sw-calibration-access=READ-ONLY, compu {0=NULL_PTR}, data-constr=SoAd_EventQueueStateSoConConfigOfPCPartitionConfigType}
            EventQueueTpRxSoConOfPCPartitionConfig: resulting-properties={base-type=SoAd_EventQueueTpRxSoConOfPCPartitionConfigType, sw-calibration-access=READ-ONLY, compu {0=NULL_PTR}, data-constr=SoAd_EventQueueTpRxSoConOfPCPartitionConfigType}
            EventQueueTpRxSoConConfigOfPCPartitionConfig: resulting-properties={base-type=SoAd_EventQueueTpRxSoConConfigOfPCPartitionConfigType, sw-calibration-access=READ-ONLY, compu {0=NULL_PTR}, data-constr=SoAd_EventQueueTpRxSoConConfigOfPCPartitionConfigType}
            EventQueueTpTxSoConOfPCPartitionConfig: resulting-properties={base-type=SoAd_EventQueueTpTxSoConOfPCPartitionConfigType, sw-calibration-access=READ-ONLY, compu {0=NULL_PTR}, data-constr=SoAd_EventQueueTpTxSoConOfPCPartitionConfigType}
            EventQueueTpTxSoConConfigOfPCPartitionConfig: resulting-properties={base-type=SoAd_EventQueueTpTxSoConConfigOfPCPartitionConfigType, sw-calibration-access=READ-ONLY, compu {0=NULL_PTR}, data-constr=SoAd_EventQueueTpTxSoConConfigOfPCPartitionConfigType}
            IfRxBufferOfPCPartitionConfig: resulting-properties={base-type=SoAd_IfRxBufferOfPCPartitionConfigType, sw-calibration-access=READ-ONLY, compu {0=NULL_PTR}, data-constr=SoAd_IfRxBufferOfPCPartitionConfigType}
            InstanceOfPCPartitionConfig: resulting-properties={base-type=SoAd_InstanceOfPCPartitionConfigType, sw-calibration-access=READ-ONLY, compu {0=NULL_PTR}, data-constr=SoAd_InstanceOfPCPartitionConfigType}
            InstanceDynOfPCPartitionConfig: resulting-properties={base-type=SoAd_InstanceDynOfPCPartitionConfigType, sw-calibration-access=READ-ONLY, compu {0=NULL_PTR}, data-constr=SoAd_InstanceDynOfPCPartitionConfigType}
            InstanceMapOfPCPartitionConfig: resulting-properties={base-type=SoAd_InstanceMapOfPCPartitionConfigType, sw-calibration-access=READ-ONLY, compu {0=NULL_PTR}, data-constr=SoAd_InstanceMapOfPCPartitionConfigType}
            IpFragBufOfPCPartitionConfig: resulting-properties={base-type=SoAd_IpFragBufOfPCPartitionConfigType, sw-calibration-access=READ-ONLY, compu {0=NULL_PTR}, data-constr=SoAd_IpFragBufOfPCPartitionConfigType}
            IpFragBufConfigOfPCPartitionConfig: resulting-properties={base-type=SoAd_IpFragBufConfigOfPCPartitionConfigType, sw-calibration-access=READ-ONLY, compu {0=NULL_PTR}, data-constr=SoAd_IpFragBufConfigOfPCPartitionConfigType}
            IpFragBufConfigDynOfPCPartitionConfig: resulting-properties={base-type=SoAd_IpFragBufConfigDynOfPCPartitionConfigType, sw-calibration-access=READ-ONLY, compu {0=NULL_PTR}, data-constr=SoAd_IpFragBufConfigDynOfPCPartitionConfigType}
            IpFragMgtOfPCPartitionConfig: resulting-properties={base-type=SoAd_IpFragMgtOfPCPartitionConfigType, sw-calibration-access=READ-ONLY, compu {0=NULL_PTR}, data-constr=SoAd_IpFragMgtOfPCPartitionConfigType}
            LocalAddrOfPCPartitionConfig: resulting-properties={base-type=SoAd_LocalAddrOfPCPartitionConfigType, sw-calibration-access=READ-ONLY, compu {0=NULL_PTR}, data-constr=SoAd_LocalAddrOfPCPartitionConfigType}
            LocalAddrByTcpIpCtrlIndOfPCPartitionConfig: resulting-properties={base-type=SoAd_LocalAddrByTcpIpCtrlIndOfPCPartitionConfigType, sw-calibration-access=READ-ONLY, compu {0=NULL_PTR}, data-constr=SoAd_LocalAddrByTcpIpCtrlIndOfPCPartitionConfigType}
            LocalAddrDynOfPCPartitionConfig: resulting-properties={base-type=SoAd_LocalAddrDynOfPCPartitionConfigType, sw-calibration-access=READ-ONLY, compu {0=NULL_PTR}, data-constr=SoAd_LocalAddrDynOfPCPartitionConfigType}
            LocalAddrIdMapOfPCPartitionConfig: resulting-properties={base-type=SoAd_LocalAddrIdMapOfPCPartitionConfigType, sw-calibration-access=READ-ONLY, compu {0=NULL_PTR}, data-constr=SoAd_LocalAddrIdMapOfPCPartitionConfigType}
            LocalIpAddrAssignmentChgCbkOfPCPartitionConfig: resulting-properties={base-type=SoAd_LocalIpAddrAssignmentChgCbkOfPCPartitionConfigType, sw-calibration-access=READ-ONLY, compu {0=NULL_PTR}, data-constr=SoAd_LocalIpAddrAssignmentChgCbkOfPCPartitionConfigType}
            LocalIpAddrAssignmentChgCbkIndOfPCPartitionConfig: resulting-properties={base-type=SoAd_LocalIpAddrAssignmentChgCbkIndOfPCPartitionConfigType, sw-calibration-access=READ-ONLY, compu {0=NULL_PTR}, data-constr=SoAd_LocalIpAddrAssignmentChgCbkIndOfPCPartitionConfigType}
            MetaDataRxBufOfPCPartitionConfig: resulting-properties={base-type=SoAd_MetaDataRxBufOfPCPartitionConfigType, sw-calibration-access=READ-ONLY, compu {0=NULL_PTR}, data-constr=SoAd_MetaDataRxBufOfPCPartitionConfigType}
            MetaDataRxBufConfigOfPCPartitionConfig: resulting-properties={base-type=SoAd_MetaDataRxBufConfigOfPCPartitionConfigType, sw-calibration-access=READ-ONLY, compu {0=NULL_PTR}, data-constr=SoAd_MetaDataRxBufConfigOfPCPartitionConfigType}
            MetaDataRxBufConfigDynOfPCPartitionConfig: resulting-properties={base-type=SoAd_MetaDataRxBufConfigDynOfPCPartitionConfigType, sw-calibration-access=READ-ONLY, compu {0=NULL_PTR}, data-constr=SoAd_MetaDataRxBufConfigDynOfPCPartitionConfigType}
            NPduUdpTxOfPCPartitionConfig: resulting-properties={base-type=SoAd_NPduUdpTxOfPCPartitionConfigType, sw-calibration-access=READ-ONLY, compu {0=NULL_PTR}, data-constr=SoAd_NPduUdpTxOfPCPartitionConfigType}
            NPduUdpTxBufferOfPCPartitionConfig: resulting-properties={base-type=SoAd_NPduUdpTxBufferOfPCPartitionConfigType, sw-calibration-access=READ-ONLY, compu {0=NULL_PTR}, data-constr=SoAd_NPduUdpTxBufferOfPCPartitionConfigType}
            NPduUdpTxDynOfPCPartitionConfig: resulting-properties={base-type=SoAd_NPduUdpTxDynOfPCPartitionConfigType, sw-calibration-access=READ-ONLY, compu {0=NULL_PTR}, data-constr=SoAd_NPduUdpTxDynOfPCPartitionConfigType}
            NPduUdpTxQueueOfPCPartitionConfig: resulting-properties={base-type=SoAd_NPduUdpTxQueueOfPCPartitionConfigType, sw-calibration-access=READ-ONLY, compu {0=NULL_PTR}, data-constr=SoAd_NPduUdpTxQueueOfPCPartitionConfigType}
            PartitionDynOfPCPartitionConfig: resulting-properties={base-type=SoAd_PartitionDynOfPCPartitionConfigType, sw-calibration-access=READ-ONLY, compu {0=NULL_PTR}, data-constr=SoAd_PartitionDynOfPCPartitionConfigType}
            PduRouteOfPCPartitionConfig: resulting-properties={base-type=SoAd_PduRouteOfPCPartitionConfigType, sw-calibration-access=READ-ONLY, compu {0=NULL_PTR}, data-constr=SoAd_PduRouteOfPCPartitionConfigType}
            PduRouteDestOfPCPartitionConfig: resulting-properties={base-type=SoAd_PduRouteDestOfPCPartitionConfigType, sw-calibration-access=READ-ONLY, compu {0=NULL_PTR}, data-constr=SoAd_PduRouteDestOfPCPartitionConfigType}
            PduRouteDestBySoConIndOfPCPartitionConfig: resulting-properties={base-type=SoAd_PduRouteDestBySoConIndOfPCPartitionConfigType, sw-calibration-access=READ-ONLY, compu {0=NULL_PTR}, data-constr=SoAd_PduRouteDestBySoConIndOfPCPartitionConfigType}
            PduRouteDestIndOfPCPartitionConfig: resulting-properties={base-type=SoAd_PduRouteDestIndOfPCPartitionConfigType, sw-calibration-access=READ-ONLY, compu {0=NULL_PTR}, data-constr=SoAd_PduRouteDestIndOfPCPartitionConfigType}
            PduRouteDynOfPCPartitionConfig: resulting-properties={base-type=SoAd_PduRouteDynOfPCPartitionConfigType, sw-calibration-access=READ-ONLY, compu {0=NULL_PTR}, data-constr=SoAd_PduRouteDynOfPCPartitionConfigType}
            RcvRemAddrOfPCPartitionConfig: resulting-properties={base-type=SoAd_RcvRemAddrOfPCPartitionConfigType, sw-calibration-access=READ-ONLY, compu {0=NULL_PTR}, data-constr=SoAd_RcvRemAddrOfPCPartitionConfigType}
            RemAddrIpV4OfPCPartitionConfig: resulting-properties={base-type=SoAd_RemAddrIpV4OfPCPartitionConfigType, sw-calibration-access=READ-ONLY, compu {0=NULL_PTR}, data-constr=SoAd_RemAddrIpV4OfPCPartitionConfigType}
            RemAddrIpV6OfPCPartitionConfig: resulting-properties={base-type=SoAd_RemAddrIpV6OfPCPartitionConfigType, sw-calibration-access=READ-ONLY, compu {0=NULL_PTR}, data-constr=SoAd_RemAddrIpV6OfPCPartitionConfigType}
            RouteGrpOfPCPartitionConfig: resulting-properties={base-type=SoAd_RouteGrpOfPCPartitionConfigType, sw-calibration-access=READ-ONLY, compu {0=NULL_PTR}, data-constr=SoAd_RouteGrpOfPCPartitionConfigType}
            RouteGrpIdMapOfPCPartitionConfig: resulting-properties={base-type=SoAd_RouteGrpIdMapOfPCPartitionConfigType, sw-calibration-access=READ-ONLY, compu {0=NULL_PTR}, data-constr=SoAd_RouteGrpIdMapOfPCPartitionConfigType}
            RouteGrpSoConOfPCPartitionConfig: resulting-properties={base-type=SoAd_RouteGrpSoConOfPCPartitionConfigType, sw-calibration-access=READ-ONLY, compu {0=NULL_PTR}, data-constr=SoAd_RouteGrpSoConOfPCPartitionConfigType}
            RouteGrpSoConByPduRouteDestIndOfPCPartitionConfig: resulting-properties={base-type=SoAd_RouteGrpSoConByPduRouteDestIndOfPCPartitionConfigType, sw-calibration-access=READ-ONLY, compu {0=NULL_PTR}, data-constr=SoAd_RouteGrpSoConByPduRouteDestIndOfPCPartitionConfigType}
            RouteGrpSoConBySocketRouteDestIndOfPCPartitionConfig: resulting-properties={base-type=SoAd_RouteGrpSoConBySocketRouteDestIndOfPCPartitionConfigType, sw-calibration-access=READ-ONLY, compu {0=NULL_PTR}, data-constr=SoAd_RouteGrpSoConBySocketRouteDestIndOfPCPartitionConfigType}
            RouteGrpSoConDynOfPCPartitionConfig: resulting-properties={base-type=SoAd_RouteGrpSoConDynOfPCPartitionConfigType, sw-calibration-access=READ-ONLY, compu {0=NULL_PTR}, data-constr=SoAd_RouteGrpSoConDynOfPCPartitionConfigType}
            RxBufStructMgtOfPCPartitionConfig: resulting-properties={base-type=SoAd_RxBufStructMgtOfPCPartitionConfigType, sw-calibration-access=READ-ONLY, compu {0=NULL_PTR}, data-constr=SoAd_RxBufStructMgtOfPCPartitionConfigType}
            RxBufStructSegOfPCPartitionConfig: resulting-properties={base-type=SoAd_RxBufStructSegOfPCPartitionConfigType, sw-calibration-access=READ-ONLY, compu {0=NULL_PTR}, data-constr=SoAd_RxBufStructSegOfPCPartitionConfigType}
            RxBufferConfigOfPCPartitionConfig: resulting-properties={base-type=SoAd_RxBufferConfigOfPCPartitionConfigType, sw-calibration-access=READ-ONLY, compu {0=NULL_PTR}, data-constr=SoAd_RxBufferConfigOfPCPartitionConfigType}
            RxBufferConfigDynOfPCPartitionConfig: resulting-properties={base-type=SoAd_RxBufferConfigDynOfPCPartitionConfigType, sw-calibration-access=READ-ONLY, compu {0=NULL_PTR}, data-constr=SoAd_RxBufferConfigDynOfPCPartitionConfigType}
            RxMgtOfPCPartitionConfig: resulting-properties={base-type=SoAd_RxMgtOfPCPartitionConfigType, sw-calibration-access=READ-ONLY, compu {0=NULL_PTR}, data-constr=SoAd_RxMgtOfPCPartitionConfigType}
            RxPduIdIdMapOfPCPartitionConfig: resulting-properties={base-type=SoAd_RxPduIdIdMapOfPCPartitionConfigType, sw-calibration-access=READ-ONLY, compu {0=NULL_PTR}, data-constr=SoAd_RxPduIdIdMapOfPCPartitionConfigType}
            ShutdownFinishedCbkOfPCPartitionConfig: resulting-properties={base-type=SoAd_ShutdownFinishedCbkOfPCPartitionConfigType, sw-calibration-access=READ-ONLY, compu {0=NULL_PTR}, data-constr=SoAd_ShutdownFinishedCbkOfPCPartitionConfigType}
            SoConOfPCPartitionConfig: resulting-properties={base-type=SoAd_SoConOfPCPartitionConfigType, sw-calibration-access=READ-ONLY, compu {0=NULL_PTR}, data-constr=SoAd_SoConOfPCPartitionConfigType}
            SoConDynOfPCPartitionConfig: resulting-properties={base-type=SoAd_SoConDynOfPCPartitionConfigType, sw-calibration-access=READ-ONLY, compu {0=NULL_PTR}, data-constr=SoAd_SoConDynOfPCPartitionConfigType}
            SoConGrpOfPCPartitionConfig: resulting-properties={base-type=SoAd_SoConGrpOfPCPartitionConfigType, sw-calibration-access=READ-ONLY, compu {0=NULL_PTR}, data-constr=SoAd_SoConGrpOfPCPartitionConfigType}
            SoConMapOfPCPartitionConfig: resulting-properties={base-type=SoAd_SoConMapOfPCPartitionConfigType, sw-calibration-access=READ-ONLY, compu {0=NULL_PTR}, data-constr=SoAd_SoConMapOfPCPartitionConfigType}
            SoConModeChgCbkOfPCPartitionConfig: resulting-properties={base-type=SoAd_SoConModeChgCbkOfPCPartitionConfigType, sw-calibration-access=READ-ONLY, compu {0=NULL_PTR}, data-constr=SoAd_SoConModeChgCbkOfPCPartitionConfigType}
            SoConModeChgCbkIndOfPCPartitionConfig: resulting-properties={base-type=SoAd_SoConModeChgCbkIndOfPCPartitionConfigType, sw-calibration-access=READ-ONLY, compu {0=NULL_PTR}, data-constr=SoAd_SoConModeChgCbkIndOfPCPartitionConfigType}
            SocketOfPCPartitionConfig: resulting-properties={base-type=SoAd_SocketOfPCPartitionConfigType, sw-calibration-access=READ-ONLY, compu {0=NULL_PTR}, data-constr=SoAd_SocketOfPCPartitionConfigType}
            SocketDynOfPCPartitionConfig: resulting-properties={base-type=SoAd_SocketDynOfPCPartitionConfigType, sw-calibration-access=READ-ONLY, compu {0=NULL_PTR}, data-constr=SoAd_SocketDynOfPCPartitionConfigType}
            SocketMapOfPCPartitionConfig: resulting-properties={base-type=SoAd_SocketMapOfPCPartitionConfigType, sw-calibration-access=READ-ONLY, compu {0=NULL_PTR}, data-constr=SoAd_SocketMapOfPCPartitionConfigType}
            SocketRouteOfPCPartitionConfig: resulting-properties={base-type=SoAd_SocketRouteOfPCPartitionConfigType, sw-calibration-access=READ-ONLY, compu {0=NULL_PTR}, data-constr=SoAd_SocketRouteOfPCPartitionConfigType}
            SocketRouteDestOfPCPartitionConfig: resulting-properties={base-type=SoAd_SocketRouteDestOfPCPartitionConfigType, sw-calibration-access=READ-ONLY, compu {0=NULL_PTR}, data-constr=SoAd_SocketRouteDestOfPCPartitionConfigType}
            SocketRouteIndOfPCPartitionConfig: resulting-properties={base-type=SoAd_SocketRouteIndOfPCPartitionConfigType, sw-calibration-access=READ-ONLY, compu {0=NULL_PTR}, data-constr=SoAd_SocketRouteIndOfPCPartitionConfigType}
            SocketTcpOfPCPartitionConfig: resulting-properties={base-type=SoAd_SocketTcpOfPCPartitionConfigType, sw-calibration-access=READ-ONLY, compu {0=NULL_PTR}, data-constr=SoAd_SocketTcpOfPCPartitionConfigType}
            SocketUdpOfPCPartitionConfig: resulting-properties={base-type=SoAd_SocketUdpOfPCPartitionConfigType, sw-calibration-access=READ-ONLY, compu {0=NULL_PTR}, data-constr=SoAd_SocketUdpOfPCPartitionConfigType}
            TcpIpCtrlOfPCPartitionConfig: resulting-properties={base-type=SoAd_TcpIpCtrlOfPCPartitionConfigType, sw-calibration-access=READ-ONLY, compu {0=NULL_PTR}, data-constr=SoAd_TcpIpCtrlOfPCPartitionConfigType}
            TcpKeepAliveGloballyEnabledOfPCPartitionConfig: resulting-properties={base-type=SoAd_TcpKeepAliveGloballyEnabledOfPCPartitionConfigType, sw-calibration-access=READ-ONLY, compu {0=NULL_PTR}, data-constr=SoAd_TcpKeepAliveGloballyEnabledOfPCPartitionConfigType}
            TcpTxQueueOfPCPartitionConfig: resulting-properties={base-type=SoAd_TcpTxQueueOfPCPartitionConfigType, sw-calibration-access=READ-ONLY, compu {0=NULL_PTR}, data-constr=SoAd_TcpTxQueueOfPCPartitionConfigType}
            TcpTxQueueDataOfPCPartitionConfig: resulting-properties={base-type=SoAd_TcpTxQueueDataOfPCPartitionConfigType, sw-calibration-access=READ-ONLY, compu {0=NULL_PTR}, data-constr=SoAd_TcpTxQueueDataOfPCPartitionConfigType}
            TcpTxQueueMgtOfPCPartitionConfig: resulting-properties={base-type=SoAd_TcpTxQueueMgtOfPCPartitionConfigType, sw-calibration-access=READ-ONLY, compu {0=NULL_PTR}, data-constr=SoAd_TcpTxQueueMgtOfPCPartitionConfigType}
            TimeoutListIdentOfPCPartitionConfig: resulting-properties={base-type=SoAd_TimeoutListIdentOfPCPartitionConfigType, sw-calibration-access=READ-ONLY, compu {0=NULL_PTR}, data-constr=SoAd_TimeoutListIdentOfPCPartitionConfigType}
            TimeoutListMgmtOfPCPartitionConfig: resulting-properties={base-type=SoAd_TimeoutListMgmtOfPCPartitionConfigType, sw-calibration-access=READ-ONLY, compu {0=NULL_PTR}, data-constr=SoAd_TimeoutListMgmtOfPCPartitionConfigType}
            TimeoutListNPduUdpTxOfPCPartitionConfig: resulting-properties={base-type=SoAd_TimeoutListNPduUdpTxOfPCPartitionConfigType, sw-calibration-access=READ-ONLY, compu {0=NULL_PTR}, data-constr=SoAd_TimeoutListNPduUdpTxOfPCPartitionConfigType}
            TimeoutListNPduUdpTxConfigOfPCPartitionConfig: resulting-properties={base-type=SoAd_TimeoutListNPduUdpTxConfigOfPCPartitionConfigType, sw-calibration-access=READ-ONLY, compu {0=NULL_PTR}, data-constr=SoAd_TimeoutListNPduUdpTxConfigOfPCPartitionConfigType}
            TimeoutListNPduUdpTxMapOfPCPartitionConfig: resulting-properties={base-type=SoAd_TimeoutListNPduUdpTxMapOfPCPartitionConfigType, sw-calibration-access=READ-ONLY, compu {0=NULL_PTR}, data-constr=SoAd_TimeoutListNPduUdpTxMapOfPCPartitionConfigType}
            TimeoutListUdpAliveOfPCPartitionConfig: resulting-properties={base-type=SoAd_TimeoutListUdpAliveOfPCPartitionConfigType, sw-calibration-access=READ-ONLY, compu {0=NULL_PTR}, data-constr=SoAd_TimeoutListUdpAliveOfPCPartitionConfigType}
            TimeoutListUdpAliveConfigOfPCPartitionConfig: resulting-properties={base-type=SoAd_TimeoutListUdpAliveConfigOfPCPartitionConfigType, sw-calibration-access=READ-ONLY, compu {0=NULL_PTR}, data-constr=SoAd_TimeoutListUdpAliveConfigOfPCPartitionConfigType}
            TimeoutListUdpAliveMapOfPCPartitionConfig: resulting-properties={base-type=SoAd_TimeoutListUdpAliveMapOfPCPartitionConfigType, sw-calibration-access=READ-ONLY, compu {0=NULL_PTR}, data-constr=SoAd_TimeoutListUdpAliveMapOfPCPartitionConfigType}
            TpRxBufferOfPCPartitionConfig: resulting-properties={base-type=SoAd_TpRxBufferOfPCPartitionConfigType, sw-calibration-access=READ-ONLY, compu {0=NULL_PTR}, data-constr=SoAd_TpRxBufferOfPCPartitionConfigType}
            TpTxBufferOfPCPartitionConfig: resulting-properties={base-type=SoAd_TpTxBufferOfPCPartitionConfigType, sw-calibration-access=READ-ONLY, compu {0=NULL_PTR}, data-constr=SoAd_TpTxBufferOfPCPartitionConfigType}
            TpTxBufferConfigOfPCPartitionConfig: resulting-properties={base-type=SoAd_TpTxBufferConfigOfPCPartitionConfigType, sw-calibration-access=READ-ONLY, compu {0=NULL_PTR}, data-constr=SoAd_TpTxBufferConfigOfPCPartitionConfigType}
            TpTxBufferConfigDynOfPCPartitionConfig: resulting-properties={base-type=SoAd_TpTxBufferConfigDynOfPCPartitionConfigType, sw-calibration-access=READ-ONLY, compu {0=NULL_PTR}, data-constr=SoAd_TpTxBufferConfigDynOfPCPartitionConfigType}
            TriggerBufOfPCPartitionConfig: resulting-properties={base-type=SoAd_TriggerBufOfPCPartitionConfigType, sw-calibration-access=READ-ONLY, compu {0=NULL_PTR}, data-constr=SoAd_TriggerBufOfPCPartitionConfigType}
            TriggerBufConfigOfPCPartitionConfig: resulting-properties={base-type=SoAd_TriggerBufConfigOfPCPartitionConfigType, sw-calibration-access=READ-ONLY, compu {0=NULL_PTR}, data-constr=SoAd_TriggerBufConfigOfPCPartitionConfigType}
            TriggerBufConfigDynOfPCPartitionConfig: resulting-properties={base-type=SoAd_TriggerBufConfigDynOfPCPartitionConfigType, sw-calibration-access=READ-ONLY, compu {0=NULL_PTR}, data-constr=SoAd_TriggerBufConfigDynOfPCPartitionConfigType}
            TxMgtOfPCPartitionConfig: resulting-properties={base-type=SoAd_TxMgtOfPCPartitionConfigType, sw-calibration-access=READ-ONLY, compu {0=NULL_PTR}, data-constr=SoAd_TxMgtOfPCPartitionConfigType}
            TxPduIdMapOfPCPartitionConfig: resulting-properties={base-type=SoAd_TxPduIdMapOfPCPartitionConfigType, sw-calibration-access=READ-ONLY, compu {0=NULL_PTR}, data-constr=SoAd_TxPduIdMapOfPCPartitionConfigType}
            UpperLayerOfPCPartitionConfig: resulting-properties={base-type=SoAd_UpperLayerOfPCPartitionConfigType, sw-calibration-access=READ-ONLY, compu {0=NULL_PTR}, data-constr=SoAd_UpperLayerOfPCPartitionConfigType}
            MaxIfRouteGrpTransmitPduSizeOfPCPartitionConfig: resulting-properties={base-type=uint8, sw-calibration-access=READ-ONLY, range raw 0..255}
            SizeOfBestMatchSoConIdxListOfPCPartitionConfig: resulting-properties={base-type=uint8, sw-calibration-access=READ-ONLY, range raw 0..255}
            SizeOfDhcpEventCbkOfPCPartitionConfig: resulting-properties={base-type=uint8, sw-calibration-access=READ-ONLY, range raw 0..255}
            SizeOfEventQueueFlagOfPCPartitionConfig: resulting-properties={base-type=uint8, sw-calibration-access=READ-ONLY, range raw 0..255}
            SizeOfEventQueueIdentOfPCPartitionConfig: resulting-properties={base-type=uint8, sw-calibration-access=READ-ONLY, range raw 0..255}
            SizeOfEventQueueIfTxRouteGrpOfPCPartitionConfig: resulting-properties={base-type=uint8, sw-calibration-access=READ-ONLY, range raw 0..255}
            SizeOfEventQueueIfTxRouteGrpConfigOfPCPartitionConfig: resulting-properties={base-type=uint8, sw-calibration-access=READ-ONLY, range raw 0..255}
            SizeOfEventQueueIfUdpPduRouteOfPCPartitionConfig: resulting-properties={base-type=uint8, sw-calibration-access=READ-ONLY, range raw 0..255}
            SizeOfEventQueueIfUdpPduRouteConfigOfPCPartitionConfig: resulting-properties={base-type=uint8, sw-calibration-access=READ-ONLY, range raw 0..255}
            SizeOfEventQueueMgmtOfPCPartitionConfig: resulting-properties={base-type=uint8, sw-calibration-access=READ-ONLY, range raw 0..255}
            SizeOfEventQueueStateSoConOfPCPartitionConfig: resulting-properties={base-type=uint8, sw-calibration-access=READ-ONLY, range raw 0..255}
            SizeOfEventQueueStateSoConConfigOfPCPartitionConfig: resulting-properties={base-type=uint8, sw-calibration-access=READ-ONLY, range raw 0..255}
            SizeOfEventQueueTpRxSoConOfPCPartitionConfig: resulting-properties={base-type=uint8, sw-calibration-access=READ-ONLY, range raw 0..255}
            SizeOfEventQueueTpRxSoConConfigOfPCPartitionConfig: resulting-properties={base-type=uint8, sw-calibration-access=READ-ONLY, range raw 0..255}
            SizeOfEventQueueTpTxSoConOfPCPartitionConfig: resulting-properties={base-type=uint8, sw-calibration-access=READ-ONLY, range raw 0..255}
            SizeOfEventQueueTpTxSoConConfigOfPCPartitionConfig: resulting-properties={base-type=uint8, sw-calibration-access=READ-ONLY, range raw 0..255}
            SizeOfIfRxBufferOfPCPartitionConfig: resulting-properties={base-type=uint8, sw-calibration-access=READ-ONLY, range raw 0..255}
            SizeOfInstanceOfPCPartitionConfig: resulting-properties={base-type=uint8, sw-calibration-access=READ-ONLY, range raw 0..255}
            SizeOfInstanceMapOfPCPartitionConfig: resulting-properties={base-type=uint8, sw-calibration-access=READ-ONLY, range raw 0..255}
            SizeOfIpFragBufOfPCPartitionConfig: resulting-properties={base-type=uint8, sw-calibration-access=READ-ONLY, range raw 0..255}
            SizeOfIpFragBufConfigOfPCPartitionConfig: resulting-properties={base-type=uint8, sw-calibration-access=READ-ONLY, range raw 0..255}
            SizeOfIpFragMgtOfPCPartitionConfig: resulting-properties={base-type=uint8, sw-calibration-access=READ-ONLY, range raw 0..255}
            SizeOfLocalAddrOfPCPartitionConfig: resulting-properties={base-type=uint8, sw-calibration-access=READ-ONLY, range raw 0..255}
            SizeOfLocalAddrByTcpIpCtrlIndOfPCPartitionConfig: resulting-properties={base-type=uint8, sw-calibration-access=READ-ONLY, range raw 0..255}
            SizeOfLocalAddrIdMapOfPCPartitionConfig: resulting-properties={base-type=uint8, sw-calibration-access=READ-ONLY, range raw 0..255}
            SizeOfLocalIpAddrAssignmentChgCbkOfPCPartitionConfig: resulting-properties={base-type=uint8, sw-calibration-access=READ-ONLY, range raw 0..255}
            SizeOfLocalIpAddrAssignmentChgCbkIndOfPCPartitionConfig: resulting-properties={base-type=uint8, sw-calibration-access=READ-ONLY, range raw 0..255}
            SizeOfMetaDataRxBufOfPCPartitionConfig: resulting-properties={base-type=uint8, sw-calibration-access=READ-ONLY, range raw 0..255}
            SizeOfMetaDataRxBufConfigOfPCPartitionConfig: resulting-properties={base-type=uint8, sw-calibration-access=READ-ONLY, range raw 0..255}
            SizeOfNPduUdpTxOfPCPartitionConfig: resulting-properties={base-type=uint8, sw-calibration-access=READ-ONLY, range raw 0..255}
            SizeOfNPduUdpTxBufferOfPCPartitionConfig: resulting-properties={base-type=uint8, sw-calibration-access=READ-ONLY, range raw 0..255}
            SizeOfNPduUdpTxQueueOfPCPartitionConfig: resulting-properties={base-type=uint8, sw-calibration-access=READ-ONLY, range raw 0..255}
            SizeOfPartitionDynOfPCPartitionConfig: resulting-properties={base-type=uint8, sw-calibration-access=READ-ONLY, range raw 0..255}
            SizeOfPduRouteOfPCPartitionConfig: resulting-properties={base-type=uint8, sw-calibration-access=READ-ONLY, range raw 0..255}
            SizeOfPduRouteDestOfPCPartitionConfig: resulting-properties={base-type=uint8, sw-calibration-access=READ-ONLY, range raw 0..255}
            SizeOfPduRouteDestBySoConIndOfPCPartitionConfig: resulting-properties={base-type=uint8, sw-calibration-access=READ-ONLY, range raw 0..255}
            SizeOfPduRouteDestIndOfPCPartitionConfig: resulting-properties={base-type=uint8, sw-calibration-access=READ-ONLY, range raw 0..255}
            SizeOfRcvRemAddrOfPCPartitionConfig: resulting-properties={base-type=uint8, sw-calibration-access=READ-ONLY, range raw 0..255}
            SizeOfRemAddrIpV4OfPCPartitionConfig: resulting-properties={base-type=uint8, sw-calibration-access=READ-ONLY, range raw 0..255}
            SizeOfRemAddrIpV6OfPCPartitionConfig: resulting-properties={base-type=uint8, sw-calibration-access=READ-ONLY, range raw 0..255}
            SizeOfRouteGrpOfPCPartitionConfig: resulting-properties={base-type=uint8, sw-calibration-access=READ-ONLY, range raw 0..255}
            SizeOfRouteGrpIdMapOfPCPartitionConfig: resulting-properties={base-type=uint8, sw-calibration-access=READ-ONLY, range raw 0..255}
            SizeOfRouteGrpSoConOfPCPartitionConfig: resulting-properties={base-type=uint8, sw-calibration-access=READ-ONLY, range raw 0..255}
            SizeOfRouteGrpSoConByPduRouteDestIndOfPCPartitionConfig: resulting-properties={base-type=uint8, sw-calibration-access=READ-ONLY, range raw 0..255}
            SizeOfRouteGrpSoConBySocketRouteDestIndOfPCPartitionConfig: resulting-properties={base-type=uint8, sw-calibration-access=READ-ONLY, range raw 0..255}
            SizeOfRxBufStructMgtOfPCPartitionConfig: resulting-properties={base-type=uint8, sw-calibration-access=READ-ONLY, range raw 0..255}
            SizeOfRxBufStructSegOfPCPartitionConfig: resulting-properties={base-type=uint8, sw-calibration-access=READ-ONLY, range raw 0..255}
            SizeOfRxBufferConfigOfPCPartitionConfig: resulting-properties={base-type=uint8, sw-calibration-access=READ-ONLY, range raw 0..255}
            SizeOfRxMgtOfPCPartitionConfig: resulting-properties={base-type=uint8, sw-calibration-access=READ-ONLY, range raw 0..255}
            SizeOfRxPduIdIdMapOfPCPartitionConfig: resulting-properties={base-type=uint8, sw-calibration-access=READ-ONLY, range raw 0..255}
            SizeOfShutdownFinishedCbkOfPCPartitionConfig: resulting-properties={base-type=uint8, sw-calibration-access=READ-ONLY, range raw 0..255}
            SizeOfSoConOfPCPartitionConfig: resulting-properties={base-type=uint8, sw-calibration-access=READ-ONLY, range raw 0..255}
            SizeOfSoConGrpOfPCPartitionConfig: resulting-properties={base-type=uint8, sw-calibration-access=READ-ONLY, range raw 0..255}
            SizeOfSoConMapOfPCPartitionConfig: resulting-properties={base-type=uint8, sw-calibration-access=READ-ONLY, range raw 0..255}
            SizeOfSoConModeChgCbkOfPCPartitionConfig: resulting-properties={base-type=uint8, sw-calibration-access=READ-ONLY, range raw 0..255}
            SizeOfSoConModeChgCbkIndOfPCPartitionConfig: resulting-properties={base-type=uint8, sw-calibration-access=READ-ONLY, range raw 0..255}
            SizeOfSocketOfPCPartitionConfig: resulting-properties={base-type=uint8, sw-calibration-access=READ-ONLY, range raw 0..255}
            SizeOfSocketMapOfPCPartitionConfig: resulting-properties={base-type=uint8, sw-calibration-access=READ-ONLY, range raw 0..255}
            SizeOfSocketRouteOfPCPartitionConfig: resulting-properties={base-type=uint8, sw-calibration-access=READ-ONLY, range raw 0..255}
            SizeOfSocketRouteDestOfPCPartitionConfig: resulting-properties={base-type=uint8, sw-calibration-access=READ-ONLY, range raw 0..255}
            SizeOfSocketRouteIndOfPCPartitionConfig: resulting-properties={base-type=uint8, sw-calibration-access=READ-ONLY, range raw 0..255}
            SizeOfSocketTcpOfPCPartitionConfig: resulting-properties={base-type=uint8, sw-calibration-access=READ-ONLY, range raw 0..255}
            SizeOfSocketUdpOfPCPartitionConfig: resulting-properties={base-type=uint8, sw-calibration-access=READ-ONLY, range raw 0..255}
            SizeOfTcpIpCtrlOfPCPartitionConfig: resulting-properties={base-type=uint8, sw-calibration-access=READ-ONLY, range raw 0..255}
            SizeOfTcpKeepAliveGloballyEnabledOfPCPartitionConfig: resulting-properties={base-type=uint8, sw-calibration-access=READ-ONLY, range raw 0..255}
            SizeOfTcpTxQueueOfPCPartitionConfig: resulting-properties={base-type=uint8, sw-calibration-access=READ-ONLY, range raw 0..255}
            SizeOfTcpTxQueueDataOfPCPartitionConfig: resulting-properties={base-type=uint8, sw-calibration-access=READ-ONLY, range raw 0..255}
            SizeOfTimeoutListIdentOfPCPartitionConfig: resulting-properties={base-type=uint8, sw-calibration-access=READ-ONLY, range raw 0..255}
            SizeOfTimeoutListMgmtOfPCPartitionConfig: resulting-properties={base-type=uint8, sw-calibration-access=READ-ONLY, range raw 0..255}
            SizeOfTimeoutListNPduUdpTxOfPCPartitionConfig: resulting-properties={base-type=uint8, sw-calibration-access=READ-ONLY, range raw 0..255}
            SizeOfTimeoutListNPduUdpTxConfigOfPCPartitionConfig: resulting-properties={base-type=uint8, sw-calibration-access=READ-ONLY, range raw 0..255}
            SizeOfTimeoutListNPduUdpTxMapOfPCPartitionConfig: resulting-properties={base-type=uint8, sw-calibration-access=READ-ONLY, range raw 0..255}
            SizeOfTimeoutListUdpAliveOfPCPartitionConfig: resulting-properties={base-type=uint8, sw-calibration-access=READ-ONLY, range raw 0..255}
            SizeOfTimeoutListUdpAliveConfigOfPCPartitionConfig: resulting-properties={base-type=uint8, sw-calibration-access=READ-ONLY, range raw 0..255}
            SizeOfTimeoutListUdpAliveMapOfPCPartitionConfig: resulting-properties={base-type=uint8, sw-calibration-access=READ-ONLY, range raw 0..255}
            SizeOfTpRxBufferOfPCPartitionConfig: resulting-properties={base-type=uint8, sw-calibration-access=READ-ONLY, range raw 0..255}
            SizeOfTpTxBufferOfPCPartitionConfig: resulting-properties={base-type=uint8, sw-calibration-access=READ-ONLY, range raw 0..255}
            SizeOfTpTxBufferConfigOfPCPartitionConfig: resulting-properties={base-type=uint8, sw-calibration-access=READ-ONLY, range raw 0..255}
            SizeOfTriggerBufOfPCPartitionConfig: resulting-properties={base-type=uint8, sw-calibration-access=READ-ONLY, range raw 0..255}
            SizeOfTriggerBufConfigOfPCPartitionConfig: resulting-properties={base-type=uint8, sw-calibration-access=READ-ONLY, range raw 0..255}
            SizeOfTxMgtOfPCPartitionConfig: resulting-properties={base-type=uint8, sw-calibration-access=READ-ONLY, range raw 0..255}
            SizeOfTxPduIdMapOfPCPartitionConfig: resulting-properties={base-type=uint8, sw-calibration-access=READ-ONLY, range raw 0..255}
            SizeOfUpperLayerOfPCPartitionConfig: resulting-properties={base-type=uint8, sw-calibration-access=READ-ONLY, range raw 0..255}
        SoAd_PartitionIdentifiers: category=ARRAY, array-size=1  # the partition context in Config
          mc data instance Element_0: category=STRUCTURE, symbol=[0]
            mc data instance PartitionSNVOfPartitionIdentifiers: category=VALUE, resulting-properties={base-type=uint32, sw-calibration-access=READ-ONLY, range raw 0..4294967295}
        SoAd_RouteGrp: category=ARRAY, array-size=3  # the routing group configuration
          mc data instance Element_0: category=STRUCTURE, symbol=[0]
            5 x mc data instance, all with category=VALUE:
              MultiInstanceOnGrpOfRouteGrp: resulting-properties={base-type=boolean, sw-calibration-access=READ-ONLY, compu {0=FALSE, 1..255=TRUE}, range raw 0..1}
              PduRouteDestIndEndIdxOfRouteGrp: resulting-properties={base-type=uint8, sw-calibration-access=READ-ONLY, compu {255=SOAD_NO_PDUROUTEDESTINDENDIDXOFROUTEGRP}, range raw 0..255}
              PduRouteDestIndStartIdxOfRouteGrp: resulting-properties={base-type=uint8, sw-calibration-access=READ-ONLY, compu {255=SOAD_NO_PDUROUTEDESTINDSTARTIDXOFROUTEGRP}, range raw 0..255}
              SocketRouteIndEndIdxOfRouteGrp: resulting-properties={base-type=uint8, sw-calibration-access=READ-ONLY, compu {255=SOAD_NO_SOCKETROUTEINDENDIDXOFROUTEGRP}, range raw 0..255}
              SocketRouteIndStartIdxOfRouteGrp: resulting-properties={base-type=uint8, sw-calibration-access=READ-ONLY, compu {255=SOAD_NO_SOCKETROUTEINDSTARTIDXOFROUTEGRP}, range raw 0..255}
          mc data instance Element_1: category=STRUCTURE, symbol=[1]
            5 x mc data instance, all with category=VALUE:
              MultiInstanceOnGrpOfRouteGrp: resulting-properties={base-type=boolean, sw-calibration-access=READ-ONLY, compu {0=FALSE, 1..255=TRUE}, range raw 0..1}
              PduRouteDestIndEndIdxOfRouteGrp: resulting-properties={base-type=uint8, sw-calibration-access=READ-ONLY, compu {255=SOAD_NO_PDUROUTEDESTINDENDIDXOFROUTEGRP}, range raw 0..255}
              PduRouteDestIndStartIdxOfRouteGrp: resulting-properties={base-type=uint8, sw-calibration-access=READ-ONLY, compu {255=SOAD_NO_PDUROUTEDESTINDSTARTIDXOFROUTEGRP}, range raw 0..255}
              SocketRouteIndEndIdxOfRouteGrp: resulting-properties={base-type=uint8, sw-calibration-access=READ-ONLY, compu {255=SOAD_NO_SOCKETROUTEINDENDIDXOFROUTEGRP}, range raw 0..255}
              SocketRouteIndStartIdxOfRouteGrp: resulting-properties={base-type=uint8, sw-calibration-access=READ-ONLY, compu {255=SOAD_NO_SOCKETROUTEINDSTARTIDXOFROUTEGRP}, range raw 0..255}
          mc data instance Element_2: category=STRUCTURE, symbol=[2]
            5 x mc data instance, all with category=VALUE:
              MultiInstanceOnGrpOfRouteGrp: resulting-properties={base-type=boolean, sw-calibration-access=READ-ONLY, compu {0=FALSE, 1..255=TRUE}, range raw 0..1}
              PduRouteDestIndEndIdxOfRouteGrp: resulting-properties={base-type=uint8, sw-calibration-access=READ-ONLY, compu {255=SOAD_NO_PDUROUTEDESTINDENDIDXOFROUTEGRP}, range raw 0..255}
              PduRouteDestIndStartIdxOfRouteGrp: resulting-properties={base-type=uint8, sw-calibration-access=READ-ONLY, compu {255=SOAD_NO_PDUROUTEDESTINDSTARTIDXOFROUTEGRP}, range raw 0..255}
              SocketRouteIndEndIdxOfRouteGrp: resulting-properties={base-type=uint8, sw-calibration-access=READ-ONLY, compu {255=SOAD_NO_SOCKETROUTEINDENDIDXOFROUTEGRP}, range raw 0..255}
              SocketRouteIndStartIdxOfRouteGrp: resulting-properties={base-type=uint8, sw-calibration-access=READ-ONLY, compu {255=SOAD_NO_SOCKETROUTEINDSTARTIDXOFROUTEGRP}, range raw 0..255}
        SoAd_RouteGrpIdMap: category=ARRAY, array-size=3  # the partition-unspecific handle ID mapping to partition-specific SoAdRoutingGroupId
          mc data instance Element_0: category=STRUCTURE, symbol=[0]
            mc data instance InvalidHndOfRouteGrpIdMap: category=VALUE, resulting-properties={base-type=boolean, sw-calibration-access=READ-ONLY, compu {0=FALSE, 1..255=TRUE}, range raw 0..1}
            mc data instance PartitionSpecificRouteGrpIdxOfRouteGrpIdMap: category=VALUE, resulting-properties={base-type=uint8, sw-calibration-access=READ-ONLY, compu {255=SOAD_NO_PARTITIONSPECIFICROUTEGRPIDXOFROUTEGRPIDMAP}, range raw 0..255}
            mc data instance PartitionSpecificRouteGrpPartitionIdxOfRouteGrpIdMap: category=VALUE, resulting-properties={base-type=uint8, sw-calibration-access=READ-ONLY, compu {255=SOAD_NO_PARTITIONSPECIFICROUTEGRPPARTITIONIDXOFROUTEGRPIDMAP}, range raw 0..255}
          mc data instance Element_1: category=STRUCTURE, symbol=[1]
            mc data instance InvalidHndOfRouteGrpIdMap: category=VALUE, resulting-properties={base-type=boolean, sw-calibration-access=READ-ONLY, compu {0=FALSE, 1..255=TRUE}, range raw 0..1}
            mc data instance PartitionSpecificRouteGrpIdxOfRouteGrpIdMap: category=VALUE, resulting-properties={base-type=uint8, sw-calibration-access=READ-ONLY, compu {255=SOAD_NO_PARTITIONSPECIFICROUTEGRPIDXOFROUTEGRPIDMAP}, range raw 0..255}
            mc data instance PartitionSpecificRouteGrpPartitionIdxOfRouteGrpIdMap: category=VALUE, resulting-properties={base-type=uint8, sw-calibration-access=READ-ONLY, compu {255=SOAD_NO_PARTITIONSPECIFICROUTEGRPPARTITIONIDXOFROUTEGRPIDMAP}, range raw 0..255}
          mc data instance Element_2: category=STRUCTURE, symbol=[2]
            mc data instance InvalidHndOfRouteGrpIdMap: category=VALUE, resulting-properties={base-type=boolean, sw-calibration-access=READ-ONLY, compu {0=FALSE, 1..255=TRUE}, range raw 0..1}
            mc data instance PartitionSpecificRouteGrpIdxOfRouteGrpIdMap: category=VALUE, resulting-properties={base-type=uint8, sw-calibration-access=READ-ONLY, compu {255=SOAD_NO_PARTITIONSPECIFICROUTEGRPIDXOFROUTEGRPIDMAP}, range raw 0..255}
            mc data instance PartitionSpecificRouteGrpPartitionIdxOfRouteGrpIdMap: category=VALUE, resulting-properties={base-type=uint8, sw-calibration-access=READ-ONLY, compu {255=SOAD_NO_PARTITIONSPECIFICROUTEGRPPARTITIONIDXOFROUTEGRPIDMAP}, range raw 0..255}
        SoAd_RouteGrpSoCon: category=ARRAY, array-size=3  # the routing groups on the socket connections
          mc data instance Element_0: category=STRUCTURE, symbol=[0]
            mc data instance SoConIdxOfRouteGrpSoCon: category=VALUE, resulting-properties={base-type=uint8, sw-calibration-access=READ-ONLY, range raw 0..255}
          mc data instance Element_1: category=STRUCTURE, symbol=[1]
            mc data instance SoConIdxOfRouteGrpSoCon: category=VALUE, resulting-properties={base-type=uint8, sw-calibration-access=READ-ONLY, range raw 0..255}
          mc data instance Element_2: category=STRUCTURE, symbol=[2]
            mc data instance SoConIdxOfRouteGrpSoCon: category=VALUE, resulting-properties={base-type=uint8, sw-calibration-access=READ-ONLY, range raw 0..255}
        SoAd_RxPduIdIdMap: category=ARRAY, array-size=15  # the partition-unspecific handle ID mapping to partition-specific RxPduId
          15 x mc data instance, all with category=STRUCTURE:
            Element_0: symbol=[0]
              mc data instance InvalidHndOfRxPduIdIdMap: category=VALUE, resulting-properties={base-type=boolean, sw-calibration-access=READ-ONLY, compu {0=FALSE, 1..255=TRUE}, range raw 0..1}
              mc data instance PartitionSpecificSocketRouteDestIdxOfRxPduIdIdMap: category=VALUE, resulting-properties={base-type=uint8, sw-calibration-access=READ-ONLY, range raw 0..255}
              mc data instance PartitionSpecificSocketRouteDestPartitionIdxOfRxPduIdIdMap: category=VALUE, resulting-properties={base-type=uint8, sw-calibration-access=READ-ONLY, compu {255=SOAD_NO_PARTITIONSPECIFICSOCKETROUTEDESTPARTITIONIDXOFRXPDUIDIDMAP}, range raw 0..255}
            Element_1: symbol=[1]
              mc data instance InvalidHndOfRxPduIdIdMap: category=VALUE, resulting-properties={base-type=boolean, sw-calibration-access=READ-ONLY, compu {0=FALSE, 1..255=TRUE}, range raw 0..1}
              mc data instance PartitionSpecificSocketRouteDestIdxOfRxPduIdIdMap: category=VALUE, resulting-properties={base-type=uint8, sw-calibration-access=READ-ONLY, range raw 0..255}
              mc data instance PartitionSpecificSocketRouteDestPartitionIdxOfRxPduIdIdMap: category=VALUE, resulting-properties={base-type=uint8, sw-calibration-access=READ-ONLY, compu {255=SOAD_NO_PARTITIONSPECIFICSOCKETROUTEDESTPARTITIONIDXOFRXPDUIDIDMAP}, range raw 0..255}
            Element_2: symbol=[2]
              mc data instance InvalidHndOfRxPduIdIdMap: category=VALUE, resulting-properties={base-type=boolean, sw-calibration-access=READ-ONLY, compu {0=FALSE, 1..255=TRUE}, range raw 0..1}
              mc data instance PartitionSpecificSocketRouteDestIdxOfRxPduIdIdMap: category=VALUE, resulting-properties={base-type=uint8, sw-calibration-access=READ-ONLY, range raw 0..255}
              mc data instance PartitionSpecificSocketRouteDestPartitionIdxOfRxPduIdIdMap: category=VALUE, resulting-properties={base-type=uint8, sw-calibration-access=READ-ONLY, compu {255=SOAD_NO_PARTITIONSPECIFICSOCKETROUTEDESTPARTITIONIDXOFRXPDUIDIDMAP}, range raw 0..255}
            Element_3: symbol=[3]
              mc data instance InvalidHndOfRxPduIdIdMap: category=VALUE, resulting-properties={base-type=boolean, sw-calibration-access=READ-ONLY, compu {0=FALSE, 1..255=TRUE}, range raw 0..1}
              mc data instance PartitionSpecificSocketRouteDestIdxOfRxPduIdIdMap: category=VALUE, resulting-properties={base-type=uint8, sw-calibration-access=READ-ONLY, range raw 0..255}
              mc data instance PartitionSpecificSocketRouteDestPartitionIdxOfRxPduIdIdMap: category=VALUE, resulting-properties={base-type=uint8, sw-calibration-access=READ-ONLY, compu {255=SOAD_NO_PARTITIONSPECIFICSOCKETROUTEDESTPARTITIONIDXOFRXPDUIDIDMAP}, range raw 0..255}
            Element_4: symbol=[4]
              mc data instance InvalidHndOfRxPduIdIdMap: category=VALUE, resulting-properties={base-type=boolean, sw-calibration-access=READ-ONLY, compu {0=FALSE, 1..255=TRUE}, range raw 0..1}
              mc data instance PartitionSpecificSocketRouteDestIdxOfRxPduIdIdMap: category=VALUE, resulting-properties={base-type=uint8, sw-calibration-access=READ-ONLY, range raw 0..255}
              mc data instance PartitionSpecificSocketRouteDestPartitionIdxOfRxPduIdIdMap: category=VALUE, resulting-properties={base-type=uint8, sw-calibration-access=READ-ONLY, compu {255=SOAD_NO_PARTITIONSPECIFICSOCKETROUTEDESTPARTITIONIDXOFRXPDUIDIDMAP}, range raw 0..255}
            Element_5: symbol=[5]
              mc data instance InvalidHndOfRxPduIdIdMap: category=VALUE, resulting-properties={base-type=boolean, sw-calibration-access=READ-ONLY, compu {0=FALSE, 1..255=TRUE}, range raw 0..1}
              mc data instance PartitionSpecificSocketRouteDestIdxOfRxPduIdIdMap: category=VALUE, resulting-properties={base-type=uint8, sw-calibration-access=READ-ONLY, range raw 0..255}
              mc data instance PartitionSpecificSocketRouteDestPartitionIdxOfRxPduIdIdMap: category=VALUE, resulting-properties={base-type=uint8, sw-calibration-access=READ-ONLY, compu {255=SOAD_NO_PARTITIONSPECIFICSOCKETROUTEDESTPARTITIONIDXOFRXPDUIDIDMAP}, range raw 0..255}
            Element_6: symbol=[6]
              mc data instance InvalidHndOfRxPduIdIdMap: category=VALUE, resulting-properties={base-type=boolean, sw-calibration-access=READ-ONLY, compu {0=FALSE, 1..255=TRUE}, range raw 0..1}
              mc data instance PartitionSpecificSocketRouteDestIdxOfRxPduIdIdMap: category=VALUE, resulting-properties={base-type=uint8, sw-calibration-access=READ-ONLY, range raw 0..255}
              mc data instance PartitionSpecificSocketRouteDestPartitionIdxOfRxPduIdIdMap: category=VALUE, resulting-properties={base-type=uint8, sw-calibration-access=READ-ONLY, compu {255=SOAD_NO_PARTITIONSPECIFICSOCKETROUTEDESTPARTITIONIDXOFRXPDUIDIDMAP}, range raw 0..255}
            Element_7: symbol=[7]
              mc data instance InvalidHndOfRxPduIdIdMap: category=VALUE, resulting-properties={base-type=boolean, sw-calibration-access=READ-ONLY, compu {0=FALSE, 1..255=TRUE}, range raw 0..1}
              mc data instance PartitionSpecificSocketRouteDestIdxOfRxPduIdIdMap: category=VALUE, resulting-properties={base-type=uint8, sw-calibration-access=READ-ONLY, range raw 0..255}
              mc data instance PartitionSpecificSocketRouteDestPartitionIdxOfRxPduIdIdMap: category=VALUE, resulting-properties={base-type=uint8, sw-calibration-access=READ-ONLY, compu {255=SOAD_NO_PARTITIONSPECIFICSOCKETROUTEDESTPARTITIONIDXOFRXPDUIDIDMAP}, range raw 0..255}
            Element_8: symbol=[8]
              mc data instance InvalidHndOfRxPduIdIdMap: category=VALUE, resulting-properties={base-type=boolean, sw-calibration-access=READ-ONLY, compu {0=FALSE, 1..255=TRUE}, range raw 0..1}
              mc data instance PartitionSpecificSocketRouteDestIdxOfRxPduIdIdMap: category=VALUE, resulting-properties={base-type=uint8, sw-calibration-access=READ-ONLY, range raw 0..255}
              mc data instance PartitionSpecificSocketRouteDestPartitionIdxOfRxPduIdIdMap: category=VALUE, resulting-properties={base-type=uint8, sw-calibration-access=READ-ONLY, compu {255=SOAD_NO_PARTITIONSPECIFICSOCKETROUTEDESTPARTITIONIDXOFRXPDUIDIDMAP}, range raw 0..255}
            Element_9: symbol=[9]
              mc data instance InvalidHndOfRxPduIdIdMap: category=VALUE, resulting-properties={base-type=boolean, sw-calibration-access=READ-ONLY, compu {0=FALSE, 1..255=TRUE}, range raw 0..1}
              mc data instance PartitionSpecificSocketRouteDestIdxOfRxPduIdIdMap: category=VALUE, resulting-properties={base-type=uint8, sw-calibration-access=READ-ONLY, range raw 0..255}
              mc data instance PartitionSpecificSocketRouteDestPartitionIdxOfRxPduIdIdMap: category=VALUE, resulting-properties={base-type=uint8, sw-calibration-access=READ-ONLY, compu {255=SOAD_NO_PARTITIONSPECIFICSOCKETROUTEDESTPARTITIONIDXOFRXPDUIDIDMAP}, range raw 0..255}
            Element_10: symbol=[10]
              mc data instance InvalidHndOfRxPduIdIdMap: category=VALUE, resulting-properties={base-type=boolean, sw-calibration-access=READ-ONLY, compu {0=FALSE, 1..255=TRUE}, range raw 0..1}
              mc data instance PartitionSpecificSocketRouteDestIdxOfRxPduIdIdMap: category=VALUE, resulting-properties={base-type=uint8, sw-calibration-access=READ-ONLY, range raw 0..255}
              mc data instance PartitionSpecificSocketRouteDestPartitionIdxOfRxPduIdIdMap: category=VALUE, resulting-properties={base-type=uint8, sw-calibration-access=READ-ONLY, compu {255=SOAD_NO_PARTITIONSPECIFICSOCKETROUTEDESTPARTITIONIDXOFRXPDUIDIDMAP}, range raw 0..255}
            Element_11: symbol=[11]
              mc data instance InvalidHndOfRxPduIdIdMap: category=VALUE, resulting-properties={base-type=boolean, sw-calibration-access=READ-ONLY, compu {0=FALSE, 1..255=TRUE}, range raw 0..1}
              mc data instance PartitionSpecificSocketRouteDestIdxOfRxPduIdIdMap: category=VALUE, resulting-properties={base-type=uint8, sw-calibration-access=READ-ONLY, range raw 0..255}
              mc data instance PartitionSpecificSocketRouteDestPartitionIdxOfRxPduIdIdMap: category=VALUE, resulting-properties={base-type=uint8, sw-calibration-access=READ-ONLY, compu {255=SOAD_NO_PARTITIONSPECIFICSOCKETROUTEDESTPARTITIONIDXOFRXPDUIDIDMAP}, range raw 0..255}
            Element_12: symbol=[12]
              mc data instance InvalidHndOfRxPduIdIdMap: category=VALUE, resulting-properties={base-type=boolean, sw-calibration-access=READ-ONLY, compu {0=FALSE, 1..255=TRUE}, range raw 0..1}
              mc data instance PartitionSpecificSocketRouteDestIdxOfRxPduIdIdMap: category=VALUE, resulting-properties={base-type=uint8, sw-calibration-access=READ-ONLY, range raw 0..255}
              mc data instance PartitionSpecificSocketRouteDestPartitionIdxOfRxPduIdIdMap: category=VALUE, resulting-properties={base-type=uint8, sw-calibration-access=READ-ONLY, compu {255=SOAD_NO_PARTITIONSPECIFICSOCKETROUTEDESTPARTITIONIDXOFRXPDUIDIDMAP}, range raw 0..255}
            Element_13: symbol=[13]
              mc data instance InvalidHndOfRxPduIdIdMap: category=VALUE, resulting-properties={base-type=boolean, sw-calibration-access=READ-ONLY, compu {0=FALSE, 1..255=TRUE}, range raw 0..1}
              mc data instance PartitionSpecificSocketRouteDestIdxOfRxPduIdIdMap: category=VALUE, resulting-properties={base-type=uint8, sw-calibration-access=READ-ONLY, range raw 0..255}
              mc data instance PartitionSpecificSocketRouteDestPartitionIdxOfRxPduIdIdMap: category=VALUE, resulting-properties={base-type=uint8, sw-calibration-access=READ-ONLY, compu {255=SOAD_NO_PARTITIONSPECIFICSOCKETROUTEDESTPARTITIONIDXOFRXPDUIDIDMAP}, range raw 0..255}
            Element_14: symbol=[14]
              mc data instance InvalidHndOfRxPduIdIdMap: category=VALUE, resulting-properties={base-type=boolean, sw-calibration-access=READ-ONLY, compu {0=FALSE, 1..255=TRUE}, range raw 0..1}
              mc data instance PartitionSpecificSocketRouteDestIdxOfRxPduIdIdMap: category=VALUE, resulting-properties={base-type=uint8, sw-calibration-access=READ-ONLY, range raw 0..255}
              mc data instance PartitionSpecificSocketRouteDestPartitionIdxOfRxPduIdIdMap: category=VALUE, resulting-properties={base-type=uint8, sw-calibration-access=READ-ONLY, compu {255=SOAD_NO_PARTITIONSPECIFICSOCKETROUTEDESTPARTITIONIDXOFRXPDUIDIDMAP}, range raw 0..255}
        SoAd_SoConMap: category=ARRAY, array-size=14  # the partition-unspecific handle ID mapping to partition-specific SoAdSocketId
          14 x mc data instance, all with category=STRUCTURE:
            Element_0: symbol=[0]
              mc data instance InvalidHndOfSoConMap: category=VALUE, resulting-properties={base-type=boolean, sw-calibration-access=READ-ONLY, compu {0=FALSE, 1..255=TRUE}, range raw 0..1}
              mc data instance PartitionSpecificSoConIdxOfSoConMap: category=VALUE, resulting-properties={base-type=uint8, sw-calibration-access=READ-ONLY, range raw 0..255}
              mc data instance PartitionSpecificSoConPartitionIdxOfSoConMap: category=VALUE, resulting-properties={base-type=uint8, sw-calibration-access=READ-ONLY, compu {255=SOAD_NO_PARTITIONSPECIFICSOCONPARTITIONIDXOFSOCONMAP}, range raw 0..255}
            Element_1: symbol=[1]
              mc data instance InvalidHndOfSoConMap: category=VALUE, resulting-properties={base-type=boolean, sw-calibration-access=READ-ONLY, compu {0=FALSE, 1..255=TRUE}, range raw 0..1}
              mc data instance PartitionSpecificSoConIdxOfSoConMap: category=VALUE, resulting-properties={base-type=uint8, sw-calibration-access=READ-ONLY, range raw 0..255}
              mc data instance PartitionSpecificSoConPartitionIdxOfSoConMap: category=VALUE, resulting-properties={base-type=uint8, sw-calibration-access=READ-ONLY, compu {255=SOAD_NO_PARTITIONSPECIFICSOCONPARTITIONIDXOFSOCONMAP}, range raw 0..255}
            Element_2: symbol=[2]
              mc data instance InvalidHndOfSoConMap: category=VALUE, resulting-properties={base-type=boolean, sw-calibration-access=READ-ONLY, compu {0=FALSE, 1..255=TRUE}, range raw 0..1}
              mc data instance PartitionSpecificSoConIdxOfSoConMap: category=VALUE, resulting-properties={base-type=uint8, sw-calibration-access=READ-ONLY, range raw 0..255}
              mc data instance PartitionSpecificSoConPartitionIdxOfSoConMap: category=VALUE, resulting-properties={base-type=uint8, sw-calibration-access=READ-ONLY, compu {255=SOAD_NO_PARTITIONSPECIFICSOCONPARTITIONIDXOFSOCONMAP}, range raw 0..255}
            Element_3: symbol=[3]
              mc data instance InvalidHndOfSoConMap: category=VALUE, resulting-properties={base-type=boolean, sw-calibration-access=READ-ONLY, compu {0=FALSE, 1..255=TRUE}, range raw 0..1}
              mc data instance PartitionSpecificSoConIdxOfSoConMap: category=VALUE, resulting-properties={base-type=uint8, sw-calibration-access=READ-ONLY, range raw 0..255}
              mc data instance PartitionSpecificSoConPartitionIdxOfSoConMap: category=VALUE, resulting-properties={base-type=uint8, sw-calibration-access=READ-ONLY, compu {255=SOAD_NO_PARTITIONSPECIFICSOCONPARTITIONIDXOFSOCONMAP}, range raw 0..255}
            Element_4: symbol=[4]
              mc data instance InvalidHndOfSoConMap: category=VALUE, resulting-properties={base-type=boolean, sw-calibration-access=READ-ONLY, compu {0=FALSE, 1..255=TRUE}, range raw 0..1}
              mc data instance PartitionSpecificSoConIdxOfSoConMap: category=VALUE, resulting-properties={base-type=uint8, sw-calibration-access=READ-ONLY, range raw 0..255}
              mc data instance PartitionSpecificSoConPartitionIdxOfSoConMap: category=VALUE, resulting-properties={base-type=uint8, sw-calibration-access=READ-ONLY, compu {255=SOAD_NO_PARTITIONSPECIFICSOCONPARTITIONIDXOFSOCONMAP}, range raw 0..255}
            Element_5: symbol=[5]
              mc data instance InvalidHndOfSoConMap: category=VALUE, resulting-properties={base-type=boolean, sw-calibration-access=READ-ONLY, compu {0=FALSE, 1..255=TRUE}, range raw 0..1}
              mc data instance PartitionSpecificSoConIdxOfSoConMap: category=VALUE, resulting-properties={base-type=uint8, sw-calibration-access=READ-ONLY, range raw 0..255}
              mc data instance PartitionSpecificSoConPartitionIdxOfSoConMap: category=VALUE, resulting-properties={base-type=uint8, sw-calibration-access=READ-ONLY, compu {255=SOAD_NO_PARTITIONSPECIFICSOCONPARTITIONIDXOFSOCONMAP}, range raw 0..255}
            Element_6: symbol=[6]
              mc data instance InvalidHndOfSoConMap: category=VALUE, resulting-properties={base-type=boolean, sw-calibration-access=READ-ONLY, compu {0=FALSE, 1..255=TRUE}, range raw 0..1}
              mc data instance PartitionSpecificSoConIdxOfSoConMap: category=VALUE, resulting-properties={base-type=uint8, sw-calibration-access=READ-ONLY, range raw 0..255}
              mc data instance PartitionSpecificSoConPartitionIdxOfSoConMap: category=VALUE, resulting-properties={base-type=uint8, sw-calibration-access=READ-ONLY, compu {255=SOAD_NO_PARTITIONSPECIFICSOCONPARTITIONIDXOFSOCONMAP}, range raw 0..255}
            Element_7: symbol=[7]
              mc data instance InvalidHndOfSoConMap: category=VALUE, resulting-properties={base-type=boolean, sw-calibration-access=READ-ONLY, compu {0=FALSE, 1..255=TRUE}, range raw 0..1}
              mc data instance PartitionSpecificSoConIdxOfSoConMap: category=VALUE, resulting-properties={base-type=uint8, sw-calibration-access=READ-ONLY, range raw 0..255}
              mc data instance PartitionSpecificSoConPartitionIdxOfSoConMap: category=VALUE, resulting-properties={base-type=uint8, sw-calibration-access=READ-ONLY, compu {255=SOAD_NO_PARTITIONSPECIFICSOCONPARTITIONIDXOFSOCONMAP}, range raw 0..255}
            Element_8: symbol=[8]
              mc data instance InvalidHndOfSoConMap: category=VALUE, resulting-properties={base-type=boolean, sw-calibration-access=READ-ONLY, compu {0=FALSE, 1..255=TRUE}, range raw 0..1}
              mc data instance PartitionSpecificSoConIdxOfSoConMap: category=VALUE, resulting-properties={base-type=uint8, sw-calibration-access=READ-ONLY, range raw 0..255}
              mc data instance PartitionSpecificSoConPartitionIdxOfSoConMap: category=VALUE, resulting-properties={base-type=uint8, sw-calibration-access=READ-ONLY, compu {255=SOAD_NO_PARTITIONSPECIFICSOCONPARTITIONIDXOFSOCONMAP}, range raw 0..255}
            Element_9: symbol=[9]
              mc data instance InvalidHndOfSoConMap: category=VALUE, resulting-properties={base-type=boolean, sw-calibration-access=READ-ONLY, compu {0=FALSE, 1..255=TRUE}, range raw 0..1}
              mc data instance PartitionSpecificSoConIdxOfSoConMap: category=VALUE, resulting-properties={base-type=uint8, sw-calibration-access=READ-ONLY, range raw 0..255}
              mc data instance PartitionSpecificSoConPartitionIdxOfSoConMap: category=VALUE, resulting-properties={base-type=uint8, sw-calibration-access=READ-ONLY, compu {255=SOAD_NO_PARTITIONSPECIFICSOCONPARTITIONIDXOFSOCONMAP}, range raw 0..255}
            Element_10: symbol=[10]
              mc data instance InvalidHndOfSoConMap: category=VALUE, resulting-properties={base-type=boolean, sw-calibration-access=READ-ONLY, compu {0=FALSE, 1..255=TRUE}, range raw 0..1}
              mc data instance PartitionSpecificSoConIdxOfSoConMap: category=VALUE, resulting-properties={base-type=uint8, sw-calibration-access=READ-ONLY, range raw 0..255}
              mc data instance PartitionSpecificSoConPartitionIdxOfSoConMap: category=VALUE, resulting-properties={base-type=uint8, sw-calibration-access=READ-ONLY, compu {255=SOAD_NO_PARTITIONSPECIFICSOCONPARTITIONIDXOFSOCONMAP}, range raw 0..255}
            Element_11: symbol=[11]
              mc data instance InvalidHndOfSoConMap: category=VALUE, resulting-properties={base-type=boolean, sw-calibration-access=READ-ONLY, compu {0=FALSE, 1..255=TRUE}, range raw 0..1}
              mc data instance PartitionSpecificSoConIdxOfSoConMap: category=VALUE, resulting-properties={base-type=uint8, sw-calibration-access=READ-ONLY, range raw 0..255}
              mc data instance PartitionSpecificSoConPartitionIdxOfSoConMap: category=VALUE, resulting-properties={base-type=uint8, sw-calibration-access=READ-ONLY, compu {255=SOAD_NO_PARTITIONSPECIFICSOCONPARTITIONIDXOFSOCONMAP}, range raw 0..255}
            Element_12: symbol=[12]
              mc data instance InvalidHndOfSoConMap: category=VALUE, resulting-properties={base-type=boolean, sw-calibration-access=READ-ONLY, compu {0=FALSE, 1..255=TRUE}, range raw 0..1}
              mc data instance PartitionSpecificSoConIdxOfSoConMap: category=VALUE, resulting-properties={base-type=uint8, sw-calibration-access=READ-ONLY, range raw 0..255}
              mc data instance PartitionSpecificSoConPartitionIdxOfSoConMap: category=VALUE, resulting-properties={base-type=uint8, sw-calibration-access=READ-ONLY, compu {255=SOAD_NO_PARTITIONSPECIFICSOCONPARTITIONIDXOFSOCONMAP}, range raw 0..255}
            Element_13: symbol=[13]
              mc data instance InvalidHndOfSoConMap: category=VALUE, resulting-properties={base-type=boolean, sw-calibration-access=READ-ONLY, compu {0=FALSE, 1..255=TRUE}, range raw 0..1}
              mc data instance PartitionSpecificSoConIdxOfSoConMap: category=VALUE, resulting-properties={base-type=uint8, sw-calibration-access=READ-ONLY, range raw 0..255}
              mc data instance PartitionSpecificSoConPartitionIdxOfSoConMap: category=VALUE, resulting-properties={base-type=uint8, sw-calibration-access=READ-ONLY, compu {255=SOAD_NO_PARTITIONSPECIFICSOCONPARTITIONIDXOFSOCONMAP}, range raw 0..255}
        SoAd_Socket: category=ARRAY, array-size=14  # the socket configuration
          14 x mc data instance, all with category=STRUCTURE:
            Element_0: symbol=[0]
              mc data instance SoConEndIdxOfSocket: category=VALUE, resulting-properties={base-type=uint8, sw-calibration-access=READ-ONLY, range raw 0..255}
              mc data instance SoConStartIdxOfSocket: category=VALUE, resulting-properties={base-type=uint8, sw-calibration-access=READ-ONLY, range raw 0..255}
            Element_1: symbol=[1]
              mc data instance SoConEndIdxOfSocket: category=VALUE, resulting-properties={base-type=uint8, sw-calibration-access=READ-ONLY, range raw 0..255}
              mc data instance SoConStartIdxOfSocket: category=VALUE, resulting-properties={base-type=uint8, sw-calibration-access=READ-ONLY, range raw 0..255}
            Element_2: symbol=[2]
              mc data instance SoConEndIdxOfSocket: category=VALUE, resulting-properties={base-type=uint8, sw-calibration-access=READ-ONLY, range raw 0..255}
              mc data instance SoConStartIdxOfSocket: category=VALUE, resulting-properties={base-type=uint8, sw-calibration-access=READ-ONLY, range raw 0..255}
            Element_3: symbol=[3]
              mc data instance SoConEndIdxOfSocket: category=VALUE, resulting-properties={base-type=uint8, sw-calibration-access=READ-ONLY, range raw 0..255}
              mc data instance SoConStartIdxOfSocket: category=VALUE, resulting-properties={base-type=uint8, sw-calibration-access=READ-ONLY, range raw 0..255}
            Element_4: symbol=[4]
              mc data instance SoConEndIdxOfSocket: category=VALUE, resulting-properties={base-type=uint8, sw-calibration-access=READ-ONLY, range raw 0..255}
              mc data instance SoConStartIdxOfSocket: category=VALUE, resulting-properties={base-type=uint8, sw-calibration-access=READ-ONLY, range raw 0..255}
            Element_5: symbol=[5]
              mc data instance SoConEndIdxOfSocket: category=VALUE, resulting-properties={base-type=uint8, sw-calibration-access=READ-ONLY, range raw 0..255}
              mc data instance SoConStartIdxOfSocket: category=VALUE, resulting-properties={base-type=uint8, sw-calibration-access=READ-ONLY, range raw 0..255}
            Element_6: symbol=[6]
              mc data instance SoConEndIdxOfSocket: category=VALUE, resulting-properties={base-type=uint8, sw-calibration-access=READ-ONLY, range raw 0..255}
              mc data instance SoConStartIdxOfSocket: category=VALUE, resulting-properties={base-type=uint8, sw-calibration-access=READ-ONLY, range raw 0..255}
            Element_7: symbol=[7]
              mc data instance SoConEndIdxOfSocket: category=VALUE, resulting-properties={base-type=uint8, sw-calibration-access=READ-ONLY, range raw 0..255}
              mc data instance SoConStartIdxOfSocket: category=VALUE, resulting-properties={base-type=uint8, sw-calibration-access=READ-ONLY, range raw 0..255}
            Element_8: symbol=[8]
              mc data instance SoConEndIdxOfSocket: category=VALUE, resulting-properties={base-type=uint8, sw-calibration-access=READ-ONLY, range raw 0..255}
              mc data instance SoConStartIdxOfSocket: category=VALUE, resulting-properties={base-type=uint8, sw-calibration-access=READ-ONLY, range raw 0..255}
            Element_9: symbol=[9]
              mc data instance SoConEndIdxOfSocket: category=VALUE, resulting-properties={base-type=uint8, sw-calibration-access=READ-ONLY, range raw 0..255}
              mc data instance SoConStartIdxOfSocket: category=VALUE, resulting-properties={base-type=uint8, sw-calibration-access=READ-ONLY, range raw 0..255}
            Element_10: symbol=[10]
              mc data instance SoConEndIdxOfSocket: category=VALUE, resulting-properties={base-type=uint8, sw-calibration-access=READ-ONLY, range raw 0..255}
              mc data instance SoConStartIdxOfSocket: category=VALUE, resulting-properties={base-type=uint8, sw-calibration-access=READ-ONLY, range raw 0..255}
            Element_11: symbol=[11]
              mc data instance SoConEndIdxOfSocket: category=VALUE, resulting-properties={base-type=uint8, sw-calibration-access=READ-ONLY, range raw 0..255}
              mc data instance SoConStartIdxOfSocket: category=VALUE, resulting-properties={base-type=uint8, sw-calibration-access=READ-ONLY, range raw 0..255}
            Element_12: symbol=[12]
              mc data instance SoConEndIdxOfSocket: category=VALUE, resulting-properties={base-type=uint8, sw-calibration-access=READ-ONLY, range raw 0..255}
              mc data instance SoConStartIdxOfSocket: category=VALUE, resulting-properties={base-type=uint8, sw-calibration-access=READ-ONLY, range raw 0..255}
            Element_13: symbol=[13]
              mc data instance SoConEndIdxOfSocket: category=VALUE, resulting-properties={base-type=uint8, sw-calibration-access=READ-ONLY, range raw 0..255}
              mc data instance SoConStartIdxOfSocket: category=VALUE, resulting-properties={base-type=uint8, sw-calibration-access=READ-ONLY, range raw 0..255}
        SoAd_SocketMap: category=ARRAY, array-size=14  # the socket map configuration
          14 x mc data instance, all with category=STRUCTURE:
            Element_0: symbol=[0]
              mc data instance PartitionSpecificSocketPartitionIdxOfSocketMap: category=VALUE, resulting-properties={base-type=uint8, sw-calibration-access=READ-ONLY, compu {255=SOAD_NO_PARTITIONSPECIFICSOCKETPARTITIONIDXOFSOCKETMAP}, range raw 0..255}
            Element_1: symbol=[1]
              mc data instance PartitionSpecificSocketPartitionIdxOfSocketMap: category=VALUE, resulting-properties={base-type=uint8, sw-calibration-access=READ-ONLY, compu {255=SOAD_NO_PARTITIONSPECIFICSOCKETPARTITIONIDXOFSOCKETMAP}, range raw 0..255}
            Element_2: symbol=[2]
              mc data instance PartitionSpecificSocketPartitionIdxOfSocketMap: category=VALUE, resulting-properties={base-type=uint8, sw-calibration-access=READ-ONLY, compu {255=SOAD_NO_PARTITIONSPECIFICSOCKETPARTITIONIDXOFSOCKETMAP}, range raw 0..255}
            Element_3: symbol=[3]
              mc data instance PartitionSpecificSocketPartitionIdxOfSocketMap: category=VALUE, resulting-properties={base-type=uint8, sw-calibration-access=READ-ONLY, compu {255=SOAD_NO_PARTITIONSPECIFICSOCKETPARTITIONIDXOFSOCKETMAP}, range raw 0..255}
            Element_4: symbol=[4]
              mc data instance PartitionSpecificSocketPartitionIdxOfSocketMap: category=VALUE, resulting-properties={base-type=uint8, sw-calibration-access=READ-ONLY, compu {255=SOAD_NO_PARTITIONSPECIFICSOCKETPARTITIONIDXOFSOCKETMAP}, range raw 0..255}
            Element_5: symbol=[5]
              mc data instance PartitionSpecificSocketPartitionIdxOfSocketMap: category=VALUE, resulting-properties={base-type=uint8, sw-calibration-access=READ-ONLY, compu {255=SOAD_NO_PARTITIONSPECIFICSOCKETPARTITIONIDXOFSOCKETMAP}, range raw 0..255}
            Element_6: symbol=[6]
              mc data instance PartitionSpecificSocketPartitionIdxOfSocketMap: category=VALUE, resulting-properties={base-type=uint8, sw-calibration-access=READ-ONLY, compu {255=SOAD_NO_PARTITIONSPECIFICSOCKETPARTITIONIDXOFSOCKETMAP}, range raw 0..255}
            Element_7: symbol=[7]
              mc data instance PartitionSpecificSocketPartitionIdxOfSocketMap: category=VALUE, resulting-properties={base-type=uint8, sw-calibration-access=READ-ONLY, compu {255=SOAD_NO_PARTITIONSPECIFICSOCKETPARTITIONIDXOFSOCKETMAP}, range raw 0..255}
            Element_8: symbol=[8]
              mc data instance PartitionSpecificSocketPartitionIdxOfSocketMap: category=VALUE, resulting-properties={base-type=uint8, sw-calibration-access=READ-ONLY, compu {255=SOAD_NO_PARTITIONSPECIFICSOCKETPARTITIONIDXOFSOCKETMAP}, range raw 0..255}
            Element_9: symbol=[9]
              mc data instance PartitionSpecificSocketPartitionIdxOfSocketMap: category=VALUE, resulting-properties={base-type=uint8, sw-calibration-access=READ-ONLY, compu {255=SOAD_NO_PARTITIONSPECIFICSOCKETPARTITIONIDXOFSOCKETMAP}, range raw 0..255}
            Element_10: symbol=[10]
              mc data instance PartitionSpecificSocketPartitionIdxOfSocketMap: category=VALUE, resulting-properties={base-type=uint8, sw-calibration-access=READ-ONLY, compu {255=SOAD_NO_PARTITIONSPECIFICSOCKETPARTITIONIDXOFSOCKETMAP}, range raw 0..255}
            Element_11: symbol=[11]
              mc data instance PartitionSpecificSocketPartitionIdxOfSocketMap: category=VALUE, resulting-properties={base-type=uint8, sw-calibration-access=READ-ONLY, compu {255=SOAD_NO_PARTITIONSPECIFICSOCKETPARTITIONIDXOFSOCKETMAP}, range raw 0..255}
            Element_12: symbol=[12]
              mc data instance PartitionSpecificSocketPartitionIdxOfSocketMap: category=VALUE, resulting-properties={base-type=uint8, sw-calibration-access=READ-ONLY, compu {255=SOAD_NO_PARTITIONSPECIFICSOCKETPARTITIONIDXOFSOCKETMAP}, range raw 0..255}
            Element_13: symbol=[13]
              mc data instance PartitionSpecificSocketPartitionIdxOfSocketMap: category=VALUE, resulting-properties={base-type=uint8, sw-calibration-access=READ-ONLY, compu {255=SOAD_NO_PARTITIONSPECIFICSOCKETPARTITIONIDXOFSOCKETMAP}, range raw 0..255}
        SoAd_SocketRouteDest: category=ARRAY, array-size=15  # the socket route destination configuration
          15 x mc data instance, all with category=STRUCTURE:
            Element_0: symbol=[0]
              4 x mc data instance, all with category=VALUE:
                RxPduIdOfSocketRouteDest: resulting-properties={base-type=uint8, sw-calibration-access=READ-ONLY, range raw 0..255}
                RouteGrpSoConBySocketRouteDestIndEndIdxOfSocketRouteDest: resulting-properties={base-type=uint8, sw-calibration-access=READ-ONLY, compu {255=SOAD_NO_ROUTEGRPSOCONBYSOCKETROUTEDESTINDENDIDXOFSOCKETROUTEDEST}, range raw 0..255}
                RouteGrpSoConBySocketRouteDestIndStartIdxOfSocketRouteDest: resulting-properties={base-type=uint8, sw-calibration-access=READ-ONLY, compu {255=SOAD_NO_ROUTEGRPSOCONBYSOCKETROUTEDESTINDSTARTIDXOFSOCKETROUTEDEST}, range raw 0..255}
                UpperLayerIdxOfSocketRouteDest: resulting-properties={base-type=uint8, sw-calibration-access=READ-ONLY, range raw 0..255}
            Element_1: symbol=[1]
              4 x mc data instance, all with category=VALUE:
                RxPduIdOfSocketRouteDest: resulting-properties={base-type=uint8, sw-calibration-access=READ-ONLY, range raw 0..255}
                RouteGrpSoConBySocketRouteDestIndEndIdxOfSocketRouteDest: resulting-properties={base-type=uint8, sw-calibration-access=READ-ONLY, compu {255=SOAD_NO_ROUTEGRPSOCONBYSOCKETROUTEDESTINDENDIDXOFSOCKETROUTEDEST}, range raw 0..255}
                RouteGrpSoConBySocketRouteDestIndStartIdxOfSocketRouteDest: resulting-properties={base-type=uint8, sw-calibration-access=READ-ONLY, compu {255=SOAD_NO_ROUTEGRPSOCONBYSOCKETROUTEDESTINDSTARTIDXOFSOCKETROUTEDEST}, range raw 0..255}
                UpperLayerIdxOfSocketRouteDest: resulting-properties={base-type=uint8, sw-calibration-access=READ-ONLY, range raw 0..255}
            Element_2: symbol=[2]
              4 x mc data instance, all with category=VALUE:
                RxPduIdOfSocketRouteDest: resulting-properties={base-type=uint8, sw-calibration-access=READ-ONLY, range raw 0..255}
                RouteGrpSoConBySocketRouteDestIndEndIdxOfSocketRouteDest: resulting-properties={base-type=uint8, sw-calibration-access=READ-ONLY, compu {255=SOAD_NO_ROUTEGRPSOCONBYSOCKETROUTEDESTINDENDIDXOFSOCKETROUTEDEST}, range raw 0..255}
                RouteGrpSoConBySocketRouteDestIndStartIdxOfSocketRouteDest: resulting-properties={base-type=uint8, sw-calibration-access=READ-ONLY, compu {255=SOAD_NO_ROUTEGRPSOCONBYSOCKETROUTEDESTINDSTARTIDXOFSOCKETROUTEDEST}, range raw 0..255}
                UpperLayerIdxOfSocketRouteDest: resulting-properties={base-type=uint8, sw-calibration-access=READ-ONLY, range raw 0..255}
            Element_3: symbol=[3]
              4 x mc data instance, all with category=VALUE:
                RxPduIdOfSocketRouteDest: resulting-properties={base-type=uint8, sw-calibration-access=READ-ONLY, range raw 0..255}
                RouteGrpSoConBySocketRouteDestIndEndIdxOfSocketRouteDest: resulting-properties={base-type=uint8, sw-calibration-access=READ-ONLY, compu {255=SOAD_NO_ROUTEGRPSOCONBYSOCKETROUTEDESTINDENDIDXOFSOCKETROUTEDEST}, range raw 0..255}
                RouteGrpSoConBySocketRouteDestIndStartIdxOfSocketRouteDest: resulting-properties={base-type=uint8, sw-calibration-access=READ-ONLY, compu {255=SOAD_NO_ROUTEGRPSOCONBYSOCKETROUTEDESTINDSTARTIDXOFSOCKETROUTEDEST}, range raw 0..255}
                UpperLayerIdxOfSocketRouteDest: resulting-properties={base-type=uint8, sw-calibration-access=READ-ONLY, range raw 0..255}
            Element_4: symbol=[4]
              4 x mc data instance, all with category=VALUE:
                RxPduIdOfSocketRouteDest: resulting-properties={base-type=uint8, sw-calibration-access=READ-ONLY, range raw 0..255}
                RouteGrpSoConBySocketRouteDestIndEndIdxOfSocketRouteDest: resulting-properties={base-type=uint8, sw-calibration-access=READ-ONLY, compu {255=SOAD_NO_ROUTEGRPSOCONBYSOCKETROUTEDESTINDENDIDXOFSOCKETROUTEDEST}, range raw 0..255}
                RouteGrpSoConBySocketRouteDestIndStartIdxOfSocketRouteDest: resulting-properties={base-type=uint8, sw-calibration-access=READ-ONLY, compu {255=SOAD_NO_ROUTEGRPSOCONBYSOCKETROUTEDESTINDSTARTIDXOFSOCKETROUTEDEST}, range raw 0..255}
                UpperLayerIdxOfSocketRouteDest: resulting-properties={base-type=uint8, sw-calibration-access=READ-ONLY, range raw 0..255}
            Element_5: symbol=[5]
              4 x mc data instance, all with category=VALUE:
                RxPduIdOfSocketRouteDest: resulting-properties={base-type=uint8, sw-calibration-access=READ-ONLY, range raw 0..255}
                RouteGrpSoConBySocketRouteDestIndEndIdxOfSocketRouteDest: resulting-properties={base-type=uint8, sw-calibration-access=READ-ONLY, compu {255=SOAD_NO_ROUTEGRPSOCONBYSOCKETROUTEDESTINDENDIDXOFSOCKETROUTEDEST}, range raw 0..255}
                RouteGrpSoConBySocketRouteDestIndStartIdxOfSocketRouteDest: resulting-properties={base-type=uint8, sw-calibration-access=READ-ONLY, compu {255=SOAD_NO_ROUTEGRPSOCONBYSOCKETROUTEDESTINDSTARTIDXOFSOCKETROUTEDEST}, range raw 0..255}
                UpperLayerIdxOfSocketRouteDest: resulting-properties={base-type=uint8, sw-calibration-access=READ-ONLY, range raw 0..255}
            Element_6: symbol=[6]
              4 x mc data instance, all with category=VALUE:
                RxPduIdOfSocketRouteDest: resulting-properties={base-type=uint8, sw-calibration-access=READ-ONLY, range raw 0..255}
                RouteGrpSoConBySocketRouteDestIndEndIdxOfSocketRouteDest: resulting-properties={base-type=uint8, sw-calibration-access=READ-ONLY, compu {255=SOAD_NO_ROUTEGRPSOCONBYSOCKETROUTEDESTINDENDIDXOFSOCKETROUTEDEST}, range raw 0..255}
                RouteGrpSoConBySocketRouteDestIndStartIdxOfSocketRouteDest: resulting-properties={base-type=uint8, sw-calibration-access=READ-ONLY, compu {255=SOAD_NO_ROUTEGRPSOCONBYSOCKETROUTEDESTINDSTARTIDXOFSOCKETROUTEDEST}, range raw 0..255}
                UpperLayerIdxOfSocketRouteDest: resulting-properties={base-type=uint8, sw-calibration-access=READ-ONLY, range raw 0..255}
            Element_7: symbol=[7]
              4 x mc data instance, all with category=VALUE:
                RxPduIdOfSocketRouteDest: resulting-properties={base-type=uint8, sw-calibration-access=READ-ONLY, range raw 0..255}
                RouteGrpSoConBySocketRouteDestIndEndIdxOfSocketRouteDest: resulting-properties={base-type=uint8, sw-calibration-access=READ-ONLY, compu {255=SOAD_NO_ROUTEGRPSOCONBYSOCKETROUTEDESTINDENDIDXOFSOCKETROUTEDEST}, range raw 0..255}
                RouteGrpSoConBySocketRouteDestIndStartIdxOfSocketRouteDest: resulting-properties={base-type=uint8, sw-calibration-access=READ-ONLY, compu {255=SOAD_NO_ROUTEGRPSOCONBYSOCKETROUTEDESTINDSTARTIDXOFSOCKETROUTEDEST}, range raw 0..255}
                UpperLayerIdxOfSocketRouteDest: resulting-properties={base-type=uint8, sw-calibration-access=READ-ONLY, range raw 0..255}
            Element_8: symbol=[8]
              4 x mc data instance, all with category=VALUE:
                RxPduIdOfSocketRouteDest: resulting-properties={base-type=uint8, sw-calibration-access=READ-ONLY, range raw 0..255}
                RouteGrpSoConBySocketRouteDestIndEndIdxOfSocketRouteDest: resulting-properties={base-type=uint8, sw-calibration-access=READ-ONLY, compu {255=SOAD_NO_ROUTEGRPSOCONBYSOCKETROUTEDESTINDENDIDXOFSOCKETROUTEDEST}, range raw 0..255}
                RouteGrpSoConBySocketRouteDestIndStartIdxOfSocketRouteDest: resulting-properties={base-type=uint8, sw-calibration-access=READ-ONLY, compu {255=SOAD_NO_ROUTEGRPSOCONBYSOCKETROUTEDESTINDSTARTIDXOFSOCKETROUTEDEST}, range raw 0..255}
                UpperLayerIdxOfSocketRouteDest: resulting-properties={base-type=uint8, sw-calibration-access=READ-ONLY, range raw 0..255}
            Element_9: symbol=[9]
              4 x mc data instance, all with category=VALUE:
                RxPduIdOfSocketRouteDest: resulting-properties={base-type=uint8, sw-calibration-access=READ-ONLY, range raw 0..255}
                RouteGrpSoConBySocketRouteDestIndEndIdxOfSocketRouteDest: resulting-properties={base-type=uint8, sw-calibration-access=READ-ONLY, compu {255=SOAD_NO_ROUTEGRPSOCONBYSOCKETROUTEDESTINDENDIDXOFSOCKETROUTEDEST}, range raw 0..255}
                RouteGrpSoConBySocketRouteDestIndStartIdxOfSocketRouteDest: resulting-properties={base-type=uint8, sw-calibration-access=READ-ONLY, compu {255=SOAD_NO_ROUTEGRPSOCONBYSOCKETROUTEDESTINDSTARTIDXOFSOCKETROUTEDEST}, range raw 0..255}
                UpperLayerIdxOfSocketRouteDest: resulting-properties={base-type=uint8, sw-calibration-access=READ-ONLY, range raw 0..255}
            Element_10: symbol=[10]
              4 x mc data instance, all with category=VALUE:
                RxPduIdOfSocketRouteDest: resulting-properties={base-type=uint8, sw-calibration-access=READ-ONLY, range raw 0..255}
                RouteGrpSoConBySocketRouteDestIndEndIdxOfSocketRouteDest: resulting-properties={base-type=uint8, sw-calibration-access=READ-ONLY, compu {255=SOAD_NO_ROUTEGRPSOCONBYSOCKETROUTEDESTINDENDIDXOFSOCKETROUTEDEST}, range raw 0..255}
                RouteGrpSoConBySocketRouteDestIndStartIdxOfSocketRouteDest: resulting-properties={base-type=uint8, sw-calibration-access=READ-ONLY, compu {255=SOAD_NO_ROUTEGRPSOCONBYSOCKETROUTEDESTINDSTARTIDXOFSOCKETROUTEDEST}, range raw 0..255}
                UpperLayerIdxOfSocketRouteDest: resulting-properties={base-type=uint8, sw-calibration-access=READ-ONLY, range raw 0..255}
            Element_11: symbol=[11]
              4 x mc data instance, all with category=VALUE:
                RxPduIdOfSocketRouteDest: resulting-properties={base-type=uint8, sw-calibration-access=READ-ONLY, range raw 0..255}
                RouteGrpSoConBySocketRouteDestIndEndIdxOfSocketRouteDest: resulting-properties={base-type=uint8, sw-calibration-access=READ-ONLY, compu {255=SOAD_NO_ROUTEGRPSOCONBYSOCKETROUTEDESTINDENDIDXOFSOCKETROUTEDEST}, range raw 0..255}
                RouteGrpSoConBySocketRouteDestIndStartIdxOfSocketRouteDest: resulting-properties={base-type=uint8, sw-calibration-access=READ-ONLY, compu {255=SOAD_NO_ROUTEGRPSOCONBYSOCKETROUTEDESTINDSTARTIDXOFSOCKETROUTEDEST}, range raw 0..255}
                UpperLayerIdxOfSocketRouteDest: resulting-properties={base-type=uint8, sw-calibration-access=READ-ONLY, range raw 0..255}
            Element_12: symbol=[12]
              4 x mc data instance, all with category=VALUE:
                RxPduIdOfSocketRouteDest: resulting-properties={base-type=uint8, sw-calibration-access=READ-ONLY, range raw 0..255}
                RouteGrpSoConBySocketRouteDestIndEndIdxOfSocketRouteDest: resulting-properties={base-type=uint8, sw-calibration-access=READ-ONLY, compu {255=SOAD_NO_ROUTEGRPSOCONBYSOCKETROUTEDESTINDENDIDXOFSOCKETROUTEDEST}, range raw 0..255}
                RouteGrpSoConBySocketRouteDestIndStartIdxOfSocketRouteDest: resulting-properties={base-type=uint8, sw-calibration-access=READ-ONLY, compu {255=SOAD_NO_ROUTEGRPSOCONBYSOCKETROUTEDESTINDSTARTIDXOFSOCKETROUTEDEST}, range raw 0..255}
                UpperLayerIdxOfSocketRouteDest: resulting-properties={base-type=uint8, sw-calibration-access=READ-ONLY, range raw 0..255}
            Element_13: symbol=[13]
              4 x mc data instance, all with category=VALUE:
                RxPduIdOfSocketRouteDest: resulting-properties={base-type=uint8, sw-calibration-access=READ-ONLY, range raw 0..255}
                RouteGrpSoConBySocketRouteDestIndEndIdxOfSocketRouteDest: resulting-properties={base-type=uint8, sw-calibration-access=READ-ONLY, compu {255=SOAD_NO_ROUTEGRPSOCONBYSOCKETROUTEDESTINDENDIDXOFSOCKETROUTEDEST}, range raw 0..255}
                RouteGrpSoConBySocketRouteDestIndStartIdxOfSocketRouteDest: resulting-properties={base-type=uint8, sw-calibration-access=READ-ONLY, compu {255=SOAD_NO_ROUTEGRPSOCONBYSOCKETROUTEDESTINDSTARTIDXOFSOCKETROUTEDEST}, range raw 0..255}
                UpperLayerIdxOfSocketRouteDest: resulting-properties={base-type=uint8, sw-calibration-access=READ-ONLY, range raw 0..255}
            Element_14: symbol=[14]
              4 x mc data instance, all with category=VALUE:
                RxPduIdOfSocketRouteDest: resulting-properties={base-type=uint8, sw-calibration-access=READ-ONLY, range raw 0..255}
                RouteGrpSoConBySocketRouteDestIndEndIdxOfSocketRouteDest: resulting-properties={base-type=uint8, sw-calibration-access=READ-ONLY, compu {255=SOAD_NO_ROUTEGRPSOCONBYSOCKETROUTEDESTINDENDIDXOFSOCKETROUTEDEST}, range raw 0..255}
                RouteGrpSoConBySocketRouteDestIndStartIdxOfSocketRouteDest: resulting-properties={base-type=uint8, sw-calibration-access=READ-ONLY, compu {255=SOAD_NO_ROUTEGRPSOCONBYSOCKETROUTEDESTINDSTARTIDXOFSOCKETROUTEDEST}, range raw 0..255}
                UpperLayerIdxOfSocketRouteDest: resulting-properties={base-type=uint8, sw-calibration-access=READ-ONLY, range raw 0..255}
        SoAd_SocketUdp: category=ARRAY, array-size=2  # the UDP socket configuration
          mc data instance Element_0: category=STRUCTURE, symbol=[0]
            mc data instance ImmedIfTxConfOfSocketUdp: category=VALUE, resulting-properties={base-type=boolean, sw-calibration-access=READ-ONLY, compu {0=FALSE, 1..255=TRUE}, range raw 0..1}
            mc data instance AliveTimeoutMaxCntOfSocketUdp: category=VALUE, resulting-properties={base-type=uint8, sw-calibration-access=READ-ONLY, range raw 0..255}
            mc data instance NPduUdpTxBufferMinOfSocketUdp: category=VALUE, resulting-properties={base-type=uint8, sw-calibration-access=READ-ONLY, range raw 0..255}
          mc data instance Element_1: category=STRUCTURE, symbol=[1]
            mc data instance ImmedIfTxConfOfSocketUdp: category=VALUE, resulting-properties={base-type=boolean, sw-calibration-access=READ-ONLY, compu {0=FALSE, 1..255=TRUE}, range raw 0..1}
            mc data instance AliveTimeoutMaxCntOfSocketUdp: category=VALUE, resulting-properties={base-type=uint8, sw-calibration-access=READ-ONLY, range raw 0..255}
            mc data instance NPduUdpTxBufferMinOfSocketUdp: category=VALUE, resulting-properties={base-type=uint8, sw-calibration-access=READ-ONLY, range raw 0..255}
        SoAd_TcpIpCtrl: category=ARRAY, array-size=2  # the TcpIp controller/interface
          mc data instance Element_0: category=STRUCTURE, symbol=[0]
            mc data instance RetryEnabledOfTcpIpCtrl: category=VALUE, resulting-properties={base-type=boolean, sw-calibration-access=READ-ONLY, compu {0=FALSE, 1..255=TRUE}, range raw 0..1}
            mc data instance LocalAddrByTcpIpCtrlIndStartIdxOfTcpIpCtrl: category=VALUE, resulting-properties={base-type=uint8, sw-calibration-access=READ-ONLY, compu {255=SOAD_NO_LOCALADDRBYTCPIPCTRLINDSTARTIDXOFTCPIPCTRL}, range raw 0..255}
          mc data instance Element_1: category=STRUCTURE, symbol=[1]
            mc data instance RetryEnabledOfTcpIpCtrl: category=VALUE, resulting-properties={base-type=boolean, sw-calibration-access=READ-ONLY, compu {0=FALSE, 1..255=TRUE}, range raw 0..1}
            mc data instance LocalAddrByTcpIpCtrlIndStartIdxOfTcpIpCtrl: category=VALUE, resulting-properties={base-type=uint8, sw-calibration-access=READ-ONLY, compu {255=SOAD_NO_LOCALADDRBYTCPIPCTRLINDSTARTIDXOFTCPIPCTRL}, range raw 0..255}
        SoAd_TcpTxQueue: category=ARRAY, array-size=2  # the Tx TCP queues configuration
          mc data instance Element_0: category=STRUCTURE, symbol=[0]
            mc data instance TcpTxQueueDataStartIdxOfTcpTxQueue: category=VALUE, resulting-properties={base-type=uint8, sw-calibration-access=READ-ONLY, range raw 0..255}
          mc data instance Element_1: category=STRUCTURE, symbol=[1]
            mc data instance TcpTxQueueDataStartIdxOfTcpTxQueue: category=VALUE, resulting-properties={base-type=uint8, sw-calibration-access=READ-ONLY, range raw 0..255}
        SoAd_TimeoutListIdent: category=ARRAY, array-size=1  # the timeout list identification to get the index of a specific timeout list
          mc data instance Element_0: category=STRUCTURE, symbol=[0]
            mc data instance TimeoutListNPduUdpTxConfigIdxOfTimeoutListIdent: category=VALUE, resulting-properties={base-type=uint8, sw-calibration-access=READ-ONLY, compu {255=SOAD_NO_TIMEOUTLISTNPDUUDPTXCONFIGIDXOFTIMEOUTLISTIDENT}, range raw 0..255}
            mc data instance TimeoutListUdpAliveConfigIdxOfTimeoutListIdent: category=VALUE, resulting-properties={base-type=uint8, sw-calibration-access=READ-ONLY, compu {255=SOAD_NO_TIMEOUTLISTUDPALIVECONFIGIDXOFTIMEOUTLISTIDENT}, range raw 0..255}
        SoAd_TxPduIdMap: category=ARRAY, array-size=15  # the partition-unspecific handle ID mapping to partition-specific TxPduId
          15 x mc data instance, all with category=STRUCTURE:
            Element_0: symbol=[0]
              mc data instance InvalidHndOfTxPduIdMap: category=VALUE, resulting-properties={base-type=boolean, sw-calibration-access=READ-ONLY, compu {0=FALSE, 1..255=TRUE}, range raw 0..1}
              mc data instance PartitionSpecificPduRoutePartitionIdxOfTxPduIdMap: category=VALUE, resulting-properties={base-type=uint8, sw-calibration-access=READ-ONLY, compu {255=SOAD_NO_PARTITIONSPECIFICPDUROUTEPARTITIONIDXOFTXPDUIDMAP}, range raw 0..255}
            Element_1: symbol=[1]
              mc data instance InvalidHndOfTxPduIdMap: category=VALUE, resulting-properties={base-type=boolean, sw-calibration-access=READ-ONLY, compu {0=FALSE, 1..255=TRUE}, range raw 0..1}
              mc data instance PartitionSpecificPduRoutePartitionIdxOfTxPduIdMap: category=VALUE, resulting-properties={base-type=uint8, sw-calibration-access=READ-ONLY, compu {255=SOAD_NO_PARTITIONSPECIFICPDUROUTEPARTITIONIDXOFTXPDUIDMAP}, range raw 0..255}
            Element_2: symbol=[2]
              mc data instance InvalidHndOfTxPduIdMap: category=VALUE, resulting-properties={base-type=boolean, sw-calibration-access=READ-ONLY, compu {0=FALSE, 1..255=TRUE}, range raw 0..1}
              mc data instance PartitionSpecificPduRoutePartitionIdxOfTxPduIdMap: category=VALUE, resulting-properties={base-type=uint8, sw-calibration-access=READ-ONLY, compu {255=SOAD_NO_PARTITIONSPECIFICPDUROUTEPARTITIONIDXOFTXPDUIDMAP}, range raw 0..255}
            Element_3: symbol=[3]
              mc data instance InvalidHndOfTxPduIdMap: category=VALUE, resulting-properties={base-type=boolean, sw-calibration-access=READ-ONLY, compu {0=FALSE, 1..255=TRUE}, range raw 0..1}
              mc data instance PartitionSpecificPduRoutePartitionIdxOfTxPduIdMap: category=VALUE, resulting-properties={base-type=uint8, sw-calibration-access=READ-ONLY, compu {255=SOAD_NO_PARTITIONSPECIFICPDUROUTEPARTITIONIDXOFTXPDUIDMAP}, range raw 0..255}
            Element_4: symbol=[4]
              mc data instance InvalidHndOfTxPduIdMap: category=VALUE, resulting-properties={base-type=boolean, sw-calibration-access=READ-ONLY, compu {0=FALSE, 1..255=TRUE}, range raw 0..1}
              mc data instance PartitionSpecificPduRoutePartitionIdxOfTxPduIdMap: category=VALUE, resulting-properties={base-type=uint8, sw-calibration-access=READ-ONLY, compu {255=SOAD_NO_PARTITIONSPECIFICPDUROUTEPARTITIONIDXOFTXPDUIDMAP}, range raw 0..255}
            Element_5: symbol=[5]
              mc data instance InvalidHndOfTxPduIdMap: category=VALUE, resulting-properties={base-type=boolean, sw-calibration-access=READ-ONLY, compu {0=FALSE, 1..255=TRUE}, range raw 0..1}
              mc data instance PartitionSpecificPduRoutePartitionIdxOfTxPduIdMap: category=VALUE, resulting-properties={base-type=uint8, sw-calibration-access=READ-ONLY, compu {255=SOAD_NO_PARTITIONSPECIFICPDUROUTEPARTITIONIDXOFTXPDUIDMAP}, range raw 0..255}
            Element_6: symbol=[6]
              mc data instance InvalidHndOfTxPduIdMap: category=VALUE, resulting-properties={base-type=boolean, sw-calibration-access=READ-ONLY, compu {0=FALSE, 1..255=TRUE}, range raw 0..1}
              mc data instance PartitionSpecificPduRoutePartitionIdxOfTxPduIdMap: category=VALUE, resulting-properties={base-type=uint8, sw-calibration-access=READ-ONLY, compu {255=SOAD_NO_PARTITIONSPECIFICPDUROUTEPARTITIONIDXOFTXPDUIDMAP}, range raw 0..255}
            Element_7: symbol=[7]
              mc data instance InvalidHndOfTxPduIdMap: category=VALUE, resulting-properties={base-type=boolean, sw-calibration-access=READ-ONLY, compu {0=FALSE, 1..255=TRUE}, range raw 0..1}
              mc data instance PartitionSpecificPduRoutePartitionIdxOfTxPduIdMap: category=VALUE, resulting-properties={base-type=uint8, sw-calibration-access=READ-ONLY, compu {255=SOAD_NO_PARTITIONSPECIFICPDUROUTEPARTITIONIDXOFTXPDUIDMAP}, range raw 0..255}
            Element_8: symbol=[8]
              mc data instance InvalidHndOfTxPduIdMap: category=VALUE, resulting-properties={base-type=boolean, sw-calibration-access=READ-ONLY, compu {0=FALSE, 1..255=TRUE}, range raw 0..1}
              mc data instance PartitionSpecificPduRoutePartitionIdxOfTxPduIdMap: category=VALUE, resulting-properties={base-type=uint8, sw-calibration-access=READ-ONLY, compu {255=SOAD_NO_PARTITIONSPECIFICPDUROUTEPARTITIONIDXOFTXPDUIDMAP}, range raw 0..255}
            Element_9: symbol=[9]
              mc data instance InvalidHndOfTxPduIdMap: category=VALUE, resulting-properties={base-type=boolean, sw-calibration-access=READ-ONLY, compu {0=FALSE, 1..255=TRUE}, range raw 0..1}
              mc data instance PartitionSpecificPduRoutePartitionIdxOfTxPduIdMap: category=VALUE, resulting-properties={base-type=uint8, sw-calibration-access=READ-ONLY, compu {255=SOAD_NO_PARTITIONSPECIFICPDUROUTEPARTITIONIDXOFTXPDUIDMAP}, range raw 0..255}
            Element_10: symbol=[10]
              mc data instance InvalidHndOfTxPduIdMap: category=VALUE, resulting-properties={base-type=boolean, sw-calibration-access=READ-ONLY, compu {0=FALSE, 1..255=TRUE}, range raw 0..1}
              mc data instance PartitionSpecificPduRoutePartitionIdxOfTxPduIdMap: category=VALUE, resulting-properties={base-type=uint8, sw-calibration-access=READ-ONLY, compu {255=SOAD_NO_PARTITIONSPECIFICPDUROUTEPARTITIONIDXOFTXPDUIDMAP}, range raw 0..255}
            Element_11: symbol=[11]
              mc data instance InvalidHndOfTxPduIdMap: category=VALUE, resulting-properties={base-type=boolean, sw-calibration-access=READ-ONLY, compu {0=FALSE, 1..255=TRUE}, range raw 0..1}
              mc data instance PartitionSpecificPduRoutePartitionIdxOfTxPduIdMap: category=VALUE, resulting-properties={base-type=uint8, sw-calibration-access=READ-ONLY, compu {255=SOAD_NO_PARTITIONSPECIFICPDUROUTEPARTITIONIDXOFTXPDUIDMAP}, range raw 0..255}
            Element_12: symbol=[12]
              mc data instance InvalidHndOfTxPduIdMap: category=VALUE, resulting-properties={base-type=boolean, sw-calibration-access=READ-ONLY, compu {0=FALSE, 1..255=TRUE}, range raw 0..1}
              mc data instance PartitionSpecificPduRoutePartitionIdxOfTxPduIdMap: category=VALUE, resulting-properties={base-type=uint8, sw-calibration-access=READ-ONLY, compu {255=SOAD_NO_PARTITIONSPECIFICPDUROUTEPARTITIONIDXOFTXPDUIDMAP}, range raw 0..255}
            Element_13: symbol=[13]
              mc data instance InvalidHndOfTxPduIdMap: category=VALUE, resulting-properties={base-type=boolean, sw-calibration-access=READ-ONLY, compu {0=FALSE, 1..255=TRUE}, range raw 0..1}
              mc data instance PartitionSpecificPduRoutePartitionIdxOfTxPduIdMap: category=VALUE, resulting-properties={base-type=uint8, sw-calibration-access=READ-ONLY, compu {255=SOAD_NO_PARTITIONSPECIFICPDUROUTEPARTITIONIDXOFTXPDUIDMAP}, range raw 0..255}
            Element_14: symbol=[14]
              mc data instance InvalidHndOfTxPduIdMap: category=VALUE, resulting-properties={base-type=boolean, sw-calibration-access=READ-ONLY, compu {0=FALSE, 1..255=TRUE}, range raw 0..1}
              mc data instance PartitionSpecificPduRoutePartitionIdxOfTxPduIdMap: category=VALUE, resulting-properties={base-type=uint8, sw-calibration-access=READ-ONLY, compu {255=SOAD_NO_PARTITIONSPECIFICPDUROUTEPARTITIONIDXOFTXPDUIDMAP}, range raw 0..255}
        SoAd_LocalIpAddrAssignmentChgCbkInd: category=ARRAY, array-size=5, resulting-properties={base-type=uint8, sw-calibration-access=READ-ONLY, range raw 0..255}  # the indexes of the 1:1 sorted relation pointing to SoAd_LocalIpAddrAssignmentChgCbk
        SoAd_PduRouteDestBySoConInd: category=ARRAY, array-size=15, resulting-properties={base-type=uint8, sw-calibration-access=READ-ONLY, range raw 0..255}  # the indexes of the 1:1 sorted relation pointing to SoAd_PduRouteDest
        SoAd_PduRouteDestInd: category=ARRAY, array-size=5, resulting-properties={base-type=uint8, sw-calibration-access=READ-ONLY, range raw 0..255}  # the indexes of the 1:1 sorted relation pointing to SoAd_PduRouteDest
        SoAd_RouteGrpSoConByPduRouteDestInd: category=ARRAY, array-size=5, resulting-properties={base-type=uint8, sw-calibration-access=READ-ONLY, range raw 0..255}  # the indexes of the 1:1 sorted relation pointing to SoAd_RouteGrpSoCon
        SoAd_RouteGrpSoConBySocketRouteDestInd: category=ARRAY, array-size=5, resulting-properties={base-type=uint8, sw-calibration-access=READ-ONLY, range raw 0..255}  # the indexes of the 1:1 sorted relation pointing to SoAd_RouteGrpSoCon
        SoAd_SoConModeChgCbkInd: category=ARRAY, array-size=7, resulting-properties={base-type=uint8, sw-calibration-access=READ-ONLY, range raw 0..255}  # the indexes of the 1:1 sorted relation pointing to SoAd_SoConModeChgCbk
        SoAd_SocketRouteInd: category=ARRAY, array-size=5, resulting-properties={base-type=uint8, sw-calibration-access=READ-ONLY, range raw 0..255}  # the indexes of the 1:1 sorted relation pointing to SoAd_SocketRoute
        SoAd_TcpKeepAliveGloballyEnabled: category=ARRAY, array-size=1, resulting-properties={base-type=boolean, sw-calibration-access=READ-ONLY, compu {0=FALSE, 1..255=TRUE}, range raw 0..1}  # indicates if TCP keep alive is enabled at all
        SoAd_BestMatchSoConIdxList: category=ARRAY, array-size=2, symbol=SoAd_BestMatchSoConIdxList.raw  # the global list to store all matching socket connections if best match alogorithm is used
          mc data instance Element_0: category=STRUCTURE, symbol=[0]
            mc data instance SoConIdxOfBestMatchSoConIdxList: category=VALUE, resulting-properties={base-type=uint8, sw-calibration-access=READ-ONLY, range raw 0..255}
          mc data instance Element_1: category=STRUCTURE, symbol=[1]
            mc data instance SoConIdxOfBestMatchSoConIdxList: category=VALUE, resulting-properties={base-type=uint8, sw-calibration-access=READ-ONLY, range raw 0..255}
        SoAd_BestMatchSoConIdxList_SoAdInstance: category=ARRAY, array-size=2, symbol=SoAd_BestMatchSoConIdxList.raw[0]  # The element: SoAdInstance of SoAd_BestMatchSoConIdxList
          mc data instance Element_0: category=STRUCTURE, symbol=[0]
            mc data instance SoConIdxOfBestMatchSoConIdxList: category=VALUE, resulting-properties={base-type=uint8, sw-calibration-access=READ-ONLY, range raw 0..255}
          mc data instance Element_1: category=STRUCTURE, symbol=[1]
            mc data instance SoConIdxOfBestMatchSoConIdxList: category=VALUE, resulting-properties={base-type=uint8, sw-calibration-access=READ-ONLY, range raw 0..255}
        SoAd_EventQueueIfTxRouteGrp: category=ARRAY, array-size=1, symbol=SoAd_EventQueueIfTxRouteGrp.raw  # indicates if a transmission is active for a routing group
          mc data instance Element_0: category=STRUCTURE, symbol=[0]
            mc data instance RouteGrpIdxOfEventQueueIfTxRouteGrp: category=VALUE, resulting-properties={base-type=uint8, sw-calibration-access=READ-ONLY, range raw 0..255}
        SoAd_EventQueueIfTxRouteGrp_SoAdEventQueueIfTxRouteGrp_SoAdInstance: category=ARRAY, array-size=1, symbol=SoAd_EventQueueIfTxRouteGrp.raw[0]  # The element: SoAdEventQueueIfTxRouteGrp_SoAdInstance of SoAd_EventQueueIfTxRouteGrp
          mc data instance Element_0: category=STRUCTURE, symbol=[0]
            mc data instance RouteGrpIdxOfEventQueueIfTxRouteGrp: category=VALUE, resulting-properties={base-type=uint8, sw-calibration-access=READ-ONLY, range raw 0..255}
        SoAd_EventQueueIfUdpPduRoute: category=ARRAY, array-size=13, symbol=SoAd_EventQueueIfUdpPduRoute.raw  # indicates if a IF confirmation is pending on a UDP socket connection
          13 x mc data instance, all with category=STRUCTURE:
            Element_0: symbol=[0]
              mc data instance PduRouteIdxOfEventQueueIfUdpPduRoute: category=VALUE, resulting-properties={base-type=uint8, sw-calibration-access=READ-ONLY, range raw 0..255}
            Element_1: symbol=[1]
              mc data instance PduRouteIdxOfEventQueueIfUdpPduRoute: category=VALUE, resulting-properties={base-type=uint8, sw-calibration-access=READ-ONLY, range raw 0..255}
            Element_2: symbol=[2]
              mc data instance PduRouteIdxOfEventQueueIfUdpPduRoute: category=VALUE, resulting-properties={base-type=uint8, sw-calibration-access=READ-ONLY, range raw 0..255}
            Element_3: symbol=[3]
              mc data instance PduRouteIdxOfEventQueueIfUdpPduRoute: category=VALUE, resulting-properties={base-type=uint8, sw-calibration-access=READ-ONLY, range raw 0..255}
            Element_4: symbol=[4]
              mc data instance PduRouteIdxOfEventQueueIfUdpPduRoute: category=VALUE, resulting-properties={base-type=uint8, sw-calibration-access=READ-ONLY, range raw 0..255}
            Element_5: symbol=[5]
              mc data instance PduRouteIdxOfEventQueueIfUdpPduRoute: category=VALUE, resulting-properties={base-type=uint8, sw-calibration-access=READ-ONLY, range raw 0..255}
            Element_6: symbol=[6]
              mc data instance PduRouteIdxOfEventQueueIfUdpPduRoute: category=VALUE, resulting-properties={base-type=uint8, sw-calibration-access=READ-ONLY, range raw 0..255}
            Element_7: symbol=[7]
              mc data instance PduRouteIdxOfEventQueueIfUdpPduRoute: category=VALUE, resulting-properties={base-type=uint8, sw-calibration-access=READ-ONLY, range raw 0..255}
            Element_8: symbol=[8]
              mc data instance PduRouteIdxOfEventQueueIfUdpPduRoute: category=VALUE, resulting-properties={base-type=uint8, sw-calibration-access=READ-ONLY, range raw 0..255}
            Element_9: symbol=[9]
              mc data instance PduRouteIdxOfEventQueueIfUdpPduRoute: category=VALUE, resulting-properties={base-type=uint8, sw-calibration-access=READ-ONLY, range raw 0..255}
            Element_10: symbol=[10]
              mc data instance PduRouteIdxOfEventQueueIfUdpPduRoute: category=VALUE, resulting-properties={base-type=uint8, sw-calibration-access=READ-ONLY, range raw 0..255}
            Element_11: symbol=[11]
              mc data instance PduRouteIdxOfEventQueueIfUdpPduRoute: category=VALUE, resulting-properties={base-type=uint8, sw-calibration-access=READ-ONLY, range raw 0..255}
            Element_12: symbol=[12]
              mc data instance PduRouteIdxOfEventQueueIfUdpPduRoute: category=VALUE, resulting-properties={base-type=uint8, sw-calibration-access=READ-ONLY, range raw 0..255}
        SoAd_EventQueueIfUdpPduRoute_SoAdEventQueueIfUdpPduRoute_SoAdInstance: category=ARRAY, array-size=13, symbol=SoAd_EventQueueIfUdpPduRoute.raw[0]  # The element: SoAdEventQueueIfUdpPduRoute_SoAdInstance of SoAd_EventQueueIfUdpPduRoute
          13 x mc data instance, all with category=STRUCTURE:
            Element_0: symbol=[0]
              mc data instance PduRouteIdxOfEventQueueIfUdpPduRoute: category=VALUE, resulting-properties={base-type=uint8, sw-calibration-access=READ-ONLY, range raw 0..255}
            Element_1: symbol=[1]
              mc data instance PduRouteIdxOfEventQueueIfUdpPduRoute: category=VALUE, resulting-properties={base-type=uint8, sw-calibration-access=READ-ONLY, range raw 0..255}
            Element_2: symbol=[2]
              mc data instance PduRouteIdxOfEventQueueIfUdpPduRoute: category=VALUE, resulting-properties={base-type=uint8, sw-calibration-access=READ-ONLY, range raw 0..255}
            Element_3: symbol=[3]
              mc data instance PduRouteIdxOfEventQueueIfUdpPduRoute: category=VALUE, resulting-properties={base-type=uint8, sw-calibration-access=READ-ONLY, range raw 0..255}
            Element_4: symbol=[4]
              mc data instance PduRouteIdxOfEventQueueIfUdpPduRoute: category=VALUE, resulting-properties={base-type=uint8, sw-calibration-access=READ-ONLY, range raw 0..255}
            Element_5: symbol=[5]
              mc data instance PduRouteIdxOfEventQueueIfUdpPduRoute: category=VALUE, resulting-properties={base-type=uint8, sw-calibration-access=READ-ONLY, range raw 0..255}
            Element_6: symbol=[6]
              mc data instance PduRouteIdxOfEventQueueIfUdpPduRoute: category=VALUE, resulting-properties={base-type=uint8, sw-calibration-access=READ-ONLY, range raw 0..255}
            Element_7: symbol=[7]
              mc data instance PduRouteIdxOfEventQueueIfUdpPduRoute: category=VALUE, resulting-properties={base-type=uint8, sw-calibration-access=READ-ONLY, range raw 0..255}
            Element_8: symbol=[8]
              mc data instance PduRouteIdxOfEventQueueIfUdpPduRoute: category=VALUE, resulting-properties={base-type=uint8, sw-calibration-access=READ-ONLY, range raw 0..255}
            Element_9: symbol=[9]
              mc data instance PduRouteIdxOfEventQueueIfUdpPduRoute: category=VALUE, resulting-properties={base-type=uint8, sw-calibration-access=READ-ONLY, range raw 0..255}
            Element_10: symbol=[10]
              mc data instance PduRouteIdxOfEventQueueIfUdpPduRoute: category=VALUE, resulting-properties={base-type=uint8, sw-calibration-access=READ-ONLY, range raw 0..255}
            Element_11: symbol=[11]
              mc data instance PduRouteIdxOfEventQueueIfUdpPduRoute: category=VALUE, resulting-properties={base-type=uint8, sw-calibration-access=READ-ONLY, range raw 0..255}
            Element_12: symbol=[12]
              mc data instance PduRouteIdxOfEventQueueIfUdpPduRoute: category=VALUE, resulting-properties={base-type=uint8, sw-calibration-access=READ-ONLY, range raw 0..255}
        SoAd_EventQueueMgmt: category=ARRAY, array-size=5, symbol=SoAd_EventQueueMgmt.raw  # the management struct of all event queues
          5 x mc data instance, all with category=STRUCTURE:
            Element_0: symbol=[0]
              mc data instance IdxOfEventQueueMgmt: category=VALUE, resulting-properties={base-type=uint16, sw-calibration-access=READ-ONLY, range raw 0..65535}
              mc data instance LvlOfEventQueueMgmt: category=VALUE, resulting-properties={base-type=uint16, sw-calibration-access=READ-ONLY, range raw 0..65535}
            Element_1: symbol=[1]
              mc data instance IdxOfEventQueueMgmt: category=VALUE, resulting-properties={base-type=uint16, sw-calibration-access=READ-ONLY, range raw 0..65535}
              mc data instance LvlOfEventQueueMgmt: category=VALUE, resulting-properties={base-type=uint16, sw-calibration-access=READ-ONLY, range raw 0..65535}
            Element_2: symbol=[2]
              mc data instance IdxOfEventQueueMgmt: category=VALUE, resulting-properties={base-type=uint16, sw-calibration-access=READ-ONLY, range raw 0..65535}
              mc data instance LvlOfEventQueueMgmt: category=VALUE, resulting-properties={base-type=uint16, sw-calibration-access=READ-ONLY, range raw 0..65535}
            Element_3: symbol=[3]
              mc data instance IdxOfEventQueueMgmt: category=VALUE, resulting-properties={base-type=uint16, sw-calibration-access=READ-ONLY, range raw 0..65535}
              mc data instance LvlOfEventQueueMgmt: category=VALUE, resulting-properties={base-type=uint16, sw-calibration-access=READ-ONLY, range raw 0..65535}
            Element_4: symbol=[4]
              mc data instance IdxOfEventQueueMgmt: category=VALUE, resulting-properties={base-type=uint16, sw-calibration-access=READ-ONLY, range raw 0..65535}
              mc data instance LvlOfEventQueueMgmt: category=VALUE, resulting-properties={base-type=uint16, sw-calibration-access=READ-ONLY, range raw 0..65535}
        SoAd_EventQueueMgmt_SoAdEventQueueTpRxSoCon_SoAdInstance: category=ARRAY, array-size=1, symbol=SoAd_EventQueueMgmt.raw[0]  # The element: SoAdEventQueueTpRxSoCon_SoAdInstance of SoAd_EventQueueMgmt
          mc data instance Element_0: category=STRUCTURE, symbol=[0]
            mc data instance IdxOfEventQueueMgmt: category=VALUE, resulting-properties={base-type=uint16, sw-calibration-access=READ-ONLY, range raw 0..65535}
            mc data instance LvlOfEventQueueMgmt: category=VALUE, resulting-properties={base-type=uint16, sw-calibration-access=READ-ONLY, range raw 0..65535}
        SoAd_EventQueueMgmt_SoAdEventQueueStateSoCon_SoAdInstance: category=ARRAY, array-size=1, symbol=SoAd_EventQueueMgmt.raw[1]  # The element: SoAdEventQueueStateSoCon_SoAdInstance of SoAd_EventQueueMgmt
          mc data instance Element_0: category=STRUCTURE, symbol=[0]
            mc data instance IdxOfEventQueueMgmt: category=VALUE, resulting-properties={base-type=uint16, sw-calibration-access=READ-ONLY, range raw 0..65535}
            mc data instance LvlOfEventQueueMgmt: category=VALUE, resulting-properties={base-type=uint16, sw-calibration-access=READ-ONLY, range raw 0..65535}
        SoAd_EventQueueMgmt_SoAdEventQueueTpTxSoCon_SoAdInstance: category=ARRAY, array-size=1, symbol=SoAd_EventQueueMgmt.raw[2]  # The element: SoAdEventQueueTpTxSoCon_SoAdInstance of SoAd_EventQueueMgmt
          mc data instance Element_0: category=STRUCTURE, symbol=[0]
            mc data instance IdxOfEventQueueMgmt: category=VALUE, resulting-properties={base-type=uint16, sw-calibration-access=READ-ONLY, range raw 0..65535}
            mc data instance LvlOfEventQueueMgmt: category=VALUE, resulting-properties={base-type=uint16, sw-calibration-access=READ-ONLY, range raw 0..65535}
        SoAd_EventQueueMgmt_SoAdEventQueueIfUdpPduRoute_SoAdInstance: category=ARRAY, array-size=1, symbol=SoAd_EventQueueMgmt.raw[3]  # The element: SoAdEventQueueIfUdpPduRoute_SoAdInstance of SoAd_EventQueueMgmt
          mc data instance Element_0: category=STRUCTURE, symbol=[0]
            mc data instance IdxOfEventQueueMgmt: category=VALUE, resulting-properties={base-type=uint16, sw-calibration-access=READ-ONLY, range raw 0..65535}
            mc data instance LvlOfEventQueueMgmt: category=VALUE, resulting-properties={base-type=uint16, sw-calibration-access=READ-ONLY, range raw 0..65535}
        SoAd_EventQueueMgmt_SoAdEventQueueIfTxRouteGrp_SoAdInstance: category=ARRAY, array-size=1, symbol=SoAd_EventQueueMgmt.raw[4]  # The element: SoAdEventQueueIfTxRouteGrp_SoAdInstance of SoAd_EventQueueMgmt
          mc data instance Element_0: category=STRUCTURE, symbol=[0]
            mc data instance IdxOfEventQueueMgmt: category=VALUE, resulting-properties={base-type=uint16, sw-calibration-access=READ-ONLY, range raw 0..65535}
            mc data instance LvlOfEventQueueMgmt: category=VALUE, resulting-properties={base-type=uint16, sw-calibration-access=READ-ONLY, range raw 0..65535}
        SoAd_EventQueueStateSoCon: category=ARRAY, array-size=14, symbol=SoAd_EventQueueStateSoCon.raw  # indicates if an event is active for socket connection state
          14 x mc data instance, all with category=STRUCTURE:
            Element_0: symbol=[0]
              mc data instance SoConIdxOfEventQueueStateSoCon: category=VALUE, resulting-properties={base-type=uint8, sw-calibration-access=READ-ONLY, range raw 0..255}
            Element_1: symbol=[1]
              mc data instance SoConIdxOfEventQueueStateSoCon: category=VALUE, resulting-properties={base-type=uint8, sw-calibration-access=READ-ONLY, range raw 0..255}
            Element_2: symbol=[2]
              mc data instance SoConIdxOfEventQueueStateSoCon: category=VALUE, resulting-properties={base-type=uint8, sw-calibration-access=READ-ONLY, range raw 0..255}
            Element_3: symbol=[3]
              mc data instance SoConIdxOfEventQueueStateSoCon: category=VALUE, resulting-properties={base-type=uint8, sw-calibration-access=READ-ONLY, range raw 0..255}
            Element_4: symbol=[4]
              mc data instance SoConIdxOfEventQueueStateSoCon: category=VALUE, resulting-properties={base-type=uint8, sw-calibration-access=READ-ONLY, range raw 0..255}
            Element_5: symbol=[5]
              mc data instance SoConIdxOfEventQueueStateSoCon: category=VALUE, resulting-properties={base-type=uint8, sw-calibration-access=READ-ONLY, range raw 0..255}
            Element_6: symbol=[6]
              mc data instance SoConIdxOfEventQueueStateSoCon: category=VALUE, resulting-properties={base-type=uint8, sw-calibration-access=READ-ONLY, range raw 0..255}
            Element_7: symbol=[7]
              mc data instance SoConIdxOfEventQueueStateSoCon: category=VALUE, resulting-properties={base-type=uint8, sw-calibration-access=READ-ONLY, range raw 0..255}
            Element_8: symbol=[8]
              mc data instance SoConIdxOfEventQueueStateSoCon: category=VALUE, resulting-properties={base-type=uint8, sw-calibration-access=READ-ONLY, range raw 0..255}
            Element_9: symbol=[9]
              mc data instance SoConIdxOfEventQueueStateSoCon: category=VALUE, resulting-properties={base-type=uint8, sw-calibration-access=READ-ONLY, range raw 0..255}
            Element_10: symbol=[10]
              mc data instance SoConIdxOfEventQueueStateSoCon: category=VALUE, resulting-properties={base-type=uint8, sw-calibration-access=READ-ONLY, range raw 0..255}
            Element_11: symbol=[11]
              mc data instance SoConIdxOfEventQueueStateSoCon: category=VALUE, resulting-properties={base-type=uint8, sw-calibration-access=READ-ONLY, range raw 0..255}
            Element_12: symbol=[12]
              mc data instance SoConIdxOfEventQueueStateSoCon: category=VALUE, resulting-properties={base-type=uint8, sw-calibration-access=READ-ONLY, range raw 0..255}
            Element_13: symbol=[13]
              mc data instance SoConIdxOfEventQueueStateSoCon: category=VALUE, resulting-properties={base-type=uint8, sw-calibration-access=READ-ONLY, range raw 0..255}
        SoAd_EventQueueStateSoCon_SoAdEventQueueStateSoCon_SoAdInstance: category=ARRAY, array-size=14, symbol=SoAd_EventQueueStateSoCon.raw[0]  # The element: SoAdEventQueueStateSoCon_SoAdInstance of SoAd_EventQueueStateSoCon
          14 x mc data instance, all with category=STRUCTURE:
            Element_0: symbol=[0]
              mc data instance SoConIdxOfEventQueueStateSoCon: category=VALUE, resulting-properties={base-type=uint8, sw-calibration-access=READ-ONLY, range raw 0..255}
            Element_1: symbol=[1]
              mc data instance SoConIdxOfEventQueueStateSoCon: category=VALUE, resulting-properties={base-type=uint8, sw-calibration-access=READ-ONLY, range raw 0..255}
            Element_2: symbol=[2]
              mc data instance SoConIdxOfEventQueueStateSoCon: category=VALUE, resulting-properties={base-type=uint8, sw-calibration-access=READ-ONLY, range raw 0..255}
            Element_3: symbol=[3]
              mc data instance SoConIdxOfEventQueueStateSoCon: category=VALUE, resulting-properties={base-type=uint8, sw-calibration-access=READ-ONLY, range raw 0..255}
            Element_4: symbol=[4]
              mc data instance SoConIdxOfEventQueueStateSoCon: category=VALUE, resulting-properties={base-type=uint8, sw-calibration-access=READ-ONLY, range raw 0..255}
            Element_5: symbol=[5]
              mc data instance SoConIdxOfEventQueueStateSoCon: category=VALUE, resulting-properties={base-type=uint8, sw-calibration-access=READ-ONLY, range raw 0..255}
            Element_6: symbol=[6]
              mc data instance SoConIdxOfEventQueueStateSoCon: category=VALUE, resulting-properties={base-type=uint8, sw-calibration-access=READ-ONLY, range raw 0..255}
            Element_7: symbol=[7]
              mc data instance SoConIdxOfEventQueueStateSoCon: category=VALUE, resulting-properties={base-type=uint8, sw-calibration-access=READ-ONLY, range raw 0..255}
            Element_8: symbol=[8]
              mc data instance SoConIdxOfEventQueueStateSoCon: category=VALUE, resulting-properties={base-type=uint8, sw-calibration-access=READ-ONLY, range raw 0..255}
            Element_9: symbol=[9]
              mc data instance SoConIdxOfEventQueueStateSoCon: category=VALUE, resulting-properties={base-type=uint8, sw-calibration-access=READ-ONLY, range raw 0..255}
            Element_10: symbol=[10]
              mc data instance SoConIdxOfEventQueueStateSoCon: category=VALUE, resulting-properties={base-type=uint8, sw-calibration-access=READ-ONLY, range raw 0..255}
            Element_11: symbol=[11]
              mc data instance SoConIdxOfEventQueueStateSoCon: category=VALUE, resulting-properties={base-type=uint8, sw-calibration-access=READ-ONLY, range raw 0..255}
            Element_12: symbol=[12]
              mc data instance SoConIdxOfEventQueueStateSoCon: category=VALUE, resulting-properties={base-type=uint8, sw-calibration-access=READ-ONLY, range raw 0..255}
            Element_13: symbol=[13]
              mc data instance SoConIdxOfEventQueueStateSoCon: category=VALUE, resulting-properties={base-type=uint8, sw-calibration-access=READ-ONLY, range raw 0..255}
        SoAd_EventQueueTpRxSoCon: category=ARRAY, array-size=2, symbol=SoAd_EventQueueTpRxSoCon.raw  # indicates if TP reception is active on a socket connection with TP SoAdSocketRoute
          mc data instance Element_0: category=STRUCTURE, symbol=[0]
            mc data instance SoConIdxOfEventQueueTpRxSoCon: category=VALUE, resulting-properties={base-type=uint8, sw-calibration-access=READ-ONLY, range raw 0..255}
          mc data instance Element_1: category=STRUCTURE, symbol=[1]
            mc data instance SoConIdxOfEventQueueTpRxSoCon: category=VALUE, resulting-properties={base-type=uint8, sw-calibration-access=READ-ONLY, range raw 0..255}
        SoAd_EventQueueTpRxSoCon_SoAdEventQueueTpRxSoCon_SoAdInstance: category=ARRAY, array-size=2, symbol=SoAd_EventQueueTpRxSoCon.raw[0]  # The element: SoAdEventQueueTpRxSoCon_SoAdInstance of SoAd_EventQueueTpRxSoCon
          mc data instance Element_0: category=STRUCTURE, symbol=[0]
            mc data instance SoConIdxOfEventQueueTpRxSoCon: category=VALUE, resulting-properties={base-type=uint8, sw-calibration-access=READ-ONLY, range raw 0..255}
          mc data instance Element_1: category=STRUCTURE, symbol=[1]
            mc data instance SoConIdxOfEventQueueTpRxSoCon: category=VALUE, resulting-properties={base-type=uint8, sw-calibration-access=READ-ONLY, range raw 0..255}
        SoAd_EventQueueTpTxSoCon: category=ARRAY, array-size=2, symbol=SoAd_EventQueueTpTxSoCon.raw  # indicates if TP transmission is active on a socket connection with TP SoAdPduRoute
          mc data instance Element_0: category=STRUCTURE, symbol=[0]
            mc data instance SoConIdxOfEventQueueTpTxSoCon: category=VALUE, resulting-properties={base-type=uint8, sw-calibration-access=READ-ONLY, range raw 0..255}
          mc data instance Element_1: category=STRUCTURE, symbol=[1]
            mc data instance SoConIdxOfEventQueueTpTxSoCon: category=VALUE, resulting-properties={base-type=uint8, sw-calibration-access=READ-ONLY, range raw 0..255}
        SoAd_EventQueueTpTxSoCon_SoAdEventQueueTpTxSoCon_SoAdInstance: category=ARRAY, array-size=2, symbol=SoAd_EventQueueTpTxSoCon.raw[0]  # The element: SoAdEventQueueTpTxSoCon_SoAdInstance of SoAd_EventQueueTpTxSoCon
          mc data instance Element_0: category=STRUCTURE, symbol=[0]
            mc data instance SoConIdxOfEventQueueTpTxSoCon: category=VALUE, resulting-properties={base-type=uint8, sw-calibration-access=READ-ONLY, range raw 0..255}
          mc data instance Element_1: category=STRUCTURE, symbol=[1]
            mc data instance SoConIdxOfEventQueueTpTxSoCon: category=VALUE, resulting-properties={base-type=uint8, sw-calibration-access=READ-ONLY, range raw 0..255}
        SoAd_RouteGrpSoConDyn: category=ARRAY, array-size=3  # the routing groups on the socket connections management struct
          mc data instance Element_0: category=STRUCTURE, symbol=[0]
            mc data instance EnabledOfRouteGrpSoConDyn: category=VALUE, resulting-properties={base-type=boolean, sw-calibration-access=READ-ONLY, compu {0=FALSE, 1..255=TRUE}, range raw 0..1}
            mc data instance SentOfRouteGrpSoConDyn: category=VALUE, resulting-properties={base-type=boolean, sw-calibration-access=READ-ONLY, compu {0=FALSE, 1..255=TRUE}, range raw 0..1}
            mc data instance TriggerOfRouteGrpSoConDyn: category=VALUE, resulting-properties={base-type=boolean, sw-calibration-access=READ-ONLY, compu {0=FALSE, 1..255=TRUE}, range raw 0..1}
          mc data instance Element_1: category=STRUCTURE, symbol=[1]
            mc data instance EnabledOfRouteGrpSoConDyn: category=VALUE, resulting-properties={base-type=boolean, sw-calibration-access=READ-ONLY, compu {0=FALSE, 1..255=TRUE}, range raw 0..1}
            mc data instance SentOfRouteGrpSoConDyn: category=VALUE, resulting-properties={base-type=boolean, sw-calibration-access=READ-ONLY, compu {0=FALSE, 1..255=TRUE}, range raw 0..1}
            mc data instance TriggerOfRouteGrpSoConDyn: category=VALUE, resulting-properties={base-type=boolean, sw-calibration-access=READ-ONLY, compu {0=FALSE, 1..255=TRUE}, range raw 0..1}
          mc data instance Element_2: category=STRUCTURE, symbol=[2]
            mc data instance EnabledOfRouteGrpSoConDyn: category=VALUE, resulting-properties={base-type=boolean, sw-calibration-access=READ-ONLY, compu {0=FALSE, 1..255=TRUE}, range raw 0..1}
            mc data instance SentOfRouteGrpSoConDyn: category=VALUE, resulting-properties={base-type=boolean, sw-calibration-access=READ-ONLY, compu {0=FALSE, 1..255=TRUE}, range raw 0..1}
            mc data instance TriggerOfRouteGrpSoConDyn: category=VALUE, resulting-properties={base-type=boolean, sw-calibration-access=READ-ONLY, compu {0=FALSE, 1..255=TRUE}, range raw 0..1}
        SoAd_RxBufStructMgt: category=ARRAY, array-size=2, symbol=SoAd_RxBufStructMgt.raw  # the Rx buffer struct management struct
          mc data instance Element_0: category=STRUCTURE, symbol=[0]
            mc data instance RxBufStructSegIdxOfRxBufStructMgt: category=VALUE, resulting-properties={base-type=uint8, sw-calibration-access=READ-ONLY, range raw 0..255}
            mc data instance RxBufStructSegLvlOfRxBufStructMgt: category=VALUE, resulting-properties={base-type=uint8, sw-calibration-access=READ-ONLY, range raw 0..255}
          mc data instance Element_1: category=STRUCTURE, symbol=[1]
            mc data instance RxBufStructSegIdxOfRxBufStructMgt: category=VALUE, resulting-properties={base-type=uint8, sw-calibration-access=READ-ONLY, range raw 0..255}
            mc data instance RxBufStructSegLvlOfRxBufStructMgt: category=VALUE, resulting-properties={base-type=uint8, sw-calibration-access=READ-ONLY, range raw 0..255}
        SoAd_RxBufStructMgt_SCB_DoIP_TCP_14c6c034: category=ARRAY, array-size=1, symbol=SoAd_RxBufStructMgt.raw[0]  # The element: SCB_DoIP_TCP_14c6c034 of SoAd_RxBufStructMgt
          mc data instance Element_0: category=STRUCTURE, symbol=[0]
            mc data instance RxBufStructSegIdxOfRxBufStructMgt: category=VALUE, resulting-properties={base-type=uint8, sw-calibration-access=READ-ONLY, range raw 0..255}
            mc data instance RxBufStructSegLvlOfRxBufStructMgt: category=VALUE, resulting-properties={base-type=uint8, sw-calibration-access=READ-ONLY, range raw 0..255}
        SoAd_RxBufStructMgt_SCB_DoIP_TCP_b2b1cb80: category=ARRAY, array-size=1, symbol=SoAd_RxBufStructMgt.raw[1]  # The element: SCB_DoIP_TCP_b2b1cb80 of SoAd_RxBufStructMgt
          mc data instance Element_0: category=STRUCTURE, symbol=[0]
            mc data instance RxBufStructSegIdxOfRxBufStructMgt: category=VALUE, resulting-properties={base-type=uint8, sw-calibration-access=READ-ONLY, range raw 0..255}
            mc data instance RxBufStructSegLvlOfRxBufStructMgt: category=VALUE, resulting-properties={base-type=uint8, sw-calibration-access=READ-ONLY, range raw 0..255}
        SoAd_RxMgt: category=ARRAY, array-size=12, symbol=SoAd_RxMgt.raw  # the Rx management structs
          12 x mc data instance, all with category=STRUCTURE:
            Element_0: symbol=[0]
              mc data instance RxBytesPendingOfRxMgt: category=VALUE, resulting-properties={base-type=uint16, sw-calibration-access=READ-ONLY, range raw 0..65535}
              mc data instance CancelRequestedOfRxMgt: category=VALUE, resulting-properties={base-type=boolean, sw-calibration-access=READ-ONLY, compu {0=FALSE, 1..255=TRUE}, range raw 0..1}
              mc data instance SocketRouteDestIdxOfRxMgt: category=VALUE, resulting-properties={base-type=uint8, sw-calibration-access=READ-ONLY, range raw 0..255}
            Element_1: symbol=[1]
              mc data instance RxBytesPendingOfRxMgt: category=VALUE, resulting-properties={base-type=uint16, sw-calibration-access=READ-ONLY, range raw 0..65535}
              mc data instance CancelRequestedOfRxMgt: category=VALUE, resulting-properties={base-type=boolean, sw-calibration-access=READ-ONLY, compu {0=FALSE, 1..255=TRUE}, range raw 0..1}
              mc data instance SocketRouteDestIdxOfRxMgt: category=VALUE, resulting-properties={base-type=uint8, sw-calibration-access=READ-ONLY, range raw 0..255}
            Element_2: symbol=[2]
              mc data instance RxBytesPendingOfRxMgt: category=VALUE, resulting-properties={base-type=uint16, sw-calibration-access=READ-ONLY, range raw 0..65535}
              mc data instance CancelRequestedOfRxMgt: category=VALUE, resulting-properties={base-type=boolean, sw-calibration-access=READ-ONLY, compu {0=FALSE, 1..255=TRUE}, range raw 0..1}
              mc data instance SocketRouteDestIdxOfRxMgt: category=VALUE, resulting-properties={base-type=uint8, sw-calibration-access=READ-ONLY, range raw 0..255}
            Element_3: symbol=[3]
              mc data instance RxBytesPendingOfRxMgt: category=VALUE, resulting-properties={base-type=uint16, sw-calibration-access=READ-ONLY, range raw 0..65535}
              mc data instance CancelRequestedOfRxMgt: category=VALUE, resulting-properties={base-type=boolean, sw-calibration-access=READ-ONLY, compu {0=FALSE, 1..255=TRUE}, range raw 0..1}
              mc data instance SocketRouteDestIdxOfRxMgt: category=VALUE, resulting-properties={base-type=uint8, sw-calibration-access=READ-ONLY, range raw 0..255}
            Element_4: symbol=[4]
              mc data instance RxBytesPendingOfRxMgt: category=VALUE, resulting-properties={base-type=uint16, sw-calibration-access=READ-ONLY, range raw 0..65535}
              mc data instance CancelRequestedOfRxMgt: category=VALUE, resulting-properties={base-type=boolean, sw-calibration-access=READ-ONLY, compu {0=FALSE, 1..255=TRUE}, range raw 0..1}
              mc data instance SocketRouteDestIdxOfRxMgt: category=VALUE, resulting-properties={base-type=uint8, sw-calibration-access=READ-ONLY, range raw 0..255}
            Element_5: symbol=[5]
              mc data instance RxBytesPendingOfRxMgt: category=VALUE, resulting-properties={base-type=uint16, sw-calibration-access=READ-ONLY, range raw 0..65535}
              mc data instance CancelRequestedOfRxMgt: category=VALUE, resulting-properties={base-type=boolean, sw-calibration-access=READ-ONLY, compu {0=FALSE, 1..255=TRUE}, range raw 0..1}
              mc data instance SocketRouteDestIdxOfRxMgt: category=VALUE, resulting-properties={base-type=uint8, sw-calibration-access=READ-ONLY, range raw 0..255}
            Element_6: symbol=[6]
              mc data instance RxBytesPendingOfRxMgt: category=VALUE, resulting-properties={base-type=uint16, sw-calibration-access=READ-ONLY, range raw 0..65535}
              mc data instance CancelRequestedOfRxMgt: category=VALUE, resulting-properties={base-type=boolean, sw-calibration-access=READ-ONLY, compu {0=FALSE, 1..255=TRUE}, range raw 0..1}
              mc data instance SocketRouteDestIdxOfRxMgt: category=VALUE, resulting-properties={base-type=uint8, sw-calibration-access=READ-ONLY, range raw 0..255}
            Element_7: symbol=[7]
              mc data instance RxBytesPendingOfRxMgt: category=VALUE, resulting-properties={base-type=uint16, sw-calibration-access=READ-ONLY, range raw 0..65535}
              mc data instance CancelRequestedOfRxMgt: category=VALUE, resulting-properties={base-type=boolean, sw-calibration-access=READ-ONLY, compu {0=FALSE, 1..255=TRUE}, range raw 0..1}
              mc data instance SocketRouteDestIdxOfRxMgt: category=VALUE, resulting-properties={base-type=uint8, sw-calibration-access=READ-ONLY, range raw 0..255}
            Element_8: symbol=[8]
              mc data instance RxBytesPendingOfRxMgt: category=VALUE, resulting-properties={base-type=uint16, sw-calibration-access=READ-ONLY, range raw 0..65535}
              mc data instance CancelRequestedOfRxMgt: category=VALUE, resulting-properties={base-type=boolean, sw-calibration-access=READ-ONLY, compu {0=FALSE, 1..255=TRUE}, range raw 0..1}
              mc data instance SocketRouteDestIdxOfRxMgt: category=VALUE, resulting-properties={base-type=uint8, sw-calibration-access=READ-ONLY, range raw 0..255}
            Element_9: symbol=[9]
              mc data instance RxBytesPendingOfRxMgt: category=VALUE, resulting-properties={base-type=uint16, sw-calibration-access=READ-ONLY, range raw 0..65535}
              mc data instance CancelRequestedOfRxMgt: category=VALUE, resulting-properties={base-type=boolean, sw-calibration-access=READ-ONLY, compu {0=FALSE, 1..255=TRUE}, range raw 0..1}
              mc data instance SocketRouteDestIdxOfRxMgt: category=VALUE, resulting-properties={base-type=uint8, sw-calibration-access=READ-ONLY, range raw 0..255}
            Element_10: symbol=[10]
              mc data instance RxBytesPendingOfRxMgt: category=VALUE, resulting-properties={base-type=uint16, sw-calibration-access=READ-ONLY, range raw 0..65535}
              mc data instance CancelRequestedOfRxMgt: category=VALUE, resulting-properties={base-type=boolean, sw-calibration-access=READ-ONLY, compu {0=FALSE, 1..255=TRUE}, range raw 0..1}
              mc data instance SocketRouteDestIdxOfRxMgt: category=VALUE, resulting-properties={base-type=uint8, sw-calibration-access=READ-ONLY, range raw 0..255}
            Element_11: symbol=[11]
              mc data instance RxBytesPendingOfRxMgt: category=VALUE, resulting-properties={base-type=uint16, sw-calibration-access=READ-ONLY, range raw 0..65535}
              mc data instance CancelRequestedOfRxMgt: category=VALUE, resulting-properties={base-type=boolean, sw-calibration-access=READ-ONLY, compu {0=FALSE, 1..255=TRUE}, range raw 0..1}
              mc data instance SocketRouteDestIdxOfRxMgt: category=VALUE, resulting-properties={base-type=uint8, sw-calibration-access=READ-ONLY, range raw 0..255}
        SoAd_RxMgt_SCB_NM_Global_afa15e29: category=ARRAY, array-size=1, symbol=SoAd_RxMgt.raw[0]  # The element: SCB_NM_Global_afa15e29 of SoAd_RxMgt
          mc data instance Element_0: category=STRUCTURE, symbol=[0]
            mc data instance RxBytesPendingOfRxMgt: category=VALUE, resulting-properties={base-type=uint16, sw-calibration-access=READ-ONLY, range raw 0..65535}
            mc data instance CancelRequestedOfRxMgt: category=VALUE, resulting-properties={base-type=boolean, sw-calibration-access=READ-ONLY, compu {0=FALSE, 1..255=TRUE}, range raw 0..1}
            mc data instance SocketRouteDestIdxOfRxMgt: category=VALUE, resulting-properties={base-type=uint8, sw-calibration-access=READ-ONLY, range raw 0..255}
        SoAd_RxMgt_SCB_Basics_f1920dfe: category=ARRAY, array-size=1, symbol=SoAd_RxMgt.raw[1]  # The element: SCB_Basics_f1920dfe of SoAd_RxMgt
          mc data instance Element_0: category=STRUCTURE, symbol=[0]
            mc data instance RxBytesPendingOfRxMgt: category=VALUE, resulting-properties={base-type=uint16, sw-calibration-access=READ-ONLY, range raw 0..65535}
            mc data instance CancelRequestedOfRxMgt: category=VALUE, resulting-properties={base-type=boolean, sw-calibration-access=READ-ONLY, compu {0=FALSE, 1..255=TRUE}, range raw 0..1}
            mc data instance SocketRouteDestIdxOfRxMgt: category=VALUE, resulting-properties={base-type=uint8, sw-calibration-access=READ-ONLY, range raw 0..255}
        SoAd_RxMgt_SCB_DoIP_TCP_14c6c034: category=ARRAY, array-size=1, symbol=SoAd_RxMgt.raw[2]  # The element: SCB_DoIP_TCP_14c6c034 of SoAd_RxMgt
          mc data instance Element_0: category=STRUCTURE, symbol=[0]
            mc data instance RxBytesPendingOfRxMgt: category=VALUE, resulting-properties={base-type=uint16, sw-calibration-access=READ-ONLY, range raw 0..65535}
            mc data instance CancelRequestedOfRxMgt: category=VALUE, resulting-properties={base-type=boolean, sw-calibration-access=READ-ONLY, compu {0=FALSE, 1..255=TRUE}, range raw 0..1}
            mc data instance SocketRouteDestIdxOfRxMgt: category=VALUE, resulting-properties={base-type=uint8, sw-calibration-access=READ-ONLY, range raw 0..255}
        SoAd_RxMgt_SCB_DoIP_TCP_b2b1cb80: category=ARRAY, array-size=1, symbol=SoAd_RxMgt.raw[3]  # The element: SCB_DoIP_TCP_b2b1cb80 of SoAd_RxMgt
          mc data instance Element_0: category=STRUCTURE, symbol=[0]
            mc data instance RxBytesPendingOfRxMgt: category=VALUE, resulting-properties={base-type=uint16, sw-calibration-access=READ-ONLY, range raw 0..65535}
            mc data instance CancelRequestedOfRxMgt: category=VALUE, resulting-properties={base-type=boolean, sw-calibration-access=READ-ONLY, compu {0=FALSE, 1..255=TRUE}, range raw 0..1}
            mc data instance SocketRouteDestIdxOfRxMgt: category=VALUE, resulting-properties={base-type=uint8, sw-calibration-access=READ-ONLY, range raw 0..255}
        SoAd_RxMgt_SCB_DoIP_UDP_6c08ed5a: category=ARRAY, array-size=1, symbol=SoAd_RxMgt.raw[4]  # The element: SCB_DoIP_UDP_6c08ed5a of SoAd_RxMgt
          mc data instance Element_0: category=STRUCTURE, symbol=[0]
            mc data instance RxBytesPendingOfRxMgt: category=VALUE, resulting-properties={base-type=uint16, sw-calibration-access=READ-ONLY, range raw 0..65535}
            mc data instance CancelRequestedOfRxMgt: category=VALUE, resulting-properties={base-type=boolean, sw-calibration-access=READ-ONLY, compu {0=FALSE, 1..255=TRUE}, range raw 0..1}
            mc data instance SocketRouteDestIdxOfRxMgt: category=VALUE, resulting-properties={base-type=uint8, sw-calibration-access=READ-ONLY, range raw 0..255}
        SoAd_RxMgt_SCB_Math_88dbc7c0: category=ARRAY, array-size=1, symbol=SoAd_RxMgt.raw[5]  # The element: SCB_Math_88dbc7c0 of SoAd_RxMgt
          mc data instance Element_0: category=STRUCTURE, symbol=[0]
            mc data instance RxBytesPendingOfRxMgt: category=VALUE, resulting-properties={base-type=uint16, sw-calibration-access=READ-ONLY, range raw 0..65535}
            mc data instance CancelRequestedOfRxMgt: category=VALUE, resulting-properties={base-type=boolean, sw-calibration-access=READ-ONLY, compu {0=FALSE, 1..255=TRUE}, range raw 0..1}
            mc data instance SocketRouteDestIdxOfRxMgt: category=VALUE, resulting-properties={base-type=uint8, sw-calibration-access=READ-ONLY, range raw 0..255}
        SoAd_RxMgt_SCB_Xcp_MyECU_0195b261: category=ARRAY, array-size=1, symbol=SoAd_RxMgt.raw[6]  # The element: SCB_Xcp_MyECU_0195b261 of SoAd_RxMgt
          mc data instance Element_0: category=STRUCTURE, symbol=[0]
            mc data instance RxBytesPendingOfRxMgt: category=VALUE, resulting-properties={base-type=uint16, sw-calibration-access=READ-ONLY, range raw 0..65535}
            mc data instance CancelRequestedOfRxMgt: category=VALUE, resulting-properties={base-type=boolean, sw-calibration-access=READ-ONLY, compu {0=FALSE, 1..255=TRUE}, range raw 0..1}
            mc data instance SocketRouteDestIdxOfRxMgt: category=VALUE, resulting-properties={base-type=uint8, sw-calibration-access=READ-ONLY, range raw 0..255}
        SoAd_RxMgt_SD_Uni_MyECU_d52779b2: category=ARRAY, array-size=1, symbol=SoAd_RxMgt.raw[7]  # The element: SD_Uni_MyECU_d52779b2 of SoAd_RxMgt
          mc data instance Element_0: category=STRUCTURE, symbol=[0]
            mc data instance RxBytesPendingOfRxMgt: category=VALUE, resulting-properties={base-type=uint16, sw-calibration-access=READ-ONLY, range raw 0..65535}
            mc data instance CancelRequestedOfRxMgt: category=VALUE, resulting-properties={base-type=boolean, sw-calibration-access=READ-ONLY, compu {0=FALSE, 1..255=TRUE}, range raw 0..1}
            mc data instance SocketRouteDestIdxOfRxMgt: category=VALUE, resulting-properties={base-type=uint8, sw-calibration-access=READ-ONLY, range raw 0..255}
        SoAd_RxMgt_StartApplication_CCLD_SoAdSocketConnection_SoAdCdd_Udp: category=ARRAY, array-size=1, symbol=SoAd_RxMgt.raw[8]  # The element: StartApplication_CCLD_SoAdSocketConnection_SoAdCdd_Udp of SoAd_RxMgt
          mc data instance Element_0: category=STRUCTURE, symbol=[0]
            mc data instance RxBytesPendingOfRxMgt: category=VALUE, resulting-properties={base-type=uint16, sw-calibration-access=READ-ONLY, range raw 0..65535}
            mc data instance CancelRequestedOfRxMgt: category=VALUE, resulting-properties={base-type=boolean, sw-calibration-access=READ-ONLY, compu {0=FALSE, 1..255=TRUE}, range raw 0..1}
            mc data instance SocketRouteDestIdxOfRxMgt: category=VALUE, resulting-properties={base-type=uint8, sw-calibration-access=READ-ONLY, range raw 0..255}
        SoAd_RxMgt_StartApplication_CC_SoAdSocketConnection_SoAdCdd_Udp: category=ARRAY, array-size=1, symbol=SoAd_RxMgt.raw[9]  # The element: StartApplication_CC_SoAdSocketConnection_SoAdCdd_Udp of SoAd_RxMgt
          mc data instance Element_0: category=STRUCTURE, symbol=[0]
            mc data instance RxBytesPendingOfRxMgt: category=VALUE, resulting-properties={base-type=uint16, sw-calibration-access=READ-ONLY, range raw 0..65535}
            mc data instance CancelRequestedOfRxMgt: category=VALUE, resulting-properties={base-type=boolean, sw-calibration-access=READ-ONLY, compu {0=FALSE, 1..255=TRUE}, range raw 0..1}
            mc data instance SocketRouteDestIdxOfRxMgt: category=VALUE, resulting-properties={base-type=uint8, sw-calibration-access=READ-ONLY, range raw 0..255}
        SoAd_RxMgt_StartApplication_ETH_SoAdSocketConnection_SoAdCdd_Udp: category=ARRAY, array-size=1, symbol=SoAd_RxMgt.raw[10]  # The element: StartApplication_ETH_SoAdSocketConnection_SoAdCdd_Udp of SoAd_RxMgt
          mc data instance Element_0: category=STRUCTURE, symbol=[0]
            mc data instance RxBytesPendingOfRxMgt: category=VALUE, resulting-properties={base-type=uint16, sw-calibration-access=READ-ONLY, range raw 0..65535}
            mc data instance CancelRequestedOfRxMgt: category=VALUE, resulting-properties={base-type=boolean, sw-calibration-access=READ-ONLY, compu {0=FALSE, 1..255=TRUE}, range raw 0..1}
            mc data instance SocketRouteDestIdxOfRxMgt: category=VALUE, resulting-properties={base-type=uint8, sw-calibration-access=READ-ONLY, range raw 0..255}
        SoAd_RxMgt_SD_Multi_MyECU_5d6e9596: category=ARRAY, array-size=1, symbol=SoAd_RxMgt.raw[11]  # The element: SD_Multi_MyECU_5d6e9596 of SoAd_RxMgt
          mc data instance Element_0: category=STRUCTURE, symbol=[0]
            mc data instance RxBytesPendingOfRxMgt: category=VALUE, resulting-properties={base-type=uint16, sw-calibration-access=READ-ONLY, range raw 0..65535}
            mc data instance CancelRequestedOfRxMgt: category=VALUE, resulting-properties={base-type=boolean, sw-calibration-access=READ-ONLY, compu {0=FALSE, 1..255=TRUE}, range raw 0..1}
            mc data instance SocketRouteDestIdxOfRxMgt: category=VALUE, resulting-properties={base-type=uint8, sw-calibration-access=READ-ONLY, range raw 0..255}
        SoAd_TcpTxQueueData: category=ARRAY, array-size=4, symbol=SoAd_TcpTxQueueData.raw  # the Tx TCP queue elements
          4 x mc data instance, all with category=STRUCTURE:
            Element_0: symbol=[0]
              mc data instance LenOfTcpTxQueueData: category=VALUE, resulting-properties={base-type=uint16, sw-calibration-access=READ-ONLY, range raw 0..65535}
              mc data instance PduRouteIdxOfTcpTxQueueData: category=VALUE, resulting-properties={base-type=uint8, sw-calibration-access=READ-ONLY, range raw 0..255}
            Element_1: symbol=[1]
              mc data instance LenOfTcpTxQueueData: category=VALUE, resulting-properties={base-type=uint16, sw-calibration-access=READ-ONLY, range raw 0..65535}
              mc data instance PduRouteIdxOfTcpTxQueueData: category=VALUE, resulting-properties={base-type=uint8, sw-calibration-access=READ-ONLY, range raw 0..255}
            Element_2: symbol=[2]
              mc data instance LenOfTcpTxQueueData: category=VALUE, resulting-properties={base-type=uint16, sw-calibration-access=READ-ONLY, range raw 0..65535}
              mc data instance PduRouteIdxOfTcpTxQueueData: category=VALUE, resulting-properties={base-type=uint8, sw-calibration-access=READ-ONLY, range raw 0..255}
            Element_3: symbol=[3]
              mc data instance LenOfTcpTxQueueData: category=VALUE, resulting-properties={base-type=uint16, sw-calibration-access=READ-ONLY, range raw 0..65535}
              mc data instance PduRouteIdxOfTcpTxQueueData: category=VALUE, resulting-properties={base-type=uint8, sw-calibration-access=READ-ONLY, range raw 0..255}
        SoAd_TcpTxQueueData_SCB_DoIP_TCP_14c6c034: category=ARRAY, array-size=2, symbol=SoAd_TcpTxQueueData.raw[0]  # The element: SCB_DoIP_TCP_14c6c034 of SoAd_TcpTxQueueData
          mc data instance Element_0: category=STRUCTURE, symbol=[0]
            mc data instance LenOfTcpTxQueueData: category=VALUE, resulting-properties={base-type=uint16, sw-calibration-access=READ-ONLY, range raw 0..65535}
            mc data instance PduRouteIdxOfTcpTxQueueData: category=VALUE, resulting-properties={base-type=uint8, sw-calibration-access=READ-ONLY, range raw 0..255}
          mc data instance Element_1: category=STRUCTURE, symbol=[1]
            mc data instance LenOfTcpTxQueueData: category=VALUE, resulting-properties={base-type=uint16, sw-calibration-access=READ-ONLY, range raw 0..65535}
            mc data instance PduRouteIdxOfTcpTxQueueData: category=VALUE, resulting-properties={base-type=uint8, sw-calibration-access=READ-ONLY, range raw 0..255}
        SoAd_TcpTxQueueData_SCB_DoIP_TCP_b2b1cb80: category=ARRAY, array-size=2, symbol=SoAd_TcpTxQueueData.raw[2]  # The element: SCB_DoIP_TCP_b2b1cb80 of SoAd_TcpTxQueueData
          mc data instance Element_0: category=STRUCTURE, symbol=[0]
            mc data instance LenOfTcpTxQueueData: category=VALUE, resulting-properties={base-type=uint16, sw-calibration-access=READ-ONLY, range raw 0..65535}
            mc data instance PduRouteIdxOfTcpTxQueueData: category=VALUE, resulting-properties={base-type=uint8, sw-calibration-access=READ-ONLY, range raw 0..255}
          mc data instance Element_1: category=STRUCTURE, symbol=[1]
            mc data instance LenOfTcpTxQueueData: category=VALUE, resulting-properties={base-type=uint16, sw-calibration-access=READ-ONLY, range raw 0..65535}
            mc data instance PduRouteIdxOfTcpTxQueueData: category=VALUE, resulting-properties={base-type=uint8, sw-calibration-access=READ-ONLY, range raw 0..255}
        SoAd_TcpTxQueueMgt: category=ARRAY, array-size=2, symbol=SoAd_TcpTxQueueMgt.raw  # the Tx TCP queue management structs
          mc data instance Element_0: category=STRUCTURE, symbol=[0]
            mc data instance TotLenOfTcpTxQueueMgt: category=VALUE, resulting-properties={base-type=uint32, sw-calibration-access=READ-ONLY, range raw 0..4294967295}
            mc data instance LvlOfTcpTxQueueMgt: category=VALUE, resulting-properties={base-type=uint16, sw-calibration-access=READ-ONLY, range raw 0..65535}
            mc data instance TcpTxQueueDataIdxOfTcpTxQueueMgt: category=VALUE, resulting-properties={base-type=uint8, sw-calibration-access=READ-ONLY, range raw 0..255}
          mc data instance Element_1: category=STRUCTURE, symbol=[1]
            mc data instance TotLenOfTcpTxQueueMgt: category=VALUE, resulting-properties={base-type=uint32, sw-calibration-access=READ-ONLY, range raw 0..4294967295}
            mc data instance LvlOfTcpTxQueueMgt: category=VALUE, resulting-properties={base-type=uint16, sw-calibration-access=READ-ONLY, range raw 0..65535}
            mc data instance TcpTxQueueDataIdxOfTcpTxQueueMgt: category=VALUE, resulting-properties={base-type=uint8, sw-calibration-access=READ-ONLY, range raw 0..255}
        SoAd_TcpTxQueueMgt_SCB_DoIP_TCP_14c6c034: category=ARRAY, array-size=1, symbol=SoAd_TcpTxQueueMgt.raw[0]  # The element: SCB_DoIP_TCP_14c6c034 of SoAd_TcpTxQueueMgt
          mc data instance Element_0: category=STRUCTURE, symbol=[0]
            mc data instance TotLenOfTcpTxQueueMgt: category=VALUE, resulting-properties={base-type=uint32, sw-calibration-access=READ-ONLY, range raw 0..4294967295}
            mc data instance LvlOfTcpTxQueueMgt: category=VALUE, resulting-properties={base-type=uint16, sw-calibration-access=READ-ONLY, range raw 0..65535}
            mc data instance TcpTxQueueDataIdxOfTcpTxQueueMgt: category=VALUE, resulting-properties={base-type=uint8, sw-calibration-access=READ-ONLY, range raw 0..255}
        SoAd_TcpTxQueueMgt_SCB_DoIP_TCP_b2b1cb80: category=ARRAY, array-size=1, symbol=SoAd_TcpTxQueueMgt.raw[1]  # The element: SCB_DoIP_TCP_b2b1cb80 of SoAd_TcpTxQueueMgt
          mc data instance Element_0: category=STRUCTURE, symbol=[0]
            mc data instance TotLenOfTcpTxQueueMgt: category=VALUE, resulting-properties={base-type=uint32, sw-calibration-access=READ-ONLY, range raw 0..4294967295}
            mc data instance LvlOfTcpTxQueueMgt: category=VALUE, resulting-properties={base-type=uint16, sw-calibration-access=READ-ONLY, range raw 0..65535}
            mc data instance TcpTxQueueDataIdxOfTcpTxQueueMgt: category=VALUE, resulting-properties={base-type=uint8, sw-calibration-access=READ-ONLY, range raw 0..255}
        SoAd_TimeoutListMgmt: category=ARRAY, array-size=1, symbol=SoAd_TimeoutListMgmt.raw  # the management struct of all timeout lists
          mc data instance Element_0: category=STRUCTURE, symbol=[0]
            mc data instance LvlOfTimeoutListMgmt: category=VALUE, resulting-properties={base-type=uint16, sw-calibration-access=READ-ONLY, range raw 0..65535}
        SoAd_TimeoutListMgmt_SoAdTimeoutListUdpAlive_SoAdInstance: category=ARRAY, array-size=1, symbol=SoAd_TimeoutListMgmt.raw[0]  # The element: SoAdTimeoutListUdpAlive_SoAdInstance of SoAd_TimeoutListMgmt
          mc data instance Element_0: category=STRUCTURE, symbol=[0]
            mc data instance LvlOfTimeoutListMgmt: category=VALUE, resulting-properties={base-type=uint16, sw-calibration-access=READ-ONLY, range raw 0..65535}
        SoAd_TimeoutListUdpAlive: category=ARRAY, array-size=2, symbol=SoAd_TimeoutListUdpAlive.raw  # the timeout list for UDP Alive supervision timeout
          mc data instance Element_0: category=STRUCTURE, symbol=[0]
            mc data instance TimeoutOfTimeoutListUdpAlive: category=VALUE, resulting-properties={base-type=uint32, sw-calibration-access=READ-ONLY, range raw 0..4294967295}
            mc data instance SoConIdxOfTimeoutListUdpAlive: category=VALUE, resulting-properties={base-type=uint8, sw-calibration-access=READ-ONLY, range raw 0..255}
          mc data instance Element_1: category=STRUCTURE, symbol=[1]
            mc data instance TimeoutOfTimeoutListUdpAlive: category=VALUE, resulting-properties={base-type=uint32, sw-calibration-access=READ-ONLY, range raw 0..4294967295}
            mc data instance SoConIdxOfTimeoutListUdpAlive: category=VALUE, resulting-properties={base-type=uint8, sw-calibration-access=READ-ONLY, range raw 0..255}
        SoAd_TimeoutListUdpAlive_SoAdTimeoutListUdpAlive_SoAdInstance: category=ARRAY, array-size=2, symbol=SoAd_TimeoutListUdpAlive.raw[0]  # The element: SoAdTimeoutListUdpAlive_SoAdInstance of SoAd_TimeoutListUdpAlive
          mc data instance Element_0: category=STRUCTURE, symbol=[0]
            mc data instance TimeoutOfTimeoutListUdpAlive: category=VALUE, resulting-properties={base-type=uint32, sw-calibration-access=READ-ONLY, range raw 0..4294967295}
            mc data instance SoConIdxOfTimeoutListUdpAlive: category=VALUE, resulting-properties={base-type=uint8, sw-calibration-access=READ-ONLY, range raw 0..255}
          mc data instance Element_1: category=STRUCTURE, symbol=[1]
            mc data instance TimeoutOfTimeoutListUdpAlive: category=VALUE, resulting-properties={base-type=uint32, sw-calibration-access=READ-ONLY, range raw 0..4294967295}
            mc data instance SoConIdxOfTimeoutListUdpAlive: category=VALUE, resulting-properties={base-type=uint8, sw-calibration-access=READ-ONLY, range raw 0..255}
        SoAd_TimeoutListUdpAliveMap: category=ARRAY, array-size=14, symbol=SoAd_TimeoutListUdpAliveMap.raw  # maps all socket connections to the timeout list index for UDP Alive supervision timeout if timeout is running
          14 x mc data instance, all with category=STRUCTURE:
            Element_0: symbol=[0]
              mc data instance TimeoutListUdpAliveIdxOfTimeoutListUdpAliveMap: category=VALUE, resulting-properties={base-type=uint8, sw-calibration-access=READ-ONLY, range raw 0..255}
            Element_1: symbol=[1]
              mc data instance TimeoutListUdpAliveIdxOfTimeoutListUdpAliveMap: category=VALUE, resulting-properties={base-type=uint8, sw-calibration-access=READ-ONLY, range raw 0..255}
            Element_2: symbol=[2]
              mc data instance TimeoutListUdpAliveIdxOfTimeoutListUdpAliveMap: category=VALUE, resulting-properties={base-type=uint8, sw-calibration-access=READ-ONLY, range raw 0..255}
            Element_3: symbol=[3]
              mc data instance TimeoutListUdpAliveIdxOfTimeoutListUdpAliveMap: category=VALUE, resulting-properties={base-type=uint8, sw-calibration-access=READ-ONLY, range raw 0..255}
            Element_4: symbol=[4]
              mc data instance TimeoutListUdpAliveIdxOfTimeoutListUdpAliveMap: category=VALUE, resulting-properties={base-type=uint8, sw-calibration-access=READ-ONLY, range raw 0..255}
            Element_5: symbol=[5]
              mc data instance TimeoutListUdpAliveIdxOfTimeoutListUdpAliveMap: category=VALUE, resulting-properties={base-type=uint8, sw-calibration-access=READ-ONLY, range raw 0..255}
            Element_6: symbol=[6]
              mc data instance TimeoutListUdpAliveIdxOfTimeoutListUdpAliveMap: category=VALUE, resulting-properties={base-type=uint8, sw-calibration-access=READ-ONLY, range raw 0..255}
            Element_7: symbol=[7]
              mc data instance TimeoutListUdpAliveIdxOfTimeoutListUdpAliveMap: category=VALUE, resulting-properties={base-type=uint8, sw-calibration-access=READ-ONLY, range raw 0..255}
            Element_8: symbol=[8]
              mc data instance TimeoutListUdpAliveIdxOfTimeoutListUdpAliveMap: category=VALUE, resulting-properties={base-type=uint8, sw-calibration-access=READ-ONLY, range raw 0..255}
            Element_9: symbol=[9]
              mc data instance TimeoutListUdpAliveIdxOfTimeoutListUdpAliveMap: category=VALUE, resulting-properties={base-type=uint8, sw-calibration-access=READ-ONLY, range raw 0..255}
            Element_10: symbol=[10]
              mc data instance TimeoutListUdpAliveIdxOfTimeoutListUdpAliveMap: category=VALUE, resulting-properties={base-type=uint8, sw-calibration-access=READ-ONLY, range raw 0..255}
            Element_11: symbol=[11]
              mc data instance TimeoutListUdpAliveIdxOfTimeoutListUdpAliveMap: category=VALUE, resulting-properties={base-type=uint8, sw-calibration-access=READ-ONLY, range raw 0..255}
            Element_12: symbol=[12]
              mc data instance TimeoutListUdpAliveIdxOfTimeoutListUdpAliveMap: category=VALUE, resulting-properties={base-type=uint8, sw-calibration-access=READ-ONLY, range raw 0..255}
            Element_13: symbol=[13]
              mc data instance TimeoutListUdpAliveIdxOfTimeoutListUdpAliveMap: category=VALUE, resulting-properties={base-type=uint8, sw-calibration-access=READ-ONLY, range raw 0..255}
        SoAd_TimeoutListUdpAliveMap_SoAd: category=ARRAY, array-size=14, symbol=SoAd_TimeoutListUdpAliveMap.raw[0]  # The element: SoAd of SoAd_TimeoutListUdpAliveMap
          14 x mc data instance, all with category=STRUCTURE:
            Element_0: symbol=[0]
              mc data instance TimeoutListUdpAliveIdxOfTimeoutListUdpAliveMap: category=VALUE, resulting-properties={base-type=uint8, sw-calibration-access=READ-ONLY, range raw 0..255}
            Element_1: symbol=[1]
              mc data instance TimeoutListUdpAliveIdxOfTimeoutListUdpAliveMap: category=VALUE, resulting-properties={base-type=uint8, sw-calibration-access=READ-ONLY, range raw 0..255}
            Element_2: symbol=[2]
              mc data instance TimeoutListUdpAliveIdxOfTimeoutListUdpAliveMap: category=VALUE, resulting-properties={base-type=uint8, sw-calibration-access=READ-ONLY, range raw 0..255}
            Element_3: symbol=[3]
              mc data instance TimeoutListUdpAliveIdxOfTimeoutListUdpAliveMap: category=VALUE, resulting-properties={base-type=uint8, sw-calibration-access=READ-ONLY, range raw 0..255}
            Element_4: symbol=[4]
              mc data instance TimeoutListUdpAliveIdxOfTimeoutListUdpAliveMap: category=VALUE, resulting-properties={base-type=uint8, sw-calibration-access=READ-ONLY, range raw 0..255}
            Element_5: symbol=[5]
              mc data instance TimeoutListUdpAliveIdxOfTimeoutListUdpAliveMap: category=VALUE, resulting-properties={base-type=uint8, sw-calibration-access=READ-ONLY, range raw 0..255}
            Element_6: symbol=[6]
              mc data instance TimeoutListUdpAliveIdxOfTimeoutListUdpAliveMap: category=VALUE, resulting-properties={base-type=uint8, sw-calibration-access=READ-ONLY, range raw 0..255}
            Element_7: symbol=[7]
              mc data instance TimeoutListUdpAliveIdxOfTimeoutListUdpAliveMap: category=VALUE, resulting-properties={base-type=uint8, sw-calibration-access=READ-ONLY, range raw 0..255}
            Element_8: symbol=[8]
              mc data instance TimeoutListUdpAliveIdxOfTimeoutListUdpAliveMap: category=VALUE, resulting-properties={base-type=uint8, sw-calibration-access=READ-ONLY, range raw 0..255}
            Element_9: symbol=[9]
              mc data instance TimeoutListUdpAliveIdxOfTimeoutListUdpAliveMap: category=VALUE, resulting-properties={base-type=uint8, sw-calibration-access=READ-ONLY, range raw 0..255}
            Element_10: symbol=[10]
              mc data instance TimeoutListUdpAliveIdxOfTimeoutListUdpAliveMap: category=VALUE, resulting-properties={base-type=uint8, sw-calibration-access=READ-ONLY, range raw 0..255}
            Element_11: symbol=[11]
              mc data instance TimeoutListUdpAliveIdxOfTimeoutListUdpAliveMap: category=VALUE, resulting-properties={base-type=uint8, sw-calibration-access=READ-ONLY, range raw 0..255}
            Element_12: symbol=[12]
              mc data instance TimeoutListUdpAliveIdxOfTimeoutListUdpAliveMap: category=VALUE, resulting-properties={base-type=uint8, sw-calibration-access=READ-ONLY, range raw 0..255}
            Element_13: symbol=[13]
              mc data instance TimeoutListUdpAliveIdxOfTimeoutListUdpAliveMap: category=VALUE, resulting-properties={base-type=uint8, sw-calibration-access=READ-ONLY, range raw 0..255}
        SoAd_TriggerBufConfigDyn: category=ARRAY, array-size=1, symbol=SoAd_TriggerBufConfigDyn.raw  # the management structs to handle trigger transmission buffer
          mc data instance Element_0: category=STRUCTURE, symbol=[0]
            mc data instance LengthOfTriggerBufConfigDyn: category=VALUE, resulting-properties={base-type=uint16, sw-calibration-access=READ-ONLY, range raw 0..65535}
            mc data instance PduRouteIdxOfTriggerBufConfigDyn: category=VALUE, resulting-properties={base-type=uint8, sw-calibration-access=READ-ONLY, range raw 0..255}
        SoAd_TriggerBufConfigDyn_SoAdInstance: category=ARRAY, array-size=1, symbol=SoAd_TriggerBufConfigDyn.raw[0]  # The element: SoAdInstance of SoAd_TriggerBufConfigDyn
          mc data instance Element_0: category=STRUCTURE, symbol=[0]
            mc data instance LengthOfTriggerBufConfigDyn: category=VALUE, resulting-properties={base-type=uint16, sw-calibration-access=READ-ONLY, range raw 0..65535}
            mc data instance PduRouteIdxOfTriggerBufConfigDyn: category=VALUE, resulting-properties={base-type=uint8, sw-calibration-access=READ-ONLY, range raw 0..255}
        SoAd_TriggerBuf: category=ARRAY, array-size=12, resulting-properties={base-type=uint8, sw-calibration-access=READ-ONLY, range raw 0..255}, symbol=SoAd_TriggerBuf.raw  # the trigger transmission buffer
        SoAd_TriggerBuf_SoAdIfTriggerTransmitBuffer: category=ARRAY, array-size=12, resulting-properties={base-type=uint8, sw-calibration-access=READ-ONLY, range raw 0..255}, symbol=SoAd_TriggerBuf.raw[0]  # The element: SoAdIfTriggerTransmitBuffer of SoAd_TriggerBuf
package /MICROSAR/SoAd_ib_bswmd/DataTypes/BaseTypes
  97 x base type, all with category=FIXED_LENGTH, base-type-size=32, base-type-encoding=NONE:
    SoAd_BestMatchSoConIdxListOfPCPartitionConfigType
    SoAd_DhcpEventCbkOfPCPartitionConfigType
    SoAd_EventQueueFlagOfPCPartitionConfigType
    SoAd_EventQueueIdentOfPCPartitionConfigType
    SoAd_EventQueueIfTxRouteGrpConfigOfPCPartitionConfigType
    SoAd_EventQueueIfTxRouteGrpOfPCPartitionConfigType
    SoAd_EventQueueIfUdpPduRouteConfigOfPCPartitionConfigType
    SoAd_EventQueueIfUdpPduRouteOfPCPartitionConfigType
    SoAd_EventQueueMgmtOfPCPartitionConfigType
    SoAd_EventQueueStateSoConConfigOfPCPartitionConfigType
    SoAd_EventQueueStateSoConOfPCPartitionConfigType
    SoAd_EventQueueTpRxSoConConfigOfPCPartitionConfigType
    SoAd_EventQueueTpRxSoConOfPCPartitionConfigType
    SoAd_EventQueueTpTxSoConConfigOfPCPartitionConfigType
    SoAd_EventQueueTpTxSoConOfPCPartitionConfigType
    SoAd_IfRxBufferOfPCPartitionConfigType
    SoAd_InstanceDynOfPCPartitionConfigType
    SoAd_InstanceMapOfPCPartitionConfigType
    SoAd_InstanceOfPCPartitionConfigType
    SoAd_IpFragBufConfigDynOfPCPartitionConfigType
    SoAd_IpFragBufConfigOfPCPartitionConfigType
    SoAd_IpFragBufOfPCPartitionConfigType
    SoAd_IpFragMgtOfPCPartitionConfigType
    SoAd_LocalAddrByTcpIpCtrlIndOfPCPartitionConfigType
    SoAd_LocalAddrDynOfPCPartitionConfigType
    SoAd_LocalAddrIdMapOfPCPartitionConfigType
    SoAd_LocalAddrOfPCPartitionConfigType
    SoAd_LocalIpAddrAssignmentChgCbkIndOfPCPartitionConfigType
    SoAd_LocalIpAddrAssignmentChgCbkOfPCPartitionConfigType
    SoAd_MetaDataRxBufConfigDynOfPCPartitionConfigType
    SoAd_MetaDataRxBufConfigOfPCPartitionConfigType
    SoAd_MetaDataRxBufOfPCPartitionConfigType
    SoAd_NPduUdpTxBufferOfPCPartitionConfigType
    SoAd_NPduUdpTxDynOfPCPartitionConfigType
    SoAd_NPduUdpTxOfPCPartitionConfigType
    SoAd_NPduUdpTxQueueOfPCPartitionConfigType
    SoAd_PCPartitionConfigOfPCConfigType
    SoAd_PartitionDynOfPCPartitionConfigType
    SoAd_PartitionIdentifiersOfPCConfigType
    SoAd_PduRouteDestBySoConIndOfPCPartitionConfigType
    SoAd_PduRouteDestIndOfPCPartitionConfigType
    SoAd_PduRouteDestOfPCPartitionConfigType
    SoAd_PduRouteDynOfPCPartitionConfigType
    SoAd_PduRouteOfPCPartitionConfigType
    SoAd_RcvRemAddrOfPCPartitionConfigType
    SoAd_RemAddrIpV4OfPCPartitionConfigType
    SoAd_RemAddrIpV6OfPCPartitionConfigType
    SoAd_RouteGrpIdMapOfPCPartitionConfigType
    SoAd_RouteGrpOfPCPartitionConfigType
    SoAd_RouteGrpSoConByPduRouteDestIndOfPCPartitionConfigType
    SoAd_RouteGrpSoConBySocketRouteDestIndOfPCPartitionConfigType
    SoAd_RouteGrpSoConDynOfPCPartitionConfigType
    SoAd_RouteGrpSoConOfPCPartitionConfigType
    SoAd_RxBufStructMgtOfPCPartitionConfigType
    SoAd_RxBufStructSegOfPCPartitionConfigType
    SoAd_RxBufferConfigDynOfPCPartitionConfigType
    SoAd_RxBufferConfigOfPCPartitionConfigType
    SoAd_RxMgtOfPCPartitionConfigType
    SoAd_RxPduIdIdMapOfPCPartitionConfigType
    SoAd_ShutdownFinishedCbkOfPCPartitionConfigType
    SoAd_SoConDynOfPCPartitionConfigType
    SoAd_SoConGrpOfPCPartitionConfigType
    SoAd_SoConMapOfPCPartitionConfigType
    SoAd_SoConModeChgCbkIndOfPCPartitionConfigType
    SoAd_SoConModeChgCbkOfPCPartitionConfigType
    SoAd_SoConOfPCPartitionConfigType
    SoAd_SocketDynOfPCPartitionConfigType
    SoAd_SocketMapOfPCPartitionConfigType
    SoAd_SocketOfPCPartitionConfigType
    SoAd_SocketRouteDestOfPCPartitionConfigType
    SoAd_SocketRouteIndOfPCPartitionConfigType
    SoAd_SocketRouteOfPCPartitionConfigType
    SoAd_SocketTcpOfPCPartitionConfigType
    SoAd_SocketUdpOfPCPartitionConfigType
    SoAd_TcpIpCtrlOfPCPartitionConfigType
    SoAd_TcpKeepAliveGloballyEnabledOfPCPartitionConfigType
    SoAd_TcpTxQueueDataOfPCPartitionConfigType
    SoAd_TcpTxQueueMgtOfPCPartitionConfigType
    SoAd_TcpTxQueueOfPCPartitionConfigType
    SoAd_TimeoutListIdentOfPCPartitionConfigType
    SoAd_TimeoutListMgmtOfPCPartitionConfigType
    SoAd_TimeoutListNPduUdpTxConfigOfPCPartitionConfigType
    SoAd_TimeoutListNPduUdpTxMapOfPCPartitionConfigType
    SoAd_TimeoutListNPduUdpTxOfPCPartitionConfigType
    SoAd_TimeoutListUdpAliveConfigOfPCPartitionConfigType
    SoAd_TimeoutListUdpAliveMapOfPCPartitionConfigType
    SoAd_TimeoutListUdpAliveOfPCPartitionConfigType
    SoAd_TpRxBufferOfPCPartitionConfigType
    SoAd_TpTxBufferConfigDynOfPCPartitionConfigType
    SoAd_TpTxBufferConfigOfPCPartitionConfigType
    SoAd_TpTxBufferOfPCPartitionConfigType
    SoAd_TriggerBufConfigDynOfPCPartitionConfigType
    SoAd_TriggerBufConfigOfPCPartitionConfigType
    SoAd_TriggerBufOfPCPartitionConfigType
    SoAd_TxMgtOfPCPartitionConfigType
    SoAd_TxPduIdMapOfPCPartitionConfigType
    SoAd_UpperLayerOfPCPartitionConfigType
package /MICROSAR/SoAd_ib_bswmd/DataTypes/DataConstrs
  data constr SoAd_BestMatchSoConIdxListOfPCPartitionConfigType
  data constr SoAd_DhcpEventCbkOfPCPartitionConfigType
  data constr SoAd_EventQueueFlagOfPCPartitionConfigType
  data constr SoAd_EventQueueIdentOfPCPartitionConfigType
  data constr SoAd_EventQueueIfTxRouteGrpConfigOfPCPartitionConfigType
  data constr SoAd_EventQueueIfTxRouteGrpOfPCPartitionConfigType
  data constr SoAd_EventQueueIfUdpPduRouteConfigOfPCPartitionConfigType
  data constr SoAd_EventQueueIfUdpPduRouteOfPCPartitionConfigType
  data constr SoAd_EventQueueMgmtOfPCPartitionConfigType
  data constr SoAd_EventQueueStateSoConConfigOfPCPartitionConfigType
  data constr SoAd_EventQueueStateSoConOfPCPartitionConfigType
  data constr SoAd_EventQueueTpRxSoConConfigOfPCPartitionConfigType
  data constr SoAd_EventQueueTpRxSoConOfPCPartitionConfigType
  data constr SoAd_EventQueueTpTxSoConConfigOfPCPartitionConfigType
  data constr SoAd_EventQueueTpTxSoConOfPCPartitionConfigType
  data constr SoAd_IfRxBufferOfPCPartitionConfigType
  data constr SoAd_InstanceDynOfPCPartitionConfigType
  data constr SoAd_InstanceMapOfPCPartitionConfigType
  data constr SoAd_InstanceOfPCPartitionConfigType
  data constr SoAd_IpFragBufConfigDynOfPCPartitionConfigType
  data constr SoAd_IpFragBufConfigOfPCPartitionConfigType
  data constr SoAd_IpFragBufOfPCPartitionConfigType
  data constr SoAd_IpFragMgtOfPCPartitionConfigType
  data constr SoAd_LocalAddrByTcpIpCtrlIndOfPCPartitionConfigType
  data constr SoAd_LocalAddrDynOfPCPartitionConfigType
  data constr SoAd_LocalAddrIdMapOfPCPartitionConfigType
  data constr SoAd_LocalAddrOfPCPartitionConfigType
  data constr SoAd_LocalIpAddrAssignmentChgCbkIndOfPCPartitionConfigType
  data constr SoAd_LocalIpAddrAssignmentChgCbkOfPCPartitionConfigType
  data constr SoAd_MetaDataRxBufConfigDynOfPCPartitionConfigType
  data constr SoAd_MetaDataRxBufConfigOfPCPartitionConfigType
  data constr SoAd_MetaDataRxBufOfPCPartitionConfigType
  data constr SoAd_NPduUdpTxBufferOfPCPartitionConfigType
  data constr SoAd_NPduUdpTxDynOfPCPartitionConfigType
  data constr SoAd_NPduUdpTxOfPCPartitionConfigType
  data constr SoAd_NPduUdpTxQueueOfPCPartitionConfigType
  data constr SoAd_PCPartitionConfigOfPCConfigType
  data constr SoAd_PartitionDynOfPCPartitionConfigType
  data constr SoAd_PartitionIdentifiersOfPCConfigType
  data constr SoAd_PduRouteDestBySoConIndOfPCPartitionConfigType
  data constr SoAd_PduRouteDestIndOfPCPartitionConfigType
  data constr SoAd_PduRouteDestOfPCPartitionConfigType
  data constr SoAd_PduRouteDynOfPCPartitionConfigType
  data constr SoAd_PduRouteOfPCPartitionConfigType
  data constr SoAd_RcvRemAddrOfPCPartitionConfigType
  data constr SoAd_RemAddrIpV4OfPCPartitionConfigType
  data constr SoAd_RemAddrIpV6OfPCPartitionConfigType
  data constr SoAd_RouteGrpIdMapOfPCPartitionConfigType
  data constr SoAd_RouteGrpOfPCPartitionConfigType
  data constr SoAd_RouteGrpSoConByPduRouteDestIndOfPCPartitionConfigType
  data constr SoAd_RouteGrpSoConBySocketRouteDestIndOfPCPartitionConfigType
  data constr SoAd_RouteGrpSoConDynOfPCPartitionConfigType
  data constr SoAd_RouteGrpSoConOfPCPartitionConfigType
  data constr SoAd_RxBufStructMgtOfPCPartitionConfigType
  data constr SoAd_RxBufStructSegOfPCPartitionConfigType
  data constr SoAd_RxBufferConfigDynOfPCPartitionConfigType
  data constr SoAd_RxBufferConfigOfPCPartitionConfigType
  data constr SoAd_RxMgtOfPCPartitionConfigType
  data constr SoAd_RxPduIdIdMapOfPCPartitionConfigType
  data constr SoAd_ShutdownFinishedCbkOfPCPartitionConfigType
  data constr SoAd_SoConDynOfPCPartitionConfigType
  data constr SoAd_SoConGrpOfPCPartitionConfigType
  data constr SoAd_SoConMapOfPCPartitionConfigType
  data constr SoAd_SoConModeChgCbkIndOfPCPartitionConfigType
  data constr SoAd_SoConModeChgCbkOfPCPartitionConfigType
  data constr SoAd_SoConOfPCPartitionConfigType
  data constr SoAd_SocketDynOfPCPartitionConfigType
  data constr SoAd_SocketMapOfPCPartitionConfigType
  data constr SoAd_SocketOfPCPartitionConfigType
  data constr SoAd_SocketRouteDestOfPCPartitionConfigType
  data constr SoAd_SocketRouteIndOfPCPartitionConfigType
  data constr SoAd_SocketRouteOfPCPartitionConfigType
  data constr SoAd_SocketTcpOfPCPartitionConfigType
  data constr SoAd_SocketUdpOfPCPartitionConfigType
  data constr SoAd_TcpIpCtrlOfPCPartitionConfigType
  data constr SoAd_TcpKeepAliveGloballyEnabledOfPCPartitionConfigType
  data constr SoAd_TcpTxQueueDataOfPCPartitionConfigType
  data constr SoAd_TcpTxQueueMgtOfPCPartitionConfigType
  data constr SoAd_TcpTxQueueOfPCPartitionConfigType
  data constr SoAd_TimeoutListIdentOfPCPartitionConfigType
  data constr SoAd_TimeoutListMgmtOfPCPartitionConfigType
  data constr SoAd_TimeoutListNPduUdpTxConfigOfPCPartitionConfigType
  data constr SoAd_TimeoutListNPduUdpTxMapOfPCPartitionConfigType
  data constr SoAd_TimeoutListNPduUdpTxOfPCPartitionConfigType
  data constr SoAd_TimeoutListUdpAliveConfigOfPCPartitionConfigType
  data constr SoAd_TimeoutListUdpAliveMapOfPCPartitionConfigType
  data constr SoAd_TimeoutListUdpAliveOfPCPartitionConfigType
  data constr SoAd_TpRxBufferOfPCPartitionConfigType
  data constr SoAd_TpTxBufferConfigDynOfPCPartitionConfigType
  data constr SoAd_TpTxBufferConfigOfPCPartitionConfigType
  data constr SoAd_TpTxBufferOfPCPartitionConfigType
  data constr SoAd_TriggerBufConfigDynOfPCPartitionConfigType
  data constr SoAd_TriggerBufConfigOfPCPartitionConfigType
  data constr SoAd_TriggerBufOfPCPartitionConfigType
  data constr SoAd_TxMgtOfPCPartitionConfigType
  data constr SoAd_TxPduIdMapOfPCPartitionConfigType
  data constr SoAd_UpperLayerOfPCPartitionConfigType
