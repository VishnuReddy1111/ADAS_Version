AUTOSAR XML (schema 4-3-0)
standard types defined: uint32, uint8
package /MICROSAR
  bsw implementation EcuM_Impl: programming-language=C, sw-version=13.00.00, used-code-generator=DaVinci Configurator, vendor-id=30, ar-release-version=4.00.03
    mc-variable-instances:
      16 x mc data instance:
        EcuM_ComMChannelRefs: category=ARRAY, array-size=2  # Referenced ComM Channel(s).
          mc data instance Element_0: category=STRUCTURE, symbol=[0]
            mc data instance ChannelOfComMChannelRefs: category=VALUE, resulting-properties={base-type=uint8, sw-calibration-access=READ-ONLY, range raw 0..255}
          mc data instance Element_1: category=STRUCTURE, symbol=[1]
            mc data instance ChannelOfComMChannelRefs: category=VALUE, resulting-properties={base-type=uint8, sw-calibration-access=READ-ONLY, range raw 0..255}
        EcuM_PartitionData: category=ARRAY, array-size=2  # Contains all parameters configured for initialization of partitions.
          mc data instance Element_0: category=STRUCTURE, symbol=[0]
            mc data instance ApplicationOfPartitionData: category=VALUE, resulting-properties={base-type=uint8, sw-calibration-access=READ-ONLY, range raw 0..255}
          mc data instance Element_1: category=STRUCTURE, symbol=[1]
            mc data instance ApplicationOfPartitionData: category=VALUE, resulting-properties={base-type=uint8, sw-calibration-access=READ-ONLY, range raw 0..255}
        EcuM_WakeupSourceList: category=ARRAY, array-size=7  # Contains all parameters configured for Wakeup Sources
          7 x mc data instance, all with category=STRUCTURE:
            Element_0: symbol=[0]
              mc data instance ComMChannelRefsEndIdxOfWakeupSourceList: category=VALUE, resulting-properties={base-type=uint8, sw-calibration-access=READ-ONLY, compu {255=ECUM_NO_COMMCHANNELREFSENDIDXOFWAKEUPSOURCELIST}, range raw 0..255}
              mc data instance ComMChannelRefsStartIdxOfWakeupSourceList: category=VALUE, resulting-properties={base-type=uint8, sw-calibration-access=READ-ONLY, compu {255=ECUM_NO_COMMCHANNELREFSSTARTIDXOFWAKEUPSOURCELIST}, range raw 0..255}
            Element_1: symbol=[1]
              mc data instance ComMChannelRefsEndIdxOfWakeupSourceList: category=VALUE, resulting-properties={base-type=uint8, sw-calibration-access=READ-ONLY, compu {255=ECUM_NO_COMMCHANNELREFSENDIDXOFWAKEUPSOURCELIST}, range raw 0..255}
              mc data instance ComMChannelRefsStartIdxOfWakeupSourceList: category=VALUE, resulting-properties={base-type=uint8, sw-calibration-access=READ-ONLY, compu {255=ECUM_NO_COMMCHANNELREFSSTARTIDXOFWAKEUPSOURCELIST}, range raw 0..255}
            Element_2: symbol=[2]
              mc data instance ComMChannelRefsEndIdxOfWakeupSourceList: category=VALUE, resulting-properties={base-type=uint8, sw-calibration-access=READ-ONLY, compu {255=ECUM_NO_COMMCHANNELREFSENDIDXOFWAKEUPSOURCELIST}, range raw 0..255}
              mc data instance ComMChannelRefsStartIdxOfWakeupSourceList: category=VALUE, resulting-properties={base-type=uint8, sw-calibration-access=READ-ONLY, compu {255=ECUM_NO_COMMCHANNELREFSSTARTIDXOFWAKEUPSOURCELIST}, range raw 0..255}
            Element_3: symbol=[3]
              mc data instance ComMChannelRefsEndIdxOfWakeupSourceList: category=VALUE, resulting-properties={base-type=uint8, sw-calibration-access=READ-ONLY, compu {255=ECUM_NO_COMMCHANNELREFSENDIDXOFWAKEUPSOURCELIST}, range raw 0..255}
              mc data instance ComMChannelRefsStartIdxOfWakeupSourceList: category=VALUE, resulting-properties={base-type=uint8, sw-calibration-access=READ-ONLY, compu {255=ECUM_NO_COMMCHANNELREFSSTARTIDXOFWAKEUPSOURCELIST}, range raw 0..255}
            Element_4: symbol=[4]
              mc data instance ComMChannelRefsEndIdxOfWakeupSourceList: category=VALUE, resulting-properties={base-type=uint8, sw-calibration-access=READ-ONLY, compu {255=ECUM_NO_COMMCHANNELREFSENDIDXOFWAKEUPSOURCELIST}, range raw 0..255}
              mc data instance ComMChannelRefsStartIdxOfWakeupSourceList: category=VALUE, resulting-properties={base-type=uint8, sw-calibration-access=READ-ONLY, compu {255=ECUM_NO_COMMCHANNELREFSSTARTIDXOFWAKEUPSOURCELIST}, range raw 0..255}
            Element_5: symbol=[5]
              mc data instance ComMChannelRefsEndIdxOfWakeupSourceList: category=VALUE, resulting-properties={base-type=uint8, sw-calibration-access=READ-ONLY, compu {255=ECUM_NO_COMMCHANNELREFSENDIDXOFWAKEUPSOURCELIST}, range raw 0..255}
              mc data instance ComMChannelRefsStartIdxOfWakeupSourceList: category=VALUE, resulting-properties={base-type=uint8, sw-calibration-access=READ-ONLY, compu {255=ECUM_NO_COMMCHANNELREFSSTARTIDXOFWAKEUPSOURCELIST}, range raw 0..255}
            Element_6: symbol=[6]
              mc data instance ComMChannelRefsEndIdxOfWakeupSourceList: category=VALUE, resulting-properties={base-type=uint8, sw-calibration-access=READ-ONLY, compu {255=ECUM_NO_COMMCHANNELREFSENDIDXOFWAKEUPSOURCELIST}, range raw 0..255}
              mc data instance ComMChannelRefsStartIdxOfWakeupSourceList: category=VALUE, resulting-properties={base-type=uint8, sw-calibration-access=READ-ONLY, compu {255=ECUM_NO_COMMCHANNELREFSSTARTIDXOFWAKEUPSOURCELIST}, range raw 0..255}
        EcuM_PostRunRequestCounter: category=VALUE, resulting-properties={base-type=uint8, sw-calibration-access=READ-ONLY, range raw 0..255}
        EcuM_RunRequestCounter: category=VALUE, resulting-properties={base-type=uint8, sw-calibration-access=READ-ONLY, range raw 0..255}
        EcuM_ModuleState: category=VALUE, resulting-properties={base-type=uint8, sw-calibration-access=READ-ONLY, compu-method=CompuMethod_EcuM_ModuleState_Values, range raw 0..255}  # EcuM module state
        EcuM_CurrentShutdownTarget: category=VALUE, resulting-properties={base-type=uint8, sw-calibration-access=READ-ONLY, compu-method=CompuMethod_EcuM_ModuleState_Values, range raw 0..255}  # EcuM current shutdown target
        EcuM_LastShutdownTarget: category=VALUE, resulting-properties={base-type=uint8, sw-calibration-access=READ-ONLY, compu-method=CompuMethod_EcuM_ModuleState_Values, range raw 0..255}  # EcuM last shutdown target
        EcuM_ExpiredWakeups: category=VALUE, resulting-properties={base-type=uint32, sw-calibration-access=READ-ONLY, range raw 0..4294967295}  # EcuM expired wakeups
        EcuM_PendingWakeups: category=VALUE, resulting-properties={base-type=uint32, sw-calibration-access=READ-ONLY, range raw 0..4294967295}  # EcuM pending wakeups
        EcuM_PendingCheckWakeups: category=VALUE, resulting-properties={base-type=uint32, sw-calibration-access=READ-ONLY, range raw 0..4294967295}  # EcuM pending check-wakeups
        EcuM_ValidatedWakeups: category=VALUE, resulting-properties={base-type=uint32, sw-calibration-access=READ-ONLY, range raw 0..4294967295}  # EcuM validated wakeups
        EcuM_LastShutdownMode: category=VALUE, resulting-properties={base-type=uint8, sw-calibration-access=READ-ONLY, range raw 0..255}  # EcuM last shutdown mode
        EcuM_CurrentShutdownMode: category=VALUE, resulting-properties={base-type=uint8, sw-calibration-access=READ-ONLY, range raw 0..255}  # EcuM current shutdown mode
        EcuM_ShutdownCause: category=VALUE, resulting-properties={base-type=uint8, sw-calibration-access=READ-ONLY, range raw 0..255}  # EcuM shutdown cause
        EcuM_CurrentBootTarget: category=VALUE, resulting-properties={base-type=uint8, sw-calibration-access=READ-ONLY, compu {0=ECUM_BOOT_TARGET_APP, 1=ECUM_BOOT_TARGET_OEM_BOOTLOADER, 2=ECUM_BOOT_TARGET_SYS_BOOTLOADER}, range raw 0..255}  # EcuM current boot target
    resource consumption ResourceConsumption
      64 x memory section:
        PBCFG_GLOBALROOT: sw-addrmethod=PBCFG_GLOBALROOT
        VAR_NOCACHE_CLEARED_UNSPECIFIED: alignment=UNSPECIFIED, sw-addrmethod=VAR_NOCACHE_CLEARED
        VAR_FAST_INIT_64: alignment=64, sw-addrmethod=VAR_FAST_INIT
        VAR_FAST_CLEARED_UNSPECIFIED: alignment=UNSPECIFIED, sw-addrmethod=VAR_FAST_CLEARED
        VAR_NO_INIT_8: alignment=8, sw-addrmethod=VAR_NO_INIT
        VAR_NOCACHE_CLEARED_16: alignment=16, sw-addrmethod=VAR_NOCACHE_CLEARED
        VAR_NO_INIT_16: alignment=16, sw-addrmethod=VAR_NO_INIT
        CONST_16: alignment=16, sw-addrmethod=CONST
        VAR_FAST_CLEARED_8: alignment=8, sw-addrmethod=VAR_FAST_CLEARED
        CODE: sw-addrmethod=CODE
        CONST_64: alignment=64, sw-addrmethod=CONST
        VAR_NOCACHE_CLEARED_8: alignment=8, sw-addrmethod=VAR_NOCACHE_CLEARED
        VAR_CLEARED_16: alignment=16, sw-addrmethod=VAR_CLEARED
        VAR_NOCACHE_CLEARED_BOOLEAN: alignment=BOOLEAN, sw-addrmethod=VAR_NOCACHE_CLEARED
        VAR_FAST_NO_INIT_16: alignment=16, sw-addrmethod=VAR_FAST_NO_INIT
        VAR_NO_INIT_64: alignment=64, sw-addrmethod=VAR_NO_INIT
        VAR_NOCACHE_CLEARED_64: alignment=64, sw-addrmethod=VAR_NOCACHE_CLEARED
        VAR_NOCACHE_INIT_32: alignment=32, sw-addrmethod=VAR_NOCACHE_INIT
        VAR_FAST_INIT_32: alignment=32, sw-addrmethod=VAR_FAST_INIT
        VAR_NO_INIT_UNSPECIFIED: alignment=UNSPECIFIED, sw-addrmethod=VAR_NO_INIT
        VAR_CLEARED_8: alignment=8, sw-addrmethod=VAR_CLEARED
        VAR_FAST_CLEARED_16: alignment=16, sw-addrmethod=VAR_FAST_CLEARED
        VAR_NOCACHE_INIT_8: alignment=8, sw-addrmethod=VAR_NOCACHE_INIT
        CONST_UNSPECIFIED: alignment=UNSPECIFIED, sw-addrmethod=CONST
        VAR_NOCACHE_NO_INIT_32: alignment=32, sw-addrmethod=VAR_NOCACHE_NO_INIT
        CONST_32: alignment=32, sw-addrmethod=CONST
        VAR_FAST_CLEARED_64: alignment=64, sw-addrmethod=VAR_FAST_CLEARED
        VAR_INIT_32: alignment=32, sw-addrmethod=VAR_INIT
        VAR_FAST_NO_INIT_64: alignment=64, sw-addrmethod=VAR_FAST_NO_INIT
        VAR_INIT_8: alignment=8, sw-addrmethod=VAR_INIT
        VAR_CLEARED_64: alignment=64, sw-addrmethod=VAR_CLEARED
        VAR_NO_INIT_32: alignment=32, sw-addrmethod=VAR_NO_INIT
        VAR_NOCACHE_INIT_64: alignment=64, sw-addrmethod=VAR_NOCACHE_INIT
        VAR_NOCACHE_CLEARED_32: alignment=32, sw-addrmethod=VAR_NOCACHE_CLEARED
        VAR_NOCACHE_INIT_BOOLEAN: alignment=BOOLEAN, sw-addrmethod=VAR_NOCACHE_INIT
        VAR_FAST_NO_INIT_BOOLEAN: alignment=BOOLEAN, sw-addrmethod=VAR_FAST_NO_INIT
        VAR_FAST_CLEARED_BOOLEAN: alignment=BOOLEAN, sw-addrmethod=VAR_FAST_CLEARED
        VAR_CLEARED_BOOLEAN: alignment=BOOLEAN, sw-addrmethod=VAR_CLEARED
        VAR_NO_INIT_BOOLEAN: alignment=BOOLEAN, sw-addrmethod=VAR_NO_INIT
        VAR_NOCACHE_NO_INIT_64: alignment=64, sw-addrmethod=VAR_NOCACHE_NO_INIT
        VAR_FAST_CLEARED_32: alignment=32, sw-addrmethod=VAR_FAST_CLEARED
        VAR_NOCACHE_NO_INIT_UNSPECIFIED: alignment=UNSPECIFIED, sw-addrmethod=VAR_NOCACHE_NO_INIT
        VAR_INIT_64: alignment=64, sw-addrmethod=VAR_INIT
        VAR_CLEARED_UNSPECIFIED: alignment=UNSPECIFIED, sw-addrmethod=VAR_CLEARED
        VAR_INIT_UNSPECIFIED: alignment=UNSPECIFIED, sw-addrmethod=VAR_INIT
        CONST_8: alignment=8, sw-addrmethod=CONST
        VAR_FAST_NO_INIT_32: alignment=32, sw-addrmethod=VAR_FAST_NO_INIT
        VAR_CLEARED_32: alignment=32, sw-addrmethod=VAR_CLEARED
        VAR_NOCACHE_NO_INIT_BOOLEAN: alignment=BOOLEAN, sw-addrmethod=VAR_NOCACHE_NO_INIT
        VAR_INIT_BOOLEAN: alignment=BOOLEAN, sw-addrmethod=VAR_INIT
        VAR_NOCACHE_INIT_UNSPECIFIED: alignment=UNSPECIFIED, sw-addrmethod=VAR_NOCACHE_INIT
        VAR_FAST_INIT_UNSPECIFIED: alignment=UNSPECIFIED, sw-addrmethod=VAR_FAST_INIT
        VAR_FAST_NO_INIT_8: alignment=8, sw-addrmethod=VAR_FAST_NO_INIT
        VAR_FAST_INIT_8: alignment=8, sw-addrmethod=VAR_FAST_INIT
        VAR_NOCACHE_INIT_16: alignment=16, sw-addrmethod=VAR_NOCACHE_INIT
        VAR_FAST_NO_INIT_UNSPECIFIED: alignment=UNSPECIFIED, sw-addrmethod=VAR_FAST_NO_INIT
        VAR_FAST_INIT_BOOLEAN: alignment=BOOLEAN, sw-addrmethod=VAR_FAST_INIT
        VAR_FAST_INIT_16: alignment=16, sw-addrmethod=VAR_FAST_INIT
        VAR_NOCACHE_NO_INIT_8: alignment=8, sw-addrmethod=VAR_NOCACHE_NO_INIT
        CONST_BOOLEAN: alignment=BOOLEAN, sw-addrmethod=CONST
        VAR_INIT_16: alignment=16, sw-addrmethod=VAR_INIT
        VAR_NOCACHE_NO_INIT_16: alignment=16, sw-addrmethod=VAR_NOCACHE_NO_INIT
        VAR_PARTITION_OSAPPLICATION_SYSTEMAPPLICATION_CORE0_NOCACHE_NO_INIT_32: sw-addrmethod=OsApplication_SystemApplication_Core0_VAR_NOCACHE_NO_INIT
        VAR_PARTITION_OSAPPLICATION_SYSTEMAPPLICATION_CORE1_NOCACHE_NO_INIT_32: sw-addrmethod=OsApplication_SystemApplication_Core1_VAR_NOCACHE_NO_INIT
package /MICROSAR/EcuM_ib_bswmd/BswModuleDescriptions
  bsw module description EcuM: provided-entrys=EcuM_MainFunction
    bsw internal behavior EcuMBehavior
      4 x exclusive area:
        ECUM_EXCLUSIVE_AREA_0  # This exclusive area shall disable all wake up interrupts to prevent overwriting of some global variables.
        ECUM_EXCLUSIVE_AREA_1  # This exclusive area is only used in case of multi core and if the the EcuM is configured to handle also the slave cores. It must be configured as a spinlock to allow access to some variables simultaneously from multiple cores.
        ECUM_EXCLUSIVE_AREA_2  # This exclusive area is used for accessing the clock variable. It shall disable GPT interrupts and task changes. Only necessary if 32 Bit access is not atomic and Alarm Clock is present.
        ECUM_EXCLUSIVE_AREA_3  # This This exclusive area must be configured as a spin lock to protect access on global shutdown target variables.
      bsw schedulable entity EcuM_MainFunction: can-enter-exclusive-area=[ECUM_EXCLUSIVE_AREA_0, ECUM_EXCLUSIVE_AREA_1, ECUM_EXCLUSIVE_AREA_2, ECUM_EXCLUSIVE_AREA_3], implemented-entry=EcuM_MainFunction
      bsw timing event EcuM_MainFunctionTimingEvent0: starts-on-event=EcuM_MainFunction, period=0.01
      bsw timing event EcuM_MainFunctionTimingEvent1: starts-on-event=EcuM_MainFunction, period=0.01
  bsw module entry EcuM_MainFunction: call-type=SCHEDULED, execution-context=TASK
package /MICROSAR/EcuM_ib_bswmd/DataTypes/CompuMethods
  compu method CompuMethod_EcuM_ModuleState_Values: 16=ECUM_STATE_STARTUP, 17=ECUM_STATE_STARTUP_ONE, 18=ECUM_STATE_STARTUP_TWO, 32=ECUM_STATE_WAKEUP, 33=ECUM_STATE_WAKEUP_ONE, 34=ECUM_STATE_WAKEUP_VALIDATION, 35=ECUM_STATE_WAKEUP_REACTION, 36=ECUM_STATE_WAKEUP_TWO, 37=ECUM_STATE_WAKEUP_WAKESLEEP, 38=ECUM_STATE_WAKEUP_TTII, 48=ECUM_STATE_RUN, 50=ECUM_STATE_APP_RUN, 51=ECUM_STATE_APP_POST_RUN, 64=ECUM_STATE_SHUTDOWN, 68=ECUM_STATE_PREP_SHUTDOWN, 73=ECUM_STATE_GO_SLEEP, 77=ECUM_STATE_GO_OFF_ONE, 78=ECUM_STATE_GO_OFF_TWO, 80=ECUM_STATE_SLEEP, 128=ECUM_STATE_OFF, 144=ECUM_STATE_RESET, 255=ECUM_STATE_ERROR
