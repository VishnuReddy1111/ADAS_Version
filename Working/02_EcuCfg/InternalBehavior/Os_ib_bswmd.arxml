AUTOSAR XML (schema 00048)
package /MICROSAR/Os_ib_bswmd/SwAddrMethods
  36 x sw addr method:
    GLOBALSHARED_CONST: section-type=CONST
    GLOBALSHARED_CONST_FAST: section-type=CONST
    GLOBALSHARED_VAR_INIT: section-initialization-policy=INIT, section-type=VAR
    GLOBALSHARED_VAR_FAST_INIT: section-initialization-policy=INIT, section-type=VAR-FAST
    GLOBALSHARED_VAR_NOCACHE_INIT: section-initialization-policy=INIT, section-type=VAR
    GLOBALSHARED_VAR_NO_INIT: section-initialization-policy=NO_INIT, section-type=VAR
    GLOBALSHARED_VAR_FAST_NO_INIT: section-initialization-policy=NO_INIT, section-type=VAR-FAST
    GLOBALSHARED_VAR_NOCACHE_NO_INIT: section-initialization-policy=NO_INIT, section-type=VAR
    GLOBALSHARED_VAR_CLEARED: section-initialization-policy=CLEARED, section-type=VAR
    GLOBALSHARED_VAR_FAST_CLEARED: section-initialization-policy=CLEARED, section-type=VAR-FAST
    GLOBALSHARED_VAR_NOCACHE_CLEARED: section-initialization-policy=CLEARED, section-type=VAR
    GLOBALSHARED_VAR_SAVED_ZONE: section-initialization-policy=NO_INIT, section-type=VAR
    OsApplication_SystemApplication_Core0_CONST: section-type=CONST
    OsApplication_SystemApplication_Core0_CONST_FAST: section-type=CONST
    OsApplication_SystemApplication_Core0_VAR_SAVED_ZONE: section-initialization-policy=NO_INIT, section-type=VAR
    OsApplication_SystemApplication_Core0_VAR_INIT: section-initialization-policy=INIT, section-type=VAR
    OsApplication_SystemApplication_Core0_VAR_FAST_INIT: section-initialization-policy=INIT, section-type=VAR-FAST
    OsApplication_SystemApplication_Core0_VAR_NOCACHE_INIT: section-initialization-policy=INIT, section-type=VAR
    OsApplication_SystemApplication_Core0_VAR_NO_INIT: section-initialization-policy=NO_INIT, section-type=VAR
    OsApplication_SystemApplication_Core0_VAR_FAST_NO_INIT: section-initialization-policy=NO_INIT, section-type=VAR-FAST
    OsApplication_SystemApplication_Core0_VAR_NOCACHE_NO_INIT: section-initialization-policy=NO_INIT, section-type=VAR
    OsApplication_SystemApplication_Core0_VAR_CLEARED: section-initialization-policy=CLEARED, section-type=VAR
    OsApplication_SystemApplication_Core0_VAR_FAST_CLEARED: section-initialization-policy=CLEARED, section-type=VAR-FAST
    OsApplication_SystemApplication_Core0_VAR_NOCACHE_CLEARED: section-initialization-policy=CLEARED, section-type=VAR
    OsApplication_SystemApplication_Core1_CONST: section-type=CONST
    OsApplication_SystemApplication_Core1_CONST_FAST: section-type=CONST
    OsApplication_SystemApplication_Core1_VAR_SAVED_ZONE: section-initialization-policy=NO_INIT, section-type=VAR
    OsApplication_SystemApplication_Core1_VAR_INIT: section-initialization-policy=INIT, section-type=VAR
    OsApplication_SystemApplication_Core1_VAR_FAST_INIT: section-initialization-policy=INIT, section-type=VAR-FAST
    OsApplication_SystemApplication_Core1_VAR_NOCACHE_INIT: section-initialization-policy=INIT, section-type=VAR
    OsApplication_SystemApplication_Core1_VAR_NO_INIT: section-initialization-policy=NO_INIT, section-type=VAR
    OsApplication_SystemApplication_Core1_VAR_FAST_NO_INIT: section-initialization-policy=NO_INIT, section-type=VAR-FAST
    OsApplication_SystemApplication_Core1_VAR_NOCACHE_NO_INIT: section-initialization-policy=NO_INIT, section-type=VAR
    OsApplication_SystemApplication_Core1_VAR_CLEARED: section-initialization-policy=CLEARED, section-type=VAR
    OsApplication_SystemApplication_Core1_VAR_FAST_CLEARED: section-initialization-policy=CLEARED, section-type=VAR-FAST
    OsApplication_SystemApplication_Core1_VAR_NOCACHE_CLEARED: section-initialization-policy=CLEARED, section-type=VAR
