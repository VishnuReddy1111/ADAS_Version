AUTOSAR XML (schema 00048)
package /MICROSAR/vMem_30_Tc3xxInf01_ib_bswmd/BswModuleDescriptions
  bsw module description vMem: provided-entrys=vMem_30_Tc3xxInf01_Virtual
    bsw internal behavior vMemBehavior
      exclusive area VMEM_30_TC3XXINF01_EXCLUSIVE_AREA_0
      bsw called entity vMem_30_Tc3xxInf01_Virtual: can-enter-exclusive-area=VMEM_30_TC3XXINF01_EXCLUSIVE_AREA_0, implemented-entry=vMem_30_Tc3xxInf01_Virtual
  bsw module entry vMem_30_Tc3xxInf01_Virtual: call-type=REGULAR, execution-context=TASK
