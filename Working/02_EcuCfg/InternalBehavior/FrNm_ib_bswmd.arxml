AUTOSAR XML (schema 00048)
standard types defined: boolean, uint16, uint8
package /MICROSAR
  bsw implementation FrNm_Impl: programming-language=C, sw-version=9.01.01, used-code-generator=DaVinci Configurator, vendor-id=30, ar-release-version=4.00.03
package /MICROSAR/FrNm_ib_bswmd/DataTypes/CompuMethods
  compu method FrNm_LastNetworkRequestedType: 0=FALSE, 1..255=TRUE
  compu method FrNm_ModuleInitializedType: 0=FALSE, 1..255=TRUE
  compu method FrNm_MsgConfirmationFlagType: 0=FALSE, 1..255=TRUE
  compu method FrNm_MsgIndicationFlagType: 0=FALSE, 1..255=TRUE
  compu method FrNm_NetworkRequestedType: 0=FALSE, 1..255=TRUE
  compu method FrNm_SysToNmChIndType: 255=FRNM_NO_SYSTONMCHIND
package /MICROSAR/FrNm_ib_bswmd/DataTypes/DataConstrs
  range FrNm_CurrentFrCycleType: raw 0..255
  range FrNm_LastNetworkRequestedType: raw 0..1
  range FrNm_ModuleInitializedType: raw 0..1
  range FrNm_MsgConfirmationFlagType: raw 0..1
  range FrNm_MsgIndicationFlagType: raw 0..1
  range FrNm_NetworkRequestedType: raw 0..1
  range FrNm_NetworkRestartFlagType: raw 0..255
  range FrNm_NetworkTimerType: raw 0..65535
  range FrNm_NmStateType: raw 0..255
  range FrNm_RxMessageDataType: raw 0..255
  range FrNm_RxMessageVoteType: raw 0..255
  range FrNm_SysToNmChIndType: raw 0..255
  range FrNm_TimeoutTimerType: raw 0..65535
  range FrNm_TxControlStateRequestType: raw 0..255
  range FrNm_TxControlStateType: raw 0..255
  range FrNm_TxMessageDataType: raw 0..255
