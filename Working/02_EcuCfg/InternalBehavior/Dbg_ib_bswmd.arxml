AUTOSAR XML (schema 00048)
standard types defined: boolean, uint16, uint32
package /MICROSAR
  bsw implementation Dbg_Impl: programming-language=C, sw-version=2.00.00, used-code-generator=cMSR, vendor-id=30, ar-release-version=4.00.03
    mc-variable-instances:
      13 x mc data instance, all with category=STRUCTURE:
        Dbg_IdleTask_OsCore0
          mc data instance dbgosGetStackUsage: category=VALUE, resulting-properties={base-type=uint32, sw-calibration-access=READ-ONLY, range raw 0..4294967295}
          mc data instance Activation: category=VALUE, resulting-properties={base-type=boolean, sw-calibration-access=READ-ONLY, compu {1=TRUE, 0=FALSE}, range raw 0..1}
          mc data instance CollectionFrequency: category=VALUE, resulting-properties={base-type=uint16, sw-calibration-access=READ-ONLY, range raw 0..65535}
        Dbg_Default_Appl_Init_Task
          mc data instance dbgosGetStackUsage: category=VALUE, resulting-properties={base-type=uint32, sw-calibration-access=READ-ONLY, range raw 0..4294967295}
          mc data instance Activation: category=VALUE, resulting-properties={base-type=boolean, sw-calibration-access=READ-ONLY, compu {1=TRUE, 0=FALSE}, range raw 0..1}
          mc data instance CollectionFrequency: category=VALUE, resulting-properties={base-type=uint16, sw-calibration-access=READ-ONLY, range raw 0..65535}
        Dbg_Default_BSW_Sync_Task
          mc data instance dbgosGetStackUsage: category=VALUE, resulting-properties={base-type=uint32, sw-calibration-access=READ-ONLY, range raw 0..4294967295}
          mc data instance Activation: category=VALUE, resulting-properties={base-type=boolean, sw-calibration-access=READ-ONLY, compu {1=TRUE, 0=FALSE}, range raw 0..1}
          mc data instance CollectionFrequency: category=VALUE, resulting-properties={base-type=uint16, sw-calibration-access=READ-ONLY, range raw 0..65535}
        Dbg_Default_Init_Task
          mc data instance dbgosGetStackUsage: category=VALUE, resulting-properties={base-type=uint32, sw-calibration-access=READ-ONLY, range raw 0..4294967295}
          mc data instance Activation: category=VALUE, resulting-properties={base-type=boolean, sw-calibration-access=READ-ONLY, compu {1=TRUE, 0=FALSE}, range raw 0..1}
          mc data instance CollectionFrequency: category=VALUE, resulting-properties={base-type=uint16, sw-calibration-access=READ-ONLY, range raw 0..65535}
        Dbg_Default_Appl_Task
          mc data instance dbgosGetStackUsage: category=VALUE, resulting-properties={base-type=uint32, sw-calibration-access=READ-ONLY, range raw 0..4294967295}
          mc data instance Activation: category=VALUE, resulting-properties={base-type=boolean, sw-calibration-access=READ-ONLY, compu {1=TRUE, 0=FALSE}, range raw 0..1}
          mc data instance CollectionFrequency: category=VALUE, resulting-properties={base-type=uint16, sw-calibration-access=READ-ONLY, range raw 0..65535}
        Dbg_Default_BSW_Async_Task
          mc data instance dbgosGetStackUsage: category=VALUE, resulting-properties={base-type=uint32, sw-calibration-access=READ-ONLY, range raw 0..4294967295}
          mc data instance Activation: category=VALUE, resulting-properties={base-type=boolean, sw-calibration-access=READ-ONLY, compu {1=TRUE, 0=FALSE}, range raw 0..1}
          mc data instance CollectionFrequency: category=VALUE, resulting-properties={base-type=uint16, sw-calibration-access=READ-ONLY, range raw 0..65535}
        Dbg_Default_RTE_Mode_switch_Task
          mc data instance dbgosGetStackUsage: category=VALUE, resulting-properties={base-type=uint32, sw-calibration-access=READ-ONLY, range raw 0..4294967295}
          mc data instance Activation: category=VALUE, resulting-properties={base-type=boolean, sw-calibration-access=READ-ONLY, compu {1=TRUE, 0=FALSE}, range raw 0..1}
          mc data instance CollectionFrequency: category=VALUE, resulting-properties={base-type=uint16, sw-calibration-access=READ-ONLY, range raw 0..65535}
        Dbg_CounterIsr_SystemTimer
          mc data instance dbgDbgStaticDIDData: category=VALUE, resulting-properties={base-type=uint32, sw-calibration-access=READ-ONLY, range raw 0..4294967295}
          mc data instance Activation: category=VALUE, resulting-properties={base-type=boolean, sw-calibration-access=READ-ONLY, compu {1=TRUE, 0=FALSE}, range raw 0..1}
          mc data instance CollectionFrequency: category=VALUE, resulting-properties={base-type=uint16, sw-calibration-access=READ-ONLY, range raw 0..65535}
        Dbg_StartApplication_Appl_Task
          mc data instance dbgosGetStackUsage: category=VALUE, resulting-properties={base-type=uint32, sw-calibration-access=READ-ONLY, range raw 0..4294967295}
          mc data instance Activation: category=VALUE, resulting-properties={base-type=boolean, sw-calibration-access=READ-ONLY, compu {1=TRUE, 0=FALSE}, range raw 0..1}
          mc data instance CollectionFrequency: category=VALUE, resulting-properties={base-type=uint16, sw-calibration-access=READ-ONLY, range raw 0..65535}
        Dbg_StartApplication_Appl_Init_Task
          mc data instance dbgosGetStackUsage: category=VALUE, resulting-properties={base-type=uint32, sw-calibration-access=READ-ONLY, range raw 0..4294967295}
          mc data instance Activation: category=VALUE, resulting-properties={base-type=boolean, sw-calibration-access=READ-ONLY, compu {1=TRUE, 0=FALSE}, range raw 0..1}
          mc data instance CollectionFrequency: category=VALUE, resulting-properties={base-type=uint16, sw-calibration-access=READ-ONLY, range raw 0..65535}
        Dbg_StartApplication_NoSwc_Appl_Task
          mc data instance dbgosGetStackUsage: category=VALUE, resulting-properties={base-type=uint32, sw-calibration-access=READ-ONLY, range raw 0..4294967295}
          mc data instance Activation: category=VALUE, resulting-properties={base-type=boolean, sw-calibration-access=READ-ONLY, compu {1=TRUE, 0=FALSE}, range raw 0..1}
          mc data instance CollectionFrequency: category=VALUE, resulting-properties={base-type=uint16, sw-calibration-access=READ-ONLY, range raw 0..65535}
        Dbg_StartApplication_NoSwc_Init_Task
          mc data instance dbgosGetStackUsage: category=VALUE, resulting-properties={base-type=uint32, sw-calibration-access=READ-ONLY, range raw 0..4294967295}
          mc data instance Activation: category=VALUE, resulting-properties={base-type=boolean, sw-calibration-access=READ-ONLY, compu {1=TRUE, 0=FALSE}, range raw 0..1}
          mc data instance CollectionFrequency: category=VALUE, resulting-properties={base-type=uint16, sw-calibration-access=READ-ONLY, range raw 0..65535}
        Dbg_BswBackgroundTask
          mc data instance dbgosGetStackUsage: category=VALUE, resulting-properties={base-type=uint32, sw-calibration-access=READ-ONLY, range raw 0..4294967295}
          mc data instance Activation: category=VALUE, resulting-properties={base-type=boolean, sw-calibration-access=READ-ONLY, compu {1=TRUE, 0=FALSE}, range raw 0..1}
          mc data instance CollectionFrequency: category=VALUE, resulting-properties={base-type=uint16, sw-calibration-access=READ-ONLY, range raw 0..65535}
package /MICROSAR/Dbg_ib_bswmd/BswModuleDescriptions
  bsw module description Dbg: provided-entrys=Dbg_PeriodicSamplingFunction
    bsw internal behavior DbgBehavior
      exclusive area DBG_EXCLUSIVE_AREA_0
      bsw schedulable entity Dbg_PeriodicSamplingFunction: can-enter-exclusive-area=DBG_EXCLUSIVE_AREA_0, implemented-entry=Dbg_PeriodicSamplingFunction
      bsw timing event Dbg_PeriodicSamplingFunctionTimingEvent0: starts-on-event=Dbg_PeriodicSamplingFunction, period=0.01
  bsw module entry Dbg_PeriodicSamplingFunction: call-type=SCHEDULED, execution-context=TASK
