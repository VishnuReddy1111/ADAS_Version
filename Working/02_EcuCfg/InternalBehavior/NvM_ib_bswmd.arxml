AUTOSAR XML (schema 00048)
standard types defined: uint8
package /MICROSAR
  bsw implementation NvM_Impl: programming-language=C, sw-version=10.03.00, used-code-generator=DaVinci Configurator, vendor-id=30, ar-release-version=4.00.03
    mc-variable-instances:
      156 x mc data instance, all with category=VALUE:
        StartApplication_NvMBlock2_NvRam_ErrorStatus: resulting-properties={base-type=uint8, sw-calibration-access=READ-ONLY, compu-method=NvMErrorStatusValues, range raw 0..255}, symbol=NvM_BlockMngmtArea_at[0].NvRamErrorStatus_u8  # Block's error status
        NvMConfigBlock_NvRam_ErrorStatus: resulting-properties={base-type=uint8, sw-calibration-access=READ-ONLY, compu-method=NvMErrorStatusValues, range raw 0..255}, symbol=NvM_BlockMngmtArea_at[1].NvRamErrorStatus_u8  # Block's error status
        DemAdminDataBlock_NvRam_ErrorStatus: resulting-properties={base-type=uint8, sw-calibration-access=READ-ONLY, compu-method=NvMErrorStatusValues, range raw 0..255}, symbol=NvM_BlockMngmtArea_at[2].NvRamErrorStatus_u8  # Block's error status
        DemPrimaryDataBlock0_NvRam_ErrorStatus: resulting-properties={base-type=uint8, sw-calibration-access=READ-ONLY, compu-method=NvMErrorStatusValues, range raw 0..255}, symbol=NvM_BlockMngmtArea_at[3].NvRamErrorStatus_u8  # Block's error status
        DemPrimaryDataBlock1_NvRam_ErrorStatus: resulting-properties={base-type=uint8, sw-calibration-access=READ-ONLY, compu-method=NvMErrorStatusValues, range raw 0..255}, symbol=NvM_BlockMngmtArea_at[4].NvRamErrorStatus_u8  # Block's error status
        DemPrimaryDataBlock2_NvRam_ErrorStatus: resulting-properties={base-type=uint8, sw-calibration-access=READ-ONLY, compu-method=NvMErrorStatusValues, range raw 0..255}, symbol=NvM_BlockMngmtArea_at[5].NvRamErrorStatus_u8  # Block's error status
        DemPrimaryDataBlock3_NvRam_ErrorStatus: resulting-properties={base-type=uint8, sw-calibration-access=READ-ONLY, compu-method=NvMErrorStatusValues, range raw 0..255}, symbol=NvM_BlockMngmtArea_at[6].NvRamErrorStatus_u8  # Block's error status
        DemPrimaryDataBlock4_NvRam_ErrorStatus: resulting-properties={base-type=uint8, sw-calibration-access=READ-ONLY, compu-method=NvMErrorStatusValues, range raw 0..255}, symbol=NvM_BlockMngmtArea_at[7].NvRamErrorStatus_u8  # Block's error status
        DemPrimaryDataBlock5_NvRam_ErrorStatus: resulting-properties={base-type=uint8, sw-calibration-access=READ-ONLY, compu-method=NvMErrorStatusValues, range raw 0..255}, symbol=NvM_BlockMngmtArea_at[8].NvRamErrorStatus_u8  # Block's error status
        DemPrimaryDataBlock6_NvRam_ErrorStatus: resulting-properties={base-type=uint8, sw-calibration-access=READ-ONLY, compu-method=NvMErrorStatusValues, range raw 0..255}, symbol=NvM_BlockMngmtArea_at[9].NvRamErrorStatus_u8  # Block's error status
        DemPrimaryDataBlock7_NvRam_ErrorStatus: resulting-properties={base-type=uint8, sw-calibration-access=READ-ONLY, compu-method=NvMErrorStatusValues, range raw 0..255}, symbol=NvM_BlockMngmtArea_at[10].NvRamErrorStatus_u8  # Block's error status
        StartApplication_NvMBlock1_NvRam_ErrorStatus: resulting-properties={base-type=uint8, sw-calibration-access=READ-ONLY, compu-method=NvMErrorStatusValues, range raw 0..255}, symbol=NvM_BlockMngmtArea_at[11].NvRamErrorStatus_u8  # Block's error status
        vFotaH_NvMModuleInfo_NvRam_ErrorStatus: resulting-properties={base-type=uint8, sw-calibration-access=READ-ONLY, compu-method=NvMErrorStatusValues, range raw 0..255}, symbol=NvM_BlockMngmtArea_at[12].NvRamErrorStatus_u8  # Block's error status
        vSwUpdM_Appl_NvModuleInfo_NvRam_ErrorStatus: resulting-properties={base-type=uint8, sw-calibration-access=READ-ONLY, compu-method=NvMErrorStatusValues, range raw 0..255}, symbol=NvM_BlockMngmtArea_at[13].NvRamErrorStatus_u8  # Block's error status
        vSwUpdM_Appl_NvPartitionInfo_NvRam_ErrorStatus: resulting-properties={base-type=uint8, sw-calibration-access=READ-ONLY, compu-method=NvMErrorStatusValues, range raw 0..255}, symbol=NvM_BlockMngmtArea_at[14].NvRamErrorStatus_u8  # Block's error status
        vSwUpdM_Appl_NvRegionInfo_NvRam_ErrorStatus: resulting-properties={base-type=uint8, sw-calibration-access=READ-ONLY, compu-method=NvMErrorStatusValues, range raw 0..255}, symbol=NvM_BlockMngmtArea_at[15].NvRamErrorStatus_u8  # Block's error status
        vSwUpdM_Appl_NvResumeInfo_NvRam_ErrorStatus: resulting-properties={base-type=uint8, sw-calibration-access=READ-ONLY, compu-method=NvMErrorStatusValues, range raw 0..255}, symbol=NvM_BlockMngmtArea_at[16].NvRamErrorStatus_u8  # Block's error status
        vSwUpdM_Appl_NvSegmentAttributes_NvRam_ErrorStatus: resulting-properties={base-type=uint8, sw-calibration-access=READ-ONLY, compu-method=NvMErrorStatusValues, range raw 0..255}, symbol=NvM_BlockMngmtArea_at[17].NvRamErrorStatus_u8  # Block's error status
        vSwUpdM_Appl_NvSegmentCount_NvRam_ErrorStatus: resulting-properties={base-type=uint8, sw-calibration-access=READ-ONLY, compu-method=NvMErrorStatusValues, range raw 0..255}, symbol=NvM_BlockMngmtArea_at[18].NvRamErrorStatus_u8  # Block's error status
        vSwUpdM_Appl_NvSegmentWriteAddress_NvRam_ErrorStatus: resulting-properties={base-type=uint8, sw-calibration-access=READ-ONLY, compu-method=NvMErrorStatusValues, range raw 0..255}, symbol=NvM_BlockMngmtArea_at[19].NvRamErrorStatus_u8  # Block's error status
        vSwUpdM_Appl_NvUpdateState_NvRam_ErrorStatus: resulting-properties={base-type=uint8, sw-calibration-access=READ-ONLY, compu-method=NvMErrorStatusValues, range raw 0..255}, symbol=NvM_BlockMngmtArea_at[20].NvRamErrorStatus_u8  # Block's error status
        CryptoKeyStorage_NvRam_ErrorStatus: resulting-properties={base-type=uint8, sw-calibration-access=READ-ONLY, compu-method=NvMErrorStatusValues, range raw 0..255}, symbol=NvM_BlockMngmtArea_at[21].NvRamErrorStatus_u8  # Block's error status
        DemStatusDataBlock_NvRam_ErrorStatus: resulting-properties={base-type=uint8, sw-calibration-access=READ-ONLY, compu-method=NvMErrorStatusValues, range raw 0..255}, symbol=NvM_BlockMngmtArea_at[22].NvRamErrorStatus_u8  # Block's error status
        NvMBlock_0x0250_NvRam_ErrorStatus: resulting-properties={base-type=uint8, sw-calibration-access=READ-ONLY, compu-method=NvMErrorStatusValues, range raw 0..255}, symbol=NvM_BlockMngmtArea_at[23].NvRamErrorStatus_u8  # Block's error status
        CddNpmGen2_MeasurementsType_NvRam_ErrorStatus: resulting-properties={base-type=uint8, sw-calibration-access=READ-ONLY, compu-method=NvMErrorStatusValues, range raw 0..255}, symbol=NvM_BlockMngmtArea_at[24].NvRamErrorStatus_u8  # Block's error status
        RT_Vishnu_NvMBlock_NvRam_ErrorStatus: resulting-properties={base-type=uint8, sw-calibration-access=READ-ONLY, compu-method=NvMErrorStatusValues, range raw 0..255}, symbol=NvM_BlockMngmtArea_at[25].NvRamErrorStatus_u8  # Block's error status
        StartApplication_NvMBlock2_NvDataIndex: resulting-properties={base-type=uint8, sw-calibration-access=READ-ONLY, range raw 0..255}, symbol=NvM_BlockMngmtArea_at[0].NvDataIndex_t  # Block's dataset index
        NvMConfigBlock_NvDataIndex: resulting-properties={base-type=uint8, sw-calibration-access=READ-ONLY, range raw 0..255}, symbol=NvM_BlockMngmtArea_at[1].NvDataIndex_t  # Block's dataset index
        DemAdminDataBlock_NvDataIndex: resulting-properties={base-type=uint8, sw-calibration-access=READ-ONLY, range raw 0..255}, symbol=NvM_BlockMngmtArea_at[2].NvDataIndex_t  # Block's dataset index
        DemPrimaryDataBlock0_NvDataIndex: resulting-properties={base-type=uint8, sw-calibration-access=READ-ONLY, range raw 0..255}, symbol=NvM_BlockMngmtArea_at[3].NvDataIndex_t  # Block's dataset index
        DemPrimaryDataBlock1_NvDataIndex: resulting-properties={base-type=uint8, sw-calibration-access=READ-ONLY, range raw 0..255}, symbol=NvM_BlockMngmtArea_at[4].NvDataIndex_t  # Block's dataset index
        DemPrimaryDataBlock2_NvDataIndex: resulting-properties={base-type=uint8, sw-calibration-access=READ-ONLY, range raw 0..255}, symbol=NvM_BlockMngmtArea_at[5].NvDataIndex_t  # Block's dataset index
        DemPrimaryDataBlock3_NvDataIndex: resulting-properties={base-type=uint8, sw-calibration-access=READ-ONLY, range raw 0..255}, symbol=NvM_BlockMngmtArea_at[6].NvDataIndex_t  # Block's dataset index
        DemPrimaryDataBlock4_NvDataIndex: resulting-properties={base-type=uint8, sw-calibration-access=READ-ONLY, range raw 0..255}, symbol=NvM_BlockMngmtArea_at[7].NvDataIndex_t  # Block's dataset index
        DemPrimaryDataBlock5_NvDataIndex: resulting-properties={base-type=uint8, sw-calibration-access=READ-ONLY, range raw 0..255}, symbol=NvM_BlockMngmtArea_at[8].NvDataIndex_t  # Block's dataset index
        DemPrimaryDataBlock6_NvDataIndex: resulting-properties={base-type=uint8, sw-calibration-access=READ-ONLY, range raw 0..255}, symbol=NvM_BlockMngmtArea_at[9].NvDataIndex_t  # Block's dataset index
        DemPrimaryDataBlock7_NvDataIndex: resulting-properties={base-type=uint8, sw-calibration-access=READ-ONLY, range raw 0..255}, symbol=NvM_BlockMngmtArea_at[10].NvDataIndex_t  # Block's dataset index
        StartApplication_NvMBlock1_NvDataIndex: resulting-properties={base-type=uint8, sw-calibration-access=READ-ONLY, range raw 0..255}, symbol=NvM_BlockMngmtArea_at[11].NvDataIndex_t  # Block's dataset index
        vFotaH_NvMModuleInfo_NvDataIndex: resulting-properties={base-type=uint8, sw-calibration-access=READ-ONLY, range raw 0..255}, symbol=NvM_BlockMngmtArea_at[12].NvDataIndex_t  # Block's dataset index
        vSwUpdM_Appl_NvModuleInfo_NvDataIndex: resulting-properties={base-type=uint8, sw-calibration-access=READ-ONLY, range raw 0..255}, symbol=NvM_BlockMngmtArea_at[13].NvDataIndex_t  # Block's dataset index
        vSwUpdM_Appl_NvPartitionInfo_NvDataIndex: resulting-properties={base-type=uint8, sw-calibration-access=READ-ONLY, range raw 0..255}, symbol=NvM_BlockMngmtArea_at[14].NvDataIndex_t  # Block's dataset index
        vSwUpdM_Appl_NvRegionInfo_NvDataIndex: resulting-properties={base-type=uint8, sw-calibration-access=READ-ONLY, range raw 0..255}, symbol=NvM_BlockMngmtArea_at[15].NvDataIndex_t  # Block's dataset index
        vSwUpdM_Appl_NvResumeInfo_NvDataIndex: resulting-properties={base-type=uint8, sw-calibration-access=READ-ONLY, range raw 0..255}, symbol=NvM_BlockMngmtArea_at[16].NvDataIndex_t  # Block's dataset index
        vSwUpdM_Appl_NvSegmentAttributes_NvDataIndex: resulting-properties={base-type=uint8, sw-calibration-access=READ-ONLY, range raw 0..255}, symbol=NvM_BlockMngmtArea_at[17].NvDataIndex_t  # Block's dataset index
        vSwUpdM_Appl_NvSegmentCount_NvDataIndex: resulting-properties={base-type=uint8, sw-calibration-access=READ-ONLY, range raw 0..255}, symbol=NvM_BlockMngmtArea_at[18].NvDataIndex_t  # Block's dataset index
        vSwUpdM_Appl_NvSegmentWriteAddress_NvDataIndex: resulting-properties={base-type=uint8, sw-calibration-access=READ-ONLY, range raw 0..255}, symbol=NvM_BlockMngmtArea_at[19].NvDataIndex_t  # Block's dataset index
        vSwUpdM_Appl_NvUpdateState_NvDataIndex: resulting-properties={base-type=uint8, sw-calibration-access=READ-ONLY, range raw 0..255}, symbol=NvM_BlockMngmtArea_at[20].NvDataIndex_t  # Block's dataset index
        CryptoKeyStorage_NvDataIndex: resulting-properties={base-type=uint8, sw-calibration-access=READ-ONLY, range raw 0..255}, symbol=NvM_BlockMngmtArea_at[21].NvDataIndex_t  # Block's dataset index
        DemStatusDataBlock_NvDataIndex: resulting-properties={base-type=uint8, sw-calibration-access=READ-ONLY, range raw 0..255}, symbol=NvM_BlockMngmtArea_at[22].NvDataIndex_t  # Block's dataset index
        NvMBlock_0x0250_NvDataIndex: resulting-properties={base-type=uint8, sw-calibration-access=READ-ONLY, range raw 0..255}, symbol=NvM_BlockMngmtArea_at[23].NvDataIndex_t  # Block's dataset index
        CddNpmGen2_MeasurementsType_NvDataIndex: resulting-properties={base-type=uint8, sw-calibration-access=READ-ONLY, range raw 0..255}, symbol=NvM_BlockMngmtArea_at[24].NvDataIndex_t  # Block's dataset index
        RT_Vishnu_NvMBlock_NvDataIndex: resulting-properties={base-type=uint8, sw-calibration-access=READ-ONLY, range raw 0..255}, symbol=NvM_BlockMngmtArea_at[25].NvDataIndex_t  # Block's dataset index
        StartApplication_NvMBlock2_NVM_STATE_VALID_SET: resulting-properties={base-type=NvRamAttributes, sw-bit-representation={bit-position=0, number-of-bits=1}, sw-calibration-access=READ-ONLY, data-constr=NvRamAttributes}, symbol=NvM_BlockMngmtArea_at[0].NvRamAttributes_u8  # Block's valid status
        StartApplication_NvMBlock2_NVM_STATE_CHANGED_SET: resulting-properties={base-type=NvRamAttributes, sw-bit-representation={bit-position=1, number-of-bits=1}, sw-calibration-access=READ-ONLY, data-constr=NvRamAttributes}, symbol=NvM_BlockMngmtArea_at[0].NvRamAttributes_u8  # Block's changed status
        StartApplication_NvMBlock2_NVM_WR_PROT_SET: resulting-properties={base-type=NvRamAttributes, sw-bit-representation={bit-position=7, number-of-bits=1}, sw-calibration-access=READ-ONLY, data-constr=NvRamAttributes}, symbol=NvM_BlockMngmtArea_at[0].NvRamAttributes_u8  # Block's write protection status
        StartApplication_NvMBlock2_NVM_LOCK_STAT_SET: resulting-properties={base-type=NvRamAttributes, sw-bit-representation={bit-position=6, number-of-bits=1}, sw-calibration-access=READ-ONLY, data-constr=NvRamAttributes}, symbol=NvM_BlockMngmtArea_at[0].NvRamAttributes_u8  # Block's lock status
        NvMConfigBlock_NVM_STATE_VALID_SET: resulting-properties={base-type=NvRamAttributes, sw-bit-representation={bit-position=0, number-of-bits=1}, sw-calibration-access=READ-ONLY, data-constr=NvRamAttributes}, symbol=NvM_BlockMngmtArea_at[1].NvRamAttributes_u8  # Block's valid status
        NvMConfigBlock_NVM_STATE_CHANGED_SET: resulting-properties={base-type=NvRamAttributes, sw-bit-representation={bit-position=1, number-of-bits=1}, sw-calibration-access=READ-ONLY, data-constr=NvRamAttributes}, symbol=NvM_BlockMngmtArea_at[1].NvRamAttributes_u8  # Block's changed status
        NvMConfigBlock_NVM_WR_PROT_SET: resulting-properties={base-type=NvRamAttributes, sw-bit-representation={bit-position=7, number-of-bits=1}, sw-calibration-access=READ-ONLY, data-constr=NvRamAttributes}, symbol=NvM_BlockMngmtArea_at[1].NvRamAttributes_u8  # Block's write protection status
        NvMConfigBlock_NVM_LOCK_STAT_SET: resulting-properties={base-type=NvRamAttributes, sw-bit-representation={bit-position=6, number-of-bits=1}, sw-calibration-access=READ-ONLY, data-constr=NvRamAttributes}, symbol=NvM_BlockMngmtArea_at[1].NvRamAttributes_u8  # Block's lock status
        DemAdminDataBlock_NVM_STATE_VALID_SET: resulting-properties={base-type=NvRamAttributes, sw-bit-representation={bit-position=0, number-of-bits=1}, sw-calibration-access=READ-ONLY, data-constr=NvRamAttributes}, symbol=NvM_BlockMngmtArea_at[2].NvRamAttributes_u8  # Block's valid status
        DemAdminDataBlock_NVM_STATE_CHANGED_SET: resulting-properties={base-type=NvRamAttributes, sw-bit-representation={bit-position=1, number-of-bits=1}, sw-calibration-access=READ-ONLY, data-constr=NvRamAttributes}, symbol=NvM_BlockMngmtArea_at[2].NvRamAttributes_u8  # Block's changed status
        DemAdminDataBlock_NVM_WR_PROT_SET: resulting-properties={base-type=NvRamAttributes, sw-bit-representation={bit-position=7, number-of-bits=1}, sw-calibration-access=READ-ONLY, data-constr=NvRamAttributes}, symbol=NvM_BlockMngmtArea_at[2].NvRamAttributes_u8  # Block's write protection status
        DemAdminDataBlock_NVM_LOCK_STAT_SET: resulting-properties={base-type=NvRamAttributes, sw-bit-representation={bit-position=6, number-of-bits=1}, sw-calibration-access=READ-ONLY, data-constr=NvRamAttributes}, symbol=NvM_BlockMngmtArea_at[2].NvRamAttributes_u8  # Block's lock status
        DemPrimaryDataBlock0_NVM_STATE_VALID_SET: resulting-properties={base-type=NvRamAttributes, sw-bit-representation={bit-position=0, number-of-bits=1}, sw-calibration-access=READ-ONLY, data-constr=NvRamAttributes}, symbol=NvM_BlockMngmtArea_at[3].NvRamAttributes_u8  # Block's valid status
        DemPrimaryDataBlock0_NVM_STATE_CHANGED_SET: resulting-properties={base-type=NvRamAttributes, sw-bit-representation={bit-position=1, number-of-bits=1}, sw-calibration-access=READ-ONLY, data-constr=NvRamAttributes}, symbol=NvM_BlockMngmtArea_at[3].NvRamAttributes_u8  # Block's changed status
        DemPrimaryDataBlock0_NVM_WR_PROT_SET: resulting-properties={base-type=NvRamAttributes, sw-bit-representation={bit-position=7, number-of-bits=1}, sw-calibration-access=READ-ONLY, data-constr=NvRamAttributes}, symbol=NvM_BlockMngmtArea_at[3].NvRamAttributes_u8  # Block's write protection status
        DemPrimaryDataBlock0_NVM_LOCK_STAT_SET: resulting-properties={base-type=NvRamAttributes, sw-bit-representation={bit-position=6, number-of-bits=1}, sw-calibration-access=READ-ONLY, data-constr=NvRamAttributes}, symbol=NvM_BlockMngmtArea_at[3].NvRamAttributes_u8  # Block's lock status
        DemPrimaryDataBlock1_NVM_STATE_VALID_SET: resulting-properties={base-type=NvRamAttributes, sw-bit-representation={bit-position=0, number-of-bits=1}, sw-calibration-access=READ-ONLY, data-constr=NvRamAttributes}, symbol=NvM_BlockMngmtArea_at[4].NvRamAttributes_u8  # Block's valid status
        DemPrimaryDataBlock1_NVM_STATE_CHANGED_SET: resulting-properties={base-type=NvRamAttributes, sw-bit-representation={bit-position=1, number-of-bits=1}, sw-calibration-access=READ-ONLY, data-constr=NvRamAttributes}, symbol=NvM_BlockMngmtArea_at[4].NvRamAttributes_u8  # Block's changed status
        DemPrimaryDataBlock1_NVM_WR_PROT_SET: resulting-properties={base-type=NvRamAttributes, sw-bit-representation={bit-position=7, number-of-bits=1}, sw-calibration-access=READ-ONLY, data-constr=NvRamAttributes}, symbol=NvM_BlockMngmtArea_at[4].NvRamAttributes_u8  # Block's write protection status
        DemPrimaryDataBlock1_NVM_LOCK_STAT_SET: resulting-properties={base-type=NvRamAttributes, sw-bit-representation={bit-position=6, number-of-bits=1}, sw-calibration-access=READ-ONLY, data-constr=NvRamAttributes}, symbol=NvM_BlockMngmtArea_at[4].NvRamAttributes_u8  # Block's lock status
        DemPrimaryDataBlock2_NVM_STATE_VALID_SET: resulting-properties={base-type=NvRamAttributes, sw-bit-representation={bit-position=0, number-of-bits=1}, sw-calibration-access=READ-ONLY, data-constr=NvRamAttributes}, symbol=NvM_BlockMngmtArea_at[5].NvRamAttributes_u8  # Block's valid status
        DemPrimaryDataBlock2_NVM_STATE_CHANGED_SET: resulting-properties={base-type=NvRamAttributes, sw-bit-representation={bit-position=1, number-of-bits=1}, sw-calibration-access=READ-ONLY, data-constr=NvRamAttributes}, symbol=NvM_BlockMngmtArea_at[5].NvRamAttributes_u8  # Block's changed status
        DemPrimaryDataBlock2_NVM_WR_PROT_SET: resulting-properties={base-type=NvRamAttributes, sw-bit-representation={bit-position=7, number-of-bits=1}, sw-calibration-access=READ-ONLY, data-constr=NvRamAttributes}, symbol=NvM_BlockMngmtArea_at[5].NvRamAttributes_u8  # Block's write protection status
        DemPrimaryDataBlock2_NVM_LOCK_STAT_SET: resulting-properties={base-type=NvRamAttributes, sw-bit-representation={bit-position=6, number-of-bits=1}, sw-calibration-access=READ-ONLY, data-constr=NvRamAttributes}, symbol=NvM_BlockMngmtArea_at[5].NvRamAttributes_u8  # Block's lock status
        DemPrimaryDataBlock3_NVM_STATE_VALID_SET: resulting-properties={base-type=NvRamAttributes, sw-bit-representation={bit-position=0, number-of-bits=1}, sw-calibration-access=READ-ONLY, data-constr=NvRamAttributes}, symbol=NvM_BlockMngmtArea_at[6].NvRamAttributes_u8  # Block's valid status
        DemPrimaryDataBlock3_NVM_STATE_CHANGED_SET: resulting-properties={base-type=NvRamAttributes, sw-bit-representation={bit-position=1, number-of-bits=1}, sw-calibration-access=READ-ONLY, data-constr=NvRamAttributes}, symbol=NvM_BlockMngmtArea_at[6].NvRamAttributes_u8  # Block's changed status
        DemPrimaryDataBlock3_NVM_WR_PROT_SET: resulting-properties={base-type=NvRamAttributes, sw-bit-representation={bit-position=7, number-of-bits=1}, sw-calibration-access=READ-ONLY, data-constr=NvRamAttributes}, symbol=NvM_BlockMngmtArea_at[6].NvRamAttributes_u8  # Block's write protection status
        DemPrimaryDataBlock3_NVM_LOCK_STAT_SET: resulting-properties={base-type=NvRamAttributes, sw-bit-representation={bit-position=6, number-of-bits=1}, sw-calibration-access=READ-ONLY, data-constr=NvRamAttributes}, symbol=NvM_BlockMngmtArea_at[6].NvRamAttributes_u8  # Block's lock status
        DemPrimaryDataBlock4_NVM_STATE_VALID_SET: resulting-properties={base-type=NvRamAttributes, sw-bit-representation={bit-position=0, number-of-bits=1}, sw-calibration-access=READ-ONLY, data-constr=NvRamAttributes}, symbol=NvM_BlockMngmtArea_at[7].NvRamAttributes_u8  # Block's valid status
        DemPrimaryDataBlock4_NVM_STATE_CHANGED_SET: resulting-properties={base-type=NvRamAttributes, sw-bit-representation={bit-position=1, number-of-bits=1}, sw-calibration-access=READ-ONLY, data-constr=NvRamAttributes}, symbol=NvM_BlockMngmtArea_at[7].NvRamAttributes_u8  # Block's changed status
        DemPrimaryDataBlock4_NVM_WR_PROT_SET: resulting-properties={base-type=NvRamAttributes, sw-bit-representation={bit-position=7, number-of-bits=1}, sw-calibration-access=READ-ONLY, data-constr=NvRamAttributes}, symbol=NvM_BlockMngmtArea_at[7].NvRamAttributes_u8  # Block's write protection status
        DemPrimaryDataBlock4_NVM_LOCK_STAT_SET: resulting-properties={base-type=NvRamAttributes, sw-bit-representation={bit-position=6, number-of-bits=1}, sw-calibration-access=READ-ONLY, data-constr=NvRamAttributes}, symbol=NvM_BlockMngmtArea_at[7].NvRamAttributes_u8  # Block's lock status
        DemPrimaryDataBlock5_NVM_STATE_VALID_SET: resulting-properties={base-type=NvRamAttributes, sw-bit-representation={bit-position=0, number-of-bits=1}, sw-calibration-access=READ-ONLY, data-constr=NvRamAttributes}, symbol=NvM_BlockMngmtArea_at[8].NvRamAttributes_u8  # Block's valid status
        DemPrimaryDataBlock5_NVM_STATE_CHANGED_SET: resulting-properties={base-type=NvRamAttributes, sw-bit-representation={bit-position=1, number-of-bits=1}, sw-calibration-access=READ-ONLY, data-constr=NvRamAttributes}, symbol=NvM_BlockMngmtArea_at[8].NvRamAttributes_u8  # Block's changed status
        DemPrimaryDataBlock5_NVM_WR_PROT_SET: resulting-properties={base-type=NvRamAttributes, sw-bit-representation={bit-position=7, number-of-bits=1}, sw-calibration-access=READ-ONLY, data-constr=NvRamAttributes}, symbol=NvM_BlockMngmtArea_at[8].NvRamAttributes_u8  # Block's write protection status
        DemPrimaryDataBlock5_NVM_LOCK_STAT_SET: resulting-properties={base-type=NvRamAttributes, sw-bit-representation={bit-position=6, number-of-bits=1}, sw-calibration-access=READ-ONLY, data-constr=NvRamAttributes}, symbol=NvM_BlockMngmtArea_at[8].NvRamAttributes_u8  # Block's lock status
        DemPrimaryDataBlock6_NVM_STATE_VALID_SET: resulting-properties={base-type=NvRamAttributes, sw-bit-representation={bit-position=0, number-of-bits=1}, sw-calibration-access=READ-ONLY, data-constr=NvRamAttributes}, symbol=NvM_BlockMngmtArea_at[9].NvRamAttributes_u8  # Block's valid status
        DemPrimaryDataBlock6_NVM_STATE_CHANGED_SET: resulting-properties={base-type=NvRamAttributes, sw-bit-representation={bit-position=1, number-of-bits=1}, sw-calibration-access=READ-ONLY, data-constr=NvRamAttributes}, symbol=NvM_BlockMngmtArea_at[9].NvRamAttributes_u8  # Block's changed status
        DemPrimaryDataBlock6_NVM_WR_PROT_SET: resulting-properties={base-type=NvRamAttributes, sw-bit-representation={bit-position=7, number-of-bits=1}, sw-calibration-access=READ-ONLY, data-constr=NvRamAttributes}, symbol=NvM_BlockMngmtArea_at[9].NvRamAttributes_u8  # Block's write protection status
        DemPrimaryDataBlock6_NVM_LOCK_STAT_SET: resulting-properties={base-type=NvRamAttributes, sw-bit-representation={bit-position=6, number-of-bits=1}, sw-calibration-access=READ-ONLY, data-constr=NvRamAttributes}, symbol=NvM_BlockMngmtArea_at[9].NvRamAttributes_u8  # Block's lock status
        DemPrimaryDataBlock7_NVM_STATE_VALID_SET: resulting-properties={base-type=NvRamAttributes, sw-bit-representation={bit-position=0, number-of-bits=1}, sw-calibration-access=READ-ONLY, data-constr=NvRamAttributes}, symbol=NvM_BlockMngmtArea_at[10].NvRamAttributes_u8  # Block's valid status
        DemPrimaryDataBlock7_NVM_STATE_CHANGED_SET: resulting-properties={base-type=NvRamAttributes, sw-bit-representation={bit-position=1, number-of-bits=1}, sw-calibration-access=READ-ONLY, data-constr=NvRamAttributes}, symbol=NvM_BlockMngmtArea_at[10].NvRamAttributes_u8  # Block's changed status
        DemPrimaryDataBlock7_NVM_WR_PROT_SET: resulting-properties={base-type=NvRamAttributes, sw-bit-representation={bit-position=7, number-of-bits=1}, sw-calibration-access=READ-ONLY, data-constr=NvRamAttributes}, symbol=NvM_BlockMngmtArea_at[10].NvRamAttributes_u8  # Block's write protection status
        DemPrimaryDataBlock7_NVM_LOCK_STAT_SET: resulting-properties={base-type=NvRamAttributes, sw-bit-representation={bit-position=6, number-of-bits=1}, sw-calibration-access=READ-ONLY, data-constr=NvRamAttributes}, symbol=NvM_BlockMngmtArea_at[10].NvRamAttributes_u8  # Block's lock status
        StartApplication_NvMBlock1_NVM_STATE_VALID_SET: resulting-properties={base-type=NvRamAttributes, sw-bit-representation={bit-position=0, number-of-bits=1}, sw-calibration-access=READ-ONLY, data-constr=NvRamAttributes}, symbol=NvM_BlockMngmtArea_at[11].NvRamAttributes_u8  # Block's valid status
        StartApplication_NvMBlock1_NVM_STATE_CHANGED_SET: resulting-properties={base-type=NvRamAttributes, sw-bit-representation={bit-position=1, number-of-bits=1}, sw-calibration-access=READ-ONLY, data-constr=NvRamAttributes}, symbol=NvM_BlockMngmtArea_at[11].NvRamAttributes_u8  # Block's changed status
        StartApplication_NvMBlock1_NVM_WR_PROT_SET: resulting-properties={base-type=NvRamAttributes, sw-bit-representation={bit-position=7, number-of-bits=1}, sw-calibration-access=READ-ONLY, data-constr=NvRamAttributes}, symbol=NvM_BlockMngmtArea_at[11].NvRamAttributes_u8  # Block's write protection status
        StartApplication_NvMBlock1_NVM_LOCK_STAT_SET: resulting-properties={base-type=NvRamAttributes, sw-bit-representation={bit-position=6, number-of-bits=1}, sw-calibration-access=READ-ONLY, data-constr=NvRamAttributes}, symbol=NvM_BlockMngmtArea_at[11].NvRamAttributes_u8  # Block's lock status
        vFotaH_NvMModuleInfo_NVM_STATE_VALID_SET: resulting-properties={base-type=NvRamAttributes, sw-bit-representation={bit-position=0, number-of-bits=1}, sw-calibration-access=READ-ONLY, data-constr=NvRamAttributes}, symbol=NvM_BlockMngmtArea_at[12].NvRamAttributes_u8  # Block's valid status
        vFotaH_NvMModuleInfo_NVM_STATE_CHANGED_SET: resulting-properties={base-type=NvRamAttributes, sw-bit-representation={bit-position=1, number-of-bits=1}, sw-calibration-access=READ-ONLY, data-constr=NvRamAttributes}, symbol=NvM_BlockMngmtArea_at[12].NvRamAttributes_u8  # Block's changed status
        vFotaH_NvMModuleInfo_NVM_WR_PROT_SET: resulting-properties={base-type=NvRamAttributes, sw-bit-representation={bit-position=7, number-of-bits=1}, sw-calibration-access=READ-ONLY, data-constr=NvRamAttributes}, symbol=NvM_BlockMngmtArea_at[12].NvRamAttributes_u8  # Block's write protection status
        vFotaH_NvMModuleInfo_NVM_LOCK_STAT_SET: resulting-properties={base-type=NvRamAttributes, sw-bit-representation={bit-position=6, number-of-bits=1}, sw-calibration-access=READ-ONLY, data-constr=NvRamAttributes}, symbol=NvM_BlockMngmtArea_at[12].NvRamAttributes_u8  # Block's lock status
        vSwUpdM_Appl_NvModuleInfo_NVM_STATE_VALID_SET: resulting-properties={base-type=NvRamAttributes, sw-bit-representation={bit-position=0, number-of-bits=1}, sw-calibration-access=READ-ONLY, data-constr=NvRamAttributes}, symbol=NvM_BlockMngmtArea_at[13].NvRamAttributes_u8  # Block's valid status
        vSwUpdM_Appl_NvModuleInfo_NVM_STATE_CHANGED_SET: resulting-properties={base-type=NvRamAttributes, sw-bit-representation={bit-position=1, number-of-bits=1}, sw-calibration-access=READ-ONLY, data-constr=NvRamAttributes}, symbol=NvM_BlockMngmtArea_at[13].NvRamAttributes_u8  # Block's changed status
        vSwUpdM_Appl_NvModuleInfo_NVM_WR_PROT_SET: resulting-properties={base-type=NvRamAttributes, sw-bit-representation={bit-position=7, number-of-bits=1}, sw-calibration-access=READ-ONLY, data-constr=NvRamAttributes}, symbol=NvM_BlockMngmtArea_at[13].NvRamAttributes_u8  # Block's write protection status
        vSwUpdM_Appl_NvModuleInfo_NVM_LOCK_STAT_SET: resulting-properties={base-type=NvRamAttributes, sw-bit-representation={bit-position=6, number-of-bits=1}, sw-calibration-access=READ-ONLY, data-constr=NvRamAttributes}, symbol=NvM_BlockMngmtArea_at[13].NvRamAttributes_u8  # Block's lock status
        vSwUpdM_Appl_NvPartitionInfo_NVM_STATE_VALID_SET: resulting-properties={base-type=NvRamAttributes, sw-bit-representation={bit-position=0, number-of-bits=1}, sw-calibration-access=READ-ONLY, data-constr=NvRamAttributes}, symbol=NvM_BlockMngmtArea_at[14].NvRamAttributes_u8  # Block's valid status
        vSwUpdM_Appl_NvPartitionInfo_NVM_STATE_CHANGED_SET: resulting-properties={base-type=NvRamAttributes, sw-bit-representation={bit-position=1, number-of-bits=1}, sw-calibration-access=READ-ONLY, data-constr=NvRamAttributes}, symbol=NvM_BlockMngmtArea_at[14].NvRamAttributes_u8  # Block's changed status
        vSwUpdM_Appl_NvPartitionInfo_NVM_WR_PROT_SET: resulting-properties={base-type=NvRamAttributes, sw-bit-representation={bit-position=7, number-of-bits=1}, sw-calibration-access=READ-ONLY, data-constr=NvRamAttributes}, symbol=NvM_BlockMngmtArea_at[14].NvRamAttributes_u8  # Block's write protection status
        vSwUpdM_Appl_NvPartitionInfo_NVM_LOCK_STAT_SET: resulting-properties={base-type=NvRamAttributes, sw-bit-representation={bit-position=6, number-of-bits=1}, sw-calibration-access=READ-ONLY, data-constr=NvRamAttributes}, symbol=NvM_BlockMngmtArea_at[14].NvRamAttributes_u8  # Block's lock status
        vSwUpdM_Appl_NvRegionInfo_NVM_STATE_VALID_SET: resulting-properties={base-type=NvRamAttributes, sw-bit-representation={bit-position=0, number-of-bits=1}, sw-calibration-access=READ-ONLY, data-constr=NvRamAttributes}, symbol=NvM_BlockMngmtArea_at[15].NvRamAttributes_u8  # Block's valid status
        vSwUpdM_Appl_NvRegionInfo_NVM_STATE_CHANGED_SET: resulting-properties={base-type=NvRamAttributes, sw-bit-representation={bit-position=1, number-of-bits=1}, sw-calibration-access=READ-ONLY, data-constr=NvRamAttributes}, symbol=NvM_BlockMngmtArea_at[15].NvRamAttributes_u8  # Block's changed status
        vSwUpdM_Appl_NvRegionInfo_NVM_WR_PROT_SET: resulting-properties={base-type=NvRamAttributes, sw-bit-representation={bit-position=7, number-of-bits=1}, sw-calibration-access=READ-ONLY, data-constr=NvRamAttributes}, symbol=NvM_BlockMngmtArea_at[15].NvRamAttributes_u8  # Block's write protection status
        vSwUpdM_Appl_NvRegionInfo_NVM_LOCK_STAT_SET: resulting-properties={base-type=NvRamAttributes, sw-bit-representation={bit-position=6, number-of-bits=1}, sw-calibration-access=READ-ONLY, data-constr=NvRamAttributes}, symbol=NvM_BlockMngmtArea_at[15].NvRamAttributes_u8  # Block's lock status
        vSwUpdM_Appl_NvResumeInfo_NVM_STATE_VALID_SET: resulting-properties={base-type=NvRamAttributes, sw-bit-representation={bit-position=0, number-of-bits=1}, sw-calibration-access=READ-ONLY, data-constr=NvRamAttributes}, symbol=NvM_BlockMngmtArea_at[16].NvRamAttributes_u8  # Block's valid status
        vSwUpdM_Appl_NvResumeInfo_NVM_STATE_CHANGED_SET: resulting-properties={base-type=NvRamAttributes, sw-bit-representation={bit-position=1, number-of-bits=1}, sw-calibration-access=READ-ONLY, data-constr=NvRamAttributes}, symbol=NvM_BlockMngmtArea_at[16].NvRamAttributes_u8  # Block's changed status
        vSwUpdM_Appl_NvResumeInfo_NVM_WR_PROT_SET: resulting-properties={base-type=NvRamAttributes, sw-bit-representation={bit-position=7, number-of-bits=1}, sw-calibration-access=READ-ONLY, data-constr=NvRamAttributes}, symbol=NvM_BlockMngmtArea_at[16].NvRamAttributes_u8  # Block's write protection status
        vSwUpdM_Appl_NvResumeInfo_NVM_LOCK_STAT_SET: resulting-properties={base-type=NvRamAttributes, sw-bit-representation={bit-position=6, number-of-bits=1}, sw-calibration-access=READ-ONLY, data-constr=NvRamAttributes}, symbol=NvM_BlockMngmtArea_at[16].NvRamAttributes_u8  # Block's lock status
        vSwUpdM_Appl_NvSegmentAttributes_NVM_STATE_VALID_SET: resulting-properties={base-type=NvRamAttributes, sw-bit-representation={bit-position=0, number-of-bits=1}, sw-calibration-access=READ-ONLY, data-constr=NvRamAttributes}, symbol=NvM_BlockMngmtArea_at[17].NvRamAttributes_u8  # Block's valid status
        vSwUpdM_Appl_NvSegmentAttributes_NVM_STATE_CHANGED_SET: resulting-properties={base-type=NvRamAttributes, sw-bit-representation={bit-position=1, number-of-bits=1}, sw-calibration-access=READ-ONLY, data-constr=NvRamAttributes}, symbol=NvM_BlockMngmtArea_at[17].NvRamAttributes_u8  # Block's changed status
        vSwUpdM_Appl_NvSegmentAttributes_NVM_WR_PROT_SET: resulting-properties={base-type=NvRamAttributes, sw-bit-representation={bit-position=7, number-of-bits=1}, sw-calibration-access=READ-ONLY, data-constr=NvRamAttributes}, symbol=NvM_BlockMngmtArea_at[17].NvRamAttributes_u8  # Block's write protection status
        vSwUpdM_Appl_NvSegmentAttributes_NVM_LOCK_STAT_SET: resulting-properties={base-type=NvRamAttributes, sw-bit-representation={bit-position=6, number-of-bits=1}, sw-calibration-access=READ-ONLY, data-constr=NvRamAttributes}, symbol=NvM_BlockMngmtArea_at[17].NvRamAttributes_u8  # Block's lock status
        vSwUpdM_Appl_NvSegmentCount_NVM_STATE_VALID_SET: resulting-properties={base-type=NvRamAttributes, sw-bit-representation={bit-position=0, number-of-bits=1}, sw-calibration-access=READ-ONLY, data-constr=NvRamAttributes}, symbol=NvM_BlockMngmtArea_at[18].NvRamAttributes_u8  # Block's valid status
        vSwUpdM_Appl_NvSegmentCount_NVM_STATE_CHANGED_SET: resulting-properties={base-type=NvRamAttributes, sw-bit-representation={bit-position=1, number-of-bits=1}, sw-calibration-access=READ-ONLY, data-constr=NvRamAttributes}, symbol=NvM_BlockMngmtArea_at[18].NvRamAttributes_u8  # Block's changed status
        vSwUpdM_Appl_NvSegmentCount_NVM_WR_PROT_SET: resulting-properties={base-type=NvRamAttributes, sw-bit-representation={bit-position=7, number-of-bits=1}, sw-calibration-access=READ-ONLY, data-constr=NvRamAttributes}, symbol=NvM_BlockMngmtArea_at[18].NvRamAttributes_u8  # Block's write protection status
        vSwUpdM_Appl_NvSegmentCount_NVM_LOCK_STAT_SET: resulting-properties={base-type=NvRamAttributes, sw-bit-representation={bit-position=6, number-of-bits=1}, sw-calibration-access=READ-ONLY, data-constr=NvRamAttributes}, symbol=NvM_BlockMngmtArea_at[18].NvRamAttributes_u8  # Block's lock status
        vSwUpdM_Appl_NvSegmentWriteAddress_NVM_STATE_VALID_SET: resulting-properties={base-type=NvRamAttributes, sw-bit-representation={bit-position=0, number-of-bits=1}, sw-calibration-access=READ-ONLY, data-constr=NvRamAttributes}, symbol=NvM_BlockMngmtArea_at[19].NvRamAttributes_u8  # Block's valid status
        vSwUpdM_Appl_NvSegmentWriteAddress_NVM_STATE_CHANGED_SET: resulting-properties={base-type=NvRamAttributes, sw-bit-representation={bit-position=1, number-of-bits=1}, sw-calibration-access=READ-ONLY, data-constr=NvRamAttributes}, symbol=NvM_BlockMngmtArea_at[19].NvRamAttributes_u8  # Block's changed status
        vSwUpdM_Appl_NvSegmentWriteAddress_NVM_WR_PROT_SET: resulting-properties={base-type=NvRamAttributes, sw-bit-representation={bit-position=7, number-of-bits=1}, sw-calibration-access=READ-ONLY, data-constr=NvRamAttributes}, symbol=NvM_BlockMngmtArea_at[19].NvRamAttributes_u8  # Block's write protection status
        vSwUpdM_Appl_NvSegmentWriteAddress_NVM_LOCK_STAT_SET: resulting-properties={base-type=NvRamAttributes, sw-bit-representation={bit-position=6, number-of-bits=1}, sw-calibration-access=READ-ONLY, data-constr=NvRamAttributes}, symbol=NvM_BlockMngmtArea_at[19].NvRamAttributes_u8  # Block's lock status
        vSwUpdM_Appl_NvUpdateState_NVM_STATE_VALID_SET: resulting-properties={base-type=NvRamAttributes, sw-bit-representation={bit-position=0, number-of-bits=1}, sw-calibration-access=READ-ONLY, data-constr=NvRamAttributes}, symbol=NvM_BlockMngmtArea_at[20].NvRamAttributes_u8  # Block's valid status
        vSwUpdM_Appl_NvUpdateState_NVM_STATE_CHANGED_SET: resulting-properties={base-type=NvRamAttributes, sw-bit-representation={bit-position=1, number-of-bits=1}, sw-calibration-access=READ-ONLY, data-constr=NvRamAttributes}, symbol=NvM_BlockMngmtArea_at[20].NvRamAttributes_u8  # Block's changed status
        vSwUpdM_Appl_NvUpdateState_NVM_WR_PROT_SET: resulting-properties={base-type=NvRamAttributes, sw-bit-representation={bit-position=7, number-of-bits=1}, sw-calibration-access=READ-ONLY, data-constr=NvRamAttributes}, symbol=NvM_BlockMngmtArea_at[20].NvRamAttributes_u8  # Block's write protection status
        vSwUpdM_Appl_NvUpdateState_NVM_LOCK_STAT_SET: resulting-properties={base-type=NvRamAttributes, sw-bit-representation={bit-position=6, number-of-bits=1}, sw-calibration-access=READ-ONLY, data-constr=NvRamAttributes}, symbol=NvM_BlockMngmtArea_at[20].NvRamAttributes_u8  # Block's lock status
        CryptoKeyStorage_NVM_STATE_VALID_SET: resulting-properties={base-type=NvRamAttributes, sw-bit-representation={bit-position=0, number-of-bits=1}, sw-calibration-access=READ-ONLY, data-constr=NvRamAttributes}, symbol=NvM_BlockMngmtArea_at[21].NvRamAttributes_u8  # Block's valid status
        CryptoKeyStorage_NVM_STATE_CHANGED_SET: resulting-properties={base-type=NvRamAttributes, sw-bit-representation={bit-position=1, number-of-bits=1}, sw-calibration-access=READ-ONLY, data-constr=NvRamAttributes}, symbol=NvM_BlockMngmtArea_at[21].NvRamAttributes_u8  # Block's changed status
        CryptoKeyStorage_NVM_WR_PROT_SET: resulting-properties={base-type=NvRamAttributes, sw-bit-representation={bit-position=7, number-of-bits=1}, sw-calibration-access=READ-ONLY, data-constr=NvRamAttributes}, symbol=NvM_BlockMngmtArea_at[21].NvRamAttributes_u8  # Block's write protection status
        CryptoKeyStorage_NVM_LOCK_STAT_SET: resulting-properties={base-type=NvRamAttributes, sw-bit-representation={bit-position=6, number-of-bits=1}, sw-calibration-access=READ-ONLY, data-constr=NvRamAttributes}, symbol=NvM_BlockMngmtArea_at[21].NvRamAttributes_u8  # Block's lock status
        DemStatusDataBlock_NVM_STATE_VALID_SET: resulting-properties={base-type=NvRamAttributes, sw-bit-representation={bit-position=0, number-of-bits=1}, sw-calibration-access=READ-ONLY, data-constr=NvRamAttributes}, symbol=NvM_BlockMngmtArea_at[22].NvRamAttributes_u8  # Block's valid status
        DemStatusDataBlock_NVM_STATE_CHANGED_SET: resulting-properties={base-type=NvRamAttributes, sw-bit-representation={bit-position=1, number-of-bits=1}, sw-calibration-access=READ-ONLY, data-constr=NvRamAttributes}, symbol=NvM_BlockMngmtArea_at[22].NvRamAttributes_u8  # Block's changed status
        DemStatusDataBlock_NVM_WR_PROT_SET: resulting-properties={base-type=NvRamAttributes, sw-bit-representation={bit-position=7, number-of-bits=1}, sw-calibration-access=READ-ONLY, data-constr=NvRamAttributes}, symbol=NvM_BlockMngmtArea_at[22].NvRamAttributes_u8  # Block's write protection status
        DemStatusDataBlock_NVM_LOCK_STAT_SET: resulting-properties={base-type=NvRamAttributes, sw-bit-representation={bit-position=6, number-of-bits=1}, sw-calibration-access=READ-ONLY, data-constr=NvRamAttributes}, symbol=NvM_BlockMngmtArea_at[22].NvRamAttributes_u8  # Block's lock status
        NvMBlock_0x0250_NVM_STATE_VALID_SET: resulting-properties={base-type=NvRamAttributes, sw-bit-representation={bit-position=0, number-of-bits=1}, sw-calibration-access=READ-ONLY, data-constr=NvRamAttributes}, symbol=NvM_BlockMngmtArea_at[23].NvRamAttributes_u8  # Block's valid status
        NvMBlock_0x0250_NVM_STATE_CHANGED_SET: resulting-properties={base-type=NvRamAttributes, sw-bit-representation={bit-position=1, number-of-bits=1}, sw-calibration-access=READ-ONLY, data-constr=NvRamAttributes}, symbol=NvM_BlockMngmtArea_at[23].NvRamAttributes_u8  # Block's changed status
        NvMBlock_0x0250_NVM_WR_PROT_SET: resulting-properties={base-type=NvRamAttributes, sw-bit-representation={bit-position=7, number-of-bits=1}, sw-calibration-access=READ-ONLY, data-constr=NvRamAttributes}, symbol=NvM_BlockMngmtArea_at[23].NvRamAttributes_u8  # Block's write protection status
        NvMBlock_0x0250_NVM_LOCK_STAT_SET: resulting-properties={base-type=NvRamAttributes, sw-bit-representation={bit-position=6, number-of-bits=1}, sw-calibration-access=READ-ONLY, data-constr=NvRamAttributes}, symbol=NvM_BlockMngmtArea_at[23].NvRamAttributes_u8  # Block's lock status
        CddNpmGen2_MeasurementsType_NVM_STATE_VALID_SET: resulting-properties={base-type=NvRamAttributes, sw-bit-representation={bit-position=0, number-of-bits=1}, sw-calibration-access=READ-ONLY, data-constr=NvRamAttributes}, symbol=NvM_BlockMngmtArea_at[24].NvRamAttributes_u8  # Block's valid status
        CddNpmGen2_MeasurementsType_NVM_STATE_CHANGED_SET: resulting-properties={base-type=NvRamAttributes, sw-bit-representation={bit-position=1, number-of-bits=1}, sw-calibration-access=READ-ONLY, data-constr=NvRamAttributes}, symbol=NvM_BlockMngmtArea_at[24].NvRamAttributes_u8  # Block's changed status
        CddNpmGen2_MeasurementsType_NVM_WR_PROT_SET: resulting-properties={base-type=NvRamAttributes, sw-bit-representation={bit-position=7, number-of-bits=1}, sw-calibration-access=READ-ONLY, data-constr=NvRamAttributes}, symbol=NvM_BlockMngmtArea_at[24].NvRamAttributes_u8  # Block's write protection status
        CddNpmGen2_MeasurementsType_NVM_LOCK_STAT_SET: resulting-properties={base-type=NvRamAttributes, sw-bit-representation={bit-position=6, number-of-bits=1}, sw-calibration-access=READ-ONLY, data-constr=NvRamAttributes}, symbol=NvM_BlockMngmtArea_at[24].NvRamAttributes_u8  # Block's lock status
        RT_Vishnu_NvMBlock_NVM_STATE_VALID_SET: resulting-properties={base-type=NvRamAttributes, sw-bit-representation={bit-position=0, number-of-bits=1}, sw-calibration-access=READ-ONLY, data-constr=NvRamAttributes}, symbol=NvM_BlockMngmtArea_at[25].NvRamAttributes_u8  # Block's valid status
        RT_Vishnu_NvMBlock_NVM_STATE_CHANGED_SET: resulting-properties={base-type=NvRamAttributes, sw-bit-representation={bit-position=1, number-of-bits=1}, sw-calibration-access=READ-ONLY, data-constr=NvRamAttributes}, symbol=NvM_BlockMngmtArea_at[25].NvRamAttributes_u8  # Block's changed status
        RT_Vishnu_NvMBlock_NVM_WR_PROT_SET: resulting-properties={base-type=NvRamAttributes, sw-bit-representation={bit-position=7, number-of-bits=1}, sw-calibration-access=READ-ONLY, data-constr=NvRamAttributes}, symbol=NvM_BlockMngmtArea_at[25].NvRamAttributes_u8  # Block's write protection status
        RT_Vishnu_NvMBlock_NVM_LOCK_STAT_SET: resulting-properties={base-type=NvRamAttributes, sw-bit-representation={bit-position=6, number-of-bits=1}, sw-calibration-access=READ-ONLY, data-constr=NvRamAttributes}, symbol=NvM_BlockMngmtArea_at[25].NvRamAttributes_u8  # Block's lock status
package /MICROSAR/NvM_ib_bswmd/BswModuleDescriptions
  bsw module description NvM: provided-entrys=NvM_MainFunction
    bsw internal behavior NvMBehavior
      exclusive area NVM_EXCLUSIVE_AREA_0
      bsw schedulable entity NvM_MainFunction: can-enter-exclusive-area=NVM_EXCLUSIVE_AREA_0, implemented-entry=NvM_MainFunction
      bsw timing event NvM_MainFunctionTimingEvent0: starts-on-event=NvM_MainFunction, period=0.01
  bsw module entry NvM_MainFunction: call-type=SCHEDULED, execution-context=TASK
package /MICROSAR/NvM_ib_bswmd/DataTypes/BaseTypes
  base type NvRamAttributes: category=FIXED_LENGTH, base-type-size=1, base-type-encoding=NONE
package /MICROSAR/NvM_ib_bswmd/DataTypes/CompuMethods
  compu method NvMErrorStatusValues: 0=NVM_REQ_OK, 1=NVM_REQ_NOT_OK, 2=NVM_REQ_PENDING, 3=NVM_REQ_INTEGRITY_FAILED, 4=NVM_REQ_BLOCK_SKIPPED, 5=NVM_REQ_NV_INVALIDATED, 6=NVM_REQ_CANCELED, 7=NVM_REQ_REDUNDANCY_FAILED, 8=NVM_REQ_RESTORED_FROM_ROM
package /MICROSAR/NvM_ib_bswmd/DataTypes/DataConstrs
  data constr NvRamAttributes
