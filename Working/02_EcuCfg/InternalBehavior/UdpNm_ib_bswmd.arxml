AUTOSAR XML (schema 00048)
standard types defined: boolean, uint16, uint8, uint32
package /MICROSAR
  bsw implementation UdpNm_Impl: programming-language=C, sw-version=6.01.01, used-code-generator=DaVinci Configurator, vendor-id=30, ar-release-version=4.01.01
    mc-variable-instances:
      34 x mc data instance:
        UdpNm_ChannelConfig: category=ARRAY, array-size=1
          mc data instance Element_0: category=STRUCTURE, symbol=[0]
            10 x mc data instance, all with category=VALUE:
              ComControlEnabledOfChannelConfig: resulting-properties={base-type=boolean, sw-calibration-access=READ-ONLY, compu {0=FALSE, 1..255=TRUE}, range raw 0..1}
              NodeIdEnabledOfChannelConfig: resulting-properties={base-type=boolean, sw-calibration-access=READ-ONLY, compu {0=FALSE, 1..255=TRUE}, range raw 0..1}
              ChannelIdOfChannelConfig: resulting-properties={base-type=uint8, sw-calibration-access=READ-ONLY, range raw 0..255}
              MsgCycleTimeOfChannelConfig: resulting-properties={base-type=uint8, sw-calibration-access=READ-ONLY, range raw 0..255}
              MsgTimeoutTimeOfChannelConfig: resulting-properties={base-type=uint8, sw-calibration-access=READ-ONLY, range raw 0..255}
              PduCbvPositionOfChannelConfig: resulting-properties={base-type=uint8, sw-calibration-access=READ-ONLY, range raw 0..255}
              PduNidPositionOfChannelConfig: resulting-properties={base-type=uint8, sw-calibration-access=READ-ONLY, range raw 0..255}
              RepeatMessageTimeOfChannelConfig: resulting-properties={base-type=uint8, sw-calibration-access=READ-ONLY, range raw 0..255}
              TimeoutTimeOfChannelConfig: resulting-properties={base-type=uint8, sw-calibration-access=READ-ONLY, range raw 0..255}
              WaitBusSleepTimeOfChannelConfig: resulting-properties={base-type=uint8, sw-calibration-access=READ-ONLY, range raw 0..255}
        UdpNm_PbChannelConfig: category=ARRAY, array-size=1  # Structure for post-build channel configuration parameters
          mc data instance Element_0: category=STRUCTURE, symbol=[0]
            20 x mc data instance, all with category=VALUE:
              MsgCycleOffsetOfPbChannelConfig: resulting-properties={base-type=uint8, sw-calibration-access=READ-ONLY, range raw 0..255}
              NodeIdOfPbChannelConfig: resulting-properties={base-type=uint8, sw-calibration-access=READ-ONLY, range raw 0..255}
              RxMessageDataEndIdxOfPbChannelConfig: resulting-properties={base-type=uint8, sw-calibration-access=READ-ONLY, compu {255=UDPNM_NO_RXMESSAGEDATAENDIDXOFPBCHANNELCONFIG}, range raw 0..255}
              RxMessageDataLengthOfPbChannelConfig: resulting-properties={base-type=uint8, sw-calibration-access=READ-ONLY, range raw 0..255}
              RxMessageDataStartIdxOfPbChannelConfig: resulting-properties={base-type=uint8, sw-calibration-access=READ-ONLY, compu {255=UDPNM_NO_RXMESSAGEDATASTARTIDXOFPBCHANNELCONFIG}, range raw 0..255}
              RxMessageData_CBVIdxOfPbChannelConfig: resulting-properties={base-type=uint8, sw-calibration-access=READ-ONLY, compu {255=UDPNM_NO_RXMESSAGEDATA_CBVIDXOFPBCHANNELCONFIG}, range raw 0..255}
              RxMessageData_NIDIdxOfPbChannelConfig: resulting-properties={base-type=uint8, sw-calibration-access=READ-ONLY, compu {255=UDPNM_NO_RXMESSAGEDATA_NIDIDXOFPBCHANNELCONFIG}, range raw 0..255}
              RxMessageData_UserDataEndIdxOfPbChannelConfig: resulting-properties={base-type=uint8, sw-calibration-access=READ-ONLY, compu {255=UDPNM_NO_RXMESSAGEDATA_USERDATAENDIDXOFPBCHANNELCONFIG}, range raw 0..255}
              RxMessageData_UserDataLengthOfPbChannelConfig: resulting-properties={base-type=uint8, sw-calibration-access=READ-ONLY, range raw 0..255}
              RxMessageData_UserDataStartIdxOfPbChannelConfig: resulting-properties={base-type=uint8, sw-calibration-access=READ-ONLY, compu {255=UDPNM_NO_RXMESSAGEDATA_USERDATASTARTIDXOFPBCHANNELCONFIG}, range raw 0..255}
              TxMessageDataEndIdxOfPbChannelConfig: resulting-properties={base-type=uint8, sw-calibration-access=READ-ONLY, compu {255=UDPNM_NO_TXMESSAGEDATAENDIDXOFPBCHANNELCONFIG}, range raw 0..255}
              TxMessageDataLengthOfPbChannelConfig: resulting-properties={base-type=uint8, sw-calibration-access=READ-ONLY, range raw 0..255}
              TxMessageDataStartIdxOfPbChannelConfig: resulting-properties={base-type=uint8, sw-calibration-access=READ-ONLY, compu {255=UDPNM_NO_TXMESSAGEDATASTARTIDXOFPBCHANNELCONFIG}, range raw 0..255}
              TxMessageData_CBVIdxOfPbChannelConfig: resulting-properties={base-type=uint8, sw-calibration-access=READ-ONLY, compu {255=UDPNM_NO_TXMESSAGEDATA_CBVIDXOFPBCHANNELCONFIG}, range raw 0..255}
              TxMessageData_NIDIdxOfPbChannelConfig: resulting-properties={base-type=uint8, sw-calibration-access=READ-ONLY, compu {255=UDPNM_NO_TXMESSAGEDATA_NIDIDXOFPBCHANNELCONFIG}, range raw 0..255}
              TxMessageData_UserDataEndIdxOfPbChannelConfig: resulting-properties={base-type=uint8, sw-calibration-access=READ-ONLY, compu {255=UDPNM_NO_TXMESSAGEDATA_USERDATAENDIDXOFPBCHANNELCONFIG}, range raw 0..255}
              TxMessageData_UserDataLengthOfPbChannelConfig: resulting-properties={base-type=uint8, sw-calibration-access=READ-ONLY, range raw 0..255}
              TxMessageData_UserDataStartIdxOfPbChannelConfig: resulting-properties={base-type=uint8, sw-calibration-access=READ-ONLY, compu {255=UDPNM_NO_TXMESSAGEDATA_USERDATASTARTIDXOFPBCHANNELCONFIG}, range raw 0..255}
              TxPduIdOfPbChannelConfig: resulting-properties={base-type=uint8, sw-calibration-access=READ-ONLY, compu {255=UDPNM_NO_TXPDUIDOFPBCHANNELCONFIG}, range raw 0..255}
              TxUserDataPduIdOfPbChannelConfig: resulting-properties={base-type=uint8, sw-calibration-access=READ-ONLY, compu {255=UDPNM_NO_TXUSERDATAPDUIDOFPBCHANNELCONFIG}, range raw 0..255}
        UdpNm_SysToNmChInd: category=ARRAY, array-size=4, resulting-properties={base-type=uint8, sw-calibration-access=READ-ONLY, compu {255=UDPNM_NO_SYSTONMCHIND}, range raw 0..255}  # Channel indirection: System Channel handle to NM channel handle
        UdpNm_CommState: category=ARRAY, array-size=1, resulting-properties={base-type=uint8, sw-calibration-access=READ-ONLY, range raw 0..255}, symbol=UdpNm_CommState.raw  # Internal state for the application's need for communication.
        UdpNm_CommState_MyECU_EEI_V10_NM_53547422: category=ARRAY, array-size=1, resulting-properties={base-type=uint8, sw-calibration-access=READ-ONLY, range raw 0..255}, symbol=UdpNm_CommState.raw[0]  # The element: MyECU_EEI_V10_NM_53547422 of UdpNm_CommState
        UdpNm_CoordReadyToSleepState: category=ARRAY, array-size=1, resulting-properties={base-type=uint8, sw-calibration-access=READ-ONLY, range raw 0..255}, symbol=UdpNm_CoordReadyToSleepState.raw  # State for Rx of Coordinator Sleep Ready Bit:
        UdpNm_CoordReadyToSleepState_MyECU_EEI_V10_NM_53547422: category=ARRAY, array-size=1, resulting-properties={base-type=uint8, sw-calibration-access=READ-ONLY, range raw 0..255}, symbol=UdpNm_CoordReadyToSleepState.raw[0]  # The element: MyECU_EEI_V10_NM_53547422 of UdpNm_CoordReadyToSleepState
        UdpNm_MsgConfirmationFlag: category=ARRAY, array-size=1, resulting-properties={base-type=boolean, sw-calibration-access=READ-ONLY, compu {0=FALSE, 1..255=TRUE}, range raw 0..1}, symbol=UdpNm_MsgConfirmationFlag.raw  # Message Confirmation Flag
        UdpNm_MsgConfirmationFlag_MyECU_EEI_V10_NM_53547422: category=ARRAY, array-size=1, resulting-properties={base-type=boolean, sw-calibration-access=READ-ONLY, compu {0=FALSE, 1..255=TRUE}, range raw 0..1}, symbol=UdpNm_MsgConfirmationFlag.raw[0]  # The element: MyECU_EEI_V10_NM_53547422 of UdpNm_MsgConfirmationFlag
        UdpNm_MsgIndicationFlag: category=ARRAY, array-size=1, resulting-properties={base-type=boolean, sw-calibration-access=READ-ONLY, compu {0=FALSE, 1..255=TRUE}, range raw 0..1}, symbol=UdpNm_MsgIndicationFlag.raw  # Message Indication Flag
        UdpNm_MsgIndicationFlag_MyECU_EEI_V10_NM_53547422: category=ARRAY, array-size=1, resulting-properties={base-type=boolean, sw-calibration-access=READ-ONLY, compu {0=FALSE, 1..255=TRUE}, range raw 0..1}, symbol=UdpNm_MsgIndicationFlag.raw[0]  # The element: MyECU_EEI_V10_NM_53547422 of UdpNm_MsgIndicationFlag
        UdpNm_MsgRequest: category=ARRAY, array-size=1, resulting-properties={base-type=uint8, sw-calibration-access=READ-ONLY, range raw 0..255}, symbol=UdpNm_MsgRequest.raw  # Internal Message Request Variable
        UdpNm_MsgRequest_MyECU_EEI_V10_NM_53547422: category=ARRAY, array-size=1, resulting-properties={base-type=uint8, sw-calibration-access=READ-ONLY, range raw 0..255}, symbol=UdpNm_MsgRequest.raw[0]  # The element: MyECU_EEI_V10_NM_53547422 of UdpNm_MsgRequest
        UdpNm_MsgTimeoutTimer: category=ARRAY, array-size=1, resulting-properties={base-type=uint16, sw-calibration-access=READ-ONLY, range raw 0..65535}, symbol=UdpNm_MsgTimeoutTimer.raw
        UdpNm_MsgTimeoutTimer_MyECU_EEI_V10_NM_53547422: category=ARRAY, array-size=1, resulting-properties={base-type=uint16, sw-calibration-access=READ-ONLY, range raw 0..65535}, symbol=UdpNm_MsgTimeoutTimer.raw[0]  # The element: MyECU_EEI_V10_NM_53547422 of UdpNm_MsgTimeoutTimer
        UdpNm_MsgTimer: category=ARRAY, array-size=1, resulting-properties={base-type=uint16, sw-calibration-access=READ-ONLY, range raw 0..65535}, symbol=UdpNm_MsgTimer.raw  # Timer for NM message transmission.
        UdpNm_MsgTimer_MyECU_EEI_V10_NM_53547422: category=ARRAY, array-size=1, resulting-properties={base-type=uint16, sw-calibration-access=READ-ONLY, range raw 0..65535}, symbol=UdpNm_MsgTimer.raw[0]  # The element: MyECU_EEI_V10_NM_53547422 of UdpNm_MsgTimer
        UdpNm_NetworkRestartFlag: category=ARRAY, array-size=1, resulting-properties={base-type=uint8, sw-calibration-access=READ-ONLY, range raw 0..255}, symbol=UdpNm_NetworkRestartFlag.raw
        UdpNm_NetworkRestartFlag_MyECU_EEI_V10_NM_53547422: category=ARRAY, array-size=1, resulting-properties={base-type=uint8, sw-calibration-access=READ-ONLY, range raw 0..255}, symbol=UdpNm_NetworkRestartFlag.raw[0]  # The element: MyECU_EEI_V10_NM_53547422 of UdpNm_NetworkRestartFlag
        UdpNm_NmState: category=ARRAY, array-size=1, resulting-properties={base-type=uint8, sw-calibration-access=READ-ONLY, range raw 0..255}, symbol=UdpNm_NmState.raw  # Current state of the state machine
        UdpNm_NmState_MyECU_EEI_V10_NM_53547422: category=ARRAY, array-size=1, resulting-properties={base-type=uint8, sw-calibration-access=READ-ONLY, range raw 0..255}, symbol=UdpNm_NmState.raw[0]  # The element: MyECU_EEI_V10_NM_53547422 of UdpNm_NmState
        UdpNm_RepeatMsgTimer: category=ARRAY, array-size=1, resulting-properties={base-type=uint16, sw-calibration-access=READ-ONLY, range raw 0..65535}, symbol=UdpNm_RepeatMsgTimer.raw
        UdpNm_RepeatMsgTimer_MyECU_EEI_V10_NM_53547422: category=ARRAY, array-size=1, resulting-properties={base-type=uint16, sw-calibration-access=READ-ONLY, range raw 0..65535}, symbol=UdpNm_RepeatMsgTimer.raw[0]  # The element: MyECU_EEI_V10_NM_53547422 of UdpNm_RepeatMsgTimer
        UdpNm_RxMessageData: category=ARRAY, array-size=8, resulting-properties={base-type=uint8, sw-calibration-access=READ-ONLY, range raw 0..255}
        UdpNm_TimeoutTimer: category=ARRAY, array-size=1, resulting-properties={base-type=uint16, sw-calibration-access=READ-ONLY, range raw 0..65535}, symbol=UdpNm_TimeoutTimer.raw  # Timer for NM Algorithm.
        UdpNm_TimeoutTimer_MyECU_EEI_V10_NM_53547422: category=ARRAY, array-size=1, resulting-properties={base-type=uint16, sw-calibration-access=READ-ONLY, range raw 0..65535}, symbol=UdpNm_TimeoutTimer.raw[0]  # The element: MyECU_EEI_V10_NM_53547422 of UdpNm_TimeoutTimer
        UdpNm_TxControlState: category=ARRAY, array-size=1, resulting-properties={base-type=uint8, sw-calibration-access=READ-ONLY, range raw 0..255}, symbol=UdpNm_TxControlState.raw  # Message transmission control state.
        UdpNm_TxControlState_MyECU_EEI_V10_NM_53547422: category=ARRAY, array-size=1, resulting-properties={base-type=uint8, sw-calibration-access=READ-ONLY, range raw 0..255}, symbol=UdpNm_TxControlState.raw[0]  # The element: MyECU_EEI_V10_NM_53547422 of UdpNm_TxControlState
        UdpNm_TxControlStateRequest: category=ARRAY, array-size=1, resulting-properties={base-type=uint8, sw-calibration-access=READ-ONLY, range raw 0..255}, symbol=UdpNm_TxControlStateRequest.raw  # Message transmission control state request.
        UdpNm_TxControlStateRequest_MyECU_EEI_V10_NM_53547422: category=ARRAY, array-size=1, resulting-properties={base-type=uint8, sw-calibration-access=READ-ONLY, range raw 0..255}, symbol=UdpNm_TxControlStateRequest.raw[0]  # The element: MyECU_EEI_V10_NM_53547422 of UdpNm_TxControlStateRequest
        UdpNm_TxMessageData: category=ARRAY, array-size=8, resulting-properties={base-type=uint8, sw-calibration-access=READ-ONLY, range raw 0..255}
        UdpNm_WaitBusSleepTimer: category=ARRAY, array-size=1, resulting-properties={base-type=uint32, sw-calibration-access=READ-ONLY, range raw 0..4294967295}, symbol=UdpNm_WaitBusSleepTimer.raw
        UdpNm_WaitBusSleepTimer_MyECU_EEI_V10_NM_53547422: category=ARRAY, array-size=1, resulting-properties={base-type=uint32, sw-calibration-access=READ-ONLY, range raw 0..4294967295}, symbol=UdpNm_WaitBusSleepTimer.raw[0]  # The element: MyECU_EEI_V10_NM_53547422 of UdpNm_WaitBusSleepTimer
        UdpNm_ModuleInitialized: category=VALUE, resulting-properties={base-type=boolean, sw-calibration-access=READ-ONLY, compu {0=FALSE, 1..255=TRUE}, range raw 0..1}
