AUTOSAR XML (schema 00048)
standard types defined: boolean, uint8
package /MICROSAR
  bsw implementation LinSM_Impl: programming-language=C, sw-version=7.00.03, used-code-generator=DaVinci Configurator, vendor-id=30, ar-release-version=4.00.03
    mc-variable-instances:
      14 x mc data instance:
        LinSM_ComMToLinSMChannel: category=ARRAY, array-size=2, resulting-properties={base-type=uint8, sw-calibration-access=READ-ONLY, compu {255=LINSM_NO_COMMTOLINSMCHANNEL}, range raw 0..255}
        LinSM_ConfirmationTimer: category=ARRAY, array-size=1, resulting-properties={base-type=uint8, sw-calibration-access=READ-ONLY, range raw 0..255}, symbol=LinSM_ConfirmationTimer.raw
        LinSM_ConfirmationTimer_CHNL_45618847: category=ARRAY, array-size=1, resulting-properties={base-type=uint8, sw-calibration-access=READ-ONLY, range raw 0..255}, symbol=LinSM_ConfirmationTimer.raw[0]  # The element: CHNL_45618847 of LinSM_ConfirmationTimer
        LinSM_DesiredConfirmation: category=ARRAY, array-size=1, resulting-properties={base-type=uint8, sw-calibration-access=READ-ONLY, range raw 0..255}, symbol=LinSM_DesiredConfirmation.raw
        LinSM_DesiredConfirmation_CHNL_45618847: category=ARRAY, array-size=1, resulting-properties={base-type=uint8, sw-calibration-access=READ-ONLY, range raw 0..255}, symbol=LinSM_DesiredConfirmation.raw[0]  # The element: CHNL_45618847 of LinSM_DesiredConfirmation
        LinSM_NegativeConfirmation: category=ARRAY, array-size=1, resulting-properties={base-type=boolean, sw-calibration-access=READ-ONLY, compu {0=FALSE, 1..255=TRUE}, range raw 0..1}, symbol=LinSM_NegativeConfirmation.raw
        LinSM_NegativeConfirmation_CHNL_45618847: category=ARRAY, array-size=1, resulting-properties={base-type=boolean, sw-calibration-access=READ-ONLY, compu {0=FALSE, 1..255=TRUE}, range raw 0..1}, symbol=LinSM_NegativeConfirmation.raw[0]  # The element: CHNL_45618847 of LinSM_NegativeConfirmation
        LinSM_RequestedComMode: category=ARRAY, array-size=1, resulting-properties={base-type=uint8, sw-calibration-access=READ-ONLY, range raw 0..255}, symbol=LinSM_RequestedComMode.raw
        LinSM_RequestedComMode_CHNL_45618847: category=ARRAY, array-size=1, resulting-properties={base-type=uint8, sw-calibration-access=READ-ONLY, range raw 0..255}, symbol=LinSM_RequestedComMode.raw[0]  # The element: CHNL_45618847 of LinSM_RequestedComMode
        LinSM_SilenceAfterWakeupTimer: category=ARRAY, array-size=1, resulting-properties={base-type=uint8, sw-calibration-access=READ-ONLY, range raw 0..255}, symbol=LinSM_SilenceAfterWakeupTimer.raw
        LinSM_SilenceAfterWakeupTimer_CHNL_45618847: category=ARRAY, array-size=1, resulting-properties={base-type=uint8, sw-calibration-access=READ-ONLY, range raw 0..255}, symbol=LinSM_SilenceAfterWakeupTimer.raw[0]  # The element: CHNL_45618847 of LinSM_SilenceAfterWakeupTimer
        LinSM_WakeUpRetryCounter: category=ARRAY, array-size=1, resulting-properties={base-type=uint8, sw-calibration-access=READ-ONLY, range raw 0..255}, symbol=LinSM_WakeUpRetryCounter.raw
        LinSM_WakeUpRetryCounter_CHNL_45618847: category=ARRAY, array-size=1, resulting-properties={base-type=uint8, sw-calibration-access=READ-ONLY, range raw 0..255}, symbol=LinSM_WakeUpRetryCounter.raw[0]  # The element: CHNL_45618847 of LinSM_WakeUpRetryCounter
        LinSM_Initialized: category=VALUE, resulting-properties={base-type=boolean, sw-calibration-access=READ-ONLY, compu {0=FALSE, 1..255=TRUE}, range raw 0..1}
