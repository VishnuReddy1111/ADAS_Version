[part 1 of 2: package /COM/VECTOR/CFG/WORKFLOW/SYSDESC/SYNC]
AUTOSAR XML (schema 00048)
package /COM/VECTOR/CFG/WORKFLOW/SYSDESC/SYNC
  flat map FLATMAP
    1722 x flat instance descriptor:
      ServiceControl: upstream-reference=Geltungsbereich_E3_1_2_Premium.ServiceControl, ecu-extract-reference=COMPOSITIONTYPE.ServiceControl
      Dcm_DcmCommunicationControl_ComMConf_ComMChannel_CN_CAN_fe6ecc87_DcmCommunicationControl_ComMConf_ComMChannel_CN_CAN_fe6ecc87: ecu-extract-reference=COMPOSITIONTYPE.Dcm.DcmCommunicationControl_ComMConf_ComMChannel_CN_CAN_fe6ecc87.DcmCommunicationControl_ComMConf_ComMChannel_CN_CAN_fe6ecc87
      Dcm_DcmCommunicationControl_ComMConf_ComMChannel_MyECU_EEI_U_ee15deea_DcmCommunicationControl_ComMConf_ComMChannel_MyECU_EEI_U_e: ecu-extract-reference=COMPOSITIONTYPE.Dcm.DcmCommunicationControl_ComMConf_ComMChannel_MyECU_EEI_U_ee15deea.DcmCommunicationControl_ComMConf_ComMChannel_MyECU_EEI_U_ee15deea
      Dcm_DcmControlDtcSetting_DcmControlDtcSetting: ecu-extract-reference=COMPOSITIONTYPE.Dcm.DcmControlDtcSetting.DcmControlDtcSetting
      Dcm_DcmDiagnosticSessionControl_DcmDiagnosticSessionControl: ecu-extract-reference=COMPOSITIONTYPE.Dcm.DcmDiagnosticSessionControl.DcmDiagnosticSessionControl
      Dcm_DcmEcuReset_DcmEcuReset: ecu-extract-reference=COMPOSITIONTYPE.Dcm.DcmEcuReset.DcmEcuReset
      ServiceControl_Switch_SDC_Mode_C_CSI_Basics_0bfbbc03_BswM_MDGP_SDC_SdClientServiceState: ecu-extract-reference=COMPOSITIONTYPE.ServiceControl.Switch_SDC_Mode_C_CSI_Basics_0bfbbc03.BswM_MDGP_SDC_SdClientServiceState
      ServiceControl_Switch_SDC_Mode_C_CSI_Basics_0bfbbc03_CEG_CEG_Basics_72dd3cbe_BswM_MDGP_SDC_SdConsumedEventGroupState: ecu-extract-reference=COMPOSITIONTYPE.ServiceControl.Switch_SDC_Mode_C_CSI_Basics_0bfbbc03_CEG_CEG_Basics_72dd3cbe.BswM_MDGP_SDC_SdConsumedEventGroupState
      ServiceControl_Switch_SDC_Mode_S_PSI_Maths_5547a58a_EH_EH_Maths_8810a8d8_BswM_MDGP_SDC_SdEventHandlerState: ecu-extract-reference=COMPOSITIONTYPE.ServiceControl.Switch_SDC_Mode_S_PSI_Maths_5547a58a_EH_EH_Maths_8810a8d8.BswM_MDGP_SDC_SdEventHandlerState
      StartApplication_XcpPimDownload: ecu-extract-reference=COMPOSITIONTYPE.StartApplication.XcpPimDownload
      StartApplication_XcpPimUpload: ecu-extract-reference=COMPOSITIONTYPE.StartApplication.XcpPimUpload
      BswM_OsApplication_SystemApplication_Core0_Notification_ESH_ModeNotification_BswM_MDGP_ESH_Mode: ecu-extract-reference=COMPOSITIONTYPE.BswM_OsApplication_SystemApplication_Core0.Notification_ESH_ModeNotification.BswM_MDGP_ESH_Mode
      BswM_OsApplication_SystemApplication_Core0_Switch_ESH_ModeSwitch_BswM_MDGP_ESH_Mode: ecu-extract-reference=COMPOSITIONTYPE.BswM_OsApplication_SystemApplication_Core0.Switch_ESH_ModeSwitch.BswM_MDGP_ESH_Mode
      BswM_OsApplication_SystemApplication_Core0_Switch_SDC_Mode_C_CSI_Basics_0bfbbc03_BswM_MDGP_SDC_SdClientServiceState: ecu-extract-reference=COMPOSITIONTYPE.BswM_OsApplication_SystemApplication_Core0.Switch_SDC_Mode_C_CSI_Basics_0bfbbc03.BswM_MDGP_SDC_SdClientServiceState
      BswM_OsApplication_SystemApplication_Core0_Switch_SDC_Mode_C_CSI_Basics_0bfbbc03_CEG_CEG_Basics_72dd3cbe_BswM_MDGP_SDC_SdConsume: ecu-extract-reference=COMPOSITIONTYPE.BswM_OsApplication_SystemApplication_Core0.Switch_SDC_Mode_C_CSI_Basics_0bfbbc03_CEG_CEG_Basics_72dd3cbe.BswM_MDGP_SDC_SdConsumedEventGroupState
      BswM_OsApplication_SystemApplication_Core0_Switch_SDC_Mode_S_PSI_Maths_5547a58a_EH_EH_Maths_8810a8d8_BswM_MDGP_SDC_SdEventHandle: ecu-extract-reference=COMPOSITIONTYPE.BswM_OsApplication_SystemApplication_Core0.Switch_SDC_Mode_S_PSI_Maths_5547a58a_EH_EH_Maths_8810a8d8.BswM_MDGP_SDC_SdEventHandlerState
      StartApplication_PpRxLargeData_DeLargeDataControlCommunication: ecu-extract-reference=COMPOSITIONTYPE.StartApplication.PpRxLargeData.DeLargeDataControlCommunication
      StartApplication_PpTxLargeData_DeLargeDataControlCommunication: ecu-extract-reference=COMPOSITIONTYPE.StartApplication.PpTxLargeData.DeLargeDataControlCommunication
      StartApplicationEth_PpRxLargeData_DeLargeDataControlCommunication: ecu-extract-reference=COMPOSITIONTYPE.StartApplicationEth.PpRxLargeData.DeLargeDataControlCommunication
      StartApplicationEth_PpTxLargeData_DeLargeDataControlCommunication: ecu-extract-reference=COMPOSITIONTYPE.StartApplicationEth.PpTxLargeData.DeLargeDataControlCommunication
      StartApplicationEth_PpRxEthernetCommunication_DeEthernetCommunication: ecu-extract-reference=COMPOSITIONTYPE.StartApplicationEth.PpRxEthernetCommunication.DeEthernetCommunication
      StartApplicationEth_PpTxEthernetCommunication_DeEthernetCommunication: ecu-extract-reference=COMPOSITIONTYPE.StartApplicationEth.PpTxEthernetCommunication.DeEthernetCommunication
      StartApplication_PpRxEthernetCommunication_DeEthernetCommunication: ecu-extract-reference=COMPOSITIONTYPE.StartApplication.PpRxEthernetCommunication.DeEthernetCommunication
      StartApplication_PpTxEthernetCommunication_DeEthernetCommunication: ecu-extract-reference=COMPOSITIONTYPE.StartApplication.PpTxEthernetCommunication.DeEthernetCommunication
      Signal_MyECU_SecOC_Tx1: upstream-reference=Geltungsbereich_E3_1_2_Premium.Signal_MyECU_SecOC_Tx1, ecu-extract-reference=COMPOSITIONTYPE.Signal_MyECU_SecOC_Tx1
      Signal_MyECU_SecOC_Tx2: upstream-reference=Geltungsbereich_E3_1_2_Premium.Signal_MyECU_SecOC_Tx2, ecu-extract-reference=COMPOSITIONTYPE.Signal_MyECU_SecOC_Tx2
      RT_VehComm: upstream-reference=Geltungsbereich_E3_1_2_Premium.RT_VehComm, ecu-extract-reference=COMPOSITIONTYPE.RT_VehComm
      Signal_MyECU_SecOC_Rx2: upstream-reference=Geltungsbereich_E3_1_2_Premium.Signal_MyECU_SecOC_Rx2, ecu-extract-reference=COMPOSITIONTYPE.Signal_MyECU_SecOC_Rx2
      Signal_MyECU_SecOC_Rx2_1: upstream-reference=Geltungsbereich_E3_1_2_Premium.Signal_MyECU_SecOC_Rx2_1, ecu-extract-reference=COMPOSITIONTYPE.Signal_MyECU_SecOC_Rx2_1
      SP_IF_Anzeige_SOC_XIX_BMC_HV: upstream-reference=Geltungsbereich_E3_1_2_Premium.SP_IF_Anzeige_SOC_XIX_BMC_HV, ecu-extract-reference=COMPOSITIONTYPE.SP_IF_Anzeige_SOC_XIX_BMC_HV
      BMC_Abschaltankuendigung: upstream-reference=Geltungsbereich_E3_1_2_Premium.SP_IF_BMC_Abschaltankuendigung_XIX_BMC_HV.DE_BMC_Abschaltankuendigung, ecu-extract-reference=COMPOSITIONTYPE.SP_IF_BMC_Abschaltankuendigung_XIX_BMC_HV.DE_BMC_Abschaltankuendigung
      SP_IF_BMC_Abschaltankuendigung_XIX_BMC_HV: upstream-reference=Geltungsbereich_E3_1_2_Premium.SP_IF_BMC_Abschaltankuendigung_XIX_BMC_HV, ecu-extract-reference=COMPOSITIONTYPE.SP_IF_BMC_Abschaltankuendigung_XIX_BMC_HV
      SP_IF_BMC_AC_Laden_XIX_BMC_HV: upstream-reference=Geltungsbereich_E3_1_2_Premium.SP_IF_BMC_AC_Laden_XIX_BMC_HV, ecu-extract-reference=COMPOSITIONTYPE.SP_IF_BMC_AC_Laden_XIX_BMC_HV
      SP_IF_BMC_Bank_Notlauf_erlaubt_XIX_BMC_HV: upstream-reference=Geltungsbereich_E3_1_2_Premium.SP_IF_BMC_Bank_Notlauf_erlaubt_XIX_BMC_HV, ecu-extract-reference=COMPOSITIONTYPE.SP_IF_BMC_Bank_Notlauf_erlaubt_XIX_BMC_HV
      SP_IF_BMC_Bank_parallel_erlaubt_XIX_BMC_HV: upstream-reference=Geltungsbereich_E3_1_2_Premium.SP_IF_BMC_Bank_parallel_erlaubt_XIX_BMC_HV, ecu-extract-reference=COMPOSITIONTYPE.SP_IF_BMC_Bank_parallel_erlaubt_XIX_BMC_HV
      SP_IF_BMC_Bank_seriell_erlaubt_XIX_BMC_HV: upstream-reference=Geltungsbereich_E3_1_2_Premium.SP_IF_BMC_Bank_seriell_erlaubt_XIX_BMC_HV, ecu-extract-reference=COMPOSITIONTYPE.SP_IF_BMC_Bank_seriell_erlaubt_XIX_BMC_HV
      SP_IF_BMC_Bankstatus_XIX_BMC_HV: upstream-reference=Geltungsbereich_E3_1_2_Premium.SP_IF_BMC_Bankstatus_XIX_BMC_HV, ecu-extract-reference=COMPOSITIONTYPE.SP_IF_BMC_Bankstatus_XIX_BMC_HV
      BMC_Bidi_Energie_Absolut: upstream-reference=Geltungsbereich_E3_1_2_Premium.SP_IF_BMC_Bidi_Energie_Absolut_XIX_BMC_HV.DE_BMC_Bidi_Energie_Absolut, ecu-extract-reference=COMPOSITIONTYPE.SP_IF_BMC_Bidi_Energie_Absolut_XIX_BMC_HV.DE_BMC_Bidi_Energie_Absolut
      SP_IF_BMC_Bidi_Energie_Absolut_XIX_BMC_HV: upstream-reference=Geltungsbereich_E3_1_2_Premium.SP_IF_BMC_Bidi_Energie_Absolut_XIX_BMC_HV, ecu-extract-reference=COMPOSITIONTYPE.SP_IF_BMC_Bidi_Energie_Absolut_XIX_BMC_HV
      SP_IF_BMC_Bidi_Freigabe_XIX_BMC_HV: upstream-reference=Geltungsbereich_E3_1_2_Premium.SP_IF_BMC_Bidi_Freigabe_XIX_BMC_HV, ecu-extract-reference=COMPOSITIONTYPE.SP_IF_BMC_Bidi_Freigabe_XIX_BMC_HV
      BMC_Bidi_GenutzteEnergie: upstream-reference=Geltungsbereich_E3_1_2_Premium.SP_IF_BMC_Bidi_GenutzteEnergie_XIX_BMC_HV.DE_BMC_Bidi_GenutzteEnergie, ecu-extract-reference=COMPOSITIONTYPE.SP_IF_BMC_Bidi_GenutzteEnergie_XIX_BMC_HV.DE_BMC_Bidi_GenutzteEnergie
      SP_IF_BMC_Bidi_GenutzteEnergie_XIX_BMC_HV: upstream-reference=Geltungsbereich_E3_1_2_Premium.SP_IF_BMC_Bidi_GenutzteEnergie_XIX_BMC_HV, ecu-extract-reference=COMPOSITIONTYPE.SP_IF_BMC_Bidi_GenutzteEnergie_XIX_BMC_HV
      BMC_Bidi_Max_SoC: upstream-reference=Geltungsbereich_E3_1_2_Premium.SP_IF_BMC_Bidi_Max_SoC_XIX_BMC_HV.DE_BMC_Bidi_Max_SoC, ecu-extract-reference=COMPOSITIONTYPE.SP_IF_BMC_Bidi_Max_SoC_XIX_BMC_HV.DE_BMC_Bidi_Max_SoC
      SP_IF_BMC_Bidi_Max_SoC_XIX_BMC_HV: upstream-reference=Geltungsbereich_E3_1_2_Premium.SP_IF_BMC_Bidi_Max_SoC_XIX_BMC_HV, ecu-extract-reference=COMPOSITIONTYPE.SP_IF_BMC_Bidi_Max_SoC_XIX_BMC_HV
      BMC_Bidi_Min_SoC: upstream-reference=Geltungsbereich_E3_1_2_Premium.SP_IF_BMC_Bidi_Min_SoC_XIX_BMC_HV.DE_BMC_Bidi_Min_SoC, ecu-extract-reference=COMPOSITIONTYPE.SP_IF_BMC_Bidi_Min_SoC_XIX_BMC_HV.DE_BMC_Bidi_Min_SoC
      SP_IF_BMC_Bidi_Min_SoC_XIX_BMC_HV: upstream-reference=Geltungsbereich_E3_1_2_Premium.SP_IF_BMC_Bidi_Min_SoC_XIX_BMC_HV, ecu-extract-reference=COMPOSITIONTYPE.SP_IF_BMC_Bidi_Min_SoC_XIX_BMC_HV
      SP_IF_BMC_Bidi_Veto_Energie_XIX_BMC_HV: upstream-reference=Geltungsbereich_E3_1_2_Premium.SP_IF_BMC_Bidi_Veto_Energie_XIX_BMC_HV, ecu-extract-reference=COMPOSITIONTYPE.SP_IF_BMC_Bidi_Veto_Energie_XIX_BMC_HV
      SP_IF_BMC_Bidi_Veto_Temp_XIX_BMC_HV: upstream-reference=Geltungsbereich_E3_1_2_Premium.SP_IF_BMC_Bidi_Veto_Temp_XIX_BMC_HV, ecu-extract-reference=COMPOSITIONTYPE.SP_IF_BMC_Bidi_Veto_Temp_XIX_BMC_HV
      BMC_CMC_Temperatur_001: upstream-reference=Geltungsbereich_E3_1_2_Premium.SP_IF_BMC_CMC_Temperatur_001_XIX_BMC_HV.DE_BMC_CMC_Temperatur_001, ecu-extract-reference=COMPOSITIONTYPE.SP_IF_BMC_CMC_Temperatur_001_XIX_BMC_HV.DE_BMC_CMC_Temperatur_001
      SP_IF_BMC_CMC_Temperatur_001_XIX_BMC_HV: upstream-reference=Geltungsbereich_E3_1_2_Premium.SP_IF_BMC_CMC_Temperatur_001_XIX_BMC_HV, ecu-extract-reference=COMPOSITIONTYPE.SP_IF_BMC_CMC_Temperatur_001_XIX_BMC_HV
      BMC_CMC_Temperatur_002: upstream-reference=Geltungsbereich_E3_1_2_Premium.SP_IF_BMC_CMC_Temperatur_002_XIX_BMC_HV.DE_BMC_CMC_Temperatur_002, ecu-extract-reference=COMPOSITIONTYPE.SP_IF_BMC_CMC_Temperatur_002_XIX_BMC_HV.DE_BMC_CMC_Temperatur_002
      SP_IF_BMC_CMC_Temperatur_002_XIX_BMC_HV: upstream-reference=Geltungsbereich_E3_1_2_Premium.SP_IF_BMC_CMC_Temperatur_002_XIX_BMC_HV, ecu-extract-reference=COMPOSITIONTYPE.SP_IF_BMC_CMC_Temperatur_002_XIX_BMC_HV
      BMC_CMC_Temperatur_003: upstream-reference=Geltungsbereich_E3_1_2_Premium.SP_IF_BMC_CMC_Temperatur_003_XIX_BMC_HV.DE_BMC_CMC_Temperatur_003, ecu-extract-reference=COMPOSITIONTYPE.SP_IF_BMC_CMC_Temperatur_003_XIX_BMC_HV.DE_BMC_CMC_Temperatur_003
      SP_IF_BMC_CMC_Temperatur_003_XIX_BMC_HV: upstream-reference=Geltungsbereich_E3_1_2_Premium.SP_IF_BMC_CMC_Temperatur_003_XIX_BMC_HV, ecu-extract-reference=COMPOSITIONTYPE.SP_IF_BMC_CMC_Temperatur_003_XIX_BMC_HV
      BMC_CMC_Temperatur_004: upstream-reference=Geltungsbereich_E3_1_2_Premium.SP_IF_BMC_CMC_Temperatur_004_XIX_BMC_HV.DE_BMC_CMC_Temperatur_004, ecu-extract-reference=COMPOSITIONTYPE.SP_IF_BMC_CMC_Temperatur_004_XIX_BMC_HV.DE_BMC_CMC_Temperatur_004
      SP_IF_BMC_CMC_Temperatur_004_XIX_BMC_HV: upstream-reference=Geltungsbereich_E3_1_2_Premium.SP_IF_BMC_CMC_Temperatur_004_XIX_BMC_HV, ecu-extract-reference=COMPOSITIONTYPE.SP_IF_BMC_CMC_Temperatur_004_XIX_BMC_HV
      BMC_CMC_Temperatur_005: upstream-reference=Geltungsbereich_E3_1_2_Premium.SP_IF_BMC_CMC_Temperatur_005_XIX_BMC_HV.DE_BMC_CMC_Temperatur_005, ecu-extract-reference=COMPOSITIONTYPE.SP_IF_BMC_CMC_Temperatur_005_XIX_BMC_HV.DE_BMC_CMC_Temperatur_005
      SP_IF_BMC_CMC_Temperatur_005_XIX_BMC_HV: upstream-reference=Geltungsbereich_E3_1_2_Premium.SP_IF_BMC_CMC_Temperatur_005_XIX_BMC_HV, ecu-extract-reference=COMPOSITIONTYPE.SP_IF_BMC_CMC_Temperatur_005_XIX_BMC_HV
      BMC_CMC_Temperatur_006: upstream-reference=Geltungsbereich_E3_1_2_Premium.SP_IF_BMC_CMC_Temperatur_006_XIX_BMC_HV.DE_BMC_CMC_Temperatur_006, ecu-extract-reference=COMPOSITIONTYPE.SP_IF_BMC_CMC_Temperatur_006_XIX_BMC_HV.DE_BMC_CMC_Temperatur_006
      SP_IF_BMC_CMC_Temperatur_006_XIX_BMC_HV: upstream-reference=Geltungsbereich_E3_1_2_Premium.SP_IF_BMC_CMC_Temperatur_006_XIX_BMC_HV, ecu-extract-reference=COMPOSITIONTYPE.SP_IF_BMC_CMC_Temperatur_006_XIX_BMC_HV
      BMC_CMC_Temperatur_007: upstream-reference=Geltungsbereich_E3_1_2_Premium.SP_IF_BMC_CMC_Temperatur_007_XIX_BMC_HV.DE_BMC_CMC_Temperatur_007, ecu-extract-reference=COMPOSITIONTYPE.SP_IF_BMC_CMC_Temperatur_007_XIX_BMC_HV.DE_BMC_CMC_Temperatur_007
      SP_IF_BMC_CMC_Temperatur_007_XIX_BMC_HV: upstream-reference=Geltungsbereich_E3_1_2_Premium.SP_IF_BMC_CMC_Temperatur_007_XIX_BMC_HV, ecu-extract-reference=COMPOSITIONTYPE.SP_IF_BMC_CMC_Temperatur_007_XIX_BMC_HV
      BMC_CMC_Temperatur_008: upstream-reference=Geltungsbereich_E3_1_2_Premium.SP_IF_BMC_CMC_Temperatur_008_XIX_BMC_HV.DE_BMC_CMC_Temperatur_008, ecu-extract-reference=COMPOSITIONTYPE.SP_IF_BMC_CMC_Temperatur_008_XIX_BMC_HV.DE_BMC_CMC_Temperatur_008
      SP_IF_BMC_CMC_Temperatur_008_XIX_BMC_HV: upstream-reference=Geltungsbereich_E3_1_2_Premium.SP_IF_BMC_CMC_Temperatur_008_XIX_BMC_HV, ecu-extract-reference=COMPOSITIONTYPE.SP_IF_BMC_CMC_Temperatur_008_XIX_BMC_HV
      BMC_CMC_Temperatur_009: upstream-reference=Geltungsbereich_E3_1_2_Premium.SP_IF_BMC_CMC_Temperatur_009_XIX_BMC_HV.DE_BMC_CMC_Temperatur_009, ecu-extract-reference=COMPOSITIONTYPE.SP_IF_BMC_CMC_Temperatur_009_XIX_BMC_HV.DE_BMC_CMC_Temperatur_009
      SP_IF_BMC_CMC_Temperatur_009_XIX_BMC_HV: upstream-reference=Geltungsbereich_E3_1_2_Premium.SP_IF_BMC_CMC_Temperatur_009_XIX_BMC_HV, ecu-extract-reference=COMPOSITIONTYPE.SP_IF_BMC_CMC_Temperatur_009_XIX_BMC_HV
      BMC_CMC_Temperatur_010: upstream-reference=Geltungsbereich_E3_1_2_Premium.SP_IF_BMC_CMC_Temperatur_010_XIX_BMC_HV.DE_BMC_CMC_Temperatur_010, ecu-extract-reference=COMPOSITIONTYPE.SP_IF_BMC_CMC_Temperatur_010_XIX_BMC_HV.DE_BMC_CMC_Temperatur_010
      SP_IF_BMC_CMC_Temperatur_010_XIX_BMC_HV: upstream-reference=Geltungsbereich_E3_1_2_Premium.SP_IF_BMC_CMC_Temperatur_010_XIX_BMC_HV, ecu-extract-reference=COMPOSITIONTYPE.SP_IF_BMC_CMC_Temperatur_010_XIX_BMC_HV
      BMC_CMC_Temperatur_011: upstream-reference=Geltungsbereich_E3_1_2_Premium.SP_IF_BMC_CMC_Temperatur_011_XIX_BMC_HV.DE_BMC_CMC_Temperatur_011, ecu-extract-reference=COMPOSITIONTYPE.SP_IF_BMC_CMC_Temperatur_011_XIX_BMC_HV.DE_BMC_CMC_Temperatur_011
      SP_IF_BMC_CMC_Temperatur_011_XIX_BMC_HV: upstream-reference=Geltungsbereich_E3_1_2_Premium.SP_IF_BMC_CMC_Temperatur_011_XIX_BMC_HV, ecu-extract-reference=COMPOSITIONTYPE.SP_IF_BMC_CMC_Temperatur_011_XIX_BMC_HV
      BMC_CMC_Temperatur_012: upstream-reference=Geltungsbereich_E3_1_2_Premium.SP_IF_BMC_CMC_Temperatur_012_XIX_BMC_HV.DE_BMC_CMC_Temperatur_012, ecu-extract-reference=COMPOSITIONTYPE.SP_IF_BMC_CMC_Temperatur_012_XIX_BMC_HV.DE_BMC_CMC_Temperatur_012
      SP_IF_BMC_CMC_Temperatur_012_XIX_BMC_HV: upstream-reference=Geltungsbereich_E3_1_2_Premium.SP_IF_BMC_CMC_Temperatur_012_XIX_BMC_HV, ecu-extract-reference=COMPOSITIONTYPE.SP_IF_BMC_CMC_Temperatur_012_XIX_BMC_HV
      BMC_CMC_Temperatur_013: upstream-reference=Geltungsbereich_E3_1_2_Premium.SP_IF_BMC_CMC_Temperatur_013_XIX_BMC_HV.DE_BMC_CMC_Temperatur_013, ecu-extract-reference=COMPOSITIONTYPE.SP_IF_BMC_CMC_Temperatur_013_XIX_BMC_HV.DE_BMC_CMC_Temperatur_013
      SP_IF_BMC_CMC_Temperatur_013_XIX_BMC_HV: upstream-reference=Geltungsbereich_E3_1_2_Premium.SP_IF_BMC_CMC_Temperatur_013_XIX_BMC_HV, ecu-extract-reference=COMPOSITIONTYPE.SP_IF_BMC_CMC_Temperatur_013_XIX_BMC_HV
      BMC_CMC_Temperatur_014: upstream-reference=Geltungsbereich_E3_1_2_Premium.SP_IF_BMC_CMC_Temperatur_014_XIX_BMC_HV.DE_BMC_CMC_Temperatur_014, ecu-extract-reference=COMPOSITIONTYPE.SP_IF_BMC_CMC_Temperatur_014_XIX_BMC_HV.DE_BMC_CMC_Temperatur_014
      SP_IF_BMC_CMC_Temperatur_014_XIX_BMC_HV: upstream-reference=Geltungsbereich_E3_1_2_Premium.SP_IF_BMC_CMC_Temperatur_014_XIX_BMC_HV, ecu-extract-reference=COMPOSITIONTYPE.SP_IF_BMC_CMC_Temperatur_014_XIX_BMC_HV
      BMC_CMC_Temperatur_015: upstream-reference=Geltungsbereich_E3_1_2_Premium.SP_IF_BMC_CMC_Temperatur_015_XIX_BMC_HV.DE_BMC_CMC_Temperatur_015, ecu-extract-reference=COMPOSITIONTYPE.SP_IF_BMC_CMC_Temperatur_015_XIX_BMC_HV.DE_BMC_CMC_Temperatur_015
      SP_IF_BMC_CMC_Temperatur_015_XIX_BMC_HV: upstream-reference=Geltungsbereich_E3_1_2_Premium.SP_IF_BMC_CMC_Temperatur_015_XIX_BMC_HV, ecu-extract-reference=COMPOSITIONTYPE.SP_IF_BMC_CMC_Temperatur_015_XIX_BMC_HV
      BMC_CMC_Temperatur_016: upstream-reference=Geltungsbereich_E3_1_2_Premium.SP_IF_BMC_CMC_Temperatur_016_XIX_BMC_HV.DE_BMC_CMC_Temperatur_016, ecu-extract-reference=COMPOSITIONTYPE.SP_IF_BMC_CMC_Temperatur_016_XIX_BMC_HV.DE_BMC_CMC_Temperatur_016
      SP_IF_BMC_CMC_Temperatur_016_XIX_BMC_HV: upstream-reference=Geltungsbereich_E3_1_2_Premium.SP_IF_BMC_CMC_Temperatur_016_XIX_BMC_HV, ecu-extract-reference=COMPOSITIONTYPE.SP_IF_BMC_CMC_Temperatur_016_XIX_BMC_HV
      BMC_CMC_Temperatur_017: upstream-reference=Geltungsbereich_E3_1_2_Premium.SP_IF_BMC_CMC_Temperatur_017_XIX_BMC_HV.DE_BMC_CMC_Temperatur_017, ecu-extract-reference=COMPOSITIONTYPE.SP_IF_BMC_CMC_Temperatur_017_XIX_BMC_HV.DE_BMC_CMC_Temperatur_017
      SP_IF_BMC_CMC_Temperatur_017_XIX_BMC_HV: upstream-reference=Geltungsbereich_E3_1_2_Premium.SP_IF_BMC_CMC_Temperatur_017_XIX_BMC_HV, ecu-extract-reference=COMPOSITIONTYPE.SP_IF_BMC_CMC_Temperatur_017_XIX_BMC_HV
      BMC_CMC_Temperatur_018: upstream-reference=Geltungsbereich_E3_1_2_Premium.SP_IF_BMC_CMC_Temperatur_018_XIX_BMC_HV.DE_BMC_CMC_Temperatur_018, ecu-extract-reference=COMPOSITIONTYPE.SP_IF_BMC_CMC_Temperatur_018_XIX_BMC_HV.DE_BMC_CMC_Temperatur_018
      SP_IF_BMC_CMC_Temperatur_018_XIX_BMC_HV: upstream-reference=Geltungsbereich_E3_1_2_Premium.SP_IF_BMC_CMC_Temperatur_018_XIX_BMC_HV, ecu-extract-reference=COMPOSITIONTYPE.SP_IF_BMC_CMC_Temperatur_018_XIX_BMC_HV
      BMC_CMC_Temperatur_019: upstream-reference=Geltungsbereich_E3_1_2_Premium.SP_IF_BMC_CMC_Temperatur_019_XIX_BMC_HV.DE_BMC_CMC_Temperatur_019, ecu-extract-reference=COMPOSITIONTYPE.SP_IF_BMC_CMC_Temperatur_019_XIX_BMC_HV.DE_BMC_CMC_Temperatur_019
      SP_IF_BMC_CMC_Temperatur_019_XIX_BMC_HV: upstream-reference=Geltungsbereich_E3_1_2_Premium.SP_IF_BMC_CMC_Temperatur_019_XIX_BMC_HV, ecu-extract-reference=COMPOSITIONTYPE.SP_IF_BMC_CMC_Temperatur_019_XIX_BMC_HV
      BMC_CMC_Temperatur_01_Messzeit: upstream-reference=Geltungsbereich_E3_1_2_Premium.SP_IF_BMC_CMC_Temperatur_01_Messzeit_XIX_BMC_HV.DE_BMC_CMC_Temperatur_01_Messzeit, ecu-extract-reference=COMPOSITIONTYPE.SP_IF_BMC_CMC_Temperatur_01_Messzeit_XIX_BMC_HV.DE_BMC_CMC_Temperatur_01_Messzeit
      SP_IF_BMC_CMC_Temperatur_01_Messzeit_XIX_BMC_HV: upstream-reference=Geltungsbereich_E3_1_2_Premium.SP_IF_BMC_CMC_Temperatur_01_Messzeit_XIX_BMC_HV, ecu-extract-reference=COMPOSITIONTYPE.SP_IF_BMC_CMC_Temperatur_01_Messzeit_XIX_BMC_HV
      BMC_CMC_Temperatur_020: upstream-reference=Geltungsbereich_E3_1_2_Premium.SP_IF_BMC_CMC_Temperatur_020_XIX_BMC_HV.DE_BMC_CMC_Temperatur_020, ecu-extract-reference=COMPOSITIONTYPE.SP_IF_BMC_CMC_Temperatur_020_XIX_BMC_HV.DE_BMC_CMC_Temperatur_020
      SP_IF_BMC_CMC_Temperatur_020_XIX_BMC_HV: upstream-reference=Geltungsbereich_E3_1_2_Premium.SP_IF_BMC_CMC_Temperatur_020_XIX_BMC_HV, ecu-extract-reference=COMPOSITIONTYPE.SP_IF_BMC_CMC_Temperatur_020_XIX_BMC_HV
      BMC_CMC_Temperatur_021: upstream-reference=Geltungsbereich_E3_1_2_Premium.SP_IF_BMC_CMC_Temperatur_021_XIX_BMC_HV.DE_BMC_CMC_Temperatur_021, ecu-extract-reference=COMPOSITIONTYPE.SP_IF_BMC_CMC_Temperatur_021_XIX_BMC_HV.DE_BMC_CMC_Temperatur_021
      SP_IF_BMC_CMC_Temperatur_021_XIX_BMC_HV: upstream-reference=Geltungsbereich_E3_1_2_Premium.SP_IF_BMC_CMC_Temperatur_021_XIX_BMC_HV, ecu-extract-reference=COMPOSITIONTYPE.SP_IF_BMC_CMC_Temperatur_021_XIX_BMC_HV
      BMC_CMC_Temperatur_022: upstream-reference=Geltungsbereich_E3_1_2_Premium.SP_IF_BMC_CMC_Temperatur_022_XIX_BMC_HV.DE_BMC_CMC_Temperatur_022, ecu-extract-reference=COMPOSITIONTYPE.SP_IF_BMC_CMC_Temperatur_022_XIX_BMC_HV.DE_BMC_CMC_Temperatur_022
      SP_IF_BMC_CMC_Temperatur_022_XIX_BMC_HV: upstream-reference=Geltungsbereich_E3_1_2_Premium.SP_IF_BMC_CMC_Temperatur_022_XIX_BMC_HV, ecu-extract-reference=COMPOSITIONTYPE.SP_IF_BMC_CMC_Temperatur_022_XIX_BMC_HV
      BMC_CMC_Temperatur_023: upstream-reference=Geltungsbereich_E3_1_2_Premium.SP_IF_BMC_CMC_Temperatur_023_XIX_BMC_HV.DE_BMC_CMC_Temperatur_023, ecu-extract-reference=COMPOSITIONTYPE.SP_IF_BMC_CMC_Temperatur_023_XIX_BMC_HV.DE_BMC_CMC_Temperatur_023
      SP_IF_BMC_CMC_Temperatur_023_XIX_BMC_HV: upstream-reference=Geltungsbereich_E3_1_2_Premium.SP_IF_BMC_CMC_Temperatur_023_XIX_BMC_HV, ecu-extract-reference=COMPOSITIONTYPE.SP_IF_BMC_CMC_Temperatur_023_XIX_BMC_HV
      BMC_CMC_Temperatur_024: upstream-reference=Geltungsbereich_E3_1_2_Premium.SP_IF_BMC_CMC_Temperatur_024_XIX_BMC_HV.DE_BMC_CMC_Temperatur_024, ecu-extract-reference=COMPOSITIONTYPE.SP_IF_BMC_CMC_Temperatur_024_XIX_BMC_HV.DE_BMC_CMC_Temperatur_024
      SP_IF_BMC_CMC_Temperatur_024_XIX_BMC_HV: upstream-reference=Geltungsbereich_E3_1_2_Premium.SP_IF_BMC_CMC_Temperatur_024_XIX_BMC_HV, ecu-extract-reference=COMPOSITIONTYPE.SP_IF_BMC_CMC_Temperatur_024_XIX_BMC_HV
      BMC_CMC_Temperatur_025: upstream-reference=Geltungsbereich_E3_1_2_Premium.SP_IF_BMC_CMC_Temperatur_025_XIX_BMC_HV.DE_BMC_CMC_Temperatur_025, ecu-extract-reference=COMPOSITIONTYPE.SP_IF_BMC_CMC_Temperatur_025_XIX_BMC_HV.DE_BMC_CMC_Temperatur_025
      SP_IF_BMC_CMC_Temperatur_025_XIX_BMC_HV: upstream-reference=Geltungsbereich_E3_1_2_Premium.SP_IF_BMC_CMC_Temperatur_025_XIX_BMC_HV, ecu-extract-reference=COMPOSITIONTYPE.SP_IF_BMC_CMC_Temperatur_025_XIX_BMC_HV
      BMC_CMC_Temperatur_026: upstream-reference=Geltungsbereich_E3_1_2_Premium.SP_IF_BMC_CMC_Temperatur_026_XIX_BMC_HV.DE_BMC_CMC_Temperatur_026, ecu-extract-reference=COMPOSITIONTYPE.SP_IF_BMC_CMC_Temperatur_026_XIX_BMC_HV.DE_BMC_CMC_Temperatur_026
      SP_IF_BMC_CMC_Temperatur_026_XIX_BMC_HV: upstream-reference=Geltungsbereich_E3_1_2_Premium.SP_IF_BMC_CMC_Temperatur_026_XIX_BMC_HV, ecu-extract-reference=COMPOSITIONTYPE.SP_IF_BMC_CMC_Temperatur_026_XIX_BMC_HV
      BMC_CMC_Temperatur_027: upstream-reference=Geltungsbereich_E3_1_2_Premium.SP_IF_BMC_CMC_Temperatur_027_XIX_BMC_HV.DE_BMC_CMC_Temperatur_027, ecu-extract-reference=COMPOSITIONTYPE.SP_IF_BMC_CMC_Temperatur_027_XIX_BMC_HV.DE_BMC_CMC_Temperatur_027
      SP_IF_BMC_CMC_Temperatur_027_XIX_BMC_HV: upstream-reference=Geltungsbereich_E3_1_2_Premium.SP_IF_BMC_CMC_Temperatur_027_XIX_BMC_HV, ecu-extract-reference=COMPOSITIONTYPE.SP_IF_BMC_CMC_Temperatur_027_XIX_BMC_HV
      BMC_CMC_Temperatur_028: upstream-reference=Geltungsbereich_E3_1_2_Premium.SP_IF_BMC_CMC_Temperatur_028_XIX_BMC_HV.DE_BMC_CMC_Temperatur_028, ecu-extract-reference=COMPOSITIONTYPE.SP_IF_BMC_CMC_Temperatur_028_XIX_BMC_HV.DE_BMC_CMC_Temperatur_028
      SP_IF_BMC_CMC_Temperatur_028_XIX_BMC_HV: upstream-reference=Geltungsbereich_E3_1_2_Premium.SP_IF_BMC_CMC_Temperatur_028_XIX_BMC_HV, ecu-extract-reference=COMPOSITIONTYPE.SP_IF_BMC_CMC_Temperatur_028_XIX_BMC_HV
      BMC_CMC_Temperatur_029: upstream-reference=Geltungsbereich_E3_1_2_Premium.SP_IF_BMC_CMC_Temperatur_029_XIX_BMC_HV.DE_BMC_CMC_Temperatur_029, ecu-extract-reference=COMPOSITIONTYPE.SP_IF_BMC_CMC_Temperatur_029_XIX_BMC_HV.DE_BMC_CMC_Temperatur_029
      SP_IF_BMC_CMC_Temperatur_029_XIX_BMC_HV: upstream-reference=Geltungsbereich_E3_1_2_Premium.SP_IF_BMC_CMC_Temperatur_029_XIX_BMC_HV, ecu-extract-reference=COMPOSITIONTYPE.SP_IF_BMC_CMC_Temperatur_029_XIX_BMC_HV
      BMC_CMC_Temperatur_02_Messzeit: upstream-reference=Geltungsbereich_E3_1_2_Premium.SP_IF_BMC_CMC_Temperatur_02_Messzeit_XIX_BMC_HV.DE_BMC_CMC_Temperatur_02_Messzeit, ecu-extract-reference=COMPOSITIONTYPE.SP_IF_BMC_CMC_Temperatur_02_Messzeit_XIX_BMC_HV.DE_BMC_CMC_Temperatur_02_Messzeit
      SP_IF_BMC_CMC_Temperatur_02_Messzeit_XIX_BMC_HV: upstream-reference=Geltungsbereich_E3_1_2_Premium.SP_IF_BMC_CMC_Temperatur_02_Messzeit_XIX_BMC_HV, ecu-extract-reference=COMPOSITIONTYPE.SP_IF_BMC_CMC_Temperatur_02_Messzeit_XIX_BMC_HV
      BMC_CMC_Temperatur_030: upstream-reference=Geltungsbereich_E3_1_2_Premium.SP_IF_BMC_CMC_Temperatur_030_XIX_BMC_HV.DE_BMC_CMC_Temperatur_030, ecu-extract-reference=COMPOSITIONTYPE.SP_IF_BMC_CMC_Temperatur_030_XIX_BMC_HV.DE_BMC_CMC_Temperatur_030
      SP_IF_BMC_CMC_Temperatur_030_XIX_BMC_HV: upstream-reference=Geltungsbereich_E3_1_2_Premium.SP_IF_BMC_CMC_Temperatur_030_XIX_BMC_HV, ecu-extract-reference=COMPOSITIONTYPE.SP_IF_BMC_CMC_Temperatur_030_XIX_BMC_HV
      BMC_CMC_Temperatur_031: upstream-reference=Geltungsbereich_E3_1_2_Premium.SP_IF_BMC_CMC_Temperatur_031_XIX_BMC_HV.DE_BMC_CMC_Temperatur_031, ecu-extract-reference=COMPOSITIONTYPE.SP_IF_BMC_CMC_Temperatur_031_XIX_BMC_HV.DE_BMC_CMC_Temperatur_031
      SP_IF_BMC_CMC_Temperatur_031_XIX_BMC_HV: upstream-reference=Geltungsbereich_E3_1_2_Premium.SP_IF_BMC_CMC_Temperatur_031_XIX_BMC_HV, ecu-extract-reference=COMPOSITIONTYPE.SP_IF_BMC_CMC_Temperatur_031_XIX_BMC_HV
      BMC_CMC_Temperatur_032: upstream-reference=Geltungsbereich_E3_1_2_Premium.SP_IF_BMC_CMC_Temperatur_032_XIX_BMC_HV.DE_BMC_CMC_Temperatur_032, ecu-extract-reference=COMPOSITIONTYPE.SP_IF_BMC_CMC_Temperatur_032_XIX_BMC_HV.DE_BMC_CMC_Temperatur_032
      SP_IF_BMC_CMC_Temperatur_032_XIX_BMC_HV: upstream-reference=Geltungsbereich_E3_1_2_Premium.SP_IF_BMC_CMC_Temperatur_032_XIX_BMC_HV, ecu-extract-reference=COMPOSITIONTYPE.SP_IF_BMC_CMC_Temperatur_032_XIX_BMC_HV
      BMC_CMC_Temperatur_033: upstream-reference=Geltungsbereich_E3_1_2_Premium.SP_IF_BMC_CMC_Temperatur_033_XIX_BMC_HV.DE_BMC_CMC_Temperatur_033, ecu-extract-reference=COMPOSITIONTYPE.SP_IF_BMC_CMC_Temperatur_033_XIX_BMC_HV.DE_BMC_CMC_Temperatur_033
      SP_IF_BMC_CMC_Temperatur_033_XIX_BMC_HV: upstream-reference=Geltungsbereich_E3_1_2_Premium.SP_IF_BMC_CMC_Temperatur_033_XIX_BMC_HV, ecu-extract-reference=COMPOSITIONTYPE.SP_IF_BMC_CMC_Temperatur_033_XIX_BMC_HV
      BMC_CMC_Temperatur_034: upstream-reference=Geltungsbereich_E3_1_2_Premium.SP_IF_BMC_CMC_Temperatur_034_XIX_BMC_HV.DE_BMC_CMC_Temperatur_034, ecu-extract-reference=COMPOSITIONTYPE.SP_IF_BMC_CMC_Temperatur_034_XIX_BMC_HV.DE_BMC_CMC_Temperatur_034
      SP_IF_BMC_CMC_Temperatur_034_XIX_BMC_HV: upstream-reference=Geltungsbereich_E3_1_2_Premium.SP_IF_BMC_CMC_Temperatur_034_XIX_BMC_HV, ecu-extract-reference=COMPOSITIONTYPE.SP_IF_BMC_CMC_Temperatur_034_XIX_BMC_HV
      BMC_CMC_Temperatur_035: upstream-reference=Geltungsbereich_E3_1_2_Premium.SP_IF_BMC_CMC_Temperatur_035_XIX_BMC_HV.DE_BMC_CMC_Temperatur_035, ecu-extract-reference=COMPOSITIONTYPE.SP_IF_BMC_CMC_Temperatur_035_XIX_BMC_HV.DE_BMC_CMC_Temperatur_035
      SP_IF_BMC_CMC_Temperatur_035_XIX_BMC_HV: upstream-reference=Geltungsbereich_E3_1_2_Premium.SP_IF_BMC_CMC_Temperatur_035_XIX_BMC_HV, ecu-extract-reference=COMPOSITIONTYPE.SP_IF_BMC_CMC_Temperatur_035_XIX_BMC_HV
      BMC_CMC_Temperatur_036: upstream-reference=Geltungsbereich_E3_1_2_Premium.SP_IF_BMC_CMC_Temperatur_036_XIX_BMC_HV.DE_BMC_CMC_Temperatur_036, ecu-extract-reference=COMPOSITIONTYPE.SP_IF_BMC_CMC_Temperatur_036_XIX_BMC_HV.DE_BMC_CMC_Temperatur_036
      SP_IF_BMC_CMC_Temperatur_036_XIX_BMC_HV: upstream-reference=Geltungsbereich_E3_1_2_Premium.SP_IF_BMC_CMC_Temperatur_036_XIX_BMC_HV, ecu-extract-reference=COMPOSITIONTYPE.SP_IF_BMC_CMC_Temperatur_036_XIX_BMC_HV
      BMC_CMC_Temperatur_037: upstream-reference=Geltungsbereich_E3_1_2_Premium.SP_IF_BMC_CMC_Temperatur_037_XIX_BMC_HV.DE_BMC_CMC_Temperatur_037, ecu-extract-reference=COMPOSITIONTYPE.SP_IF_BMC_CMC_Temperatur_037_XIX_BMC_HV.DE_BMC_CMC_Temperatur_037
      SP_IF_BMC_CMC_Temperatur_037_XIX_BMC_HV: upstream-reference=Geltungsbereich_E3_1_2_Premium.SP_IF_BMC_CMC_Temperatur_037_XIX_BMC_HV, ecu-extract-reference=COMPOSITIONTYPE.SP_IF_BMC_CMC_Temperatur_037_XIX_BMC_HV
      BMC_CMC_Temperatur_038: upstream-reference=Geltungsbereich_E3_1_2_Premium.SP_IF_BMC_CMC_Temperatur_038_XIX_BMC_HV.DE_BMC_CMC_Temperatur_038, ecu-extract-reference=COMPOSITIONTYPE.SP_IF_BMC_CMC_Temperatur_038_XIX_BMC_HV.DE_BMC_CMC_Temperatur_038
      SP_IF_BMC_CMC_Temperatur_038_XIX_BMC_HV: upstream-reference=Geltungsbereich_E3_1_2_Premium.SP_IF_BMC_CMC_Temperatur_038_XIX_BMC_HV, ecu-extract-reference=COMPOSITIONTYPE.SP_IF_BMC_CMC_Temperatur_038_XIX_BMC_HV
      BMC_CMC_Temperatur_039: upstream-reference=Geltungsbereich_E3_1_2_Premium.SP_IF_BMC_CMC_Temperatur_039_XIX_BMC_HV.DE_BMC_CMC_Temperatur_039, ecu-extract-reference=COMPOSITIONTYPE.SP_IF_BMC_CMC_Temperatur_039_XIX_BMC_HV.DE_BMC_CMC_Temperatur_039
      SP_IF_BMC_CMC_Temperatur_039_XIX_BMC_HV: upstream-reference=Geltungsbereich_E3_1_2_Premium.SP_IF_BMC_CMC_Temperatur_039_XIX_BMC_HV, ecu-extract-reference=COMPOSITIONTYPE.SP_IF_BMC_CMC_Temperatur_039_XIX_BMC_HV
      BMC_CMC_Temperatur_03_Messzeit: upstream-reference=Geltungsbereich_E3_1_2_Premium.SP_IF_BMC_CMC_Temperatur_03_Messzeit_XIX_BMC_HV.DE_BMC_CMC_Temperatur_03_Messzeit, ecu-extract-reference=COMPOSITIONTYPE.SP_IF_BMC_CMC_Temperatur_03_Messzeit_XIX_BMC_HV.DE_BMC_CMC_Temperatur_03_Messzeit
      SP_IF_BMC_CMC_Temperatur_03_Messzeit_XIX_BMC_HV: upstream-reference=Geltungsbereich_E3_1_2_Premium.SP_IF_BMC_CMC_Temperatur_03_Messzeit_XIX_BMC_HV, ecu-extract-reference=COMPOSITIONTYPE.SP_IF_BMC_CMC_Temperatur_03_Messzeit_XIX_BMC_HV
      BMC_CMC_Temperatur_040: upstream-reference=Geltungsbereich_E3_1_2_Premium.SP_IF_BMC_CMC_Temperatur_040_XIX_BMC_HV.DE_BMC_CMC_Temperatur_040, ecu-extract-reference=COMPOSITIONTYPE.SP_IF_BMC_CMC_Temperatur_040_XIX_BMC_HV.DE_BMC_CMC_Temperatur_040
      SP_IF_BMC_CMC_Temperatur_040_XIX_BMC_HV: upstream-reference=Geltungsbereich_E3_1_2_Premium.SP_IF_BMC_CMC_Temperatur_040_XIX_BMC_HV, ecu-extract-reference=COMPOSITIONTYPE.SP_IF_BMC_CMC_Temperatur_040_XIX_BMC_HV
      BMC_CMC_Temperatur_041: upstream-reference=Geltungsbereich_E3_1_2_Premium.SP_IF_BMC_CMC_Temperatur_041_XIX_BMC_HV.DE_BMC_CMC_Temperatur_041, ecu-extract-reference=COMPOSITIONTYPE.SP_IF_BMC_CMC_Temperatur_041_XIX_BMC_HV.DE_BMC_CMC_Temperatur_041
      SP_IF_BMC_CMC_Temperatur_041_XIX_BMC_HV: upstream-reference=Geltungsbereich_E3_1_2_Premium.SP_IF_BMC_CMC_Temperatur_041_XIX_BMC_HV, ecu-extract-reference=COMPOSITIONTYPE.SP_IF_BMC_CMC_Temperatur_041_XIX_BMC_HV
      BMC_CMC_Temperatur_042: upstream-reference=Geltungsbereich_E3_1_2_Premium.SP_IF_BMC_CMC_Temperatur_042_XIX_BMC_HV.DE_BMC_CMC_Temperatur_042, ecu-extract-reference=COMPOSITIONTYPE.SP_IF_BMC_CMC_Temperatur_042_XIX_BMC_HV.DE_BMC_CMC_Temperatur_042
      SP_IF_BMC_CMC_Temperatur_042_XIX_BMC_HV: upstream-reference=Geltungsbereich_E3_1_2_Premium.SP_IF_BMC_CMC_Temperatur_042_XIX_BMC_HV, ecu-extract-reference=COMPOSITIONTYPE.SP_IF_BMC_CMC_Temperatur_042_XIX_BMC_HV
      BMC_CMC_Temperatur_043: upstream-reference=Geltungsbereich_E3_1_2_Premium.SP_IF_BMC_CMC_Temperatur_043_XIX_BMC_HV.DE_BMC_CMC_Temperatur_043, ecu-extract-reference=COMPOSITIONTYPE.SP_IF_BMC_CMC_Temperatur_043_XIX_BMC_HV.DE_BMC_CMC_Temperatur_043
      SP_IF_BMC_CMC_Temperatur_043_XIX_BMC_HV: upstream-reference=Geltungsbereich_E3_1_2_Premium.SP_IF_BMC_CMC_Temperatur_043_XIX_BMC_HV, ecu-extract-reference=COMPOSITIONTYPE.SP_IF_BMC_CMC_Temperatur_043_XIX_BMC_HV
      BMC_CMC_Temperatur_044: upstream-reference=Geltungsbereich_E3_1_2_Premium.SP_IF_BMC_CMC_Temperatur_044_XIX_BMC_HV.DE_BMC_CMC_Temperatur_044, ecu-extract-reference=COMPOSITIONTYPE.SP_IF_BMC_CMC_Temperatur_044_XIX_BMC_HV.DE_BMC_CMC_Temperatur_044
      SP_IF_BMC_CMC_Temperatur_044_XIX_BMC_HV: upstream-reference=Geltungsbereich_E3_1_2_Premium.SP_IF_BMC_CMC_Temperatur_044_XIX_BMC_HV, ecu-extract-reference=COMPOSITIONTYPE.SP_IF_BMC_CMC_Temperatur_044_XIX_BMC_HV
      BMC_CMC_Temperatur_045: upstream-reference=Geltungsbereich_E3_1_2_Premium.SP_IF_BMC_CMC_Temperatur_045_XIX_BMC_HV.DE_BMC_CMC_Temperatur_045, ecu-extract-reference=COMPOSITIONTYPE.SP_IF_BMC_CMC_Temperatur_045_XIX_BMC_HV.DE_BMC_CMC_Temperatur_045
      SP_IF_BMC_CMC_Temperatur_045_XIX_BMC_HV: upstream-reference=Geltungsbereich_E3_1_2_Premium.SP_IF_BMC_CMC_Temperatur_045_XIX_BMC_HV, ecu-extract-reference=COMPOSITIONTYPE.SP_IF_BMC_CMC_Temperatur_045_XIX_BMC_HV
      BMC_CMC_Temperatur_046: upstream-reference=Geltungsbereich_E3_1_2_Premium.SP_IF_BMC_CMC_Temperatur_046_XIX_BMC_HV.DE_BMC_CMC_Temperatur_046, ecu-extract-reference=COMPOSITIONTYPE.SP_IF_BMC_CMC_Temperatur_046_XIX_BMC_HV.DE_BMC_CMC_Temperatur_046
      SP_IF_BMC_CMC_Temperatur_046_XIX_BMC_HV: upstream-reference=Geltungsbereich_E3_1_2_Premium.SP_IF_BMC_CMC_Temperatur_046_XIX_BMC_HV, ecu-extract-reference=COMPOSITIONTYPE.SP_IF_BMC_CMC_Temperatur_046_XIX_BMC_HV
      BMC_CMC_Temperatur_047: upstream-reference=Geltungsbereich_E3_1_2_Premium.SP_IF_BMC_CMC_Temperatur_047_XIX_BMC_HV.DE_BMC_CMC_Temperatur_047, ecu-extract-reference=COMPOSITIONTYPE.SP_IF_BMC_CMC_Temperatur_047_XIX_BMC_HV.DE_BMC_CMC_Temperatur_047
      SP_IF_BMC_CMC_Temperatur_047_XIX_BMC_HV: upstream-reference=Geltungsbereich_E3_1_2_Premium.SP_IF_BMC_CMC_Temperatur_047_XIX_BMC_HV, ecu-extract-reference=COMPOSITIONTYPE.SP_IF_BMC_CMC_Temperatur_047_XIX_BMC_HV
      BMC_CMC_Temperatur_048: upstream-reference=Geltungsbereich_E3_1_2_Premium.SP_IF_BMC_CMC_Temperatur_048_XIX_BMC_HV.DE_BMC_CMC_Temperatur_048, ecu-extract-reference=COMPOSITIONTYPE.SP_IF_BMC_CMC_Temperatur_048_XIX_BMC_HV.DE_BMC_CMC_Temperatur_048
      SP_IF_BMC_CMC_Temperatur_048_XIX_BMC_HV: upstream-reference=Geltungsbereich_E3_1_2_Premium.SP_IF_BMC_CMC_Temperatur_048_XIX_BMC_HV, ecu-extract-reference=COMPOSITIONTYPE.SP_IF_BMC_CMC_Temperatur_048_XIX_BMC_HV
      BMC_CMC_Temperatur_049: upstream-reference=Geltungsbereich_E3_1_2_Premium.SP_IF_BMC_CMC_Temperatur_049_XIX_BMC_HV.DE_BMC_CMC_Temperatur_049, ecu-extract-reference=COMPOSITIONTYPE.SP_IF_BMC_CMC_Temperatur_049_XIX_BMC_HV.DE_BMC_CMC_Temperatur_049
      SP_IF_BMC_CMC_Temperatur_049_XIX_BMC_HV: upstream-reference=Geltungsbereich_E3_1_2_Premium.SP_IF_BMC_CMC_Temperatur_049_XIX_BMC_HV, ecu-extract-reference=COMPOSITIONTYPE.SP_IF_BMC_CMC_Temperatur_049_XIX_BMC_HV
      BMC_CMC_Temperatur_050: upstream-reference=Geltungsbereich_E3_1_2_Premium.SP_IF_BMC_CMC_Temperatur_050_XIX_BMC_HV.DE_BMC_CMC_Temperatur_050, ecu-extract-reference=COMPOSITIONTYPE.SP_IF_BMC_CMC_Temperatur_050_XIX_BMC_HV.DE_BMC_CMC_Temperatur_050
      SP_IF_BMC_CMC_Temperatur_050_XIX_BMC_HV: upstream-reference=Geltungsbereich_E3_1_2_Premium.SP_IF_BMC_CMC_Temperatur_050_XIX_BMC_HV, ecu-extract-reference=COMPOSITIONTYPE.SP_IF_BMC_CMC_Temperatur_050_XIX_BMC_HV
      BMC_CMC_Temperatur_051: upstream-reference=Geltungsbereich_E3_1_2_Premium.SP_IF_BMC_CMC_Temperatur_051_XIX_BMC_HV.DE_BMC_CMC_Temperatur_051, ecu-extract-reference=COMPOSITIONTYPE.SP_IF_BMC_CMC_Temperatur_051_XIX_BMC_HV.DE_BMC_CMC_Temperatur_051
      SP_IF_BMC_CMC_Temperatur_051_XIX_BMC_HV: upstream-reference=Geltungsbereich_E3_1_2_Premium.SP_IF_BMC_CMC_Temperatur_051_XIX_BMC_HV, ecu-extract-reference=COMPOSITIONTYPE.SP_IF_BMC_CMC_Temperatur_051_XIX_BMC_HV
      BMC_CMC_Temperatur_052: upstream-reference=Geltungsbereich_E3_1_2_Premium.SP_IF_BMC_CMC_Temperatur_052_XIX_BMC_HV.DE_BMC_CMC_Temperatur_052, ecu-extract-reference=COMPOSITIONTYPE.SP_IF_BMC_CMC_Temperatur_052_XIX_BMC_HV.DE_BMC_CMC_Temperatur_052
      SP_IF_BMC_CMC_Temperatur_052_XIX_BMC_HV: upstream-reference=Geltungsbereich_E3_1_2_Premium.SP_IF_BMC_CMC_Temperatur_052_XIX_BMC_HV, ecu-extract-reference=COMPOSITIONTYPE.SP_IF_BMC_CMC_Temperatur_052_XIX_BMC_HV
      BMC_CMC_Temperatur_053: upstream-reference=Geltungsbereich_E3_1_2_Premium.SP_IF_BMC_CMC_Temperatur_053_XIX_BMC_HV.DE_BMC_CMC_Temperatur_053, ecu-extract-reference=COMPOSITIONTYPE.SP_IF_BMC_CMC_Temperatur_053_XIX_BMC_HV.DE_BMC_CMC_Temperatur_053
      SP_IF_BMC_CMC_Temperatur_053_XIX_BMC_HV: upstream-reference=Geltungsbereich_E3_1_2_Premium.SP_IF_BMC_CMC_Temperatur_053_XIX_BMC_HV, ecu-extract-reference=COMPOSITIONTYPE.SP_IF_BMC_CMC_Temperatur_053_XIX_BMC_HV
      BMC_CMC_Temperatur_054: upstream-reference=Geltungsbereich_E3_1_2_Premium.SP_IF_BMC_CMC_Temperatur_054_XIX_BMC_HV.DE_BMC_CMC_Temperatur_054, ecu-extract-reference=COMPOSITIONTYPE.SP_IF_BMC_CMC_Temperatur_054_XIX_BMC_HV.DE_BMC_CMC_Temperatur_054
      SP_IF_BMC_CMC_Temperatur_054_XIX_BMC_HV: upstream-reference=Geltungsbereich_E3_1_2_Premium.SP_IF_BMC_CMC_Temperatur_054_XIX_BMC_HV, ecu-extract-reference=COMPOSITIONTYPE.SP_IF_BMC_CMC_Temperatur_054_XIX_BMC_HV
      BMC_CMC_Temperatur_055: upstream-reference=Geltungsbereich_E3_1_2_Premium.SP_IF_BMC_CMC_Temperatur_055_XIX_BMC_HV.DE_BMC_CMC_Temperatur_055, ecu-extract-reference=COMPOSITIONTYPE.SP_IF_BMC_CMC_Temperatur_055_XIX_BMC_HV.DE_BMC_CMC_Temperatur_055
      SP_IF_BMC_CMC_Temperatur_055_XIX_BMC_HV: upstream-reference=Geltungsbereich_E3_1_2_Premium.SP_IF_BMC_CMC_Temperatur_055_XIX_BMC_HV, ecu-extract-reference=COMPOSITIONTYPE.SP_IF_BMC_CMC_Temperatur_055_XIX_BMC_HV
      BMC_CMC_Temperatur_056: upstream-reference=Geltungsbereich_E3_1_2_Premium.SP_IF_BMC_CMC_Temperatur_056_XIX_BMC_HV.DE_BMC_CMC_Temperatur_056, ecu-extract-reference=COMPOSITIONTYPE.SP_IF_BMC_CMC_Temperatur_056_XIX_BMC_HV.DE_BMC_CMC_Temperatur_056
      SP_IF_BMC_CMC_Temperatur_056_XIX_BMC_HV: upstream-reference=Geltungsbereich_E3_1_2_Premium.SP_IF_BMC_CMC_Temperatur_056_XIX_BMC_HV, ecu-extract-reference=COMPOSITIONTYPE.SP_IF_BMC_CMC_Temperatur_056_XIX_BMC_HV
      BMC_CMC_Temperatur_057: upstream-reference=Geltungsbereich_E3_1_2_Premium.SP_IF_BMC_CMC_Temperatur_057_XIX_BMC_HV.DE_BMC_CMC_Temperatur_057, ecu-extract-reference=COMPOSITIONTYPE.SP_IF_BMC_CMC_Temperatur_057_XIX_BMC_HV.DE_BMC_CMC_Temperatur_057
      SP_IF_BMC_CMC_Temperatur_057_XIX_BMC_HV: upstream-reference=Geltungsbereich_E3_1_2_Premium.SP_IF_BMC_CMC_Temperatur_057_XIX_BMC_HV, ecu-extract-reference=COMPOSITIONTYPE.SP_IF_BMC_CMC_Temperatur_057_XIX_BMC_HV
      BMC_CMC_Temperatur_058: upstream-reference=Geltungsbereich_E3_1_2_Premium.SP_IF_BMC_CMC_Temperatur_058_XIX_BMC_HV.DE_BMC_CMC_Temperatur_058, ecu-extract-reference=COMPOSITIONTYPE.SP_IF_BMC_CMC_Temperatur_058_XIX_BMC_HV.DE_BMC_CMC_Temperatur_058
      SP_IF_BMC_CMC_Temperatur_058_XIX_BMC_HV: upstream-reference=Geltungsbereich_E3_1_2_Premium.SP_IF_BMC_CMC_Temperatur_058_XIX_BMC_HV, ecu-extract-reference=COMPOSITIONTYPE.SP_IF_BMC_CMC_Temperatur_058_XIX_BMC_HV
      BMC_CMC_Temperatur_059: upstream-reference=Geltungsbereich_E3_1_2_Premium.SP_IF_BMC_CMC_Temperatur_059_XIX_BMC_HV.DE_BMC_CMC_Temperatur_059, ecu-extract-reference=COMPOSITIONTYPE.SP_IF_BMC_CMC_Temperatur_059_XIX_BMC_HV.DE_BMC_CMC_Temperatur_059
      SP_IF_BMC_CMC_Temperatur_059_XIX_BMC_HV: upstream-reference=Geltungsbereich_E3_1_2_Premium.SP_IF_BMC_CMC_Temperatur_059_XIX_BMC_HV, ecu-extract-reference=COMPOSITIONTYPE.SP_IF_BMC_CMC_Temperatur_059_XIX_BMC_HV
      BMC_CMC_Temperatur_060: upstream-reference=Geltungsbereich_E3_1_2_Premium.SP_IF_BMC_CMC_Temperatur_060_XIX_BMC_HV.DE_BMC_CMC_Temperatur_060, ecu-extract-reference=COMPOSITIONTYPE.SP_IF_BMC_CMC_Temperatur_060_XIX_BMC_HV.DE_BMC_CMC_Temperatur_060
      SP_IF_BMC_CMC_Temperatur_060_XIX_BMC_HV: upstream-reference=Geltungsbereich_E3_1_2_Premium.SP_IF_BMC_CMC_Temperatur_060_XIX_BMC_HV, ecu-extract-reference=COMPOSITIONTYPE.SP_IF_BMC_CMC_Temperatur_060_XIX_BMC_HV
      BMC_CMC_Temperatur_061: upstream-reference=Geltungsbereich_E3_1_2_Premium.SP_IF_BMC_CMC_Temperatur_061_XIX_BMC_HV.DE_BMC_CMC_Temperatur_061, ecu-extract-reference=COMPOSITIONTYPE.SP_IF_BMC_CMC_Temperatur_061_XIX_BMC_HV.DE_BMC_CMC_Temperatur_061
      SP_IF_BMC_CMC_Temperatur_061_XIX_BMC_HV: upstream-reference=Geltungsbereich_E3_1_2_Premium.SP_IF_BMC_CMC_Temperatur_061_XIX_BMC_HV, ecu-extract-reference=COMPOSITIONTYPE.SP_IF_BMC_CMC_Temperatur_061_XIX_BMC_HV
      BMC_CMC_Temperatur_062: upstream-reference=Geltungsbereich_E3_1_2_Premium.SP_IF_BMC_CMC_Temperatur_062_XIX_BMC_HV.DE_BMC_CMC_Temperatur_062, ecu-extract-reference=COMPOSITIONTYPE.SP_IF_BMC_CMC_Temperatur_062_XIX_BMC_HV.DE_BMC_CMC_Temperatur_062
      SP_IF_BMC_CMC_Temperatur_062_XIX_BMC_HV: upstream-reference=Geltungsbereich_E3_1_2_Premium.SP_IF_BMC_CMC_Temperatur_062_XIX_BMC_HV, ecu-extract-reference=COMPOSITIONTYPE.SP_IF_BMC_CMC_Temperatur_062_XIX_BMC_HV
      BMC_CMC_Temperatur_063: upstream-reference=Geltungsbereich_E3_1_2_Premium.SP_IF_BMC_CMC_Temperatur_063_XIX_BMC_HV.DE_BMC_CMC_Temperatur_063, ecu-extract-reference=COMPOSITIONTYPE.SP_IF_BMC_CMC_Temperatur_063_XIX_BMC_HV.DE_BMC_CMC_Temperatur_063
      SP_IF_BMC_CMC_Temperatur_063_XIX_BMC_HV: upstream-reference=Geltungsbereich_E3_1_2_Premium.SP_IF_BMC_CMC_Temperatur_063_XIX_BMC_HV, ecu-extract-reference=COMPOSITIONTYPE.SP_IF_BMC_CMC_Temperatur_063_XIX_BMC_HV
      BMC_CMC_Temperatur_064: upstream-reference=Geltungsbereich_E3_1_2_Premium.SP_IF_BMC_CMC_Temperatur_064_XIX_BMC_HV.DE_BMC_CMC_Temperatur_064, ecu-extract-reference=COMPOSITIONTYPE.SP_IF_BMC_CMC_Temperatur_064_XIX_BMC_HV.DE_BMC_CMC_Temperatur_064
      SP_IF_BMC_CMC_Temperatur_064_XIX_BMC_HV: upstream-reference=Geltungsbereich_E3_1_2_Premium.SP_IF_BMC_CMC_Temperatur_064_XIX_BMC_HV, ecu-extract-reference=COMPOSITIONTYPE.SP_IF_BMC_CMC_Temperatur_064_XIX_BMC_HV
      BMC_CMC_Temperatur_065: upstream-reference=Geltungsbereich_E3_1_2_Premium.SP_IF_BMC_CMC_Temperatur_065_XIX_BMC_HV.DE_BMC_CMC_Temperatur_065, ecu-extract-reference=COMPOSITIONTYPE.SP_IF_BMC_CMC_Temperatur_065_XIX_BMC_HV.DE_BMC_CMC_Temperatur_065
      SP_IF_BMC_CMC_Temperatur_065_XIX_BMC_HV: upstream-reference=Geltungsbereich_E3_1_2_Premium.SP_IF_BMC_CMC_Temperatur_065_XIX_BMC_HV, ecu-extract-reference=COMPOSITIONTYPE.SP_IF_BMC_CMC_Temperatur_065_XIX_BMC_HV
      BMC_CMC_Temperatur_066: upstream-reference=Geltungsbereich_E3_1_2_Premium.SP_IF_BMC_CMC_Temperatur_066_XIX_BMC_HV.DE_BMC_CMC_Temperatur_066, ecu-extract-reference=COMPOSITIONTYPE.SP_IF_BMC_CMC_Temperatur_066_XIX_BMC_HV.DE_BMC_CMC_Temperatur_066
      SP_IF_BMC_CMC_Temperatur_066_XIX_BMC_HV: upstream-reference=Geltungsbereich_E3_1_2_Premium.SP_IF_BMC_CMC_Temperatur_066_XIX_BMC_HV, ecu-extract-reference=COMPOSITIONTYPE.SP_IF_BMC_CMC_Temperatur_066_XIX_BMC_HV
      BMC_CMC_Temperatur_067: upstream-reference=Geltungsbereich_E3_1_2_Premium.SP_IF_BMC_CMC_Temperatur_067_XIX_BMC_HV.DE_BMC_CMC_Temperatur_067, ecu-extract-reference=COMPOSITIONTYPE.SP_IF_BMC_CMC_Temperatur_067_XIX_BMC_HV.DE_BMC_CMC_Temperatur_067
      SP_IF_BMC_CMC_Temperatur_067_XIX_BMC_HV: upstream-reference=Geltungsbereich_E3_1_2_Premium.SP_IF_BMC_CMC_Temperatur_067_XIX_BMC_HV, ecu-extract-reference=COMPOSITIONTYPE.SP_IF_BMC_CMC_Temperatur_067_XIX_BMC_HV
      BMC_CMC_Temperatur_068: upstream-reference=Geltungsbereich_E3_1_2_Premium.SP_IF_BMC_CMC_Temperatur_068_XIX_BMC_HV.DE_BMC_CMC_Temperatur_068, ecu-extract-reference=COMPOSITIONTYPE.SP_IF_BMC_CMC_Temperatur_068_XIX_BMC_HV.DE_BMC_CMC_Temperatur_068
      SP_IF_BMC_CMC_Temperatur_068_XIX_BMC_HV: upstream-reference=Geltungsbereich_E3_1_2_Premium.SP_IF_BMC_CMC_Temperatur_068_XIX_BMC_HV, ecu-extract-reference=COMPOSITIONTYPE.SP_IF_BMC_CMC_Temperatur_068_XIX_BMC_HV
      BMC_CMC_Temperatur_069: upstream-reference=Geltungsbereich_E3_1_2_Premium.SP_IF_BMC_CMC_Temperatur_069_XIX_BMC_HV.DE_BMC_CMC_Temperatur_069, ecu-extract-reference=COMPOSITIONTYPE.SP_IF_BMC_CMC_Temperatur_069_XIX_BMC_HV.DE_BMC_CMC_Temperatur_069
      SP_IF_BMC_CMC_Temperatur_069_XIX_BMC_HV: upstream-reference=Geltungsbereich_E3_1_2_Premium.SP_IF_BMC_CMC_Temperatur_069_XIX_BMC_HV, ecu-extract-reference=COMPOSITIONTYPE.SP_IF_BMC_CMC_Temperatur_069_XIX_BMC_HV
      BMC_CMC_Temperatur_070: upstream-reference=Geltungsbereich_E3_1_2_Premium.SP_IF_BMC_CMC_Temperatur_070_XIX_BMC_HV.DE_BMC_CMC_Temperatur_070, ecu-extract-reference=COMPOSITIONTYPE.SP_IF_BMC_CMC_Temperatur_070_XIX_BMC_HV.DE_BMC_CMC_Temperatur_070
      SP_IF_BMC_CMC_Temperatur_070_XIX_BMC_HV: upstream-reference=Geltungsbereich_E3_1_2_Premium.SP_IF_BMC_CMC_Temperatur_070_XIX_BMC_HV, ecu-extract-reference=COMPOSITIONTYPE.SP_IF_BMC_CMC_Temperatur_070_XIX_BMC_HV
      BMC_CMC_Temperatur_071: upstream-reference=Geltungsbereich_E3_1_2_Premium.SP_IF_BMC_CMC_Temperatur_071_XIX_BMC_HV.DE_BMC_CMC_Temperatur_071, ecu-extract-reference=COMPOSITIONTYPE.SP_IF_BMC_CMC_Temperatur_071_XIX_BMC_HV.DE_BMC_CMC_Temperatur_071
      SP_IF_BMC_CMC_Temperatur_071_XIX_BMC_HV: upstream-reference=Geltungsbereich_E3_1_2_Premium.SP_IF_BMC_CMC_Temperatur_071_XIX_BMC_HV, ecu-extract-reference=COMPOSITIONTYPE.SP_IF_BMC_CMC_Temperatur_071_XIX_BMC_HV
      BMC_CMC_Temperatur_072: upstream-reference=Geltungsbereich_E3_1_2_Premium.SP_IF_BMC_CMC_Temperatur_072_XIX_BMC_HV.DE_BMC_CMC_Temperatur_072, ecu-extract-reference=COMPOSITIONTYPE.SP_IF_BMC_CMC_Temperatur_072_XIX_BMC_HV.DE_BMC_CMC_Temperatur_072
      SP_IF_BMC_CMC_Temperatur_072_XIX_BMC_HV: upstream-reference=Geltungsbereich_E3_1_2_Premium.SP_IF_BMC_CMC_Temperatur_072_XIX_BMC_HV, ecu-extract-reference=COMPOSITIONTYPE.SP_IF_BMC_CMC_Temperatur_072_XIX_BMC_HV
      BMC_CMC_Temperatur_073: upstream-reference=Geltungsbereich_E3_1_2_Premium.SP_IF_BMC_CMC_Temperatur_073_XIX_BMC_HV.DE_BMC_CMC_Temperatur_073, ecu-extract-reference=COMPOSITIONTYPE.SP_IF_BMC_CMC_Temperatur_073_XIX_BMC_HV.DE_BMC_CMC_Temperatur_073
      SP_IF_BMC_CMC_Temperatur_073_XIX_BMC_HV: upstream-reference=Geltungsbereich_E3_1_2_Premium.SP_IF_BMC_CMC_Temperatur_073_XIX_BMC_HV, ecu-extract-reference=COMPOSITIONTYPE.SP_IF_BMC_CMC_Temperatur_073_XIX_BMC_HV
      BMC_CMC_Temperatur_074: upstream-reference=Geltungsbereich_E3_1_2_Premium.SP_IF_BMC_CMC_Temperatur_074_XIX_BMC_HV.DE_BMC_CMC_Temperatur_074, ecu-extract-reference=COMPOSITIONTYPE.SP_IF_BMC_CMC_Temperatur_074_XIX_BMC_HV.DE_BMC_CMC_Temperatur_074
      SP_IF_BMC_CMC_Temperatur_074_XIX_BMC_HV: upstream-reference=Geltungsbereich_E3_1_2_Premium.SP_IF_BMC_CMC_Temperatur_074_XIX_BMC_HV, ecu-extract-reference=COMPOSITIONTYPE.SP_IF_BMC_CMC_Temperatur_074_XIX_BMC_HV
      BMC_CMC_Temperatur_075: upstream-reference=Geltungsbereich_E3_1_2_Premium.SP_IF_BMC_CMC_Temperatur_075_XIX_BMC_HV.DE_BMC_CMC_Temperatur_075, ecu-extract-reference=COMPOSITIONTYPE.SP_IF_BMC_CMC_Temperatur_075_XIX_BMC_HV.DE_BMC_CMC_Temperatur_075
      SP_IF_BMC_CMC_Temperatur_075_XIX_BMC_HV: upstream-reference=Geltungsbereich_E3_1_2_Premium.SP_IF_BMC_CMC_Temperatur_075_XIX_BMC_HV, ecu-extract-reference=COMPOSITIONTYPE.SP_IF_BMC_CMC_Temperatur_075_XIX_BMC_HV
      BMC_CMC_Temperatur_076: upstream-reference=Geltungsbereich_E3_1_2_Premium.SP_IF_BMC_CMC_Temperatur_076_XIX_BMC_HV.DE_BMC_CMC_Temperatur_076, ecu-extract-reference=COMPOSITIONTYPE.SP_IF_BMC_CMC_Temperatur_076_XIX_BMC_HV.DE_BMC_CMC_Temperatur_076
      SP_IF_BMC_CMC_Temperatur_076_XIX_BMC_HV: upstream-reference=Geltungsbereich_E3_1_2_Premium.SP_IF_BMC_CMC_Temperatur_076_XIX_BMC_HV, ecu-extract-reference=COMPOSITIONTYPE.SP_IF_BMC_CMC_Temperatur_076_XIX_BMC_HV
      BMC_CMC_Temperatur_077: upstream-reference=Geltungsbereich_E3_1_2_Premium.SP_IF_BMC_CMC_Temperatur_077_XIX_BMC_HV.DE_BMC_CMC_Temperatur_077, ecu-extract-reference=COMPOSITIONTYPE.SP_IF_BMC_CMC_Temperatur_077_XIX_BMC_HV.DE_BMC_CMC_Temperatur_077
      SP_IF_BMC_CMC_Temperatur_077_XIX_BMC_HV: upstream-reference=Geltungsbereich_E3_1_2_Premium.SP_IF_BMC_CMC_Temperatur_077_XIX_BMC_HV, ecu-extract-reference=COMPOSITIONTYPE.SP_IF_BMC_CMC_Temperatur_077_XIX_BMC_HV
      BMC_CMC_Temperatur_078: upstream-reference=Geltungsbereich_E3_1_2_Premium.SP_IF_BMC_CMC_Temperatur_078_XIX_BMC_HV.DE_BMC_CMC_Temperatur_078, ecu-extract-reference=COMPOSITIONTYPE.SP_IF_BMC_CMC_Temperatur_078_XIX_BMC_HV.DE_BMC_CMC_Temperatur_078
      SP_IF_BMC_CMC_Temperatur_078_XIX_BMC_HV: upstream-reference=Geltungsbereich_E3_1_2_Premium.SP_IF_BMC_CMC_Temperatur_078_XIX_BMC_HV, ecu-extract-reference=COMPOSITIONTYPE.SP_IF_BMC_CMC_Temperatur_078_XIX_BMC_HV
      BMC_CMC_Temperatur_079: upstream-reference=Geltungsbereich_E3_1_2_Premium.SP_IF_BMC_CMC_Temperatur_079_XIX_BMC_HV.DE_BMC_CMC_Temperatur_079, ecu-extract-reference=COMPOSITIONTYPE.SP_IF_BMC_CMC_Temperatur_079_XIX_BMC_HV.DE_BMC_CMC_Temperatur_079
      SP_IF_BMC_CMC_Temperatur_079_XIX_BMC_HV: upstream-reference=Geltungsbereich_E3_1_2_Premium.SP_IF_BMC_CMC_Temperatur_079_XIX_BMC_HV, ecu-extract-reference=COMPOSITIONTYPE.SP_IF_BMC_CMC_Temperatur_079_XIX_BMC_HV
      BMC_CMC_Temperatur_080: upstream-reference=Geltungsbereich_E3_1_2_Premium.SP_IF_BMC_CMC_Temperatur_080_XIX_BMC_HV.DE_BMC_CMC_Temperatur_080, ecu-extract-reference=COMPOSITIONTYPE.SP_IF_BMC_CMC_Temperatur_080_XIX_BMC_HV.DE_BMC_CMC_Temperatur_080
      SP_IF_BMC_CMC_Temperatur_080_XIX_BMC_HV: upstream-reference=Geltungsbereich_E3_1_2_Premium.SP_IF_BMC_CMC_Temperatur_080_XIX_BMC_HV, ecu-extract-reference=COMPOSITIONTYPE.SP_IF_BMC_CMC_Temperatur_080_XIX_BMC_HV
      BMC_CMC_Temperatur_081: upstream-reference=Geltungsbereich_E3_1_2_Premium.SP_IF_BMC_CMC_Temperatur_081_XIX_BMC_HV.DE_BMC_CMC_Temperatur_081, ecu-extract-reference=COMPOSITIONTYPE.SP_IF_BMC_CMC_Temperatur_081_XIX_BMC_HV.DE_BMC_CMC_Temperatur_081
      SP_IF_BMC_CMC_Temperatur_081_XIX_BMC_HV: upstream-reference=Geltungsbereich_E3_1_2_Premium.SP_IF_BMC_CMC_Temperatur_081_XIX_BMC_HV, ecu-extract-reference=COMPOSITIONTYPE.SP_IF_BMC_CMC_Temperatur_081_XIX_BMC_HV
      BMC_CMC_Temperatur_082: upstream-reference=Geltungsbereich_E3_1_2_Premium.SP_IF_BMC_CMC_Temperatur_082_XIX_BMC_HV.DE_BMC_CMC_Temperatur_082, ecu-extract-reference=COMPOSITIONTYPE.SP_IF_BMC_CMC_Temperatur_082_XIX_BMC_HV.DE_BMC_CMC_Temperatur_082
      SP_IF_BMC_CMC_Temperatur_082_XIX_BMC_HV: upstream-reference=Geltungsbereich_E3_1_2_Premium.SP_IF_BMC_CMC_Temperatur_082_XIX_BMC_HV, ecu-extract-reference=COMPOSITIONTYPE.SP_IF_BMC_CMC_Temperatur_082_XIX_BMC_HV
      BMC_CMC_Temperatur_083: upstream-reference=Geltungsbereich_E3_1_2_Premium.SP_IF_BMC_CMC_Temperatur_083_XIX_BMC_HV.DE_BMC_CMC_Temperatur_083, ecu-extract-reference=COMPOSITIONTYPE.SP_IF_BMC_CMC_Temperatur_083_XIX_BMC_HV.DE_BMC_CMC_Temperatur_083
      SP_IF_BMC_CMC_Temperatur_083_XIX_BMC_HV: upstream-reference=Geltungsbereich_E3_1_2_Premium.SP_IF_BMC_CMC_Temperatur_083_XIX_BMC_HV, ecu-extract-reference=COMPOSITIONTYPE.SP_IF_BMC_CMC_Temperatur_083_XIX_BMC_HV
      BMC_CMC_Temperatur_084: upstream-reference=Geltungsbereich_E3_1_2_Premium.SP_IF_BMC_CMC_Temperatur_084_XIX_BMC_HV.DE_BMC_CMC_Temperatur_084, ecu-extract-reference=COMPOSITIONTYPE.SP_IF_BMC_CMC_Temperatur_084_XIX_BMC_HV.DE_BMC_CMC_Temperatur_084
      SP_IF_BMC_CMC_Temperatur_084_XIX_BMC_HV: upstream-reference=Geltungsbereich_E3_1_2_Premium.SP_IF_BMC_CMC_Temperatur_084_XIX_BMC_HV, ecu-extract-reference=COMPOSITIONTYPE.SP_IF_BMC_CMC_Temperatur_084_XIX_BMC_HV
      BMC_CMC_Temperatur_085: upstream-reference=Geltungsbereich_E3_1_2_Premium.SP_IF_BMC_CMC_Temperatur_085_XIX_BMC_HV.DE_BMC_CMC_Temperatur_085, ecu-extract-reference=COMPOSITIONTYPE.SP_IF_BMC_CMC_Temperatur_085_XIX_BMC_HV.DE_BMC_CMC_Temperatur_085
      SP_IF_BMC_CMC_Temperatur_085_XIX_BMC_HV: upstream-reference=Geltungsbereich_E3_1_2_Premium.SP_IF_BMC_CMC_Temperatur_085_XIX_BMC_HV, ecu-extract-reference=COMPOSITIONTYPE.SP_IF_BMC_CMC_Temperatur_085_XIX_BMC_HV
      BMC_CMC_Temperatur_086: upstream-reference=Geltungsbereich_E3_1_2_Premium.SP_IF_BMC_CMC_Temperatur_086_XIX_BMC_HV.DE_BMC_CMC_Temperatur_086, ecu-extract-reference=COMPOSITIONTYPE.SP_IF_BMC_CMC_Temperatur_086_XIX_BMC_HV.DE_BMC_CMC_Temperatur_086
      SP_IF_BMC_CMC_Temperatur_086_XIX_BMC_HV: upstream-reference=Geltungsbereich_E3_1_2_Premium.SP_IF_BMC_CMC_Temperatur_086_XIX_BMC_HV, ecu-extract-reference=COMPOSITIONTYPE.SP_IF_BMC_CMC_Temperatur_086_XIX_BMC_HV
      BMC_CMC_Temperatur_087: upstream-reference=Geltungsbereich_E3_1_2_Premium.SP_IF_BMC_CMC_Temperatur_087_XIX_BMC_HV.DE_BMC_CMC_Temperatur_087, ecu-extract-reference=COMPOSITIONTYPE.SP_IF_BMC_CMC_Temperatur_087_XIX_BMC_HV.DE_BMC_CMC_Temperatur_087
      SP_IF_BMC_CMC_Temperatur_087_XIX_BMC_HV: upstream-reference=Geltungsbereich_E3_1_2_Premium.SP_IF_BMC_CMC_Temperatur_087_XIX_BMC_HV, ecu-extract-reference=COMPOSITIONTYPE.SP_IF_BMC_CMC_Temperatur_087_XIX_BMC_HV
      BMC_CMC_Temperatur_088: upstream-reference=Geltungsbereich_E3_1_2_Premium.SP_IF_BMC_CMC_Temperatur_088_XIX_BMC_HV.DE_BMC_CMC_Temperatur_088, ecu-extract-reference=COMPOSITIONTYPE.SP_IF_BMC_CMC_Temperatur_088_XIX_BMC_HV.DE_BMC_CMC_Temperatur_088
      SP_IF_BMC_CMC_Temperatur_088_XIX_BMC_HV: upstream-reference=Geltungsbereich_E3_1_2_Premium.SP_IF_BMC_CMC_Temperatur_088_XIX_BMC_HV, ecu-extract-reference=COMPOSITIONTYPE.SP_IF_BMC_CMC_Temperatur_088_XIX_BMC_HV
      BMC_CMC_Temperatur_089: upstream-reference=Geltungsbereich_E3_1_2_Premium.SP_IF_BMC_CMC_Temperatur_089_XIX_BMC_HV.DE_BMC_CMC_Temperatur_089, ecu-extract-reference=COMPOSITIONTYPE.SP_IF_BMC_CMC_Temperatur_089_XIX_BMC_HV.DE_BMC_CMC_Temperatur_089
      SP_IF_BMC_CMC_Temperatur_089_XIX_BMC_HV: upstream-reference=Geltungsbereich_E3_1_2_Premium.SP_IF_BMC_CMC_Temperatur_089_XIX_BMC_HV, ecu-extract-reference=COMPOSITIONTYPE.SP_IF_BMC_CMC_Temperatur_089_XIX_BMC_HV
      BMC_CMC_Temperatur_090: upstream-reference=Geltungsbereich_E3_1_2_Premium.SP_IF_BMC_CMC_Temperatur_090_XIX_BMC_HV.DE_BMC_CMC_Temperatur_090, ecu-extract-reference=COMPOSITIONTYPE.SP_IF_BMC_CMC_Temperatur_090_XIX_BMC_HV.DE_BMC_CMC_Temperatur_090
      SP_IF_BMC_CMC_Temperatur_090_XIX_BMC_HV: upstream-reference=Geltungsbereich_E3_1_2_Premium.SP_IF_BMC_CMC_Temperatur_090_XIX_BMC_HV, ecu-extract-reference=COMPOSITIONTYPE.SP_IF_BMC_CMC_Temperatur_090_XIX_BMC_HV
      BMC_CMC_Temperatur_091: upstream-reference=Geltungsbereich_E3_1_2_Premium.SP_IF_BMC_CMC_Temperatur_091_XIX_BMC_HV.DE_BMC_CMC_Temperatur_091, ecu-extract-reference=COMPOSITIONTYPE.SP_IF_BMC_CMC_Temperatur_091_XIX_BMC_HV.DE_BMC_CMC_Temperatur_091
      SP_IF_BMC_CMC_Temperatur_091_XIX_BMC_HV: upstream-reference=Geltungsbereich_E3_1_2_Premium.SP_IF_BMC_CMC_Temperatur_091_XIX_BMC_HV, ecu-extract-reference=COMPOSITIONTYPE.SP_IF_BMC_CMC_Temperatur_091_XIX_BMC_HV
      BMC_CMC_Temperatur_092: upstream-reference=Geltungsbereich_E3_1_2_Premium.SP_IF_BMC_CMC_Temperatur_092_XIX_BMC_HV.DE_BMC_CMC_Temperatur_092, ecu-extract-reference=COMPOSITIONTYPE.SP_IF_BMC_CMC_Temperatur_092_XIX_BMC_HV.DE_BMC_CMC_Temperatur_092
      SP_IF_BMC_CMC_Temperatur_092_XIX_BMC_HV: upstream-reference=Geltungsbereich_E3_1_2_Premium.SP_IF_BMC_CMC_Temperatur_092_XIX_BMC_HV, ecu-extract-reference=COMPOSITIONTYPE.SP_IF_BMC_CMC_Temperatur_092_XIX_BMC_HV
      BMC_CMC_Temperatur_093: upstream-reference=Geltungsbereich_E3_1_2_Premium.SP_IF_BMC_CMC_Temperatur_093_XIX_BMC_HV.DE_BMC_CMC_Temperatur_093, ecu-extract-reference=COMPOSITIONTYPE.SP_IF_BMC_CMC_Temperatur_093_XIX_BMC_HV.DE_BMC_CMC_Temperatur_093
      SP_IF_BMC_CMC_Temperatur_093_XIX_BMC_HV: upstream-reference=Geltungsbereich_E3_1_2_Premium.SP_IF_BMC_CMC_Temperatur_093_XIX_BMC_HV, ecu-extract-reference=COMPOSITIONTYPE.SP_IF_BMC_CMC_Temperatur_093_XIX_BMC_HV
      BMC_CMC_Temperatur_094: upstream-reference=Geltungsbereich_E3_1_2_Premium.SP_IF_BMC_CMC_Temperatur_094_XIX_BMC_HV.DE_BMC_CMC_Temperatur_094, ecu-extract-reference=COMPOSITIONTYPE.SP_IF_BMC_CMC_Temperatur_094_XIX_BMC_HV.DE_BMC_CMC_Temperatur_094
      SP_IF_BMC_CMC_Temperatur_094_XIX_BMC_HV: upstream-reference=Geltungsbereich_E3_1_2_Premium.SP_IF_BMC_CMC_Temperatur_094_XIX_BMC_HV, ecu-extract-reference=COMPOSITIONTYPE.SP_IF_BMC_CMC_Temperatur_094_XIX_BMC_HV
      BMC_CMC_Temperatur_095: upstream-reference=Geltungsbereich_E3_1_2_Premium.SP_IF_BMC_CMC_Temperatur_095_XIX_BMC_HV.DE_BMC_CMC_Temperatur_095, ecu-extract-reference=COMPOSITIONTYPE.SP_IF_BMC_CMC_Temperatur_095_XIX_BMC_HV.DE_BMC_CMC_Temperatur_095
      SP_IF_BMC_CMC_Temperatur_095_XIX_BMC_HV: upstream-reference=Geltungsbereich_E3_1_2_Premium.SP_IF_BMC_CMC_Temperatur_095_XIX_BMC_HV, ecu-extract-reference=COMPOSITIONTYPE.SP_IF_BMC_CMC_Temperatur_095_XIX_BMC_HV
      BMC_CMC_Temperatur_096: upstream-reference=Geltungsbereich_E3_1_2_Premium.SP_IF_BMC_CMC_Temperatur_096_XIX_BMC_HV.DE_BMC_CMC_Temperatur_096, ecu-extract-reference=COMPOSITIONTYPE.SP_IF_BMC_CMC_Temperatur_096_XIX_BMC_HV.DE_BMC_CMC_Temperatur_096
      SP_IF_BMC_CMC_Temperatur_096_XIX_BMC_HV: upstream-reference=Geltungsbereich_E3_1_2_Premium.SP_IF_BMC_CMC_Temperatur_096_XIX_BMC_HV, ecu-extract-reference=COMPOSITIONTYPE.SP_IF_BMC_CMC_Temperatur_096_XIX_BMC_HV
      BMC_CMC_Zellspannung_001: upstream-reference=Geltungsbereich_E3_1_2_Premium.SP_IF_BMC_CMC_Zellspannung_001_XIX_BMC_HV.DE_BMC_CMC_Zellspannung_001, ecu-extract-reference=COMPOSITIONTYPE.SP_IF_BMC_CMC_Zellspannung_001_XIX_BMC_HV.DE_BMC_CMC_Zellspannung_001
      SP_IF_BMC_CMC_Zellspannung_001_XIX_BMC_HV: upstream-reference=Geltungsbereich_E3_1_2_Premium.SP_IF_BMC_CMC_Zellspannung_001_XIX_BMC_HV, ecu-extract-reference=COMPOSITIONTYPE.SP_IF_BMC_CMC_Zellspannung_001_XIX_BMC_HV
      BMC_CMC_Zellspannung_002: upstream-reference=Geltungsbereich_E3_1_2_Premium.SP_IF_BMC_CMC_Zellspannung_002_XIX_BMC_HV.DE_BMC_CMC_Zellspannung_002, ecu-extract-reference=COMPOSITIONTYPE.SP_IF_BMC_CMC_Zellspannung_002_XIX_BMC_HV.DE_BMC_CMC_Zellspannung_002
      SP_IF_BMC_CMC_Zellspannung_002_XIX_BMC_HV: upstream-reference=Geltungsbereich_E3_1_2_Premium.SP_IF_BMC_CMC_Zellspannung_002_XIX_BMC_HV, ecu-extract-reference=COMPOSITIONTYPE.SP_IF_BMC_CMC_Zellspannung_002_XIX_BMC_HV
      BMC_CMC_Zellspannung_003: upstream-reference=Geltungsbereich_E3_1_2_Premium.SP_IF_BMC_CMC_Zellspannung_003_XIX_BMC_HV.DE_BMC_CMC_Zellspannung_003, ecu-extract-reference=COMPOSITIONTYPE.SP_IF_BMC_CMC_Zellspannung_003_XIX_BMC_HV.DE_BMC_CMC_Zellspannung_003
      SP_IF_BMC_CMC_Zellspannung_003_XIX_BMC_HV: upstream-reference=Geltungsbereich_E3_1_2_Premium.SP_IF_BMC_CMC_Zellspannung_003_XIX_BMC_HV, ecu-extract-reference=COMPOSITIONTYPE.SP_IF_BMC_CMC_Zellspannung_003_XIX_BMC_HV
      BMC_CMC_Zellspannung_004: upstream-reference=Geltungsbereich_E3_1_2_Premium.SP_IF_BMC_CMC_Zellspannung_004_XIX_BMC_HV.DE_BMC_CMC_Zellspannung_004, ecu-extract-reference=COMPOSITIONTYPE.SP_IF_BMC_CMC_Zellspannung_004_XIX_BMC_HV.DE_BMC_CMC_Zellspannung_004
      SP_IF_BMC_CMC_Zellspannung_004_XIX_BMC_HV: upstream-reference=Geltungsbereich_E3_1_2_Premium.SP_IF_BMC_CMC_Zellspannung_004_XIX_BMC_HV, ecu-extract-reference=COMPOSITIONTYPE.SP_IF_BMC_CMC_Zellspannung_004_XIX_BMC_HV
      BMC_CMC_Zellspannung_005: upstream-reference=Geltungsbereich_E3_1_2_Premium.SP_IF_BMC_CMC_Zellspannung_005_XIX_BMC_HV.DE_BMC_CMC_Zellspannung_005, ecu-extract-reference=COMPOSITIONTYPE.SP_IF_BMC_CMC_Zellspannung_005_XIX_BMC_HV.DE_BMC_CMC_Zellspannung_005
      SP_IF_BMC_CMC_Zellspannung_005_XIX_BMC_HV: upstream-reference=Geltungsbereich_E3_1_2_Premium.SP_IF_BMC_CMC_Zellspannung_005_XIX_BMC_HV, ecu-extract-reference=COMPOSITIONTYPE.SP_IF_BMC_CMC_Zellspannung_005_XIX_BMC_HV
      BMC_CMC_Zellspannung_006: upstream-reference=Geltungsbereich_E3_1_2_Premium.SP_IF_BMC_CMC_Zellspannung_006_XIX_BMC_HV.DE_BMC_CMC_Zellspannung_006, ecu-extract-reference=COMPOSITIONTYPE.SP_IF_BMC_CMC_Zellspannung_006_XIX_BMC_HV.DE_BMC_CMC_Zellspannung_006
      SP_IF_BMC_CMC_Zellspannung_006_XIX_BMC_HV: upstream-reference=Geltungsbereich_E3_1_2_Premium.SP_IF_BMC_CMC_Zellspannung_006_XIX_BMC_HV, ecu-extract-reference=COMPOSITIONTYPE.SP_IF_BMC_CMC_Zellspannung_006_XIX_BMC_HV
      BMC_CMC_Zellspannung_007: upstream-reference=Geltungsbereich_E3_1_2_Premium.SP_IF_BMC_CMC_Zellspannung_007_XIX_BMC_HV.DE_BMC_CMC_Zellspannung_007, ecu-extract-reference=COMPOSITIONTYPE.SP_IF_BMC_CMC_Zellspannung_007_XIX_BMC_HV.DE_BMC_CMC_Zellspannung_007
      SP_IF_BMC_CMC_Zellspannung_007_XIX_BMC_HV: upstream-reference=Geltungsbereich_E3_1_2_Premium.SP_IF_BMC_CMC_Zellspannung_007_XIX_BMC_HV, ecu-extract-reference=COMPOSITIONTYPE.SP_IF_BMC_CMC_Zellspannung_007_XIX_BMC_HV
      BMC_CMC_Zellspannung_008: upstream-reference=Geltungsbereich_E3_1_2_Premium.SP_IF_BMC_CMC_Zellspannung_008_XIX_BMC_HV.DE_BMC_CMC_Zellspannung_008, ecu-extract-reference=COMPOSITIONTYPE.SP_IF_BMC_CMC_Zellspannung_008_XIX_BMC_HV.DE_BMC_CMC_Zellspannung_008
      SP_IF_BMC_CMC_Zellspannung_008_XIX_BMC_HV: upstream-reference=Geltungsbereich_E3_1_2_Premium.SP_IF_BMC_CMC_Zellspannung_008_XIX_BMC_HV, ecu-extract-reference=COMPOSITIONTYPE.SP_IF_BMC_CMC_Zellspannung_008_XIX_BMC_HV
      BMC_CMC_Zellspannung_009: upstream-reference=Geltungsbereich_E3_1_2_Premium.SP_IF_BMC_CMC_Zellspannung_009_XIX_BMC_HV.DE_BMC_CMC_Zellspannung_009, ecu-extract-reference=COMPOSITIONTYPE.SP_IF_BMC_CMC_Zellspannung_009_XIX_BMC_HV.DE_BMC_CMC_Zellspannung_009
      SP_IF_BMC_CMC_Zellspannung_009_XIX_BMC_HV: upstream-reference=Geltungsbereich_E3_1_2_Premium.SP_IF_BMC_CMC_Zellspannung_009_XIX_BMC_HV, ecu-extract-reference=COMPOSITIONTYPE.SP_IF_BMC_CMC_Zellspannung_009_XIX_BMC_HV
      BMC_CMC_Zellspannung_010: upstream-reference=Geltungsbereich_E3_1_2_Premium.SP_IF_BMC_CMC_Zellspannung_010_XIX_BMC_HV.DE_BMC_CMC_Zellspannung_010, ecu-extract-reference=COMPOSITIONTYPE.SP_IF_BMC_CMC_Zellspannung_010_XIX_BMC_HV.DE_BMC_CMC_Zellspannung_010
      SP_IF_BMC_CMC_Zellspannung_010_XIX_BMC_HV: upstream-reference=Geltungsbereich_E3_1_2_Premium.SP_IF_BMC_CMC_Zellspannung_010_XIX_BMC_HV, ecu-extract-reference=COMPOSITIONTYPE.SP_IF_BMC_CMC_Zellspannung_010_XIX_BMC_HV
      BMC_CMC_Zellspannung_011: upstream-reference=Geltungsbereich_E3_1_2_Premium.SP_IF_BMC_CMC_Zellspannung_011_XIX_BMC_HV.DE_BMC_CMC_Zellspannung_011, ecu-extract-reference=COMPOSITIONTYPE.SP_IF_BMC_CMC_Zellspannung_011_XIX_BMC_HV.DE_BMC_CMC_Zellspannung_011
      SP_IF_BMC_CMC_Zellspannung_011_XIX_BMC_HV: upstream-reference=Geltungsbereich_E3_1_2_Premium.SP_IF_BMC_CMC_Zellspannung_011_XIX_BMC_HV, ecu-extract-reference=COMPOSITIONTYPE.SP_IF_BMC_CMC_Zellspannung_011_XIX_BMC_HV
      BMC_CMC_Zellspannung_012: upstream-reference=Geltungsbereich_E3_1_2_Premium.SP_IF_BMC_CMC_Zellspannung_012_XIX_BMC_HV.DE_BMC_CMC_Zellspannung_012, ecu-extract-reference=COMPOSITIONTYPE.SP_IF_BMC_CMC_Zellspannung_012_XIX_BMC_HV.DE_BMC_CMC_Zellspannung_012
      SP_IF_BMC_CMC_Zellspannung_012_XIX_BMC_HV: upstream-reference=Geltungsbereich_E3_1_2_Premium.SP_IF_BMC_CMC_Zellspannung_012_XIX_BMC_HV, ecu-extract-reference=COMPOSITIONTYPE.SP_IF_BMC_CMC_Zellspannung_012_XIX_BMC_HV
      BMC_CMC_Zellspannung_013: upstream-reference=Geltungsbereich_E3_1_2_Premium.SP_IF_BMC_CMC_Zellspannung_013_XIX_BMC_HV.DE_BMC_CMC_Zellspannung_013, ecu-extract-reference=COMPOSITIONTYPE.SP_IF_BMC_CMC_Zellspannung_013_XIX_BMC_HV.DE_BMC_CMC_Zellspannung_013
      SP_IF_BMC_CMC_Zellspannung_013_XIX_BMC_HV: upstream-reference=Geltungsbereich_E3_1_2_Premium.SP_IF_BMC_CMC_Zellspannung_013_XIX_BMC_HV, ecu-extract-reference=COMPOSITIONTYPE.SP_IF_BMC_CMC_Zellspannung_013_XIX_BMC_HV
      BMC_CMC_Zellspannung_014: upstream-reference=Geltungsbereich_E3_1_2_Premium.SP_IF_BMC_CMC_Zellspannung_014_XIX_BMC_HV.DE_BMC_CMC_Zellspannung_014, ecu-extract-reference=COMPOSITIONTYPE.SP_IF_BMC_CMC_Zellspannung_014_XIX_BMC_HV.DE_BMC_CMC_Zellspannung_014
      SP_IF_BMC_CMC_Zellspannung_014_XIX_BMC_HV: upstream-reference=Geltungsbereich_E3_1_2_Premium.SP_IF_BMC_CMC_Zellspannung_014_XIX_BMC_HV, ecu-extract-reference=COMPOSITIONTYPE.SP_IF_BMC_CMC_Zellspannung_014_XIX_BMC_HV
      BMC_CMC_Zellspannung_015: upstream-reference=Geltungsbereich_E3_1_2_Premium.SP_IF_BMC_CMC_Zellspannung_015_XIX_BMC_HV.DE_BMC_CMC_Zellspannung_015, ecu-extract-reference=COMPOSITIONTYPE.SP_IF_BMC_CMC_Zellspannung_015_XIX_BMC_HV.DE_BMC_CMC_Zellspannung_015
      SP_IF_BMC_CMC_Zellspannung_015_XIX_BMC_HV: upstream-reference=Geltungsbereich_E3_1_2_Premium.SP_IF_BMC_CMC_Zellspannung_015_XIX_BMC_HV, ecu-extract-reference=COMPOSITIONTYPE.SP_IF_BMC_CMC_Zellspannung_015_XIX_BMC_HV
      BMC_CMC_Zellspannung_016: upstream-reference=Geltungsbereich_E3_1_2_Premium.SP_IF_BMC_CMC_Zellspannung_016_XIX_BMC_HV.DE_BMC_CMC_Zellspannung_016, ecu-extract-reference=COMPOSITIONTYPE.SP_IF_BMC_CMC_Zellspannung_016_XIX_BMC_HV.DE_BMC_CMC_Zellspannung_016
      SP_IF_BMC_CMC_Zellspannung_016_XIX_BMC_HV: upstream-reference=Geltungsbereich_E3_1_2_Premium.SP_IF_BMC_CMC_Zellspannung_016_XIX_BMC_HV, ecu-extract-reference=COMPOSITIONTYPE.SP_IF_BMC_CMC_Zellspannung_016_XIX_BMC_HV
      BMC_CMC_Zellspannung_017: upstream-reference=Geltungsbereich_E3_1_2_Premium.SP_IF_BMC_CMC_Zellspannung_017_XIX_BMC_HV.DE_BMC_CMC_Zellspannung_017, ecu-extract-reference=COMPOSITIONTYPE.SP_IF_BMC_CMC_Zellspannung_017_XIX_BMC_HV.DE_BMC_CMC_Zellspannung_017
      SP_IF_BMC_CMC_Zellspannung_017_XIX_BMC_HV: upstream-reference=Geltungsbereich_E3_1_2_Premium.SP_IF_BMC_CMC_Zellspannung_017_XIX_BMC_HV, ecu-extract-reference=COMPOSITIONTYPE.SP_IF_BMC_CMC_Zellspannung_017_XIX_BMC_HV
      BMC_CMC_Zellspannung_018: upstream-reference=Geltungsbereich_E3_1_2_Premium.SP_IF_BMC_CMC_Zellspannung_018_XIX_BMC_HV.DE_BMC_CMC_Zellspannung_018, ecu-extract-reference=COMPOSITIONTYPE.SP_IF_BMC_CMC_Zellspannung_018_XIX_BMC_HV.DE_BMC_CMC_Zellspannung_018
      SP_IF_BMC_CMC_Zellspannung_018_XIX_BMC_HV: upstream-reference=Geltungsbereich_E3_1_2_Premium.SP_IF_BMC_CMC_Zellspannung_018_XIX_BMC_HV, ecu-extract-reference=COMPOSITIONTYPE.SP_IF_BMC_CMC_Zellspannung_018_XIX_BMC_HV
      BMC_CMC_Zellspannung_019: upstream-reference=Geltungsbereich_E3_1_2_Premium.SP_IF_BMC_CMC_Zellspannung_019_XIX_BMC_HV.DE_BMC_CMC_Zellspannung_019, ecu-extract-reference=COMPOSITIONTYPE.SP_IF_BMC_CMC_Zellspannung_019_XIX_BMC_HV.DE_BMC_CMC_Zellspannung_019
      SP_IF_BMC_CMC_Zellspannung_019_XIX_BMC_HV: upstream-reference=Geltungsbereich_E3_1_2_Premium.SP_IF_BMC_CMC_Zellspannung_019_XIX_BMC_HV, ecu-extract-reference=COMPOSITIONTYPE.SP_IF_BMC_CMC_Zellspannung_019_XIX_BMC_HV
      BMC_CMC_Zellspannung_01_Messzeit: upstream-reference=Geltungsbereich_E3_1_2_Premium.SP_IF_BMC_CMC_Zellspannung_01_Messzeit_XIX_BMC_HV.DE_BMC_CMC_Zellspannung_01_Messzeit, ecu-extract-reference=COMPOSITIONTYPE.SP_IF_BMC_CMC_Zellspannung_01_Messzeit_XIX_BMC_HV.DE_BMC_CMC_Zellspannung_01_Messzeit
      SP_IF_BMC_CMC_Zellspannung_01_Messzeit_XIX_BMC_HV: upstream-reference=Geltungsbereich_E3_1_2_Premium.SP_IF_BMC_CMC_Zellspannung_01_Messzeit_XIX_BMC_HV, ecu-extract-reference=COMPOSITIONTYPE.SP_IF_BMC_CMC_Zellspannung_01_Messzeit_XIX_BMC_HV
      BMC_CMC_Zellspannung_020: upstream-reference=Geltungsbereich_E3_1_2_Premium.SP_IF_BMC_CMC_Zellspannung_020_XIX_BMC_HV.DE_BMC_CMC_Zellspannung_020, ecu-extract-reference=COMPOSITIONTYPE.SP_IF_BMC_CMC_Zellspannung_020_XIX_BMC_HV.DE_BMC_CMC_Zellspannung_020
      SP_IF_BMC_CMC_Zellspannung_020_XIX_BMC_HV: upstream-reference=Geltungsbereich_E3_1_2_Premium.SP_IF_BMC_CMC_Zellspannung_020_XIX_BMC_HV, ecu-extract-reference=COMPOSITIONTYPE.SP_IF_BMC_CMC_Zellspannung_020_XIX_BMC_HV
      BMC_CMC_Zellspannung_021: upstream-reference=Geltungsbereich_E3_1_2_Premium.SP_IF_BMC_CMC_Zellspannung_021_XIX_BMC_HV.DE_BMC_CMC_Zellspannung_021, ecu-extract-reference=COMPOSITIONTYPE.SP_IF_BMC_CMC_Zellspannung_021_XIX_BMC_HV.DE_BMC_CMC_Zellspannung_021
      SP_IF_BMC_CMC_Zellspannung_021_XIX_BMC_HV: upstream-reference=Geltungsbereich_E3_1_2_Premium.SP_IF_BMC_CMC_Zellspannung_021_XIX_BMC_HV, ecu-extract-reference=COMPOSITIONTYPE.SP_IF_BMC_CMC_Zellspannung_021_XIX_BMC_HV
      BMC_CMC_Zellspannung_022: upstream-reference=Geltungsbereich_E3_1_2_Premium.SP_IF_BMC_CMC_Zellspannung_022_XIX_BMC_HV.DE_BMC_CMC_Zellspannung_022, ecu-extract-reference=COMPOSITIONTYPE.SP_IF_BMC_CMC_Zellspannung_022_XIX_BMC_HV.DE_BMC_CMC_Zellspannung_022
      SP_IF_BMC_CMC_Zellspannung_022_XIX_BMC_HV: upstream-reference=Geltungsbereich_E3_1_2_Premium.SP_IF_BMC_CMC_Zellspannung_022_XIX_BMC_HV, ecu-extract-reference=COMPOSITIONTYPE.SP_IF_BMC_CMC_Zellspannung_022_XIX_BMC_HV
      BMC_CMC_Zellspannung_023: upstream-reference=Geltungsbereich_E3_1_2_Premium.SP_IF_BMC_CMC_Zellspannung_023_XIX_BMC_HV.DE_BMC_CMC_Zellspannung_023, ecu-extract-reference=COMPOSITIONTYPE.SP_IF_BMC_CMC_Zellspannung_023_XIX_BMC_HV.DE_BMC_CMC_Zellspannung_023
      SP_IF_BMC_CMC_Zellspannung_023_XIX_BMC_HV: upstream-reference=Geltungsbereich_E3_1_2_Premium.SP_IF_BMC_CMC_Zellspannung_023_XIX_BMC_HV, ecu-extract-reference=COMPOSITIONTYPE.SP_IF_BMC_CMC_Zellspannung_023_XIX_BMC_HV
      BMC_CMC_Zellspannung_024: upstream-reference=Geltungsbereich_E3_1_2_Premium.SP_IF_BMC_CMC_Zellspannung_024_XIX_BMC_HV.DE_BMC_CMC_Zellspannung_024, ecu-extract-reference=COMPOSITIONTYPE.SP_IF_BMC_CMC_Zellspannung_024_XIX_BMC_HV.DE_BMC_CMC_Zellspannung_024
      SP_IF_BMC_CMC_Zellspannung_024_XIX_BMC_HV: upstream-reference=Geltungsbereich_E3_1_2_Premium.SP_IF_BMC_CMC_Zellspannung_024_XIX_BMC_HV, ecu-extract-reference=COMPOSITIONTYPE.SP_IF_BMC_CMC_Zellspannung_024_XIX_BMC_HV
      BMC_CMC_Zellspannung_025: upstream-reference=Geltungsbereich_E3_1_2_Premium.SP_IF_BMC_CMC_Zellspannung_025_XIX_BMC_HV.DE_BMC_CMC_Zellspannung_025, ecu-extract-reference=COMPOSITIONTYPE.SP_IF_BMC_CMC_Zellspannung_025_XIX_BMC_HV.DE_BMC_CMC_Zellspannung_025
      SP_IF_BMC_CMC_Zellspannung_025_XIX_BMC_HV: upstream-reference=Geltungsbereich_E3_1_2_Premium.SP_IF_BMC_CMC_Zellspannung_025_XIX_BMC_HV, ecu-extract-reference=COMPOSITIONTYPE.SP_IF_BMC_CMC_Zellspannung_025_XIX_BMC_HV
      BMC_CMC_Zellspannung_026: upstream-reference=Geltungsbereich_E3_1_2_Premium.SP_IF_BMC_CMC_Zellspannung_026_XIX_BMC_HV.DE_BMC_CMC_Zellspannung_026, ecu-extract-reference=COMPOSITIONTYPE.SP_IF_BMC_CMC_Zellspannung_026_XIX_BMC_HV.DE_BMC_CMC_Zellspannung_026
      SP_IF_BMC_CMC_Zellspannung_026_XIX_BMC_HV: upstream-reference=Geltungsbereich_E3_1_2_Premium.SP_IF_BMC_CMC_Zellspannung_026_XIX_BMC_HV, ecu-extract-reference=COMPOSITIONTYPE.SP_IF_BMC_CMC_Zellspannung_026_XIX_BMC_HV
      BMC_CMC_Zellspannung_027: upstream-reference=Geltungsbereich_E3_1_2_Premium.SP_IF_BMC_CMC_Zellspannung_027_XIX_BMC_HV.DE_BMC_CMC_Zellspannung_027, ecu-extract-reference=COMPOSITIONTYPE.SP_IF_BMC_CMC_Zellspannung_027_XIX_BMC_HV.DE_BMC_CMC_Zellspannung_027
      SP_IF_BMC_CMC_Zellspannung_027_XIX_BMC_HV: upstream-reference=Geltungsbereich_E3_1_2_Premium.SP_IF_BMC_CMC_Zellspannung_027_XIX_BMC_HV, ecu-extract-reference=COMPOSITIONTYPE.SP_IF_BMC_CMC_Zellspannung_027_XIX_BMC_HV
      BMC_CMC_Zellspannung_028: upstream-reference=Geltungsbereich_E3_1_2_Premium.SP_IF_BMC_CMC_Zellspannung_028_XIX_BMC_HV.DE_BMC_CMC_Zellspannung_028, ecu-extract-reference=COMPOSITIONTYPE.SP_IF_BMC_CMC_Zellspannung_028_XIX_BMC_HV.DE_BMC_CMC_Zellspannung_028
      SP_IF_BMC_CMC_Zellspannung_028_XIX_BMC_HV: upstream-reference=Geltungsbereich_E3_1_2_Premium.SP_IF_BMC_CMC_Zellspannung_028_XIX_BMC_HV, ecu-extract-reference=COMPOSITIONTYPE.SP_IF_BMC_CMC_Zellspannung_028_XIX_BMC_HV
      BMC_CMC_Zellspannung_029: upstream-reference=Geltungsbereich_E3_1_2_Premium.SP_IF_BMC_CMC_Zellspannung_029_XIX_BMC_HV.DE_BMC_CMC_Zellspannung_029, ecu-extract-reference=COMPOSITIONTYPE.SP_IF_BMC_CMC_Zellspannung_029_XIX_BMC_HV.DE_BMC_CMC_Zellspannung_029
      SP_IF_BMC_CMC_Zellspannung_029_XIX_BMC_HV: upstream-reference=Geltungsbereich_E3_1_2_Premium.SP_IF_BMC_CMC_Zellspannung_029_XIX_BMC_HV, ecu-extract-reference=COMPOSITIONTYPE.SP_IF_BMC_CMC_Zellspannung_029_XIX_BMC_HV
      BMC_CMC_Zellspannung_02_Messzeit: upstream-reference=Geltungsbereich_E3_1_2_Premium.SP_IF_BMC_CMC_Zellspannung_02_Messzeit_XIX_BMC_HV.DE_BMC_CMC_Zellspannung_02_Messzeit, ecu-extract-reference=COMPOSITIONTYPE.SP_IF_BMC_CMC_Zellspannung_02_Messzeit_XIX_BMC_HV.DE_BMC_CMC_Zellspannung_02_Messzeit
      SP_IF_BMC_CMC_Zellspannung_02_Messzeit_XIX_BMC_HV: upstream-reference=Geltungsbereich_E3_1_2_Premium.SP_IF_BMC_CMC_Zellspannung_02_Messzeit_XIX_BMC_HV, ecu-extract-reference=COMPOSITIONTYPE.SP_IF_BMC_CMC_Zellspannung_02_Messzeit_XIX_BMC_HV
      BMC_CMC_Zellspannung_030: upstream-reference=Geltungsbereich_E3_1_2_Premium.SP_IF_BMC_CMC_Zellspannung_030_XIX_BMC_HV.DE_BMC_CMC_Zellspannung_030, ecu-extract-reference=COMPOSITIONTYPE.SP_IF_BMC_CMC_Zellspannung_030_XIX_BMC_HV.DE_BMC_CMC_Zellspannung_030
      SP_IF_BMC_CMC_Zellspannung_030_XIX_BMC_HV: upstream-reference=Geltungsbereich_E3_1_2_Premium.SP_IF_BMC_CMC_Zellspannung_030_XIX_BMC_HV, ecu-extract-reference=COMPOSITIONTYPE.SP_IF_BMC_CMC_Zellspannung_030_XIX_BMC_HV
      BMC_CMC_Zellspannung_031: upstream-reference=Geltungsbereich_E3_1_2_Premium.SP_IF_BMC_CMC_Zellspannung_031_XIX_BMC_HV.DE_BMC_CMC_Zellspannung_031, ecu-extract-reference=COMPOSITIONTYPE.SP_IF_BMC_CMC_Zellspannung_031_XIX_BMC_HV.DE_BMC_CMC_Zellspannung_031
      SP_IF_BMC_CMC_Zellspannung_031_XIX_BMC_HV: upstream-reference=Geltungsbereich_E3_1_2_Premium.SP_IF_BMC_CMC_Zellspannung_031_XIX_BMC_HV, ecu-extract-reference=COMPOSITIONTYPE.SP_IF_BMC_CMC_Zellspannung_031_XIX_BMC_HV
      BMC_CMC_Zellspannung_032: upstream-reference=Geltungsbereich_E3_1_2_Premium.SP_IF_BMC_CMC_Zellspannung_032_XIX_BMC_HV.DE_BMC_CMC_Zellspannung_032, ecu-extract-reference=COMPOSITIONTYPE.SP_IF_BMC_CMC_Zellspannung_032_XIX_BMC_HV.DE_BMC_CMC_Zellspannung_032
      SP_IF_BMC_CMC_Zellspannung_032_XIX_BMC_HV: upstream-reference=Geltungsbereich_E3_1_2_Premium.SP_IF_BMC_CMC_Zellspannung_032_XIX_BMC_HV, ecu-extract-reference=COMPOSITIONTYPE.SP_IF_BMC_CMC_Zellspannung_032_XIX_BMC_HV
      BMC_CMC_Zellspannung_033: upstream-reference=Geltungsbereich_E3_1_2_Premium.SP_IF_BMC_CMC_Zellspannung_033_XIX_BMC_HV.DE_BMC_CMC_Zellspannung_033, ecu-extract-reference=COMPOSITIONTYPE.SP_IF_BMC_CMC_Zellspannung_033_XIX_BMC_HV.DE_BMC_CMC_Zellspannung_033
      SP_IF_BMC_CMC_Zellspannung_033_XIX_BMC_HV: upstream-reference=Geltungsbereich_E3_1_2_Premium.SP_IF_BMC_CMC_Zellspannung_033_XIX_BMC_HV, ecu-extract-reference=COMPOSITIONTYPE.SP_IF_BMC_CMC_Zellspannung_033_XIX_BMC_HV
      BMC_CMC_Zellspannung_034: upstream-reference=Geltungsbereich_E3_1_2_Premium.SP_IF_BMC_CMC_Zellspannung_034_XIX_BMC_HV.DE_BMC_CMC_Zellspannung_034, ecu-extract-reference=COMPOSITIONTYPE.SP_IF_BMC_CMC_Zellspannung_034_XIX_BMC_HV.DE_BMC_CMC_Zellspannung_034
      SP_IF_BMC_CMC_Zellspannung_034_XIX_BMC_HV: upstream-reference=Geltungsbereich_E3_1_2_Premium.SP_IF_BMC_CMC_Zellspannung_034_XIX_BMC_HV, ecu-extract-reference=COMPOSITIONTYPE.SP_IF_BMC_CMC_Zellspannung_034_XIX_BMC_HV
      BMC_CMC_Zellspannung_035: upstream-reference=Geltungsbereich_E3_1_2_Premium.SP_IF_BMC_CMC_Zellspannung_035_XIX_BMC_HV.DE_BMC_CMC_Zellspannung_035, ecu-extract-reference=COMPOSITIONTYPE.SP_IF_BMC_CMC_Zellspannung_035_XIX_BMC_HV.DE_BMC_CMC_Zellspannung_035
      SP_IF_BMC_CMC_Zellspannung_035_XIX_BMC_HV: upstream-reference=Geltungsbereich_E3_1_2_Premium.SP_IF_BMC_CMC_Zellspannung_035_XIX_BMC_HV, ecu-extract-reference=COMPOSITIONTYPE.SP_IF_BMC_CMC_Zellspannung_035_XIX_BMC_HV
      BMC_CMC_Zellspannung_036: upstream-reference=Geltungsbereich_E3_1_2_Premium.SP_IF_BMC_CMC_Zellspannung_036_XIX_BMC_HV.DE_BMC_CMC_Zellspannung_036, ecu-extract-reference=COMPOSITIONTYPE.SP_IF_BMC_CMC_Zellspannung_036_XIX_BMC_HV.DE_BMC_CMC_Zellspannung_036
      SP_IF_BMC_CMC_Zellspannung_036_XIX_BMC_HV: upstream-reference=Geltungsbereich_E3_1_2_Premium.SP_IF_BMC_CMC_Zellspannung_036_XIX_BMC_HV, ecu-extract-reference=COMPOSITIONTYPE.SP_IF_BMC_CMC_Zellspannung_036_XIX_BMC_HV
      BMC_CMC_Zellspannung_037: upstream-reference=Geltungsbereich_E3_1_2_Premium.SP_IF_BMC_CMC_Zellspannung_037_XIX_BMC_HV.DE_BMC_CMC_Zellspannung_037, ecu-extract-reference=COMPOSITIONTYPE.SP_IF_BMC_CMC_Zellspannung_037_XIX_BMC_HV.DE_BMC_CMC_Zellspannung_037
      SP_IF_BMC_CMC_Zellspannung_037_XIX_BMC_HV: upstream-reference=Geltungsbereich_E3_1_2_Premium.SP_IF_BMC_CMC_Zellspannung_037_XIX_BMC_HV, ecu-extract-reference=COMPOSITIONTYPE.SP_IF_BMC_CMC_Zellspannung_037_XIX_BMC_HV
      BMC_CMC_Zellspannung_038: upstream-reference=Geltungsbereich_E3_1_2_Premium.SP_IF_BMC_CMC_Zellspannung_038_XIX_BMC_HV.DE_BMC_CMC_Zellspannung_038, ecu-extract-reference=COMPOSITIONTYPE.SP_IF_BMC_CMC_Zellspannung_038_XIX_BMC_HV.DE_BMC_CMC_Zellspannung_038
      SP_IF_BMC_CMC_Zellspannung_038_XIX_BMC_HV: upstream-reference=Geltungsbereich_E3_1_2_Premium.SP_IF_BMC_CMC_Zellspannung_038_XIX_BMC_HV, ecu-extract-reference=COMPOSITIONTYPE.SP_IF_BMC_CMC_Zellspannung_038_XIX_BMC_HV
      BMC_CMC_Zellspannung_039: upstream-reference=Geltungsbereich_E3_1_2_Premium.SP_IF_BMC_CMC_Zellspannung_039_XIX_BMC_HV.DE_BMC_CMC_Zellspannung_039, ecu-extract-reference=COMPOSITIONTYPE.SP_IF_BMC_CMC_Zellspannung_039_XIX_BMC_HV.DE_BMC_CMC_Zellspannung_039
      SP_IF_BMC_CMC_Zellspannung_039_XIX_BMC_HV: upstream-reference=Geltungsbereich_E3_1_2_Premium.SP_IF_BMC_CMC_Zellspannung_039_XIX_BMC_HV, ecu-extract-reference=COMPOSITIONTYPE.SP_IF_BMC_CMC_Zellspannung_039_XIX_BMC_HV
      BMC_CMC_Zellspannung_03_Messzeit: upstream-reference=Geltungsbereich_E3_1_2_Premium.SP_IF_BMC_CMC_Zellspannung_03_Messzeit_XIX_BMC_HV.DE_BMC_CMC_Zellspannung_03_Messzeit, ecu-extract-reference=COMPOSITIONTYPE.SP_IF_BMC_CMC_Zellspannung_03_Messzeit_XIX_BMC_HV.DE_BMC_CMC_Zellspannung_03_Messzeit
      SP_IF_BMC_CMC_Zellspannung_03_Messzeit_XIX_BMC_HV: upstream-reference=Geltungsbereich_E3_1_2_Premium.SP_IF_BMC_CMC_Zellspannung_03_Messzeit_XIX_BMC_HV, ecu-extract-reference=COMPOSITIONTYPE.SP_IF_BMC_CMC_Zellspannung_03_Messzeit_XIX_BMC_HV
      BMC_CMC_Zellspannung_040: upstream-reference=Geltungsbereich_E3_1_2_Premium.SP_IF_BMC_CMC_Zellspannung_040_XIX_BMC_HV.DE_BMC_CMC_Zellspannung_040, ecu-extract-reference=COMPOSITIONTYPE.SP_IF_BMC_CMC_Zellspannung_040_XIX_BMC_HV.DE_BMC_CMC_Zellspannung_040
      SP_IF_BMC_CMC_Zellspannung_040_XIX_BMC_HV: upstream-reference=Geltungsbereich_E3_1_2_Premium.SP_IF_BMC_CMC_Zellspannung_040_XIX_BMC_HV, ecu-extract-reference=COMPOSITIONTYPE.SP_IF_BMC_CMC_Zellspannung_040_XIX_BMC_HV
      BMC_CMC_Zellspannung_041: upstream-reference=Geltungsbereich_E3_1_2_Premium.SP_IF_BMC_CMC_Zellspannung_041_XIX_BMC_HV.DE_BMC_CMC_Zellspannung_041, ecu-extract-reference=COMPOSITIONTYPE.SP_IF_BMC_CMC_Zellspannung_041_XIX_BMC_HV.DE_BMC_CMC_Zellspannung_041
      SP_IF_BMC_CMC_Zellspannung_041_XIX_BMC_HV: upstream-reference=Geltungsbereich_E3_1_2_Premium.SP_IF_BMC_CMC_Zellspannung_041_XIX_BMC_HV, ecu-extract-reference=COMPOSITIONTYPE.SP_IF_BMC_CMC_Zellspannung_041_XIX_BMC_HV
      BMC_CMC_Zellspannung_042: upstream-reference=Geltungsbereich_E3_1_2_Premium.SP_IF_BMC_CMC_Zellspannung_042_XIX_BMC_HV.DE_BMC_CMC_Zellspannung_042, ecu-extract-reference=COMPOSITIONTYPE.SP_IF_BMC_CMC_Zellspannung_042_XIX_BMC_HV.DE_BMC_CMC_Zellspannung_042
      SP_IF_BMC_CMC_Zellspannung_042_XIX_BMC_HV: upstream-reference=Geltungsbereich_E3_1_2_Premium.SP_IF_BMC_CMC_Zellspannung_042_XIX_BMC_HV, ecu-extract-reference=COMPOSITIONTYPE.SP_IF_BMC_CMC_Zellspannung_042_XIX_BMC_HV
      BMC_CMC_Zellspannung_043: upstream-reference=Geltungsbereich_E3_1_2_Premium.SP_IF_BMC_CMC_Zellspannung_043_XIX_BMC_HV.DE_BMC_CMC_Zellspannung_043, ecu-extract-reference=COMPOSITIONTYPE.SP_IF_BMC_CMC_Zellspannung_043_XIX_BMC_HV.DE_BMC_CMC_Zellspannung_043
      SP_IF_BMC_CMC_Zellspannung_043_XIX_BMC_HV: upstream-reference=Geltungsbereich_E3_1_2_Premium.SP_IF_BMC_CMC_Zellspannung_043_XIX_BMC_HV, ecu-extract-reference=COMPOSITIONTYPE.SP_IF_BMC_CMC_Zellspannung_043_XIX_BMC_HV
      BMC_CMC_Zellspannung_044: upstream-reference=Geltungsbereich_E3_1_2_Premium.SP_IF_BMC_CMC_Zellspannung_044_XIX_BMC_HV.DE_BMC_CMC_Zellspannung_044, ecu-extract-reference=COMPOSITIONTYPE.SP_IF_BMC_CMC_Zellspannung_044_XIX_BMC_HV.DE_BMC_CMC_Zellspannung_044
      SP_IF_BMC_CMC_Zellspannung_044_XIX_BMC_HV: upstream-reference=Geltungsbereich_E3_1_2_Premium.SP_IF_BMC_CMC_Zellspannung_044_XIX_BMC_HV, ecu-extract-reference=COMPOSITIONTYPE.SP_IF_BMC_CMC_Zellspannung_044_XIX_BMC_HV
      BMC_CMC_Zellspannung_045: upstream-reference=Geltungsbereich_E3_1_2_Premium.SP_IF_BMC_CMC_Zellspannung_045_XIX_BMC_HV.DE_BMC_CMC_Zellspannung_045, ecu-extract-reference=COMPOSITIONTYPE.SP_IF_BMC_CMC_Zellspannung_045_XIX_BMC_HV.DE_BMC_CMC_Zellspannung_045
      SP_IF_BMC_CMC_Zellspannung_045_XIX_BMC_HV: upstream-reference=Geltungsbereich_E3_1_2_Premium.SP_IF_BMC_CMC_Zellspannung_045_XIX_BMC_HV, ecu-extract-reference=COMPOSITIONTYPE.SP_IF_BMC_CMC_Zellspannung_045_XIX_BMC_HV
      BMC_CMC_Zellspannung_046: upstream-reference=Geltungsbereich_E3_1_2_Premium.SP_IF_BMC_CMC_Zellspannung_046_XIX_BMC_HV.DE_BMC_CMC_Zellspannung_046, ecu-extract-reference=COMPOSITIONTYPE.SP_IF_BMC_CMC_Zellspannung_046_XIX_BMC_HV.DE_BMC_CMC_Zellspannung_046
      SP_IF_BMC_CMC_Zellspannung_046_XIX_BMC_HV: upstream-reference=Geltungsbereich_E3_1_2_Premium.SP_IF_BMC_CMC_Zellspannung_046_XIX_BMC_HV, ecu-extract-reference=COMPOSITIONTYPE.SP_IF_BMC_CMC_Zellspannung_046_XIX_BMC_HV
      BMC_CMC_Zellspannung_047: upstream-reference=Geltungsbereich_E3_1_2_Premium.SP_IF_BMC_CMC_Zellspannung_047_XIX_BMC_HV.DE_BMC_CMC_Zellspannung_047, ecu-extract-reference=COMPOSITIONTYPE.SP_IF_BMC_CMC_Zellspannung_047_XIX_BMC_HV.DE_BMC_CMC_Zellspannung_047
      SP_IF_BMC_CMC_Zellspannung_047_XIX_BMC_HV: upstream-reference=Geltungsbereich_E3_1_2_Premium.SP_IF_BMC_CMC_Zellspannung_047_XIX_BMC_HV, ecu-extract-reference=COMPOSITIONTYPE.SP_IF_BMC_CMC_Zellspannung_047_XIX_BMC_HV
      BMC_CMC_Zellspannung_048: upstream-reference=Geltungsbereich_E3_1_2_Premium.SP_IF_BMC_CMC_Zellspannung_048_XIX_BMC_HV.DE_BMC_CMC_Zellspannung_048, ecu-extract-reference=COMPOSITIONTYPE.SP_IF_BMC_CMC_Zellspannung_048_XIX_BMC_HV.DE_BMC_CMC_Zellspannung_048
      SP_IF_BMC_CMC_Zellspannung_048_XIX_BMC_HV: upstream-reference=Geltungsbereich_E3_1_2_Premium.SP_IF_BMC_CMC_Zellspannung_048_XIX_BMC_HV, ecu-extract-reference=COMPOSITIONTYPE.SP_IF_BMC_CMC_Zellspannung_048_XIX_BMC_HV
      BMC_CMC_Zellspannung_049: upstream-reference=Geltungsbereich_E3_1_2_Premium.SP_IF_BMC_CMC_Zellspannung_049_XIX_BMC_HV.DE_BMC_CMC_Zellspannung_049, ecu-extract-reference=COMPOSITIONTYPE.SP_IF_BMC_CMC_Zellspannung_049_XIX_BMC_HV.DE_BMC_CMC_Zellspannung_049
      SP_IF_BMC_CMC_Zellspannung_049_XIX_BMC_HV: upstream-reference=Geltungsbereich_E3_1_2_Premium.SP_IF_BMC_CMC_Zellspannung_049_XIX_BMC_HV, ecu-extract-reference=COMPOSITIONTYPE.SP_IF_BMC_CMC_Zellspannung_049_XIX_BMC_HV
      BMC_CMC_Zellspannung_04_Messzeit: upstream-reference=Geltungsbereich_E3_1_2_Premium.SP_IF_BMC_CMC_Zellspannung_04_Messzeit_XIX_BMC_HV.DE_BMC_CMC_Zellspannung_04_Messzeit, ecu-extract-reference=COMPOSITIONTYPE.SP_IF_BMC_CMC_Zellspannung_04_Messzeit_XIX_BMC_HV.DE_BMC_CMC_Zellspannung_04_Messzeit
      SP_IF_BMC_CMC_Zellspannung_04_Messzeit_XIX_BMC_HV: upstream-reference=Geltungsbereich_E3_1_2_Premium.SP_IF_BMC_CMC_Zellspannung_04_Messzeit_XIX_BMC_HV, ecu-extract-reference=COMPOSITIONTYPE.SP_IF_BMC_CMC_Zellspannung_04_Messzeit_XIX_BMC_HV
      BMC_CMC_Zellspannung_050: upstream-reference=Geltungsbereich_E3_1_2_Premium.SP_IF_BMC_CMC_Zellspannung_050_XIX_BMC_HV.DE_BMC_CMC_Zellspannung_050, ecu-extract-reference=COMPOSITIONTYPE.SP_IF_BMC_CMC_Zellspannung_050_XIX_BMC_HV.DE_BMC_CMC_Zellspannung_050
      SP_IF_BMC_CMC_Zellspannung_050_XIX_BMC_HV: upstream-reference=Geltungsbereich_E3_1_2_Premium.SP_IF_BMC_CMC_Zellspannung_050_XIX_BMC_HV, ecu-extract-reference=COMPOSITIONTYPE.SP_IF_BMC_CMC_Zellspannung_050_XIX_BMC_HV
      BMC_CMC_Zellspannung_051: upstream-reference=Geltungsbereich_E3_1_2_Premium.SP_IF_BMC_CMC_Zellspannung_051_XIX_BMC_HV.DE_BMC_CMC_Zellspannung_051, ecu-extract-reference=COMPOSITIONTYPE.SP_IF_BMC_CMC_Zellspannung_051_XIX_BMC_HV.DE_BMC_CMC_Zellspannung_051
      SP_IF_BMC_CMC_Zellspannung_051_XIX_BMC_HV: upstream-reference=Geltungsbereich_E3_1_2_Premium.SP_IF_BMC_CMC_Zellspannung_051_XIX_BMC_HV, ecu-extract-reference=COMPOSITIONTYPE.SP_IF_BMC_CMC_Zellspannung_051_XIX_BMC_HV
      BMC_CMC_Zellspannung_052: upstream-reference=Geltungsbereich_E3_1_2_Premium.SP_IF_BMC_CMC_Zellspannung_052_XIX_BMC_HV.DE_BMC_CMC_Zellspannung_052, ecu-extract-reference=COMPOSITIONTYPE.SP_IF_BMC_CMC_Zellspannung_052_XIX_BMC_HV.DE_BMC_CMC_Zellspannung_052
      SP_IF_BMC_CMC_Zellspannung_052_XIX_BMC_HV: upstream-reference=Geltungsbereich_E3_1_2_Premium.SP_IF_BMC_CMC_Zellspannung_052_XIX_BMC_HV, ecu-extract-reference=COMPOSITIONTYPE.SP_IF_BMC_CMC_Zellspannung_052_XIX_BMC_HV
      BMC_CMC_Zellspannung_053: upstream-reference=Geltungsbereich_E3_1_2_Premium.SP_IF_BMC_CMC_Zellspannung_053_XIX_BMC_HV.DE_BMC_CMC_Zellspannung_053, ecu-extract-reference=COMPOSITIONTYPE.SP_IF_BMC_CMC_Zellspannung_053_XIX_BMC_HV.DE_BMC_CMC_Zellspannung_053
      SP_IF_BMC_CMC_Zellspannung_053_XIX_BMC_HV: upstream-reference=Geltungsbereich_E3_1_2_Premium.SP_IF_BMC_CMC_Zellspannung_053_XIX_BMC_HV, ecu-extract-reference=COMPOSITIONTYPE.SP_IF_BMC_CMC_Zellspannung_053_XIX_BMC_HV
      BMC_CMC_Zellspannung_054: upstream-reference=Geltungsbereich_E3_1_2_Premium.SP_IF_BMC_CMC_Zellspannung_054_XIX_BMC_HV.DE_BMC_CMC_Zellspannung_054, ecu-extract-reference=COMPOSITIONTYPE.SP_IF_BMC_CMC_Zellspannung_054_XIX_BMC_HV.DE_BMC_CMC_Zellspannung_054
      SP_IF_BMC_CMC_Zellspannung_054_XIX_BMC_HV: upstream-reference=Geltungsbereich_E3_1_2_Premium.SP_IF_BMC_CMC_Zellspannung_054_XIX_BMC_HV, ecu-extract-reference=COMPOSITIONTYPE.SP_IF_BMC_CMC_Zellspannung_054_XIX_BMC_HV
      BMC_CMC_Zellspannung_055: upstream-reference=Geltungsbereich_E3_1_2_Premium.SP_IF_BMC_CMC_Zellspannung_055_XIX_BMC_HV.DE_BMC_CMC_Zellspannung_055, ecu-extract-reference=COMPOSITIONTYPE.SP_IF_BMC_CMC_Zellspannung_055_XIX_BMC_HV.DE_BMC_CMC_Zellspannung_055
      SP_IF_BMC_CMC_Zellspannung_055_XIX_BMC_HV: upstream-reference=Geltungsbereich_E3_1_2_Premium.SP_IF_BMC_CMC_Zellspannung_055_XIX_BMC_HV, ecu-extract-reference=COMPOSITIONTYPE.SP_IF_BMC_CMC_Zellspannung_055_XIX_BMC_HV
      BMC_CMC_Zellspannung_056: upstream-reference=Geltungsbereich_E3_1_2_Premium.SP_IF_BMC_CMC_Zellspannung_056_XIX_BMC_HV.DE_BMC_CMC_Zellspannung_056, ecu-extract-reference=COMPOSITIONTYPE.SP_IF_BMC_CMC_Zellspannung_056_XIX_BMC_HV.DE_BMC_CMC_Zellspannung_056
      SP_IF_BMC_CMC_Zellspannung_056_XIX_BMC_HV: upstream-reference=Geltungsbereich_E3_1_2_Premium.SP_IF_BMC_CMC_Zellspannung_056_XIX_BMC_HV, ecu-extract-reference=COMPOSITIONTYPE.SP_IF_BMC_CMC_Zellspannung_056_XIX_BMC_HV
      BMC_CMC_Zellspannung_057: upstream-reference=Geltungsbereich_E3_1_2_Premium.SP_IF_BMC_CMC_Zellspannung_057_XIX_BMC_HV.DE_BMC_CMC_Zellspannung_057, ecu-extract-reference=COMPOSITIONTYPE.SP_IF_BMC_CMC_Zellspannung_057_XIX_BMC_HV.DE_BMC_CMC_Zellspannung_057
      SP_IF_BMC_CMC_Zellspannung_057_XIX_BMC_HV: upstream-reference=Geltungsbereich_E3_1_2_Premium.SP_IF_BMC_CMC_Zellspannung_057_XIX_BMC_HV, ecu-extract-reference=COMPOSITIONTYPE.SP_IF_BMC_CMC_Zellspannung_057_XIX_BMC_HV
      BMC_CMC_Zellspannung_058: upstream-reference=Geltungsbereich_E3_1_2_Premium.SP_IF_BMC_CMC_Zellspannung_058_XIX_BMC_HV.DE_BMC_CMC_Zellspannung_058, ecu-extract-reference=COMPOSITIONTYPE.SP_IF_BMC_CMC_Zellspannung_058_XIX_BMC_HV.DE_BMC_CMC_Zellspannung_058
      SP_IF_BMC_CMC_Zellspannung_058_XIX_BMC_HV: upstream-reference=Geltungsbereich_E3_1_2_Premium.SP_IF_BMC_CMC_Zellspannung_058_XIX_BMC_HV, ecu-extract-reference=COMPOSITIONTYPE.SP_IF_BMC_CMC_Zellspannung_058_XIX_BMC_HV
      BMC_CMC_Zellspannung_059: upstream-reference=Geltungsbereich_E3_1_2_Premium.SP_IF_BMC_CMC_Zellspannung_059_XIX_BMC_HV.DE_BMC_CMC_Zellspannung_059, ecu-extract-reference=COMPOSITIONTYPE.SP_IF_BMC_CMC_Zellspannung_059_XIX_BMC_HV.DE_BMC_CMC_Zellspannung_059
      SP_IF_BMC_CMC_Zellspannung_059_XIX_BMC_HV: upstream-reference=Geltungsbereich_E3_1_2_Premium.SP_IF_BMC_CMC_Zellspannung_059_XIX_BMC_HV, ecu-extract-reference=COMPOSITIONTYPE.SP_IF_BMC_CMC_Zellspannung_059_XIX_BMC_HV
      BMC_CMC_Zellspannung_05_Messzeit: upstream-reference=Geltungsbereich_E3_1_2_Premium.SP_IF_BMC_CMC_Zellspannung_05_Messzeit_XIX_BMC_HV.DE_BMC_CMC_Zellspannung_05_Messzeit, ecu-extract-reference=COMPOSITIONTYPE.SP_IF_BMC_CMC_Zellspannung_05_Messzeit_XIX_BMC_HV.DE_BMC_CMC_Zellspannung_05_Messzeit
      SP_IF_BMC_CMC_Zellspannung_05_Messzeit_XIX_BMC_HV: upstream-reference=Geltungsbereich_E3_1_2_Premium.SP_IF_BMC_CMC_Zellspannung_05_Messzeit_XIX_BMC_HV, ecu-extract-reference=COMPOSITIONTYPE.SP_IF_BMC_CMC_Zellspannung_05_Messzeit_XIX_BMC_HV
      BMC_CMC_Zellspannung_060: upstream-reference=Geltungsbereich_E3_1_2_Premium.SP_IF_BMC_CMC_Zellspannung_060_XIX_BMC_HV.DE_BMC_CMC_Zellspannung_060, ecu-extract-reference=COMPOSITIONTYPE.SP_IF_BMC_CMC_Zellspannung_060_XIX_BMC_HV.DE_BMC_CMC_Zellspannung_060
      SP_IF_BMC_CMC_Zellspannung_060_XIX_BMC_HV: upstream-reference=Geltungsbereich_E3_1_2_Premium.SP_IF_BMC_CMC_Zellspannung_060_XIX_BMC_HV, ecu-extract-reference=COMPOSITIONTYPE.SP_IF_BMC_CMC_Zellspannung_060_XIX_BMC_HV
      BMC_CMC_Zellspannung_061: upstream-reference=Geltungsbereich_E3_1_2_Premium.SP_IF_BMC_CMC_Zellspannung_061_XIX_BMC_HV.DE_BMC_CMC_Zellspannung_061, ecu-extract-reference=COMPOSITIONTYPE.SP_IF_BMC_CMC_Zellspannung_061_XIX_BMC_HV.DE_BMC_CMC_Zellspannung_061
      SP_IF_BMC_CMC_Zellspannung_061_XIX_BMC_HV: upstream-reference=Geltungsbereich_E3_1_2_Premium.SP_IF_BMC_CMC_Zellspannung_061_XIX_BMC_HV, ecu-extract-reference=COMPOSITIONTYPE.SP_IF_BMC_CMC_Zellspannung_061_XIX_BMC_HV
      BMC_CMC_Zellspannung_062: upstream-reference=Geltungsbereich_E3_1_2_Premium.SP_IF_BMC_CMC_Zellspannung_062_XIX_BMC_HV.DE_BMC_CMC_Zellspannung_062, ecu-extract-reference=COMPOSITIONTYPE.SP_IF_BMC_CMC_Zellspannung_062_XIX_BMC_HV.DE_BMC_CMC_Zellspannung_062
      SP_IF_BMC_CMC_Zellspannung_062_XIX_BMC_HV: upstream-reference=Geltungsbereich_E3_1_2_Premium.SP_IF_BMC_CMC_Zellspannung_062_XIX_BMC_HV, ecu-extract-reference=COMPOSITIONTYPE.SP_IF_BMC_CMC_Zellspannung_062_XIX_BMC_HV
      BMC_CMC_Zellspannung_063: upstream-reference=Geltungsbereich_E3_1_2_Premium.SP_IF_BMC_CMC_Zellspannung_063_XIX_BMC_HV.DE_BMC_CMC_Zellspannung_063, ecu-extract-reference=COMPOSITIONTYPE.SP_IF_BMC_CMC_Zellspannung_063_XIX_BMC_HV.DE_BMC_CMC_Zellspannung_063
      SP_IF_BMC_CMC_Zellspannung_063_XIX_BMC_HV: upstream-reference=Geltungsbereich_E3_1_2_Premium.SP_IF_BMC_CMC_Zellspannung_063_XIX_BMC_HV, ecu-extract-reference=COMPOSITIONTYPE.SP_IF_BMC_CMC_Zellspannung_063_XIX_BMC_HV
      BMC_CMC_Zellspannung_064: upstream-reference=Geltungsbereich_E3_1_2_Premium.SP_IF_BMC_CMC_Zellspannung_064_XIX_BMC_HV.DE_BMC_CMC_Zellspannung_064, ecu-extract-reference=COMPOSITIONTYPE.SP_IF_BMC_CMC_Zellspannung_064_XIX_BMC_HV.DE_BMC_CMC_Zellspannung_064
      SP_IF_BMC_CMC_Zellspannung_064_XIX_BMC_HV: upstream-reference=Geltungsbereich_E3_1_2_Premium.SP_IF_BMC_CMC_Zellspannung_064_XIX_BMC_HV, ecu-extract-reference=COMPOSITIONTYPE.SP_IF_BMC_CMC_Zellspannung_064_XIX_BMC_HV
      BMC_CMC_Zellspannung_065: upstream-reference=Geltungsbereich_E3_1_2_Premium.SP_IF_BMC_CMC_Zellspannung_065_XIX_BMC_HV.DE_BMC_CMC_Zellspannung_065, ecu-extract-reference=COMPOSITIONTYPE.SP_IF_BMC_CMC_Zellspannung_065_XIX_BMC_HV.DE_BMC_CMC_Zellspannung_065
      SP_IF_BMC_CMC_Zellspannung_065_XIX_BMC_HV: upstream-reference=Geltungsbereich_E3_1_2_Premium.SP_IF_BMC_CMC_Zellspannung_065_XIX_BMC_HV, ecu-extract-reference=COMPOSITIONTYPE.SP_IF_BMC_CMC_Zellspannung_065_XIX_BMC_HV
      BMC_CMC_Zellspannung_066: upstream-reference=Geltungsbereich_E3_1_2_Premium.SP_IF_BMC_CMC_Zellspannung_066_XIX_BMC_HV.DE_BMC_CMC_Zellspannung_066, ecu-extract-reference=COMPOSITIONTYPE.SP_IF_BMC_CMC_Zellspannung_066_XIX_BMC_HV.DE_BMC_CMC_Zellspannung_066
      SP_IF_BMC_CMC_Zellspannung_066_XIX_BMC_HV: upstream-reference=Geltungsbereich_E3_1_2_Premium.SP_IF_BMC_CMC_Zellspannung_066_XIX_BMC_HV, ecu-extract-reference=COMPOSITIONTYPE.SP_IF_BMC_CMC_Zellspannung_066_XIX_BMC_HV
      BMC_CMC_Zellspannung_067: upstream-reference=Geltungsbereich_E3_1_2_Premium.SP_IF_BMC_CMC_Zellspannung_067_XIX_BMC_HV.DE_BMC_CMC_Zellspannung_067, ecu-extract-reference=COMPOSITIONTYPE.SP_IF_BMC_CMC_Zellspannung_067_XIX_BMC_HV.DE_BMC_CMC_Zellspannung_067
      SP_IF_BMC_CMC_Zellspannung_067_XIX_BMC_HV: upstream-reference=Geltungsbereich_E3_1_2_Premium.SP_IF_BMC_CMC_Zellspannung_067_XIX_BMC_HV, ecu-extract-reference=COMPOSITIONTYPE.SP_IF_BMC_CMC_Zellspannung_067_XIX_BMC_HV
      BMC_CMC_Zellspannung_068: upstream-reference=Geltungsbereich_E3_1_2_Premium.SP_IF_BMC_CMC_Zellspannung_068_XIX_BMC_HV.DE_BMC_CMC_Zellspannung_068, ecu-extract-reference=COMPOSITIONTYPE.SP_IF_BMC_CMC_Zellspannung_068_XIX_BMC_HV.DE_BMC_CMC_Zellspannung_068
      SP_IF_BMC_CMC_Zellspannung_068_XIX_BMC_HV: upstream-reference=Geltungsbereich_E3_1_2_Premium.SP_IF_BMC_CMC_Zellspannung_068_XIX_BMC_HV, ecu-extract-reference=COMPOSITIONTYPE.SP_IF_BMC_CMC_Zellspannung_068_XIX_BMC_HV
      BMC_CMC_Zellspannung_069: upstream-reference=Geltungsbereich_E3_1_2_Premium.SP_IF_BMC_CMC_Zellspannung_069_XIX_BMC_HV.DE_BMC_CMC_Zellspannung_069, ecu-extract-reference=COMPOSITIONTYPE.SP_IF_BMC_CMC_Zellspannung_069_XIX_BMC_HV.DE_BMC_CMC_Zellspannung_069
      SP_IF_BMC_CMC_Zellspannung_069_XIX_BMC_HV: upstream-reference=Geltungsbereich_E3_1_2_Premium.SP_IF_BMC_CMC_Zellspannung_069_XIX_BMC_HV, ecu-extract-reference=COMPOSITIONTYPE.SP_IF_BMC_CMC_Zellspannung_069_XIX_BMC_HV
      BMC_CMC_Zellspannung_070: upstream-reference=Geltungsbereich_E3_1_2_Premium.SP_IF_BMC_CMC_Zellspannung_070_XIX_BMC_HV.DE_BMC_CMC_Zellspannung_070, ecu-extract-reference=COMPOSITIONTYPE.SP_IF_BMC_CMC_Zellspannung_070_XIX_BMC_HV.DE_BMC_CMC_Zellspannung_070
      SP_IF_BMC_CMC_Zellspannung_070_XIX_BMC_HV: upstream-reference=Geltungsbereich_E3_1_2_Premium.SP_IF_BMC_CMC_Zellspannung_070_XIX_BMC_HV, ecu-extract-reference=COMPOSITIONTYPE.SP_IF_BMC_CMC_Zellspannung_070_XIX_BMC_HV
      BMC_CMC_Zellspannung_071: upstream-reference=Geltungsbereich_E3_1_2_Premium.SP_IF_BMC_CMC_Zellspannung_071_XIX_BMC_HV.DE_BMC_CMC_Zellspannung_071, ecu-extract-reference=COMPOSITIONTYPE.SP_IF_BMC_CMC_Zellspannung_071_XIX_BMC_HV.DE_BMC_CMC_Zellspannung_071
      SP_IF_BMC_CMC_Zellspannung_071_XIX_BMC_HV: upstream-reference=Geltungsbereich_E3_1_2_Premium.SP_IF_BMC_CMC_Zellspannung_071_XIX_BMC_HV, ecu-extract-reference=COMPOSITIONTYPE.SP_IF_BMC_CMC_Zellspannung_071_XIX_BMC_HV
      BMC_CMC_Zellspannung_072: upstream-reference=Geltungsbereich_E3_1_2_Premium.SP_IF_BMC_CMC_Zellspannung_072_XIX_BMC_HV.DE_BMC_CMC_Zellspannung_072, ecu-extract-reference=COMPOSITIONTYPE.SP_IF_BMC_CMC_Zellspannung_072_XIX_BMC_HV.DE_BMC_CMC_Zellspannung_072
      SP_IF_BMC_CMC_Zellspannung_072_XIX_BMC_HV: upstream-reference=Geltungsbereich_E3_1_2_Premium.SP_IF_BMC_CMC_Zellspannung_072_XIX_BMC_HV, ecu-extract-reference=COMPOSITIONTYPE.SP_IF_BMC_CMC_Zellspannung_072_XIX_BMC_HV
      BMC_CMC_Zellspannung_073: upstream-reference=Geltungsbereich_E3_1_2_Premium.SP_IF_BMC_CMC_Zellspannung_073_XIX_BMC_HV.DE_BMC_CMC_Zellspannung_073, ecu-extract-reference=COMPOSITIONTYPE.SP_IF_BMC_CMC_Zellspannung_073_XIX_BMC_HV.DE_BMC_CMC_Zellspannung_073
      SP_IF_BMC_CMC_Zellspannung_073_XIX_BMC_HV: upstream-reference=Geltungsbereich_E3_1_2_Premium.SP_IF_BMC_CMC_Zellspannung_073_XIX_BMC_HV, ecu-extract-reference=COMPOSITIONTYPE.SP_IF_BMC_CMC_Zellspannung_073_XIX_BMC_HV
      BMC_CMC_Zellspannung_074: upstream-reference=Geltungsbereich_E3_1_2_Premium.SP_IF_BMC_CMC_Zellspannung_074_XIX_BMC_HV.DE_BMC_CMC_Zellspannung_074, ecu-extract-reference=COMPOSITIONTYPE.SP_IF_BMC_CMC_Zellspannung_074_XIX_BMC_HV.DE_BMC_CMC_Zellspannung_074
      SP_IF_BMC_CMC_Zellspannung_074_XIX_BMC_HV: upstream-reference=Geltungsbereich_E3_1_2_Premium.SP_IF_BMC_CMC_Zellspannung_074_XIX_BMC_HV, ecu-extract-reference=COMPOSITIONTYPE.SP_IF_BMC_CMC_Zellspannung_074_XIX_BMC_HV
      BMC_CMC_Zellspannung_075: upstream-reference=Geltungsbereich_E3_1_2_Premium.SP_IF_BMC_CMC_Zellspannung_075_XIX_BMC_HV.DE_BMC_CMC_Zellspannung_075, ecu-extract-reference=COMPOSITIONTYPE.SP_IF_BMC_CMC_Zellspannung_075_XIX_BMC_HV.DE_BMC_CMC_Zellspannung_075
      SP_IF_BMC_CMC_Zellspannung_075_XIX_BMC_HV: upstream-reference=Geltungsbereich_E3_1_2_Premium.SP_IF_BMC_CMC_Zellspannung_075_XIX_BMC_HV, ecu-extract-reference=COMPOSITIONTYPE.SP_IF_BMC_CMC_Zellspannung_075_XIX_BMC_HV
      BMC_CMC_Zellspannung_076: upstream-reference=Geltungsbereich_E3_1_2_Premium.SP_IF_BMC_CMC_Zellspannung_076_XIX_BMC_HV.DE_BMC_CMC_Zellspannung_076, ecu-extract-reference=COMPOSITIONTYPE.SP_IF_BMC_CMC_Zellspannung_076_XIX_BMC_HV.DE_BMC_CMC_Zellspannung_076
      SP_IF_BMC_CMC_Zellspannung_076_XIX_BMC_HV: upstream-reference=Geltungsbereich_E3_1_2_Premium.SP_IF_BMC_CMC_Zellspannung_076_XIX_BMC_HV, ecu-extract-reference=COMPOSITIONTYPE.SP_IF_BMC_CMC_Zellspannung_076_XIX_BMC_HV
      BMC_CMC_Zellspannung_077: upstream-reference=Geltungsbereich_E3_1_2_Premium.SP_IF_BMC_CMC_Zellspannung_077_XIX_BMC_HV.DE_BMC_CMC_Zellspannung_077, ecu-extract-reference=COMPOSITIONTYPE.SP_IF_BMC_CMC_Zellspannung_077_XIX_BMC_HV.DE_BMC_CMC_Zellspannung_077
      SP_IF_BMC_CMC_Zellspannung_077_XIX_BMC_HV: upstream-reference=Geltungsbereich_E3_1_2_Premium.SP_IF_BMC_CMC_Zellspannung_077_XIX_BMC_HV, ecu-extract-reference=COMPOSITIONTYPE.SP_IF_BMC_CMC_Zellspannung_077_XIX_BMC_HV
      BMC_CMC_Zellspannung_078: upstream-reference=Geltungsbereich_E3_1_2_Premium.SP_IF_BMC_CMC_Zellspannung_078_XIX_BMC_HV.DE_BMC_CMC_Zellspannung_078, ecu-extract-reference=COMPOSITIONTYPE.SP_IF_BMC_CMC_Zellspannung_078_XIX_BMC_HV.DE_BMC_CMC_Zellspannung_078
      SP_IF_BMC_CMC_Zellspannung_078_XIX_BMC_HV: upstream-reference=Geltungsbereich_E3_1_2_Premium.SP_IF_BMC_CMC_Zellspannung_078_XIX_BMC_HV, ecu-extract-reference=COMPOSITIONTYPE.SP_IF_BMC_CMC_Zellspannung_078_XIX_BMC_HV
      BMC_CMC_Zellspannung_079: upstream-reference=Geltungsbereich_E3_1_2_Premium.SP_IF_BMC_CMC_Zellspannung_079_XIX_BMC_HV.DE_BMC_CMC_Zellspannung_079, ecu-extract-reference=COMPOSITIONTYPE.SP_IF_BMC_CMC_Zellspannung_079_XIX_BMC_HV.DE_BMC_CMC_Zellspannung_079
      SP_IF_BMC_CMC_Zellspannung_079_XIX_BMC_HV: upstream-reference=Geltungsbereich_E3_1_2_Premium.SP_IF_BMC_CMC_Zellspannung_079_XIX_BMC_HV, ecu-extract-reference=COMPOSITIONTYPE.SP_IF_BMC_CMC_Zellspannung_079_XIX_BMC_HV
      BMC_CMC_Zellspannung_080: upstream-reference=Geltungsbereich_E3_1_2_Premium.SP_IF_BMC_CMC_Zellspannung_080_XIX_BMC_HV.DE_BMC_CMC_Zellspannung_080, ecu-extract-reference=COMPOSITIONTYPE.SP_IF_BMC_CMC_Zellspannung_080_XIX_BMC_HV.DE_BMC_CMC_Zellspannung_080
      SP_IF_BMC_CMC_Zellspannung_080_XIX_BMC_HV: upstream-reference=Geltungsbereich_E3_1_2_Premium.SP_IF_BMC_CMC_Zellspannung_080_XIX_BMC_HV, ecu-extract-reference=COMPOSITIONTYPE.SP_IF_BMC_CMC_Zellspannung_080_XIX_BMC_HV
      BMC_CMC_Zellspannung_081: upstream-reference=Geltungsbereich_E3_1_2_Premium.SP_IF_BMC_CMC_Zellspannung_081_XIX_BMC_HV.DE_BMC_CMC_Zellspannung_081, ecu-extract-reference=COMPOSITIONTYPE.SP_IF_BMC_CMC_Zellspannung_081_XIX_BMC_HV.DE_BMC_CMC_Zellspannung_081
      SP_IF_BMC_CMC_Zellspannung_081_XIX_BMC_HV: upstream-reference=Geltungsbereich_E3_1_2_Premium.SP_IF_BMC_CMC_Zellspannung_081_XIX_BMC_HV, ecu-extract-reference=COMPOSITIONTYPE.SP_IF_BMC_CMC_Zellspannung_081_XIX_BMC_HV
      BMC_CMC_Zellspannung_082: upstream-reference=Geltungsbereich_E3_1_2_Premium.SP_IF_BMC_CMC_Zellspannung_082_XIX_BMC_HV.DE_BMC_CMC_Zellspannung_082, ecu-extract-reference=COMPOSITIONTYPE.SP_IF_BMC_CMC_Zellspannung_082_XIX_BMC_HV.DE_BMC_CMC_Zellspannung_082
      SP_IF_BMC_CMC_Zellspannung_082_XIX_BMC_HV: upstream-reference=Geltungsbereich_E3_1_2_Premium.SP_IF_BMC_CMC_Zellspannung_082_XIX_BMC_HV, ecu-extract-reference=COMPOSITIONTYPE.SP_IF_BMC_CMC_Zellspannung_082_XIX_BMC_HV
      BMC_CMC_Zellspannung_083: upstream-reference=Geltungsbereich_E3_1_2_Premium.SP_IF_BMC_CMC_Zellspannung_083_XIX_BMC_HV.DE_BMC_CMC_Zellspannung_083, ecu-extract-reference=COMPOSITIONTYPE.SP_IF_BMC_CMC_Zellspannung_083_XIX_BMC_HV.DE_BMC_CMC_Zellspannung_083
      SP_IF_BMC_CMC_Zellspannung_083_XIX_BMC_HV: upstream-reference=Geltungsbereich_E3_1_2_Premium.SP_IF_BMC_CMC_Zellspannung_083_XIX_BMC_HV, ecu-extract-reference=COMPOSITIONTYPE.SP_IF_BMC_CMC_Zellspannung_083_XIX_BMC_HV
      BMC_CMC_Zellspannung_084: upstream-reference=Geltungsbereich_E3_1_2_Premium.SP_IF_BMC_CMC_Zellspannung_084_XIX_BMC_HV.DE_BMC_CMC_Zellspannung_084, ecu-extract-reference=COMPOSITIONTYPE.SP_IF_BMC_CMC_Zellspannung_084_XIX_BMC_HV.DE_BMC_CMC_Zellspannung_084
      SP_IF_BMC_CMC_Zellspannung_084_XIX_BMC_HV: upstream-reference=Geltungsbereich_E3_1_2_Premium.SP_IF_BMC_CMC_Zellspannung_084_XIX_BMC_HV, ecu-extract-reference=COMPOSITIONTYPE.SP_IF_BMC_CMC_Zellspannung_084_XIX_BMC_HV
      BMC_CMC_Zellspannung_085: upstream-reference=Geltungsbereich_E3_1_2_Premium.SP_IF_BMC_CMC_Zellspannung_085_XIX_BMC_HV.DE_BMC_CMC_Zellspannung_085, ecu-extract-reference=COMPOSITIONTYPE.SP_IF_BMC_CMC_Zellspannung_085_XIX_BMC_HV.DE_BMC_CMC_Zellspannung_085
      SP_IF_BMC_CMC_Zellspannung_085_XIX_BMC_HV: upstream-reference=Geltungsbereich_E3_1_2_Premium.SP_IF_BMC_CMC_Zellspannung_085_XIX_BMC_HV, ecu-extract-reference=COMPOSITIONTYPE.SP_IF_BMC_CMC_Zellspannung_085_XIX_BMC_HV
      BMC_CMC_Zellspannung_086: upstream-reference=Geltungsbereich_E3_1_2_Premium.SP_IF_BMC_CMC_Zellspannung_086_XIX_BMC_HV.DE_BMC_CMC_Zellspannung_086, ecu-extract-reference=COMPOSITIONTYPE.SP_IF_BMC_CMC_Zellspannung_086_XIX_BMC_HV.DE_BMC_CMC_Zellspannung_086
      SP_IF_BMC_CMC_Zellspannung_086_XIX_BMC_HV: upstream-reference=Geltungsbereich_E3_1_2_Premium.SP_IF_BMC_CMC_Zellspannung_086_XIX_BMC_HV, ecu-extract-reference=COMPOSITIONTYPE.SP_IF_BMC_CMC_Zellspannung_086_XIX_BMC_HV
      BMC_CMC_Zellspannung_087: upstream-reference=Geltungsbereich_E3_1_2_Premium.SP_IF_BMC_CMC_Zellspannung_087_XIX_BMC_HV.DE_BMC_CMC_Zellspannung_087, ecu-extract-reference=COMPOSITIONTYPE.SP_IF_BMC_CMC_Zellspannung_087_XIX_BMC_HV.DE_BMC_CMC_Zellspannung_087
      SP_IF_BMC_CMC_Zellspannung_087_XIX_BMC_HV: upstream-reference=Geltungsbereich_E3_1_2_Premium.SP_IF_BMC_CMC_Zellspannung_087_XIX_BMC_HV, ecu-extract-reference=COMPOSITIONTYPE.SP_IF_BMC_CMC_Zellspannung_087_XIX_BMC_HV
      BMC_CMC_Zellspannung_088: upstream-reference=Geltungsbereich_E3_1_2_Premium.SP_IF_BMC_CMC_Zellspannung_088_XIX_BMC_HV.DE_BMC_CMC_Zellspannung_088, ecu-extract-reference=COMPOSITIONTYPE.SP_IF_BMC_CMC_Zellspannung_088_XIX_BMC_HV.DE_BMC_CMC_Zellspannung_088
      SP_IF_BMC_CMC_Zellspannung_088_XIX_BMC_HV: upstream-reference=Geltungsbereich_E3_1_2_Premium.SP_IF_BMC_CMC_Zellspannung_088_XIX_BMC_HV, ecu-extract-reference=COMPOSITIONTYPE.SP_IF_BMC_CMC_Zellspannung_088_XIX_BMC_HV
      BMC_CMC_Zellspannung_089: upstream-reference=Geltungsbereich_E3_1_2_Premium.SP_IF_BMC_CMC_Zellspannung_089_XIX_BMC_HV.DE_BMC_CMC_Zellspannung_089, ecu-extract-reference=COMPOSITIONTYPE.SP_IF_BMC_CMC_Zellspannung_089_XIX_BMC_HV.DE_BMC_CMC_Zellspannung_089
      SP_IF_BMC_CMC_Zellspannung_089_XIX_BMC_HV: upstream-reference=Geltungsbereich_E3_1_2_Premium.SP_IF_BMC_CMC_Zellspannung_089_XIX_BMC_HV, ecu-extract-reference=COMPOSITIONTYPE.SP_IF_BMC_CMC_Zellspannung_089_XIX_BMC_HV
      BMC_CMC_Zellspannung_090: upstream-reference=Geltungsbereich_E3_1_2_Premium.SP_IF_BMC_CMC_Zellspannung_090_XIX_BMC_HV.DE_BMC_CMC_Zellspannung_090, ecu-extract-reference=COMPOSITIONTYPE.SP_IF_BMC_CMC_Zellspannung_090_XIX_BMC_HV.DE_BMC_CMC_Zellspannung_090
      SP_IF_BMC_CMC_Zellspannung_090_XIX_BMC_HV: upstream-reference=Geltungsbereich_E3_1_2_Premium.SP_IF_BMC_CMC_Zellspannung_090_XIX_BMC_HV, ecu-extract-reference=COMPOSITIONTYPE.SP_IF_BMC_CMC_Zellspannung_090_XIX_BMC_HV
      BMC_CMC_Zellspannung_091: upstream-reference=Geltungsbereich_E3_1_2_Premium.SP_IF_BMC_CMC_Zellspannung_091_XIX_BMC_HV.DE_BMC_CMC_Zellspannung_091, ecu-extract-reference=COMPOSITIONTYPE.SP_IF_BMC_CMC_Zellspannung_091_XIX_BMC_HV.DE_BMC_CMC_Zellspannung_091
      SP_IF_BMC_CMC_Zellspannung_091_XIX_BMC_HV: upstream-reference=Geltungsbereich_E3_1_2_Premium.SP_IF_BMC_CMC_Zellspannung_091_XIX_BMC_HV, ecu-extract-reference=COMPOSITIONTYPE.SP_IF_BMC_CMC_Zellspannung_091_XIX_BMC_HV
      BMC_CMC_Zellspannung_092: upstream-reference=Geltungsbereich_E3_1_2_Premium.SP_IF_BMC_CMC_Zellspannung_092_XIX_BMC_HV.DE_BMC_CMC_Zellspannung_092, ecu-extract-reference=COMPOSITIONTYPE.SP_IF_BMC_CMC_Zellspannung_092_XIX_BMC_HV.DE_BMC_CMC_Zellspannung_092
      SP_IF_BMC_CMC_Zellspannung_092_XIX_BMC_HV: upstream-reference=Geltungsbereich_E3_1_2_Premium.SP_IF_BMC_CMC_Zellspannung_092_XIX_BMC_HV, ecu-extract-reference=COMPOSITIONTYPE.SP_IF_BMC_CMC_Zellspannung_092_XIX_BMC_HV
      BMC_CMC_Zellspannung_093: upstream-reference=Geltungsbereich_E3_1_2_Premium.SP_IF_BMC_CMC_Zellspannung_093_XIX_BMC_HV.DE_BMC_CMC_Zellspannung_093, ecu-extract-reference=COMPOSITIONTYPE.SP_IF_BMC_CMC_Zellspannung_093_XIX_BMC_HV.DE_BMC_CMC_Zellspannung_093
      SP_IF_BMC_CMC_Zellspannung_093_XIX_BMC_HV: upstream-reference=Geltungsbereich_E3_1_2_Premium.SP_IF_BMC_CMC_Zellspannung_093_XIX_BMC_HV, ecu-extract-reference=COMPOSITIONTYPE.SP_IF_BMC_CMC_Zellspannung_093_XIX_BMC_HV
      BMC_CMC_Zellspannung_094: upstream-reference=Geltungsbereich_E3_1_2_Premium.SP_IF_BMC_CMC_Zellspannung_094_XIX_BMC_HV.DE_BMC_CMC_Zellspannung_094, ecu-extract-reference=COMPOSITIONTYPE.SP_IF_BMC_CMC_Zellspannung_094_XIX_BMC_HV.DE_BMC_CMC_Zellspannung_094
      SP_IF_BMC_CMC_Zellspannung_094_XIX_BMC_HV: upstream-reference=Geltungsbereich_E3_1_2_Premium.SP_IF_BMC_CMC_Zellspannung_094_XIX_BMC_HV, ecu-extract-reference=COMPOSITIONTYPE.SP_IF_BMC_CMC_Zellspannung_094_XIX_BMC_HV
      BMC_CMC_Zellspannung_095: upstream-reference=Geltungsbereich_E3_1_2_Premium.SP_IF_BMC_CMC_Zellspannung_095_XIX_BMC_HV.DE_BMC_CMC_Zellspannung_095, ecu-extract-reference=COMPOSITIONTYPE.SP_IF_BMC_CMC_Zellspannung_095_XIX_BMC_HV.DE_BMC_CMC_Zellspannung_095
      SP_IF_BMC_CMC_Zellspannung_095_XIX_BMC_HV: upstream-reference=Geltungsbereich_E3_1_2_Premium.SP_IF_BMC_CMC_Zellspannung_095_XIX_BMC_HV, ecu-extract-reference=COMPOSITIONTYPE.SP_IF_BMC_CMC_Zellspannung_095_XIX_BMC_HV
      BMC_CMC_Zellspannung_096: upstream-reference=Geltungsbereich_E3_1_2_Premium.SP_IF_BMC_CMC_Zellspannung_096_XIX_BMC_HV.DE_BMC_CMC_Zellspannung_096, ecu-extract-reference=COMPOSITIONTYPE.SP_IF_BMC_CMC_Zellspannung_096_XIX_BMC_HV.DE_BMC_CMC_Zellspannung_096
      SP_IF_BMC_CMC_Zellspannung_096_XIX_BMC_HV: upstream-reference=Geltungsbereich_E3_1_2_Premium.SP_IF_BMC_CMC_Zellspannung_096_XIX_BMC_HV, ecu-extract-reference=COMPOSITIONTYPE.SP_IF_BMC_CMC_Zellspannung_096_XIX_BMC_HV
      BMC_CMC_Zellspannung_097: upstream-reference=Geltungsbereich_E3_1_2_Premium.SP_IF_BMC_CMC_Zellspannung_097_XIX_BMC_HV.DE_BMC_CMC_Zellspannung_097, ecu-extract-reference=COMPOSITIONTYPE.SP_IF_BMC_CMC_Zellspannung_097_XIX_BMC_HV.DE_BMC_CMC_Zellspannung_097
      SP_IF_BMC_CMC_Zellspannung_097_XIX_BMC_HV: upstream-reference=Geltungsbereich_E3_1_2_Premium.SP_IF_BMC_CMC_Zellspannung_097_XIX_BMC_HV, ecu-extract-reference=COMPOSITIONTYPE.SP_IF_BMC_CMC_Zellspannung_097_XIX_BMC_HV
      BMC_CMC_Zellspannung_098: upstream-reference=Geltungsbereich_E3_1_2_Premium.SP_IF_BMC_CMC_Zellspannung_098_XIX_BMC_HV.DE_BMC_CMC_Zellspannung_098, ecu-extract-reference=COMPOSITIONTYPE.SP_IF_BMC_CMC_Zellspannung_098_XIX_BMC_HV.DE_BMC_CMC_Zellspannung_098
      SP_IF_BMC_CMC_Zellspannung_098_XIX_BMC_HV: upstream-reference=Geltungsbereich_E3_1_2_Premium.SP_IF_BMC_CMC_Zellspannung_098_XIX_BMC_HV, ecu-extract-reference=COMPOSITIONTYPE.SP_IF_BMC_CMC_Zellspannung_098_XIX_BMC_HV
      BMC_CMC_Zellspannung_099: upstream-reference=Geltungsbereich_E3_1_2_Premium.SP_IF_BMC_CMC_Zellspannung_099_XIX_BMC_HV.DE_BMC_CMC_Zellspannung_099, ecu-extract-reference=COMPOSITIONTYPE.SP_IF_BMC_CMC_Zellspannung_099_XIX_BMC_HV.DE_BMC_CMC_Zellspannung_099
      SP_IF_BMC_CMC_Zellspannung_099_XIX_BMC_HV: upstream-reference=Geltungsbereich_E3_1_2_Premium.SP_IF_BMC_CMC_Zellspannung_099_XIX_BMC_HV, ecu-extract-reference=COMPOSITIONTYPE.SP_IF_BMC_CMC_Zellspannung_099_XIX_BMC_HV
      BMC_CMC_Zellspannung_100: upstream-reference=Geltungsbereich_E3_1_2_Premium.SP_IF_BMC_CMC_Zellspannung_100_XIX_BMC_HV.DE_BMC_CMC_Zellspannung_100, ecu-extract-reference=COMPOSITIONTYPE.SP_IF_BMC_CMC_Zellspannung_100_XIX_BMC_HV.DE_BMC_CMC_Zellspannung_100
      SP_IF_BMC_CMC_Zellspannung_100_XIX_BMC_HV: upstream-reference=Geltungsbereich_E3_1_2_Premium.SP_IF_BMC_CMC_Zellspannung_100_XIX_BMC_HV, ecu-extract-reference=COMPOSITIONTYPE.SP_IF_BMC_CMC_Zellspannung_100_XIX_BMC_HV
      BMC_CMC_Zellspannung_101: upstream-reference=Geltungsbereich_E3_1_2_Premium.SP_IF_BMC_CMC_Zellspannung_101_XIX_BMC_HV.DE_BMC_CMC_Zellspannung_101, ecu-extract-reference=COMPOSITIONTYPE.SP_IF_BMC_CMC_Zellspannung_101_XIX_BMC_HV.DE_BMC_CMC_Zellspannung_101
      SP_IF_BMC_CMC_Zellspannung_101_XIX_BMC_HV: upstream-reference=Geltungsbereich_E3_1_2_Premium.SP_IF_BMC_CMC_Zellspannung_101_XIX_BMC_HV, ecu-extract-reference=COMPOSITIONTYPE.SP_IF_BMC_CMC_Zellspannung_101_XIX_BMC_HV
      BMC_CMC_Zellspannung_102: upstream-reference=Geltungsbereich_E3_1_2_Premium.SP_IF_BMC_CMC_Zellspannung_102_XIX_BMC_HV.DE_BMC_CMC_Zellspannung_102, ecu-extract-reference=COMPOSITIONTYPE.SP_IF_BMC_CMC_Zellspannung_102_XIX_BMC_HV.DE_BMC_CMC_Zellspannung_102
      SP_IF_BMC_CMC_Zellspannung_102_XIX_BMC_HV: upstream-reference=Geltungsbereich_E3_1_2_Premium.SP_IF_BMC_CMC_Zellspannung_102_XIX_BMC_HV, ecu-extract-reference=COMPOSITIONTYPE.SP_IF_BMC_CMC_Zellspannung_102_XIX_BMC_HV
      BMC_CMC_Zellspannung_103: upstream-reference=Geltungsbereich_E3_1_2_Premium.SP_IF_BMC_CMC_Zellspannung_103_XIX_BMC_HV.DE_BMC_CMC_Zellspannung_103, ecu-extract-reference=COMPOSITIONTYPE.SP_IF_BMC_CMC_Zellspannung_103_XIX_BMC_HV.DE_BMC_CMC_Zellspannung_103
      SP_IF_BMC_CMC_Zellspannung_103_XIX_BMC_HV: upstream-reference=Geltungsbereich_E3_1_2_Premium.SP_IF_BMC_CMC_Zellspannung_103_XIX_BMC_HV, ecu-extract-reference=COMPOSITIONTYPE.SP_IF_BMC_CMC_Zellspannung_103_XIX_BMC_HV
      BMC_CMC_Zellspannung_104: upstream-reference=Geltungsbereich_E3_1_2_Premium.SP_IF_BMC_CMC_Zellspannung_104_XIX_BMC_HV.DE_BMC_CMC_Zellspannung_104, ecu-extract-reference=COMPOSITIONTYPE.SP_IF_BMC_CMC_Zellspannung_104_XIX_BMC_HV.DE_BMC_CMC_Zellspannung_104
      SP_IF_BMC_CMC_Zellspannung_104_XIX_BMC_HV: upstream-reference=Geltungsbereich_E3_1_2_Premium.SP_IF_BMC_CMC_Zellspannung_104_XIX_BMC_HV, ecu-extract-reference=COMPOSITIONTYPE.SP_IF_BMC_CMC_Zellspannung_104_XIX_BMC_HV
      BMC_CMC_Zellspannung_105: upstream-reference=Geltungsbereich_E3_1_2_Premium.SP_IF_BMC_CMC_Zellspannung_105_XIX_BMC_HV.DE_BMC_CMC_Zellspannung_105, ecu-extract-reference=COMPOSITIONTYPE.SP_IF_BMC_CMC_Zellspannung_105_XIX_BMC_HV.DE_BMC_CMC_Zellspannung_105
      SP_IF_BMC_CMC_Zellspannung_105_XIX_BMC_HV: upstream-reference=Geltungsbereich_E3_1_2_Premium.SP_IF_BMC_CMC_Zellspannung_105_XIX_BMC_HV, ecu-extract-reference=COMPOSITIONTYPE.SP_IF_BMC_CMC_Zellspannung_105_XIX_BMC_HV
      BMC_CMC_Zellspannung_106: upstream-reference=Geltungsbereich_E3_1_2_Premium.SP_IF_BMC_CMC_Zellspannung_106_XIX_BMC_HV.DE_BMC_CMC_Zellspannung_106, ecu-extract-reference=COMPOSITIONTYPE.SP_IF_BMC_CMC_Zellspannung_106_XIX_BMC_HV.DE_BMC_CMC_Zellspannung_106
      SP_IF_BMC_CMC_Zellspannung_106_XIX_BMC_HV: upstream-reference=Geltungsbereich_E3_1_2_Premium.SP_IF_BMC_CMC_Zellspannung_106_XIX_BMC_HV, ecu-extract-reference=COMPOSITIONTYPE.SP_IF_BMC_CMC_Zellspannung_106_XIX_BMC_HV
      BMC_CMC_Zellspannung_107: upstream-reference=Geltungsbereich_E3_1_2_Premium.SP_IF_BMC_CMC_Zellspannung_107_XIX_BMC_HV.DE_BMC_CMC_Zellspannung_107, ecu-extract-reference=COMPOSITIONTYPE.SP_IF_BMC_CMC_Zellspannung_107_XIX_BMC_HV.DE_BMC_CMC_Zellspannung_107
      SP_IF_BMC_CMC_Zellspannung_107_XIX_BMC_HV: upstream-reference=Geltungsbereich_E3_1_2_Premium.SP_IF_BMC_CMC_Zellspannung_107_XIX_BMC_HV, ecu-extract-reference=COMPOSITIONTYPE.SP_IF_BMC_CMC_Zellspannung_107_XIX_BMC_HV
      BMC_CMC_Zellspannung_108: upstream-reference=Geltungsbereich_E3_1_2_Premium.SP_IF_BMC_CMC_Zellspannung_108_XIX_BMC_HV.DE_BMC_CMC_Zellspannung_108, ecu-extract-reference=COMPOSITIONTYPE.SP_IF_BMC_CMC_Zellspannung_108_XIX_BMC_HV.DE_BMC_CMC_Zellspannung_108
      SP_IF_BMC_CMC_Zellspannung_108_XIX_BMC_HV: upstream-reference=Geltungsbereich_E3_1_2_Premium.SP_IF_BMC_CMC_Zellspannung_108_XIX_BMC_HV, ecu-extract-reference=COMPOSITIONTYPE.SP_IF_BMC_CMC_Zellspannung_108_XIX_BMC_HV
      BMC_CMC_Zellspannung_109: upstream-reference=Geltungsbereich_E3_1_2_Premium.SP_IF_BMC_CMC_Zellspannung_109_XIX_BMC_HV.DE_BMC_CMC_Zellspannung_109, ecu-extract-reference=COMPOSITIONTYPE.SP_IF_BMC_CMC_Zellspannung_109_XIX_BMC_HV.DE_BMC_CMC_Zellspannung_109
      SP_IF_BMC_CMC_Zellspannung_109_XIX_BMC_HV: upstream-reference=Geltungsbereich_E3_1_2_Premium.SP_IF_BMC_CMC_Zellspannung_109_XIX_BMC_HV, ecu-extract-reference=COMPOSITIONTYPE.SP_IF_BMC_CMC_Zellspannung_109_XIX_BMC_HV
      BMC_CMC_Zellspannung_110: upstream-reference=Geltungsbereich_E3_1_2_Premium.SP_IF_BMC_CMC_Zellspannung_110_XIX_BMC_HV.DE_BMC_CMC_Zellspannung_110, ecu-extract-reference=COMPOSITIONTYPE.SP_IF_BMC_CMC_Zellspannung_110_XIX_BMC_HV.DE_BMC_CMC_Zellspannung_110
      SP_IF_BMC_CMC_Zellspannung_110_XIX_BMC_HV: upstream-reference=Geltungsbereich_E3_1_2_Premium.SP_IF_BMC_CMC_Zellspannung_110_XIX_BMC_HV, ecu-extract-reference=COMPOSITIONTYPE.SP_IF_BMC_CMC_Zellspannung_110_XIX_BMC_HV
      BMC_CMC_Zellspannung_111: upstream-reference=Geltungsbereich_E3_1_2_Premium.SP_IF_BMC_CMC_Zellspannung_111_XIX_BMC_HV.DE_BMC_CMC_Zellspannung_111, ecu-extract-reference=COMPOSITIONTYPE.SP_IF_BMC_CMC_Zellspannung_111_XIX_BMC_HV.DE_BMC_CMC_Zellspannung_111
      SP_IF_BMC_CMC_Zellspannung_111_XIX_BMC_HV: upstream-reference=Geltungsbereich_E3_1_2_Premium.SP_IF_BMC_CMC_Zellspannung_111_XIX_BMC_HV, ecu-extract-reference=COMPOSITIONTYPE.SP_IF_BMC_CMC_Zellspannung_111_XIX_BMC_HV
      BMC_CMC_Zellspannung_112: upstream-reference=Geltungsbereich_E3_1_2_Premium.SP_IF_BMC_CMC_Zellspannung_112_XIX_BMC_HV.DE_BMC_CMC_Zellspannung_112, ecu-extract-reference=COMPOSITIONTYPE.SP_IF_BMC_CMC_Zellspannung_112_XIX_BMC_HV.DE_BMC_CMC_Zellspannung_112
      SP_IF_BMC_CMC_Zellspannung_112_XIX_BMC_HV: upstream-reference=Geltungsbereich_E3_1_2_Premium.SP_IF_BMC_CMC_Zellspannung_112_XIX_BMC_HV, ecu-extract-reference=COMPOSITIONTYPE.SP_IF_BMC_CMC_Zellspannung_112_XIX_BMC_HV
      BMC_CMC_Zellspannung_113: upstream-reference=Geltungsbereich_E3_1_2_Premium.SP_IF_BMC_CMC_Zellspannung_113_XIX_BMC_HV.DE_BMC_CMC_Zellspannung_113, ecu-extract-reference=COMPOSITIONTYPE.SP_IF_BMC_CMC_Zellspannung_113_XIX_BMC_HV.DE_BMC_CMC_Zellspannung_113
      SP_IF_BMC_CMC_Zellspannung_113_XIX_BMC_HV: upstream-reference=Geltungsbereich_E3_1_2_Premium.SP_IF_BMC_CMC_Zellspannung_113_XIX_BMC_HV, ecu-extract-reference=COMPOSITIONTYPE.SP_IF_BMC_CMC_Zellspannung_113_XIX_BMC_HV
      BMC_CMC_Zellspannung_114: upstream-reference=Geltungsbereich_E3_1_2_Premium.SP_IF_BMC_CMC_Zellspannung_114_XIX_BMC_HV.DE_BMC_CMC_Zellspannung_114, ecu-extract-reference=COMPOSITIONTYPE.SP_IF_BMC_CMC_Zellspannung_114_XIX_BMC_HV.DE_BMC_CMC_Zellspannung_114
      SP_IF_BMC_CMC_Zellspannung_114_XIX_BMC_HV: upstream-reference=Geltungsbereich_E3_1_2_Premium.SP_IF_BMC_CMC_Zellspannung_114_XIX_BMC_HV, ecu-extract-reference=COMPOSITIONTYPE.SP_IF_BMC_CMC_Zellspannung_114_XIX_BMC_HV
      BMC_CMC_Zellspannung_115: upstream-reference=Geltungsbereich_E3_1_2_Premium.SP_IF_BMC_CMC_Zellspannung_115_XIX_BMC_HV.DE_BMC_CMC_Zellspannung_115, ecu-extract-reference=COMPOSITIONTYPE.SP_IF_BMC_CMC_Zellspannung_115_XIX_BMC_HV.DE_BMC_CMC_Zellspannung_115
      SP_IF_BMC_CMC_Zellspannung_115_XIX_BMC_HV: upstream-reference=Geltungsbereich_E3_1_2_Premium.SP_IF_BMC_CMC_Zellspannung_115_XIX_BMC_HV, ecu-extract-reference=COMPOSITIONTYPE.SP_IF_BMC_CMC_Zellspannung_115_XIX_BMC_HV
      BMC_CMC_Zellspannung_116: upstream-reference=Geltungsbereich_E3_1_2_Premium.SP_IF_BMC_CMC_Zellspannung_116_XIX_BMC_HV.DE_BMC_CMC_Zellspannung_116, ecu-extract-reference=COMPOSITIONTYPE.SP_IF_BMC_CMC_Zellspannung_116_XIX_BMC_HV.DE_BMC_CMC_Zellspannung_116
      SP_IF_BMC_CMC_Zellspannung_116_XIX_BMC_HV: upstream-reference=Geltungsbereich_E3_1_2_Premium.SP_IF_BMC_CMC_Zellspannung_116_XIX_BMC_HV, ecu-extract-reference=COMPOSITIONTYPE.SP_IF_BMC_CMC_Zellspannung_116_XIX_BMC_HV
      BMC_CMC_Zellspannung_117: upstream-reference=Geltungsbereich_E3_1_2_Premium.SP_IF_BMC_CMC_Zellspannung_117_XIX_BMC_HV.DE_BMC_CMC_Zellspannung_117, ecu-extract-reference=COMPOSITIONTYPE.SP_IF_BMC_CMC_Zellspannung_117_XIX_BMC_HV.DE_BMC_CMC_Zellspannung_117
      SP_IF_BMC_CMC_Zellspannung_117_XIX_BMC_HV: upstream-reference=Geltungsbereich_E3_1_2_Premium.SP_IF_BMC_CMC_Zellspannung_117_XIX_BMC_HV, ecu-extract-reference=COMPOSITIONTYPE.SP_IF_BMC_CMC_Zellspannung_117_XIX_BMC_HV
      BMC_CMC_Zellspannung_118: upstream-reference=Geltungsbereich_E3_1_2_Premium.SP_IF_BMC_CMC_Zellspannung_118_XIX_BMC_HV.DE_BMC_CMC_Zellspannung_118, ecu-extract-reference=COMPOSITIONTYPE.SP_IF_BMC_CMC_Zellspannung_118_XIX_BMC_HV.DE_BMC_CMC_Zellspannung_118
      SP_IF_BMC_CMC_Zellspannung_118_XIX_BMC_HV: upstream-reference=Geltungsbereich_E3_1_2_Premium.SP_IF_BMC_CMC_Zellspannung_118_XIX_BMC_HV, ecu-extract-reference=COMPOSITIONTYPE.SP_IF_BMC_CMC_Zellspannung_118_XIX_BMC_HV
      BMC_CMC_Zellspannung_119: upstream-reference=Geltungsbereich_E3_1_2_Premium.SP_IF_BMC_CMC_Zellspannung_119_XIX_BMC_HV.DE_BMC_CMC_Zellspannung_119, ecu-extract-reference=COMPOSITIONTYPE.SP_IF_BMC_CMC_Zellspannung_119_XIX_BMC_HV.DE_BMC_CMC_Zellspannung_119
      SP_IF_BMC_CMC_Zellspannung_119_XIX_BMC_HV: upstream-reference=Geltungsbereich_E3_1_2_Premium.SP_IF_BMC_CMC_Zellspannung_119_XIX_BMC_HV, ecu-extract-reference=COMPOSITIONTYPE.SP_IF_BMC_CMC_Zellspannung_119_XIX_BMC_HV
      BMC_CMC_Zellspannung_120: upstream-reference=Geltungsbereich_E3_1_2_Premium.SP_IF_BMC_CMC_Zellspannung_120_XIX_BMC_HV.DE_BMC_CMC_Zellspannung_120, ecu-extract-reference=COMPOSITIONTYPE.SP_IF_BMC_CMC_Zellspannung_120_XIX_BMC_HV.DE_BMC_CMC_Zellspannung_120
      SP_IF_BMC_CMC_Zellspannung_120_XIX_BMC_HV: upstream-reference=Geltungsbereich_E3_1_2_Premium.SP_IF_BMC_CMC_Zellspannung_120_XIX_BMC_HV, ecu-extract-reference=COMPOSITIONTYPE.SP_IF_BMC_CMC_Zellspannung_120_XIX_BMC_HV
      BMC_CMC_Zellspannung_121: upstream-reference=Geltungsbereich_E3_1_2_Premium.SP_IF_BMC_CMC_Zellspannung_121_XIX_BMC_HV.DE_BMC_CMC_Zellspannung_121, ecu-extract-reference=COMPOSITIONTYPE.SP_IF_BMC_CMC_Zellspannung_121_XIX_BMC_HV.DE_BMC_CMC_Zellspannung_121
      SP_IF_BMC_CMC_Zellspannung_121_XIX_BMC_HV: upstream-reference=Geltungsbereich_E3_1_2_Premium.SP_IF_BMC_CMC_Zellspannung_121_XIX_BMC_HV, ecu-extract-reference=COMPOSITIONTYPE.SP_IF_BMC_CMC_Zellspannung_121_XIX_BMC_HV
      BMC_CMC_Zellspannung_122: upstream-reference=Geltungsbereich_E3_1_2_Premium.SP_IF_BMC_CMC_Zellspannung_122_XIX_BMC_HV.DE_BMC_CMC_Zellspannung_122, ecu-extract-reference=COMPOSITIONTYPE.SP_IF_BMC_CMC_Zellspannung_122_XIX_BMC_HV.DE_BMC_CMC_Zellspannung_122
      SP_IF_BMC_CMC_Zellspannung_122_XIX_BMC_HV: upstream-reference=Geltungsbereich_E3_1_2_Premium.SP_IF_BMC_CMC_Zellspannung_122_XIX_BMC_HV, ecu-extract-reference=COMPOSITIONTYPE.SP_IF_BMC_CMC_Zellspannung_122_XIX_BMC_HV
      BMC_CMC_Zellspannung_123: upstream-reference=Geltungsbereich_E3_1_2_Premium.SP_IF_BMC_CMC_Zellspannung_123_XIX_BMC_HV.DE_BMC_CMC_Zellspannung_123, ecu-extract-reference=COMPOSITIONTYPE.SP_IF_BMC_CMC_Zellspannung_123_XIX_BMC_HV.DE_BMC_CMC_Zellspannung_123
      SP_IF_BMC_CMC_Zellspannung_123_XIX_BMC_HV: upstream-reference=Geltungsbereich_E3_1_2_Premium.SP_IF_BMC_CMC_Zellspannung_123_XIX_BMC_HV, ecu-extract-reference=COMPOSITIONTYPE.SP_IF_BMC_CMC_Zellspannung_123_XIX_BMC_HV
      BMC_CMC_Zellspannung_124: upstream-reference=Geltungsbereich_E3_1_2_Premium.SP_IF_BMC_CMC_Zellspannung_124_XIX_BMC_HV.DE_BMC_CMC_Zellspannung_124, ecu-extract-reference=COMPOSITIONTYPE.SP_IF_BMC_CMC_Zellspannung_124_XIX_BMC_HV.DE_BMC_CMC_Zellspannung_124
      SP_IF_BMC_CMC_Zellspannung_124_XIX_BMC_HV: upstream-reference=Geltungsbereich_E3_1_2_Premium.SP_IF_BMC_CMC_Zellspannung_124_XIX_BMC_HV, ecu-extract-reference=COMPOSITIONTYPE.SP_IF_BMC_CMC_Zellspannung_124_XIX_BMC_HV
      BMC_CMC_Zellspannung_125: upstream-reference=Geltungsbereich_E3_1_2_Premium.SP_IF_BMC_CMC_Zellspannung_125_XIX_BMC_HV.DE_BMC_CMC_Zellspannung_125, ecu-extract-reference=COMPOSITIONTYPE.SP_IF_BMC_CMC_Zellspannung_125_XIX_BMC_HV.DE_BMC_CMC_Zellspannung_125
      SP_IF_BMC_CMC_Zellspannung_125_XIX_BMC_HV: upstream-reference=Geltungsbereich_E3_1_2_Premium.SP_IF_BMC_CMC_Zellspannung_125_XIX_BMC_HV, ecu-extract-reference=COMPOSITIONTYPE.SP_IF_BMC_CMC_Zellspannung_125_XIX_BMC_HV
      BMC_CMC_Zellspannung_126: upstream-reference=Geltungsbereich_E3_1_2_Premium.SP_IF_BMC_CMC_Zellspannung_126_XIX_BMC_HV.DE_BMC_CMC_Zellspannung_126, ecu-extract-reference=COMPOSITIONTYPE.SP_IF_BMC_CMC_Zellspannung_126_XIX_BMC_HV.DE_BMC_CMC_Zellspannung_126
      SP_IF_BMC_CMC_Zellspannung_126_XIX_BMC_HV: upstream-reference=Geltungsbereich_E3_1_2_Premium.SP_IF_BMC_CMC_Zellspannung_126_XIX_BMC_HV, ecu-extract-reference=COMPOSITIONTYPE.SP_IF_BMC_CMC_Zellspannung_126_XIX_BMC_HV
      BMC_CMC_Zellspannung_127: upstream-reference=Geltungsbereich_E3_1_2_Premium.SP_IF_BMC_CMC_Zellspannung_127_XIX_BMC_HV.DE_BMC_CMC_Zellspannung_127, ecu-extract-reference=COMPOSITIONTYPE.SP_IF_BMC_CMC_Zellspannung_127_XIX_BMC_HV.DE_BMC_CMC_Zellspannung_127
      SP_IF_BMC_CMC_Zellspannung_127_XIX_BMC_HV: upstream-reference=Geltungsbereich_E3_1_2_Premium.SP_IF_BMC_CMC_Zellspannung_127_XIX_BMC_HV, ecu-extract-reference=COMPOSITIONTYPE.SP_IF_BMC_CMC_Zellspannung_127_XIX_BMC_HV
      BMC_CMC_Zellspannung_128: upstream-reference=Geltungsbereich_E3_1_2_Premium.SP_IF_BMC_CMC_Zellspannung_128_XIX_BMC_HV.DE_BMC_CMC_Zellspannung_128, ecu-extract-reference=COMPOSITIONTYPE.SP_IF_BMC_CMC_Zellspannung_128_XIX_BMC_HV.DE_BMC_CMC_Zellspannung_128
      SP_IF_BMC_CMC_Zellspannung_128_XIX_BMC_HV: upstream-reference=Geltungsbereich_E3_1_2_Premium.SP_IF_BMC_CMC_Zellspannung_128_XIX_BMC_HV, ecu-extract-reference=COMPOSITIONTYPE.SP_IF_BMC_CMC_Zellspannung_128_XIX_BMC_HV
      BMC_CMC_Zellspannung_129: upstream-reference=Geltungsbereich_E3_1_2_Premium.SP_IF_BMC_CMC_Zellspannung_129_XIX_BMC_HV.DE_BMC_CMC_Zellspannung_129, ecu-extract-reference=COMPOSITIONTYPE.SP_IF_BMC_CMC_Zellspannung_129_XIX_BMC_HV.DE_BMC_CMC_Zellspannung_129
      SP_IF_BMC_CMC_Zellspannung_129_XIX_BMC_HV: upstream-reference=Geltungsbereich_E3_1_2_Premium.SP_IF_BMC_CMC_Zellspannung_129_XIX_BMC_HV, ecu-extract-reference=COMPOSITIONTYPE.SP_IF_BMC_CMC_Zellspannung_129_XIX_BMC_HV
      BMC_CMC_Zellspannung_130: upstream-reference=Geltungsbereich_E3_1_2_Premium.SP_IF_BMC_CMC_Zellspannung_130_XIX_BMC_HV.DE_BMC_CMC_Zellspannung_130, ecu-extract-reference=COMPOSITIONTYPE.SP_IF_BMC_CMC_Zellspannung_130_XIX_BMC_HV.DE_BMC_CMC_Zellspannung_130
      SP_IF_BMC_CMC_Zellspannung_130_XIX_BMC_HV: upstream-reference=Geltungsbereich_E3_1_2_Premium.SP_IF_BMC_CMC_Zellspannung_130_XIX_BMC_HV, ecu-extract-reference=COMPOSITIONTYPE.SP_IF_BMC_CMC_Zellspannung_130_XIX_BMC_HV
      BMC_CMC_Zellspannung_131: upstream-reference=Geltungsbereich_E3_1_2_Premium.SP_IF_BMC_CMC_Zellspannung_131_XIX_BMC_HV.DE_BMC_CMC_Zellspannung_131, ecu-extract-reference=COMPOSITIONTYPE.SP_IF_BMC_CMC_Zellspannung_131_XIX_BMC_HV.DE_BMC_CMC_Zellspannung_131
      SP_IF_BMC_CMC_Zellspannung_131_XIX_BMC_HV: upstream-reference=Geltungsbereich_E3_1_2_Premium.SP_IF_BMC_CMC_Zellspannung_131_XIX_BMC_HV, ecu-extract-reference=COMPOSITIONTYPE.SP_IF_BMC_CMC_Zellspannung_131_XIX_BMC_HV
      BMC_CMC_Zellspannung_132: upstream-reference=Geltungsbereich_E3_1_2_Premium.SP_IF_BMC_CMC_Zellspannung_132_XIX_BMC_HV.DE_BMC_CMC_Zellspannung_132, ecu-extract-reference=COMPOSITIONTYPE.SP_IF_BMC_CMC_Zellspannung_132_XIX_BMC_HV.DE_BMC_CMC_Zellspannung_132
      SP_IF_BMC_CMC_Zellspannung_132_XIX_BMC_HV: upstream-reference=Geltungsbereich_E3_1_2_Premium.SP_IF_BMC_CMC_Zellspannung_132_XIX_BMC_HV, ecu-extract-reference=COMPOSITIONTYPE.SP_IF_BMC_CMC_Zellspannung_132_XIX_BMC_HV
      BMC_CMC_Zellspannung_133: upstream-reference=Geltungsbereich_E3_1_2_Premium.SP_IF_BMC_CMC_Zellspannung_133_XIX_BMC_HV.DE_BMC_CMC_Zellspannung_133, ecu-extract-reference=COMPOSITIONTYPE.SP_IF_BMC_CMC_Zellspannung_133_XIX_BMC_HV.DE_BMC_CMC_Zellspannung_133
      SP_IF_BMC_CMC_Zellspannung_133_XIX_BMC_HV: upstream-reference=Geltungsbereich_E3_1_2_Premium.SP_IF_BMC_CMC_Zellspannung_133_XIX_BMC_HV, ecu-extract-reference=COMPOSITIONTYPE.SP_IF_BMC_CMC_Zellspannung_133_XIX_BMC_HV
      BMC_CMC_Zellspannung_134: upstream-reference=Geltungsbereich_E3_1_2_Premium.SP_IF_BMC_CMC_Zellspannung_134_XIX_BMC_HV.DE_BMC_CMC_Zellspannung_134, ecu-extract-reference=COMPOSITIONTYPE.SP_IF_BMC_CMC_Zellspannung_134_XIX_BMC_HV.DE_BMC_CMC_Zellspannung_134
      SP_IF_BMC_CMC_Zellspannung_134_XIX_BMC_HV: upstream-reference=Geltungsbereich_E3_1_2_Premium.SP_IF_BMC_CMC_Zellspannung_134_XIX_BMC_HV, ecu-extract-reference=COMPOSITIONTYPE.SP_IF_BMC_CMC_Zellspannung_134_XIX_BMC_HV
      BMC_CMC_Zellspannung_135: upstream-reference=Geltungsbereich_E3_1_2_Premium.SP_IF_BMC_CMC_Zellspannung_135_XIX_BMC_HV.DE_BMC_CMC_Zellspannung_135, ecu-extract-reference=COMPOSITIONTYPE.SP_IF_BMC_CMC_Zellspannung_135_XIX_BMC_HV.DE_BMC_CMC_Zellspannung_135
      SP_IF_BMC_CMC_Zellspannung_135_XIX_BMC_HV: upstream-reference=Geltungsbereich_E3_1_2_Premium.SP_IF_BMC_CMC_Zellspannung_135_XIX_BMC_HV, ecu-extract-reference=COMPOSITIONTYPE.SP_IF_BMC_CMC_Zellspannung_135_XIX_BMC_HV
      BMC_CMC_Zellspannung_136: upstream-reference=Geltungsbereich_E3_1_2_Premium.SP_IF_BMC_CMC_Zellspannung_136_XIX_BMC_HV.DE_BMC_CMC_Zellspannung_136, ecu-extract-reference=COMPOSITIONTYPE.SP_IF_BMC_CMC_Zellspannung_136_XIX_BMC_HV.DE_BMC_CMC_Zellspannung_136
      SP_IF_BMC_CMC_Zellspannung_136_XIX_BMC_HV: upstream-reference=Geltungsbereich_E3_1_2_Premium.SP_IF_BMC_CMC_Zellspannung_136_XIX_BMC_HV, ecu-extract-reference=COMPOSITIONTYPE.SP_IF_BMC_CMC_Zellspannung_136_XIX_BMC_HV
      BMC_CMC_Zellspannung_137: upstream-reference=Geltungsbereich_E3_1_2_Premium.SP_IF_BMC_CMC_Zellspannung_137_XIX_BMC_HV.DE_BMC_CMC_Zellspannung_137, ecu-extract-reference=COMPOSITIONTYPE.SP_IF_BMC_CMC_Zellspannung_137_XIX_BMC_HV.DE_BMC_CMC_Zellspannung_137
      SP_IF_BMC_CMC_Zellspannung_137_XIX_BMC_HV: upstream-reference=Geltungsbereich_E3_1_2_Premium.SP_IF_BMC_CMC_Zellspannung_137_XIX_BMC_HV, ecu-extract-reference=COMPOSITIONTYPE.SP_IF_BMC_CMC_Zellspannung_137_XIX_BMC_HV
      BMC_CMC_Zellspannung_138: upstream-reference=Geltungsbereich_E3_1_2_Premium.SP_IF_BMC_CMC_Zellspannung_138_XIX_BMC_HV.DE_BMC_CMC_Zellspannung_138, ecu-extract-reference=COMPOSITIONTYPE.SP_IF_BMC_CMC_Zellspannung_138_XIX_BMC_HV.DE_BMC_CMC_Zellspannung_138
      SP_IF_BMC_CMC_Zellspannung_138_XIX_BMC_HV: upstream-reference=Geltungsbereich_E3_1_2_Premium.SP_IF_BMC_CMC_Zellspannung_138_XIX_BMC_HV, ecu-extract-reference=COMPOSITIONTYPE.SP_IF_BMC_CMC_Zellspannung_138_XIX_BMC_HV
      BMC_CMC_Zellspannung_139: upstream-reference=Geltungsbereich_E3_1_2_Premium.SP_IF_BMC_CMC_Zellspannung_139_XIX_BMC_HV.DE_BMC_CMC_Zellspannung_139, ecu-extract-reference=COMPOSITIONTYPE.SP_IF_BMC_CMC_Zellspannung_139_XIX_BMC_HV.DE_BMC_CMC_Zellspannung_139
      SP_IF_BMC_CMC_Zellspannung_139_XIX_BMC_HV: upstream-reference=Geltungsbereich_E3_1_2_Premium.SP_IF_BMC_CMC_Zellspannung_139_XIX_BMC_HV, ecu-extract-reference=COMPOSITIONTYPE.SP_IF_BMC_CMC_Zellspannung_139_XIX_BMC_HV
      BMC_CMC_Zellspannung_140: upstream-reference=Geltungsbereich_E3_1_2_Premium.SP_IF_BMC_CMC_Zellspannung_140_XIX_BMC_HV.DE_BMC_CMC_Zellspannung_140, ecu-extract-reference=COMPOSITIONTYPE.SP_IF_BMC_CMC_Zellspannung_140_XIX_BMC_HV.DE_BMC_CMC_Zellspannung_140
      SP_IF_BMC_CMC_Zellspannung_140_XIX_BMC_HV: upstream-reference=Geltungsbereich_E3_1_2_Premium.SP_IF_BMC_CMC_Zellspannung_140_XIX_BMC_HV, ecu-extract-reference=COMPOSITIONTYPE.SP_IF_BMC_CMC_Zellspannung_140_XIX_BMC_HV
      BMC_CMC_Zellspannung_141: upstream-reference=Geltungsbereich_E3_1_2_Premium.SP_IF_BMC_CMC_Zellspannung_141_XIX_BMC_HV.DE_BMC_CMC_Zellspannung_141, ecu-extract-reference=COMPOSITIONTYPE.SP_IF_BMC_CMC_Zellspannung_141_XIX_BMC_HV.DE_BMC_CMC_Zellspannung_141
      SP_IF_BMC_CMC_Zellspannung_141_XIX_BMC_HV: upstream-reference=Geltungsbereich_E3_1_2_Premium.SP_IF_BMC_CMC_Zellspannung_141_XIX_BMC_HV, ecu-extract-reference=COMPOSITIONTYPE.SP_IF_BMC_CMC_Zellspannung_141_XIX_BMC_HV
      BMC_CMC_Zellspannung_142: upstream-reference=Geltungsbereich_E3_1_2_Premium.SP_IF_BMC_CMC_Zellspannung_142_XIX_BMC_HV.DE_BMC_CMC_Zellspannung_142, ecu-extract-reference=COMPOSITIONTYPE.SP_IF_BMC_CMC_Zellspannung_142_XIX_BMC_HV.DE_BMC_CMC_Zellspannung_142
      SP_IF_BMC_CMC_Zellspannung_142_XIX_BMC_HV: upstream-reference=Geltungsbereich_E3_1_2_Premium.SP_IF_BMC_CMC_Zellspannung_142_XIX_BMC_HV, ecu-extract-reference=COMPOSITIONTYPE.SP_IF_BMC_CMC_Zellspannung_142_XIX_BMC_HV
      BMC_CMC_Zellspannung_143: upstream-reference=Geltungsbereich_E3_1_2_Premium.SP_IF_BMC_CMC_Zellspannung_143_XIX_BMC_HV.DE_BMC_CMC_Zellspannung_143, ecu-extract-reference=COMPOSITIONTYPE.SP_IF_BMC_CMC_Zellspannung_143_XIX_BMC_HV.DE_BMC_CMC_Zellspannung_143
      SP_IF_BMC_CMC_Zellspannung_143_XIX_BMC_HV: upstream-reference=Geltungsbereich_E3_1_2_Premium.SP_IF_BMC_CMC_Zellspannung_143_XIX_BMC_HV, ecu-extract-reference=COMPOSITIONTYPE.SP_IF_BMC_CMC_Zellspannung_143_XIX_BMC_HV
      BMC_CMC_Zellspannung_144: upstream-reference=Geltungsbereich_E3_1_2_Premium.SP_IF_BMC_CMC_Zellspannung_144_XIX_BMC_HV.DE_BMC_CMC_Zellspannung_144, ecu-extract-reference=COMPOSITIONTYPE.SP_IF_BMC_CMC_Zellspannung_144_XIX_BMC_HV.DE_BMC_CMC_Zellspannung_144
      SP_IF_BMC_CMC_Zellspannung_144_XIX_BMC_HV: upstream-reference=Geltungsbereich_E3_1_2_Premium.SP_IF_BMC_CMC_Zellspannung_144_XIX_BMC_HV, ecu-extract-reference=COMPOSITIONTYPE.SP_IF_BMC_CMC_Zellspannung_144_XIX_BMC_HV
      BMC_CMC_Zellspannung_145: upstream-reference=Geltungsbereich_E3_1_2_Premium.SP_IF_BMC_CMC_Zellspannung_145_XIX_BMC_HV.DE_BMC_CMC_Zellspannung_145, ecu-extract-reference=COMPOSITIONTYPE.SP_IF_BMC_CMC_Zellspannung_145_XIX_BMC_HV.DE_BMC_CMC_Zellspannung_145
      SP_IF_BMC_CMC_Zellspannung_145_XIX_BMC_HV: upstream-reference=Geltungsbereich_E3_1_2_Premium.SP_IF_BMC_CMC_Zellspannung_145_XIX_BMC_HV, ecu-extract-reference=COMPOSITIONTYPE.SP_IF_BMC_CMC_Zellspannung_145_XIX_BMC_HV
      BMC_CMC_Zellspannung_146: upstream-reference=Geltungsbereich_E3_1_2_Premium.SP_IF_BMC_CMC_Zellspannung_146_XIX_BMC_HV.DE_BMC_CMC_Zellspannung_146, ecu-extract-reference=COMPOSITIONTYPE.SP_IF_BMC_CMC_Zellspannung_146_XIX_BMC_HV.DE_BMC_CMC_Zellspannung_146
      SP_IF_BMC_CMC_Zellspannung_146_XIX_BMC_HV: upstream-reference=Geltungsbereich_E3_1_2_Premium.SP_IF_BMC_CMC_Zellspannung_146_XIX_BMC_HV, ecu-extract-reference=COMPOSITIONTYPE.SP_IF_BMC_CMC_Zellspannung_146_XIX_BMC_HV
      BMC_CMC_Zellspannung_147: upstream-reference=Geltungsbereich_E3_1_2_Premium.SP_IF_BMC_CMC_Zellspannung_147_XIX_BMC_HV.DE_BMC_CMC_Zellspannung_147, ecu-extract-reference=COMPOSITIONTYPE.SP_IF_BMC_CMC_Zellspannung_147_XIX_BMC_HV.DE_BMC_CMC_Zellspannung_147
      SP_IF_BMC_CMC_Zellspannung_147_XIX_BMC_HV: upstream-reference=Geltungsbereich_E3_1_2_Premium.SP_IF_BMC_CMC_Zellspannung_147_XIX_BMC_HV, ecu-extract-reference=COMPOSITIONTYPE.SP_IF_BMC_CMC_Zellspannung_147_XIX_BMC_HV
      BMC_CMC_Zellspannung_148: upstream-reference=Geltungsbereich_E3_1_2_Premium.SP_IF_BMC_CMC_Zellspannung_148_XIX_BMC_HV.DE_BMC_CMC_Zellspannung_148, ecu-extract-reference=COMPOSITIONTYPE.SP_IF_BMC_CMC_Zellspannung_148_XIX_BMC_HV.DE_BMC_CMC_Zellspannung_148
      SP_IF_BMC_CMC_Zellspannung_148_XIX_BMC_HV: upstream-reference=Geltungsbereich_E3_1_2_Premium.SP_IF_BMC_CMC_Zellspannung_148_XIX_BMC_HV, ecu-extract-reference=COMPOSITIONTYPE.SP_IF_BMC_CMC_Zellspannung_148_XIX_BMC_HV
      BMC_CMC_Zellspannung_149: upstream-reference=Geltungsbereich_E3_1_2_Premium.SP_IF_BMC_CMC_Zellspannung_149_XIX_BMC_HV.DE_BMC_CMC_Zellspannung_149, ecu-extract-reference=COMPOSITIONTYPE.SP_IF_BMC_CMC_Zellspannung_149_XIX_BMC_HV.DE_BMC_CMC_Zellspannung_149
      SP_IF_BMC_CMC_Zellspannung_149_XIX_BMC_HV: upstream-reference=Geltungsbereich_E3_1_2_Premium.SP_IF_BMC_CMC_Zellspannung_149_XIX_BMC_HV, ecu-extract-reference=COMPOSITIONTYPE.SP_IF_BMC_CMC_Zellspannung_149_XIX_BMC_HV
      BMC_CMC_Zellspannung_150: upstream-reference=Geltungsbereich_E3_1_2_Premium.SP_IF_BMC_CMC_Zellspannung_150_XIX_BMC_HV.DE_BMC_CMC_Zellspannung_150, ecu-extract-reference=COMPOSITIONTYPE.SP_IF_BMC_CMC_Zellspannung_150_XIX_BMC_HV.DE_BMC_CMC_Zellspannung_150
      SP_IF_BMC_CMC_Zellspannung_150_XIX_BMC_HV: upstream-reference=Geltungsbereich_E3_1_2_Premium.SP_IF_BMC_CMC_Zellspannung_150_XIX_BMC_HV, ecu-extract-reference=COMPOSITIONTYPE.SP_IF_BMC_CMC_Zellspannung_150_XIX_BMC_HV
      BMC_CMC_Zellspannung_151: upstream-reference=Geltungsbereich_E3_1_2_Premium.SP_IF_BMC_CMC_Zellspannung_151_XIX_BMC_HV.DE_BMC_CMC_Zellspannung_151, ecu-extract-reference=COMPOSITIONTYPE.SP_IF_BMC_CMC_Zellspannung_151_XIX_BMC_HV.DE_BMC_CMC_Zellspannung_151
      SP_IF_BMC_CMC_Zellspannung_151_XIX_BMC_HV: upstream-reference=Geltungsbereich_E3_1_2_Premium.SP_IF_BMC_CMC_Zellspannung_151_XIX_BMC_HV, ecu-extract-reference=COMPOSITIONTYPE.SP_IF_BMC_CMC_Zellspannung_151_XIX_BMC_HV
      BMC_CMC_Zellspannung_152: upstream-reference=Geltungsbereich_E3_1_2_Premium.SP_IF_BMC_CMC_Zellspannung_152_XIX_BMC_HV.DE_BMC_CMC_Zellspannung_152, ecu-extract-reference=COMPOSITIONTYPE.SP_IF_BMC_CMC_Zellspannung_152_XIX_BMC_HV.DE_BMC_CMC_Zellspannung_152
      SP_IF_BMC_CMC_Zellspannung_152_XIX_BMC_HV: upstream-reference=Geltungsbereich_E3_1_2_Premium.SP_IF_BMC_CMC_Zellspannung_152_XIX_BMC_HV, ecu-extract-reference=COMPOSITIONTYPE.SP_IF_BMC_CMC_Zellspannung_152_XIX_BMC_HV
      BMC_CMC_Zellspannung_153: upstream-reference=Geltungsbereich_E3_1_2_Premium.SP_IF_BMC_CMC_Zellspannung_153_XIX_BMC_HV.DE_BMC_CMC_Zellspannung_153, ecu-extract-reference=COMPOSITIONTYPE.SP_IF_BMC_CMC_Zellspannung_153_XIX_BMC_HV.DE_BMC_CMC_Zellspannung_153
      SP_IF_BMC_CMC_Zellspannung_153_XIX_BMC_HV: upstream-reference=Geltungsbereich_E3_1_2_Premium.SP_IF_BMC_CMC_Zellspannung_153_XIX_BMC_HV, ecu-extract-reference=COMPOSITIONTYPE.SP_IF_BMC_CMC_Zellspannung_153_XIX_BMC_HV
      BMC_CMC_Zellspannung_154: upstream-reference=Geltungsbereich_E3_1_2_Premium.SP_IF_BMC_CMC_Zellspannung_154_XIX_BMC_HV.DE_BMC_CMC_Zellspannung_154, ecu-extract-reference=COMPOSITIONTYPE.SP_IF_BMC_CMC_Zellspannung_154_XIX_BMC_HV.DE_BMC_CMC_Zellspannung_154
      SP_IF_BMC_CMC_Zellspannung_154_XIX_BMC_HV: upstream-reference=Geltungsbereich_E3_1_2_Premium.SP_IF_BMC_CMC_Zellspannung_154_XIX_BMC_HV, ecu-extract-reference=COMPOSITIONTYPE.SP_IF_BMC_CMC_Zellspannung_154_XIX_BMC_HV
      BMC_CMC_Zellspannung_155: upstream-reference=Geltungsbereich_E3_1_2_Premium.SP_IF_BMC_CMC_Zellspannung_155_XIX_BMC_HV.DE_BMC_CMC_Zellspannung_155, ecu-extract-reference=COMPOSITIONTYPE.SP_IF_BMC_CMC_Zellspannung_155_XIX_BMC_HV.DE_BMC_CMC_Zellspannung_155
      SP_IF_BMC_CMC_Zellspannung_155_XIX_BMC_HV: upstream-reference=Geltungsbereich_E3_1_2_Premium.SP_IF_BMC_CMC_Zellspannung_155_XIX_BMC_HV, ecu-extract-reference=COMPOSITIONTYPE.SP_IF_BMC_CMC_Zellspannung_155_XIX_BMC_HV
      BMC_CMC_Zellspannung_156: upstream-reference=Geltungsbereich_E3_1_2_Premium.SP_IF_BMC_CMC_Zellspannung_156_XIX_BMC_HV.DE_BMC_CMC_Zellspannung_156, ecu-extract-reference=COMPOSITIONTYPE.SP_IF_BMC_CMC_Zellspannung_156_XIX_BMC_HV.DE_BMC_CMC_Zellspannung_156
      SP_IF_BMC_CMC_Zellspannung_156_XIX_BMC_HV: upstream-reference=Geltungsbereich_E3_1_2_Premium.SP_IF_BMC_CMC_Zellspannung_156_XIX_BMC_HV, ecu-extract-reference=COMPOSITIONTYPE.SP_IF_BMC_CMC_Zellspannung_156_XIX_BMC_HV
      BMC_CMC_Zellspannung_157: upstream-reference=Geltungsbereich_E3_1_2_Premium.SP_IF_BMC_CMC_Zellspannung_157_XIX_BMC_HV.DE_BMC_CMC_Zellspannung_157, ecu-extract-reference=COMPOSITIONTYPE.SP_IF_BMC_CMC_Zellspannung_157_XIX_BMC_HV.DE_BMC_CMC_Zellspannung_157
      SP_IF_BMC_CMC_Zellspannung_157_XIX_BMC_HV: upstream-reference=Geltungsbereich_E3_1_2_Premium.SP_IF_BMC_CMC_Zellspannung_157_XIX_BMC_HV, ecu-extract-reference=COMPOSITIONTYPE.SP_IF_BMC_CMC_Zellspannung_157_XIX_BMC_HV
      BMC_CMC_Zellspannung_158: upstream-reference=Geltungsbereich_E3_1_2_Premium.SP_IF_BMC_CMC_Zellspannung_158_XIX_BMC_HV.DE_BMC_CMC_Zellspannung_158, ecu-extract-reference=COMPOSITIONTYPE.SP_IF_BMC_CMC_Zellspannung_158_XIX_BMC_HV.DE_BMC_CMC_Zellspannung_158
      SP_IF_BMC_CMC_Zellspannung_158_XIX_BMC_HV: upstream-reference=Geltungsbereich_E3_1_2_Premium.SP_IF_BMC_CMC_Zellspannung_158_XIX_BMC_HV, ecu-extract-reference=COMPOSITIONTYPE.SP_IF_BMC_CMC_Zellspannung_158_XIX_BMC_HV
      BMC_CMC_Zellspannung_159: upstream-reference=Geltungsbereich_E3_1_2_Premium.SP_IF_BMC_CMC_Zellspannung_159_XIX_BMC_HV.DE_BMC_CMC_Zellspannung_159, ecu-extract-reference=COMPOSITIONTYPE.SP_IF_BMC_CMC_Zellspannung_159_XIX_BMC_HV.DE_BMC_CMC_Zellspannung_159
      SP_IF_BMC_CMC_Zellspannung_159_XIX_BMC_HV: upstream-reference=Geltungsbereich_E3_1_2_Premium.SP_IF_BMC_CMC_Zellspannung_159_XIX_BMC_HV, ecu-extract-reference=COMPOSITIONTYPE.SP_IF_BMC_CMC_Zellspannung_159_XIX_BMC_HV
      BMC_CMC_Zellspannung_160: upstream-reference=Geltungsbereich_E3_1_2_Premium.SP_IF_BMC_CMC_Zellspannung_160_XIX_BMC_HV.DE_BMC_CMC_Zellspannung_160, ecu-extract-reference=COMPOSITIONTYPE.SP_IF_BMC_CMC_Zellspannung_160_XIX_BMC_HV.DE_BMC_CMC_Zellspannung_160
      SP_IF_BMC_CMC_Zellspannung_160_XIX_BMC_HV: upstream-reference=Geltungsbereich_E3_1_2_Premium.SP_IF_BMC_CMC_Zellspannung_160_XIX_BMC_HV, ecu-extract-reference=COMPOSITIONTYPE.SP_IF_BMC_CMC_Zellspannung_160_XIX_BMC_HV
      BMC_CMC_Zellspannung_161: upstream-reference=Geltungsbereich_E3_1_2_Premium.SP_IF_BMC_CMC_Zellspannung_161_XIX_BMC_HV.DE_BMC_CMC_Zellspannung_161, ecu-extract-reference=COMPOSITIONTYPE.SP_IF_BMC_CMC_Zellspannung_161_XIX_BMC_HV.DE_BMC_CMC_Zellspannung_161
      SP_IF_BMC_CMC_Zellspannung_161_XIX_BMC_HV: upstream-reference=Geltungsbereich_E3_1_2_Premium.SP_IF_BMC_CMC_Zellspannung_161_XIX_BMC_HV, ecu-extract-reference=COMPOSITIONTYPE.SP_IF_BMC_CMC_Zellspannung_161_XIX_BMC_HV
      BMC_CMC_Zellspannung_162: upstream-reference=Geltungsbereich_E3_1_2_Premium.SP_IF_BMC_CMC_Zellspannung_162_XIX_BMC_HV.DE_BMC_CMC_Zellspannung_162, ecu-extract-reference=COMPOSITIONTYPE.SP_IF_BMC_CMC_Zellspannung_162_XIX_BMC_HV.DE_BMC_CMC_Zellspannung_162
      SP_IF_BMC_CMC_Zellspannung_162_XIX_BMC_HV: upstream-reference=Geltungsbereich_E3_1_2_Premium.SP_IF_BMC_CMC_Zellspannung_162_XIX_BMC_HV, ecu-extract-reference=COMPOSITIONTYPE.SP_IF_BMC_CMC_Zellspannung_162_XIX_BMC_HV
      BMC_CMC_Zellspannung_163: upstream-reference=Geltungsbereich_E3_1_2_Premium.SP_IF_BMC_CMC_Zellspannung_163_XIX_BMC_HV.DE_BMC_CMC_Zellspannung_163, ecu-extract-reference=COMPOSITIONTYPE.SP_IF_BMC_CMC_Zellspannung_163_XIX_BMC_HV.DE_BMC_CMC_Zellspannung_163
      SP_IF_BMC_CMC_Zellspannung_163_XIX_BMC_HV: upstream-reference=Geltungsbereich_E3_1_2_Premium.SP_IF_BMC_CMC_Zellspannung_163_XIX_BMC_HV, ecu-extract-reference=COMPOSITIONTYPE.SP_IF_BMC_CMC_Zellspannung_163_XIX_BMC_HV
      BMC_CMC_Zellspannung_164: upstream-reference=Geltungsbereich_E3_1_2_Premium.SP_IF_BMC_CMC_Zellspannung_164_XIX_BMC_HV.DE_BMC_CMC_Zellspannung_164, ecu-extract-reference=COMPOSITIONTYPE.SP_IF_BMC_CMC_Zellspannung_164_XIX_BMC_HV.DE_BMC_CMC_Zellspannung_164
      SP_IF_BMC_CMC_Zellspannung_164_XIX_BMC_HV: upstream-reference=Geltungsbereich_E3_1_2_Premium.SP_IF_BMC_CMC_Zellspannung_164_XIX_BMC_HV, ecu-extract-reference=COMPOSITIONTYPE.SP_IF_BMC_CMC_Zellspannung_164_XIX_BMC_HV
      BMC_CMC_Zellspannung_165: upstream-reference=Geltungsbereich_E3_1_2_Premium.SP_IF_BMC_CMC_Zellspannung_165_XIX_BMC_HV.DE_BMC_CMC_Zellspannung_165, ecu-extract-reference=COMPOSITIONTYPE.SP_IF_BMC_CMC_Zellspannung_165_XIX_BMC_HV.DE_BMC_CMC_Zellspannung_165
      SP_IF_BMC_CMC_Zellspannung_165_XIX_BMC_HV: upstream-reference=Geltungsbereich_E3_1_2_Premium.SP_IF_BMC_CMC_Zellspannung_165_XIX_BMC_HV, ecu-extract-reference=COMPOSITIONTYPE.SP_IF_BMC_CMC_Zellspannung_165_XIX_BMC_HV
      BMC_CMC_Zellspannung_166: upstream-reference=Geltungsbereich_E3_1_2_Premium.SP_IF_BMC_CMC_Zellspannung_166_XIX_BMC_HV.DE_BMC_CMC_Zellspannung_166, ecu-extract-reference=COMPOSITIONTYPE.SP_IF_BMC_CMC_Zellspannung_166_XIX_BMC_HV.DE_BMC_CMC_Zellspannung_166
      SP_IF_BMC_CMC_Zellspannung_166_XIX_BMC_HV: upstream-reference=Geltungsbereich_E3_1_2_Premium.SP_IF_BMC_CMC_Zellspannung_166_XIX_BMC_HV, ecu-extract-reference=COMPOSITIONTYPE.SP_IF_BMC_CMC_Zellspannung_166_XIX_BMC_HV
      BMC_CMC_Zellspannung_167: upstream-reference=Geltungsbereich_E3_1_2_Premium.SP_IF_BMC_CMC_Zellspannung_167_XIX_BMC_HV.DE_BMC_CMC_Zellspannung_167, ecu-extract-reference=COMPOSITIONTYPE.SP_IF_BMC_CMC_Zellspannung_167_XIX_BMC_HV.DE_BMC_CMC_Zellspannung_167
      SP_IF_BMC_CMC_Zellspannung_167_XIX_BMC_HV: upstream-reference=Geltungsbereich_E3_1_2_Premium.SP_IF_BMC_CMC_Zellspannung_167_XIX_BMC_HV, ecu-extract-reference=COMPOSITIONTYPE.SP_IF_BMC_CMC_Zellspannung_167_XIX_BMC_HV
      BMC_CMC_Zellspannung_168: upstream-reference=Geltungsbereich_E3_1_2_Premium.SP_IF_BMC_CMC_Zellspannung_168_XIX_BMC_HV.DE_BMC_CMC_Zellspannung_168, ecu-extract-reference=COMPOSITIONTYPE.SP_IF_BMC_CMC_Zellspannung_168_XIX_BMC_HV.DE_BMC_CMC_Zellspannung_168
      SP_IF_BMC_CMC_Zellspannung_168_XIX_BMC_HV: upstream-reference=Geltungsbereich_E3_1_2_Premium.SP_IF_BMC_CMC_Zellspannung_168_XIX_BMC_HV, ecu-extract-reference=COMPOSITIONTYPE.SP_IF_BMC_CMC_Zellspannung_168_XIX_BMC_HV
      BMC_CMC_Zellspannung_169: upstream-reference=Geltungsbereich_E3_1_2_Premium.SP_IF_BMC_CMC_Zellspannung_169_XIX_BMC_HV.DE_BMC_CMC_Zellspannung_169, ecu-extract-reference=COMPOSITIONTYPE.SP_IF_BMC_CMC_Zellspannung_169_XIX_BMC_HV.DE_BMC_CMC_Zellspannung_169
      SP_IF_BMC_CMC_Zellspannung_169_XIX_BMC_HV: upstream-reference=Geltungsbereich_E3_1_2_Premium.SP_IF_BMC_CMC_Zellspannung_169_XIX_BMC_HV, ecu-extract-reference=COMPOSITIONTYPE.SP_IF_BMC_CMC_Zellspannung_169_XIX_BMC_HV
      BMC_CMC_Zellspannung_170: upstream-reference=Geltungsbereich_E3_1_2_Premium.SP_IF_BMC_CMC_Zellspannung_170_XIX_BMC_HV.DE_BMC_CMC_Zellspannung_170, ecu-extract-reference=COMPOSITIONTYPE.SP_IF_BMC_CMC_Zellspannung_170_XIX_BMC_HV.DE_BMC_CMC_Zellspannung_170
      SP_IF_BMC_CMC_Zellspannung_170_XIX_BMC_HV: upstream-reference=Geltungsbereich_E3_1_2_Premium.SP_IF_BMC_CMC_Zellspannung_170_XIX_BMC_HV, ecu-extract-reference=COMPOSITIONTYPE.SP_IF_BMC_CMC_Zellspannung_170_XIX_BMC_HV
      BMC_CMC_Zellspannung_171: upstream-reference=Geltungsbereich_E3_1_2_Premium.SP_IF_BMC_CMC_Zellspannung_171_XIX_BMC_HV.DE_BMC_CMC_Zellspannung_171, ecu-extract-reference=COMPOSITIONTYPE.SP_IF_BMC_CMC_Zellspannung_171_XIX_BMC_HV.DE_BMC_CMC_Zellspannung_171
      SP_IF_BMC_CMC_Zellspannung_171_XIX_BMC_HV: upstream-reference=Geltungsbereich_E3_1_2_Premium.SP_IF_BMC_CMC_Zellspannung_171_XIX_BMC_HV, ecu-extract-reference=COMPOSITIONTYPE.SP_IF_BMC_CMC_Zellspannung_171_XIX_BMC_HV
      BMC_CMC_Zellspannung_172: upstream-reference=Geltungsbereich_E3_1_2_Premium.SP_IF_BMC_CMC_Zellspannung_172_XIX_BMC_HV.DE_BMC_CMC_Zellspannung_172, ecu-extract-reference=COMPOSITIONTYPE.SP_IF_BMC_CMC_Zellspannung_172_XIX_BMC_HV.DE_BMC_CMC_Zellspannung_172
      SP_IF_BMC_CMC_Zellspannung_172_XIX_BMC_HV: upstream-reference=Geltungsbereich_E3_1_2_Premium.SP_IF_BMC_CMC_Zellspannung_172_XIX_BMC_HV, ecu-extract-reference=COMPOSITIONTYPE.SP_IF_BMC_CMC_Zellspannung_172_XIX_BMC_HV
      BMC_CMC_Zellspannung_173: upstream-reference=Geltungsbereich_E3_1_2_Premium.SP_IF_BMC_CMC_Zellspannung_173_XIX_BMC_HV.DE_BMC_CMC_Zellspannung_173, ecu-extract-reference=COMPOSITIONTYPE.SP_IF_BMC_CMC_Zellspannung_173_XIX_BMC_HV.DE_BMC_CMC_Zellspannung_173
      SP_IF_BMC_CMC_Zellspannung_173_XIX_BMC_HV: upstream-reference=Geltungsbereich_E3_1_2_Premium.SP_IF_BMC_CMC_Zellspannung_173_XIX_BMC_HV, ecu-extract-reference=COMPOSITIONTYPE.SP_IF_BMC_CMC_Zellspannung_173_XIX_BMC_HV
      BMC_CMC_Zellspannung_174: upstream-reference=Geltungsbereich_E3_1_2_Premium.SP_IF_BMC_CMC_Zellspannung_174_XIX_BMC_HV.DE_BMC_CMC_Zellspannung_174, ecu-extract-reference=COMPOSITIONTYPE.SP_IF_BMC_CMC_Zellspannung_174_XIX_BMC_HV.DE_BMC_CMC_Zellspannung_174
      SP_IF_BMC_CMC_Zellspannung_174_XIX_BMC_HV: upstream-reference=Geltungsbereich_E3_1_2_Premium.SP_IF_BMC_CMC_Zellspannung_174_XIX_BMC_HV, ecu-extract-reference=COMPOSITIONTYPE.SP_IF_BMC_CMC_Zellspannung_174_XIX_BMC_HV
      BMC_CMC_Zellspannung_175: upstream-reference=Geltungsbereich_E3_1_2_Premium.SP_IF_BMC_CMC_Zellspannung_175_XIX_BMC_HV.DE_BMC_CMC_Zellspannung_175, ecu-extract-reference=COMPOSITIONTYPE.SP_IF_BMC_CMC_Zellspannung_175_XIX_BMC_HV.DE_BMC_CMC_Zellspannung_175
      SP_IF_BMC_CMC_Zellspannung_175_XIX_BMC_HV: upstream-reference=Geltungsbereich_E3_1_2_Premium.SP_IF_BMC_CMC_Zellspannung_175_XIX_BMC_HV, ecu-extract-reference=COMPOSITIONTYPE.SP_IF_BMC_CMC_Zellspannung_175_XIX_BMC_HV
      BMC_CMC_Zellspannung_176: upstream-reference=Geltungsbereich_E3_1_2_Premium.SP_IF_BMC_CMC_Zellspannung_176_XIX_BMC_HV.DE_BMC_CMC_Zellspannung_176, ecu-extract-reference=COMPOSITIONTYPE.SP_IF_BMC_CMC_Zellspannung_176_XIX_BMC_HV.DE_BMC_CMC_Zellspannung_176
      SP_IF_BMC_CMC_Zellspannung_176_XIX_BMC_HV: upstream-reference=Geltungsbereich_E3_1_2_Premium.SP_IF_BMC_CMC_Zellspannung_176_XIX_BMC_HV, ecu-extract-reference=COMPOSITIONTYPE.SP_IF_BMC_CMC_Zellspannung_176_XIX_BMC_HV
      BMC_CMC_Zellspannung_177: upstream-reference=Geltungsbereich_E3_1_2_Premium.SP_IF_BMC_CMC_Zellspannung_177_XIX_BMC_HV.DE_BMC_CMC_Zellspannung_177, ecu-extract-reference=COMPOSITIONTYPE.SP_IF_BMC_CMC_Zellspannung_177_XIX_BMC_HV.DE_BMC_CMC_Zellspannung_177
      SP_IF_BMC_CMC_Zellspannung_177_XIX_BMC_HV: upstream-reference=Geltungsbereich_E3_1_2_Premium.SP_IF_BMC_CMC_Zellspannung_177_XIX_BMC_HV, ecu-extract-reference=COMPOSITIONTYPE.SP_IF_BMC_CMC_Zellspannung_177_XIX_BMC_HV
      BMC_CMC_Zellspannung_178: upstream-reference=Geltungsbereich_E3_1_2_Premium.SP_IF_BMC_CMC_Zellspannung_178_XIX_BMC_HV.DE_BMC_CMC_Zellspannung_178, ecu-extract-reference=COMPOSITIONTYPE.SP_IF_BMC_CMC_Zellspannung_178_XIX_BMC_HV.DE_BMC_CMC_Zellspannung_178
      SP_IF_BMC_CMC_Zellspannung_178_XIX_BMC_HV: upstream-reference=Geltungsbereich_E3_1_2_Premium.SP_IF_BMC_CMC_Zellspannung_178_XIX_BMC_HV, ecu-extract-reference=COMPOSITIONTYPE.SP_IF_BMC_CMC_Zellspannung_178_XIX_BMC_HV
      BMC_CMC_Zellspannung_179: upstream-reference=Geltungsbereich_E3_1_2_Premium.SP_IF_BMC_CMC_Zellspannung_179_XIX_BMC_HV.DE_BMC_CMC_Zellspannung_179, ecu-extract-reference=COMPOSITIONTYPE.SP_IF_BMC_CMC_Zellspannung_179_XIX_BMC_HV.DE_BMC_CMC_Zellspannung_179
      SP_IF_BMC_CMC_Zellspannung_179_XIX_BMC_HV: upstream-reference=Geltungsbereich_E3_1_2_Premium.SP_IF_BMC_CMC_Zellspannung_179_XIX_BMC_HV, ecu-extract-reference=COMPOSITIONTYPE.SP_IF_BMC_CMC_Zellspannung_179_XIX_BMC_HV
      BMC_CMC_Zellspannung_180: upstream-reference=Geltungsbereich_E3_1_2_Premium.SP_IF_BMC_CMC_Zellspannung_180_XIX_BMC_HV.DE_BMC_CMC_Zellspannung_180, ecu-extract-reference=COMPOSITIONTYPE.SP_IF_BMC_CMC_Zellspannung_180_XIX_BMC_HV.DE_BMC_CMC_Zellspannung_180
      SP_IF_BMC_CMC_Zellspannung_180_XIX_BMC_HV: upstream-reference=Geltungsbereich_E3_1_2_Premium.SP_IF_BMC_CMC_Zellspannung_180_XIX_BMC_HV, ecu-extract-reference=COMPOSITIONTYPE.SP_IF_BMC_CMC_Zellspannung_180_XIX_BMC_HV
      BMC_CMC_Zellspannung_181: upstream-reference=Geltungsbereich_E3_1_2_Premium.SP_IF_BMC_CMC_Zellspannung_181_XIX_BMC_HV.DE_BMC_CMC_Zellspannung_181, ecu-extract-reference=COMPOSITIONTYPE.SP_IF_BMC_CMC_Zellspannung_181_XIX_BMC_HV.DE_BMC_CMC_Zellspannung_181
      SP_IF_BMC_CMC_Zellspannung_181_XIX_BMC_HV: upstream-reference=Geltungsbereich_E3_1_2_Premium.SP_IF_BMC_CMC_Zellspannung_181_XIX_BMC_HV, ecu-extract-reference=COMPOSITIONTYPE.SP_IF_BMC_CMC_Zellspannung_181_XIX_BMC_HV
      BMC_CMC_Zellspannung_182: upstream-reference=Geltungsbereich_E3_1_2_Premium.SP_IF_BMC_CMC_Zellspannung_182_XIX_BMC_HV.DE_BMC_CMC_Zellspannung_182, ecu-extract-reference=COMPOSITIONTYPE.SP_IF_BMC_CMC_Zellspannung_182_XIX_BMC_HV.DE_BMC_CMC_Zellspannung_182
      SP_IF_BMC_CMC_Zellspannung_182_XIX_BMC_HV: upstream-reference=Geltungsbereich_E3_1_2_Premium.SP_IF_BMC_CMC_Zellspannung_182_XIX_BMC_HV, ecu-extract-reference=COMPOSITIONTYPE.SP_IF_BMC_CMC_Zellspannung_182_XIX_BMC_HV
      BMC_CMC_Zellspannung_183: upstream-reference=Geltungsbereich_E3_1_2_Premium.SP_IF_BMC_CMC_Zellspannung_183_XIX_BMC_HV.DE_BMC_CMC_Zellspannung_183, ecu-extract-reference=COMPOSITIONTYPE.SP_IF_BMC_CMC_Zellspannung_183_XIX_BMC_HV.DE_BMC_CMC_Zellspannung_183
      SP_IF_BMC_CMC_Zellspannung_183_XIX_BMC_HV: upstream-reference=Geltungsbereich_E3_1_2_Premium.SP_IF_BMC_CMC_Zellspannung_183_XIX_BMC_HV, ecu-extract-reference=COMPOSITIONTYPE.SP_IF_BMC_CMC_Zellspannung_183_XIX_BMC_HV
      BMC_CMC_Zellspannung_184: upstream-reference=Geltungsbereich_E3_1_2_Premium.SP_IF_BMC_CMC_Zellspannung_184_XIX_BMC_HV.DE_BMC_CMC_Zellspannung_184, ecu-extract-reference=COMPOSITIONTYPE.SP_IF_BMC_CMC_Zellspannung_184_XIX_BMC_HV.DE_BMC_CMC_Zellspannung_184
      SP_IF_BMC_CMC_Zellspannung_184_XIX_BMC_HV: upstream-reference=Geltungsbereich_E3_1_2_Premium.SP_IF_BMC_CMC_Zellspannung_184_XIX_BMC_HV, ecu-extract-reference=COMPOSITIONTYPE.SP_IF_BMC_CMC_Zellspannung_184_XIX_BMC_HV
      BMC_CMC_Zellspannung_185: upstream-reference=Geltungsbereich_E3_1_2_Premium.SP_IF_BMC_CMC_Zellspannung_185_XIX_BMC_HV.DE_BMC_CMC_Zellspannung_185, ecu-extract-reference=COMPOSITIONTYPE.SP_IF_BMC_CMC_Zellspannung_185_XIX_BMC_HV.DE_BMC_CMC_Zellspannung_185
      SP_IF_BMC_CMC_Zellspannung_185_XIX_BMC_HV: upstream-reference=Geltungsbereich_E3_1_2_Premium.SP_IF_BMC_CMC_Zellspannung_185_XIX_BMC_HV, ecu-extract-reference=COMPOSITIONTYPE.SP_IF_BMC_CMC_Zellspannung_185_XIX_BMC_HV
      BMC_CMC_Zellspannung_186: upstream-reference=Geltungsbereich_E3_1_2_Premium.SP_IF_BMC_CMC_Zellspannung_186_XIX_BMC_HV.DE_BMC_CMC_Zellspannung_186, ecu-extract-reference=COMPOSITIONTYPE.SP_IF_BMC_CMC_Zellspannung_186_XIX_BMC_HV.DE_BMC_CMC_Zellspannung_186
      SP_IF_BMC_CMC_Zellspannung_186_XIX_BMC_HV: upstream-reference=Geltungsbereich_E3_1_2_Premium.SP_IF_BMC_CMC_Zellspannung_186_XIX_BMC_HV, ecu-extract-reference=COMPOSITIONTYPE.SP_IF_BMC_CMC_Zellspannung_186_XIX_BMC_HV
      BMC_CMC_Zellspannung_187: upstream-reference=Geltungsbereich_E3_1_2_Premium.SP_IF_BMC_CMC_Zellspannung_187_XIX_BMC_HV.DE_BMC_CMC_Zellspannung_187, ecu-extract-reference=COMPOSITIONTYPE.SP_IF_BMC_CMC_Zellspannung_187_XIX_BMC_HV.DE_BMC_CMC_Zellspannung_187
      SP_IF_BMC_CMC_Zellspannung_187_XIX_BMC_HV: upstream-reference=Geltungsbereich_E3_1_2_Premium.SP_IF_BMC_CMC_Zellspannung_187_XIX_BMC_HV, ecu-extract-reference=COMPOSITIONTYPE.SP_IF_BMC_CMC_Zellspannung_187_XIX_BMC_HV
      BMC_CMC_Zellspannung_188: upstream-reference=Geltungsbereich_E3_1_2_Premium.SP_IF_BMC_CMC_Zellspannung_188_XIX_BMC_HV.DE_BMC_CMC_Zellspannung_188, ecu-extract-reference=COMPOSITIONTYPE.SP_IF_BMC_CMC_Zellspannung_188_XIX_BMC_HV.DE_BMC_CMC_Zellspannung_188
      SP_IF_BMC_CMC_Zellspannung_188_XIX_BMC_HV: upstream-reference=Geltungsbereich_E3_1_2_Premium.SP_IF_BMC_CMC_Zellspannung_188_XIX_BMC_HV, ecu-extract-reference=COMPOSITIONTYPE.SP_IF_BMC_CMC_Zellspannung_188_XIX_BMC_HV
      BMC_CMC_Zellspannung_189: upstream-reference=Geltungsbereich_E3_1_2_Premium.SP_IF_BMC_CMC_Zellspannung_189_XIX_BMC_HV.DE_BMC_CMC_Zellspannung_189, ecu-extract-reference=COMPOSITIONTYPE.SP_IF_BMC_CMC_Zellspannung_189_XIX_BMC_HV.DE_BMC_CMC_Zellspannung_189
      SP_IF_BMC_CMC_Zellspannung_189_XIX_BMC_HV: upstream-reference=Geltungsbereich_E3_1_2_Premium.SP_IF_BMC_CMC_Zellspannung_189_XIX_BMC_HV, ecu-extract-reference=COMPOSITIONTYPE.SP_IF_BMC_CMC_Zellspannung_189_XIX_BMC_HV
      BMC_CMC_Zellspannung_190: upstream-reference=Geltungsbereich_E3_1_2_Premium.SP_IF_BMC_CMC_Zellspannung_190_XIX_BMC_HV.DE_BMC_CMC_Zellspannung_190, ecu-extract-reference=COMPOSITIONTYPE.SP_IF_BMC_CMC_Zellspannung_190_XIX_BMC_HV.DE_BMC_CMC_Zellspannung_190
      SP_IF_BMC_CMC_Zellspannung_190_XIX_BMC_HV: upstream-reference=Geltungsbereich_E3_1_2_Premium.SP_IF_BMC_CMC_Zellspannung_190_XIX_BMC_HV, ecu-extract-reference=COMPOSITIONTYPE.SP_IF_BMC_CMC_Zellspannung_190_XIX_BMC_HV
      BMC_CMC_Zellspannung_191: upstream-reference=Geltungsbereich_E3_1_2_Premium.SP_IF_BMC_CMC_Zellspannung_191_XIX_BMC_HV.DE_BMC_CMC_Zellspannung_191, ecu-extract-reference=COMPOSITIONTYPE.SP_IF_BMC_CMC_Zellspannung_191_XIX_BMC_HV.DE_BMC_CMC_Zellspannung_191
      SP_IF_BMC_CMC_Zellspannung_191_XIX_BMC_HV: upstream-reference=Geltungsbereich_E3_1_2_Premium.SP_IF_BMC_CMC_Zellspannung_191_XIX_BMC_HV, ecu-extract-reference=COMPOSITIONTYPE.SP_IF_BMC_CMC_Zellspannung_191_XIX_BMC_HV
      BMC_CMC_Zellspannung_192: upstream-reference=Geltungsbereich_E3_1_2_Premium.SP_IF_BMC_CMC_Zellspannung_192_XIX_BMC_HV.DE_BMC_CMC_Zellspannung_192, ecu-extract-reference=COMPOSITIONTYPE.SP_IF_BMC_CMC_Zellspannung_192_XIX_BMC_HV.DE_BMC_CMC_Zellspannung_192
      SP_IF_BMC_CMC_Zellspannung_192_XIX_BMC_HV: upstream-reference=Geltungsbereich_E3_1_2_Premium.SP_IF_BMC_CMC_Zellspannung_192_XIX_BMC_HV, ecu-extract-reference=COMPOSITIONTYPE.SP_IF_BMC_CMC_Zellspannung_192_XIX_BMC_HV
      SP_IF_BMC_Datenuebernahme_Anf_XIX_BMC_HV: upstream-reference=Geltungsbereich_E3_1_2_Premium.SP_IF_BMC_Datenuebernahme_Anf_XIX_BMC_HV, ecu-extract-reference=COMPOSITIONTYPE.SP_IF_BMC_Datenuebernahme_Anf_XIX_BMC_HV
      BMC_Dauer_Entladeleistung_02: upstream-reference=Geltungsbereich_E3_1_2_Premium.SP_IF_BMC_Dauer_Entladeleistung_02_XIX_BMC_HV.DE_BMC_Dauer_Entladeleistung_02, ecu-extract-reference=COMPOSITIONTYPE.SP_IF_BMC_Dauer_Entladeleistung_02_XIX_BMC_HV.DE_BMC_Dauer_Entladeleistung_02
      SP_IF_BMC_Dauer_Entladeleistung_02_XIX_BMC_HV: upstream-reference=Geltungsbereich_E3_1_2_Premium.SP_IF_BMC_Dauer_Entladeleistung_02_XIX_BMC_HV, ecu-extract-reference=COMPOSITIONTYPE.SP_IF_BMC_Dauer_Entladeleistung_02_XIX_BMC_HV
      BMC_Dauer_Entladeleistung: upstream-reference=Geltungsbereich_E3_1_2_Premium.SP_IF_BMC_Dauer_Entladeleistung_XIX_BMC_HV.DE_BMC_Dauer_Entladeleistung, ecu-extract-reference=COMPOSITIONTYPE.SP_IF_BMC_Dauer_Entladeleistung_XIX_BMC_HV.DE_BMC_Dauer_Entladeleistung
      SP_IF_BMC_Dauer_Entladeleistung_XIX_BMC_HV: upstream-reference=Geltungsbereich_E3_1_2_Premium.SP_IF_BMC_Dauer_Entladeleistung_XIX_BMC_HV, ecu-extract-reference=COMPOSITIONTYPE.SP_IF_BMC_Dauer_Entladeleistung_XIX_BMC_HV
      BMC_Dauer_Ladeleistung_02: upstream-reference=Geltungsbereich_E3_1_2_Premium.SP_IF_BMC_Dauer_Ladeleistung_02_XIX_BMC_HV.DE_BMC_Dauer_Ladeleistung_02, ecu-extract-reference=COMPOSITIONTYPE.SP_IF_BMC_Dauer_Ladeleistung_02_XIX_BMC_HV.DE_BMC_Dauer_Ladeleistung_02
      SP_IF_BMC_Dauer_Ladeleistung_02_XIX_BMC_HV: upstream-reference=Geltungsbereich_E3_1_2_Premium.SP_IF_BMC_Dauer_Ladeleistung_02_XIX_BMC_HV, ecu-extract-reference=COMPOSITIONTYPE.SP_IF_BMC_Dauer_Ladeleistung_02_XIX_BMC_HV
      BMC_Dauer_Ladeleistung: upstream-reference=Geltungsbereich_E3_1_2_Premium.SP_IF_BMC_Dauer_Ladeleistung_XIX_BMC_HV.DE_BMC_Dauer_Ladeleistung, ecu-extract-reference=COMPOSITIONTYPE.SP_IF_BMC_Dauer_Ladeleistung_XIX_BMC_HV.DE_BMC_Dauer_Ladeleistung
      SP_IF_BMC_Dauer_Ladeleistung_XIX_BMC_HV: upstream-reference=Geltungsbereich_E3_1_2_Premium.SP_IF_BMC_Dauer_Ladeleistung_XIX_BMC_HV, ecu-extract-reference=COMPOSITIONTYPE.SP_IF_BMC_Dauer_Ladeleistung_XIX_BMC_HV
      SP_IF_BMC_DC_Laden_XIX_BMC_HV: upstream-reference=Geltungsbereich_E3_1_2_Premium.SP_IF_BMC_DC_Laden_XIX_BMC_HV, ecu-extract-reference=COMPOSITIONTYPE.SP_IF_BMC_DC_Laden_XIX_BMC_HV
      SP_IF_BMC_Dev_Freigabe_XIX_BMC_HV: upstream-reference=Geltungsbereich_E3_1_2_Premium.SP_IF_BMC_Dev_Freigabe_XIX_BMC_HV, ecu-extract-reference=COMPOSITIONTYPE.SP_IF_BMC_Dev_Freigabe_XIX_BMC_HV
      BMC_Energie_Entladen: upstream-reference=Geltungsbereich_E3_1_2_Premium.SP_IF_BMC_Energie_Entladen_XIX_BMC_HV.DE_BMC_Energie_Entladen, ecu-extract-reference=COMPOSITIONTYPE.SP_IF_BMC_Energie_Entladen_XIX_BMC_HV.DE_BMC_Energie_Entladen
      SP_IF_BMC_Energie_Entladen_XIX_BMC_HV: upstream-reference=Geltungsbereich_E3_1_2_Premium.SP_IF_BMC_Energie_Entladen_XIX_BMC_HV, ecu-extract-reference=COMPOSITIONTYPE.SP_IF_BMC_Energie_Entladen_XIX_BMC_HV
      BMC_Energie_Laden: upstream-reference=Geltungsbereich_E3_1_2_Premium.SP_IF_BMC_Energie_Laden_XIX_BMC_HV.DE_BMC_Energie_Laden, ecu-extract-reference=COMPOSITIONTYPE.SP_IF_BMC_Energie_Laden_XIX_BMC_HV.DE_BMC_Energie_Laden
      SP_IF_BMC_Energie_Laden_XIX_BMC_HV: upstream-reference=Geltungsbereich_E3_1_2_Premium.SP_IF_BMC_Energie_Laden_XIX_BMC_HV, ecu-extract-reference=COMPOSITIONTYPE.SP_IF_BMC_Energie_Laden_XIX_BMC_HV
      SP_IF_BMC_Energie_Sockel_SoC_XIX_BMC_HV: upstream-reference=Geltungsbereich_E3_1_2_Premium.SP_IF_BMC_Energie_Sockel_SoC_XIX_BMC_HV, ecu-extract-reference=COMPOSITIONTYPE.SP_IF_BMC_Energie_Sockel_SoC_XIX_BMC_HV
      SP_IF_BMC_Energieinhalt_XIX_BMC_HV: upstream-reference=Geltungsbereich_E3_1_2_Premium.SP_IF_BMC_Energieinhalt_XIX_BMC_HV, ecu-extract-reference=COMPOSITIONTYPE.SP_IF_BMC_Energieinhalt_XIX_BMC_HV
      BMC_EnergieVorhalt: upstream-reference=Geltungsbereich_E3_1_2_Premium.SP_IF_BMC_EnergieVorhalt_XIX_BMC_HV.DE_BMC_EnergieVorhalt, ecu-extract-reference=COMPOSITIONTYPE.SP_IF_BMC_EnergieVorhalt_XIX_BMC_HV.DE_BMC_EnergieVorhalt
      SP_IF_BMC_EnergieVorhalt_XIX_BMC_HV: upstream-reference=Geltungsbereich_E3_1_2_Premium.SP_IF_BMC_EnergieVorhalt_XIX_BMC_HV, ecu-extract-reference=COMPOSITIONTYPE.SP_IF_BMC_EnergieVorhalt_XIX_BMC_HV
      BMC_ExtLadeleistung: upstream-reference=Geltungsbereich_E3_1_2_Premium.SP_IF_BMC_ExtLadeleistung_XIX_BMC_HV.DE_BMC_ExtLadeleistung, ecu-extract-reference=COMPOSITIONTYPE.SP_IF_BMC_ExtLadeleistung_XIX_BMC_HV.DE_BMC_ExtLadeleistung
      SP_IF_BMC_ExtLadeleistung_XIX_BMC_HV: upstream-reference=Geltungsbereich_E3_1_2_Premium.SP_IF_BMC_ExtLadeleistung_XIX_BMC_HV, ecu-extract-reference=COMPOSITIONTYPE.SP_IF_BMC_ExtLadeleistung_XIX_BMC_HV
      SP_IF_BMC_Fehler_Leistungsred_XIX_BMC_HV: upstream-reference=Geltungsbereich_E3_1_2_Premium.SP_IF_BMC_Fehler_Leistungsred_XIX_BMC_HV, ecu-extract-reference=COMPOSITIONTYPE.SP_IF_BMC_Fehler_Leistungsred_XIX_BMC_HV
      SP_IF_BMC_Fehler_Warnung_XIX_BMC_HV: upstream-reference=Geltungsbereich_E3_1_2_Premium.SP_IF_BMC_Fehler_Warnung_XIX_BMC_HV, ecu-extract-reference=COMPOSITIONTYPE.SP_IF_BMC_Fehler_Warnung_XIX_BMC_HV
      SP_IF_BMC_Flash_Freigabe_XIX_BMC_HV: upstream-reference=Geltungsbereich_E3_1_2_Premium.SP_IF_BMC_Flash_Freigabe_XIX_BMC_HV, ecu-extract-reference=COMPOSITIONTYPE.SP_IF_BMC_Flash_Freigabe_XIX_BMC_HV
      SP_IF_BMC_HV_01_BZ_XIX_BMC_HV: upstream-reference=Geltungsbereich_E3_1_2_Premium.SP_IF_BMC_HV_01_BZ_XIX_BMC_HV, ecu-extract-reference=COMPOSITIONTYPE.SP_IF_BMC_HV_01_BZ_XIX_BMC_HV
      SP_IF_BMC_HV_01_CRC_XIX_BMC_HV: upstream-reference=Geltungsbereich_E3_1_2_Premium.SP_IF_BMC_HV_01_CRC_XIX_BMC_HV, ecu-extract-reference=COMPOSITIONTYPE.SP_IF_BMC_HV_01_CRC_XIX_BMC_HV
      SP_IF_BMC_HV_02_BZ_XIX_BMC_HV: upstream-reference=Geltungsbereich_E3_1_2_Premium.SP_IF_BMC_HV_02_BZ_XIX_BMC_HV, ecu-extract-reference=COMPOSITIONTYPE.SP_IF_BMC_HV_02_BZ_XIX_BMC_HV
      SP_IF_BMC_HV_02_CRC_XIX_BMC_HV: upstream-reference=Geltungsbereich_E3_1_2_Premium.SP_IF_BMC_HV_02_CRC_XIX_BMC_HV, ecu-extract-reference=COMPOSITIONTYPE.SP_IF_BMC_HV_02_CRC_XIX_BMC_HV
      SP_IF_BMC_HV_04_BZ_XIX_BMC_HV: upstream-reference=Geltungsbereich_E3_1_2_Premium.SP_IF_BMC_HV_04_BZ_XIX_BMC_HV, ecu-extract-reference=COMPOSITIONTYPE.SP_IF_BMC_HV_04_BZ_XIX_BMC_HV
      SP_IF_BMC_HV_04_CRC_XIX_BMC_HV: upstream-reference=Geltungsbereich_E3_1_2_Premium.SP_IF_BMC_HV_04_CRC_XIX_BMC_HV, ecu-extract-reference=COMPOSITIONTYPE.SP_IF_BMC_HV_04_CRC_XIX_BMC_HV
      SP_IF_BMC_HV_10_BZ_XIX_BMC_HV: upstream-reference=Geltungsbereich_E3_1_2_Premium.SP_IF_BMC_HV_10_BZ_XIX_BMC_HV, ecu-extract-reference=COMPOSITIONTYPE.SP_IF_BMC_HV_10_BZ_XIX_BMC_HV
      SP_IF_BMC_HV_10_CRC_XIX_BMC_HV: upstream-reference=Geltungsbereich_E3_1_2_Premium.SP_IF_BMC_HV_10_CRC_XIX_BMC_HV, ecu-extract-reference=COMPOSITIONTYPE.SP_IF_BMC_HV_10_CRC_XIX_BMC_HV
      SP_IF_BMC_HV_11_BZ_XIX_BMC_HV: upstream-reference=Geltungsbereich_E3_1_2_Premium.SP_IF_BMC_HV_11_BZ_XIX_BMC_HV, ecu-extract-reference=COMPOSITIONTYPE.SP_IF_BMC_HV_11_BZ_XIX_BMC_HV
      SP_IF_BMC_HV_11_CRC_XIX_BMC_HV: upstream-reference=Geltungsbereich_E3_1_2_Premium.SP_IF_BMC_HV_11_CRC_XIX_BMC_HV, ecu-extract-reference=COMPOSITIONTYPE.SP_IF_BMC_HV_11_CRC_XIX_BMC_HV
      SP_IF_BMC_HV_12_BZ_XIX_BMC_HV: upstream-reference=Geltungsbereich_E3_1_2_Premium.SP_IF_BMC_HV_12_BZ_XIX_BMC_HV, ecu-extract-reference=COMPOSITIONTYPE.SP_IF_BMC_HV_12_BZ_XIX_BMC_HV
      SP_IF_BMC_HV_12_CRC_XIX_BMC_HV: upstream-reference=Geltungsbereich_E3_1_2_Premium.SP_IF_BMC_HV_12_CRC_XIX_BMC_HV, ecu-extract-reference=COMPOSITIONTYPE.SP_IF_BMC_HV_12_CRC_XIX_BMC_HV
      SP_IF_BMC_HV_13_BZ_XIX_BMC_HV: upstream-reference=Geltungsbereich_E3_1_2_Premium.SP_IF_BMC_HV_13_BZ_XIX_BMC_HV, ecu-extract-reference=COMPOSITIONTYPE.SP_IF_BMC_HV_13_BZ_XIX_BMC_HV
      SP_IF_BMC_HV_13_CRC_XIX_BMC_HV: upstream-reference=Geltungsbereich_E3_1_2_Premium.SP_IF_BMC_HV_13_CRC_XIX_BMC_HV, ecu-extract-reference=COMPOSITIONTYPE.SP_IF_BMC_HV_13_CRC_XIX_BMC_HV
      SP_IF_BMC_HVK_EoHVL_Status_XIX_BMC_HV: upstream-reference=Geltungsbereich_E3_1_2_Premium.SP_IF_BMC_HVK_EoHVL_Status_XIX_BMC_HV, ecu-extract-reference=COMPOSITIONTYPE.SP_IF_BMC_HVK_EoHVL_Status_XIX_BMC_HV
      SP_IF_BMC_HVK_Fehler_HVIL_XIX_BMC_HV: upstream-reference=Geltungsbereich_E3_1_2_Premium.SP_IF_BMC_HVK_Fehler_HVIL_XIX_BMC_HV, ecu-extract-reference=COMPOSITIONTYPE.SP_IF_BMC_HVK_Fehler_HVIL_XIX_BMC_HV
      SP_IF_BMC_HVK_Fehler_Intern_XIX_BMC_HV: upstream-reference=Geltungsbereich_E3_1_2_Premium.SP_IF_BMC_HVK_Fehler_Intern_XIX_BMC_HV, ecu-extract-reference=COMPOSITIONTYPE.SP_IF_BMC_HVK_Fehler_Intern_XIX_BMC_HV
      SP_IF_BMC_HVK_Fehler_SD_XIX_BMC_HV: upstream-reference=Geltungsbereich_E3_1_2_Premium.SP_IF_BMC_HVK_Fehler_SD_XIX_BMC_HV, ecu-extract-reference=COMPOSITIONTYPE.SP_IF_BMC_HVK_Fehler_SD_XIX_BMC_HV
      SP_IF_BMC_Iso_Mode_Anf_XIX_BMC_HV: upstream-reference=Geltungsbereich_E3_1_2_Premium.SP_IF_BMC_Iso_Mode_Anf_XIX_BMC_HV, ecu-extract-reference=COMPOSITIONTYPE.SP_IF_BMC_Iso_Mode_Anf_XIX_BMC_HV
      BMC_IstTemperaturMax_Modul_ID: upstream-reference=Geltungsbereich_E3_1_2_Premium.SP_IF_BMC_IstTemperaturMax_Modul_ID_XIX_BMC_HV.DE_BMC_IstTemperaturMax_Modul_ID, ecu-extract-reference=COMPOSITIONTYPE.SP_IF_BMC_IstTemperaturMax_Modul_ID_XIX_BMC_HV.DE_BMC_IstTemperaturMax_Modul_ID
      SP_IF_BMC_IstTemperaturMax_Modul_ID_XIX_BMC_HV: upstream-reference=Geltungsbereich_E3_1_2_Premium.SP_IF_BMC_IstTemperaturMax_Modul_ID_XIX_BMC_HV, ecu-extract-reference=COMPOSITIONTYPE.SP_IF_BMC_IstTemperaturMax_Modul_ID_XIX_BMC_HV
      BMC_IstTemperaturMax_Sensor_ID: upstream-reference=Geltungsbereich_E3_1_2_Premium.SP_IF_BMC_IstTemperaturMax_Sensor_ID_XIX_BMC_HV.DE_BMC_IstTemperaturMax_Sensor_ID, ecu-extract-reference=COMPOSITIONTYPE.SP_IF_BMC_IstTemperaturMax_Sensor_ID_XIX_BMC_HV.DE_BMC_IstTemperaturMax_Sensor_ID
      SP_IF_BMC_IstTemperaturMax_Sensor_ID_XIX_BMC_HV: upstream-reference=Geltungsbereich_E3_1_2_Premium.SP_IF_BMC_IstTemperaturMax_Sensor_ID_XIX_BMC_HV, ecu-extract-reference=COMPOSITIONTYPE.SP_IF_BMC_IstTemperaturMax_Sensor_ID_XIX_BMC_HV
      BMC_IstTemperaturMin_Modul_ID: upstream-reference=Geltungsbereich_E3_1_2_Premium.SP_IF_BMC_IstTemperaturMin_Modul_ID_XIX_BMC_HV.DE_BMC_IstTemperaturMin_Modul_ID, ecu-extract-reference=COMPOSITIONTYPE.SP_IF_BMC_IstTemperaturMin_Modul_ID_XIX_BMC_HV.DE_BMC_IstTemperaturMin_Modul_ID
      SP_IF_BMC_IstTemperaturMin_Modul_ID_XIX_BMC_HV: upstream-reference=Geltungsbereich_E3_1_2_Premium.SP_IF_BMC_IstTemperaturMin_Modul_ID_XIX_BMC_HV, ecu-extract-reference=COMPOSITIONTYPE.SP_IF_BMC_IstTemperaturMin_Modul_ID_XIX_BMC_HV
      BMC_IstTemperaturMin_Sensor_ID: upstream-reference=Geltungsbereich_E3_1_2_Premium.SP_IF_BMC_IstTemperaturMin_Sensor_ID_XIX_BMC_HV.DE_BMC_IstTemperaturMin_Sensor_ID, ecu-extract-reference=COMPOSITIONTYPE.SP_IF_BMC_IstTemperaturMin_Sensor_ID_XIX_BMC_HV.DE_BMC_IstTemperaturMin_Sensor_ID
      SP_IF_BMC_IstTemperaturMin_Sensor_ID_XIX_BMC_HV: upstream-reference=Geltungsbereich_E3_1_2_Premium.SP_IF_BMC_IstTemperaturMin_Sensor_ID_XIX_BMC_HV, ecu-extract-reference=COMPOSITIONTYPE.SP_IF_BMC_IstTemperaturMin_Sensor_ID_XIX_BMC_HV
      BMC_IstZellSpannungMax_Modul_ID: upstream-reference=Geltungsbereich_E3_1_2_Premium.SP_IF_BMC_IstZellSpannungMax_Modul_ID_XIX_BMC_HV.DE_BMC_IstZellSpannungMax_Modul_ID, ecu-extract-reference=COMPOSITIONTYPE.SP_IF_BMC_IstZellSpannungMax_Modul_ID_XIX_BMC_HV.DE_BMC_IstZellSpannungMax_Modul_ID
      SP_IF_BMC_IstZellSpannungMax_Modul_ID_XIX_BMC_HV: upstream-reference=Geltungsbereich_E3_1_2_Premium.SP_IF_BMC_IstZellSpannungMax_Modul_ID_XIX_BMC_HV, ecu-extract-reference=COMPOSITIONTYPE.SP_IF_BMC_IstZellSpannungMax_Modul_ID_XIX_BMC_HV
      SP_IF_BMC_IstZellspannungMax_XIX_BMC_HV: upstream-reference=Geltungsbereich_E3_1_2_Premium.SP_IF_BMC_IstZellspannungMax_XIX_BMC_HV, ecu-extract-reference=COMPOSITIONTYPE.SP_IF_BMC_IstZellspannungMax_XIX_BMC_HV
      BMC_IstZellSpannungMax_Zell_ID: upstream-reference=Geltungsbereich_E3_1_2_Premium.SP_IF_BMC_IstZellSpannungMax_Zell_ID_XIX_BMC_HV.DE_BMC_IstZellSpannungMax_Zell_ID, ecu-extract-reference=COMPOSITIONTYPE.SP_IF_BMC_IstZellSpannungMax_Zell_ID_XIX_BMC_HV.DE_BMC_IstZellSpannungMax_Zell_ID
      SP_IF_BMC_IstZellSpannungMax_Zell_ID_XIX_BMC_HV: upstream-reference=Geltungsbereich_E3_1_2_Premium.SP_IF_BMC_IstZellSpannungMax_Zell_ID_XIX_BMC_HV, ecu-extract-reference=COMPOSITIONTYPE.SP_IF_BMC_IstZellSpannungMax_Zell_ID_XIX_BMC_HV
      BMC_IstZellSpannungMin_Modul_ID: upstream-reference=Geltungsbereich_E3_1_2_Premium.SP_IF_BMC_IstZellSpannungMin_Modul_ID_XIX_BMC_HV.DE_BMC_IstZellSpannungMin_Modul_ID, ecu-extract-reference=COMPOSITIONTYPE.SP_IF_BMC_IstZellSpannungMin_Modul_ID_XIX_BMC_HV.DE_BMC_IstZellSpannungMin_Modul_ID
      SP_IF_BMC_IstZellSpannungMin_Modul_ID_XIX_BMC_HV: upstream-reference=Geltungsbereich_E3_1_2_Premium.SP_IF_BMC_IstZellSpannungMin_Modul_ID_XIX_BMC_HV, ecu-extract-reference=COMPOSITIONTYPE.SP_IF_BMC_IstZellSpannungMin_Modul_ID_XIX_BMC_HV
      SP_IF_BMC_IstZellspannungMin_XIX_BMC_HV: upstream-reference=Geltungsbereich_E3_1_2_Premium.SP_IF_BMC_IstZellspannungMin_XIX_BMC_HV, ecu-extract-reference=COMPOSITIONTYPE.SP_IF_BMC_IstZellspannungMin_XIX_BMC_HV
      BMC_IstZellSpannungMin_Zell_ID: upstream-reference=Geltungsbereich_E3_1_2_Premium.SP_IF_BMC_IstZellSpannungMin_Zell_ID_XIX_BMC_HV.DE_BMC_IstZellSpannungMin_Zell_ID, ecu-extract-reference=COMPOSITIONTYPE.SP_IF_BMC_IstZellSpannungMin_Zell_ID_XIX_BMC_HV.DE_BMC_IstZellSpannungMin_Zell_ID
      SP_IF_BMC_IstZellSpannungMin_Zell_ID_XIX_BMC_HV: upstream-reference=Geltungsbereich_E3_1_2_Premium.SP_IF_BMC_IstZellSpannungMin_Zell_ID_XIX_BMC_HV, ecu-extract-reference=COMPOSITIONTYPE.SP_IF_BMC_IstZellSpannungMin_Zell_ID_XIX_BMC_HV
      SP_IF_BMC_IWU_Status_XIX_BMC_HV: upstream-reference=Geltungsbereich_E3_1_2_Premium.SP_IF_BMC_IWU_Status_XIX_BMC_HV, ecu-extract-reference=COMPOSITIONTYPE.SP_IF_BMC_IWU_Status_XIX_BMC_HV
      SP_IF_BMC_IWU_Wert_neg_XIX_BMC_HV: upstream-reference=Geltungsbereich_E3_1_2_Premium.SP_IF_BMC_IWU_Wert_neg_XIX_BMC_HV, ecu-extract-reference=COMPOSITIONTYPE.SP_IF_BMC_IWU_Wert_neg_XIX_BMC_HV
      SP_IF_BMC_IWU_Wert_pos_XIX_BMC_HV: upstream-reference=Geltungsbereich_E3_1_2_Premium.SP_IF_BMC_IWU_Wert_pos_XIX_BMC_HV, ecu-extract-reference=COMPOSITIONTYPE.SP_IF_BMC_IWU_Wert_pos_XIX_BMC_HV
      SP_IF_BMC_Konditionierung_Anf_XIX_BMC_HV: upstream-reference=Geltungsbereich_E3_1_2_Premium.SP_IF_BMC_Konditionierung_Anf_XIX_BMC_HV, ecu-extract-reference=COMPOSITIONTYPE.SP_IF_BMC_Konditionierung_Anf_XIX_BMC_HV
      SP_IF_BMC_KundenWarnung_XIX_BMC_HV: upstream-reference=Geltungsbereich_E3_1_2_Premium.SP_IF_BMC_KundenWarnung_XIX_BMC_HV, ecu-extract-reference=COMPOSITIONTYPE.SP_IF_BMC_KundenWarnung_XIX_BMC_HV
      SP_IF_BMC_Lebensdauer_Trennelemente_XIX_BMC_HV: upstream-reference=Geltungsbereich_E3_1_2_Premium.SP_IF_BMC_Lebensdauer_Trennelemente_XIX_BMC_HV, ecu-extract-reference=COMPOSITIONTYPE.SP_IF_BMC_Lebensdauer_Trennelemente_XIX_BMC_HV
      SP_IF_BMC_Leerlaufspannung_XIX_BMC_HV: upstream-reference=Geltungsbereich_E3_1_2_Premium.SP_IF_BMC_Leerlaufspannung_XIX_BMC_HV, ecu-extract-reference=COMPOSITIONTYPE.SP_IF_BMC_Leerlaufspannung_XIX_BMC_HV
      BMC_Max_Entladeleistung_02: upstream-reference=Geltungsbereich_E3_1_2_Premium.SP_IF_BMC_Max_Entladeleistung_02_XIX_BMC_HV.DE_BMC_Max_Entladeleistung_02, ecu-extract-reference=COMPOSITIONTYPE.SP_IF_BMC_Max_Entladeleistung_02_XIX_BMC_HV.DE_BMC_Max_Entladeleistung_02
      SP_IF_BMC_Max_Entladeleistung_02_XIX_BMC_HV: upstream-reference=Geltungsbereich_E3_1_2_Premium.SP_IF_BMC_Max_Entladeleistung_02_XIX_BMC_HV, ecu-extract-reference=COMPOSITIONTYPE.SP_IF_BMC_Max_Entladeleistung_02_XIX_BMC_HV
      SP_IF_BMC_Max_Entladeleistung_XIX_BMC_HV: upstream-reference=Geltungsbereich_E3_1_2_Premium.SP_IF_BMC_Max_Entladeleistung_XIX_BMC_HV, ecu-extract-reference=COMPOSITIONTYPE.SP_IF_BMC_Max_Entladeleistung_XIX_BMC_HV
      BMC_Max_Entladestrom_02: upstream-reference=Geltungsbereich_E3_1_2_Premium.SP_IF_BMC_Max_Entladestrom_02_XIX_BMC_HV.DE_BMC_Max_Entladestrom_02, ecu-extract-reference=COMPOSITIONTYPE.SP_IF_BMC_Max_Entladestrom_02_XIX_BMC_HV.DE_BMC_Max_Entladestrom_02
      SP_IF_BMC_Max_Entladestrom_02_XIX_BMC_HV: upstream-reference=Geltungsbereich_E3_1_2_Premium.SP_IF_BMC_Max_Entladestrom_02_XIX_BMC_HV, ecu-extract-reference=COMPOSITIONTYPE.SP_IF_BMC_Max_Entladestrom_02_XIX_BMC_HV
      SP_IF_BMC_Max_Entladestrom_XIX_BMC_HV: upstream-reference=Geltungsbereich_E3_1_2_Premium.SP_IF_BMC_Max_Entladestrom_XIX_BMC_HV, ecu-extract-reference=COMPOSITIONTYPE.SP_IF_BMC_Max_Entladestrom_XIX_BMC_HV
      BMC_Max_Ladeleistung_02: upstream-reference=Geltungsbereich_E3_1_2_Premium.SP_IF_BMC_Max_Ladeleistung_02_XIX_BMC_HV.DE_BMC_Max_Ladeleistung_02, ecu-extract-reference=COMPOSITIONTYPE.SP_IF_BMC_Max_Ladeleistung_02_XIX_BMC_HV.DE_BMC_Max_Ladeleistung_02
      SP_IF_BMC_Max_Ladeleistung_02_XIX_BMC_HV: upstream-reference=Geltungsbereich_E3_1_2_Premium.SP_IF_BMC_Max_Ladeleistung_02_XIX_BMC_HV, ecu-extract-reference=COMPOSITIONTYPE.SP_IF_BMC_Max_Ladeleistung_02_XIX_BMC_HV
      SP_IF_BMC_Max_Ladeleistung_XIX_BMC_HV: upstream-reference=Geltungsbereich_E3_1_2_Premium.SP_IF_BMC_Max_Ladeleistung_XIX_BMC_HV, ecu-extract-reference=COMPOSITIONTYPE.SP_IF_BMC_Max_Ladeleistung_XIX_BMC_HV
      BMC_Max_Ladestrom_02: upstream-reference=Geltungsbereich_E3_1_2_Premium.SP_IF_BMC_Max_Ladestrom_02_XIX_BMC_HV.DE_BMC_Max_Ladestrom_02, ecu-extract-reference=COMPOSITIONTYPE.SP_IF_BMC_Max_Ladestrom_02_XIX_BMC_HV.DE_BMC_Max_Ladestrom_02
      SP_IF_BMC_Max_Ladestrom_02_XIX_BMC_HV: upstream-reference=Geltungsbereich_E3_1_2_Premium.SP_IF_BMC_Max_Ladestrom_02_XIX_BMC_HV, ecu-extract-reference=COMPOSITIONTYPE.SP_IF_BMC_Max_Ladestrom_02_XIX_BMC_HV
      SP_IF_BMC_Max_Ladestrom_XIX_BMC_HV: upstream-reference=Geltungsbereich_E3_1_2_Premium.SP_IF_BMC_Max_Ladestrom_XIX_BMC_HV, ecu-extract-reference=COMPOSITIONTYPE.SP_IF_BMC_Max_Ladestrom_XIX_BMC_HV
      BMC_Max_Spannung: upstream-reference=Geltungsbereich_E3_1_2_Premium.SP_IF_BMC_Max_Spannung_XIX_BMC_HV.DE_BMC_Max_Spannung, ecu-extract-reference=COMPOSITIONTYPE.SP_IF_BMC_Max_Spannung_XIX_BMC_HV.DE_BMC_Max_Spannung
      SP_IF_BMC_Max_Spannung_XIX_BMC_HV: upstream-reference=Geltungsbereich_E3_1_2_Premium.SP_IF_BMC_Max_Spannung_XIX_BMC_HV, ecu-extract-reference=COMPOSITIONTYPE.SP_IF_BMC_Max_Spannung_XIX_BMC_HV
      BMC_MaxEnergieinhalt: upstream-reference=Geltungsbereich_E3_1_2_Premium.SP_IF_BMC_MaxEnergieinhalt_XIX_BMC_HV.DE_BMC_MaxEnergieinhalt, ecu-extract-reference=COMPOSITIONTYPE.SP_IF_BMC_MaxEnergieinhalt_XIX_BMC_HV.DE_BMC_MaxEnergieinhalt
      SP_IF_BMC_MaxEnergieinhalt_XIX_BMC_HV: upstream-reference=Geltungsbereich_E3_1_2_Premium.SP_IF_BMC_MaxEnergieinhalt_XIX_BMC_HV, ecu-extract-reference=COMPOSITIONTYPE.SP_IF_BMC_MaxEnergieinhalt_XIX_BMC_HV
      BMC_Min_Spannung: upstream-reference=Geltungsbereich_E3_1_2_Premium.SP_IF_BMC_Min_Spannung_XIX_BMC_HV.DE_BMC_Min_Spannung, ecu-extract-reference=COMPOSITIONTYPE.SP_IF_BMC_Min_Spannung_XIX_BMC_HV.DE_BMC_Min_Spannung
      SP_IF_BMC_Min_Spannung_XIX_BMC_HV: upstream-reference=Geltungsbereich_E3_1_2_Premium.SP_IF_BMC_Min_Spannung_XIX_BMC_HV, ecu-extract-reference=COMPOSITIONTYPE.SP_IF_BMC_Min_Spannung_XIX_BMC_HV
      SP_IF_BMC_MinDyn_Entladespannung_XIX_BMC_HV: upstream-reference=Geltungsbereich_E3_1_2_Premium.SP_IF_BMC_MinDyn_Entladespannung_XIX_BMC_HV, ecu-extract-reference=COMPOSITIONTYPE.SP_IF_BMC_MinDyn_Entladespannung_XIX_BMC_HV
      SP_IF_BMC_MinDyn_Ladespannung_XIX_BMC_HV: upstream-reference=Geltungsbereich_E3_1_2_Premium.SP_IF_BMC_MinDyn_Ladespannung_XIX_BMC_HV, ecu-extract-reference=COMPOSITIONTYPE.SP_IF_BMC_MinDyn_Ladespannung_XIX_BMC_HV
      SP_IF_BMC_MMTR_Status_XIX_BMC_HV: upstream-reference=Geltungsbereich_E3_1_2_Premium.SP_IF_BMC_MMTR_Status_XIX_BMC_HV, ecu-extract-reference=COMPOSITIONTYPE.SP_IF_BMC_MMTR_Status_XIX_BMC_HV
      SP_IF_BMC_Modus_XIX_BMC_HV: upstream-reference=Geltungsbereich_E3_1_2_Premium.SP_IF_BMC_Modus_XIX_BMC_HV, ecu-extract-reference=COMPOSITIONTYPE.SP_IF_BMC_Modus_XIX_BMC_HV
      BMC_NutzbareKapazitaet: upstream-reference=Geltungsbereich_E3_1_2_Premium.SP_IF_BMC_NutzbareKapazitaet_XIX_BMC_HV.DE_BMC_NutzbareKapazitaet, ecu-extract-reference=COMPOSITIONTYPE.SP_IF_BMC_NutzbareKapazitaet_XIX_BMC_HV.DE_BMC_NutzbareKapazitaet
      SP_IF_BMC_NutzbareKapazitaet_XIX_BMC_HV: upstream-reference=Geltungsbereich_E3_1_2_Premium.SP_IF_BMC_NutzbareKapazitaet_XIX_BMC_HV, ecu-extract-reference=COMPOSITIONTYPE.SP_IF_BMC_NutzbareKapazitaet_XIX_BMC_HV
      SP_IF_BMC_NutzbarerSOC_XIX_BMC_HV: upstream-reference=Geltungsbereich_E3_1_2_Premium.SP_IF_BMC_NutzbarerSOC_XIX_BMC_HV, ecu-extract-reference=COMPOSITIONTYPE.SP_IF_BMC_NutzbarerSOC_XIX_BMC_HV
      SP_IF_BMC_Pack_SN_{01..26}_XIX_BMC_HV: upstream-reference=Geltungsbereich_E3_1_2_Premium.SP_IF_BMC_Pack_SN_{01..26}_XIX_BMC_HV, ecu-extract-reference=COMPOSITIONTYPE.SP_IF_BMC_Pack_SN_{01..26}_XIX_BMC_HV
      SP_IF_BMC_PCM_VTD_Freeze_Req_XIX_BMC_HV: upstream-reference=Geltungsbereich_E3_1_2_Premium.SP_IF_BMC_PCM_VTD_Freeze_Req_XIX_BMC_HV, ecu-extract-reference=COMPOSITIONTYPE.SP_IF_BMC_PCM_VTD_Freeze_Req_XIX_BMC_HV
      SP_IF_BMC_PCM_VTD_LifeTimeReset_Req_XIX_BMC_HV: upstream-reference=Geltungsbereich_E3_1_2_Premium.SP_IF_BMC_PCM_VTD_LifeTimeReset_Req_XIX_BMC_HV, ecu-extract-reference=COMPOSITIONTYPE.SP_IF_BMC_PCM_VTD_LifeTimeReset_Req_XIX_BMC_HV
      SP_IF_BMC_PCM_VTD_LifeTimeReset_Resp_XIX_BMC_HV: upstream-reference=Geltungsbereich_E3_1_2_Premium.SP_IF_BMC_PCM_VTD_LifeTimeReset_Resp_XIX_BMC_HV, ecu-extract-reference=COMPOSITIONTYPE.SP_IF_BMC_PCM_VTD_LifeTimeReset_Resp_XIX_BMC_HV
      SP_IF_BMC_PCM_VTD_RecentReset_Req_XIX_BMC_HV: upstream-reference=Geltungsbereich_E3_1_2_Premium.SP_IF_BMC_PCM_VTD_RecentReset_Req_XIX_BMC_HV, ecu-extract-reference=COMPOSITIONTYPE.SP_IF_BMC_PCM_VTD_RecentReset_Req_XIX_BMC_HV
      SP_IF_BMC_PerfInd_Entladen_XIX_BMC_HV: upstream-reference=Geltungsbereich_E3_1_2_Premium.SP_IF_BMC_PerfInd_Entladen_XIX_BMC_HV, ecu-extract-reference=COMPOSITIONTYPE.SP_IF_BMC_PerfInd_Entladen_XIX_BMC_HV
      SP_IF_BMC_PerfInd_Laden_XIX_BMC_HV: upstream-reference=Geltungsbereich_E3_1_2_Premium.SP_IF_BMC_PerfInd_Laden_XIX_BMC_HV, ecu-extract-reference=COMPOSITIONTYPE.SP_IF_BMC_PerfInd_Laden_XIX_BMC_HV
      SP_IF_BMC_PredLeistung_StuetzungNV_XIX_BMC_HV: upstream-reference=Geltungsbereich_E3_1_2_Premium.SP_IF_BMC_PredLeistung_StuetzungNV_XIX_BMC_HV, ecu-extract-reference=COMPOSITIONTYPE.SP_IF_BMC_PredLeistung_StuetzungNV_XIX_BMC_HV
      BMC_Range_Indikator: upstream-reference=Geltungsbereich_E3_1_2_Premium.SP_IF_BMC_Range_Indikator_XIX_BMC_HV.DE_BMC_Range_Indikator, ecu-extract-reference=COMPOSITIONTYPE.SP_IF_BMC_Range_Indikator_XIX_BMC_HV.DE_BMC_Range_Indikator
      SP_IF_BMC_Range_Indikator_XIX_BMC_HV: upstream-reference=Geltungsbereich_E3_1_2_Premium.SP_IF_BMC_Range_Indikator_XIX_BMC_HV, ecu-extract-reference=COMPOSITIONTYPE.SP_IF_BMC_Range_Indikator_XIX_BMC_HV
      SP_IF_BMC_Rekuperation_Ueberlauf_XIX_BMC_HV: upstream-reference=Geltungsbereich_E3_1_2_Premium.SP_IF_BMC_Rekuperation_Ueberlauf_XIX_BMC_HV, ecu-extract-reference=COMPOSITIONTYPE.SP_IF_BMC_Rekuperation_Ueberlauf_XIX_BMC_HV
      BMC_Rekuperation: upstream-reference=Geltungsbereich_E3_1_2_Premium.SP_IF_BMC_Rekuperation_XIX_BMC_HV.DE_BMC_Rekuperation, ecu-extract-reference=COMPOSITIONTYPE.SP_IF_BMC_Rekuperation_XIX_BMC_HV.DE_BMC_Rekuperation
      SP_IF_BMC_Rekuperation_XIX_BMC_HV: upstream-reference=Geltungsbereich_E3_1_2_Premium.SP_IF_BMC_Rekuperation_XIX_BMC_HV, ecu-extract-reference=COMPOSITIONTYPE.SP_IF_BMC_Rekuperation_XIX_BMC_HV
      SP_IF_BMC_RtmWarnBattUnautorisiert_XIX_BMC_HV: upstream-reference=Geltungsbereich_E3_1_2_Premium.SP_IF_BMC_RtmWarnBattUnautorisiert_XIX_BMC_HV, ecu-extract-reference=COMPOSITIONTYPE.SP_IF_BMC_RtmWarnBattUnautorisiert_XIX_BMC_HV
      SP_IF_BMC_RtmWarnPackKommunikation_XIX_BMC_HV: upstream-reference=Geltungsbereich_E3_1_2_Premium.SP_IF_BMC_RtmWarnPackKommunikation_XIX_BMC_HV, ecu-extract-reference=COMPOSITIONTYPE.SP_IF_BMC_RtmWarnPackKommunikation_XIX_BMC_HV
      SP_IF_BMC_RtmWarnPackUeberladen_XIX_BMC_HV: upstream-reference=Geltungsbereich_E3_1_2_Premium.SP_IF_BMC_RtmWarnPackUeberladen_XIX_BMC_HV, ecu-extract-reference=COMPOSITIONTYPE.SP_IF_BMC_RtmWarnPackUeberladen_XIX_BMC_HV
      SP_IF_BMC_RtmWarnSocHoch_XIX_BMC_HV: upstream-reference=Geltungsbereich_E3_1_2_Premium.SP_IF_BMC_RtmWarnSocHoch_XIX_BMC_HV, ecu-extract-reference=COMPOSITIONTYPE.SP_IF_BMC_RtmWarnSocHoch_XIX_BMC_HV
      SP_IF_BMC_RtmWarnSocNiedrig_XIX_BMC_HV: upstream-reference=Geltungsbereich_E3_1_2_Premium.SP_IF_BMC_RtmWarnSocNiedrig_XIX_BMC_HV, ecu-extract-reference=COMPOSITIONTYPE.SP_IF_BMC_RtmWarnSocNiedrig_XIX_BMC_HV
      SP_IF_BMC_RtmWarnSocSprung_XIX_BMC_HV: upstream-reference=Geltungsbereich_E3_1_2_Premium.SP_IF_BMC_RtmWarnSocSprung_XIX_BMC_HV, ecu-extract-reference=COMPOSITIONTYPE.SP_IF_BMC_RtmWarnSocSprung_XIX_BMC_HV
      SP_IF_BMC_RtmWarnTZelleDiff_XIX_BMC_HV: upstream-reference=Geltungsbereich_E3_1_2_Premium.SP_IF_BMC_RtmWarnTZelleDiff_XIX_BMC_HV, ecu-extract-reference=COMPOSITIONTYPE.SP_IF_BMC_RtmWarnTZelleDiff_XIX_BMC_HV
      SP_IF_BMC_RtmWarnTZelleMax_XIX_BMC_HV: upstream-reference=Geltungsbereich_E3_1_2_Premium.SP_IF_BMC_RtmWarnTZelleMax_XIX_BMC_HV, ecu-extract-reference=COMPOSITIONTYPE.SP_IF_BMC_RtmWarnTZelleMax_XIX_BMC_HV
      SP_IF_BMC_RtmWarnTZelleMin_XIX_BMC_HV: upstream-reference=Geltungsbereich_E3_1_2_Premium.SP_IF_BMC_RtmWarnTZelleMin_XIX_BMC_HV, ecu-extract-reference=COMPOSITIONTYPE.SP_IF_BMC_RtmWarnTZelleMin_XIX_BMC_HV
      SP_IF_BMC_RtmWarnUeberstrom_XIX_BMC_HV: upstream-reference=Geltungsbereich_E3_1_2_Premium.SP_IF_BMC_RtmWarnUeberstrom_XIX_BMC_HV, ecu-extract-reference=COMPOSITIONTYPE.SP_IF_BMC_RtmWarnUeberstrom_XIX_BMC_HV
      SP_IF_BMC_RtmWarnUPackMax_XIX_BMC_HV: upstream-reference=Geltungsbereich_E3_1_2_Premium.SP_IF_BMC_RtmWarnUPackMax_XIX_BMC_HV, ecu-extract-reference=COMPOSITIONTYPE.SP_IF_BMC_RtmWarnUPackMax_XIX_BMC_HV
      SP_IF_BMC_RtmWarnUPackMin_XIX_BMC_HV: upstream-reference=Geltungsbereich_E3_1_2_Premium.SP_IF_BMC_RtmWarnUPackMin_XIX_BMC_HV, ecu-extract-reference=COMPOSITIONTYPE.SP_IF_BMC_RtmWarnUPackMin_XIX_BMC_HV
      SP_IF_BMC_RtmWarnUZelleMax_XIX_BMC_HV: upstream-reference=Geltungsbereich_E3_1_2_Premium.SP_IF_BMC_RtmWarnUZelleMax_XIX_BMC_HV, ecu-extract-reference=COMPOSITIONTYPE.SP_IF_BMC_RtmWarnUZelleMax_XIX_BMC_HV
      SP_IF_BMC_RtmWarnUZelleMin_XIX_BMC_HV: upstream-reference=Geltungsbereich_E3_1_2_Premium.SP_IF_BMC_RtmWarnUZelleMin_XIX_BMC_HV, ecu-extract-reference=COMPOSITIONTYPE.SP_IF_BMC_RtmWarnUZelleMin_XIX_BMC_HV
      SP_IF_BMC_RtmWarnZelleZustand_XIX_BMC_HV: upstream-reference=Geltungsbereich_E3_1_2_Premium.SP_IF_BMC_RtmWarnZelleZustand_XIX_BMC_HV, ecu-extract-reference=COMPOSITIONTYPE.SP_IF_BMC_RtmWarnZelleZustand_XIX_BMC_HV
      BMC_RuecklaufTemperatur: upstream-reference=Geltungsbereich_E3_1_2_Premium.SP_IF_BMC_RuecklaufTemperatur_XIX_BMC_HV.DE_BMC_RuecklaufTemperatur, ecu-extract-reference=COMPOSITIONTYPE.SP_IF_BMC_RuecklaufTemperatur_XIX_BMC_HV.DE_BMC_RuecklaufTemperatur
      SP_IF_BMC_RuecklaufTemperatur_XIX_BMC_HV: upstream-reference=Geltungsbereich_E3_1_2_Premium.SP_IF_BMC_RuecklaufTemperatur_XIX_BMC_HV, ecu-extract-reference=COMPOSITIONTYPE.SP_IF_BMC_RuecklaufTemperatur_XIX_BMC_HV
      SP_IF_BMC_Spannung_DC_Ladesaeule_XIX_BMC_HV: upstream-reference=Geltungsbereich_E3_1_2_Premium.SP_IF_BMC_Spannung_DC_Ladesaeule_XIX_BMC_HV, ecu-extract-reference=COMPOSITIONTYPE.SP_IF_BMC_Spannung_DC_Ladesaeule_XIX_BMC_HV
      SP_IF_BMC_Spannung_Messzeit_XIX_BMC_HV: upstream-reference=Geltungsbereich_E3_1_2_Premium.SP_IF_BMC_Spannung_Messzeit_XIX_BMC_HV, ecu-extract-reference=COMPOSITIONTYPE.SP_IF_BMC_Spannung_Messzeit_XIX_BMC_HV
      SP_IF_BMC_Spannung_XIX_BMC_HV: upstream-reference=Geltungsbereich_E3_1_2_Premium.SP_IF_BMC_Spannung_XIX_BMC_HV, ecu-extract-reference=COMPOSITIONTYPE.SP_IF_BMC_Spannung_XIX_BMC_HV
      SP_IF_BMC_Spannung_ZwischenKreis_2_XIX_BMC_HV: upstream-reference=Geltungsbereich_E3_1_2_Premium.SP_IF_BMC_Spannung_ZwischenKreis_2_XIX_BMC_HV, ecu-extract-reference=COMPOSITIONTYPE.SP_IF_BMC_Spannung_ZwischenKreis_2_XIX_BMC_HV
      SP_IF_BMC_Spannung_ZwischenKreis_XIX_BMC_HV: upstream-reference=Geltungsbereich_E3_1_2_Premium.SP_IF_BMC_Spannung_ZwischenKreis_XIX_BMC_HV, ecu-extract-reference=COMPOSITIONTYPE.SP_IF_BMC_Spannung_ZwischenKreis_XIX_BMC_HV
      SP_IF_BMC_Sperrung_Ueberspannung_XIX_BMC_HV: upstream-reference=Geltungsbereich_E3_1_2_Premium.SP_IF_BMC_Sperrung_Ueberspannung_XIX_BMC_HV, ecu-extract-reference=COMPOSITIONTYPE.SP_IF_BMC_Sperrung_Ueberspannung_XIX_BMC_HV
      SP_IF_BMC_Sperrung_Uebertemperatur_XIX_BMC_HV: upstream-reference=Geltungsbereich_E3_1_2_Premium.SP_IF_BMC_Sperrung_Uebertemperatur_XIX_BMC_HV, ecu-extract-reference=COMPOSITIONTYPE.SP_IF_BMC_Sperrung_Uebertemperatur_XIX_BMC_HV
      SP_IF_BMC_Sperrung_Unterspannung_XIX_BMC_HV: upstream-reference=Geltungsbereich_E3_1_2_Premium.SP_IF_BMC_Sperrung_Unterspannung_XIX_BMC_HV, ecu-extract-reference=COMPOSITIONTYPE.SP_IF_BMC_Sperrung_Unterspannung_XIX_BMC_HV
      SP_IF_BMC_Status_DCLS_XIX_BMC_HV: upstream-reference=Geltungsbereich_E3_1_2_Premium.SP_IF_BMC_Status_DCLS_XIX_BMC_HV, ecu-extract-reference=COMPOSITIONTYPE.SP_IF_BMC_Status_DCLS_XIX_BMC_HV
      SP_IF_BMC_Status_HV_Spannungssensorik_XIX_BMC_HV: upstream-reference=Geltungsbereich_E3_1_2_Premium.SP_IF_BMC_Status_HV_Spannungssensorik_XIX_BMC_HV, ecu-extract-reference=COMPOSITIONTYPE.SP_IF_BMC_Status_HV_Spannungssensorik_XIX_BMC_HV
      SP_IF_BMC_Status_Spgfreiheit_XIX_BMC_HV: upstream-reference=Geltungsbereich_E3_1_2_Premium.SP_IF_BMC_Status_Spgfreiheit_XIX_BMC_HV, ecu-extract-reference=COMPOSITIONTYPE.SP_IF_BMC_Status_Spgfreiheit_XIX_BMC_HV
      SP_IF_BMC_Status_Trennelemente_XIX_BMC_HV: upstream-reference=Geltungsbereich_E3_1_2_Premium.SP_IF_BMC_Status_Trennelemente_XIX_BMC_HV, ecu-extract-reference=COMPOSITIONTYPE.SP_IF_BMC_Status_Trennelemente_XIX_BMC_HV
      SP_IF_BMC_Strom_02_XIX_BMC_HV: upstream-reference=Geltungsbereich_E3_1_2_Premium.SP_IF_BMC_Strom_02_XIX_BMC_HV, ecu-extract-reference=COMPOSITIONTYPE.SP_IF_BMC_Strom_02_XIX_BMC_HV
      SP_IF_BMC_Strom_Messzeit_XIX_BMC_HV: upstream-reference=Geltungsbereich_E3_1_2_Premium.SP_IF_BMC_Strom_Messzeit_XIX_BMC_HV, ecu-extract-reference=COMPOSITIONTYPE.SP_IF_BMC_Strom_Messzeit_XIX_BMC_HV
      SP_IF_BMC_Strom_XIX_BMC_HV: upstream-reference=Geltungsbereich_E3_1_2_Premium.SP_IF_BMC_Strom_XIX_BMC_HV, ecu-extract-reference=COMPOSITIONTYPE.SP_IF_BMC_Strom_XIX_BMC_HV
      SP_IF_BMC_TechnischerSOC_XIX_BMC_HV: upstream-reference=Geltungsbereich_E3_1_2_Premium.SP_IF_BMC_TechnischerSOC_XIX_BMC_HV, ecu-extract-reference=COMPOSITIONTYPE.SP_IF_BMC_TechnischerSOC_XIX_BMC_HV
      BMC_Temperatur_hoechste: upstream-reference=Geltungsbereich_E3_1_2_Premium.SP_IF_BMC_Temperatur_hoechste_XIX_BMC_HV.DE_BMC_Temperatur_hoechste, ecu-extract-reference=COMPOSITIONTYPE.SP_IF_BMC_Temperatur_hoechste_XIX_BMC_HV.DE_BMC_Temperatur_hoechste
      SP_IF_BMC_Temperatur_hoechste_XIX_BMC_HV: upstream-reference=Geltungsbereich_E3_1_2_Premium.SP_IF_BMC_Temperatur_hoechste_XIX_BMC_HV, ecu-extract-reference=COMPOSITIONTYPE.SP_IF_BMC_Temperatur_hoechste_XIX_BMC_HV
      BMC_Temperatur_niedrigste: upstream-reference=Geltungsbereich_E3_1_2_Premium.SP_IF_BMC_Temperatur_niedrigste_XIX_BMC_HV.DE_BMC_Temperatur_niedrigste, ecu-extract-reference=COMPOSITIONTYPE.SP_IF_BMC_Temperatur_niedrigste_XIX_BMC_HV.DE_BMC_Temperatur_niedrigste
      SP_IF_BMC_Temperatur_niedrigste_XIX_BMC_HV: upstream-reference=Geltungsbereich_E3_1_2_Premium.SP_IF_BMC_Temperatur_niedrigste_XIX_BMC_HV, ecu-extract-reference=COMPOSITIONTYPE.SP_IF_BMC_Temperatur_niedrigste_XIX_BMC_HV
      BMC_Temperatur: upstream-reference=Geltungsbereich_E3_1_2_Premium.SP_IF_BMC_Temperatur_XIX_BMC_HV.DE_BMC_Temperatur, ecu-extract-reference=COMPOSITIONTYPE.SP_IF_BMC_Temperatur_XIX_BMC_HV.DE_BMC_Temperatur
      SP_IF_BMC_Temperatur_XIX_BMC_HV: upstream-reference=Geltungsbereich_E3_1_2_Premium.SP_IF_BMC_Temperatur_XIX_BMC_HV, ecu-extract-reference=COMPOSITIONTYPE.SP_IF_BMC_Temperatur_XIX_BMC_HV
      BMC_ThermAuslastung: upstream-reference=Geltungsbereich_E3_1_2_Premium.SP_IF_BMC_ThermAuslastung_XIX_BMC_HV.DE_BMC_ThermAuslastung, ecu-extract-reference=COMPOSITIONTYPE.SP_IF_BMC_ThermAuslastung_XIX_BMC_HV.DE_BMC_ThermAuslastung
      SP_IF_BMC_ThermAuslastung_XIX_BMC_HV: upstream-reference=Geltungsbereich_E3_1_2_Premium.SP_IF_BMC_ThermAuslastung_XIX_BMC_HV, ecu-extract-reference=COMPOSITIONTYPE.SP_IF_BMC_ThermAuslastung_XIX_BMC_HV
      BMC_ThermSpreizung: upstream-reference=Geltungsbereich_E3_1_2_Premium.SP_IF_BMC_ThermSpreizung_XIX_BMC_HV.DE_BMC_ThermSpreizung, ecu-extract-reference=COMPOSITIONTYPE.SP_IF_BMC_ThermSpreizung_XIX_BMC_HV.DE_BMC_ThermSpreizung
      SP_IF_BMC_ThermSpreizung_XIX_BMC_HV: upstream-reference=Geltungsbereich_E3_1_2_Premium.SP_IF_BMC_ThermSpreizung_XIX_BMC_HV, ecu-extract-reference=COMPOSITIONTYPE.SP_IF_BMC_ThermSpreizung_XIX_BMC_HV
      BMC_UBE_Indik_last_update_km: upstream-reference=Geltungsbereich_E3_1_2_Premium.SP_IF_BMC_UBE_Indik_last_update_km_XIX_BMC_HV.DE_BMC_UBE_Indik_last_update_km, ecu-extract-reference=COMPOSITIONTYPE.SP_IF_BMC_UBE_Indik_last_update_km_XIX_BMC_HV.DE_BMC_UBE_Indik_last_update_km
      SP_IF_BMC_UBE_Indik_last_update_km_XIX_BMC_HV: upstream-reference=Geltungsbereich_E3_1_2_Premium.SP_IF_BMC_UBE_Indik_last_update_km_XIX_BMC_HV, ecu-extract-reference=COMPOSITIONTYPE.SP_IF_BMC_UBE_Indik_last_update_km_XIX_BMC_HV
      BMC_UBE_Indikator: upstream-reference=Geltungsbereich_E3_1_2_Premium.SP_IF_BMC_UBE_Indikator_XIX_BMC_HV.DE_BMC_UBE_Indikator, ecu-extract-reference=COMPOSITIONTYPE.SP_IF_BMC_UBE_Indikator_XIX_BMC_HV.DE_BMC_UBE_Indikator
      SP_IF_BMC_UBE_Indikator_XIX_BMC_HV: upstream-reference=Geltungsbereich_E3_1_2_Premium.SP_IF_BMC_UBE_Indikator_XIX_BMC_HV, ecu-extract-reference=COMPOSITIONTYPE.SP_IF_BMC_UBE_Indikator_XIX_BMC_HV
      SP_IF_BMC_Ueberspannungszaehler_CMC{01..04}_XIX_BMC_HV: upstream-reference=Geltungsbereich_E3_1_2_Premium.SP_IF_BMC_Ueberspannungszaehler_CMC{01..04}_XIX_BMC_HV, ecu-extract-reference=COMPOSITIONTYPE.SP_IF_BMC_Ueberspannungszaehler_CMC{01..04}_XIX_BMC_HV
      SP_IF_BMC_Uebertemperaturzaehler_CMC{01..04}_XIX_BMC_HV: upstream-reference=Geltungsbereich_E3_1_2_Premium.SP_IF_BMC_Uebertemperaturzaehler_CMC{01..04}_XIX_BMC_HV, ecu-extract-reference=COMPOSITIONTYPE.SP_IF_BMC_Uebertemperaturzaehler_CMC{01..04}_XIX_BMC_HV
      SP_IF_BMC_UI1_Spannung1_Schalt_Anf_XIX_BMC_HV: upstream-reference=Geltungsbereich_E3_1_2_Premium.SP_IF_BMC_UI1_Spannung1_Schalt_Anf_XIX_BMC_HV, ecu-extract-reference=COMPOSITIONTYPE.SP_IF_BMC_UI1_Spannung1_Schalt_Anf_XIX_BMC_HV
      SP_IF_BMC_UI1_Spannung2_Schalt_Anf_XIX_BMC_HV: upstream-reference=Geltungsbereich_E3_1_2_Premium.SP_IF_BMC_UI1_Spannung2_Schalt_Anf_XIX_BMC_HV, ecu-extract-reference=COMPOSITIONTYPE.SP_IF_BMC_UI1_Spannung2_Schalt_Anf_XIX_BMC_HV
      SP_IF_BMC_UI2_Spannung1_Schalt_Anf_XIX_BMC_HV: upstream-reference=Geltungsbereich_E3_1_2_Premium.SP_IF_BMC_UI2_Spannung1_Schalt_Anf_XIX_BMC_HV, ecu-extract-reference=COMPOSITIONTYPE.SP_IF_BMC_UI2_Spannung1_Schalt_Anf_XIX_BMC_HV
      SP_IF_BMC_UI2_Spannung2_Schalt_Anf_XIX_BMC_HV: upstream-reference=Geltungsbereich_E3_1_2_Premium.SP_IF_BMC_UI2_Spannung2_Schalt_Anf_XIX_BMC_HV, ecu-extract-reference=COMPOSITIONTYPE.SP_IF_BMC_UI2_Spannung2_Schalt_Anf_XIX_BMC_HV
      SP_IF_BMC_Unterboden_Warnung_XIX_BMC_HV: upstream-reference=Geltungsbereich_E3_1_2_Premium.SP_IF_BMC_Unterboden_Warnung_XIX_BMC_HV, ecu-extract-reference=COMPOSITIONTYPE.SP_IF_BMC_Unterboden_Warnung_XIX_BMC_HV
      SP_IF_BMC_Unterspannungszaehler_CMC{01..04}_XIX_BMC_HV: upstream-reference=Geltungsbereich_E3_1_2_Premium.SP_IF_BMC_Unterspannungszaehler_CMC{01..04}_XIX_BMC_HV, ecu-extract-reference=COMPOSITIONTYPE.SP_IF_BMC_Unterspannungszaehler_CMC{01..04}_XIX_BMC_HV
      SP_IF_BMC_Verbauinfo_ACSchuetz_XIX_BMC_HV: upstream-reference=Geltungsbereich_E3_1_2_Premium.SP_IF_BMC_Verbauinfo_ACSchuetz_XIX_BMC_HV, ecu-extract-reference=COMPOSITIONTYPE.SP_IF_BMC_Verbauinfo_ACSchuetz_XIX_BMC_HV
      SP_IF_BMC_Verbauinfo_Bank_XIX_BMC_HV: upstream-reference=Geltungsbereich_E3_1_2_Premium.SP_IF_BMC_Verbauinfo_Bank_XIX_BMC_HV, ecu-extract-reference=COMPOSITIONTYPE.SP_IF_BMC_Verbauinfo_Bank_XIX_BMC_HV
      SP_IF_BMC_Verbrauch_Ueberlauf_XIX_BMC_HV: upstream-reference=Geltungsbereich_E3_1_2_Premium.SP_IF_BMC_Verbrauch_Ueberlauf_XIX_BMC_HV, ecu-extract-reference=COMPOSITIONTYPE.SP_IF_BMC_Verbrauch_Ueberlauf_XIX_BMC_HV
      BMC_Verbrauch: upstream-reference=Geltungsbereich_E3_1_2_Premium.SP_IF_BMC_Verbrauch_XIX_BMC_HV.DE_BMC_Verbrauch, ecu-extract-reference=COMPOSITIONTYPE.SP_IF_BMC_Verbrauch_XIX_BMC_HV.DE_BMC_Verbrauch
      SP_IF_BMC_Verbrauch_XIX_BMC_HV: upstream-reference=Geltungsbereich_E3_1_2_Premium.SP_IF_BMC_Verbrauch_XIX_BMC_HV, ecu-extract-reference=COMPOSITIONTYPE.SP_IF_BMC_Verbrauch_XIX_BMC_HV
      BMC_VerlustEnergie: upstream-reference=Geltungsbereich_E3_1_2_Premium.SP_IF_BMC_VerlustEnergie_XIX_BMC_HV.DE_BMC_VerlustEnergie, ecu-extract-reference=COMPOSITIONTYPE.SP_IF_BMC_VerlustEnergie_XIX_BMC_HV.DE_BMC_VerlustEnergie
      SP_IF_BMC_VerlustEnergie_XIX_BMC_HV: upstream-reference=Geltungsbereich_E3_1_2_Premium.SP_IF_BMC_VerlustEnergie_XIX_BMC_HV, ecu-extract-reference=COMPOSITIONTYPE.SP_IF_BMC_VerlustEnergie_XIX_BMC_HV
      SP_IF_BMC_Vorlade_Zielspannung_XIX_BMC_HV: upstream-reference=Geltungsbereich_E3_1_2_Premium.SP_IF_BMC_Vorlade_Zielspannung_XIX_BMC_HV, ecu-extract-reference=COMPOSITIONTYPE.SP_IF_BMC_Vorlade_Zielspannung_XIX_BMC_HV
      BMC_VorlaufTemperatur: upstream-reference=Geltungsbereich_E3_1_2_Premium.SP_IF_BMC_VorlaufTemperatur_XIX_BMC_HV.DE_BMC_VorlaufTemperatur, ecu-extract-reference=COMPOSITIONTYPE.SP_IF_BMC_VorlaufTemperatur_XIX_BMC_HV.DE_BMC_VorlaufTemperatur
      SP_IF_BMC_VorlaufTemperatur_XIX_BMC_HV: upstream-reference=Geltungsbereich_E3_1_2_Premium.SP_IF_BMC_VorlaufTemperatur_XIX_BMC_HV, ecu-extract-reference=COMPOSITIONTYPE.SP_IF_BMC_VorlaufTemperatur_XIX_BMC_HV
      SP_IF_BMC_ZellTemp_virtuell_max_XIX_BMC_HV: upstream-reference=Geltungsbereich_E3_1_2_Premium.SP_IF_BMC_ZellTemp_virtuell_max_XIX_BMC_HV, ecu-extract-reference=COMPOSITIONTYPE.SP_IF_BMC_ZellTemp_virtuell_max_XIX_BMC_HV
      SP_IF_BMC_ZellTemp_virtuell_min_XIX_BMC_HV: upstream-reference=Geltungsbereich_E3_1_2_Premium.SP_IF_BMC_ZellTemp_virtuell_min_XIX_BMC_HV, ecu-extract-reference=COMPOSITIONTYPE.SP_IF_BMC_ZellTemp_virtuell_min_XIX_BMC_HV
      DS_Hybrid_01_ConfDTCChanged: upstream-reference=Geltungsbereich_E3_1_2_Premium.SP_IF_DS_Hybrid_01_ConfDTCChanged_XIX_BMC_HV.DE_DS_Hybrid_01_ConfDTCChanged, ecu-extract-reference=COMPOSITIONTYPE.SP_IF_DS_Hybrid_01_ConfDTCChanged_XIX_BMC_HV.DE_DS_Hybrid_01_ConfDTCChanged
      SP_IF_DS_Hybrid_01_ConfDTCChanged_XIX_BMC_HV: upstream-reference=Geltungsbereich_E3_1_2_Premium.SP_IF_DS_Hybrid_01_ConfDTCChanged_XIX_BMC_HV, ecu-extract-reference=COMPOSITIONTYPE.SP_IF_DS_Hybrid_01_ConfDTCChanged_XIX_BMC_HV
      DS_Hybrid_01_DiagAdr: upstream-reference=Geltungsbereich_E3_1_2_Premium.SP_IF_DS_Hybrid_01_DiagAdr_XIX_BMC_HV.DE_DS_Hybrid_01_DiagAdr, ecu-extract-reference=COMPOSITIONTYPE.SP_IF_DS_Hybrid_01_DiagAdr_XIX_BMC_HV.DE_DS_Hybrid_01_DiagAdr
      SP_IF_DS_Hybrid_01_DiagAdr_XIX_BMC_HV: upstream-reference=Geltungsbereich_E3_1_2_Premium.SP_IF_DS_Hybrid_01_DiagAdr_XIX_BMC_HV, ecu-extract-reference=COMPOSITIONTYPE.SP_IF_DS_Hybrid_01_DiagAdr_XIX_BMC_HV
      SP_IF_DS_Hybrid_01_IdentValid_XIX_BMC_HV: upstream-reference=Geltungsbereich_E3_1_2_Premium.SP_IF_DS_Hybrid_01_IdentValid_XIX_BMC_HV, ecu-extract-reference=COMPOSITIONTYPE.SP_IF_DS_Hybrid_01_IdentValid_XIX_BMC_HV
      SP_IF_DS_Hybrid_01_Lokalaktiv_XIX_BMC_HV: upstream-reference=Geltungsbereich_E3_1_2_Premium.SP_IF_DS_Hybrid_01_Lokalaktiv_XIX_BMC_HV, ecu-extract-reference=COMPOSITIONTYPE.SP_IF_DS_Hybrid_01_Lokalaktiv_XIX_BMC_HV
      DS_Hybrid_01_MemSel10Changed: upstream-reference=Geltungsbereich_E3_1_2_Premium.SP_IF_DS_Hybrid_01_MemSel10Changed_XIX_BMC_HV.DE_DS_Hybrid_01_MemSel10Changed, ecu-extract-reference=COMPOSITIONTYPE.SP_IF_DS_Hybrid_01_MemSel10Changed_XIX_BMC_HV.DE_DS_Hybrid_01_MemSel10Changed
      SP_IF_DS_Hybrid_01_MemSel10Changed_XIX_BMC_HV: upstream-reference=Geltungsbereich_E3_1_2_Premium.SP_IF_DS_Hybrid_01_MemSel10Changed_XIX_BMC_HV, ecu-extract-reference=COMPOSITIONTYPE.SP_IF_DS_Hybrid_01_MemSel10Changed_XIX_BMC_HV
      DS_Hybrid_01_MemSelChanged: upstream-reference=Geltungsbereich_E3_1_2_Premium.SP_IF_DS_Hybrid_01_MemSelChanged_XIX_BMC_HV.DE_DS_Hybrid_01_MemSelChanged, ecu-extract-reference=COMPOSITIONTYPE.SP_IF_DS_Hybrid_01_MemSelChanged_XIX_BMC_HV.DE_DS_Hybrid_01_MemSelChanged
      SP_IF_DS_Hybrid_01_MemSelChanged_XIX_BMC_HV: upstream-reference=Geltungsbereich_E3_1_2_Premium.SP_IF_DS_Hybrid_01_MemSelChanged_XIX_BMC_HV, ecu-extract-reference=COMPOSITIONTYPE.SP_IF_DS_Hybrid_01_MemSelChanged_XIX_BMC_HV
      DS_Hybrid_01_StMemChanged: upstream-reference=Geltungsbereich_E3_1_2_Premium.SP_IF_DS_Hybrid_01_StMemChanged_XIX_BMC_HV.DE_DS_Hybrid_01_StMemChanged, ecu-extract-reference=COMPOSITIONTYPE.SP_IF_DS_Hybrid_01_StMemChanged_XIX_BMC_HV.DE_DS_Hybrid_01_StMemChanged
      SP_IF_DS_Hybrid_01_StMemChanged_XIX_BMC_HV: upstream-reference=Geltungsbereich_E3_1_2_Premium.SP_IF_DS_Hybrid_01_StMemChanged_XIX_BMC_HV, ecu-extract-reference=COMPOSITIONTYPE.SP_IF_DS_Hybrid_01_StMemChanged_XIX_BMC_HV
      SP_IF_DS_Hybrid_01_Subsystemaktiv_XIX_BMC_HV: upstream-reference=Geltungsbereich_E3_1_2_Premium.SP_IF_DS_Hybrid_01_Subsystemaktiv_XIX_BMC_HV, ecu-extract-reference=COMPOSITIONTYPE.SP_IF_DS_Hybrid_01_Subsystemaktiv_XIX_BMC_HV
      DS_Hybrid_01_TestFailedChanged: upstream-reference=Geltungsbereich_E3_1_2_Premium.SP_IF_DS_Hybrid_01_TestFailedChanged_XIX_BMC_HV.DE_DS_Hybrid_01_TestFailedChanged, ecu-extract-reference=COMPOSITIONTYPE.SP_IF_DS_Hybrid_01_TestFailedChanged_XIX_BMC_HV.DE_DS_Hybrid_01_TestFailedChanged
      SP_IF_DS_Hybrid_01_TestFailedChanged_XIX_BMC_HV: upstream-reference=Geltungsbereich_E3_1_2_Premium.SP_IF_DS_Hybrid_01_TestFailedChanged_XIX_BMC_HV, ecu-extract-reference=COMPOSITIONTYPE.SP_IF_DS_Hybrid_01_TestFailedChanged_XIX_BMC_HV
      DS_Hybrid_01_WIRChanged: upstream-reference=Geltungsbereich_E3_1_2_Premium.SP_IF_DS_Hybrid_01_WIRChanged_XIX_BMC_HV.DE_DS_Hybrid_01_WIRChanged, ecu-extract-reference=COMPOSITIONTYPE.SP_IF_DS_Hybrid_01_WIRChanged_XIX_BMC_HV.DE_DS_Hybrid_01_WIRChanged
      SP_IF_DS_Hybrid_01_WIRChanged_XIX_BMC_HV: upstream-reference=Geltungsbereich_E3_1_2_Premium.SP_IF_DS_Hybrid_01_WIRChanged_XIX_BMC_HV, ecu-extract-reference=COMPOSITIONTYPE.SP_IF_DS_Hybrid_01_WIRChanged_XIX_BMC_HV
      SP_IF_Hybrid_01_Indc_StChk_XIX_BMC_HV: upstream-reference=Geltungsbereich_E3_1_2_Premium.SP_IF_Hybrid_01_Indc_StChk_XIX_BMC_HV, ecu-extract-reference=COMPOSITIONTYPE.SP_IF_Hybrid_01_Indc_StChk_XIX_BMC_HV
      SP_IF_Hybrid_01_Indc_StFail_XIX_BMC_HV: upstream-reference=Geltungsbereich_E3_1_2_Premium.SP_IF_Hybrid_01_Indc_StFail_XIX_BMC_HV, ecu-extract-reference=COMPOSITIONTYPE.SP_IF_Hybrid_01_Indc_StFail_XIX_BMC_HV
      SP_IF_Hybrid_01_KD_Fehler_XIX_BMC_HV: upstream-reference=Geltungsbereich_E3_1_2_Premium.SP_IF_Hybrid_01_KD_Fehler_XIX_BMC_HV, ecu-extract-reference=COMPOSITIONTYPE.SP_IF_Hybrid_01_KD_Fehler_XIX_BMC_HV
      SP_IF_Hybrid_01_Nachlauftyp_XIX_BMC_HV: upstream-reference=Geltungsbereich_E3_1_2_Premium.SP_IF_Hybrid_01_Nachlauftyp_XIX_BMC_HV, ecu-extract-reference=COMPOSITIONTYPE.SP_IF_Hybrid_01_Nachlauftyp_XIX_BMC_HV
      SP_IF_Hybrid_01_OBD_Lampe_Anf_XIX_BMC_HV: upstream-reference=Geltungsbereich_E3_1_2_Premium.SP_IF_Hybrid_01_OBD_Lampe_Anf_XIX_BMC_HV, ecu-extract-reference=COMPOSITIONTYPE.SP_IF_Hybrid_01_OBD_Lampe_Anf_XIX_BMC_HV
      Hybrid_01_SNI_10: upstream-reference=Geltungsbereich_E3_1_2_Premium.SP_IF_Hybrid_01_SNI_10_XIX_BMC_HV.DE_Hybrid_01_SNI_10, ecu-extract-reference=COMPOSITIONTYPE.SP_IF_Hybrid_01_SNI_10_XIX_BMC_HV.DE_Hybrid_01_SNI_10
      SP_IF_Hybrid_01_SNI_10_XIX_BMC_HV: upstream-reference=Geltungsbereich_E3_1_2_Premium.SP_IF_Hybrid_01_SNI_10_XIX_BMC_HV, ecu-extract-reference=COMPOSITIONTYPE.SP_IF_Hybrid_01_SNI_10_XIX_BMC_HV
      SP_IF_KN_Hybrid_01_DiagPfad_V12_XIX_BMC_HV: upstream-reference=Geltungsbereich_E3_1_2_Premium.SP_IF_KN_Hybrid_01_DiagPfad_V12_XIX_BMC_HV, ecu-extract-reference=COMPOSITIONTYPE.SP_IF_KN_Hybrid_01_DiagPfad_V12_XIX_BMC_HV
      SP_IF_KS_Hybrid_01_ChK_IKACtr_XIX_BMC_HV: upstream-reference=Geltungsbereich_E3_1_2_Premium.SP_IF_KS_Hybrid_01_ChK_IKACtr_XIX_BMC_HV, ecu-extract-reference=COMPOSITIONTYPE.SP_IF_KS_Hybrid_01_ChK_IKACtr_XIX_BMC_HV
      SP_IF_KS_Hybrid_01_ChK_SID_XIX_BMC_HV: upstream-reference=Geltungsbereich_E3_1_2_Premium.SP_IF_KS_Hybrid_01_ChK_SID_XIX_BMC_HV, ecu-extract-reference=COMPOSITIONTYPE.SP_IF_KS_Hybrid_01_ChK_SID_XIX_BMC_HV
      SP_IF_KS_Hybrid_01_ChK_XIX_BMC_HV: upstream-reference=Geltungsbereich_E3_1_2_Premium.SP_IF_KS_Hybrid_01_ChK_XIX_BMC_HV, ecu-extract-reference=COMPOSITIONTYPE.SP_IF_KS_Hybrid_01_ChK_XIX_BMC_HV
      SP_IF_KS_Hybrid_01_ReK_IKACtr_XIX_BMC_HV: upstream-reference=Geltungsbereich_E3_1_2_Premium.SP_IF_KS_Hybrid_01_ReK_IKACtr_XIX_BMC_HV, ecu-extract-reference=COMPOSITIONTYPE.SP_IF_KS_Hybrid_01_ReK_IKACtr_XIX_BMC_HV
      SP_IF_KS_Hybrid_01_ReK_SID_XIX_BMC_HV: upstream-reference=Geltungsbereich_E3_1_2_Premium.SP_IF_KS_Hybrid_01_ReK_SID_XIX_BMC_HV, ecu-extract-reference=COMPOSITIONTYPE.SP_IF_KS_Hybrid_01_ReK_SID_XIX_BMC_HV
      SP_IF_KS_Hybrid_01_ReK_XIX_BMC_HV: upstream-reference=Geltungsbereich_E3_1_2_Premium.SP_IF_KS_Hybrid_01_ReK_XIX_BMC_HV, ecu-extract-reference=COMPOSITIONTYPE.SP_IF_KS_Hybrid_01_ReK_XIX_BMC_HV
