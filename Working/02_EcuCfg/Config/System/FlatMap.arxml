[part 2 of 2: package /COM/VECTOR/CFG/WORKFLOW/SYSDESC/SYNC]
AUTOSAR XML (schema 00048)
package /COM/VECTOR/CFG/WORKFLOW/SYSDESC/SYNC  (continued)
  flat map FLATMAP  (continued)
    1722 x flat instance descriptor:  (continued)
      SP_IF_KS_Hybrid_01_Req_ErrCtr_XIX_BMC_HV: upstream-reference=Geltungsbereich_E3_1_2_Premium.SP_IF_KS_Hybrid_01_Req_ErrCtr_XIX_BMC_HV, ecu-extract-reference=COMPOSITIONTYPE.SP_IF_KS_Hybrid_01_Req_ErrCtr_XIX_BMC_HV
      SP_IF_KS_Hybrid_01_Req_IKA_Retry_XIX_BMC_HV: upstream-reference=Geltungsbereich_E3_1_2_Premium.SP_IF_KS_Hybrid_01_Req_IKA_Retry_XIX_BMC_HV, ecu-extract-reference=COMPOSITIONTYPE.SP_IF_KS_Hybrid_01_Req_IKA_Retry_XIX_BMC_HV
      SP_IF_KS_Hybrid_01_Req_Prio_XIX_BMC_HV: upstream-reference=Geltungsbereich_E3_1_2_Premium.SP_IF_KS_Hybrid_01_Req_Prio_XIX_BMC_HV, ecu-extract-reference=COMPOSITIONTYPE.SP_IF_KS_Hybrid_01_Req_Prio_XIX_BMC_HV
      SP_IF_KS_Hybrid_01_Req_SID_XIX_BMC_HV: upstream-reference=Geltungsbereich_E3_1_2_Premium.SP_IF_KS_Hybrid_01_Req_SID_XIX_BMC_HV, ecu-extract-reference=COMPOSITIONTYPE.SP_IF_KS_Hybrid_01_Req_SID_XIX_BMC_HV
      SP_IF_KS_Hybrid_01_Req_SWMaj_XIX_BMC_HV: upstream-reference=Geltungsbereich_E3_1_2_Premium.SP_IF_KS_Hybrid_01_Req_SWMaj_XIX_BMC_HV, ecu-extract-reference=COMPOSITIONTYPE.SP_IF_KS_Hybrid_01_Req_SWMaj_XIX_BMC_HV
      SP_IF_KS_Hybrid_01_Req_SWMin_XIX_BMC_HV: upstream-reference=Geltungsbereich_E3_1_2_Premium.SP_IF_KS_Hybrid_01_Req_SWMin_XIX_BMC_HV, ecu-extract-reference=COMPOSITIONTYPE.SP_IF_KS_Hybrid_01_Req_SWMin_XIX_BMC_HV
      SP_IF_KS_Hybrid_01_Req_SWPat_XIX_BMC_HV: upstream-reference=Geltungsbereich_E3_1_2_Premium.SP_IF_KS_Hybrid_01_Req_SWPat_XIX_BMC_HV, ecu-extract-reference=COMPOSITIONTYPE.SP_IF_KS_Hybrid_01_Req_SWPat_XIX_BMC_HV
      SP_IF_KS_Hybrid_01_Req_VKMS_Err_XIX_BMC_HV: upstream-reference=Geltungsbereich_E3_1_2_Premium.SP_IF_KS_Hybrid_01_Req_VKMS_Err_XIX_BMC_HV, ecu-extract-reference=COMPOSITIONTYPE.SP_IF_KS_Hybrid_01_Req_VKMS_Err_XIX_BMC_HV
      SP_IF_NM_Hybrid_01_CAB_V12_XIX_BMC_HV: upstream-reference=Geltungsbereich_E3_1_2_Premium.SP_IF_NM_Hybrid_01_CAB_V12_XIX_BMC_HV, ecu-extract-reference=COMPOSITIONTYPE.SP_IF_NM_Hybrid_01_CAB_V12_XIX_BMC_HV
      SP_IF_NM_Hybrid_01_CBV_AWB_XIX_BMC_HV: upstream-reference=Geltungsbereich_E3_1_2_Premium.SP_IF_NM_Hybrid_01_CBV_AWB_XIX_BMC_HV, ecu-extract-reference=COMPOSITIONTYPE.SP_IF_NM_Hybrid_01_CBV_AWB_XIX_BMC_HV
      SP_IF_NM_Hybrid_01_FCAB_XIX_BMC_HV: upstream-reference=Geltungsbereich_E3_1_2_Premium.SP_IF_NM_Hybrid_01_FCAB_XIX_BMC_HV, ecu-extract-reference=COMPOSITIONTYPE.SP_IF_NM_Hybrid_01_FCAB_XIX_BMC_HV
      SP_IF_NM_Hybrid_01_FCIB_XIX_BMC_HV: upstream-reference=Geltungsbereich_E3_1_2_Premium.SP_IF_NM_Hybrid_01_FCIB_XIX_BMC_HV, ecu-extract-reference=COMPOSITIONTYPE.SP_IF_NM_Hybrid_01_FCIB_XIX_BMC_HV
      SP_IF_NM_Hybrid_01_NM_State_XIX_BMC_HV: upstream-reference=Geltungsbereich_E3_1_2_Premium.SP_IF_NM_Hybrid_01_NM_State_XIX_BMC_HV, ecu-extract-reference=COMPOSITIONTYPE.SP_IF_NM_Hybrid_01_NM_State_XIX_BMC_HV
      SP_IF_NM_Hybrid_01_SNI_10_XIX_BMC_HV: upstream-reference=Geltungsbereich_E3_1_2_Premium.SP_IF_NM_Hybrid_01_SNI_10_XIX_BMC_HV, ecu-extract-reference=COMPOSITIONTYPE.SP_IF_NM_Hybrid_01_SNI_10_XIX_BMC_HV
      SP_IF_OBDProtocol_Hybrid_01_XIX_BMC_HV: upstream-reference=Geltungsbereich_E3_1_2_Premium.SP_IF_OBDProtocol_Hybrid_01_XIX_BMC_HV, ecu-extract-reference=COMPOSITIONTYPE.SP_IF_OBDProtocol_Hybrid_01_XIX_BMC_HV
      SOK_Zeit_Hybrid_01_Challenge: upstream-reference=Geltungsbereich_E3_1_2_Premium.SP_IF_SOK_Zeit_Hybrid_01_Challenge_XIX_BMC_HV.DE_SOK_Zeit_Hybrid_01_Challenge, ecu-extract-reference=COMPOSITIONTYPE.SP_IF_SOK_Zeit_Hybrid_01_Challenge_XIX_BMC_HV.DE_SOK_Zeit_Hybrid_01_Challenge
      SP_IF_SOK_Zeit_Hybrid_01_Challenge_XIX_BMC_HV: upstream-reference=Geltungsbereich_E3_1_2_Premium.SP_IF_SOK_Zeit_Hybrid_01_Challenge_XIX_BMC_HV, ecu-extract-reference=COMPOSITIONTYPE.SP_IF_SOK_Zeit_Hybrid_01_Challenge_XIX_BMC_HV
      AB_Deaktivierung_HV: upstream-reference=Geltungsbereich_E3_1_2_Premium.AB_Deaktivierung_HV.AB_Deaktivierung_HV, ecu-extract-reference=COMPOSITIONTYPE.AB_Deaktivierung_HV.AB_Deaktivierung_HV
      RP_IF_AB_Deaktivierung_HV_XIX_BMC_HV: upstream-reference=Geltungsbereich_E3_1_2_Premium.RP_IF_AB_Deaktivierung_HV_XIX_BMC_HV, ecu-extract-reference=COMPOSITIONTYPE.RP_IF_AB_Deaktivierung_HV_XIX_BMC_HV
      BJB_CALID_Index_01: upstream-reference=Geltungsbereich_E3_1_2_Premium.RP_IF_BJB_CALID_Index_01_XIX_BMC_HV.DE_BJB_CALID_Index_01, ecu-extract-reference=COMPOSITIONTYPE.RP_IF_BJB_CALID_Index_01_XIX_BMC_HV.DE_BJB_CALID_Index_01
      RP_IF_BJB_CALID_Index_01_XIX_BMC_HV: upstream-reference=Geltungsbereich_E3_1_2_Premium.RP_IF_BJB_CALID_Index_01_XIX_BMC_HV, ecu-extract-reference=COMPOSITIONTYPE.RP_IF_BJB_CALID_Index_01_XIX_BMC_HV
      BJB_CALID_Index_02: upstream-reference=Geltungsbereich_E3_1_2_Premium.RP_IF_BJB_CALID_Index_02_XIX_BMC_HV.DE_BJB_CALID_Index_02, ecu-extract-reference=COMPOSITIONTYPE.RP_IF_BJB_CALID_Index_02_XIX_BMC_HV.DE_BJB_CALID_Index_02
      RP_IF_BJB_CALID_Index_02_XIX_BMC_HV: upstream-reference=Geltungsbereich_E3_1_2_Premium.RP_IF_BJB_CALID_Index_02_XIX_BMC_HV, ecu-extract-reference=COMPOSITIONTYPE.RP_IF_BJB_CALID_Index_02_XIX_BMC_HV
      BJB_CALID_Index_03: upstream-reference=Geltungsbereich_E3_1_2_Premium.RP_IF_BJB_CALID_Index_03_XIX_BMC_HV.DE_BJB_CALID_Index_03, ecu-extract-reference=COMPOSITIONTYPE.RP_IF_BJB_CALID_Index_03_XIX_BMC_HV.DE_BJB_CALID_Index_03
      RP_IF_BJB_CALID_Index_03_XIX_BMC_HV: upstream-reference=Geltungsbereich_E3_1_2_Premium.RP_IF_BJB_CALID_Index_03_XIX_BMC_HV, ecu-extract-reference=COMPOSITIONTYPE.RP_IF_BJB_CALID_Index_03_XIX_BMC_HV
      BJB_CALID_Index_04: upstream-reference=Geltungsbereich_E3_1_2_Premium.RP_IF_BJB_CALID_Index_04_XIX_BMC_HV.DE_BJB_CALID_Index_04, ecu-extract-reference=COMPOSITIONTYPE.RP_IF_BJB_CALID_Index_04_XIX_BMC_HV.DE_BJB_CALID_Index_04
      RP_IF_BJB_CALID_Index_04_XIX_BMC_HV: upstream-reference=Geltungsbereich_E3_1_2_Premium.RP_IF_BJB_CALID_Index_04_XIX_BMC_HV, ecu-extract-reference=COMPOSITIONTYPE.RP_IF_BJB_CALID_Index_04_XIX_BMC_HV
      BJB_CALID_Index_05: upstream-reference=Geltungsbereich_E3_1_2_Premium.RP_IF_BJB_CALID_Index_05_XIX_BMC_HV.DE_BJB_CALID_Index_05, ecu-extract-reference=COMPOSITIONTYPE.RP_IF_BJB_CALID_Index_05_XIX_BMC_HV.DE_BJB_CALID_Index_05
      RP_IF_BJB_CALID_Index_05_XIX_BMC_HV: upstream-reference=Geltungsbereich_E3_1_2_Premium.RP_IF_BJB_CALID_Index_05_XIX_BMC_HV, ecu-extract-reference=COMPOSITIONTYPE.RP_IF_BJB_CALID_Index_05_XIX_BMC_HV
      BJB_CALID_Index_06: upstream-reference=Geltungsbereich_E3_1_2_Premium.RP_IF_BJB_CALID_Index_06_XIX_BMC_HV.DE_BJB_CALID_Index_06, ecu-extract-reference=COMPOSITIONTYPE.RP_IF_BJB_CALID_Index_06_XIX_BMC_HV.DE_BJB_CALID_Index_06
      RP_IF_BJB_CALID_Index_06_XIX_BMC_HV: upstream-reference=Geltungsbereich_E3_1_2_Premium.RP_IF_BJB_CALID_Index_06_XIX_BMC_HV, ecu-extract-reference=COMPOSITIONTYPE.RP_IF_BJB_CALID_Index_06_XIX_BMC_HV
      BJB_CALID_Index_07: upstream-reference=Geltungsbereich_E3_1_2_Premium.RP_IF_BJB_CALID_Index_07_XIX_BMC_HV.DE_BJB_CALID_Index_07, ecu-extract-reference=COMPOSITIONTYPE.RP_IF_BJB_CALID_Index_07_XIX_BMC_HV.DE_BJB_CALID_Index_07
      RP_IF_BJB_CALID_Index_07_XIX_BMC_HV: upstream-reference=Geltungsbereich_E3_1_2_Premium.RP_IF_BJB_CALID_Index_07_XIX_BMC_HV, ecu-extract-reference=COMPOSITIONTYPE.RP_IF_BJB_CALID_Index_07_XIX_BMC_HV
      BJB_CALID_Index_08: upstream-reference=Geltungsbereich_E3_1_2_Premium.RP_IF_BJB_CALID_Index_08_XIX_BMC_HV.DE_BJB_CALID_Index_08, ecu-extract-reference=COMPOSITIONTYPE.RP_IF_BJB_CALID_Index_08_XIX_BMC_HV.DE_BJB_CALID_Index_08
      RP_IF_BJB_CALID_Index_08_XIX_BMC_HV: upstream-reference=Geltungsbereich_E3_1_2_Premium.RP_IF_BJB_CALID_Index_08_XIX_BMC_HV, ecu-extract-reference=COMPOSITIONTYPE.RP_IF_BJB_CALID_Index_08_XIX_BMC_HV
      BJB_CALID_Index_09: upstream-reference=Geltungsbereich_E3_1_2_Premium.RP_IF_BJB_CALID_Index_09_XIX_BMC_HV.DE_BJB_CALID_Index_09, ecu-extract-reference=COMPOSITIONTYPE.RP_IF_BJB_CALID_Index_09_XIX_BMC_HV.DE_BJB_CALID_Index_09
      RP_IF_BJB_CALID_Index_09_XIX_BMC_HV: upstream-reference=Geltungsbereich_E3_1_2_Premium.RP_IF_BJB_CALID_Index_09_XIX_BMC_HV, ecu-extract-reference=COMPOSITIONTYPE.RP_IF_BJB_CALID_Index_09_XIX_BMC_HV
      BJB_CALID_Index_10: upstream-reference=Geltungsbereich_E3_1_2_Premium.RP_IF_BJB_CALID_Index_10_XIX_BMC_HV.DE_BJB_CALID_Index_10, ecu-extract-reference=COMPOSITIONTYPE.RP_IF_BJB_CALID_Index_10_XIX_BMC_HV.DE_BJB_CALID_Index_10
      RP_IF_BJB_CALID_Index_10_XIX_BMC_HV: upstream-reference=Geltungsbereich_E3_1_2_Premium.RP_IF_BJB_CALID_Index_10_XIX_BMC_HV, ecu-extract-reference=COMPOSITIONTYPE.RP_IF_BJB_CALID_Index_10_XIX_BMC_HV
      BJB_CALID_Index_11: upstream-reference=Geltungsbereich_E3_1_2_Premium.RP_IF_BJB_CALID_Index_11_XIX_BMC_HV.DE_BJB_CALID_Index_11, ecu-extract-reference=COMPOSITIONTYPE.RP_IF_BJB_CALID_Index_11_XIX_BMC_HV.DE_BJB_CALID_Index_11
      RP_IF_BJB_CALID_Index_11_XIX_BMC_HV: upstream-reference=Geltungsbereich_E3_1_2_Premium.RP_IF_BJB_CALID_Index_11_XIX_BMC_HV, ecu-extract-reference=COMPOSITIONTYPE.RP_IF_BJB_CALID_Index_11_XIX_BMC_HV
      BJB_CALID_Index_12: upstream-reference=Geltungsbereich_E3_1_2_Premium.RP_IF_BJB_CALID_Index_12_XIX_BMC_HV.DE_BJB_CALID_Index_12, ecu-extract-reference=COMPOSITIONTYPE.RP_IF_BJB_CALID_Index_12_XIX_BMC_HV.DE_BJB_CALID_Index_12
      RP_IF_BJB_CALID_Index_12_XIX_BMC_HV: upstream-reference=Geltungsbereich_E3_1_2_Premium.RP_IF_BJB_CALID_Index_12_XIX_BMC_HV, ecu-extract-reference=COMPOSITIONTYPE.RP_IF_BJB_CALID_Index_12_XIX_BMC_HV
      BJB_CALID_Index_13: upstream-reference=Geltungsbereich_E3_1_2_Premium.RP_IF_BJB_CALID_Index_13_XIX_BMC_HV.DE_BJB_CALID_Index_13, ecu-extract-reference=COMPOSITIONTYPE.RP_IF_BJB_CALID_Index_13_XIX_BMC_HV.DE_BJB_CALID_Index_13
      RP_IF_BJB_CALID_Index_13_XIX_BMC_HV: upstream-reference=Geltungsbereich_E3_1_2_Premium.RP_IF_BJB_CALID_Index_13_XIX_BMC_HV, ecu-extract-reference=COMPOSITIONTYPE.RP_IF_BJB_CALID_Index_13_XIX_BMC_HV
      BJB_CALID_Index_14: upstream-reference=Geltungsbereich_E3_1_2_Premium.RP_IF_BJB_CALID_Index_14_XIX_BMC_HV.DE_BJB_CALID_Index_14, ecu-extract-reference=COMPOSITIONTYPE.RP_IF_BJB_CALID_Index_14_XIX_BMC_HV.DE_BJB_CALID_Index_14
      RP_IF_BJB_CALID_Index_14_XIX_BMC_HV: upstream-reference=Geltungsbereich_E3_1_2_Premium.RP_IF_BJB_CALID_Index_14_XIX_BMC_HV, ecu-extract-reference=COMPOSITIONTYPE.RP_IF_BJB_CALID_Index_14_XIX_BMC_HV
      BJB_CALID_Index_15: upstream-reference=Geltungsbereich_E3_1_2_Premium.RP_IF_BJB_CALID_Index_15_XIX_BMC_HV.DE_BJB_CALID_Index_15, ecu-extract-reference=COMPOSITIONTYPE.RP_IF_BJB_CALID_Index_15_XIX_BMC_HV.DE_BJB_CALID_Index_15
      RP_IF_BJB_CALID_Index_15_XIX_BMC_HV: upstream-reference=Geltungsbereich_E3_1_2_Premium.RP_IF_BJB_CALID_Index_15_XIX_BMC_HV, ecu-extract-reference=COMPOSITIONTYPE.RP_IF_BJB_CALID_Index_15_XIX_BMC_HV
      BJB_CALID_Index_16: upstream-reference=Geltungsbereich_E3_1_2_Premium.RP_IF_BJB_CALID_Index_16_XIX_BMC_HV.DE_BJB_CALID_Index_16, ecu-extract-reference=COMPOSITIONTYPE.RP_IF_BJB_CALID_Index_16_XIX_BMC_HV.DE_BJB_CALID_Index_16
      RP_IF_BJB_CALID_Index_16_XIX_BMC_HV: upstream-reference=Geltungsbereich_E3_1_2_Premium.RP_IF_BJB_CALID_Index_16_XIX_BMC_HV, ecu-extract-reference=COMPOSITIONTYPE.RP_IF_BJB_CALID_Index_16_XIX_BMC_HV
      BJB_CVN_Byte_1: upstream-reference=Geltungsbereich_E3_1_2_Premium.RP_IF_BJB_CVN_Byte_1_XIX_BMC_HV.DE_BJB_CVN_Byte_1, ecu-extract-reference=COMPOSITIONTYPE.RP_IF_BJB_CVN_Byte_1_XIX_BMC_HV.DE_BJB_CVN_Byte_1
      RP_IF_BJB_CVN_Byte_1_XIX_BMC_HV: upstream-reference=Geltungsbereich_E3_1_2_Premium.RP_IF_BJB_CVN_Byte_1_XIX_BMC_HV, ecu-extract-reference=COMPOSITIONTYPE.RP_IF_BJB_CVN_Byte_1_XIX_BMC_HV
      BJB_CVN_Byte_2: upstream-reference=Geltungsbereich_E3_1_2_Premium.RP_IF_BJB_CVN_Byte_2_XIX_BMC_HV.DE_BJB_CVN_Byte_2, ecu-extract-reference=COMPOSITIONTYPE.RP_IF_BJB_CVN_Byte_2_XIX_BMC_HV.DE_BJB_CVN_Byte_2
      RP_IF_BJB_CVN_Byte_2_XIX_BMC_HV: upstream-reference=Geltungsbereich_E3_1_2_Premium.RP_IF_BJB_CVN_Byte_2_XIX_BMC_HV, ecu-extract-reference=COMPOSITIONTYPE.RP_IF_BJB_CVN_Byte_2_XIX_BMC_HV
      BJB_CVN_Byte_3: upstream-reference=Geltungsbereich_E3_1_2_Premium.RP_IF_BJB_CVN_Byte_3_XIX_BMC_HV.DE_BJB_CVN_Byte_3, ecu-extract-reference=COMPOSITIONTYPE.RP_IF_BJB_CVN_Byte_3_XIX_BMC_HV.DE_BJB_CVN_Byte_3
      RP_IF_BJB_CVN_Byte_3_XIX_BMC_HV: upstream-reference=Geltungsbereich_E3_1_2_Premium.RP_IF_BJB_CVN_Byte_3_XIX_BMC_HV, ecu-extract-reference=COMPOSITIONTYPE.RP_IF_BJB_CVN_Byte_3_XIX_BMC_HV
      BJB_CVN_Byte_4: upstream-reference=Geltungsbereich_E3_1_2_Premium.RP_IF_BJB_CVN_Byte_4_XIX_BMC_HV.DE_BJB_CVN_Byte_4, ecu-extract-reference=COMPOSITIONTYPE.RP_IF_BJB_CVN_Byte_4_XIX_BMC_HV.DE_BJB_CVN_Byte_4
      RP_IF_BJB_CVN_Byte_4_XIX_BMC_HV: upstream-reference=Geltungsbereich_E3_1_2_Premium.RP_IF_BJB_CVN_Byte_4_XIX_BMC_HV, ecu-extract-reference=COMPOSITIONTYPE.RP_IF_BJB_CVN_Byte_4_XIX_BMC_HV
      BJB_CVN_VLD: upstream-reference=Geltungsbereich_E3_1_2_Premium.RP_IF_BJB_CVN_VLD_XIX_BMC_HV.DE_BJB_CVN_VLD, ecu-extract-reference=COMPOSITIONTYPE.RP_IF_BJB_CVN_VLD_XIX_BMC_HV.DE_BJB_CVN_VLD
      RP_IF_BJB_CVN_VLD_XIX_BMC_HV: upstream-reference=Geltungsbereich_E3_1_2_Premium.RP_IF_BJB_CVN_VLD_XIX_BMC_HV, ecu-extract-reference=COMPOSITIONTYPE.RP_IF_BJB_CVN_VLD_XIX_BMC_HV
      BJB_ErrMem_State: upstream-reference=Geltungsbereich_E3_1_2_Premium.BJB_ErrMem_State, ecu-extract-reference=COMPOSITIONTYPE.BJB_ErrMem_State
      RP_IF_BJB_ErrMem_State_XIX_BMC_HV: upstream-reference=Geltungsbereich_E3_1_2_Premium.RP_IF_BJB_ErrMem_State_XIX_BMC_HV, ecu-extract-reference=COMPOSITIONTYPE.RP_IF_BJB_ErrMem_State_XIX_BMC_HV
      CHA_ReqPrgBms: upstream-reference=Geltungsbereich_E3_1_2_Premium.RP_IF_CHA_ReqPrgBms_XIX_BMC_HV.DE_CHA_ReqPrgBms, ecu-extract-reference=COMPOSITIONTYPE.RP_IF_CHA_ReqPrgBms_XIX_BMC_HV.DE_CHA_ReqPrgBms
      RP_IF_CHA_ReqPrgBms_XIX_BMC_HV: upstream-reference=Geltungsbereich_E3_1_2_Premium.RP_IF_CHA_ReqPrgBms_XIX_BMC_HV, ecu-extract-reference=COMPOSITIONTYPE.RP_IF_CHA_ReqPrgBms_XIX_BMC_HV
      DC_IstLeistung_HV: upstream-reference=Geltungsbereich_E3_1_2_Premium.RP_IF_DC_IstLeistung_HV_XIX_BMC_HV.DE_DC_IstLeistung_HV, ecu-extract-reference=COMPOSITIONTYPE.RP_IF_DC_IstLeistung_HV_XIX_BMC_HV.DE_DC_IstLeistung_HV
      RP_IF_DC_IstLeistung_HV_XIX_BMC_HV: upstream-reference=Geltungsbereich_E3_1_2_Premium.RP_IF_DC_IstLeistung_HV_XIX_BMC_HV, ecu-extract-reference=COMPOSITIONTYPE.RP_IF_DC_IstLeistung_HV_XIX_BMC_HV
      DCDC_NV_CALID_Index_01: upstream-reference=Geltungsbereich_E3_1_2_Premium.RP_IF_DCDC_NV_CALID_Index_01_XIX_BMC_HV.DE_DCDC_NV_CALID_Index_01, ecu-extract-reference=COMPOSITIONTYPE.RP_IF_DCDC_NV_CALID_Index_01_XIX_BMC_HV.DE_DCDC_NV_CALID_Index_01
      RP_IF_DCDC_NV_CALID_Index_01_XIX_BMC_HV: upstream-reference=Geltungsbereich_E3_1_2_Premium.RP_IF_DCDC_NV_CALID_Index_01_XIX_BMC_HV, ecu-extract-reference=COMPOSITIONTYPE.RP_IF_DCDC_NV_CALID_Index_01_XIX_BMC_HV
      DCDC_NV_CALID_Index_02: upstream-reference=Geltungsbereich_E3_1_2_Premium.RP_IF_DCDC_NV_CALID_Index_02_XIX_BMC_HV.DE_DCDC_NV_CALID_Index_02, ecu-extract-reference=COMPOSITIONTYPE.RP_IF_DCDC_NV_CALID_Index_02_XIX_BMC_HV.DE_DCDC_NV_CALID_Index_02
      RP_IF_DCDC_NV_CALID_Index_02_XIX_BMC_HV: upstream-reference=Geltungsbereich_E3_1_2_Premium.RP_IF_DCDC_NV_CALID_Index_02_XIX_BMC_HV, ecu-extract-reference=COMPOSITIONTYPE.RP_IF_DCDC_NV_CALID_Index_02_XIX_BMC_HV
      DCDC_NV_CALID_Index_03: upstream-reference=Geltungsbereich_E3_1_2_Premium.RP_IF_DCDC_NV_CALID_Index_03_XIX_BMC_HV.DE_DCDC_NV_CALID_Index_03, ecu-extract-reference=COMPOSITIONTYPE.RP_IF_DCDC_NV_CALID_Index_03_XIX_BMC_HV.DE_DCDC_NV_CALID_Index_03
      RP_IF_DCDC_NV_CALID_Index_03_XIX_BMC_HV: upstream-reference=Geltungsbereich_E3_1_2_Premium.RP_IF_DCDC_NV_CALID_Index_03_XIX_BMC_HV, ecu-extract-reference=COMPOSITIONTYPE.RP_IF_DCDC_NV_CALID_Index_03_XIX_BMC_HV
      DCDC_NV_CALID_Index_04: upstream-reference=Geltungsbereich_E3_1_2_Premium.RP_IF_DCDC_NV_CALID_Index_04_XIX_BMC_HV.DE_DCDC_NV_CALID_Index_04, ecu-extract-reference=COMPOSITIONTYPE.RP_IF_DCDC_NV_CALID_Index_04_XIX_BMC_HV.DE_DCDC_NV_CALID_Index_04
      RP_IF_DCDC_NV_CALID_Index_04_XIX_BMC_HV: upstream-reference=Geltungsbereich_E3_1_2_Premium.RP_IF_DCDC_NV_CALID_Index_04_XIX_BMC_HV, ecu-extract-reference=COMPOSITIONTYPE.RP_IF_DCDC_NV_CALID_Index_04_XIX_BMC_HV
      DCDC_NV_CALID_Index_05: upstream-reference=Geltungsbereich_E3_1_2_Premium.RP_IF_DCDC_NV_CALID_Index_05_XIX_BMC_HV.DE_DCDC_NV_CALID_Index_05, ecu-extract-reference=COMPOSITIONTYPE.RP_IF_DCDC_NV_CALID_Index_05_XIX_BMC_HV.DE_DCDC_NV_CALID_Index_05
      RP_IF_DCDC_NV_CALID_Index_05_XIX_BMC_HV: upstream-reference=Geltungsbereich_E3_1_2_Premium.RP_IF_DCDC_NV_CALID_Index_05_XIX_BMC_HV, ecu-extract-reference=COMPOSITIONTYPE.RP_IF_DCDC_NV_CALID_Index_05_XIX_BMC_HV
      DCDC_NV_CALID_Index_06: upstream-reference=Geltungsbereich_E3_1_2_Premium.RP_IF_DCDC_NV_CALID_Index_06_XIX_BMC_HV.DE_DCDC_NV_CALID_Index_06, ecu-extract-reference=COMPOSITIONTYPE.RP_IF_DCDC_NV_CALID_Index_06_XIX_BMC_HV.DE_DCDC_NV_CALID_Index_06
      RP_IF_DCDC_NV_CALID_Index_06_XIX_BMC_HV: upstream-reference=Geltungsbereich_E3_1_2_Premium.RP_IF_DCDC_NV_CALID_Index_06_XIX_BMC_HV, ecu-extract-reference=COMPOSITIONTYPE.RP_IF_DCDC_NV_CALID_Index_06_XIX_BMC_HV
      DCDC_NV_CALID_Index_07: upstream-reference=Geltungsbereich_E3_1_2_Premium.RP_IF_DCDC_NV_CALID_Index_07_XIX_BMC_HV.DE_DCDC_NV_CALID_Index_07, ecu-extract-reference=COMPOSITIONTYPE.RP_IF_DCDC_NV_CALID_Index_07_XIX_BMC_HV.DE_DCDC_NV_CALID_Index_07
      RP_IF_DCDC_NV_CALID_Index_07_XIX_BMC_HV: upstream-reference=Geltungsbereich_E3_1_2_Premium.RP_IF_DCDC_NV_CALID_Index_07_XIX_BMC_HV, ecu-extract-reference=COMPOSITIONTYPE.RP_IF_DCDC_NV_CALID_Index_07_XIX_BMC_HV
      DCDC_NV_CALID_Index_08: upstream-reference=Geltungsbereich_E3_1_2_Premium.RP_IF_DCDC_NV_CALID_Index_08_XIX_BMC_HV.DE_DCDC_NV_CALID_Index_08, ecu-extract-reference=COMPOSITIONTYPE.RP_IF_DCDC_NV_CALID_Index_08_XIX_BMC_HV.DE_DCDC_NV_CALID_Index_08
      RP_IF_DCDC_NV_CALID_Index_08_XIX_BMC_HV: upstream-reference=Geltungsbereich_E3_1_2_Premium.RP_IF_DCDC_NV_CALID_Index_08_XIX_BMC_HV, ecu-extract-reference=COMPOSITIONTYPE.RP_IF_DCDC_NV_CALID_Index_08_XIX_BMC_HV
      DCDC_NV_CALID_Index_09: upstream-reference=Geltungsbereich_E3_1_2_Premium.RP_IF_DCDC_NV_CALID_Index_09_XIX_BMC_HV.DE_DCDC_NV_CALID_Index_09, ecu-extract-reference=COMPOSITIONTYPE.RP_IF_DCDC_NV_CALID_Index_09_XIX_BMC_HV.DE_DCDC_NV_CALID_Index_09
      RP_IF_DCDC_NV_CALID_Index_09_XIX_BMC_HV: upstream-reference=Geltungsbereich_E3_1_2_Premium.RP_IF_DCDC_NV_CALID_Index_09_XIX_BMC_HV, ecu-extract-reference=COMPOSITIONTYPE.RP_IF_DCDC_NV_CALID_Index_09_XIX_BMC_HV
      DCDC_NV_CALID_Index_10: upstream-reference=Geltungsbereich_E3_1_2_Premium.RP_IF_DCDC_NV_CALID_Index_10_XIX_BMC_HV.DE_DCDC_NV_CALID_Index_10, ecu-extract-reference=COMPOSITIONTYPE.RP_IF_DCDC_NV_CALID_Index_10_XIX_BMC_HV.DE_DCDC_NV_CALID_Index_10
      RP_IF_DCDC_NV_CALID_Index_10_XIX_BMC_HV: upstream-reference=Geltungsbereich_E3_1_2_Premium.RP_IF_DCDC_NV_CALID_Index_10_XIX_BMC_HV, ecu-extract-reference=COMPOSITIONTYPE.RP_IF_DCDC_NV_CALID_Index_10_XIX_BMC_HV
      DCDC_NV_CALID_Index_11: upstream-reference=Geltungsbereich_E3_1_2_Premium.RP_IF_DCDC_NV_CALID_Index_11_XIX_BMC_HV.DE_DCDC_NV_CALID_Index_11, ecu-extract-reference=COMPOSITIONTYPE.RP_IF_DCDC_NV_CALID_Index_11_XIX_BMC_HV.DE_DCDC_NV_CALID_Index_11
      RP_IF_DCDC_NV_CALID_Index_11_XIX_BMC_HV: upstream-reference=Geltungsbereich_E3_1_2_Premium.RP_IF_DCDC_NV_CALID_Index_11_XIX_BMC_HV, ecu-extract-reference=COMPOSITIONTYPE.RP_IF_DCDC_NV_CALID_Index_11_XIX_BMC_HV
      DCDC_NV_CALID_Index_12: upstream-reference=Geltungsbereich_E3_1_2_Premium.RP_IF_DCDC_NV_CALID_Index_12_XIX_BMC_HV.DE_DCDC_NV_CALID_Index_12, ecu-extract-reference=COMPOSITIONTYPE.RP_IF_DCDC_NV_CALID_Index_12_XIX_BMC_HV.DE_DCDC_NV_CALID_Index_12
      RP_IF_DCDC_NV_CALID_Index_12_XIX_BMC_HV: upstream-reference=Geltungsbereich_E3_1_2_Premium.RP_IF_DCDC_NV_CALID_Index_12_XIX_BMC_HV, ecu-extract-reference=COMPOSITIONTYPE.RP_IF_DCDC_NV_CALID_Index_12_XIX_BMC_HV
      DCDC_NV_CALID_Index_13: upstream-reference=Geltungsbereich_E3_1_2_Premium.RP_IF_DCDC_NV_CALID_Index_13_XIX_BMC_HV.DE_DCDC_NV_CALID_Index_13, ecu-extract-reference=COMPOSITIONTYPE.RP_IF_DCDC_NV_CALID_Index_13_XIX_BMC_HV.DE_DCDC_NV_CALID_Index_13
      RP_IF_DCDC_NV_CALID_Index_13_XIX_BMC_HV: upstream-reference=Geltungsbereich_E3_1_2_Premium.RP_IF_DCDC_NV_CALID_Index_13_XIX_BMC_HV, ecu-extract-reference=COMPOSITIONTYPE.RP_IF_DCDC_NV_CALID_Index_13_XIX_BMC_HV
      DCDC_NV_CALID_Index_14: upstream-reference=Geltungsbereich_E3_1_2_Premium.RP_IF_DCDC_NV_CALID_Index_14_XIX_BMC_HV.DE_DCDC_NV_CALID_Index_14, ecu-extract-reference=COMPOSITIONTYPE.RP_IF_DCDC_NV_CALID_Index_14_XIX_BMC_HV.DE_DCDC_NV_CALID_Index_14
      RP_IF_DCDC_NV_CALID_Index_14_XIX_BMC_HV: upstream-reference=Geltungsbereich_E3_1_2_Premium.RP_IF_DCDC_NV_CALID_Index_14_XIX_BMC_HV, ecu-extract-reference=COMPOSITIONTYPE.RP_IF_DCDC_NV_CALID_Index_14_XIX_BMC_HV
      DCDC_NV_CALID_Index_15: upstream-reference=Geltungsbereich_E3_1_2_Premium.RP_IF_DCDC_NV_CALID_Index_15_XIX_BMC_HV.DE_DCDC_NV_CALID_Index_15, ecu-extract-reference=COMPOSITIONTYPE.RP_IF_DCDC_NV_CALID_Index_15_XIX_BMC_HV.DE_DCDC_NV_CALID_Index_15
      RP_IF_DCDC_NV_CALID_Index_15_XIX_BMC_HV: upstream-reference=Geltungsbereich_E3_1_2_Premium.RP_IF_DCDC_NV_CALID_Index_15_XIX_BMC_HV, ecu-extract-reference=COMPOSITIONTYPE.RP_IF_DCDC_NV_CALID_Index_15_XIX_BMC_HV
      DCDC_NV_CALID_Index_16: upstream-reference=Geltungsbereich_E3_1_2_Premium.RP_IF_DCDC_NV_CALID_Index_16_XIX_BMC_HV.DE_DCDC_NV_CALID_Index_16, ecu-extract-reference=COMPOSITIONTYPE.RP_IF_DCDC_NV_CALID_Index_16_XIX_BMC_HV.DE_DCDC_NV_CALID_Index_16
      RP_IF_DCDC_NV_CALID_Index_16_XIX_BMC_HV: upstream-reference=Geltungsbereich_E3_1_2_Premium.RP_IF_DCDC_NV_CALID_Index_16_XIX_BMC_HV, ecu-extract-reference=COMPOSITIONTYPE.RP_IF_DCDC_NV_CALID_Index_16_XIX_BMC_HV
      DCDC_NV_CVN_Byte_1: upstream-reference=Geltungsbereich_E3_1_2_Premium.RP_IF_DCDC_NV_CVN_Byte_1_XIX_BMC_HV.DE_DCDC_NV_CVN_Byte_1, ecu-extract-reference=COMPOSITIONTYPE.RP_IF_DCDC_NV_CVN_Byte_1_XIX_BMC_HV.DE_DCDC_NV_CVN_Byte_1
      RP_IF_DCDC_NV_CVN_Byte_1_XIX_BMC_HV: upstream-reference=Geltungsbereich_E3_1_2_Premium.RP_IF_DCDC_NV_CVN_Byte_1_XIX_BMC_HV, ecu-extract-reference=COMPOSITIONTYPE.RP_IF_DCDC_NV_CVN_Byte_1_XIX_BMC_HV
      DCDC_NV_CVN_Byte_2: upstream-reference=Geltungsbereich_E3_1_2_Premium.RP_IF_DCDC_NV_CVN_Byte_2_XIX_BMC_HV.DE_DCDC_NV_CVN_Byte_2, ecu-extract-reference=COMPOSITIONTYPE.RP_IF_DCDC_NV_CVN_Byte_2_XIX_BMC_HV.DE_DCDC_NV_CVN_Byte_2
      RP_IF_DCDC_NV_CVN_Byte_2_XIX_BMC_HV: upstream-reference=Geltungsbereich_E3_1_2_Premium.RP_IF_DCDC_NV_CVN_Byte_2_XIX_BMC_HV, ecu-extract-reference=COMPOSITIONTYPE.RP_IF_DCDC_NV_CVN_Byte_2_XIX_BMC_HV
      DCDC_NV_CVN_Byte_3: upstream-reference=Geltungsbereich_E3_1_2_Premium.RP_IF_DCDC_NV_CVN_Byte_3_XIX_BMC_HV.DE_DCDC_NV_CVN_Byte_3, ecu-extract-reference=COMPOSITIONTYPE.RP_IF_DCDC_NV_CVN_Byte_3_XIX_BMC_HV.DE_DCDC_NV_CVN_Byte_3
      RP_IF_DCDC_NV_CVN_Byte_3_XIX_BMC_HV: upstream-reference=Geltungsbereich_E3_1_2_Premium.RP_IF_DCDC_NV_CVN_Byte_3_XIX_BMC_HV, ecu-extract-reference=COMPOSITIONTYPE.RP_IF_DCDC_NV_CVN_Byte_3_XIX_BMC_HV
      DCDC_NV_CVN_Byte_4: upstream-reference=Geltungsbereich_E3_1_2_Premium.RP_IF_DCDC_NV_CVN_Byte_4_XIX_BMC_HV.DE_DCDC_NV_CVN_Byte_4, ecu-extract-reference=COMPOSITIONTYPE.RP_IF_DCDC_NV_CVN_Byte_4_XIX_BMC_HV.DE_DCDC_NV_CVN_Byte_4
      RP_IF_DCDC_NV_CVN_Byte_4_XIX_BMC_HV: upstream-reference=Geltungsbereich_E3_1_2_Premium.RP_IF_DCDC_NV_CVN_Byte_4_XIX_BMC_HV, ecu-extract-reference=COMPOSITIONTYPE.RP_IF_DCDC_NV_CVN_Byte_4_XIX_BMC_HV
      DCDC_NV_CVN_VLD: upstream-reference=Geltungsbereich_E3_1_2_Premium.RP_IF_DCDC_NV_CVN_VLD_XIX_BMC_HV.DE_DCDC_NV_CVN_VLD, ecu-extract-reference=COMPOSITIONTYPE.RP_IF_DCDC_NV_CVN_VLD_XIX_BMC_HV.DE_DCDC_NV_CVN_VLD
      RP_IF_DCDC_NV_CVN_VLD_XIX_BMC_HV: upstream-reference=Geltungsbereich_E3_1_2_Premium.RP_IF_DCDC_NV_CVN_VLD_XIX_BMC_HV, ecu-extract-reference=COMPOSITIONTYPE.RP_IF_DCDC_NV_CVN_VLD_XIX_BMC_HV
      DCDC_NV_Komponentenfehler_01: upstream-reference=Geltungsbereich_E3_1_2_Premium.RP_IF_DCDC_NV_Komponentenfehler_01_XIX_BMC_HV.DE_DCDC_NV_Komponentenfehler_01, ecu-extract-reference=COMPOSITIONTYPE.RP_IF_DCDC_NV_Komponentenfehler_01_XIX_BMC_HV.DE_DCDC_NV_Komponentenfehler_01
      RP_IF_DCDC_NV_Komponentenfehler_01_XIX_BMC_HV: upstream-reference=Geltungsbereich_E3_1_2_Premium.RP_IF_DCDC_NV_Komponentenfehler_01_XIX_BMC_HV, ecu-extract-reference=COMPOSITIONTYPE.RP_IF_DCDC_NV_Komponentenfehler_01_XIX_BMC_HV
      DCDC_NV_Komponentenfehler_02: upstream-reference=Geltungsbereich_E3_1_2_Premium.RP_IF_DCDC_NV_Komponentenfehler_02_XIX_BMC_HV.DE_DCDC_NV_Komponentenfehler_02, ecu-extract-reference=COMPOSITIONTYPE.RP_IF_DCDC_NV_Komponentenfehler_02_XIX_BMC_HV.DE_DCDC_NV_Komponentenfehler_02
      RP_IF_DCDC_NV_Komponentenfehler_02_XIX_BMC_HV: upstream-reference=Geltungsbereich_E3_1_2_Premium.RP_IF_DCDC_NV_Komponentenfehler_02_XIX_BMC_HV, ecu-extract-reference=COMPOSITIONTYPE.RP_IF_DCDC_NV_Komponentenfehler_02_XIX_BMC_HV
      DCDC_NV_Komponentenfehler_03: upstream-reference=Geltungsbereich_E3_1_2_Premium.RP_IF_DCDC_NV_Komponentenfehler_03_XIX_BMC_HV.DE_DCDC_NV_Komponentenfehler_03, ecu-extract-reference=COMPOSITIONTYPE.RP_IF_DCDC_NV_Komponentenfehler_03_XIX_BMC_HV.DE_DCDC_NV_Komponentenfehler_03
      RP_IF_DCDC_NV_Komponentenfehler_03_XIX_BMC_HV: upstream-reference=Geltungsbereich_E3_1_2_Premium.RP_IF_DCDC_NV_Komponentenfehler_03_XIX_BMC_HV, ecu-extract-reference=COMPOSITIONTYPE.RP_IF_DCDC_NV_Komponentenfehler_03_XIX_BMC_HV
      DCDC_NV_Komponentenfehler_04: upstream-reference=Geltungsbereich_E3_1_2_Premium.RP_IF_DCDC_NV_Komponentenfehler_04_XIX_BMC_HV.DE_DCDC_NV_Komponentenfehler_04, ecu-extract-reference=COMPOSITIONTYPE.RP_IF_DCDC_NV_Komponentenfehler_04_XIX_BMC_HV.DE_DCDC_NV_Komponentenfehler_04
      RP_IF_DCDC_NV_Komponentenfehler_04_XIX_BMC_HV: upstream-reference=Geltungsbereich_E3_1_2_Premium.RP_IF_DCDC_NV_Komponentenfehler_04_XIX_BMC_HV, ecu-extract-reference=COMPOSITIONTYPE.RP_IF_DCDC_NV_Komponentenfehler_04_XIX_BMC_HV
      DCDC_NV_Komponentenfehler_05: upstream-reference=Geltungsbereich_E3_1_2_Premium.RP_IF_DCDC_NV_Komponentenfehler_05_XIX_BMC_HV.DE_DCDC_NV_Komponentenfehler_05, ecu-extract-reference=COMPOSITIONTYPE.RP_IF_DCDC_NV_Komponentenfehler_05_XIX_BMC_HV.DE_DCDC_NV_Komponentenfehler_05
      RP_IF_DCDC_NV_Komponentenfehler_05_XIX_BMC_HV: upstream-reference=Geltungsbereich_E3_1_2_Premium.RP_IF_DCDC_NV_Komponentenfehler_05_XIX_BMC_HV, ecu-extract-reference=COMPOSITIONTYPE.RP_IF_DCDC_NV_Komponentenfehler_05_XIX_BMC_HV
      DCDC_NV_Komponentenfehler_06: upstream-reference=Geltungsbereich_E3_1_2_Premium.RP_IF_DCDC_NV_Komponentenfehler_06_XIX_BMC_HV.DE_DCDC_NV_Komponentenfehler_06, ecu-extract-reference=COMPOSITIONTYPE.RP_IF_DCDC_NV_Komponentenfehler_06_XIX_BMC_HV.DE_DCDC_NV_Komponentenfehler_06
      RP_IF_DCDC_NV_Komponentenfehler_06_XIX_BMC_HV: upstream-reference=Geltungsbereich_E3_1_2_Premium.RP_IF_DCDC_NV_Komponentenfehler_06_XIX_BMC_HV, ecu-extract-reference=COMPOSITIONTYPE.RP_IF_DCDC_NV_Komponentenfehler_06_XIX_BMC_HV
      DCDC_NV_Komponentenfehler_07: upstream-reference=Geltungsbereich_E3_1_2_Premium.RP_IF_DCDC_NV_Komponentenfehler_07_XIX_BMC_HV.DE_DCDC_NV_Komponentenfehler_07, ecu-extract-reference=COMPOSITIONTYPE.RP_IF_DCDC_NV_Komponentenfehler_07_XIX_BMC_HV.DE_DCDC_NV_Komponentenfehler_07
      RP_IF_DCDC_NV_Komponentenfehler_07_XIX_BMC_HV: upstream-reference=Geltungsbereich_E3_1_2_Premium.RP_IF_DCDC_NV_Komponentenfehler_07_XIX_BMC_HV, ecu-extract-reference=COMPOSITIONTYPE.RP_IF_DCDC_NV_Komponentenfehler_07_XIX_BMC_HV
      DCDC_NV_Komponentenfehler_08: upstream-reference=Geltungsbereich_E3_1_2_Premium.RP_IF_DCDC_NV_Komponentenfehler_08_XIX_BMC_HV.DE_DCDC_NV_Komponentenfehler_08, ecu-extract-reference=COMPOSITIONTYPE.RP_IF_DCDC_NV_Komponentenfehler_08_XIX_BMC_HV.DE_DCDC_NV_Komponentenfehler_08
      RP_IF_DCDC_NV_Komponentenfehler_08_XIX_BMC_HV: upstream-reference=Geltungsbereich_E3_1_2_Premium.RP_IF_DCDC_NV_Komponentenfehler_08_XIX_BMC_HV, ecu-extract-reference=COMPOSITIONTYPE.RP_IF_DCDC_NV_Komponentenfehler_08_XIX_BMC_HV
      DCDC_NV_Komponentenfehler_09: upstream-reference=Geltungsbereich_E3_1_2_Premium.RP_IF_DCDC_NV_Komponentenfehler_09_XIX_BMC_HV.DE_DCDC_NV_Komponentenfehler_09, ecu-extract-reference=COMPOSITIONTYPE.RP_IF_DCDC_NV_Komponentenfehler_09_XIX_BMC_HV.DE_DCDC_NV_Komponentenfehler_09
      RP_IF_DCDC_NV_Komponentenfehler_09_XIX_BMC_HV: upstream-reference=Geltungsbereich_E3_1_2_Premium.RP_IF_DCDC_NV_Komponentenfehler_09_XIX_BMC_HV, ecu-extract-reference=COMPOSITIONTYPE.RP_IF_DCDC_NV_Komponentenfehler_09_XIX_BMC_HV
      DCDC_NV_Komponentenfehler_10: upstream-reference=Geltungsbereich_E3_1_2_Premium.RP_IF_DCDC_NV_Komponentenfehler_10_XIX_BMC_HV.DE_DCDC_NV_Komponentenfehler_10, ecu-extract-reference=COMPOSITIONTYPE.RP_IF_DCDC_NV_Komponentenfehler_10_XIX_BMC_HV.DE_DCDC_NV_Komponentenfehler_10
      RP_IF_DCDC_NV_Komponentenfehler_10_XIX_BMC_HV: upstream-reference=Geltungsbereich_E3_1_2_Premium.RP_IF_DCDC_NV_Komponentenfehler_10_XIX_BMC_HV, ecu-extract-reference=COMPOSITIONTYPE.RP_IF_DCDC_NV_Komponentenfehler_10_XIX_BMC_HV
      DCDC_NV_Komponentenfehler_11: upstream-reference=Geltungsbereich_E3_1_2_Premium.RP_IF_DCDC_NV_Komponentenfehler_11_XIX_BMC_HV.DE_DCDC_NV_Komponentenfehler_11, ecu-extract-reference=COMPOSITIONTYPE.RP_IF_DCDC_NV_Komponentenfehler_11_XIX_BMC_HV.DE_DCDC_NV_Komponentenfehler_11
      RP_IF_DCDC_NV_Komponentenfehler_11_XIX_BMC_HV: upstream-reference=Geltungsbereich_E3_1_2_Premium.RP_IF_DCDC_NV_Komponentenfehler_11_XIX_BMC_HV, ecu-extract-reference=COMPOSITIONTYPE.RP_IF_DCDC_NV_Komponentenfehler_11_XIX_BMC_HV
      DCDC_NV_Komponentenfehler_12: upstream-reference=Geltungsbereich_E3_1_2_Premium.RP_IF_DCDC_NV_Komponentenfehler_12_XIX_BMC_HV.DE_DCDC_NV_Komponentenfehler_12, ecu-extract-reference=COMPOSITIONTYPE.RP_IF_DCDC_NV_Komponentenfehler_12_XIX_BMC_HV.DE_DCDC_NV_Komponentenfehler_12
      RP_IF_DCDC_NV_Komponentenfehler_12_XIX_BMC_HV: upstream-reference=Geltungsbereich_E3_1_2_Premium.RP_IF_DCDC_NV_Komponentenfehler_12_XIX_BMC_HV, ecu-extract-reference=COMPOSITIONTYPE.RP_IF_DCDC_NV_Komponentenfehler_12_XIX_BMC_HV
      DCDC_NV_Komponentenfehler_13: upstream-reference=Geltungsbereich_E3_1_2_Premium.RP_IF_DCDC_NV_Komponentenfehler_13_XIX_BMC_HV.DE_DCDC_NV_Komponentenfehler_13, ecu-extract-reference=COMPOSITIONTYPE.RP_IF_DCDC_NV_Komponentenfehler_13_XIX_BMC_HV.DE_DCDC_NV_Komponentenfehler_13
      RP_IF_DCDC_NV_Komponentenfehler_13_XIX_BMC_HV: upstream-reference=Geltungsbereich_E3_1_2_Premium.RP_IF_DCDC_NV_Komponentenfehler_13_XIX_BMC_HV, ecu-extract-reference=COMPOSITIONTYPE.RP_IF_DCDC_NV_Komponentenfehler_13_XIX_BMC_HV
      DCDC_NV_Komponentenfehler_14: upstream-reference=Geltungsbereich_E3_1_2_Premium.RP_IF_DCDC_NV_Komponentenfehler_14_XIX_BMC_HV.DE_DCDC_NV_Komponentenfehler_14, ecu-extract-reference=COMPOSITIONTYPE.RP_IF_DCDC_NV_Komponentenfehler_14_XIX_BMC_HV.DE_DCDC_NV_Komponentenfehler_14
      RP_IF_DCDC_NV_Komponentenfehler_14_XIX_BMC_HV: upstream-reference=Geltungsbereich_E3_1_2_Premium.RP_IF_DCDC_NV_Komponentenfehler_14_XIX_BMC_HV, ecu-extract-reference=COMPOSITIONTYPE.RP_IF_DCDC_NV_Komponentenfehler_14_XIX_BMC_HV
      DCDC_NV_Komponentenfehler_15: upstream-reference=Geltungsbereich_E3_1_2_Premium.RP_IF_DCDC_NV_Komponentenfehler_15_XIX_BMC_HV.DE_DCDC_NV_Komponentenfehler_15, ecu-extract-reference=COMPOSITIONTYPE.RP_IF_DCDC_NV_Komponentenfehler_15_XIX_BMC_HV.DE_DCDC_NV_Komponentenfehler_15
      RP_IF_DCDC_NV_Komponentenfehler_15_XIX_BMC_HV: upstream-reference=Geltungsbereich_E3_1_2_Premium.RP_IF_DCDC_NV_Komponentenfehler_15_XIX_BMC_HV, ecu-extract-reference=COMPOSITIONTYPE.RP_IF_DCDC_NV_Komponentenfehler_15_XIX_BMC_HV
      DCDC_NV_Komponentenfehler_16: upstream-reference=Geltungsbereich_E3_1_2_Premium.RP_IF_DCDC_NV_Komponentenfehler_16_XIX_BMC_HV.DE_DCDC_NV_Komponentenfehler_16, ecu-extract-reference=COMPOSITIONTYPE.RP_IF_DCDC_NV_Komponentenfehler_16_XIX_BMC_HV.DE_DCDC_NV_Komponentenfehler_16
      RP_IF_DCDC_NV_Komponentenfehler_16_XIX_BMC_HV: upstream-reference=Geltungsbereich_E3_1_2_Premium.RP_IF_DCDC_NV_Komponentenfehler_16_XIX_BMC_HV, ecu-extract-reference=COMPOSITIONTYPE.RP_IF_DCDC_NV_Komponentenfehler_16_XIX_BMC_HV
      DCDC_NV_Komponentenfehler_17: upstream-reference=Geltungsbereich_E3_1_2_Premium.RP_IF_DCDC_NV_Komponentenfehler_17_XIX_BMC_HV.DE_DCDC_NV_Komponentenfehler_17, ecu-extract-reference=COMPOSITIONTYPE.RP_IF_DCDC_NV_Komponentenfehler_17_XIX_BMC_HV.DE_DCDC_NV_Komponentenfehler_17
      RP_IF_DCDC_NV_Komponentenfehler_17_XIX_BMC_HV: upstream-reference=Geltungsbereich_E3_1_2_Premium.RP_IF_DCDC_NV_Komponentenfehler_17_XIX_BMC_HV, ecu-extract-reference=COMPOSITIONTYPE.RP_IF_DCDC_NV_Komponentenfehler_17_XIX_BMC_HV
      DCDC_NV_Komponentenfehler_18: upstream-reference=Geltungsbereich_E3_1_2_Premium.RP_IF_DCDC_NV_Komponentenfehler_18_XIX_BMC_HV.DE_DCDC_NV_Komponentenfehler_18, ecu-extract-reference=COMPOSITIONTYPE.RP_IF_DCDC_NV_Komponentenfehler_18_XIX_BMC_HV.DE_DCDC_NV_Komponentenfehler_18
      RP_IF_DCDC_NV_Komponentenfehler_18_XIX_BMC_HV: upstream-reference=Geltungsbereich_E3_1_2_Premium.RP_IF_DCDC_NV_Komponentenfehler_18_XIX_BMC_HV, ecu-extract-reference=COMPOSITIONTYPE.RP_IF_DCDC_NV_Komponentenfehler_18_XIX_BMC_HV
      DCDC_NV_Komponentenfehler_19: upstream-reference=Geltungsbereich_E3_1_2_Premium.RP_IF_DCDC_NV_Komponentenfehler_19_XIX_BMC_HV.DE_DCDC_NV_Komponentenfehler_19, ecu-extract-reference=COMPOSITIONTYPE.RP_IF_DCDC_NV_Komponentenfehler_19_XIX_BMC_HV.DE_DCDC_NV_Komponentenfehler_19
      RP_IF_DCDC_NV_Komponentenfehler_19_XIX_BMC_HV: upstream-reference=Geltungsbereich_E3_1_2_Premium.RP_IF_DCDC_NV_Komponentenfehler_19_XIX_BMC_HV, ecu-extract-reference=COMPOSITIONTYPE.RP_IF_DCDC_NV_Komponentenfehler_19_XIX_BMC_HV
      DCDC_NV_Komponentenfehler_20: upstream-reference=Geltungsbereich_E3_1_2_Premium.RP_IF_DCDC_NV_Komponentenfehler_20_XIX_BMC_HV.DE_DCDC_NV_Komponentenfehler_20, ecu-extract-reference=COMPOSITIONTYPE.RP_IF_DCDC_NV_Komponentenfehler_20_XIX_BMC_HV.DE_DCDC_NV_Komponentenfehler_20
      RP_IF_DCDC_NV_Komponentenfehler_20_XIX_BMC_HV: upstream-reference=Geltungsbereich_E3_1_2_Premium.RP_IF_DCDC_NV_Komponentenfehler_20_XIX_BMC_HV, ecu-extract-reference=COMPOSITIONTYPE.RP_IF_DCDC_NV_Komponentenfehler_20_XIX_BMC_HV
      DCDC_NV_Komponentenfehler_21: upstream-reference=Geltungsbereich_E3_1_2_Premium.RP_IF_DCDC_NV_Komponentenfehler_21_XIX_BMC_HV.DE_DCDC_NV_Komponentenfehler_21, ecu-extract-reference=COMPOSITIONTYPE.RP_IF_DCDC_NV_Komponentenfehler_21_XIX_BMC_HV.DE_DCDC_NV_Komponentenfehler_21
      RP_IF_DCDC_NV_Komponentenfehler_21_XIX_BMC_HV: upstream-reference=Geltungsbereich_E3_1_2_Premium.RP_IF_DCDC_NV_Komponentenfehler_21_XIX_BMC_HV, ecu-extract-reference=COMPOSITIONTYPE.RP_IF_DCDC_NV_Komponentenfehler_21_XIX_BMC_HV
      DCDC_NV_Komponentenfehler_22: upstream-reference=Geltungsbereich_E3_1_2_Premium.RP_IF_DCDC_NV_Komponentenfehler_22_XIX_BMC_HV.DE_DCDC_NV_Komponentenfehler_22, ecu-extract-reference=COMPOSITIONTYPE.RP_IF_DCDC_NV_Komponentenfehler_22_XIX_BMC_HV.DE_DCDC_NV_Komponentenfehler_22
      RP_IF_DCDC_NV_Komponentenfehler_22_XIX_BMC_HV: upstream-reference=Geltungsbereich_E3_1_2_Premium.RP_IF_DCDC_NV_Komponentenfehler_22_XIX_BMC_HV, ecu-extract-reference=COMPOSITIONTYPE.RP_IF_DCDC_NV_Komponentenfehler_22_XIX_BMC_HV
      DCDC_NV_Komponentenfehler_23: upstream-reference=Geltungsbereich_E3_1_2_Premium.RP_IF_DCDC_NV_Komponentenfehler_23_XIX_BMC_HV.DE_DCDC_NV_Komponentenfehler_23, ecu-extract-reference=COMPOSITIONTYPE.RP_IF_DCDC_NV_Komponentenfehler_23_XIX_BMC_HV.DE_DCDC_NV_Komponentenfehler_23
      RP_IF_DCDC_NV_Komponentenfehler_23_XIX_BMC_HV: upstream-reference=Geltungsbereich_E3_1_2_Premium.RP_IF_DCDC_NV_Komponentenfehler_23_XIX_BMC_HV, ecu-extract-reference=COMPOSITIONTYPE.RP_IF_DCDC_NV_Komponentenfehler_23_XIX_BMC_HV
      DCDC_NV_Komponentenfehler_24: upstream-reference=Geltungsbereich_E3_1_2_Premium.RP_IF_DCDC_NV_Komponentenfehler_24_XIX_BMC_HV.DE_DCDC_NV_Komponentenfehler_24, ecu-extract-reference=COMPOSITIONTYPE.RP_IF_DCDC_NV_Komponentenfehler_24_XIX_BMC_HV.DE_DCDC_NV_Komponentenfehler_24
      RP_IF_DCDC_NV_Komponentenfehler_24_XIX_BMC_HV: upstream-reference=Geltungsbereich_E3_1_2_Premium.RP_IF_DCDC_NV_Komponentenfehler_24_XIX_BMC_HV, ecu-extract-reference=COMPOSITIONTYPE.RP_IF_DCDC_NV_Komponentenfehler_24_XIX_BMC_HV
      DCDC_NV_Komponentenfehler_25: upstream-reference=Geltungsbereich_E3_1_2_Premium.RP_IF_DCDC_NV_Komponentenfehler_25_XIX_BMC_HV.DE_DCDC_NV_Komponentenfehler_25, ecu-extract-reference=COMPOSITIONTYPE.RP_IF_DCDC_NV_Komponentenfehler_25_XIX_BMC_HV.DE_DCDC_NV_Komponentenfehler_25
      RP_IF_DCDC_NV_Komponentenfehler_25_XIX_BMC_HV: upstream-reference=Geltungsbereich_E3_1_2_Premium.RP_IF_DCDC_NV_Komponentenfehler_25_XIX_BMC_HV, ecu-extract-reference=COMPOSITIONTYPE.RP_IF_DCDC_NV_Komponentenfehler_25_XIX_BMC_HV
      DCDC_NV_Komponentenfehler_26: upstream-reference=Geltungsbereich_E3_1_2_Premium.RP_IF_DCDC_NV_Komponentenfehler_26_XIX_BMC_HV.DE_DCDC_NV_Komponentenfehler_26, ecu-extract-reference=COMPOSITIONTYPE.RP_IF_DCDC_NV_Komponentenfehler_26_XIX_BMC_HV.DE_DCDC_NV_Komponentenfehler_26
      RP_IF_DCDC_NV_Komponentenfehler_26_XIX_BMC_HV: upstream-reference=Geltungsbereich_E3_1_2_Premium.RP_IF_DCDC_NV_Komponentenfehler_26_XIX_BMC_HV, ecu-extract-reference=COMPOSITIONTYPE.RP_IF_DCDC_NV_Komponentenfehler_26_XIX_BMC_HV
      DCDC_NV_Komponentenfehler_27: upstream-reference=Geltungsbereich_E3_1_2_Premium.RP_IF_DCDC_NV_Komponentenfehler_27_XIX_BMC_HV.DE_DCDC_NV_Komponentenfehler_27, ecu-extract-reference=COMPOSITIONTYPE.RP_IF_DCDC_NV_Komponentenfehler_27_XIX_BMC_HV.DE_DCDC_NV_Komponentenfehler_27
      RP_IF_DCDC_NV_Komponentenfehler_27_XIX_BMC_HV: upstream-reference=Geltungsbereich_E3_1_2_Premium.RP_IF_DCDC_NV_Komponentenfehler_27_XIX_BMC_HV, ecu-extract-reference=COMPOSITIONTYPE.RP_IF_DCDC_NV_Komponentenfehler_27_XIX_BMC_HV
      DCDC_NV_Komponentenfehler_28: upstream-reference=Geltungsbereich_E3_1_2_Premium.RP_IF_DCDC_NV_Komponentenfehler_28_XIX_BMC_HV.DE_DCDC_NV_Komponentenfehler_28, ecu-extract-reference=COMPOSITIONTYPE.RP_IF_DCDC_NV_Komponentenfehler_28_XIX_BMC_HV.DE_DCDC_NV_Komponentenfehler_28
      RP_IF_DCDC_NV_Komponentenfehler_28_XIX_BMC_HV: upstream-reference=Geltungsbereich_E3_1_2_Premium.RP_IF_DCDC_NV_Komponentenfehler_28_XIX_BMC_HV, ecu-extract-reference=COMPOSITIONTYPE.RP_IF_DCDC_NV_Komponentenfehler_28_XIX_BMC_HV
      DCDC_NV_Komponentenfehler_29: upstream-reference=Geltungsbereich_E3_1_2_Premium.RP_IF_DCDC_NV_Komponentenfehler_29_XIX_BMC_HV.DE_DCDC_NV_Komponentenfehler_29, ecu-extract-reference=COMPOSITIONTYPE.RP_IF_DCDC_NV_Komponentenfehler_29_XIX_BMC_HV.DE_DCDC_NV_Komponentenfehler_29
      RP_IF_DCDC_NV_Komponentenfehler_29_XIX_BMC_HV: upstream-reference=Geltungsbereich_E3_1_2_Premium.RP_IF_DCDC_NV_Komponentenfehler_29_XIX_BMC_HV, ecu-extract-reference=COMPOSITIONTYPE.RP_IF_DCDC_NV_Komponentenfehler_29_XIX_BMC_HV
      DCDC_NV_Komponentenfehler_30: upstream-reference=Geltungsbereich_E3_1_2_Premium.RP_IF_DCDC_NV_Komponentenfehler_30_XIX_BMC_HV.DE_DCDC_NV_Komponentenfehler_30, ecu-extract-reference=COMPOSITIONTYPE.RP_IF_DCDC_NV_Komponentenfehler_30_XIX_BMC_HV.DE_DCDC_NV_Komponentenfehler_30
      RP_IF_DCDC_NV_Komponentenfehler_30_XIX_BMC_HV: upstream-reference=Geltungsbereich_E3_1_2_Premium.RP_IF_DCDC_NV_Komponentenfehler_30_XIX_BMC_HV, ecu-extract-reference=COMPOSITIONTYPE.RP_IF_DCDC_NV_Komponentenfehler_30_XIX_BMC_HV
      DCDC_NV_Komponentenfehler_31: upstream-reference=Geltungsbereich_E3_1_2_Premium.RP_IF_DCDC_NV_Komponentenfehler_31_XIX_BMC_HV.DE_DCDC_NV_Komponentenfehler_31, ecu-extract-reference=COMPOSITIONTYPE.RP_IF_DCDC_NV_Komponentenfehler_31_XIX_BMC_HV.DE_DCDC_NV_Komponentenfehler_31
      RP_IF_DCDC_NV_Komponentenfehler_31_XIX_BMC_HV: upstream-reference=Geltungsbereich_E3_1_2_Premium.RP_IF_DCDC_NV_Komponentenfehler_31_XIX_BMC_HV, ecu-extract-reference=COMPOSITIONTYPE.RP_IF_DCDC_NV_Komponentenfehler_31_XIX_BMC_HV
      DCDC_NV_Komponentenfehler_32: upstream-reference=Geltungsbereich_E3_1_2_Premium.RP_IF_DCDC_NV_Komponentenfehler_32_XIX_BMC_HV.DE_DCDC_NV_Komponentenfehler_32, ecu-extract-reference=COMPOSITIONTYPE.RP_IF_DCDC_NV_Komponentenfehler_32_XIX_BMC_HV.DE_DCDC_NV_Komponentenfehler_32
      RP_IF_DCDC_NV_Komponentenfehler_32_XIX_BMC_HV: upstream-reference=Geltungsbereich_E3_1_2_Premium.RP_IF_DCDC_NV_Komponentenfehler_32_XIX_BMC_HV, ecu-extract-reference=COMPOSITIONTYPE.RP_IF_DCDC_NV_Komponentenfehler_32_XIX_BMC_HV
      DCDC_NV_Komponentenfehler_33: upstream-reference=Geltungsbereich_E3_1_2_Premium.RP_IF_DCDC_NV_Komponentenfehler_33_XIX_BMC_HV.DE_DCDC_NV_Komponentenfehler_33, ecu-extract-reference=COMPOSITIONTYPE.RP_IF_DCDC_NV_Komponentenfehler_33_XIX_BMC_HV.DE_DCDC_NV_Komponentenfehler_33
      RP_IF_DCDC_NV_Komponentenfehler_33_XIX_BMC_HV: upstream-reference=Geltungsbereich_E3_1_2_Premium.RP_IF_DCDC_NV_Komponentenfehler_33_XIX_BMC_HV, ecu-extract-reference=COMPOSITIONTYPE.RP_IF_DCDC_NV_Komponentenfehler_33_XIX_BMC_HV
      DCDC_NV_Komponentenfehler_34: upstream-reference=Geltungsbereich_E3_1_2_Premium.RP_IF_DCDC_NV_Komponentenfehler_34_XIX_BMC_HV.DE_DCDC_NV_Komponentenfehler_34, ecu-extract-reference=COMPOSITIONTYPE.RP_IF_DCDC_NV_Komponentenfehler_34_XIX_BMC_HV.DE_DCDC_NV_Komponentenfehler_34
      RP_IF_DCDC_NV_Komponentenfehler_34_XIX_BMC_HV: upstream-reference=Geltungsbereich_E3_1_2_Premium.RP_IF_DCDC_NV_Komponentenfehler_34_XIX_BMC_HV, ecu-extract-reference=COMPOSITIONTYPE.RP_IF_DCDC_NV_Komponentenfehler_34_XIX_BMC_HV
      DCDC_NV_Komponentenfehler_35: upstream-reference=Geltungsbereich_E3_1_2_Premium.RP_IF_DCDC_NV_Komponentenfehler_35_XIX_BMC_HV.DE_DCDC_NV_Komponentenfehler_35, ecu-extract-reference=COMPOSITIONTYPE.RP_IF_DCDC_NV_Komponentenfehler_35_XIX_BMC_HV.DE_DCDC_NV_Komponentenfehler_35
      RP_IF_DCDC_NV_Komponentenfehler_35_XIX_BMC_HV: upstream-reference=Geltungsbereich_E3_1_2_Premium.RP_IF_DCDC_NV_Komponentenfehler_35_XIX_BMC_HV, ecu-extract-reference=COMPOSITIONTYPE.RP_IF_DCDC_NV_Komponentenfehler_35_XIX_BMC_HV
      DCDC_NV_Komponentenfehler_36: upstream-reference=Geltungsbereich_E3_1_2_Premium.RP_IF_DCDC_NV_Komponentenfehler_36_XIX_BMC_HV.DE_DCDC_NV_Komponentenfehler_36, ecu-extract-reference=COMPOSITIONTYPE.RP_IF_DCDC_NV_Komponentenfehler_36_XIX_BMC_HV.DE_DCDC_NV_Komponentenfehler_36
      RP_IF_DCDC_NV_Komponentenfehler_36_XIX_BMC_HV: upstream-reference=Geltungsbereich_E3_1_2_Premium.RP_IF_DCDC_NV_Komponentenfehler_36_XIX_BMC_HV, ecu-extract-reference=COMPOSITIONTYPE.RP_IF_DCDC_NV_Komponentenfehler_36_XIX_BMC_HV
      DCDC_NV_Komponentenfehler_37: upstream-reference=Geltungsbereich_E3_1_2_Premium.RP_IF_DCDC_NV_Komponentenfehler_37_XIX_BMC_HV.DE_DCDC_NV_Komponentenfehler_37, ecu-extract-reference=COMPOSITIONTYPE.RP_IF_DCDC_NV_Komponentenfehler_37_XIX_BMC_HV.DE_DCDC_NV_Komponentenfehler_37
      RP_IF_DCDC_NV_Komponentenfehler_37_XIX_BMC_HV: upstream-reference=Geltungsbereich_E3_1_2_Premium.RP_IF_DCDC_NV_Komponentenfehler_37_XIX_BMC_HV, ecu-extract-reference=COMPOSITIONTYPE.RP_IF_DCDC_NV_Komponentenfehler_37_XIX_BMC_HV
      DCDC_NV_Komponentenfehler_38: upstream-reference=Geltungsbereich_E3_1_2_Premium.RP_IF_DCDC_NV_Komponentenfehler_38_XIX_BMC_HV.DE_DCDC_NV_Komponentenfehler_38, ecu-extract-reference=COMPOSITIONTYPE.RP_IF_DCDC_NV_Komponentenfehler_38_XIX_BMC_HV.DE_DCDC_NV_Komponentenfehler_38
      RP_IF_DCDC_NV_Komponentenfehler_38_XIX_BMC_HV: upstream-reference=Geltungsbereich_E3_1_2_Premium.RP_IF_DCDC_NV_Komponentenfehler_38_XIX_BMC_HV, ecu-extract-reference=COMPOSITIONTYPE.RP_IF_DCDC_NV_Komponentenfehler_38_XIX_BMC_HV
      DCDC_NV_Komponentenfehler_39: upstream-reference=Geltungsbereich_E3_1_2_Premium.RP_IF_DCDC_NV_Komponentenfehler_39_XIX_BMC_HV.DE_DCDC_NV_Komponentenfehler_39, ecu-extract-reference=COMPOSITIONTYPE.RP_IF_DCDC_NV_Komponentenfehler_39_XIX_BMC_HV.DE_DCDC_NV_Komponentenfehler_39
      RP_IF_DCDC_NV_Komponentenfehler_39_XIX_BMC_HV: upstream-reference=Geltungsbereich_E3_1_2_Premium.RP_IF_DCDC_NV_Komponentenfehler_39_XIX_BMC_HV, ecu-extract-reference=COMPOSITIONTYPE.RP_IF_DCDC_NV_Komponentenfehler_39_XIX_BMC_HV
      DCDC_NV_Komponentenfehler_3_10: upstream-reference=Geltungsbereich_E3_1_2_Premium.RP_IF_DCDC_NV_Komponentenfehler_3_10_XIX_BMC_HV.DE_DCDC_NV_Komponentenfehler_3_10, ecu-extract-reference=COMPOSITIONTYPE.RP_IF_DCDC_NV_Komponentenfehler_3_10_XIX_BMC_HV.DE_DCDC_NV_Komponentenfehler_3_10
      RP_IF_DCDC_NV_Komponentenfehler_3_10_XIX_BMC_HV: upstream-reference=Geltungsbereich_E3_1_2_Premium.RP_IF_DCDC_NV_Komponentenfehler_3_10_XIX_BMC_HV, ecu-extract-reference=COMPOSITIONTYPE.RP_IF_DCDC_NV_Komponentenfehler_3_10_XIX_BMC_HV
      DCDC_NV_Komponentenfehler_3_11: upstream-reference=Geltungsbereich_E3_1_2_Premium.RP_IF_DCDC_NV_Komponentenfehler_3_11_XIX_BMC_HV.DE_DCDC_NV_Komponentenfehler_3_11, ecu-extract-reference=COMPOSITIONTYPE.RP_IF_DCDC_NV_Komponentenfehler_3_11_XIX_BMC_HV.DE_DCDC_NV_Komponentenfehler_3_11
      RP_IF_DCDC_NV_Komponentenfehler_3_11_XIX_BMC_HV: upstream-reference=Geltungsbereich_E3_1_2_Premium.RP_IF_DCDC_NV_Komponentenfehler_3_11_XIX_BMC_HV, ecu-extract-reference=COMPOSITIONTYPE.RP_IF_DCDC_NV_Komponentenfehler_3_11_XIX_BMC_HV
      DCDC_NV_Komponentenfehler_3_12: upstream-reference=Geltungsbereich_E3_1_2_Premium.RP_IF_DCDC_NV_Komponentenfehler_3_12_XIX_BMC_HV.DE_DCDC_NV_Komponentenfehler_3_12, ecu-extract-reference=COMPOSITIONTYPE.RP_IF_DCDC_NV_Komponentenfehler_3_12_XIX_BMC_HV.DE_DCDC_NV_Komponentenfehler_3_12
      RP_IF_DCDC_NV_Komponentenfehler_3_12_XIX_BMC_HV: upstream-reference=Geltungsbereich_E3_1_2_Premium.RP_IF_DCDC_NV_Komponentenfehler_3_12_XIX_BMC_HV, ecu-extract-reference=COMPOSITIONTYPE.RP_IF_DCDC_NV_Komponentenfehler_3_12_XIX_BMC_HV
      DCDC_NV_Komponentenfehler_3_13: upstream-reference=Geltungsbereich_E3_1_2_Premium.RP_IF_DCDC_NV_Komponentenfehler_3_13_XIX_BMC_HV.DE_DCDC_NV_Komponentenfehler_3_13, ecu-extract-reference=COMPOSITIONTYPE.RP_IF_DCDC_NV_Komponentenfehler_3_13_XIX_BMC_HV.DE_DCDC_NV_Komponentenfehler_3_13
      RP_IF_DCDC_NV_Komponentenfehler_3_13_XIX_BMC_HV: upstream-reference=Geltungsbereich_E3_1_2_Premium.RP_IF_DCDC_NV_Komponentenfehler_3_13_XIX_BMC_HV, ecu-extract-reference=COMPOSITIONTYPE.RP_IF_DCDC_NV_Komponentenfehler_3_13_XIX_BMC_HV
      DCDC_NV_Komponentenfehler_3_14: upstream-reference=Geltungsbereich_E3_1_2_Premium.RP_IF_DCDC_NV_Komponentenfehler_3_14_XIX_BMC_HV.DE_DCDC_NV_Komponentenfehler_3_14, ecu-extract-reference=COMPOSITIONTYPE.RP_IF_DCDC_NV_Komponentenfehler_3_14_XIX_BMC_HV.DE_DCDC_NV_Komponentenfehler_3_14
      RP_IF_DCDC_NV_Komponentenfehler_3_14_XIX_BMC_HV: upstream-reference=Geltungsbereich_E3_1_2_Premium.RP_IF_DCDC_NV_Komponentenfehler_3_14_XIX_BMC_HV, ecu-extract-reference=COMPOSITIONTYPE.RP_IF_DCDC_NV_Komponentenfehler_3_14_XIX_BMC_HV
      DCDC_NV_Komponentenfehler_3_15: upstream-reference=Geltungsbereich_E3_1_2_Premium.RP_IF_DCDC_NV_Komponentenfehler_3_15_XIX_BMC_HV.DE_DCDC_NV_Komponentenfehler_3_15, ecu-extract-reference=COMPOSITIONTYPE.RP_IF_DCDC_NV_Komponentenfehler_3_15_XIX_BMC_HV.DE_DCDC_NV_Komponentenfehler_3_15
      RP_IF_DCDC_NV_Komponentenfehler_3_15_XIX_BMC_HV: upstream-reference=Geltungsbereich_E3_1_2_Premium.RP_IF_DCDC_NV_Komponentenfehler_3_15_XIX_BMC_HV, ecu-extract-reference=COMPOSITIONTYPE.RP_IF_DCDC_NV_Komponentenfehler_3_15_XIX_BMC_HV
      DCDC_NV_Komponentenfehler_3_16: upstream-reference=Geltungsbereich_E3_1_2_Premium.RP_IF_DCDC_NV_Komponentenfehler_3_16_XIX_BMC_HV.DE_DCDC_NV_Komponentenfehler_3_16, ecu-extract-reference=COMPOSITIONTYPE.RP_IF_DCDC_NV_Komponentenfehler_3_16_XIX_BMC_HV.DE_DCDC_NV_Komponentenfehler_3_16
      RP_IF_DCDC_NV_Komponentenfehler_3_16_XIX_BMC_HV: upstream-reference=Geltungsbereich_E3_1_2_Premium.RP_IF_DCDC_NV_Komponentenfehler_3_16_XIX_BMC_HV, ecu-extract-reference=COMPOSITIONTYPE.RP_IF_DCDC_NV_Komponentenfehler_3_16_XIX_BMC_HV
      DCDC_NV_Komponentenfehler_3_1: upstream-reference=Geltungsbereich_E3_1_2_Premium.RP_IF_DCDC_NV_Komponentenfehler_3_1_XIX_BMC_HV.DE_DCDC_NV_Komponentenfehler_3_1, ecu-extract-reference=COMPOSITIONTYPE.RP_IF_DCDC_NV_Komponentenfehler_3_1_XIX_BMC_HV.DE_DCDC_NV_Komponentenfehler_3_1
      RP_IF_DCDC_NV_Komponentenfehler_3_1_XIX_BMC_HV: upstream-reference=Geltungsbereich_E3_1_2_Premium.RP_IF_DCDC_NV_Komponentenfehler_3_1_XIX_BMC_HV, ecu-extract-reference=COMPOSITIONTYPE.RP_IF_DCDC_NV_Komponentenfehler_3_1_XIX_BMC_HV
      DCDC_NV_Komponentenfehler_3_2: upstream-reference=Geltungsbereich_E3_1_2_Premium.RP_IF_DCDC_NV_Komponentenfehler_3_2_XIX_BMC_HV.DE_DCDC_NV_Komponentenfehler_3_2, ecu-extract-reference=COMPOSITIONTYPE.RP_IF_DCDC_NV_Komponentenfehler_3_2_XIX_BMC_HV.DE_DCDC_NV_Komponentenfehler_3_2
      RP_IF_DCDC_NV_Komponentenfehler_3_2_XIX_BMC_HV: upstream-reference=Geltungsbereich_E3_1_2_Premium.RP_IF_DCDC_NV_Komponentenfehler_3_2_XIX_BMC_HV, ecu-extract-reference=COMPOSITIONTYPE.RP_IF_DCDC_NV_Komponentenfehler_3_2_XIX_BMC_HV
      DCDC_NV_Komponentenfehler_3_3: upstream-reference=Geltungsbereich_E3_1_2_Premium.RP_IF_DCDC_NV_Komponentenfehler_3_3_XIX_BMC_HV.DE_DCDC_NV_Komponentenfehler_3_3, ecu-extract-reference=COMPOSITIONTYPE.RP_IF_DCDC_NV_Komponentenfehler_3_3_XIX_BMC_HV.DE_DCDC_NV_Komponentenfehler_3_3
      RP_IF_DCDC_NV_Komponentenfehler_3_3_XIX_BMC_HV: upstream-reference=Geltungsbereich_E3_1_2_Premium.RP_IF_DCDC_NV_Komponentenfehler_3_3_XIX_BMC_HV, ecu-extract-reference=COMPOSITIONTYPE.RP_IF_DCDC_NV_Komponentenfehler_3_3_XIX_BMC_HV
      DCDC_NV_Komponentenfehler_3_4: upstream-reference=Geltungsbereich_E3_1_2_Premium.RP_IF_DCDC_NV_Komponentenfehler_3_4_XIX_BMC_HV.DE_DCDC_NV_Komponentenfehler_3_4, ecu-extract-reference=COMPOSITIONTYPE.RP_IF_DCDC_NV_Komponentenfehler_3_4_XIX_BMC_HV.DE_DCDC_NV_Komponentenfehler_3_4
      RP_IF_DCDC_NV_Komponentenfehler_3_4_XIX_BMC_HV: upstream-reference=Geltungsbereich_E3_1_2_Premium.RP_IF_DCDC_NV_Komponentenfehler_3_4_XIX_BMC_HV, ecu-extract-reference=COMPOSITIONTYPE.RP_IF_DCDC_NV_Komponentenfehler_3_4_XIX_BMC_HV
      DCDC_NV_Komponentenfehler_3_5: upstream-reference=Geltungsbereich_E3_1_2_Premium.RP_IF_DCDC_NV_Komponentenfehler_3_5_XIX_BMC_HV.DE_DCDC_NV_Komponentenfehler_3_5, ecu-extract-reference=COMPOSITIONTYPE.RP_IF_DCDC_NV_Komponentenfehler_3_5_XIX_BMC_HV.DE_DCDC_NV_Komponentenfehler_3_5
      RP_IF_DCDC_NV_Komponentenfehler_3_5_XIX_BMC_HV: upstream-reference=Geltungsbereich_E3_1_2_Premium.RP_IF_DCDC_NV_Komponentenfehler_3_5_XIX_BMC_HV, ecu-extract-reference=COMPOSITIONTYPE.RP_IF_DCDC_NV_Komponentenfehler_3_5_XIX_BMC_HV
      DCDC_NV_Komponentenfehler_3_6: upstream-reference=Geltungsbereich_E3_1_2_Premium.RP_IF_DCDC_NV_Komponentenfehler_3_6_XIX_BMC_HV.DE_DCDC_NV_Komponentenfehler_3_6, ecu-extract-reference=COMPOSITIONTYPE.RP_IF_DCDC_NV_Komponentenfehler_3_6_XIX_BMC_HV.DE_DCDC_NV_Komponentenfehler_3_6
      RP_IF_DCDC_NV_Komponentenfehler_3_6_XIX_BMC_HV: upstream-reference=Geltungsbereich_E3_1_2_Premium.RP_IF_DCDC_NV_Komponentenfehler_3_6_XIX_BMC_HV, ecu-extract-reference=COMPOSITIONTYPE.RP_IF_DCDC_NV_Komponentenfehler_3_6_XIX_BMC_HV
      DCDC_NV_Komponentenfehler_3_7: upstream-reference=Geltungsbereich_E3_1_2_Premium.RP_IF_DCDC_NV_Komponentenfehler_3_7_XIX_BMC_HV.DE_DCDC_NV_Komponentenfehler_3_7, ecu-extract-reference=COMPOSITIONTYPE.RP_IF_DCDC_NV_Komponentenfehler_3_7_XIX_BMC_HV.DE_DCDC_NV_Komponentenfehler_3_7
      RP_IF_DCDC_NV_Komponentenfehler_3_7_XIX_BMC_HV: upstream-reference=Geltungsbereich_E3_1_2_Premium.RP_IF_DCDC_NV_Komponentenfehler_3_7_XIX_BMC_HV, ecu-extract-reference=COMPOSITIONTYPE.RP_IF_DCDC_NV_Komponentenfehler_3_7_XIX_BMC_HV
      DCDC_NV_Komponentenfehler_3_8: upstream-reference=Geltungsbereich_E3_1_2_Premium.RP_IF_DCDC_NV_Komponentenfehler_3_8_XIX_BMC_HV.DE_DCDC_NV_Komponentenfehler_3_8, ecu-extract-reference=COMPOSITIONTYPE.RP_IF_DCDC_NV_Komponentenfehler_3_8_XIX_BMC_HV.DE_DCDC_NV_Komponentenfehler_3_8
      RP_IF_DCDC_NV_Komponentenfehler_3_8_XIX_BMC_HV: upstream-reference=Geltungsbereich_E3_1_2_Premium.RP_IF_DCDC_NV_Komponentenfehler_3_8_XIX_BMC_HV, ecu-extract-reference=COMPOSITIONTYPE.RP_IF_DCDC_NV_Komponentenfehler_3_8_XIX_BMC_HV
      DCDC_NV_Komponentenfehler_3_9: upstream-reference=Geltungsbereich_E3_1_2_Premium.RP_IF_DCDC_NV_Komponentenfehler_3_9_XIX_BMC_HV.DE_DCDC_NV_Komponentenfehler_3_9, ecu-extract-reference=COMPOSITIONTYPE.RP_IF_DCDC_NV_Komponentenfehler_3_9_XIX_BMC_HV.DE_DCDC_NV_Komponentenfehler_3_9
      RP_IF_DCDC_NV_Komponentenfehler_3_9_XIX_BMC_HV: upstream-reference=Geltungsbereich_E3_1_2_Premium.RP_IF_DCDC_NV_Komponentenfehler_3_9_XIX_BMC_HV, ecu-extract-reference=COMPOSITIONTYPE.RP_IF_DCDC_NV_Komponentenfehler_3_9_XIX_BMC_HV
      DCDC_NV_Komponentenfehler_40: upstream-reference=Geltungsbereich_E3_1_2_Premium.RP_IF_DCDC_NV_Komponentenfehler_40_XIX_BMC_HV.DE_DCDC_NV_Komponentenfehler_40, ecu-extract-reference=COMPOSITIONTYPE.RP_IF_DCDC_NV_Komponentenfehler_40_XIX_BMC_HV.DE_DCDC_NV_Komponentenfehler_40
      RP_IF_DCDC_NV_Komponentenfehler_40_XIX_BMC_HV: upstream-reference=Geltungsbereich_E3_1_2_Premium.RP_IF_DCDC_NV_Komponentenfehler_40_XIX_BMC_HV, ecu-extract-reference=COMPOSITIONTYPE.RP_IF_DCDC_NV_Komponentenfehler_40_XIX_BMC_HV
      DCDC_NV_Komponentenfehler_41: upstream-reference=Geltungsbereich_E3_1_2_Premium.RP_IF_DCDC_NV_Komponentenfehler_41_XIX_BMC_HV.DE_DCDC_NV_Komponentenfehler_41, ecu-extract-reference=COMPOSITIONTYPE.RP_IF_DCDC_NV_Komponentenfehler_41_XIX_BMC_HV.DE_DCDC_NV_Komponentenfehler_41
      RP_IF_DCDC_NV_Komponentenfehler_41_XIX_BMC_HV: upstream-reference=Geltungsbereich_E3_1_2_Premium.RP_IF_DCDC_NV_Komponentenfehler_41_XIX_BMC_HV, ecu-extract-reference=COMPOSITIONTYPE.RP_IF_DCDC_NV_Komponentenfehler_41_XIX_BMC_HV
      DCDC_NV_Komponentenfehler_42: upstream-reference=Geltungsbereich_E3_1_2_Premium.RP_IF_DCDC_NV_Komponentenfehler_42_XIX_BMC_HV.DE_DCDC_NV_Komponentenfehler_42, ecu-extract-reference=COMPOSITIONTYPE.RP_IF_DCDC_NV_Komponentenfehler_42_XIX_BMC_HV.DE_DCDC_NV_Komponentenfehler_42
      RP_IF_DCDC_NV_Komponentenfehler_42_XIX_BMC_HV: upstream-reference=Geltungsbereich_E3_1_2_Premium.RP_IF_DCDC_NV_Komponentenfehler_42_XIX_BMC_HV, ecu-extract-reference=COMPOSITIONTYPE.RP_IF_DCDC_NV_Komponentenfehler_42_XIX_BMC_HV
      DCDC_NV_Komponentenfehler_43: upstream-reference=Geltungsbereich_E3_1_2_Premium.RP_IF_DCDC_NV_Komponentenfehler_43_XIX_BMC_HV.DE_DCDC_NV_Komponentenfehler_43, ecu-extract-reference=COMPOSITIONTYPE.RP_IF_DCDC_NV_Komponentenfehler_43_XIX_BMC_HV.DE_DCDC_NV_Komponentenfehler_43
      RP_IF_DCDC_NV_Komponentenfehler_43_XIX_BMC_HV: upstream-reference=Geltungsbereich_E3_1_2_Premium.RP_IF_DCDC_NV_Komponentenfehler_43_XIX_BMC_HV, ecu-extract-reference=COMPOSITIONTYPE.RP_IF_DCDC_NV_Komponentenfehler_43_XIX_BMC_HV
      DCDC_NV_Komponentenfehler_44: upstream-reference=Geltungsbereich_E3_1_2_Premium.RP_IF_DCDC_NV_Komponentenfehler_44_XIX_BMC_HV.DE_DCDC_NV_Komponentenfehler_44, ecu-extract-reference=COMPOSITIONTYPE.RP_IF_DCDC_NV_Komponentenfehler_44_XIX_BMC_HV.DE_DCDC_NV_Komponentenfehler_44
      RP_IF_DCDC_NV_Komponentenfehler_44_XIX_BMC_HV: upstream-reference=Geltungsbereich_E3_1_2_Premium.RP_IF_DCDC_NV_Komponentenfehler_44_XIX_BMC_HV, ecu-extract-reference=COMPOSITIONTYPE.RP_IF_DCDC_NV_Komponentenfehler_44_XIX_BMC_HV
      DCDC_NV_Komponentenfehler_45: upstream-reference=Geltungsbereich_E3_1_2_Premium.RP_IF_DCDC_NV_Komponentenfehler_45_XIX_BMC_HV.DE_DCDC_NV_Komponentenfehler_45, ecu-extract-reference=COMPOSITIONTYPE.RP_IF_DCDC_NV_Komponentenfehler_45_XIX_BMC_HV.DE_DCDC_NV_Komponentenfehler_45
      RP_IF_DCDC_NV_Komponentenfehler_45_XIX_BMC_HV: upstream-reference=Geltungsbereich_E3_1_2_Premium.RP_IF_DCDC_NV_Komponentenfehler_45_XIX_BMC_HV, ecu-extract-reference=COMPOSITIONTYPE.RP_IF_DCDC_NV_Komponentenfehler_45_XIX_BMC_HV
      DCDC_NV_Komponentenfehler_46: upstream-reference=Geltungsbereich_E3_1_2_Premium.RP_IF_DCDC_NV_Komponentenfehler_46_XIX_BMC_HV.DE_DCDC_NV_Komponentenfehler_46, ecu-extract-reference=COMPOSITIONTYPE.RP_IF_DCDC_NV_Komponentenfehler_46_XIX_BMC_HV.DE_DCDC_NV_Komponentenfehler_46
      RP_IF_DCDC_NV_Komponentenfehler_46_XIX_BMC_HV: upstream-reference=Geltungsbereich_E3_1_2_Premium.RP_IF_DCDC_NV_Komponentenfehler_46_XIX_BMC_HV, ecu-extract-reference=COMPOSITIONTYPE.RP_IF_DCDC_NV_Komponentenfehler_46_XIX_BMC_HV
      DCDC_NV_Komponentenfehler_47: upstream-reference=Geltungsbereich_E3_1_2_Premium.RP_IF_DCDC_NV_Komponentenfehler_47_XIX_BMC_HV.DE_DCDC_NV_Komponentenfehler_47, ecu-extract-reference=COMPOSITIONTYPE.RP_IF_DCDC_NV_Komponentenfehler_47_XIX_BMC_HV.DE_DCDC_NV_Komponentenfehler_47
      RP_IF_DCDC_NV_Komponentenfehler_47_XIX_BMC_HV: upstream-reference=Geltungsbereich_E3_1_2_Premium.RP_IF_DCDC_NV_Komponentenfehler_47_XIX_BMC_HV, ecu-extract-reference=COMPOSITIONTYPE.RP_IF_DCDC_NV_Komponentenfehler_47_XIX_BMC_HV
      DCDC_NV_Komponentenfehler_48: upstream-reference=Geltungsbereich_E3_1_2_Premium.RP_IF_DCDC_NV_Komponentenfehler_48_XIX_BMC_HV.DE_DCDC_NV_Komponentenfehler_48, ecu-extract-reference=COMPOSITIONTYPE.RP_IF_DCDC_NV_Komponentenfehler_48_XIX_BMC_HV.DE_DCDC_NV_Komponentenfehler_48
      RP_IF_DCDC_NV_Komponentenfehler_48_XIX_BMC_HV: upstream-reference=Geltungsbereich_E3_1_2_Premium.RP_IF_DCDC_NV_Komponentenfehler_48_XIX_BMC_HV, ecu-extract-reference=COMPOSITIONTYPE.RP_IF_DCDC_NV_Komponentenfehler_48_XIX_BMC_HV
      DCDC_NV_Komponentenfehler_49: upstream-reference=Geltungsbereich_E3_1_2_Premium.RP_IF_DCDC_NV_Komponentenfehler_49_XIX_BMC_HV.DE_DCDC_NV_Komponentenfehler_49, ecu-extract-reference=COMPOSITIONTYPE.RP_IF_DCDC_NV_Komponentenfehler_49_XIX_BMC_HV.DE_DCDC_NV_Komponentenfehler_49
      RP_IF_DCDC_NV_Komponentenfehler_49_XIX_BMC_HV: upstream-reference=Geltungsbereich_E3_1_2_Premium.RP_IF_DCDC_NV_Komponentenfehler_49_XIX_BMC_HV, ecu-extract-reference=COMPOSITIONTYPE.RP_IF_DCDC_NV_Komponentenfehler_49_XIX_BMC_HV
      DCDC_NV_Komponentenfehler_50: upstream-reference=Geltungsbereich_E3_1_2_Premium.RP_IF_DCDC_NV_Komponentenfehler_50_XIX_BMC_HV.DE_DCDC_NV_Komponentenfehler_50, ecu-extract-reference=COMPOSITIONTYPE.RP_IF_DCDC_NV_Komponentenfehler_50_XIX_BMC_HV.DE_DCDC_NV_Komponentenfehler_50
      RP_IF_DCDC_NV_Komponentenfehler_50_XIX_BMC_HV: upstream-reference=Geltungsbereich_E3_1_2_Premium.RP_IF_DCDC_NV_Komponentenfehler_50_XIX_BMC_HV, ecu-extract-reference=COMPOSITIONTYPE.RP_IF_DCDC_NV_Komponentenfehler_50_XIX_BMC_HV
      DCDC_NV_Komponentenfehler_51: upstream-reference=Geltungsbereich_E3_1_2_Premium.RP_IF_DCDC_NV_Komponentenfehler_51_XIX_BMC_HV.DE_DCDC_NV_Komponentenfehler_51, ecu-extract-reference=COMPOSITIONTYPE.RP_IF_DCDC_NV_Komponentenfehler_51_XIX_BMC_HV.DE_DCDC_NV_Komponentenfehler_51
      RP_IF_DCDC_NV_Komponentenfehler_51_XIX_BMC_HV: upstream-reference=Geltungsbereich_E3_1_2_Premium.RP_IF_DCDC_NV_Komponentenfehler_51_XIX_BMC_HV, ecu-extract-reference=COMPOSITIONTYPE.RP_IF_DCDC_NV_Komponentenfehler_51_XIX_BMC_HV
      DCDC_NV_Komponentenfehler_52: upstream-reference=Geltungsbereich_E3_1_2_Premium.RP_IF_DCDC_NV_Komponentenfehler_52_XIX_BMC_HV.DE_DCDC_NV_Komponentenfehler_52, ecu-extract-reference=COMPOSITIONTYPE.RP_IF_DCDC_NV_Komponentenfehler_52_XIX_BMC_HV.DE_DCDC_NV_Komponentenfehler_52
      RP_IF_DCDC_NV_Komponentenfehler_52_XIX_BMC_HV: upstream-reference=Geltungsbereich_E3_1_2_Premium.RP_IF_DCDC_NV_Komponentenfehler_52_XIX_BMC_HV, ecu-extract-reference=COMPOSITIONTYPE.RP_IF_DCDC_NV_Komponentenfehler_52_XIX_BMC_HV
      DCDC_NV_Komponentenfehler_53: upstream-reference=Geltungsbereich_E3_1_2_Premium.RP_IF_DCDC_NV_Komponentenfehler_53_XIX_BMC_HV.DE_DCDC_NV_Komponentenfehler_53, ecu-extract-reference=COMPOSITIONTYPE.RP_IF_DCDC_NV_Komponentenfehler_53_XIX_BMC_HV.DE_DCDC_NV_Komponentenfehler_53
      RP_IF_DCDC_NV_Komponentenfehler_53_XIX_BMC_HV: upstream-reference=Geltungsbereich_E3_1_2_Premium.RP_IF_DCDC_NV_Komponentenfehler_53_XIX_BMC_HV, ecu-extract-reference=COMPOSITIONTYPE.RP_IF_DCDC_NV_Komponentenfehler_53_XIX_BMC_HV
      DCDC_NV_Komponentenfehler_54: upstream-reference=Geltungsbereich_E3_1_2_Premium.RP_IF_DCDC_NV_Komponentenfehler_54_XIX_BMC_HV.DE_DCDC_NV_Komponentenfehler_54, ecu-extract-reference=COMPOSITIONTYPE.RP_IF_DCDC_NV_Komponentenfehler_54_XIX_BMC_HV.DE_DCDC_NV_Komponentenfehler_54
      RP_IF_DCDC_NV_Komponentenfehler_54_XIX_BMC_HV: upstream-reference=Geltungsbereich_E3_1_2_Premium.RP_IF_DCDC_NV_Komponentenfehler_54_XIX_BMC_HV, ecu-extract-reference=COMPOSITIONTYPE.RP_IF_DCDC_NV_Komponentenfehler_54_XIX_BMC_HV
      DCDC_NV_Komponentenfehler_55: upstream-reference=Geltungsbereich_E3_1_2_Premium.RP_IF_DCDC_NV_Komponentenfehler_55_XIX_BMC_HV.DE_DCDC_NV_Komponentenfehler_55, ecu-extract-reference=COMPOSITIONTYPE.RP_IF_DCDC_NV_Komponentenfehler_55_XIX_BMC_HV.DE_DCDC_NV_Komponentenfehler_55
      RP_IF_DCDC_NV_Komponentenfehler_55_XIX_BMC_HV: upstream-reference=Geltungsbereich_E3_1_2_Premium.RP_IF_DCDC_NV_Komponentenfehler_55_XIX_BMC_HV, ecu-extract-reference=COMPOSITIONTYPE.RP_IF_DCDC_NV_Komponentenfehler_55_XIX_BMC_HV
      DCDC_NV_Komponentenfehler_56: upstream-reference=Geltungsbereich_E3_1_2_Premium.RP_IF_DCDC_NV_Komponentenfehler_56_XIX_BMC_HV.DE_DCDC_NV_Komponentenfehler_56, ecu-extract-reference=COMPOSITIONTYPE.RP_IF_DCDC_NV_Komponentenfehler_56_XIX_BMC_HV.DE_DCDC_NV_Komponentenfehler_56
      RP_IF_DCDC_NV_Komponentenfehler_56_XIX_BMC_HV: upstream-reference=Geltungsbereich_E3_1_2_Premium.RP_IF_DCDC_NV_Komponentenfehler_56_XIX_BMC_HV, ecu-extract-reference=COMPOSITIONTYPE.RP_IF_DCDC_NV_Komponentenfehler_56_XIX_BMC_HV
      DCDC_NV_Komponentenfehler_57: upstream-reference=Geltungsbereich_E3_1_2_Premium.RP_IF_DCDC_NV_Komponentenfehler_57_XIX_BMC_HV.DE_DCDC_NV_Komponentenfehler_57, ecu-extract-reference=COMPOSITIONTYPE.RP_IF_DCDC_NV_Komponentenfehler_57_XIX_BMC_HV.DE_DCDC_NV_Komponentenfehler_57
      RP_IF_DCDC_NV_Komponentenfehler_57_XIX_BMC_HV: upstream-reference=Geltungsbereich_E3_1_2_Premium.RP_IF_DCDC_NV_Komponentenfehler_57_XIX_BMC_HV, ecu-extract-reference=COMPOSITIONTYPE.RP_IF_DCDC_NV_Komponentenfehler_57_XIX_BMC_HV
      DCDC_NV_Komponentenfehler_58: upstream-reference=Geltungsbereich_E3_1_2_Premium.RP_IF_DCDC_NV_Komponentenfehler_58_XIX_BMC_HV.DE_DCDC_NV_Komponentenfehler_58, ecu-extract-reference=COMPOSITIONTYPE.RP_IF_DCDC_NV_Komponentenfehler_58_XIX_BMC_HV.DE_DCDC_NV_Komponentenfehler_58
      RP_IF_DCDC_NV_Komponentenfehler_58_XIX_BMC_HV: upstream-reference=Geltungsbereich_E3_1_2_Premium.RP_IF_DCDC_NV_Komponentenfehler_58_XIX_BMC_HV, ecu-extract-reference=COMPOSITIONTYPE.RP_IF_DCDC_NV_Komponentenfehler_58_XIX_BMC_HV
      DCDC_NV_Komponentenfehler_59: upstream-reference=Geltungsbereich_E3_1_2_Premium.RP_IF_DCDC_NV_Komponentenfehler_59_XIX_BMC_HV.DE_DCDC_NV_Komponentenfehler_59, ecu-extract-reference=COMPOSITIONTYPE.RP_IF_DCDC_NV_Komponentenfehler_59_XIX_BMC_HV.DE_DCDC_NV_Komponentenfehler_59
      RP_IF_DCDC_NV_Komponentenfehler_59_XIX_BMC_HV: upstream-reference=Geltungsbereich_E3_1_2_Premium.RP_IF_DCDC_NV_Komponentenfehler_59_XIX_BMC_HV, ecu-extract-reference=COMPOSITIONTYPE.RP_IF_DCDC_NV_Komponentenfehler_59_XIX_BMC_HV
      DCDC_NV_Komponentenfehler_60: upstream-reference=Geltungsbereich_E3_1_2_Premium.RP_IF_DCDC_NV_Komponentenfehler_60_XIX_BMC_HV.DE_DCDC_NV_Komponentenfehler_60, ecu-extract-reference=COMPOSITIONTYPE.RP_IF_DCDC_NV_Komponentenfehler_60_XIX_BMC_HV.DE_DCDC_NV_Komponentenfehler_60
      RP_IF_DCDC_NV_Komponentenfehler_60_XIX_BMC_HV: upstream-reference=Geltungsbereich_E3_1_2_Premium.RP_IF_DCDC_NV_Komponentenfehler_60_XIX_BMC_HV, ecu-extract-reference=COMPOSITIONTYPE.RP_IF_DCDC_NV_Komponentenfehler_60_XIX_BMC_HV
      DCDC_NV_Komponentenfehler_61: upstream-reference=Geltungsbereich_E3_1_2_Premium.RP_IF_DCDC_NV_Komponentenfehler_61_XIX_BMC_HV.DE_DCDC_NV_Komponentenfehler_61, ecu-extract-reference=COMPOSITIONTYPE.RP_IF_DCDC_NV_Komponentenfehler_61_XIX_BMC_HV.DE_DCDC_NV_Komponentenfehler_61
      RP_IF_DCDC_NV_Komponentenfehler_61_XIX_BMC_HV: upstream-reference=Geltungsbereich_E3_1_2_Premium.RP_IF_DCDC_NV_Komponentenfehler_61_XIX_BMC_HV, ecu-extract-reference=COMPOSITIONTYPE.RP_IF_DCDC_NV_Komponentenfehler_61_XIX_BMC_HV
      DCDC_NV_Komponentenfehler_62: upstream-reference=Geltungsbereich_E3_1_2_Premium.RP_IF_DCDC_NV_Komponentenfehler_62_XIX_BMC_HV.DE_DCDC_NV_Komponentenfehler_62, ecu-extract-reference=COMPOSITIONTYPE.RP_IF_DCDC_NV_Komponentenfehler_62_XIX_BMC_HV.DE_DCDC_NV_Komponentenfehler_62
      RP_IF_DCDC_NV_Komponentenfehler_62_XIX_BMC_HV: upstream-reference=Geltungsbereich_E3_1_2_Premium.RP_IF_DCDC_NV_Komponentenfehler_62_XIX_BMC_HV, ecu-extract-reference=COMPOSITIONTYPE.RP_IF_DCDC_NV_Komponentenfehler_62_XIX_BMC_HV
      DCDC_NV_Komponentenfehler_63: upstream-reference=Geltungsbereich_E3_1_2_Premium.RP_IF_DCDC_NV_Komponentenfehler_63_XIX_BMC_HV.DE_DCDC_NV_Komponentenfehler_63, ecu-extract-reference=COMPOSITIONTYPE.RP_IF_DCDC_NV_Komponentenfehler_63_XIX_BMC_HV.DE_DCDC_NV_Komponentenfehler_63
      RP_IF_DCDC_NV_Komponentenfehler_63_XIX_BMC_HV: upstream-reference=Geltungsbereich_E3_1_2_Premium.RP_IF_DCDC_NV_Komponentenfehler_63_XIX_BMC_HV, ecu-extract-reference=COMPOSITIONTYPE.RP_IF_DCDC_NV_Komponentenfehler_63_XIX_BMC_HV
      DCDC_NV_Komponentenfehler_64: upstream-reference=Geltungsbereich_E3_1_2_Premium.RP_IF_DCDC_NV_Komponentenfehler_64_XIX_BMC_HV.DE_DCDC_NV_Komponentenfehler_64, ecu-extract-reference=COMPOSITIONTYPE.RP_IF_DCDC_NV_Komponentenfehler_64_XIX_BMC_HV.DE_DCDC_NV_Komponentenfehler_64
      RP_IF_DCDC_NV_Komponentenfehler_64_XIX_BMC_HV: upstream-reference=Geltungsbereich_E3_1_2_Premium.RP_IF_DCDC_NV_Komponentenfehler_64_XIX_BMC_HV, ecu-extract-reference=COMPOSITIONTYPE.RP_IF_DCDC_NV_Komponentenfehler_64_XIX_BMC_HV
      DCDC_NV_Komponentenfehler_65: upstream-reference=Geltungsbereich_E3_1_2_Premium.RP_IF_DCDC_NV_Komponentenfehler_65_XIX_BMC_HV.DE_DCDC_NV_Komponentenfehler_65, ecu-extract-reference=COMPOSITIONTYPE.RP_IF_DCDC_NV_Komponentenfehler_65_XIX_BMC_HV.DE_DCDC_NV_Komponentenfehler_65
      RP_IF_DCDC_NV_Komponentenfehler_65_XIX_BMC_HV: upstream-reference=Geltungsbereich_E3_1_2_Premium.RP_IF_DCDC_NV_Komponentenfehler_65_XIX_BMC_HV, ecu-extract-reference=COMPOSITIONTYPE.RP_IF_DCDC_NV_Komponentenfehler_65_XIX_BMC_HV
      DCDC_NV_Komponentenfehler_66: upstream-reference=Geltungsbereich_E3_1_2_Premium.RP_IF_DCDC_NV_Komponentenfehler_66_XIX_BMC_HV.DE_DCDC_NV_Komponentenfehler_66, ecu-extract-reference=COMPOSITIONTYPE.RP_IF_DCDC_NV_Komponentenfehler_66_XIX_BMC_HV.DE_DCDC_NV_Komponentenfehler_66
      RP_IF_DCDC_NV_Komponentenfehler_66_XIX_BMC_HV: upstream-reference=Geltungsbereich_E3_1_2_Premium.RP_IF_DCDC_NV_Komponentenfehler_66_XIX_BMC_HV, ecu-extract-reference=COMPOSITIONTYPE.RP_IF_DCDC_NV_Komponentenfehler_66_XIX_BMC_HV
      DCDC_NV_Komponentenfehler_67: upstream-reference=Geltungsbereich_E3_1_2_Premium.RP_IF_DCDC_NV_Komponentenfehler_67_XIX_BMC_HV.DE_DCDC_NV_Komponentenfehler_67, ecu-extract-reference=COMPOSITIONTYPE.RP_IF_DCDC_NV_Komponentenfehler_67_XIX_BMC_HV.DE_DCDC_NV_Komponentenfehler_67
      RP_IF_DCDC_NV_Komponentenfehler_67_XIX_BMC_HV: upstream-reference=Geltungsbereich_E3_1_2_Premium.RP_IF_DCDC_NV_Komponentenfehler_67_XIX_BMC_HV, ecu-extract-reference=COMPOSITIONTYPE.RP_IF_DCDC_NV_Komponentenfehler_67_XIX_BMC_HV
      DCDC_NV_Komponentenfehler_68: upstream-reference=Geltungsbereich_E3_1_2_Premium.RP_IF_DCDC_NV_Komponentenfehler_68_XIX_BMC_HV.DE_DCDC_NV_Komponentenfehler_68, ecu-extract-reference=COMPOSITIONTYPE.RP_IF_DCDC_NV_Komponentenfehler_68_XIX_BMC_HV.DE_DCDC_NV_Komponentenfehler_68
      RP_IF_DCDC_NV_Komponentenfehler_68_XIX_BMC_HV: upstream-reference=Geltungsbereich_E3_1_2_Premium.RP_IF_DCDC_NV_Komponentenfehler_68_XIX_BMC_HV, ecu-extract-reference=COMPOSITIONTYPE.RP_IF_DCDC_NV_Komponentenfehler_68_XIX_BMC_HV
      DCDC_NV_Komponentenfehler_69: upstream-reference=Geltungsbereich_E3_1_2_Premium.RP_IF_DCDC_NV_Komponentenfehler_69_XIX_BMC_HV.DE_DCDC_NV_Komponentenfehler_69, ecu-extract-reference=COMPOSITIONTYPE.RP_IF_DCDC_NV_Komponentenfehler_69_XIX_BMC_HV.DE_DCDC_NV_Komponentenfehler_69
      RP_IF_DCDC_NV_Komponentenfehler_69_XIX_BMC_HV: upstream-reference=Geltungsbereich_E3_1_2_Premium.RP_IF_DCDC_NV_Komponentenfehler_69_XIX_BMC_HV, ecu-extract-reference=COMPOSITIONTYPE.RP_IF_DCDC_NV_Komponentenfehler_69_XIX_BMC_HV
      DCDC_NV_Komponentenfehler_70: upstream-reference=Geltungsbereich_E3_1_2_Premium.RP_IF_DCDC_NV_Komponentenfehler_70_XIX_BMC_HV.DE_DCDC_NV_Komponentenfehler_70, ecu-extract-reference=COMPOSITIONTYPE.RP_IF_DCDC_NV_Komponentenfehler_70_XIX_BMC_HV.DE_DCDC_NV_Komponentenfehler_70
      RP_IF_DCDC_NV_Komponentenfehler_70_XIX_BMC_HV: upstream-reference=Geltungsbereich_E3_1_2_Premium.RP_IF_DCDC_NV_Komponentenfehler_70_XIX_BMC_HV, ecu-extract-reference=COMPOSITIONTYPE.RP_IF_DCDC_NV_Komponentenfehler_70_XIX_BMC_HV
      DCDC_NV_Komponentenfehler_71: upstream-reference=Geltungsbereich_E3_1_2_Premium.RP_IF_DCDC_NV_Komponentenfehler_71_XIX_BMC_HV.DE_DCDC_NV_Komponentenfehler_71, ecu-extract-reference=COMPOSITIONTYPE.RP_IF_DCDC_NV_Komponentenfehler_71_XIX_BMC_HV.DE_DCDC_NV_Komponentenfehler_71
      RP_IF_DCDC_NV_Komponentenfehler_71_XIX_BMC_HV: upstream-reference=Geltungsbereich_E3_1_2_Premium.RP_IF_DCDC_NV_Komponentenfehler_71_XIX_BMC_HV, ecu-extract-reference=COMPOSITIONTYPE.RP_IF_DCDC_NV_Komponentenfehler_71_XIX_BMC_HV
      DCDC_NV_Komponentenfehler_72: upstream-reference=Geltungsbereich_E3_1_2_Premium.RP_IF_DCDC_NV_Komponentenfehler_72_XIX_BMC_HV.DE_DCDC_NV_Komponentenfehler_72, ecu-extract-reference=COMPOSITIONTYPE.RP_IF_DCDC_NV_Komponentenfehler_72_XIX_BMC_HV.DE_DCDC_NV_Komponentenfehler_72
      RP_IF_DCDC_NV_Komponentenfehler_72_XIX_BMC_HV: upstream-reference=Geltungsbereich_E3_1_2_Premium.RP_IF_DCDC_NV_Komponentenfehler_72_XIX_BMC_HV, ecu-extract-reference=COMPOSITIONTYPE.RP_IF_DCDC_NV_Komponentenfehler_72_XIX_BMC_HV
      DCDC_NV_Komponentenfehler_73: upstream-reference=Geltungsbereich_E3_1_2_Premium.RP_IF_DCDC_NV_Komponentenfehler_73_XIX_BMC_HV.DE_DCDC_NV_Komponentenfehler_73, ecu-extract-reference=COMPOSITIONTYPE.RP_IF_DCDC_NV_Komponentenfehler_73_XIX_BMC_HV.DE_DCDC_NV_Komponentenfehler_73
      RP_IF_DCDC_NV_Komponentenfehler_73_XIX_BMC_HV: upstream-reference=Geltungsbereich_E3_1_2_Premium.RP_IF_DCDC_NV_Komponentenfehler_73_XIX_BMC_HV, ecu-extract-reference=COMPOSITIONTYPE.RP_IF_DCDC_NV_Komponentenfehler_73_XIX_BMC_HV
      DCDC_NV_Komponentenfehler_74: upstream-reference=Geltungsbereich_E3_1_2_Premium.RP_IF_DCDC_NV_Komponentenfehler_74_XIX_BMC_HV.DE_DCDC_NV_Komponentenfehler_74, ecu-extract-reference=COMPOSITIONTYPE.RP_IF_DCDC_NV_Komponentenfehler_74_XIX_BMC_HV.DE_DCDC_NV_Komponentenfehler_74
      RP_IF_DCDC_NV_Komponentenfehler_74_XIX_BMC_HV: upstream-reference=Geltungsbereich_E3_1_2_Premium.RP_IF_DCDC_NV_Komponentenfehler_74_XIX_BMC_HV, ecu-extract-reference=COMPOSITIONTYPE.RP_IF_DCDC_NV_Komponentenfehler_74_XIX_BMC_HV
      DCDC_NV_Komponentenfehler_75: upstream-reference=Geltungsbereich_E3_1_2_Premium.RP_IF_DCDC_NV_Komponentenfehler_75_XIX_BMC_HV.DE_DCDC_NV_Komponentenfehler_75, ecu-extract-reference=COMPOSITIONTYPE.RP_IF_DCDC_NV_Komponentenfehler_75_XIX_BMC_HV.DE_DCDC_NV_Komponentenfehler_75
      RP_IF_DCDC_NV_Komponentenfehler_75_XIX_BMC_HV: upstream-reference=Geltungsbereich_E3_1_2_Premium.RP_IF_DCDC_NV_Komponentenfehler_75_XIX_BMC_HV, ecu-extract-reference=COMPOSITIONTYPE.RP_IF_DCDC_NV_Komponentenfehler_75_XIX_BMC_HV
      DCDC_NV_Komponentenfehler_76: upstream-reference=Geltungsbereich_E3_1_2_Premium.RP_IF_DCDC_NV_Komponentenfehler_76_XIX_BMC_HV.DE_DCDC_NV_Komponentenfehler_76, ecu-extract-reference=COMPOSITIONTYPE.RP_IF_DCDC_NV_Komponentenfehler_76_XIX_BMC_HV.DE_DCDC_NV_Komponentenfehler_76
      RP_IF_DCDC_NV_Komponentenfehler_76_XIX_BMC_HV: upstream-reference=Geltungsbereich_E3_1_2_Premium.RP_IF_DCDC_NV_Komponentenfehler_76_XIX_BMC_HV, ecu-extract-reference=COMPOSITIONTYPE.RP_IF_DCDC_NV_Komponentenfehler_76_XIX_BMC_HV
      DCDC_NV_Komponentenfehler_77: upstream-reference=Geltungsbereich_E3_1_2_Premium.RP_IF_DCDC_NV_Komponentenfehler_77_XIX_BMC_HV.DE_DCDC_NV_Komponentenfehler_77, ecu-extract-reference=COMPOSITIONTYPE.RP_IF_DCDC_NV_Komponentenfehler_77_XIX_BMC_HV.DE_DCDC_NV_Komponentenfehler_77
      RP_IF_DCDC_NV_Komponentenfehler_77_XIX_BMC_HV: upstream-reference=Geltungsbereich_E3_1_2_Premium.RP_IF_DCDC_NV_Komponentenfehler_77_XIX_BMC_HV, ecu-extract-reference=COMPOSITIONTYPE.RP_IF_DCDC_NV_Komponentenfehler_77_XIX_BMC_HV
      DCDC_NV_Komponentenfehler_78: upstream-reference=Geltungsbereich_E3_1_2_Premium.RP_IF_DCDC_NV_Komponentenfehler_78_XIX_BMC_HV.DE_DCDC_NV_Komponentenfehler_78, ecu-extract-reference=COMPOSITIONTYPE.RP_IF_DCDC_NV_Komponentenfehler_78_XIX_BMC_HV.DE_DCDC_NV_Komponentenfehler_78
      RP_IF_DCDC_NV_Komponentenfehler_78_XIX_BMC_HV: upstream-reference=Geltungsbereich_E3_1_2_Premium.RP_IF_DCDC_NV_Komponentenfehler_78_XIX_BMC_HV, ecu-extract-reference=COMPOSITIONTYPE.RP_IF_DCDC_NV_Komponentenfehler_78_XIX_BMC_HV
      DCDC_NV_Komponentenfehler_79: upstream-reference=Geltungsbereich_E3_1_2_Premium.RP_IF_DCDC_NV_Komponentenfehler_79_XIX_BMC_HV.DE_DCDC_NV_Komponentenfehler_79, ecu-extract-reference=COMPOSITIONTYPE.RP_IF_DCDC_NV_Komponentenfehler_79_XIX_BMC_HV.DE_DCDC_NV_Komponentenfehler_79
      RP_IF_DCDC_NV_Komponentenfehler_79_XIX_BMC_HV: upstream-reference=Geltungsbereich_E3_1_2_Premium.RP_IF_DCDC_NV_Komponentenfehler_79_XIX_BMC_HV, ecu-extract-reference=COMPOSITIONTYPE.RP_IF_DCDC_NV_Komponentenfehler_79_XIX_BMC_HV
      DCDC_NV_Komponentenfehler_80: upstream-reference=Geltungsbereich_E3_1_2_Premium.RP_IF_DCDC_NV_Komponentenfehler_80_XIX_BMC_HV.DE_DCDC_NV_Komponentenfehler_80, ecu-extract-reference=COMPOSITIONTYPE.RP_IF_DCDC_NV_Komponentenfehler_80_XIX_BMC_HV.DE_DCDC_NV_Komponentenfehler_80
      RP_IF_DCDC_NV_Komponentenfehler_80_XIX_BMC_HV: upstream-reference=Geltungsbereich_E3_1_2_Premium.RP_IF_DCDC_NV_Komponentenfehler_80_XIX_BMC_HV, ecu-extract-reference=COMPOSITIONTYPE.RP_IF_DCDC_NV_Komponentenfehler_80_XIX_BMC_HV
      DCDC_NV_Komponentenfehler_VLD: upstream-reference=Geltungsbereich_E3_1_2_Premium.RP_IF_DCDC_NV_Komponentenfehler_VLD_XIX_BMC_HV.DE_DCDC_NV_Komponentenfehler_VLD, ecu-extract-reference=COMPOSITIONTYPE.RP_IF_DCDC_NV_Komponentenfehler_VLD_XIX_BMC_HV.DE_DCDC_NV_Komponentenfehler_VLD
      RP_IF_DCDC_NV_Komponentenfehler_VLD_XIX_BMC_HV: upstream-reference=Geltungsbereich_E3_1_2_Premium.RP_IF_DCDC_NV_Komponentenfehler_VLD_XIX_BMC_HV, ecu-extract-reference=COMPOSITIONTYPE.RP_IF_DCDC_NV_Komponentenfehler_VLD_XIX_BMC_HV
      DW_Kilometerstand: upstream-reference=Geltungsbereich_E3_1_2_Premium.RP_IF_DW_Kilometerstand_XIX_BMC_HV.DE_DW_Kilometerstand, ecu-extract-reference=COMPOSITIONTYPE.RP_IF_DW_Kilometerstand_XIX_BMC_HV.DE_DW_Kilometerstand
      RP_IF_DW_Kilometerstand_XIX_BMC_HV: upstream-reference=Geltungsbereich_E3_1_2_Premium.RP_IF_DW_Kilometerstand_XIX_BMC_HV, ecu-extract-reference=COMPOSITIONTYPE.RP_IF_DW_Kilometerstand_XIX_BMC_HV
      EKK_HVK_EoHVL_Status: upstream-reference=Geltungsbereich_E3_1_2_Premium.RP_IF_EKK_HVK_EoHVL_Status_XIX_BMC_HV.DE_EKK_HVK_EoHVL_Status, ecu-extract-reference=COMPOSITIONTYPE.RP_IF_EKK_HVK_EoHVL_Status_XIX_BMC_HV.DE_EKK_HVK_EoHVL_Status
      RP_IF_EKK_HVK_EoHVL_Status_XIX_BMC_HV: upstream-reference=Geltungsbereich_E3_1_2_Premium.RP_IF_EKK_HVK_EoHVL_Status_XIX_BMC_HV, ecu-extract-reference=COMPOSITIONTYPE.RP_IF_EKK_HVK_EoHVL_Status_XIX_BMC_HV
      HVEM_BMC_CHA_Wunschleistung_02: upstream-reference=Geltungsbereich_E3_1_2_Premium.RP_IF_HVEM_BMC_CHA_Wunschleistung_02_XIX_BMC_HV.DE_HVEM_BMC_CHA_Wunschleistung_02, ecu-extract-reference=COMPOSITIONTYPE.RP_IF_HVEM_BMC_CHA_Wunschleistung_02_XIX_BMC_HV.DE_HVEM_BMC_CHA_Wunschleistung_02
      RP_IF_HVEM_BMC_CHA_Wunschleistung_02_XIX_BMC_HV: upstream-reference=Geltungsbereich_E3_1_2_Premium.RP_IF_HVEM_BMC_CHA_Wunschleistung_02_XIX_BMC_HV, ecu-extract-reference=COMPOSITIONTYPE.RP_IF_HVEM_BMC_CHA_Wunschleistung_02_XIX_BMC_HV
      HVEM_BMC_CHA_Wunschleistung: upstream-reference=Geltungsbereich_E3_1_2_Premium.RP_IF_HVEM_BMC_CHA_Wunschleistung_XIX_BMC_HV.DE_HVEM_BMC_CHA_Wunschleistung, ecu-extract-reference=COMPOSITIONTYPE.RP_IF_HVEM_BMC_CHA_Wunschleistung_XIX_BMC_HV.DE_HVEM_BMC_CHA_Wunschleistung
      RP_IF_HVEM_BMC_CHA_Wunschleistung_XIX_BMC_HV: upstream-reference=Geltungsbereich_E3_1_2_Premium.RP_IF_HVEM_BMC_CHA_Wunschleistung_XIX_BMC_HV, ecu-extract-reference=COMPOSITIONTYPE.RP_IF_HVEM_BMC_CHA_Wunschleistung_XIX_BMC_HV
      HVEM_MMTR_State: upstream-reference=Geltungsbereich_E3_1_2_Premium.RP_IF_HVEM_MMTR_State_XIX_BMC_HV.DE_HVEM_MMTR_State, ecu-extract-reference=COMPOSITIONTYPE.RP_IF_HVEM_MMTR_State_XIX_BMC_HV.DE_HVEM_MMTR_State
      RP_IF_HVEM_MMTR_State_XIX_BMC_HV: upstream-reference=Geltungsbereich_E3_1_2_Premium.RP_IF_HVEM_MMTR_State_XIX_BMC_HV, ecu-extract-reference=COMPOSITIONTYPE.RP_IF_HVEM_MMTR_State_XIX_BMC_HV
      HVEM_SystemMinLeistungsgrenze: upstream-reference=Geltungsbereich_E3_1_2_Premium.RP_IF_HVEM_SystemMinLeistungsgrenze_XIX_BMC_HV.DE_HVEM_SystemMinLeistungsgrenze, ecu-extract-reference=COMPOSITIONTYPE.RP_IF_HVEM_SystemMinLeistungsgrenze_XIX_BMC_HV.DE_HVEM_SystemMinLeistungsgrenze
      RP_IF_HVEM_SystemMinLeistungsgrenze_XIX_BMC_HV: upstream-reference=Geltungsbereich_E3_1_2_Premium.RP_IF_HVEM_SystemMinLeistungsgrenze_XIX_BMC_HV, ecu-extract-reference=COMPOSITIONTYPE.RP_IF_HVEM_SystemMinLeistungsgrenze_XIX_BMC_HV
      HVLE_IstSpannung_HV: upstream-reference=Geltungsbereich_E3_1_2_Premium.RP_IF_HVLE_IstSpannung_HV_XIX_BMC_HV.DE_HVLE_IstSpannung_HV, ecu-extract-reference=COMPOSITIONTYPE.RP_IF_HVLE_IstSpannung_HV_XIX_BMC_HV.DE_HVLE_IstSpannung_HV
      RP_IF_HVLE_IstSpannung_HV_XIX_BMC_HV: upstream-reference=Geltungsbereich_E3_1_2_Premium.RP_IF_HVLE_IstSpannung_HV_XIX_BMC_HV, ecu-extract-reference=COMPOSITIONTYPE.RP_IF_HVLE_IstSpannung_HV_XIX_BMC_HV
      HVLE_OBG_IstModus: upstream-reference=Geltungsbereich_E3_1_2_Premium.RP_IF_HVLE_OBG_IstModus_XIX_BMC_HV.DE_HVLE_OBG_IstModus, ecu-extract-reference=COMPOSITIONTYPE.RP_IF_HVLE_OBG_IstModus_XIX_BMC_HV.DE_HVLE_OBG_IstModus
      RP_IF_HVLE_OBG_IstModus_XIX_BMC_HV: upstream-reference=Geltungsbereich_E3_1_2_Premium.RP_IF_HVLE_OBG_IstModus_XIX_BMC_HV, ecu-extract-reference=COMPOSITIONTYPE.RP_IF_HVLE_OBG_IstModus_XIX_BMC_HV
      HVLM_BCAM_Aktiv: upstream-reference=Geltungsbereich_E3_1_2_Premium.RP_IF_HVLM_BCAM_Aktiv_XIX_BMC_HV.DE_HVLM_BCAM_Aktiv, ecu-extract-reference=COMPOSITIONTYPE.RP_IF_HVLM_BCAM_Aktiv_XIX_BMC_HV.DE_HVLM_BCAM_Aktiv
      RP_IF_HVLM_BCAM_Aktiv_XIX_BMC_HV: upstream-reference=Geltungsbereich_E3_1_2_Premium.RP_IF_HVLM_BCAM_Aktiv_XIX_BMC_HV, ecu-extract-reference=COMPOSITIONTYPE.RP_IF_HVLM_BCAM_Aktiv_XIX_BMC_HV
      HVLM_BidiLadeModus: upstream-reference=Geltungsbereich_E3_1_2_Premium.RP_IF_HVLM_BidiLadeModus_XIX_BMC_HV.DE_HVLM_BidiLadeModus, ecu-extract-reference=COMPOSITIONTYPE.RP_IF_HVLM_BidiLadeModus_XIX_BMC_HV.DE_HVLM_BidiLadeModus
      RP_IF_HVLM_BidiLadeModus_XIX_BMC_HV: upstream-reference=Geltungsbereich_E3_1_2_Premium.RP_IF_HVLM_BidiLadeModus_XIX_BMC_HV, ecu-extract-reference=COMPOSITIONTYPE.RP_IF_HVLM_BidiLadeModus_XIX_BMC_HV
      KST_KL_15: upstream-reference=Geltungsbereich_E3_1_2_Premium.RP_IF_KST_KL_15_XIX_BMC_HV.DE_KST_KL_15, ecu-extract-reference=COMPOSITIONTYPE.RP_IF_KST_KL_15_XIX_BMC_HV.DE_KST_KL_15
      RP_IF_KST_KL_15_XIX_BMC_HV: upstream-reference=Geltungsbereich_E3_1_2_Premium.RP_IF_KST_KL_15_XIX_BMC_HV, ecu-extract-reference=COMPOSITIONTYPE.RP_IF_KST_KL_15_XIX_BMC_HV
      MM_PropulsionSystemActive: upstream-reference=Geltungsbereich_E3_1_2_Premium.RP_IF_MM_PropulsionSystemActive_XIX_BMC_HV.DE_MM_PropulsionSystemActive, ecu-extract-reference=COMPOSITIONTYPE.RP_IF_MM_PropulsionSystemActive_XIX_BMC_HV.DE_MM_PropulsionSystemActive
      RP_IF_MM_PropulsionSystemActive_XIX_BMC_HV: upstream-reference=Geltungsbereich_E3_1_2_Premium.RP_IF_MM_PropulsionSystemActive_XIX_BMC_HV, ecu-extract-reference=COMPOSITIONTYPE.RP_IF_MM_PropulsionSystemActive_XIX_BMC_HV
      RP_IF_NM_AWC_FCAB_XIX_BMC_HV: upstream-reference=Geltungsbereich_E3_1_2_Premium.RP_IF_NM_AWC_FCAB_XIX_BMC_HV, ecu-extract-reference=COMPOSITIONTYPE.RP_IF_NM_AWC_FCAB_XIX_BMC_HV
      RP_IF_NM_Gateway_FCAB_XIX_BMC_HV: upstream-reference=Geltungsbereich_E3_1_2_Premium.RP_IF_NM_Gateway_FCAB_XIX_BMC_HV, ecu-extract-reference=COMPOSITIONTYPE.RP_IF_NM_Gateway_FCAB_XIX_BMC_HV
      RP_IF_NM_HVZB_FCAB_XIX_BMC_HV: upstream-reference=Geltungsbereich_E3_1_2_Premium.RP_IF_NM_HVZB_FCAB_XIX_BMC_HV, ecu-extract-reference=COMPOSITIONTYPE.RP_IF_NM_HVZB_FCAB_XIX_BMC_HV
      RP_IF_NM_Ladegeraet_FCAB_XIX_BMC_HV: upstream-reference=Geltungsbereich_E3_1_2_Premium.RP_IF_NM_Ladegeraet_FCAB_XIX_BMC_HV, ecu-extract-reference=COMPOSITIONTYPE.RP_IF_NM_Ladegeraet_FCAB_XIX_BMC_HV
      RP_IF_NM_SACID_1_FCAB_XIX_BMC_HV: upstream-reference=Geltungsbereich_E3_1_2_Premium.RP_IF_NM_SACID_1_FCAB_XIX_BMC_HV, ecu-extract-reference=COMPOSITIONTYPE.RP_IF_NM_SACID_1_FCAB_XIX_BMC_HV
      RP_IF_NM_SACID_2_FCAB_XIX_BMC_HV: upstream-reference=Geltungsbereich_E3_1_2_Premium.RP_IF_NM_SACID_2_FCAB_XIX_BMC_HV, ecu-extract-reference=COMPOSITIONTYPE.RP_IF_NM_SACID_2_FCAB_XIX_BMC_HV
      NVEM_Abschaltstufe: upstream-reference=Geltungsbereich_E3_1_2_Premium.RP_IF_NVEM_Abschaltstufe_XIX_BMC_HV.DE_NVEM_Abschaltstufe, ecu-extract-reference=COMPOSITIONTYPE.RP_IF_NVEM_Abschaltstufe_XIX_BMC_HV.DE_NVEM_Abschaltstufe
      RP_IF_NVEM_Abschaltstufe_XIX_BMC_HV: upstream-reference=Geltungsbereich_E3_1_2_Premium.RP_IF_NVEM_Abschaltstufe_XIX_BMC_HV, ecu-extract-reference=COMPOSITIONTYPE.RP_IF_NVEM_Abschaltstufe_XIX_BMC_HV
      OBD_Abs_Pedal_Pos: upstream-reference=Geltungsbereich_E3_1_2_Premium.RP_IF_OBD_Abs_Pedal_Pos_XIX_BMC_HV.DE_OBD_Abs_Pedal_Pos, ecu-extract-reference=COMPOSITIONTYPE.RP_IF_OBD_Abs_Pedal_Pos_XIX_BMC_HV.DE_OBD_Abs_Pedal_Pos
      RP_IF_OBD_Abs_Pedal_Pos_XIX_BMC_HV: upstream-reference=Geltungsbereich_E3_1_2_Premium.RP_IF_OBD_Abs_Pedal_Pos_XIX_BMC_HV, ecu-extract-reference=COMPOSITIONTYPE.RP_IF_OBD_Abs_Pedal_Pos_XIX_BMC_HV
      OBD_Aussen_Temp_gef: upstream-reference=Geltungsbereich_E3_1_2_Premium.RP_IF_OBD_Aussen_Temp_gef_XIX_BMC_HV.DE_OBD_Aussen_Temp_gef, ecu-extract-reference=COMPOSITIONTYPE.RP_IF_OBD_Aussen_Temp_gef_XIX_BMC_HV.DE_OBD_Aussen_Temp_gef
      RP_IF_OBD_Aussen_Temp_gef_XIX_BMC_HV: upstream-reference=Geltungsbereich_E3_1_2_Premium.RP_IF_OBD_Aussen_Temp_gef_XIX_BMC_HV, ecu-extract-reference=COMPOSITIONTYPE.RP_IF_OBD_Aussen_Temp_gef_XIX_BMC_HV
      OBD_Barometric_Pressure: upstream-reference=Geltungsbereich_E3_1_2_Premium.RP_IF_OBD_Barometric_Pressure_XIX_BMC_HV.DE_OBD_Barometric_Pressure, ecu-extract-reference=COMPOSITIONTYPE.RP_IF_OBD_Barometric_Pressure_XIX_BMC_HV.DE_OBD_Barometric_Pressure
      RP_IF_OBD_Barometric_Pressure_XIX_BMC_HV: upstream-reference=Geltungsbereich_E3_1_2_Premium.RP_IF_OBD_Barometric_Pressure_XIX_BMC_HV, ecu-extract-reference=COMPOSITIONTYPE.RP_IF_OBD_Barometric_Pressure_XIX_BMC_HV
      OBD_Calc_Load_Val: upstream-reference=Geltungsbereich_E3_1_2_Premium.RP_IF_OBD_Calc_Load_Val_XIX_BMC_HV.DE_OBD_Calc_Load_Val, ecu-extract-reference=COMPOSITIONTYPE.RP_IF_OBD_Calc_Load_Val_XIX_BMC_HV.DE_OBD_Calc_Load_Val
      RP_IF_OBD_Calc_Load_Val_XIX_BMC_HV: upstream-reference=Geltungsbereich_E3_1_2_Premium.RP_IF_OBD_Calc_Load_Val_XIX_BMC_HV, ecu-extract-reference=COMPOSITIONTYPE.RP_IF_OBD_Calc_Load_Val_XIX_BMC_HV
      OBD_ClearMem_Inhibit: upstream-reference=Geltungsbereich_E3_1_2_Premium.RP_IF_OBD_ClearMem_Inhibit_XIX_BMC_HV.DE_OBD_ClearMem_Inhibit, ecu-extract-reference=COMPOSITIONTYPE.RP_IF_OBD_ClearMem_Inhibit_XIX_BMC_HV.DE_OBD_ClearMem_Inhibit
      RP_IF_OBD_ClearMem_Inhibit_XIX_BMC_HV: upstream-reference=Geltungsbereich_E3_1_2_Premium.RP_IF_OBD_ClearMem_Inhibit_XIX_BMC_HV, ecu-extract-reference=COMPOSITIONTYPE.RP_IF_OBD_ClearMem_Inhibit_XIX_BMC_HV
      OBD_Driving_Cycle: upstream-reference=Geltungsbereich_E3_1_2_Premium.RP_IF_OBD_Driving_Cycle_XIX_BMC_HV.DE_OBD_Driving_Cycle, ecu-extract-reference=COMPOSITIONTYPE.RP_IF_OBD_Driving_Cycle_XIX_BMC_HV.DE_OBD_Driving_Cycle
      RP_IF_OBD_Driving_Cycle_XIX_BMC_HV: upstream-reference=Geltungsbereich_E3_1_2_Premium.RP_IF_OBD_Driving_Cycle_XIX_BMC_HV, ecu-extract-reference=COMPOSITIONTYPE.RP_IF_OBD_Driving_Cycle_XIX_BMC_HV
      OBD_Eng_Cool_Temp: upstream-reference=Geltungsbereich_E3_1_2_Premium.RP_IF_OBD_Eng_Cool_Temp_XIX_BMC_HV.DE_OBD_Eng_Cool_Temp, ecu-extract-reference=COMPOSITIONTYPE.RP_IF_OBD_Eng_Cool_Temp_XIX_BMC_HV.DE_OBD_Eng_Cool_Temp
      RP_IF_OBD_Eng_Cool_Temp_XIX_BMC_HV: upstream-reference=Geltungsbereich_E3_1_2_Premium.RP_IF_OBD_Eng_Cool_Temp_XIX_BMC_HV, ecu-extract-reference=COMPOSITIONTYPE.RP_IF_OBD_Eng_Cool_Temp_XIX_BMC_HV
      OBD_Engine_RPM: upstream-reference=Geltungsbereich_E3_1_2_Premium.RP_IF_OBD_Engine_RPM_XIX_BMC_HV.DE_OBD_Engine_RPM, ecu-extract-reference=COMPOSITIONTYPE.RP_IF_OBD_Engine_RPM_XIX_BMC_HV.DE_OBD_Engine_RPM
      RP_IF_OBD_Engine_RPM_XIX_BMC_HV: upstream-reference=Geltungsbereich_E3_1_2_Premium.RP_IF_OBD_Engine_RPM_XIX_BMC_HV, ecu-extract-reference=COMPOSITIONTYPE.RP_IF_OBD_Engine_RPM_XIX_BMC_HV
      OBD_Kaltstart_Denominator: upstream-reference=Geltungsbereich_E3_1_2_Premium.RP_IF_OBD_Kaltstart_Denominator_XIX_BMC_HV.DE_OBD_Kaltstart_Denominator, ecu-extract-reference=COMPOSITIONTYPE.RP_IF_OBD_Kaltstart_Denominator_XIX_BMC_HV.DE_OBD_Kaltstart_Denominator
      RP_IF_OBD_Kaltstart_Denominator_XIX_BMC_HV: upstream-reference=Geltungsbereich_E3_1_2_Premium.RP_IF_OBD_Kaltstart_Denominator_XIX_BMC_HV, ecu-extract-reference=COMPOSITIONTYPE.RP_IF_OBD_Kaltstart_Denominator_XIX_BMC_HV
      OBD_Minimum_Trip: upstream-reference=Geltungsbereich_E3_1_2_Premium.RP_IF_OBD_Minimum_Trip_XIX_BMC_HV.DE_OBD_Minimum_Trip, ecu-extract-reference=COMPOSITIONTYPE.RP_IF_OBD_Minimum_Trip_XIX_BMC_HV.DE_OBD_Minimum_Trip
      RP_IF_OBD_Minimum_Trip_XIX_BMC_HV: upstream-reference=Geltungsbereich_E3_1_2_Premium.RP_IF_OBD_Minimum_Trip_XIX_BMC_HV, ecu-extract-reference=COMPOSITIONTYPE.RP_IF_OBD_Minimum_Trip_XIX_BMC_HV
      OBD_Normed_Trip: upstream-reference=Geltungsbereich_E3_1_2_Premium.RP_IF_OBD_Normed_Trip_XIX_BMC_HV.DE_OBD_Normed_Trip, ecu-extract-reference=COMPOSITIONTYPE.RP_IF_OBD_Normed_Trip_XIX_BMC_HV.DE_OBD_Normed_Trip
      RP_IF_OBD_Normed_Trip_XIX_BMC_HV: upstream-reference=Geltungsbereich_E3_1_2_Premium.RP_IF_OBD_Normed_Trip_XIX_BMC_HV, ecu-extract-reference=COMPOSITIONTYPE.RP_IF_OBD_Normed_Trip_XIX_BMC_HV
      OBD_NumDcyMilOnReq: upstream-reference=Geltungsbereich_E3_1_2_Premium.RP_IF_OBD_NumDcyMilOnReq_XIX_BMC_HV.DE_OBD_NumDcyMilOnReq, ecu-extract-reference=COMPOSITIONTYPE.RP_IF_OBD_NumDcyMilOnReq_XIX_BMC_HV.DE_OBD_NumDcyMilOnReq
      RP_IF_OBD_NumDcyMilOnReq_XIX_BMC_HV: upstream-reference=Geltungsbereich_E3_1_2_Premium.RP_IF_OBD_NumDcyMilOnReq_XIX_BMC_HV, ecu-extract-reference=COMPOSITIONTYPE.RP_IF_OBD_NumDcyMilOnReq_XIX_BMC_HV
      OBD_QBit_Aussen_Temp: upstream-reference=Geltungsbereich_E3_1_2_Premium.RP_IF_OBD_QBit_Aussen_Temp_XIX_BMC_HV.DE_OBD_QBit_Aussen_Temp, ecu-extract-reference=COMPOSITIONTYPE.RP_IF_OBD_QBit_Aussen_Temp_XIX_BMC_HV.DE_OBD_QBit_Aussen_Temp
      RP_IF_OBD_QBit_Aussen_Temp_XIX_BMC_HV: upstream-reference=Geltungsbereich_E3_1_2_Premium.RP_IF_OBD_QBit_Aussen_Temp_XIX_BMC_HV, ecu-extract-reference=COMPOSITIONTYPE.RP_IF_OBD_QBit_Aussen_Temp_XIX_BMC_HV
      OBD_Sperrung_IUMPR: upstream-reference=Geltungsbereich_E3_1_2_Premium.RP_IF_OBD_Sperrung_IUMPR_XIX_BMC_HV.DE_OBD_Sperrung_IUMPR, ecu-extract-reference=COMPOSITIONTYPE.RP_IF_OBD_Sperrung_IUMPR_XIX_BMC_HV.DE_OBD_Sperrung_IUMPR
      RP_IF_OBD_Sperrung_IUMPR_XIX_BMC_HV: upstream-reference=Geltungsbereich_E3_1_2_Premium.RP_IF_OBD_Sperrung_IUMPR_XIX_BMC_HV, ecu-extract-reference=COMPOSITIONTYPE.RP_IF_OBD_Sperrung_IUMPR_XIX_BMC_HV
      OBD_Sperrung_Kaltstart_Denom: upstream-reference=Geltungsbereich_E3_1_2_Premium.RP_IF_OBD_Sperrung_Kaltstart_Denom_XIX_BMC_HV.DE_OBD_Sperrung_Kaltstart_Denom, ecu-extract-reference=COMPOSITIONTYPE.RP_IF_OBD_Sperrung_Kaltstart_Denom_XIX_BMC_HV.DE_OBD_Sperrung_Kaltstart_Denom
      RP_IF_OBD_Sperrung_Kaltstart_Denom_XIX_BMC_HV: upstream-reference=Geltungsbereich_E3_1_2_Premium.RP_IF_OBD_Sperrung_Kaltstart_Denom_XIX_BMC_HV, ecu-extract-reference=COMPOSITIONTYPE.RP_IF_OBD_Sperrung_Kaltstart_Denom_XIX_BMC_HV
      OBD_Typ: upstream-reference=Geltungsbereich_E3_1_2_Premium.RP_IF_OBD_Typ_XIX_BMC_HV.DE_OBD_Typ, ecu-extract-reference=COMPOSITIONTYPE.RP_IF_OBD_Typ_XIX_BMC_HV.DE_OBD_Typ
      RP_IF_OBD_Typ_XIX_BMC_HV: upstream-reference=Geltungsbereich_E3_1_2_Premium.RP_IF_OBD_Typ_XIX_BMC_HV, ecu-extract-reference=COMPOSITIONTYPE.RP_IF_OBD_Typ_XIX_BMC_HV
      OBD_Warm_Up_Cycle: upstream-reference=Geltungsbereich_E3_1_2_Premium.RP_IF_OBD_Warm_Up_Cycle_XIX_BMC_HV.DE_OBD_Warm_Up_Cycle, ecu-extract-reference=COMPOSITIONTYPE.RP_IF_OBD_Warm_Up_Cycle_XIX_BMC_HV.DE_OBD_Warm_Up_Cycle
      RP_IF_OBD_Warm_Up_Cycle_XIX_BMC_HV: upstream-reference=Geltungsbereich_E3_1_2_Premium.RP_IF_OBD_Warm_Up_Cycle_XIX_BMC_HV, ecu-extract-reference=COMPOSITIONTYPE.RP_IF_OBD_Warm_Up_Cycle_XIX_BMC_HV
      OBDProtocol_req: upstream-reference=Geltungsbereich_E3_1_2_Premium.RP_IF_OBDProtocol_req_XIX_BMC_HV.DE_OBDProtocol_req, ecu-extract-reference=COMPOSITIONTYPE.RP_IF_OBDProtocol_req_XIX_BMC_HV.DE_OBDProtocol_req
      RP_IF_OBDProtocol_req_XIX_BMC_HV: upstream-reference=Geltungsbereich_E3_1_2_Premium.RP_IF_OBDProtocol_req_XIX_BMC_HV, ecu-extract-reference=COMPOSITIONTYPE.RP_IF_OBDProtocol_req_XIX_BMC_HV
      ORU_Status: upstream-reference=Geltungsbereich_E3_1_2_Premium.RP_IF_ORU_Status_XIX_BMC_HV.DE_ORU_Status, ecu-extract-reference=COMPOSITIONTYPE.RP_IF_ORU_Status_XIX_BMC_HV.DE_ORU_Status
      RP_IF_ORU_Status_XIX_BMC_HV: upstream-reference=Geltungsbereich_E3_1_2_Premium.RP_IF_ORU_Status_XIX_BMC_HV, ecu-extract-reference=COMPOSITIONTYPE.RP_IF_ORU_Status_XIX_BMC_HV
      OTP_Aussen_Temp_OBD: upstream-reference=Geltungsbereich_E3_1_2_Premium.RP_IF_OTP_Aussen_Temp_OBD_XIX_BMC_HV.DE_OTP_Aussen_Temp_OBD, ecu-extract-reference=COMPOSITIONTYPE.RP_IF_OTP_Aussen_Temp_OBD_XIX_BMC_HV.DE_OTP_Aussen_Temp_OBD
      RP_IF_OTP_Aussen_Temp_OBD_XIX_BMC_HV: upstream-reference=Geltungsbereich_E3_1_2_Premium.RP_IF_OTP_Aussen_Temp_OBD_XIX_BMC_HV, ecu-extract-reference=COMPOSITIONTYPE.RP_IF_OTP_Aussen_Temp_OBD_XIX_BMC_HV
      OTP_Aussen_Temp_ungef: upstream-reference=Geltungsbereich_E3_1_2_Premium.RP_IF_OTP_Aussen_Temp_ungef_XIX_BMC_HV.DE_OTP_Aussen_Temp_ungef, ecu-extract-reference=COMPOSITIONTYPE.RP_IF_OTP_Aussen_Temp_ungef_XIX_BMC_HV.DE_OTP_Aussen_Temp_ungef
      RP_IF_OTP_Aussen_Temp_ungef_XIX_BMC_HV: upstream-reference=Geltungsbereich_E3_1_2_Premium.RP_IF_OTP_Aussen_Temp_ungef_XIX_BMC_HV, ecu-extract-reference=COMPOSITIONTYPE.RP_IF_OTP_Aussen_Temp_ungef_XIX_BMC_HV
      PCM_BMC_VTD_Freeze_Req: upstream-reference=Geltungsbereich_E3_1_2_Premium.RP_IF_PCM_BMC_VTD_Freeze_Req_XIX_BMC_HV.DE_PCM_BMC_VTD_Freeze_Req, ecu-extract-reference=COMPOSITIONTYPE.RP_IF_PCM_BMC_VTD_Freeze_Req_XIX_BMC_HV.DE_PCM_BMC_VTD_Freeze_Req
      RP_IF_PCM_BMC_VTD_Freeze_Req_XIX_BMC_HV: upstream-reference=Geltungsbereich_E3_1_2_Premium.RP_IF_PCM_BMC_VTD_Freeze_Req_XIX_BMC_HV, ecu-extract-reference=COMPOSITIONTYPE.RP_IF_PCM_BMC_VTD_Freeze_Req_XIX_BMC_HV
      PCM_BMC_VTD_LifeTimeReset_Req: upstream-reference=Geltungsbereich_E3_1_2_Premium.RP_IF_PCM_BMC_VTD_LifeTimeReset_Req_XIX_BMC_HV.DE_PCM_BMC_VTD_LifeTimeReset_Req, ecu-extract-reference=COMPOSITIONTYPE.RP_IF_PCM_BMC_VTD_LifeTimeReset_Req_XIX_BMC_HV.DE_PCM_BMC_VTD_LifeTimeReset_Req
      RP_IF_PCM_BMC_VTD_LifeTimeReset_Req_XIX_BMC_HV: upstream-reference=Geltungsbereich_E3_1_2_Premium.RP_IF_PCM_BMC_VTD_LifeTimeReset_Req_XIX_BMC_HV, ecu-extract-reference=COMPOSITIONTYPE.RP_IF_PCM_BMC_VTD_LifeTimeReset_Req_XIX_BMC_HV
      PCM_BMC_VTD_LifeTimeReset_Resp: upstream-reference=Geltungsbereich_E3_1_2_Premium.RP_IF_PCM_BMC_VTD_LifeTimeReset_Resp_XIX_BMC_HV.DE_PCM_BMC_VTD_LifeTimeReset_Resp, ecu-extract-reference=COMPOSITIONTYPE.RP_IF_PCM_BMC_VTD_LifeTimeReset_Resp_XIX_BMC_HV.DE_PCM_BMC_VTD_LifeTimeReset_Resp
      RP_IF_PCM_BMC_VTD_LifeTimeReset_Resp_XIX_BMC_HV: upstream-reference=Geltungsbereich_E3_1_2_Premium.RP_IF_PCM_BMC_VTD_LifeTimeReset_Resp_XIX_BMC_HV, ecu-extract-reference=COMPOSITIONTYPE.RP_IF_PCM_BMC_VTD_LifeTimeReset_Resp_XIX_BMC_HV
      PCM_BMC_VTD_RecentReset_Req: upstream-reference=Geltungsbereich_E3_1_2_Premium.RP_IF_PCM_BMC_VTD_RecentReset_Req_XIX_BMC_HV.DE_PCM_BMC_VTD_RecentReset_Req, ecu-extract-reference=COMPOSITIONTYPE.RP_IF_PCM_BMC_VTD_RecentReset_Req_XIX_BMC_HV.DE_PCM_BMC_VTD_RecentReset_Req
      RP_IF_PCM_BMC_VTD_RecentReset_Req_XIX_BMC_HV: upstream-reference=Geltungsbereich_E3_1_2_Premium.RP_IF_PCM_BMC_VTD_RecentReset_Req_XIX_BMC_HV, ecu-extract-reference=COMPOSITIONTYPE.RP_IF_PCM_BMC_VTD_RecentReset_Req_XIX_BMC_HV
      RP_IF_SG_BJB_{10..13}_XIX_BMC_HV: upstream-reference=Geltungsbereich_E3_1_2_Premium.RP_IF_SG_BJB_{10..13}_XIX_BMC_HV, ecu-extract-reference=COMPOSITIONTYPE.RP_IF_SG_BJB_{10..13}_XIX_BMC_HV
      RP_IF_SG_HVK_03_XIX_BMC_HV: upstream-reference=Geltungsbereich_E3_1_2_Premium.RP_IF_SG_HVK_03_XIX_BMC_HV, ecu-extract-reference=COMPOSITIONTYPE.RP_IF_SG_HVK_03_XIX_BMC_HV
      RP_IF_SG_HVLM_14_XIX_BMC_HV: upstream-reference=Geltungsbereich_E3_1_2_Premium.RP_IF_SG_HVLM_14_XIX_BMC_HV, ecu-extract-reference=COMPOSITIONTYPE.RP_IF_SG_HVLM_14_XIX_BMC_HV
      SG_KS_Hybrid_01_Challenge_M: upstream-reference=Geltungsbereich_E3_1_2_Premium.RP_IF_SG_KS_Hybrid_01_Challenge_M_XIX_BMC_HV.DE_SG_KS_Hybrid_01_Challenge_M, ecu-extract-reference=COMPOSITIONTYPE.RP_IF_SG_KS_Hybrid_01_Challenge_M_XIX_BMC_HV.DE_SG_KS_Hybrid_01_Challenge_M
      RP_IF_SG_KS_Hybrid_01_Challenge_M_XIX_BMC_HV: upstream-reference=Geltungsbereich_E3_1_2_Premium.RP_IF_SG_KS_Hybrid_01_Challenge_M_XIX_BMC_HV, ecu-extract-reference=COMPOSITIONTYPE.RP_IF_SG_KS_Hybrid_01_Challenge_M_XIX_BMC_HV
      SG_KS_Hybrid_01_Response_M: upstream-reference=Geltungsbereich_E3_1_2_Premium.RP_IF_SG_KS_Hybrid_01_Response_M_XIX_BMC_HV.DE_SG_KS_Hybrid_01_Response_M, ecu-extract-reference=COMPOSITIONTYPE.RP_IF_SG_KS_Hybrid_01_Response_M_XIX_BMC_HV.DE_SG_KS_Hybrid_01_Response_M
      RP_IF_SG_KS_Hybrid_01_Response_M_XIX_BMC_HV: upstream-reference=Geltungsbereich_E3_1_2_Premium.RP_IF_SG_KS_Hybrid_01_Response_M_XIX_BMC_HV, ecu-extract-reference=COMPOSITIONTYPE.RP_IF_SG_KS_Hybrid_01_Response_M_XIX_BMC_HV
      RP_IF_SG_ORU_Control_A_01_XIX_BMC_HV: upstream-reference=Geltungsbereich_E3_1_2_Premium.RP_IF_SG_ORU_Control_A_01_XIX_BMC_HV, ecu-extract-reference=COMPOSITIONTYPE.RP_IF_SG_ORU_Control_A_01_XIX_BMC_HV
      RP_IF_SG_ORU_Control_D_01_XIX_BMC_HV: upstream-reference=Geltungsbereich_E3_1_2_Premium.RP_IF_SG_ORU_Control_D_01_XIX_BMC_HV, ecu-extract-reference=COMPOSITIONTYPE.RP_IF_SG_ORU_Control_D_01_XIX_BMC_HV
      RP_IF_SG_OTAMC_D_01_XIX_BMC_HV: upstream-reference=Geltungsbereich_E3_1_2_Premium.RP_IF_SG_OTAMC_D_01_XIX_BMC_HV, ecu-extract-reference=COMPOSITIONTYPE.RP_IF_SG_OTAMC_D_01_XIX_BMC_HV
      SG_UI1_01: upstream-reference=Geltungsbereich_E3_1_2_Premium.SG_UI1_01, ecu-extract-reference=COMPOSITIONTYPE.SG_UI1_01
      RP_IF_SG_UI1_01_XIX_BMC_HV: upstream-reference=Geltungsbereich_E3_1_2_Premium.RP_IF_SG_UI1_01_XIX_BMC_HV, ecu-extract-reference=COMPOSITIONTYPE.RP_IF_SG_UI1_01_XIX_BMC_HV
      RP_IF_SG_UI1_02_XIX_BMC_HV: upstream-reference=Geltungsbereich_E3_1_2_Premium.RP_IF_SG_UI1_02_XIX_BMC_HV, ecu-extract-reference=COMPOSITIONTYPE.RP_IF_SG_UI1_02_XIX_BMC_HV
      RP_IF_SG_UI2_{01..03}_XIX_BMC_HV: upstream-reference=Geltungsbereich_E3_1_2_Premium.RP_IF_SG_UI2_{01..03}_XIX_BMC_HV, ecu-extract-reference=COMPOSITIONTYPE.RP_IF_SG_UI2_{01..03}_XIX_BMC_HV
      SI_NWDF_30: upstream-reference=Geltungsbereich_E3_1_2_Premium.RP_IF_SI_NWDF_30_XIX_BMC_HV.DE_SI_NWDF_30, ecu-extract-reference=COMPOSITIONTYPE.RP_IF_SI_NWDF_30_XIX_BMC_HV.DE_SI_NWDF_30
      RP_IF_SI_NWDF_30_XIX_BMC_HV: upstream-reference=Geltungsbereich_E3_1_2_Premium.RP_IF_SI_NWDF_30_XIX_BMC_HV, ecu-extract-reference=COMPOSITIONTYPE.RP_IF_SI_NWDF_30_XIX_BMC_HV
      SI_NWDF: upstream-reference=Geltungsbereich_E3_1_2_Premium.RP_IF_SI_NWDF_XIX_BMC_HV.DE_SI_NWDF, ecu-extract-reference=COMPOSITIONTYPE.RP_IF_SI_NWDF_XIX_BMC_HV.DE_SI_NWDF
      RP_IF_SI_NWDF_XIX_BMC_HV: upstream-reference=Geltungsbereich_E3_1_2_Premium.RP_IF_SI_NWDF_XIX_BMC_HV, ecu-extract-reference=COMPOSITIONTYPE.RP_IF_SI_NWDF_XIX_BMC_HV
      SI_P_Mode_gueltig: upstream-reference=Geltungsbereich_E3_1_2_Premium.RP_IF_SI_P_Mode_gueltig_XIX_BMC_HV.DE_SI_P_Mode_gueltig, ecu-extract-reference=COMPOSITIONTYPE.RP_IF_SI_P_Mode_gueltig_XIX_BMC_HV.DE_SI_P_Mode_gueltig
      RP_IF_SI_P_Mode_gueltig_XIX_BMC_HV: upstream-reference=Geltungsbereich_E3_1_2_Premium.RP_IF_SI_P_Mode_gueltig_XIX_BMC_HV, ecu-extract-reference=COMPOSITIONTYPE.RP_IF_SI_P_Mode_gueltig_XIX_BMC_HV
      SI_P_Mode: upstream-reference=Geltungsbereich_E3_1_2_Premium.RP_IF_SI_P_Mode_XIX_BMC_HV.DE_SI_P_Mode, ecu-extract-reference=COMPOSITIONTYPE.RP_IF_SI_P_Mode_XIX_BMC_HV.DE_SI_P_Mode
      RP_IF_SI_P_Mode_XIX_BMC_HV: upstream-reference=Geltungsbereich_E3_1_2_Premium.RP_IF_SI_P_Mode_XIX_BMC_HV, ecu-extract-reference=COMPOSITIONTYPE.RP_IF_SI_P_Mode_XIX_BMC_HV
      SI_T_Mode: upstream-reference=Geltungsbereich_E3_1_2_Premium.RP_IF_SI_T_Mode_XIX_BMC_HV.DE_SI_T_Mode, ecu-extract-reference=COMPOSITIONTYPE.RP_IF_SI_T_Mode_XIX_BMC_HV.DE_SI_T_Mode
      RP_IF_SI_T_Mode_XIX_BMC_HV: upstream-reference=Geltungsbereich_E3_1_2_Premium.RP_IF_SI_T_Mode_XIX_BMC_HV, ecu-extract-reference=COMPOSITIONTYPE.RP_IF_SI_T_Mode_XIX_BMC_HV
      SOK_ungeschuetzte_Zeit: upstream-reference=Geltungsbereich_E3_1_2_Premium.RP_IF_SOK_ungeschuetzte_Zeit_XIX_BMC_HV.DE_SOK_ungeschuetzte_Zeit, ecu-extract-reference=COMPOSITIONTYPE.RP_IF_SOK_ungeschuetzte_Zeit_XIX_BMC_HV.DE_SOK_ungeschuetzte_Zeit
      RP_IF_SOK_ungeschuetzte_Zeit_XIX_BMC_HV: upstream-reference=Geltungsbereich_E3_1_2_Premium.RP_IF_SOK_ungeschuetzte_Zeit_XIX_BMC_HV, ecu-extract-reference=COMPOSITIONTYPE.RP_IF_SOK_ungeschuetzte_Zeit_XIX_BMC_HV
      SOK_Zeit_Hybrid_01_Zeit: upstream-reference=Geltungsbereich_E3_1_2_Premium.RP_IF_SOK_Zeit_Hybrid_01_Zeit_XIX_BMC_HV.DE_SOK_Zeit_Hybrid_01_Zeit, ecu-extract-reference=COMPOSITIONTYPE.RP_IF_SOK_Zeit_Hybrid_01_Zeit_XIX_BMC_HV.DE_SOK_Zeit_Hybrid_01_Zeit
      RP_IF_SOK_Zeit_Hybrid_01_Zeit_XIX_BMC_HV: upstream-reference=Geltungsbereich_E3_1_2_Premium.RP_IF_SOK_Zeit_Hybrid_01_Zeit_XIX_BMC_HV, ecu-extract-reference=COMPOSITIONTYPE.RP_IF_SOK_Zeit_Hybrid_01_Zeit_XIX_BMC_HV
      TME_Batt_Kond_Verf: upstream-reference=Geltungsbereich_E3_1_2_Premium.RP_IF_TME_Batt_Kond_Verf_XIX_BMC_HV.DE_TME_Batt_Kond_Verf, ecu-extract-reference=COMPOSITIONTYPE.RP_IF_TME_Batt_Kond_Verf_XIX_BMC_HV.DE_TME_Batt_Kond_Verf
      RP_IF_TME_Batt_Kond_Verf_XIX_BMC_HV: upstream-reference=Geltungsbereich_E3_1_2_Premium.RP_IF_TME_Batt_Kond_Verf_XIX_BMC_HV, ecu-extract-reference=COMPOSITIONTYPE.RP_IF_TME_Batt_Kond_Verf_XIX_BMC_HV
      TME_Therm_IstLeistung_HVBatterie: upstream-reference=Geltungsbereich_E3_1_2_Premium.RP_IF_TME_Therm_IstLeistung_HVBatterie_XIX_BMC_HV.DE_TME_Therm_IstLeistung_HVBatterie, ecu-extract-reference=COMPOSITIONTYPE.RP_IF_TME_Therm_IstLeistung_HVBatterie_XIX_BMC_HV.DE_TME_Therm_IstLeistung_HVBatterie
      RP_IF_TME_Therm_IstLeistung_HVBatterie_XIX_BMC_HV: upstream-reference=Geltungsbereich_E3_1_2_Premium.RP_IF_TME_Therm_IstLeistung_HVBatterie_XIX_BMC_HV, ecu-extract-reference=COMPOSITIONTYPE.RP_IF_TME_Therm_IstLeistung_HVBatterie_XIX_BMC_HV
      UH_Jahr: upstream-reference=Geltungsbereich_E3_1_2_Premium.RP_IF_UH_Jahr_XIX_BMC_HV.DE_UH_Jahr, ecu-extract-reference=COMPOSITIONTYPE.RP_IF_UH_Jahr_XIX_BMC_HV.DE_UH_Jahr
      RP_IF_UH_Jahr_XIX_BMC_HV: upstream-reference=Geltungsbereich_E3_1_2_Premium.RP_IF_UH_Jahr_XIX_BMC_HV, ecu-extract-reference=COMPOSITIONTYPE.RP_IF_UH_Jahr_XIX_BMC_HV
      UH_Minute: upstream-reference=Geltungsbereich_E3_1_2_Premium.RP_IF_UH_Minute_XIX_BMC_HV.DE_UH_Minute, ecu-extract-reference=COMPOSITIONTYPE.RP_IF_UH_Minute_XIX_BMC_HV.DE_UH_Minute
      RP_IF_UH_Minute_XIX_BMC_HV: upstream-reference=Geltungsbereich_E3_1_2_Premium.RP_IF_UH_Minute_XIX_BMC_HV, ecu-extract-reference=COMPOSITIONTYPE.RP_IF_UH_Minute_XIX_BMC_HV
      UH_Monat: upstream-reference=Geltungsbereich_E3_1_2_Premium.RP_IF_UH_Monat_XIX_BMC_HV.DE_UH_Monat, ecu-extract-reference=COMPOSITIONTYPE.RP_IF_UH_Monat_XIX_BMC_HV.DE_UH_Monat
      RP_IF_UH_Monat_XIX_BMC_HV: upstream-reference=Geltungsbereich_E3_1_2_Premium.RP_IF_UH_Monat_XIX_BMC_HV, ecu-extract-reference=COMPOSITIONTYPE.RP_IF_UH_Monat_XIX_BMC_HV
      UH_Sekunde: upstream-reference=Geltungsbereich_E3_1_2_Premium.RP_IF_UH_Sekunde_XIX_BMC_HV.DE_UH_Sekunde, ecu-extract-reference=COMPOSITIONTYPE.RP_IF_UH_Sekunde_XIX_BMC_HV.DE_UH_Sekunde
      RP_IF_UH_Sekunde_XIX_BMC_HV: upstream-reference=Geltungsbereich_E3_1_2_Premium.RP_IF_UH_Sekunde_XIX_BMC_HV, ecu-extract-reference=COMPOSITIONTYPE.RP_IF_UH_Sekunde_XIX_BMC_HV
      UH_Stunde: upstream-reference=Geltungsbereich_E3_1_2_Premium.RP_IF_UH_Stunde_XIX_BMC_HV.DE_UH_Stunde, ecu-extract-reference=COMPOSITIONTYPE.RP_IF_UH_Stunde_XIX_BMC_HV.DE_UH_Stunde
      RP_IF_UH_Stunde_XIX_BMC_HV: upstream-reference=Geltungsbereich_E3_1_2_Premium.RP_IF_UH_Stunde_XIX_BMC_HV, ecu-extract-reference=COMPOSITIONTYPE.RP_IF_UH_Stunde_XIX_BMC_HV
      UH_Tag: upstream-reference=Geltungsbereich_E3_1_2_Premium.RP_IF_UH_Tag_XIX_BMC_HV.DE_UH_Tag, ecu-extract-reference=COMPOSITIONTYPE.RP_IF_UH_Tag_XIX_BMC_HV.DE_UH_Tag
      RP_IF_UH_Tag_XIX_BMC_HV: upstream-reference=Geltungsbereich_E3_1_2_Premium.RP_IF_UH_Tag_XIX_BMC_HV, ecu-extract-reference=COMPOSITIONTYPE.RP_IF_UH_Tag_XIX_BMC_HV
      UI1_Iso_Neg: upstream-reference=Geltungsbereich_E3_1_2_Premium.RP_IF_UI1_Iso_Neg_XIX_BMC_HV.DE_UI1_Iso_Neg, ecu-extract-reference=COMPOSITIONTYPE.RP_IF_UI1_Iso_Neg_XIX_BMC_HV.DE_UI1_Iso_Neg
      RP_IF_UI1_Iso_Neg_XIX_BMC_HV: upstream-reference=Geltungsbereich_E3_1_2_Premium.RP_IF_UI1_Iso_Neg_XIX_BMC_HV, ecu-extract-reference=COMPOSITIONTYPE.RP_IF_UI1_Iso_Neg_XIX_BMC_HV
      UI1_Iso_Pos: upstream-reference=Geltungsbereich_E3_1_2_Premium.RP_IF_UI1_Iso_Pos_XIX_BMC_HV.DE_UI1_Iso_Pos, ecu-extract-reference=COMPOSITIONTYPE.RP_IF_UI1_Iso_Pos_XIX_BMC_HV.DE_UI1_Iso_Pos
      RP_IF_UI1_Iso_Pos_XIX_BMC_HV: upstream-reference=Geltungsbereich_E3_1_2_Premium.RP_IF_UI1_Iso_Pos_XIX_BMC_HV, ecu-extract-reference=COMPOSITIONTYPE.RP_IF_UI1_Iso_Pos_XIX_BMC_HV
      UI1_Iso_Status: upstream-reference=Geltungsbereich_E3_1_2_Premium.RP_IF_UI1_Iso_Status_XIX_BMC_HV.DE_UI1_Iso_Status, ecu-extract-reference=COMPOSITIONTYPE.RP_IF_UI1_Iso_Status_XIX_BMC_HV.DE_UI1_Iso_Status
      RP_IF_UI1_Iso_Status_XIX_BMC_HV: upstream-reference=Geltungsbereich_E3_1_2_Premium.RP_IF_UI1_Iso_Status_XIX_BMC_HV, ecu-extract-reference=COMPOSITIONTYPE.RP_IF_UI1_Iso_Status_XIX_BMC_HV
      UI1_KompFehlerModus2_01: upstream-reference=Geltungsbereich_E3_1_2_Premium.RP_IF_UI1_KompFehlerModus2_01_XIX_BMC_HV.DE_UI1_KompFehlerModus2_01, ecu-extract-reference=COMPOSITIONTYPE.RP_IF_UI1_KompFehlerModus2_01_XIX_BMC_HV.DE_UI1_KompFehlerModus2_01
      RP_IF_UI1_KompFehlerModus2_01_XIX_BMC_HV: upstream-reference=Geltungsbereich_E3_1_2_Premium.RP_IF_UI1_KompFehlerModus2_01_XIX_BMC_HV, ecu-extract-reference=COMPOSITIONTYPE.RP_IF_UI1_KompFehlerModus2_01_XIX_BMC_HV
      UI1_KompFehlerModus2_02: upstream-reference=Geltungsbereich_E3_1_2_Premium.RP_IF_UI1_KompFehlerModus2_02_XIX_BMC_HV.DE_UI1_KompFehlerModus2_02, ecu-extract-reference=COMPOSITIONTYPE.RP_IF_UI1_KompFehlerModus2_02_XIX_BMC_HV.DE_UI1_KompFehlerModus2_02
      RP_IF_UI1_KompFehlerModus2_02_XIX_BMC_HV: upstream-reference=Geltungsbereich_E3_1_2_Premium.RP_IF_UI1_KompFehlerModus2_02_XIX_BMC_HV, ecu-extract-reference=COMPOSITIONTYPE.RP_IF_UI1_KompFehlerModus2_02_XIX_BMC_HV
      UI1_KompFehlerModus2_03: upstream-reference=Geltungsbereich_E3_1_2_Premium.RP_IF_UI1_KompFehlerModus2_03_XIX_BMC_HV.DE_UI1_KompFehlerModus2_03, ecu-extract-reference=COMPOSITIONTYPE.RP_IF_UI1_KompFehlerModus2_03_XIX_BMC_HV.DE_UI1_KompFehlerModus2_03
      RP_IF_UI1_KompFehlerModus2_03_XIX_BMC_HV: upstream-reference=Geltungsbereich_E3_1_2_Premium.RP_IF_UI1_KompFehlerModus2_03_XIX_BMC_HV, ecu-extract-reference=COMPOSITIONTYPE.RP_IF_UI1_KompFehlerModus2_03_XIX_BMC_HV
      UI1_KompFehlerModus2_04: upstream-reference=Geltungsbereich_E3_1_2_Premium.RP_IF_UI1_KompFehlerModus2_04_XIX_BMC_HV.DE_UI1_KompFehlerModus2_04, ecu-extract-reference=COMPOSITIONTYPE.RP_IF_UI1_KompFehlerModus2_04_XIX_BMC_HV.DE_UI1_KompFehlerModus2_04
      RP_IF_UI1_KompFehlerModus2_04_XIX_BMC_HV: upstream-reference=Geltungsbereich_E3_1_2_Premium.RP_IF_UI1_KompFehlerModus2_04_XIX_BMC_HV, ecu-extract-reference=COMPOSITIONTYPE.RP_IF_UI1_KompFehlerModus2_04_XIX_BMC_HV
      UI1_KompFehlerModus2_05: upstream-reference=Geltungsbereich_E3_1_2_Premium.RP_IF_UI1_KompFehlerModus2_05_XIX_BMC_HV.DE_UI1_KompFehlerModus2_05, ecu-extract-reference=COMPOSITIONTYPE.RP_IF_UI1_KompFehlerModus2_05_XIX_BMC_HV.DE_UI1_KompFehlerModus2_05
      RP_IF_UI1_KompFehlerModus2_05_XIX_BMC_HV: upstream-reference=Geltungsbereich_E3_1_2_Premium.RP_IF_UI1_KompFehlerModus2_05_XIX_BMC_HV, ecu-extract-reference=COMPOSITIONTYPE.RP_IF_UI1_KompFehlerModus2_05_XIX_BMC_HV
      UI1_KompFehlerModus2_06: upstream-reference=Geltungsbereich_E3_1_2_Premium.RP_IF_UI1_KompFehlerModus2_06_XIX_BMC_HV.DE_UI1_KompFehlerModus2_06, ecu-extract-reference=COMPOSITIONTYPE.RP_IF_UI1_KompFehlerModus2_06_XIX_BMC_HV.DE_UI1_KompFehlerModus2_06
      RP_IF_UI1_KompFehlerModus2_06_XIX_BMC_HV: upstream-reference=Geltungsbereich_E3_1_2_Premium.RP_IF_UI1_KompFehlerModus2_06_XIX_BMC_HV, ecu-extract-reference=COMPOSITIONTYPE.RP_IF_UI1_KompFehlerModus2_06_XIX_BMC_HV
      UI1_KompFehlerModus2_07: upstream-reference=Geltungsbereich_E3_1_2_Premium.RP_IF_UI1_KompFehlerModus2_07_XIX_BMC_HV.DE_UI1_KompFehlerModus2_07, ecu-extract-reference=COMPOSITIONTYPE.RP_IF_UI1_KompFehlerModus2_07_XIX_BMC_HV.DE_UI1_KompFehlerModus2_07
      RP_IF_UI1_KompFehlerModus2_07_XIX_BMC_HV: upstream-reference=Geltungsbereich_E3_1_2_Premium.RP_IF_UI1_KompFehlerModus2_07_XIX_BMC_HV, ecu-extract-reference=COMPOSITIONTYPE.RP_IF_UI1_KompFehlerModus2_07_XIX_BMC_HV
      UI1_KompFehlerModus2_08: upstream-reference=Geltungsbereich_E3_1_2_Premium.RP_IF_UI1_KompFehlerModus2_08_XIX_BMC_HV.DE_UI1_KompFehlerModus2_08, ecu-extract-reference=COMPOSITIONTYPE.RP_IF_UI1_KompFehlerModus2_08_XIX_BMC_HV.DE_UI1_KompFehlerModus2_08
      RP_IF_UI1_KompFehlerModus2_08_XIX_BMC_HV: upstream-reference=Geltungsbereich_E3_1_2_Premium.RP_IF_UI1_KompFehlerModus2_08_XIX_BMC_HV, ecu-extract-reference=COMPOSITIONTYPE.RP_IF_UI1_KompFehlerModus2_08_XIX_BMC_HV
      UI1_KompFehlerModus2_09: upstream-reference=Geltungsbereich_E3_1_2_Premium.RP_IF_UI1_KompFehlerModus2_09_XIX_BMC_HV.DE_UI1_KompFehlerModus2_09, ecu-extract-reference=COMPOSITIONTYPE.RP_IF_UI1_KompFehlerModus2_09_XIX_BMC_HV.DE_UI1_KompFehlerModus2_09
      RP_IF_UI1_KompFehlerModus2_09_XIX_BMC_HV: upstream-reference=Geltungsbereich_E3_1_2_Premium.RP_IF_UI1_KompFehlerModus2_09_XIX_BMC_HV, ecu-extract-reference=COMPOSITIONTYPE.RP_IF_UI1_KompFehlerModus2_09_XIX_BMC_HV
      UI1_KompFehlerModus2_10: upstream-reference=Geltungsbereich_E3_1_2_Premium.RP_IF_UI1_KompFehlerModus2_10_XIX_BMC_HV.DE_UI1_KompFehlerModus2_10, ecu-extract-reference=COMPOSITIONTYPE.RP_IF_UI1_KompFehlerModus2_10_XIX_BMC_HV.DE_UI1_KompFehlerModus2_10
      RP_IF_UI1_KompFehlerModus2_10_XIX_BMC_HV: upstream-reference=Geltungsbereich_E3_1_2_Premium.RP_IF_UI1_KompFehlerModus2_10_XIX_BMC_HV, ecu-extract-reference=COMPOSITIONTYPE.RP_IF_UI1_KompFehlerModus2_10_XIX_BMC_HV
      UI1_KompFehlerModus2_11: upstream-reference=Geltungsbereich_E3_1_2_Premium.RP_IF_UI1_KompFehlerModus2_11_XIX_BMC_HV.DE_UI1_KompFehlerModus2_11, ecu-extract-reference=COMPOSITIONTYPE.RP_IF_UI1_KompFehlerModus2_11_XIX_BMC_HV.DE_UI1_KompFehlerModus2_11
      RP_IF_UI1_KompFehlerModus2_11_XIX_BMC_HV: upstream-reference=Geltungsbereich_E3_1_2_Premium.RP_IF_UI1_KompFehlerModus2_11_XIX_BMC_HV, ecu-extract-reference=COMPOSITIONTYPE.RP_IF_UI1_KompFehlerModus2_11_XIX_BMC_HV
      UI1_KompFehlerModus2_12: upstream-reference=Geltungsbereich_E3_1_2_Premium.RP_IF_UI1_KompFehlerModus2_12_XIX_BMC_HV.DE_UI1_KompFehlerModus2_12, ecu-extract-reference=COMPOSITIONTYPE.RP_IF_UI1_KompFehlerModus2_12_XIX_BMC_HV.DE_UI1_KompFehlerModus2_12
      RP_IF_UI1_KompFehlerModus2_12_XIX_BMC_HV: upstream-reference=Geltungsbereich_E3_1_2_Premium.RP_IF_UI1_KompFehlerModus2_12_XIX_BMC_HV, ecu-extract-reference=COMPOSITIONTYPE.RP_IF_UI1_KompFehlerModus2_12_XIX_BMC_HV
      UI1_KompFehlerModus2_13: upstream-reference=Geltungsbereich_E3_1_2_Premium.RP_IF_UI1_KompFehlerModus2_13_XIX_BMC_HV.DE_UI1_KompFehlerModus2_13, ecu-extract-reference=COMPOSITIONTYPE.RP_IF_UI1_KompFehlerModus2_13_XIX_BMC_HV.DE_UI1_KompFehlerModus2_13
      RP_IF_UI1_KompFehlerModus2_13_XIX_BMC_HV: upstream-reference=Geltungsbereich_E3_1_2_Premium.RP_IF_UI1_KompFehlerModus2_13_XIX_BMC_HV, ecu-extract-reference=COMPOSITIONTYPE.RP_IF_UI1_KompFehlerModus2_13_XIX_BMC_HV
      UI1_KompFehlerModus2_14: upstream-reference=Geltungsbereich_E3_1_2_Premium.RP_IF_UI1_KompFehlerModus2_14_XIX_BMC_HV.DE_UI1_KompFehlerModus2_14, ecu-extract-reference=COMPOSITIONTYPE.RP_IF_UI1_KompFehlerModus2_14_XIX_BMC_HV.DE_UI1_KompFehlerModus2_14
      RP_IF_UI1_KompFehlerModus2_14_XIX_BMC_HV: upstream-reference=Geltungsbereich_E3_1_2_Premium.RP_IF_UI1_KompFehlerModus2_14_XIX_BMC_HV, ecu-extract-reference=COMPOSITIONTYPE.RP_IF_UI1_KompFehlerModus2_14_XIX_BMC_HV
      UI1_KompFehlerModus2_15: upstream-reference=Geltungsbereich_E3_1_2_Premium.RP_IF_UI1_KompFehlerModus2_15_XIX_BMC_HV.DE_UI1_KompFehlerModus2_15, ecu-extract-reference=COMPOSITIONTYPE.RP_IF_UI1_KompFehlerModus2_15_XIX_BMC_HV.DE_UI1_KompFehlerModus2_15
      RP_IF_UI1_KompFehlerModus2_15_XIX_BMC_HV: upstream-reference=Geltungsbereich_E3_1_2_Premium.RP_IF_UI1_KompFehlerModus2_15_XIX_BMC_HV, ecu-extract-reference=COMPOSITIONTYPE.RP_IF_UI1_KompFehlerModus2_15_XIX_BMC_HV
      UI1_KompFehlerModus2_16: upstream-reference=Geltungsbereich_E3_1_2_Premium.RP_IF_UI1_KompFehlerModus2_16_XIX_BMC_HV.DE_UI1_KompFehlerModus2_16, ecu-extract-reference=COMPOSITIONTYPE.RP_IF_UI1_KompFehlerModus2_16_XIX_BMC_HV.DE_UI1_KompFehlerModus2_16
      RP_IF_UI1_KompFehlerModus2_16_XIX_BMC_HV: upstream-reference=Geltungsbereich_E3_1_2_Premium.RP_IF_UI1_KompFehlerModus2_16_XIX_BMC_HV, ecu-extract-reference=COMPOSITIONTYPE.RP_IF_UI1_KompFehlerModus2_16_XIX_BMC_HV
      UI1_KompFehlerModus2_17: upstream-reference=Geltungsbereich_E3_1_2_Premium.RP_IF_UI1_KompFehlerModus2_17_XIX_BMC_HV.DE_UI1_KompFehlerModus2_17, ecu-extract-reference=COMPOSITIONTYPE.RP_IF_UI1_KompFehlerModus2_17_XIX_BMC_HV.DE_UI1_KompFehlerModus2_17
      RP_IF_UI1_KompFehlerModus2_17_XIX_BMC_HV: upstream-reference=Geltungsbereich_E3_1_2_Premium.RP_IF_UI1_KompFehlerModus2_17_XIX_BMC_HV, ecu-extract-reference=COMPOSITIONTYPE.RP_IF_UI1_KompFehlerModus2_17_XIX_BMC_HV
      UI1_KompFehlerModus2_18: upstream-reference=Geltungsbereich_E3_1_2_Premium.RP_IF_UI1_KompFehlerModus2_18_XIX_BMC_HV.DE_UI1_KompFehlerModus2_18, ecu-extract-reference=COMPOSITIONTYPE.RP_IF_UI1_KompFehlerModus2_18_XIX_BMC_HV.DE_UI1_KompFehlerModus2_18
      RP_IF_UI1_KompFehlerModus2_18_XIX_BMC_HV: upstream-reference=Geltungsbereich_E3_1_2_Premium.RP_IF_UI1_KompFehlerModus2_18_XIX_BMC_HV, ecu-extract-reference=COMPOSITIONTYPE.RP_IF_UI1_KompFehlerModus2_18_XIX_BMC_HV
      UI1_KompFehlerModus2_19: upstream-reference=Geltungsbereich_E3_1_2_Premium.RP_IF_UI1_KompFehlerModus2_19_XIX_BMC_HV.DE_UI1_KompFehlerModus2_19, ecu-extract-reference=COMPOSITIONTYPE.RP_IF_UI1_KompFehlerModus2_19_XIX_BMC_HV.DE_UI1_KompFehlerModus2_19
      RP_IF_UI1_KompFehlerModus2_19_XIX_BMC_HV: upstream-reference=Geltungsbereich_E3_1_2_Premium.RP_IF_UI1_KompFehlerModus2_19_XIX_BMC_HV, ecu-extract-reference=COMPOSITIONTYPE.RP_IF_UI1_KompFehlerModus2_19_XIX_BMC_HV
      UI1_KompFehlerModus2_20: upstream-reference=Geltungsbereich_E3_1_2_Premium.RP_IF_UI1_KompFehlerModus2_20_XIX_BMC_HV.DE_UI1_KompFehlerModus2_20, ecu-extract-reference=COMPOSITIONTYPE.RP_IF_UI1_KompFehlerModus2_20_XIX_BMC_HV.DE_UI1_KompFehlerModus2_20
      RP_IF_UI1_KompFehlerModus2_20_XIX_BMC_HV: upstream-reference=Geltungsbereich_E3_1_2_Premium.RP_IF_UI1_KompFehlerModus2_20_XIX_BMC_HV, ecu-extract-reference=COMPOSITIONTYPE.RP_IF_UI1_KompFehlerModus2_20_XIX_BMC_HV
      UI1_KompFehlerModus2_21: upstream-reference=Geltungsbereich_E3_1_2_Premium.RP_IF_UI1_KompFehlerModus2_21_XIX_BMC_HV.DE_UI1_KompFehlerModus2_21, ecu-extract-reference=COMPOSITIONTYPE.RP_IF_UI1_KompFehlerModus2_21_XIX_BMC_HV.DE_UI1_KompFehlerModus2_21
      RP_IF_UI1_KompFehlerModus2_21_XIX_BMC_HV: upstream-reference=Geltungsbereich_E3_1_2_Premium.RP_IF_UI1_KompFehlerModus2_21_XIX_BMC_HV, ecu-extract-reference=COMPOSITIONTYPE.RP_IF_UI1_KompFehlerModus2_21_XIX_BMC_HV
      UI1_KompFehlerModus2_22: upstream-reference=Geltungsbereich_E3_1_2_Premium.RP_IF_UI1_KompFehlerModus2_22_XIX_BMC_HV.DE_UI1_KompFehlerModus2_22, ecu-extract-reference=COMPOSITIONTYPE.RP_IF_UI1_KompFehlerModus2_22_XIX_BMC_HV.DE_UI1_KompFehlerModus2_22
      RP_IF_UI1_KompFehlerModus2_22_XIX_BMC_HV: upstream-reference=Geltungsbereich_E3_1_2_Premium.RP_IF_UI1_KompFehlerModus2_22_XIX_BMC_HV, ecu-extract-reference=COMPOSITIONTYPE.RP_IF_UI1_KompFehlerModus2_22_XIX_BMC_HV
      UI1_KompFehlerModus2_23: upstream-reference=Geltungsbereich_E3_1_2_Premium.RP_IF_UI1_KompFehlerModus2_23_XIX_BMC_HV.DE_UI1_KompFehlerModus2_23, ecu-extract-reference=COMPOSITIONTYPE.RP_IF_UI1_KompFehlerModus2_23_XIX_BMC_HV.DE_UI1_KompFehlerModus2_23
      RP_IF_UI1_KompFehlerModus2_23_XIX_BMC_HV: upstream-reference=Geltungsbereich_E3_1_2_Premium.RP_IF_UI1_KompFehlerModus2_23_XIX_BMC_HV, ecu-extract-reference=COMPOSITIONTYPE.RP_IF_UI1_KompFehlerModus2_23_XIX_BMC_HV
      UI1_KompFehlerModus2_24: upstream-reference=Geltungsbereich_E3_1_2_Premium.RP_IF_UI1_KompFehlerModus2_24_XIX_BMC_HV.DE_UI1_KompFehlerModus2_24, ecu-extract-reference=COMPOSITIONTYPE.RP_IF_UI1_KompFehlerModus2_24_XIX_BMC_HV.DE_UI1_KompFehlerModus2_24
      RP_IF_UI1_KompFehlerModus2_24_XIX_BMC_HV: upstream-reference=Geltungsbereich_E3_1_2_Premium.RP_IF_UI1_KompFehlerModus2_24_XIX_BMC_HV, ecu-extract-reference=COMPOSITIONTYPE.RP_IF_UI1_KompFehlerModus2_24_XIX_BMC_HV
      UI1_KompFehlerModus2_25: upstream-reference=Geltungsbereich_E3_1_2_Premium.RP_IF_UI1_KompFehlerModus2_25_XIX_BMC_HV.DE_UI1_KompFehlerModus2_25, ecu-extract-reference=COMPOSITIONTYPE.RP_IF_UI1_KompFehlerModus2_25_XIX_BMC_HV.DE_UI1_KompFehlerModus2_25
      RP_IF_UI1_KompFehlerModus2_25_XIX_BMC_HV: upstream-reference=Geltungsbereich_E3_1_2_Premium.RP_IF_UI1_KompFehlerModus2_25_XIX_BMC_HV, ecu-extract-reference=COMPOSITIONTYPE.RP_IF_UI1_KompFehlerModus2_25_XIX_BMC_HV
      UI1_KompFehlerModus2_26: upstream-reference=Geltungsbereich_E3_1_2_Premium.RP_IF_UI1_KompFehlerModus2_26_XIX_BMC_HV.DE_UI1_KompFehlerModus2_26, ecu-extract-reference=COMPOSITIONTYPE.RP_IF_UI1_KompFehlerModus2_26_XIX_BMC_HV.DE_UI1_KompFehlerModus2_26
      RP_IF_UI1_KompFehlerModus2_26_XIX_BMC_HV: upstream-reference=Geltungsbereich_E3_1_2_Premium.RP_IF_UI1_KompFehlerModus2_26_XIX_BMC_HV, ecu-extract-reference=COMPOSITIONTYPE.RP_IF_UI1_KompFehlerModus2_26_XIX_BMC_HV
      UI1_KompFehlerModus4_01: upstream-reference=Geltungsbereich_E3_1_2_Premium.RP_IF_UI1_KompFehlerModus4_01_XIX_BMC_HV.DE_UI1_KompFehlerModus4_01, ecu-extract-reference=COMPOSITIONTYPE.RP_IF_UI1_KompFehlerModus4_01_XIX_BMC_HV.DE_UI1_KompFehlerModus4_01
      RP_IF_UI1_KompFehlerModus4_01_XIX_BMC_HV: upstream-reference=Geltungsbereich_E3_1_2_Premium.RP_IF_UI1_KompFehlerModus4_01_XIX_BMC_HV, ecu-extract-reference=COMPOSITIONTYPE.RP_IF_UI1_KompFehlerModus4_01_XIX_BMC_HV
      UI1_KompFehlerModus4_02: upstream-reference=Geltungsbereich_E3_1_2_Premium.RP_IF_UI1_KompFehlerModus4_02_XIX_BMC_HV.DE_UI1_KompFehlerModus4_02, ecu-extract-reference=COMPOSITIONTYPE.RP_IF_UI1_KompFehlerModus4_02_XIX_BMC_HV.DE_UI1_KompFehlerModus4_02
      RP_IF_UI1_KompFehlerModus4_02_XIX_BMC_HV: upstream-reference=Geltungsbereich_E3_1_2_Premium.RP_IF_UI1_KompFehlerModus4_02_XIX_BMC_HV, ecu-extract-reference=COMPOSITIONTYPE.RP_IF_UI1_KompFehlerModus4_02_XIX_BMC_HV
      UI1_KompFehlerModus4_03: upstream-reference=Geltungsbereich_E3_1_2_Premium.RP_IF_UI1_KompFehlerModus4_03_XIX_BMC_HV.DE_UI1_KompFehlerModus4_03, ecu-extract-reference=COMPOSITIONTYPE.RP_IF_UI1_KompFehlerModus4_03_XIX_BMC_HV.DE_UI1_KompFehlerModus4_03
      RP_IF_UI1_KompFehlerModus4_03_XIX_BMC_HV: upstream-reference=Geltungsbereich_E3_1_2_Premium.RP_IF_UI1_KompFehlerModus4_03_XIX_BMC_HV, ecu-extract-reference=COMPOSITIONTYPE.RP_IF_UI1_KompFehlerModus4_03_XIX_BMC_HV
      UI1_KompFehlerModus4_04: upstream-reference=Geltungsbereich_E3_1_2_Premium.RP_IF_UI1_KompFehlerModus4_04_XIX_BMC_HV.DE_UI1_KompFehlerModus4_04, ecu-extract-reference=COMPOSITIONTYPE.RP_IF_UI1_KompFehlerModus4_04_XIX_BMC_HV.DE_UI1_KompFehlerModus4_04
      RP_IF_UI1_KompFehlerModus4_04_XIX_BMC_HV: upstream-reference=Geltungsbereich_E3_1_2_Premium.RP_IF_UI1_KompFehlerModus4_04_XIX_BMC_HV, ecu-extract-reference=COMPOSITIONTYPE.RP_IF_UI1_KompFehlerModus4_04_XIX_BMC_HV
      UI1_KompFehlerModus4_05: upstream-reference=Geltungsbereich_E3_1_2_Premium.RP_IF_UI1_KompFehlerModus4_05_XIX_BMC_HV.DE_UI1_KompFehlerModus4_05, ecu-extract-reference=COMPOSITIONTYPE.RP_IF_UI1_KompFehlerModus4_05_XIX_BMC_HV.DE_UI1_KompFehlerModus4_05
      RP_IF_UI1_KompFehlerModus4_05_XIX_BMC_HV: upstream-reference=Geltungsbereich_E3_1_2_Premium.RP_IF_UI1_KompFehlerModus4_05_XIX_BMC_HV, ecu-extract-reference=COMPOSITIONTYPE.RP_IF_UI1_KompFehlerModus4_05_XIX_BMC_HV
      UI1_KompFehlerModus4_06: upstream-reference=Geltungsbereich_E3_1_2_Premium.RP_IF_UI1_KompFehlerModus4_06_XIX_BMC_HV.DE_UI1_KompFehlerModus4_06, ecu-extract-reference=COMPOSITIONTYPE.RP_IF_UI1_KompFehlerModus4_06_XIX_BMC_HV.DE_UI1_KompFehlerModus4_06
      RP_IF_UI1_KompFehlerModus4_06_XIX_BMC_HV: upstream-reference=Geltungsbereich_E3_1_2_Premium.RP_IF_UI1_KompFehlerModus4_06_XIX_BMC_HV, ecu-extract-reference=COMPOSITIONTYPE.RP_IF_UI1_KompFehlerModus4_06_XIX_BMC_HV
      UI1_KompFehlerModus4_07: upstream-reference=Geltungsbereich_E3_1_2_Premium.RP_IF_UI1_KompFehlerModus4_07_XIX_BMC_HV.DE_UI1_KompFehlerModus4_07, ecu-extract-reference=COMPOSITIONTYPE.RP_IF_UI1_KompFehlerModus4_07_XIX_BMC_HV.DE_UI1_KompFehlerModus4_07
      RP_IF_UI1_KompFehlerModus4_07_XIX_BMC_HV: upstream-reference=Geltungsbereich_E3_1_2_Premium.RP_IF_UI1_KompFehlerModus4_07_XIX_BMC_HV, ecu-extract-reference=COMPOSITIONTYPE.RP_IF_UI1_KompFehlerModus4_07_XIX_BMC_HV
      UI1_KompFehlerModus4_08: upstream-reference=Geltungsbereich_E3_1_2_Premium.RP_IF_UI1_KompFehlerModus4_08_XIX_BMC_HV.DE_UI1_KompFehlerModus4_08, ecu-extract-reference=COMPOSITIONTYPE.RP_IF_UI1_KompFehlerModus4_08_XIX_BMC_HV.DE_UI1_KompFehlerModus4_08
      RP_IF_UI1_KompFehlerModus4_08_XIX_BMC_HV: upstream-reference=Geltungsbereich_E3_1_2_Premium.RP_IF_UI1_KompFehlerModus4_08_XIX_BMC_HV, ecu-extract-reference=COMPOSITIONTYPE.RP_IF_UI1_KompFehlerModus4_08_XIX_BMC_HV
      UI1_KompFehlerModus4_09: upstream-reference=Geltungsbereich_E3_1_2_Premium.RP_IF_UI1_KompFehlerModus4_09_XIX_BMC_HV.DE_UI1_KompFehlerModus4_09, ecu-extract-reference=COMPOSITIONTYPE.RP_IF_UI1_KompFehlerModus4_09_XIX_BMC_HV.DE_UI1_KompFehlerModus4_09
      RP_IF_UI1_KompFehlerModus4_09_XIX_BMC_HV: upstream-reference=Geltungsbereich_E3_1_2_Premium.RP_IF_UI1_KompFehlerModus4_09_XIX_BMC_HV, ecu-extract-reference=COMPOSITIONTYPE.RP_IF_UI1_KompFehlerModus4_09_XIX_BMC_HV
      UI1_KompFehlerModus4_10: upstream-reference=Geltungsbereich_E3_1_2_Premium.RP_IF_UI1_KompFehlerModus4_10_XIX_BMC_HV.DE_UI1_KompFehlerModus4_10, ecu-extract-reference=COMPOSITIONTYPE.RP_IF_UI1_KompFehlerModus4_10_XIX_BMC_HV.DE_UI1_KompFehlerModus4_10
      RP_IF_UI1_KompFehlerModus4_10_XIX_BMC_HV: upstream-reference=Geltungsbereich_E3_1_2_Premium.RP_IF_UI1_KompFehlerModus4_10_XIX_BMC_HV, ecu-extract-reference=COMPOSITIONTYPE.RP_IF_UI1_KompFehlerModus4_10_XIX_BMC_HV
      UI1_KompFehlerModus4_11: upstream-reference=Geltungsbereich_E3_1_2_Premium.RP_IF_UI1_KompFehlerModus4_11_XIX_BMC_HV.DE_UI1_KompFehlerModus4_11, ecu-extract-reference=COMPOSITIONTYPE.RP_IF_UI1_KompFehlerModus4_11_XIX_BMC_HV.DE_UI1_KompFehlerModus4_11
      RP_IF_UI1_KompFehlerModus4_11_XIX_BMC_HV: upstream-reference=Geltungsbereich_E3_1_2_Premium.RP_IF_UI1_KompFehlerModus4_11_XIX_BMC_HV, ecu-extract-reference=COMPOSITIONTYPE.RP_IF_UI1_KompFehlerModus4_11_XIX_BMC_HV
      UI1_KompFehlerModus4_12: upstream-reference=Geltungsbereich_E3_1_2_Premium.RP_IF_UI1_KompFehlerModus4_12_XIX_BMC_HV.DE_UI1_KompFehlerModus4_12, ecu-extract-reference=COMPOSITIONTYPE.RP_IF_UI1_KompFehlerModus4_12_XIX_BMC_HV.DE_UI1_KompFehlerModus4_12
      RP_IF_UI1_KompFehlerModus4_12_XIX_BMC_HV: upstream-reference=Geltungsbereich_E3_1_2_Premium.RP_IF_UI1_KompFehlerModus4_12_XIX_BMC_HV, ecu-extract-reference=COMPOSITIONTYPE.RP_IF_UI1_KompFehlerModus4_12_XIX_BMC_HV
      UI1_KompFehlerModus4_13: upstream-reference=Geltungsbereich_E3_1_2_Premium.RP_IF_UI1_KompFehlerModus4_13_XIX_BMC_HV.DE_UI1_KompFehlerModus4_13, ecu-extract-reference=COMPOSITIONTYPE.RP_IF_UI1_KompFehlerModus4_13_XIX_BMC_HV.DE_UI1_KompFehlerModus4_13
      RP_IF_UI1_KompFehlerModus4_13_XIX_BMC_HV: upstream-reference=Geltungsbereich_E3_1_2_Premium.RP_IF_UI1_KompFehlerModus4_13_XIX_BMC_HV, ecu-extract-reference=COMPOSITIONTYPE.RP_IF_UI1_KompFehlerModus4_13_XIX_BMC_HV
      UI1_KompFehlerModus4_14: upstream-reference=Geltungsbereich_E3_1_2_Premium.RP_IF_UI1_KompFehlerModus4_14_XIX_BMC_HV.DE_UI1_KompFehlerModus4_14, ecu-extract-reference=COMPOSITIONTYPE.RP_IF_UI1_KompFehlerModus4_14_XIX_BMC_HV.DE_UI1_KompFehlerModus4_14
      RP_IF_UI1_KompFehlerModus4_14_XIX_BMC_HV: upstream-reference=Geltungsbereich_E3_1_2_Premium.RP_IF_UI1_KompFehlerModus4_14_XIX_BMC_HV, ecu-extract-reference=COMPOSITIONTYPE.RP_IF_UI1_KompFehlerModus4_14_XIX_BMC_HV
      UI1_KompFehlerModus4_15: upstream-reference=Geltungsbereich_E3_1_2_Premium.RP_IF_UI1_KompFehlerModus4_15_XIX_BMC_HV.DE_UI1_KompFehlerModus4_15, ecu-extract-reference=COMPOSITIONTYPE.RP_IF_UI1_KompFehlerModus4_15_XIX_BMC_HV.DE_UI1_KompFehlerModus4_15
      RP_IF_UI1_KompFehlerModus4_15_XIX_BMC_HV: upstream-reference=Geltungsbereich_E3_1_2_Premium.RP_IF_UI1_KompFehlerModus4_15_XIX_BMC_HV, ecu-extract-reference=COMPOSITIONTYPE.RP_IF_UI1_KompFehlerModus4_15_XIX_BMC_HV
      UI1_KompFehlerModus4_16: upstream-reference=Geltungsbereich_E3_1_2_Premium.RP_IF_UI1_KompFehlerModus4_16_XIX_BMC_HV.DE_UI1_KompFehlerModus4_16, ecu-extract-reference=COMPOSITIONTYPE.RP_IF_UI1_KompFehlerModus4_16_XIX_BMC_HV.DE_UI1_KompFehlerModus4_16
      RP_IF_UI1_KompFehlerModus4_16_XIX_BMC_HV: upstream-reference=Geltungsbereich_E3_1_2_Premium.RP_IF_UI1_KompFehlerModus4_16_XIX_BMC_HV, ecu-extract-reference=COMPOSITIONTYPE.RP_IF_UI1_KompFehlerModus4_16_XIX_BMC_HV
      UI1_Spannung4: upstream-reference=Geltungsbereich_E3_1_2_Premium.RP_IF_UI1_Spannung4_XIX_BMC_HV.DE_UI1_Spannung4, ecu-extract-reference=COMPOSITIONTYPE.RP_IF_UI1_Spannung4_XIX_BMC_HV.DE_UI1_Spannung4
      RP_IF_UI1_Spannung4_XIX_BMC_HV: upstream-reference=Geltungsbereich_E3_1_2_Premium.RP_IF_UI1_Spannung4_XIX_BMC_HV, ecu-extract-reference=COMPOSITIONTYPE.RP_IF_UI1_Spannung4_XIX_BMC_HV
      UI1_Spannung5: upstream-reference=Geltungsbereich_E3_1_2_Premium.RP_IF_UI1_Spannung5_XIX_BMC_HV.DE_UI1_Spannung5, ecu-extract-reference=COMPOSITIONTYPE.RP_IF_UI1_Spannung5_XIX_BMC_HV.DE_UI1_Spannung5
      RP_IF_UI1_Spannung5_XIX_BMC_HV: upstream-reference=Geltungsbereich_E3_1_2_Premium.RP_IF_UI1_Spannung5_XIX_BMC_HV, ecu-extract-reference=COMPOSITIONTYPE.RP_IF_UI1_Spannung5_XIX_BMC_HV
      UI1_Spannung6: upstream-reference=Geltungsbereich_E3_1_2_Premium.RP_IF_UI1_Spannung6_XIX_BMC_HV.DE_UI1_Spannung6, ecu-extract-reference=COMPOSITIONTYPE.RP_IF_UI1_Spannung6_XIX_BMC_HV.DE_UI1_Spannung6
      RP_IF_UI1_Spannung6_XIX_BMC_HV: upstream-reference=Geltungsbereich_E3_1_2_Premium.RP_IF_UI1_Spannung6_XIX_BMC_HV, ecu-extract-reference=COMPOSITIONTYPE.RP_IF_UI1_Spannung6_XIX_BMC_HV
      UI1_Status: upstream-reference=Geltungsbereich_E3_1_2_Premium.RP_IF_UI1_Status_XIX_BMC_HV.DE_UI1_Status, ecu-extract-reference=COMPOSITIONTYPE.RP_IF_UI1_Status_XIX_BMC_HV.DE_UI1_Status
      RP_IF_UI1_Status_XIX_BMC_HV: upstream-reference=Geltungsbereich_E3_1_2_Premium.RP_IF_UI1_Status_XIX_BMC_HV, ecu-extract-reference=COMPOSITIONTYPE.RP_IF_UI1_Status_XIX_BMC_HV
      UI1_Stromintegral_Entladen: upstream-reference=Geltungsbereich_E3_1_2_Premium.RP_IF_UI1_Stromintegral_Entladen_XIX_BMC_HV.DE_UI1_Stromintegral_Entladen, ecu-extract-reference=COMPOSITIONTYPE.RP_IF_UI1_Stromintegral_Entladen_XIX_BMC_HV.DE_UI1_Stromintegral_Entladen
      RP_IF_UI1_Stromintegral_Entladen_XIX_BMC_HV: upstream-reference=Geltungsbereich_E3_1_2_Premium.RP_IF_UI1_Stromintegral_Entladen_XIX_BMC_HV, ecu-extract-reference=COMPOSITIONTYPE.RP_IF_UI1_Stromintegral_Entladen_XIX_BMC_HV
      UI1_Stromintegral_Laden: upstream-reference=Geltungsbereich_E3_1_2_Premium.RP_IF_UI1_Stromintegral_Laden_XIX_BMC_HV.DE_UI1_Stromintegral_Laden, ecu-extract-reference=COMPOSITIONTYPE.RP_IF_UI1_Stromintegral_Laden_XIX_BMC_HV.DE_UI1_Stromintegral_Laden
      RP_IF_UI1_Stromintegral_Laden_XIX_BMC_HV: upstream-reference=Geltungsbereich_E3_1_2_Premium.RP_IF_UI1_Stromintegral_Laden_XIX_BMC_HV, ecu-extract-reference=COMPOSITIONTYPE.RP_IF_UI1_Stromintegral_Laden_XIX_BMC_HV
      UI1_Temperatur_1: upstream-reference=Geltungsbereich_E3_1_2_Premium.RP_IF_UI1_Temperatur_1_XIX_BMC_HV.DE_UI1_Temperatur_1, ecu-extract-reference=COMPOSITIONTYPE.RP_IF_UI1_Temperatur_1_XIX_BMC_HV.DE_UI1_Temperatur_1
      RP_IF_UI1_Temperatur_1_XIX_BMC_HV: upstream-reference=Geltungsbereich_E3_1_2_Premium.RP_IF_UI1_Temperatur_1_XIX_BMC_HV, ecu-extract-reference=COMPOSITIONTYPE.RP_IF_UI1_Temperatur_1_XIX_BMC_HV
      UI1_Temperatur_2: upstream-reference=Geltungsbereich_E3_1_2_Premium.RP_IF_UI1_Temperatur_2_XIX_BMC_HV.DE_UI1_Temperatur_2, ecu-extract-reference=COMPOSITIONTYPE.RP_IF_UI1_Temperatur_2_XIX_BMC_HV.DE_UI1_Temperatur_2
      RP_IF_UI1_Temperatur_2_XIX_BMC_HV: upstream-reference=Geltungsbereich_E3_1_2_Premium.RP_IF_UI1_Temperatur_2_XIX_BMC_HV, ecu-extract-reference=COMPOSITIONTYPE.RP_IF_UI1_Temperatur_2_XIX_BMC_HV
      UI2_KompFehlerModus2_01: upstream-reference=Geltungsbereich_E3_1_2_Premium.RP_IF_UI2_KompFehlerModus2_01_XIX_BMC_HV.DE_UI2_KompFehlerModus2_01, ecu-extract-reference=COMPOSITIONTYPE.RP_IF_UI2_KompFehlerModus2_01_XIX_BMC_HV.DE_UI2_KompFehlerModus2_01
      RP_IF_UI2_KompFehlerModus2_01_XIX_BMC_HV: upstream-reference=Geltungsbereich_E3_1_2_Premium.RP_IF_UI2_KompFehlerModus2_01_XIX_BMC_HV, ecu-extract-reference=COMPOSITIONTYPE.RP_IF_UI2_KompFehlerModus2_01_XIX_BMC_HV
      UI2_KompFehlerModus2_02: upstream-reference=Geltungsbereich_E3_1_2_Premium.RP_IF_UI2_KompFehlerModus2_02_XIX_BMC_HV.DE_UI2_KompFehlerModus2_02, ecu-extract-reference=COMPOSITIONTYPE.RP_IF_UI2_KompFehlerModus2_02_XIX_BMC_HV.DE_UI2_KompFehlerModus2_02
      RP_IF_UI2_KompFehlerModus2_02_XIX_BMC_HV: upstream-reference=Geltungsbereich_E3_1_2_Premium.RP_IF_UI2_KompFehlerModus2_02_XIX_BMC_HV, ecu-extract-reference=COMPOSITIONTYPE.RP_IF_UI2_KompFehlerModus2_02_XIX_BMC_HV
      UI2_KompFehlerModus2_03: upstream-reference=Geltungsbereich_E3_1_2_Premium.RP_IF_UI2_KompFehlerModus2_03_XIX_BMC_HV.DE_UI2_KompFehlerModus2_03, ecu-extract-reference=COMPOSITIONTYPE.RP_IF_UI2_KompFehlerModus2_03_XIX_BMC_HV.DE_UI2_KompFehlerModus2_03
      RP_IF_UI2_KompFehlerModus2_03_XIX_BMC_HV: upstream-reference=Geltungsbereich_E3_1_2_Premium.RP_IF_UI2_KompFehlerModus2_03_XIX_BMC_HV, ecu-extract-reference=COMPOSITIONTYPE.RP_IF_UI2_KompFehlerModus2_03_XIX_BMC_HV
      UI2_KompFehlerModus2_04: upstream-reference=Geltungsbereich_E3_1_2_Premium.RP_IF_UI2_KompFehlerModus2_04_XIX_BMC_HV.DE_UI2_KompFehlerModus2_04, ecu-extract-reference=COMPOSITIONTYPE.RP_IF_UI2_KompFehlerModus2_04_XIX_BMC_HV.DE_UI2_KompFehlerModus2_04
      RP_IF_UI2_KompFehlerModus2_04_XIX_BMC_HV: upstream-reference=Geltungsbereich_E3_1_2_Premium.RP_IF_UI2_KompFehlerModus2_04_XIX_BMC_HV, ecu-extract-reference=COMPOSITIONTYPE.RP_IF_UI2_KompFehlerModus2_04_XIX_BMC_HV
      UI2_KompFehlerModus2_05: upstream-reference=Geltungsbereich_E3_1_2_Premium.RP_IF_UI2_KompFehlerModus2_05_XIX_BMC_HV.DE_UI2_KompFehlerModus2_05, ecu-extract-reference=COMPOSITIONTYPE.RP_IF_UI2_KompFehlerModus2_05_XIX_BMC_HV.DE_UI2_KompFehlerModus2_05
      RP_IF_UI2_KompFehlerModus2_05_XIX_BMC_HV: upstream-reference=Geltungsbereich_E3_1_2_Premium.RP_IF_UI2_KompFehlerModus2_05_XIX_BMC_HV, ecu-extract-reference=COMPOSITIONTYPE.RP_IF_UI2_KompFehlerModus2_05_XIX_BMC_HV
      UI2_KompFehlerModus2_06: upstream-reference=Geltungsbereich_E3_1_2_Premium.RP_IF_UI2_KompFehlerModus2_06_XIX_BMC_HV.DE_UI2_KompFehlerModus2_06, ecu-extract-reference=COMPOSITIONTYPE.RP_IF_UI2_KompFehlerModus2_06_XIX_BMC_HV.DE_UI2_KompFehlerModus2_06
      RP_IF_UI2_KompFehlerModus2_06_XIX_BMC_HV: upstream-reference=Geltungsbereich_E3_1_2_Premium.RP_IF_UI2_KompFehlerModus2_06_XIX_BMC_HV, ecu-extract-reference=COMPOSITIONTYPE.RP_IF_UI2_KompFehlerModus2_06_XIX_BMC_HV
      UI2_KompFehlerModus2_07: upstream-reference=Geltungsbereich_E3_1_2_Premium.RP_IF_UI2_KompFehlerModus2_07_XIX_BMC_HV.DE_UI2_KompFehlerModus2_07, ecu-extract-reference=COMPOSITIONTYPE.RP_IF_UI2_KompFehlerModus2_07_XIX_BMC_HV.DE_UI2_KompFehlerModus2_07
      RP_IF_UI2_KompFehlerModus2_07_XIX_BMC_HV: upstream-reference=Geltungsbereich_E3_1_2_Premium.RP_IF_UI2_KompFehlerModus2_07_XIX_BMC_HV, ecu-extract-reference=COMPOSITIONTYPE.RP_IF_UI2_KompFehlerModus2_07_XIX_BMC_HV
      UI2_KompFehlerModus2_08: upstream-reference=Geltungsbereich_E3_1_2_Premium.RP_IF_UI2_KompFehlerModus2_08_XIX_BMC_HV.DE_UI2_KompFehlerModus2_08, ecu-extract-reference=COMPOSITIONTYPE.RP_IF_UI2_KompFehlerModus2_08_XIX_BMC_HV.DE_UI2_KompFehlerModus2_08
      RP_IF_UI2_KompFehlerModus2_08_XIX_BMC_HV: upstream-reference=Geltungsbereich_E3_1_2_Premium.RP_IF_UI2_KompFehlerModus2_08_XIX_BMC_HV, ecu-extract-reference=COMPOSITIONTYPE.RP_IF_UI2_KompFehlerModus2_08_XIX_BMC_HV
      UI2_KompFehlerModus2_09: upstream-reference=Geltungsbereich_E3_1_2_Premium.RP_IF_UI2_KompFehlerModus2_09_XIX_BMC_HV.DE_UI2_KompFehlerModus2_09, ecu-extract-reference=COMPOSITIONTYPE.RP_IF_UI2_KompFehlerModus2_09_XIX_BMC_HV.DE_UI2_KompFehlerModus2_09
      RP_IF_UI2_KompFehlerModus2_09_XIX_BMC_HV: upstream-reference=Geltungsbereich_E3_1_2_Premium.RP_IF_UI2_KompFehlerModus2_09_XIX_BMC_HV, ecu-extract-reference=COMPOSITIONTYPE.RP_IF_UI2_KompFehlerModus2_09_XIX_BMC_HV
      UI2_KompFehlerModus2_10: upstream-reference=Geltungsbereich_E3_1_2_Premium.RP_IF_UI2_KompFehlerModus2_10_XIX_BMC_HV.DE_UI2_KompFehlerModus2_10, ecu-extract-reference=COMPOSITIONTYPE.RP_IF_UI2_KompFehlerModus2_10_XIX_BMC_HV.DE_UI2_KompFehlerModus2_10
      RP_IF_UI2_KompFehlerModus2_10_XIX_BMC_HV: upstream-reference=Geltungsbereich_E3_1_2_Premium.RP_IF_UI2_KompFehlerModus2_10_XIX_BMC_HV, ecu-extract-reference=COMPOSITIONTYPE.RP_IF_UI2_KompFehlerModus2_10_XIX_BMC_HV
      UI2_KompFehlerModus2_11: upstream-reference=Geltungsbereich_E3_1_2_Premium.RP_IF_UI2_KompFehlerModus2_11_XIX_BMC_HV.DE_UI2_KompFehlerModus2_11, ecu-extract-reference=COMPOSITIONTYPE.RP_IF_UI2_KompFehlerModus2_11_XIX_BMC_HV.DE_UI2_KompFehlerModus2_11
      RP_IF_UI2_KompFehlerModus2_11_XIX_BMC_HV: upstream-reference=Geltungsbereich_E3_1_2_Premium.RP_IF_UI2_KompFehlerModus2_11_XIX_BMC_HV, ecu-extract-reference=COMPOSITIONTYPE.RP_IF_UI2_KompFehlerModus2_11_XIX_BMC_HV
      UI2_KompFehlerModus2_12: upstream-reference=Geltungsbereich_E3_1_2_Premium.RP_IF_UI2_KompFehlerModus2_12_XIX_BMC_HV.DE_UI2_KompFehlerModus2_12, ecu-extract-reference=COMPOSITIONTYPE.RP_IF_UI2_KompFehlerModus2_12_XIX_BMC_HV.DE_UI2_KompFehlerModus2_12
      RP_IF_UI2_KompFehlerModus2_12_XIX_BMC_HV: upstream-reference=Geltungsbereich_E3_1_2_Premium.RP_IF_UI2_KompFehlerModus2_12_XIX_BMC_HV, ecu-extract-reference=COMPOSITIONTYPE.RP_IF_UI2_KompFehlerModus2_12_XIX_BMC_HV
      UI2_KompFehlerModus2_13: upstream-reference=Geltungsbereich_E3_1_2_Premium.RP_IF_UI2_KompFehlerModus2_13_XIX_BMC_HV.DE_UI2_KompFehlerModus2_13, ecu-extract-reference=COMPOSITIONTYPE.RP_IF_UI2_KompFehlerModus2_13_XIX_BMC_HV.DE_UI2_KompFehlerModus2_13
      RP_IF_UI2_KompFehlerModus2_13_XIX_BMC_HV: upstream-reference=Geltungsbereich_E3_1_2_Premium.RP_IF_UI2_KompFehlerModus2_13_XIX_BMC_HV, ecu-extract-reference=COMPOSITIONTYPE.RP_IF_UI2_KompFehlerModus2_13_XIX_BMC_HV
      UI2_KompFehlerModus2_14: upstream-reference=Geltungsbereich_E3_1_2_Premium.RP_IF_UI2_KompFehlerModus2_14_XIX_BMC_HV.DE_UI2_KompFehlerModus2_14, ecu-extract-reference=COMPOSITIONTYPE.RP_IF_UI2_KompFehlerModus2_14_XIX_BMC_HV.DE_UI2_KompFehlerModus2_14
      RP_IF_UI2_KompFehlerModus2_14_XIX_BMC_HV: upstream-reference=Geltungsbereich_E3_1_2_Premium.RP_IF_UI2_KompFehlerModus2_14_XIX_BMC_HV, ecu-extract-reference=COMPOSITIONTYPE.RP_IF_UI2_KompFehlerModus2_14_XIX_BMC_HV
      UI2_KompFehlerModus2_15: upstream-reference=Geltungsbereich_E3_1_2_Premium.RP_IF_UI2_KompFehlerModus2_15_XIX_BMC_HV.DE_UI2_KompFehlerModus2_15, ecu-extract-reference=COMPOSITIONTYPE.RP_IF_UI2_KompFehlerModus2_15_XIX_BMC_HV.DE_UI2_KompFehlerModus2_15
      RP_IF_UI2_KompFehlerModus2_15_XIX_BMC_HV: upstream-reference=Geltungsbereich_E3_1_2_Premium.RP_IF_UI2_KompFehlerModus2_15_XIX_BMC_HV, ecu-extract-reference=COMPOSITIONTYPE.RP_IF_UI2_KompFehlerModus2_15_XIX_BMC_HV
      UI2_KompFehlerModus2_16: upstream-reference=Geltungsbereich_E3_1_2_Premium.RP_IF_UI2_KompFehlerModus2_16_XIX_BMC_HV.DE_UI2_KompFehlerModus2_16, ecu-extract-reference=COMPOSITIONTYPE.RP_IF_UI2_KompFehlerModus2_16_XIX_BMC_HV.DE_UI2_KompFehlerModus2_16
      RP_IF_UI2_KompFehlerModus2_16_XIX_BMC_HV: upstream-reference=Geltungsbereich_E3_1_2_Premium.RP_IF_UI2_KompFehlerModus2_16_XIX_BMC_HV, ecu-extract-reference=COMPOSITIONTYPE.RP_IF_UI2_KompFehlerModus2_16_XIX_BMC_HV
      UI2_KompFehlerModus2_17: upstream-reference=Geltungsbereich_E3_1_2_Premium.RP_IF_UI2_KompFehlerModus2_17_XIX_BMC_HV.DE_UI2_KompFehlerModus2_17, ecu-extract-reference=COMPOSITIONTYPE.RP_IF_UI2_KompFehlerModus2_17_XIX_BMC_HV.DE_UI2_KompFehlerModus2_17
      RP_IF_UI2_KompFehlerModus2_17_XIX_BMC_HV: upstream-reference=Geltungsbereich_E3_1_2_Premium.RP_IF_UI2_KompFehlerModus2_17_XIX_BMC_HV, ecu-extract-reference=COMPOSITIONTYPE.RP_IF_UI2_KompFehlerModus2_17_XIX_BMC_HV
      UI2_KompFehlerModus2_18: upstream-reference=Geltungsbereich_E3_1_2_Premium.RP_IF_UI2_KompFehlerModus2_18_XIX_BMC_HV.DE_UI2_KompFehlerModus2_18, ecu-extract-reference=COMPOSITIONTYPE.RP_IF_UI2_KompFehlerModus2_18_XIX_BMC_HV.DE_UI2_KompFehlerModus2_18
      RP_IF_UI2_KompFehlerModus2_18_XIX_BMC_HV: upstream-reference=Geltungsbereich_E3_1_2_Premium.RP_IF_UI2_KompFehlerModus2_18_XIX_BMC_HV, ecu-extract-reference=COMPOSITIONTYPE.RP_IF_UI2_KompFehlerModus2_18_XIX_BMC_HV
      UI2_KompFehlerModus2_19: upstream-reference=Geltungsbereich_E3_1_2_Premium.RP_IF_UI2_KompFehlerModus2_19_XIX_BMC_HV.DE_UI2_KompFehlerModus2_19, ecu-extract-reference=COMPOSITIONTYPE.RP_IF_UI2_KompFehlerModus2_19_XIX_BMC_HV.DE_UI2_KompFehlerModus2_19
      RP_IF_UI2_KompFehlerModus2_19_XIX_BMC_HV: upstream-reference=Geltungsbereich_E3_1_2_Premium.RP_IF_UI2_KompFehlerModus2_19_XIX_BMC_HV, ecu-extract-reference=COMPOSITIONTYPE.RP_IF_UI2_KompFehlerModus2_19_XIX_BMC_HV
      UI2_KompFehlerModus2_20: upstream-reference=Geltungsbereich_E3_1_2_Premium.RP_IF_UI2_KompFehlerModus2_20_XIX_BMC_HV.DE_UI2_KompFehlerModus2_20, ecu-extract-reference=COMPOSITIONTYPE.RP_IF_UI2_KompFehlerModus2_20_XIX_BMC_HV.DE_UI2_KompFehlerModus2_20
      RP_IF_UI2_KompFehlerModus2_20_XIX_BMC_HV: upstream-reference=Geltungsbereich_E3_1_2_Premium.RP_IF_UI2_KompFehlerModus2_20_XIX_BMC_HV, ecu-extract-reference=COMPOSITIONTYPE.RP_IF_UI2_KompFehlerModus2_20_XIX_BMC_HV
      UI2_KompFehlerModus2_21: upstream-reference=Geltungsbereich_E3_1_2_Premium.RP_IF_UI2_KompFehlerModus2_21_XIX_BMC_HV.DE_UI2_KompFehlerModus2_21, ecu-extract-reference=COMPOSITIONTYPE.RP_IF_UI2_KompFehlerModus2_21_XIX_BMC_HV.DE_UI2_KompFehlerModus2_21
      RP_IF_UI2_KompFehlerModus2_21_XIX_BMC_HV: upstream-reference=Geltungsbereich_E3_1_2_Premium.RP_IF_UI2_KompFehlerModus2_21_XIX_BMC_HV, ecu-extract-reference=COMPOSITIONTYPE.RP_IF_UI2_KompFehlerModus2_21_XIX_BMC_HV
      UI2_KompFehlerModus2_22: upstream-reference=Geltungsbereich_E3_1_2_Premium.RP_IF_UI2_KompFehlerModus2_22_XIX_BMC_HV.DE_UI2_KompFehlerModus2_22, ecu-extract-reference=COMPOSITIONTYPE.RP_IF_UI2_KompFehlerModus2_22_XIX_BMC_HV.DE_UI2_KompFehlerModus2_22
      RP_IF_UI2_KompFehlerModus2_22_XIX_BMC_HV: upstream-reference=Geltungsbereich_E3_1_2_Premium.RP_IF_UI2_KompFehlerModus2_22_XIX_BMC_HV, ecu-extract-reference=COMPOSITIONTYPE.RP_IF_UI2_KompFehlerModus2_22_XIX_BMC_HV
      UI2_KompFehlerModus2_23: upstream-reference=Geltungsbereich_E3_1_2_Premium.RP_IF_UI2_KompFehlerModus2_23_XIX_BMC_HV.DE_UI2_KompFehlerModus2_23, ecu-extract-reference=COMPOSITIONTYPE.RP_IF_UI2_KompFehlerModus2_23_XIX_BMC_HV.DE_UI2_KompFehlerModus2_23
      RP_IF_UI2_KompFehlerModus2_23_XIX_BMC_HV: upstream-reference=Geltungsbereich_E3_1_2_Premium.RP_IF_UI2_KompFehlerModus2_23_XIX_BMC_HV, ecu-extract-reference=COMPOSITIONTYPE.RP_IF_UI2_KompFehlerModus2_23_XIX_BMC_HV
      UI2_KompFehlerModus2_24: upstream-reference=Geltungsbereich_E3_1_2_Premium.RP_IF_UI2_KompFehlerModus2_24_XIX_BMC_HV.DE_UI2_KompFehlerModus2_24, ecu-extract-reference=COMPOSITIONTYPE.RP_IF_UI2_KompFehlerModus2_24_XIX_BMC_HV.DE_UI2_KompFehlerModus2_24
      RP_IF_UI2_KompFehlerModus2_24_XIX_BMC_HV: upstream-reference=Geltungsbereich_E3_1_2_Premium.RP_IF_UI2_KompFehlerModus2_24_XIX_BMC_HV, ecu-extract-reference=COMPOSITIONTYPE.RP_IF_UI2_KompFehlerModus2_24_XIX_BMC_HV
      UI2_KompFehlerModus2_25: upstream-reference=Geltungsbereich_E3_1_2_Premium.RP_IF_UI2_KompFehlerModus2_25_XIX_BMC_HV.DE_UI2_KompFehlerModus2_25, ecu-extract-reference=COMPOSITIONTYPE.RP_IF_UI2_KompFehlerModus2_25_XIX_BMC_HV.DE_UI2_KompFehlerModus2_25
      RP_IF_UI2_KompFehlerModus2_25_XIX_BMC_HV: upstream-reference=Geltungsbereich_E3_1_2_Premium.RP_IF_UI2_KompFehlerModus2_25_XIX_BMC_HV, ecu-extract-reference=COMPOSITIONTYPE.RP_IF_UI2_KompFehlerModus2_25_XIX_BMC_HV
      UI2_KompFehlerModus2_26: upstream-reference=Geltungsbereich_E3_1_2_Premium.RP_IF_UI2_KompFehlerModus2_26_XIX_BMC_HV.DE_UI2_KompFehlerModus2_26, ecu-extract-reference=COMPOSITIONTYPE.RP_IF_UI2_KompFehlerModus2_26_XIX_BMC_HV.DE_UI2_KompFehlerModus2_26
      RP_IF_UI2_KompFehlerModus2_26_XIX_BMC_HV: upstream-reference=Geltungsbereich_E3_1_2_Premium.RP_IF_UI2_KompFehlerModus2_26_XIX_BMC_HV, ecu-extract-reference=COMPOSITIONTYPE.RP_IF_UI2_KompFehlerModus2_26_XIX_BMC_HV
      UI2_KompFehlerModus4_01: upstream-reference=Geltungsbereich_E3_1_2_Premium.RP_IF_UI2_KompFehlerModus4_01_XIX_BMC_HV.DE_UI2_KompFehlerModus4_01, ecu-extract-reference=COMPOSITIONTYPE.RP_IF_UI2_KompFehlerModus4_01_XIX_BMC_HV.DE_UI2_KompFehlerModus4_01
      RP_IF_UI2_KompFehlerModus4_01_XIX_BMC_HV: upstream-reference=Geltungsbereich_E3_1_2_Premium.RP_IF_UI2_KompFehlerModus4_01_XIX_BMC_HV, ecu-extract-reference=COMPOSITIONTYPE.RP_IF_UI2_KompFehlerModus4_01_XIX_BMC_HV
      UI2_KompFehlerModus4_02: upstream-reference=Geltungsbereich_E3_1_2_Premium.RP_IF_UI2_KompFehlerModus4_02_XIX_BMC_HV.DE_UI2_KompFehlerModus4_02, ecu-extract-reference=COMPOSITIONTYPE.RP_IF_UI2_KompFehlerModus4_02_XIX_BMC_HV.DE_UI2_KompFehlerModus4_02
      RP_IF_UI2_KompFehlerModus4_02_XIX_BMC_HV: upstream-reference=Geltungsbereich_E3_1_2_Premium.RP_IF_UI2_KompFehlerModus4_02_XIX_BMC_HV, ecu-extract-reference=COMPOSITIONTYPE.RP_IF_UI2_KompFehlerModus4_02_XIX_BMC_HV
      UI2_KompFehlerModus4_03: upstream-reference=Geltungsbereich_E3_1_2_Premium.RP_IF_UI2_KompFehlerModus4_03_XIX_BMC_HV.DE_UI2_KompFehlerModus4_03, ecu-extract-reference=COMPOSITIONTYPE.RP_IF_UI2_KompFehlerModus4_03_XIX_BMC_HV.DE_UI2_KompFehlerModus4_03
      RP_IF_UI2_KompFehlerModus4_03_XIX_BMC_HV: upstream-reference=Geltungsbereich_E3_1_2_Premium.RP_IF_UI2_KompFehlerModus4_03_XIX_BMC_HV, ecu-extract-reference=COMPOSITIONTYPE.RP_IF_UI2_KompFehlerModus4_03_XIX_BMC_HV
      UI2_KompFehlerModus4_04: upstream-reference=Geltungsbereich_E3_1_2_Premium.RP_IF_UI2_KompFehlerModus4_04_XIX_BMC_HV.DE_UI2_KompFehlerModus4_04, ecu-extract-reference=COMPOSITIONTYPE.RP_IF_UI2_KompFehlerModus4_04_XIX_BMC_HV.DE_UI2_KompFehlerModus4_04
      RP_IF_UI2_KompFehlerModus4_04_XIX_BMC_HV: upstream-reference=Geltungsbereich_E3_1_2_Premium.RP_IF_UI2_KompFehlerModus4_04_XIX_BMC_HV, ecu-extract-reference=COMPOSITIONTYPE.RP_IF_UI2_KompFehlerModus4_04_XIX_BMC_HV
      UI2_KompFehlerModus4_05: upstream-reference=Geltungsbereich_E3_1_2_Premium.RP_IF_UI2_KompFehlerModus4_05_XIX_BMC_HV.DE_UI2_KompFehlerModus4_05, ecu-extract-reference=COMPOSITIONTYPE.RP_IF_UI2_KompFehlerModus4_05_XIX_BMC_HV.DE_UI2_KompFehlerModus4_05
      RP_IF_UI2_KompFehlerModus4_05_XIX_BMC_HV: upstream-reference=Geltungsbereich_E3_1_2_Premium.RP_IF_UI2_KompFehlerModus4_05_XIX_BMC_HV, ecu-extract-reference=COMPOSITIONTYPE.RP_IF_UI2_KompFehlerModus4_05_XIX_BMC_HV
      UI2_KompFehlerModus4_06: upstream-reference=Geltungsbereich_E3_1_2_Premium.RP_IF_UI2_KompFehlerModus4_06_XIX_BMC_HV.DE_UI2_KompFehlerModus4_06, ecu-extract-reference=COMPOSITIONTYPE.RP_IF_UI2_KompFehlerModus4_06_XIX_BMC_HV.DE_UI2_KompFehlerModus4_06
      RP_IF_UI2_KompFehlerModus4_06_XIX_BMC_HV: upstream-reference=Geltungsbereich_E3_1_2_Premium.RP_IF_UI2_KompFehlerModus4_06_XIX_BMC_HV, ecu-extract-reference=COMPOSITIONTYPE.RP_IF_UI2_KompFehlerModus4_06_XIX_BMC_HV
      UI2_KompFehlerModus4_07: upstream-reference=Geltungsbereich_E3_1_2_Premium.RP_IF_UI2_KompFehlerModus4_07_XIX_BMC_HV.DE_UI2_KompFehlerModus4_07, ecu-extract-reference=COMPOSITIONTYPE.RP_IF_UI2_KompFehlerModus4_07_XIX_BMC_HV.DE_UI2_KompFehlerModus4_07
      RP_IF_UI2_KompFehlerModus4_07_XIX_BMC_HV: upstream-reference=Geltungsbereich_E3_1_2_Premium.RP_IF_UI2_KompFehlerModus4_07_XIX_BMC_HV, ecu-extract-reference=COMPOSITIONTYPE.RP_IF_UI2_KompFehlerModus4_07_XIX_BMC_HV
      UI2_KompFehlerModus4_08: upstream-reference=Geltungsbereich_E3_1_2_Premium.RP_IF_UI2_KompFehlerModus4_08_XIX_BMC_HV.DE_UI2_KompFehlerModus4_08, ecu-extract-reference=COMPOSITIONTYPE.RP_IF_UI2_KompFehlerModus4_08_XIX_BMC_HV.DE_UI2_KompFehlerModus4_08
      RP_IF_UI2_KompFehlerModus4_08_XIX_BMC_HV: upstream-reference=Geltungsbereich_E3_1_2_Premium.RP_IF_UI2_KompFehlerModus4_08_XIX_BMC_HV, ecu-extract-reference=COMPOSITIONTYPE.RP_IF_UI2_KompFehlerModus4_08_XIX_BMC_HV
      UI2_KompFehlerModus4_09: upstream-reference=Geltungsbereich_E3_1_2_Premium.RP_IF_UI2_KompFehlerModus4_09_XIX_BMC_HV.DE_UI2_KompFehlerModus4_09, ecu-extract-reference=COMPOSITIONTYPE.RP_IF_UI2_KompFehlerModus4_09_XIX_BMC_HV.DE_UI2_KompFehlerModus4_09
      RP_IF_UI2_KompFehlerModus4_09_XIX_BMC_HV: upstream-reference=Geltungsbereich_E3_1_2_Premium.RP_IF_UI2_KompFehlerModus4_09_XIX_BMC_HV, ecu-extract-reference=COMPOSITIONTYPE.RP_IF_UI2_KompFehlerModus4_09_XIX_BMC_HV
      UI2_KompFehlerModus4_10: upstream-reference=Geltungsbereich_E3_1_2_Premium.RP_IF_UI2_KompFehlerModus4_10_XIX_BMC_HV.DE_UI2_KompFehlerModus4_10, ecu-extract-reference=COMPOSITIONTYPE.RP_IF_UI2_KompFehlerModus4_10_XIX_BMC_HV.DE_UI2_KompFehlerModus4_10
      RP_IF_UI2_KompFehlerModus4_10_XIX_BMC_HV: upstream-reference=Geltungsbereich_E3_1_2_Premium.RP_IF_UI2_KompFehlerModus4_10_XIX_BMC_HV, ecu-extract-reference=COMPOSITIONTYPE.RP_IF_UI2_KompFehlerModus4_10_XIX_BMC_HV
      UI2_KompFehlerModus4_11: upstream-reference=Geltungsbereich_E3_1_2_Premium.RP_IF_UI2_KompFehlerModus4_11_XIX_BMC_HV.DE_UI2_KompFehlerModus4_11, ecu-extract-reference=COMPOSITIONTYPE.RP_IF_UI2_KompFehlerModus4_11_XIX_BMC_HV.DE_UI2_KompFehlerModus4_11
      RP_IF_UI2_KompFehlerModus4_11_XIX_BMC_HV: upstream-reference=Geltungsbereich_E3_1_2_Premium.RP_IF_UI2_KompFehlerModus4_11_XIX_BMC_HV, ecu-extract-reference=COMPOSITIONTYPE.RP_IF_UI2_KompFehlerModus4_11_XIX_BMC_HV
      UI2_KompFehlerModus4_12: upstream-reference=Geltungsbereich_E3_1_2_Premium.RP_IF_UI2_KompFehlerModus4_12_XIX_BMC_HV.DE_UI2_KompFehlerModus4_12, ecu-extract-reference=COMPOSITIONTYPE.RP_IF_UI2_KompFehlerModus4_12_XIX_BMC_HV.DE_UI2_KompFehlerModus4_12
      RP_IF_UI2_KompFehlerModus4_12_XIX_BMC_HV: upstream-reference=Geltungsbereich_E3_1_2_Premium.RP_IF_UI2_KompFehlerModus4_12_XIX_BMC_HV, ecu-extract-reference=COMPOSITIONTYPE.RP_IF_UI2_KompFehlerModus4_12_XIX_BMC_HV
      UI2_KompFehlerModus4_13: upstream-reference=Geltungsbereich_E3_1_2_Premium.RP_IF_UI2_KompFehlerModus4_13_XIX_BMC_HV.DE_UI2_KompFehlerModus4_13, ecu-extract-reference=COMPOSITIONTYPE.RP_IF_UI2_KompFehlerModus4_13_XIX_BMC_HV.DE_UI2_KompFehlerModus4_13
      RP_IF_UI2_KompFehlerModus4_13_XIX_BMC_HV: upstream-reference=Geltungsbereich_E3_1_2_Premium.RP_IF_UI2_KompFehlerModus4_13_XIX_BMC_HV, ecu-extract-reference=COMPOSITIONTYPE.RP_IF_UI2_KompFehlerModus4_13_XIX_BMC_HV
      UI2_KompFehlerModus4_14: upstream-reference=Geltungsbereich_E3_1_2_Premium.RP_IF_UI2_KompFehlerModus4_14_XIX_BMC_HV.DE_UI2_KompFehlerModus4_14, ecu-extract-reference=COMPOSITIONTYPE.RP_IF_UI2_KompFehlerModus4_14_XIX_BMC_HV.DE_UI2_KompFehlerModus4_14
      RP_IF_UI2_KompFehlerModus4_14_XIX_BMC_HV: upstream-reference=Geltungsbereich_E3_1_2_Premium.RP_IF_UI2_KompFehlerModus4_14_XIX_BMC_HV, ecu-extract-reference=COMPOSITIONTYPE.RP_IF_UI2_KompFehlerModus4_14_XIX_BMC_HV
      UI2_KompFehlerModus4_15: upstream-reference=Geltungsbereich_E3_1_2_Premium.RP_IF_UI2_KompFehlerModus4_15_XIX_BMC_HV.DE_UI2_KompFehlerModus4_15, ecu-extract-reference=COMPOSITIONTYPE.RP_IF_UI2_KompFehlerModus4_15_XIX_BMC_HV.DE_UI2_KompFehlerModus4_15
      RP_IF_UI2_KompFehlerModus4_15_XIX_BMC_HV: upstream-reference=Geltungsbereich_E3_1_2_Premium.RP_IF_UI2_KompFehlerModus4_15_XIX_BMC_HV, ecu-extract-reference=COMPOSITIONTYPE.RP_IF_UI2_KompFehlerModus4_15_XIX_BMC_HV
      UI2_KompFehlerModus4_16: upstream-reference=Geltungsbereich_E3_1_2_Premium.RP_IF_UI2_KompFehlerModus4_16_XIX_BMC_HV.DE_UI2_KompFehlerModus4_16, ecu-extract-reference=COMPOSITIONTYPE.RP_IF_UI2_KompFehlerModus4_16_XIX_BMC_HV.DE_UI2_KompFehlerModus4_16
      RP_IF_UI2_KompFehlerModus4_16_XIX_BMC_HV: upstream-reference=Geltungsbereich_E3_1_2_Premium.RP_IF_UI2_KompFehlerModus4_16_XIX_BMC_HV, ecu-extract-reference=COMPOSITIONTYPE.RP_IF_UI2_KompFehlerModus4_16_XIX_BMC_HV
      UI2_Status: upstream-reference=Geltungsbereich_E3_1_2_Premium.RP_IF_UI2_Status_XIX_BMC_HV.DE_UI2_Status, ecu-extract-reference=COMPOSITIONTYPE.RP_IF_UI2_Status_XIX_BMC_HV.DE_UI2_Status
      RP_IF_UI2_Status_XIX_BMC_HV: upstream-reference=Geltungsbereich_E3_1_2_Premium.RP_IF_UI2_Status_XIX_BMC_HV, ecu-extract-reference=COMPOSITIONTYPE.RP_IF_UI2_Status_XIX_BMC_HV
      UI2_Stromintegral_Entladen: upstream-reference=Geltungsbereich_E3_1_2_Premium.RP_IF_UI2_Stromintegral_Entladen_XIX_BMC_HV.DE_UI2_Stromintegral_Entladen, ecu-extract-reference=COMPOSITIONTYPE.RP_IF_UI2_Stromintegral_Entladen_XIX_BMC_HV.DE_UI2_Stromintegral_Entladen
      RP_IF_UI2_Stromintegral_Entladen_XIX_BMC_HV: upstream-reference=Geltungsbereich_E3_1_2_Premium.RP_IF_UI2_Stromintegral_Entladen_XIX_BMC_HV, ecu-extract-reference=COMPOSITIONTYPE.RP_IF_UI2_Stromintegral_Entladen_XIX_BMC_HV
      UI2_Stromintegral_Laden: upstream-reference=Geltungsbereich_E3_1_2_Premium.RP_IF_UI2_Stromintegral_Laden_XIX_BMC_HV.DE_UI2_Stromintegral_Laden, ecu-extract-reference=COMPOSITIONTYPE.RP_IF_UI2_Stromintegral_Laden_XIX_BMC_HV.DE_UI2_Stromintegral_Laden
      RP_IF_UI2_Stromintegral_Laden_XIX_BMC_HV: upstream-reference=Geltungsbereich_E3_1_2_Premium.RP_IF_UI2_Stromintegral_Laden_XIX_BMC_HV, ecu-extract-reference=COMPOSITIONTYPE.RP_IF_UI2_Stromintegral_Laden_XIX_BMC_HV
      UI2_Temperatur_1: upstream-reference=Geltungsbereich_E3_1_2_Premium.RP_IF_UI2_Temperatur_1_XIX_BMC_HV.DE_UI2_Temperatur_1, ecu-extract-reference=COMPOSITIONTYPE.RP_IF_UI2_Temperatur_1_XIX_BMC_HV.DE_UI2_Temperatur_1
      RP_IF_UI2_Temperatur_1_XIX_BMC_HV: upstream-reference=Geltungsbereich_E3_1_2_Premium.RP_IF_UI2_Temperatur_1_XIX_BMC_HV, ecu-extract-reference=COMPOSITIONTYPE.RP_IF_UI2_Temperatur_1_XIX_BMC_HV
      UI2_Temperatur_2: upstream-reference=Geltungsbereich_E3_1_2_Premium.RP_IF_UI2_Temperatur_2_XIX_BMC_HV.DE_UI2_Temperatur_2, ecu-extract-reference=COMPOSITIONTYPE.RP_IF_UI2_Temperatur_2_XIX_BMC_HV.DE_UI2_Temperatur_2
      RP_IF_UI2_Temperatur_2_XIX_BMC_HV: upstream-reference=Geltungsbereich_E3_1_2_Premium.RP_IF_UI2_Temperatur_2_XIX_BMC_HV, ecu-extract-reference=COMPOSITIONTYPE.RP_IF_UI2_Temperatur_2_XIX_BMC_HV
      UI2Sens01_CALID_Index_01: upstream-reference=Geltungsbereich_E3_1_2_Premium.RP_IF_UI2Sens01_CALID_Index_01_XIX_BMC_HV.DE_UI2Sens01_CALID_Index_01, ecu-extract-reference=COMPOSITIONTYPE.RP_IF_UI2Sens01_CALID_Index_01_XIX_BMC_HV.DE_UI2Sens01_CALID_Index_01
      RP_IF_UI2Sens01_CALID_Index_01_XIX_BMC_HV: upstream-reference=Geltungsbereich_E3_1_2_Premium.RP_IF_UI2Sens01_CALID_Index_01_XIX_BMC_HV, ecu-extract-reference=COMPOSITIONTYPE.RP_IF_UI2Sens01_CALID_Index_01_XIX_BMC_HV
      UI2Sens01_CALID_Index_02: upstream-reference=Geltungsbereich_E3_1_2_Premium.RP_IF_UI2Sens01_CALID_Index_02_XIX_BMC_HV.DE_UI2Sens01_CALID_Index_02, ecu-extract-reference=COMPOSITIONTYPE.RP_IF_UI2Sens01_CALID_Index_02_XIX_BMC_HV.DE_UI2Sens01_CALID_Index_02
      RP_IF_UI2Sens01_CALID_Index_02_XIX_BMC_HV: upstream-reference=Geltungsbereich_E3_1_2_Premium.RP_IF_UI2Sens01_CALID_Index_02_XIX_BMC_HV, ecu-extract-reference=COMPOSITIONTYPE.RP_IF_UI2Sens01_CALID_Index_02_XIX_BMC_HV
      UI2Sens01_CALID_Index_03: upstream-reference=Geltungsbereich_E3_1_2_Premium.RP_IF_UI2Sens01_CALID_Index_03_XIX_BMC_HV.DE_UI2Sens01_CALID_Index_03, ecu-extract-reference=COMPOSITIONTYPE.RP_IF_UI2Sens01_CALID_Index_03_XIX_BMC_HV.DE_UI2Sens01_CALID_Index_03
      RP_IF_UI2Sens01_CALID_Index_03_XIX_BMC_HV: upstream-reference=Geltungsbereich_E3_1_2_Premium.RP_IF_UI2Sens01_CALID_Index_03_XIX_BMC_HV, ecu-extract-reference=COMPOSITIONTYPE.RP_IF_UI2Sens01_CALID_Index_03_XIX_BMC_HV
      UI2Sens01_CALID_Index_04: upstream-reference=Geltungsbereich_E3_1_2_Premium.RP_IF_UI2Sens01_CALID_Index_04_XIX_BMC_HV.DE_UI2Sens01_CALID_Index_04, ecu-extract-reference=COMPOSITIONTYPE.RP_IF_UI2Sens01_CALID_Index_04_XIX_BMC_HV.DE_UI2Sens01_CALID_Index_04
      RP_IF_UI2Sens01_CALID_Index_04_XIX_BMC_HV: upstream-reference=Geltungsbereich_E3_1_2_Premium.RP_IF_UI2Sens01_CALID_Index_04_XIX_BMC_HV, ecu-extract-reference=COMPOSITIONTYPE.RP_IF_UI2Sens01_CALID_Index_04_XIX_BMC_HV
      UI2Sens01_CALID_Index_05: upstream-reference=Geltungsbereich_E3_1_2_Premium.RP_IF_UI2Sens01_CALID_Index_05_XIX_BMC_HV.DE_UI2Sens01_CALID_Index_05, ecu-extract-reference=COMPOSITIONTYPE.RP_IF_UI2Sens01_CALID_Index_05_XIX_BMC_HV.DE_UI2Sens01_CALID_Index_05
      RP_IF_UI2Sens01_CALID_Index_05_XIX_BMC_HV: upstream-reference=Geltungsbereich_E3_1_2_Premium.RP_IF_UI2Sens01_CALID_Index_05_XIX_BMC_HV, ecu-extract-reference=COMPOSITIONTYPE.RP_IF_UI2Sens01_CALID_Index_05_XIX_BMC_HV
      UI2Sens01_CALID_Index_06: upstream-reference=Geltungsbereich_E3_1_2_Premium.RP_IF_UI2Sens01_CALID_Index_06_XIX_BMC_HV.DE_UI2Sens01_CALID_Index_06, ecu-extract-reference=COMPOSITIONTYPE.RP_IF_UI2Sens01_CALID_Index_06_XIX_BMC_HV.DE_UI2Sens01_CALID_Index_06
      RP_IF_UI2Sens01_CALID_Index_06_XIX_BMC_HV: upstream-reference=Geltungsbereich_E3_1_2_Premium.RP_IF_UI2Sens01_CALID_Index_06_XIX_BMC_HV, ecu-extract-reference=COMPOSITIONTYPE.RP_IF_UI2Sens01_CALID_Index_06_XIX_BMC_HV
      UI2Sens01_CALID_Index_07: upstream-reference=Geltungsbereich_E3_1_2_Premium.RP_IF_UI2Sens01_CALID_Index_07_XIX_BMC_HV.DE_UI2Sens01_CALID_Index_07, ecu-extract-reference=COMPOSITIONTYPE.RP_IF_UI2Sens01_CALID_Index_07_XIX_BMC_HV.DE_UI2Sens01_CALID_Index_07
      RP_IF_UI2Sens01_CALID_Index_07_XIX_BMC_HV: upstream-reference=Geltungsbereich_E3_1_2_Premium.RP_IF_UI2Sens01_CALID_Index_07_XIX_BMC_HV, ecu-extract-reference=COMPOSITIONTYPE.RP_IF_UI2Sens01_CALID_Index_07_XIX_BMC_HV
      UI2Sens01_CALID_Index_08: upstream-reference=Geltungsbereich_E3_1_2_Premium.RP_IF_UI2Sens01_CALID_Index_08_XIX_BMC_HV.DE_UI2Sens01_CALID_Index_08, ecu-extract-reference=COMPOSITIONTYPE.RP_IF_UI2Sens01_CALID_Index_08_XIX_BMC_HV.DE_UI2Sens01_CALID_Index_08
      RP_IF_UI2Sens01_CALID_Index_08_XIX_BMC_HV: upstream-reference=Geltungsbereich_E3_1_2_Premium.RP_IF_UI2Sens01_CALID_Index_08_XIX_BMC_HV, ecu-extract-reference=COMPOSITIONTYPE.RP_IF_UI2Sens01_CALID_Index_08_XIX_BMC_HV
      UI2Sens01_CALID_Index_09: upstream-reference=Geltungsbereich_E3_1_2_Premium.RP_IF_UI2Sens01_CALID_Index_09_XIX_BMC_HV.DE_UI2Sens01_CALID_Index_09, ecu-extract-reference=COMPOSITIONTYPE.RP_IF_UI2Sens01_CALID_Index_09_XIX_BMC_HV.DE_UI2Sens01_CALID_Index_09
      RP_IF_UI2Sens01_CALID_Index_09_XIX_BMC_HV: upstream-reference=Geltungsbereich_E3_1_2_Premium.RP_IF_UI2Sens01_CALID_Index_09_XIX_BMC_HV, ecu-extract-reference=COMPOSITIONTYPE.RP_IF_UI2Sens01_CALID_Index_09_XIX_BMC_HV
      UI2Sens01_CALID_Index_10: upstream-reference=Geltungsbereich_E3_1_2_Premium.RP_IF_UI2Sens01_CALID_Index_10_XIX_BMC_HV.DE_UI2Sens01_CALID_Index_10, ecu-extract-reference=COMPOSITIONTYPE.RP_IF_UI2Sens01_CALID_Index_10_XIX_BMC_HV.DE_UI2Sens01_CALID_Index_10
      RP_IF_UI2Sens01_CALID_Index_10_XIX_BMC_HV: upstream-reference=Geltungsbereich_E3_1_2_Premium.RP_IF_UI2Sens01_CALID_Index_10_XIX_BMC_HV, ecu-extract-reference=COMPOSITIONTYPE.RP_IF_UI2Sens01_CALID_Index_10_XIX_BMC_HV
      UI2Sens01_CALID_Index_11: upstream-reference=Geltungsbereich_E3_1_2_Premium.RP_IF_UI2Sens01_CALID_Index_11_XIX_BMC_HV.DE_UI2Sens01_CALID_Index_11, ecu-extract-reference=COMPOSITIONTYPE.RP_IF_UI2Sens01_CALID_Index_11_XIX_BMC_HV.DE_UI2Sens01_CALID_Index_11
      RP_IF_UI2Sens01_CALID_Index_11_XIX_BMC_HV: upstream-reference=Geltungsbereich_E3_1_2_Premium.RP_IF_UI2Sens01_CALID_Index_11_XIX_BMC_HV, ecu-extract-reference=COMPOSITIONTYPE.RP_IF_UI2Sens01_CALID_Index_11_XIX_BMC_HV
      UI2Sens01_CALID_Index_12: upstream-reference=Geltungsbereich_E3_1_2_Premium.RP_IF_UI2Sens01_CALID_Index_12_XIX_BMC_HV.DE_UI2Sens01_CALID_Index_12, ecu-extract-reference=COMPOSITIONTYPE.RP_IF_UI2Sens01_CALID_Index_12_XIX_BMC_HV.DE_UI2Sens01_CALID_Index_12
      RP_IF_UI2Sens01_CALID_Index_12_XIX_BMC_HV: upstream-reference=Geltungsbereich_E3_1_2_Premium.RP_IF_UI2Sens01_CALID_Index_12_XIX_BMC_HV, ecu-extract-reference=COMPOSITIONTYPE.RP_IF_UI2Sens01_CALID_Index_12_XIX_BMC_HV
      UI2Sens01_CALID_Index_13: upstream-reference=Geltungsbereich_E3_1_2_Premium.RP_IF_UI2Sens01_CALID_Index_13_XIX_BMC_HV.DE_UI2Sens01_CALID_Index_13, ecu-extract-reference=COMPOSITIONTYPE.RP_IF_UI2Sens01_CALID_Index_13_XIX_BMC_HV.DE_UI2Sens01_CALID_Index_13
      RP_IF_UI2Sens01_CALID_Index_13_XIX_BMC_HV: upstream-reference=Geltungsbereich_E3_1_2_Premium.RP_IF_UI2Sens01_CALID_Index_13_XIX_BMC_HV, ecu-extract-reference=COMPOSITIONTYPE.RP_IF_UI2Sens01_CALID_Index_13_XIX_BMC_HV
      UI2Sens01_CALID_Index_14: upstream-reference=Geltungsbereich_E3_1_2_Premium.RP_IF_UI2Sens01_CALID_Index_14_XIX_BMC_HV.DE_UI2Sens01_CALID_Index_14, ecu-extract-reference=COMPOSITIONTYPE.RP_IF_UI2Sens01_CALID_Index_14_XIX_BMC_HV.DE_UI2Sens01_CALID_Index_14
      RP_IF_UI2Sens01_CALID_Index_14_XIX_BMC_HV: upstream-reference=Geltungsbereich_E3_1_2_Premium.RP_IF_UI2Sens01_CALID_Index_14_XIX_BMC_HV, ecu-extract-reference=COMPOSITIONTYPE.RP_IF_UI2Sens01_CALID_Index_14_XIX_BMC_HV
      UI2Sens01_CALID_Index_15: upstream-reference=Geltungsbereich_E3_1_2_Premium.RP_IF_UI2Sens01_CALID_Index_15_XIX_BMC_HV.DE_UI2Sens01_CALID_Index_15, ecu-extract-reference=COMPOSITIONTYPE.RP_IF_UI2Sens01_CALID_Index_15_XIX_BMC_HV.DE_UI2Sens01_CALID_Index_15
      RP_IF_UI2Sens01_CALID_Index_15_XIX_BMC_HV: upstream-reference=Geltungsbereich_E3_1_2_Premium.RP_IF_UI2Sens01_CALID_Index_15_XIX_BMC_HV, ecu-extract-reference=COMPOSITIONTYPE.RP_IF_UI2Sens01_CALID_Index_15_XIX_BMC_HV
      UI2Sens01_CALID_Index_16: upstream-reference=Geltungsbereich_E3_1_2_Premium.RP_IF_UI2Sens01_CALID_Index_16_XIX_BMC_HV.DE_UI2Sens01_CALID_Index_16, ecu-extract-reference=COMPOSITIONTYPE.RP_IF_UI2Sens01_CALID_Index_16_XIX_BMC_HV.DE_UI2Sens01_CALID_Index_16
      RP_IF_UI2Sens01_CALID_Index_16_XIX_BMC_HV: upstream-reference=Geltungsbereich_E3_1_2_Premium.RP_IF_UI2Sens01_CALID_Index_16_XIX_BMC_HV, ecu-extract-reference=COMPOSITIONTYPE.RP_IF_UI2Sens01_CALID_Index_16_XIX_BMC_HV
      UI2Sens01_CVN_Byte_1: upstream-reference=Geltungsbereich_E3_1_2_Premium.RP_IF_UI2Sens01_CVN_Byte_1_XIX_BMC_HV.DE_UI2Sens01_CVN_Byte_1, ecu-extract-reference=COMPOSITIONTYPE.RP_IF_UI2Sens01_CVN_Byte_1_XIX_BMC_HV.DE_UI2Sens01_CVN_Byte_1
      RP_IF_UI2Sens01_CVN_Byte_1_XIX_BMC_HV: upstream-reference=Geltungsbereich_E3_1_2_Premium.RP_IF_UI2Sens01_CVN_Byte_1_XIX_BMC_HV, ecu-extract-reference=COMPOSITIONTYPE.RP_IF_UI2Sens01_CVN_Byte_1_XIX_BMC_HV
      UI2Sens01_CVN_Byte_2: upstream-reference=Geltungsbereich_E3_1_2_Premium.RP_IF_UI2Sens01_CVN_Byte_2_XIX_BMC_HV.DE_UI2Sens01_CVN_Byte_2, ecu-extract-reference=COMPOSITIONTYPE.RP_IF_UI2Sens01_CVN_Byte_2_XIX_BMC_HV.DE_UI2Sens01_CVN_Byte_2
      RP_IF_UI2Sens01_CVN_Byte_2_XIX_BMC_HV: upstream-reference=Geltungsbereich_E3_1_2_Premium.RP_IF_UI2Sens01_CVN_Byte_2_XIX_BMC_HV, ecu-extract-reference=COMPOSITIONTYPE.RP_IF_UI2Sens01_CVN_Byte_2_XIX_BMC_HV
      UI2Sens01_CVN_Byte_3: upstream-reference=Geltungsbereich_E3_1_2_Premium.RP_IF_UI2Sens01_CVN_Byte_3_XIX_BMC_HV.DE_UI2Sens01_CVN_Byte_3, ecu-extract-reference=COMPOSITIONTYPE.RP_IF_UI2Sens01_CVN_Byte_3_XIX_BMC_HV.DE_UI2Sens01_CVN_Byte_3
      RP_IF_UI2Sens01_CVN_Byte_3_XIX_BMC_HV: upstream-reference=Geltungsbereich_E3_1_2_Premium.RP_IF_UI2Sens01_CVN_Byte_3_XIX_BMC_HV, ecu-extract-reference=COMPOSITIONTYPE.RP_IF_UI2Sens01_CVN_Byte_3_XIX_BMC_HV
      UI2Sens01_CVN_Byte_4: upstream-reference=Geltungsbereich_E3_1_2_Premium.RP_IF_UI2Sens01_CVN_Byte_4_XIX_BMC_HV.DE_UI2Sens01_CVN_Byte_4, ecu-extract-reference=COMPOSITIONTYPE.RP_IF_UI2Sens01_CVN_Byte_4_XIX_BMC_HV.DE_UI2Sens01_CVN_Byte_4
      RP_IF_UI2Sens01_CVN_Byte_4_XIX_BMC_HV: upstream-reference=Geltungsbereich_E3_1_2_Premium.RP_IF_UI2Sens01_CVN_Byte_4_XIX_BMC_HV, ecu-extract-reference=COMPOSITIONTYPE.RP_IF_UI2Sens01_CVN_Byte_4_XIX_BMC_HV
      UI2Sens01_CVN_VLD: upstream-reference=Geltungsbereich_E3_1_2_Premium.RP_IF_UI2Sens01_CVN_VLD_XIX_BMC_HV.DE_UI2Sens01_CVN_VLD, ecu-extract-reference=COMPOSITIONTYPE.RP_IF_UI2Sens01_CVN_VLD_XIX_BMC_HV.DE_UI2Sens01_CVN_VLD
      RP_IF_UI2Sens01_CVN_VLD_XIX_BMC_HV: upstream-reference=Geltungsbereich_E3_1_2_Premium.RP_IF_UI2Sens01_CVN_VLD_XIX_BMC_HV, ecu-extract-reference=COMPOSITIONTYPE.RP_IF_UI2Sens01_CVN_VLD_XIX_BMC_HV
      UI2Sens01_ErrMem_State: upstream-reference=Geltungsbereich_E3_1_2_Premium.RP_IF_UI2Sens01_ErrMem_State_XIX_BMC_HV.DE_UI2Sens01_ErrMem_State, ecu-extract-reference=COMPOSITIONTYPE.RP_IF_UI2Sens01_ErrMem_State_XIX_BMC_HV.DE_UI2Sens01_ErrMem_State
      RP_IF_UI2Sens01_ErrMem_State_XIX_BMC_HV: upstream-reference=Geltungsbereich_E3_1_2_Premium.RP_IF_UI2Sens01_ErrMem_State_XIX_BMC_HV, ecu-extract-reference=COMPOSITIONTYPE.RP_IF_UI2Sens01_ErrMem_State_XIX_BMC_HV
      UI2Sens02_CALID_Index_01: upstream-reference=Geltungsbereich_E3_1_2_Premium.RP_IF_UI2Sens02_CALID_Index_01_XIX_BMC_HV.DE_UI2Sens02_CALID_Index_01, ecu-extract-reference=COMPOSITIONTYPE.RP_IF_UI2Sens02_CALID_Index_01_XIX_BMC_HV.DE_UI2Sens02_CALID_Index_01
      RP_IF_UI2Sens02_CALID_Index_01_XIX_BMC_HV: upstream-reference=Geltungsbereich_E3_1_2_Premium.RP_IF_UI2Sens02_CALID_Index_01_XIX_BMC_HV, ecu-extract-reference=COMPOSITIONTYPE.RP_IF_UI2Sens02_CALID_Index_01_XIX_BMC_HV
      UI2Sens02_CALID_Index_02: upstream-reference=Geltungsbereich_E3_1_2_Premium.RP_IF_UI2Sens02_CALID_Index_02_XIX_BMC_HV.DE_UI2Sens02_CALID_Index_02, ecu-extract-reference=COMPOSITIONTYPE.RP_IF_UI2Sens02_CALID_Index_02_XIX_BMC_HV.DE_UI2Sens02_CALID_Index_02
      RP_IF_UI2Sens02_CALID_Index_02_XIX_BMC_HV: upstream-reference=Geltungsbereich_E3_1_2_Premium.RP_IF_UI2Sens02_CALID_Index_02_XIX_BMC_HV, ecu-extract-reference=COMPOSITIONTYPE.RP_IF_UI2Sens02_CALID_Index_02_XIX_BMC_HV
      UI2Sens02_CALID_Index_03: upstream-reference=Geltungsbereich_E3_1_2_Premium.RP_IF_UI2Sens02_CALID_Index_03_XIX_BMC_HV.DE_UI2Sens02_CALID_Index_03, ecu-extract-reference=COMPOSITIONTYPE.RP_IF_UI2Sens02_CALID_Index_03_XIX_BMC_HV.DE_UI2Sens02_CALID_Index_03
      RP_IF_UI2Sens02_CALID_Index_03_XIX_BMC_HV: upstream-reference=Geltungsbereich_E3_1_2_Premium.RP_IF_UI2Sens02_CALID_Index_03_XIX_BMC_HV, ecu-extract-reference=COMPOSITIONTYPE.RP_IF_UI2Sens02_CALID_Index_03_XIX_BMC_HV
      UI2Sens02_CALID_Index_04: upstream-reference=Geltungsbereich_E3_1_2_Premium.RP_IF_UI2Sens02_CALID_Index_04_XIX_BMC_HV.DE_UI2Sens02_CALID_Index_04, ecu-extract-reference=COMPOSITIONTYPE.RP_IF_UI2Sens02_CALID_Index_04_XIX_BMC_HV.DE_UI2Sens02_CALID_Index_04
      RP_IF_UI2Sens02_CALID_Index_04_XIX_BMC_HV: upstream-reference=Geltungsbereich_E3_1_2_Premium.RP_IF_UI2Sens02_CALID_Index_04_XIX_BMC_HV, ecu-extract-reference=COMPOSITIONTYPE.RP_IF_UI2Sens02_CALID_Index_04_XIX_BMC_HV
      UI2Sens02_CALID_Index_05: upstream-reference=Geltungsbereich_E3_1_2_Premium.RP_IF_UI2Sens02_CALID_Index_05_XIX_BMC_HV.DE_UI2Sens02_CALID_Index_05, ecu-extract-reference=COMPOSITIONTYPE.RP_IF_UI2Sens02_CALID_Index_05_XIX_BMC_HV.DE_UI2Sens02_CALID_Index_05
      RP_IF_UI2Sens02_CALID_Index_05_XIX_BMC_HV: upstream-reference=Geltungsbereich_E3_1_2_Premium.RP_IF_UI2Sens02_CALID_Index_05_XIX_BMC_HV, ecu-extract-reference=COMPOSITIONTYPE.RP_IF_UI2Sens02_CALID_Index_05_XIX_BMC_HV
      UI2Sens02_CALID_Index_06: upstream-reference=Geltungsbereich_E3_1_2_Premium.RP_IF_UI2Sens02_CALID_Index_06_XIX_BMC_HV.DE_UI2Sens02_CALID_Index_06, ecu-extract-reference=COMPOSITIONTYPE.RP_IF_UI2Sens02_CALID_Index_06_XIX_BMC_HV.DE_UI2Sens02_CALID_Index_06
      RP_IF_UI2Sens02_CALID_Index_06_XIX_BMC_HV: upstream-reference=Geltungsbereich_E3_1_2_Premium.RP_IF_UI2Sens02_CALID_Index_06_XIX_BMC_HV, ecu-extract-reference=COMPOSITIONTYPE.RP_IF_UI2Sens02_CALID_Index_06_XIX_BMC_HV
      UI2Sens02_CALID_Index_07: upstream-reference=Geltungsbereich_E3_1_2_Premium.RP_IF_UI2Sens02_CALID_Index_07_XIX_BMC_HV.DE_UI2Sens02_CALID_Index_07, ecu-extract-reference=COMPOSITIONTYPE.RP_IF_UI2Sens02_CALID_Index_07_XIX_BMC_HV.DE_UI2Sens02_CALID_Index_07
      RP_IF_UI2Sens02_CALID_Index_07_XIX_BMC_HV: upstream-reference=Geltungsbereich_E3_1_2_Premium.RP_IF_UI2Sens02_CALID_Index_07_XIX_BMC_HV, ecu-extract-reference=COMPOSITIONTYPE.RP_IF_UI2Sens02_CALID_Index_07_XIX_BMC_HV
      UI2Sens02_CALID_Index_08: upstream-reference=Geltungsbereich_E3_1_2_Premium.RP_IF_UI2Sens02_CALID_Index_08_XIX_BMC_HV.DE_UI2Sens02_CALID_Index_08, ecu-extract-reference=COMPOSITIONTYPE.RP_IF_UI2Sens02_CALID_Index_08_XIX_BMC_HV.DE_UI2Sens02_CALID_Index_08
      RP_IF_UI2Sens02_CALID_Index_08_XIX_BMC_HV: upstream-reference=Geltungsbereich_E3_1_2_Premium.RP_IF_UI2Sens02_CALID_Index_08_XIX_BMC_HV, ecu-extract-reference=COMPOSITIONTYPE.RP_IF_UI2Sens02_CALID_Index_08_XIX_BMC_HV
      UI2Sens02_CALID_Index_09: upstream-reference=Geltungsbereich_E3_1_2_Premium.RP_IF_UI2Sens02_CALID_Index_09_XIX_BMC_HV.DE_UI2Sens02_CALID_Index_09, ecu-extract-reference=COMPOSITIONTYPE.RP_IF_UI2Sens02_CALID_Index_09_XIX_BMC_HV.DE_UI2Sens02_CALID_Index_09
      RP_IF_UI2Sens02_CALID_Index_09_XIX_BMC_HV: upstream-reference=Geltungsbereich_E3_1_2_Premium.RP_IF_UI2Sens02_CALID_Index_09_XIX_BMC_HV, ecu-extract-reference=COMPOSITIONTYPE.RP_IF_UI2Sens02_CALID_Index_09_XIX_BMC_HV
      UI2Sens02_CALID_Index_10: upstream-reference=Geltungsbereich_E3_1_2_Premium.RP_IF_UI2Sens02_CALID_Index_10_XIX_BMC_HV.DE_UI2Sens02_CALID_Index_10, ecu-extract-reference=COMPOSITIONTYPE.RP_IF_UI2Sens02_CALID_Index_10_XIX_BMC_HV.DE_UI2Sens02_CALID_Index_10
      RP_IF_UI2Sens02_CALID_Index_10_XIX_BMC_HV: upstream-reference=Geltungsbereich_E3_1_2_Premium.RP_IF_UI2Sens02_CALID_Index_10_XIX_BMC_HV, ecu-extract-reference=COMPOSITIONTYPE.RP_IF_UI2Sens02_CALID_Index_10_XIX_BMC_HV
      UI2Sens02_CALID_Index_11: upstream-reference=Geltungsbereich_E3_1_2_Premium.RP_IF_UI2Sens02_CALID_Index_11_XIX_BMC_HV.DE_UI2Sens02_CALID_Index_11, ecu-extract-reference=COMPOSITIONTYPE.RP_IF_UI2Sens02_CALID_Index_11_XIX_BMC_HV.DE_UI2Sens02_CALID_Index_11
      RP_IF_UI2Sens02_CALID_Index_11_XIX_BMC_HV: upstream-reference=Geltungsbereich_E3_1_2_Premium.RP_IF_UI2Sens02_CALID_Index_11_XIX_BMC_HV, ecu-extract-reference=COMPOSITIONTYPE.RP_IF_UI2Sens02_CALID_Index_11_XIX_BMC_HV
      UI2Sens02_CALID_Index_12: upstream-reference=Geltungsbereich_E3_1_2_Premium.RP_IF_UI2Sens02_CALID_Index_12_XIX_BMC_HV.DE_UI2Sens02_CALID_Index_12, ecu-extract-reference=COMPOSITIONTYPE.RP_IF_UI2Sens02_CALID_Index_12_XIX_BMC_HV.DE_UI2Sens02_CALID_Index_12
      RP_IF_UI2Sens02_CALID_Index_12_XIX_BMC_HV: upstream-reference=Geltungsbereich_E3_1_2_Premium.RP_IF_UI2Sens02_CALID_Index_12_XIX_BMC_HV, ecu-extract-reference=COMPOSITIONTYPE.RP_IF_UI2Sens02_CALID_Index_12_XIX_BMC_HV
      UI2Sens02_CALID_Index_13: upstream-reference=Geltungsbereich_E3_1_2_Premium.RP_IF_UI2Sens02_CALID_Index_13_XIX_BMC_HV.DE_UI2Sens02_CALID_Index_13, ecu-extract-reference=COMPOSITIONTYPE.RP_IF_UI2Sens02_CALID_Index_13_XIX_BMC_HV.DE_UI2Sens02_CALID_Index_13
      RP_IF_UI2Sens02_CALID_Index_13_XIX_BMC_HV: upstream-reference=Geltungsbereich_E3_1_2_Premium.RP_IF_UI2Sens02_CALID_Index_13_XIX_BMC_HV, ecu-extract-reference=COMPOSITIONTYPE.RP_IF_UI2Sens02_CALID_Index_13_XIX_BMC_HV
      UI2Sens02_CALID_Index_14: upstream-reference=Geltungsbereich_E3_1_2_Premium.RP_IF_UI2Sens02_CALID_Index_14_XIX_BMC_HV.DE_UI2Sens02_CALID_Index_14, ecu-extract-reference=COMPOSITIONTYPE.RP_IF_UI2Sens02_CALID_Index_14_XIX_BMC_HV.DE_UI2Sens02_CALID_Index_14
      RP_IF_UI2Sens02_CALID_Index_14_XIX_BMC_HV: upstream-reference=Geltungsbereich_E3_1_2_Premium.RP_IF_UI2Sens02_CALID_Index_14_XIX_BMC_HV, ecu-extract-reference=COMPOSITIONTYPE.RP_IF_UI2Sens02_CALID_Index_14_XIX_BMC_HV
      UI2Sens02_CALID_Index_15: upstream-reference=Geltungsbereich_E3_1_2_Premium.RP_IF_UI2Sens02_CALID_Index_15_XIX_BMC_HV.DE_UI2Sens02_CALID_Index_15, ecu-extract-reference=COMPOSITIONTYPE.RP_IF_UI2Sens02_CALID_Index_15_XIX_BMC_HV.DE_UI2Sens02_CALID_Index_15
      RP_IF_UI2Sens02_CALID_Index_15_XIX_BMC_HV: upstream-reference=Geltungsbereich_E3_1_2_Premium.RP_IF_UI2Sens02_CALID_Index_15_XIX_BMC_HV, ecu-extract-reference=COMPOSITIONTYPE.RP_IF_UI2Sens02_CALID_Index_15_XIX_BMC_HV
      UI2Sens02_CALID_Index_16: upstream-reference=Geltungsbereich_E3_1_2_Premium.RP_IF_UI2Sens02_CALID_Index_16_XIX_BMC_HV.DE_UI2Sens02_CALID_Index_16, ecu-extract-reference=COMPOSITIONTYPE.RP_IF_UI2Sens02_CALID_Index_16_XIX_BMC_HV.DE_UI2Sens02_CALID_Index_16
      RP_IF_UI2Sens02_CALID_Index_16_XIX_BMC_HV: upstream-reference=Geltungsbereich_E3_1_2_Premium.RP_IF_UI2Sens02_CALID_Index_16_XIX_BMC_HV, ecu-extract-reference=COMPOSITIONTYPE.RP_IF_UI2Sens02_CALID_Index_16_XIX_BMC_HV
      UI2Sens02_CVN_Byte_1: upstream-reference=Geltungsbereich_E3_1_2_Premium.RP_IF_UI2Sens02_CVN_Byte_1_XIX_BMC_HV.DE_UI2Sens02_CVN_Byte_1, ecu-extract-reference=COMPOSITIONTYPE.RP_IF_UI2Sens02_CVN_Byte_1_XIX_BMC_HV.DE_UI2Sens02_CVN_Byte_1
      RP_IF_UI2Sens02_CVN_Byte_1_XIX_BMC_HV: upstream-reference=Geltungsbereich_E3_1_2_Premium.RP_IF_UI2Sens02_CVN_Byte_1_XIX_BMC_HV, ecu-extract-reference=COMPOSITIONTYPE.RP_IF_UI2Sens02_CVN_Byte_1_XIX_BMC_HV
      UI2Sens02_CVN_Byte_2: upstream-reference=Geltungsbereich_E3_1_2_Premium.RP_IF_UI2Sens02_CVN_Byte_2_XIX_BMC_HV.DE_UI2Sens02_CVN_Byte_2, ecu-extract-reference=COMPOSITIONTYPE.RP_IF_UI2Sens02_CVN_Byte_2_XIX_BMC_HV.DE_UI2Sens02_CVN_Byte_2
      RP_IF_UI2Sens02_CVN_Byte_2_XIX_BMC_HV: upstream-reference=Geltungsbereich_E3_1_2_Premium.RP_IF_UI2Sens02_CVN_Byte_2_XIX_BMC_HV, ecu-extract-reference=COMPOSITIONTYPE.RP_IF_UI2Sens02_CVN_Byte_2_XIX_BMC_HV
      UI2Sens02_CVN_Byte_3: upstream-reference=Geltungsbereich_E3_1_2_Premium.RP_IF_UI2Sens02_CVN_Byte_3_XIX_BMC_HV.DE_UI2Sens02_CVN_Byte_3, ecu-extract-reference=COMPOSITIONTYPE.RP_IF_UI2Sens02_CVN_Byte_3_XIX_BMC_HV.DE_UI2Sens02_CVN_Byte_3
      RP_IF_UI2Sens02_CVN_Byte_3_XIX_BMC_HV: upstream-reference=Geltungsbereich_E3_1_2_Premium.RP_IF_UI2Sens02_CVN_Byte_3_XIX_BMC_HV, ecu-extract-reference=COMPOSITIONTYPE.RP_IF_UI2Sens02_CVN_Byte_3_XIX_BMC_HV
      UI2Sens02_CVN_Byte_4: upstream-reference=Geltungsbereich_E3_1_2_Premium.RP_IF_UI2Sens02_CVN_Byte_4_XIX_BMC_HV.DE_UI2Sens02_CVN_Byte_4, ecu-extract-reference=COMPOSITIONTYPE.RP_IF_UI2Sens02_CVN_Byte_4_XIX_BMC_HV.DE_UI2Sens02_CVN_Byte_4
      RP_IF_UI2Sens02_CVN_Byte_4_XIX_BMC_HV: upstream-reference=Geltungsbereich_E3_1_2_Premium.RP_IF_UI2Sens02_CVN_Byte_4_XIX_BMC_HV, ecu-extract-reference=COMPOSITIONTYPE.RP_IF_UI2Sens02_CVN_Byte_4_XIX_BMC_HV
      UI2Sens02_CVN_VLD: upstream-reference=Geltungsbereich_E3_1_2_Premium.RP_IF_UI2Sens02_CVN_VLD_XIX_BMC_HV.DE_UI2Sens02_CVN_VLD, ecu-extract-reference=COMPOSITIONTYPE.RP_IF_UI2Sens02_CVN_VLD_XIX_BMC_HV.DE_UI2Sens02_CVN_VLD
      RP_IF_UI2Sens02_CVN_VLD_XIX_BMC_HV: upstream-reference=Geltungsbereich_E3_1_2_Premium.RP_IF_UI2Sens02_CVN_VLD_XIX_BMC_HV, ecu-extract-reference=COMPOSITIONTYPE.RP_IF_UI2Sens02_CVN_VLD_XIX_BMC_HV
      UI2Sens02_ErrMem_State: upstream-reference=Geltungsbereich_E3_1_2_Premium.RP_IF_UI2Sens02_ErrMem_State_XIX_BMC_HV.DE_UI2Sens02_ErrMem_State, ecu-extract-reference=COMPOSITIONTYPE.RP_IF_UI2Sens02_ErrMem_State_XIX_BMC_HV.DE_UI2Sens02_ErrMem_State
      RP_IF_UI2Sens02_ErrMem_State_XIX_BMC_HV: upstream-reference=Geltungsbereich_E3_1_2_Premium.RP_IF_UI2Sens02_ErrMem_State_XIX_BMC_HV, ecu-extract-reference=COMPOSITIONTYPE.RP_IF_UI2Sens02_ErrMem_State_XIX_BMC_HV
      VDSO_Vx3d: upstream-reference=Geltungsbereich_E3_1_2_Premium.RP_IF_VDSO_Vx3d_XIX_BMC_HV.DE_VDSO_Vx3d, ecu-extract-reference=COMPOSITIONTYPE.RP_IF_VDSO_Vx3d_XIX_BMC_HV.DE_VDSO_Vx3d
      RP_IF_VDSO_Vx3d_XIX_BMC_HV: upstream-reference=Geltungsbereich_E3_1_2_Premium.RP_IF_VDSO_Vx3d_XIX_BMC_HV, ecu-extract-reference=COMPOSITIONTYPE.RP_IF_VDSO_Vx3d_XIX_BMC_HV
      VIN_10: upstream-reference=Geltungsbereich_E3_1_2_Premium.RP_IF_VIN_10_XIX_BMC_HV.DE_VIN_10, ecu-extract-reference=COMPOSITIONTYPE.RP_IF_VIN_10_XIX_BMC_HV.DE_VIN_10
      RP_IF_VIN_10_XIX_BMC_HV: upstream-reference=Geltungsbereich_E3_1_2_Premium.RP_IF_VIN_10_XIX_BMC_HV, ecu-extract-reference=COMPOSITIONTYPE.RP_IF_VIN_10_XIX_BMC_HV
      VIN_11: upstream-reference=Geltungsbereich_E3_1_2_Premium.RP_IF_VIN_11_XIX_BMC_HV.DE_VIN_11, ecu-extract-reference=COMPOSITIONTYPE.RP_IF_VIN_11_XIX_BMC_HV.DE_VIN_11
      RP_IF_VIN_11_XIX_BMC_HV: upstream-reference=Geltungsbereich_E3_1_2_Premium.RP_IF_VIN_11_XIX_BMC_HV, ecu-extract-reference=COMPOSITIONTYPE.RP_IF_VIN_11_XIX_BMC_HV
      VIN_12: upstream-reference=Geltungsbereich_E3_1_2_Premium.RP_IF_VIN_12_XIX_BMC_HV.DE_VIN_12, ecu-extract-reference=COMPOSITIONTYPE.RP_IF_VIN_12_XIX_BMC_HV.DE_VIN_12
      RP_IF_VIN_12_XIX_BMC_HV: upstream-reference=Geltungsbereich_E3_1_2_Premium.RP_IF_VIN_12_XIX_BMC_HV, ecu-extract-reference=COMPOSITIONTYPE.RP_IF_VIN_12_XIX_BMC_HV
      VIN_13: upstream-reference=Geltungsbereich_E3_1_2_Premium.RP_IF_VIN_13_XIX_BMC_HV.DE_VIN_13, ecu-extract-reference=COMPOSITIONTYPE.RP_IF_VIN_13_XIX_BMC_HV.DE_VIN_13
      RP_IF_VIN_13_XIX_BMC_HV: upstream-reference=Geltungsbereich_E3_1_2_Premium.RP_IF_VIN_13_XIX_BMC_HV, ecu-extract-reference=COMPOSITIONTYPE.RP_IF_VIN_13_XIX_BMC_HV
      VIN_14: upstream-reference=Geltungsbereich_E3_1_2_Premium.RP_IF_VIN_14_XIX_BMC_HV.DE_VIN_14, ecu-extract-reference=COMPOSITIONTYPE.RP_IF_VIN_14_XIX_BMC_HV.DE_VIN_14
      RP_IF_VIN_14_XIX_BMC_HV: upstream-reference=Geltungsbereich_E3_1_2_Premium.RP_IF_VIN_14_XIX_BMC_HV, ecu-extract-reference=COMPOSITIONTYPE.RP_IF_VIN_14_XIX_BMC_HV
      VIN_15: upstream-reference=Geltungsbereich_E3_1_2_Premium.RP_IF_VIN_15_XIX_BMC_HV.DE_VIN_15, ecu-extract-reference=COMPOSITIONTYPE.RP_IF_VIN_15_XIX_BMC_HV.DE_VIN_15
      RP_IF_VIN_15_XIX_BMC_HV: upstream-reference=Geltungsbereich_E3_1_2_Premium.RP_IF_VIN_15_XIX_BMC_HV, ecu-extract-reference=COMPOSITIONTYPE.RP_IF_VIN_15_XIX_BMC_HV
      VIN_16: upstream-reference=Geltungsbereich_E3_1_2_Premium.RP_IF_VIN_16_XIX_BMC_HV.DE_VIN_16, ecu-extract-reference=COMPOSITIONTYPE.RP_IF_VIN_16_XIX_BMC_HV.DE_VIN_16
      RP_IF_VIN_16_XIX_BMC_HV: upstream-reference=Geltungsbereich_E3_1_2_Premium.RP_IF_VIN_16_XIX_BMC_HV, ecu-extract-reference=COMPOSITIONTYPE.RP_IF_VIN_16_XIX_BMC_HV
      VIN_17: upstream-reference=Geltungsbereich_E3_1_2_Premium.RP_IF_VIN_17_XIX_BMC_HV.DE_VIN_17, ecu-extract-reference=COMPOSITIONTYPE.RP_IF_VIN_17_XIX_BMC_HV.DE_VIN_17
      RP_IF_VIN_17_XIX_BMC_HV: upstream-reference=Geltungsbereich_E3_1_2_Premium.RP_IF_VIN_17_XIX_BMC_HV, ecu-extract-reference=COMPOSITIONTYPE.RP_IF_VIN_17_XIX_BMC_HV
      VIN_1: upstream-reference=Geltungsbereich_E3_1_2_Premium.RP_IF_VIN_1_XIX_BMC_HV.DE_VIN_1, ecu-extract-reference=COMPOSITIONTYPE.RP_IF_VIN_1_XIX_BMC_HV.DE_VIN_1
      RP_IF_VIN_1_XIX_BMC_HV: upstream-reference=Geltungsbereich_E3_1_2_Premium.RP_IF_VIN_1_XIX_BMC_HV, ecu-extract-reference=COMPOSITIONTYPE.RP_IF_VIN_1_XIX_BMC_HV
      VIN_2: upstream-reference=Geltungsbereich_E3_1_2_Premium.RP_IF_VIN_2_XIX_BMC_HV.DE_VIN_2, ecu-extract-reference=COMPOSITIONTYPE.RP_IF_VIN_2_XIX_BMC_HV.DE_VIN_2
      RP_IF_VIN_2_XIX_BMC_HV: upstream-reference=Geltungsbereich_E3_1_2_Premium.RP_IF_VIN_2_XIX_BMC_HV, ecu-extract-reference=COMPOSITIONTYPE.RP_IF_VIN_2_XIX_BMC_HV
      VIN_3: upstream-reference=Geltungsbereich_E3_1_2_Premium.RP_IF_VIN_3_XIX_BMC_HV.DE_VIN_3, ecu-extract-reference=COMPOSITIONTYPE.RP_IF_VIN_3_XIX_BMC_HV.DE_VIN_3
      RP_IF_VIN_3_XIX_BMC_HV: upstream-reference=Geltungsbereich_E3_1_2_Premium.RP_IF_VIN_3_XIX_BMC_HV, ecu-extract-reference=COMPOSITIONTYPE.RP_IF_VIN_3_XIX_BMC_HV
      VIN_4: upstream-reference=Geltungsbereich_E3_1_2_Premium.RP_IF_VIN_4_XIX_BMC_HV.DE_VIN_4, ecu-extract-reference=COMPOSITIONTYPE.RP_IF_VIN_4_XIX_BMC_HV.DE_VIN_4
      RP_IF_VIN_4_XIX_BMC_HV: upstream-reference=Geltungsbereich_E3_1_2_Premium.RP_IF_VIN_4_XIX_BMC_HV, ecu-extract-reference=COMPOSITIONTYPE.RP_IF_VIN_4_XIX_BMC_HV
      VIN_5: upstream-reference=Geltungsbereich_E3_1_2_Premium.RP_IF_VIN_5_XIX_BMC_HV.DE_VIN_5, ecu-extract-reference=COMPOSITIONTYPE.RP_IF_VIN_5_XIX_BMC_HV.DE_VIN_5
      RP_IF_VIN_5_XIX_BMC_HV: upstream-reference=Geltungsbereich_E3_1_2_Premium.RP_IF_VIN_5_XIX_BMC_HV, ecu-extract-reference=COMPOSITIONTYPE.RP_IF_VIN_5_XIX_BMC_HV
      VIN_6: upstream-reference=Geltungsbereich_E3_1_2_Premium.RP_IF_VIN_6_XIX_BMC_HV.DE_VIN_6, ecu-extract-reference=COMPOSITIONTYPE.RP_IF_VIN_6_XIX_BMC_HV.DE_VIN_6
      RP_IF_VIN_6_XIX_BMC_HV: upstream-reference=Geltungsbereich_E3_1_2_Premium.RP_IF_VIN_6_XIX_BMC_HV, ecu-extract-reference=COMPOSITIONTYPE.RP_IF_VIN_6_XIX_BMC_HV
      VIN_7: upstream-reference=Geltungsbereich_E3_1_2_Premium.RP_IF_VIN_7_XIX_BMC_HV.DE_VIN_7, ecu-extract-reference=COMPOSITIONTYPE.RP_IF_VIN_7_XIX_BMC_HV.DE_VIN_7
      RP_IF_VIN_7_XIX_BMC_HV: upstream-reference=Geltungsbereich_E3_1_2_Premium.RP_IF_VIN_7_XIX_BMC_HV, ecu-extract-reference=COMPOSITIONTYPE.RP_IF_VIN_7_XIX_BMC_HV
      VIN_8: upstream-reference=Geltungsbereich_E3_1_2_Premium.RP_IF_VIN_8_XIX_BMC_HV.DE_VIN_8, ecu-extract-reference=COMPOSITIONTYPE.RP_IF_VIN_8_XIX_BMC_HV.DE_VIN_8
      RP_IF_VIN_8_XIX_BMC_HV: upstream-reference=Geltungsbereich_E3_1_2_Premium.RP_IF_VIN_8_XIX_BMC_HV, ecu-extract-reference=COMPOSITIONTYPE.RP_IF_VIN_8_XIX_BMC_HV
      VIN_9: upstream-reference=Geltungsbereich_E3_1_2_Premium.RP_IF_VIN_9_XIX_BMC_HV.DE_VIN_9, ecu-extract-reference=COMPOSITIONTYPE.RP_IF_VIN_9_XIX_BMC_HV.DE_VIN_9
      RP_IF_VIN_9_XIX_BMC_HV: upstream-reference=Geltungsbereich_E3_1_2_Premium.RP_IF_VIN_9_XIX_BMC_HV, ecu-extract-reference=COMPOSITIONTYPE.RP_IF_VIN_9_XIX_BMC_HV
      ZM_HV_Auszeit_HiRes: upstream-reference=Geltungsbereich_E3_1_2_Premium.RP_IF_ZM_HV_Auszeit_HiRes_XIX_BMC_HV.DE_ZM_HV_Auszeit_HiRes, ecu-extract-reference=COMPOSITIONTYPE.RP_IF_ZM_HV_Auszeit_HiRes_XIX_BMC_HV.DE_ZM_HV_Auszeit_HiRes
      RP_IF_ZM_HV_Auszeit_HiRes_XIX_BMC_HV: upstream-reference=Geltungsbereich_E3_1_2_Premium.RP_IF_ZM_HV_Auszeit_HiRes_XIX_BMC_HV, ecu-extract-reference=COMPOSITIONTYPE.RP_IF_ZM_HV_Auszeit_HiRes_XIX_BMC_HV
      ZM_HV_Auszeit_Status: upstream-reference=Geltungsbereich_E3_1_2_Premium.RP_IF_ZM_HV_Auszeit_Status_XIX_BMC_HV.DE_ZM_HV_Auszeit_Status, ecu-extract-reference=COMPOSITIONTYPE.RP_IF_ZM_HV_Auszeit_Status_XIX_BMC_HV.DE_ZM_HV_Auszeit_Status
      RP_IF_ZM_HV_Auszeit_Status_XIX_BMC_HV: upstream-reference=Geltungsbereich_E3_1_2_Premium.RP_IF_ZM_HV_Auszeit_Status_XIX_BMC_HV, ecu-extract-reference=COMPOSITIONTYPE.RP_IF_ZM_HV_Auszeit_Status_XIX_BMC_HV
      ZM_HV_Auszeit: upstream-reference=Geltungsbereich_E3_1_2_Premium.RP_IF_ZM_HV_Auszeit_XIX_BMC_HV.DE_ZM_HV_Auszeit, ecu-extract-reference=COMPOSITIONTYPE.RP_IF_ZM_HV_Auszeit_XIX_BMC_HV.DE_ZM_HV_Auszeit
      RP_IF_ZM_HV_Auszeit_XIX_BMC_HV: upstream-reference=Geltungsbereich_E3_1_2_Premium.RP_IF_ZM_HV_Auszeit_XIX_BMC_HV, ecu-extract-reference=COMPOSITIONTYPE.RP_IF_ZM_HV_Auszeit_XIX_BMC_HV
      KN_Hybrid_01_ECUKnockOutTimer: upstream-reference=Geltungsbereich_E3_1_2_Premium.SP_IF_KN_Hybrid_01_ECUKnockOutTimer_XIX_Infrastructure_Hybrid_01_XIX_network_infrastructure_XIX_BMC_HV.DE_KN_Hybrid_01_ECUKnockOutTimer, ecu-extract-reference=COMPOSITIONTYPE.SP_IF_KN_Hybrid_01_ECUKnockOutTimer_XIX_Infrastructure_Hybrid_01_XIX_network_infrastructure_XIX_BMC_HV.DE_KN_Hybrid_01_ECUKnockOutTimer
      SP_IF_KN_Hybrid_01_ECUKnockOutTimer_XIX_Infrastructure_Hybrid_01_XIX_network_infrastructure_XIX_BMC_HV: upstream-reference=Geltungsbereich_E3_1_2_Premium.SP_IF_KN_Hybrid_01_ECUKnockOutTimer_XIX_Infrastructure_Hybrid_01_XIX_network_infrastructure_XIX_BMC_HV, ecu-extract-reference=COMPOSITIONTYPE.SP_IF_KN_Hybrid_01_ECUKnockOutTimer_XIX_Infrastructure_Hybrid_01_XIX_network_infrastructure_XIX_BMC_HV
      SP_IF_KN_Hybrid_01_BusKnockOut_XIX_Infrastructure_Hybrid_01_XIX_network_infrastructure_XIX_BMC_HV: upstream-reference=Geltungsbereich_E3_1_2_Premium.SP_IF_KN_Hybrid_01_BusKnockOut_XIX_Infrastructure_Hybrid_01_XIX_network_infrastructure_XIX_BMC_HV, ecu-extract-reference=COMPOSITIONTYPE.SP_IF_KN_Hybrid_01_BusKnockOut_XIX_Infrastructure_Hybrid_01_XIX_network_infrastructure_XIX_BMC_HV
      SP_IF_KN_Hybrid_01_ECUKnockOut_XIX_Infrastructure_Hybrid_01_XIX_network_infrastructure_XIX_BMC_HV: upstream-reference=Geltungsbereich_E3_1_2_Premium.SP_IF_KN_Hybrid_01_ECUKnockOut_XIX_Infrastructure_Hybrid_01_XIX_network_infrastructure_XIX_BMC_HV, ecu-extract-reference=COMPOSITIONTYPE.SP_IF_KN_Hybrid_01_ECUKnockOut_XIX_Infrastructure_Hybrid_01_XIX_network_infrastructure_XIX_BMC_HV
      KN_Hybrid_01_BusKnockOutTimer: upstream-reference=Geltungsbereich_E3_1_2_Premium.SP_IF_KN_Hybrid_01_BusKnockOutTimer_XIX_Infrastructure_Hybrid_01_XIX_network_infrastructure_XIX_BMC_HV.DE_KN_Hybrid_01_BusKnockOutTimer, ecu-extract-reference=COMPOSITIONTYPE.SP_IF_KN_Hybrid_01_BusKnockOutTimer_XIX_Infrastructure_Hybrid_01_XIX_network_infrastructure_XIX_BMC_HV.DE_KN_Hybrid_01_BusKnockOutTimer
      SP_IF_KN_Hybrid_01_BusKnockOutTimer_XIX_Infrastructure_Hybrid_01_XIX_network_infrastructure_XIX_BMC_HV: upstream-reference=Geltungsbereich_E3_1_2_Premium.SP_IF_KN_Hybrid_01_BusKnockOutTimer_XIX_Infrastructure_Hybrid_01_XIX_network_infrastructure_XIX_BMC_HV, ecu-extract-reference=COMPOSITIONTYPE.SP_IF_KN_Hybrid_01_BusKnockOutTimer_XIX_Infrastructure_Hybrid_01_XIX_network_infrastructure_XIX_BMC_HV
      SP_IF_NM_Hybrid_01_NM_aktiv_Diag_XIX_Infrastructure_Hybrid_01_XIX_network_infrastructure_XIX_BMC_HV: upstream-reference=Geltungsbereich_E3_1_2_Premium.SP_IF_NM_Hybrid_01_NM_aktiv_Diag_XIX_Infrastructure_Hybrid_01_XIX_network_infrastructure_XIX_BMC_HV, ecu-extract-reference=COMPOSITIONTYPE.SP_IF_NM_Hybrid_01_NM_aktiv_Diag_XIX_Infrastructure_Hybrid_01_XIX_network_infrastructure_XIX_BMC_HV
      SP_IF_NM_Hybrid_01_UDS_CC_XIX_Infrastructure_Hybrid_01_XIX_network_infrastructure_XIX_BMC_HV: upstream-reference=Geltungsbereich_E3_1_2_Premium.SP_IF_NM_Hybrid_01_UDS_CC_XIX_Infrastructure_Hybrid_01_XIX_network_infrastructure_XIX_BMC_HV, ecu-extract-reference=COMPOSITIONTYPE.SP_IF_NM_Hybrid_01_UDS_CC_XIX_Infrastructure_Hybrid_01_XIX_network_infrastructure_XIX_BMC_HV
      SP_IF_NM_Hybrid_01_CBV_CRI_XIX_Infrastructure_Hybrid_01_XIX_network_infrastructure_XIX_BMC_HV: upstream-reference=Geltungsbereich_E3_1_2_Premium.SP_IF_NM_Hybrid_01_CBV_CRI_XIX_Infrastructure_Hybrid_01_XIX_network_infrastructure_XIX_BMC_HV, ecu-extract-reference=COMPOSITIONTYPE.SP_IF_NM_Hybrid_01_CBV_CRI_XIX_Infrastructure_Hybrid_01_XIX_network_infrastructure_XIX_BMC_HV
      SP_IF_NM_Hybrid_01_NM_aktiv_Tmin_XIX_Infrastructure_Hybrid_01_XIX_network_infrastructure_XIX_BMC_HV: upstream-reference=Geltungsbereich_E3_1_2_Premium.SP_IF_NM_Hybrid_01_NM_aktiv_Tmin_XIX_Infrastructure_Hybrid_01_XIX_network_infrastructure_XIX_BMC_HV, ecu-extract-reference=COMPOSITIONTYPE.SP_IF_NM_Hybrid_01_NM_aktiv_Tmin_XIX_Infrastructure_Hybrid_01_XIX_network_infrastructure_XIX_BMC_HV
      SP_IF_NM_Hybrid_01_NM_aktiv_KL15_XIX_Infrastructure_Hybrid_01_XIX_network_infrastructure_XIX_BMC_HV: upstream-reference=Geltungsbereich_E3_1_2_Premium.SP_IF_NM_Hybrid_01_NM_aktiv_KL15_XIX_Infrastructure_Hybrid_01_XIX_network_infrastructure_XIX_BMC_HV, ecu-extract-reference=COMPOSITIONTYPE.SP_IF_NM_Hybrid_01_NM_aktiv_KL15_XIX_Infrastructure_Hybrid_01_XIX_network_infrastructure_XIX_BMC_HV
      DEV_Hybrid_01_Req_00_FD_Data: upstream-reference=Geltungsbereich_E3_1_2_Premium.RP_IF_DEV_Hybrid_01_Req_00_FD_Data_XIX_Infrastructure_Hybrid_01_XIX_network_infrastructure_XIX_BMC_HV.DE_DEV_Hybrid_01_Req_00_FD_Data, ecu-extract-reference=COMPOSITIONTYPE.RP_IF_DEV_Hybrid_01_Req_00_FD_Data_XIX_Infrastructure_Hybrid_01_XIX_network_infrastructure_XIX_BMC_HV.DE_DEV_Hybrid_01_Req_00_FD_Data
      RP_IF_DEV_Hybrid_01_Req_00_FD_Data_XIX_Infrastructure_Hybrid_01_XIX_network_infrastructure_XIX_BMC_HV: upstream-reference=Geltungsbereich_E3_1_2_Premium.RP_IF_DEV_Hybrid_01_Req_00_FD_Data_XIX_Infrastructure_Hybrid_01_XIX_network_infrastructure_XIX_BMC_HV, ecu-extract-reference=COMPOSITIONTYPE.RP_IF_DEV_Hybrid_01_Req_00_FD_Data_XIX_Infrastructure_Hybrid_01_XIX_network_infrastructure_XIX_BMC_HV
      DEV_Hybrid_01_Resp_FF_FD_Data: upstream-reference=Geltungsbereich_E3_1_2_Premium.SP_IF_DEV_Hybrid_01_Resp_FF_FD_Data_XIX_Infrastructure_Hybrid_01_XIX_network_infrastructure_XIX_BMC_HV.DE_DEV_Hybrid_01_Resp_FF_FD_Data, ecu-extract-reference=COMPOSITIONTYPE.SP_IF_DEV_Hybrid_01_Resp_FF_FD_Data_XIX_Infrastructure_Hybrid_01_XIX_network_infrastructure_XIX_BMC_HV.DE_DEV_Hybrid_01_Resp_FF_FD_Data
      SP_IF_DEV_Hybrid_01_Resp_FF_FD_Data_XIX_Infrastructure_Hybrid_01_XIX_network_infrastructure_XIX_BMC_HV: upstream-reference=Geltungsbereich_E3_1_2_Premium.SP_IF_DEV_Hybrid_01_Resp_FF_FD_Data_XIX_Infrastructure_Hybrid_01_XIX_network_infrastructure_XIX_BMC_HV, ecu-extract-reference=COMPOSITIONTYPE.SP_IF_DEV_Hybrid_01_Resp_FF_FD_Data_XIX_Infrastructure_Hybrid_01_XIX_network_infrastructure_XIX_BMC_HV
      SP_IF_NM_Hybrid_01_Wakeup_V12_XIX_Infrastructure_Hybrid_01_XIX_network_infrastructure_XIX_BMC_HV: upstream-reference=Geltungsbereich_E3_1_2_Premium.SP_IF_NM_Hybrid_01_Wakeup_V12_XIX_Infrastructure_Hybrid_01_XIX_network_infrastructure_XIX_BMC_HV, ecu-extract-reference=COMPOSITIONTYPE.SP_IF_NM_Hybrid_01_Wakeup_V12_XIX_Infrastructure_Hybrid_01_XIX_network_infrastructure_XIX_BMC_HV
      SP_IF_NM_aktiv_Konditionierungsbedarf_XIX_Infrastructure_Hybrid_01_XIX_network_infrastructure_XIX_BMC_HV: upstream-reference=Geltungsbereich_E3_1_2_Premium.SP_IF_NM_aktiv_Konditionierungsbedarf_XIX_Infrastructure_Hybrid_01_XIX_network_infrastructure_XIX_BMC_HV, ecu-extract-reference=COMPOSITIONTYPE.SP_IF_NM_aktiv_Konditionierungsbedarf_XIX_Infrastructure_Hybrid_01_XIX_network_infrastructure_XIX_BMC_HV
      SP_IF_NM_Hybrid_01_Lokalaktiv_XIX_Infrastructure_Hybrid_01_XIX_network_infrastructure_XIX_BMC_HV: upstream-reference=Geltungsbereich_E3_1_2_Premium.SP_IF_NM_Hybrid_01_Lokalaktiv_XIX_Infrastructure_Hybrid_01_XIX_network_infrastructure_XIX_BMC_HV, ecu-extract-reference=COMPOSITIONTYPE.SP_IF_NM_Hybrid_01_Lokalaktiv_XIX_Infrastructure_Hybrid_01_XIX_network_infrastructure_XIX_BMC_HV
      SP_IF_NM_Hybrid_01_Subsystemaktiv_XIX_Infrastructure_Hybrid_01_XIX_network_infrastructure_XIX_BMC_HV: upstream-reference=Geltungsbereich_E3_1_2_Premium.SP_IF_NM_Hybrid_01_Subsystemaktiv_XIX_Infrastructure_Hybrid_01_XIX_network_infrastructure_XIX_BMC_HV, ecu-extract-reference=COMPOSITIONTYPE.SP_IF_NM_Hybrid_01_Subsystemaktiv_XIX_Infrastructure_Hybrid_01_XIX_network_infrastructure_XIX_BMC_HV
      SP_IF_NM_aktiv_SubbusSteuerung_BMC_HV_XIX_Infrastructure_Hybrid_01_XIX_network_infrastructure_XIX_BMC_HV: upstream-reference=Geltungsbereich_E3_1_2_Premium.SP_IF_NM_aktiv_SubbusSteuerung_BMC_HV_XIX_Infrastructure_Hybrid_01_XIX_network_infrastructure_XIX_BMC_HV, ecu-extract-reference=COMPOSITIONTYPE.SP_IF_NM_aktiv_SubbusSteuerung_BMC_HV_XIX_Infrastructure_Hybrid_01_XIX_network_infrastructure_XIX_BMC_HV
      ISO_ALL_01_Req_Data: upstream-reference=Geltungsbereich_E3_1_2_Premium.RP_IF_ISO_ALL_01_Req_Data_XIX_diagnosis_infrastructure_Hybrid_01_XIX_diagnosis_infrastructure_XIX_BMC_HV.DE_ISO_ALL_01_Req_Data, ecu-extract-reference=COMPOSITIONTYPE.RP_IF_ISO_ALL_01_Req_Data_XIX_diagnosis_infrastructure_Hybrid_01_XIX_diagnosis_infrastructure_XIX_BMC_HV.DE_ISO_ALL_01_Req_Data
      RP_IF_ISO_ALL_01_Req_Data_XIX_diagnosis_infrastructure_Hybrid_01_XIX_diagnosis_infrastructure_XIX_BMC_HV: upstream-reference=Geltungsbereich_E3_1_2_Premium.RP_IF_ISO_ALL_01_Req_Data_XIX_diagnosis_infrastructure_Hybrid_01_XIX_diagnosis_infrastructure_XIX_BMC_HV, ecu-extract-reference=COMPOSITIONTYPE.RP_IF_ISO_ALL_01_Req_Data_XIX_diagnosis_infrastructure_Hybrid_01_XIX_diagnosis_infrastructure_XIX_BMC_HV
      ISO_ALL_01_Req_Data_001: upstream-reference=Geltungsbereich_E3_1_2_Premium.SP_IF_ISO_ALL_01_Req_Data_XIX_diagnosis_infrastructure_Hybrid_01_XIX_diagnosis_infrastructure_XIX_BMC_HV.DE_ISO_ALL_01_Req_Data, ecu-extract-reference=COMPOSITIONTYPE.SP_IF_ISO_ALL_01_Req_Data_XIX_diagnosis_infrastructure_Hybrid_01_XIX_diagnosis_infrastructure_XIX_BMC_HV.DE_ISO_ALL_01_Req_Data
      SP_IF_ISO_ALL_01_Req_Data_XIX_diagnosis_infrastructure_Hybrid_01_XIX_diagnosis_infrastructure_XIX_BMC_HV: upstream-reference=Geltungsbereich_E3_1_2_Premium.SP_IF_ISO_ALL_01_Req_Data_XIX_diagnosis_infrastructure_Hybrid_01_XIX_diagnosis_infrastructure_XIX_BMC_HV, ecu-extract-reference=COMPOSITIONTYPE.SP_IF_ISO_ALL_01_Req_Data_XIX_diagnosis_infrastructure_Hybrid_01_XIX_diagnosis_infrastructure_XIX_BMC_HV
      SP_IF_Hybrid_01_KompSchutz_XIX_KS_BMC_HV_XIX_KSGen3_XIX_BMC_HV: upstream-reference=Geltungsbereich_E3_1_2_Premium.SP_IF_Hybrid_01_KompSchutz_XIX_KS_BMC_HV_XIX_KSGen3_XIX_BMC_HV, ecu-extract-reference=COMPOSITIONTYPE.SP_IF_Hybrid_01_KompSchutz_XIX_KS_BMC_HV_XIX_KSGen3_XIX_BMC_HV
      ShA: upstream-reference=Geltungsbereich_E3_1_2_Premium.Ivd.ShA, ecu-extract-reference=COMPOSITIONTYPE.ShA
      NvA: upstream-reference=Geltungsbereich_E3_1_2_Premium.Ivd.NvA, ecu-extract-reference=COMPOSITIONTYPE.NvA
      DiagA: upstream-reference=Geltungsbereich_E3_1_2_Premium.Ivd.DiagA, ecu-extract-reference=COMPOSITIONTYPE.DiagA
      AppDataA: upstream-reference=Geltungsbereich_E3_1_2_Premium.Ivd.AppDataA, ecu-extract-reference=COMPOSITIONTYPE.AppDataA
      SG_BMC_HV_13: upstream-reference=Geltungsbereich_E3_1_2_Premium.SG_BMC_HV_13, ecu-extract-reference=COMPOSITIONTYPE.SG_BMC_HV_13
      SG_BMC_HV_14: upstream-reference=Geltungsbereich_E3_1_2_Premium.SG_BMC_HV_14, ecu-extract-reference=COMPOSITIONTYPE.SG_BMC_HV_14
      BJB_ErrMem_State_1: upstream-reference=Geltungsbereich_E3_1_2_Premium.BJB_ErrMem_State_1, ecu-extract-reference=COMPOSITIONTYPE.BJB_ErrMem_State_1
      BAPConfig: upstream-reference=Geltungsbereich_E3_1_2_Premium.BAPConfig, ecu-extract-reference=COMPOSITIONTYPE.BAPConfig
      ctASG_LSG1: upstream-reference=Geltungsbereich_E3_1_2_Premium.ctASG_LSG1, ecu-extract-reference=COMPOSITIONTYPE.ctASG_LSG1
      SG_BMC_HV_12: upstream-reference=Geltungsbereich_E3_1_2_Premium.SG_BMC_HV_12, ecu-extract-reference=COMPOSITIONTYPE.SG_BMC_HV_12
      SG_BMC_HV_15: upstream-reference=Geltungsbereich_E3_1_2_Premium.SG_BMC_HV_15, ecu-extract-reference=COMPOSITIONTYPE.SG_BMC_HV_15
      AB_Deaktivierung_HV_001: upstream-reference=Geltungsbereich_E3_1_2_Premium.AB_Deaktivierung_HV, ecu-extract-reference=COMPOSITIONTYPE.AB_Deaktivierung_HV
      RT_Vishnu: upstream-reference=Geltungsbereich_E3_1_2_Premium.RT_Vishnu, ecu-extract-reference=COMPOSITIONTYPE.RT_Vishnu
      SG_BMC_HV_11: upstream-reference=Geltungsbereich_E3_1_2_Premium.SG_BMC_HV_11, ecu-extract-reference=COMPOSITIONTYPE.SG_BMC_HV_11
      SG_BMC_HV_16: upstream-reference=Geltungsbereich_E3_1_2_Premium.SG_BMC_HV_16, ecu-extract-reference=COMPOSITIONTYPE.SG_BMC_HV_16
      SG_BMC_HV_10: upstream-reference=Geltungsbereich_E3_1_2_Premium.SG_BMC_HV_10, ecu-extract-reference=COMPOSITIONTYPE.SG_BMC_HV_10
      SG_BMC_HV_18: upstream-reference=Geltungsbereich_E3_1_2_Premium.SG_BMC_HV_18, ecu-extract-reference=COMPOSITIONTYPE.SG_BMC_HV_18
      SG_BMC_HV_04: upstream-reference=Geltungsbereich_E3_1_2_Premium.SG_BMC_HV_04, ecu-extract-reference=COMPOSITIONTYPE.SG_BMC_HV_04
      SG_BMC_HV_01: upstream-reference=Geltungsbereich_E3_1_2_Premium.SG_BMC_HV_01, ecu-extract-reference=COMPOSITIONTYPE.SG_BMC_HV_01
      SG_BMC_HV_02: upstream-reference=Geltungsbereich_E3_1_2_Premium.SG_BMC_HV_02, ecu-extract-reference=COMPOSITIONTYPE.SG_BMC_HV_02
      SG_KS_Hybrid_01_Challenge_K: upstream-reference=Geltungsbereich_E3_1_2_Premium.SG_KS_Hybrid_01_Challenge_K.SG_KS_Hybrid_01_Challenge_K, ecu-extract-reference=COMPOSITIONTYPE.SG_KS_Hybrid_01_Challenge_K.SG_KS_Hybrid_01_Challenge_K
      SG_KS_Hybrid_01_Challenge_K_001: upstream-reference=Geltungsbereich_E3_1_2_Premium.SG_KS_Hybrid_01_Challenge_K, ecu-extract-reference=COMPOSITIONTYPE.SG_KS_Hybrid_01_Challenge_K
      SG_KS_Hybrid_01_ReqFrame: upstream-reference=Geltungsbereich_E3_1_2_Premium.SG_KS_Hybrid_01_ReqFrame.SG_KS_Hybrid_01_ReqFrame, ecu-extract-reference=COMPOSITIONTYPE.SG_KS_Hybrid_01_ReqFrame.SG_KS_Hybrid_01_ReqFrame
      SG_KS_Hybrid_01_ReqFrame_001: upstream-reference=Geltungsbereich_E3_1_2_Premium.SG_KS_Hybrid_01_ReqFrame, ecu-extract-reference=COMPOSITIONTYPE.SG_KS_Hybrid_01_ReqFrame
      SG_KS_Hybrid_01_Response_K: upstream-reference=Geltungsbereich_E3_1_2_Premium.SG_KS_Hybrid_01_Response_K.SG_KS_Hybrid_01_Response_K, ecu-extract-reference=COMPOSITIONTYPE.SG_KS_Hybrid_01_Response_K.SG_KS_Hybrid_01_Response_K
      SG_KS_Hybrid_01_Response_K_001: upstream-reference=Geltungsbereich_E3_1_2_Premium.SG_KS_Hybrid_01_Response_K, ecu-extract-reference=COMPOSITIONTYPE.SG_KS_Hybrid_01_Response_K
      SG_BJB_11: upstream-reference=Geltungsbereich_E3_1_2_Premium.SG_BJB_11, ecu-extract-reference=COMPOSITIONTYPE.SG_BJB_11
      SG_BJB_10: upstream-reference=Geltungsbereich_E3_1_2_Premium.SG_BJB_10.SG_BJB_10, ecu-extract-reference=COMPOSITIONTYPE.SG_BJB_10.SG_BJB_10
      SG_BJB_12: upstream-reference=Geltungsbereich_E3_1_2_Premium.SG_BJB_10, ecu-extract-reference=COMPOSITIONTYPE.SG_BJB_10
      SG_BJB_13: upstream-reference=Geltungsbereich_E3_1_2_Premium.SG_BJB_12, ecu-extract-reference=COMPOSITIONTYPE.SG_BJB_12
      SG_BJB_14: upstream-reference=Geltungsbereich_E3_1_2_Premium.SG_BJB_13.SG_BJB_11, ecu-extract-reference=COMPOSITIONTYPE.SG_BJB_13.SG_BJB_11
      SG_BJB_15: upstream-reference=Geltungsbereich_E3_1_2_Premium.SG_BJB_13, ecu-extract-reference=COMPOSITIONTYPE.SG_BJB_13
      SG_BJB_16: upstream-reference=Geltungsbereich_E3_1_2_Premium.SG_BJB_14, ecu-extract-reference=COMPOSITIONTYPE.SG_BJB_14
      SG_BJB_17: upstream-reference=Geltungsbereich_E3_1_2_Premium.SG_BJB_15.SG_BJB_12, ecu-extract-reference=COMPOSITIONTYPE.SG_BJB_15.SG_BJB_12
      SG_BJB_18: upstream-reference=Geltungsbereich_E3_1_2_Premium.SG_BJB_15, ecu-extract-reference=COMPOSITIONTYPE.SG_BJB_15
      SG_BJB_19: upstream-reference=Geltungsbereich_E3_1_2_Premium.SG_BJB_16.SG_BJB_13, ecu-extract-reference=COMPOSITIONTYPE.SG_BJB_16.SG_BJB_13
      SG_BJB_20: upstream-reference=Geltungsbereich_E3_1_2_Premium.SG_BJB_16, ecu-extract-reference=COMPOSITIONTYPE.SG_BJB_16
      SG_BMC_HV_05: upstream-reference=Geltungsbereich_E3_1_2_Premium.SG_BMC_HV_5.SG_BMC_HV_04, ecu-extract-reference=COMPOSITIONTYPE.SG_BMC_HV_5.SG_BMC_HV_04
      SG_BMC_HV_5: upstream-reference=Geltungsbereich_E3_1_2_Premium.SG_BMC_HV_5, ecu-extract-reference=COMPOSITIONTYPE.SG_BMC_HV_5
      SG_BMC_HV_17: upstream-reference=Geltungsbereich_E3_1_2_Premium.SG_BMC_HV_17.SG_BMC_HV_10, ecu-extract-reference=COMPOSITIONTYPE.SG_BMC_HV_17.SG_BMC_HV_10
      SG_BMC_HV_19: upstream-reference=Geltungsbereich_E3_1_2_Premium.SG_BMC_HV_17, ecu-extract-reference=COMPOSITIONTYPE.SG_BMC_HV_17
      SG_BMC_HV_20: upstream-reference=Geltungsbereich_E3_1_2_Premium.SG_BMC_HV_19.SG_BMC_HV_11, ecu-extract-reference=COMPOSITIONTYPE.SG_BMC_HV_19.SG_BMC_HV_11
      SG_BMC_HV_21: upstream-reference=Geltungsbereich_E3_1_2_Premium.SG_BMC_HV_19, ecu-extract-reference=COMPOSITIONTYPE.SG_BMC_HV_19
      SG_BMC_HV_22: upstream-reference=Geltungsbereich_E3_1_2_Premium.SG_BMC_HV_20.SG_BMC_HV_12, ecu-extract-reference=COMPOSITIONTYPE.SG_BMC_HV_20.SG_BMC_HV_12
      SG_BMC_HV_23: upstream-reference=Geltungsbereich_E3_1_2_Premium.SG_BMC_HV_20, ecu-extract-reference=COMPOSITIONTYPE.SG_BMC_HV_20
      SG_BMC_HV_24: upstream-reference=Geltungsbereich_E3_1_2_Premium.SG_BMC_HV_21.SG_BMC_HV_13, ecu-extract-reference=COMPOSITIONTYPE.SG_BMC_HV_21.SG_BMC_HV_13
      SG_BMC_HV_25: upstream-reference=Geltungsbereich_E3_1_2_Premium.SG_BMC_HV_21, ecu-extract-reference=COMPOSITIONTYPE.SG_BMC_HV_21
      Vishnu_Test_100Bytes_PDU_NewSignal1_37542d23452fe910: upstream-reference=Geltungsbereich_E3_1_2_Premium.Vishnu_Test_100Bytes_PDU_NewSignal1_37542d23452fe910, ecu-extract-reference=COMPOSITIONTYPE.Vishnu_Test_100Bytes_PDU_NewSignal1_37542d23452fe910
      Vishnu_Test_100Bytes_PDU_NewSignal2_302017e93d94206c: upstream-reference=Geltungsbereich_E3_1_2_Premium.Vishnu_Test_100Bytes_PDU_NewSignal2_302017e93d94206c, ecu-extract-reference=COMPOSITIONTYPE.Vishnu_Test_100Bytes_PDU_NewSignal2_302017e93d94206c
      Vishnu_Test_100Bytes_PDU_NewSignal3_ebd34b418955d5b1: upstream-reference=Geltungsbereich_E3_1_2_Premium.Vishnu_Test_100Bytes_PDU_NewSignal3_ebd34b418955d5b1, ecu-extract-reference=COMPOSITIONTYPE.Vishnu_Test_100Bytes_PDU_NewSignal3_ebd34b418955d5b1
      Vishnu_Test_100Bytes_PDU_NewSignal4_21c239f862026de9: upstream-reference=Geltungsbereich_E3_1_2_Premium.Vishnu_Test_100Bytes_PDU_NewSignal4_21c239f862026de9, ecu-extract-reference=COMPOSITIONTYPE.Vishnu_Test_100Bytes_PDU_NewSignal4_21c239f862026de9
      Vishnu_Test_100Bytes_PDU_NewSignal5_2a9e79b5a4a81ebd: upstream-reference=Geltungsbereich_E3_1_2_Premium.Vishnu_Test_100Bytes_PDU_NewSignal5_2a9e79b5a4a81ebd.Vishnu_Test_100Bytes_PDU_NewSignal5_2a9e79b5a4a81ebd, ecu-extract-reference=COMPOSITIONTYPE.Vishnu_Test_100Bytes_PDU_NewSignal5_2a9e79b5a4a81ebd.Vishnu_Test_100Bytes_PDU_NewSignal5_2a9e79b5a4a81ebd
      Vishnu_Test_100Bytes_PDU_NewSignal5_2a9e79b5a4a81ebd_001: upstream-reference=Geltungsbereich_E3_1_2_Premium.Vishnu_Test_100Bytes_PDU_NewSignal5_2a9e79b5a4a81ebd, ecu-extract-reference=COMPOSITIONTYPE.Vishnu_Test_100Bytes_PDU_NewSignal5_2a9e79b5a4a81ebd
      DTC_Test_PDU_Set_Signal_e68158b3301efab7: upstream-reference=Geltungsbereich_E3_1_2_Premium.DTC_Test_PDU_Set_Signal_e68158b3301efab7.DTC_Test_PDU_Set_Signal_e68158b3301efab7, ecu-extract-reference=COMPOSITIONTYPE.DTC_Test_PDU_Set_Signal_e68158b3301efab7.DTC_Test_PDU_Set_Signal_e68158b3301efab7
      DTC_Test_PDU_Set_Signal_e68158b3301efab7_001: upstream-reference=Geltungsbereich_E3_1_2_Premium.DTC_Test_PDU_Set_Signal_e68158b3301efab7, ecu-extract-reference=COMPOSITIONTYPE.DTC_Test_PDU_Set_Signal_e68158b3301efab7
