[part 3 of 12: package /Cluster]
AUTOSAR XML (schema 4-3-0)
package /Cluster  (continued)
  can cluster HCP5_CANFD01: baudrate=500000, protocol-name=CAN, protocol-version=2.0, bus-off-recovery={bor-counter-l-1-to-l-2=1, bor-time-l-1=0.05, bor-time-l-2=0.2}, can-fd-baudrate=2000000  (continued)
    can physical channel CHNL: comm-connectors=CN_HCP5_CANFD01  (continued)
      frame BMC_CMC_Temperatur_02_XIX_HCP5_CANFD01: id 0x1A55562B, from BMC_HV, frame-length=24, can-addressing-mode=EXTENDED, can-frame-rx-behavior=CAN-FD, can-frame-tx-behavior=CAN-FD
        pdu BMC_CMC_Temperatur_02_XIX_HCP5_CANFD01: length=24, transmission-mode-true-timing=cyclic-timing={time-offset=0, time-period=1}, unused-bit-pattern=0
          signal BMC_CMC_Temperatur_059_XIX_BMC_CMC_Temperatur_02_XIX_HCP5_CANFD01: start 16, 8 bit, little-endian, data-type-policy=OVERRIDE, i-signal-type=PRIMITIVE, init-value=254, base-type=BT_BMC_CMC_Temperatur_059, invalid-value=Invalid_BMC_CMC_Temperatur_059_XIX_BMC_CMC_Temperatur_02_XIX_HCP5_CANFD01:255, compu {phys=raw*0.5-40 for raw 0..252, 253=Cxfd_nicht_vorhanden (CM_BMC_CMC_Temperatur_059_Cxfd_nicht_vorhanden), 254=Cxfe_Init (CM_BMC_CMC_Temperatur_059_Cxfe_Init), 255=Cxff_Fehler (CM_BMC_CMC_Temperatur_059_Cxff_Fehler); unit Unit_DegreCelsi}, range phys -40..86 Unit_DegreCelsi, raw 0..255, unit=Unit_DegreCelsi, transfer-property=PENDING  # Temperatur Zellmodul fuer die Uebertragung per RTM
          signal BMC_CMC_Temperatur_060_XIX_BMC_CMC_Temperatur_02_XIX_HCP5_CANFD01: start 24, 8 bit, little-endian, data-type-policy=OVERRIDE, i-signal-type=PRIMITIVE, init-value=254, base-type=BT_BMC_CMC_Temperatur_060, invalid-value=Invalid_BMC_CMC_Temperatur_060_XIX_BMC_CMC_Temperatur_02_XIX_HCP5_CANFD01:255, compu {phys=raw*0.5-40 for raw 0..252, 253=Cxfd_nicht_vorhanden (CM_BMC_CMC_Temperatur_060_Cxfd_nicht_vorhanden), 254=Cxfe_Init (CM_BMC_CMC_Temperatur_060_Cxfe_Init), 255=Cxff_Fehler (CM_BMC_CMC_Temperatur_060_Cxff_Fehler); unit Unit_DegreCelsi}, range phys -40..86 Unit_DegreCelsi, raw 0..255, unit=Unit_DegreCelsi, transfer-property=PENDING  # Temperatur Zellmodul fuer die Uebertragung per RTM
          signal BMC_CMC_Temperatur_061_XIX_BMC_CMC_Temperatur_02_XIX_HCP5_CANFD01: start 32, 8 bit, little-endian, data-type-policy=OVERRIDE, i-signal-type=PRIMITIVE, init-value=254, base-type=BT_BMC_CMC_Temperatur_061, invalid-value=Invalid_BMC_CMC_Temperatur_061_XIX_BMC_CMC_Temperatur_02_XIX_HCP5_CANFD01:255, compu {phys=raw*0.5-40 for raw 0..252, 253=Cxfd_nicht_vorhanden (CM_BMC_CMC_Temperatur_061_Cxfd_nicht_vorhanden), 254=Cxfe_Init (CM_BMC_CMC_Temperatur_061_Cxfe_Init), 255=Cxff_Fehler (CM_BMC_CMC_Temperatur_061_Cxff_Fehler); unit Unit_DegreCelsi}, range phys -40..86 Unit_DegreCelsi, raw 0..255, unit=Unit_DegreCelsi, transfer-property=PENDING  # Temperatur Zellmodul fuer die Uebertragung per RTM
          signal BMC_CMC_Temperatur_062_XIX_BMC_CMC_Temperatur_02_XIX_HCP5_CANFD01: start 40, 8 bit, little-endian, data-type-policy=OVERRIDE, i-signal-type=PRIMITIVE, init-value=254, base-type=BT_BMC_CMC_Temperatur_062, invalid-value=Invalid_BMC_CMC_Temperatur_062_XIX_BMC_CMC_Temperatur_02_XIX_HCP5_CANFD01:255, compu {phys=raw*0.5-40 for raw 0..252, 253=Cxfd_nicht_vorhanden (CM_BMC_CMC_Temperatur_062_Cxfd_nicht_vorhanden), 254=Cxfe_Init (CM_BMC_CMC_Temperatur_062_Cxfe_Init), 255=Cxff_Fehler (CM_BMC_CMC_Temperatur_062_Cxff_Fehler); unit Unit_DegreCelsi}, range phys -40..86 Unit_DegreCelsi, raw 0..255, unit=Unit_DegreCelsi, transfer-property=PENDING  # Temperatur Zellmodul fuer die Uebertragung per RTM
          signal BMC_CMC_Temperatur_063_XIX_BMC_CMC_Temperatur_02_XIX_HCP5_CANFD01: start 48, 8 bit, little-endian, data-type-policy=OVERRIDE, i-signal-type=PRIMITIVE, init-value=254, base-type=BT_BMC_CMC_Temperatur_063, invalid-value=Invalid_BMC_CMC_Temperatur_063_XIX_BMC_CMC_Temperatur_02_XIX_HCP5_CANFD01:255, compu {phys=raw*0.5-40 for raw 0..252, 253=Cxfd_nicht_vorhanden (CM_BMC_CMC_Temperatur_063_Cxfd_nicht_vorhanden), 254=Cxfe_Init (CM_BMC_CMC_Temperatur_063_Cxfe_Init), 255=Cxff_Fehler (CM_BMC_CMC_Temperatur_063_Cxff_Fehler); unit Unit_DegreCelsi}, range phys -40..86 Unit_DegreCelsi, raw 0..255, unit=Unit_DegreCelsi, transfer-property=PENDING  # Temperatur Zellmodul fuer die Uebertragung per RTM
          signal BMC_CMC_Temperatur_064_XIX_BMC_CMC_Temperatur_02_XIX_HCP5_CANFD01: start 56, 8 bit, little-endian, data-type-policy=OVERRIDE, i-signal-type=PRIMITIVE, init-value=254, base-type=BT_BMC_CMC_Temperatur_064, invalid-value=Invalid_BMC_CMC_Temperatur_064_XIX_BMC_CMC_Temperatur_02_XIX_HCP5_CANFD01:255, compu {phys=raw*0.5-40 for raw 0..252, 253=Cxfd_nicht_vorhanden (CM_BMC_CMC_Temperatur_064_Cxfd_nicht_vorhanden), 254=Cxfe_Init (CM_BMC_CMC_Temperatur_064_Cxfe_Init), 255=Cxff_Fehler (CM_BMC_CMC_Temperatur_064_Cxff_Fehler); unit Unit_DegreCelsi}, range phys -40..86 Unit_DegreCelsi, raw 0..255, unit=Unit_DegreCelsi, transfer-property=PENDING  # Temperatur Zellmodul fuer die Uebertragung per RTM
          signal BMC_CMC_Temperatur_065_XIX_BMC_CMC_Temperatur_02_XIX_HCP5_CANFD01: start 64, 8 bit, little-endian, data-type-policy=OVERRIDE, i-signal-type=PRIMITIVE, init-value=254, base-type=BT_BMC_CMC_Temperatur_065, invalid-value=Invalid_BMC_CMC_Temperatur_065_XIX_BMC_CMC_Temperatur_02_XIX_HCP5_CANFD01:255, compu {phys=raw*0.5-40 for raw 0..252, 253=Cxfd_nicht_vorhanden (CM_BMC_CMC_Temperatur_065_Cxfd_nicht_vorhanden), 254=Cxfe_Init (CM_BMC_CMC_Temperatur_065_Cxfe_Init), 255=Cxff_Fehler (CM_BMC_CMC_Temperatur_065_Cxff_Fehler); unit Unit_DegreCelsi}, range phys -40..86 Unit_DegreCelsi, raw 0..255, unit=Unit_DegreCelsi, transfer-property=PENDING  # Temperatur Zellmodul fuer die Uebertragung per RTM
          signal BMC_CMC_Temperatur_066_XIX_BMC_CMC_Temperatur_02_XIX_HCP5_CANFD01: start 72, 8 bit, little-endian, data-type-policy=OVERRIDE, i-signal-type=PRIMITIVE, init-value=254, base-type=BT_BMC_CMC_Temperatur_066, invalid-value=Invalid_BMC_CMC_Temperatur_066_XIX_BMC_CMC_Temperatur_02_XIX_HCP5_CANFD01:255, compu {phys=raw*0.5-40 for raw 0..252, 253=Cxfd_nicht_vorhanden (CM_BMC_CMC_Temperatur_066_Cxfd_nicht_vorhanden), 254=Cxfe_Init (CM_BMC_CMC_Temperatur_066_Cxfe_Init), 255=Cxff_Fehler (CM_BMC_CMC_Temperatur_066_Cxff_Fehler); unit Unit_DegreCelsi}, range phys -40..86 Unit_DegreCelsi, raw 0..255, unit=Unit_DegreCelsi, transfer-property=PENDING  # Temperatur Zellmodul fuer die Uebertragung per RTM
          signal BMC_CMC_Temperatur_067_XIX_BMC_CMC_Temperatur_02_XIX_HCP5_CANFD01: start 80, 8 bit, little-endian, data-type-policy=OVERRIDE, i-signal-type=PRIMITIVE, init-value=254, base-type=BT_BMC_CMC_Temperatur_067, invalid-value=Invalid_BMC_CMC_Temperatur_067_XIX_BMC_CMC_Temperatur_02_XIX_HCP5_CANFD01:255, compu {phys=raw*0.5-40 for raw 0..252, 253=Cxfd_nicht_vorhanden (CM_BMC_CMC_Temperatur_067_Cxfd_nicht_vorhanden), 254=Cxfe_Init (CM_BMC_CMC_Temperatur_067_Cxfe_Init), 255=Cxff_Fehler (CM_BMC_CMC_Temperatur_067_Cxff_Fehler); unit Unit_DegreCelsi}, range phys -40..86 Unit_DegreCelsi, raw 0..255, unit=Unit_DegreCelsi, transfer-property=PENDING  # Temperatur Zellmodul fuer die Uebertragung per RTM
          signal BMC_CMC_Temperatur_068_XIX_BMC_CMC_Temperatur_02_XIX_HCP5_CANFD01: start 88, 8 bit, little-endian, data-type-policy=OVERRIDE, i-signal-type=PRIMITIVE, init-value=254, base-type=BT_BMC_CMC_Temperatur_068, invalid-value=Invalid_BMC_CMC_Temperatur_068_XIX_BMC_CMC_Temperatur_02_XIX_HCP5_CANFD01:255, compu {phys=raw*0.5-40 for raw 0..252, 253=Cxfd_nicht_vorhanden (CM_BMC_CMC_Temperatur_068_Cxfd_nicht_vorhanden), 254=Cxfe_Init (CM_BMC_CMC_Temperatur_068_Cxfe_Init), 255=Cxff_Fehler (CM_BMC_CMC_Temperatur_068_Cxff_Fehler); unit Unit_DegreCelsi}, range phys -40..86 Unit_DegreCelsi, raw 0..255, unit=Unit_DegreCelsi, transfer-property=PENDING  # Temperatur Zellmodul fuer die Uebertragung per RTM
          signal BMC_CMC_Temperatur_069_XIX_BMC_CMC_Temperatur_02_XIX_HCP5_CANFD01: start 96, 8 bit, little-endian, data-type-policy=OVERRIDE, i-signal-type=PRIMITIVE, init-value=254, base-type=BT_BMC_CMC_Temperatur_069, invalid-value=Invalid_BMC_CMC_Temperatur_069_XIX_BMC_CMC_Temperatur_02_XIX_HCP5_CANFD01:255, compu {phys=raw*0.5-40 for raw 0..252, 253=Cxfd_nicht_vorhanden (CM_BMC_CMC_Temperatur_069_Cxfd_nicht_vorhanden), 254=Cxfe_Init (CM_BMC_CMC_Temperatur_069_Cxfe_Init), 255=Cxff_Fehler (CM_BMC_CMC_Temperatur_069_Cxff_Fehler); unit Unit_DegreCelsi}, range phys -40..86 Unit_DegreCelsi, raw 0..255, unit=Unit_DegreCelsi, transfer-property=PENDING  # Temperatur Zellmodul fuer die Uebertragung per RTM
          signal BMC_CMC_Temperatur_070_XIX_BMC_CMC_Temperatur_02_XIX_HCP5_CANFD01: start 104, 8 bit, little-endian, data-type-policy=OVERRIDE, i-signal-type=PRIMITIVE, init-value=254, base-type=BT_BMC_CMC_Temperatur_070, invalid-value=Invalid_BMC_CMC_Temperatur_070_XIX_BMC_CMC_Temperatur_02_XIX_HCP5_CANFD01:255, compu {phys=raw*0.5-40 for raw 0..252, 253=Cxfd_nicht_vorhanden (CM_BMC_CMC_Temperatur_070_Cxfd_nicht_vorhanden), 254=Cxfe_Init (CM_BMC_CMC_Temperatur_070_Cxfe_Init), 255=Cxff_Fehler (CM_BMC_CMC_Temperatur_070_Cxff_Fehler); unit Unit_DegreCelsi}, range phys -40..86 Unit_DegreCelsi, raw 0..255, unit=Unit_DegreCelsi, transfer-property=PENDING  # Temperatur Zellmodul fuer die Uebertragung per RTM
          signal BMC_CMC_Temperatur_071_XIX_BMC_CMC_Temperatur_02_XIX_HCP5_CANFD01: start 112, 8 bit, little-endian, data-type-policy=OVERRIDE, i-signal-type=PRIMITIVE, init-value=254, base-type=BT_BMC_CMC_Temperatur_071, invalid-value=Invalid_BMC_CMC_Temperatur_071_XIX_BMC_CMC_Temperatur_02_XIX_HCP5_CANFD01:255, compu {phys=raw*0.5-40 for raw 0..252, 253=Cxfd_nicht_vorhanden (CM_BMC_CMC_Temperatur_071_Cxfd_nicht_vorhanden), 254=Cxfe_Init (CM_BMC_CMC_Temperatur_071_Cxfe_Init), 255=Cxff_Fehler (CM_BMC_CMC_Temperatur_071_Cxff_Fehler); unit Unit_DegreCelsi}, range phys -40..86 Unit_DegreCelsi, raw 0..255, unit=Unit_DegreCelsi, transfer-property=PENDING  # Temperatur Zellmodul fuer die Uebertragung per RTM
          signal BMC_CMC_Temperatur_072_XIX_BMC_CMC_Temperatur_02_XIX_HCP5_CANFD01: start 120, 8 bit, little-endian, data-type-policy=OVERRIDE, i-signal-type=PRIMITIVE, init-value=254, base-type=BT_BMC_CMC_Temperatur_072, invalid-value=Invalid_BMC_CMC_Temperatur_072_XIX_BMC_CMC_Temperatur_02_XIX_HCP5_CANFD01:255, compu {phys=raw*0.5-40 for raw 0..252, 253=Cxfd_nicht_vorhanden (CM_BMC_CMC_Temperatur_072_Cxfd_nicht_vorhanden), 254=Cxfe_Init (CM_BMC_CMC_Temperatur_072_Cxfe_Init), 255=Cxff_Fehler (CM_BMC_CMC_Temperatur_072_Cxff_Fehler); unit Unit_DegreCelsi}, range phys -40..86 Unit_DegreCelsi, raw 0..255, unit=Unit_DegreCelsi, transfer-property=PENDING  # Temperatur Zellmodul fuer die Uebertragung per RTM
          signal BMC_CMC_Temperatur_02_Messzeit_XIX_BMC_CMC_Temperatur_02_XIX_HCP5_CANFD01: start 128, 8 bit, little-endian, data-type-policy=OVERRIDE, i-signal-type=PRIMITIVE, init-value=254, base-type=BT_BMC_CMC_Temperatur_02_Messzeit, invalid-value=Invalid_BMC_CMC_Temperatur_02_Messzeit_XIX_BMC_CMC_Temperatur_02_XIX_HCP5_CANFD01:255, compu {phys=raw for raw 0..253, 254=Cxfe_Init (CM_BMC_CMC_Temperatur_02_Messzeit_Cxfe_Init), 255=Cxff_Fehler (CM_BMC_CMC_Temperatur_02_Messzeit_Cxff_Fehler); unit Unit_None}, range phys 0..253 Unit_None, raw 0..255, unit=Unit_None, transfer-property=PENDING  # Messzeit zu Botschaft BMC_CMC_Temperatur_02
      frame BMC_CMC_Temperatur_03_XIX_HCP5_CANFD01: id 0x1A55566C, from BMC_HV, frame-length=64, can-addressing-mode=EXTENDED, can-frame-rx-behavior=CAN-FD, can-frame-tx-behavior=CAN-FD
        pdu BMC_CMC_Temperatur_03_XIX_HCP5_CANFD01: length=64, transmission-mode-true-timing=cyclic-timing={time-offset=0, time-period=1}, unused-bit-pattern=0
          signal BMC_CMC_Temperatur_073_XIX_BMC_CMC_Temperatur_03_XIX_HCP5_CANFD01: start 16, 8 bit, little-endian, data-type-policy=OVERRIDE, i-signal-type=PRIMITIVE, init-value=254, base-type=BT_BMC_CMC_Temperatur_073, invalid-value=Invalid_BMC_CMC_Temperatur_073_XIX_BMC_CMC_Temperatur_03_XIX_HCP5_CANFD01:255, compu {phys=raw*0.5-40 for raw 0..252, 253=Cxfd_nicht_vorhanden (CM_BMC_CMC_Temperatur_073_Cxfd_nicht_vorhanden), 254=Cxfe_Init (CM_BMC_CMC_Temperatur_073_Cxfe_Init), 255=Cxff_Fehler (CM_BMC_CMC_Temperatur_073_Cxff_Fehler); unit Unit_DegreCelsi}, range phys -40..86 Unit_DegreCelsi, raw 0..255, unit=Unit_DegreCelsi, transfer-property=PENDING  # Temperatur Zellmodul fuer die Uebertragung per RTM
          signal BMC_CMC_Temperatur_074_XIX_BMC_CMC_Temperatur_03_XIX_HCP5_CANFD01: start 24, 8 bit, little-endian, data-type-policy=OVERRIDE, i-signal-type=PRIMITIVE, init-value=254, base-type=BT_BMC_CMC_Temperatur_074, invalid-value=Invalid_BMC_CMC_Temperatur_074_XIX_BMC_CMC_Temperatur_03_XIX_HCP5_CANFD01:255, compu {phys=raw*0.5-40 for raw 0..252, 253=Cxfd_nicht_vorhanden (CM_BMC_CMC_Temperatur_074_Cxfd_nicht_vorhanden), 254=Cxfe_Init (CM_BMC_CMC_Temperatur_074_Cxfe_Init), 255=Cxff_Fehler (CM_BMC_CMC_Temperatur_074_Cxff_Fehler); unit Unit_DegreCelsi}, range phys -40..86 Unit_DegreCelsi, raw 0..255, unit=Unit_DegreCelsi, transfer-property=PENDING  # Temperatur Zellmodul fuer die Uebertragung per RTM
          signal BMC_CMC_Temperatur_075_XIX_BMC_CMC_Temperatur_03_XIX_HCP5_CANFD01: start 32, 8 bit, little-endian, data-type-policy=OVERRIDE, i-signal-type=PRIMITIVE, init-value=254, base-type=BT_BMC_CMC_Temperatur_075, invalid-value=Invalid_BMC_CMC_Temperatur_075_XIX_BMC_CMC_Temperatur_03_XIX_HCP5_CANFD01:255, compu {phys=raw*0.5-40 for raw 0..252, 253=Cxfd_nicht_vorhanden (CM_BMC_CMC_Temperatur_075_Cxfd_nicht_vorhanden), 254=Cxfe_Init (CM_BMC_CMC_Temperatur_075_Cxfe_Init), 255=Cxff_Fehler (CM_BMC_CMC_Temperatur_075_Cxff_Fehler); unit Unit_DegreCelsi}, range phys -40..86 Unit_DegreCelsi, raw 0..255, unit=Unit_DegreCelsi, transfer-property=PENDING  # Temperatur Zellmodul fuer die Uebertragung per RTM
          signal BMC_CMC_Temperatur_076_XIX_BMC_CMC_Temperatur_03_XIX_HCP5_CANFD01: start 40, 8 bit, little-endian, data-type-policy=OVERRIDE, i-signal-type=PRIMITIVE, init-value=254, base-type=BT_BMC_CMC_Temperatur_076, invalid-value=Invalid_BMC_CMC_Temperatur_076_XIX_BMC_CMC_Temperatur_03_XIX_HCP5_CANFD01:255, compu {phys=raw*0.5-40 for raw 0..252, 253=Cxfd_nicht_vorhanden (CM_BMC_CMC_Temperatur_076_Cxfd_nicht_vorhanden), 254=Cxfe_Init (CM_BMC_CMC_Temperatur_076_Cxfe_Init), 255=Cxff_Fehler (CM_BMC_CMC_Temperatur_076_Cxff_Fehler); unit Unit_DegreCelsi}, range phys -40..86 Unit_DegreCelsi, raw 0..255, unit=Unit_DegreCelsi, transfer-property=PENDING  # Temperatur Zellmodul fuer die Uebertragung per RTM
          signal BMC_CMC_Temperatur_077_XIX_BMC_CMC_Temperatur_03_XIX_HCP5_CANFD01: start 48, 8 bit, little-endian, data-type-policy=OVERRIDE, i-signal-type=PRIMITIVE, init-value=254, base-type=BT_BMC_CMC_Temperatur_077, invalid-value=Invalid_BMC_CMC_Temperatur_077_XIX_BMC_CMC_Temperatur_03_XIX_HCP5_CANFD01:255, compu {phys=raw*0.5-40 for raw 0..252, 253=Cxfd_nicht_vorhanden (CM_BMC_CMC_Temperatur_077_Cxfd_nicht_vorhanden), 254=Cxfe_Init (CM_BMC_CMC_Temperatur_077_Cxfe_Init), 255=Cxff_Fehler (CM_BMC_CMC_Temperatur_077_Cxff_Fehler); unit Unit_DegreCelsi}, range phys -40..86 Unit_DegreCelsi, raw 0..255, unit=Unit_DegreCelsi, transfer-property=PENDING  # Temperatur Zellmodul fuer die Uebertragung per RTM
          signal BMC_CMC_Temperatur_078_XIX_BMC_CMC_Temperatur_03_XIX_HCP5_CANFD01: start 56, 8 bit, little-endian, data-type-policy=OVERRIDE, i-signal-type=PRIMITIVE, init-value=254, base-type=BT_BMC_CMC_Temperatur_078, invalid-value=Invalid_BMC_CMC_Temperatur_078_XIX_BMC_CMC_Temperatur_03_XIX_HCP5_CANFD01:255, compu {phys=raw*0.5-40 for raw 0..252, 253=Cxfd_nicht_vorhanden (CM_BMC_CMC_Temperatur_078_Cxfd_nicht_vorhanden), 254=Cxfe_Init (CM_BMC_CMC_Temperatur_078_Cxfe_Init), 255=Cxff_Fehler (CM_BMC_CMC_Temperatur_078_Cxff_Fehler); unit Unit_DegreCelsi}, range phys -40..86 Unit_DegreCelsi, raw 0..255, unit=Unit_DegreCelsi, transfer-property=PENDING  # Temperatur Zellmodul fuer die Uebertragung per RTM
          signal BMC_CMC_Temperatur_079_XIX_BMC_CMC_Temperatur_03_XIX_HCP5_CANFD01: start 64, 8 bit, little-endian, data-type-policy=OVERRIDE, i-signal-type=PRIMITIVE, init-value=254, base-type=BT_BMC_CMC_Temperatur_079, invalid-value=Invalid_BMC_CMC_Temperatur_079_XIX_BMC_CMC_Temperatur_03_XIX_HCP5_CANFD01:255, compu {phys=raw*0.5-40 for raw 0..252, 253=Cxfd_nicht_vorhanden (CM_BMC_CMC_Temperatur_079_Cxfd_nicht_vorhanden), 254=Cxfe_Init (CM_BMC_CMC_Temperatur_079_Cxfe_Init), 255=Cxff_Fehler (CM_BMC_CMC_Temperatur_079_Cxff_Fehler); unit Unit_DegreCelsi}, range phys -40..86 Unit_DegreCelsi, raw 0..255, unit=Unit_DegreCelsi, transfer-property=PENDING  # Temperatur Zellmodul fuer die Uebertragung per RTM
          signal BMC_CMC_Temperatur_080_XIX_BMC_CMC_Temperatur_03_XIX_HCP5_CANFD01: start 72, 8 bit, little-endian, data-type-policy=OVERRIDE, i-signal-type=PRIMITIVE, init-value=254, base-type=BT_BMC_CMC_Temperatur_080, invalid-value=Invalid_BMC_CMC_Temperatur_080_XIX_BMC_CMC_Temperatur_03_XIX_HCP5_CANFD01:255, compu {phys=raw*0.5-40 for raw 0..252, 253=Cxfd_nicht_vorhanden (CM_BMC_CMC_Temperatur_080_Cxfd_nicht_vorhanden), 254=Cxfe_Init (CM_BMC_CMC_Temperatur_080_Cxfe_Init), 255=Cxff_Fehler (CM_BMC_CMC_Temperatur_080_Cxff_Fehler); unit Unit_DegreCelsi}, range phys -40..86 Unit_DegreCelsi, raw 0..255, unit=Unit_DegreCelsi, transfer-property=PENDING  # Temperatur Zellmodul fuer die Uebertragung per RTM
          signal BMC_CMC_Temperatur_081_XIX_BMC_CMC_Temperatur_03_XIX_HCP5_CANFD01: start 80, 8 bit, little-endian, data-type-policy=OVERRIDE, i-signal-type=PRIMITIVE, init-value=254, base-type=BT_BMC_CMC_Temperatur_081, invalid-value=Invalid_BMC_CMC_Temperatur_081_XIX_BMC_CMC_Temperatur_03_XIX_HCP5_CANFD01:255, compu {phys=raw*0.5-40 for raw 0..252, 253=Cxfd_nicht_vorhanden (CM_BMC_CMC_Temperatur_081_Cxfd_nicht_vorhanden), 254=Cxfe_Init (CM_BMC_CMC_Temperatur_081_Cxfe_Init), 255=Cxff_Fehler (CM_BMC_CMC_Temperatur_081_Cxff_Fehler); unit Unit_DegreCelsi}, range phys -40..86 Unit_DegreCelsi, raw 0..255, unit=Unit_DegreCelsi, transfer-property=PENDING  # Temperatur Zellmodul fuer die Uebertragung per RTM
          signal BMC_CMC_Temperatur_082_XIX_BMC_CMC_Temperatur_03_XIX_HCP5_CANFD01: start 88, 8 bit, little-endian, data-type-policy=OVERRIDE, i-signal-type=PRIMITIVE, init-value=254, base-type=BT_BMC_CMC_Temperatur_082, invalid-value=Invalid_BMC_CMC_Temperatur_082_XIX_BMC_CMC_Temperatur_03_XIX_HCP5_CANFD01:255, compu {phys=raw*0.5-40 for raw 0..252, 253=Cxfd_nicht_vorhanden (CM_BMC_CMC_Temperatur_082_Cxfd_nicht_vorhanden), 254=Cxfe_Init (CM_BMC_CMC_Temperatur_082_Cxfe_Init), 255=Cxff_Fehler (CM_BMC_CMC_Temperatur_082_Cxff_Fehler); unit Unit_DegreCelsi}, range phys -40..86 Unit_DegreCelsi, raw 0..255, unit=Unit_DegreCelsi, transfer-property=PENDING  # Temperatur Zellmodul fuer die Uebertragung per RTM
          signal BMC_CMC_Temperatur_083_XIX_BMC_CMC_Temperatur_03_XIX_HCP5_CANFD01: start 96, 8 bit, little-endian, data-type-policy=OVERRIDE, i-signal-type=PRIMITIVE, init-value=254, base-type=BT_BMC_CMC_Temperatur_083, invalid-value=Invalid_BMC_CMC_Temperatur_083_XIX_BMC_CMC_Temperatur_03_XIX_HCP5_CANFD01:255, compu {phys=raw*0.5-40 for raw 0..252, 253=Cxfd_nicht_vorhanden (CM_BMC_CMC_Temperatur_083_Cxfd_nicht_vorhanden), 254=Cxfe_Init (CM_BMC_CMC_Temperatur_083_Cxfe_Init), 255=Cxff_Fehler (CM_BMC_CMC_Temperatur_083_Cxff_Fehler); unit Unit_DegreCelsi}, range phys -40..86 Unit_DegreCelsi, raw 0..255, unit=Unit_DegreCelsi, transfer-property=PENDING  # Temperatur Zellmodul fuer die Uebertragung per RTM
          signal BMC_CMC_Temperatur_084_XIX_BMC_CMC_Temperatur_03_XIX_HCP5_CANFD01: start 104, 8 bit, little-endian, data-type-policy=OVERRIDE, i-signal-type=PRIMITIVE, init-value=254, base-type=BT_BMC_CMC_Temperatur_084, invalid-value=Invalid_BMC_CMC_Temperatur_084_XIX_BMC_CMC_Temperatur_03_XIX_HCP5_CANFD01:255, compu {phys=raw*0.5-40 for raw 0..252, 253=Cxfd_nicht_vorhanden (CM_BMC_CMC_Temperatur_084_Cxfd_nicht_vorhanden), 254=Cxfe_Init (CM_BMC_CMC_Temperatur_084_Cxfe_Init), 255=Cxff_Fehler (CM_BMC_CMC_Temperatur_084_Cxff_Fehler); unit Unit_DegreCelsi}, range phys -40..86 Unit_DegreCelsi, raw 0..255, unit=Unit_DegreCelsi, transfer-property=PENDING  # Temperatur Zellmodul fuer die Uebertragung per RTM
          signal BMC_CMC_Temperatur_085_XIX_BMC_CMC_Temperatur_03_XIX_HCP5_CANFD01: start 112, 8 bit, little-endian, data-type-policy=OVERRIDE, i-signal-type=PRIMITIVE, init-value=254, base-type=BT_BMC_CMC_Temperatur_085, invalid-value=Invalid_BMC_CMC_Temperatur_085_XIX_BMC_CMC_Temperatur_03_XIX_HCP5_CANFD01:255, compu {phys=raw*0.5-40 for raw 0..252, 253=Cxfd_nicht_vorhanden (CM_BMC_CMC_Temperatur_085_Cxfd_nicht_vorhanden), 254=Cxfe_Init (CM_BMC_CMC_Temperatur_085_Cxfe_Init), 255=Cxff_Fehler (CM_BMC_CMC_Temperatur_085_Cxff_Fehler); unit Unit_DegreCelsi}, range phys -40..86 Unit_DegreCelsi, raw 0..255, unit=Unit_DegreCelsi, transfer-property=PENDING  # Temperatur Zellmodul fuer die Uebertragung per RTM
          signal BMC_CMC_Temperatur_086_XIX_BMC_CMC_Temperatur_03_XIX_HCP5_CANFD01: start 120, 8 bit, little-endian, data-type-policy=OVERRIDE, i-signal-type=PRIMITIVE, init-value=254, base-type=BT_BMC_CMC_Temperatur_086, invalid-value=Invalid_BMC_CMC_Temperatur_086_XIX_BMC_CMC_Temperatur_03_XIX_HCP5_CANFD01:255, compu {phys=raw*0.5-40 for raw 0..252, 253=Cxfd_nicht_vorhanden (CM_BMC_CMC_Temperatur_086_Cxfd_nicht_vorhanden), 254=Cxfe_Init (CM_BMC_CMC_Temperatur_086_Cxfe_Init), 255=Cxff_Fehler (CM_BMC_CMC_Temperatur_086_Cxff_Fehler); unit Unit_DegreCelsi}, range phys -40..86 Unit_DegreCelsi, raw 0..255, unit=Unit_DegreCelsi, transfer-property=PENDING  # Temperatur Zellmodul fuer die Uebertragung per RTM
          signal BMC_CMC_Temperatur_087_XIX_BMC_CMC_Temperatur_03_XIX_HCP5_CANFD01: start 128, 8 bit, little-endian, data-type-policy=OVERRIDE, i-signal-type=PRIMITIVE, init-value=254, base-type=BT_BMC_CMC_Temperatur_087, invalid-value=Invalid_BMC_CMC_Temperatur_087_XIX_BMC_CMC_Temperatur_03_XIX_HCP5_CANFD01:255, compu {phys=raw*0.5-40 for raw 0..252, 253=Cxfd_nicht_vorhanden (CM_BMC_CMC_Temperatur_087_Cxfd_nicht_vorhanden), 254=Cxfe_Init (CM_BMC_CMC_Temperatur_087_Cxfe_Init), 255=Cxff_Fehler (CM_BMC_CMC_Temperatur_087_Cxff_Fehler); unit Unit_DegreCelsi}, range phys -40..86 Unit_DegreCelsi, raw 0..255, unit=Unit_DegreCelsi, transfer-property=PENDING  # Temperatur Zellmodul fuer die Uebertragung per RTM
          signal BMC_CMC_Temperatur_088_XIX_BMC_CMC_Temperatur_03_XIX_HCP5_CANFD01: start 136, 8 bit, little-endian, data-type-policy=OVERRIDE, i-signal-type=PRIMITIVE, init-value=254, base-type=BT_BMC_CMC_Temperatur_088, invalid-value=Invalid_BMC_CMC_Temperatur_088_XIX_BMC_CMC_Temperatur_03_XIX_HCP5_CANFD01:255, compu {phys=raw*0.5-40 for raw 0..252, 253=Cxfd_nicht_vorhanden (CM_BMC_CMC_Temperatur_088_Cxfd_nicht_vorhanden), 254=Cxfe_Init (CM_BMC_CMC_Temperatur_088_Cxfe_Init), 255=Cxff_Fehler (CM_BMC_CMC_Temperatur_088_Cxff_Fehler); unit Unit_DegreCelsi}, range phys -40..86 Unit_DegreCelsi, raw 0..255, unit=Unit_DegreCelsi, transfer-property=PENDING  # Temperatur Zellmodul fuer die Uebertragung per RTM
          signal BMC_CMC_Temperatur_089_XIX_BMC_CMC_Temperatur_03_XIX_HCP5_CANFD01: start 144, 8 bit, little-endian, data-type-policy=OVERRIDE, i-signal-type=PRIMITIVE, init-value=254, base-type=BT_BMC_CMC_Temperatur_089, invalid-value=Invalid_BMC_CMC_Temperatur_089_XIX_BMC_CMC_Temperatur_03_XIX_HCP5_CANFD01:255, compu {phys=raw*0.5-40 for raw 0..252, 253=Cxfd_nicht_vorhanden (CM_BMC_CMC_Temperatur_089_Cxfd_nicht_vorhanden), 254=Cxfe_Init (CM_BMC_CMC_Temperatur_089_Cxfe_Init), 255=Cxff_Fehler (CM_BMC_CMC_Temperatur_089_Cxff_Fehler); unit Unit_DegreCelsi}, range phys -40..86 Unit_DegreCelsi, raw 0..255, unit=Unit_DegreCelsi, transfer-property=PENDING  # Temperatur Zellmodul fuer die Uebertragung per RTM
          signal BMC_CMC_Temperatur_090_XIX_BMC_CMC_Temperatur_03_XIX_HCP5_CANFD01: start 152, 8 bit, little-endian, data-type-policy=OVERRIDE, i-signal-type=PRIMITIVE, init-value=254, base-type=BT_BMC_CMC_Temperatur_090, invalid-value=Invalid_BMC_CMC_Temperatur_090_XIX_BMC_CMC_Temperatur_03_XIX_HCP5_CANFD01:255, compu {phys=raw*0.5-40 for raw 0..252, 253=Cxfd_nicht_vorhanden (CM_BMC_CMC_Temperatur_090_Cxfd_nicht_vorhanden), 254=Cxfe_Init (CM_BMC_CMC_Temperatur_090_Cxfe_Init), 255=Cxff_Fehler (CM_BMC_CMC_Temperatur_090_Cxff_Fehler); unit Unit_DegreCelsi}, range phys -40..86 Unit_DegreCelsi, raw 0..255, unit=Unit_DegreCelsi, transfer-property=PENDING  # Temperatur Zellmodul fuer die Uebertragung per RTM
          signal BMC_CMC_Temperatur_091_XIX_BMC_CMC_Temperatur_03_XIX_HCP5_CANFD01: start 160, 8 bit, little-endian, data-type-policy=OVERRIDE, i-signal-type=PRIMITIVE, init-value=254, base-type=BT_BMC_CMC_Temperatur_091, invalid-value=Invalid_BMC_CMC_Temperatur_091_XIX_BMC_CMC_Temperatur_03_XIX_HCP5_CANFD01:255, compu {phys=raw*0.5-40 for raw 0..252, 253=Cxfd_nicht_vorhanden (CM_BMC_CMC_Temperatur_091_Cxfd_nicht_vorhanden), 254=Cxfe_Init (CM_BMC_CMC_Temperatur_091_Cxfe_Init), 255=Cxff_Fehler (CM_BMC_CMC_Temperatur_091_Cxff_Fehler); unit Unit_DegreCelsi}, range phys -40..86 Unit_DegreCelsi, raw 0..255, unit=Unit_DegreCelsi, transfer-property=PENDING  # Temperatur Zellmodul fuer die Uebertragung per RTM
          signal BMC_CMC_Temperatur_092_XIX_BMC_CMC_Temperatur_03_XIX_HCP5_CANFD01: start 168, 8 bit, little-endian, data-type-policy=OVERRIDE, i-signal-type=PRIMITIVE, init-value=254, base-type=BT_BMC_CMC_Temperatur_092, invalid-value=Invalid_BMC_CMC_Temperatur_092_XIX_BMC_CMC_Temperatur_03_XIX_HCP5_CANFD01:255, compu {phys=raw*0.5-40 for raw 0..252, 253=Cxfd_nicht_vorhanden (CM_BMC_CMC_Temperatur_092_Cxfd_nicht_vorhanden), 254=Cxfe_Init (CM_BMC_CMC_Temperatur_092_Cxfe_Init), 255=Cxff_Fehler (CM_BMC_CMC_Temperatur_092_Cxff_Fehler); unit Unit_DegreCelsi}, range phys -40..86 Unit_DegreCelsi, raw 0..255, unit=Unit_DegreCelsi, transfer-property=PENDING  # Temperatur Zellmodul fuer die Uebertragung per RTM
          signal BMC_CMC_Temperatur_093_XIX_BMC_CMC_Temperatur_03_XIX_HCP5_CANFD01: start 176, 8 bit, little-endian, data-type-policy=OVERRIDE, i-signal-type=PRIMITIVE, init-value=254, base-type=BT_BMC_CMC_Temperatur_093, invalid-value=Invalid_BMC_CMC_Temperatur_093_XIX_BMC_CMC_Temperatur_03_XIX_HCP5_CANFD01:255, compu {phys=raw*0.5-40 for raw 0..252, 253=Cxfd_nicht_vorhanden (CM_BMC_CMC_Temperatur_093_Cxfd_nicht_vorhanden), 254=Cxfe_Init (CM_BMC_CMC_Temperatur_093_Cxfe_Init), 255=Cxff_Fehler (CM_BMC_CMC_Temperatur_093_Cxff_Fehler); unit Unit_DegreCelsi}, range phys -40..86 Unit_DegreCelsi, raw 0..255, unit=Unit_DegreCelsi, transfer-property=PENDING  # Temperatur Zellmodul fuer die Uebertragung per RTM
          signal BMC_CMC_Temperatur_094_XIX_BMC_CMC_Temperatur_03_XIX_HCP5_CANFD01: start 184, 8 bit, little-endian, data-type-policy=OVERRIDE, i-signal-type=PRIMITIVE, init-value=254, base-type=BT_BMC_CMC_Temperatur_094, invalid-value=Invalid_BMC_CMC_Temperatur_094_XIX_BMC_CMC_Temperatur_03_XIX_HCP5_CANFD01:255, compu {phys=raw*0.5-40 for raw 0..252, 253=Cxfd_nicht_vorhanden (CM_BMC_CMC_Temperatur_094_Cxfd_nicht_vorhanden), 254=Cxfe_Init (CM_BMC_CMC_Temperatur_094_Cxfe_Init), 255=Cxff_Fehler (CM_BMC_CMC_Temperatur_094_Cxff_Fehler); unit Unit_DegreCelsi}, range phys -40..86 Unit_DegreCelsi, raw 0..255, unit=Unit_DegreCelsi, transfer-property=PENDING  # Temperatur Zellmodul fuer die Uebertragung per RTM
          signal BMC_CMC_Temperatur_095_XIX_BMC_CMC_Temperatur_03_XIX_HCP5_CANFD01: start 192, 8 bit, little-endian, data-type-policy=OVERRIDE, i-signal-type=PRIMITIVE, init-value=254, base-type=BT_BMC_CMC_Temperatur_095, invalid-value=Invalid_BMC_CMC_Temperatur_095_XIX_BMC_CMC_Temperatur_03_XIX_HCP5_CANFD01:255, compu {phys=raw*0.5-40 for raw 0..252, 253=Cxfd_nicht_vorhanden (CM_BMC_CMC_Temperatur_095_Cxfd_nicht_vorhanden), 254=Cxfe_Init (CM_BMC_CMC_Temperatur_095_Cxfe_Init), 255=Cxff_Fehler (CM_BMC_CMC_Temperatur_095_Cxff_Fehler); unit Unit_DegreCelsi}, range phys -40..86 Unit_DegreCelsi, raw 0..255, unit=Unit_DegreCelsi, transfer-property=PENDING  # Temperatur Zellmodul fuer die Uebertragung per RTM
          signal BMC_CMC_Temperatur_096_XIX_BMC_CMC_Temperatur_03_XIX_HCP5_CANFD01: start 200, 8 bit, little-endian, data-type-policy=OVERRIDE, i-signal-type=PRIMITIVE, init-value=254, base-type=BT_BMC_CMC_Temperatur_096, invalid-value=Invalid_BMC_CMC_Temperatur_096_XIX_BMC_CMC_Temperatur_03_XIX_HCP5_CANFD01:255, compu {phys=raw*0.5-40 for raw 0..252, 253=Cxfd_nicht_vorhanden (CM_BMC_CMC_Temperatur_096_Cxfd_nicht_vorhanden), 254=Cxfe_Init (CM_BMC_CMC_Temperatur_096_Cxfe_Init), 255=Cxff_Fehler (CM_BMC_CMC_Temperatur_096_Cxff_Fehler); unit Unit_DegreCelsi}, range phys -40..86 Unit_DegreCelsi, raw 0..255, unit=Unit_DegreCelsi, transfer-property=PENDING  # Temperatur Zellmodul fuer die Uebertragung per RTM
          signal BMC_CMC_Temperatur_03_Messzeit_XIX_BMC_CMC_Temperatur_03_XIX_HCP5_CANFD01: start 480, 8 bit, little-endian, data-type-policy=OVERRIDE, i-signal-type=PRIMITIVE, init-value=254, base-type=BT_BMC_CMC_Temperatur_03_Messzeit, invalid-value=Invalid_BMC_CMC_Temperatur_03_Messzeit_XIX_BMC_CMC_Temperatur_03_XIX_HCP5_CANFD01:255, compu {phys=raw for raw 0..253, 254=Cxfe_Init (CM_BMC_CMC_Temperatur_03_Messzeit_Cxfe_Init), 255=Cxff_Fehler (CM_BMC_CMC_Temperatur_03_Messzeit_Cxff_Fehler); unit Unit_None}, range phys 0..253 Unit_None, raw 0..255, unit=Unit_None, transfer-property=PENDING  # Messzeit zu Botschaft BMC_CMC_Temperatur_03
      frame BMC_CMC_Zellspannung_01_XIX_HCP5_CANFD01: id 0x1A55562C, from BMC_HV, frame-length=64, can-addressing-mode=EXTENDED, can-frame-rx-behavior=CAN-FD, can-frame-tx-behavior=CAN-FD
        pdu BMC_CMC_Zellspannung_01_XIX_HCP5_CANFD01: length=64, transmission-mode-true-timing=cyclic-timing={time-offset=0, time-period=1}, unused-bit-pattern=0
          signal BMC_CMC_Zellspannung_001_XIX_BMC_CMC_Zellspannung_01_XIX_HCP5_CANFD01: start 12, 12 bit, little-endian, data-type-policy=OVERRIDE, i-signal-type=PRIMITIVE, init-value=4094, base-type=BT_BMC_CMC_Zellspannung_001, invalid-value=Invalid_BMC_CMC_Zellspannung_001_XIX_BMC_CMC_Zellspannung_01_XIX_HCP5_CANFD01:4095, compu {phys=raw+1000 for raw 0..4091, 4092=Cxffc_kleiner_1V (CM_BMC_CMC_Zellspannung_001_Cxffc_kleiner_1V), 4093=Cxffd_nicht_vorhanden (CM_BMC_CMC_Zellspannung_001_Cxffd_nicht_vorhanden), 4094=Cxffe_Init (CM_BMC_CMC_Zellspannung_001_Cxffe_Init), 4095=Cxfff_Fehler (CM_BMC_CMC_Zellspannung_001_Cxfff_Fehler); unit Unit_MilliVolt}, range phys 1000..5091 Unit_MilliVolt, raw 0..4095, unit=Unit_MilliVolt, transfer-property=PENDING  # Einzelzellspannung zur Uebertragung per RTM
          signal BMC_CMC_Zellspannung_002_XIX_BMC_CMC_Zellspannung_01_XIX_HCP5_CANFD01: start 24, 12 bit, little-endian, data-type-policy=OVERRIDE, i-signal-type=PRIMITIVE, init-value=4094, base-type=BT_BMC_CMC_Zellspannung_002, invalid-value=Invalid_BMC_CMC_Zellspannung_002_XIX_BMC_CMC_Zellspannung_01_XIX_HCP5_CANFD01:4095, compu {phys=raw+1000 for raw 0..4091, 4092=Cxffc_kleiner_1V (CM_BMC_CMC_Zellspannung_002_Cxffc_kleiner_1V), 4093=Cxffd_nicht_vorhanden (CM_BMC_CMC_Zellspannung_002_Cxffd_nicht_vorhanden), 4094=Cxffe_Init (CM_BMC_CMC_Zellspannung_002_Cxffe_Init), 4095=Cxfff_Fehler (CM_BMC_CMC_Zellspannung_002_Cxfff_Fehler); unit Unit_MilliVolt}, range phys 1000..5091 Unit_MilliVolt, raw 0..4095, unit=Unit_MilliVolt, transfer-property=PENDING  # Einzelzellspannung zur Uebertragung per RTM
          signal BMC_CMC_Zellspannung_003_XIX_BMC_CMC_Zellspannung_01_XIX_HCP5_CANFD01: start 36, 12 bit, little-endian, data-type-policy=OVERRIDE, i-signal-type=PRIMITIVE, init-value=4094, base-type=BT_BMC_CMC_Zellspannung_003, invalid-value=Invalid_BMC_CMC_Zellspannung_003_XIX_BMC_CMC_Zellspannung_01_XIX_HCP5_CANFD01:4095, compu {phys=raw+1000 for raw 0..4091, 4092=Cxffc_kleiner_1V (CM_BMC_CMC_Zellspannung_003_Cxffc_kleiner_1V), 4093=Cxffd_nicht_vorhanden (CM_BMC_CMC_Zellspannung_003_Cxffd_nicht_vorhanden), 4094=Cxffe_Init (CM_BMC_CMC_Zellspannung_003_Cxffe_Init), 4095=Cxfff_Fehler (CM_BMC_CMC_Zellspannung_003_Cxfff_Fehler); unit Unit_MilliVolt}, range phys 1000..5091 Unit_MilliVolt, raw 0..4095, unit=Unit_MilliVolt, transfer-property=PENDING  # Einzelzellspannung zur Uebertragung per RTM
          signal BMC_CMC_Zellspannung_004_XIX_BMC_CMC_Zellspannung_01_XIX_HCP5_CANFD01: start 48, 12 bit, little-endian, data-type-policy=OVERRIDE, i-signal-type=PRIMITIVE, init-value=4094, base-type=BT_BMC_CMC_Zellspannung_004, invalid-value=Invalid_BMC_CMC_Zellspannung_004_XIX_BMC_CMC_Zellspannung_01_XIX_HCP5_CANFD01:4095, compu {phys=raw+1000 for raw 0..4091, 4092=Cxffc_kleiner_1V (CM_BMC_CMC_Zellspannung_004_Cxffc_kleiner_1V), 4093=Cxffd_nicht_vorhanden (CM_BMC_CMC_Zellspannung_004_Cxffd_nicht_vorhanden), 4094=Cxffe_Init (CM_BMC_CMC_Zellspannung_004_Cxffe_Init), 4095=Cxfff_Fehler (CM_BMC_CMC_Zellspannung_004_Cxfff_Fehler); unit Unit_MilliVolt}, range phys 1000..5091 Unit_MilliVolt, raw 0..4095, unit=Unit_MilliVolt, transfer-property=PENDING  # Einzelzellspannung zur Uebertragung per RTM
          signal BMC_CMC_Zellspannung_005_XIX_BMC_CMC_Zellspannung_01_XIX_HCP5_CANFD01: start 60, 12 bit, little-endian, data-type-policy=OVERRIDE, i-signal-type=PRIMITIVE, init-value=4094, base-type=BT_BMC_CMC_Zellspannung_005, invalid-value=Invalid_BMC_CMC_Zellspannung_005_XIX_BMC_CMC_Zellspannung_01_XIX_HCP5_CANFD01:4095, compu {phys=raw+1000 for raw 0..4091, 4092=Cxffc_kleiner_1V (CM_BMC_CMC_Zellspannung_005_Cxffc_kleiner_1V), 4093=Cxffd_nicht_vorhanden (CM_BMC_CMC_Zellspannung_005_Cxffd_nicht_vorhanden), 4094=Cxffe_Init (CM_BMC_CMC_Zellspannung_005_Cxffe_Init), 4095=Cxfff_Fehler (CM_BMC_CMC_Zellspannung_005_Cxfff_Fehler); unit Unit_MilliVolt}, range phys 1000..5091 Unit_MilliVolt, raw 0..4095, unit=Unit_MilliVolt, transfer-property=PENDING  # Einzelzellspannung zur Uebertragung per RTM
          signal BMC_CMC_Zellspannung_006_XIX_BMC_CMC_Zellspannung_01_XIX_HCP5_CANFD01: start 72, 12 bit, little-endian, data-type-policy=OVERRIDE, i-signal-type=PRIMITIVE, init-value=4094, base-type=BT_BMC_CMC_Zellspannung_006, invalid-value=Invalid_BMC_CMC_Zellspannung_006_XIX_BMC_CMC_Zellspannung_01_XIX_HCP5_CANFD01:4095, compu {phys=raw+1000 for raw 0..4091, 4092=Cxffc_kleiner_1V (CM_BMC_CMC_Zellspannung_006_Cxffc_kleiner_1V), 4093=Cxffd_nicht_vorhanden (CM_BMC_CMC_Zellspannung_006_Cxffd_nicht_vorhanden), 4094=Cxffe_Init (CM_BMC_CMC_Zellspannung_006_Cxffe_Init), 4095=Cxfff_Fehler (CM_BMC_CMC_Zellspannung_006_Cxfff_Fehler); unit Unit_MilliVolt}, range phys 1000..5091 Unit_MilliVolt, raw 0..4095, unit=Unit_MilliVolt, transfer-property=PENDING  # Einzelzellspannung zur Uebertragung per RTM
          signal BMC_CMC_Zellspannung_007_XIX_BMC_CMC_Zellspannung_01_XIX_HCP5_CANFD01: start 84, 12 bit, little-endian, data-type-policy=OVERRIDE, i-signal-type=PRIMITIVE, init-value=4094, base-type=BT_BMC_CMC_Zellspannung_007, invalid-value=Invalid_BMC_CMC_Zellspannung_007_XIX_BMC_CMC_Zellspannung_01_XIX_HCP5_CANFD01:4095, compu {phys=raw+1000 for raw 0..4091, 4092=Cxffc_kleiner_1V (CM_BMC_CMC_Zellspannung_007_Cxffc_kleiner_1V), 4093=Cxffd_nicht_vorhanden (CM_BMC_CMC_Zellspannung_007_Cxffd_nicht_vorhanden), 4094=Cxffe_Init (CM_BMC_CMC_Zellspannung_007_Cxffe_Init), 4095=Cxfff_Fehler (CM_BMC_CMC_Zellspannung_007_Cxfff_Fehler); unit Unit_MilliVolt}, range phys 1000..5091 Unit_MilliVolt, raw 0..4095, unit=Unit_MilliVolt, transfer-property=PENDING  # Einzelzellspannung zur Uebertragung per RTM
          signal BMC_CMC_Zellspannung_008_XIX_BMC_CMC_Zellspannung_01_XIX_HCP5_CANFD01: start 96, 12 bit, little-endian, data-type-policy=OVERRIDE, i-signal-type=PRIMITIVE, init-value=4094, base-type=BT_BMC_CMC_Zellspannung_008, invalid-value=Invalid_BMC_CMC_Zellspannung_008_XIX_BMC_CMC_Zellspannung_01_XIX_HCP5_CANFD01:4095, compu {phys=raw+1000 for raw 0..4091, 4092=Cxffc_kleiner_1V (CM_BMC_CMC_Zellspannung_008_Cxffc_kleiner_1V), 4093=Cxffd_nicht_vorhanden (CM_BMC_CMC_Zellspannung_008_Cxffd_nicht_vorhanden), 4094=Cxffe_Init (CM_BMC_CMC_Zellspannung_008_Cxffe_Init), 4095=Cxfff_Fehler (CM_BMC_CMC_Zellspannung_008_Cxfff_Fehler); unit Unit_MilliVolt}, range phys 1000..5091 Unit_MilliVolt, raw 0..4095, unit=Unit_MilliVolt, transfer-property=PENDING  # Einzelzellspannung zur Uebertragung per RTM
          signal BMC_CMC_Zellspannung_009_XIX_BMC_CMC_Zellspannung_01_XIX_HCP5_CANFD01: start 108, 12 bit, little-endian, data-type-policy=OVERRIDE, i-signal-type=PRIMITIVE, init-value=4094, base-type=BT_BMC_CMC_Zellspannung_009, invalid-value=Invalid_BMC_CMC_Zellspannung_009_XIX_BMC_CMC_Zellspannung_01_XIX_HCP5_CANFD01:4095, compu {phys=raw+1000 for raw 0..4091, 4092=Cxffc_kleiner_1V (CM_BMC_CMC_Zellspannung_009_Cxffc_kleiner_1V), 4093=Cxffd_nicht_vorhanden (CM_BMC_CMC_Zellspannung_009_Cxffd_nicht_vorhanden), 4094=Cxffe_Init (CM_BMC_CMC_Zellspannung_009_Cxffe_Init), 4095=Cxfff_Fehler (CM_BMC_CMC_Zellspannung_009_Cxfff_Fehler); unit Unit_MilliVolt}, range phys 1000..5091 Unit_MilliVolt, raw 0..4095, unit=Unit_MilliVolt, transfer-property=PENDING  # Einzelzellspannung zur Uebertragung per RTM
          signal BMC_CMC_Zellspannung_010_XIX_BMC_CMC_Zellspannung_01_XIX_HCP5_CANFD01: start 120, 12 bit, little-endian, data-type-policy=OVERRIDE, i-signal-type=PRIMITIVE, init-value=4094, base-type=BT_BMC_CMC_Zellspannung_010, invalid-value=Invalid_BMC_CMC_Zellspannung_010_XIX_BMC_CMC_Zellspannung_01_XIX_HCP5_CANFD01:4095, compu {phys=raw+1000 for raw 0..4091, 4092=Cxffc_kleiner_1V (CM_BMC_CMC_Zellspannung_010_Cxffc_kleiner_1V), 4093=Cxffd_nicht_vorhanden (CM_BMC_CMC_Zellspannung_010_Cxffd_nicht_vorhanden), 4094=Cxffe_Init (CM_BMC_CMC_Zellspannung_010_Cxffe_Init), 4095=Cxfff_Fehler (CM_BMC_CMC_Zellspannung_010_Cxfff_Fehler); unit Unit_MilliVolt}, range phys 1000..5091 Unit_MilliVolt, raw 0..4095, unit=Unit_MilliVolt, transfer-property=PENDING  # Einzelzellspannung zur Uebertragung per RTM
          signal BMC_CMC_Zellspannung_011_XIX_BMC_CMC_Zellspannung_01_XIX_HCP5_CANFD01: start 132, 12 bit, little-endian, data-type-policy=OVERRIDE, i-signal-type=PRIMITIVE, init-value=4094, base-type=BT_BMC_CMC_Zellspannung_011, invalid-value=Invalid_BMC_CMC_Zellspannung_011_XIX_BMC_CMC_Zellspannung_01_XIX_HCP5_CANFD01:4095, compu {phys=raw+1000 for raw 0..4091, 4092=Cxffc_kleiner_1V (CM_BMC_CMC_Zellspannung_011_Cxffc_kleiner_1V), 4093=Cxffd_nicht_vorhanden (CM_BMC_CMC_Zellspannung_011_Cxffd_nicht_vorhanden), 4094=Cxffe_Init (CM_BMC_CMC_Zellspannung_011_Cxffe_Init), 4095=Cxfff_Fehler (CM_BMC_CMC_Zellspannung_011_Cxfff_Fehler); unit Unit_MilliVolt}, range phys 1000..5091 Unit_MilliVolt, raw 0..4095, unit=Unit_MilliVolt, transfer-property=PENDING  # Einzelzellspannung zur Uebertragung per RTM
          signal BMC_CMC_Zellspannung_012_XIX_BMC_CMC_Zellspannung_01_XIX_HCP5_CANFD01: start 144, 12 bit, little-endian, data-type-policy=OVERRIDE, i-signal-type=PRIMITIVE, init-value=4094, base-type=BT_BMC_CMC_Zellspannung_012, invalid-value=Invalid_BMC_CMC_Zellspannung_012_XIX_BMC_CMC_Zellspannung_01_XIX_HCP5_CANFD01:4095, compu {phys=raw+1000 for raw 0..4091, 4092=Cxffc_kleiner_1V (CM_BMC_CMC_Zellspannung_012_Cxffc_kleiner_1V), 4093=Cxffd_nicht_vorhanden (CM_BMC_CMC_Zellspannung_012_Cxffd_nicht_vorhanden), 4094=Cxffe_Init (CM_BMC_CMC_Zellspannung_012_Cxffe_Init), 4095=Cxfff_Fehler (CM_BMC_CMC_Zellspannung_012_Cxfff_Fehler); unit Unit_MilliVolt}, range phys 1000..5091 Unit_MilliVolt, raw 0..4095, unit=Unit_MilliVolt, transfer-property=PENDING  # Einzelzellspannung zur Uebertragung per RTM
          signal BMC_CMC_Zellspannung_013_XIX_BMC_CMC_Zellspannung_01_XIX_HCP5_CANFD01: start 156, 12 bit, little-endian, data-type-policy=OVERRIDE, i-signal-type=PRIMITIVE, init-value=4094, base-type=BT_BMC_CMC_Zellspannung_013, invalid-value=Invalid_BMC_CMC_Zellspannung_013_XIX_BMC_CMC_Zellspannung_01_XIX_HCP5_CANFD01:4095, compu {phys=raw+1000 for raw 0..4091, 4092=Cxffc_kleiner_1V (CM_BMC_CMC_Zellspannung_013_Cxffc_kleiner_1V), 4093=Cxffd_nicht_vorhanden (CM_BMC_CMC_Zellspannung_013_Cxffd_nicht_vorhanden), 4094=Cxffe_Init (CM_BMC_CMC_Zellspannung_013_Cxffe_Init), 4095=Cxfff_Fehler (CM_BMC_CMC_Zellspannung_013_Cxfff_Fehler); unit Unit_MilliVolt}, range phys 1000..5091 Unit_MilliVolt, raw 0..4095, unit=Unit_MilliVolt, transfer-property=PENDING  # Einzelzellspannung zur Uebertragung per RTM
          signal BMC_CMC_Zellspannung_014_XIX_BMC_CMC_Zellspannung_01_XIX_HCP5_CANFD01: start 168, 12 bit, little-endian, data-type-policy=OVERRIDE, i-signal-type=PRIMITIVE, init-value=4094, base-type=BT_BMC_CMC_Zellspannung_014, invalid-value=Invalid_BMC_CMC_Zellspannung_014_XIX_BMC_CMC_Zellspannung_01_XIX_HCP5_CANFD01:4095, compu {phys=raw+1000 for raw 0..4091, 4092=Cxffc_kleiner_1V (CM_BMC_CMC_Zellspannung_014_Cxffc_kleiner_1V), 4093=Cxffd_nicht_vorhanden (CM_BMC_CMC_Zellspannung_014_Cxffd_nicht_vorhanden), 4094=Cxffe_Init (CM_BMC_CMC_Zellspannung_014_Cxffe_Init), 4095=Cxfff_Fehler (CM_BMC_CMC_Zellspannung_014_Cxfff_Fehler); unit Unit_MilliVolt}, range phys 1000..5091 Unit_MilliVolt, raw 0..4095, unit=Unit_MilliVolt, transfer-property=PENDING  # Einzelzellspannung zur Uebertragung per RTM
          signal BMC_CMC_Zellspannung_015_XIX_BMC_CMC_Zellspannung_01_XIX_HCP5_CANFD01: start 180, 12 bit, little-endian, data-type-policy=OVERRIDE, i-signal-type=PRIMITIVE, init-value=4094, base-type=BT_BMC_CMC_Zellspannung_015, invalid-value=Invalid_BMC_CMC_Zellspannung_015_XIX_BMC_CMC_Zellspannung_01_XIX_HCP5_CANFD01:4095, compu {phys=raw+1000 for raw 0..4091, 4092=Cxffc_kleiner_1V (CM_BMC_CMC_Zellspannung_015_Cxffc_kleiner_1V), 4093=Cxffd_nicht_vorhanden (CM_BMC_CMC_Zellspannung_015_Cxffd_nicht_vorhanden), 4094=Cxffe_Init (CM_BMC_CMC_Zellspannung_015_Cxffe_Init), 4095=Cxfff_Fehler (CM_BMC_CMC_Zellspannung_015_Cxfff_Fehler); unit Unit_MilliVolt}, range phys 1000..5091 Unit_MilliVolt, raw 0..4095, unit=Unit_MilliVolt, transfer-property=PENDING  # Einzelzellspannung zur Uebertragung per RTM
          signal BMC_CMC_Zellspannung_016_XIX_BMC_CMC_Zellspannung_01_XIX_HCP5_CANFD01: start 192, 12 bit, little-endian, data-type-policy=OVERRIDE, i-signal-type=PRIMITIVE, init-value=4094, base-type=BT_BMC_CMC_Zellspannung_016, invalid-value=Invalid_BMC_CMC_Zellspannung_016_XIX_BMC_CMC_Zellspannung_01_XIX_HCP5_CANFD01:4095, compu {phys=raw+1000 for raw 0..4091, 4092=Cxffc_kleiner_1V (CM_BMC_CMC_Zellspannung_016_Cxffc_kleiner_1V), 4093=Cxffd_nicht_vorhanden (CM_BMC_CMC_Zellspannung_016_Cxffd_nicht_vorhanden), 4094=Cxffe_Init (CM_BMC_CMC_Zellspannung_016_Cxffe_Init), 4095=Cxfff_Fehler (CM_BMC_CMC_Zellspannung_016_Cxfff_Fehler); unit Unit_MilliVolt}, range phys 1000..5091 Unit_MilliVolt, raw 0..4095, unit=Unit_MilliVolt, transfer-property=PENDING  # Einzelzellspannung zur Uebertragung per RTM
          signal BMC_CMC_Zellspannung_017_XIX_BMC_CMC_Zellspannung_01_XIX_HCP5_CANFD01: start 204, 12 bit, little-endian, data-type-policy=OVERRIDE, i-signal-type=PRIMITIVE, init-value=4094, base-type=BT_BMC_CMC_Zellspannung_017, invalid-value=Invalid_BMC_CMC_Zellspannung_017_XIX_BMC_CMC_Zellspannung_01_XIX_HCP5_CANFD01:4095, compu {phys=raw+1000 for raw 0..4091, 4092=Cxffc_kleiner_1V (CM_BMC_CMC_Zellspannung_017_Cxffc_kleiner_1V), 4093=Cxffd_nicht_vorhanden (CM_BMC_CMC_Zellspannung_017_Cxffd_nicht_vorhanden), 4094=Cxffe_Init (CM_BMC_CMC_Zellspannung_017_Cxffe_Init), 4095=Cxfff_Fehler (CM_BMC_CMC_Zellspannung_017_Cxfff_Fehler); unit Unit_MilliVolt}, range phys 1000..5091 Unit_MilliVolt, raw 0..4095, unit=Unit_MilliVolt, transfer-property=PENDING  # Einzelzellspannung zur Uebertragung per RTM
          signal BMC_CMC_Zellspannung_018_XIX_BMC_CMC_Zellspannung_01_XIX_HCP5_CANFD01: start 216, 12 bit, little-endian, data-type-policy=OVERRIDE, i-signal-type=PRIMITIVE, init-value=4094, base-type=BT_BMC_CMC_Zellspannung_018, invalid-value=Invalid_BMC_CMC_Zellspannung_018_XIX_BMC_CMC_Zellspannung_01_XIX_HCP5_CANFD01:4095, compu {phys=raw+1000 for raw 0..4091, 4092=Cxffc_kleiner_1V (CM_BMC_CMC_Zellspannung_018_Cxffc_kleiner_1V), 4093=Cxffd_nicht_vorhanden (CM_BMC_CMC_Zellspannung_018_Cxffd_nicht_vorhanden), 4094=Cxffe_Init (CM_BMC_CMC_Zellspannung_018_Cxffe_Init), 4095=Cxfff_Fehler (CM_BMC_CMC_Zellspannung_018_Cxfff_Fehler); unit Unit_MilliVolt}, range phys 1000..5091 Unit_MilliVolt, raw 0..4095, unit=Unit_MilliVolt, transfer-property=PENDING  # Einzelzellspannung zur Uebertragung per RTM
          signal BMC_CMC_Zellspannung_019_XIX_BMC_CMC_Zellspannung_01_XIX_HCP5_CANFD01: start 228, 12 bit, little-endian, data-type-policy=OVERRIDE, i-signal-type=PRIMITIVE, init-value=4094, base-type=BT_BMC_CMC_Zellspannung_019, invalid-value=Invalid_BMC_CMC_Zellspannung_019_XIX_BMC_CMC_Zellspannung_01_XIX_HCP5_CANFD01:4095, compu {phys=raw+1000 for raw 0..4091, 4092=Cxffc_kleiner_1V (CM_BMC_CMC_Zellspannung_019_Cxffc_kleiner_1V), 4093=Cxffd_nicht_vorhanden (CM_BMC_CMC_Zellspannung_019_Cxffd_nicht_vorhanden), 4094=Cxffe_Init (CM_BMC_CMC_Zellspannung_019_Cxffe_Init), 4095=Cxfff_Fehler (CM_BMC_CMC_Zellspannung_019_Cxfff_Fehler); unit Unit_MilliVolt}, range phys 1000..5091 Unit_MilliVolt, raw 0..4095, unit=Unit_MilliVolt, transfer-property=PENDING  # Einzelzellspannung zur Uebertragung per RTM
          signal BMC_CMC_Zellspannung_020_XIX_BMC_CMC_Zellspannung_01_XIX_HCP5_CANFD01: start 240, 12 bit, little-endian, data-type-policy=OVERRIDE, i-signal-type=PRIMITIVE, init-value=4094, base-type=BT_BMC_CMC_Zellspannung_020, invalid-value=Invalid_BMC_CMC_Zellspannung_020_XIX_BMC_CMC_Zellspannung_01_XIX_HCP5_CANFD01:4095, compu {phys=raw+1000 for raw 0..4091, 4092=Cxffc_kleiner_1V (CM_BMC_CMC_Zellspannung_020_Cxffc_kleiner_1V), 4093=Cxffd_nicht_vorhanden (CM_BMC_CMC_Zellspannung_020_Cxffd_nicht_vorhanden), 4094=Cxffe_Init (CM_BMC_CMC_Zellspannung_020_Cxffe_Init), 4095=Cxfff_Fehler (CM_BMC_CMC_Zellspannung_020_Cxfff_Fehler); unit Unit_MilliVolt}, range phys 1000..5091 Unit_MilliVolt, raw 0..4095, unit=Unit_MilliVolt, transfer-property=PENDING  # Einzelzellspannung zur Uebertragung per RTM
          signal BMC_CMC_Zellspannung_021_XIX_BMC_CMC_Zellspannung_01_XIX_HCP5_CANFD01: start 252, 12 bit, little-endian, data-type-policy=OVERRIDE, i-signal-type=PRIMITIVE, init-value=4094, base-type=BT_BMC_CMC_Zellspannung_021, invalid-value=Invalid_BMC_CMC_Zellspannung_021_XIX_BMC_CMC_Zellspannung_01_XIX_HCP5_CANFD01:4095, compu {phys=raw+1000 for raw 0..4091, 4092=Cxffc_kleiner_1V (CM_BMC_CMC_Zellspannung_021_Cxffc_kleiner_1V), 4093=Cxffd_nicht_vorhanden (CM_BMC_CMC_Zellspannung_021_Cxffd_nicht_vorhanden), 4094=Cxffe_Init (CM_BMC_CMC_Zellspannung_021_Cxffe_Init), 4095=Cxfff_Fehler (CM_BMC_CMC_Zellspannung_021_Cxfff_Fehler); unit Unit_MilliVolt}, range phys 1000..5091 Unit_MilliVolt, raw 0..4095, unit=Unit_MilliVolt, transfer-property=PENDING  # Einzelzellspannung zur Uebertragung per RTM
          signal BMC_CMC_Zellspannung_022_XIX_BMC_CMC_Zellspannung_01_XIX_HCP5_CANFD01: start 264, 12 bit, little-endian, data-type-policy=OVERRIDE, i-signal-type=PRIMITIVE, init-value=4094, base-type=BT_BMC_CMC_Zellspannung_022, invalid-value=Invalid_BMC_CMC_Zellspannung_022_XIX_BMC_CMC_Zellspannung_01_XIX_HCP5_CANFD01:4095, compu {phys=raw+1000 for raw 0..4091, 4092=Cxffc_kleiner_1V (CM_BMC_CMC_Zellspannung_022_Cxffc_kleiner_1V), 4093=Cxffd_nicht_vorhanden (CM_BMC_CMC_Zellspannung_022_Cxffd_nicht_vorhanden), 4094=Cxffe_Init (CM_BMC_CMC_Zellspannung_022_Cxffe_Init), 4095=Cxfff_Fehler (CM_BMC_CMC_Zellspannung_022_Cxfff_Fehler); unit Unit_MilliVolt}, range phys 1000..5091 Unit_MilliVolt, raw 0..4095, unit=Unit_MilliVolt, transfer-property=PENDING  # Einzelzellspannung zur Uebertragung per RTM
          signal BMC_CMC_Zellspannung_023_XIX_BMC_CMC_Zellspannung_01_XIX_HCP5_CANFD01: start 276, 12 bit, little-endian, data-type-policy=OVERRIDE, i-signal-type=PRIMITIVE, init-value=4094, base-type=BT_BMC_CMC_Zellspannung_023, invalid-value=Invalid_BMC_CMC_Zellspannung_023_XIX_BMC_CMC_Zellspannung_01_XIX_HCP5_CANFD01:4095, compu {phys=raw+1000 for raw 0..4091, 4092=Cxffc_kleiner_1V (CM_BMC_CMC_Zellspannung_023_Cxffc_kleiner_1V), 4093=Cxffd_nicht_vorhanden (CM_BMC_CMC_Zellspannung_023_Cxffd_nicht_vorhanden), 4094=Cxffe_Init (CM_BMC_CMC_Zellspannung_023_Cxffe_Init), 4095=Cxfff_Fehler (CM_BMC_CMC_Zellspannung_023_Cxfff_Fehler); unit Unit_MilliVolt}, range phys 1000..5091 Unit_MilliVolt, raw 0..4095, unit=Unit_MilliVolt, transfer-property=PENDING  # Einzelzellspannung zur Uebertragung per RTM
          signal BMC_CMC_Zellspannung_024_XIX_BMC_CMC_Zellspannung_01_XIX_HCP5_CANFD01: start 288, 12 bit, little-endian, data-type-policy=OVERRIDE, i-signal-type=PRIMITIVE, init-value=4094, base-type=BT_BMC_CMC_Zellspannung_024, invalid-value=Invalid_BMC_CMC_Zellspannung_024_XIX_BMC_CMC_Zellspannung_01_XIX_HCP5_CANFD01:4095, compu {phys=raw+1000 for raw 0..4091, 4092=Cxffc_kleiner_1V (CM_BMC_CMC_Zellspannung_024_Cxffc_kleiner_1V), 4093=Cxffd_nicht_vorhanden (CM_BMC_CMC_Zellspannung_024_Cxffd_nicht_vorhanden), 4094=Cxffe_Init (CM_BMC_CMC_Zellspannung_024_Cxffe_Init), 4095=Cxfff_Fehler (CM_BMC_CMC_Zellspannung_024_Cxfff_Fehler); unit Unit_MilliVolt}, range phys 1000..5091 Unit_MilliVolt, raw 0..4095, unit=Unit_MilliVolt, transfer-property=PENDING  # Einzelzellspannung zur Uebertragung per RTM
          signal BMC_CMC_Zellspannung_025_XIX_BMC_CMC_Zellspannung_01_XIX_HCP5_CANFD01: start 300, 12 bit, little-endian, data-type-policy=OVERRIDE, i-signal-type=PRIMITIVE, init-value=4094, base-type=BT_BMC_CMC_Zellspannung_025, invalid-value=Invalid_BMC_CMC_Zellspannung_025_XIX_BMC_CMC_Zellspannung_01_XIX_HCP5_CANFD01:4095, compu {phys=raw+1000 for raw 0..4091, 4092=Cxffc_kleiner_1V (CM_BMC_CMC_Zellspannung_025_Cxffc_kleiner_1V), 4093=Cxffd_nicht_vorhanden (CM_BMC_CMC_Zellspannung_025_Cxffd_nicht_vorhanden), 4094=Cxffe_Init (CM_BMC_CMC_Zellspannung_025_Cxffe_Init), 4095=Cxfff_Fehler (CM_BMC_CMC_Zellspannung_025_Cxfff_Fehler); unit Unit_MilliVolt}, range phys 1000..5091 Unit_MilliVolt, raw 0..4095, unit=Unit_MilliVolt, transfer-property=PENDING  # Einzelzellspannung zur Uebertragung per RTM
          signal BMC_CMC_Zellspannung_026_XIX_BMC_CMC_Zellspannung_01_XIX_HCP5_CANFD01: start 312, 12 bit, little-endian, data-type-policy=OVERRIDE, i-signal-type=PRIMITIVE, init-value=4094, base-type=BT_BMC_CMC_Zellspannung_026, invalid-value=Invalid_BMC_CMC_Zellspannung_026_XIX_BMC_CMC_Zellspannung_01_XIX_HCP5_CANFD01:4095, compu {phys=raw+1000 for raw 0..4091, 4092=Cxffc_kleiner_1V (CM_BMC_CMC_Zellspannung_026_Cxffc_kleiner_1V), 4093=Cxffd_nicht_vorhanden (CM_BMC_CMC_Zellspannung_026_Cxffd_nicht_vorhanden), 4094=Cxffe_Init (CM_BMC_CMC_Zellspannung_026_Cxffe_Init), 4095=Cxfff_Fehler (CM_BMC_CMC_Zellspannung_026_Cxfff_Fehler); unit Unit_MilliVolt}, range phys 1000..5091 Unit_MilliVolt, raw 0..4095, unit=Unit_MilliVolt, transfer-property=PENDING  # Einzelzellspannung zur Uebertragung per RTM
          signal BMC_CMC_Zellspannung_027_XIX_BMC_CMC_Zellspannung_01_XIX_HCP5_CANFD01: start 324, 12 bit, little-endian, data-type-policy=OVERRIDE, i-signal-type=PRIMITIVE, init-value=4094, base-type=BT_BMC_CMC_Zellspannung_027, invalid-value=Invalid_BMC_CMC_Zellspannung_027_XIX_BMC_CMC_Zellspannung_01_XIX_HCP5_CANFD01:4095, compu {phys=raw+1000 for raw 0..4091, 4092=Cxffc_kleiner_1V (CM_BMC_CMC_Zellspannung_027_Cxffc_kleiner_1V), 4093=Cxffd_nicht_vorhanden (CM_BMC_CMC_Zellspannung_027_Cxffd_nicht_vorhanden), 4094=Cxffe_Init (CM_BMC_CMC_Zellspannung_027_Cxffe_Init), 4095=Cxfff_Fehler (CM_BMC_CMC_Zellspannung_027_Cxfff_Fehler); unit Unit_MilliVolt}, range phys 1000..5091 Unit_MilliVolt, raw 0..4095, unit=Unit_MilliVolt, transfer-property=PENDING  # Einzelzellspannung zur Uebertragung per RTM
          signal BMC_CMC_Zellspannung_028_XIX_BMC_CMC_Zellspannung_01_XIX_HCP5_CANFD01: start 336, 12 bit, little-endian, data-type-policy=OVERRIDE, i-signal-type=PRIMITIVE, init-value=4094, base-type=BT_BMC_CMC_Zellspannung_028, invalid-value=Invalid_BMC_CMC_Zellspannung_028_XIX_BMC_CMC_Zellspannung_01_XIX_HCP5_CANFD01:4095, compu {phys=raw+1000 for raw 0..4091, 4092=Cxffc_kleiner_1V (CM_BMC_CMC_Zellspannung_028_Cxffc_kleiner_1V), 4093=Cxffd_nicht_vorhanden (CM_BMC_CMC_Zellspannung_028_Cxffd_nicht_vorhanden), 4094=Cxffe_Init (CM_BMC_CMC_Zellspannung_028_Cxffe_Init), 4095=Cxfff_Fehler (CM_BMC_CMC_Zellspannung_028_Cxfff_Fehler); unit Unit_MilliVolt}, range phys 1000..5091 Unit_MilliVolt, raw 0..4095, unit=Unit_MilliVolt, transfer-property=PENDING  # Einzelzellspannung zur Uebertragung per RTM
          signal BMC_CMC_Zellspannung_029_XIX_BMC_CMC_Zellspannung_01_XIX_HCP5_CANFD01: start 348, 12 bit, little-endian, data-type-policy=OVERRIDE, i-signal-type=PRIMITIVE, init-value=4094, base-type=BT_BMC_CMC_Zellspannung_029, invalid-value=Invalid_BMC_CMC_Zellspannung_029_XIX_BMC_CMC_Zellspannung_01_XIX_HCP5_CANFD01:4095, compu {phys=raw+1000 for raw 0..4091, 4092=Cxffc_kleiner_1V (CM_BMC_CMC_Zellspannung_029_Cxffc_kleiner_1V), 4093=Cxffd_nicht_vorhanden (CM_BMC_CMC_Zellspannung_029_Cxffd_nicht_vorhanden), 4094=Cxffe_Init (CM_BMC_CMC_Zellspannung_029_Cxffe_Init), 4095=Cxfff_Fehler (CM_BMC_CMC_Zellspannung_029_Cxfff_Fehler); unit Unit_MilliVolt}, range phys 1000..5091 Unit_MilliVolt, raw 0..4095, unit=Unit_MilliVolt, transfer-property=PENDING  # Einzelzellspannung zur Uebertragung per RTM
          signal BMC_CMC_Zellspannung_030_XIX_BMC_CMC_Zellspannung_01_XIX_HCP5_CANFD01: start 360, 12 bit, little-endian, data-type-policy=OVERRIDE, i-signal-type=PRIMITIVE, init-value=4094, base-type=BT_BMC_CMC_Zellspannung_030, invalid-value=Invalid_BMC_CMC_Zellspannung_030_XIX_BMC_CMC_Zellspannung_01_XIX_HCP5_CANFD01:4095, compu {phys=raw+1000 for raw 0..4091, 4092=Cxffc_kleiner_1V (CM_BMC_CMC_Zellspannung_030_Cxffc_kleiner_1V), 4093=Cxffd_nicht_vorhanden (CM_BMC_CMC_Zellspannung_030_Cxffd_nicht_vorhanden), 4094=Cxffe_Init (CM_BMC_CMC_Zellspannung_030_Cxffe_Init), 4095=Cxfff_Fehler (CM_BMC_CMC_Zellspannung_030_Cxfff_Fehler); unit Unit_MilliVolt}, range phys 1000..5091 Unit_MilliVolt, raw 0..4095, unit=Unit_MilliVolt, transfer-property=PENDING  # Einzelzellspannung zur Uebertragung per RTM
          signal BMC_CMC_Zellspannung_031_XIX_BMC_CMC_Zellspannung_01_XIX_HCP5_CANFD01: start 372, 12 bit, little-endian, data-type-policy=OVERRIDE, i-signal-type=PRIMITIVE, init-value=4094, base-type=BT_BMC_CMC_Zellspannung_031, invalid-value=Invalid_BMC_CMC_Zellspannung_031_XIX_BMC_CMC_Zellspannung_01_XIX_HCP5_CANFD01:4095, compu {phys=raw+1000 for raw 0..4091, 4092=Cxffc_kleiner_1V (CM_BMC_CMC_Zellspannung_031_Cxffc_kleiner_1V), 4093=Cxffd_nicht_vorhanden (CM_BMC_CMC_Zellspannung_031_Cxffd_nicht_vorhanden), 4094=Cxffe_Init (CM_BMC_CMC_Zellspannung_031_Cxffe_Init), 4095=Cxfff_Fehler (CM_BMC_CMC_Zellspannung_031_Cxfff_Fehler); unit Unit_MilliVolt}, range phys 1000..5091 Unit_MilliVolt, raw 0..4095, unit=Unit_MilliVolt, transfer-property=PENDING  # Einzelzellspannung zur Uebertragung per RTM
          signal BMC_CMC_Zellspannung_032_XIX_BMC_CMC_Zellspannung_01_XIX_HCP5_CANFD01: start 384, 12 bit, little-endian, data-type-policy=OVERRIDE, i-signal-type=PRIMITIVE, init-value=4094, base-type=BT_BMC_CMC_Zellspannung_032, invalid-value=Invalid_BMC_CMC_Zellspannung_032_XIX_BMC_CMC_Zellspannung_01_XIX_HCP5_CANFD01:4095, compu {phys=raw+1000 for raw 0..4091, 4092=Cxffc_kleiner_1V (CM_BMC_CMC_Zellspannung_032_Cxffc_kleiner_1V), 4093=Cxffd_nicht_vorhanden (CM_BMC_CMC_Zellspannung_032_Cxffd_nicht_vorhanden), 4094=Cxffe_Init (CM_BMC_CMC_Zellspannung_032_Cxffe_Init), 4095=Cxfff_Fehler (CM_BMC_CMC_Zellspannung_032_Cxfff_Fehler); unit Unit_MilliVolt}, range phys 1000..5091 Unit_MilliVolt, raw 0..4095, unit=Unit_MilliVolt, transfer-property=PENDING  # Einzelzellspannung zur Uebertragung per RTM
          signal BMC_CMC_Zellspannung_033_XIX_BMC_CMC_Zellspannung_01_XIX_HCP5_CANFD01: start 396, 12 bit, little-endian, data-type-policy=OVERRIDE, i-signal-type=PRIMITIVE, init-value=4094, base-type=BT_BMC_CMC_Zellspannung_033, invalid-value=Invalid_BMC_CMC_Zellspannung_033_XIX_BMC_CMC_Zellspannung_01_XIX_HCP5_CANFD01:4095, compu {phys=raw+1000 for raw 0..4091, 4092=Cxffc_kleiner_1V (CM_BMC_CMC_Zellspannung_033_Cxffc_kleiner_1V), 4093=Cxffd_nicht_vorhanden (CM_BMC_CMC_Zellspannung_033_Cxffd_nicht_vorhanden), 4094=Cxffe_Init (CM_BMC_CMC_Zellspannung_033_Cxffe_Init), 4095=Cxfff_Fehler (CM_BMC_CMC_Zellspannung_033_Cxfff_Fehler); unit Unit_MilliVolt}, range phys 1000..5091 Unit_MilliVolt, raw 0..4095, unit=Unit_MilliVolt, transfer-property=PENDING  # Einzelzellspannung zur Uebertragung per RTM
          signal BMC_CMC_Zellspannung_034_XIX_BMC_CMC_Zellspannung_01_XIX_HCP5_CANFD01: start 408, 12 bit, little-endian, data-type-policy=OVERRIDE, i-signal-type=PRIMITIVE, init-value=4094, base-type=BT_BMC_CMC_Zellspannung_034, invalid-value=Invalid_BMC_CMC_Zellspannung_034_XIX_BMC_CMC_Zellspannung_01_XIX_HCP5_CANFD01:4095, compu {phys=raw+1000 for raw 0..4091, 4092=Cxffc_kleiner_1V (CM_BMC_CMC_Zellspannung_034_Cxffc_kleiner_1V), 4093=Cxffd_nicht_vorhanden (CM_BMC_CMC_Zellspannung_034_Cxffd_nicht_vorhanden), 4094=Cxffe_Init (CM_BMC_CMC_Zellspannung_034_Cxffe_Init), 4095=Cxfff_Fehler (CM_BMC_CMC_Zellspannung_034_Cxfff_Fehler); unit Unit_MilliVolt}, range phys 1000..5091 Unit_MilliVolt, raw 0..4095, unit=Unit_MilliVolt, transfer-property=PENDING  # Einzelzellspannung zur Uebertragung per RTM
          signal BMC_CMC_Zellspannung_035_XIX_BMC_CMC_Zellspannung_01_XIX_HCP5_CANFD01: start 420, 12 bit, little-endian, data-type-policy=OVERRIDE, i-signal-type=PRIMITIVE, init-value=4094, base-type=BT_BMC_CMC_Zellspannung_035, invalid-value=Invalid_BMC_CMC_Zellspannung_035_XIX_BMC_CMC_Zellspannung_01_XIX_HCP5_CANFD01:4095, compu {phys=raw+1000 for raw 0..4091, 4092=Cxffc_kleiner_1V (CM_BMC_CMC_Zellspannung_035_Cxffc_kleiner_1V), 4093=Cxffd_nicht_vorhanden (CM_BMC_CMC_Zellspannung_035_Cxffd_nicht_vorhanden), 4094=Cxffe_Init (CM_BMC_CMC_Zellspannung_035_Cxffe_Init), 4095=Cxfff_Fehler (CM_BMC_CMC_Zellspannung_035_Cxfff_Fehler); unit Unit_MilliVolt}, range phys 1000..5091 Unit_MilliVolt, raw 0..4095, unit=Unit_MilliVolt, transfer-property=PENDING  # Einzelzellspannung zur Uebertragung per RTM
          signal BMC_CMC_Zellspannung_036_XIX_BMC_CMC_Zellspannung_01_XIX_HCP5_CANFD01: start 432, 12 bit, little-endian, data-type-policy=OVERRIDE, i-signal-type=PRIMITIVE, init-value=4094, base-type=BT_BMC_CMC_Zellspannung_036, invalid-value=Invalid_BMC_CMC_Zellspannung_036_XIX_BMC_CMC_Zellspannung_01_XIX_HCP5_CANFD01:4095, compu {phys=raw+1000 for raw 0..4091, 4092=Cxffc_kleiner_1V (CM_BMC_CMC_Zellspannung_036_Cxffc_kleiner_1V), 4093=Cxffd_nicht_vorhanden (CM_BMC_CMC_Zellspannung_036_Cxffd_nicht_vorhanden), 4094=Cxffe_Init (CM_BMC_CMC_Zellspannung_036_Cxffe_Init), 4095=Cxfff_Fehler (CM_BMC_CMC_Zellspannung_036_Cxfff_Fehler); unit Unit_MilliVolt}, range phys 1000..5091 Unit_MilliVolt, raw 0..4095, unit=Unit_MilliVolt, transfer-property=PENDING  # Einzelzellspannung zur Uebertragung per RTM
          signal BMC_CMC_Zellspannung_037_XIX_BMC_CMC_Zellspannung_01_XIX_HCP5_CANFD01: start 444, 12 bit, little-endian, data-type-policy=OVERRIDE, i-signal-type=PRIMITIVE, init-value=4094, base-type=BT_BMC_CMC_Zellspannung_037, invalid-value=Invalid_BMC_CMC_Zellspannung_037_XIX_BMC_CMC_Zellspannung_01_XIX_HCP5_CANFD01:4095, compu {phys=raw+1000 for raw 0..4091, 4092=Cxffc_kleiner_1V (CM_BMC_CMC_Zellspannung_037_Cxffc_kleiner_1V), 4093=Cxffd_nicht_vorhanden (CM_BMC_CMC_Zellspannung_037_Cxffd_nicht_vorhanden), 4094=Cxffe_Init (CM_BMC_CMC_Zellspannung_037_Cxffe_Init), 4095=Cxfff_Fehler (CM_BMC_CMC_Zellspannung_037_Cxfff_Fehler); unit Unit_MilliVolt}, range phys 1000..5091 Unit_MilliVolt, raw 0..4095, unit=Unit_MilliVolt, transfer-property=PENDING  # Einzelzellspannung zur Uebertragung per RTM
          signal BMC_CMC_Zellspannung_038_XIX_BMC_CMC_Zellspannung_01_XIX_HCP5_CANFD01: start 456, 12 bit, little-endian, data-type-policy=OVERRIDE, i-signal-type=PRIMITIVE, init-value=4094, base-type=BT_BMC_CMC_Zellspannung_038, invalid-value=Invalid_BMC_CMC_Zellspannung_038_XIX_BMC_CMC_Zellspannung_01_XIX_HCP5_CANFD01:4095, compu {phys=raw+1000 for raw 0..4091, 4092=Cxffc_kleiner_1V (CM_BMC_CMC_Zellspannung_038_Cxffc_kleiner_1V), 4093=Cxffd_nicht_vorhanden (CM_BMC_CMC_Zellspannung_038_Cxffd_nicht_vorhanden), 4094=Cxffe_Init (CM_BMC_CMC_Zellspannung_038_Cxffe_Init), 4095=Cxfff_Fehler (CM_BMC_CMC_Zellspannung_038_Cxfff_Fehler); unit Unit_MilliVolt}, range phys 1000..5091 Unit_MilliVolt, raw 0..4095, unit=Unit_MilliVolt, transfer-property=PENDING  # Einzelzellspannung zur Uebertragung per RTM
          signal BMC_CMC_Zellspannung_039_XIX_BMC_CMC_Zellspannung_01_XIX_HCP5_CANFD01: start 468, 12 bit, little-endian, data-type-policy=OVERRIDE, i-signal-type=PRIMITIVE, init-value=4094, base-type=BT_BMC_CMC_Zellspannung_039, invalid-value=Invalid_BMC_CMC_Zellspannung_039_XIX_BMC_CMC_Zellspannung_01_XIX_HCP5_CANFD01:4095, compu {phys=raw+1000 for raw 0..4091, 4092=Cxffc_kleiner_1V (CM_BMC_CMC_Zellspannung_039_Cxffc_kleiner_1V), 4093=Cxffd_nicht_vorhanden (CM_BMC_CMC_Zellspannung_039_Cxffd_nicht_vorhanden), 4094=Cxffe_Init (CM_BMC_CMC_Zellspannung_039_Cxffe_Init), 4095=Cxfff_Fehler (CM_BMC_CMC_Zellspannung_039_Cxfff_Fehler); unit Unit_MilliVolt}, range phys 1000..5091 Unit_MilliVolt, raw 0..4095, unit=Unit_MilliVolt, transfer-property=PENDING  # Einzelzellspannung zur Uebertragung per RTM
          signal BMC_CMC_Zellspannung_01_Messzeit_XIX_BMC_CMC_Zellspannung_01_XIX_HCP5_CANFD01: start 480, 8 bit, little-endian, data-type-policy=OVERRIDE, i-signal-type=PRIMITIVE, init-value=254, base-type=BT_BMC_CMC_Zellspannung_01_Messzeit, invalid-value=Invalid_BMC_CMC_Zellspannung_01_Messzeit_XIX_BMC_CMC_Zellspannung_01_XIX_HCP5_CANFD01:255, compu {phys=raw for raw 0..253, 254=Cxfe_Init (CM_BMC_CMC_Zellspannung_01_Messzeit_Cxfe_Init), 255=Cxff_Fehler (CM_BMC_CMC_Zellspannung_01_Messzeit_Cxff_Fehler); unit Unit_None}, range phys 0..253 Unit_None, raw 0..255, unit=Unit_None, transfer-property=PENDING  # Messzeit zu Botschaft BMC_CMC_Zellspannung_01
      frame BMC_CMC_Zellspannung_02_XIX_HCP5_CANFD01: id 0x1A55562D, from BMC_HV, frame-length=64, can-addressing-mode=EXTENDED, can-frame-rx-behavior=CAN-FD, can-frame-tx-behavior=CAN-FD
        pdu BMC_CMC_Zellspannung_02_XIX_HCP5_CANFD01: length=64, transmission-mode-true-timing=cyclic-timing={time-offset=0, time-period=1}, unused-bit-pattern=0
          signal BMC_CMC_Zellspannung_040_XIX_BMC_CMC_Zellspannung_02_XIX_HCP5_CANFD01: start 12, 12 bit, little-endian, data-type-policy=OVERRIDE, i-signal-type=PRIMITIVE, init-value=4094, base-type=BT_BMC_CMC_Zellspannung_040, invalid-value=Invalid_BMC_CMC_Zellspannung_040_XIX_BMC_CMC_Zellspannung_02_XIX_HCP5_CANFD01:4095, compu {phys=raw+1000 for raw 0..4091, 4092=Cxffc_kleiner_1V (CM_BMC_CMC_Zellspannung_040_Cxffc_kleiner_1V), 4093=Cxffd_nicht_vorhanden (CM_BMC_CMC_Zellspannung_040_Cxffd_nicht_vorhanden), 4094=Cxffe_Init (CM_BMC_CMC_Zellspannung_040_Cxffe_Init), 4095=Cxfff_Fehler (CM_BMC_CMC_Zellspannung_040_Cxfff_Fehler); unit Unit_MilliVolt}, range phys 1000..5091 Unit_MilliVolt, raw 0..4095, unit=Unit_MilliVolt, transfer-property=PENDING  # Einzelzellspannung zur Uebertragung per RTM
          signal BMC_CMC_Zellspannung_041_XIX_BMC_CMC_Zellspannung_02_XIX_HCP5_CANFD01: start 24, 12 bit, little-endian, data-type-policy=OVERRIDE, i-signal-type=PRIMITIVE, init-value=4094, base-type=BT_BMC_CMC_Zellspannung_041, invalid-value=Invalid_BMC_CMC_Zellspannung_041_XIX_BMC_CMC_Zellspannung_02_XIX_HCP5_CANFD01:4095, compu {phys=raw+1000 for raw 0..4091, 4092=Cxffc_kleiner_1V (CM_BMC_CMC_Zellspannung_041_Cxffc_kleiner_1V), 4093=Cxffd_nicht_vorhanden (CM_BMC_CMC_Zellspannung_041_Cxffd_nicht_vorhanden), 4094=Cxffe_Init (CM_BMC_CMC_Zellspannung_041_Cxffe_Init), 4095=Cxfff_Fehler (CM_BMC_CMC_Zellspannung_041_Cxfff_Fehler); unit Unit_MilliVolt}, range phys 1000..5091 Unit_MilliVolt, raw 0..4095, unit=Unit_MilliVolt, transfer-property=PENDING  # Einzelzellspannung zur Uebertragung per RTM
          signal BMC_CMC_Zellspannung_042_XIX_BMC_CMC_Zellspannung_02_XIX_HCP5_CANFD01: start 36, 12 bit, little-endian, data-type-policy=OVERRIDE, i-signal-type=PRIMITIVE, init-value=4094, base-type=BT_BMC_CMC_Zellspannung_042, invalid-value=Invalid_BMC_CMC_Zellspannung_042_XIX_BMC_CMC_Zellspannung_02_XIX_HCP5_CANFD01:4095, compu {phys=raw+1000 for raw 0..4091, 4092=Cxffc_kleiner_1V (CM_BMC_CMC_Zellspannung_042_Cxffc_kleiner_1V), 4093=Cxffd_nicht_vorhanden (CM_BMC_CMC_Zellspannung_042_Cxffd_nicht_vorhanden), 4094=Cxffe_Init (CM_BMC_CMC_Zellspannung_042_Cxffe_Init), 4095=Cxfff_Fehler (CM_BMC_CMC_Zellspannung_042_Cxfff_Fehler); unit Unit_MilliVolt}, range phys 1000..5091 Unit_MilliVolt, raw 0..4095, unit=Unit_MilliVolt, transfer-property=PENDING  # Einzelzellspannung zur Uebertragung per RTM
          signal BMC_CMC_Zellspannung_043_XIX_BMC_CMC_Zellspannung_02_XIX_HCP5_CANFD01: start 48, 12 bit, little-endian, data-type-policy=OVERRIDE, i-signal-type=PRIMITIVE, init-value=4094, base-type=BT_BMC_CMC_Zellspannung_043, invalid-value=Invalid_BMC_CMC_Zellspannung_043_XIX_BMC_CMC_Zellspannung_02_XIX_HCP5_CANFD01:4095, compu {phys=raw+1000 for raw 0..4091, 4092=Cxffc_kleiner_1V (CM_BMC_CMC_Zellspannung_043_Cxffc_kleiner_1V), 4093=Cxffd_nicht_vorhanden (CM_BMC_CMC_Zellspannung_043_Cxffd_nicht_vorhanden), 4094=Cxffe_Init (CM_BMC_CMC_Zellspannung_043_Cxffe_Init), 4095=Cxfff_Fehler (CM_BMC_CMC_Zellspannung_043_Cxfff_Fehler); unit Unit_MilliVolt}, range phys 1000..5091 Unit_MilliVolt, raw 0..4095, unit=Unit_MilliVolt, transfer-property=PENDING  # Einzelzellspannung zur Uebertragung per RTM
          signal BMC_CMC_Zellspannung_044_XIX_BMC_CMC_Zellspannung_02_XIX_HCP5_CANFD01: start 60, 12 bit, little-endian, data-type-policy=OVERRIDE, i-signal-type=PRIMITIVE, init-value=4094, base-type=BT_BMC_CMC_Zellspannung_044, invalid-value=Invalid_BMC_CMC_Zellspannung_044_XIX_BMC_CMC_Zellspannung_02_XIX_HCP5_CANFD01:4095, compu {phys=raw+1000 for raw 0..4091, 4092=Cxffc_kleiner_1V (CM_BMC_CMC_Zellspannung_044_Cxffc_kleiner_1V), 4093=Cxffd_nicht_vorhanden (CM_BMC_CMC_Zellspannung_044_Cxffd_nicht_vorhanden), 4094=Cxffe_Init (CM_BMC_CMC_Zellspannung_044_Cxffe_Init), 4095=Cxfff_Fehler (CM_BMC_CMC_Zellspannung_044_Cxfff_Fehler); unit Unit_MilliVolt}, range phys 1000..5091 Unit_MilliVolt, raw 0..4095, unit=Unit_MilliVolt, transfer-property=PENDING  # Einzelzellspannung zur Uebertragung per RTM
          signal BMC_CMC_Zellspannung_045_XIX_BMC_CMC_Zellspannung_02_XIX_HCP5_CANFD01: start 72, 12 bit, little-endian, data-type-policy=OVERRIDE, i-signal-type=PRIMITIVE, init-value=4094, base-type=BT_BMC_CMC_Zellspannung_045, invalid-value=Invalid_BMC_CMC_Zellspannung_045_XIX_BMC_CMC_Zellspannung_02_XIX_HCP5_CANFD01:4095, compu {phys=raw+1000 for raw 0..4091, 4092=Cxffc_kleiner_1V (CM_BMC_CMC_Zellspannung_045_Cxffc_kleiner_1V), 4093=Cxffd_nicht_vorhanden (CM_BMC_CMC_Zellspannung_045_Cxffd_nicht_vorhanden), 4094=Cxffe_Init (CM_BMC_CMC_Zellspannung_045_Cxffe_Init), 4095=Cxfff_Fehler (CM_BMC_CMC_Zellspannung_045_Cxfff_Fehler); unit Unit_MilliVolt}, range phys 1000..5091 Unit_MilliVolt, raw 0..4095, unit=Unit_MilliVolt, transfer-property=PENDING  # Einzelzellspannung zur Uebertragung per RTM
          signal BMC_CMC_Zellspannung_046_XIX_BMC_CMC_Zellspannung_02_XIX_HCP5_CANFD01: start 84, 12 bit, little-endian, data-type-policy=OVERRIDE, i-signal-type=PRIMITIVE, init-value=4094, base-type=BT_BMC_CMC_Zellspannung_046, invalid-value=Invalid_BMC_CMC_Zellspannung_046_XIX_BMC_CMC_Zellspannung_02_XIX_HCP5_CANFD01:4095, compu {phys=raw+1000 for raw 0..4091, 4092=Cxffc_kleiner_1V (CM_BMC_CMC_Zellspannung_046_Cxffc_kleiner_1V), 4093=Cxffd_nicht_vorhanden (CM_BMC_CMC_Zellspannung_046_Cxffd_nicht_vorhanden), 4094=Cxffe_Init (CM_BMC_CMC_Zellspannung_046_Cxffe_Init), 4095=Cxfff_Fehler (CM_BMC_CMC_Zellspannung_046_Cxfff_Fehler); unit Unit_MilliVolt}, range phys 1000..5091 Unit_MilliVolt, raw 0..4095, unit=Unit_MilliVolt, transfer-property=PENDING  # Einzelzellspannung zur Uebertragung per RTM
          signal BMC_CMC_Zellspannung_047_XIX_BMC_CMC_Zellspannung_02_XIX_HCP5_CANFD01: start 96, 12 bit, little-endian, data-type-policy=OVERRIDE, i-signal-type=PRIMITIVE, init-value=4094, base-type=BT_BMC_CMC_Zellspannung_047, invalid-value=Invalid_BMC_CMC_Zellspannung_047_XIX_BMC_CMC_Zellspannung_02_XIX_HCP5_CANFD01:4095, compu {phys=raw+1000 for raw 0..4091, 4092=Cxffc_kleiner_1V (CM_BMC_CMC_Zellspannung_047_Cxffc_kleiner_1V), 4093=Cxffd_nicht_vorhanden (CM_BMC_CMC_Zellspannung_047_Cxffd_nicht_vorhanden), 4094=Cxffe_Init (CM_BMC_CMC_Zellspannung_047_Cxffe_Init), 4095=Cxfff_Fehler (CM_BMC_CMC_Zellspannung_047_Cxfff_Fehler); unit Unit_MilliVolt}, range phys 1000..5091 Unit_MilliVolt, raw 0..4095, unit=Unit_MilliVolt, transfer-property=PENDING  # Einzelzellspannung zur Uebertragung per RTM
          signal BMC_CMC_Zellspannung_048_XIX_BMC_CMC_Zellspannung_02_XIX_HCP5_CANFD01: start 108, 12 bit, little-endian, data-type-policy=OVERRIDE, i-signal-type=PRIMITIVE, init-value=4094, base-type=BT_BMC_CMC_Zellspannung_048, invalid-value=Invalid_BMC_CMC_Zellspannung_048_XIX_BMC_CMC_Zellspannung_02_XIX_HCP5_CANFD01:4095, compu {phys=raw+1000 for raw 0..4091, 4092=Cxffc_kleiner_1V (CM_BMC_CMC_Zellspannung_048_Cxffc_kleiner_1V), 4093=Cxffd_nicht_vorhanden (CM_BMC_CMC_Zellspannung_048_Cxffd_nicht_vorhanden), 4094=Cxffe_Init (CM_BMC_CMC_Zellspannung_048_Cxffe_Init), 4095=Cxfff_Fehler (CM_BMC_CMC_Zellspannung_048_Cxfff_Fehler); unit Unit_MilliVolt}, range phys 1000..5091 Unit_MilliVolt, raw 0..4095, unit=Unit_MilliVolt, transfer-property=PENDING  # Einzelzellspannung zur Uebertragung per RTM
          signal BMC_CMC_Zellspannung_049_XIX_BMC_CMC_Zellspannung_02_XIX_HCP5_CANFD01: start 120, 12 bit, little-endian, data-type-policy=OVERRIDE, i-signal-type=PRIMITIVE, init-value=4094, base-type=BT_BMC_CMC_Zellspannung_049, invalid-value=Invalid_BMC_CMC_Zellspannung_049_XIX_BMC_CMC_Zellspannung_02_XIX_HCP5_CANFD01:4095, compu {phys=raw+1000 for raw 0..4091, 4092=Cxffc_kleiner_1V (CM_BMC_CMC_Zellspannung_049_Cxffc_kleiner_1V), 4093=Cxffd_nicht_vorhanden (CM_BMC_CMC_Zellspannung_049_Cxffd_nicht_vorhanden), 4094=Cxffe_Init (CM_BMC_CMC_Zellspannung_049_Cxffe_Init), 4095=Cxfff_Fehler (CM_BMC_CMC_Zellspannung_049_Cxfff_Fehler); unit Unit_MilliVolt}, range phys 1000..5091 Unit_MilliVolt, raw 0..4095, unit=Unit_MilliVolt, transfer-property=PENDING  # Einzelzellspannung zur Uebertragung per RTM
          signal BMC_CMC_Zellspannung_050_XIX_BMC_CMC_Zellspannung_02_XIX_HCP5_CANFD01: start 132, 12 bit, little-endian, data-type-policy=OVERRIDE, i-signal-type=PRIMITIVE, init-value=4094, base-type=BT_BMC_CMC_Zellspannung_050, invalid-value=Invalid_BMC_CMC_Zellspannung_050_XIX_BMC_CMC_Zellspannung_02_XIX_HCP5_CANFD01:4095, compu {phys=raw+1000 for raw 0..4091, 4092=Cxffc_kleiner_1V (CM_BMC_CMC_Zellspannung_050_Cxffc_kleiner_1V), 4093=Cxffd_nicht_vorhanden (CM_BMC_CMC_Zellspannung_050_Cxffd_nicht_vorhanden), 4094=Cxffe_Init (CM_BMC_CMC_Zellspannung_050_Cxffe_Init), 4095=Cxfff_Fehler (CM_BMC_CMC_Zellspannung_050_Cxfff_Fehler); unit Unit_MilliVolt}, range phys 1000..5091 Unit_MilliVolt, raw 0..4095, unit=Unit_MilliVolt, transfer-property=PENDING  # Einzelzellspannung zur Uebertragung per RTM
          signal BMC_CMC_Zellspannung_051_XIX_BMC_CMC_Zellspannung_02_XIX_HCP5_CANFD01: start 144, 12 bit, little-endian, data-type-policy=OVERRIDE, i-signal-type=PRIMITIVE, init-value=4094, base-type=BT_BMC_CMC_Zellspannung_051, invalid-value=Invalid_BMC_CMC_Zellspannung_051_XIX_BMC_CMC_Zellspannung_02_XIX_HCP5_CANFD01:4095, compu {phys=raw+1000 for raw 0..4091, 4092=Cxffc_kleiner_1V (CM_BMC_CMC_Zellspannung_051_Cxffc_kleiner_1V), 4093=Cxffd_nicht_vorhanden (CM_BMC_CMC_Zellspannung_051_Cxffd_nicht_vorhanden), 4094=Cxffe_Init (CM_BMC_CMC_Zellspannung_051_Cxffe_Init), 4095=Cxfff_Fehler (CM_BMC_CMC_Zellspannung_051_Cxfff_Fehler); unit Unit_MilliVolt}, range phys 1000..5091 Unit_MilliVolt, raw 0..4095, unit=Unit_MilliVolt, transfer-property=PENDING  # Einzelzellspannung zur Uebertragung per RTM
          signal BMC_CMC_Zellspannung_052_XIX_BMC_CMC_Zellspannung_02_XIX_HCP5_CANFD01: start 156, 12 bit, little-endian, data-type-policy=OVERRIDE, i-signal-type=PRIMITIVE, init-value=4094, base-type=BT_BMC_CMC_Zellspannung_052, invalid-value=Invalid_BMC_CMC_Zellspannung_052_XIX_BMC_CMC_Zellspannung_02_XIX_HCP5_CANFD01:4095, compu {phys=raw+1000 for raw 0..4091, 4092=Cxffc_kleiner_1V (CM_BMC_CMC_Zellspannung_052_Cxffc_kleiner_1V), 4093=Cxffd_nicht_vorhanden (CM_BMC_CMC_Zellspannung_052_Cxffd_nicht_vorhanden), 4094=Cxffe_Init (CM_BMC_CMC_Zellspannung_052_Cxffe_Init), 4095=Cxfff_Fehler (CM_BMC_CMC_Zellspannung_052_Cxfff_Fehler); unit Unit_MilliVolt}, range phys 1000..5091 Unit_MilliVolt, raw 0..4095, unit=Unit_MilliVolt, transfer-property=PENDING  # Einzelzellspannung zur Uebertragung per RTM
          signal BMC_CMC_Zellspannung_053_XIX_BMC_CMC_Zellspannung_02_XIX_HCP5_CANFD01: start 168, 12 bit, little-endian, data-type-policy=OVERRIDE, i-signal-type=PRIMITIVE, init-value=4094, base-type=BT_BMC_CMC_Zellspannung_053, invalid-value=Invalid_BMC_CMC_Zellspannung_053_XIX_BMC_CMC_Zellspannung_02_XIX_HCP5_CANFD01:4095, compu {phys=raw+1000 for raw 0..4091, 4092=Cxffc_kleiner_1V (CM_BMC_CMC_Zellspannung_053_Cxffc_kleiner_1V), 4093=Cxffd_nicht_vorhanden (CM_BMC_CMC_Zellspannung_053_Cxffd_nicht_vorhanden), 4094=Cxffe_Init (CM_BMC_CMC_Zellspannung_053_Cxffe_Init), 4095=Cxfff_Fehler (CM_BMC_CMC_Zellspannung_053_Cxfff_Fehler); unit Unit_MilliVolt}, range phys 1000..5091 Unit_MilliVolt, raw 0..4095, unit=Unit_MilliVolt, transfer-property=PENDING  # Einzelzellspannung zur Uebertragung per RTM
          signal BMC_CMC_Zellspannung_054_XIX_BMC_CMC_Zellspannung_02_XIX_HCP5_CANFD01: start 180, 12 bit, little-endian, data-type-policy=OVERRIDE, i-signal-type=PRIMITIVE, init-value=4094, base-type=BT_BMC_CMC_Zellspannung_054, invalid-value=Invalid_BMC_CMC_Zellspannung_054_XIX_BMC_CMC_Zellspannung_02_XIX_HCP5_CANFD01:4095, compu {phys=raw+1000 for raw 0..4091, 4092=Cxffc_kleiner_1V (CM_BMC_CMC_Zellspannung_054_Cxffc_kleiner_1V), 4093=Cxffd_nicht_vorhanden (CM_BMC_CMC_Zellspannung_054_Cxffd_nicht_vorhanden), 4094=Cxffe_Init (CM_BMC_CMC_Zellspannung_054_Cxffe_Init), 4095=Cxfff_Fehler (CM_BMC_CMC_Zellspannung_054_Cxfff_Fehler); unit Unit_MilliVolt}, range phys 1000..5091 Unit_MilliVolt, raw 0..4095, unit=Unit_MilliVolt, transfer-property=PENDING  # Einzelzellspannung zur Uebertragung per RTM
          signal BMC_CMC_Zellspannung_055_XIX_BMC_CMC_Zellspannung_02_XIX_HCP5_CANFD01: start 192, 12 bit, little-endian, data-type-policy=OVERRIDE, i-signal-type=PRIMITIVE, init-value=4094, base-type=BT_BMC_CMC_Zellspannung_055, invalid-value=Invalid_BMC_CMC_Zellspannung_055_XIX_BMC_CMC_Zellspannung_02_XIX_HCP5_CANFD01:4095, compu {phys=raw+1000 for raw 0..4091, 4092=Cxffc_kleiner_1V (CM_BMC_CMC_Zellspannung_055_Cxffc_kleiner_1V), 4093=Cxffd_nicht_vorhanden (CM_BMC_CMC_Zellspannung_055_Cxffd_nicht_vorhanden), 4094=Cxffe_Init (CM_BMC_CMC_Zellspannung_055_Cxffe_Init), 4095=Cxfff_Fehler (CM_BMC_CMC_Zellspannung_055_Cxfff_Fehler); unit Unit_MilliVolt}, range phys 1000..5091 Unit_MilliVolt, raw 0..4095, unit=Unit_MilliVolt, transfer-property=PENDING  # Einzelzellspannung zur Uebertragung per RTM
          signal BMC_CMC_Zellspannung_056_XIX_BMC_CMC_Zellspannung_02_XIX_HCP5_CANFD01: start 204, 12 bit, little-endian, data-type-policy=OVERRIDE, i-signal-type=PRIMITIVE, init-value=4094, base-type=BT_BMC_CMC_Zellspannung_056, invalid-value=Invalid_BMC_CMC_Zellspannung_056_XIX_BMC_CMC_Zellspannung_02_XIX_HCP5_CANFD01:4095, compu {phys=raw+1000 for raw 0..4091, 4092=Cxffc_kleiner_1V (CM_BMC_CMC_Zellspannung_056_Cxffc_kleiner_1V), 4093=Cxffd_nicht_vorhanden (CM_BMC_CMC_Zellspannung_056_Cxffd_nicht_vorhanden), 4094=Cxffe_Init (CM_BMC_CMC_Zellspannung_056_Cxffe_Init), 4095=Cxfff_Fehler (CM_BMC_CMC_Zellspannung_056_Cxfff_Fehler); unit Unit_MilliVolt}, range phys 1000..5091 Unit_MilliVolt, raw 0..4095, unit=Unit_MilliVolt, transfer-property=PENDING  # Einzelzellspannung zur Uebertragung per RTM
          signal BMC_CMC_Zellspannung_057_XIX_BMC_CMC_Zellspannung_02_XIX_HCP5_CANFD01: start 216, 12 bit, little-endian, data-type-policy=OVERRIDE, i-signal-type=PRIMITIVE, init-value=4094, base-type=BT_BMC_CMC_Zellspannung_057, invalid-value=Invalid_BMC_CMC_Zellspannung_057_XIX_BMC_CMC_Zellspannung_02_XIX_HCP5_CANFD01:4095, compu {phys=raw+1000 for raw 0..4091, 4092=Cxffc_kleiner_1V (CM_BMC_CMC_Zellspannung_057_Cxffc_kleiner_1V), 4093=Cxffd_nicht_vorhanden (CM_BMC_CMC_Zellspannung_057_Cxffd_nicht_vorhanden), 4094=Cxffe_Init (CM_BMC_CMC_Zellspannung_057_Cxffe_Init), 4095=Cxfff_Fehler (CM_BMC_CMC_Zellspannung_057_Cxfff_Fehler); unit Unit_MilliVolt}, range phys 1000..5091 Unit_MilliVolt, raw 0..4095, unit=Unit_MilliVolt, transfer-property=PENDING  # Einzelzellspannung zur Uebertragung per RTM
          signal BMC_CMC_Zellspannung_058_XIX_BMC_CMC_Zellspannung_02_XIX_HCP5_CANFD01: start 228, 12 bit, little-endian, data-type-policy=OVERRIDE, i-signal-type=PRIMITIVE, init-value=4094, base-type=BT_BMC_CMC_Zellspannung_058, invalid-value=Invalid_BMC_CMC_Zellspannung_058_XIX_BMC_CMC_Zellspannung_02_XIX_HCP5_CANFD01:4095, compu {phys=raw+1000 for raw 0..4091, 4092=Cxffc_kleiner_1V (CM_BMC_CMC_Zellspannung_058_Cxffc_kleiner_1V), 4093=Cxffd_nicht_vorhanden (CM_BMC_CMC_Zellspannung_058_Cxffd_nicht_vorhanden), 4094=Cxffe_Init (CM_BMC_CMC_Zellspannung_058_Cxffe_Init), 4095=Cxfff_Fehler (CM_BMC_CMC_Zellspannung_058_Cxfff_Fehler); unit Unit_MilliVolt}, range phys 1000..5091 Unit_MilliVolt, raw 0..4095, unit=Unit_MilliVolt, transfer-property=PENDING  # Einzelzellspannung zur Uebertragung per RTM
          signal BMC_CMC_Zellspannung_059_XIX_BMC_CMC_Zellspannung_02_XIX_HCP5_CANFD01: start 240, 12 bit, little-endian, data-type-policy=OVERRIDE, i-signal-type=PRIMITIVE, init-value=4094, base-type=BT_BMC_CMC_Zellspannung_059, invalid-value=Invalid_BMC_CMC_Zellspannung_059_XIX_BMC_CMC_Zellspannung_02_XIX_HCP5_CANFD01:4095, compu {phys=raw+1000 for raw 0..4091, 4092=Cxffc_kleiner_1V (CM_BMC_CMC_Zellspannung_059_Cxffc_kleiner_1V), 4093=Cxffd_nicht_vorhanden (CM_BMC_CMC_Zellspannung_059_Cxffd_nicht_vorhanden), 4094=Cxffe_Init (CM_BMC_CMC_Zellspannung_059_Cxffe_Init), 4095=Cxfff_Fehler (CM_BMC_CMC_Zellspannung_059_Cxfff_Fehler); unit Unit_MilliVolt}, range phys 1000..5091 Unit_MilliVolt, raw 0..4095, unit=Unit_MilliVolt, transfer-property=PENDING  # Einzelzellspannung zur Uebertragung per RTM
          signal BMC_CMC_Zellspannung_060_XIX_BMC_CMC_Zellspannung_02_XIX_HCP5_CANFD01: start 252, 12 bit, little-endian, data-type-policy=OVERRIDE, i-signal-type=PRIMITIVE, init-value=4094, base-type=BT_BMC_CMC_Zellspannung_060, invalid-value=Invalid_BMC_CMC_Zellspannung_060_XIX_BMC_CMC_Zellspannung_02_XIX_HCP5_CANFD01:4095, compu {phys=raw+1000 for raw 0..4091, 4092=Cxffc_kleiner_1V (CM_BMC_CMC_Zellspannung_060_Cxffc_kleiner_1V), 4093=Cxffd_nicht_vorhanden (CM_BMC_CMC_Zellspannung_060_Cxffd_nicht_vorhanden), 4094=Cxffe_Init (CM_BMC_CMC_Zellspannung_060_Cxffe_Init), 4095=Cxfff_Fehler (CM_BMC_CMC_Zellspannung_060_Cxfff_Fehler); unit Unit_MilliVolt}, range phys 1000..5091 Unit_MilliVolt, raw 0..4095, unit=Unit_MilliVolt, transfer-property=PENDING  # Einzelzellspannung zur Uebertragung per RTM
          signal BMC_CMC_Zellspannung_061_XIX_BMC_CMC_Zellspannung_02_XIX_HCP5_CANFD01: start 264, 12 bit, little-endian, data-type-policy=OVERRIDE, i-signal-type=PRIMITIVE, init-value=4094, base-type=BT_BMC_CMC_Zellspannung_061, invalid-value=Invalid_BMC_CMC_Zellspannung_061_XIX_BMC_CMC_Zellspannung_02_XIX_HCP5_CANFD01:4095, compu {phys=raw+1000 for raw 0..4091, 4092=Cxffc_kleiner_1V (CM_BMC_CMC_Zellspannung_061_Cxffc_kleiner_1V), 4093=Cxffd_nicht_vorhanden (CM_BMC_CMC_Zellspannung_061_Cxffd_nicht_vorhanden), 4094=Cxffe_Init (CM_BMC_CMC_Zellspannung_061_Cxffe_Init), 4095=Cxfff_Fehler (CM_BMC_CMC_Zellspannung_061_Cxfff_Fehler); unit Unit_MilliVolt}, range phys 1000..5091 Unit_MilliVolt, raw 0..4095, unit=Unit_MilliVolt, transfer-property=PENDING  # Einzelzellspannung zur Uebertragung per RTM
          signal BMC_CMC_Zellspannung_062_XIX_BMC_CMC_Zellspannung_02_XIX_HCP5_CANFD01: start 276, 12 bit, little-endian, data-type-policy=OVERRIDE, i-signal-type=PRIMITIVE, init-value=4094, base-type=BT_BMC_CMC_Zellspannung_062, invalid-value=Invalid_BMC_CMC_Zellspannung_062_XIX_BMC_CMC_Zellspannung_02_XIX_HCP5_CANFD01:4095, compu {phys=raw+1000 for raw 0..4091, 4092=Cxffc_kleiner_1V (CM_BMC_CMC_Zellspannung_062_Cxffc_kleiner_1V), 4093=Cxffd_nicht_vorhanden (CM_BMC_CMC_Zellspannung_062_Cxffd_nicht_vorhanden), 4094=Cxffe_Init (CM_BMC_CMC_Zellspannung_062_Cxffe_Init), 4095=Cxfff_Fehler (CM_BMC_CMC_Zellspannung_062_Cxfff_Fehler); unit Unit_MilliVolt}, range phys 1000..5091 Unit_MilliVolt, raw 0..4095, unit=Unit_MilliVolt, transfer-property=PENDING  # Einzelzellspannung zur Uebertragung per RTM
          signal BMC_CMC_Zellspannung_063_XIX_BMC_CMC_Zellspannung_02_XIX_HCP5_CANFD01: start 288, 12 bit, little-endian, data-type-policy=OVERRIDE, i-signal-type=PRIMITIVE, init-value=4094, base-type=BT_BMC_CMC_Zellspannung_063, invalid-value=Invalid_BMC_CMC_Zellspannung_063_XIX_BMC_CMC_Zellspannung_02_XIX_HCP5_CANFD01:4095, compu {phys=raw+1000 for raw 0..4091, 4092=Cxffc_kleiner_1V (CM_BMC_CMC_Zellspannung_063_Cxffc_kleiner_1V), 4093=Cxffd_nicht_vorhanden (CM_BMC_CMC_Zellspannung_063_Cxffd_nicht_vorhanden), 4094=Cxffe_Init (CM_BMC_CMC_Zellspannung_063_Cxffe_Init), 4095=Cxfff_Fehler (CM_BMC_CMC_Zellspannung_063_Cxfff_Fehler); unit Unit_MilliVolt}, range phys 1000..5091 Unit_MilliVolt, raw 0..4095, unit=Unit_MilliVolt, transfer-property=PENDING  # Einzelzellspannung zur Uebertragung per RTM
          signal BMC_CMC_Zellspannung_064_XIX_BMC_CMC_Zellspannung_02_XIX_HCP5_CANFD01: start 300, 12 bit, little-endian, data-type-policy=OVERRIDE, i-signal-type=PRIMITIVE, init-value=4094, base-type=BT_BMC_CMC_Zellspannung_064, invalid-value=Invalid_BMC_CMC_Zellspannung_064_XIX_BMC_CMC_Zellspannung_02_XIX_HCP5_CANFD01:4095, compu {phys=raw+1000 for raw 0..4091, 4092=Cxffc_kleiner_1V (CM_BMC_CMC_Zellspannung_064_Cxffc_kleiner_1V), 4093=Cxffd_nicht_vorhanden (CM_BMC_CMC_Zellspannung_064_Cxffd_nicht_vorhanden), 4094=Cxffe_Init (CM_BMC_CMC_Zellspannung_064_Cxffe_Init), 4095=Cxfff_Fehler (CM_BMC_CMC_Zellspannung_064_Cxfff_Fehler); unit Unit_MilliVolt}, range phys 1000..5091 Unit_MilliVolt, raw 0..4095, unit=Unit_MilliVolt, transfer-property=PENDING  # Einzelzellspannung zur Uebertragung per RTM
          signal BMC_CMC_Zellspannung_065_XIX_BMC_CMC_Zellspannung_02_XIX_HCP5_CANFD01: start 312, 12 bit, little-endian, data-type-policy=OVERRIDE, i-signal-type=PRIMITIVE, init-value=4094, base-type=BT_BMC_CMC_Zellspannung_065, invalid-value=Invalid_BMC_CMC_Zellspannung_065_XIX_BMC_CMC_Zellspannung_02_XIX_HCP5_CANFD01:4095, compu {phys=raw+1000 for raw 0..4091, 4092=Cxffc_kleiner_1V (CM_BMC_CMC_Zellspannung_065_Cxffc_kleiner_1V), 4093=Cxffd_nicht_vorhanden (CM_BMC_CMC_Zellspannung_065_Cxffd_nicht_vorhanden), 4094=Cxffe_Init (CM_BMC_CMC_Zellspannung_065_Cxffe_Init), 4095=Cxfff_Fehler (CM_BMC_CMC_Zellspannung_065_Cxfff_Fehler); unit Unit_MilliVolt}, range phys 1000..5091 Unit_MilliVolt, raw 0..4095, unit=Unit_MilliVolt, transfer-property=PENDING  # Einzelzellspannung zur Uebertragung per RTM
          signal BMC_CMC_Zellspannung_066_XIX_BMC_CMC_Zellspannung_02_XIX_HCP5_CANFD01: start 324, 12 bit, little-endian, data-type-policy=OVERRIDE, i-signal-type=PRIMITIVE, init-value=4094, base-type=BT_BMC_CMC_Zellspannung_066, invalid-value=Invalid_BMC_CMC_Zellspannung_066_XIX_BMC_CMC_Zellspannung_02_XIX_HCP5_CANFD01:4095, compu {phys=raw+1000 for raw 0..4091, 4092=Cxffc_kleiner_1V (CM_BMC_CMC_Zellspannung_066_Cxffc_kleiner_1V), 4093=Cxffd_nicht_vorhanden (CM_BMC_CMC_Zellspannung_066_Cxffd_nicht_vorhanden), 4094=Cxffe_Init (CM_BMC_CMC_Zellspannung_066_Cxffe_Init), 4095=Cxfff_Fehler (CM_BMC_CMC_Zellspannung_066_Cxfff_Fehler); unit Unit_MilliVolt}, range phys 1000..5091 Unit_MilliVolt, raw 0..4095, unit=Unit_MilliVolt, transfer-property=PENDING  # Einzelzellspannung zur Uebertragung per RTM
          signal BMC_CMC_Zellspannung_067_XIX_BMC_CMC_Zellspannung_02_XIX_HCP5_CANFD01: start 336, 12 bit, little-endian, data-type-policy=OVERRIDE, i-signal-type=PRIMITIVE, init-value=4094, base-type=BT_BMC_CMC_Zellspannung_067, invalid-value=Invalid_BMC_CMC_Zellspannung_067_XIX_BMC_CMC_Zellspannung_02_XIX_HCP5_CANFD01:4095, compu {phys=raw+1000 for raw 0..4091, 4092=Cxffc_kleiner_1V (CM_BMC_CMC_Zellspannung_067_Cxffc_kleiner_1V), 4093=Cxffd_nicht_vorhanden (CM_BMC_CMC_Zellspannung_067_Cxffd_nicht_vorhanden), 4094=Cxffe_Init (CM_BMC_CMC_Zellspannung_067_Cxffe_Init), 4095=Cxfff_Fehler (CM_BMC_CMC_Zellspannung_067_Cxfff_Fehler); unit Unit_MilliVolt}, range phys 1000..5091 Unit_MilliVolt, raw 0..4095, unit=Unit_MilliVolt, transfer-property=PENDING  # Einzelzellspannung zur Uebertragung per RTM
          signal BMC_CMC_Zellspannung_068_XIX_BMC_CMC_Zellspannung_02_XIX_HCP5_CANFD01: start 348, 12 bit, little-endian, data-type-policy=OVERRIDE, i-signal-type=PRIMITIVE, init-value=4094, base-type=BT_BMC_CMC_Zellspannung_068, invalid-value=Invalid_BMC_CMC_Zellspannung_068_XIX_BMC_CMC_Zellspannung_02_XIX_HCP5_CANFD01:4095, compu {phys=raw+1000 for raw 0..4091, 4092=Cxffc_kleiner_1V (CM_BMC_CMC_Zellspannung_068_Cxffc_kleiner_1V), 4093=Cxffd_nicht_vorhanden (CM_BMC_CMC_Zellspannung_068_Cxffd_nicht_vorhanden), 4094=Cxffe_Init (CM_BMC_CMC_Zellspannung_068_Cxffe_Init), 4095=Cxfff_Fehler (CM_BMC_CMC_Zellspannung_068_Cxfff_Fehler); unit Unit_MilliVolt}, range phys 1000..5091 Unit_MilliVolt, raw 0..4095, unit=Unit_MilliVolt, transfer-property=PENDING  # Einzelzellspannung zur Uebertragung per RTM
          signal BMC_CMC_Zellspannung_069_XIX_BMC_CMC_Zellspannung_02_XIX_HCP5_CANFD01: start 360, 12 bit, little-endian, data-type-policy=OVERRIDE, i-signal-type=PRIMITIVE, init-value=4094, base-type=BT_BMC_CMC_Zellspannung_069, invalid-value=Invalid_BMC_CMC_Zellspannung_069_XIX_BMC_CMC_Zellspannung_02_XIX_HCP5_CANFD01:4095, compu {phys=raw+1000 for raw 0..4091, 4092=Cxffc_kleiner_1V (CM_BMC_CMC_Zellspannung_069_Cxffc_kleiner_1V), 4093=Cxffd_nicht_vorhanden (CM_BMC_CMC_Zellspannung_069_Cxffd_nicht_vorhanden), 4094=Cxffe_Init (CM_BMC_CMC_Zellspannung_069_Cxffe_Init), 4095=Cxfff_Fehler (CM_BMC_CMC_Zellspannung_069_Cxfff_Fehler); unit Unit_MilliVolt}, range phys 1000..5091 Unit_MilliVolt, raw 0..4095, unit=Unit_MilliVolt, transfer-property=PENDING  # Einzelzellspannung zur Uebertragung per RTM
          signal BMC_CMC_Zellspannung_070_XIX_BMC_CMC_Zellspannung_02_XIX_HCP5_CANFD01: start 372, 12 bit, little-endian, data-type-policy=OVERRIDE, i-signal-type=PRIMITIVE, init-value=4094, base-type=BT_BMC_CMC_Zellspannung_070, invalid-value=Invalid_BMC_CMC_Zellspannung_070_XIX_BMC_CMC_Zellspannung_02_XIX_HCP5_CANFD01:4095, compu {phys=raw+1000 for raw 0..4091, 4092=Cxffc_kleiner_1V (CM_BMC_CMC_Zellspannung_070_Cxffc_kleiner_1V), 4093=Cxffd_nicht_vorhanden (CM_BMC_CMC_Zellspannung_070_Cxffd_nicht_vorhanden), 4094=Cxffe_Init (CM_BMC_CMC_Zellspannung_070_Cxffe_Init), 4095=Cxfff_Fehler (CM_BMC_CMC_Zellspannung_070_Cxfff_Fehler); unit Unit_MilliVolt}, range phys 1000..5091 Unit_MilliVolt, raw 0..4095, unit=Unit_MilliVolt, transfer-property=PENDING  # Einzelzellspannung zur Uebertragung per RTM
          signal BMC_CMC_Zellspannung_071_XIX_BMC_CMC_Zellspannung_02_XIX_HCP5_CANFD01: start 384, 12 bit, little-endian, data-type-policy=OVERRIDE, i-signal-type=PRIMITIVE, init-value=4094, base-type=BT_BMC_CMC_Zellspannung_071, invalid-value=Invalid_BMC_CMC_Zellspannung_071_XIX_BMC_CMC_Zellspannung_02_XIX_HCP5_CANFD01:4095, compu {phys=raw+1000 for raw 0..4091, 4092=Cxffc_kleiner_1V (CM_BMC_CMC_Zellspannung_071_Cxffc_kleiner_1V), 4093=Cxffd_nicht_vorhanden (CM_BMC_CMC_Zellspannung_071_Cxffd_nicht_vorhanden), 4094=Cxffe_Init (CM_BMC_CMC_Zellspannung_071_Cxffe_Init), 4095=Cxfff_Fehler (CM_BMC_CMC_Zellspannung_071_Cxfff_Fehler); unit Unit_MilliVolt}, range phys 1000..5091 Unit_MilliVolt, raw 0..4095, unit=Unit_MilliVolt, transfer-property=PENDING  # Einzelzellspannung zur Uebertragung per RTM
          signal BMC_CMC_Zellspannung_072_XIX_BMC_CMC_Zellspannung_02_XIX_HCP5_CANFD01: start 396, 12 bit, little-endian, data-type-policy=OVERRIDE, i-signal-type=PRIMITIVE, init-value=4094, base-type=BT_BMC_CMC_Zellspannung_072, invalid-value=Invalid_BMC_CMC_Zellspannung_072_XIX_BMC_CMC_Zellspannung_02_XIX_HCP5_CANFD01:4095, compu {phys=raw+1000 for raw 0..4091, 4092=Cxffc_kleiner_1V (CM_BMC_CMC_Zellspannung_072_Cxffc_kleiner_1V), 4093=Cxffd_nicht_vorhanden (CM_BMC_CMC_Zellspannung_072_Cxffd_nicht_vorhanden), 4094=Cxffe_Init (CM_BMC_CMC_Zellspannung_072_Cxffe_Init), 4095=Cxfff_Fehler (CM_BMC_CMC_Zellspannung_072_Cxfff_Fehler); unit Unit_MilliVolt}, range phys 1000..5091 Unit_MilliVolt, raw 0..4095, unit=Unit_MilliVolt, transfer-property=PENDING  # Einzelzellspannung zur Uebertragung per RTM
          signal BMC_CMC_Zellspannung_073_XIX_BMC_CMC_Zellspannung_02_XIX_HCP5_CANFD01: start 408, 12 bit, little-endian, data-type-policy=OVERRIDE, i-signal-type=PRIMITIVE, init-value=4094, base-type=BT_BMC_CMC_Zellspannung_073, invalid-value=Invalid_BMC_CMC_Zellspannung_073_XIX_BMC_CMC_Zellspannung_02_XIX_HCP5_CANFD01:4095, compu {phys=raw+1000 for raw 0..4091, 4092=Cxffc_kleiner_1V (CM_BMC_CMC_Zellspannung_073_Cxffc_kleiner_1V), 4093=Cxffd_nicht_vorhanden (CM_BMC_CMC_Zellspannung_073_Cxffd_nicht_vorhanden), 4094=Cxffe_Init (CM_BMC_CMC_Zellspannung_073_Cxffe_Init), 4095=Cxfff_Fehler (CM_BMC_CMC_Zellspannung_073_Cxfff_Fehler); unit Unit_MilliVolt}, range phys 1000..5091 Unit_MilliVolt, raw 0..4095, unit=Unit_MilliVolt, transfer-property=PENDING  # Einzelzellspannung zur Uebertragung per RTM
          signal BMC_CMC_Zellspannung_074_XIX_BMC_CMC_Zellspannung_02_XIX_HCP5_CANFD01: start 420, 12 bit, little-endian, data-type-policy=OVERRIDE, i-signal-type=PRIMITIVE, init-value=4094, base-type=BT_BMC_CMC_Zellspannung_074, invalid-value=Invalid_BMC_CMC_Zellspannung_074_XIX_BMC_CMC_Zellspannung_02_XIX_HCP5_CANFD01:4095, compu {phys=raw+1000 for raw 0..4091, 4092=Cxffc_kleiner_1V (CM_BMC_CMC_Zellspannung_074_Cxffc_kleiner_1V), 4093=Cxffd_nicht_vorhanden (CM_BMC_CMC_Zellspannung_074_Cxffd_nicht_vorhanden), 4094=Cxffe_Init (CM_BMC_CMC_Zellspannung_074_Cxffe_Init), 4095=Cxfff_Fehler (CM_BMC_CMC_Zellspannung_074_Cxfff_Fehler); unit Unit_MilliVolt}, range phys 1000..5091 Unit_MilliVolt, raw 0..4095, unit=Unit_MilliVolt, transfer-property=PENDING  # Einzelzellspannung zur Uebertragung per RTM
          signal BMC_CMC_Zellspannung_075_XIX_BMC_CMC_Zellspannung_02_XIX_HCP5_CANFD01: start 432, 12 bit, little-endian, data-type-policy=OVERRIDE, i-signal-type=PRIMITIVE, init-value=4094, base-type=BT_BMC_CMC_Zellspannung_075, invalid-value=Invalid_BMC_CMC_Zellspannung_075_XIX_BMC_CMC_Zellspannung_02_XIX_HCP5_CANFD01:4095, compu {phys=raw+1000 for raw 0..4091, 4092=Cxffc_kleiner_1V (CM_BMC_CMC_Zellspannung_075_Cxffc_kleiner_1V), 4093=Cxffd_nicht_vorhanden (CM_BMC_CMC_Zellspannung_075_Cxffd_nicht_vorhanden), 4094=Cxffe_Init (CM_BMC_CMC_Zellspannung_075_Cxffe_Init), 4095=Cxfff_Fehler (CM_BMC_CMC_Zellspannung_075_Cxfff_Fehler); unit Unit_MilliVolt}, range phys 1000..5091 Unit_MilliVolt, raw 0..4095, unit=Unit_MilliVolt, transfer-property=PENDING  # Einzelzellspannung zur Uebertragung per RTM
          signal BMC_CMC_Zellspannung_076_XIX_BMC_CMC_Zellspannung_02_XIX_HCP5_CANFD01: start 444, 12 bit, little-endian, data-type-policy=OVERRIDE, i-signal-type=PRIMITIVE, init-value=4094, base-type=BT_BMC_CMC_Zellspannung_076, invalid-value=Invalid_BMC_CMC_Zellspannung_076_XIX_BMC_CMC_Zellspannung_02_XIX_HCP5_CANFD01:4095, compu {phys=raw+1000 for raw 0..4091, 4092=Cxffc_kleiner_1V (CM_BMC_CMC_Zellspannung_076_Cxffc_kleiner_1V), 4093=Cxffd_nicht_vorhanden (CM_BMC_CMC_Zellspannung_076_Cxffd_nicht_vorhanden), 4094=Cxffe_Init (CM_BMC_CMC_Zellspannung_076_Cxffe_Init), 4095=Cxfff_Fehler (CM_BMC_CMC_Zellspannung_076_Cxfff_Fehler); unit Unit_MilliVolt}, range phys 1000..5091 Unit_MilliVolt, raw 0..4095, unit=Unit_MilliVolt, transfer-property=PENDING  # Einzelzellspannung zur Uebertragung per RTM
          signal BMC_CMC_Zellspannung_077_XIX_BMC_CMC_Zellspannung_02_XIX_HCP5_CANFD01: start 456, 12 bit, little-endian, data-type-policy=OVERRIDE, i-signal-type=PRIMITIVE, init-value=4094, base-type=BT_BMC_CMC_Zellspannung_077, invalid-value=Invalid_BMC_CMC_Zellspannung_077_XIX_BMC_CMC_Zellspannung_02_XIX_HCP5_CANFD01:4095, compu {phys=raw+1000 for raw 0..4091, 4092=Cxffc_kleiner_1V (CM_BMC_CMC_Zellspannung_077_Cxffc_kleiner_1V), 4093=Cxffd_nicht_vorhanden (CM_BMC_CMC_Zellspannung_077_Cxffd_nicht_vorhanden), 4094=Cxffe_Init (CM_BMC_CMC_Zellspannung_077_Cxffe_Init), 4095=Cxfff_Fehler (CM_BMC_CMC_Zellspannung_077_Cxfff_Fehler); unit Unit_MilliVolt}, range phys 1000..5091 Unit_MilliVolt, raw 0..4095, unit=Unit_MilliVolt, transfer-property=PENDING  # Einzelzellspannung zur Uebertragung per RTM
          signal BMC_CMC_Zellspannung_078_XIX_BMC_CMC_Zellspannung_02_XIX_HCP5_CANFD01: start 468, 12 bit, little-endian, data-type-policy=OVERRIDE, i-signal-type=PRIMITIVE, init-value=4094, base-type=BT_BMC_CMC_Zellspannung_078, invalid-value=Invalid_BMC_CMC_Zellspannung_078_XIX_BMC_CMC_Zellspannung_02_XIX_HCP5_CANFD01:4095, compu {phys=raw+1000 for raw 0..4091, 4092=Cxffc_kleiner_1V (CM_BMC_CMC_Zellspannung_078_Cxffc_kleiner_1V), 4093=Cxffd_nicht_vorhanden (CM_BMC_CMC_Zellspannung_078_Cxffd_nicht_vorhanden), 4094=Cxffe_Init (CM_BMC_CMC_Zellspannung_078_Cxffe_Init), 4095=Cxfff_Fehler (CM_BMC_CMC_Zellspannung_078_Cxfff_Fehler); unit Unit_MilliVolt}, range phys 1000..5091 Unit_MilliVolt, raw 0..4095, unit=Unit_MilliVolt, transfer-property=PENDING  # Einzelzellspannung zur Uebertragung per RTM
          signal BMC_CMC_Zellspannung_02_Messzeit_XIX_BMC_CMC_Zellspannung_02_XIX_HCP5_CANFD01: start 480, 8 bit, little-endian, data-type-policy=OVERRIDE, i-signal-type=PRIMITIVE, init-value=254, base-type=BT_BMC_CMC_Zellspannung_02_Messzeit, invalid-value=Invalid_BMC_CMC_Zellspannung_02_Messzeit_XIX_BMC_CMC_Zellspannung_02_XIX_HCP5_CANFD01:255, compu {phys=raw for raw 0..253, 254=Cxfe_Init (CM_BMC_CMC_Zellspannung_02_Messzeit_Cxfe_Init), 255=Cxff_Fehler (CM_BMC_CMC_Zellspannung_02_Messzeit_Cxff_Fehler); unit Unit_None}, range phys 0..253 Unit_None, raw 0..255, unit=Unit_None, transfer-property=PENDING  # Messzeit zu Botschaft BMC_CMC_Zellspannung_02
      frame BMC_CMC_Zellspannung_03_XIX_HCP5_CANFD01: id 0x1A55562E, from BMC_HV, frame-length=64, can-addressing-mode=EXTENDED, can-frame-rx-behavior=CAN-FD, can-frame-tx-behavior=CAN-FD
        pdu BMC_CMC_Zellspannung_03_XIX_HCP5_CANFD01: length=64, transmission-mode-true-timing=cyclic-timing={time-offset=0, time-period=1}, unused-bit-pattern=0
          signal BMC_CMC_Zellspannung_079_XIX_BMC_CMC_Zellspannung_03_XIX_HCP5_CANFD01: start 12, 12 bit, little-endian, data-type-policy=OVERRIDE, i-signal-type=PRIMITIVE, init-value=4094, base-type=BT_BMC_CMC_Zellspannung_079, invalid-value=Invalid_BMC_CMC_Zellspannung_079_XIX_BMC_CMC_Zellspannung_03_XIX_HCP5_CANFD01:4095, compu {phys=raw+1000 for raw 0..4091, 4092=Cxffc_kleiner_1V (CM_BMC_CMC_Zellspannung_079_Cxffc_kleiner_1V), 4093=Cxffd_nicht_vorhanden (CM_BMC_CMC_Zellspannung_079_Cxffd_nicht_vorhanden), 4094=Cxffe_Init (CM_BMC_CMC_Zellspannung_079_Cxffe_Init), 4095=Cxfff_Fehler (CM_BMC_CMC_Zellspannung_079_Cxfff_Fehler); unit Unit_MilliVolt}, range phys 1000..5091 Unit_MilliVolt, raw 0..4095, unit=Unit_MilliVolt, transfer-property=PENDING  # Einzelzellspannung zur Uebertragung per RTM
          signal BMC_CMC_Zellspannung_080_XIX_BMC_CMC_Zellspannung_03_XIX_HCP5_CANFD01: start 24, 12 bit, little-endian, data-type-policy=OVERRIDE, i-signal-type=PRIMITIVE, init-value=4094, base-type=BT_BMC_CMC_Zellspannung_080, invalid-value=Invalid_BMC_CMC_Zellspannung_080_XIX_BMC_CMC_Zellspannung_03_XIX_HCP5_CANFD01:4095, compu {phys=raw+1000 for raw 0..4091, 4092=Cxffc_kleiner_1V (CM_BMC_CMC_Zellspannung_080_Cxffc_kleiner_1V), 4093=Cxffd_nicht_vorhanden (CM_BMC_CMC_Zellspannung_080_Cxffd_nicht_vorhanden), 4094=Cxffe_Init (CM_BMC_CMC_Zellspannung_080_Cxffe_Init), 4095=Cxfff_Fehler (CM_BMC_CMC_Zellspannung_080_Cxfff_Fehler); unit Unit_MilliVolt}, range phys 1000..5091 Unit_MilliVolt, raw 0..4095, unit=Unit_MilliVolt, transfer-property=PENDING  # Einzelzellspannung zur Uebertragung per RTM
          signal BMC_CMC_Zellspannung_081_XIX_BMC_CMC_Zellspannung_03_XIX_HCP5_CANFD01: start 36, 12 bit, little-endian, data-type-policy=OVERRIDE, i-signal-type=PRIMITIVE, init-value=4094, base-type=BT_BMC_CMC_Zellspannung_081, invalid-value=Invalid_BMC_CMC_Zellspannung_081_XIX_BMC_CMC_Zellspannung_03_XIX_HCP5_CANFD01:4095, compu {phys=raw+1000 for raw 0..4091, 4092=Cxffc_kleiner_1V (CM_BMC_CMC_Zellspannung_081_Cxffc_kleiner_1V), 4093=Cxffd_nicht_vorhanden (CM_BMC_CMC_Zellspannung_081_Cxffd_nicht_vorhanden), 4094=Cxffe_Init (CM_BMC_CMC_Zellspannung_081_Cxffe_Init), 4095=Cxfff_Fehler (CM_BMC_CMC_Zellspannung_081_Cxfff_Fehler); unit Unit_MilliVolt}, range phys 1000..5091 Unit_MilliVolt, raw 0..4095, unit=Unit_MilliVolt, transfer-property=PENDING  # Einzelzellspannung zur Uebertragung per RTM
          signal BMC_CMC_Zellspannung_082_XIX_BMC_CMC_Zellspannung_03_XIX_HCP5_CANFD01: start 48, 12 bit, little-endian, data-type-policy=OVERRIDE, i-signal-type=PRIMITIVE, init-value=4094, base-type=BT_BMC_CMC_Zellspannung_082, invalid-value=Invalid_BMC_CMC_Zellspannung_082_XIX_BMC_CMC_Zellspannung_03_XIX_HCP5_CANFD01:4095, compu {phys=raw+1000 for raw 0..4091, 4092=Cxffc_kleiner_1V (CM_BMC_CMC_Zellspannung_082_Cxffc_kleiner_1V), 4093=Cxffd_nicht_vorhanden (CM_BMC_CMC_Zellspannung_082_Cxffd_nicht_vorhanden), 4094=Cxffe_Init (CM_BMC_CMC_Zellspannung_082_Cxffe_Init), 4095=Cxfff_Fehler (CM_BMC_CMC_Zellspannung_082_Cxfff_Fehler); unit Unit_MilliVolt}, range phys 1000..5091 Unit_MilliVolt, raw 0..4095, unit=Unit_MilliVolt, transfer-property=PENDING  # Einzelzellspannung zur Uebertragung per RTM
          signal BMC_CMC_Zellspannung_083_XIX_BMC_CMC_Zellspannung_03_XIX_HCP5_CANFD01: start 60, 12 bit, little-endian, data-type-policy=OVERRIDE, i-signal-type=PRIMITIVE, init-value=4094, base-type=BT_BMC_CMC_Zellspannung_083, invalid-value=Invalid_BMC_CMC_Zellspannung_083_XIX_BMC_CMC_Zellspannung_03_XIX_HCP5_CANFD01:4095, compu {phys=raw+1000 for raw 0..4091, 4092=Cxffc_kleiner_1V (CM_BMC_CMC_Zellspannung_083_Cxffc_kleiner_1V), 4093=Cxffd_nicht_vorhanden (CM_BMC_CMC_Zellspannung_083_Cxffd_nicht_vorhanden), 4094=Cxffe_Init (CM_BMC_CMC_Zellspannung_083_Cxffe_Init), 4095=Cxfff_Fehler (CM_BMC_CMC_Zellspannung_083_Cxfff_Fehler); unit Unit_MilliVolt}, range phys 1000..5091 Unit_MilliVolt, raw 0..4095, unit=Unit_MilliVolt, transfer-property=PENDING  # Einzelzellspannung zur Uebertragung per RTM
          signal BMC_CMC_Zellspannung_084_XIX_BMC_CMC_Zellspannung_03_XIX_HCP5_CANFD01: start 72, 12 bit, little-endian, data-type-policy=OVERRIDE, i-signal-type=PRIMITIVE, init-value=4094, base-type=BT_BMC_CMC_Zellspannung_084, invalid-value=Invalid_BMC_CMC_Zellspannung_084_XIX_BMC_CMC_Zellspannung_03_XIX_HCP5_CANFD01:4095, compu {phys=raw+1000 for raw 0..4091, 4092=Cxffc_kleiner_1V (CM_BMC_CMC_Zellspannung_084_Cxffc_kleiner_1V), 4093=Cxffd_nicht_vorhanden (CM_BMC_CMC_Zellspannung_084_Cxffd_nicht_vorhanden), 4094=Cxffe_Init (CM_BMC_CMC_Zellspannung_084_Cxffe_Init), 4095=Cxfff_Fehler (CM_BMC_CMC_Zellspannung_084_Cxfff_Fehler); unit Unit_MilliVolt}, range phys 1000..5091 Unit_MilliVolt, raw 0..4095, unit=Unit_MilliVolt, transfer-property=PENDING  # Einzelzellspannung zur Uebertragung per RTM
          signal BMC_CMC_Zellspannung_085_XIX_BMC_CMC_Zellspannung_03_XIX_HCP5_CANFD01: start 84, 12 bit, little-endian, data-type-policy=OVERRIDE, i-signal-type=PRIMITIVE, init-value=4094, base-type=BT_BMC_CMC_Zellspannung_085, invalid-value=Invalid_BMC_CMC_Zellspannung_085_XIX_BMC_CMC_Zellspannung_03_XIX_HCP5_CANFD01:4095, compu {phys=raw+1000 for raw 0..4091, 4092=Cxffc_kleiner_1V (CM_BMC_CMC_Zellspannung_085_Cxffc_kleiner_1V), 4093=Cxffd_nicht_vorhanden (CM_BMC_CMC_Zellspannung_085_Cxffd_nicht_vorhanden), 4094=Cxffe_Init (CM_BMC_CMC_Zellspannung_085_Cxffe_Init), 4095=Cxfff_Fehler (CM_BMC_CMC_Zellspannung_085_Cxfff_Fehler); unit Unit_MilliVolt}, range phys 1000..5091 Unit_MilliVolt, raw 0..4095, unit=Unit_MilliVolt, transfer-property=PENDING  # Einzelzellspannung zur Uebertragung per RTM
          signal BMC_CMC_Zellspannung_086_XIX_BMC_CMC_Zellspannung_03_XIX_HCP5_CANFD01: start 96, 12 bit, little-endian, data-type-policy=OVERRIDE, i-signal-type=PRIMITIVE, init-value=4094, base-type=BT_BMC_CMC_Zellspannung_086, invalid-value=Invalid_BMC_CMC_Zellspannung_086_XIX_BMC_CMC_Zellspannung_03_XIX_HCP5_CANFD01:4095, compu {phys=raw+1000 for raw 0..4091, 4092=Cxffc_kleiner_1V (CM_BMC_CMC_Zellspannung_086_Cxffc_kleiner_1V), 4093=Cxffd_nicht_vorhanden (CM_BMC_CMC_Zellspannung_086_Cxffd_nicht_vorhanden), 4094=Cxffe_Init (CM_BMC_CMC_Zellspannung_086_Cxffe_Init), 4095=Cxfff_Fehler (CM_BMC_CMC_Zellspannung_086_Cxfff_Fehler); unit Unit_MilliVolt}, range phys 1000..5091 Unit_MilliVolt, raw 0..4095, unit=Unit_MilliVolt, transfer-property=PENDING  # Einzelzellspannung zur Uebertragung per RTM
          signal BMC_CMC_Zellspannung_087_XIX_BMC_CMC_Zellspannung_03_XIX_HCP5_CANFD01: start 108, 12 bit, little-endian, data-type-policy=OVERRIDE, i-signal-type=PRIMITIVE, init-value=4094, base-type=BT_BMC_CMC_Zellspannung_087, invalid-value=Invalid_BMC_CMC_Zellspannung_087_XIX_BMC_CMC_Zellspannung_03_XIX_HCP5_CANFD01:4095, compu {phys=raw+1000 for raw 0..4091, 4092=Cxffc_kleiner_1V (CM_BMC_CMC_Zellspannung_087_Cxffc_kleiner_1V), 4093=Cxffd_nicht_vorhanden (CM_BMC_CMC_Zellspannung_087_Cxffd_nicht_vorhanden), 4094=Cxffe_Init (CM_BMC_CMC_Zellspannung_087_Cxffe_Init), 4095=Cxfff_Fehler (CM_BMC_CMC_Zellspannung_087_Cxfff_Fehler); unit Unit_MilliVolt}, range phys 1000..5091 Unit_MilliVolt, raw 0..4095, unit=Unit_MilliVolt, transfer-property=PENDING  # Einzelzellspannung zur Uebertragung per RTM
          signal BMC_CMC_Zellspannung_088_XIX_BMC_CMC_Zellspannung_03_XIX_HCP5_CANFD01: start 120, 12 bit, little-endian, data-type-policy=OVERRIDE, i-signal-type=PRIMITIVE, init-value=4094, base-type=BT_BMC_CMC_Zellspannung_088, invalid-value=Invalid_BMC_CMC_Zellspannung_088_XIX_BMC_CMC_Zellspannung_03_XIX_HCP5_CANFD01:4095, compu {phys=raw+1000 for raw 0..4091, 4092=Cxffc_kleiner_1V (CM_BMC_CMC_Zellspannung_088_Cxffc_kleiner_1V), 4093=Cxffd_nicht_vorhanden (CM_BMC_CMC_Zellspannung_088_Cxffd_nicht_vorhanden), 4094=Cxffe_Init (CM_BMC_CMC_Zellspannung_088_Cxffe_Init), 4095=Cxfff_Fehler (CM_BMC_CMC_Zellspannung_088_Cxfff_Fehler); unit Unit_MilliVolt}, range phys 1000..5091 Unit_MilliVolt, raw 0..4095, unit=Unit_MilliVolt, transfer-property=PENDING  # Einzelzellspannung zur Uebertragung per RTM
          signal BMC_CMC_Zellspannung_089_XIX_BMC_CMC_Zellspannung_03_XIX_HCP5_CANFD01: start 132, 12 bit, little-endian, data-type-policy=OVERRIDE, i-signal-type=PRIMITIVE, init-value=4094, base-type=BT_BMC_CMC_Zellspannung_089, invalid-value=Invalid_BMC_CMC_Zellspannung_089_XIX_BMC_CMC_Zellspannung_03_XIX_HCP5_CANFD01:4095, compu {phys=raw+1000 for raw 0..4091, 4092=Cxffc_kleiner_1V (CM_BMC_CMC_Zellspannung_089_Cxffc_kleiner_1V), 4093=Cxffd_nicht_vorhanden (CM_BMC_CMC_Zellspannung_089_Cxffd_nicht_vorhanden), 4094=Cxffe_Init (CM_BMC_CMC_Zellspannung_089_Cxffe_Init), 4095=Cxfff_Fehler (CM_BMC_CMC_Zellspannung_089_Cxfff_Fehler); unit Unit_MilliVolt}, range phys 1000..5091 Unit_MilliVolt, raw 0..4095, unit=Unit_MilliVolt, transfer-property=PENDING  # Einzelzellspannung zur Uebertragung per RTM
          signal BMC_CMC_Zellspannung_090_XIX_BMC_CMC_Zellspannung_03_XIX_HCP5_CANFD01: start 144, 12 bit, little-endian, data-type-policy=OVERRIDE, i-signal-type=PRIMITIVE, init-value=4094, base-type=BT_BMC_CMC_Zellspannung_090, invalid-value=Invalid_BMC_CMC_Zellspannung_090_XIX_BMC_CMC_Zellspannung_03_XIX_HCP5_CANFD01:4095, compu {phys=raw+1000 for raw 0..4091, 4092=Cxffc_kleiner_1V (CM_BMC_CMC_Zellspannung_090_Cxffc_kleiner_1V), 4093=Cxffd_nicht_vorhanden (CM_BMC_CMC_Zellspannung_090_Cxffd_nicht_vorhanden), 4094=Cxffe_Init (CM_BMC_CMC_Zellspannung_090_Cxffe_Init), 4095=Cxfff_Fehler (CM_BMC_CMC_Zellspannung_090_Cxfff_Fehler); unit Unit_MilliVolt}, range phys 1000..5091 Unit_MilliVolt, raw 0..4095, unit=Unit_MilliVolt, transfer-property=PENDING  # Einzelzellspannung zur Uebertragung per RTM
          signal BMC_CMC_Zellspannung_091_XIX_BMC_CMC_Zellspannung_03_XIX_HCP5_CANFD01: start 156, 12 bit, little-endian, data-type-policy=OVERRIDE, i-signal-type=PRIMITIVE, init-value=4094, base-type=BT_BMC_CMC_Zellspannung_091, invalid-value=Invalid_BMC_CMC_Zellspannung_091_XIX_BMC_CMC_Zellspannung_03_XIX_HCP5_CANFD01:4095, compu {phys=raw+1000 for raw 0..4091, 4092=Cxffc_kleiner_1V (CM_BMC_CMC_Zellspannung_091_Cxffc_kleiner_1V), 4093=Cxffd_nicht_vorhanden (CM_BMC_CMC_Zellspannung_091_Cxffd_nicht_vorhanden), 4094=Cxffe_Init (CM_BMC_CMC_Zellspannung_091_Cxffe_Init), 4095=Cxfff_Fehler (CM_BMC_CMC_Zellspannung_091_Cxfff_Fehler); unit Unit_MilliVolt}, range phys 1000..5091 Unit_MilliVolt, raw 0..4095, unit=Unit_MilliVolt, transfer-property=PENDING  # Einzelzellspannung zur Uebertragung per RTM
          signal BMC_CMC_Zellspannung_092_XIX_BMC_CMC_Zellspannung_03_XIX_HCP5_CANFD01: start 168, 12 bit, little-endian, data-type-policy=OVERRIDE, i-signal-type=PRIMITIVE, init-value=4094, base-type=BT_BMC_CMC_Zellspannung_092, invalid-value=Invalid_BMC_CMC_Zellspannung_092_XIX_BMC_CMC_Zellspannung_03_XIX_HCP5_CANFD01:4095, compu {phys=raw+1000 for raw 0..4091, 4092=Cxffc_kleiner_1V (CM_BMC_CMC_Zellspannung_092_Cxffc_kleiner_1V), 4093=Cxffd_nicht_vorhanden (CM_BMC_CMC_Zellspannung_092_Cxffd_nicht_vorhanden), 4094=Cxffe_Init (CM_BMC_CMC_Zellspannung_092_Cxffe_Init), 4095=Cxfff_Fehler (CM_BMC_CMC_Zellspannung_092_Cxfff_Fehler); unit Unit_MilliVolt}, range phys 1000..5091 Unit_MilliVolt, raw 0..4095, unit=Unit_MilliVolt, transfer-property=PENDING  # Einzelzellspannung zur Uebertragung per RTM
          signal BMC_CMC_Zellspannung_093_XIX_BMC_CMC_Zellspannung_03_XIX_HCP5_CANFD01: start 180, 12 bit, little-endian, data-type-policy=OVERRIDE, i-signal-type=PRIMITIVE, init-value=4094, base-type=BT_BMC_CMC_Zellspannung_093, invalid-value=Invalid_BMC_CMC_Zellspannung_093_XIX_BMC_CMC_Zellspannung_03_XIX_HCP5_CANFD01:4095, compu {phys=raw+1000 for raw 0..4091, 4092=Cxffc_kleiner_1V (CM_BMC_CMC_Zellspannung_093_Cxffc_kleiner_1V), 4093=Cxffd_nicht_vorhanden (CM_BMC_CMC_Zellspannung_093_Cxffd_nicht_vorhanden), 4094=Cxffe_Init (CM_BMC_CMC_Zellspannung_093_Cxffe_Init), 4095=Cxfff_Fehler (CM_BMC_CMC_Zellspannung_093_Cxfff_Fehler); unit Unit_MilliVolt}, range phys 1000..5091 Unit_MilliVolt, raw 0..4095, unit=Unit_MilliVolt, transfer-property=PENDING  # Einzelzellspannung zur Uebertragung per RTM
          signal BMC_CMC_Zellspannung_094_XIX_BMC_CMC_Zellspannung_03_XIX_HCP5_CANFD01: start 192, 12 bit, little-endian, data-type-policy=OVERRIDE, i-signal-type=PRIMITIVE, init-value=4094, base-type=BT_BMC_CMC_Zellspannung_094, invalid-value=Invalid_BMC_CMC_Zellspannung_094_XIX_BMC_CMC_Zellspannung_03_XIX_HCP5_CANFD01:4095, compu {phys=raw+1000 for raw 0..4091, 4092=Cxffc_kleiner_1V (CM_BMC_CMC_Zellspannung_094_Cxffc_kleiner_1V), 4093=Cxffd_nicht_vorhanden (CM_BMC_CMC_Zellspannung_094_Cxffd_nicht_vorhanden), 4094=Cxffe_Init (CM_BMC_CMC_Zellspannung_094_Cxffe_Init), 4095=Cxfff_Fehler (CM_BMC_CMC_Zellspannung_094_Cxfff_Fehler); unit Unit_MilliVolt}, range phys 1000..5091 Unit_MilliVolt, raw 0..4095, unit=Unit_MilliVolt, transfer-property=PENDING  # Einzelzellspannung zur Uebertragung per RTM
          signal BMC_CMC_Zellspannung_095_XIX_BMC_CMC_Zellspannung_03_XIX_HCP5_CANFD01: start 204, 12 bit, little-endian, data-type-policy=OVERRIDE, i-signal-type=PRIMITIVE, init-value=4094, base-type=BT_BMC_CMC_Zellspannung_095, invalid-value=Invalid_BMC_CMC_Zellspannung_095_XIX_BMC_CMC_Zellspannung_03_XIX_HCP5_CANFD01:4095, compu {phys=raw+1000 for raw 0..4091, 4092=Cxffc_kleiner_1V (CM_BMC_CMC_Zellspannung_095_Cxffc_kleiner_1V), 4093=Cxffd_nicht_vorhanden (CM_BMC_CMC_Zellspannung_095_Cxffd_nicht_vorhanden), 4094=Cxffe_Init (CM_BMC_CMC_Zellspannung_095_Cxffe_Init), 4095=Cxfff_Fehler (CM_BMC_CMC_Zellspannung_095_Cxfff_Fehler); unit Unit_MilliVolt}, range phys 1000..5091 Unit_MilliVolt, raw 0..4095, unit=Unit_MilliVolt, transfer-property=PENDING  # Einzelzellspannung zur Uebertragung per RTM
          signal BMC_CMC_Zellspannung_096_XIX_BMC_CMC_Zellspannung_03_XIX_HCP5_CANFD01: start 216, 12 bit, little-endian, data-type-policy=OVERRIDE, i-signal-type=PRIMITIVE, init-value=4094, base-type=BT_BMC_CMC_Zellspannung_096, invalid-value=Invalid_BMC_CMC_Zellspannung_096_XIX_BMC_CMC_Zellspannung_03_XIX_HCP5_CANFD01:4095, compu {phys=raw+1000 for raw 0..4091, 4092=Cxffc_kleiner_1V (CM_BMC_CMC_Zellspannung_096_Cxffc_kleiner_1V), 4093=Cxffd_nicht_vorhanden (CM_BMC_CMC_Zellspannung_096_Cxffd_nicht_vorhanden), 4094=Cxffe_Init (CM_BMC_CMC_Zellspannung_096_Cxffe_Init), 4095=Cxfff_Fehler (CM_BMC_CMC_Zellspannung_096_Cxfff_Fehler); unit Unit_MilliVolt}, range phys 1000..5091 Unit_MilliVolt, raw 0..4095, unit=Unit_MilliVolt, transfer-property=PENDING  # Einzelzellspannung zur Uebertragung per RTM
          signal BMC_CMC_Zellspannung_097_XIX_BMC_CMC_Zellspannung_03_XIX_HCP5_CANFD01: start 228, 12 bit, little-endian, data-type-policy=OVERRIDE, i-signal-type=PRIMITIVE, init-value=4094, base-type=BT_BMC_CMC_Zellspannung_097, invalid-value=Invalid_BMC_CMC_Zellspannung_097_XIX_BMC_CMC_Zellspannung_03_XIX_HCP5_CANFD01:4095, compu {phys=raw+1000 for raw 0..4091, 4092=Cxffc_kleiner_1V (CM_BMC_CMC_Zellspannung_097_Cxffc_kleiner_1V), 4093=Cxffd_nicht_vorhanden (CM_BMC_CMC_Zellspannung_097_Cxffd_nicht_vorhanden), 4094=Cxffe_Init (CM_BMC_CMC_Zellspannung_097_Cxffe_Init), 4095=Cxfff_Fehler (CM_BMC_CMC_Zellspannung_097_Cxfff_Fehler); unit Unit_MilliVolt}, range phys 1000..5091 Unit_MilliVolt, raw 0..4095, unit=Unit_MilliVolt, transfer-property=PENDING  # Einzelzellspannung zur Uebertragung per RTM
          signal BMC_CMC_Zellspannung_098_XIX_BMC_CMC_Zellspannung_03_XIX_HCP5_CANFD01: start 240, 12 bit, little-endian, data-type-policy=OVERRIDE, i-signal-type=PRIMITIVE, init-value=4094, base-type=BT_BMC_CMC_Zellspannung_098, invalid-value=Invalid_BMC_CMC_Zellspannung_098_XIX_BMC_CMC_Zellspannung_03_XIX_HCP5_CANFD01:4095, compu {phys=raw+1000 for raw 0..4091, 4092=Cxffc_kleiner_1V (CM_BMC_CMC_Zellspannung_098_Cxffc_kleiner_1V), 4093=Cxffd_nicht_vorhanden (CM_BMC_CMC_Zellspannung_098_Cxffd_nicht_vorhanden), 4094=Cxffe_Init (CM_BMC_CMC_Zellspannung_098_Cxffe_Init), 4095=Cxfff_Fehler (CM_BMC_CMC_Zellspannung_098_Cxfff_Fehler); unit Unit_MilliVolt}, range phys 1000..5091 Unit_MilliVolt, raw 0..4095, unit=Unit_MilliVolt, transfer-property=PENDING  # Einzelzellspannung zur Uebertragung per RTM
          signal BMC_CMC_Zellspannung_099_XIX_BMC_CMC_Zellspannung_03_XIX_HCP5_CANFD01: start 252, 12 bit, little-endian, data-type-policy=OVERRIDE, i-signal-type=PRIMITIVE, init-value=4094, base-type=BT_BMC_CMC_Zellspannung_099, invalid-value=Invalid_BMC_CMC_Zellspannung_099_XIX_BMC_CMC_Zellspannung_03_XIX_HCP5_CANFD01:4095, compu {phys=raw+1000 for raw 0..4091, 4092=Cxffc_kleiner_1V (CM_BMC_CMC_Zellspannung_099_Cxffc_kleiner_1V), 4093=Cxffd_nicht_vorhanden (CM_BMC_CMC_Zellspannung_099_Cxffd_nicht_vorhanden), 4094=Cxffe_Init (CM_BMC_CMC_Zellspannung_099_Cxffe_Init), 4095=Cxfff_Fehler (CM_BMC_CMC_Zellspannung_099_Cxfff_Fehler); unit Unit_MilliVolt}, range phys 1000..5091 Unit_MilliVolt, raw 0..4095, unit=Unit_MilliVolt, transfer-property=PENDING  # Einzelzellspannung zur Uebertragung per RTM
          signal BMC_CMC_Zellspannung_100_XIX_BMC_CMC_Zellspannung_03_XIX_HCP5_CANFD01: start 264, 12 bit, little-endian, data-type-policy=OVERRIDE, i-signal-type=PRIMITIVE, init-value=4094, base-type=BT_BMC_CMC_Zellspannung_100, invalid-value=Invalid_BMC_CMC_Zellspannung_100_XIX_BMC_CMC_Zellspannung_03_XIX_HCP5_CANFD01:4095, compu {phys=raw+1000 for raw 0..4091, 4092=Cxffc_kleiner_1V (CM_BMC_CMC_Zellspannung_100_Cxffc_kleiner_1V), 4093=Cxffd_nicht_vorhanden (CM_BMC_CMC_Zellspannung_100_Cxffd_nicht_vorhanden), 4094=Cxffe_Init (CM_BMC_CMC_Zellspannung_100_Cxffe_Init), 4095=Cxfff_Fehler (CM_BMC_CMC_Zellspannung_100_Cxfff_Fehler); unit Unit_MilliVolt}, range phys 1000..5091 Unit_MilliVolt, raw 0..4095, unit=Unit_MilliVolt, transfer-property=PENDING  # Einzelzellspannung zur Uebertragung per RTM
          signal BMC_CMC_Zellspannung_101_XIX_BMC_CMC_Zellspannung_03_XIX_HCP5_CANFD01: start 276, 12 bit, little-endian, data-type-policy=OVERRIDE, i-signal-type=PRIMITIVE, init-value=4094, base-type=BT_BMC_CMC_Zellspannung_101, invalid-value=Invalid_BMC_CMC_Zellspannung_101_XIX_BMC_CMC_Zellspannung_03_XIX_HCP5_CANFD01:4095, compu {phys=raw+1000 for raw 0..4091, 4092=Cxffc_kleiner_1V (CM_BMC_CMC_Zellspannung_101_Cxffc_kleiner_1V), 4093=Cxffd_nicht_vorhanden (CM_BMC_CMC_Zellspannung_101_Cxffd_nicht_vorhanden), 4094=Cxffe_Init (CM_BMC_CMC_Zellspannung_101_Cxffe_Init), 4095=Cxfff_Fehler (CM_BMC_CMC_Zellspannung_101_Cxfff_Fehler); unit Unit_MilliVolt}, range phys 1000..5091 Unit_MilliVolt, raw 0..4095, unit=Unit_MilliVolt, transfer-property=PENDING  # Einzelzellspannung zur Uebertragung per RTM
          signal BMC_CMC_Zellspannung_102_XIX_BMC_CMC_Zellspannung_03_XIX_HCP5_CANFD01: start 288, 12 bit, little-endian, data-type-policy=OVERRIDE, i-signal-type=PRIMITIVE, init-value=4094, base-type=BT_BMC_CMC_Zellspannung_102, invalid-value=Invalid_BMC_CMC_Zellspannung_102_XIX_BMC_CMC_Zellspannung_03_XIX_HCP5_CANFD01:4095, compu {phys=raw+1000 for raw 0..4091, 4092=Cxffc_kleiner_1V (CM_BMC_CMC_Zellspannung_102_Cxffc_kleiner_1V), 4093=Cxffd_nicht_vorhanden (CM_BMC_CMC_Zellspannung_102_Cxffd_nicht_vorhanden), 4094=Cxffe_Init (CM_BMC_CMC_Zellspannung_102_Cxffe_Init), 4095=Cxfff_Fehler (CM_BMC_CMC_Zellspannung_102_Cxfff_Fehler); unit Unit_MilliVolt}, range phys 1000..5091 Unit_MilliVolt, raw 0..4095, unit=Unit_MilliVolt, transfer-property=PENDING  # Einzelzellspannung zur Uebertragung per RTM
          signal BMC_CMC_Zellspannung_103_XIX_BMC_CMC_Zellspannung_03_XIX_HCP5_CANFD01: start 300, 12 bit, little-endian, data-type-policy=OVERRIDE, i-signal-type=PRIMITIVE, init-value=4094, base-type=BT_BMC_CMC_Zellspannung_103, invalid-value=Invalid_BMC_CMC_Zellspannung_103_XIX_BMC_CMC_Zellspannung_03_XIX_HCP5_CANFD01:4095, compu {phys=raw+1000 for raw 0..4091, 4092=Cxffc_kleiner_1V (CM_BMC_CMC_Zellspannung_103_Cxffc_kleiner_1V), 4093=Cxffd_nicht_vorhanden (CM_BMC_CMC_Zellspannung_103_Cxffd_nicht_vorhanden), 4094=Cxffe_Init (CM_BMC_CMC_Zellspannung_103_Cxffe_Init), 4095=Cxfff_Fehler (CM_BMC_CMC_Zellspannung_103_Cxfff_Fehler); unit Unit_MilliVolt}, range phys 1000..5091 Unit_MilliVolt, raw 0..4095, unit=Unit_MilliVolt, transfer-property=PENDING  # Einzelzellspannung zur Uebertragung per RTM
          signal BMC_CMC_Zellspannung_104_XIX_BMC_CMC_Zellspannung_03_XIX_HCP5_CANFD01: start 312, 12 bit, little-endian, data-type-policy=OVERRIDE, i-signal-type=PRIMITIVE, init-value=4094, base-type=BT_BMC_CMC_Zellspannung_104, invalid-value=Invalid_BMC_CMC_Zellspannung_104_XIX_BMC_CMC_Zellspannung_03_XIX_HCP5_CANFD01:4095, compu {phys=raw+1000 for raw 0..4091, 4092=Cxffc_kleiner_1V (CM_BMC_CMC_Zellspannung_104_Cxffc_kleiner_1V), 4093=Cxffd_nicht_vorhanden (CM_BMC_CMC_Zellspannung_104_Cxffd_nicht_vorhanden), 4094=Cxffe_Init (CM_BMC_CMC_Zellspannung_104_Cxffe_Init), 4095=Cxfff_Fehler (CM_BMC_CMC_Zellspannung_104_Cxfff_Fehler); unit Unit_MilliVolt}, range phys 1000..5091 Unit_MilliVolt, raw 0..4095, unit=Unit_MilliVolt, transfer-property=PENDING  # Einzelzellspannung zur Uebertragung per RTM
          signal BMC_CMC_Zellspannung_105_XIX_BMC_CMC_Zellspannung_03_XIX_HCP5_CANFD01: start 324, 12 bit, little-endian, data-type-policy=OVERRIDE, i-signal-type=PRIMITIVE, init-value=4094, base-type=BT_BMC_CMC_Zellspannung_105, invalid-value=Invalid_BMC_CMC_Zellspannung_105_XIX_BMC_CMC_Zellspannung_03_XIX_HCP5_CANFD01:4095, compu {phys=raw+1000 for raw 0..4091, 4092=Cxffc_kleiner_1V (CM_BMC_CMC_Zellspannung_105_Cxffc_kleiner_1V), 4093=Cxffd_nicht_vorhanden (CM_BMC_CMC_Zellspannung_105_Cxffd_nicht_vorhanden), 4094=Cxffe_Init (CM_BMC_CMC_Zellspannung_105_Cxffe_Init), 4095=Cxfff_Fehler (CM_BMC_CMC_Zellspannung_105_Cxfff_Fehler); unit Unit_MilliVolt}, range phys 1000..5091 Unit_MilliVolt, raw 0..4095, unit=Unit_MilliVolt, transfer-property=PENDING  # Einzelzellspannung zur Uebertragung per RTM
          signal BMC_CMC_Zellspannung_106_XIX_BMC_CMC_Zellspannung_03_XIX_HCP5_CANFD01: start 336, 12 bit, little-endian, data-type-policy=OVERRIDE, i-signal-type=PRIMITIVE, init-value=4094, base-type=BT_BMC_CMC_Zellspannung_106, invalid-value=Invalid_BMC_CMC_Zellspannung_106_XIX_BMC_CMC_Zellspannung_03_XIX_HCP5_CANFD01:4095, compu {phys=raw+1000 for raw 0..4091, 4092=Cxffc_kleiner_1V (CM_BMC_CMC_Zellspannung_106_Cxffc_kleiner_1V), 4093=Cxffd_nicht_vorhanden (CM_BMC_CMC_Zellspannung_106_Cxffd_nicht_vorhanden), 4094=Cxffe_Init (CM_BMC_CMC_Zellspannung_106_Cxffe_Init), 4095=Cxfff_Fehler (CM_BMC_CMC_Zellspannung_106_Cxfff_Fehler); unit Unit_MilliVolt}, range phys 1000..5091 Unit_MilliVolt, raw 0..4095, unit=Unit_MilliVolt, transfer-property=PENDING  # Einzelzellspannung zur Uebertragung per RTM
          signal BMC_CMC_Zellspannung_107_XIX_BMC_CMC_Zellspannung_03_XIX_HCP5_CANFD01: start 348, 12 bit, little-endian, data-type-policy=OVERRIDE, i-signal-type=PRIMITIVE, init-value=4094, base-type=BT_BMC_CMC_Zellspannung_107, invalid-value=Invalid_BMC_CMC_Zellspannung_107_XIX_BMC_CMC_Zellspannung_03_XIX_HCP5_CANFD01:4095, compu {phys=raw+1000 for raw 0..4091, 4092=Cxffc_kleiner_1V (CM_BMC_CMC_Zellspannung_107_Cxffc_kleiner_1V), 4093=Cxffd_nicht_vorhanden (CM_BMC_CMC_Zellspannung_107_Cxffd_nicht_vorhanden), 4094=Cxffe_Init (CM_BMC_CMC_Zellspannung_107_Cxffe_Init), 4095=Cxfff_Fehler (CM_BMC_CMC_Zellspannung_107_Cxfff_Fehler); unit Unit_MilliVolt}, range phys 1000..5091 Unit_MilliVolt, raw 0..4095, unit=Unit_MilliVolt, transfer-property=PENDING  # Einzelzellspannung zur Uebertragung per RTM
          signal BMC_CMC_Zellspannung_108_XIX_BMC_CMC_Zellspannung_03_XIX_HCP5_CANFD01: start 360, 12 bit, little-endian, data-type-policy=OVERRIDE, i-signal-type=PRIMITIVE, init-value=4094, base-type=BT_BMC_CMC_Zellspannung_108, invalid-value=Invalid_BMC_CMC_Zellspannung_108_XIX_BMC_CMC_Zellspannung_03_XIX_HCP5_CANFD01:4095, compu {phys=raw+1000 for raw 0..4091, 4092=Cxffc_kleiner_1V (CM_BMC_CMC_Zellspannung_108_Cxffc_kleiner_1V), 4093=Cxffd_nicht_vorhanden (CM_BMC_CMC_Zellspannung_108_Cxffd_nicht_vorhanden), 4094=Cxffe_Init (CM_BMC_CMC_Zellspannung_108_Cxffe_Init), 4095=Cxfff_Fehler (CM_BMC_CMC_Zellspannung_108_Cxfff_Fehler); unit Unit_MilliVolt}, range phys 1000..5091 Unit_MilliVolt, raw 0..4095, unit=Unit_MilliVolt, transfer-property=PENDING  # Einzelzellspannung zur Uebertragung per RTM
          signal BMC_CMC_Zellspannung_109_XIX_BMC_CMC_Zellspannung_03_XIX_HCP5_CANFD01: start 372, 12 bit, little-endian, data-type-policy=OVERRIDE, i-signal-type=PRIMITIVE, init-value=4094, base-type=BT_BMC_CMC_Zellspannung_109, invalid-value=Invalid_BMC_CMC_Zellspannung_109_XIX_BMC_CMC_Zellspannung_03_XIX_HCP5_CANFD01:4095, compu {phys=raw+1000 for raw 0..4091, 4092=Cxffc_kleiner_1V (CM_BMC_CMC_Zellspannung_109_Cxffc_kleiner_1V), 4093=Cxffd_nicht_vorhanden (CM_BMC_CMC_Zellspannung_109_Cxffd_nicht_vorhanden), 4094=Cxffe_Init (CM_BMC_CMC_Zellspannung_109_Cxffe_Init), 4095=Cxfff_Fehler (CM_BMC_CMC_Zellspannung_109_Cxfff_Fehler); unit Unit_MilliVolt}, range phys 1000..5091 Unit_MilliVolt, raw 0..4095, unit=Unit_MilliVolt, transfer-property=PENDING  # Einzelzellspannung zur Uebertragung per RTM
          signal BMC_CMC_Zellspannung_110_XIX_BMC_CMC_Zellspannung_03_XIX_HCP5_CANFD01: start 384, 12 bit, little-endian, data-type-policy=OVERRIDE, i-signal-type=PRIMITIVE, init-value=4094, base-type=BT_BMC_CMC_Zellspannung_110, invalid-value=Invalid_BMC_CMC_Zellspannung_110_XIX_BMC_CMC_Zellspannung_03_XIX_HCP5_CANFD01:4095, compu {phys=raw+1000 for raw 0..4091, 4092=Cxffc_kleiner_1V (CM_BMC_CMC_Zellspannung_110_Cxffc_kleiner_1V), 4093=Cxffd_nicht_vorhanden (CM_BMC_CMC_Zellspannung_110_Cxffd_nicht_vorhanden), 4094=Cxffe_Init (CM_BMC_CMC_Zellspannung_110_Cxffe_Init), 4095=Cxfff_Fehler (CM_BMC_CMC_Zellspannung_110_Cxfff_Fehler); unit Unit_MilliVolt}, range phys 1000..5091 Unit_MilliVolt, raw 0..4095, unit=Unit_MilliVolt, transfer-property=PENDING  # Einzelzellspannung zur Uebertragung per RTM
          signal BMC_CMC_Zellspannung_111_XIX_BMC_CMC_Zellspannung_03_XIX_HCP5_CANFD01: start 396, 12 bit, little-endian, data-type-policy=OVERRIDE, i-signal-type=PRIMITIVE, init-value=4094, base-type=BT_BMC_CMC_Zellspannung_111, invalid-value=Invalid_BMC_CMC_Zellspannung_111_XIX_BMC_CMC_Zellspannung_03_XIX_HCP5_CANFD01:4095, compu {phys=raw+1000 for raw 0..4091, 4092=Cxffc_kleiner_1V (CM_BMC_CMC_Zellspannung_111_Cxffc_kleiner_1V), 4093=Cxffd_nicht_vorhanden (CM_BMC_CMC_Zellspannung_111_Cxffd_nicht_vorhanden), 4094=Cxffe_Init (CM_BMC_CMC_Zellspannung_111_Cxffe_Init), 4095=Cxfff_Fehler (CM_BMC_CMC_Zellspannung_111_Cxfff_Fehler); unit Unit_MilliVolt}, range phys 1000..5091 Unit_MilliVolt, raw 0..4095, unit=Unit_MilliVolt, transfer-property=PENDING  # Einzelzellspannung zur Uebertragung per RTM
          signal BMC_CMC_Zellspannung_112_XIX_BMC_CMC_Zellspannung_03_XIX_HCP5_CANFD01: start 408, 12 bit, little-endian, data-type-policy=OVERRIDE, i-signal-type=PRIMITIVE, init-value=4094, base-type=BT_BMC_CMC_Zellspannung_112, invalid-value=Invalid_BMC_CMC_Zellspannung_112_XIX_BMC_CMC_Zellspannung_03_XIX_HCP5_CANFD01:4095, compu {phys=raw+1000 for raw 0..4091, 4092=Cxffc_kleiner_1V (CM_BMC_CMC_Zellspannung_112_Cxffc_kleiner_1V), 4093=Cxffd_nicht_vorhanden (CM_BMC_CMC_Zellspannung_112_Cxffd_nicht_vorhanden), 4094=Cxffe_Init (CM_BMC_CMC_Zellspannung_112_Cxffe_Init), 4095=Cxfff_Fehler (CM_BMC_CMC_Zellspannung_112_Cxfff_Fehler); unit Unit_MilliVolt}, range phys 1000..5091 Unit_MilliVolt, raw 0..4095, unit=Unit_MilliVolt, transfer-property=PENDING  # Einzelzellspannung zur Uebertragung per RTM
          signal BMC_CMC_Zellspannung_113_XIX_BMC_CMC_Zellspannung_03_XIX_HCP5_CANFD01: start 420, 12 bit, little-endian, data-type-policy=OVERRIDE, i-signal-type=PRIMITIVE, init-value=4094, base-type=BT_BMC_CMC_Zellspannung_113, invalid-value=Invalid_BMC_CMC_Zellspannung_113_XIX_BMC_CMC_Zellspannung_03_XIX_HCP5_CANFD01:4095, compu {phys=raw+1000 for raw 0..4091, 4092=Cxffc_kleiner_1V (CM_BMC_CMC_Zellspannung_113_Cxffc_kleiner_1V), 4093=Cxffd_nicht_vorhanden (CM_BMC_CMC_Zellspannung_113_Cxffd_nicht_vorhanden), 4094=Cxffe_Init (CM_BMC_CMC_Zellspannung_113_Cxffe_Init), 4095=Cxfff_Fehler (CM_BMC_CMC_Zellspannung_113_Cxfff_Fehler); unit Unit_MilliVolt}, range phys 1000..5091 Unit_MilliVolt, raw 0..4095, unit=Unit_MilliVolt, transfer-property=PENDING  # Einzelzellspannung zur Uebertragung per RTM
          signal BMC_CMC_Zellspannung_114_XIX_BMC_CMC_Zellspannung_03_XIX_HCP5_CANFD01: start 432, 12 bit, little-endian, data-type-policy=OVERRIDE, i-signal-type=PRIMITIVE, init-value=4094, base-type=BT_BMC_CMC_Zellspannung_114, invalid-value=Invalid_BMC_CMC_Zellspannung_114_XIX_BMC_CMC_Zellspannung_03_XIX_HCP5_CANFD01:4095, compu {phys=raw+1000 for raw 0..4091, 4092=Cxffc_kleiner_1V (CM_BMC_CMC_Zellspannung_114_Cxffc_kleiner_1V), 4093=Cxffd_nicht_vorhanden (CM_BMC_CMC_Zellspannung_114_Cxffd_nicht_vorhanden), 4094=Cxffe_Init (CM_BMC_CMC_Zellspannung_114_Cxffe_Init), 4095=Cxfff_Fehler (CM_BMC_CMC_Zellspannung_114_Cxfff_Fehler); unit Unit_MilliVolt}, range phys 1000..5091 Unit_MilliVolt, raw 0..4095, unit=Unit_MilliVolt, transfer-property=PENDING  # Einzelzellspannung zur Uebertragung per RTM
          signal BMC_CMC_Zellspannung_115_XIX_BMC_CMC_Zellspannung_03_XIX_HCP5_CANFD01: start 444, 12 bit, little-endian, data-type-policy=OVERRIDE, i-signal-type=PRIMITIVE, init-value=4094, base-type=BT_BMC_CMC_Zellspannung_115, invalid-value=Invalid_BMC_CMC_Zellspannung_115_XIX_BMC_CMC_Zellspannung_03_XIX_HCP5_CANFD01:4095, compu {phys=raw+1000 for raw 0..4091, 4092=Cxffc_kleiner_1V (CM_BMC_CMC_Zellspannung_115_Cxffc_kleiner_1V), 4093=Cxffd_nicht_vorhanden (CM_BMC_CMC_Zellspannung_115_Cxffd_nicht_vorhanden), 4094=Cxffe_Init (CM_BMC_CMC_Zellspannung_115_Cxffe_Init), 4095=Cxfff_Fehler (CM_BMC_CMC_Zellspannung_115_Cxfff_Fehler); unit Unit_MilliVolt}, range phys 1000..5091 Unit_MilliVolt, raw 0..4095, unit=Unit_MilliVolt, transfer-property=PENDING  # Einzelzellspannung zur Uebertragung per RTM
          signal BMC_CMC_Zellspannung_116_XIX_BMC_CMC_Zellspannung_03_XIX_HCP5_CANFD01: start 456, 12 bit, little-endian, data-type-policy=OVERRIDE, i-signal-type=PRIMITIVE, init-value=4094, base-type=BT_BMC_CMC_Zellspannung_116, invalid-value=Invalid_BMC_CMC_Zellspannung_116_XIX_BMC_CMC_Zellspannung_03_XIX_HCP5_CANFD01:4095, compu {phys=raw+1000 for raw 0..4091, 4092=Cxffc_kleiner_1V (CM_BMC_CMC_Zellspannung_116_Cxffc_kleiner_1V), 4093=Cxffd_nicht_vorhanden (CM_BMC_CMC_Zellspannung_116_Cxffd_nicht_vorhanden), 4094=Cxffe_Init (CM_BMC_CMC_Zellspannung_116_Cxffe_Init), 4095=Cxfff_Fehler (CM_BMC_CMC_Zellspannung_116_Cxfff_Fehler); unit Unit_MilliVolt}, range phys 1000..5091 Unit_MilliVolt, raw 0..4095, unit=Unit_MilliVolt, transfer-property=PENDING  # Einzelzellspannung zur Uebertragung per RTM
          signal BMC_CMC_Zellspannung_117_XIX_BMC_CMC_Zellspannung_03_XIX_HCP5_CANFD01: start 468, 12 bit, little-endian, data-type-policy=OVERRIDE, i-signal-type=PRIMITIVE, init-value=4094, base-type=BT_BMC_CMC_Zellspannung_117, invalid-value=Invalid_BMC_CMC_Zellspannung_117_XIX_BMC_CMC_Zellspannung_03_XIX_HCP5_CANFD01:4095, compu {phys=raw+1000 for raw 0..4091, 4092=Cxffc_kleiner_1V (CM_BMC_CMC_Zellspannung_117_Cxffc_kleiner_1V), 4093=Cxffd_nicht_vorhanden (CM_BMC_CMC_Zellspannung_117_Cxffd_nicht_vorhanden), 4094=Cxffe_Init (CM_BMC_CMC_Zellspannung_117_Cxffe_Init), 4095=Cxfff_Fehler (CM_BMC_CMC_Zellspannung_117_Cxfff_Fehler); unit Unit_MilliVolt}, range phys 1000..5091 Unit_MilliVolt, raw 0..4095, unit=Unit_MilliVolt, transfer-property=PENDING  # Einzelzellspannung zur Uebertragung per RTM
          signal BMC_CMC_Zellspannung_03_Messzeit_XIX_BMC_CMC_Zellspannung_03_XIX_HCP5_CANFD01: start 480, 8 bit, little-endian, data-type-policy=OVERRIDE, i-signal-type=PRIMITIVE, init-value=254, base-type=BT_BMC_CMC_Zellspannung_03_Messzeit, invalid-value=Invalid_BMC_CMC_Zellspannung_03_Messzeit_XIX_BMC_CMC_Zellspannung_03_XIX_HCP5_CANFD01:255, compu {phys=raw for raw 0..253, 254=Cxfe_Init (CM_BMC_CMC_Zellspannung_03_Messzeit_Cxfe_Init), 255=Cxff_Fehler (CM_BMC_CMC_Zellspannung_03_Messzeit_Cxff_Fehler); unit Unit_None}, range phys 0..253 Unit_None, raw 0..255, unit=Unit_None, transfer-property=PENDING  # Messzeit zu Botschaft BMC_CMC_Zellspannung_03
      frame BMC_CMC_Zellspannung_04_XIX_HCP5_CANFD01: id 0x1A55562F, from BMC_HV, frame-length=64, can-addressing-mode=EXTENDED, can-frame-rx-behavior=CAN-FD, can-frame-tx-behavior=CAN-FD
        pdu BMC_CMC_Zellspannung_04_XIX_HCP5_CANFD01: length=64, transmission-mode-true-timing=cyclic-timing={time-offset=0, time-period=1}, unused-bit-pattern=0
          signal BMC_CMC_Zellspannung_118_XIX_BMC_CMC_Zellspannung_04_XIX_HCP5_CANFD01: start 12, 12 bit, little-endian, data-type-policy=OVERRIDE, i-signal-type=PRIMITIVE, init-value=4094, base-type=BT_BMC_CMC_Zellspannung_118, invalid-value=Invalid_BMC_CMC_Zellspannung_118_XIX_BMC_CMC_Zellspannung_04_XIX_HCP5_CANFD01:4095, compu {phys=raw+1000 for raw 0..4091, 4092=Cxffc_kleiner_1V (CM_BMC_CMC_Zellspannung_118_Cxffc_kleiner_1V), 4093=Cxffd_nicht_vorhanden (CM_BMC_CMC_Zellspannung_118_Cxffd_nicht_vorhanden), 4094=Cxffe_Init (CM_BMC_CMC_Zellspannung_118_Cxffe_Init), 4095=Cxfff_Fehler (CM_BMC_CMC_Zellspannung_118_Cxfff_Fehler); unit Unit_MilliVolt}, range phys 1000..5091 Unit_MilliVolt, raw 0..4095, unit=Unit_MilliVolt, transfer-property=PENDING  # Einzelzellspannung zur Uebertragung per RTM
          signal BMC_CMC_Zellspannung_119_XIX_BMC_CMC_Zellspannung_04_XIX_HCP5_CANFD01: start 24, 12 bit, little-endian, data-type-policy=OVERRIDE, i-signal-type=PRIMITIVE, init-value=4094, base-type=BT_BMC_CMC_Zellspannung_119, invalid-value=Invalid_BMC_CMC_Zellspannung_119_XIX_BMC_CMC_Zellspannung_04_XIX_HCP5_CANFD01:4095, compu {phys=raw+1000 for raw 0..4091, 4092=Cxffc_kleiner_1V (CM_BMC_CMC_Zellspannung_119_Cxffc_kleiner_1V), 4093=Cxffd_nicht_vorhanden (CM_BMC_CMC_Zellspannung_119_Cxffd_nicht_vorhanden), 4094=Cxffe_Init (CM_BMC_CMC_Zellspannung_119_Cxffe_Init), 4095=Cxfff_Fehler (CM_BMC_CMC_Zellspannung_119_Cxfff_Fehler); unit Unit_MilliVolt}, range phys 1000..5091 Unit_MilliVolt, raw 0..4095, unit=Unit_MilliVolt, transfer-property=PENDING  # Einzelzellspannung zur Uebertragung per RTM
          signal BMC_CMC_Zellspannung_120_XIX_BMC_CMC_Zellspannung_04_XIX_HCP5_CANFD01: start 36, 12 bit, little-endian, data-type-policy=OVERRIDE, i-signal-type=PRIMITIVE, init-value=4094, base-type=BT_BMC_CMC_Zellspannung_120, invalid-value=Invalid_BMC_CMC_Zellspannung_120_XIX_BMC_CMC_Zellspannung_04_XIX_HCP5_CANFD01:4095, compu {phys=raw+1000 for raw 0..4091, 4092=Cxffc_kleiner_1V (CM_BMC_CMC_Zellspannung_120_Cxffc_kleiner_1V), 4093=Cxffd_nicht_vorhanden (CM_BMC_CMC_Zellspannung_120_Cxffd_nicht_vorhanden), 4094=Cxffe_Init (CM_BMC_CMC_Zellspannung_120_Cxffe_Init), 4095=Cxfff_Fehler (CM_BMC_CMC_Zellspannung_120_Cxfff_Fehler); unit Unit_MilliVolt}, range phys 1000..5091 Unit_MilliVolt, raw 0..4095, unit=Unit_MilliVolt, transfer-property=PENDING  # Einzelzellspannung zur Uebertragung per RTM
          signal BMC_CMC_Zellspannung_121_XIX_BMC_CMC_Zellspannung_04_XIX_HCP5_CANFD01: start 48, 12 bit, little-endian, data-type-policy=OVERRIDE, i-signal-type=PRIMITIVE, init-value=4094, base-type=BT_BMC_CMC_Zellspannung_121, invalid-value=Invalid_BMC_CMC_Zellspannung_121_XIX_BMC_CMC_Zellspannung_04_XIX_HCP5_CANFD01:4095, compu {phys=raw+1000 for raw 0..4091, 4092=Cxffc_kleiner_1V (CM_BMC_CMC_Zellspannung_121_Cxffc_kleiner_1V), 4093=Cxffd_nicht_vorhanden (CM_BMC_CMC_Zellspannung_121_Cxffd_nicht_vorhanden), 4094=Cxffe_Init (CM_BMC_CMC_Zellspannung_121_Cxffe_Init), 4095=Cxfff_Fehler (CM_BMC_CMC_Zellspannung_121_Cxfff_Fehler); unit Unit_MilliVolt}, range phys 1000..5091 Unit_MilliVolt, raw 0..4095, unit=Unit_MilliVolt, transfer-property=PENDING  # Einzelzellspannung zur Uebertragung per RTM
          signal BMC_CMC_Zellspannung_122_XIX_BMC_CMC_Zellspannung_04_XIX_HCP5_CANFD01: start 60, 12 bit, little-endian, data-type-policy=OVERRIDE, i-signal-type=PRIMITIVE, init-value=4094, base-type=BT_BMC_CMC_Zellspannung_122, invalid-value=Invalid_BMC_CMC_Zellspannung_122_XIX_BMC_CMC_Zellspannung_04_XIX_HCP5_CANFD01:4095, compu {phys=raw+1000 for raw 0..4091, 4092=Cxffc_kleiner_1V (CM_BMC_CMC_Zellspannung_122_Cxffc_kleiner_1V), 4093=Cxffd_nicht_vorhanden (CM_BMC_CMC_Zellspannung_122_Cxffd_nicht_vorhanden), 4094=Cxffe_Init (CM_BMC_CMC_Zellspannung_122_Cxffe_Init), 4095=Cxfff_Fehler (CM_BMC_CMC_Zellspannung_122_Cxfff_Fehler); unit Unit_MilliVolt}, range phys 1000..5091 Unit_MilliVolt, raw 0..4095, unit=Unit_MilliVolt, transfer-property=PENDING  # Einzelzellspannung zur Uebertragung per RTM
          signal BMC_CMC_Zellspannung_123_XIX_BMC_CMC_Zellspannung_04_XIX_HCP5_CANFD01: start 72, 12 bit, little-endian, data-type-policy=OVERRIDE, i-signal-type=PRIMITIVE, init-value=4094, base-type=BT_BMC_CMC_Zellspannung_123, invalid-value=Invalid_BMC_CMC_Zellspannung_123_XIX_BMC_CMC_Zellspannung_04_XIX_HCP5_CANFD01:4095, compu {phys=raw+1000 for raw 0..4091, 4092=Cxffc_kleiner_1V (CM_BMC_CMC_Zellspannung_123_Cxffc_kleiner_1V), 4093=Cxffd_nicht_vorhanden (CM_BMC_CMC_Zellspannung_123_Cxffd_nicht_vorhanden), 4094=Cxffe_Init (CM_BMC_CMC_Zellspannung_123_Cxffe_Init), 4095=Cxfff_Fehler (CM_BMC_CMC_Zellspannung_123_Cxfff_Fehler); unit Unit_MilliVolt}, range phys 1000..5091 Unit_MilliVolt, raw 0..4095, unit=Unit_MilliVolt, transfer-property=PENDING  # Einzelzellspannung zur Uebertragung per RTM
          signal BMC_CMC_Zellspannung_124_XIX_BMC_CMC_Zellspannung_04_XIX_HCP5_CANFD01: start 84, 12 bit, little-endian, data-type-policy=OVERRIDE, i-signal-type=PRIMITIVE, init-value=4094, base-type=BT_BMC_CMC_Zellspannung_124, invalid-value=Invalid_BMC_CMC_Zellspannung_124_XIX_BMC_CMC_Zellspannung_04_XIX_HCP5_CANFD01:4095, compu {phys=raw+1000 for raw 0..4091, 4092=Cxffc_kleiner_1V (CM_BMC_CMC_Zellspannung_124_Cxffc_kleiner_1V), 4093=Cxffd_nicht_vorhanden (CM_BMC_CMC_Zellspannung_124_Cxffd_nicht_vorhanden), 4094=Cxffe_Init (CM_BMC_CMC_Zellspannung_124_Cxffe_Init), 4095=Cxfff_Fehler (CM_BMC_CMC_Zellspannung_124_Cxfff_Fehler); unit Unit_MilliVolt}, range phys 1000..5091 Unit_MilliVolt, raw 0..4095, unit=Unit_MilliVolt, transfer-property=PENDING  # Einzelzellspannung zur Uebertragung per RTM
          signal BMC_CMC_Zellspannung_125_XIX_BMC_CMC_Zellspannung_04_XIX_HCP5_CANFD01: start 96, 12 bit, little-endian, data-type-policy=OVERRIDE, i-signal-type=PRIMITIVE, init-value=4094, base-type=BT_BMC_CMC_Zellspannung_125, invalid-value=Invalid_BMC_CMC_Zellspannung_125_XIX_BMC_CMC_Zellspannung_04_XIX_HCP5_CANFD01:4095, compu {phys=raw+1000 for raw 0..4091, 4092=Cxffc_kleiner_1V (CM_BMC_CMC_Zellspannung_125_Cxffc_kleiner_1V), 4093=Cxffd_nicht_vorhanden (CM_BMC_CMC_Zellspannung_125_Cxffd_nicht_vorhanden), 4094=Cxffe_Init (CM_BMC_CMC_Zellspannung_125_Cxffe_Init), 4095=Cxfff_Fehler (CM_BMC_CMC_Zellspannung_125_Cxfff_Fehler); unit Unit_MilliVolt}, range phys 1000..5091 Unit_MilliVolt, raw 0..4095, unit=Unit_MilliVolt, transfer-property=PENDING  # Einzelzellspannung zur Uebertragung per RTM
          signal BMC_CMC_Zellspannung_126_XIX_BMC_CMC_Zellspannung_04_XIX_HCP5_CANFD01: start 108, 12 bit, little-endian, data-type-policy=OVERRIDE, i-signal-type=PRIMITIVE, init-value=4094, base-type=BT_BMC_CMC_Zellspannung_126, invalid-value=Invalid_BMC_CMC_Zellspannung_126_XIX_BMC_CMC_Zellspannung_04_XIX_HCP5_CANFD01:4095, compu {phys=raw+1000 for raw 0..4091, 4092=Cxffc_kleiner_1V (CM_BMC_CMC_Zellspannung_126_Cxffc_kleiner_1V), 4093=Cxffd_nicht_vorhanden (CM_BMC_CMC_Zellspannung_126_Cxffd_nicht_vorhanden), 4094=Cxffe_Init (CM_BMC_CMC_Zellspannung_126_Cxffe_Init), 4095=Cxfff_Fehler (CM_BMC_CMC_Zellspannung_126_Cxfff_Fehler); unit Unit_MilliVolt}, range phys 1000..5091 Unit_MilliVolt, raw 0..4095, unit=Unit_MilliVolt, transfer-property=PENDING  # Einzelzellspannung zur Uebertragung per RTM
          signal BMC_CMC_Zellspannung_127_XIX_BMC_CMC_Zellspannung_04_XIX_HCP5_CANFD01: start 120, 12 bit, little-endian, data-type-policy=OVERRIDE, i-signal-type=PRIMITIVE, init-value=4094, base-type=BT_BMC_CMC_Zellspannung_127, invalid-value=Invalid_BMC_CMC_Zellspannung_127_XIX_BMC_CMC_Zellspannung_04_XIX_HCP5_CANFD01:4095, compu {phys=raw+1000 for raw 0..4091, 4092=Cxffc_kleiner_1V (CM_BMC_CMC_Zellspannung_127_Cxffc_kleiner_1V), 4093=Cxffd_nicht_vorhanden (CM_BMC_CMC_Zellspannung_127_Cxffd_nicht_vorhanden), 4094=Cxffe_Init (CM_BMC_CMC_Zellspannung_127_Cxffe_Init), 4095=Cxfff_Fehler (CM_BMC_CMC_Zellspannung_127_Cxfff_Fehler); unit Unit_MilliVolt}, range phys 1000..5091 Unit_MilliVolt, raw 0..4095, unit=Unit_MilliVolt, transfer-property=PENDING  # Einzelzellspannung zur Uebertragung per RTM
          signal BMC_CMC_Zellspannung_128_XIX_BMC_CMC_Zellspannung_04_XIX_HCP5_CANFD01: start 132, 12 bit, little-endian, data-type-policy=OVERRIDE, i-signal-type=PRIMITIVE, init-value=4094, base-type=BT_BMC_CMC_Zellspannung_128, invalid-value=Invalid_BMC_CMC_Zellspannung_128_XIX_BMC_CMC_Zellspannung_04_XIX_HCP5_CANFD01:4095, compu {phys=raw+1000 for raw 0..4091, 4092=Cxffc_kleiner_1V (CM_BMC_CMC_Zellspannung_128_Cxffc_kleiner_1V), 4093=Cxffd_nicht_vorhanden (CM_BMC_CMC_Zellspannung_128_Cxffd_nicht_vorhanden), 4094=Cxffe_Init (CM_BMC_CMC_Zellspannung_128_Cxffe_Init), 4095=Cxfff_Fehler (CM_BMC_CMC_Zellspannung_128_Cxfff_Fehler); unit Unit_MilliVolt}, range phys 1000..5091 Unit_MilliVolt, raw 0..4095, unit=Unit_MilliVolt, transfer-property=PENDING  # Einzelzellspannung zur Uebertragung per RTM
          signal BMC_CMC_Zellspannung_129_XIX_BMC_CMC_Zellspannung_04_XIX_HCP5_CANFD01: start 144, 12 bit, little-endian, data-type-policy=OVERRIDE, i-signal-type=PRIMITIVE, init-value=4094, base-type=BT_BMC_CMC_Zellspannung_129, invalid-value=Invalid_BMC_CMC_Zellspannung_129_XIX_BMC_CMC_Zellspannung_04_XIX_HCP5_CANFD01:4095, compu {phys=raw+1000 for raw 0..4091, 4092=Cxffc_kleiner_1V (CM_BMC_CMC_Zellspannung_129_Cxffc_kleiner_1V), 4093=Cxffd_nicht_vorhanden (CM_BMC_CMC_Zellspannung_129_Cxffd_nicht_vorhanden), 4094=Cxffe_Init (CM_BMC_CMC_Zellspannung_129_Cxffe_Init), 4095=Cxfff_Fehler (CM_BMC_CMC_Zellspannung_129_Cxfff_Fehler); unit Unit_MilliVolt}, range phys 1000..5091 Unit_MilliVolt, raw 0..4095, unit=Unit_MilliVolt, transfer-property=PENDING  # Einzelzellspannung zur Uebertragung per RTM
          signal BMC_CMC_Zellspannung_130_XIX_BMC_CMC_Zellspannung_04_XIX_HCP5_CANFD01: start 156, 12 bit, little-endian, data-type-policy=OVERRIDE, i-signal-type=PRIMITIVE, init-value=4094, base-type=BT_BMC_CMC_Zellspannung_130, invalid-value=Invalid_BMC_CMC_Zellspannung_130_XIX_BMC_CMC_Zellspannung_04_XIX_HCP5_CANFD01:4095, compu {phys=raw+1000 for raw 0..4091, 4092=Cxffc_kleiner_1V (CM_BMC_CMC_Zellspannung_130_Cxffc_kleiner_1V), 4093=Cxffd_nicht_vorhanden (CM_BMC_CMC_Zellspannung_130_Cxffd_nicht_vorhanden), 4094=Cxffe_Init (CM_BMC_CMC_Zellspannung_130_Cxffe_Init), 4095=Cxfff_Fehler (CM_BMC_CMC_Zellspannung_130_Cxfff_Fehler); unit Unit_MilliVolt}, range phys 1000..5091 Unit_MilliVolt, raw 0..4095, unit=Unit_MilliVolt, transfer-property=PENDING  # Einzelzellspannung zur Uebertragung per RTM
          signal BMC_CMC_Zellspannung_131_XIX_BMC_CMC_Zellspannung_04_XIX_HCP5_CANFD01: start 168, 12 bit, little-endian, data-type-policy=OVERRIDE, i-signal-type=PRIMITIVE, init-value=4094, base-type=BT_BMC_CMC_Zellspannung_131, invalid-value=Invalid_BMC_CMC_Zellspannung_131_XIX_BMC_CMC_Zellspannung_04_XIX_HCP5_CANFD01:4095, compu {phys=raw+1000 for raw 0..4091, 4092=Cxffc_kleiner_1V (CM_BMC_CMC_Zellspannung_131_Cxffc_kleiner_1V), 4093=Cxffd_nicht_vorhanden (CM_BMC_CMC_Zellspannung_131_Cxffd_nicht_vorhanden), 4094=Cxffe_Init (CM_BMC_CMC_Zellspannung_131_Cxffe_Init), 4095=Cxfff_Fehler (CM_BMC_CMC_Zellspannung_131_Cxfff_Fehler); unit Unit_MilliVolt}, range phys 1000..5091 Unit_MilliVolt, raw 0..4095, unit=Unit_MilliVolt, transfer-property=PENDING  # Einzelzellspannung zur Uebertragung per RTM
          signal BMC_CMC_Zellspannung_132_XIX_BMC_CMC_Zellspannung_04_XIX_HCP5_CANFD01: start 180, 12 bit, little-endian, data-type-policy=OVERRIDE, i-signal-type=PRIMITIVE, init-value=4094, base-type=BT_BMC_CMC_Zellspannung_132, invalid-value=Invalid_BMC_CMC_Zellspannung_132_XIX_BMC_CMC_Zellspannung_04_XIX_HCP5_CANFD01:4095, compu {phys=raw+1000 for raw 0..4091, 4092=Cxffc_kleiner_1V (CM_BMC_CMC_Zellspannung_132_Cxffc_kleiner_1V), 4093=Cxffd_nicht_vorhanden (CM_BMC_CMC_Zellspannung_132_Cxffd_nicht_vorhanden), 4094=Cxffe_Init (CM_BMC_CMC_Zellspannung_132_Cxffe_Init), 4095=Cxfff_Fehler (CM_BMC_CMC_Zellspannung_132_Cxfff_Fehler); unit Unit_MilliVolt}, range phys 1000..5091 Unit_MilliVolt, raw 0..4095, unit=Unit_MilliVolt, transfer-property=PENDING  # Einzelzellspannung zur Uebertragung per RTM
          signal BMC_CMC_Zellspannung_133_XIX_BMC_CMC_Zellspannung_04_XIX_HCP5_CANFD01: start 192, 12 bit, little-endian, data-type-policy=OVERRIDE, i-signal-type=PRIMITIVE, init-value=4094, base-type=BT_BMC_CMC_Zellspannung_133, invalid-value=Invalid_BMC_CMC_Zellspannung_133_XIX_BMC_CMC_Zellspannung_04_XIX_HCP5_CANFD01:4095, compu {phys=raw+1000 for raw 0..4091, 4092=Cxffc_kleiner_1V (CM_BMC_CMC_Zellspannung_133_Cxffc_kleiner_1V), 4093=Cxffd_nicht_vorhanden (CM_BMC_CMC_Zellspannung_133_Cxffd_nicht_vorhanden), 4094=Cxffe_Init (CM_BMC_CMC_Zellspannung_133_Cxffe_Init), 4095=Cxfff_Fehler (CM_BMC_CMC_Zellspannung_133_Cxfff_Fehler); unit Unit_MilliVolt}, range phys 1000..5091 Unit_MilliVolt, raw 0..4095, unit=Unit_MilliVolt, transfer-property=PENDING  # Einzelzellspannung zur Uebertragung per RTM
          signal BMC_CMC_Zellspannung_134_XIX_BMC_CMC_Zellspannung_04_XIX_HCP5_CANFD01: start 204, 12 bit, little-endian, data-type-policy=OVERRIDE, i-signal-type=PRIMITIVE, init-value=4094, base-type=BT_BMC_CMC_Zellspannung_134, invalid-value=Invalid_BMC_CMC_Zellspannung_134_XIX_BMC_CMC_Zellspannung_04_XIX_HCP5_CANFD01:4095, compu {phys=raw+1000 for raw 0..4091, 4092=Cxffc_kleiner_1V (CM_BMC_CMC_Zellspannung_134_Cxffc_kleiner_1V), 4093=Cxffd_nicht_vorhanden (CM_BMC_CMC_Zellspannung_134_Cxffd_nicht_vorhanden), 4094=Cxffe_Init (CM_BMC_CMC_Zellspannung_134_Cxffe_Init), 4095=Cxfff_Fehler (CM_BMC_CMC_Zellspannung_134_Cxfff_Fehler); unit Unit_MilliVolt}, range phys 1000..5091 Unit_MilliVolt, raw 0..4095, unit=Unit_MilliVolt, transfer-property=PENDING  # Einzelzellspannung zur Uebertragung per RTM
          signal BMC_CMC_Zellspannung_135_XIX_BMC_CMC_Zellspannung_04_XIX_HCP5_CANFD01: start 216, 12 bit, little-endian, data-type-policy=OVERRIDE, i-signal-type=PRIMITIVE, init-value=4094, base-type=BT_BMC_CMC_Zellspannung_135, invalid-value=Invalid_BMC_CMC_Zellspannung_135_XIX_BMC_CMC_Zellspannung_04_XIX_HCP5_CANFD01:4095, compu {phys=raw+1000 for raw 0..4091, 4092=Cxffc_kleiner_1V (CM_BMC_CMC_Zellspannung_135_Cxffc_kleiner_1V), 4093=Cxffd_nicht_vorhanden (CM_BMC_CMC_Zellspannung_135_Cxffd_nicht_vorhanden), 4094=Cxffe_Init (CM_BMC_CMC_Zellspannung_135_Cxffe_Init), 4095=Cxfff_Fehler (CM_BMC_CMC_Zellspannung_135_Cxfff_Fehler); unit Unit_MilliVolt}, range phys 1000..5091 Unit_MilliVolt, raw 0..4095, unit=Unit_MilliVolt, transfer-property=PENDING  # Einzelzellspannung zur Uebertragung per RTM
          signal BMC_CMC_Zellspannung_136_XIX_BMC_CMC_Zellspannung_04_XIX_HCP5_CANFD01: start 228, 12 bit, little-endian, data-type-policy=OVERRIDE, i-signal-type=PRIMITIVE, init-value=4094, base-type=BT_BMC_CMC_Zellspannung_136, invalid-value=Invalid_BMC_CMC_Zellspannung_136_XIX_BMC_CMC_Zellspannung_04_XIX_HCP5_CANFD01:4095, compu {phys=raw+1000 for raw 0..4091, 4092=Cxffc_kleiner_1V (CM_BMC_CMC_Zellspannung_136_Cxffc_kleiner_1V), 4093=Cxffd_nicht_vorhanden (CM_BMC_CMC_Zellspannung_136_Cxffd_nicht_vorhanden), 4094=Cxffe_Init (CM_BMC_CMC_Zellspannung_136_Cxffe_Init), 4095=Cxfff_Fehler (CM_BMC_CMC_Zellspannung_136_Cxfff_Fehler); unit Unit_MilliVolt}, range phys 1000..5091 Unit_MilliVolt, raw 0..4095, unit=Unit_MilliVolt, transfer-property=PENDING  # Einzelzellspannung zur Uebertragung per RTM
          signal BMC_CMC_Zellspannung_137_XIX_BMC_CMC_Zellspannung_04_XIX_HCP5_CANFD01: start 240, 12 bit, little-endian, data-type-policy=OVERRIDE, i-signal-type=PRIMITIVE, init-value=4094, base-type=BT_BMC_CMC_Zellspannung_137, invalid-value=Invalid_BMC_CMC_Zellspannung_137_XIX_BMC_CMC_Zellspannung_04_XIX_HCP5_CANFD01:4095, compu {phys=raw+1000 for raw 0..4091, 4092=Cxffc_kleiner_1V (CM_BMC_CMC_Zellspannung_137_Cxffc_kleiner_1V), 4093=Cxffd_nicht_vorhanden (CM_BMC_CMC_Zellspannung_137_Cxffd_nicht_vorhanden), 4094=Cxffe_Init (CM_BMC_CMC_Zellspannung_137_Cxffe_Init), 4095=Cxfff_Fehler (CM_BMC_CMC_Zellspannung_137_Cxfff_Fehler); unit Unit_MilliVolt}, range phys 1000..5091 Unit_MilliVolt, raw 0..4095, unit=Unit_MilliVolt, transfer-property=PENDING  # Einzelzellspannung zur Uebertragung per RTM
          signal BMC_CMC_Zellspannung_138_XIX_BMC_CMC_Zellspannung_04_XIX_HCP5_CANFD01: start 252, 12 bit, little-endian, data-type-policy=OVERRIDE, i-signal-type=PRIMITIVE, init-value=4094, base-type=BT_BMC_CMC_Zellspannung_138, invalid-value=Invalid_BMC_CMC_Zellspannung_138_XIX_BMC_CMC_Zellspannung_04_XIX_HCP5_CANFD01:4095, compu {phys=raw+1000 for raw 0..4091, 4092=Cxffc_kleiner_1V (CM_BMC_CMC_Zellspannung_138_Cxffc_kleiner_1V), 4093=Cxffd_nicht_vorhanden (CM_BMC_CMC_Zellspannung_138_Cxffd_nicht_vorhanden), 4094=Cxffe_Init (CM_BMC_CMC_Zellspannung_138_Cxffe_Init), 4095=Cxfff_Fehler (CM_BMC_CMC_Zellspannung_138_Cxfff_Fehler); unit Unit_MilliVolt}, range phys 1000..5091 Unit_MilliVolt, raw 0..4095, unit=Unit_MilliVolt, transfer-property=PENDING  # Einzelzellspannung zur Uebertragung per RTM
          signal BMC_CMC_Zellspannung_139_XIX_BMC_CMC_Zellspannung_04_XIX_HCP5_CANFD01: start 264, 12 bit, little-endian, data-type-policy=OVERRIDE, i-signal-type=PRIMITIVE, init-value=4094, base-type=BT_BMC_CMC_Zellspannung_139, invalid-value=Invalid_BMC_CMC_Zellspannung_139_XIX_BMC_CMC_Zellspannung_04_XIX_HCP5_CANFD01:4095, compu {phys=raw+1000 for raw 0..4091, 4092=Cxffc_kleiner_1V (CM_BMC_CMC_Zellspannung_139_Cxffc_kleiner_1V), 4093=Cxffd_nicht_vorhanden (CM_BMC_CMC_Zellspannung_139_Cxffd_nicht_vorhanden), 4094=Cxffe_Init (CM_BMC_CMC_Zellspannung_139_Cxffe_Init), 4095=Cxfff_Fehler (CM_BMC_CMC_Zellspannung_139_Cxfff_Fehler); unit Unit_MilliVolt}, range phys 1000..5091 Unit_MilliVolt, raw 0..4095, unit=Unit_MilliVolt, transfer-property=PENDING  # Einzelzellspannung zur Uebertragung per RTM
          signal BMC_CMC_Zellspannung_140_XIX_BMC_CMC_Zellspannung_04_XIX_HCP5_CANFD01: start 276, 12 bit, little-endian, data-type-policy=OVERRIDE, i-signal-type=PRIMITIVE, init-value=4094, base-type=BT_BMC_CMC_Zellspannung_140, invalid-value=Invalid_BMC_CMC_Zellspannung_140_XIX_BMC_CMC_Zellspannung_04_XIX_HCP5_CANFD01:4095, compu {phys=raw+1000 for raw 0..4091, 4092=Cxffc_kleiner_1V (CM_BMC_CMC_Zellspannung_140_Cxffc_kleiner_1V), 4093=Cxffd_nicht_vorhanden (CM_BMC_CMC_Zellspannung_140_Cxffd_nicht_vorhanden), 4094=Cxffe_Init (CM_BMC_CMC_Zellspannung_140_Cxffe_Init), 4095=Cxfff_Fehler (CM_BMC_CMC_Zellspannung_140_Cxfff_Fehler); unit Unit_MilliVolt}, range phys 1000..5091 Unit_MilliVolt, raw 0..4095, unit=Unit_MilliVolt, transfer-property=PENDING  # Einzelzellspannung zur Uebertragung per RTM
          signal BMC_CMC_Zellspannung_141_XIX_BMC_CMC_Zellspannung_04_XIX_HCP5_CANFD01: start 288, 12 bit, little-endian, data-type-policy=OVERRIDE, i-signal-type=PRIMITIVE, init-value=4094, base-type=BT_BMC_CMC_Zellspannung_141, invalid-value=Invalid_BMC_CMC_Zellspannung_141_XIX_BMC_CMC_Zellspannung_04_XIX_HCP5_CANFD01:4095, compu {phys=raw+1000 for raw 0..4091, 4092=Cxffc_kleiner_1V (CM_BMC_CMC_Zellspannung_141_Cxffc_kleiner_1V), 4093=Cxffd_nicht_vorhanden (CM_BMC_CMC_Zellspannung_141_Cxffd_nicht_vorhanden), 4094=Cxffe_Init (CM_BMC_CMC_Zellspannung_141_Cxffe_Init), 4095=Cxfff_Fehler (CM_BMC_CMC_Zellspannung_141_Cxfff_Fehler); unit Unit_MilliVolt}, range phys 1000..5091 Unit_MilliVolt, raw 0..4095, unit=Unit_MilliVolt, transfer-property=PENDING  # Einzelzellspannung zur Uebertragung per RTM
          signal BMC_CMC_Zellspannung_142_XIX_BMC_CMC_Zellspannung_04_XIX_HCP5_CANFD01: start 300, 12 bit, little-endian, data-type-policy=OVERRIDE, i-signal-type=PRIMITIVE, init-value=4094, base-type=BT_BMC_CMC_Zellspannung_142, invalid-value=Invalid_BMC_CMC_Zellspannung_142_XIX_BMC_CMC_Zellspannung_04_XIX_HCP5_CANFD01:4095, compu {phys=raw+1000 for raw 0..4091, 4092=Cxffc_kleiner_1V (CM_BMC_CMC_Zellspannung_142_Cxffc_kleiner_1V), 4093=Cxffd_nicht_vorhanden (CM_BMC_CMC_Zellspannung_142_Cxffd_nicht_vorhanden), 4094=Cxffe_Init (CM_BMC_CMC_Zellspannung_142_Cxffe_Init), 4095=Cxfff_Fehler (CM_BMC_CMC_Zellspannung_142_Cxfff_Fehler); unit Unit_MilliVolt}, range phys 1000..5091 Unit_MilliVolt, raw 0..4095, unit=Unit_MilliVolt, transfer-property=PENDING  # Einzelzellspannung zur Uebertragung per RTM
          signal BMC_CMC_Zellspannung_143_XIX_BMC_CMC_Zellspannung_04_XIX_HCP5_CANFD01: start 312, 12 bit, little-endian, data-type-policy=OVERRIDE, i-signal-type=PRIMITIVE, init-value=4094, base-type=BT_BMC_CMC_Zellspannung_143, invalid-value=Invalid_BMC_CMC_Zellspannung_143_XIX_BMC_CMC_Zellspannung_04_XIX_HCP5_CANFD01:4095, compu {phys=raw+1000 for raw 0..4091, 4092=Cxffc_kleiner_1V (CM_BMC_CMC_Zellspannung_143_Cxffc_kleiner_1V), 4093=Cxffd_nicht_vorhanden (CM_BMC_CMC_Zellspannung_143_Cxffd_nicht_vorhanden), 4094=Cxffe_Init (CM_BMC_CMC_Zellspannung_143_Cxffe_Init), 4095=Cxfff_Fehler (CM_BMC_CMC_Zellspannung_143_Cxfff_Fehler); unit Unit_MilliVolt}, range phys 1000..5091 Unit_MilliVolt, raw 0..4095, unit=Unit_MilliVolt, transfer-property=PENDING  # Einzelzellspannung zur Uebertragung per RTM
          signal BMC_CMC_Zellspannung_144_XIX_BMC_CMC_Zellspannung_04_XIX_HCP5_CANFD01: start 324, 12 bit, little-endian, data-type-policy=OVERRIDE, i-signal-type=PRIMITIVE, init-value=4094, base-type=BT_BMC_CMC_Zellspannung_144, invalid-value=Invalid_BMC_CMC_Zellspannung_144_XIX_BMC_CMC_Zellspannung_04_XIX_HCP5_CANFD01:4095, compu {phys=raw+1000 for raw 0..4091, 4092=Cxffc_kleiner_1V (CM_BMC_CMC_Zellspannung_144_Cxffc_kleiner_1V), 4093=Cxffd_nicht_vorhanden (CM_BMC_CMC_Zellspannung_144_Cxffd_nicht_vorhanden), 4094=Cxffe_Init (CM_BMC_CMC_Zellspannung_144_Cxffe_Init), 4095=Cxfff_Fehler (CM_BMC_CMC_Zellspannung_144_Cxfff_Fehler); unit Unit_MilliVolt}, range phys 1000..5091 Unit_MilliVolt, raw 0..4095, unit=Unit_MilliVolt, transfer-property=PENDING  # Einzelzellspannung zur Uebertragung per RTM
          signal BMC_CMC_Zellspannung_145_XIX_BMC_CMC_Zellspannung_04_XIX_HCP5_CANFD01: start 336, 12 bit, little-endian, data-type-policy=OVERRIDE, i-signal-type=PRIMITIVE, init-value=4094, base-type=BT_BMC_CMC_Zellspannung_145, invalid-value=Invalid_BMC_CMC_Zellspannung_145_XIX_BMC_CMC_Zellspannung_04_XIX_HCP5_CANFD01:4095, compu {phys=raw+1000 for raw 0..4091, 4092=Cxffc_kleiner_1V (CM_BMC_CMC_Zellspannung_145_Cxffc_kleiner_1V), 4093=Cxffd_nicht_vorhanden (CM_BMC_CMC_Zellspannung_145_Cxffd_nicht_vorhanden), 4094=Cxffe_Init (CM_BMC_CMC_Zellspannung_145_Cxffe_Init), 4095=Cxfff_Fehler (CM_BMC_CMC_Zellspannung_145_Cxfff_Fehler); unit Unit_MilliVolt}, range phys 1000..5091 Unit_MilliVolt, raw 0..4095, unit=Unit_MilliVolt, transfer-property=PENDING  # Einzelzellspannung zur Uebertragung per RTM
          signal BMC_CMC_Zellspannung_146_XIX_BMC_CMC_Zellspannung_04_XIX_HCP5_CANFD01: start 348, 12 bit, little-endian, data-type-policy=OVERRIDE, i-signal-type=PRIMITIVE, init-value=4094, base-type=BT_BMC_CMC_Zellspannung_146, invalid-value=Invalid_BMC_CMC_Zellspannung_146_XIX_BMC_CMC_Zellspannung_04_XIX_HCP5_CANFD01:4095, compu {phys=raw+1000 for raw 0..4091, 4092=Cxffc_kleiner_1V (CM_BMC_CMC_Zellspannung_146_Cxffc_kleiner_1V), 4093=Cxffd_nicht_vorhanden (CM_BMC_CMC_Zellspannung_146_Cxffd_nicht_vorhanden), 4094=Cxffe_Init (CM_BMC_CMC_Zellspannung_146_Cxffe_Init), 4095=Cxfff_Fehler (CM_BMC_CMC_Zellspannung_146_Cxfff_Fehler); unit Unit_MilliVolt}, range phys 1000..5091 Unit_MilliVolt, raw 0..4095, unit=Unit_MilliVolt, transfer-property=PENDING  # Einzelzellspannung zur Uebertragung per RTM
          signal BMC_CMC_Zellspannung_147_XIX_BMC_CMC_Zellspannung_04_XIX_HCP5_CANFD01: start 360, 12 bit, little-endian, data-type-policy=OVERRIDE, i-signal-type=PRIMITIVE, init-value=4094, base-type=BT_BMC_CMC_Zellspannung_147, invalid-value=Invalid_BMC_CMC_Zellspannung_147_XIX_BMC_CMC_Zellspannung_04_XIX_HCP5_CANFD01:4095, compu {phys=raw+1000 for raw 0..4091, 4092=Cxffc_kleiner_1V (CM_BMC_CMC_Zellspannung_147_Cxffc_kleiner_1V), 4093=Cxffd_nicht_vorhanden (CM_BMC_CMC_Zellspannung_147_Cxffd_nicht_vorhanden), 4094=Cxffe_Init (CM_BMC_CMC_Zellspannung_147_Cxffe_Init), 4095=Cxfff_Fehler (CM_BMC_CMC_Zellspannung_147_Cxfff_Fehler); unit Unit_MilliVolt}, range phys 1000..5091 Unit_MilliVolt, raw 0..4095, unit=Unit_MilliVolt, transfer-property=PENDING  # Einzelzellspannung zur Uebertragung per RTM
          signal BMC_CMC_Zellspannung_148_XIX_BMC_CMC_Zellspannung_04_XIX_HCP5_CANFD01: start 372, 12 bit, little-endian, data-type-policy=OVERRIDE, i-signal-type=PRIMITIVE, init-value=4094, base-type=BT_BMC_CMC_Zellspannung_148, invalid-value=Invalid_BMC_CMC_Zellspannung_148_XIX_BMC_CMC_Zellspannung_04_XIX_HCP5_CANFD01:4095, compu {phys=raw+1000 for raw 0..4091, 4092=Cxffc_kleiner_1V (CM_BMC_CMC_Zellspannung_148_Cxffc_kleiner_1V), 4093=Cxffd_nicht_vorhanden (CM_BMC_CMC_Zellspannung_148_Cxffd_nicht_vorhanden), 4094=Cxffe_Init (CM_BMC_CMC_Zellspannung_148_Cxffe_Init), 4095=Cxfff_Fehler (CM_BMC_CMC_Zellspannung_148_Cxfff_Fehler); unit Unit_MilliVolt}, range phys 1000..5091 Unit_MilliVolt, raw 0..4095, unit=Unit_MilliVolt, transfer-property=PENDING  # Einzelzellspannung zur Uebertragung per RTM
          signal BMC_CMC_Zellspannung_149_XIX_BMC_CMC_Zellspannung_04_XIX_HCP5_CANFD01: start 384, 12 bit, little-endian, data-type-policy=OVERRIDE, i-signal-type=PRIMITIVE, init-value=4094, base-type=BT_BMC_CMC_Zellspannung_149, invalid-value=Invalid_BMC_CMC_Zellspannung_149_XIX_BMC_CMC_Zellspannung_04_XIX_HCP5_CANFD01:4095, compu {phys=raw+1000 for raw 0..4091, 4092=Cxffc_kleiner_1V (CM_BMC_CMC_Zellspannung_149_Cxffc_kleiner_1V), 4093=Cxffd_nicht_vorhanden (CM_BMC_CMC_Zellspannung_149_Cxffd_nicht_vorhanden), 4094=Cxffe_Init (CM_BMC_CMC_Zellspannung_149_Cxffe_Init), 4095=Cxfff_Fehler (CM_BMC_CMC_Zellspannung_149_Cxfff_Fehler); unit Unit_MilliVolt}, range phys 1000..5091 Unit_MilliVolt, raw 0..4095, unit=Unit_MilliVolt, transfer-property=PENDING  # Einzelzellspannung zur Uebertragung per RTM
          signal BMC_CMC_Zellspannung_150_XIX_BMC_CMC_Zellspannung_04_XIX_HCP5_CANFD01: start 396, 12 bit, little-endian, data-type-policy=OVERRIDE, i-signal-type=PRIMITIVE, init-value=4094, base-type=BT_BMC_CMC_Zellspannung_150, invalid-value=Invalid_BMC_CMC_Zellspannung_150_XIX_BMC_CMC_Zellspannung_04_XIX_HCP5_CANFD01:4095, compu {phys=raw+1000 for raw 0..4091, 4092=Cxffc_kleiner_1V (CM_BMC_CMC_Zellspannung_150_Cxffc_kleiner_1V), 4093=Cxffd_nicht_vorhanden (CM_BMC_CMC_Zellspannung_150_Cxffd_nicht_vorhanden), 4094=Cxffe_Init (CM_BMC_CMC_Zellspannung_150_Cxffe_Init), 4095=Cxfff_Fehler (CM_BMC_CMC_Zellspannung_150_Cxfff_Fehler); unit Unit_MilliVolt}, range phys 1000..5091 Unit_MilliVolt, raw 0..4095, unit=Unit_MilliVolt, transfer-property=PENDING  # Einzelzellspannung zur Uebertragung per RTM
          signal BMC_CMC_Zellspannung_151_XIX_BMC_CMC_Zellspannung_04_XIX_HCP5_CANFD01: start 408, 12 bit, little-endian, data-type-policy=OVERRIDE, i-signal-type=PRIMITIVE, init-value=4094, base-type=BT_BMC_CMC_Zellspannung_151, invalid-value=Invalid_BMC_CMC_Zellspannung_151_XIX_BMC_CMC_Zellspannung_04_XIX_HCP5_CANFD01:4095, compu {phys=raw+1000 for raw 0..4091, 4092=Cxffc_kleiner_1V (CM_BMC_CMC_Zellspannung_151_Cxffc_kleiner_1V), 4093=Cxffd_nicht_vorhanden (CM_BMC_CMC_Zellspannung_151_Cxffd_nicht_vorhanden), 4094=Cxffe_Init (CM_BMC_CMC_Zellspannung_151_Cxffe_Init), 4095=Cxfff_Fehler (CM_BMC_CMC_Zellspannung_151_Cxfff_Fehler); unit Unit_MilliVolt}, range phys 1000..5091 Unit_MilliVolt, raw 0..4095, unit=Unit_MilliVolt, transfer-property=PENDING  # Einzelzellspannung zur Uebertragung per RTM
          signal BMC_CMC_Zellspannung_152_XIX_BMC_CMC_Zellspannung_04_XIX_HCP5_CANFD01: start 420, 12 bit, little-endian, data-type-policy=OVERRIDE, i-signal-type=PRIMITIVE, init-value=4094, base-type=BT_BMC_CMC_Zellspannung_152, invalid-value=Invalid_BMC_CMC_Zellspannung_152_XIX_BMC_CMC_Zellspannung_04_XIX_HCP5_CANFD01:4095, compu {phys=raw+1000 for raw 0..4091, 4092=Cxffc_kleiner_1V (CM_BMC_CMC_Zellspannung_152_Cxffc_kleiner_1V), 4093=Cxffd_nicht_vorhanden (CM_BMC_CMC_Zellspannung_152_Cxffd_nicht_vorhanden), 4094=Cxffe_Init (CM_BMC_CMC_Zellspannung_152_Cxffe_Init), 4095=Cxfff_Fehler (CM_BMC_CMC_Zellspannung_152_Cxfff_Fehler); unit Unit_MilliVolt}, range phys 1000..5091 Unit_MilliVolt, raw 0..4095, unit=Unit_MilliVolt, transfer-property=PENDING  # Einzelzellspannung zur Uebertragung per RTM
          signal BMC_CMC_Zellspannung_153_XIX_BMC_CMC_Zellspannung_04_XIX_HCP5_CANFD01: start 432, 12 bit, little-endian, data-type-policy=OVERRIDE, i-signal-type=PRIMITIVE, init-value=4094, base-type=BT_BMC_CMC_Zellspannung_153, invalid-value=Invalid_BMC_CMC_Zellspannung_153_XIX_BMC_CMC_Zellspannung_04_XIX_HCP5_CANFD01:4095, compu {phys=raw+1000 for raw 0..4091, 4092=Cxffc_kleiner_1V (CM_BMC_CMC_Zellspannung_153_Cxffc_kleiner_1V), 4093=Cxffd_nicht_vorhanden (CM_BMC_CMC_Zellspannung_153_Cxffd_nicht_vorhanden), 4094=Cxffe_Init (CM_BMC_CMC_Zellspannung_153_Cxffe_Init), 4095=Cxfff_Fehler (CM_BMC_CMC_Zellspannung_153_Cxfff_Fehler); unit Unit_MilliVolt}, range phys 1000..5091 Unit_MilliVolt, raw 0..4095, unit=Unit_MilliVolt, transfer-property=PENDING  # Einzelzellspannung zur Uebertragung per RTM
          signal BMC_CMC_Zellspannung_154_XIX_BMC_CMC_Zellspannung_04_XIX_HCP5_CANFD01: start 444, 12 bit, little-endian, data-type-policy=OVERRIDE, i-signal-type=PRIMITIVE, init-value=4094, base-type=BT_BMC_CMC_Zellspannung_154, invalid-value=Invalid_BMC_CMC_Zellspannung_154_XIX_BMC_CMC_Zellspannung_04_XIX_HCP5_CANFD01:4095, compu {phys=raw+1000 for raw 0..4091, 4092=Cxffc_kleiner_1V (CM_BMC_CMC_Zellspannung_154_Cxffc_kleiner_1V), 4093=Cxffd_nicht_vorhanden (CM_BMC_CMC_Zellspannung_154_Cxffd_nicht_vorhanden), 4094=Cxffe_Init (CM_BMC_CMC_Zellspannung_154_Cxffe_Init), 4095=Cxfff_Fehler (CM_BMC_CMC_Zellspannung_154_Cxfff_Fehler); unit Unit_MilliVolt}, range phys 1000..5091 Unit_MilliVolt, raw 0..4095, unit=Unit_MilliVolt, transfer-property=PENDING  # Einzelzellspannung zur Uebertragung per RTM
          signal BMC_CMC_Zellspannung_155_XIX_BMC_CMC_Zellspannung_04_XIX_HCP5_CANFD01: start 456, 12 bit, little-endian, data-type-policy=OVERRIDE, i-signal-type=PRIMITIVE, init-value=4094, base-type=BT_BMC_CMC_Zellspannung_155, invalid-value=Invalid_BMC_CMC_Zellspannung_155_XIX_BMC_CMC_Zellspannung_04_XIX_HCP5_CANFD01:4095, compu {phys=raw+1000 for raw 0..4091, 4092=Cxffc_kleiner_1V (CM_BMC_CMC_Zellspannung_155_Cxffc_kleiner_1V), 4093=Cxffd_nicht_vorhanden (CM_BMC_CMC_Zellspannung_155_Cxffd_nicht_vorhanden), 4094=Cxffe_Init (CM_BMC_CMC_Zellspannung_155_Cxffe_Init), 4095=Cxfff_Fehler (CM_BMC_CMC_Zellspannung_155_Cxfff_Fehler); unit Unit_MilliVolt}, range phys 1000..5091 Unit_MilliVolt, raw 0..4095, unit=Unit_MilliVolt, transfer-property=PENDING  # Einzelzellspannung zur Uebertragung per RTM
          signal BMC_CMC_Zellspannung_156_XIX_BMC_CMC_Zellspannung_04_XIX_HCP5_CANFD01: start 468, 12 bit, little-endian, data-type-policy=OVERRIDE, i-signal-type=PRIMITIVE, init-value=4094, base-type=BT_BMC_CMC_Zellspannung_156, invalid-value=Invalid_BMC_CMC_Zellspannung_156_XIX_BMC_CMC_Zellspannung_04_XIX_HCP5_CANFD01:4095, compu {phys=raw+1000 for raw 0..4091, 4092=Cxffc_kleiner_1V (CM_BMC_CMC_Zellspannung_156_Cxffc_kleiner_1V), 4093=Cxffd_nicht_vorhanden (CM_BMC_CMC_Zellspannung_156_Cxffd_nicht_vorhanden), 4094=Cxffe_Init (CM_BMC_CMC_Zellspannung_156_Cxffe_Init), 4095=Cxfff_Fehler (CM_BMC_CMC_Zellspannung_156_Cxfff_Fehler); unit Unit_MilliVolt}, range phys 1000..5091 Unit_MilliVolt, raw 0..4095, unit=Unit_MilliVolt, transfer-property=PENDING  # Einzelzellspannung zur Uebertragung per RTM
          signal BMC_CMC_Zellspannung_04_Messzeit_XIX_BMC_CMC_Zellspannung_04_XIX_HCP5_CANFD01: start 480, 8 bit, little-endian, data-type-policy=OVERRIDE, i-signal-type=PRIMITIVE, init-value=254, base-type=BT_BMC_CMC_Zellspannung_04_Messzeit, invalid-value=Invalid_BMC_CMC_Zellspannung_04_Messzeit_XIX_BMC_CMC_Zellspannung_04_XIX_HCP5_CANFD01:255, compu {phys=raw for raw 0..253, 254=Cxfe_Init (CM_BMC_CMC_Zellspannung_04_Messzeit_Cxfe_Init), 255=Cxff_Fehler (CM_BMC_CMC_Zellspannung_04_Messzeit_Cxff_Fehler); unit Unit_None}, range phys 0..253 Unit_None, raw 0..255, unit=Unit_None, transfer-property=PENDING  # Messzeit zu Botschaft BMC_CMC_Zellspannung_04
      frame BMC_CMC_Zellspannung_05_XIX_HCP5_CANFD01: id 0x1A555630, from BMC_HV, frame-length=64, can-addressing-mode=EXTENDED, can-frame-rx-behavior=CAN-FD, can-frame-tx-behavior=CAN-FD
        pdu BMC_CMC_Zellspannung_05_XIX_HCP5_CANFD01: length=64, transmission-mode-true-timing=cyclic-timing={time-offset=0, time-period=1}, unused-bit-pattern=0
          signal BMC_CMC_Zellspannung_157_XIX_BMC_CMC_Zellspannung_05_XIX_HCP5_CANFD01: start 12, 12 bit, little-endian, data-type-policy=OVERRIDE, i-signal-type=PRIMITIVE, init-value=4094, base-type=BT_BMC_CMC_Zellspannung_157, invalid-value=Invalid_BMC_CMC_Zellspannung_157_XIX_BMC_CMC_Zellspannung_05_XIX_HCP5_CANFD01:4095, compu {phys=raw+1000 for raw 0..4091, 4092=Cxffc_kleiner_1V (CM_BMC_CMC_Zellspannung_157_Cxffc_kleiner_1V), 4093=Cxffd_nicht_vorhanden (CM_BMC_CMC_Zellspannung_157_Cxffd_nicht_vorhanden), 4094=Cxffe_Init (CM_BMC_CMC_Zellspannung_157_Cxffe_Init), 4095=Cxfff_Fehler (CM_BMC_CMC_Zellspannung_157_Cxfff_Fehler); unit Unit_MilliVolt}, range phys 1000..5091 Unit_MilliVolt, raw 0..4095, unit=Unit_MilliVolt, transfer-property=PENDING  # Einzelzellspannung zur Uebertragung per RTM
          signal BMC_CMC_Zellspannung_158_XIX_BMC_CMC_Zellspannung_05_XIX_HCP5_CANFD01: start 24, 12 bit, little-endian, data-type-policy=OVERRIDE, i-signal-type=PRIMITIVE, init-value=4094, base-type=BT_BMC_CMC_Zellspannung_158, invalid-value=Invalid_BMC_CMC_Zellspannung_158_XIX_BMC_CMC_Zellspannung_05_XIX_HCP5_CANFD01:4095, compu {phys=raw+1000 for raw 0..4091, 4092=Cxffc_kleiner_1V (CM_BMC_CMC_Zellspannung_158_Cxffc_kleiner_1V), 4093=Cxffd_nicht_vorhanden (CM_BMC_CMC_Zellspannung_158_Cxffd_nicht_vorhanden), 4094=Cxffe_Init (CM_BMC_CMC_Zellspannung_158_Cxffe_Init), 4095=Cxfff_Fehler (CM_BMC_CMC_Zellspannung_158_Cxfff_Fehler); unit Unit_MilliVolt}, range phys 1000..5091 Unit_MilliVolt, raw 0..4095, unit=Unit_MilliVolt, transfer-property=PENDING  # Einzelzellspannung zur Uebertragung per RTM
          signal BMC_CMC_Zellspannung_159_XIX_BMC_CMC_Zellspannung_05_XIX_HCP5_CANFD01: start 36, 12 bit, little-endian, data-type-policy=OVERRIDE, i-signal-type=PRIMITIVE, init-value=4094, base-type=BT_BMC_CMC_Zellspannung_159, invalid-value=Invalid_BMC_CMC_Zellspannung_159_XIX_BMC_CMC_Zellspannung_05_XIX_HCP5_CANFD01:4095, compu {phys=raw+1000 for raw 0..4091, 4092=Cxffc_kleiner_1V (CM_BMC_CMC_Zellspannung_159_Cxffc_kleiner_1V), 4093=Cxffd_nicht_vorhanden (CM_BMC_CMC_Zellspannung_159_Cxffd_nicht_vorhanden), 4094=Cxffe_Init (CM_BMC_CMC_Zellspannung_159_Cxffe_Init), 4095=Cxfff_Fehler (CM_BMC_CMC_Zellspannung_159_Cxfff_Fehler); unit Unit_MilliVolt}, range phys 1000..5091 Unit_MilliVolt, raw 0..4095, unit=Unit_MilliVolt, transfer-property=PENDING  # Einzelzellspannung zur Uebertragung per RTM
          signal BMC_CMC_Zellspannung_160_XIX_BMC_CMC_Zellspannung_05_XIX_HCP5_CANFD01: start 48, 12 bit, little-endian, data-type-policy=OVERRIDE, i-signal-type=PRIMITIVE, init-value=4094, base-type=BT_BMC_CMC_Zellspannung_160, invalid-value=Invalid_BMC_CMC_Zellspannung_160_XIX_BMC_CMC_Zellspannung_05_XIX_HCP5_CANFD01:4095, compu {phys=raw+1000 for raw 0..4091, 4092=Cxffc_kleiner_1V (CM_BMC_CMC_Zellspannung_160_Cxffc_kleiner_1V), 4093=Cxffd_nicht_vorhanden (CM_BMC_CMC_Zellspannung_160_Cxffd_nicht_vorhanden), 4094=Cxffe_Init (CM_BMC_CMC_Zellspannung_160_Cxffe_Init), 4095=Cxfff_Fehler (CM_BMC_CMC_Zellspannung_160_Cxfff_Fehler); unit Unit_MilliVolt}, range phys 1000..5091 Unit_MilliVolt, raw 0..4095, unit=Unit_MilliVolt, transfer-property=PENDING  # Einzelzellspannung zur Uebertragung per RTM
          signal BMC_CMC_Zellspannung_161_XIX_BMC_CMC_Zellspannung_05_XIX_HCP5_CANFD01: start 60, 12 bit, little-endian, data-type-policy=OVERRIDE, i-signal-type=PRIMITIVE, init-value=4094, base-type=BT_BMC_CMC_Zellspannung_161, invalid-value=Invalid_BMC_CMC_Zellspannung_161_XIX_BMC_CMC_Zellspannung_05_XIX_HCP5_CANFD01:4095, compu {phys=raw+1000 for raw 0..4091, 4092=Cxffc_kleiner_1V (CM_BMC_CMC_Zellspannung_161_Cxffc_kleiner_1V), 4093=Cxffd_nicht_vorhanden (CM_BMC_CMC_Zellspannung_161_Cxffd_nicht_vorhanden), 4094=Cxffe_Init (CM_BMC_CMC_Zellspannung_161_Cxffe_Init), 4095=Cxfff_Fehler (CM_BMC_CMC_Zellspannung_161_Cxfff_Fehler); unit Unit_MilliVolt}, range phys 1000..5091 Unit_MilliVolt, raw 0..4095, unit=Unit_MilliVolt, transfer-property=PENDING  # Einzelzellspannung zur Uebertragung per RTM
          signal BMC_CMC_Zellspannung_162_XIX_BMC_CMC_Zellspannung_05_XIX_HCP5_CANFD01: start 72, 12 bit, little-endian, data-type-policy=OVERRIDE, i-signal-type=PRIMITIVE, init-value=4094, base-type=BT_BMC_CMC_Zellspannung_162, invalid-value=Invalid_BMC_CMC_Zellspannung_162_XIX_BMC_CMC_Zellspannung_05_XIX_HCP5_CANFD01:4095, compu {phys=raw+1000 for raw 0..4091, 4092=Cxffc_kleiner_1V (CM_BMC_CMC_Zellspannung_162_Cxffc_kleiner_1V), 4093=Cxffd_nicht_vorhanden (CM_BMC_CMC_Zellspannung_162_Cxffd_nicht_vorhanden), 4094=Cxffe_Init (CM_BMC_CMC_Zellspannung_162_Cxffe_Init), 4095=Cxfff_Fehler (CM_BMC_CMC_Zellspannung_162_Cxfff_Fehler); unit Unit_MilliVolt}, range phys 1000..5091 Unit_MilliVolt, raw 0..4095, unit=Unit_MilliVolt, transfer-property=PENDING  # Einzelzellspannung zur Uebertragung per RTM
          signal BMC_CMC_Zellspannung_163_XIX_BMC_CMC_Zellspannung_05_XIX_HCP5_CANFD01: start 84, 12 bit, little-endian, data-type-policy=OVERRIDE, i-signal-type=PRIMITIVE, init-value=4094, base-type=BT_BMC_CMC_Zellspannung_163, invalid-value=Invalid_BMC_CMC_Zellspannung_163_XIX_BMC_CMC_Zellspannung_05_XIX_HCP5_CANFD01:4095, compu {phys=raw+1000 for raw 0..4091, 4092=Cxffc_kleiner_1V (CM_BMC_CMC_Zellspannung_163_Cxffc_kleiner_1V), 4093=Cxffd_nicht_vorhanden (CM_BMC_CMC_Zellspannung_163_Cxffd_nicht_vorhanden), 4094=Cxffe_Init (CM_BMC_CMC_Zellspannung_163_Cxffe_Init), 4095=Cxfff_Fehler (CM_BMC_CMC_Zellspannung_163_Cxfff_Fehler); unit Unit_MilliVolt}, range phys 1000..5091 Unit_MilliVolt, raw 0..4095, unit=Unit_MilliVolt, transfer-property=PENDING  # Einzelzellspannung zur Uebertragung per RTM
          signal BMC_CMC_Zellspannung_164_XIX_BMC_CMC_Zellspannung_05_XIX_HCP5_CANFD01: start 96, 12 bit, little-endian, data-type-policy=OVERRIDE, i-signal-type=PRIMITIVE, init-value=4094, base-type=BT_BMC_CMC_Zellspannung_164, invalid-value=Invalid_BMC_CMC_Zellspannung_164_XIX_BMC_CMC_Zellspannung_05_XIX_HCP5_CANFD01:4095, compu {phys=raw+1000 for raw 0..4091, 4092=Cxffc_kleiner_1V (CM_BMC_CMC_Zellspannung_164_Cxffc_kleiner_1V), 4093=Cxffd_nicht_vorhanden (CM_BMC_CMC_Zellspannung_164_Cxffd_nicht_vorhanden), 4094=Cxffe_Init (CM_BMC_CMC_Zellspannung_164_Cxffe_Init), 4095=Cxfff_Fehler (CM_BMC_CMC_Zellspannung_164_Cxfff_Fehler); unit Unit_MilliVolt}, range phys 1000..5091 Unit_MilliVolt, raw 0..4095, unit=Unit_MilliVolt, transfer-property=PENDING  # Einzelzellspannung zur Uebertragung per RTM
          signal BMC_CMC_Zellspannung_165_XIX_BMC_CMC_Zellspannung_05_XIX_HCP5_CANFD01: start 108, 12 bit, little-endian, data-type-policy=OVERRIDE, i-signal-type=PRIMITIVE, init-value=4094, base-type=BT_BMC_CMC_Zellspannung_165, invalid-value=Invalid_BMC_CMC_Zellspannung_165_XIX_BMC_CMC_Zellspannung_05_XIX_HCP5_CANFD01:4095, compu {phys=raw+1000 for raw 0..4091, 4092=Cxffc_kleiner_1V (CM_BMC_CMC_Zellspannung_165_Cxffc_kleiner_1V), 4093=Cxffd_nicht_vorhanden (CM_BMC_CMC_Zellspannung_165_Cxffd_nicht_vorhanden), 4094=Cxffe_Init (CM_BMC_CMC_Zellspannung_165_Cxffe_Init), 4095=Cxfff_Fehler (CM_BMC_CMC_Zellspannung_165_Cxfff_Fehler); unit Unit_MilliVolt}, range phys 1000..5091 Unit_MilliVolt, raw 0..4095, unit=Unit_MilliVolt, transfer-property=PENDING  # Einzelzellspannung zur Uebertragung per RTM
          signal BMC_CMC_Zellspannung_166_XIX_BMC_CMC_Zellspannung_05_XIX_HCP5_CANFD01: start 120, 12 bit, little-endian, data-type-policy=OVERRIDE, i-signal-type=PRIMITIVE, init-value=4094, base-type=BT_BMC_CMC_Zellspannung_166, invalid-value=Invalid_BMC_CMC_Zellspannung_166_XIX_BMC_CMC_Zellspannung_05_XIX_HCP5_CANFD01:4095, compu {phys=raw+1000 for raw 0..4091, 4092=Cxffc_kleiner_1V (CM_BMC_CMC_Zellspannung_166_Cxffc_kleiner_1V), 4093=Cxffd_nicht_vorhanden (CM_BMC_CMC_Zellspannung_166_Cxffd_nicht_vorhanden), 4094=Cxffe_Init (CM_BMC_CMC_Zellspannung_166_Cxffe_Init), 4095=Cxfff_Fehler (CM_BMC_CMC_Zellspannung_166_Cxfff_Fehler); unit Unit_MilliVolt}, range phys 1000..5091 Unit_MilliVolt, raw 0..4095, unit=Unit_MilliVolt, transfer-property=PENDING  # Einzelzellspannung zur Uebertragung per RTM
          signal BMC_CMC_Zellspannung_167_XIX_BMC_CMC_Zellspannung_05_XIX_HCP5_CANFD01: start 132, 12 bit, little-endian, data-type-policy=OVERRIDE, i-signal-type=PRIMITIVE, init-value=4094, base-type=BT_BMC_CMC_Zellspannung_167, invalid-value=Invalid_BMC_CMC_Zellspannung_167_XIX_BMC_CMC_Zellspannung_05_XIX_HCP5_CANFD01:4095, compu {phys=raw+1000 for raw 0..4091, 4092=Cxffc_kleiner_1V (CM_BMC_CMC_Zellspannung_167_Cxffc_kleiner_1V), 4093=Cxffd_nicht_vorhanden (CM_BMC_CMC_Zellspannung_167_Cxffd_nicht_vorhanden), 4094=Cxffe_Init (CM_BMC_CMC_Zellspannung_167_Cxffe_Init), 4095=Cxfff_Fehler (CM_BMC_CMC_Zellspannung_167_Cxfff_Fehler); unit Unit_MilliVolt}, range phys 1000..5091 Unit_MilliVolt, raw 0..4095, unit=Unit_MilliVolt, transfer-property=PENDING  # Einzelzellspannung zur Uebertragung per RTM
          signal BMC_CMC_Zellspannung_168_XIX_BMC_CMC_Zellspannung_05_XIX_HCP5_CANFD01: start 144, 12 bit, little-endian, data-type-policy=OVERRIDE, i-signal-type=PRIMITIVE, init-value=4094, base-type=BT_BMC_CMC_Zellspannung_168, invalid-value=Invalid_BMC_CMC_Zellspannung_168_XIX_BMC_CMC_Zellspannung_05_XIX_HCP5_CANFD01:4095, compu {phys=raw+1000 for raw 0..4091, 4092=Cxffc_kleiner_1V (CM_BMC_CMC_Zellspannung_168_Cxffc_kleiner_1V), 4093=Cxffd_nicht_vorhanden (CM_BMC_CMC_Zellspannung_168_Cxffd_nicht_vorhanden), 4094=Cxffe_Init (CM_BMC_CMC_Zellspannung_168_Cxffe_Init), 4095=Cxfff_Fehler (CM_BMC_CMC_Zellspannung_168_Cxfff_Fehler); unit Unit_MilliVolt}, range phys 1000..5091 Unit_MilliVolt, raw 0..4095, unit=Unit_MilliVolt, transfer-property=PENDING  # Einzelzellspannung zur Uebertragung per RTM
          signal BMC_CMC_Zellspannung_169_XIX_BMC_CMC_Zellspannung_05_XIX_HCP5_CANFD01: start 156, 12 bit, little-endian, data-type-policy=OVERRIDE, i-signal-type=PRIMITIVE, init-value=4094, base-type=BT_BMC_CMC_Zellspannung_169, invalid-value=Invalid_BMC_CMC_Zellspannung_169_XIX_BMC_CMC_Zellspannung_05_XIX_HCP5_CANFD01:4095, compu {phys=raw+1000 for raw 0..4091, 4092=Cxffc_kleiner_1V (CM_BMC_CMC_Zellspannung_169_Cxffc_kleiner_1V), 4093=Cxffd_nicht_vorhanden (CM_BMC_CMC_Zellspannung_169_Cxffd_nicht_vorhanden), 4094=Cxffe_Init (CM_BMC_CMC_Zellspannung_169_Cxffe_Init), 4095=Cxfff_Fehler (CM_BMC_CMC_Zellspannung_169_Cxfff_Fehler); unit Unit_MilliVolt}, range phys 1000..5091 Unit_MilliVolt, raw 0..4095, unit=Unit_MilliVolt, transfer-property=PENDING  # Einzelzellspannung zur Uebertragung per RTM
          signal BMC_CMC_Zellspannung_170_XIX_BMC_CMC_Zellspannung_05_XIX_HCP5_CANFD01: start 168, 12 bit, little-endian, data-type-policy=OVERRIDE, i-signal-type=PRIMITIVE, init-value=4094, base-type=BT_BMC_CMC_Zellspannung_170, invalid-value=Invalid_BMC_CMC_Zellspannung_170_XIX_BMC_CMC_Zellspannung_05_XIX_HCP5_CANFD01:4095, compu {phys=raw+1000 for raw 0..4091, 4092=Cxffc_kleiner_1V (CM_BMC_CMC_Zellspannung_170_Cxffc_kleiner_1V), 4093=Cxffd_nicht_vorhanden (CM_BMC_CMC_Zellspannung_170_Cxffd_nicht_vorhanden), 4094=Cxffe_Init (CM_BMC_CMC_Zellspannung_170_Cxffe_Init), 4095=Cxfff_Fehler (CM_BMC_CMC_Zellspannung_170_Cxfff_Fehler); unit Unit_MilliVolt}, range phys 1000..5091 Unit_MilliVolt, raw 0..4095, unit=Unit_MilliVolt, transfer-property=PENDING  # Einzelzellspannung zur Uebertragung per RTM
          signal BMC_CMC_Zellspannung_171_XIX_BMC_CMC_Zellspannung_05_XIX_HCP5_CANFD01: start 180, 12 bit, little-endian, data-type-policy=OVERRIDE, i-signal-type=PRIMITIVE, init-value=4094, base-type=BT_BMC_CMC_Zellspannung_171, invalid-value=Invalid_BMC_CMC_Zellspannung_171_XIX_BMC_CMC_Zellspannung_05_XIX_HCP5_CANFD01:4095, compu {phys=raw+1000 for raw 0..4091, 4092=Cxffc_kleiner_1V (CM_BMC_CMC_Zellspannung_171_Cxffc_kleiner_1V), 4093=Cxffd_nicht_vorhanden (CM_BMC_CMC_Zellspannung_171_Cxffd_nicht_vorhanden), 4094=Cxffe_Init (CM_BMC_CMC_Zellspannung_171_Cxffe_Init), 4095=Cxfff_Fehler (CM_BMC_CMC_Zellspannung_171_Cxfff_Fehler); unit Unit_MilliVolt}, range phys 1000..5091 Unit_MilliVolt, raw 0..4095, unit=Unit_MilliVolt, transfer-property=PENDING  # Einzelzellspannung zur Uebertragung per RTM
          signal BMC_CMC_Zellspannung_172_XIX_BMC_CMC_Zellspannung_05_XIX_HCP5_CANFD01: start 192, 12 bit, little-endian, data-type-policy=OVERRIDE, i-signal-type=PRIMITIVE, init-value=4094, base-type=BT_BMC_CMC_Zellspannung_172, invalid-value=Invalid_BMC_CMC_Zellspannung_172_XIX_BMC_CMC_Zellspannung_05_XIX_HCP5_CANFD01:4095, compu {phys=raw+1000 for raw 0..4091, 4092=Cxffc_kleiner_1V (CM_BMC_CMC_Zellspannung_172_Cxffc_kleiner_1V), 4093=Cxffd_nicht_vorhanden (CM_BMC_CMC_Zellspannung_172_Cxffd_nicht_vorhanden), 4094=Cxffe_Init (CM_BMC_CMC_Zellspannung_172_Cxffe_Init), 4095=Cxfff_Fehler (CM_BMC_CMC_Zellspannung_172_Cxfff_Fehler); unit Unit_MilliVolt}, range phys 1000..5091 Unit_MilliVolt, raw 0..4095, unit=Unit_MilliVolt, transfer-property=PENDING  # Einzelzellspannung zur Uebertragung per RTM
          signal BMC_CMC_Zellspannung_173_XIX_BMC_CMC_Zellspannung_05_XIX_HCP5_CANFD01: start 204, 12 bit, little-endian, data-type-policy=OVERRIDE, i-signal-type=PRIMITIVE, init-value=4094, base-type=BT_BMC_CMC_Zellspannung_173, invalid-value=Invalid_BMC_CMC_Zellspannung_173_XIX_BMC_CMC_Zellspannung_05_XIX_HCP5_CANFD01:4095, compu {phys=raw+1000 for raw 0..4091, 4092=Cxffc_kleiner_1V (CM_BMC_CMC_Zellspannung_173_Cxffc_kleiner_1V), 4093=Cxffd_nicht_vorhanden (CM_BMC_CMC_Zellspannung_173_Cxffd_nicht_vorhanden), 4094=Cxffe_Init (CM_BMC_CMC_Zellspannung_173_Cxffe_Init), 4095=Cxfff_Fehler (CM_BMC_CMC_Zellspannung_173_Cxfff_Fehler); unit Unit_MilliVolt}, range phys 1000..5091 Unit_MilliVolt, raw 0..4095, unit=Unit_MilliVolt, transfer-property=PENDING  # Einzelzellspannung zur Uebertragung per RTM
          signal BMC_CMC_Zellspannung_174_XIX_BMC_CMC_Zellspannung_05_XIX_HCP5_CANFD01: start 216, 12 bit, little-endian, data-type-policy=OVERRIDE, i-signal-type=PRIMITIVE, init-value=4094, base-type=BT_BMC_CMC_Zellspannung_174, invalid-value=Invalid_BMC_CMC_Zellspannung_174_XIX_BMC_CMC_Zellspannung_05_XIX_HCP5_CANFD01:4095, compu {phys=raw+1000 for raw 0..4091, 4092=Cxffc_kleiner_1V (CM_BMC_CMC_Zellspannung_174_Cxffc_kleiner_1V), 4093=Cxffd_nicht_vorhanden (CM_BMC_CMC_Zellspannung_174_Cxffd_nicht_vorhanden), 4094=Cxffe_Init (CM_BMC_CMC_Zellspannung_174_Cxffe_Init), 4095=Cxfff_Fehler (CM_BMC_CMC_Zellspannung_174_Cxfff_Fehler); unit Unit_MilliVolt}, range phys 1000..5091 Unit_MilliVolt, raw 0..4095, unit=Unit_MilliVolt, transfer-property=PENDING  # Einzelzellspannung zur Uebertragung per RTM
          signal BMC_CMC_Zellspannung_175_XIX_BMC_CMC_Zellspannung_05_XIX_HCP5_CANFD01: start 228, 12 bit, little-endian, data-type-policy=OVERRIDE, i-signal-type=PRIMITIVE, init-value=4094, base-type=BT_BMC_CMC_Zellspannung_175, invalid-value=Invalid_BMC_CMC_Zellspannung_175_XIX_BMC_CMC_Zellspannung_05_XIX_HCP5_CANFD01:4095, compu {phys=raw+1000 for raw 0..4091, 4092=Cxffc_kleiner_1V (CM_BMC_CMC_Zellspannung_175_Cxffc_kleiner_1V), 4093=Cxffd_nicht_vorhanden (CM_BMC_CMC_Zellspannung_175_Cxffd_nicht_vorhanden), 4094=Cxffe_Init (CM_BMC_CMC_Zellspannung_175_Cxffe_Init), 4095=Cxfff_Fehler (CM_BMC_CMC_Zellspannung_175_Cxfff_Fehler); unit Unit_MilliVolt}, range phys 1000..5091 Unit_MilliVolt, raw 0..4095, unit=Unit_MilliVolt, transfer-property=PENDING  # Einzelzellspannung zur Uebertragung per RTM
          signal BMC_CMC_Zellspannung_176_XIX_BMC_CMC_Zellspannung_05_XIX_HCP5_CANFD01: start 240, 12 bit, little-endian, data-type-policy=OVERRIDE, i-signal-type=PRIMITIVE, init-value=4094, base-type=BT_BMC_CMC_Zellspannung_176, invalid-value=Invalid_BMC_CMC_Zellspannung_176_XIX_BMC_CMC_Zellspannung_05_XIX_HCP5_CANFD01:4095, compu {phys=raw+1000 for raw 0..4091, 4092=Cxffc_kleiner_1V (CM_BMC_CMC_Zellspannung_176_Cxffc_kleiner_1V), 4093=Cxffd_nicht_vorhanden (CM_BMC_CMC_Zellspannung_176_Cxffd_nicht_vorhanden), 4094=Cxffe_Init (CM_BMC_CMC_Zellspannung_176_Cxffe_Init), 4095=Cxfff_Fehler (CM_BMC_CMC_Zellspannung_176_Cxfff_Fehler); unit Unit_MilliVolt}, range phys 1000..5091 Unit_MilliVolt, raw 0..4095, unit=Unit_MilliVolt, transfer-property=PENDING  # Einzelzellspannung zur Uebertragung per RTM
          signal BMC_CMC_Zellspannung_177_XIX_BMC_CMC_Zellspannung_05_XIX_HCP5_CANFD01: start 252, 12 bit, little-endian, data-type-policy=OVERRIDE, i-signal-type=PRIMITIVE, init-value=4094, base-type=BT_BMC_CMC_Zellspannung_177, invalid-value=Invalid_BMC_CMC_Zellspannung_177_XIX_BMC_CMC_Zellspannung_05_XIX_HCP5_CANFD01:4095, compu {phys=raw+1000 for raw 0..4091, 4092=Cxffc_kleiner_1V (CM_BMC_CMC_Zellspannung_177_Cxffc_kleiner_1V), 4093=Cxffd_nicht_vorhanden (CM_BMC_CMC_Zellspannung_177_Cxffd_nicht_vorhanden), 4094=Cxffe_Init (CM_BMC_CMC_Zellspannung_177_Cxffe_Init), 4095=Cxfff_Fehler (CM_BMC_CMC_Zellspannung_177_Cxfff_Fehler); unit Unit_MilliVolt}, range phys 1000..5091 Unit_MilliVolt, raw 0..4095, unit=Unit_MilliVolt, transfer-property=PENDING  # Einzelzellspannung zur Uebertragung per RTM
          signal BMC_CMC_Zellspannung_178_XIX_BMC_CMC_Zellspannung_05_XIX_HCP5_CANFD01: start 264, 12 bit, little-endian, data-type-policy=OVERRIDE, i-signal-type=PRIMITIVE, init-value=4094, base-type=BT_BMC_CMC_Zellspannung_178, invalid-value=Invalid_BMC_CMC_Zellspannung_178_XIX_BMC_CMC_Zellspannung_05_XIX_HCP5_CANFD01:4095, compu {phys=raw+1000 for raw 0..4091, 4092=Cxffc_kleiner_1V (CM_BMC_CMC_Zellspannung_178_Cxffc_kleiner_1V), 4093=Cxffd_nicht_vorhanden (CM_BMC_CMC_Zellspannung_178_Cxffd_nicht_vorhanden), 4094=Cxffe_Init (CM_BMC_CMC_Zellspannung_178_Cxffe_Init), 4095=Cxfff_Fehler (CM_BMC_CMC_Zellspannung_178_Cxfff_Fehler); unit Unit_MilliVolt}, range phys 1000..5091 Unit_MilliVolt, raw 0..4095, unit=Unit_MilliVolt, transfer-property=PENDING  # Einzelzellspannung zur Uebertragung per RTM
          signal BMC_CMC_Zellspannung_179_XIX_BMC_CMC_Zellspannung_05_XIX_HCP5_CANFD01: start 276, 12 bit, little-endian, data-type-policy=OVERRIDE, i-signal-type=PRIMITIVE, init-value=4094, base-type=BT_BMC_CMC_Zellspannung_179, invalid-value=Invalid_BMC_CMC_Zellspannung_179_XIX_BMC_CMC_Zellspannung_05_XIX_HCP5_CANFD01:4095, compu {phys=raw+1000 for raw 0..4091, 4092=Cxffc_kleiner_1V (CM_BMC_CMC_Zellspannung_179_Cxffc_kleiner_1V), 4093=Cxffd_nicht_vorhanden (CM_BMC_CMC_Zellspannung_179_Cxffd_nicht_vorhanden), 4094=Cxffe_Init (CM_BMC_CMC_Zellspannung_179_Cxffe_Init), 4095=Cxfff_Fehler (CM_BMC_CMC_Zellspannung_179_Cxfff_Fehler); unit Unit_MilliVolt}, range phys 1000..5091 Unit_MilliVolt, raw 0..4095, unit=Unit_MilliVolt, transfer-property=PENDING  # Einzelzellspannung zur Uebertragung per RTM
          signal BMC_CMC_Zellspannung_180_XIX_BMC_CMC_Zellspannung_05_XIX_HCP5_CANFD01: start 288, 12 bit, little-endian, data-type-policy=OVERRIDE, i-signal-type=PRIMITIVE, init-value=4094, base-type=BT_BMC_CMC_Zellspannung_180, invalid-value=Invalid_BMC_CMC_Zellspannung_180_XIX_BMC_CMC_Zellspannung_05_XIX_HCP5_CANFD01:4095, compu {phys=raw+1000 for raw 0..4091, 4092=Cxffc_kleiner_1V (CM_BMC_CMC_Zellspannung_180_Cxffc_kleiner_1V), 4093=Cxffd_nicht_vorhanden (CM_BMC_CMC_Zellspannung_180_Cxffd_nicht_vorhanden), 4094=Cxffe_Init (CM_BMC_CMC_Zellspannung_180_Cxffe_Init), 4095=Cxfff_Fehler (CM_BMC_CMC_Zellspannung_180_Cxfff_Fehler); unit Unit_MilliVolt}, range phys 1000..5091 Unit_MilliVolt, raw 0..4095, unit=Unit_MilliVolt, transfer-property=PENDING  # Einzelzellspannung zur Uebertragung per RTM
          signal BMC_CMC_Zellspannung_181_XIX_BMC_CMC_Zellspannung_05_XIX_HCP5_CANFD01: start 300, 12 bit, little-endian, data-type-policy=OVERRIDE, i-signal-type=PRIMITIVE, init-value=4094, base-type=BT_BMC_CMC_Zellspannung_181, invalid-value=Invalid_BMC_CMC_Zellspannung_181_XIX_BMC_CMC_Zellspannung_05_XIX_HCP5_CANFD01:4095, compu {phys=raw+1000 for raw 0..4091, 4092=Cxffc_kleiner_1V (CM_BMC_CMC_Zellspannung_181_Cxffc_kleiner_1V), 4093=Cxffd_nicht_vorhanden (CM_BMC_CMC_Zellspannung_181_Cxffd_nicht_vorhanden), 4094=Cxffe_Init (CM_BMC_CMC_Zellspannung_181_Cxffe_Init), 4095=Cxfff_Fehler (CM_BMC_CMC_Zellspannung_181_Cxfff_Fehler); unit Unit_MilliVolt}, range phys 1000..5091 Unit_MilliVolt, raw 0..4095, unit=Unit_MilliVolt, transfer-property=PENDING  # Einzelzellspannung zur Uebertragung per RTM
          signal BMC_CMC_Zellspannung_182_XIX_BMC_CMC_Zellspannung_05_XIX_HCP5_CANFD01: start 312, 12 bit, little-endian, data-type-policy=OVERRIDE, i-signal-type=PRIMITIVE, init-value=4094, base-type=BT_BMC_CMC_Zellspannung_182, invalid-value=Invalid_BMC_CMC_Zellspannung_182_XIX_BMC_CMC_Zellspannung_05_XIX_HCP5_CANFD01:4095, compu {phys=raw+1000 for raw 0..4091, 4092=Cxffc_kleiner_1V (CM_BMC_CMC_Zellspannung_182_Cxffc_kleiner_1V), 4093=Cxffd_nicht_vorhanden (CM_BMC_CMC_Zellspannung_182_Cxffd_nicht_vorhanden), 4094=Cxffe_Init (CM_BMC_CMC_Zellspannung_182_Cxffe_Init), 4095=Cxfff_Fehler (CM_BMC_CMC_Zellspannung_182_Cxfff_Fehler); unit Unit_MilliVolt}, range phys 1000..5091 Unit_MilliVolt, raw 0..4095, unit=Unit_MilliVolt, transfer-property=PENDING  # Einzelzellspannung zur Uebertragung per RTM
          signal BMC_CMC_Zellspannung_183_XIX_BMC_CMC_Zellspannung_05_XIX_HCP5_CANFD01: start 324, 12 bit, little-endian, data-type-policy=OVERRIDE, i-signal-type=PRIMITIVE, init-value=4094, base-type=BT_BMC_CMC_Zellspannung_183, invalid-value=Invalid_BMC_CMC_Zellspannung_183_XIX_BMC_CMC_Zellspannung_05_XIX_HCP5_CANFD01:4095, compu {phys=raw+1000 for raw 0..4091, 4092=Cxffc_kleiner_1V (CM_BMC_CMC_Zellspannung_183_Cxffc_kleiner_1V), 4093=Cxffd_nicht_vorhanden (CM_BMC_CMC_Zellspannung_183_Cxffd_nicht_vorhanden), 4094=Cxffe_Init (CM_BMC_CMC_Zellspannung_183_Cxffe_Init), 4095=Cxfff_Fehler (CM_BMC_CMC_Zellspannung_183_Cxfff_Fehler); unit Unit_MilliVolt}, range phys 1000..5091 Unit_MilliVolt, raw 0..4095, unit=Unit_MilliVolt, transfer-property=PENDING  # Einzelzellspannung zur Uebertragung per RTM
          signal BMC_CMC_Zellspannung_184_XIX_BMC_CMC_Zellspannung_05_XIX_HCP5_CANFD01: start 336, 12 bit, little-endian, data-type-policy=OVERRIDE, i-signal-type=PRIMITIVE, init-value=4094, base-type=BT_BMC_CMC_Zellspannung_184, invalid-value=Invalid_BMC_CMC_Zellspannung_184_XIX_BMC_CMC_Zellspannung_05_XIX_HCP5_CANFD01:4095, compu {phys=raw+1000 for raw 0..4091, 4092=Cxffc_kleiner_1V (CM_BMC_CMC_Zellspannung_184_Cxffc_kleiner_1V), 4093=Cxffd_nicht_vorhanden (CM_BMC_CMC_Zellspannung_184_Cxffd_nicht_vorhanden), 4094=Cxffe_Init (CM_BMC_CMC_Zellspannung_184_Cxffe_Init), 4095=Cxfff_Fehler (CM_BMC_CMC_Zellspannung_184_Cxfff_Fehler); unit Unit_MilliVolt}, range phys 1000..5091 Unit_MilliVolt, raw 0..4095, unit=Unit_MilliVolt, transfer-property=PENDING  # Einzelzellspannung zur Uebertragung per RTM
          signal BMC_CMC_Zellspannung_185_XIX_BMC_CMC_Zellspannung_05_XIX_HCP5_CANFD01: start 348, 12 bit, little-endian, data-type-policy=OVERRIDE, i-signal-type=PRIMITIVE, init-value=4094, base-type=BT_BMC_CMC_Zellspannung_185, invalid-value=Invalid_BMC_CMC_Zellspannung_185_XIX_BMC_CMC_Zellspannung_05_XIX_HCP5_CANFD01:4095, compu {phys=raw+1000 for raw 0..4091, 4092=Cxffc_kleiner_1V (CM_BMC_CMC_Zellspannung_185_Cxffc_kleiner_1V), 4093=Cxffd_nicht_vorhanden (CM_BMC_CMC_Zellspannung_185_Cxffd_nicht_vorhanden), 4094=Cxffe_Init (CM_BMC_CMC_Zellspannung_185_Cxffe_Init), 4095=Cxfff_Fehler (CM_BMC_CMC_Zellspannung_185_Cxfff_Fehler); unit Unit_MilliVolt}, range phys 1000..5091 Unit_MilliVolt, raw 0..4095, unit=Unit_MilliVolt, transfer-property=PENDING  # Einzelzellspannung zur Uebertragung per RTM
          signal BMC_CMC_Zellspannung_186_XIX_BMC_CMC_Zellspannung_05_XIX_HCP5_CANFD01: start 360, 12 bit, little-endian, data-type-policy=OVERRIDE, i-signal-type=PRIMITIVE, init-value=4094, base-type=BT_BMC_CMC_Zellspannung_186, invalid-value=Invalid_BMC_CMC_Zellspannung_186_XIX_BMC_CMC_Zellspannung_05_XIX_HCP5_CANFD01:4095, compu {phys=raw+1000 for raw 0..4091, 4092=Cxffc_kleiner_1V (CM_BMC_CMC_Zellspannung_186_Cxffc_kleiner_1V), 4093=Cxffd_nicht_vorhanden (CM_BMC_CMC_Zellspannung_186_Cxffd_nicht_vorhanden), 4094=Cxffe_Init (CM_BMC_CMC_Zellspannung_186_Cxffe_Init), 4095=Cxfff_Fehler (CM_BMC_CMC_Zellspannung_186_Cxfff_Fehler); unit Unit_MilliVolt}, range phys 1000..5091 Unit_MilliVolt, raw 0..4095, unit=Unit_MilliVolt, transfer-property=PENDING  # Einzelzellspannung zur Uebertragung per RTM
          signal BMC_CMC_Zellspannung_187_XIX_BMC_CMC_Zellspannung_05_XIX_HCP5_CANFD01: start 372, 12 bit, little-endian, data-type-policy=OVERRIDE, i-signal-type=PRIMITIVE, init-value=4094, base-type=BT_BMC_CMC_Zellspannung_187, invalid-value=Invalid_BMC_CMC_Zellspannung_187_XIX_BMC_CMC_Zellspannung_05_XIX_HCP5_CANFD01:4095, compu {phys=raw+1000 for raw 0..4091, 4092=Cxffc_kleiner_1V (CM_BMC_CMC_Zellspannung_187_Cxffc_kleiner_1V), 4093=Cxffd_nicht_vorhanden (CM_BMC_CMC_Zellspannung_187_Cxffd_nicht_vorhanden), 4094=Cxffe_Init (CM_BMC_CMC_Zellspannung_187_Cxffe_Init), 4095=Cxfff_Fehler (CM_BMC_CMC_Zellspannung_187_Cxfff_Fehler); unit Unit_MilliVolt}, range phys 1000..5091 Unit_MilliVolt, raw 0..4095, unit=Unit_MilliVolt, transfer-property=PENDING  # Einzelzellspannung zur Uebertragung per RTM
          signal BMC_CMC_Zellspannung_188_XIX_BMC_CMC_Zellspannung_05_XIX_HCP5_CANFD01: start 384, 12 bit, little-endian, data-type-policy=OVERRIDE, i-signal-type=PRIMITIVE, init-value=4094, base-type=BT_BMC_CMC_Zellspannung_188, invalid-value=Invalid_BMC_CMC_Zellspannung_188_XIX_BMC_CMC_Zellspannung_05_XIX_HCP5_CANFD01:4095, compu {phys=raw+1000 for raw 0..4091, 4092=Cxffc_kleiner_1V (CM_BMC_CMC_Zellspannung_188_Cxffc_kleiner_1V), 4093=Cxffd_nicht_vorhanden (CM_BMC_CMC_Zellspannung_188_Cxffd_nicht_vorhanden), 4094=Cxffe_Init (CM_BMC_CMC_Zellspannung_188_Cxffe_Init), 4095=Cxfff_Fehler (CM_BMC_CMC_Zellspannung_188_Cxfff_Fehler); unit Unit_MilliVolt}, range phys 1000..5091 Unit_MilliVolt, raw 0..4095, unit=Unit_MilliVolt, transfer-property=PENDING  # Einzelzellspannung zur Uebertragung per RTM
          signal BMC_CMC_Zellspannung_189_XIX_BMC_CMC_Zellspannung_05_XIX_HCP5_CANFD01: start 396, 12 bit, little-endian, data-type-policy=OVERRIDE, i-signal-type=PRIMITIVE, init-value=4094, base-type=BT_BMC_CMC_Zellspannung_189, invalid-value=Invalid_BMC_CMC_Zellspannung_189_XIX_BMC_CMC_Zellspannung_05_XIX_HCP5_CANFD01:4095, compu {phys=raw+1000 for raw 0..4091, 4092=Cxffc_kleiner_1V (CM_BMC_CMC_Zellspannung_189_Cxffc_kleiner_1V), 4093=Cxffd_nicht_vorhanden (CM_BMC_CMC_Zellspannung_189_Cxffd_nicht_vorhanden), 4094=Cxffe_Init (CM_BMC_CMC_Zellspannung_189_Cxffe_Init), 4095=Cxfff_Fehler (CM_BMC_CMC_Zellspannung_189_Cxfff_Fehler); unit Unit_MilliVolt}, range phys 1000..5091 Unit_MilliVolt, raw 0..4095, unit=Unit_MilliVolt, transfer-property=PENDING  # Einzelzellspannung zur Uebertragung per RTM
          signal BMC_CMC_Zellspannung_190_XIX_BMC_CMC_Zellspannung_05_XIX_HCP5_CANFD01: start 408, 12 bit, little-endian, data-type-policy=OVERRIDE, i-signal-type=PRIMITIVE, init-value=4094, base-type=BT_BMC_CMC_Zellspannung_190, invalid-value=Invalid_BMC_CMC_Zellspannung_190_XIX_BMC_CMC_Zellspannung_05_XIX_HCP5_CANFD01:4095, compu {phys=raw+1000 for raw 0..4091, 4092=Cxffc_kleiner_1V (CM_BMC_CMC_Zellspannung_190_Cxffc_kleiner_1V), 4093=Cxffd_nicht_vorhanden (CM_BMC_CMC_Zellspannung_190_Cxffd_nicht_vorhanden), 4094=Cxffe_Init (CM_BMC_CMC_Zellspannung_190_Cxffe_Init), 4095=Cxfff_Fehler (CM_BMC_CMC_Zellspannung_190_Cxfff_Fehler); unit Unit_MilliVolt}, range phys 1000..5091 Unit_MilliVolt, raw 0..4095, unit=Unit_MilliVolt, transfer-property=PENDING  # Einzelzellspannung zur Uebertragung per RTM
          signal BMC_CMC_Zellspannung_191_XIX_BMC_CMC_Zellspannung_05_XIX_HCP5_CANFD01: start 420, 12 bit, little-endian, data-type-policy=OVERRIDE, i-signal-type=PRIMITIVE, init-value=4094, base-type=BT_BMC_CMC_Zellspannung_191, invalid-value=Invalid_BMC_CMC_Zellspannung_191_XIX_BMC_CMC_Zellspannung_05_XIX_HCP5_CANFD01:4095, compu {phys=raw+1000 for raw 0..4091, 4092=Cxffc_kleiner_1V (CM_BMC_CMC_Zellspannung_191_Cxffc_kleiner_1V), 4093=Cxffd_nicht_vorhanden (CM_BMC_CMC_Zellspannung_191_Cxffd_nicht_vorhanden), 4094=Cxffe_Init (CM_BMC_CMC_Zellspannung_191_Cxffe_Init), 4095=Cxfff_Fehler (CM_BMC_CMC_Zellspannung_191_Cxfff_Fehler); unit Unit_MilliVolt}, range phys 1000..5091 Unit_MilliVolt, raw 0..4095, unit=Unit_MilliVolt, transfer-property=PENDING  # Einzelzellspannung zur Uebertragung per RTM
          signal BMC_CMC_Zellspannung_192_XIX_BMC_CMC_Zellspannung_05_XIX_HCP5_CANFD01: start 432, 12 bit, little-endian, data-type-policy=OVERRIDE, i-signal-type=PRIMITIVE, init-value=4094, base-type=BT_BMC_CMC_Zellspannung_192, invalid-value=Invalid_BMC_CMC_Zellspannung_192_XIX_BMC_CMC_Zellspannung_05_XIX_HCP5_CANFD01:4095, compu {phys=raw+1000 for raw 0..4091, 4092=Cxffc_kleiner_1V (CM_BMC_CMC_Zellspannung_192_Cxffc_kleiner_1V), 4093=Cxffd_nicht_vorhanden (CM_BMC_CMC_Zellspannung_192_Cxffd_nicht_vorhanden), 4094=Cxffe_Init (CM_BMC_CMC_Zellspannung_192_Cxffe_Init), 4095=Cxfff_Fehler (CM_BMC_CMC_Zellspannung_192_Cxfff_Fehler); unit Unit_MilliVolt}, range phys 1000..5091 Unit_MilliVolt, raw 0..4095, unit=Unit_MilliVolt, transfer-property=PENDING  # Einzelzellspannung zur Uebertragung per RTM
          signal BMC_CMC_Zellspannung_05_Messzeit_XIX_BMC_CMC_Zellspannung_05_XIX_HCP5_CANFD01: start 444, 8 bit, little-endian, data-type-policy=OVERRIDE, i-signal-type=PRIMITIVE, init-value=254, base-type=BT_BMC_CMC_Zellspannung_05_Messzeit, invalid-value=Invalid_BMC_CMC_Zellspannung_05_Messzeit_XIX_BMC_CMC_Zellspannung_05_XIX_HCP5_CANFD01:255, compu {phys=raw for raw 0..253, 254=Cxfe_Init (CM_BMC_CMC_Zellspannung_05_Messzeit_Cxfe_Init), 255=Cxff_Fehler (CM_BMC_CMC_Zellspannung_05_Messzeit_Cxff_Fehler); unit Unit_None}, range phys 0..253 Unit_None, raw 0..255, unit=Unit_None, transfer-property=PENDING  # Messzeit zu Botschaft BMC_CMC_Zellspannung_05
      frame BMC_HV_01_SOK_XIX_HCP5_CANFD01: id 0x113, from BMC_HV, frame-length=20, can-addressing-mode=STANDARD, can-frame-rx-behavior=CAN-FD, can-frame-tx-behavior=CAN-FD
        secured i pdu BMC_HV_01_E2E_SOK_XIX_HCP5_CANFD01:
          length=20
          authentication-props=SecureCommunicationAuthenticationProps_XIX_32
          freshness-props=SecureCommunicationFreshnessProps
          payload=PT_BMC_HV_01_E2E
          secure-communication-props={auth-data-freshness-length=0, auth-data-freshness-start-position=0, auth-info-tx-length=32, authentication-build-attempts=1, authentication-retries=4, data-id=533, freshness-value-id=0, freshness-value-length=64, freshness-value-tx-length=0}
          use-as-cryptographic-i-pdu=false
      frame BMC_HV_02_SOK_XIX_HCP5_CANFD01: id 0x12DD5514, from BMC_HV, frame-length=48, can-addressing-mode=EXTENDED, can-frame-rx-behavior=CAN-FD, can-frame-tx-behavior=CAN-FD
        secured i pdu BMC_HV_02_E2E_SOK_XIX_HCP5_CANFD01:
          length=48
          authentication-props=SecureCommunicationAuthenticationProps_XIX_32
          freshness-props=SecureCommunicationFreshnessProps
          payload=PT_BMC_HV_02_E2E
          secure-communication-props={auth-data-freshness-length=0, auth-data-freshness-start-position=0, auth-info-tx-length=32, authentication-build-attempts=1, authentication-retries=4, data-id=534, freshness-value-id=1, freshness-value-length=64, freshness-value-tx-length=0}
          use-as-cryptographic-i-pdu=false
