[part 1 of 12: package /E3_1_2_Premium]
AUTOSAR XML (schema 4-3-0)
standard types defined: sint8, sint16, sint32, sint64, uint8, uint16, uint32, uint64, float32, float64, boolean
package /E3_1_2_Premium
  system System: pnc-vector-length=7, pnc-vector-offset=1
    system mapping System_Mappings
      data-mappings:
        sender-receiver-to-signal-mapping={communication-direction=OUT, data-element=Infrastructure_Hybrid_01_XIX_network_infrastructure_XIX_BMC_HV.Geltungsbereich_E3_1_2_Premium.SP_IF_KN_Hybrid_01_ECUKnockOutTimer_XIX_Infrastructure_Hybrid_01_XIX_network_infrastructure_XIX_BMC_HV.DE_KN_Hybrid_01_ECUKnockOutTimer, system-signal=KN_Hybrid_01_ECUKnockOutTimer}
        sender-receiver-to-signal-mapping={communication-direction=OUT, data-element=Infrastructure_Hybrid_01_XIX_network_infrastructure_XIX_BMC_HV.Geltungsbereich_E3_1_2_Premium.SP_IF_NM_Hybrid_01_FCIB_XIX_Infrastructure_Hybrid_01_XIX_network_infrastructure_XIX_BMC_HV.DE_NM_Hybrid_01_FCIB, system-signal=NM_Hybrid_01_FCIB}
        sender-receiver-to-signal-mapping={communication-direction=OUT, data-element=Infrastructure_Hybrid_01_XIX_network_infrastructure_XIX_BMC_HV.Geltungsbereich_E3_1_2_Premium.SP_IF_KN_Hybrid_01_BusKnockOut_XIX_Infrastructure_Hybrid_01_XIX_network_infrastructure_XIX_BMC_HV.DE_KN_Hybrid_01_BusKnockOut, system-signal=KN_Hybrid_01_BusKnockOut}
        sender-receiver-to-signal-mapping={communication-direction=OUT, data-element=Infrastructure_Hybrid_01_XIX_network_infrastructure_XIX_BMC_HV.Geltungsbereich_E3_1_2_Premium.SP_IF_KN_Hybrid_01_ECUKnockOut_XIX_Infrastructure_Hybrid_01_XIX_network_infrastructure_XIX_BMC_HV.DE_KN_Hybrid_01_ECUKnockOut, system-signal=KN_Hybrid_01_ECUKnockOut}
        sender-receiver-to-signal-mapping={communication-direction=OUT, data-element=Infrastructure_Hybrid_01_XIX_network_infrastructure_XIX_BMC_HV.Geltungsbereich_E3_1_2_Premium.SP_IF_KN_Hybrid_01_BusKnockOutTimer_XIX_Infrastructure_Hybrid_01_XIX_network_infrastructure_XIX_BMC_HV.DE_KN_Hybrid_01_BusKnockOutTimer, system-signal=KN_Hybrid_01_BusKnockOutTimer}
        sender-receiver-to-signal-mapping={communication-direction=OUT, data-element=Infrastructure_Hybrid_01_XIX_network_infrastructure_XIX_BMC_HV.Geltungsbereich_E3_1_2_Premium.SP_IF_NM_Hybrid_01_FCAB_XIX_Infrastructure_Hybrid_01_XIX_network_infrastructure_XIX_BMC_HV.DE_NM_Hybrid_01_FCAB, system-signal=NM_Hybrid_01_FCAB}
        sender-receiver-to-signal-mapping={communication-direction=OUT, data-element=Infrastructure_Hybrid_01_XIX_network_infrastructure_XIX_BMC_HV.Geltungsbereich_E3_1_2_Premium.SP_IF_NM_Hybrid_01_NM_aktiv_Diag_XIX_Infrastructure_Hybrid_01_XIX_network_infrastructure_XIX_BMC_HV.DE_NM_Hybrid_01_NM_aktiv_Diag, system-signal=NM_Hybrid_01_NM_aktiv_Diag}
        sender-receiver-to-signal-mapping={communication-direction=OUT, data-element=Infrastructure_Hybrid_01_XIX_network_infrastructure_XIX_BMC_HV.Geltungsbereich_E3_1_2_Premium.SP_IF_NM_Hybrid_01_UDS_CC_XIX_Infrastructure_Hybrid_01_XIX_network_infrastructure_XIX_BMC_HV.DE_NM_Hybrid_01_UDS_CC, system-signal=NM_Hybrid_01_UDS_CC}
        sender-receiver-to-signal-mapping={communication-direction=OUT, data-element=Infrastructure_Hybrid_01_XIX_network_infrastructure_XIX_BMC_HV.Geltungsbereich_E3_1_2_Premium.SP_IF_NM_Hybrid_01_NM_State_XIX_Infrastructure_Hybrid_01_XIX_network_infrastructure_XIX_BMC_HV.DE_NM_Hybrid_01_NM_State, system-signal=NM_Hybrid_01_NM_State}
        sender-receiver-to-signal-mapping={communication-direction=OUT, data-element=Infrastructure_Hybrid_01_XIX_network_infrastructure_XIX_BMC_HV.Geltungsbereich_E3_1_2_Premium.SP_IF_NM_Hybrid_01_CBV_CRI_XIX_Infrastructure_Hybrid_01_XIX_network_infrastructure_XIX_BMC_HV.DE_NM_Hybrid_01_CBV_CRI, system-signal=NM_Hybrid_01_CBV_CRI}
        sender-receiver-to-signal-mapping={communication-direction=OUT, data-element=Infrastructure_Hybrid_01_XIX_network_infrastructure_XIX_BMC_HV.Geltungsbereich_E3_1_2_Premium.SP_IF_NM_Hybrid_01_NM_aktiv_Tmin_XIX_Infrastructure_Hybrid_01_XIX_network_infrastructure_XIX_BMC_HV.DE_NM_Hybrid_01_NM_aktiv_Tmin, system-signal=NM_Hybrid_01_NM_aktiv_Tmin}
        sender-receiver-to-signal-mapping={communication-direction=IN, data-element=Infrastructure_Hybrid_01_XIX_network_infrastructure_XIX_BMC_HV.Geltungsbereich_E3_1_2_Premium.RP_IF_KST_KL_15_XIX_Infrastructure_Hybrid_01_XIX_network_infrastructure_XIX_BMC_HV.DE_KST_KL_15, system-signal=KST_KL_15}
        sender-receiver-to-signal-mapping={communication-direction=OUT, data-element=Infrastructure_Hybrid_01_XIX_network_infrastructure_XIX_BMC_HV.Geltungsbereich_E3_1_2_Premium.SP_IF_NM_Hybrid_01_CBV_AWB_XIX_Infrastructure_Hybrid_01_XIX_network_infrastructure_XIX_BMC_HV.DE_NM_Hybrid_01_CBV_AWB, system-signal=NM_Hybrid_01_CBV_AWB}
        sender-receiver-to-signal-mapping={communication-direction=OUT, data-element=Infrastructure_Hybrid_01_XIX_network_infrastructure_XIX_BMC_HV.Geltungsbereich_E3_1_2_Premium.SP_IF_NM_Hybrid_01_NM_aktiv_KL15_XIX_Infrastructure_Hybrid_01_XIX_network_infrastructure_XIX_BMC_HV.DE_NM_Hybrid_01_NM_aktiv_KL15, system-signal=NM_Hybrid_01_NM_aktiv_KL15}
        sender-receiver-to-signal-mapping={communication-direction=IN, data-element=Infrastructure_Hybrid_01_XIX_network_infrastructure_XIX_BMC_HV.Geltungsbereich_E3_1_2_Premium.RP_IF_DEV_Hybrid_01_Req_00_FD_Data_XIX_Infrastructure_Hybrid_01_XIX_network_infrastructure_XIX_BMC_HV.DE_DEV_Hybrid_01_Req_00_FD_Data, system-signal=DEV_Hybrid_01_Req_00_FD_Data}
        sender-receiver-to-signal-mapping={communication-direction=OUT, data-element=Infrastructure_Hybrid_01_XIX_network_infrastructure_XIX_BMC_HV.Geltungsbereich_E3_1_2_Premium.SP_IF_DEV_Hybrid_01_Resp_FF_FD_Data_XIX_Infrastructure_Hybrid_01_XIX_network_infrastructure_XIX_BMC_HV.DE_DEV_Hybrid_01_Resp_FF_FD_Data, system-signal=DEV_Hybrid_01_Resp_FF_FD_Data}
        sender-receiver-to-signal-mapping={communication-direction=OUT, data-element=Infrastructure_Hybrid_01_XIX_network_infrastructure_XIX_BMC_HV.Geltungsbereich_E3_1_2_Premium.SP_IF_NM_Hybrid_01_SNI_10_XIX_Infrastructure_Hybrid_01_XIX_network_infrastructure_XIX_BMC_HV.DE_NM_Hybrid_01_SNI_10, system-signal=NM_Hybrid_01_SNI_10}
        sender-receiver-to-signal-mapping={communication-direction=IN, data-element=Infrastructure_Hybrid_01_XIX_network_infrastructure_XIX_BMC_HV.Geltungsbereich_E3_1_2_Premium.RP_IF_NVEM_Abschaltstufe_XIX_Infrastructure_Hybrid_01_XIX_network_infrastructure_XIX_BMC_HV.DE_NVEM_Abschaltstufe, system-signal=NVEM_Abschaltstufe}
        sender-receiver-to-signal-mapping={communication-direction=OUT, data-element=Infrastructure_Hybrid_01_XIX_network_infrastructure_XIX_BMC_HV.Geltungsbereich_E3_1_2_Premium.SP_IF_Hybrid_01_Nachlauftyp_XIX_Infrastructure_Hybrid_01_XIX_network_infrastructure_XIX_BMC_HV.DE_Hybrid_01_Nachlauftyp, system-signal=Hybrid_01_Nachlauftyp}
        sender-receiver-to-signal-mapping={communication-direction=OUT, data-element=Infrastructure_Hybrid_01_XIX_network_infrastructure_XIX_BMC_HV.Geltungsbereich_E3_1_2_Premium.SP_IF_NM_Hybrid_01_Wakeup_V12_XIX_Infrastructure_Hybrid_01_XIX_network_infrastructure_XIX_BMC_HV.DE_NM_Hybrid_01_Wakeup_V12, system-signal=NM_Hybrid_01_Wakeup_V12}
        sender-receiver-to-signal-mapping={communication-direction=OUT, data-element=Infrastructure_Hybrid_01_XIX_network_infrastructure_XIX_BMC_HV.Geltungsbereich_E3_1_2_Premium.SP_IF_NM_aktiv_Konditionierungsbedarf_XIX_Infrastructure_Hybrid_01_XIX_network_infrastructure_XIX_BMC_HV.DE_NM_aktiv_Konditionierungsbedarf, system-signal=NM_aktiv_Konditionierungsbedarf}
        sender-receiver-to-signal-mapping={communication-direction=OUT, data-element=Infrastructure_Hybrid_01_XIX_network_infrastructure_XIX_BMC_HV.Geltungsbereich_E3_1_2_Premium.SP_IF_NM_Hybrid_01_CAB_V12_XIX_Infrastructure_Hybrid_01_XIX_network_infrastructure_XIX_BMC_HV.DE_NM_Hybrid_01_CAB_V12, system-signal=NM_Hybrid_01_CAB_V12}
        sender-receiver-to-signal-mapping={communication-direction=IN, data-element=Infrastructure_Hybrid_01_XIX_network_infrastructure_XIX_BMC_HV.Geltungsbereich_E3_1_2_Premium.RP_IF_SI_NWDF_XIX_Infrastructure_Hybrid_01_XIX_network_infrastructure_XIX_BMC_HV.DE_SI_NWDF, system-signal=SI_NWDF}
        sender-receiver-to-signal-mapping={communication-direction=IN, data-element=Infrastructure_Hybrid_01_XIX_network_infrastructure_XIX_BMC_HV.Geltungsbereich_E3_1_2_Premium.RP_IF_SI_NWDF_30_XIX_Infrastructure_Hybrid_01_XIX_network_infrastructure_XIX_BMC_HV.DE_SI_NWDF_30, system-signal=SI_NWDF_30}
        sender-receiver-to-signal-mapping={communication-direction=OUT, data-element=Infrastructure_Hybrid_01_XIX_network_infrastructure_XIX_BMC_HV.Geltungsbereich_E3_1_2_Premium.SP_IF_NM_Hybrid_01_Lokalaktiv_XIX_Infrastructure_Hybrid_01_XIX_network_infrastructure_XIX_BMC_HV.DE_NM_Hybrid_01_Lokalaktiv, system-signal=NM_Hybrid_01_Lokalaktiv}
        sender-receiver-to-signal-mapping={communication-direction=OUT, data-element=Infrastructure_Hybrid_01_XIX_network_infrastructure_XIX_BMC_HV.Geltungsbereich_E3_1_2_Premium.SP_IF_NM_Hybrid_01_Subsystemaktiv_XIX_Infrastructure_Hybrid_01_XIX_network_infrastructure_XIX_BMC_HV.DE_NM_Hybrid_01_Subsystemaktiv, system-signal=NM_Hybrid_01_Subsystemaktiv}
        sender-receiver-to-signal-mapping={communication-direction=OUT, data-element=Infrastructure_Hybrid_01_XIX_network_infrastructure_XIX_BMC_HV.Geltungsbereich_E3_1_2_Premium.SP_IF_DS_Hybrid_01_Subsystemaktiv_XIX_Infrastructure_Hybrid_01_XIX_network_infrastructure_XIX_BMC_HV.DE_DS_Hybrid_01_Subsystemaktiv, system-signal=DS_Hybrid_01_Subsystemaktiv}
        sender-receiver-to-signal-mapping={communication-direction=OUT, data-element=Infrastructure_Hybrid_01_XIX_network_infrastructure_XIX_BMC_HV.Geltungsbereich_E3_1_2_Premium.SP_IF_DS_Hybrid_01_Lokalaktiv_XIX_Infrastructure_Hybrid_01_XIX_network_infrastructure_XIX_BMC_HV.DE_DS_Hybrid_01_Lokalaktiv, system-signal=DS_Hybrid_01_Lokalaktiv}
        sender-receiver-to-signal-mapping={communication-direction=OUT, data-element=Infrastructure_Hybrid_01_XIX_network_infrastructure_XIX_BMC_HV.Geltungsbereich_E3_1_2_Premium.SP_IF_NM_aktiv_SubbusSteuerung_BMC_HV_XIX_Infrastructure_Hybrid_01_XIX_network_infrastructure_XIX_BMC_HV.DE_NM_aktiv_SubbusSteuerung_BMC_HV, system-signal=NM_aktiv_SubbusSteuerung_BMC_HV}
        sender-receiver-to-signal-mapping={communication-direction=OUT, data-element=HochvoltBatterieManagement_XIX_SoC_XIX_BMC_HV.Geltungsbereich_E3_1_2_Premium.SP_IF_BMC_Dauer_Ladeleistung_XIX_HochvoltBatterieManagement_XIX_SoC_XIX_BMC_HV.DE_BMC_Dauer_Ladeleistung, system-signal=BMC_Dauer_Ladeleistung}
        sender-receiver-to-signal-mapping={communication-direction=OUT, data-element=HochvoltBatterieManagement_XIX_SoC_XIX_BMC_HV.Geltungsbereich_E3_1_2_Premium.SP_IF_BMC_ThermSpreizung_XIX_HochvoltBatterieManagement_XIX_SoC_XIX_BMC_HV.DE_BMC_ThermSpreizung, system-signal=BMC_ThermSpreizung}
        sender-receiver-to-signal-mapping={communication-direction=OUT, data-element=HochvoltBatterieManagement_XIX_SoC_XIX_BMC_HV.Geltungsbereich_E3_1_2_Premium.SP_IF_BMC_Bank_parallel_erlaubt_XIX_HochvoltBatterieManagement_XIX_SoC_XIX_BMC_HV.DE_BMC_Bank_parallel_erlaubt, system-signal=BMC_Bank_parallel_erlaubt}
        sender-receiver-to-signal-mapping={communication-direction=OUT, data-element=HochvoltBatterieManagement_XIX_SoC_XIX_BMC_HV.Geltungsbereich_E3_1_2_Premium.SP_IF_BMC_Bankstatus_XIX_HochvoltBatterieManagement_XIX_SoC_XIX_BMC_HV.DE_BMC_Bankstatus, system-signal=BMC_Bankstatus}
        sender-receiver-to-signal-mapping={communication-direction=OUT, data-element=HochvoltBatterieManagement_XIX_SoC_XIX_BMC_HV.Geltungsbereich_E3_1_2_Premium.SP_IF_BMC_Spannung_XIX_HochvoltBatterieManagement_XIX_SoC_XIX_BMC_HV.DE_BMC_Spannung, system-signal=BMC_Spannung}
        sender-receiver-to-signal-mapping={communication-direction=OUT, data-element=HochvoltBatterieManagement_XIX_SoC_XIX_BMC_HV.Geltungsbereich_E3_1_2_Premium.SP_IF_BMC_Temperatur_XIX_HochvoltBatterieManagement_XIX_SoC_XIX_BMC_HV.DE_BMC_Temperatur, system-signal=BMC_Temperatur}
        sender-receiver-to-signal-mapping={communication-direction=OUT, data-element=HochvoltBatterieManagement_XIX_SoC_XIX_BMC_HV.Geltungsbereich_E3_1_2_Premium.SP_IF_BMC_RuecklaufTemperatur_XIX_HochvoltBatterieManagement_XIX_SoC_XIX_BMC_HV.DE_BMC_RuecklaufTemperatur, system-signal=BMC_RuecklaufTemperatur}
        sender-receiver-to-signal-mapping={communication-direction=OUT, data-element=HochvoltBatterieManagement_XIX_SoC_XIX_BMC_HV.Geltungsbereich_E3_1_2_Premium.SP_IF_BMC_VorlaufTemperatur_XIX_HochvoltBatterieManagement_XIX_SoC_XIX_BMC_HV.DE_BMC_VorlaufTemperatur, system-signal=BMC_VorlaufTemperatur}
        sender-receiver-to-signal-mapping={communication-direction=OUT, data-element=HochvoltBatterieManagement_XIX_SoC_XIX_BMC_HV.Geltungsbereich_E3_1_2_Premium.SP_IF_BMC_ThermAuslastung_XIX_HochvoltBatterieManagement_XIX_SoC_XIX_BMC_HV.DE_BMC_ThermAuslastung, system-signal=BMC_ThermAuslastung}
        sender-receiver-to-signal-mapping={communication-direction=OUT, data-element=HochvoltBatterieManagement_XIX_SoC_XIX_BMC_HV.Geltungsbereich_E3_1_2_Premium.SP_IF_BMC_Bank_Notlauf_erlaubt_XIX_HochvoltBatterieManagement_XIX_SoC_XIX_BMC_HV.DE_BMC_Bank_Notlauf_erlaubt, system-signal=BMC_Bank_Notlauf_erlaubt}
        sender-receiver-to-signal-mapping={communication-direction=OUT, data-element=HochvoltBatterieManagement_XIX_SoC_XIX_BMC_HV.Geltungsbereich_E3_1_2_Premium.SP_IF_BMC_Bank_seriell_erlaubt_XIX_HochvoltBatterieManagement_XIX_SoC_XIX_BMC_HV.DE_BMC_Bank_seriell_erlaubt, system-signal=BMC_Bank_seriell_erlaubt}
        sender-receiver-to-signal-mapping={communication-direction=OUT, data-element=HochvoltBatterieManagement_XIX_SoC_XIX_BMC_HV.Geltungsbereich_E3_1_2_Premium.SP_IF_BMC_Dauer_Entladeleistung_XIX_HochvoltBatterieManagement_XIX_SoC_XIX_BMC_HV.DE_BMC_Dauer_Entladeleistung, system-signal=BMC_Dauer_Entladeleistung}
        sender-receiver-to-signal-mapping={communication-direction=OUT, data-element=HochvoltBatterieManagement_XIX_SoC_XIX_BMC_HV.Geltungsbereich_E3_1_2_Premium.SP_IF_BMC_NutzbareKapazitaet_XIX_HochvoltBatterieManagement_XIX_SoC_XIX_BMC_HV.DE_BMC_NutzbareKapazitaet, system-signal=BMC_NutzbareKapazitaet}
        sender-receiver-to-signal-mapping={communication-direction=IN, data-element=HochvoltBatterieManagement_XIX_SoC_XIX_BMC_HV.Geltungsbereich_E3_1_2_Premium.RP_IF_CHA_ReqPrgBms_XIX_HochvoltBatterieManagement_XIX_SoC_XIX_BMC_HV.DE_CHA_ReqPrgBms, system-signal=CHA_ReqPrgBms}
        sender-receiver-to-signal-mapping={communication-direction=OUT, data-element=HochvoltBatterieManagement_XIX_SoC_XIX_BMC_HV.Geltungsbereich_E3_1_2_Premium.SP_IF_BMC_PerfInd_Laden_XIX_HochvoltBatterieManagement_XIX_SoC_XIX_BMC_HV.DE_BMC_PerfInd_Laden, system-signal=BMC_PerfInd_Laden}
        sender-receiver-to-signal-mapping={communication-direction=OUT, data-element=HochvoltBatterieManagement_XIX_SoC_XIX_BMC_HV.Geltungsbereich_E3_1_2_Premium.SP_IF_BMC_Max_Entladeleistung_XIX_HochvoltBatterieManagement_XIX_SoC_XIX_BMC_HV.DE_BMC_Max_Entladeleistung, system-signal=BMC_Max_Entladeleistung}
        sender-receiver-to-signal-mapping={communication-direction=OUT, data-element=HochvoltBatterieManagement_XIX_SoC_XIX_BMC_HV.Geltungsbereich_E3_1_2_Premium.SP_IF_BMC_Energieinhalt_XIX_HochvoltBatterieManagement_XIX_SoC_XIX_BMC_HV.DE_BMC_Energieinhalt, system-signal=BMC_Energieinhalt}
        sender-receiver-to-signal-mapping={communication-direction=OUT, data-element=HochvoltBatterieManagement_XIX_SoC_XIX_BMC_HV.Geltungsbereich_E3_1_2_Premium.SP_IF_BMC_Spannung_ZwischenKreis_XIX_HochvoltBatterieManagement_XIX_SoC_XIX_BMC_HV.DE_BMC_Spannung_ZwischenKreis, system-signal=BMC_Spannung_ZwischenKreis}
        sender-receiver-to-signal-mapping={communication-direction=OUT, data-element=HochvoltBatterieManagement_XIX_SoC_XIX_BMC_HV.Geltungsbereich_E3_1_2_Premium.SP_IF_BMC_VerlustEnergie_XIX_HochvoltBatterieManagement_XIX_SoC_XIX_BMC_HV.DE_BMC_VerlustEnergie, system-signal=BMC_VerlustEnergie}
        sender-receiver-to-signal-mapping={communication-direction=OUT, data-element=HochvoltBatterieManagement_XIX_SoC_XIX_BMC_HV.Geltungsbereich_E3_1_2_Premium.SP_IF_BMC_Max_Ladeleistung_XIX_HochvoltBatterieManagement_XIX_SoC_XIX_BMC_HV.DE_BMC_Max_Ladeleistung, system-signal=BMC_Max_Ladeleistung}
        sender-receiver-to-signal-mapping={communication-direction=OUT, data-element=HochvoltBatterieManagement_XIX_SoC_XIX_BMC_HV.Geltungsbereich_E3_1_2_Premium.SP_IF_BMC_NutzbarerSOC_XIX_HochvoltBatterieManagement_XIX_SoC_XIX_BMC_HV.DE_BMC_NutzbarerSOC, system-signal=BMC_NutzbarerSOC}
        sender-receiver-to-signal-mapping={communication-direction=OUT, data-element=HochvoltBatterieManagement_XIX_SoC_XIX_BMC_HV.Geltungsbereich_E3_1_2_Premium.SP_IF_BMC_Strom_XIX_HochvoltBatterieManagement_XIX_SoC_XIX_BMC_HV.DE_BMC_Strom, system-signal=BMC_Strom}
        sender-receiver-to-signal-mapping={communication-direction=OUT, data-element=HochvoltBatterieManagement_XIX_SoC_XIX_BMC_HV.Geltungsbereich_E3_1_2_Premium.SP_IF_BMC_MaxEnergieinhalt_XIX_HochvoltBatterieManagement_XIX_SoC_XIX_BMC_HV.DE_BMC_MaxEnergieinhalt, system-signal=BMC_MaxEnergieinhalt}
        sender-receiver-to-signal-mapping={communication-direction=OUT, data-element=HochvoltBatterieManagement_XIX_SoC_XIX_BMC_HV.Geltungsbereich_E3_1_2_Premium.SP_IF_BMC_PerfInd_Entladen_XIX_HochvoltBatterieManagement_XIX_SoC_XIX_BMC_HV.DE_BMC_PerfInd_Entladen, system-signal=BMC_PerfInd_Entladen}
        sender-receiver-to-signal-mapping={communication-direction=OUT, data-element=HochvoltBatterieManagement_XIX_SoC_XIX_BMC_HV.Geltungsbereich_E3_1_2_Premium.SP_IF_BMC_Spannung_ZwischenKreis_2_XIX_HochvoltBatterieManagement_XIX_SoC_XIX_BMC_HV.DE_BMC_Spannung_ZwischenKreis_2, system-signal=BMC_Spannung_ZwischenKreis_2}
        sender-receiver-to-signal-mapping={communication-direction=IN, data-element=HochvoltBatterieManagement_XIX_SoC_XIX_BMC_HV.Geltungsbereich_E3_1_2_Premium.RP_IF_KST_KL_15_XIX_HochvoltBatterieManagement_XIX_SoC_XIX_BMC_HV.DE_KST_KL_15, system-signal=KST_KL_15}
        sender-receiver-to-signal-mapping={communication-direction=IN, data-element=HochvoltBatterieManagement_XIX_SoC_XIX_BMC_HV.Geltungsbereich_E3_1_2_Premium.RP_IF_UH_Jahr_XIX_HochvoltBatterieManagement_XIX_SoC_XIX_BMC_HV.DE_UH_Jahr, system-signal=UH_Jahr}
        sender-receiver-to-signal-mapping={communication-direction=IN, data-element=HochvoltBatterieManagement_XIX_SoC_XIX_BMC_HV.Geltungsbereich_E3_1_2_Premium.RP_IF_UH_Minute_XIX_HochvoltBatterieManagement_XIX_SoC_XIX_BMC_HV.DE_UH_Minute, system-signal=UH_Minute}
        sender-receiver-to-signal-mapping={communication-direction=IN, data-element=HochvoltBatterieManagement_XIX_SoC_XIX_BMC_HV.Geltungsbereich_E3_1_2_Premium.RP_IF_UH_Sekunde_XIX_HochvoltBatterieManagement_XIX_SoC_XIX_BMC_HV.DE_UH_Sekunde, system-signal=UH_Sekunde}
        sender-receiver-to-signal-mapping={communication-direction=IN, data-element=HochvoltBatterieManagement_XIX_SoC_XIX_BMC_HV.Geltungsbereich_E3_1_2_Premium.RP_IF_UH_Stunde_XIX_HochvoltBatterieManagement_XIX_SoC_XIX_BMC_HV.DE_UH_Stunde, system-signal=UH_Stunde}
        sender-receiver-to-signal-mapping={communication-direction=IN, data-element=HochvoltBatterieManagement_XIX_SoC_XIX_BMC_HV.Geltungsbereich_E3_1_2_Premium.RP_IF_UH_Tag_XIX_HochvoltBatterieManagement_XIX_SoC_XIX_BMC_HV.DE_UH_Tag, system-signal=UH_Tag}
        sender-receiver-to-signal-mapping={communication-direction=IN, data-element=HochvoltBatterieManagement_XIX_SoC_XIX_BMC_HV.Geltungsbereich_E3_1_2_Premium.RP_IF_UH_Monat_XIX_HochvoltBatterieManagement_XIX_SoC_XIX_BMC_HV.DE_UH_Monat, system-signal=UH_Monat}
        sender-receiver-to-signal-mapping={communication-direction=OUT, data-element=HochvoltBatterieManagement_XIX_SoC_XIX_BMC_HV.Geltungsbereich_E3_1_2_Premium.SP_IF_BMC_Spannung_DC_Ladesaeule_XIX_HochvoltBatterieManagement_XIX_SoC_XIX_BMC_HV.DE_BMC_Spannung_DC_Ladesaeule, system-signal=BMC_Spannung_DC_Ladesaeule}
        sender-receiver-to-signal-mapping={communication-direction=IN, data-element=HochvoltBatterieManagement_XIX_SoC_XIX_BMC_HV.Geltungsbereich_E3_1_2_Premium.RP_IF_UI1_Stromintegral_Laden_XIX_HochvoltBatterieManagement_XIX_SoC_XIX_BMC_HV.DE_UI1_Stromintegral_Laden, system-signal=UI1_Stromintegral_Laden}
        sender-receiver-to-signal-mapping={communication-direction=IN, data-element=HochvoltBatterieManagement_XIX_SoC_XIX_BMC_HV.Geltungsbereich_E3_1_2_Premium.RP_IF_UI1_Spannung6_XIX_HochvoltBatterieManagement_XIX_SoC_XIX_BMC_HV.DE_UI1_Spannung6, system-signal=UI1_Spannung6}
        sender-receiver-to-signal-mapping={communication-direction=IN, data-element=HochvoltBatterieManagement_XIX_SoC_XIX_BMC_HV.Geltungsbereich_E3_1_2_Premium.RP_IF_UI1_Temperatur_1_XIX_HochvoltBatterieManagement_XIX_SoC_XIX_BMC_HV.DE_UI1_Temperatur_1, system-signal=UI1_Temperatur_1}
        sender-receiver-to-signal-mapping={communication-direction=IN, data-element=HochvoltBatterieManagement_XIX_SoC_XIX_BMC_HV.Geltungsbereich_E3_1_2_Premium.RP_IF_UI2_Temperatur_1_XIX_HochvoltBatterieManagement_XIX_SoC_XIX_BMC_HV.DE_UI2_Temperatur_1, system-signal=UI2_Temperatur_1}
        sender-receiver-to-signal-mapping={communication-direction=IN, data-element=HochvoltBatterieManagement_XIX_SoC_XIX_BMC_HV.Geltungsbereich_E3_1_2_Premium.RP_IF_UI1_Iso_Neg_XIX_HochvoltBatterieManagement_XIX_SoC_XIX_BMC_HV.DE_UI1_Iso_Neg, system-signal=UI1_Iso_Neg}
        sender-receiver-to-signal-mapping={communication-direction=IN, data-element=HochvoltBatterieManagement_XIX_SoC_XIX_BMC_HV.Geltungsbereich_E3_1_2_Premium.RP_IF_UI2_Stromintegral_Laden_XIX_HochvoltBatterieManagement_XIX_SoC_XIX_BMC_HV.DE_UI2_Stromintegral_Laden, system-signal=UI2_Stromintegral_Laden}
        sender-receiver-to-signal-group-mapping={communication-direction=IN, data-element=HochvoltBatterieManagement_XIX_SoC_XIX_BMC_HV.Geltungsbereich_E3_1_2_Premium.RP_IF_SG_UI1_02_XIX_HochvoltBatterieManagement_XIX_SoC_XIX_BMC_HV.DE_SG_UI1_02, signal-group=SG_UI1_02, type-mapping=sender-rec-record-type-mapping=record-element-mappings=[{implementation-record-element=UI1_Spannung3, system-signal=UI1_Spannung3}, {implementation-record-element=UI1_Spannung2_Schalt_Status, system-signal=UI1_Spannung2_Schalt_Status}, {implementation-record-element=UI1_Spannung1, system-signal=UI1_Spannung1}, {implementation-record-element=UI1_Spannung2, system-signal=UI1_Spannung2}, {implementation-record-element=UI1_Spannung1_Schalt_Status, system-signal=UI1_Spannung1_Schalt_Status}, {implementation-record-element=UISensorIso_02_BZ, system-signal=UISensorIso_02_BZ}, {implementation-record-element=UISensorIso_02_CRC, system-signal=UISensorIso_02_CRC}]}
        sender-receiver-to-signal-mapping={communication-direction=IN, data-element=HochvoltBatterieManagement_XIX_SoC_XIX_BMC_HV.Geltungsbereich_E3_1_2_Premium.RP_IF_UI1_Iso_Status_XIX_HochvoltBatterieManagement_XIX_SoC_XIX_BMC_HV.DE_UI1_Iso_Status, system-signal=UI1_Iso_Status}
        sender-receiver-to-signal-group-mapping={communication-direction=IN, data-element=HochvoltBatterieManagement_XIX_SoC_XIX_BMC_HV.Geltungsbereich_E3_1_2_Premium.RP_IF_SG_UI2_02_XIX_HochvoltBatterieManagement_XIX_SoC_XIX_BMC_HV.DE_SG_UI2_02, signal-group=SG_UI2_02, type-mapping=sender-rec-record-type-mapping=record-element-mappings=[{implementation-record-element=UI2_Spannung2_Schalt_Status, system-signal=UI2_Spannung2_Schalt_Status}, {implementation-record-element=UI2_Spannung2, system-signal=UI2_Spannung2}, {implementation-record-element=UI2_Spannung3, system-signal=UI2_Spannung3}, {implementation-record-element=UI2_Spannung1, system-signal=UI2_Spannung1}, {implementation-record-element=UI2_Spannung1_Schalt_Status, system-signal=UI2_Spannung1_Schalt_Status}, {implementation-record-element=UISensorPyro_02_BZ, system-signal=UISensorPyro_02_BZ}, {implementation-record-element=UISensorPyro_02_CRC, system-signal=UISensorPyro_02_CRC}]}
        sender-receiver-to-signal-mapping={communication-direction=IN, data-element=HochvoltBatterieManagement_XIX_SoC_XIX_BMC_HV.Geltungsbereich_E3_1_2_Premium.RP_IF_UI1_Spannung5_XIX_HochvoltBatterieManagement_XIX_SoC_XIX_BMC_HV.DE_UI1_Spannung5, system-signal=UI1_Spannung5}
        sender-receiver-to-signal-mapping={communication-direction=IN, data-element=HochvoltBatterieManagement_XIX_SoC_XIX_BMC_HV.Geltungsbereich_E3_1_2_Premium.RP_IF_UI2_Stromintegral_Entladen_XIX_HochvoltBatterieManagement_XIX_SoC_XIX_BMC_HV.DE_UI2_Stromintegral_Entladen, system-signal=UI2_Stromintegral_Entladen}
        sender-receiver-to-signal-mapping={communication-direction=IN, data-element=HochvoltBatterieManagement_XIX_SoC_XIX_BMC_HV.Geltungsbereich_E3_1_2_Premium.RP_IF_UI1_Iso_Pos_XIX_HochvoltBatterieManagement_XIX_SoC_XIX_BMC_HV.DE_UI1_Iso_Pos, system-signal=UI1_Iso_Pos}
        sender-receiver-to-signal-mapping={communication-direction=IN, data-element=HochvoltBatterieManagement_XIX_SoC_XIX_BMC_HV.Geltungsbereich_E3_1_2_Premium.RP_IF_UI2_Temperatur_2_XIX_HochvoltBatterieManagement_XIX_SoC_XIX_BMC_HV.DE_UI2_Temperatur_2, system-signal=UI2_Temperatur_2}
        sender-receiver-to-signal-mapping={communication-direction=IN, data-element=HochvoltBatterieManagement_XIX_SoC_XIX_BMC_HV.Geltungsbereich_E3_1_2_Premium.RP_IF_UI1_Spannung4_XIX_HochvoltBatterieManagement_XIX_SoC_XIX_BMC_HV.DE_UI1_Spannung4, system-signal=UI1_Spannung4}
        sender-receiver-to-signal-mapping={communication-direction=IN, data-element=HochvoltBatterieManagement_XIX_SoC_XIX_BMC_HV.Geltungsbereich_E3_1_2_Premium.RP_IF_UI1_Stromintegral_Entladen_XIX_HochvoltBatterieManagement_XIX_SoC_XIX_BMC_HV.DE_UI1_Stromintegral_Entladen, system-signal=UI1_Stromintegral_Entladen}
        sender-receiver-to-signal-mapping={communication-direction=IN, data-element=HochvoltBatterieManagement_XIX_SoC_XIX_BMC_HV.Geltungsbereich_E3_1_2_Premium.RP_IF_UI1_Temperatur_2_XIX_HochvoltBatterieManagement_XIX_SoC_XIX_BMC_HV.DE_UI1_Temperatur_2, system-signal=UI1_Temperatur_2}
        sender-receiver-to-signal-mapping={communication-direction=OUT, data-element=HochvoltBatterieManagement_XIX_SoC_XIX_BMC_HV.Geltungsbereich_E3_1_2_Premium.SP_IF_BMC_Iso_Mode_Anf_XIX_HochvoltBatterieManagement_XIX_SoC_XIX_BMC_HV.DE_BMC_Iso_Mode_Anf, system-signal=BMC_Iso_Mode_Anf}
        sender-receiver-to-signal-mapping={communication-direction=OUT, data-element=HochvoltBatterieManagement_XIX_SoC_XIX_BMC_HV.Geltungsbereich_E3_1_2_Premium.SP_IF_BMC_UI1_Spannung1_Schalt_Anf_XIX_HochvoltBatterieManagement_XIX_SoC_XIX_BMC_HV.DE_BMC_UI1_Spannung1_Schalt_Anf, system-signal=BMC_UI1_Spannung1_Schalt_Anf}
        sender-receiver-to-signal-mapping={communication-direction=OUT, data-element=HochvoltBatterieManagement_XIX_SoC_XIX_BMC_HV.Geltungsbereich_E3_1_2_Premium.SP_IF_BMC_UI1_Spannung2_Schalt_Anf_XIX_HochvoltBatterieManagement_XIX_SoC_XIX_BMC_HV.DE_BMC_UI1_Spannung2_Schalt_Anf, system-signal=BMC_UI1_Spannung2_Schalt_Anf}
        sender-receiver-to-signal-mapping={communication-direction=OUT, data-element=HochvoltBatterieManagement_XIX_SoC_XIX_BMC_HV.Geltungsbereich_E3_1_2_Premium.SP_IF_BMC_UI2_Spannung2_Schalt_Anf_XIX_HochvoltBatterieManagement_XIX_SoC_XIX_BMC_HV.DE_BMC_UI2_Spannung2_Schalt_Anf, system-signal=BMC_UI2_Spannung2_Schalt_Anf}
        sender-receiver-to-signal-mapping={communication-direction=OUT, data-element=HochvoltBatterieManagement_XIX_SoC_XIX_BMC_HV.Geltungsbereich_E3_1_2_Premium.SP_IF_BMC_UI2_Spannung1_Schalt_Anf_XIX_HochvoltBatterieManagement_XIX_SoC_XIX_BMC_HV.DE_BMC_UI2_Spannung1_Schalt_Anf, system-signal=BMC_UI2_Spannung1_Schalt_Anf}
        sender-receiver-to-signal-mapping={communication-direction=OUT, data-element=HochvoltBatterieManagement_XIX_SoC_XIX_BMC_HV.Geltungsbereich_E3_1_2_Premium.SP_IF_BMC_Status_DCLS_XIX_HochvoltBatterieManagement_XIX_SoC_XIX_BMC_HV.DE_BMC_Status_DCLS, system-signal=BMC_Status_DCLS}
        sender-receiver-to-signal-mapping={communication-direction=OUT, data-element=HochvoltBatterieManagement_XIX_SoC_XIX_BMC_HV.Geltungsbereich_E3_1_2_Premium.SP_IF_BMC_Max_Ladestrom_XIX_HochvoltBatterieManagement_XIX_SoC_XIX_BMC_HV.DE_BMC_Max_Ladestrom, system-signal=BMC_Max_Ladestrom}
        sender-receiver-to-signal-mapping={communication-direction=OUT, data-element=HochvoltBatterieManagement_XIX_SoC_XIX_BMC_HV.Geltungsbereich_E3_1_2_Premium.SP_IF_BMC_Max_Entladestrom_XIX_HochvoltBatterieManagement_XIX_SoC_XIX_BMC_HV.DE_BMC_Max_Entladestrom, system-signal=BMC_Max_Entladestrom}
        sender-receiver-to-signal-mapping={communication-direction=OUT, data-element=HochvoltBatterieManagement_XIX_SoC_XIX_BMC_HV.Geltungsbereich_E3_1_2_Premium.SP_IF_BMC_Verbrauch_XIX_HochvoltBatterieManagement_XIX_SoC_XIX_BMC_HV.DE_BMC_Verbrauch, system-signal=BMC_Verbrauch}
        sender-receiver-to-signal-mapping={communication-direction=OUT, data-element=HochvoltBatterieManagement_XIX_SoC_XIX_BMC_HV.Geltungsbereich_E3_1_2_Premium.SP_IF_BMC_Rekuperation_Ueberlauf_XIX_HochvoltBatterieManagement_XIX_SoC_XIX_BMC_HV.DE_BMC_Rekuperation_Ueberlauf, system-signal=BMC_Rekuperation_Ueberlauf}
        sender-receiver-to-signal-mapping={communication-direction=OUT, data-element=HochvoltBatterieManagement_XIX_SoC_XIX_BMC_HV.Geltungsbereich_E3_1_2_Premium.SP_IF_BMC_Rekuperation_XIX_HochvoltBatterieManagement_XIX_SoC_XIX_BMC_HV.DE_BMC_Rekuperation, system-signal=BMC_Rekuperation}
        sender-receiver-to-signal-mapping={communication-direction=OUT, data-element=HochvoltBatterieManagement_XIX_SoC_XIX_BMC_HV.Geltungsbereich_E3_1_2_Premium.SP_IF_BMC_Verbrauch_Ueberlauf_XIX_HochvoltBatterieManagement_XIX_SoC_XIX_BMC_HV.DE_BMC_Verbrauch_Ueberlauf, system-signal=BMC_Verbrauch_Ueberlauf}
        sender-receiver-to-signal-mapping={communication-direction=OUT, data-element=HochvoltBatterieManagement_XIX_SoC_XIX_BMC_HV.Geltungsbereich_E3_1_2_Premium.SP_IF_BMC_Min_Spannung_XIX_HochvoltBatterieManagement_XIX_SoC_XIX_BMC_HV.DE_BMC_Min_Spannung, system-signal=BMC_Min_Spannung}
        sender-receiver-to-signal-mapping={communication-direction=OUT, data-element=HochvoltBatterieManagement_XIX_SoC_XIX_BMC_HV.Geltungsbereich_E3_1_2_Premium.SP_IF_BMC_Max_Spannung_XIX_HochvoltBatterieManagement_XIX_SoC_XIX_BMC_HV.DE_BMC_Max_Spannung, system-signal=BMC_Max_Spannung}
        sender-receiver-to-signal-group-mapping={communication-direction=IN, data-element=HochvoltBatterieManagement_XIX_SoC_XIX_BMC_HV.Geltungsbereich_E3_1_2_Premium.RP_IF_SG_UI1_01_XIX_HochvoltBatterieManagement_XIX_SoC_XIX_BMC_HV.DE_SG_UI1_01, signal-group=SG_UI1_01, type-mapping=sender-rec-record-type-mapping=record-element-mappings=[{implementation-record-element=UI1_Strom, system-signal=UI1_Strom}, {implementation-record-element=UI1_KL30_Spannung, system-signal=UI1_KL30_Spannung}, {implementation-record-element=UISensorIso_01_BZ, system-signal=UISensorIso_01_BZ}, {implementation-record-element=UISensorIso_01_CRC, system-signal=UISensorIso_01_CRC}]}
        sender-receiver-to-signal-group-mapping={communication-direction=IN, data-element=HochvoltBatterieManagement_XIX_SoC_XIX_BMC_HV.Geltungsbereich_E3_1_2_Premium.RP_IF_SG_UI2_01_XIX_HochvoltBatterieManagement_XIX_SoC_XIX_BMC_HV.DE_SG_UI2_01, signal-group=SG_UI2_01, type-mapping=sender-rec-record-type-mapping=record-element-mappings=[{implementation-record-element=UI2_Strom, system-signal=UI2_Strom}, {implementation-record-element=UI2_KL30_Spannung, system-signal=UI2_KL30_Spannung}, {implementation-record-element=UISensorPyro_01_BZ, system-signal=UISensorPyro_01_BZ}, {implementation-record-element=UISensorPyro_01_CRC, system-signal=UISensorPyro_01_CRC}]}
        sender-receiver-to-signal-mapping={communication-direction=IN, data-element=HochvoltBatterieManagement_XIX_SoC_XIX_BMC_HV.Geltungsbereich_E3_1_2_Premium.RP_IF_UI2_Status_XIX_HochvoltBatterieManagement_XIX_SoC_XIX_BMC_HV.DE_UI2_Status, system-signal=UI2_Status}
        sender-receiver-to-signal-mapping={communication-direction=IN, data-element=HochvoltBatterieManagement_XIX_SoC_XIX_BMC_HV.Geltungsbereich_E3_1_2_Premium.RP_IF_UI1_KompFehlerModus2_15_XIX_HochvoltBatterieManagement_XIX_SoC_XIX_BMC_HV.DE_UI1_KompFehlerModus2_15, system-signal=UI1_KompFehlerModus2_15}
        sender-receiver-to-signal-mapping={communication-direction=IN, data-element=HochvoltBatterieManagement_XIX_SoC_XIX_BMC_HV.Geltungsbereich_E3_1_2_Premium.RP_IF_UI1_KompFehlerModus2_05_XIX_HochvoltBatterieManagement_XIX_SoC_XIX_BMC_HV.DE_UI1_KompFehlerModus2_05, system-signal=UI1_KompFehlerModus2_05}
        sender-receiver-to-signal-mapping={communication-direction=IN, data-element=HochvoltBatterieManagement_XIX_SoC_XIX_BMC_HV.Geltungsbereich_E3_1_2_Premium.RP_IF_UI1_KompFehlerModus2_14_XIX_HochvoltBatterieManagement_XIX_SoC_XIX_BMC_HV.DE_UI1_KompFehlerModus2_14, system-signal=UI1_KompFehlerModus2_14}
        sender-receiver-to-signal-mapping={communication-direction=IN, data-element=HochvoltBatterieManagement_XIX_SoC_XIX_BMC_HV.Geltungsbereich_E3_1_2_Premium.RP_IF_UI1_KompFehlerModus4_14_XIX_HochvoltBatterieManagement_XIX_SoC_XIX_BMC_HV.DE_UI1_KompFehlerModus4_14, system-signal=UI1_KompFehlerModus4_14}
        sender-receiver-to-signal-mapping={communication-direction=IN, data-element=HochvoltBatterieManagement_XIX_SoC_XIX_BMC_HV.Geltungsbereich_E3_1_2_Premium.RP_IF_UI1_KompFehlerModus2_17_XIX_HochvoltBatterieManagement_XIX_SoC_XIX_BMC_HV.DE_UI1_KompFehlerModus2_17, system-signal=UI1_KompFehlerModus2_17}
        sender-receiver-to-signal-mapping={communication-direction=IN, data-element=HochvoltBatterieManagement_XIX_SoC_XIX_BMC_HV.Geltungsbereich_E3_1_2_Premium.RP_IF_UI1_KompFehlerModus2_01_XIX_HochvoltBatterieManagement_XIX_SoC_XIX_BMC_HV.DE_UI1_KompFehlerModus2_01, system-signal=UI1_KompFehlerModus2_01}
        sender-receiver-to-signal-mapping={communication-direction=IN, data-element=HochvoltBatterieManagement_XIX_SoC_XIX_BMC_HV.Geltungsbereich_E3_1_2_Premium.RP_IF_UI1_KompFehlerModus2_19_XIX_HochvoltBatterieManagement_XIX_SoC_XIX_BMC_HV.DE_UI1_KompFehlerModus2_19, system-signal=UI1_KompFehlerModus2_19}
        sender-receiver-to-signal-mapping={communication-direction=IN, data-element=HochvoltBatterieManagement_XIX_SoC_XIX_BMC_HV.Geltungsbereich_E3_1_2_Premium.RP_IF_UI1_KompFehlerModus2_20_XIX_HochvoltBatterieManagement_XIX_SoC_XIX_BMC_HV.DE_UI1_KompFehlerModus2_20, system-signal=UI1_KompFehlerModus2_20}
        sender-receiver-to-signal-mapping={communication-direction=IN, data-element=HochvoltBatterieManagement_XIX_SoC_XIX_BMC_HV.Geltungsbereich_E3_1_2_Premium.RP_IF_UI1_KompFehlerModus2_13_XIX_HochvoltBatterieManagement_XIX_SoC_XIX_BMC_HV.DE_UI1_KompFehlerModus2_13, system-signal=UI1_KompFehlerModus2_13}
        sender-receiver-to-signal-mapping={communication-direction=IN, data-element=HochvoltBatterieManagement_XIX_SoC_XIX_BMC_HV.Geltungsbereich_E3_1_2_Premium.RP_IF_UI1_KompFehlerModus2_12_XIX_HochvoltBatterieManagement_XIX_SoC_XIX_BMC_HV.DE_UI1_KompFehlerModus2_12, system-signal=UI1_KompFehlerModus2_12}
        sender-receiver-to-signal-mapping={communication-direction=IN, data-element=HochvoltBatterieManagement_XIX_SoC_XIX_BMC_HV.Geltungsbereich_E3_1_2_Premium.RP_IF_UI1_KompFehlerModus2_02_XIX_HochvoltBatterieManagement_XIX_SoC_XIX_BMC_HV.DE_UI1_KompFehlerModus2_02, system-signal=UI1_KompFehlerModus2_02}
        sender-receiver-to-signal-mapping={communication-direction=IN, data-element=HochvoltBatterieManagement_XIX_SoC_XIX_BMC_HV.Geltungsbereich_E3_1_2_Premium.RP_IF_UI1_KompFehlerModus4_05_XIX_HochvoltBatterieManagement_XIX_SoC_XIX_BMC_HV.DE_UI1_KompFehlerModus4_05, system-signal=UI1_KompFehlerModus4_05}
        sender-receiver-to-signal-mapping={communication-direction=IN, data-element=HochvoltBatterieManagement_XIX_SoC_XIX_BMC_HV.Geltungsbereich_E3_1_2_Premium.RP_IF_UI1_KompFehlerModus4_11_XIX_HochvoltBatterieManagement_XIX_SoC_XIX_BMC_HV.DE_UI1_KompFehlerModus4_11, system-signal=UI1_KompFehlerModus4_11}
        sender-receiver-to-signal-mapping={communication-direction=IN, data-element=HochvoltBatterieManagement_XIX_SoC_XIX_BMC_HV.Geltungsbereich_E3_1_2_Premium.RP_IF_UI1_KompFehlerModus4_01_XIX_HochvoltBatterieManagement_XIX_SoC_XIX_BMC_HV.DE_UI1_KompFehlerModus4_01, system-signal=UI1_KompFehlerModus4_01}
        sender-receiver-to-signal-mapping={communication-direction=IN, data-element=HochvoltBatterieManagement_XIX_SoC_XIX_BMC_HV.Geltungsbereich_E3_1_2_Premium.RP_IF_UI1_KompFehlerModus4_08_XIX_HochvoltBatterieManagement_XIX_SoC_XIX_BMC_HV.DE_UI1_KompFehlerModus4_08, system-signal=UI1_KompFehlerModus4_08}
        sender-receiver-to-signal-mapping={communication-direction=IN, data-element=HochvoltBatterieManagement_XIX_SoC_XIX_BMC_HV.Geltungsbereich_E3_1_2_Premium.RP_IF_UI1_KompFehlerModus4_02_XIX_HochvoltBatterieManagement_XIX_SoC_XIX_BMC_HV.DE_UI1_KompFehlerModus4_02, system-signal=UI1_KompFehlerModus4_02}
        sender-receiver-to-signal-mapping={communication-direction=IN, data-element=HochvoltBatterieManagement_XIX_SoC_XIX_BMC_HV.Geltungsbereich_E3_1_2_Premium.RP_IF_UI1_KompFehlerModus2_21_XIX_HochvoltBatterieManagement_XIX_SoC_XIX_BMC_HV.DE_UI1_KompFehlerModus2_21, system-signal=UI1_KompFehlerModus2_21}
        sender-receiver-to-signal-mapping={communication-direction=IN, data-element=HochvoltBatterieManagement_XIX_SoC_XIX_BMC_HV.Geltungsbereich_E3_1_2_Premium.RP_IF_UI1_KompFehlerModus4_09_XIX_HochvoltBatterieManagement_XIX_SoC_XIX_BMC_HV.DE_UI1_KompFehlerModus4_09, system-signal=UI1_KompFehlerModus4_09}
        sender-receiver-to-signal-mapping={communication-direction=IN, data-element=HochvoltBatterieManagement_XIX_SoC_XIX_BMC_HV.Geltungsbereich_E3_1_2_Premium.RP_IF_UI1_KompFehlerModus4_06_XIX_HochvoltBatterieManagement_XIX_SoC_XIX_BMC_HV.DE_UI1_KompFehlerModus4_06, system-signal=UI1_KompFehlerModus4_06}
        sender-receiver-to-signal-mapping={communication-direction=IN, data-element=HochvoltBatterieManagement_XIX_SoC_XIX_BMC_HV.Geltungsbereich_E3_1_2_Premium.RP_IF_UI1_KompFehlerModus4_04_XIX_HochvoltBatterieManagement_XIX_SoC_XIX_BMC_HV.DE_UI1_KompFehlerModus4_04, system-signal=UI1_KompFehlerModus4_04}
        sender-receiver-to-signal-mapping={communication-direction=IN, data-element=HochvoltBatterieManagement_XIX_SoC_XIX_BMC_HV.Geltungsbereich_E3_1_2_Premium.RP_IF_UI1_KompFehlerModus2_18_XIX_HochvoltBatterieManagement_XIX_SoC_XIX_BMC_HV.DE_UI1_KompFehlerModus2_18, system-signal=UI1_KompFehlerModus2_18}
        sender-receiver-to-signal-mapping={communication-direction=IN, data-element=HochvoltBatterieManagement_XIX_SoC_XIX_BMC_HV.Geltungsbereich_E3_1_2_Premium.RP_IF_UI1_KompFehlerModus4_03_XIX_HochvoltBatterieManagement_XIX_SoC_XIX_BMC_HV.DE_UI1_KompFehlerModus4_03, system-signal=UI1_KompFehlerModus4_03}
        sender-receiver-to-signal-mapping={communication-direction=IN, data-element=HochvoltBatterieManagement_XIX_SoC_XIX_BMC_HV.Geltungsbereich_E3_1_2_Premium.RP_IF_UI1_KompFehlerModus4_10_XIX_HochvoltBatterieManagement_XIX_SoC_XIX_BMC_HV.DE_UI1_KompFehlerModus4_10, system-signal=UI1_KompFehlerModus4_10}
        sender-receiver-to-signal-mapping={communication-direction=IN, data-element=HochvoltBatterieManagement_XIX_SoC_XIX_BMC_HV.Geltungsbereich_E3_1_2_Premium.RP_IF_UI1_KompFehlerModus4_15_XIX_HochvoltBatterieManagement_XIX_SoC_XIX_BMC_HV.DE_UI1_KompFehlerModus4_15, system-signal=UI1_KompFehlerModus4_15}
        sender-receiver-to-signal-mapping={communication-direction=IN, data-element=HochvoltBatterieManagement_XIX_SoC_XIX_BMC_HV.Geltungsbereich_E3_1_2_Premium.RP_IF_UI1_KompFehlerModus2_23_XIX_HochvoltBatterieManagement_XIX_SoC_XIX_BMC_HV.DE_UI1_KompFehlerModus2_23, system-signal=UI1_KompFehlerModus2_23}
        sender-receiver-to-signal-mapping={communication-direction=IN, data-element=HochvoltBatterieManagement_XIX_SoC_XIX_BMC_HV.Geltungsbereich_E3_1_2_Premium.RP_IF_UI1_KompFehlerModus4_16_XIX_HochvoltBatterieManagement_XIX_SoC_XIX_BMC_HV.DE_UI1_KompFehlerModus4_16, system-signal=UI1_KompFehlerModus4_16}
        sender-receiver-to-signal-mapping={communication-direction=IN, data-element=HochvoltBatterieManagement_XIX_SoC_XIX_BMC_HV.Geltungsbereich_E3_1_2_Premium.RP_IF_UI1_KompFehlerModus2_11_XIX_HochvoltBatterieManagement_XIX_SoC_XIX_BMC_HV.DE_UI1_KompFehlerModus2_11, system-signal=UI1_KompFehlerModus2_11}
        sender-receiver-to-signal-mapping={communication-direction=IN, data-element=HochvoltBatterieManagement_XIX_SoC_XIX_BMC_HV.Geltungsbereich_E3_1_2_Premium.RP_IF_UI1_KompFehlerModus2_07_XIX_HochvoltBatterieManagement_XIX_SoC_XIX_BMC_HV.DE_UI1_KompFehlerModus2_07, system-signal=UI1_KompFehlerModus2_07}
        sender-receiver-to-signal-mapping={communication-direction=IN, data-element=HochvoltBatterieManagement_XIX_SoC_XIX_BMC_HV.Geltungsbereich_E3_1_2_Premium.RP_IF_UI1_KompFehlerModus2_24_XIX_HochvoltBatterieManagement_XIX_SoC_XIX_BMC_HV.DE_UI1_KompFehlerModus2_24, system-signal=UI1_KompFehlerModus2_24}
        sender-receiver-to-signal-mapping={communication-direction=IN, data-element=HochvoltBatterieManagement_XIX_SoC_XIX_BMC_HV.Geltungsbereich_E3_1_2_Premium.RP_IF_UI1_KompFehlerModus4_13_XIX_HochvoltBatterieManagement_XIX_SoC_XIX_BMC_HV.DE_UI1_KompFehlerModus4_13, system-signal=UI1_KompFehlerModus4_13}
        sender-receiver-to-signal-mapping={communication-direction=IN, data-element=HochvoltBatterieManagement_XIX_SoC_XIX_BMC_HV.Geltungsbereich_E3_1_2_Premium.RP_IF_UI1_KompFehlerModus2_08_XIX_HochvoltBatterieManagement_XIX_SoC_XIX_BMC_HV.DE_UI1_KompFehlerModus2_08, system-signal=UI1_KompFehlerModus2_08}
        sender-receiver-to-signal-mapping={communication-direction=IN, data-element=HochvoltBatterieManagement_XIX_SoC_XIX_BMC_HV.Geltungsbereich_E3_1_2_Premium.RP_IF_UI1_KompFehlerModus4_12_XIX_HochvoltBatterieManagement_XIX_SoC_XIX_BMC_HV.DE_UI1_KompFehlerModus4_12, system-signal=UI1_KompFehlerModus4_12}
        sender-receiver-to-signal-mapping={communication-direction=IN, data-element=HochvoltBatterieManagement_XIX_SoC_XIX_BMC_HV.Geltungsbereich_E3_1_2_Premium.RP_IF_UI1_KompFehlerModus2_04_XIX_HochvoltBatterieManagement_XIX_SoC_XIX_BMC_HV.DE_UI1_KompFehlerModus2_04, system-signal=UI1_KompFehlerModus2_04}
        sender-receiver-to-signal-mapping={communication-direction=IN, data-element=HochvoltBatterieManagement_XIX_SoC_XIX_BMC_HV.Geltungsbereich_E3_1_2_Premium.RP_IF_UI1_KompFehlerModus2_06_XIX_HochvoltBatterieManagement_XIX_SoC_XIX_BMC_HV.DE_UI1_KompFehlerModus2_06, system-signal=UI1_KompFehlerModus2_06}
        sender-receiver-to-signal-mapping={communication-direction=IN, data-element=HochvoltBatterieManagement_XIX_SoC_XIX_BMC_HV.Geltungsbereich_E3_1_2_Premium.RP_IF_UI1_KompFehlerModus2_10_XIX_HochvoltBatterieManagement_XIX_SoC_XIX_BMC_HV.DE_UI1_KompFehlerModus2_10, system-signal=UI1_KompFehlerModus2_10}
        sender-receiver-to-signal-mapping={communication-direction=IN, data-element=HochvoltBatterieManagement_XIX_SoC_XIX_BMC_HV.Geltungsbereich_E3_1_2_Premium.RP_IF_UI1_KompFehlerModus2_09_XIX_HochvoltBatterieManagement_XIX_SoC_XIX_BMC_HV.DE_UI1_KompFehlerModus2_09, system-signal=UI1_KompFehlerModus2_09}
        sender-receiver-to-signal-mapping={communication-direction=IN, data-element=HochvoltBatterieManagement_XIX_SoC_XIX_BMC_HV.Geltungsbereich_E3_1_2_Premium.RP_IF_UI1_KompFehlerModus4_07_XIX_HochvoltBatterieManagement_XIX_SoC_XIX_BMC_HV.DE_UI1_KompFehlerModus4_07, system-signal=UI1_KompFehlerModus4_07}
        sender-receiver-to-signal-mapping={communication-direction=IN, data-element=HochvoltBatterieManagement_XIX_SoC_XIX_BMC_HV.Geltungsbereich_E3_1_2_Premium.RP_IF_UI1_KompFehlerModus2_03_XIX_HochvoltBatterieManagement_XIX_SoC_XIX_BMC_HV.DE_UI1_KompFehlerModus2_03, system-signal=UI1_KompFehlerModus2_03}
        sender-receiver-to-signal-mapping={communication-direction=IN, data-element=HochvoltBatterieManagement_XIX_SoC_XIX_BMC_HV.Geltungsbereich_E3_1_2_Premium.RP_IF_UI1_KompFehlerModus2_16_XIX_HochvoltBatterieManagement_XIX_SoC_XIX_BMC_HV.DE_UI1_KompFehlerModus2_16, system-signal=UI1_KompFehlerModus2_16}
        sender-receiver-to-signal-mapping={communication-direction=IN, data-element=HochvoltBatterieManagement_XIX_SoC_XIX_BMC_HV.Geltungsbereich_E3_1_2_Premium.RP_IF_UI1_KompFehlerModus2_22_XIX_HochvoltBatterieManagement_XIX_SoC_XIX_BMC_HV.DE_UI1_KompFehlerModus2_22, system-signal=UI1_KompFehlerModus2_22}
        sender-receiver-to-signal-mapping={communication-direction=IN, data-element=HochvoltBatterieManagement_XIX_SoC_XIX_BMC_HV.Geltungsbereich_E3_1_2_Premium.RP_IF_UI2_KompFehlerModus2_01_XIX_HochvoltBatterieManagement_XIX_SoC_XIX_BMC_HV.DE_UI2_KompFehlerModus2_01, system-signal=UI2_KompFehlerModus2_01}
        sender-receiver-to-signal-mapping={communication-direction=IN, data-element=HochvoltBatterieManagement_XIX_SoC_XIX_BMC_HV.Geltungsbereich_E3_1_2_Premium.RP_IF_UI2_KompFehlerModus2_19_XIX_HochvoltBatterieManagement_XIX_SoC_XIX_BMC_HV.DE_UI2_KompFehlerModus2_19, system-signal=UI2_KompFehlerModus2_19}
        sender-receiver-to-signal-mapping={communication-direction=IN, data-element=HochvoltBatterieManagement_XIX_SoC_XIX_BMC_HV.Geltungsbereich_E3_1_2_Premium.RP_IF_UI2_KompFehlerModus4_09_XIX_HochvoltBatterieManagement_XIX_SoC_XIX_BMC_HV.DE_UI2_KompFehlerModus4_09, system-signal=UI2_KompFehlerModus4_09}
        sender-receiver-to-signal-mapping={communication-direction=IN, data-element=HochvoltBatterieManagement_XIX_SoC_XIX_BMC_HV.Geltungsbereich_E3_1_2_Premium.RP_IF_UI2_KompFehlerModus4_08_XIX_HochvoltBatterieManagement_XIX_SoC_XIX_BMC_HV.DE_UI2_KompFehlerModus4_08, system-signal=UI2_KompFehlerModus4_08}
        sender-receiver-to-signal-mapping={communication-direction=IN, data-element=HochvoltBatterieManagement_XIX_SoC_XIX_BMC_HV.Geltungsbereich_E3_1_2_Premium.RP_IF_UI2_KompFehlerModus4_07_XIX_HochvoltBatterieManagement_XIX_SoC_XIX_BMC_HV.DE_UI2_KompFehlerModus4_07, system-signal=UI2_KompFehlerModus4_07}
        sender-receiver-to-signal-mapping={communication-direction=IN, data-element=HochvoltBatterieManagement_XIX_SoC_XIX_BMC_HV.Geltungsbereich_E3_1_2_Premium.RP_IF_UI2_KompFehlerModus2_02_XIX_HochvoltBatterieManagement_XIX_SoC_XIX_BMC_HV.DE_UI2_KompFehlerModus2_02, system-signal=UI2_KompFehlerModus2_02}
        sender-receiver-to-signal-mapping={communication-direction=IN, data-element=HochvoltBatterieManagement_XIX_SoC_XIX_BMC_HV.Geltungsbereich_E3_1_2_Premium.RP_IF_UI2_KompFehlerModus4_05_XIX_HochvoltBatterieManagement_XIX_SoC_XIX_BMC_HV.DE_UI2_KompFehlerModus4_05, system-signal=UI2_KompFehlerModus4_05}
        sender-receiver-to-signal-mapping={communication-direction=IN, data-element=HochvoltBatterieManagement_XIX_SoC_XIX_BMC_HV.Geltungsbereich_E3_1_2_Premium.RP_IF_UI2_KompFehlerModus4_01_XIX_HochvoltBatterieManagement_XIX_SoC_XIX_BMC_HV.DE_UI2_KompFehlerModus4_01, system-signal=UI2_KompFehlerModus4_01}
        sender-receiver-to-signal-mapping={communication-direction=IN, data-element=HochvoltBatterieManagement_XIX_SoC_XIX_BMC_HV.Geltungsbereich_E3_1_2_Premium.RP_IF_UI2_KompFehlerModus2_13_XIX_HochvoltBatterieManagement_XIX_SoC_XIX_BMC_HV.DE_UI2_KompFehlerModus2_13, system-signal=UI2_KompFehlerModus2_13}
        sender-receiver-to-signal-mapping={communication-direction=IN, data-element=HochvoltBatterieManagement_XIX_SoC_XIX_BMC_HV.Geltungsbereich_E3_1_2_Premium.RP_IF_UI2_KompFehlerModus2_24_XIX_HochvoltBatterieManagement_XIX_SoC_XIX_BMC_HV.DE_UI2_KompFehlerModus2_24, system-signal=UI2_KompFehlerModus2_24}
        sender-receiver-to-signal-mapping={communication-direction=IN, data-element=HochvoltBatterieManagement_XIX_SoC_XIX_BMC_HV.Geltungsbereich_E3_1_2_Premium.RP_IF_UI2_KompFehlerModus2_07_XIX_HochvoltBatterieManagement_XIX_SoC_XIX_BMC_HV.DE_UI2_KompFehlerModus2_07, system-signal=UI2_KompFehlerModus2_07}
        sender-receiver-to-signal-mapping={communication-direction=IN, data-element=HochvoltBatterieManagement_XIX_SoC_XIX_BMC_HV.Geltungsbereich_E3_1_2_Premium.RP_IF_UI2_KompFehlerModus2_10_XIX_HochvoltBatterieManagement_XIX_SoC_XIX_BMC_HV.DE_UI2_KompFehlerModus2_10, system-signal=UI2_KompFehlerModus2_10}
        sender-receiver-to-signal-mapping={communication-direction=IN, data-element=HochvoltBatterieManagement_XIX_SoC_XIX_BMC_HV.Geltungsbereich_E3_1_2_Premium.RP_IF_UI2_KompFehlerModus4_06_XIX_HochvoltBatterieManagement_XIX_SoC_XIX_BMC_HV.DE_UI2_KompFehlerModus4_06, system-signal=UI2_KompFehlerModus4_06}
        sender-receiver-to-signal-mapping={communication-direction=IN, data-element=HochvoltBatterieManagement_XIX_SoC_XIX_BMC_HV.Geltungsbereich_E3_1_2_Premium.RP_IF_UI2_KompFehlerModus4_14_XIX_HochvoltBatterieManagement_XIX_SoC_XIX_BMC_HV.DE_UI2_KompFehlerModus4_14, system-signal=UI2_KompFehlerModus4_14}
        sender-receiver-to-signal-mapping={communication-direction=IN, data-element=HochvoltBatterieManagement_XIX_SoC_XIX_BMC_HV.Geltungsbereich_E3_1_2_Premium.RP_IF_UI2_KompFehlerModus2_08_XIX_HochvoltBatterieManagement_XIX_SoC_XIX_BMC_HV.DE_UI2_KompFehlerModus2_08, system-signal=UI2_KompFehlerModus2_08}
        sender-receiver-to-signal-mapping={communication-direction=IN, data-element=HochvoltBatterieManagement_XIX_SoC_XIX_BMC_HV.Geltungsbereich_E3_1_2_Premium.RP_IF_UI2_KompFehlerModus4_12_XIX_HochvoltBatterieManagement_XIX_SoC_XIX_BMC_HV.DE_UI2_KompFehlerModus4_12, system-signal=UI2_KompFehlerModus4_12}
        sender-receiver-to-signal-mapping={communication-direction=IN, data-element=HochvoltBatterieManagement_XIX_SoC_XIX_BMC_HV.Geltungsbereich_E3_1_2_Premium.RP_IF_UI2_KompFehlerModus2_23_XIX_HochvoltBatterieManagement_XIX_SoC_XIX_BMC_HV.DE_UI2_KompFehlerModus2_23, system-signal=UI2_KompFehlerModus2_23}
        sender-receiver-to-signal-mapping={communication-direction=IN, data-element=HochvoltBatterieManagement_XIX_SoC_XIX_BMC_HV.Geltungsbereich_E3_1_2_Premium.RP_IF_UI2_KompFehlerModus2_20_XIX_HochvoltBatterieManagement_XIX_SoC_XIX_BMC_HV.DE_UI2_KompFehlerModus2_20, system-signal=UI2_KompFehlerModus2_20}
        sender-receiver-to-signal-mapping={communication-direction=IN, data-element=HochvoltBatterieManagement_XIX_SoC_XIX_BMC_HV.Geltungsbereich_E3_1_2_Premium.RP_IF_UI2_KompFehlerModus4_03_XIX_HochvoltBatterieManagement_XIX_SoC_XIX_BMC_HV.DE_UI2_KompFehlerModus4_03, system-signal=UI2_KompFehlerModus4_03}
        sender-receiver-to-signal-mapping={communication-direction=IN, data-element=HochvoltBatterieManagement_XIX_SoC_XIX_BMC_HV.Geltungsbereich_E3_1_2_Premium.RP_IF_UI2_KompFehlerModus2_14_XIX_HochvoltBatterieManagement_XIX_SoC_XIX_BMC_HV.DE_UI2_KompFehlerModus2_14, system-signal=UI2_KompFehlerModus2_14}
        sender-receiver-to-signal-mapping={communication-direction=IN, data-element=HochvoltBatterieManagement_XIX_SoC_XIX_BMC_HV.Geltungsbereich_E3_1_2_Premium.RP_IF_UI2_KompFehlerModus4_13_XIX_HochvoltBatterieManagement_XIX_SoC_XIX_BMC_HV.DE_UI2_KompFehlerModus4_13, system-signal=UI2_KompFehlerModus4_13}
        sender-receiver-to-signal-mapping={communication-direction=IN, data-element=HochvoltBatterieManagement_XIX_SoC_XIX_BMC_HV.Geltungsbereich_E3_1_2_Premium.RP_IF_UI2_KompFehlerModus2_06_XIX_HochvoltBatterieManagement_XIX_SoC_XIX_BMC_HV.DE_UI2_KompFehlerModus2_06, system-signal=UI2_KompFehlerModus2_06}
        sender-receiver-to-signal-mapping={communication-direction=IN, data-element=HochvoltBatterieManagement_XIX_SoC_XIX_BMC_HV.Geltungsbereich_E3_1_2_Premium.RP_IF_UI2_KompFehlerModus4_15_XIX_HochvoltBatterieManagement_XIX_SoC_XIX_BMC_HV.DE_UI2_KompFehlerModus4_15, system-signal=UI2_KompFehlerModus4_15}
        sender-receiver-to-signal-mapping={communication-direction=IN, data-element=HochvoltBatterieManagement_XIX_SoC_XIX_BMC_HV.Geltungsbereich_E3_1_2_Premium.RP_IF_UI2_KompFehlerModus2_11_XIX_HochvoltBatterieManagement_XIX_SoC_XIX_BMC_HV.DE_UI2_KompFehlerModus2_11, system-signal=UI2_KompFehlerModus2_11}
        sender-receiver-to-signal-mapping={communication-direction=IN, data-element=HochvoltBatterieManagement_XIX_SoC_XIX_BMC_HV.Geltungsbereich_E3_1_2_Premium.RP_IF_UI2_KompFehlerModus2_04_XIX_HochvoltBatterieManagement_XIX_SoC_XIX_BMC_HV.DE_UI2_KompFehlerModus2_04, system-signal=UI2_KompFehlerModus2_04}
        sender-receiver-to-signal-mapping={communication-direction=IN, data-element=HochvoltBatterieManagement_XIX_SoC_XIX_BMC_HV.Geltungsbereich_E3_1_2_Premium.RP_IF_UI2_KompFehlerModus2_22_XIX_HochvoltBatterieManagement_XIX_SoC_XIX_BMC_HV.DE_UI2_KompFehlerModus2_22, system-signal=UI2_KompFehlerModus2_22}
        sender-receiver-to-signal-mapping={communication-direction=IN, data-element=HochvoltBatterieManagement_XIX_SoC_XIX_BMC_HV.Geltungsbereich_E3_1_2_Premium.RP_IF_UI2_KompFehlerModus2_18_XIX_HochvoltBatterieManagement_XIX_SoC_XIX_BMC_HV.DE_UI2_KompFehlerModus2_18, system-signal=UI2_KompFehlerModus2_18}
        sender-receiver-to-signal-mapping={communication-direction=IN, data-element=HochvoltBatterieManagement_XIX_SoC_XIX_BMC_HV.Geltungsbereich_E3_1_2_Premium.RP_IF_UI2_KompFehlerModus4_16_XIX_HochvoltBatterieManagement_XIX_SoC_XIX_BMC_HV.DE_UI2_KompFehlerModus4_16, system-signal=UI2_KompFehlerModus4_16}
        sender-receiver-to-signal-mapping={communication-direction=IN, data-element=HochvoltBatterieManagement_XIX_SoC_XIX_BMC_HV.Geltungsbereich_E3_1_2_Premium.RP_IF_UI2_KompFehlerModus2_16_XIX_HochvoltBatterieManagement_XIX_SoC_XIX_BMC_HV.DE_UI2_KompFehlerModus2_16, system-signal=UI2_KompFehlerModus2_16}
        sender-receiver-to-signal-mapping={communication-direction=IN, data-element=HochvoltBatterieManagement_XIX_SoC_XIX_BMC_HV.Geltungsbereich_E3_1_2_Premium.RP_IF_UI2_KompFehlerModus2_09_XIX_HochvoltBatterieManagement_XIX_SoC_XIX_BMC_HV.DE_UI2_KompFehlerModus2_09, system-signal=UI2_KompFehlerModus2_09}
        sender-receiver-to-signal-mapping={communication-direction=IN, data-element=HochvoltBatterieManagement_XIX_SoC_XIX_BMC_HV.Geltungsbereich_E3_1_2_Premium.RP_IF_UI2_KompFehlerModus4_11_XIX_HochvoltBatterieManagement_XIX_SoC_XIX_BMC_HV.DE_UI2_KompFehlerModus4_11, system-signal=UI2_KompFehlerModus4_11}
        sender-receiver-to-signal-mapping={communication-direction=IN, data-element=HochvoltBatterieManagement_XIX_SoC_XIX_BMC_HV.Geltungsbereich_E3_1_2_Premium.RP_IF_UI2_KompFehlerModus2_12_XIX_HochvoltBatterieManagement_XIX_SoC_XIX_BMC_HV.DE_UI2_KompFehlerModus2_12, system-signal=UI2_KompFehlerModus2_12}
        sender-receiver-to-signal-mapping={communication-direction=IN, data-element=HochvoltBatterieManagement_XIX_SoC_XIX_BMC_HV.Geltungsbereich_E3_1_2_Premium.RP_IF_UI2_KompFehlerModus2_05_XIX_HochvoltBatterieManagement_XIX_SoC_XIX_BMC_HV.DE_UI2_KompFehlerModus2_05, system-signal=UI2_KompFehlerModus2_05}
        sender-receiver-to-signal-mapping={communication-direction=IN, data-element=HochvoltBatterieManagement_XIX_SoC_XIX_BMC_HV.Geltungsbereich_E3_1_2_Premium.RP_IF_UI2_KompFehlerModus4_04_XIX_HochvoltBatterieManagement_XIX_SoC_XIX_BMC_HV.DE_UI2_KompFehlerModus4_04, system-signal=UI2_KompFehlerModus4_04}
        sender-receiver-to-signal-mapping={communication-direction=IN, data-element=HochvoltBatterieManagement_XIX_SoC_XIX_BMC_HV.Geltungsbereich_E3_1_2_Premium.RP_IF_UI2_KompFehlerModus2_15_XIX_HochvoltBatterieManagement_XIX_SoC_XIX_BMC_HV.DE_UI2_KompFehlerModus2_15, system-signal=UI2_KompFehlerModus2_15}
        sender-receiver-to-signal-mapping={communication-direction=IN, data-element=HochvoltBatterieManagement_XIX_SoC_XIX_BMC_HV.Geltungsbereich_E3_1_2_Premium.RP_IF_UI2_KompFehlerModus4_10_XIX_HochvoltBatterieManagement_XIX_SoC_XIX_BMC_HV.DE_UI2_KompFehlerModus4_10, system-signal=UI2_KompFehlerModus4_10}
        sender-receiver-to-signal-mapping={communication-direction=IN, data-element=HochvoltBatterieManagement_XIX_SoC_XIX_BMC_HV.Geltungsbereich_E3_1_2_Premium.RP_IF_UI2_KompFehlerModus4_02_XIX_HochvoltBatterieManagement_XIX_SoC_XIX_BMC_HV.DE_UI2_KompFehlerModus4_02, system-signal=UI2_KompFehlerModus4_02}
        sender-receiver-to-signal-mapping={communication-direction=IN, data-element=HochvoltBatterieManagement_XIX_SoC_XIX_BMC_HV.Geltungsbereich_E3_1_2_Premium.RP_IF_UI2_KompFehlerModus2_17_XIX_HochvoltBatterieManagement_XIX_SoC_XIX_BMC_HV.DE_UI2_KompFehlerModus2_17, system-signal=UI2_KompFehlerModus2_17}
        sender-receiver-to-signal-mapping={communication-direction=IN, data-element=HochvoltBatterieManagement_XIX_SoC_XIX_BMC_HV.Geltungsbereich_E3_1_2_Premium.RP_IF_UI2_KompFehlerModus2_03_XIX_HochvoltBatterieManagement_XIX_SoC_XIX_BMC_HV.DE_UI2_KompFehlerModus2_03, system-signal=UI2_KompFehlerModus2_03}
        sender-receiver-to-signal-mapping={communication-direction=IN, data-element=HochvoltBatterieManagement_XIX_SoC_XIX_BMC_HV.Geltungsbereich_E3_1_2_Premium.RP_IF_UI2_KompFehlerModus2_21_XIX_HochvoltBatterieManagement_XIX_SoC_XIX_BMC_HV.DE_UI2_KompFehlerModus2_21, system-signal=UI2_KompFehlerModus2_21}
        sender-receiver-to-signal-mapping={communication-direction=IN, data-element=HochvoltBatterieManagement_XIX_SoC_XIX_BMC_HV.Geltungsbereich_E3_1_2_Premium.RP_IF_UI1_Status_XIX_HochvoltBatterieManagement_XIX_SoC_XIX_BMC_HV.DE_UI1_Status, system-signal=UI1_Status}
        sender-receiver-to-signal-mapping={communication-direction=OUT, data-element=HochvoltBatterieManagement_XIX_SoC_XIX_BMC_HV.Geltungsbereich_E3_1_2_Premium.SP_IF_BMC_HV_04_CRC_XIX_HochvoltBatterieManagement_XIX_SoC_XIX_BMC_HV.DE_BMC_HV_04_CRC, system-signal=BMC_HV_04_CRC}
        sender-receiver-to-signal-mapping={communication-direction=OUT, data-element=HochvoltBatterieManagement_XIX_SoC_XIX_BMC_HV.Geltungsbereich_E3_1_2_Premium.SP_IF_BMC_HV_04_BZ_XIX_HochvoltBatterieManagement_XIX_SoC_XIX_BMC_HV.DE_BMC_HV_04_BZ, system-signal=BMC_HV_04_BZ}
        sender-receiver-to-signal-mapping={communication-direction=OUT, data-element=HochvoltBatterieManagement_XIX_SoC_XIX_BMC_HV.Geltungsbereich_E3_1_2_Premium.SP_IF_BMC_HV_01_BZ_XIX_HochvoltBatterieManagement_XIX_SoC_XIX_BMC_HV.DE_BMC_HV_01_BZ, system-signal=BMC_HV_01_BZ}
        sender-receiver-to-signal-mapping={communication-direction=OUT, data-element=HochvoltBatterieManagement_XIX_SoC_XIX_BMC_HV.Geltungsbereich_E3_1_2_Premium.SP_IF_BMC_HV_01_CRC_XIX_HochvoltBatterieManagement_XIX_SoC_XIX_BMC_HV.DE_BMC_HV_01_CRC, system-signal=BMC_HV_01_CRC}
        sender-receiver-to-signal-mapping={communication-direction=OUT, data-element=HochvoltBatterieManagement_XIX_SoC_XIX_BMC_HV.Geltungsbereich_E3_1_2_Premium.SP_IF_BMC_Flash_Freigabe_XIX_HochvoltBatterieManagement_XIX_SoC_XIX_BMC_HV.DE_BMC_Flash_Freigabe, system-signal=BMC_Flash_Freigabe}
        sender-receiver-to-signal-mapping={communication-direction=IN, data-element=HochvoltBatterieManagement_XIX_SoC_XIX_BMC_HV.Geltungsbereich_E3_1_2_Premium.RP_IF_UI1_KompFehlerModus2_25_XIX_HochvoltBatterieManagement_XIX_SoC_XIX_BMC_HV.DE_UI1_KompFehlerModus2_25, system-signal=UI1_KompFehlerModus2_25}
        sender-receiver-to-signal-mapping={communication-direction=IN, data-element=HochvoltBatterieManagement_XIX_SoC_XIX_BMC_HV.Geltungsbereich_E3_1_2_Premium.RP_IF_UI1_KompFehlerModus2_26_XIX_HochvoltBatterieManagement_XIX_SoC_XIX_BMC_HV.DE_UI1_KompFehlerModus2_26, system-signal=UI1_KompFehlerModus2_26}
        sender-receiver-to-signal-mapping={communication-direction=IN, data-element=HochvoltBatterieManagement_XIX_SoC_XIX_BMC_HV.Geltungsbereich_E3_1_2_Premium.RP_IF_UI2_KompFehlerModus2_25_XIX_HochvoltBatterieManagement_XIX_SoC_XIX_BMC_HV.DE_UI2_KompFehlerModus2_25, system-signal=UI2_KompFehlerModus2_25}
        sender-receiver-to-signal-mapping={communication-direction=IN, data-element=HochvoltBatterieManagement_XIX_SoC_XIX_BMC_HV.Geltungsbereich_E3_1_2_Premium.RP_IF_UI2_KompFehlerModus2_26_XIX_HochvoltBatterieManagement_XIX_SoC_XIX_BMC_HV.DE_UI2_KompFehlerModus2_26, system-signal=UI2_KompFehlerModus2_26}
        sender-receiver-to-signal-mapping={communication-direction=OUT, data-element=HochvoltBatterieManagement_XIX_SoC_XIX_BMC_HV.Geltungsbereich_E3_1_2_Premium.SP_IF_BMC_Dev_Freigabe_XIX_HochvoltBatterieManagement_XIX_SoC_XIX_BMC_HV.DE_BMC_Dev_Freigabe, system-signal=BMC_Dev_Freigabe}
        sender-receiver-to-signal-mapping={communication-direction=IN, data-element=HochvoltBatterieManagement_XIX_SoC_XIX_BMC_HV.Geltungsbereich_E3_1_2_Premium.RP_IF_ZM_HV_Auszeit_HiRes_XIX_HochvoltBatterieManagement_XIX_SoC_XIX_BMC_HV.DE_ZM_HV_Auszeit_HiRes, system-signal=ZM_HV_Auszeit_HiRes}
        sender-receiver-to-signal-mapping={communication-direction=OUT, data-element=HochvoltBatterieManagement_XIX_SoC_XIX_BMC_HV.Geltungsbereich_E3_1_2_Premium.SP_IF_BMC_DC_Laden_XIX_HochvoltBatterieManagement_XIX_SoC_XIX_BMC_HV.DE_BMC_DC_Laden, system-signal=BMC_DC_Laden}
        sender-receiver-to-signal-mapping={communication-direction=OUT, data-element=HochvoltBatterieManagement_XIX_SoC_XIX_BMC_HV.Geltungsbereich_E3_1_2_Premium.SP_IF_BMC_AC_Laden_XIX_HochvoltBatterieManagement_XIX_SoC_XIX_BMC_HV.DE_BMC_AC_Laden, system-signal=BMC_AC_Laden}
        sender-receiver-to-signal-mapping={communication-direction=OUT, data-element=HochvoltBatterieManagement_XIX_SoC_XIX_BMC_HV.Geltungsbereich_E3_1_2_Premium.SP_IF_BMC_Verbauinfo_ACSchuetz_XIX_HochvoltBatterieManagement_XIX_SoC_XIX_BMC_HV.DE_BMC_Verbauinfo_ACSchuetz, system-signal=BMC_Verbauinfo_ACSchuetz}
        sender-receiver-to-signal-group-mapping={communication-direction=IN, data-element=HochvoltBatterieManagement_XIX_SoC_XIX_BMC_HV.Geltungsbereich_E3_1_2_Premium.RP_IF_SG_UI2_03_XIX_HochvoltBatterieManagement_XIX_SoC_XIX_BMC_HV.DE_SG_UI2_03, signal-group=SG_UI2_03, type-mapping=sender-rec-record-type-mapping=record-element-mappings=[{implementation-record-element=UI2_Spannung6, system-signal=UI2_Spannung6}, {implementation-record-element=UI2_Spannung5, system-signal=UI2_Spannung5}, {implementation-record-element=UI2_Spannung4, system-signal=UI2_Spannung4}, {implementation-record-element=UISensorPyro_03_BZ, system-signal=UISensorPyro_03_BZ}, {implementation-record-element=UISensorPyro_03_CRC, system-signal=UISensorPyro_03_CRC}, {implementation-record-element=UI2_HW_Crashleitung_Status, system-signal=UI2_HW_Crashleitung_Status}, {implementation-record-element=UI2_Pyro_Status, system-signal=UI2_Pyro_Status}]}
        sender-receiver-to-signal-mapping={communication-direction=OUT, data-element=HochvoltBatterieManagement_XIX_SoC_XIX_BMC_HV.Geltungsbereich_E3_1_2_Premium.SP_IF_BMC_Fehler_Leistungsred_XIX_HochvoltBatterieManagement_XIX_SoC_XIX_BMC_HV.DE_BMC_Fehler_Leistungsred, system-signal=BMC_Fehler_Leistungsred}
        sender-receiver-to-signal-mapping={communication-direction=OUT, data-element=HochvoltBatterieManagement_XIX_SoC_XIX_BMC_HV.Geltungsbereich_E3_1_2_Premium.SP_IF_BMC_Verbauinfo_Bank_XIX_HochvoltBatterieManagement_XIX_SoC_XIX_BMC_HV.DE_BMC_Verbauinfo_Bank, system-signal=BMC_Verbauinfo_Bank}
        sender-receiver-to-signal-mapping={communication-direction=OUT, data-element=HochvoltBatterieManagement_XIX_SoC_XIX_BMC_HV.Geltungsbereich_E3_1_2_Premium.SP_IF_BMC_KundenWarnung_XIX_HochvoltBatterieManagement_XIX_SoC_XIX_BMC_HV.DE_BMC_KundenWarnung, system-signal=BMC_KundenWarnung}
        sender-receiver-to-signal-mapping={communication-direction=OUT, data-element=HochvoltBatterieManagement_XIX_SoC_XIX_BMC_HV.Geltungsbereich_E3_1_2_Premium.SP_IF_BMC_HV_02_BZ_XIX_HochvoltBatterieManagement_XIX_SoC_XIX_BMC_HV.DE_BMC_HV_02_BZ, system-signal=BMC_HV_02_BZ}
        sender-receiver-to-signal-mapping={communication-direction=OUT, data-element=HochvoltBatterieManagement_XIX_SoC_XIX_BMC_HV.Geltungsbereich_E3_1_2_Premium.SP_IF_BMC_Abschaltankuendigung_XIX_HochvoltBatterieManagement_XIX_SoC_XIX_BMC_HV.DE_BMC_Abschaltankuendigung, system-signal=BMC_Abschaltankuendigung}
        sender-receiver-to-signal-mapping={communication-direction=OUT, data-element=HochvoltBatterieManagement_XIX_SoC_XIX_BMC_HV.Geltungsbereich_E3_1_2_Premium.SP_IF_BMC_MinDyn_Entladespannung_XIX_HochvoltBatterieManagement_XIX_SoC_XIX_BMC_HV.DE_BMC_MinDyn_Entladespannung, system-signal=BMC_MinDyn_Entladespannung}
        sender-receiver-to-signal-mapping={communication-direction=OUT, data-element=HochvoltBatterieManagement_XIX_SoC_XIX_BMC_HV.Geltungsbereich_E3_1_2_Premium.SP_IF_BMC_Unterboden_Warnung_XIX_HochvoltBatterieManagement_XIX_SoC_XIX_BMC_HV.DE_BMC_Unterboden_Warnung, system-signal=BMC_Unterboden_Warnung}
        sender-receiver-to-signal-mapping={communication-direction=IN, data-element=HochvoltBatterieManagement_XIX_SoC_XIX_BMC_HV.Geltungsbereich_E3_1_2_Premium.RP_IF_TME_Therm_IstLeistung_HVBatterie_XIX_HochvoltBatterieManagement_XIX_SoC_XIX_BMC_HV.DE_TME_Therm_IstLeistung_HVBatterie, system-signal=TME_Therm_IstLeistung_HVBatterie}
        sender-receiver-to-signal-mapping={communication-direction=IN, data-element=HochvoltBatterieManagement_XIX_SoC_XIX_BMC_HV.Geltungsbereich_E3_1_2_Premium.RP_IF_SI_T_Mode_XIX_HochvoltBatterieManagement_XIX_SoC_XIX_BMC_HV.DE_SI_T_Mode, system-signal=SI_T_Mode}
        sender-receiver-to-signal-mapping={communication-direction=IN, data-element=HochvoltBatterieManagement_XIX_SoC_XIX_BMC_HV.Geltungsbereich_E3_1_2_Premium.RP_IF_HVEM_BMC_CHA_Wunschleistung_XIX_HochvoltBatterieManagement_XIX_SoC_XIX_BMC_HV.DE_HVEM_BMC_CHA_Wunschleistung, system-signal=HVEM_BMC_CHA_Wunschleistung}
        sender-receiver-to-signal-mapping={communication-direction=OUT, data-element=HochvoltBatterieManagement_XIX_SoC_XIX_BMC_HV.Geltungsbereich_E3_1_2_Premium.SP_IF_BMC_MinDyn_Ladespannung_XIX_HochvoltBatterieManagement_XIX_SoC_XIX_BMC_HV.DE_BMC_MinDyn_Ladespannung, system-signal=BMC_MinDyn_Ladespannung}
        sender-receiver-to-signal-mapping={communication-direction=OUT, data-element=HochvoltBatterieManagement_XIX_SoC_XIX_BMC_HV.Geltungsbereich_E3_1_2_Premium.SP_IF_BMC_Leerlaufspannung_XIX_HochvoltBatterieManagement_XIX_SoC_XIX_BMC_HV.DE_BMC_Leerlaufspannung, system-signal=BMC_Leerlaufspannung}
        sender-receiver-to-signal-mapping={communication-direction=IN, data-element=HochvoltBatterieManagement_XIX_SoC_XIX_BMC_HV.Geltungsbereich_E3_1_2_Premium.RP_IF_ZM_HV_Auszeit_XIX_HochvoltBatterieManagement_XIX_SoC_XIX_BMC_HV.DE_ZM_HV_Auszeit, system-signal=ZM_HV_Auszeit}
        sender-receiver-to-signal-mapping={communication-direction=IN, data-element=HochvoltBatterieManagement_XIX_SoC_XIX_BMC_HV.Geltungsbereich_E3_1_2_Premium.RP_IF_ZM_HV_Auszeit_Status_XIX_HochvoltBatterieManagement_XIX_SoC_XIX_BMC_HV.DE_ZM_HV_Auszeit_Status, system-signal=ZM_HV_Auszeit_Status}
        sender-receiver-to-signal-mapping={communication-direction=IN, data-element=HochvoltBatterieManagement_XIX_SoC_XIX_BMC_HV.Geltungsbereich_E3_1_2_Premium.RP_IF_HVEM_SystemMinLeistungsgrenze_XIX_HochvoltBatterieManagement_XIX_SoC_XIX_BMC_HV.DE_HVEM_SystemMinLeistungsgrenze, system-signal=HVEM_SystemMinLeistungsgrenze}
        sender-receiver-to-signal-mapping={communication-direction=IN, data-element=HochvoltBatterieManagement_XIX_SoC_XIX_BMC_HV.Geltungsbereich_E3_1_2_Premium.RP_IF_OTP_Aussen_Temp_ungef_XIX_HochvoltBatterieManagement_XIX_SoC_XIX_BMC_HV.DE_OTP_Aussen_Temp_ungef, system-signal=OTP_Aussen_Temp_ungef}
        sender-receiver-to-signal-mapping={communication-direction=OUT, data-element=HochvoltBatterieManagement_XIX_SoC_XIX_BMC_HV.Geltungsbereich_E3_1_2_Premium.SP_IF_BMC_Energie_Entladen_XIX_HochvoltBatterieManagement_XIX_SoC_XIX_BMC_HV.DE_BMC_Energie_Entladen, system-signal=BMC_Energie_Entladen}
        sender-receiver-to-signal-mapping={communication-direction=OUT, data-element=HochvoltBatterieManagement_XIX_SoC_XIX_BMC_HV.Geltungsbereich_E3_1_2_Premium.SP_IF_BMC_Energie_Laden_XIX_HochvoltBatterieManagement_XIX_SoC_XIX_BMC_HV.DE_BMC_Energie_Laden, system-signal=BMC_Energie_Laden}
        sender-receiver-to-signal-mapping={communication-direction=OUT, data-element=HochvoltBatterieManagement_XIX_SoC_XIX_BMC_HV.Geltungsbereich_E3_1_2_Premium.SP_IF_BMC_Konditionierung_Anf_XIX_HochvoltBatterieManagement_XIX_SoC_XIX_BMC_HV.DE_BMC_Konditionierung_Anf, system-signal=BMC_Konditionierung_Anf}
        sender-receiver-to-signal-mapping={communication-direction=OUT, data-element=HochvoltBatterieManagement_XIX_SoC_XIX_BMC_HV.Geltungsbereich_E3_1_2_Premium.SP_IF_BMC_PredLeistung_StuetzungNV_XIX_HochvoltBatterieManagement_XIX_SoC_XIX_BMC_HV.DE_BMC_PredLeistung_StuetzungNV, system-signal=BMC_PredLeistung_StuetzungNV}
        sender-receiver-to-signal-mapping={communication-direction=IN, data-element=HochvoltBatterieManagement_XIX_SoC_XIX_BMC_HV.Geltungsbereich_E3_1_2_Premium.RP_IF_TME_Batt_Kond_Verf_XIX_HochvoltBatterieManagement_XIX_SoC_XIX_BMC_HV.DE_TME_Batt_Kond_Verf, system-signal=TME_Batt_Kond_Verf}
        sender-receiver-to-signal-mapping={communication-direction=IN, data-element=HochvoltBatterieManagement_XIX_SoC_XIX_BMC_HV.Geltungsbereich_E3_1_2_Premium.RP_IF_AB_Deaktivierung_HV_XIX_HochvoltBatterieManagement_XIX_SoC_XIX_BMC_HV.DE_AB_Deaktivierung_HV, system-signal=AB_Deaktivierung_HV}
        sender-receiver-to-signal-group-mapping={communication-direction=IN, data-element=HochvoltBatterieManagement_XIX_SoC_XIX_BMC_HV.Geltungsbereich_E3_1_2_Premium.RP_IF_SG_HVK_03_XIX_HochvoltBatterieManagement_XIX_SoC_XIX_BMC_HV.DE_SG_HVK_03, signal-group=SG_HVK_03, type-mapping=sender-rec-record-type-mapping=record-element-mappings=[{implementation-record-element=HVK_Istmodus_Anf, system-signal=HVK_Istmodus_Anf}, {implementation-record-element=HVK_Iso_Messung_Start, system-signal=HVK_Iso_Messung_Start}, {implementation-record-element=HVK_BMC_Sollmodus, system-signal=HVK_BMC_Sollmodus}, {implementation-record-element=HVK_BMC_Spannung_Anf, system-signal=HVK_BMC_Spannung_Anf}, {implementation-record-element=HVK_03_BZ, system-signal=HVK_03_BZ}, {implementation-record-element=HVK_03_CRC, system-signal=HVK_03_CRC}]}
        sender-receiver-to-signal-mapping={communication-direction=OUT, data-element=HochvoltBatterieManagement_XIX_SoC_XIX_BMC_HV.Geltungsbereich_E3_1_2_Premium.SP_IF_BMC_HV_02_CRC_XIX_HochvoltBatterieManagement_XIX_SoC_XIX_BMC_HV.DE_BMC_HV_02_CRC, system-signal=BMC_HV_02_CRC}
        sender-receiver-to-signal-mapping={communication-direction=IN, data-element=HochvoltBatterieManagement_XIX_SoC_XIX_BMC_HV.Geltungsbereich_E3_1_2_Premium.RP_IF_OTP_Aussen_Temp_OBD_XIX_HochvoltBatterieManagement_XIX_SoC_XIX_BMC_HV.DE_OTP_Aussen_Temp_OBD, system-signal=OTP_Aussen_Temp_OBD}
        sender-receiver-to-signal-group-mapping={communication-direction=IN, data-element=HochvoltBatterieManagement_XIX_SoC_XIX_BMC_HV.Geltungsbereich_E3_1_2_Premium.RP_IF_SG_HVLM_14_XIX_HochvoltBatterieManagement_XIX_SoC_XIX_BMC_HV.DE_SG_HVLM_14, signal-group=SG_HVLM_14, type-mapping=sender-rec-record-type-mapping=record-element-mappings=[{implementation-record-element=HVLM_ZustandLadeablauf, system-signal=HVLM_ZustandLadeablauf}, {implementation-record-element=HVLM_DC_Aufstartmodus, system-signal=HVLM_DC_Aufstartmodus}, {implementation-record-element=HVLM_Start_Pulserkennung, system-signal=HVLM_Start_Pulserkennung}, {implementation-record-element=HVLM_Steckerstatus, system-signal=HVLM_Steckerstatus}, {implementation-record-element=HVLM_14_BZ, system-signal=HVLM_14_BZ}, {implementation-record-element=HVLM_14_CRC, system-signal=HVLM_14_CRC}]}
        sender-receiver-to-signal-mapping={communication-direction=OUT, data-element=HochvoltBatterieManagement_XIX_SoC_XIX_BMC_HV.Geltungsbereich_E3_1_2_Premium.SP_IF_BMC_Bidi_Energie_Absolut_XIX_HochvoltBatterieManagement_XIX_SoC_XIX_BMC_HV.DE_BMC_Bidi_Energie_Absolut, system-signal=BMC_Bidi_Energie_Absolut}
        sender-receiver-to-signal-mapping={communication-direction=OUT, data-element=HochvoltBatterieManagement_XIX_SoC_XIX_BMC_HV.Geltungsbereich_E3_1_2_Premium.SP_IF_BMC_Bidi_Veto_Energie_XIX_HochvoltBatterieManagement_XIX_SoC_XIX_BMC_HV.DE_BMC_Bidi_Veto_Energie, system-signal=BMC_Bidi_Veto_Energie}
        sender-receiver-to-signal-mapping={communication-direction=OUT, data-element=HochvoltBatterieManagement_XIX_SoC_XIX_BMC_HV.Geltungsbereich_E3_1_2_Premium.SP_IF_BMC_Fehler_Warnung_XIX_HochvoltBatterieManagement_XIX_SoC_XIX_BMC_HV.DE_BMC_Fehler_Warnung, system-signal=BMC_Fehler_Warnung}
        sender-receiver-to-signal-mapping={communication-direction=OUT, data-element=HochvoltBatterieManagement_XIX_SoC_XIX_BMC_HV.Geltungsbereich_E3_1_2_Premium.SP_IF_BMC_TechnischerSOC_XIX_HochvoltBatterieManagement_XIX_SoC_XIX_BMC_HV.DE_BMC_TechnischerSOC, system-signal=BMC_TechnischerSOC}
        sender-receiver-to-signal-mapping={communication-direction=OUT, data-element=HochvoltBatterieManagement_XIX_SoC_XIX_BMC_HV.Geltungsbereich_E3_1_2_Premium.SP_IF_BMC_Bidi_Veto_Temp_XIX_HochvoltBatterieManagement_XIX_SoC_XIX_BMC_HV.DE_BMC_Bidi_Veto_Temp, system-signal=BMC_Bidi_Veto_Temp}
        sender-receiver-to-signal-mapping={communication-direction=OUT, data-element=HochvoltBatterieManagement_XIX_SoC_XIX_BMC_HV.Geltungsbereich_E3_1_2_Premium.SP_IF_BMC_Bidi_Freigabe_XIX_HochvoltBatterieManagement_XIX_SoC_XIX_BMC_HV.DE_BMC_Bidi_Freigabe, system-signal=BMC_Bidi_Freigabe}
        sender-receiver-to-signal-mapping={communication-direction=OUT, data-element=HochvoltBatterieManagement_XIX_SoC_XIX_BMC_HV.Geltungsbereich_E3_1_2_Premium.SP_IF_BMC_Bidi_GenutzteEnergie_XIX_HochvoltBatterieManagement_XIX_SoC_XIX_BMC_HV.DE_BMC_Bidi_GenutzteEnergie, system-signal=BMC_Bidi_GenutzteEnergie}
        sender-receiver-to-signal-mapping={communication-direction=OUT, data-element=HochvoltBatterieManagement_XIX_SoC_XIX_BMC_HV.Geltungsbereich_E3_1_2_Premium.SP_IF_BMC_Bidi_Min_SoC_XIX_HochvoltBatterieManagement_XIX_SoC_XIX_BMC_HV.DE_BMC_Bidi_Min_SoC, system-signal=BMC_Bidi_Min_SoC}
        sender-receiver-to-signal-mapping={communication-direction=OUT, data-element=HochvoltBatterieManagement_XIX_SoC_XIX_BMC_HV.Geltungsbereich_E3_1_2_Premium.SP_IF_BMC_Bidi_Max_SoC_XIX_HochvoltBatterieManagement_XIX_SoC_XIX_BMC_HV.DE_BMC_Bidi_Max_SoC, system-signal=BMC_Bidi_Max_SoC}
        sender-receiver-to-signal-mapping={communication-direction=IN, data-element=HochvoltBatterieManagement_XIX_SoC_XIX_BMC_HV.Geltungsbereich_E3_1_2_Premium.RP_IF_HVLM_BidiLadeModus_XIX_HochvoltBatterieManagement_XIX_SoC_XIX_BMC_HV.DE_HVLM_BidiLadeModus, system-signal=HVLM_BidiLadeModus}
        sender-receiver-to-signal-mapping={communication-direction=OUT, data-element=HochvoltBatterieManagement_XIX_SoC_XIX_BMC_HV.Geltungsbereich_E3_1_2_Premium.SP_IF_BMC_Energie_Sockel_SoC_XIX_HochvoltBatterieManagement_XIX_SoC_XIX_BMC_HV.DE_BMC_Energie_Sockel_SoC, system-signal=BMC_Energie_Sockel_SoC}
        sender-receiver-to-signal-mapping={communication-direction=IN, data-element=HochvoltBatterieManagement_XIX_SoC_XIX_BMC_HV.Geltungsbereich_E3_1_2_Premium.RP_IF_HVLE_IstSpannung_HV_XIX_HochvoltBatterieManagement_XIX_SoC_XIX_BMC_HV.DE_HVLE_IstSpannung_HV, system-signal=HVLE_IstSpannung_HV}
        sender-receiver-to-signal-mapping={communication-direction=IN, data-element=HochvoltBatterieManagement_XIX_SoC_XIX_BMC_HV.Geltungsbereich_E3_1_2_Premium.RP_IF_HVLE_OBG_IstModus_XIX_HochvoltBatterieManagement_XIX_SoC_XIX_BMC_HV.DE_HVLE_OBG_IstModus, system-signal=HVLE_OBG_IstModus}
        sender-receiver-to-signal-mapping={communication-direction=IN, data-element=HochvoltBatterieManagement_XIX_SoC_XIX_BMC_HV.Geltungsbereich_E3_1_2_Premium.RP_IF_DC_IstLeistung_HV_XIX_HochvoltBatterieManagement_XIX_SoC_XIX_BMC_HV.DE_DC_IstLeistung_HV, system-signal=DC_IstLeistung_HV}
        sender-receiver-to-signal-mapping={communication-direction=IN, data-element=HochvoltBatterieManagement_XIX_SoC_XIX_BMC_HV.Geltungsbereich_E3_1_2_Premium.RP_IF_HVLM_BCAM_Aktiv_XIX_HochvoltBatterieManagement_XIX_SoC_XIX_BMC_HV.DE_HVLM_BCAM_Aktiv, system-signal=HVLM_BCAM_Aktiv}
        sender-receiver-to-signal-mapping={communication-direction=OUT, data-element=HochvoltBatterieManagement_XIX_SoC_XIX_BMC_HV.Geltungsbereich_E3_1_2_Premium.SP_IF_BMC_MMTR_Status_XIX_HochvoltBatterieManagement_XIX_SoC_XIX_BMC_HV.DE_BMC_MMTR_Status, system-signal=BMC_MMTR_Status}
        sender-receiver-to-signal-mapping={communication-direction=OUT, data-element=HochvoltBatterieManagement_XIX_SoC_XIX_BMC_HV.Geltungsbereich_E3_1_2_Premium.SP_IF_BMC_ZellTemp_virtuell_min_XIX_HochvoltBatterieManagement_XIX_SoC_XIX_BMC_HV.DE_BMC_ZellTemp_virtuell_min, system-signal=BMC_ZellTemp_virtuell_min}
        sender-receiver-to-signal-mapping={communication-direction=OUT, data-element=HochvoltBatterieManagement_XIX_SoC_XIX_BMC_HV.Geltungsbereich_E3_1_2_Premium.SP_IF_BMC_ZellTemp_virtuell_max_XIX_HochvoltBatterieManagement_XIX_SoC_XIX_BMC_HV.DE_BMC_ZellTemp_virtuell_max, system-signal=BMC_ZellTemp_virtuell_max}
        sender-receiver-to-signal-mapping={communication-direction=IN, data-element=HochvoltBatterieManagement_XIX_SoC_XIX_BMC_HV.Geltungsbereich_E3_1_2_Premium.RP_IF_HVEM_MMTR_State_XIX_HochvoltBatterieManagement_XIX_SoC_XIX_BMC_HV.DE_HVEM_MMTR_State, system-signal=HVEM_MMTR_State}
        sender-receiver-to-signal-mapping={communication-direction=IN, data-element=HochvoltBatterieManagement_XIX_SoC_XIX_BMC_HV.Geltungsbereich_E3_1_2_Premium.RP_IF_EKK_HVK_EoHVL_Status_XIX_HochvoltBatterieManagement_XIX_SoC_XIX_BMC_HV.DE_EKK_HVK_EoHVL_Status, system-signal=EKK_HVK_EoHVL_Status}
        sender-receiver-to-signal-mapping={communication-direction=OUT, data-element=HochvoltBatterieManagement_XIX_SoC_XIX_BMC_HV.Geltungsbereich_E3_1_2_Premium.SP_IF_BMC_Max_Entladestrom_02_XIX_HochvoltBatterieManagement_XIX_SoC_XIX_BMC_HV.DE_BMC_Max_Entladestrom_02, system-signal=BMC_Max_Entladestrom_02}
        sender-receiver-to-signal-mapping={communication-direction=OUT, data-element=HochvoltBatterieManagement_XIX_SoC_XIX_BMC_HV.Geltungsbereich_E3_1_2_Premium.SP_IF_BMC_Dauer_Ladeleistung_02_XIX_HochvoltBatterieManagement_XIX_SoC_XIX_BMC_HV.DE_BMC_Dauer_Ladeleistung_02, system-signal=BMC_Dauer_Ladeleistung_02}
        sender-receiver-to-signal-mapping={communication-direction=OUT, data-element=HochvoltBatterieManagement_XIX_SoC_XIX_BMC_HV.Geltungsbereich_E3_1_2_Premium.SP_IF_BMC_Dauer_Entladeleistung_02_XIX_HochvoltBatterieManagement_XIX_SoC_XIX_BMC_HV.DE_BMC_Dauer_Entladeleistung_02, system-signal=BMC_Dauer_Entladeleistung_02}
        sender-receiver-to-signal-mapping={communication-direction=OUT, data-element=HochvoltBatterieManagement_XIX_SoC_XIX_BMC_HV.Geltungsbereich_E3_1_2_Premium.SP_IF_BMC_Max_Ladestrom_02_XIX_HochvoltBatterieManagement_XIX_SoC_XIX_BMC_HV.DE_BMC_Max_Ladestrom_02, system-signal=BMC_Max_Ladestrom_02}
        sender-receiver-to-signal-mapping={communication-direction=OUT, data-element=HochvoltBatterieManagement_XIX_SoC_XIX_BMC_HV.Geltungsbereich_E3_1_2_Premium.SP_IF_BMC_Max_Entladeleistung_02_XIX_HochvoltBatterieManagement_XIX_SoC_XIX_BMC_HV.DE_BMC_Max_Entladeleistung_02, system-signal=BMC_Max_Entladeleistung_02}
        sender-receiver-to-signal-mapping={communication-direction=OUT, data-element=HochvoltBatterieManagement_XIX_SoC_XIX_BMC_HV.Geltungsbereich_E3_1_2_Premium.SP_IF_BMC_Strom_02_XIX_HochvoltBatterieManagement_XIX_SoC_XIX_BMC_HV.DE_BMC_Strom_02, system-signal=BMC_Strom_02}
        sender-receiver-to-signal-mapping={communication-direction=OUT, data-element=HochvoltBatterieManagement_XIX_SoC_XIX_BMC_HV.Geltungsbereich_E3_1_2_Premium.SP_IF_BMC_Max_Ladeleistung_02_XIX_HochvoltBatterieManagement_XIX_SoC_XIX_BMC_HV.DE_BMC_Max_Ladeleistung_02, system-signal=BMC_Max_Ladeleistung_02}
        sender-receiver-to-signal-mapping={communication-direction=IN, data-element=HochvoltBatterieManagement_XIX_SoC_XIX_BMC_HV.Geltungsbereich_E3_1_2_Premium.RP_IF_HVEM_BMC_CHA_Wunschleistung_02_XIX_HochvoltBatterieManagement_XIX_SoC_XIX_BMC_HV.DE_HVEM_BMC_CHA_Wunschleistung_02, system-signal=HVEM_BMC_CHA_Wunschleistung_02}
        sender-receiver-to-signal-mapping={communication-direction=IN, data-element=HochvoltBatterieManagement_XIX_SoC_XIX_BMC_HV.Geltungsbereich_E3_1_2_Premium.RP_IF_PCM_BMC_VTD_LifeTimeReset_Resp_XIX_HochvoltBatterieManagement_XIX_SoC_XIX_BMC_HV.DE_PCM_BMC_VTD_LifeTimeReset_Resp, system-signal=PCM_BMC_VTD_LifeTimeReset_Resp}
        sender-receiver-to-signal-mapping={communication-direction=IN, data-element=HochvoltBatterieManagement_XIX_SoC_XIX_BMC_HV.Geltungsbereich_E3_1_2_Premium.RP_IF_PCM_BMC_VTD_LifeTimeReset_Req_XIX_HochvoltBatterieManagement_XIX_SoC_XIX_BMC_HV.DE_PCM_BMC_VTD_LifeTimeReset_Req, system-signal=PCM_BMC_VTD_LifeTimeReset_Req}
        sender-receiver-to-signal-mapping={communication-direction=IN, data-element=HochvoltBatterieManagement_XIX_SoC_XIX_BMC_HV.Geltungsbereich_E3_1_2_Premium.RP_IF_PCM_BMC_VTD_Freeze_Req_XIX_HochvoltBatterieManagement_XIX_SoC_XIX_BMC_HV.DE_PCM_BMC_VTD_Freeze_Req, system-signal=PCM_BMC_VTD_Freeze_Req}
        sender-receiver-to-signal-mapping={communication-direction=IN, data-element=HochvoltBatterieManagement_XIX_SoC_XIX_BMC_HV.Geltungsbereich_E3_1_2_Premium.RP_IF_PCM_BMC_VTD_RecentReset_Req_XIX_HochvoltBatterieManagement_XIX_SoC_XIX_BMC_HV.DE_PCM_BMC_VTD_RecentReset_Req, system-signal=PCM_BMC_VTD_RecentReset_Req}
        sender-receiver-to-signal-mapping={communication-direction=OUT, data-element=HochvoltBatterieManagement_XIX_SoC_XIX_BMC_HV.Geltungsbereich_E3_1_2_Premium.SP_IF_BMC_PCM_VTD_Freeze_Req_XIX_HochvoltBatterieManagement_XIX_SoC_XIX_BMC_HV.DE_BMC_PCM_VTD_Freeze_Req, system-signal=BMC_PCM_VTD_Freeze_Req}
        sender-receiver-to-signal-mapping={communication-direction=OUT, data-element=HochvoltBatterieManagement_XIX_SoC_XIX_BMC_HV.Geltungsbereich_E3_1_2_Premium.SP_IF_BMC_PCM_VTD_RecentReset_Req_XIX_HochvoltBatterieManagement_XIX_SoC_XIX_BMC_HV.DE_BMC_PCM_VTD_RecentReset_Req, system-signal=BMC_PCM_VTD_RecentReset_Req}
        sender-receiver-to-signal-mapping={communication-direction=OUT, data-element=HochvoltBatterieManagement_XIX_SoC_XIX_BMC_HV.Geltungsbereich_E3_1_2_Premium.SP_IF_BMC_UBE_Indikator_XIX_HochvoltBatterieManagement_XIX_SoC_XIX_BMC_HV.DE_BMC_UBE_Indikator, system-signal=BMC_UBE_Indikator}
        sender-receiver-to-signal-mapping={communication-direction=OUT, data-element=HochvoltBatterieManagement_XIX_SoC_XIX_BMC_HV.Geltungsbereich_E3_1_2_Premium.SP_IF_BMC_Range_Indikator_XIX_HochvoltBatterieManagement_XIX_SoC_XIX_BMC_HV.DE_BMC_Range_Indikator, system-signal=BMC_Range_Indikator}
        sender-receiver-to-signal-mapping={communication-direction=OUT, data-element=HochvoltBatterieManagement_XIX_SoC_XIX_BMC_HV.Geltungsbereich_E3_1_2_Premium.SP_IF_BMC_PCM_VTD_LifeTimeReset_Req_XIX_HochvoltBatterieManagement_XIX_SoC_XIX_BMC_HV.DE_BMC_PCM_VTD_LifeTimeReset_Req, system-signal=BMC_PCM_VTD_LifeTimeReset_Req}
        sender-receiver-to-signal-mapping={communication-direction=OUT, data-element=HochvoltBatterieManagement_XIX_SoC_XIX_BMC_HV.Geltungsbereich_E3_1_2_Premium.SP_IF_BMC_EnergieVorhalt_XIX_HochvoltBatterieManagement_XIX_SoC_XIX_BMC_HV.DE_BMC_EnergieVorhalt, system-signal=BMC_EnergieVorhalt}
        sender-receiver-to-signal-mapping={communication-direction=OUT, data-element=HochvoltBatterieManagement_XIX_SoC_XIX_BMC_HV.Geltungsbereich_E3_1_2_Premium.SP_IF_BMC_UBE_Indik_last_update_km_XIX_HochvoltBatterieManagement_XIX_SoC_XIX_BMC_HV.DE_BMC_UBE_Indik_last_update_km, system-signal=BMC_UBE_Indik_last_update_km}
        sender-receiver-to-signal-mapping={communication-direction=OUT, data-element=HochvoltBatterieManagement_XIX_SoC_XIX_BMC_HV.Geltungsbereich_E3_1_2_Premium.SP_IF_BMC_PCM_VTD_LifeTimeReset_Resp_XIX_HochvoltBatterieManagement_XIX_SoC_XIX_BMC_HV.DE_BMC_PCM_VTD_LifeTimeReset_Resp, system-signal=BMC_PCM_VTD_LifeTimeReset_Resp}
        sender-receiver-to-signal-mapping={communication-direction=OUT, data-element=HochvoltBatterieManagement_XIX_SoC_XIX_BMC_HV.Geltungsbereich_E3_1_2_Premium.SP_IF_BMC_ExtLadeleistung_XIX_HochvoltBatterieManagement_XIX_SoC_XIX_BMC_HV.DE_BMC_ExtLadeleistung, system-signal=BMC_ExtLadeleistung}
        sender-receiver-to-signal-mapping={communication-direction=IN, data-element=diagnosis_infrastructure_Hybrid_01_XIX_diagnosis_infrastructure_XIX_BMC_HV.Geltungsbereich_E3_1_2_Premium.RP_IF_UH_Tag_XIX_diagnosis_infrastructure_Hybrid_01_XIX_diagnosis_infrastructure_XIX_BMC_HV.DE_UH_Tag, system-signal=UH_Tag}
        sender-receiver-to-signal-mapping={communication-direction=IN, data-element=diagnosis_infrastructure_Hybrid_01_XIX_diagnosis_infrastructure_XIX_BMC_HV.Geltungsbereich_E3_1_2_Premium.RP_IF_UH_Jahr_XIX_diagnosis_infrastructure_Hybrid_01_XIX_diagnosis_infrastructure_XIX_BMC_HV.DE_UH_Jahr, system-signal=UH_Jahr}
        sender-receiver-to-signal-mapping={communication-direction=IN, data-element=diagnosis_infrastructure_Hybrid_01_XIX_diagnosis_infrastructure_XIX_BMC_HV.Geltungsbereich_E3_1_2_Premium.RP_IF_UH_Sekunde_XIX_diagnosis_infrastructure_Hybrid_01_XIX_diagnosis_infrastructure_XIX_BMC_HV.DE_UH_Sekunde, system-signal=UH_Sekunde}
        sender-receiver-to-signal-mapping={communication-direction=IN, data-element=diagnosis_infrastructure_Hybrid_01_XIX_diagnosis_infrastructure_XIX_BMC_HV.Geltungsbereich_E3_1_2_Premium.RP_IF_DW_Kilometerstand_XIX_diagnosis_infrastructure_Hybrid_01_XIX_diagnosis_infrastructure_XIX_BMC_HV.DE_DW_Kilometerstand, system-signal=DW_Kilometerstand}
        sender-receiver-to-signal-mapping={communication-direction=IN, data-element=diagnosis_infrastructure_Hybrid_01_XIX_diagnosis_infrastructure_XIX_BMC_HV.Geltungsbereich_E3_1_2_Premium.RP_IF_UH_Monat_XIX_diagnosis_infrastructure_Hybrid_01_XIX_diagnosis_infrastructure_XIX_BMC_HV.DE_UH_Monat, system-signal=UH_Monat}
        sender-receiver-to-signal-mapping={communication-direction=IN, data-element=diagnosis_infrastructure_Hybrid_01_XIX_diagnosis_infrastructure_XIX_BMC_HV.Geltungsbereich_E3_1_2_Premium.RP_IF_UH_Minute_XIX_diagnosis_infrastructure_Hybrid_01_XIX_diagnosis_infrastructure_XIX_BMC_HV.DE_UH_Minute, system-signal=UH_Minute}
        sender-receiver-to-signal-mapping={communication-direction=IN, data-element=diagnosis_infrastructure_Hybrid_01_XIX_diagnosis_infrastructure_XIX_BMC_HV.Geltungsbereich_E3_1_2_Premium.RP_IF_UH_Stunde_XIX_diagnosis_infrastructure_Hybrid_01_XIX_diagnosis_infrastructure_XIX_BMC_HV.DE_UH_Stunde, system-signal=UH_Stunde}
        sender-receiver-to-signal-mapping={communication-direction=IN, data-element=diagnosis_infrastructure_Hybrid_01_XIX_diagnosis_infrastructure_XIX_BMC_HV.Geltungsbereich_E3_1_2_Premium.RP_IF_ISO_ALL_01_Req_Data_XIX_diagnosis_infrastructure_Hybrid_01_XIX_diagnosis_infrastructure_XIX_BMC_HV.DE_ISO_ALL_01_Req_Data, system-signal=ISO_ALL_01_Req_Data}
        sender-receiver-to-signal-mapping={communication-direction=OUT, data-element=diagnosis_infrastructure_Hybrid_01_XIX_diagnosis_infrastructure_XIX_BMC_HV.Geltungsbereich_E3_1_2_Premium.SP_IF_DS_Hybrid_01_MemSel10Changed_XIX_diagnosis_infrastructure_Hybrid_01_XIX_diagnosis_infrastructure_XIX_BMC_HV.DE_DS_Hybrid_01_MemSel10Changed, system-signal=DS_Hybrid_01_MemSel10Changed}
        sender-receiver-to-signal-mapping={communication-direction=OUT, data-element=diagnosis_infrastructure_Hybrid_01_XIX_diagnosis_infrastructure_XIX_BMC_HV.Geltungsbereich_E3_1_2_Premium.SP_IF_DS_Hybrid_01_IdentValid_XIX_diagnosis_infrastructure_Hybrid_01_XIX_diagnosis_infrastructure_XIX_BMC_HV.DE_DS_Hybrid_01_IdentValid, system-signal=DS_Hybrid_01_IdentValid}
        sender-receiver-to-signal-mapping={communication-direction=OUT, data-element=diagnosis_infrastructure_Hybrid_01_XIX_diagnosis_infrastructure_XIX_BMC_HV.Geltungsbereich_E3_1_2_Premium.SP_IF_DS_Hybrid_01_StMemChanged_XIX_diagnosis_infrastructure_Hybrid_01_XIX_diagnosis_infrastructure_XIX_BMC_HV.DE_DS_Hybrid_01_StMemChanged, system-signal=DS_Hybrid_01_StMemChanged}
        sender-receiver-to-signal-mapping={communication-direction=OUT, data-element=diagnosis_infrastructure_Hybrid_01_XIX_diagnosis_infrastructure_XIX_BMC_HV.Geltungsbereich_E3_1_2_Premium.SP_IF_DS_Hybrid_01_TestFailedChanged_XIX_diagnosis_infrastructure_Hybrid_01_XIX_diagnosis_infrastructure_XIX_BMC_HV.DE_DS_Hybrid_01_TestFailedChanged, system-signal=DS_Hybrid_01_TestFailedChanged}
        sender-receiver-to-signal-mapping={communication-direction=OUT, data-element=diagnosis_infrastructure_Hybrid_01_XIX_diagnosis_infrastructure_XIX_BMC_HV.Geltungsbereich_E3_1_2_Premium.SP_IF_DS_Hybrid_01_WIRChanged_XIX_diagnosis_infrastructure_Hybrid_01_XIX_diagnosis_infrastructure_XIX_BMC_HV.DE_DS_Hybrid_01_WIRChanged, system-signal=DS_Hybrid_01_WIRChanged}
        sender-receiver-to-signal-mapping={communication-direction=OUT, data-element=diagnosis_infrastructure_Hybrid_01_XIX_diagnosis_infrastructure_XIX_BMC_HV.Geltungsbereich_E3_1_2_Premium.SP_IF_DS_Hybrid_01_MemSelChanged_XIX_diagnosis_infrastructure_Hybrid_01_XIX_diagnosis_infrastructure_XIX_BMC_HV.DE_DS_Hybrid_01_MemSelChanged, system-signal=DS_Hybrid_01_MemSelChanged}
        sender-receiver-to-signal-mapping={communication-direction=OUT, data-element=diagnosis_infrastructure_Hybrid_01_XIX_diagnosis_infrastructure_XIX_BMC_HV.Geltungsbereich_E3_1_2_Premium.SP_IF_DS_Hybrid_01_DiagAdr_XIX_diagnosis_infrastructure_Hybrid_01_XIX_diagnosis_infrastructure_XIX_BMC_HV.DE_DS_Hybrid_01_DiagAdr, system-signal=DS_Hybrid_01_DiagAdr}
        sender-receiver-to-signal-mapping={communication-direction=IN, data-element=diagnosis_infrastructure_Hybrid_01_XIX_diagnosis_infrastructure_XIX_BMC_HV.Geltungsbereich_E3_1_2_Premium.RP_IF_OBD_Driving_Cycle_XIX_diagnosis_infrastructure_Hybrid_01_XIX_diagnosis_infrastructure_XIX_BMC_HV.DE_OBD_Driving_Cycle, system-signal=OBD_Driving_Cycle}
        sender-receiver-to-signal-mapping={communication-direction=IN, data-element=diagnosis_infrastructure_Hybrid_01_XIX_diagnosis_infrastructure_XIX_BMC_HV.Geltungsbereich_E3_1_2_Premium.RP_IF_OBD_Normed_Trip_XIX_diagnosis_infrastructure_Hybrid_01_XIX_diagnosis_infrastructure_XIX_BMC_HV.DE_OBD_Normed_Trip, system-signal=OBD_Normed_Trip}
        sender-receiver-to-signal-mapping={communication-direction=IN, data-element=diagnosis_infrastructure_Hybrid_01_XIX_diagnosis_infrastructure_XIX_BMC_HV.Geltungsbereich_E3_1_2_Premium.RP_IF_OBD_Warm_Up_Cycle_XIX_diagnosis_infrastructure_Hybrid_01_XIX_diagnosis_infrastructure_XIX_BMC_HV.DE_OBD_Warm_Up_Cycle, system-signal=OBD_Warm_Up_Cycle}
        sender-receiver-to-signal-mapping={communication-direction=IN, data-element=diagnosis_infrastructure_Hybrid_01_XIX_diagnosis_infrastructure_XIX_BMC_HV.Geltungsbereich_E3_1_2_Premium.RP_IF_OBD_Minimum_Trip_XIX_diagnosis_infrastructure_Hybrid_01_XIX_diagnosis_infrastructure_XIX_BMC_HV.DE_OBD_Minimum_Trip, system-signal=OBD_Minimum_Trip}
        sender-receiver-to-signal-mapping={communication-direction=OUT, data-element=diagnosis_infrastructure_Hybrid_01_XIX_diagnosis_infrastructure_XIX_BMC_HV.Geltungsbereich_E3_1_2_Premium.SP_IF_DS_Hybrid_01_ConfDTCChanged_XIX_diagnosis_infrastructure_Hybrid_01_XIX_diagnosis_infrastructure_XIX_BMC_HV.DE_DS_Hybrid_01_ConfDTCChanged, system-signal=DS_Hybrid_01_ConfDTCChanged}
        sender-receiver-to-signal-mapping={communication-direction=OUT, data-element=diagnosis_infrastructure_Hybrid_01_XIX_diagnosis_infrastructure_XIX_BMC_HV.Geltungsbereich_E3_1_2_Premium.SP_IF_Hybrid_01_SNI_10_XIX_diagnosis_infrastructure_Hybrid_01_XIX_diagnosis_infrastructure_XIX_BMC_HV.DE_Hybrid_01_SNI_10, system-signal=Hybrid_01_SNI_10}
        sender-receiver-to-signal-mapping={communication-direction=IN, data-element=diagnosis_infrastructure_Hybrid_01_XIX_diagnosis_infrastructure_XIX_BMC_HV.Geltungsbereich_E3_1_2_Premium.RP_IF_VDSO_Vx3d_XIX_diagnosis_infrastructure_Hybrid_01_XIX_diagnosis_infrastructure_XIX_BMC_HV.DE_VDSO_Vx3d, system-signal=VDSO_Vx3d}
        sender-receiver-to-signal-mapping={communication-direction=IN, data-element=diagnosis_infrastructure_Hybrid_01_XIX_diagnosis_infrastructure_XIX_BMC_HV.Geltungsbereich_E3_1_2_Premium.RP_IF_OBD_Sperrung_IUMPR_XIX_diagnosis_infrastructure_Hybrid_01_XIX_diagnosis_infrastructure_XIX_BMC_HV.DE_OBD_Sperrung_IUMPR, system-signal=OBD_Sperrung_IUMPR}
        sender-receiver-to-signal-mapping={communication-direction=IN, data-element=diagnosis_infrastructure_Hybrid_01_XIX_diagnosis_infrastructure_XIX_BMC_HV.Geltungsbereich_E3_1_2_Premium.RP_IF_MM_PropulsionSystemActive_XIX_diagnosis_infrastructure_Hybrid_01_XIX_diagnosis_infrastructure_XIX_BMC_HV.DE_MM_PropulsionSystemActive, system-signal=MM_PropulsionSystemActive}
        sender-receiver-to-signal-mapping={communication-direction=IN, data-element=diagnosis_infrastructure_Hybrid_01_XIX_diagnosis_infrastructure_XIX_BMC_HV.Geltungsbereich_E3_1_2_Premium.RP_IF_UI2Sens01_CVN_VLD_XIX_diagnosis_infrastructure_Hybrid_01_XIX_diagnosis_infrastructure_XIX_BMC_HV.DE_UI2Sens01_CVN_VLD, system-signal=UI2Sens01_CVN_VLD}
        sender-receiver-to-signal-mapping={communication-direction=IN, data-element=diagnosis_infrastructure_Hybrid_01_XIX_diagnosis_infrastructure_XIX_BMC_HV.Geltungsbereich_E3_1_2_Premium.RP_IF_UI2Sens02_CVN_VLD_XIX_diagnosis_infrastructure_Hybrid_01_XIX_diagnosis_infrastructure_XIX_BMC_HV.DE_UI2Sens02_CVN_VLD, system-signal=UI2Sens02_CVN_VLD}
        sender-receiver-to-signal-mapping={communication-direction=OUT, data-element=diagnosis_infrastructure_Hybrid_01_XIX_diagnosis_infrastructure_XIX_BMC_HV.Geltungsbereich_E3_1_2_Premium.SP_IF_Hybrid_01_KD_Fehler_XIX_diagnosis_infrastructure_Hybrid_01_XIX_diagnosis_infrastructure_XIX_BMC_HV.DE_Hybrid_01_KD_Fehler, system-signal=Hybrid_01_KD_Fehler}
        sender-receiver-to-signal-mapping={communication-direction=OUT, data-element=diagnosis_infrastructure_Hybrid_01_XIX_diagnosis_infrastructure_XIX_BMC_HV.Geltungsbereich_E3_1_2_Premium.SP_IF_Hybrid_01_OBD_Lampe_Anf_XIX_diagnosis_infrastructure_Hybrid_01_XIX_diagnosis_infrastructure_XIX_BMC_HV.DE_Hybrid_01_OBD_Lampe_Anf, system-signal=Hybrid_01_OBD_Lampe_Anf}
        sender-receiver-to-signal-mapping={communication-direction=IN, data-element=diagnosis_infrastructure_Hybrid_01_XIX_diagnosis_infrastructure_XIX_BMC_HV.Geltungsbereich_E3_1_2_Premium.RP_IF_SI_P_Mode_XIX_diagnosis_infrastructure_Hybrid_01_XIX_diagnosis_infrastructure_XIX_BMC_HV.DE_SI_P_Mode, system-signal=SI_P_Mode}
        sender-receiver-to-signal-mapping={communication-direction=IN, data-element=diagnosis_infrastructure_Hybrid_01_XIX_diagnosis_infrastructure_XIX_BMC_HV.Geltungsbereich_E3_1_2_Premium.RP_IF_SI_P_Mode_gueltig_XIX_diagnosis_infrastructure_Hybrid_01_XIX_diagnosis_infrastructure_XIX_BMC_HV.DE_SI_P_Mode_gueltig, system-signal=SI_P_Mode_gueltig}
        sender-receiver-to-signal-mapping={communication-direction=IN, data-element=diagnosis_infrastructure_Hybrid_01_XIX_diagnosis_infrastructure_XIX_BMC_HV.Geltungsbereich_E3_1_2_Premium.RP_IF_UI2Sens01_CALID_Index_12_XIX_diagnosis_infrastructure_Hybrid_01_XIX_diagnosis_infrastructure_XIX_BMC_HV.DE_UI2Sens01_CALID_Index_12, system-signal=UI2Sens01_CALID_Index_12}
        sender-receiver-to-signal-mapping={communication-direction=IN, data-element=diagnosis_infrastructure_Hybrid_01_XIX_diagnosis_infrastructure_XIX_BMC_HV.Geltungsbereich_E3_1_2_Premium.RP_IF_UI2Sens01_CALID_Index_14_XIX_diagnosis_infrastructure_Hybrid_01_XIX_diagnosis_infrastructure_XIX_BMC_HV.DE_UI2Sens01_CALID_Index_14, system-signal=UI2Sens01_CALID_Index_14}
        sender-receiver-to-signal-mapping={communication-direction=IN, data-element=diagnosis_infrastructure_Hybrid_01_XIX_diagnosis_infrastructure_XIX_BMC_HV.Geltungsbereich_E3_1_2_Premium.RP_IF_UI2Sens01_CALID_Index_13_XIX_diagnosis_infrastructure_Hybrid_01_XIX_diagnosis_infrastructure_XIX_BMC_HV.DE_UI2Sens01_CALID_Index_13, system-signal=UI2Sens01_CALID_Index_13}
        sender-receiver-to-signal-mapping={communication-direction=IN, data-element=diagnosis_infrastructure_Hybrid_01_XIX_diagnosis_infrastructure_XIX_BMC_HV.Geltungsbereich_E3_1_2_Premium.RP_IF_UI2Sens01_CALID_Index_16_XIX_diagnosis_infrastructure_Hybrid_01_XIX_diagnosis_infrastructure_XIX_BMC_HV.DE_UI2Sens01_CALID_Index_16, system-signal=UI2Sens01_CALID_Index_16}
        sender-receiver-to-signal-mapping={communication-direction=IN, data-element=diagnosis_infrastructure_Hybrid_01_XIX_diagnosis_infrastructure_XIX_BMC_HV.Geltungsbereich_E3_1_2_Premium.RP_IF_UI2Sens01_CALID_Index_11_XIX_diagnosis_infrastructure_Hybrid_01_XIX_diagnosis_infrastructure_XIX_BMC_HV.DE_UI2Sens01_CALID_Index_11, system-signal=UI2Sens01_CALID_Index_11}
        sender-receiver-to-signal-mapping={communication-direction=IN, data-element=diagnosis_infrastructure_Hybrid_01_XIX_diagnosis_infrastructure_XIX_BMC_HV.Geltungsbereich_E3_1_2_Premium.RP_IF_UI2Sens01_CVN_Byte_4_XIX_diagnosis_infrastructure_Hybrid_01_XIX_diagnosis_infrastructure_XIX_BMC_HV.DE_UI2Sens01_CVN_Byte_4, system-signal=UI2Sens01_CVN_Byte_4}
        sender-receiver-to-signal-mapping={communication-direction=IN, data-element=diagnosis_infrastructure_Hybrid_01_XIX_diagnosis_infrastructure_XIX_BMC_HV.Geltungsbereich_E3_1_2_Premium.RP_IF_UI2Sens01_CVN_Byte_2_XIX_diagnosis_infrastructure_Hybrid_01_XIX_diagnosis_infrastructure_XIX_BMC_HV.DE_UI2Sens01_CVN_Byte_2, system-signal=UI2Sens01_CVN_Byte_2}
        sender-receiver-to-signal-mapping={communication-direction=IN, data-element=diagnosis_infrastructure_Hybrid_01_XIX_diagnosis_infrastructure_XIX_BMC_HV.Geltungsbereich_E3_1_2_Premium.RP_IF_UI2Sens01_CVN_Byte_1_XIX_diagnosis_infrastructure_Hybrid_01_XIX_diagnosis_infrastructure_XIX_BMC_HV.DE_UI2Sens01_CVN_Byte_1, system-signal=UI2Sens01_CVN_Byte_1}
        sender-receiver-to-signal-mapping={communication-direction=IN, data-element=diagnosis_infrastructure_Hybrid_01_XIX_diagnosis_infrastructure_XIX_BMC_HV.Geltungsbereich_E3_1_2_Premium.RP_IF_UI2Sens01_CALID_Index_15_XIX_diagnosis_infrastructure_Hybrid_01_XIX_diagnosis_infrastructure_XIX_BMC_HV.DE_UI2Sens01_CALID_Index_15, system-signal=UI2Sens01_CALID_Index_15}
        sender-receiver-to-signal-mapping={communication-direction=IN, data-element=diagnosis_infrastructure_Hybrid_01_XIX_diagnosis_infrastructure_XIX_BMC_HV.Geltungsbereich_E3_1_2_Premium.RP_IF_UI2Sens01_CALID_Index_10_XIX_diagnosis_infrastructure_Hybrid_01_XIX_diagnosis_infrastructure_XIX_BMC_HV.DE_UI2Sens01_CALID_Index_10, system-signal=UI2Sens01_CALID_Index_10}
        sender-receiver-to-signal-mapping={communication-direction=IN, data-element=diagnosis_infrastructure_Hybrid_01_XIX_diagnosis_infrastructure_XIX_BMC_HV.Geltungsbereich_E3_1_2_Premium.RP_IF_UI2Sens01_CVN_Byte_3_XIX_diagnosis_infrastructure_Hybrid_01_XIX_diagnosis_infrastructure_XIX_BMC_HV.DE_UI2Sens01_CVN_Byte_3, system-signal=UI2Sens01_CVN_Byte_3}
        sender-receiver-to-signal-mapping={communication-direction=IN, data-element=diagnosis_infrastructure_Hybrid_01_XIX_diagnosis_infrastructure_XIX_BMC_HV.Geltungsbereich_E3_1_2_Premium.RP_IF_UI2Sens02_CALID_Index_16_XIX_diagnosis_infrastructure_Hybrid_01_XIX_diagnosis_infrastructure_XIX_BMC_HV.DE_UI2Sens02_CALID_Index_16, system-signal=UI2Sens02_CALID_Index_16}
        sender-receiver-to-signal-mapping={communication-direction=IN, data-element=diagnosis_infrastructure_Hybrid_01_XIX_diagnosis_infrastructure_XIX_BMC_HV.Geltungsbereich_E3_1_2_Premium.RP_IF_UI2Sens02_CALID_Index_15_XIX_diagnosis_infrastructure_Hybrid_01_XIX_diagnosis_infrastructure_XIX_BMC_HV.DE_UI2Sens02_CALID_Index_15, system-signal=UI2Sens02_CALID_Index_15}
        sender-receiver-to-signal-mapping={communication-direction=IN, data-element=diagnosis_infrastructure_Hybrid_01_XIX_diagnosis_infrastructure_XIX_BMC_HV.Geltungsbereich_E3_1_2_Premium.RP_IF_UI2Sens02_CALID_Index_13_XIX_diagnosis_infrastructure_Hybrid_01_XIX_diagnosis_infrastructure_XIX_BMC_HV.DE_UI2Sens02_CALID_Index_13, system-signal=UI2Sens02_CALID_Index_13}
        sender-receiver-to-signal-mapping={communication-direction=IN, data-element=diagnosis_infrastructure_Hybrid_01_XIX_diagnosis_infrastructure_XIX_BMC_HV.Geltungsbereich_E3_1_2_Premium.RP_IF_UI2Sens02_CALID_Index_14_XIX_diagnosis_infrastructure_Hybrid_01_XIX_diagnosis_infrastructure_XIX_BMC_HV.DE_UI2Sens02_CALID_Index_14, system-signal=UI2Sens02_CALID_Index_14}
        sender-receiver-to-signal-mapping={communication-direction=IN, data-element=diagnosis_infrastructure_Hybrid_01_XIX_diagnosis_infrastructure_XIX_BMC_HV.Geltungsbereich_E3_1_2_Premium.RP_IF_UI2Sens02_CALID_Index_11_XIX_diagnosis_infrastructure_Hybrid_01_XIX_diagnosis_infrastructure_XIX_BMC_HV.DE_UI2Sens02_CALID_Index_11, system-signal=UI2Sens02_CALID_Index_11}
        sender-receiver-to-signal-mapping={communication-direction=IN, data-element=diagnosis_infrastructure_Hybrid_01_XIX_diagnosis_infrastructure_XIX_BMC_HV.Geltungsbereich_E3_1_2_Premium.RP_IF_UI2Sens02_CALID_Index_12_XIX_diagnosis_infrastructure_Hybrid_01_XIX_diagnosis_infrastructure_XIX_BMC_HV.DE_UI2Sens02_CALID_Index_12, system-signal=UI2Sens02_CALID_Index_12}
        sender-receiver-to-signal-mapping={communication-direction=IN, data-element=diagnosis_infrastructure_Hybrid_01_XIX_diagnosis_infrastructure_XIX_BMC_HV.Geltungsbereich_E3_1_2_Premium.RP_IF_UI2Sens02_CVN_Byte_1_XIX_diagnosis_infrastructure_Hybrid_01_XIX_diagnosis_infrastructure_XIX_BMC_HV.DE_UI2Sens02_CVN_Byte_1, system-signal=UI2Sens02_CVN_Byte_1}
        sender-receiver-to-signal-mapping={communication-direction=IN, data-element=diagnosis_infrastructure_Hybrid_01_XIX_diagnosis_infrastructure_XIX_BMC_HV.Geltungsbereich_E3_1_2_Premium.RP_IF_UI2Sens02_CVN_Byte_3_XIX_diagnosis_infrastructure_Hybrid_01_XIX_diagnosis_infrastructure_XIX_BMC_HV.DE_UI2Sens02_CVN_Byte_3, system-signal=UI2Sens02_CVN_Byte_3}
        sender-receiver-to-signal-mapping={communication-direction=IN, data-element=diagnosis_infrastructure_Hybrid_01_XIX_diagnosis_infrastructure_XIX_BMC_HV.Geltungsbereich_E3_1_2_Premium.RP_IF_UI2Sens02_CVN_Byte_2_XIX_diagnosis_infrastructure_Hybrid_01_XIX_diagnosis_infrastructure_XIX_BMC_HV.DE_UI2Sens02_CVN_Byte_2, system-signal=UI2Sens02_CVN_Byte_2}
        sender-receiver-to-signal-mapping={communication-direction=IN, data-element=diagnosis_infrastructure_Hybrid_01_XIX_diagnosis_infrastructure_XIX_BMC_HV.Geltungsbereich_E3_1_2_Premium.RP_IF_UI2Sens02_CVN_Byte_4_XIX_diagnosis_infrastructure_Hybrid_01_XIX_diagnosis_infrastructure_XIX_BMC_HV.DE_UI2Sens02_CVN_Byte_4, system-signal=UI2Sens02_CVN_Byte_4}
        sender-receiver-to-signal-mapping={communication-direction=IN, data-element=diagnosis_infrastructure_Hybrid_01_XIX_diagnosis_infrastructure_XIX_BMC_HV.Geltungsbereich_E3_1_2_Premium.RP_IF_UI2Sens02_CALID_Index_10_XIX_diagnosis_infrastructure_Hybrid_01_XIX_diagnosis_infrastructure_XIX_BMC_HV.DE_UI2Sens02_CALID_Index_10, system-signal=UI2Sens02_CALID_Index_10}
        sender-receiver-to-signal-mapping={communication-direction=OUT, data-element=diagnosis_infrastructure_Hybrid_01_XIX_diagnosis_infrastructure_XIX_BMC_HV.Geltungsbereich_E3_1_2_Premium.SP_IF_KN_Hybrid_01_DiagPfad_V12_XIX_diagnosis_infrastructure_Hybrid_01_XIX_diagnosis_infrastructure_XIX_BMC_HV.DE_KN_Hybrid_01_DiagPfad_V12, system-signal=KN_Hybrid_01_DiagPfad_V12}
        sender-receiver-to-signal-mapping={communication-direction=IN, data-element=diagnosis_infrastructure_Hybrid_01_XIX_diagnosis_infrastructure_XIX_BMC_HV.Geltungsbereich_E3_1_2_Premium.RP_IF_UI2Sens01_ErrMem_State_XIX_diagnosis_infrastructure_Hybrid_01_XIX_diagnosis_infrastructure_XIX_BMC_HV.DE_UI2Sens01_ErrMem_State, system-signal=UI2Sens01_ErrMem_State}
        sender-receiver-to-signal-mapping={communication-direction=IN, data-element=diagnosis_infrastructure_Hybrid_01_XIX_diagnosis_infrastructure_XIX_BMC_HV.Geltungsbereich_E3_1_2_Premium.RP_IF_UI2Sens02_ErrMem_State_XIX_diagnosis_infrastructure_Hybrid_01_XIX_diagnosis_infrastructure_XIX_BMC_HV.DE_UI2Sens02_ErrMem_State, system-signal=UI2Sens02_ErrMem_State}
        sender-receiver-to-signal-mapping={communication-direction=IN, data-element=diagnosis_infrastructure_Hybrid_01_XIX_diagnosis_infrastructure_XIX_BMC_HV.Geltungsbereich_E3_1_2_Premium.RP_IF_OBD_Abs_Pedal_Pos_XIX_diagnosis_infrastructure_Hybrid_01_XIX_diagnosis_infrastructure_XIX_BMC_HV.DE_OBD_Abs_Pedal_Pos, system-signal=OBD_Abs_Pedal_Pos}
        sender-receiver-to-signal-mapping={communication-direction=IN, data-element=diagnosis_infrastructure_Hybrid_01_XIX_diagnosis_infrastructure_XIX_BMC_HV.Geltungsbereich_E3_1_2_Premium.RP_IF_OBD_Aussen_Temp_gef_XIX_diagnosis_infrastructure_Hybrid_01_XIX_diagnosis_infrastructure_XIX_BMC_HV.DE_OBD_Aussen_Temp_gef, system-signal=OBD_Aussen_Temp_gef}
        sender-receiver-to-signal-mapping={communication-direction=IN, data-element=diagnosis_infrastructure_Hybrid_01_XIX_diagnosis_infrastructure_XIX_BMC_HV.Geltungsbereich_E3_1_2_Premium.RP_IF_OBD_Calc_Load_Val_XIX_diagnosis_infrastructure_Hybrid_01_XIX_diagnosis_infrastructure_XIX_BMC_HV.DE_OBD_Calc_Load_Val, system-signal=OBD_Calc_Load_Val}
        sender-receiver-to-signal-mapping={communication-direction=IN, data-element=diagnosis_infrastructure_Hybrid_01_XIX_diagnosis_infrastructure_XIX_BMC_HV.Geltungsbereich_E3_1_2_Premium.RP_IF_OBD_Sperrung_Kaltstart_Denom_XIX_diagnosis_infrastructure_Hybrid_01_XIX_diagnosis_infrastructure_XIX_BMC_HV.DE_OBD_Sperrung_Kaltstart_Denom, system-signal=OBD_Sperrung_Kaltstart_Denom}
        sender-receiver-to-signal-mapping={communication-direction=IN, data-element=diagnosis_infrastructure_Hybrid_01_XIX_diagnosis_infrastructure_XIX_BMC_HV.Geltungsbereich_E3_1_2_Premium.RP_IF_OBD_ClearMem_Inhibit_XIX_diagnosis_infrastructure_Hybrid_01_XIX_diagnosis_infrastructure_XIX_BMC_HV.DE_OBD_ClearMem_Inhibit, system-signal=OBD_ClearMem_Inhibit}
        sender-receiver-to-signal-mapping={communication-direction=IN, data-element=diagnosis_infrastructure_Hybrid_01_XIX_diagnosis_infrastructure_XIX_BMC_HV.Geltungsbereich_E3_1_2_Premium.RP_IF_OBD_Kaltstart_Denominator_XIX_diagnosis_infrastructure_Hybrid_01_XIX_diagnosis_infrastructure_XIX_BMC_HV.DE_OBD_Kaltstart_Denominator, system-signal=OBD_Kaltstart_Denominator}
        sender-receiver-to-signal-mapping={communication-direction=IN, data-element=diagnosis_infrastructure_Hybrid_01_XIX_diagnosis_infrastructure_XIX_BMC_HV.Geltungsbereich_E3_1_2_Premium.RP_IF_OBD_Eng_Cool_Temp_XIX_diagnosis_infrastructure_Hybrid_01_XIX_diagnosis_infrastructure_XIX_BMC_HV.DE_OBD_Eng_Cool_Temp, system-signal=OBD_Eng_Cool_Temp}
        sender-receiver-to-signal-mapping={communication-direction=IN, data-element=diagnosis_infrastructure_Hybrid_01_XIX_diagnosis_infrastructure_XIX_BMC_HV.Geltungsbereich_E3_1_2_Premium.RP_IF_OBD_Typ_XIX_diagnosis_infrastructure_Hybrid_01_XIX_diagnosis_infrastructure_XIX_BMC_HV.DE_OBD_Typ, system-signal=OBD_Typ}
        sender-receiver-to-signal-mapping={communication-direction=IN, data-element=diagnosis_infrastructure_Hybrid_01_XIX_diagnosis_infrastructure_XIX_BMC_HV.Geltungsbereich_E3_1_2_Premium.RP_IF_OBD_QBit_Aussen_Temp_XIX_diagnosis_infrastructure_Hybrid_01_XIX_diagnosis_infrastructure_XIX_BMC_HV.DE_OBD_QBit_Aussen_Temp, system-signal=OBD_QBit_Aussen_Temp}
        sender-receiver-to-signal-mapping={communication-direction=IN, data-element=diagnosis_infrastructure_Hybrid_01_XIX_diagnosis_infrastructure_XIX_BMC_HV.Geltungsbereich_E3_1_2_Premium.RP_IF_BJB_CVN_Byte_2_XIX_diagnosis_infrastructure_Hybrid_01_XIX_diagnosis_infrastructure_XIX_BMC_HV.DE_BJB_CVN_Byte_2, system-signal=BJB_CVN_Byte_2}
        sender-receiver-to-signal-mapping={communication-direction=IN, data-element=diagnosis_infrastructure_Hybrid_01_XIX_diagnosis_infrastructure_XIX_BMC_HV.Geltungsbereich_E3_1_2_Premium.RP_IF_BJB_CVN_Byte_4_XIX_diagnosis_infrastructure_Hybrid_01_XIX_diagnosis_infrastructure_XIX_BMC_HV.DE_BJB_CVN_Byte_4, system-signal=BJB_CVN_Byte_4}
        sender-receiver-to-signal-mapping={communication-direction=IN, data-element=diagnosis_infrastructure_Hybrid_01_XIX_diagnosis_infrastructure_XIX_BMC_HV.Geltungsbereich_E3_1_2_Premium.RP_IF_BJB_CVN_Byte_3_XIX_diagnosis_infrastructure_Hybrid_01_XIX_diagnosis_infrastructure_XIX_BMC_HV.DE_BJB_CVN_Byte_3, system-signal=BJB_CVN_Byte_3}
        sender-receiver-to-signal-mapping={communication-direction=IN, data-element=diagnosis_infrastructure_Hybrid_01_XIX_diagnosis_infrastructure_XIX_BMC_HV.Geltungsbereich_E3_1_2_Premium.RP_IF_BJB_CVN_Byte_1_XIX_diagnosis_infrastructure_Hybrid_01_XIX_diagnosis_infrastructure_XIX_BMC_HV.DE_BJB_CVN_Byte_1, system-signal=BJB_CVN_Byte_1}
        sender-receiver-to-signal-mapping={communication-direction=IN, data-element=diagnosis_infrastructure_Hybrid_01_XIX_diagnosis_infrastructure_XIX_BMC_HV.Geltungsbereich_E3_1_2_Premium.RP_IF_UI2Sens01_CALID_Index_06_XIX_diagnosis_infrastructure_Hybrid_01_XIX_diagnosis_infrastructure_XIX_BMC_HV.DE_UI2Sens01_CALID_Index_06, system-signal=UI2Sens01_CALID_Index_06}
        sender-receiver-to-signal-mapping={communication-direction=IN, data-element=diagnosis_infrastructure_Hybrid_01_XIX_diagnosis_infrastructure_XIX_BMC_HV.Geltungsbereich_E3_1_2_Premium.RP_IF_UI2Sens01_CALID_Index_03_XIX_diagnosis_infrastructure_Hybrid_01_XIX_diagnosis_infrastructure_XIX_BMC_HV.DE_UI2Sens01_CALID_Index_03, system-signal=UI2Sens01_CALID_Index_03}
        sender-receiver-to-signal-mapping={communication-direction=IN, data-element=diagnosis_infrastructure_Hybrid_01_XIX_diagnosis_infrastructure_XIX_BMC_HV.Geltungsbereich_E3_1_2_Premium.RP_IF_UI2Sens01_CALID_Index_01_XIX_diagnosis_infrastructure_Hybrid_01_XIX_diagnosis_infrastructure_XIX_BMC_HV.DE_UI2Sens01_CALID_Index_01, system-signal=UI2Sens01_CALID_Index_01}
        sender-receiver-to-signal-mapping={communication-direction=IN, data-element=diagnosis_infrastructure_Hybrid_01_XIX_diagnosis_infrastructure_XIX_BMC_HV.Geltungsbereich_E3_1_2_Premium.RP_IF_UI2Sens01_CALID_Index_02_XIX_diagnosis_infrastructure_Hybrid_01_XIX_diagnosis_infrastructure_XIX_BMC_HV.DE_UI2Sens01_CALID_Index_02, system-signal=UI2Sens01_CALID_Index_02}
        sender-receiver-to-signal-mapping={communication-direction=IN, data-element=diagnosis_infrastructure_Hybrid_01_XIX_diagnosis_infrastructure_XIX_BMC_HV.Geltungsbereich_E3_1_2_Premium.RP_IF_UI2Sens01_CALID_Index_08_XIX_diagnosis_infrastructure_Hybrid_01_XIX_diagnosis_infrastructure_XIX_BMC_HV.DE_UI2Sens01_CALID_Index_08, system-signal=UI2Sens01_CALID_Index_08}
        sender-receiver-to-signal-mapping={communication-direction=IN, data-element=diagnosis_infrastructure_Hybrid_01_XIX_diagnosis_infrastructure_XIX_BMC_HV.Geltungsbereich_E3_1_2_Premium.RP_IF_UI2Sens01_CALID_Index_05_XIX_diagnosis_infrastructure_Hybrid_01_XIX_diagnosis_infrastructure_XIX_BMC_HV.DE_UI2Sens01_CALID_Index_05, system-signal=UI2Sens01_CALID_Index_05}
        sender-receiver-to-signal-mapping={communication-direction=IN, data-element=diagnosis_infrastructure_Hybrid_01_XIX_diagnosis_infrastructure_XIX_BMC_HV.Geltungsbereich_E3_1_2_Premium.RP_IF_UI2Sens01_CALID_Index_04_XIX_diagnosis_infrastructure_Hybrid_01_XIX_diagnosis_infrastructure_XIX_BMC_HV.DE_UI2Sens01_CALID_Index_04, system-signal=UI2Sens01_CALID_Index_04}
        sender-receiver-to-signal-mapping={communication-direction=IN, data-element=diagnosis_infrastructure_Hybrid_01_XIX_diagnosis_infrastructure_XIX_BMC_HV.Geltungsbereich_E3_1_2_Premium.RP_IF_UI2Sens01_CALID_Index_07_XIX_diagnosis_infrastructure_Hybrid_01_XIX_diagnosis_infrastructure_XIX_BMC_HV.DE_UI2Sens01_CALID_Index_07, system-signal=UI2Sens01_CALID_Index_07}
        sender-receiver-to-signal-mapping={communication-direction=IN, data-element=diagnosis_infrastructure_Hybrid_01_XIX_diagnosis_infrastructure_XIX_BMC_HV.Geltungsbereich_E3_1_2_Premium.RP_IF_UI2Sens01_CALID_Index_09_XIX_diagnosis_infrastructure_Hybrid_01_XIX_diagnosis_infrastructure_XIX_BMC_HV.DE_UI2Sens01_CALID_Index_09, system-signal=UI2Sens01_CALID_Index_09}
        sender-receiver-to-signal-mapping={communication-direction=IN, data-element=diagnosis_infrastructure_Hybrid_01_XIX_diagnosis_infrastructure_XIX_BMC_HV.Geltungsbereich_E3_1_2_Premium.RP_IF_UI2Sens02_CALID_Index_04_XIX_diagnosis_infrastructure_Hybrid_01_XIX_diagnosis_infrastructure_XIX_BMC_HV.DE_UI2Sens02_CALID_Index_04, system-signal=UI2Sens02_CALID_Index_04}
        sender-receiver-to-signal-mapping={communication-direction=IN, data-element=diagnosis_infrastructure_Hybrid_01_XIX_diagnosis_infrastructure_XIX_BMC_HV.Geltungsbereich_E3_1_2_Premium.RP_IF_UI2Sens02_CALID_Index_01_XIX_diagnosis_infrastructure_Hybrid_01_XIX_diagnosis_infrastructure_XIX_BMC_HV.DE_UI2Sens02_CALID_Index_01, system-signal=UI2Sens02_CALID_Index_01}
        sender-receiver-to-signal-mapping={communication-direction=IN, data-element=diagnosis_infrastructure_Hybrid_01_XIX_diagnosis_infrastructure_XIX_BMC_HV.Geltungsbereich_E3_1_2_Premium.RP_IF_UI2Sens02_CALID_Index_07_XIX_diagnosis_infrastructure_Hybrid_01_XIX_diagnosis_infrastructure_XIX_BMC_HV.DE_UI2Sens02_CALID_Index_07, system-signal=UI2Sens02_CALID_Index_07}
        sender-receiver-to-signal-mapping={communication-direction=IN, data-element=diagnosis_infrastructure_Hybrid_01_XIX_diagnosis_infrastructure_XIX_BMC_HV.Geltungsbereich_E3_1_2_Premium.RP_IF_UI2Sens02_CALID_Index_09_XIX_diagnosis_infrastructure_Hybrid_01_XIX_diagnosis_infrastructure_XIX_BMC_HV.DE_UI2Sens02_CALID_Index_09, system-signal=UI2Sens02_CALID_Index_09}
        sender-receiver-to-signal-mapping={communication-direction=IN, data-element=diagnosis_infrastructure_Hybrid_01_XIX_diagnosis_infrastructure_XIX_BMC_HV.Geltungsbereich_E3_1_2_Premium.RP_IF_UI2Sens02_CALID_Index_03_XIX_diagnosis_infrastructure_Hybrid_01_XIX_diagnosis_infrastructure_XIX_BMC_HV.DE_UI2Sens02_CALID_Index_03, system-signal=UI2Sens02_CALID_Index_03}
        sender-receiver-to-signal-mapping={communication-direction=IN, data-element=diagnosis_infrastructure_Hybrid_01_XIX_diagnosis_infrastructure_XIX_BMC_HV.Geltungsbereich_E3_1_2_Premium.RP_IF_UI2Sens02_CALID_Index_08_XIX_diagnosis_infrastructure_Hybrid_01_XIX_diagnosis_infrastructure_XIX_BMC_HV.DE_UI2Sens02_CALID_Index_08, system-signal=UI2Sens02_CALID_Index_08}
        sender-receiver-to-signal-mapping={communication-direction=IN, data-element=diagnosis_infrastructure_Hybrid_01_XIX_diagnosis_infrastructure_XIX_BMC_HV.Geltungsbereich_E3_1_2_Premium.RP_IF_UI2Sens02_CALID_Index_02_XIX_diagnosis_infrastructure_Hybrid_01_XIX_diagnosis_infrastructure_XIX_BMC_HV.DE_UI2Sens02_CALID_Index_02, system-signal=UI2Sens02_CALID_Index_02}
        sender-receiver-to-signal-mapping={communication-direction=IN, data-element=diagnosis_infrastructure_Hybrid_01_XIX_diagnosis_infrastructure_XIX_BMC_HV.Geltungsbereich_E3_1_2_Premium.RP_IF_UI2Sens02_CALID_Index_05_XIX_diagnosis_infrastructure_Hybrid_01_XIX_diagnosis_infrastructure_XIX_BMC_HV.DE_UI2Sens02_CALID_Index_05, system-signal=UI2Sens02_CALID_Index_05}
        sender-receiver-to-signal-mapping={communication-direction=IN, data-element=diagnosis_infrastructure_Hybrid_01_XIX_diagnosis_infrastructure_XIX_BMC_HV.Geltungsbereich_E3_1_2_Premium.RP_IF_UI2Sens02_CALID_Index_06_XIX_diagnosis_infrastructure_Hybrid_01_XIX_diagnosis_infrastructure_XIX_BMC_HV.DE_UI2Sens02_CALID_Index_06, system-signal=UI2Sens02_CALID_Index_06}
        sender-receiver-to-signal-mapping={communication-direction=IN, data-element=diagnosis_infrastructure_Hybrid_01_XIX_diagnosis_infrastructure_XIX_BMC_HV.Geltungsbereich_E3_1_2_Premium.RP_IF_BJB_CALID_Index_03_XIX_diagnosis_infrastructure_Hybrid_01_XIX_diagnosis_infrastructure_XIX_BMC_HV.DE_BJB_CALID_Index_03, system-signal=BJB_CALID_Index_03}
        sender-receiver-to-signal-mapping={communication-direction=IN, data-element=diagnosis_infrastructure_Hybrid_01_XIX_diagnosis_infrastructure_XIX_BMC_HV.Geltungsbereich_E3_1_2_Premium.RP_IF_BJB_CALID_Index_11_XIX_diagnosis_infrastructure_Hybrid_01_XIX_diagnosis_infrastructure_XIX_BMC_HV.DE_BJB_CALID_Index_11, system-signal=BJB_CALID_Index_11}
        sender-receiver-to-signal-mapping={communication-direction=IN, data-element=diagnosis_infrastructure_Hybrid_01_XIX_diagnosis_infrastructure_XIX_BMC_HV.Geltungsbereich_E3_1_2_Premium.RP_IF_BJB_CALID_Index_05_XIX_diagnosis_infrastructure_Hybrid_01_XIX_diagnosis_infrastructure_XIX_BMC_HV.DE_BJB_CALID_Index_05, system-signal=BJB_CALID_Index_05}
        sender-receiver-to-signal-mapping={communication-direction=IN, data-element=diagnosis_infrastructure_Hybrid_01_XIX_diagnosis_infrastructure_XIX_BMC_HV.Geltungsbereich_E3_1_2_Premium.RP_IF_BJB_CALID_Index_02_XIX_diagnosis_infrastructure_Hybrid_01_XIX_diagnosis_infrastructure_XIX_BMC_HV.DE_BJB_CALID_Index_02, system-signal=BJB_CALID_Index_02}
        sender-receiver-to-signal-mapping={communication-direction=IN, data-element=diagnosis_infrastructure_Hybrid_01_XIX_diagnosis_infrastructure_XIX_BMC_HV.Geltungsbereich_E3_1_2_Premium.RP_IF_BJB_CALID_Index_14_XIX_diagnosis_infrastructure_Hybrid_01_XIX_diagnosis_infrastructure_XIX_BMC_HV.DE_BJB_CALID_Index_14, system-signal=BJB_CALID_Index_14}
        sender-receiver-to-signal-mapping={communication-direction=IN, data-element=diagnosis_infrastructure_Hybrid_01_XIX_diagnosis_infrastructure_XIX_BMC_HV.Geltungsbereich_E3_1_2_Premium.RP_IF_BJB_CALID_Index_12_XIX_diagnosis_infrastructure_Hybrid_01_XIX_diagnosis_infrastructure_XIX_BMC_HV.DE_BJB_CALID_Index_12, system-signal=BJB_CALID_Index_12}
        sender-receiver-to-signal-mapping={communication-direction=IN, data-element=diagnosis_infrastructure_Hybrid_01_XIX_diagnosis_infrastructure_XIX_BMC_HV.Geltungsbereich_E3_1_2_Premium.RP_IF_BJB_CALID_Index_13_XIX_diagnosis_infrastructure_Hybrid_01_XIX_diagnosis_infrastructure_XIX_BMC_HV.DE_BJB_CALID_Index_13, system-signal=BJB_CALID_Index_13}
        sender-receiver-to-signal-mapping={communication-direction=IN, data-element=diagnosis_infrastructure_Hybrid_01_XIX_diagnosis_infrastructure_XIX_BMC_HV.Geltungsbereich_E3_1_2_Premium.RP_IF_BJB_CALID_Index_09_XIX_diagnosis_infrastructure_Hybrid_01_XIX_diagnosis_infrastructure_XIX_BMC_HV.DE_BJB_CALID_Index_09, system-signal=BJB_CALID_Index_09}
        sender-receiver-to-signal-mapping={communication-direction=IN, data-element=diagnosis_infrastructure_Hybrid_01_XIX_diagnosis_infrastructure_XIX_BMC_HV.Geltungsbereich_E3_1_2_Premium.RP_IF_BJB_CALID_Index_01_XIX_diagnosis_infrastructure_Hybrid_01_XIX_diagnosis_infrastructure_XIX_BMC_HV.DE_BJB_CALID_Index_01, system-signal=BJB_CALID_Index_01}
        sender-receiver-to-signal-mapping={communication-direction=IN, data-element=diagnosis_infrastructure_Hybrid_01_XIX_diagnosis_infrastructure_XIX_BMC_HV.Geltungsbereich_E3_1_2_Premium.RP_IF_BJB_CALID_Index_07_XIX_diagnosis_infrastructure_Hybrid_01_XIX_diagnosis_infrastructure_XIX_BMC_HV.DE_BJB_CALID_Index_07, system-signal=BJB_CALID_Index_07}
        sender-receiver-to-signal-mapping={communication-direction=IN, data-element=diagnosis_infrastructure_Hybrid_01_XIX_diagnosis_infrastructure_XIX_BMC_HV.Geltungsbereich_E3_1_2_Premium.RP_IF_BJB_CALID_Index_08_XIX_diagnosis_infrastructure_Hybrid_01_XIX_diagnosis_infrastructure_XIX_BMC_HV.DE_BJB_CALID_Index_08, system-signal=BJB_CALID_Index_08}
        sender-receiver-to-signal-mapping={communication-direction=IN, data-element=diagnosis_infrastructure_Hybrid_01_XIX_diagnosis_infrastructure_XIX_BMC_HV.Geltungsbereich_E3_1_2_Premium.RP_IF_BJB_CVN_VLD_XIX_diagnosis_infrastructure_Hybrid_01_XIX_diagnosis_infrastructure_XIX_BMC_HV.DE_BJB_CVN_VLD, system-signal=BJB_CVN_VLD}
        sender-receiver-to-signal-mapping={communication-direction=IN, data-element=diagnosis_infrastructure_Hybrid_01_XIX_diagnosis_infrastructure_XIX_BMC_HV.Geltungsbereich_E3_1_2_Premium.RP_IF_BJB_CALID_Index_15_XIX_diagnosis_infrastructure_Hybrid_01_XIX_diagnosis_infrastructure_XIX_BMC_HV.DE_BJB_CALID_Index_15, system-signal=BJB_CALID_Index_15}
        sender-receiver-to-signal-mapping={communication-direction=IN, data-element=diagnosis_infrastructure_Hybrid_01_XIX_diagnosis_infrastructure_XIX_BMC_HV.Geltungsbereich_E3_1_2_Premium.RP_IF_BJB_CALID_Index_04_XIX_diagnosis_infrastructure_Hybrid_01_XIX_diagnosis_infrastructure_XIX_BMC_HV.DE_BJB_CALID_Index_04, system-signal=BJB_CALID_Index_04}
        sender-receiver-to-signal-mapping={communication-direction=IN, data-element=diagnosis_infrastructure_Hybrid_01_XIX_diagnosis_infrastructure_XIX_BMC_HV.Geltungsbereich_E3_1_2_Premium.RP_IF_BJB_CALID_Index_10_XIX_diagnosis_infrastructure_Hybrid_01_XIX_diagnosis_infrastructure_XIX_BMC_HV.DE_BJB_CALID_Index_10, system-signal=BJB_CALID_Index_10}
        sender-receiver-to-signal-mapping={communication-direction=IN, data-element=diagnosis_infrastructure_Hybrid_01_XIX_diagnosis_infrastructure_XIX_BMC_HV.Geltungsbereich_E3_1_2_Premium.RP_IF_BJB_CALID_Index_06_XIX_diagnosis_infrastructure_Hybrid_01_XIX_diagnosis_infrastructure_XIX_BMC_HV.DE_BJB_CALID_Index_06, system-signal=BJB_CALID_Index_06}
        sender-receiver-to-signal-mapping={communication-direction=IN, data-element=diagnosis_infrastructure_Hybrid_01_XIX_diagnosis_infrastructure_XIX_BMC_HV.Geltungsbereich_E3_1_2_Premium.RP_IF_BJB_CALID_Index_16_XIX_diagnosis_infrastructure_Hybrid_01_XIX_diagnosis_infrastructure_XIX_BMC_HV.DE_BJB_CALID_Index_16, system-signal=BJB_CALID_Index_16}
        sender-receiver-to-signal-mapping={communication-direction=OUT, data-element=diagnosis_infrastructure_Hybrid_01_XIX_diagnosis_infrastructure_XIX_BMC_HV.Geltungsbereich_E3_1_2_Premium.SP_IF_ISO_ALL_01_Req_Data_XIX_diagnosis_infrastructure_Hybrid_01_XIX_diagnosis_infrastructure_XIX_BMC_HV.DE_ISO_ALL_01_Req_Data, system-signal=ISO_ALL_01_Req_Data}
        sender-receiver-to-signal-mapping={communication-direction=IN, data-element=diagnosis_infrastructure_Hybrid_01_XIX_diagnosis_infrastructure_XIX_BMC_HV.Geltungsbereich_E3_1_2_Premium.RP_IF_BJB_ErrMem_State_XIX_diagnosis_infrastructure_Hybrid_01_XIX_diagnosis_infrastructure_XIX_BMC_HV.DE_BJB_ErrMem_State, system-signal=BJB_ErrMem_State}
        sender-receiver-to-signal-mapping={communication-direction=IN, data-element=diagnosis_infrastructure_Hybrid_01_XIX_diagnosis_infrastructure_XIX_BMC_HV.Geltungsbereich_E3_1_2_Premium.RP_IF_OBD_Engine_RPM_XIX_diagnosis_infrastructure_Hybrid_01_XIX_diagnosis_infrastructure_XIX_BMC_HV.DE_OBD_Engine_RPM, system-signal=OBD_Engine_RPM}
        sender-receiver-to-signal-mapping={communication-direction=IN, data-element=diagnosis_infrastructure_Hybrid_01_XIX_diagnosis_infrastructure_XIX_BMC_HV.Geltungsbereich_E3_1_2_Premium.RP_IF_DCDC_NV_CALID_Index_01_XIX_diagnosis_infrastructure_Hybrid_01_XIX_diagnosis_infrastructure_XIX_BMC_HV.DE_DCDC_NV_CALID_Index_01, system-signal=DCDC_NV_CALID_Index_01}
        sender-receiver-to-signal-mapping={communication-direction=IN, data-element=diagnosis_infrastructure_Hybrid_01_XIX_diagnosis_infrastructure_XIX_BMC_HV.Geltungsbereich_E3_1_2_Premium.RP_IF_DCDC_NV_CVN_VLD_XIX_diagnosis_infrastructure_Hybrid_01_XIX_diagnosis_infrastructure_XIX_BMC_HV.DE_DCDC_NV_CVN_VLD, system-signal=DCDC_NV_CVN_VLD}
        sender-receiver-to-signal-mapping={communication-direction=IN, data-element=diagnosis_infrastructure_Hybrid_01_XIX_diagnosis_infrastructure_XIX_BMC_HV.Geltungsbereich_E3_1_2_Premium.RP_IF_DCDC_NV_CALID_Index_12_XIX_diagnosis_infrastructure_Hybrid_01_XIX_diagnosis_infrastructure_XIX_BMC_HV.DE_DCDC_NV_CALID_Index_12, system-signal=DCDC_NV_CALID_Index_12}
        sender-receiver-to-signal-mapping={communication-direction=IN, data-element=diagnosis_infrastructure_Hybrid_01_XIX_diagnosis_infrastructure_XIX_BMC_HV.Geltungsbereich_E3_1_2_Premium.RP_IF_DCDC_NV_CALID_Index_06_XIX_diagnosis_infrastructure_Hybrid_01_XIX_diagnosis_infrastructure_XIX_BMC_HV.DE_DCDC_NV_CALID_Index_06, system-signal=DCDC_NV_CALID_Index_06}
        sender-receiver-to-signal-mapping={communication-direction=IN, data-element=diagnosis_infrastructure_Hybrid_01_XIX_diagnosis_infrastructure_XIX_BMC_HV.Geltungsbereich_E3_1_2_Premium.RP_IF_DCDC_NV_CALID_Index_13_XIX_diagnosis_infrastructure_Hybrid_01_XIX_diagnosis_infrastructure_XIX_BMC_HV.DE_DCDC_NV_CALID_Index_13, system-signal=DCDC_NV_CALID_Index_13}
        sender-receiver-to-signal-mapping={communication-direction=IN, data-element=diagnosis_infrastructure_Hybrid_01_XIX_diagnosis_infrastructure_XIX_BMC_HV.Geltungsbereich_E3_1_2_Premium.RP_IF_DCDC_NV_CALID_Index_08_XIX_diagnosis_infrastructure_Hybrid_01_XIX_diagnosis_infrastructure_XIX_BMC_HV.DE_DCDC_NV_CALID_Index_08, system-signal=DCDC_NV_CALID_Index_08}
        sender-receiver-to-signal-mapping={communication-direction=IN, data-element=diagnosis_infrastructure_Hybrid_01_XIX_diagnosis_infrastructure_XIX_BMC_HV.Geltungsbereich_E3_1_2_Premium.RP_IF_DCDC_NV_CALID_Index_15_XIX_diagnosis_infrastructure_Hybrid_01_XIX_diagnosis_infrastructure_XIX_BMC_HV.DE_DCDC_NV_CALID_Index_15, system-signal=DCDC_NV_CALID_Index_15}
        sender-receiver-to-signal-mapping={communication-direction=IN, data-element=diagnosis_infrastructure_Hybrid_01_XIX_diagnosis_infrastructure_XIX_BMC_HV.Geltungsbereich_E3_1_2_Premium.RP_IF_DCDC_NV_CALID_Index_16_XIX_diagnosis_infrastructure_Hybrid_01_XIX_diagnosis_infrastructure_XIX_BMC_HV.DE_DCDC_NV_CALID_Index_16, system-signal=DCDC_NV_CALID_Index_16}
        sender-receiver-to-signal-mapping={communication-direction=IN, data-element=diagnosis_infrastructure_Hybrid_01_XIX_diagnosis_infrastructure_XIX_BMC_HV.Geltungsbereich_E3_1_2_Premium.RP_IF_DCDC_NV_CVN_Byte_1_XIX_diagnosis_infrastructure_Hybrid_01_XIX_diagnosis_infrastructure_XIX_BMC_HV.DE_DCDC_NV_CVN_Byte_1, system-signal=DCDC_NV_CVN_Byte_1}
        sender-receiver-to-signal-mapping={communication-direction=IN, data-element=diagnosis_infrastructure_Hybrid_01_XIX_diagnosis_infrastructure_XIX_BMC_HV.Geltungsbereich_E3_1_2_Premium.RP_IF_DCDC_NV_CALID_Index_07_XIX_diagnosis_infrastructure_Hybrid_01_XIX_diagnosis_infrastructure_XIX_BMC_HV.DE_DCDC_NV_CALID_Index_07, system-signal=DCDC_NV_CALID_Index_07}
        sender-receiver-to-signal-mapping={communication-direction=IN, data-element=diagnosis_infrastructure_Hybrid_01_XIX_diagnosis_infrastructure_XIX_BMC_HV.Geltungsbereich_E3_1_2_Premium.RP_IF_DCDC_NV_CALID_Index_05_XIX_diagnosis_infrastructure_Hybrid_01_XIX_diagnosis_infrastructure_XIX_BMC_HV.DE_DCDC_NV_CALID_Index_05, system-signal=DCDC_NV_CALID_Index_05}
        sender-receiver-to-signal-mapping={communication-direction=IN, data-element=diagnosis_infrastructure_Hybrid_01_XIX_diagnosis_infrastructure_XIX_BMC_HV.Geltungsbereich_E3_1_2_Premium.RP_IF_DCDC_NV_CALID_Index_02_XIX_diagnosis_infrastructure_Hybrid_01_XIX_diagnosis_infrastructure_XIX_BMC_HV.DE_DCDC_NV_CALID_Index_02, system-signal=DCDC_NV_CALID_Index_02}
        sender-receiver-to-signal-mapping={communication-direction=IN, data-element=diagnosis_infrastructure_Hybrid_01_XIX_diagnosis_infrastructure_XIX_BMC_HV.Geltungsbereich_E3_1_2_Premium.RP_IF_DCDC_NV_CVN_Byte_3_XIX_diagnosis_infrastructure_Hybrid_01_XIX_diagnosis_infrastructure_XIX_BMC_HV.DE_DCDC_NV_CVN_Byte_3, system-signal=DCDC_NV_CVN_Byte_3}
        sender-receiver-to-signal-mapping={communication-direction=IN, data-element=diagnosis_infrastructure_Hybrid_01_XIX_diagnosis_infrastructure_XIX_BMC_HV.Geltungsbereich_E3_1_2_Premium.RP_IF_DCDC_NV_CALID_Index_10_XIX_diagnosis_infrastructure_Hybrid_01_XIX_diagnosis_infrastructure_XIX_BMC_HV.DE_DCDC_NV_CALID_Index_10, system-signal=DCDC_NV_CALID_Index_10}
        sender-receiver-to-signal-mapping={communication-direction=IN, data-element=diagnosis_infrastructure_Hybrid_01_XIX_diagnosis_infrastructure_XIX_BMC_HV.Geltungsbereich_E3_1_2_Premium.RP_IF_DCDC_NV_CALID_Index_09_XIX_diagnosis_infrastructure_Hybrid_01_XIX_diagnosis_infrastructure_XIX_BMC_HV.DE_DCDC_NV_CALID_Index_09, system-signal=DCDC_NV_CALID_Index_09}
        sender-receiver-to-signal-mapping={communication-direction=IN, data-element=diagnosis_infrastructure_Hybrid_01_XIX_diagnosis_infrastructure_XIX_BMC_HV.Geltungsbereich_E3_1_2_Premium.RP_IF_DCDC_NV_CALID_Index_14_XIX_diagnosis_infrastructure_Hybrid_01_XIX_diagnosis_infrastructure_XIX_BMC_HV.DE_DCDC_NV_CALID_Index_14, system-signal=DCDC_NV_CALID_Index_14}
        sender-receiver-to-signal-mapping={communication-direction=IN, data-element=diagnosis_infrastructure_Hybrid_01_XIX_diagnosis_infrastructure_XIX_BMC_HV.Geltungsbereich_E3_1_2_Premium.RP_IF_DCDC_NV_CVN_Byte_2_XIX_diagnosis_infrastructure_Hybrid_01_XIX_diagnosis_infrastructure_XIX_BMC_HV.DE_DCDC_NV_CVN_Byte_2, system-signal=DCDC_NV_CVN_Byte_2}
        sender-receiver-to-signal-mapping={communication-direction=IN, data-element=diagnosis_infrastructure_Hybrid_01_XIX_diagnosis_infrastructure_XIX_BMC_HV.Geltungsbereich_E3_1_2_Premium.RP_IF_DCDC_NV_CALID_Index_11_XIX_diagnosis_infrastructure_Hybrid_01_XIX_diagnosis_infrastructure_XIX_BMC_HV.DE_DCDC_NV_CALID_Index_11, system-signal=DCDC_NV_CALID_Index_11}
        sender-receiver-to-signal-mapping={communication-direction=IN, data-element=diagnosis_infrastructure_Hybrid_01_XIX_diagnosis_infrastructure_XIX_BMC_HV.Geltungsbereich_E3_1_2_Premium.RP_IF_DCDC_NV_CALID_Index_04_XIX_diagnosis_infrastructure_Hybrid_01_XIX_diagnosis_infrastructure_XIX_BMC_HV.DE_DCDC_NV_CALID_Index_04, system-signal=DCDC_NV_CALID_Index_04}
        sender-receiver-to-signal-mapping={communication-direction=IN, data-element=diagnosis_infrastructure_Hybrid_01_XIX_diagnosis_infrastructure_XIX_BMC_HV.Geltungsbereich_E3_1_2_Premium.RP_IF_DCDC_NV_CALID_Index_03_XIX_diagnosis_infrastructure_Hybrid_01_XIX_diagnosis_infrastructure_XIX_BMC_HV.DE_DCDC_NV_CALID_Index_03, system-signal=DCDC_NV_CALID_Index_03}
        sender-receiver-to-signal-mapping={communication-direction=IN, data-element=diagnosis_infrastructure_Hybrid_01_XIX_diagnosis_infrastructure_XIX_BMC_HV.Geltungsbereich_E3_1_2_Premium.RP_IF_DCDC_NV_CVN_Byte_4_XIX_diagnosis_infrastructure_Hybrid_01_XIX_diagnosis_infrastructure_XIX_BMC_HV.DE_DCDC_NV_CVN_Byte_4, system-signal=DCDC_NV_CVN_Byte_4}
        sender-receiver-to-signal-mapping={communication-direction=IN, data-element=diagnosis_infrastructure_Hybrid_01_XIX_diagnosis_infrastructure_XIX_BMC_HV.Geltungsbereich_E3_1_2_Premium.RP_IF_OBD_Barometric_Pressure_XIX_diagnosis_infrastructure_Hybrid_01_XIX_diagnosis_infrastructure_XIX_BMC_HV.DE_OBD_Barometric_Pressure, system-signal=OBD_Barometric_Pressure}
        sender-receiver-to-signal-mapping={communication-direction=IN, data-element=diagnosis_infrastructure_Hybrid_01_XIX_diagnosis_infrastructure_XIX_BMC_HV.Geltungsbereich_E3_1_2_Premium.RP_IF_OBD_NumDcyMilOnReq_XIX_diagnosis_infrastructure_Hybrid_01_XIX_diagnosis_infrastructure_XIX_BMC_HV.DE_OBD_NumDcyMilOnReq, system-signal=OBD_NumDcyMilOnReq}
        sender-receiver-to-signal-mapping={communication-direction=IN, data-element=diagnosis_infrastructure_Hybrid_01_XIX_diagnosis_infrastructure_XIX_BMC_HV.Geltungsbereich_E3_1_2_Premium.RP_IF_OBDProtocol_req_XIX_diagnosis_infrastructure_Hybrid_01_XIX_diagnosis_infrastructure_XIX_BMC_HV.DE_OBDProtocol_req, system-signal=OBDProtocol_req}
        sender-receiver-to-signal-mapping={communication-direction=OUT, data-element=diagnosis_infrastructure_Hybrid_01_XIX_diagnosis_infrastructure_XIX_BMC_HV.Geltungsbereich_E3_1_2_Premium.SP_IF_Hybrid_01_Indc_StChk_XIX_diagnosis_infrastructure_Hybrid_01_XIX_diagnosis_infrastructure_XIX_BMC_HV.DE_Hybrid_01_Indc_StChk, system-signal=Hybrid_01_Indc_StChk}
        sender-receiver-to-signal-mapping={communication-direction=OUT, data-element=diagnosis_infrastructure_Hybrid_01_XIX_diagnosis_infrastructure_XIX_BMC_HV.Geltungsbereich_E3_1_2_Premium.SP_IF_OBDProtocol_Hybrid_01_XIX_diagnosis_infrastructure_Hybrid_01_XIX_diagnosis_infrastructure_XIX_BMC_HV.DE_OBDProtocol_Hybrid_01, system-signal=OBDProtocol_Hybrid_01}
        sender-receiver-to-signal-mapping={communication-direction=OUT, data-element=diagnosis_infrastructure_Hybrid_01_XIX_diagnosis_infrastructure_XIX_BMC_HV.Geltungsbereich_E3_1_2_Premium.SP_IF_Hybrid_01_Indc_StFail_XIX_diagnosis_infrastructure_Hybrid_01_XIX_diagnosis_infrastructure_XIX_BMC_HV.DE_Hybrid_01_Indc_StFail, system-signal=Hybrid_01_Indc_StFail}
        sender-receiver-to-signal-mapping={communication-direction=OUT, data-element=KS_BMC_HV_XIX_KSGen3_XIX_BMC_HV.Geltungsbereich_E3_1_2_Premium.SP_IF_KS_Hybrid_01_Req_SWMaj_XIX_KS_BMC_HV_XIX_KSGen3_XIX_BMC_HV.DE_KS_Hybrid_01_Req_SWMaj, system-signal=KS_Hybrid_01_Req_SWMaj}
        sender-receiver-to-signal-mapping={communication-direction=OUT, data-element=KS_BMC_HV_XIX_KSGen3_XIX_BMC_HV.Geltungsbereich_E3_1_2_Premium.SP_IF_KS_Hybrid_01_Req_IKA_Retry_XIX_KS_BMC_HV_XIX_KSGen3_XIX_BMC_HV.DE_KS_Hybrid_01_Req_IKA_Retry, system-signal=KS_Hybrid_01_Req_IKA_Retry}
        sender-receiver-to-signal-mapping={communication-direction=OUT, data-element=KS_BMC_HV_XIX_KSGen3_XIX_BMC_HV.Geltungsbereich_E3_1_2_Premium.SP_IF_KS_Hybrid_01_Req_Prio_XIX_KS_BMC_HV_XIX_KSGen3_XIX_BMC_HV.DE_KS_Hybrid_01_Req_Prio, system-signal=KS_Hybrid_01_Req_Prio}
        sender-receiver-to-signal-mapping={communication-direction=OUT, data-element=KS_BMC_HV_XIX_KSGen3_XIX_BMC_HV.Geltungsbereich_E3_1_2_Premium.SP_IF_KS_Hybrid_01_Req_SWMin_XIX_KS_BMC_HV_XIX_KSGen3_XIX_BMC_HV.DE_KS_Hybrid_01_Req_SWMin, system-signal=KS_Hybrid_01_Req_SWMin}
        sender-receiver-to-signal-mapping={communication-direction=OUT, data-element=KS_BMC_HV_XIX_KSGen3_XIX_BMC_HV.Geltungsbereich_E3_1_2_Premium.SP_IF_KS_Hybrid_01_ChK_XIX_KS_BMC_HV_XIX_KSGen3_XIX_BMC_HV.DE_KS_Hybrid_01_ChK, system-signal=KS_Hybrid_01_ChK}
        sender-receiver-to-signal-mapping={communication-direction=OUT, data-element=KS_BMC_HV_XIX_KSGen3_XIX_BMC_HV.Geltungsbereich_E3_1_2_Premium.SP_IF_KS_Hybrid_01_ReK_SID_XIX_KS_BMC_HV_XIX_KSGen3_XIX_BMC_HV.DE_KS_Hybrid_01_ReK_SID, system-signal=KS_Hybrid_01_ReK_SID}
        sender-receiver-to-signal-mapping={communication-direction=OUT, data-element=KS_BMC_HV_XIX_KSGen3_XIX_BMC_HV.Geltungsbereich_E3_1_2_Premium.SP_IF_KS_Hybrid_01_Req_SWPat_XIX_KS_BMC_HV_XIX_KSGen3_XIX_BMC_HV.DE_KS_Hybrid_01_Req_SWPat, system-signal=KS_Hybrid_01_Req_SWPat}
        sender-receiver-to-signal-mapping={communication-direction=OUT, data-element=KS_BMC_HV_XIX_KSGen3_XIX_BMC_HV.Geltungsbereich_E3_1_2_Premium.SP_IF_KS_Hybrid_01_ReK_IKACtr_XIX_KS_BMC_HV_XIX_KSGen3_XIX_BMC_HV.DE_KS_Hybrid_01_ReK_IKACtr, system-signal=KS_Hybrid_01_ReK_IKACtr}
        sender-receiver-to-signal-mapping={communication-direction=OUT, data-element=KS_BMC_HV_XIX_KSGen3_XIX_BMC_HV.Geltungsbereich_E3_1_2_Premium.SP_IF_KS_Hybrid_01_Req_SID_XIX_KS_BMC_HV_XIX_KSGen3_XIX_BMC_HV.DE_KS_Hybrid_01_Req_SID, system-signal=KS_Hybrid_01_Req_SID}
        sender-receiver-to-signal-mapping={communication-direction=OUT, data-element=KS_BMC_HV_XIX_KSGen3_XIX_BMC_HV.Geltungsbereich_E3_1_2_Premium.SP_IF_KS_Hybrid_01_Req_VKMS_Err_XIX_KS_BMC_HV_XIX_KSGen3_XIX_BMC_HV.DE_KS_Hybrid_01_Req_VKMS_Err, system-signal=KS_Hybrid_01_Req_VKMS_Err}
        sender-receiver-to-signal-mapping={communication-direction=OUT, data-element=KS_BMC_HV_XIX_KSGen3_XIX_BMC_HV.Geltungsbereich_E3_1_2_Premium.SP_IF_KS_Hybrid_01_ChK_IKACtr_XIX_KS_BMC_HV_XIX_KSGen3_XIX_BMC_HV.DE_KS_Hybrid_01_ChK_IKACtr, system-signal=KS_Hybrid_01_ChK_IKACtr}
        sender-receiver-to-signal-group-mapping={communication-direction=IN, data-element=KS_BMC_HV_XIX_KSGen3_XIX_BMC_HV.Geltungsbereich_E3_1_2_Premium.RP_IF_SG_KS_Hybrid_01_Challenge_M_XIX_KS_BMC_HV_XIX_KSGen3_XIX_BMC_HV.DE_SG_KS_Hybrid_01_Challenge_M, signal-group=SG_KS_Hybrid_01_Challenge_M, type-mapping=sender-rec-record-type-mapping=record-element-mappings=[{implementation-record-element=KS_Hybrid_01_ChM_SID, system-signal=KS_Hybrid_01_ChM_SID}, {implementation-record-element=KS_Hybrid_01_ChM_IKACtr, system-signal=KS_Hybrid_01_ChM_IKACtr}, {implementation-record-element=KS_Hybrid_01_ChM, system-signal=KS_Hybrid_01_ChM}]}
        sender-receiver-to-signal-group-mapping={communication-direction=IN, data-element=KS_BMC_HV_XIX_KSGen3_XIX_BMC_HV.Geltungsbereich_E3_1_2_Premium.RP_IF_SG_KS_Hybrid_01_Response_M_XIX_KS_BMC_HV_XIX_KSGen3_XIX_BMC_HV.DE_SG_KS_Hybrid_01_Response_M, signal-group=SG_KS_Hybrid_01_Response_M, type-mapping=sender-rec-record-type-mapping=record-element-mappings=[{implementation-record-element=KS_Hybrid_01_ReM_SID, system-signal=KS_Hybrid_01_ReM_SID}, {implementation-record-element=KS_Hybrid_01_ReM_IKACtr, system-signal=KS_Hybrid_01_ReM_IKACtr}, {implementation-record-element=KS_Hybrid_01_ReM, system-signal=KS_Hybrid_01_ReM}]}
        sender-receiver-to-signal-mapping={communication-direction=OUT, data-element=KS_BMC_HV_XIX_KSGen3_XIX_BMC_HV.Geltungsbereich_E3_1_2_Premium.SP_IF_KS_Hybrid_01_Req_ErrCtr_XIX_KS_BMC_HV_XIX_KSGen3_XIX_BMC_HV.DE_KS_Hybrid_01_Req_ErrCtr, system-signal=KS_Hybrid_01_Req_ErrCtr}
        sender-receiver-to-signal-mapping={communication-direction=OUT, data-element=KS_BMC_HV_XIX_KSGen3_XIX_BMC_HV.Geltungsbereich_E3_1_2_Premium.SP_IF_KS_Hybrid_01_ChK_SID_XIX_KS_BMC_HV_XIX_KSGen3_XIX_BMC_HV.DE_KS_Hybrid_01_ChK_SID, system-signal=KS_Hybrid_01_ChK_SID}
        sender-receiver-to-signal-mapping={communication-direction=OUT, data-element=KS_BMC_HV_XIX_KSGen3_XIX_BMC_HV.Geltungsbereich_E3_1_2_Premium.SP_IF_KS_Hybrid_01_ReK_XIX_KS_BMC_HV_XIX_KSGen3_XIX_BMC_HV.DE_KS_Hybrid_01_ReK, system-signal=KS_Hybrid_01_ReK}
        sender-receiver-to-signal-mapping={communication-direction=OUT, data-element=KS_BMC_HV_XIX_KSGen3_XIX_BMC_HV.Geltungsbereich_E3_1_2_Premium.SP_IF_Hybrid_01_KompSchutz_XIX_KS_BMC_HV_XIX_KSGen3_XIX_BMC_HV.DE_Hybrid_01_KompSchutz, system-signal=Hybrid_01_KompSchutz}
        sender-receiver-to-signal-mapping={communication-direction=OUT, data-element=BMC_HV_Netzsteuerung_XIX_NV_SD_XIX_BMC_HV.Geltungsbereich_E3_1_2_Premium.SP_IF_BMC_Modus_XIX_BMC_HV_Netzsteuerung_XIX_NV_SD_XIX_BMC_HV.DE_BMC_Modus, system-signal=BMC_Modus}
        sender-receiver-to-signal-mapping={communication-direction=OUT, data-element=BMC_HV_Netzsteuerung_XIX_NV_SD_XIX_BMC_HV.Geltungsbereich_E3_1_2_Premium.SP_IF_BMC_Vorlade_Zielspannung_XIX_BMC_HV_Netzsteuerung_XIX_NV_SD_XIX_BMC_HV.DE_BMC_Vorlade_Zielspannung, system-signal=BMC_Vorlade_Zielspannung}
        sender-receiver-to-signal-group-mapping={communication-direction=IN, data-element=BMC_HV_Netzsteuerung_XIX_NV_SD_XIX_BMC_HV.Geltungsbereich_E3_1_2_Premium.RP_IF_SG_HVK_03_XIX_BMC_HV_Netzsteuerung_XIX_NV_SD_XIX_BMC_HV.DE_SG_HVK_03, signal-group=SG_HVK_03, type-mapping=sender-rec-record-type-mapping=record-element-mappings=[{implementation-record-element=HVK_Istmodus_Anf, system-signal=HVK_Istmodus_Anf}, {implementation-record-element=HVK_Iso_Messung_Start, system-signal=HVK_Iso_Messung_Start}, {implementation-record-element=HVK_BMC_Sollmodus, system-signal=HVK_BMC_Sollmodus}, {implementation-record-element=HVK_BMC_Spannung_Anf, system-signal=HVK_BMC_Spannung_Anf}, {implementation-record-element=HVK_03_BZ, system-signal=HVK_03_BZ}, {implementation-record-element=HVK_03_CRC, system-signal=HVK_03_CRC}]}
        sender-receiver-to-signal-mapping={communication-direction=IN, data-element=SOK_Participant_BMC_HV_XIX_SOK_XIX_BMC_HV.Geltungsbereich_E3_1_2_Premium.RP_IF_SOK_Zeit_Hybrid_01_Zeit_XIX_SOK_Participant_BMC_HV_XIX_SOK_XIX_BMC_HV.DE_SOK_Zeit_Hybrid_01_Zeit, system-signal=SOK_Zeit_Hybrid_01_Zeit}
        sender-receiver-to-signal-mapping={communication-direction=OUT, data-element=SOK_Participant_BMC_HV_XIX_SOK_XIX_BMC_HV.Geltungsbereich_E3_1_2_Premium.SP_IF_SOK_Zeit_Hybrid_01_Challenge_XIX_SOK_Participant_BMC_HV_XIX_SOK_XIX_BMC_HV.DE_SOK_Zeit_Hybrid_01_Challenge, system-signal=SOK_Zeit_Hybrid_01_Challenge}
        sender-receiver-to-signal-mapping={communication-direction=IN, data-element=SOK_Participant_BMC_HV_XIX_SOK_XIX_BMC_HV.Geltungsbereich_E3_1_2_Premium.RP_IF_SOK_ungeschuetzte_Zeit_XIX_SOK_Participant_BMC_HV_XIX_SOK_XIX_BMC_HV.DE_SOK_ungeschuetzte_Zeit, system-signal=SOK_ungeschuetzte_Zeit}
        sender-receiver-to-signal-mapping={communication-direction=OUT, data-element=BMC_Berechnung_SOC_XIX_SoC_XIX_BMC_HV.Geltungsbereich_E3_1_2_Premium.SP_IF_Anzeige_SOC_XIX_BMC_Berechnung_SOC_XIX_SoC_XIX_BMC_HV.DE_Anzeige_SOC, system-signal=Anzeige_SOC}
        sender-receiver-to-signal-mapping={communication-direction=OUT, data-element=BMC_HVS_Slave_XIX_SoC_XIX_BMC_HV.Geltungsbereich_E3_1_2_Premium.SP_IF_BMC_HVK_Fehler_Intern_XIX_BMC_HVS_Slave_XIX_SoC_XIX_BMC_HV.DE_BMC_HVK_Fehler_Intern, system-signal=BMC_HVK_Fehler_Intern}
        sender-receiver-to-signal-mapping={communication-direction=OUT, data-element=BMC_HVS_Slave_XIX_SoC_XIX_BMC_HV.Geltungsbereich_E3_1_2_Premium.SP_IF_BMC_HVK_Fehler_SD_XIX_BMC_HVS_Slave_XIX_SoC_XIX_BMC_HV.DE_BMC_HVK_Fehler_SD, system-signal=BMC_HVK_Fehler_SD}
        sender-receiver-to-signal-mapping={communication-direction=OUT, data-element=BMC_HVS_Slave_XIX_SoC_XIX_BMC_HV.Geltungsbereich_E3_1_2_Premium.SP_IF_BMC_IWU_Wert_pos_XIX_BMC_HVS_Slave_XIX_SoC_XIX_BMC_HV.DE_BMC_IWU_Wert_pos, system-signal=BMC_IWU_Wert_pos}
        sender-receiver-to-signal-mapping={communication-direction=OUT, data-element=BMC_HVS_Slave_XIX_SoC_XIX_BMC_HV.Geltungsbereich_E3_1_2_Premium.SP_IF_BMC_IWU_Wert_neg_XIX_BMC_HVS_Slave_XIX_SoC_XIX_BMC_HV.DE_BMC_IWU_Wert_neg, system-signal=BMC_IWU_Wert_neg}
        sender-receiver-to-signal-mapping={communication-direction=OUT, data-element=BMC_HVS_Slave_XIX_SoC_XIX_BMC_HV.Geltungsbereich_E3_1_2_Premium.SP_IF_BMC_HVK_Fehler_HVIL_XIX_BMC_HVS_Slave_XIX_SoC_XIX_BMC_HV.DE_BMC_HVK_Fehler_HVIL, system-signal=BMC_HVK_Fehler_HVIL}
        sender-receiver-to-signal-mapping={communication-direction=OUT, data-element=BMC_HVS_Slave_XIX_SoC_XIX_BMC_HV.Geltungsbereich_E3_1_2_Premium.SP_IF_BMC_IWU_Status_XIX_BMC_HVS_Slave_XIX_SoC_XIX_BMC_HV.DE_BMC_IWU_Status, system-signal=BMC_IWU_Status}
        sender-receiver-to-signal-mapping={communication-direction=OUT, data-element=BMC_HVS_Slave_XIX_SoC_XIX_BMC_HV.Geltungsbereich_E3_1_2_Premium.SP_IF_BMC_Status_Spgfreiheit_XIX_BMC_HVS_Slave_XIX_SoC_XIX_BMC_HV.DE_BMC_Status_Spgfreiheit, system-signal=BMC_Status_Spgfreiheit}
        sender-receiver-to-signal-mapping={communication-direction=OUT, data-element=BMC_HVS_Slave_XIX_SoC_XIX_BMC_HV.Geltungsbereich_E3_1_2_Premium.SP_IF_BMC_HVK_EoHVL_Status_XIX_BMC_HVS_Slave_XIX_SoC_XIX_BMC_HV.DE_BMC_HVK_EoHVL_Status, system-signal=BMC_HVK_EoHVL_Status}
        sender-receiver-to-signal-group-mapping={communication-direction=IN, data-element=BMC_HVS_Slave_XIX_SoC_XIX_BMC_HV.Geltungsbereich_E3_1_2_Premium.RP_IF_SG_HVK_03_XIX_BMC_HVS_Slave_XIX_SoC_XIX_BMC_HV.DE_SG_HVK_03, signal-group=SG_HVK_03, type-mapping=sender-rec-record-type-mapping=record-element-mappings=[{implementation-record-element=HVK_Istmodus_Anf, system-signal=HVK_Istmodus_Anf}, {implementation-record-element=HVK_Iso_Messung_Start, system-signal=HVK_Iso_Messung_Start}, {implementation-record-element=HVK_BMC_Sollmodus, system-signal=HVK_BMC_Sollmodus}, {implementation-record-element=HVK_BMC_Spannung_Anf, system-signal=HVK_BMC_Spannung_Anf}, {implementation-record-element=HVK_03_BZ, system-signal=HVK_03_BZ}, {implementation-record-element=HVK_03_CRC, system-signal=HVK_03_CRC}]}
        sender-receiver-to-signal-mapping={communication-direction=OUT, data-element=HV_Batterie_RTM_XIX_RTM_XIX_BMC_HV.Geltungsbereich_E3_1_2_Premium.SP_IF_BMC_Pack_SN_25_XIX_HV_Batterie_RTM_XIX_RTM_XIX_BMC_HV.DE_BMC_Pack_SN_25, system-signal=BMC_Pack_SN_25}
        sender-receiver-to-signal-mapping={communication-direction=OUT, data-element=HV_Batterie_RTM_XIX_RTM_XIX_BMC_HV.Geltungsbereich_E3_1_2_Premium.SP_IF_BMC_Pack_SN_19_XIX_HV_Batterie_RTM_XIX_RTM_XIX_BMC_HV.DE_BMC_Pack_SN_19, system-signal=BMC_Pack_SN_19}
        sender-receiver-to-signal-mapping={communication-direction=OUT, data-element=HV_Batterie_RTM_XIX_RTM_XIX_BMC_HV.Geltungsbereich_E3_1_2_Premium.SP_IF_BMC_Pack_SN_14_XIX_HV_Batterie_RTM_XIX_RTM_XIX_BMC_HV.DE_BMC_Pack_SN_14, system-signal=BMC_Pack_SN_14}
        sender-receiver-to-signal-mapping={communication-direction=OUT, data-element=HV_Batterie_RTM_XIX_RTM_XIX_BMC_HV.Geltungsbereich_E3_1_2_Premium.SP_IF_BMC_Pack_SN_17_XIX_HV_Batterie_RTM_XIX_RTM_XIX_BMC_HV.DE_BMC_Pack_SN_17, system-signal=BMC_Pack_SN_17}
        sender-receiver-to-signal-mapping={communication-direction=OUT, data-element=HV_Batterie_RTM_XIX_RTM_XIX_BMC_HV.Geltungsbereich_E3_1_2_Premium.SP_IF_BMC_Pack_SN_01_XIX_HV_Batterie_RTM_XIX_RTM_XIX_BMC_HV.DE_BMC_Pack_SN_01, system-signal=BMC_Pack_SN_01}
        sender-receiver-to-signal-mapping={communication-direction=OUT, data-element=HV_Batterie_RTM_XIX_RTM_XIX_BMC_HV.Geltungsbereich_E3_1_2_Premium.SP_IF_BMC_Pack_SN_21_XIX_HV_Batterie_RTM_XIX_RTM_XIX_BMC_HV.DE_BMC_Pack_SN_21, system-signal=BMC_Pack_SN_21}
        sender-receiver-to-signal-mapping={communication-direction=OUT, data-element=HV_Batterie_RTM_XIX_RTM_XIX_BMC_HV.Geltungsbereich_E3_1_2_Premium.SP_IF_BMC_Pack_SN_03_XIX_HV_Batterie_RTM_XIX_RTM_XIX_BMC_HV.DE_BMC_Pack_SN_03, system-signal=BMC_Pack_SN_03}
        sender-receiver-to-signal-mapping={communication-direction=OUT, data-element=HV_Batterie_RTM_XIX_RTM_XIX_BMC_HV.Geltungsbereich_E3_1_2_Premium.SP_IF_BMC_Pack_SN_05_XIX_HV_Batterie_RTM_XIX_RTM_XIX_BMC_HV.DE_BMC_Pack_SN_05, system-signal=BMC_Pack_SN_05}
        sender-receiver-to-signal-mapping={communication-direction=OUT, data-element=HV_Batterie_RTM_XIX_RTM_XIX_BMC_HV.Geltungsbereich_E3_1_2_Premium.SP_IF_BMC_Pack_SN_08_XIX_HV_Batterie_RTM_XIX_RTM_XIX_BMC_HV.DE_BMC_Pack_SN_08, system-signal=BMC_Pack_SN_08}
        sender-receiver-to-signal-mapping={communication-direction=OUT, data-element=HV_Batterie_RTM_XIX_RTM_XIX_BMC_HV.Geltungsbereich_E3_1_2_Premium.SP_IF_BMC_Pack_SN_24_XIX_HV_Batterie_RTM_XIX_RTM_XIX_BMC_HV.DE_BMC_Pack_SN_24, system-signal=BMC_Pack_SN_24}
        sender-receiver-to-signal-mapping={communication-direction=OUT, data-element=HV_Batterie_RTM_XIX_RTM_XIX_BMC_HV.Geltungsbereich_E3_1_2_Premium.SP_IF_BMC_Pack_SN_16_XIX_HV_Batterie_RTM_XIX_RTM_XIX_BMC_HV.DE_BMC_Pack_SN_16, system-signal=BMC_Pack_SN_16}
        sender-receiver-to-signal-mapping={communication-direction=OUT, data-element=HV_Batterie_RTM_XIX_RTM_XIX_BMC_HV.Geltungsbereich_E3_1_2_Premium.SP_IF_BMC_Pack_SN_15_XIX_HV_Batterie_RTM_XIX_RTM_XIX_BMC_HV.DE_BMC_Pack_SN_15, system-signal=BMC_Pack_SN_15}
        sender-receiver-to-signal-mapping={communication-direction=OUT, data-element=HV_Batterie_RTM_XIX_RTM_XIX_BMC_HV.Geltungsbereich_E3_1_2_Premium.SP_IF_BMC_Pack_SN_11_XIX_HV_Batterie_RTM_XIX_RTM_XIX_BMC_HV.DE_BMC_Pack_SN_11, system-signal=BMC_Pack_SN_11}
        sender-receiver-to-signal-mapping={communication-direction=OUT, data-element=HV_Batterie_RTM_XIX_RTM_XIX_BMC_HV.Geltungsbereich_E3_1_2_Premium.SP_IF_BMC_Pack_SN_22_XIX_HV_Batterie_RTM_XIX_RTM_XIX_BMC_HV.DE_BMC_Pack_SN_22, system-signal=BMC_Pack_SN_22}
        sender-receiver-to-signal-mapping={communication-direction=OUT, data-element=HV_Batterie_RTM_XIX_RTM_XIX_BMC_HV.Geltungsbereich_E3_1_2_Premium.SP_IF_BMC_Pack_SN_13_XIX_HV_Batterie_RTM_XIX_RTM_XIX_BMC_HV.DE_BMC_Pack_SN_13, system-signal=BMC_Pack_SN_13}
        sender-receiver-to-signal-mapping={communication-direction=OUT, data-element=HV_Batterie_RTM_XIX_RTM_XIX_BMC_HV.Geltungsbereich_E3_1_2_Premium.SP_IF_BMC_Pack_SN_04_XIX_HV_Batterie_RTM_XIX_RTM_XIX_BMC_HV.DE_BMC_Pack_SN_04, system-signal=BMC_Pack_SN_04}
        sender-receiver-to-signal-mapping={communication-direction=OUT, data-element=HV_Batterie_RTM_XIX_RTM_XIX_BMC_HV.Geltungsbereich_E3_1_2_Premium.SP_IF_BMC_Pack_SN_20_XIX_HV_Batterie_RTM_XIX_RTM_XIX_BMC_HV.DE_BMC_Pack_SN_20, system-signal=BMC_Pack_SN_20}
        sender-receiver-to-signal-mapping={communication-direction=OUT, data-element=HV_Batterie_RTM_XIX_RTM_XIX_BMC_HV.Geltungsbereich_E3_1_2_Premium.SP_IF_BMC_Pack_SN_07_XIX_HV_Batterie_RTM_XIX_RTM_XIX_BMC_HV.DE_BMC_Pack_SN_07, system-signal=BMC_Pack_SN_07}
        sender-receiver-to-signal-mapping={communication-direction=OUT, data-element=HV_Batterie_RTM_XIX_RTM_XIX_BMC_HV.Geltungsbereich_E3_1_2_Premium.SP_IF_BMC_Pack_SN_23_XIX_HV_Batterie_RTM_XIX_RTM_XIX_BMC_HV.DE_BMC_Pack_SN_23, system-signal=BMC_Pack_SN_23}
        sender-receiver-to-signal-mapping={communication-direction=OUT, data-element=HV_Batterie_RTM_XIX_RTM_XIX_BMC_HV.Geltungsbereich_E3_1_2_Premium.SP_IF_BMC_Pack_SN_06_XIX_HV_Batterie_RTM_XIX_RTM_XIX_BMC_HV.DE_BMC_Pack_SN_06, system-signal=BMC_Pack_SN_06}
        sender-receiver-to-signal-mapping={communication-direction=OUT, data-element=HV_Batterie_RTM_XIX_RTM_XIX_BMC_HV.Geltungsbereich_E3_1_2_Premium.SP_IF_BMC_Pack_SN_26_XIX_HV_Batterie_RTM_XIX_RTM_XIX_BMC_HV.DE_BMC_Pack_SN_26, system-signal=BMC_Pack_SN_26}
        sender-receiver-to-signal-mapping={communication-direction=OUT, data-element=HV_Batterie_RTM_XIX_RTM_XIX_BMC_HV.Geltungsbereich_E3_1_2_Premium.SP_IF_BMC_Pack_SN_10_XIX_HV_Batterie_RTM_XIX_RTM_XIX_BMC_HV.DE_BMC_Pack_SN_10, system-signal=BMC_Pack_SN_10}
        sender-receiver-to-signal-mapping={communication-direction=OUT, data-element=HV_Batterie_RTM_XIX_RTM_XIX_BMC_HV.Geltungsbereich_E3_1_2_Premium.SP_IF_BMC_Pack_SN_12_XIX_HV_Batterie_RTM_XIX_RTM_XIX_BMC_HV.DE_BMC_Pack_SN_12, system-signal=BMC_Pack_SN_12}
        sender-receiver-to-signal-mapping={communication-direction=OUT, data-element=HV_Batterie_RTM_XIX_RTM_XIX_BMC_HV.Geltungsbereich_E3_1_2_Premium.SP_IF_BMC_Pack_SN_09_XIX_HV_Batterie_RTM_XIX_RTM_XIX_BMC_HV.DE_BMC_Pack_SN_09, system-signal=BMC_Pack_SN_09}
        sender-receiver-to-signal-mapping={communication-direction=OUT, data-element=HV_Batterie_RTM_XIX_RTM_XIX_BMC_HV.Geltungsbereich_E3_1_2_Premium.SP_IF_BMC_Pack_SN_02_XIX_HV_Batterie_RTM_XIX_RTM_XIX_BMC_HV.DE_BMC_Pack_SN_02, system-signal=BMC_Pack_SN_02}
        sender-receiver-to-signal-mapping={communication-direction=OUT, data-element=HV_Batterie_RTM_XIX_RTM_XIX_BMC_HV.Geltungsbereich_E3_1_2_Premium.SP_IF_BMC_Pack_SN_18_XIX_HV_Batterie_RTM_XIX_RTM_XIX_BMC_HV.DE_BMC_Pack_SN_18, system-signal=BMC_Pack_SN_18}
        sender-receiver-to-signal-mapping={communication-direction=OUT, data-element=HV_Batterie_RTM_XIX_RTM_XIX_BMC_HV.Geltungsbereich_E3_1_2_Premium.SP_IF_BMC_IstTemperaturMin_Sensor_ID_XIX_HV_Batterie_RTM_XIX_RTM_XIX_BMC_HV.DE_BMC_IstTemperaturMin_Sensor_ID, system-signal=BMC_IstTemperaturMin_Sensor_ID}
        sender-receiver-to-signal-mapping={communication-direction=OUT, data-element=HV_Batterie_RTM_XIX_RTM_XIX_BMC_HV.Geltungsbereich_E3_1_2_Premium.SP_IF_BMC_RtmWarnPackKommunikation_XIX_HV_Batterie_RTM_XIX_RTM_XIX_BMC_HV.DE_BMC_RtmWarnPackKommunikation, system-signal=BMC_RtmWarnPackKommunikation}
        sender-receiver-to-signal-mapping={communication-direction=OUT, data-element=HV_Batterie_RTM_XIX_RTM_XIX_BMC_HV.Geltungsbereich_E3_1_2_Premium.SP_IF_BMC_RtmWarnPackUeberladen_XIX_HV_Batterie_RTM_XIX_RTM_XIX_BMC_HV.DE_BMC_RtmWarnPackUeberladen, system-signal=BMC_RtmWarnPackUeberladen}
        sender-receiver-to-signal-mapping={communication-direction=OUT, data-element=HV_Batterie_RTM_XIX_RTM_XIX_BMC_HV.Geltungsbereich_E3_1_2_Premium.SP_IF_BMC_RtmWarnSocHoch_XIX_HV_Batterie_RTM_XIX_RTM_XIX_BMC_HV.DE_BMC_RtmWarnSocHoch, system-signal=BMC_RtmWarnSocHoch}
        sender-receiver-to-signal-mapping={communication-direction=OUT, data-element=HV_Batterie_RTM_XIX_RTM_XIX_BMC_HV.Geltungsbereich_E3_1_2_Premium.SP_IF_BMC_RtmWarnSocNiedrig_XIX_HV_Batterie_RTM_XIX_RTM_XIX_BMC_HV.DE_BMC_RtmWarnSocNiedrig, system-signal=BMC_RtmWarnSocNiedrig}
        sender-receiver-to-signal-mapping={communication-direction=OUT, data-element=HV_Batterie_RTM_XIX_RTM_XIX_BMC_HV.Geltungsbereich_E3_1_2_Premium.SP_IF_BMC_RtmWarnSocSprung_XIX_HV_Batterie_RTM_XIX_RTM_XIX_BMC_HV.DE_BMC_RtmWarnSocSprung, system-signal=BMC_RtmWarnSocSprung}
        sender-receiver-to-signal-mapping={communication-direction=OUT, data-element=HV_Batterie_RTM_XIX_RTM_XIX_BMC_HV.Geltungsbereich_E3_1_2_Premium.SP_IF_BMC_RtmWarnTZelleDiff_XIX_HV_Batterie_RTM_XIX_RTM_XIX_BMC_HV.DE_BMC_RtmWarnTZelleDiff, system-signal=BMC_RtmWarnTZelleDiff}
        sender-receiver-to-signal-mapping={communication-direction=OUT, data-element=HV_Batterie_RTM_XIX_RTM_XIX_BMC_HV.Geltungsbereich_E3_1_2_Premium.SP_IF_BMC_RtmWarnTZelleMax_XIX_HV_Batterie_RTM_XIX_RTM_XIX_BMC_HV.DE_BMC_RtmWarnTZelleMax, system-signal=BMC_RtmWarnTZelleMax}
        sender-receiver-to-signal-mapping={communication-direction=OUT, data-element=HV_Batterie_RTM_XIX_RTM_XIX_BMC_HV.Geltungsbereich_E3_1_2_Premium.SP_IF_BMC_RtmWarnTZelleMin_XIX_HV_Batterie_RTM_XIX_RTM_XIX_BMC_HV.DE_BMC_RtmWarnTZelleMin, system-signal=BMC_RtmWarnTZelleMin}
        sender-receiver-to-signal-mapping={communication-direction=OUT, data-element=HV_Batterie_RTM_XIX_RTM_XIX_BMC_HV.Geltungsbereich_E3_1_2_Premium.SP_IF_BMC_RtmWarnUPackMax_XIX_HV_Batterie_RTM_XIX_RTM_XIX_BMC_HV.DE_BMC_RtmWarnUPackMax, system-signal=BMC_RtmWarnUPackMax}
        sender-receiver-to-signal-mapping={communication-direction=OUT, data-element=HV_Batterie_RTM_XIX_RTM_XIX_BMC_HV.Geltungsbereich_E3_1_2_Premium.SP_IF_BMC_RtmWarnUPackMin_XIX_HV_Batterie_RTM_XIX_RTM_XIX_BMC_HV.DE_BMC_RtmWarnUPackMin, system-signal=BMC_RtmWarnUPackMin}
        sender-receiver-to-signal-mapping={communication-direction=OUT, data-element=HV_Batterie_RTM_XIX_RTM_XIX_BMC_HV.Geltungsbereich_E3_1_2_Premium.SP_IF_BMC_RtmWarnUZelleMax_XIX_HV_Batterie_RTM_XIX_RTM_XIX_BMC_HV.DE_BMC_RtmWarnUZelleMax, system-signal=BMC_RtmWarnUZelleMax}
        sender-receiver-to-signal-mapping={communication-direction=OUT, data-element=HV_Batterie_RTM_XIX_RTM_XIX_BMC_HV.Geltungsbereich_E3_1_2_Premium.SP_IF_BMC_RtmWarnUZelleMin_XIX_HV_Batterie_RTM_XIX_RTM_XIX_BMC_HV.DE_BMC_RtmWarnUZelleMin, system-signal=BMC_RtmWarnUZelleMin}
        sender-receiver-to-signal-mapping={communication-direction=OUT, data-element=HV_Batterie_RTM_XIX_RTM_XIX_BMC_HV.Geltungsbereich_E3_1_2_Premium.SP_IF_BMC_RtmWarnZelleZustand_XIX_HV_Batterie_RTM_XIX_RTM_XIX_BMC_HV.DE_BMC_RtmWarnZelleZustand, system-signal=BMC_RtmWarnZelleZustand}
        sender-receiver-to-signal-mapping={communication-direction=OUT, data-element=HV_Batterie_RTM_XIX_RTM_XIX_BMC_HV.Geltungsbereich_E3_1_2_Premium.SP_IF_BMC_IstZellSpannungMin_Modul_ID_XIX_HV_Batterie_RTM_XIX_RTM_XIX_BMC_HV.DE_BMC_IstZellSpannungMin_Modul_ID, system-signal=BMC_IstZellSpannungMin_Modul_ID}
        sender-receiver-to-signal-mapping={communication-direction=OUT, data-element=HV_Batterie_RTM_XIX_RTM_XIX_BMC_HV.Geltungsbereich_E3_1_2_Premium.SP_IF_BMC_IstZellSpannungMax_Modul_ID_XIX_HV_Batterie_RTM_XIX_RTM_XIX_BMC_HV.DE_BMC_IstZellSpannungMax_Modul_ID, system-signal=BMC_IstZellSpannungMax_Modul_ID}
        sender-receiver-to-signal-mapping={communication-direction=OUT, data-element=HV_Batterie_RTM_XIX_RTM_XIX_BMC_HV.Geltungsbereich_E3_1_2_Premium.SP_IF_BMC_IstZellSpannungMin_Zell_ID_XIX_HV_Batterie_RTM_XIX_RTM_XIX_BMC_HV.DE_BMC_IstZellSpannungMin_Zell_ID, system-signal=BMC_IstZellSpannungMin_Zell_ID}
        sender-receiver-to-signal-mapping={communication-direction=OUT, data-element=HV_Batterie_RTM_XIX_RTM_XIX_BMC_HV.Geltungsbereich_E3_1_2_Premium.SP_IF_BMC_IstZellSpannungMax_Zell_ID_XIX_HV_Batterie_RTM_XIX_RTM_XIX_BMC_HV.DE_BMC_IstZellSpannungMax_Zell_ID, system-signal=BMC_IstZellSpannungMax_Zell_ID}
        sender-receiver-to-signal-mapping={communication-direction=OUT, data-element=HV_Batterie_RTM_XIX_RTM_XIX_BMC_HV.Geltungsbereich_E3_1_2_Premium.SP_IF_BMC_RtmWarnBattUnautorisiert_XIX_HV_Batterie_RTM_XIX_RTM_XIX_BMC_HV.DE_BMC_RtmWarnBattUnautorisiert, system-signal=BMC_RtmWarnBattUnautorisiert}
        sender-receiver-to-signal-mapping={communication-direction=OUT, data-element=HV_Batterie_RTM_XIX_RTM_XIX_BMC_HV.Geltungsbereich_E3_1_2_Premium.SP_IF_BMC_CMC_Zellspannung_176_XIX_HV_Batterie_RTM_XIX_RTM_XIX_BMC_HV.DE_BMC_CMC_Zellspannung_176, system-signal=BMC_CMC_Zellspannung_176}
        sender-receiver-to-signal-mapping={communication-direction=OUT, data-element=HV_Batterie_RTM_XIX_RTM_XIX_BMC_HV.Geltungsbereich_E3_1_2_Premium.SP_IF_BMC_CMC_Zellspannung_173_XIX_HV_Batterie_RTM_XIX_RTM_XIX_BMC_HV.DE_BMC_CMC_Zellspannung_173, system-signal=BMC_CMC_Zellspannung_173}
        sender-receiver-to-signal-mapping={communication-direction=OUT, data-element=HV_Batterie_RTM_XIX_RTM_XIX_BMC_HV.Geltungsbereich_E3_1_2_Premium.SP_IF_BMC_CMC_Zellspannung_032_XIX_HV_Batterie_RTM_XIX_RTM_XIX_BMC_HV.DE_BMC_CMC_Zellspannung_032, system-signal=BMC_CMC_Zellspannung_032}
        sender-receiver-to-signal-mapping={communication-direction=OUT, data-element=HV_Batterie_RTM_XIX_RTM_XIX_BMC_HV.Geltungsbereich_E3_1_2_Premium.SP_IF_BMC_CMC_Temperatur_010_XIX_HV_Batterie_RTM_XIX_RTM_XIX_BMC_HV.DE_BMC_CMC_Temperatur_010, system-signal=BMC_CMC_Temperatur_010}
        sender-receiver-to-signal-mapping={communication-direction=OUT, data-element=HV_Batterie_RTM_XIX_RTM_XIX_BMC_HV.Geltungsbereich_E3_1_2_Premium.SP_IF_BMC_CMC_Temperatur_044_XIX_HV_Batterie_RTM_XIX_RTM_XIX_BMC_HV.DE_BMC_CMC_Temperatur_044, system-signal=BMC_CMC_Temperatur_044}
        sender-receiver-to-signal-mapping={communication-direction=OUT, data-element=HV_Batterie_RTM_XIX_RTM_XIX_BMC_HV.Geltungsbereich_E3_1_2_Premium.SP_IF_BMC_CMC_Temperatur_040_XIX_HV_Batterie_RTM_XIX_RTM_XIX_BMC_HV.DE_BMC_CMC_Temperatur_040, system-signal=BMC_CMC_Temperatur_040}
        sender-receiver-to-signal-mapping={communication-direction=OUT, data-element=HV_Batterie_RTM_XIX_RTM_XIX_BMC_HV.Geltungsbereich_E3_1_2_Premium.SP_IF_BMC_CMC_Temperatur_066_XIX_HV_Batterie_RTM_XIX_RTM_XIX_BMC_HV.DE_BMC_CMC_Temperatur_066, system-signal=BMC_CMC_Temperatur_066}
        sender-receiver-to-signal-mapping={communication-direction=OUT, data-element=HV_Batterie_RTM_XIX_RTM_XIX_BMC_HV.Geltungsbereich_E3_1_2_Premium.SP_IF_BMC_CMC_Temperatur_034_XIX_HV_Batterie_RTM_XIX_RTM_XIX_BMC_HV.DE_BMC_CMC_Temperatur_034, system-signal=BMC_CMC_Temperatur_034}
        sender-receiver-to-signal-mapping={communication-direction=OUT, data-element=HV_Batterie_RTM_XIX_RTM_XIX_BMC_HV.Geltungsbereich_E3_1_2_Premium.SP_IF_BMC_CMC_Temperatur_070_XIX_HV_Batterie_RTM_XIX_RTM_XIX_BMC_HV.DE_BMC_CMC_Temperatur_070, system-signal=BMC_CMC_Temperatur_070}
        sender-receiver-to-signal-mapping={communication-direction=OUT, data-element=HV_Batterie_RTM_XIX_RTM_XIX_BMC_HV.Geltungsbereich_E3_1_2_Premium.SP_IF_BMC_CMC_Temperatur_013_XIX_HV_Batterie_RTM_XIX_RTM_XIX_BMC_HV.DE_BMC_CMC_Temperatur_013, system-signal=BMC_CMC_Temperatur_013}
        sender-receiver-to-signal-mapping={communication-direction=OUT, data-element=HV_Batterie_RTM_XIX_RTM_XIX_BMC_HV.Geltungsbereich_E3_1_2_Premium.SP_IF_BMC_CMC_Temperatur_033_XIX_HV_Batterie_RTM_XIX_RTM_XIX_BMC_HV.DE_BMC_CMC_Temperatur_033, system-signal=BMC_CMC_Temperatur_033}
        sender-receiver-to-signal-mapping={communication-direction=OUT, data-element=HV_Batterie_RTM_XIX_RTM_XIX_BMC_HV.Geltungsbereich_E3_1_2_Premium.SP_IF_BMC_CMC_Temperatur_023_XIX_HV_Batterie_RTM_XIX_RTM_XIX_BMC_HV.DE_BMC_CMC_Temperatur_023, system-signal=BMC_CMC_Temperatur_023}
        sender-receiver-to-signal-mapping={communication-direction=OUT, data-element=HV_Batterie_RTM_XIX_RTM_XIX_BMC_HV.Geltungsbereich_E3_1_2_Premium.SP_IF_BMC_CMC_Temperatur_063_XIX_HV_Batterie_RTM_XIX_RTM_XIX_BMC_HV.DE_BMC_CMC_Temperatur_063, system-signal=BMC_CMC_Temperatur_063}
        sender-receiver-to-signal-mapping={communication-direction=OUT, data-element=HV_Batterie_RTM_XIX_RTM_XIX_BMC_HV.Geltungsbereich_E3_1_2_Premium.SP_IF_BMC_CMC_Temperatur_056_XIX_HV_Batterie_RTM_XIX_RTM_XIX_BMC_HV.DE_BMC_CMC_Temperatur_056, system-signal=BMC_CMC_Temperatur_056}
        sender-receiver-to-signal-mapping={communication-direction=OUT, data-element=HV_Batterie_RTM_XIX_RTM_XIX_BMC_HV.Geltungsbereich_E3_1_2_Premium.SP_IF_BMC_CMC_Temperatur_038_XIX_HV_Batterie_RTM_XIX_RTM_XIX_BMC_HV.DE_BMC_CMC_Temperatur_038, system-signal=BMC_CMC_Temperatur_038}
        sender-receiver-to-signal-mapping={communication-direction=OUT, data-element=HV_Batterie_RTM_XIX_RTM_XIX_BMC_HV.Geltungsbereich_E3_1_2_Premium.SP_IF_BMC_CMC_Temperatur_065_XIX_HV_Batterie_RTM_XIX_RTM_XIX_BMC_HV.DE_BMC_CMC_Temperatur_065, system-signal=BMC_CMC_Temperatur_065}
        sender-receiver-to-signal-mapping={communication-direction=OUT, data-element=HV_Batterie_RTM_XIX_RTM_XIX_BMC_HV.Geltungsbereich_E3_1_2_Premium.SP_IF_BMC_CMC_Temperatur_022_XIX_HV_Batterie_RTM_XIX_RTM_XIX_BMC_HV.DE_BMC_CMC_Temperatur_022, system-signal=BMC_CMC_Temperatur_022}
        sender-receiver-to-signal-mapping={communication-direction=OUT, data-element=HV_Batterie_RTM_XIX_RTM_XIX_BMC_HV.Geltungsbereich_E3_1_2_Premium.SP_IF_BMC_CMC_Temperatur_002_XIX_HV_Batterie_RTM_XIX_RTM_XIX_BMC_HV.DE_BMC_CMC_Temperatur_002, system-signal=BMC_CMC_Temperatur_002}
        sender-receiver-to-signal-mapping={communication-direction=OUT, data-element=HV_Batterie_RTM_XIX_RTM_XIX_BMC_HV.Geltungsbereich_E3_1_2_Premium.SP_IF_BMC_CMC_Temperatur_024_XIX_HV_Batterie_RTM_XIX_RTM_XIX_BMC_HV.DE_BMC_CMC_Temperatur_024, system-signal=BMC_CMC_Temperatur_024}
        sender-receiver-to-signal-mapping={communication-direction=OUT, data-element=HV_Batterie_RTM_XIX_RTM_XIX_BMC_HV.Geltungsbereich_E3_1_2_Premium.SP_IF_BMC_CMC_Temperatur_031_XIX_HV_Batterie_RTM_XIX_RTM_XIX_BMC_HV.DE_BMC_CMC_Temperatur_031, system-signal=BMC_CMC_Temperatur_031}
        sender-receiver-to-signal-mapping={communication-direction=OUT, data-element=HV_Batterie_RTM_XIX_RTM_XIX_BMC_HV.Geltungsbereich_E3_1_2_Premium.SP_IF_BMC_CMC_Temperatur_055_XIX_HV_Batterie_RTM_XIX_RTM_XIX_BMC_HV.DE_BMC_CMC_Temperatur_055, system-signal=BMC_CMC_Temperatur_055}
        sender-receiver-to-signal-mapping={communication-direction=OUT, data-element=HV_Batterie_RTM_XIX_RTM_XIX_BMC_HV.Geltungsbereich_E3_1_2_Premium.SP_IF_BMC_CMC_Temperatur_027_XIX_HV_Batterie_RTM_XIX_RTM_XIX_BMC_HV.DE_BMC_CMC_Temperatur_027, system-signal=BMC_CMC_Temperatur_027}
        sender-receiver-to-signal-mapping={communication-direction=OUT, data-element=HV_Batterie_RTM_XIX_RTM_XIX_BMC_HV.Geltungsbereich_E3_1_2_Premium.SP_IF_BMC_CMC_Temperatur_011_XIX_HV_Batterie_RTM_XIX_RTM_XIX_BMC_HV.DE_BMC_CMC_Temperatur_011, system-signal=BMC_CMC_Temperatur_011}
        sender-receiver-to-signal-mapping={communication-direction=OUT, data-element=HV_Batterie_RTM_XIX_RTM_XIX_BMC_HV.Geltungsbereich_E3_1_2_Premium.SP_IF_BMC_CMC_Temperatur_041_XIX_HV_Batterie_RTM_XIX_RTM_XIX_BMC_HV.DE_BMC_CMC_Temperatur_041, system-signal=BMC_CMC_Temperatur_041}
        sender-receiver-to-signal-mapping={communication-direction=OUT, data-element=HV_Batterie_RTM_XIX_RTM_XIX_BMC_HV.Geltungsbereich_E3_1_2_Premium.SP_IF_BMC_CMC_Temperatur_052_XIX_HV_Batterie_RTM_XIX_RTM_XIX_BMC_HV.DE_BMC_CMC_Temperatur_052, system-signal=BMC_CMC_Temperatur_052}
        sender-receiver-to-signal-mapping={communication-direction=OUT, data-element=HV_Batterie_RTM_XIX_RTM_XIX_BMC_HV.Geltungsbereich_E3_1_2_Premium.SP_IF_BMC_CMC_Temperatur_014_XIX_HV_Batterie_RTM_XIX_RTM_XIX_BMC_HV.DE_BMC_CMC_Temperatur_014, system-signal=BMC_CMC_Temperatur_014}
        sender-receiver-to-signal-mapping={communication-direction=OUT, data-element=HV_Batterie_RTM_XIX_RTM_XIX_BMC_HV.Geltungsbereich_E3_1_2_Premium.SP_IF_BMC_CMC_Temperatur_026_XIX_HV_Batterie_RTM_XIX_RTM_XIX_BMC_HV.DE_BMC_CMC_Temperatur_026, system-signal=BMC_CMC_Temperatur_026}
        sender-receiver-to-signal-mapping={communication-direction=OUT, data-element=HV_Batterie_RTM_XIX_RTM_XIX_BMC_HV.Geltungsbereich_E3_1_2_Premium.SP_IF_BMC_CMC_Temperatur_067_XIX_HV_Batterie_RTM_XIX_RTM_XIX_BMC_HV.DE_BMC_CMC_Temperatur_067, system-signal=BMC_CMC_Temperatur_067}
        sender-receiver-to-signal-mapping={communication-direction=OUT, data-element=HV_Batterie_RTM_XIX_RTM_XIX_BMC_HV.Geltungsbereich_E3_1_2_Premium.SP_IF_BMC_CMC_Temperatur_037_XIX_HV_Batterie_RTM_XIX_RTM_XIX_BMC_HV.DE_BMC_CMC_Temperatur_037, system-signal=BMC_CMC_Temperatur_037}
        sender-receiver-to-signal-mapping={communication-direction=OUT, data-element=HV_Batterie_RTM_XIX_RTM_XIX_BMC_HV.Geltungsbereich_E3_1_2_Premium.SP_IF_BMC_CMC_Temperatur_045_XIX_HV_Batterie_RTM_XIX_RTM_XIX_BMC_HV.DE_BMC_CMC_Temperatur_045, system-signal=BMC_CMC_Temperatur_045}
        sender-receiver-to-signal-mapping={communication-direction=OUT, data-element=HV_Batterie_RTM_XIX_RTM_XIX_BMC_HV.Geltungsbereich_E3_1_2_Premium.SP_IF_BMC_CMC_Temperatur_050_XIX_HV_Batterie_RTM_XIX_RTM_XIX_BMC_HV.DE_BMC_CMC_Temperatur_050, system-signal=BMC_CMC_Temperatur_050}
        sender-receiver-to-signal-mapping={communication-direction=OUT, data-element=HV_Batterie_RTM_XIX_RTM_XIX_BMC_HV.Geltungsbereich_E3_1_2_Premium.SP_IF_BMC_CMC_Temperatur_064_XIX_HV_Batterie_RTM_XIX_RTM_XIX_BMC_HV.DE_BMC_CMC_Temperatur_064, system-signal=BMC_CMC_Temperatur_064}
        sender-receiver-to-signal-mapping={communication-direction=OUT, data-element=HV_Batterie_RTM_XIX_RTM_XIX_BMC_HV.Geltungsbereich_E3_1_2_Premium.SP_IF_BMC_CMC_Temperatur_047_XIX_HV_Batterie_RTM_XIX_RTM_XIX_BMC_HV.DE_BMC_CMC_Temperatur_047, system-signal=BMC_CMC_Temperatur_047}
        sender-receiver-to-signal-mapping={communication-direction=OUT, data-element=HV_Batterie_RTM_XIX_RTM_XIX_BMC_HV.Geltungsbereich_E3_1_2_Premium.SP_IF_BMC_CMC_Temperatur_069_XIX_HV_Batterie_RTM_XIX_RTM_XIX_BMC_HV.DE_BMC_CMC_Temperatur_069, system-signal=BMC_CMC_Temperatur_069}
        sender-receiver-to-signal-mapping={communication-direction=OUT, data-element=HV_Batterie_RTM_XIX_RTM_XIX_BMC_HV.Geltungsbereich_E3_1_2_Premium.SP_IF_BMC_CMC_Temperatur_071_XIX_HV_Batterie_RTM_XIX_RTM_XIX_BMC_HV.DE_BMC_CMC_Temperatur_071, system-signal=BMC_CMC_Temperatur_071}
        sender-receiver-to-signal-mapping={communication-direction=OUT, data-element=HV_Batterie_RTM_XIX_RTM_XIX_BMC_HV.Geltungsbereich_E3_1_2_Premium.SP_IF_BMC_CMC_Temperatur_036_XIX_HV_Batterie_RTM_XIX_RTM_XIX_BMC_HV.DE_BMC_CMC_Temperatur_036, system-signal=BMC_CMC_Temperatur_036}
        sender-receiver-to-signal-mapping={communication-direction=OUT, data-element=HV_Batterie_RTM_XIX_RTM_XIX_BMC_HV.Geltungsbereich_E3_1_2_Premium.SP_IF_BMC_CMC_Temperatur_049_XIX_HV_Batterie_RTM_XIX_RTM_XIX_BMC_HV.DE_BMC_CMC_Temperatur_049, system-signal=BMC_CMC_Temperatur_049}
        sender-receiver-to-signal-mapping={communication-direction=OUT, data-element=HV_Batterie_RTM_XIX_RTM_XIX_BMC_HV.Geltungsbereich_E3_1_2_Premium.SP_IF_BMC_CMC_Temperatur_021_XIX_HV_Batterie_RTM_XIX_RTM_XIX_BMC_HV.DE_BMC_CMC_Temperatur_021, system-signal=BMC_CMC_Temperatur_021}
        sender-receiver-to-signal-mapping={communication-direction=OUT, data-element=HV_Batterie_RTM_XIX_RTM_XIX_BMC_HV.Geltungsbereich_E3_1_2_Premium.SP_IF_BMC_CMC_Temperatur_019_XIX_HV_Batterie_RTM_XIX_RTM_XIX_BMC_HV.DE_BMC_CMC_Temperatur_019, system-signal=BMC_CMC_Temperatur_019}
        sender-receiver-to-signal-mapping={communication-direction=OUT, data-element=HV_Batterie_RTM_XIX_RTM_XIX_BMC_HV.Geltungsbereich_E3_1_2_Premium.SP_IF_BMC_CMC_Temperatur_015_XIX_HV_Batterie_RTM_XIX_RTM_XIX_BMC_HV.DE_BMC_CMC_Temperatur_015, system-signal=BMC_CMC_Temperatur_015}
        sender-receiver-to-signal-mapping={communication-direction=OUT, data-element=HV_Batterie_RTM_XIX_RTM_XIX_BMC_HV.Geltungsbereich_E3_1_2_Premium.SP_IF_BMC_CMC_Temperatur_030_XIX_HV_Batterie_RTM_XIX_RTM_XIX_BMC_HV.DE_BMC_CMC_Temperatur_030, system-signal=BMC_CMC_Temperatur_030}
        sender-receiver-to-signal-mapping={communication-direction=OUT, data-element=HV_Batterie_RTM_XIX_RTM_XIX_BMC_HV.Geltungsbereich_E3_1_2_Premium.SP_IF_BMC_CMC_Temperatur_039_XIX_HV_Batterie_RTM_XIX_RTM_XIX_BMC_HV.DE_BMC_CMC_Temperatur_039, system-signal=BMC_CMC_Temperatur_039}
        sender-receiver-to-signal-mapping={communication-direction=OUT, data-element=HV_Batterie_RTM_XIX_RTM_XIX_BMC_HV.Geltungsbereich_E3_1_2_Premium.SP_IF_BMC_CMC_Temperatur_059_XIX_HV_Batterie_RTM_XIX_RTM_XIX_BMC_HV.DE_BMC_CMC_Temperatur_059, system-signal=BMC_CMC_Temperatur_059}
        sender-receiver-to-signal-mapping={communication-direction=OUT, data-element=HV_Batterie_RTM_XIX_RTM_XIX_BMC_HV.Geltungsbereich_E3_1_2_Premium.SP_IF_BMC_CMC_Temperatur_006_XIX_HV_Batterie_RTM_XIX_RTM_XIX_BMC_HV.DE_BMC_CMC_Temperatur_006, system-signal=BMC_CMC_Temperatur_006}
        sender-receiver-to-signal-mapping={communication-direction=OUT, data-element=HV_Batterie_RTM_XIX_RTM_XIX_BMC_HV.Geltungsbereich_E3_1_2_Premium.SP_IF_BMC_CMC_Temperatur_001_XIX_HV_Batterie_RTM_XIX_RTM_XIX_BMC_HV.DE_BMC_CMC_Temperatur_001, system-signal=BMC_CMC_Temperatur_001}
        sender-receiver-to-signal-mapping={communication-direction=OUT, data-element=HV_Batterie_RTM_XIX_RTM_XIX_BMC_HV.Geltungsbereich_E3_1_2_Premium.SP_IF_BMC_CMC_Temperatur_062_XIX_HV_Batterie_RTM_XIX_RTM_XIX_BMC_HV.DE_BMC_CMC_Temperatur_062, system-signal=BMC_CMC_Temperatur_062}
        sender-receiver-to-signal-mapping={communication-direction=OUT, data-element=HV_Batterie_RTM_XIX_RTM_XIX_BMC_HV.Geltungsbereich_E3_1_2_Premium.SP_IF_BMC_CMC_Temperatur_008_XIX_HV_Batterie_RTM_XIX_RTM_XIX_BMC_HV.DE_BMC_CMC_Temperatur_008, system-signal=BMC_CMC_Temperatur_008}
        sender-receiver-to-signal-mapping={communication-direction=OUT, data-element=HV_Batterie_RTM_XIX_RTM_XIX_BMC_HV.Geltungsbereich_E3_1_2_Premium.SP_IF_BMC_CMC_Temperatur_009_XIX_HV_Batterie_RTM_XIX_RTM_XIX_BMC_HV.DE_BMC_CMC_Temperatur_009, system-signal=BMC_CMC_Temperatur_009}
        sender-receiver-to-signal-mapping={communication-direction=OUT, data-element=HV_Batterie_RTM_XIX_RTM_XIX_BMC_HV.Geltungsbereich_E3_1_2_Premium.SP_IF_BMC_CMC_Temperatur_068_XIX_HV_Batterie_RTM_XIX_RTM_XIX_BMC_HV.DE_BMC_CMC_Temperatur_068, system-signal=BMC_CMC_Temperatur_068}
        sender-receiver-to-signal-mapping={communication-direction=OUT, data-element=HV_Batterie_RTM_XIX_RTM_XIX_BMC_HV.Geltungsbereich_E3_1_2_Premium.SP_IF_BMC_CMC_Temperatur_007_XIX_HV_Batterie_RTM_XIX_RTM_XIX_BMC_HV.DE_BMC_CMC_Temperatur_007, system-signal=BMC_CMC_Temperatur_007}
        sender-receiver-to-signal-mapping={communication-direction=OUT, data-element=HV_Batterie_RTM_XIX_RTM_XIX_BMC_HV.Geltungsbereich_E3_1_2_Premium.SP_IF_BMC_CMC_Temperatur_012_XIX_HV_Batterie_RTM_XIX_RTM_XIX_BMC_HV.DE_BMC_CMC_Temperatur_012, system-signal=BMC_CMC_Temperatur_012}
        sender-receiver-to-signal-mapping={communication-direction=OUT, data-element=HV_Batterie_RTM_XIX_RTM_XIX_BMC_HV.Geltungsbereich_E3_1_2_Premium.SP_IF_BMC_CMC_Temperatur_051_XIX_HV_Batterie_RTM_XIX_RTM_XIX_BMC_HV.DE_BMC_CMC_Temperatur_051, system-signal=BMC_CMC_Temperatur_051}
        sender-receiver-to-signal-mapping={communication-direction=OUT, data-element=HV_Batterie_RTM_XIX_RTM_XIX_BMC_HV.Geltungsbereich_E3_1_2_Premium.SP_IF_BMC_CMC_Temperatur_048_XIX_HV_Batterie_RTM_XIX_RTM_XIX_BMC_HV.DE_BMC_CMC_Temperatur_048, system-signal=BMC_CMC_Temperatur_048}
        sender-receiver-to-signal-mapping={communication-direction=OUT, data-element=HV_Batterie_RTM_XIX_RTM_XIX_BMC_HV.Geltungsbereich_E3_1_2_Premium.SP_IF_BMC_CMC_Temperatur_046_XIX_HV_Batterie_RTM_XIX_RTM_XIX_BMC_HV.DE_BMC_CMC_Temperatur_046, system-signal=BMC_CMC_Temperatur_046}
        sender-receiver-to-signal-mapping={communication-direction=OUT, data-element=HV_Batterie_RTM_XIX_RTM_XIX_BMC_HV.Geltungsbereich_E3_1_2_Premium.SP_IF_BMC_CMC_Temperatur_072_XIX_HV_Batterie_RTM_XIX_RTM_XIX_BMC_HV.DE_BMC_CMC_Temperatur_072, system-signal=BMC_CMC_Temperatur_072}
        sender-receiver-to-signal-mapping={communication-direction=OUT, data-element=HV_Batterie_RTM_XIX_RTM_XIX_BMC_HV.Geltungsbereich_E3_1_2_Premium.SP_IF_BMC_CMC_Temperatur_017_XIX_HV_Batterie_RTM_XIX_RTM_XIX_BMC_HV.DE_BMC_CMC_Temperatur_017, system-signal=BMC_CMC_Temperatur_017}
        sender-receiver-to-signal-mapping={communication-direction=OUT, data-element=HV_Batterie_RTM_XIX_RTM_XIX_BMC_HV.Geltungsbereich_E3_1_2_Premium.SP_IF_BMC_CMC_Temperatur_060_XIX_HV_Batterie_RTM_XIX_RTM_XIX_BMC_HV.DE_BMC_CMC_Temperatur_060, system-signal=BMC_CMC_Temperatur_060}
        sender-receiver-to-signal-mapping={communication-direction=OUT, data-element=HV_Batterie_RTM_XIX_RTM_XIX_BMC_HV.Geltungsbereich_E3_1_2_Premium.SP_IF_BMC_CMC_Temperatur_003_XIX_HV_Batterie_RTM_XIX_RTM_XIX_BMC_HV.DE_BMC_CMC_Temperatur_003, system-signal=BMC_CMC_Temperatur_003}
        sender-receiver-to-signal-mapping={communication-direction=OUT, data-element=HV_Batterie_RTM_XIX_RTM_XIX_BMC_HV.Geltungsbereich_E3_1_2_Premium.SP_IF_BMC_CMC_Temperatur_057_XIX_HV_Batterie_RTM_XIX_RTM_XIX_BMC_HV.DE_BMC_CMC_Temperatur_057, system-signal=BMC_CMC_Temperatur_057}
        sender-receiver-to-signal-mapping={communication-direction=OUT, data-element=HV_Batterie_RTM_XIX_RTM_XIX_BMC_HV.Geltungsbereich_E3_1_2_Premium.SP_IF_BMC_CMC_Temperatur_016_XIX_HV_Batterie_RTM_XIX_RTM_XIX_BMC_HV.DE_BMC_CMC_Temperatur_016, system-signal=BMC_CMC_Temperatur_016}
        sender-receiver-to-signal-mapping={communication-direction=OUT, data-element=HV_Batterie_RTM_XIX_RTM_XIX_BMC_HV.Geltungsbereich_E3_1_2_Premium.SP_IF_BMC_CMC_Temperatur_005_XIX_HV_Batterie_RTM_XIX_RTM_XIX_BMC_HV.DE_BMC_CMC_Temperatur_005, system-signal=BMC_CMC_Temperatur_005}
        sender-receiver-to-signal-mapping={communication-direction=OUT, data-element=HV_Batterie_RTM_XIX_RTM_XIX_BMC_HV.Geltungsbereich_E3_1_2_Premium.SP_IF_BMC_CMC_Temperatur_061_XIX_HV_Batterie_RTM_XIX_RTM_XIX_BMC_HV.DE_BMC_CMC_Temperatur_061, system-signal=BMC_CMC_Temperatur_061}
        sender-receiver-to-signal-mapping={communication-direction=OUT, data-element=HV_Batterie_RTM_XIX_RTM_XIX_BMC_HV.Geltungsbereich_E3_1_2_Premium.SP_IF_BMC_CMC_Temperatur_054_XIX_HV_Batterie_RTM_XIX_RTM_XIX_BMC_HV.DE_BMC_CMC_Temperatur_054, system-signal=BMC_CMC_Temperatur_054}
        sender-receiver-to-signal-mapping={communication-direction=OUT, data-element=HV_Batterie_RTM_XIX_RTM_XIX_BMC_HV.Geltungsbereich_E3_1_2_Premium.SP_IF_BMC_CMC_Temperatur_004_XIX_HV_Batterie_RTM_XIX_RTM_XIX_BMC_HV.DE_BMC_CMC_Temperatur_004, system-signal=BMC_CMC_Temperatur_004}
        sender-receiver-to-signal-mapping={communication-direction=OUT, data-element=HV_Batterie_RTM_XIX_RTM_XIX_BMC_HV.Geltungsbereich_E3_1_2_Premium.SP_IF_BMC_CMC_Temperatur_032_XIX_HV_Batterie_RTM_XIX_RTM_XIX_BMC_HV.DE_BMC_CMC_Temperatur_032, system-signal=BMC_CMC_Temperatur_032}
        sender-receiver-to-signal-mapping={communication-direction=OUT, data-element=HV_Batterie_RTM_XIX_RTM_XIX_BMC_HV.Geltungsbereich_E3_1_2_Premium.SP_IF_BMC_CMC_Temperatur_058_XIX_HV_Batterie_RTM_XIX_RTM_XIX_BMC_HV.DE_BMC_CMC_Temperatur_058, system-signal=BMC_CMC_Temperatur_058}
        sender-receiver-to-signal-mapping={communication-direction=OUT, data-element=HV_Batterie_RTM_XIX_RTM_XIX_BMC_HV.Geltungsbereich_E3_1_2_Premium.SP_IF_BMC_CMC_Temperatur_029_XIX_HV_Batterie_RTM_XIX_RTM_XIX_BMC_HV.DE_BMC_CMC_Temperatur_029, system-signal=BMC_CMC_Temperatur_029}
        sender-receiver-to-signal-mapping={communication-direction=OUT, data-element=HV_Batterie_RTM_XIX_RTM_XIX_BMC_HV.Geltungsbereich_E3_1_2_Premium.SP_IF_BMC_CMC_Temperatur_025_XIX_HV_Batterie_RTM_XIX_RTM_XIX_BMC_HV.DE_BMC_CMC_Temperatur_025, system-signal=BMC_CMC_Temperatur_025}
        sender-receiver-to-signal-mapping={communication-direction=OUT, data-element=HV_Batterie_RTM_XIX_RTM_XIX_BMC_HV.Geltungsbereich_E3_1_2_Premium.SP_IF_BMC_CMC_Temperatur_042_XIX_HV_Batterie_RTM_XIX_RTM_XIX_BMC_HV.DE_BMC_CMC_Temperatur_042, system-signal=BMC_CMC_Temperatur_042}
        sender-receiver-to-signal-mapping={communication-direction=OUT, data-element=HV_Batterie_RTM_XIX_RTM_XIX_BMC_HV.Geltungsbereich_E3_1_2_Premium.SP_IF_BMC_CMC_Temperatur_028_XIX_HV_Batterie_RTM_XIX_RTM_XIX_BMC_HV.DE_BMC_CMC_Temperatur_028, system-signal=BMC_CMC_Temperatur_028}
        sender-receiver-to-signal-mapping={communication-direction=OUT, data-element=HV_Batterie_RTM_XIX_RTM_XIX_BMC_HV.Geltungsbereich_E3_1_2_Premium.SP_IF_BMC_CMC_Temperatur_018_XIX_HV_Batterie_RTM_XIX_RTM_XIX_BMC_HV.DE_BMC_CMC_Temperatur_018, system-signal=BMC_CMC_Temperatur_018}
        sender-receiver-to-signal-mapping={communication-direction=OUT, data-element=HV_Batterie_RTM_XIX_RTM_XIX_BMC_HV.Geltungsbereich_E3_1_2_Premium.SP_IF_BMC_CMC_Temperatur_053_XIX_HV_Batterie_RTM_XIX_RTM_XIX_BMC_HV.DE_BMC_CMC_Temperatur_053, system-signal=BMC_CMC_Temperatur_053}
        sender-receiver-to-signal-mapping={communication-direction=OUT, data-element=HV_Batterie_RTM_XIX_RTM_XIX_BMC_HV.Geltungsbereich_E3_1_2_Premium.SP_IF_BMC_CMC_Temperatur_035_XIX_HV_Batterie_RTM_XIX_RTM_XIX_BMC_HV.DE_BMC_CMC_Temperatur_035, system-signal=BMC_CMC_Temperatur_035}
        sender-receiver-to-signal-mapping={communication-direction=OUT, data-element=HV_Batterie_RTM_XIX_RTM_XIX_BMC_HV.Geltungsbereich_E3_1_2_Premium.SP_IF_BMC_CMC_Temperatur_043_XIX_HV_Batterie_RTM_XIX_RTM_XIX_BMC_HV.DE_BMC_CMC_Temperatur_043, system-signal=BMC_CMC_Temperatur_043}
        sender-receiver-to-signal-mapping={communication-direction=OUT, data-element=HV_Batterie_RTM_XIX_RTM_XIX_BMC_HV.Geltungsbereich_E3_1_2_Premium.SP_IF_BMC_CMC_Temperatur_020_XIX_HV_Batterie_RTM_XIX_RTM_XIX_BMC_HV.DE_BMC_CMC_Temperatur_020, system-signal=BMC_CMC_Temperatur_020}
        sender-receiver-to-signal-mapping={communication-direction=OUT, data-element=HV_Batterie_RTM_XIX_RTM_XIX_BMC_HV.Geltungsbereich_E3_1_2_Premium.SP_IF_BMC_CMC_Zellspannung_025_XIX_HV_Batterie_RTM_XIX_RTM_XIX_BMC_HV.DE_BMC_CMC_Zellspannung_025, system-signal=BMC_CMC_Zellspannung_025}
        sender-receiver-to-signal-mapping={communication-direction=OUT, data-element=HV_Batterie_RTM_XIX_RTM_XIX_BMC_HV.Geltungsbereich_E3_1_2_Premium.SP_IF_BMC_CMC_Zellspannung_146_XIX_HV_Batterie_RTM_XIX_RTM_XIX_BMC_HV.DE_BMC_CMC_Zellspannung_146, system-signal=BMC_CMC_Zellspannung_146}
        sender-receiver-to-signal-mapping={communication-direction=OUT, data-element=HV_Batterie_RTM_XIX_RTM_XIX_BMC_HV.Geltungsbereich_E3_1_2_Premium.SP_IF_BMC_CMC_Zellspannung_059_XIX_HV_Batterie_RTM_XIX_RTM_XIX_BMC_HV.DE_BMC_CMC_Zellspannung_059, system-signal=BMC_CMC_Zellspannung_059}
        sender-receiver-to-signal-mapping={communication-direction=OUT, data-element=HV_Batterie_RTM_XIX_RTM_XIX_BMC_HV.Geltungsbereich_E3_1_2_Premium.SP_IF_BMC_CMC_Zellspannung_073_XIX_HV_Batterie_RTM_XIX_RTM_XIX_BMC_HV.DE_BMC_CMC_Zellspannung_073, system-signal=BMC_CMC_Zellspannung_073}
        sender-receiver-to-signal-mapping={communication-direction=OUT, data-element=HV_Batterie_RTM_XIX_RTM_XIX_BMC_HV.Geltungsbereich_E3_1_2_Premium.SP_IF_BMC_CMC_Zellspannung_191_XIX_HV_Batterie_RTM_XIX_RTM_XIX_BMC_HV.DE_BMC_CMC_Zellspannung_191, system-signal=BMC_CMC_Zellspannung_191}
        sender-receiver-to-signal-mapping={communication-direction=OUT, data-element=HV_Batterie_RTM_XIX_RTM_XIX_BMC_HV.Geltungsbereich_E3_1_2_Premium.SP_IF_BMC_CMC_Zellspannung_120_XIX_HV_Batterie_RTM_XIX_RTM_XIX_BMC_HV.DE_BMC_CMC_Zellspannung_120, system-signal=BMC_CMC_Zellspannung_120}
        sender-receiver-to-signal-mapping={communication-direction=OUT, data-element=HV_Batterie_RTM_XIX_RTM_XIX_BMC_HV.Geltungsbereich_E3_1_2_Premium.SP_IF_BMC_CMC_Zellspannung_045_XIX_HV_Batterie_RTM_XIX_RTM_XIX_BMC_HV.DE_BMC_CMC_Zellspannung_045, system-signal=BMC_CMC_Zellspannung_045}
        sender-receiver-to-signal-mapping={communication-direction=OUT, data-element=HV_Batterie_RTM_XIX_RTM_XIX_BMC_HV.Geltungsbereich_E3_1_2_Premium.SP_IF_BMC_CMC_Zellspannung_015_XIX_HV_Batterie_RTM_XIX_RTM_XIX_BMC_HV.DE_BMC_CMC_Zellspannung_015, system-signal=BMC_CMC_Zellspannung_015}
        sender-receiver-to-signal-mapping={communication-direction=OUT, data-element=HV_Batterie_RTM_XIX_RTM_XIX_BMC_HV.Geltungsbereich_E3_1_2_Premium.SP_IF_BMC_CMC_Zellspannung_043_XIX_HV_Batterie_RTM_XIX_RTM_XIX_BMC_HV.DE_BMC_CMC_Zellspannung_043, system-signal=BMC_CMC_Zellspannung_043}
        sender-receiver-to-signal-mapping={communication-direction=OUT, data-element=HV_Batterie_RTM_XIX_RTM_XIX_BMC_HV.Geltungsbereich_E3_1_2_Premium.SP_IF_BMC_CMC_Zellspannung_140_XIX_HV_Batterie_RTM_XIX_RTM_XIX_BMC_HV.DE_BMC_CMC_Zellspannung_140, system-signal=BMC_CMC_Zellspannung_140}
        sender-receiver-to-signal-mapping={communication-direction=OUT, data-element=HV_Batterie_RTM_XIX_RTM_XIX_BMC_HV.Geltungsbereich_E3_1_2_Premium.SP_IF_BMC_CMC_Zellspannung_101_XIX_HV_Batterie_RTM_XIX_RTM_XIX_BMC_HV.DE_BMC_CMC_Zellspannung_101, system-signal=BMC_CMC_Zellspannung_101}
        sender-receiver-to-signal-mapping={communication-direction=OUT, data-element=HV_Batterie_RTM_XIX_RTM_XIX_BMC_HV.Geltungsbereich_E3_1_2_Premium.SP_IF_BMC_CMC_Zellspannung_075_XIX_HV_Batterie_RTM_XIX_RTM_XIX_BMC_HV.DE_BMC_CMC_Zellspannung_075, system-signal=BMC_CMC_Zellspannung_075}
        sender-receiver-to-signal-mapping={communication-direction=OUT, data-element=HV_Batterie_RTM_XIX_RTM_XIX_BMC_HV.Geltungsbereich_E3_1_2_Premium.SP_IF_BMC_CMC_Zellspannung_181_XIX_HV_Batterie_RTM_XIX_RTM_XIX_BMC_HV.DE_BMC_CMC_Zellspannung_181, system-signal=BMC_CMC_Zellspannung_181}
        sender-receiver-to-signal-mapping={communication-direction=OUT, data-element=HV_Batterie_RTM_XIX_RTM_XIX_BMC_HV.Geltungsbereich_E3_1_2_Premium.SP_IF_BMC_CMC_Zellspannung_110_XIX_HV_Batterie_RTM_XIX_RTM_XIX_BMC_HV.DE_BMC_CMC_Zellspannung_110, system-signal=BMC_CMC_Zellspannung_110}
        sender-receiver-to-signal-mapping={communication-direction=OUT, data-element=HV_Batterie_RTM_XIX_RTM_XIX_BMC_HV.Geltungsbereich_E3_1_2_Premium.SP_IF_BMC_CMC_Zellspannung_018_XIX_HV_Batterie_RTM_XIX_RTM_XIX_BMC_HV.DE_BMC_CMC_Zellspannung_018, system-signal=BMC_CMC_Zellspannung_018}
        sender-receiver-to-signal-mapping={communication-direction=OUT, data-element=HV_Batterie_RTM_XIX_RTM_XIX_BMC_HV.Geltungsbereich_E3_1_2_Premium.SP_IF_BMC_CMC_Zellspannung_088_XIX_HV_Batterie_RTM_XIX_RTM_XIX_BMC_HV.DE_BMC_CMC_Zellspannung_088, system-signal=BMC_CMC_Zellspannung_088}
        sender-receiver-to-signal-mapping={communication-direction=OUT, data-element=HV_Batterie_RTM_XIX_RTM_XIX_BMC_HV.Geltungsbereich_E3_1_2_Premium.SP_IF_BMC_CMC_Zellspannung_111_XIX_HV_Batterie_RTM_XIX_RTM_XIX_BMC_HV.DE_BMC_CMC_Zellspannung_111, system-signal=BMC_CMC_Zellspannung_111}
        sender-receiver-to-signal-mapping={communication-direction=OUT, data-element=HV_Batterie_RTM_XIX_RTM_XIX_BMC_HV.Geltungsbereich_E3_1_2_Premium.SP_IF_BMC_CMC_Zellspannung_158_XIX_HV_Batterie_RTM_XIX_RTM_XIX_BMC_HV.DE_BMC_CMC_Zellspannung_158, system-signal=BMC_CMC_Zellspannung_158}
        sender-receiver-to-signal-mapping={communication-direction=OUT, data-element=HV_Batterie_RTM_XIX_RTM_XIX_BMC_HV.Geltungsbereich_E3_1_2_Premium.SP_IF_BMC_CMC_Zellspannung_113_XIX_HV_Batterie_RTM_XIX_RTM_XIX_BMC_HV.DE_BMC_CMC_Zellspannung_113, system-signal=BMC_CMC_Zellspannung_113}
        sender-receiver-to-signal-mapping={communication-direction=OUT, data-element=HV_Batterie_RTM_XIX_RTM_XIX_BMC_HV.Geltungsbereich_E3_1_2_Premium.SP_IF_BMC_CMC_Zellspannung_152_XIX_HV_Batterie_RTM_XIX_RTM_XIX_BMC_HV.DE_BMC_CMC_Zellspannung_152, system-signal=BMC_CMC_Zellspannung_152}
        sender-receiver-to-signal-mapping={communication-direction=OUT, data-element=HV_Batterie_RTM_XIX_RTM_XIX_BMC_HV.Geltungsbereich_E3_1_2_Premium.SP_IF_BMC_CMC_Zellspannung_019_XIX_HV_Batterie_RTM_XIX_RTM_XIX_BMC_HV.DE_BMC_CMC_Zellspannung_019, system-signal=BMC_CMC_Zellspannung_019}
        sender-receiver-to-signal-mapping={communication-direction=OUT, data-element=HV_Batterie_RTM_XIX_RTM_XIX_BMC_HV.Geltungsbereich_E3_1_2_Premium.SP_IF_BMC_CMC_Zellspannung_013_XIX_HV_Batterie_RTM_XIX_RTM_XIX_BMC_HV.DE_BMC_CMC_Zellspannung_013, system-signal=BMC_CMC_Zellspannung_013}
        sender-receiver-to-signal-mapping={communication-direction=OUT, data-element=HV_Batterie_RTM_XIX_RTM_XIX_BMC_HV.Geltungsbereich_E3_1_2_Premium.SP_IF_BMC_CMC_Zellspannung_123_XIX_HV_Batterie_RTM_XIX_RTM_XIX_BMC_HV.DE_BMC_CMC_Zellspannung_123, system-signal=BMC_CMC_Zellspannung_123}
        sender-receiver-to-signal-mapping={communication-direction=OUT, data-element=HV_Batterie_RTM_XIX_RTM_XIX_BMC_HV.Geltungsbereich_E3_1_2_Premium.SP_IF_BMC_CMC_Zellspannung_069_XIX_HV_Batterie_RTM_XIX_RTM_XIX_BMC_HV.DE_BMC_CMC_Zellspannung_069, system-signal=BMC_CMC_Zellspannung_069}
        sender-receiver-to-signal-mapping={communication-direction=OUT, data-element=HV_Batterie_RTM_XIX_RTM_XIX_BMC_HV.Geltungsbereich_E3_1_2_Premium.SP_IF_BMC_CMC_Zellspannung_023_XIX_HV_Batterie_RTM_XIX_RTM_XIX_BMC_HV.DE_BMC_CMC_Zellspannung_023, system-signal=BMC_CMC_Zellspannung_023}
        sender-receiver-to-signal-mapping={communication-direction=OUT, data-element=HV_Batterie_RTM_XIX_RTM_XIX_BMC_HV.Geltungsbereich_E3_1_2_Premium.SP_IF_BMC_CMC_Zellspannung_129_XIX_HV_Batterie_RTM_XIX_RTM_XIX_BMC_HV.DE_BMC_CMC_Zellspannung_129, system-signal=BMC_CMC_Zellspannung_129}
        sender-receiver-to-signal-mapping={communication-direction=OUT, data-element=HV_Batterie_RTM_XIX_RTM_XIX_BMC_HV.Geltungsbereich_E3_1_2_Premium.SP_IF_BMC_CMC_Zellspannung_042_XIX_HV_Batterie_RTM_XIX_RTM_XIX_BMC_HV.DE_BMC_CMC_Zellspannung_042, system-signal=BMC_CMC_Zellspannung_042}
        sender-receiver-to-signal-mapping={communication-direction=OUT, data-element=HV_Batterie_RTM_XIX_RTM_XIX_BMC_HV.Geltungsbereich_E3_1_2_Premium.SP_IF_BMC_CMC_Zellspannung_137_XIX_HV_Batterie_RTM_XIX_RTM_XIX_BMC_HV.DE_BMC_CMC_Zellspannung_137, system-signal=BMC_CMC_Zellspannung_137}
        sender-receiver-to-signal-mapping={communication-direction=OUT, data-element=HV_Batterie_RTM_XIX_RTM_XIX_BMC_HV.Geltungsbereich_E3_1_2_Premium.SP_IF_BMC_CMC_Zellspannung_150_XIX_HV_Batterie_RTM_XIX_RTM_XIX_BMC_HV.DE_BMC_CMC_Zellspannung_150, system-signal=BMC_CMC_Zellspannung_150}
        sender-receiver-to-signal-mapping={communication-direction=OUT, data-element=HV_Batterie_RTM_XIX_RTM_XIX_BMC_HV.Geltungsbereich_E3_1_2_Premium.SP_IF_BMC_CMC_Zellspannung_031_XIX_HV_Batterie_RTM_XIX_RTM_XIX_BMC_HV.DE_BMC_CMC_Zellspannung_031, system-signal=BMC_CMC_Zellspannung_031}
        sender-receiver-to-signal-mapping={communication-direction=OUT, data-element=HV_Batterie_RTM_XIX_RTM_XIX_BMC_HV.Geltungsbereich_E3_1_2_Premium.SP_IF_BMC_CMC_Zellspannung_057_XIX_HV_Batterie_RTM_XIX_RTM_XIX_BMC_HV.DE_BMC_CMC_Zellspannung_057, system-signal=BMC_CMC_Zellspannung_057}
        sender-receiver-to-signal-mapping={communication-direction=OUT, data-element=HV_Batterie_RTM_XIX_RTM_XIX_BMC_HV.Geltungsbereich_E3_1_2_Premium.SP_IF_BMC_CMC_Zellspannung_178_XIX_HV_Batterie_RTM_XIX_RTM_XIX_BMC_HV.DE_BMC_CMC_Zellspannung_178, system-signal=BMC_CMC_Zellspannung_178}
        sender-receiver-to-signal-mapping={communication-direction=OUT, data-element=HV_Batterie_RTM_XIX_RTM_XIX_BMC_HV.Geltungsbereich_E3_1_2_Premium.SP_IF_BMC_CMC_Zellspannung_090_XIX_HV_Batterie_RTM_XIX_RTM_XIX_BMC_HV.DE_BMC_CMC_Zellspannung_090, system-signal=BMC_CMC_Zellspannung_090}
        sender-receiver-to-signal-mapping={communication-direction=OUT, data-element=HV_Batterie_RTM_XIX_RTM_XIX_BMC_HV.Geltungsbereich_E3_1_2_Premium.SP_IF_BMC_CMC_Zellspannung_080_XIX_HV_Batterie_RTM_XIX_RTM_XIX_BMC_HV.DE_BMC_CMC_Zellspannung_080, system-signal=BMC_CMC_Zellspannung_080}
        sender-receiver-to-signal-mapping={communication-direction=OUT, data-element=HV_Batterie_RTM_XIX_RTM_XIX_BMC_HV.Geltungsbereich_E3_1_2_Premium.SP_IF_BMC_CMC_Zellspannung_054_XIX_HV_Batterie_RTM_XIX_RTM_XIX_BMC_HV.DE_BMC_CMC_Zellspannung_054, system-signal=BMC_CMC_Zellspannung_054}
        sender-receiver-to-signal-mapping={communication-direction=OUT, data-element=HV_Batterie_RTM_XIX_RTM_XIX_BMC_HV.Geltungsbereich_E3_1_2_Premium.SP_IF_BMC_CMC_Zellspannung_067_XIX_HV_Batterie_RTM_XIX_RTM_XIX_BMC_HV.DE_BMC_CMC_Zellspannung_067, system-signal=BMC_CMC_Zellspannung_067}
        sender-receiver-to-signal-mapping={communication-direction=OUT, data-element=HV_Batterie_RTM_XIX_RTM_XIX_BMC_HV.Geltungsbereich_E3_1_2_Premium.SP_IF_BMC_CMC_Zellspannung_076_XIX_HV_Batterie_RTM_XIX_RTM_XIX_BMC_HV.DE_BMC_CMC_Zellspannung_076, system-signal=BMC_CMC_Zellspannung_076}
        sender-receiver-to-signal-mapping={communication-direction=OUT, data-element=HV_Batterie_RTM_XIX_RTM_XIX_BMC_HV.Geltungsbereich_E3_1_2_Premium.SP_IF_BMC_CMC_Zellspannung_189_XIX_HV_Batterie_RTM_XIX_RTM_XIX_BMC_HV.DE_BMC_CMC_Zellspannung_189, system-signal=BMC_CMC_Zellspannung_189}
        sender-receiver-to-signal-mapping={communication-direction=OUT, data-element=HV_Batterie_RTM_XIX_RTM_XIX_BMC_HV.Geltungsbereich_E3_1_2_Premium.SP_IF_BMC_CMC_Zellspannung_131_XIX_HV_Batterie_RTM_XIX_RTM_XIX_BMC_HV.DE_BMC_CMC_Zellspannung_131, system-signal=BMC_CMC_Zellspannung_131}
        sender-receiver-to-signal-mapping={communication-direction=OUT, data-element=HV_Batterie_RTM_XIX_RTM_XIX_BMC_HV.Geltungsbereich_E3_1_2_Premium.SP_IF_BMC_CMC_Zellspannung_115_XIX_HV_Batterie_RTM_XIX_RTM_XIX_BMC_HV.DE_BMC_CMC_Zellspannung_115, system-signal=BMC_CMC_Zellspannung_115}
        sender-receiver-to-signal-mapping={communication-direction=OUT, data-element=HV_Batterie_RTM_XIX_RTM_XIX_BMC_HV.Geltungsbereich_E3_1_2_Premium.SP_IF_BMC_CMC_Zellspannung_005_XIX_HV_Batterie_RTM_XIX_RTM_XIX_BMC_HV.DE_BMC_CMC_Zellspannung_005, system-signal=BMC_CMC_Zellspannung_005}
        sender-receiver-to-signal-mapping={communication-direction=OUT, data-element=HV_Batterie_RTM_XIX_RTM_XIX_BMC_HV.Geltungsbereich_E3_1_2_Premium.SP_IF_BMC_CMC_Zellspannung_098_XIX_HV_Batterie_RTM_XIX_RTM_XIX_BMC_HV.DE_BMC_CMC_Zellspannung_098, system-signal=BMC_CMC_Zellspannung_098}
        sender-receiver-to-signal-mapping={communication-direction=OUT, data-element=HV_Batterie_RTM_XIX_RTM_XIX_BMC_HV.Geltungsbereich_E3_1_2_Premium.SP_IF_BMC_CMC_Zellspannung_133_XIX_HV_Batterie_RTM_XIX_RTM_XIX_BMC_HV.DE_BMC_CMC_Zellspannung_133, system-signal=BMC_CMC_Zellspannung_133}
        sender-receiver-to-signal-mapping={communication-direction=OUT, data-element=HV_Batterie_RTM_XIX_RTM_XIX_BMC_HV.Geltungsbereich_E3_1_2_Premium.SP_IF_BMC_CMC_Zellspannung_077_XIX_HV_Batterie_RTM_XIX_RTM_XIX_BMC_HV.DE_BMC_CMC_Zellspannung_077, system-signal=BMC_CMC_Zellspannung_077}
        sender-receiver-to-signal-mapping={communication-direction=OUT, data-element=HV_Batterie_RTM_XIX_RTM_XIX_BMC_HV.Geltungsbereich_E3_1_2_Premium.SP_IF_BMC_CMC_Zellspannung_089_XIX_HV_Batterie_RTM_XIX_RTM_XIX_BMC_HV.DE_BMC_CMC_Zellspannung_089, system-signal=BMC_CMC_Zellspannung_089}
        sender-receiver-to-signal-mapping={communication-direction=OUT, data-element=HV_Batterie_RTM_XIX_RTM_XIX_BMC_HV.Geltungsbereich_E3_1_2_Premium.SP_IF_BMC_CMC_Zellspannung_091_XIX_HV_Batterie_RTM_XIX_RTM_XIX_BMC_HV.DE_BMC_CMC_Zellspannung_091, system-signal=BMC_CMC_Zellspannung_091}
        sender-receiver-to-signal-mapping={communication-direction=OUT, data-element=HV_Batterie_RTM_XIX_RTM_XIX_BMC_HV.Geltungsbereich_E3_1_2_Premium.SP_IF_BMC_CMC_Zellspannung_180_XIX_HV_Batterie_RTM_XIX_RTM_XIX_BMC_HV.DE_BMC_CMC_Zellspannung_180, system-signal=BMC_CMC_Zellspannung_180}
        sender-receiver-to-signal-mapping={communication-direction=OUT, data-element=HV_Batterie_RTM_XIX_RTM_XIX_BMC_HV.Geltungsbereich_E3_1_2_Premium.SP_IF_BMC_CMC_Zellspannung_065_XIX_HV_Batterie_RTM_XIX_RTM_XIX_BMC_HV.DE_BMC_CMC_Zellspannung_065, system-signal=BMC_CMC_Zellspannung_065}
        sender-receiver-to-signal-mapping={communication-direction=OUT, data-element=HV_Batterie_RTM_XIX_RTM_XIX_BMC_HV.Geltungsbereich_E3_1_2_Premium.SP_IF_BMC_CMC_Zellspannung_119_XIX_HV_Batterie_RTM_XIX_RTM_XIX_BMC_HV.DE_BMC_CMC_Zellspannung_119, system-signal=BMC_CMC_Zellspannung_119}
        sender-receiver-to-signal-mapping={communication-direction=OUT, data-element=HV_Batterie_RTM_XIX_RTM_XIX_BMC_HV.Geltungsbereich_E3_1_2_Premium.SP_IF_BMC_CMC_Zellspannung_004_XIX_HV_Batterie_RTM_XIX_RTM_XIX_BMC_HV.DE_BMC_CMC_Zellspannung_004, system-signal=BMC_CMC_Zellspannung_004}
        sender-receiver-to-signal-mapping={communication-direction=OUT, data-element=HV_Batterie_RTM_XIX_RTM_XIX_BMC_HV.Geltungsbereich_E3_1_2_Premium.SP_IF_BMC_CMC_Zellspannung_100_XIX_HV_Batterie_RTM_XIX_RTM_XIX_BMC_HV.DE_BMC_CMC_Zellspannung_100, system-signal=BMC_CMC_Zellspannung_100}
        sender-receiver-to-signal-mapping={communication-direction=OUT, data-element=HV_Batterie_RTM_XIX_RTM_XIX_BMC_HV.Geltungsbereich_E3_1_2_Premium.SP_IF_BMC_CMC_Zellspannung_162_XIX_HV_Batterie_RTM_XIX_RTM_XIX_BMC_HV.DE_BMC_CMC_Zellspannung_162, system-signal=BMC_CMC_Zellspannung_162}
        sender-receiver-to-signal-mapping={communication-direction=OUT, data-element=HV_Batterie_RTM_XIX_RTM_XIX_BMC_HV.Geltungsbereich_E3_1_2_Premium.SP_IF_BMC_CMC_Zellspannung_093_XIX_HV_Batterie_RTM_XIX_RTM_XIX_BMC_HV.DE_BMC_CMC_Zellspannung_093, system-signal=BMC_CMC_Zellspannung_093}
        sender-receiver-to-signal-mapping={communication-direction=OUT, data-element=HV_Batterie_RTM_XIX_RTM_XIX_BMC_HV.Geltungsbereich_E3_1_2_Premium.SP_IF_BMC_CMC_Zellspannung_185_XIX_HV_Batterie_RTM_XIX_RTM_XIX_BMC_HV.DE_BMC_CMC_Zellspannung_185, system-signal=BMC_CMC_Zellspannung_185}
        sender-receiver-to-signal-mapping={communication-direction=OUT, data-element=HV_Batterie_RTM_XIX_RTM_XIX_BMC_HV.Geltungsbereich_E3_1_2_Premium.SP_IF_BMC_CMC_Zellspannung_055_XIX_HV_Batterie_RTM_XIX_RTM_XIX_BMC_HV.DE_BMC_CMC_Zellspannung_055, system-signal=BMC_CMC_Zellspannung_055}
        sender-receiver-to-signal-mapping={communication-direction=OUT, data-element=HV_Batterie_RTM_XIX_RTM_XIX_BMC_HV.Geltungsbereich_E3_1_2_Premium.SP_IF_BMC_CMC_Zellspannung_169_XIX_HV_Batterie_RTM_XIX_RTM_XIX_BMC_HV.DE_BMC_CMC_Zellspannung_169, system-signal=BMC_CMC_Zellspannung_169}
