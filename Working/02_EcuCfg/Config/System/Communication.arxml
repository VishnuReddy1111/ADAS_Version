[part 5 of 5: packages /PDU to /VectorAutosarExplorerGeneratedObjects/PDU_GROUP]
AUTOSAR XML (schema 4-3-0)
package /PDU
  dcm i pdu DCM_BMC_CAN01_XIX_TPCHType_CANHS_Flash_DIA_XIX_0x17FC16D0_XIX_0x17FE16D0_XIX_Physical: length=512, diag-pdu-type=DIAG-REQUEST
  dcm i pdu DCM_BMC_CAN01_XIX_TPCHType_CANHS_Flash_DIA_XIX_0x17FC17B1_XIX_0x17FE17B1_XIX_Physical: length=512, diag-pdu-type=DIAG-REQUEST
  dcm i pdu DCM_BMC_CAN01_XIX_TPCHType_CANHS_Flash_DIA_XIX_0x17FC17B2_XIX_0x17FE17B2_XIX_Physical: length=512, diag-pdu-type=DIAG-REQUEST
  dcm i pdu DCM_BMC_CAN01_XIX_TPCHType_CANHS_Flash_DIA_XIX_0x17FE16D0_XIX_0x17FC16D0_XIX_Physical: length=512, diag-pdu-type=DIAG-RESPONSE
  dcm i pdu DCM_BMC_CAN01_XIX_TPCHType_CANHS_Flash_DIA_XIX_0x17FE17B1_XIX_0x17FC17B1_XIX_Physical: length=512, diag-pdu-type=DIAG-RESPONSE
  dcm i pdu DCM_BMC_CAN01_XIX_TPCHType_CANHS_Flash_DIA_XIX_0x17FE17B2_XIX_0x17FC17B2_XIX_Physical: length=512, diag-pdu-type=DIAG-RESPONSE
  dcm i pdu DCM_BMC_CAN01_XIX_TPCHType_CANHS_ISO_Diagnose_XIX_0x700_XIX_Functional: length=6, diag-pdu-type=DIAG-REQUEST
  dcm i pdu DCM_BMC_CAN01_XIX_TPCHType_CANHS_OBDC_Diagnose_XIX_0x17FD0200_XIX_Functional: length=6, diag-pdu-type=DIAG-REQUEST
  dcm i pdu DCM_BMC_CAN01_XIX_TPCHType_CANHS_OBDC_SSN_Diagnose_XIX_0x17FC70D0_XIX_0x17FE70D0_XIX_Physical: length=512, diag-pdu-type=DIAG-REQUEST
  dcm i pdu DCM_BMC_CAN01_XIX_TPCHType_CANHS_OBDC_SSN_Diagnose_XIX_0x17FC71B1_XIX_0x17FE71B1_XIX_Physical: length=512, diag-pdu-type=DIAG-REQUEST
  dcm i pdu DCM_BMC_CAN01_XIX_TPCHType_CANHS_OBDC_SSN_Diagnose_XIX_0x17FC71B2_XIX_0x17FE71B2_XIX_Physical: length=512, diag-pdu-type=DIAG-REQUEST
  dcm i pdu DCM_BMC_CAN01_XIX_TPCHType_CANHS_OBDC_SSN_Diagnose_XIX_0x17FE70D0_XIX_0x17FC70D0_XIX_Physical: length=512, diag-pdu-type=DIAG-RESPONSE
  dcm i pdu DCM_BMC_CAN01_XIX_TPCHType_CANHS_OBDC_SSN_Diagnose_XIX_0x17FE71B1_XIX_0x17FC71B1_XIX_Physical: length=512, diag-pdu-type=DIAG-RESPONSE
  dcm i pdu DCM_BMC_CAN01_XIX_TPCHType_CANHS_OBDC_SSN_Diagnose_XIX_0x17FE71B2_XIX_0x17FC71B2_XIX_Physical: length=512, diag-pdu-type=DIAG-RESPONSE
  dcm i pdu DCM_HCP5_CANFD01_XIX_TPCHType_CANFD_ISO_Diagnose_XIX_0x1C40007B_XIX_0x1C42007B_XIX_Physical: length=512, diag-pdu-type=DIAG-REQUEST
  dcm i pdu DCM_HCP5_CANFD01_XIX_TPCHType_CANFD_ISO_Diagnose_XIX_0x1C410000_XIX_Functional: length=62, diag-pdu-type=DIAG-REQUEST
  dcm i pdu DCM_HCP5_CANFD01_XIX_TPCHType_CANFD_ISO_Diagnose_XIX_0x1C42007B_XIX_0x1C40007B_XIX_Physical: length=512, diag-pdu-type=DIAG-RESPONSE
  dcm i pdu DCM_HCP5_CANFD01_XIX_TPCHType_CANFD_OBDC_Diagnose_XIX_0x1C40027B_XIX_0x1C42027B_XIX_Physical: length=512, diag-pdu-type=DIAG-REQUEST
  dcm i pdu DCM_HCP5_CANFD01_XIX_TPCHType_CANFD_OBDC_Diagnose_XIX_0x1C410200_XIX_Functional: length=62, diag-pdu-type=DIAG-REQUEST
  dcm i pdu DCM_HCP5_CANFD01_XIX_TPCHType_CANFD_OBDC_Diagnose_XIX_0x1C42027B_XIX_0x1C40027B_XIX_Physical: length=512, diag-pdu-type=DIAG-RESPONSE
  dcm i pdu DCM_HCP5_CANFD01_XIX_TPCHType_CANHS_Flash_DIA_XIX_0x17FC16D0_XIX_0x17FE16D0_XIX_Physical: length=512, diag-pdu-type=DIAG-REQUEST
  dcm i pdu DCM_HCP5_CANFD01_XIX_TPCHType_CANHS_Flash_DIA_XIX_0x17FC17B1_XIX_0x17FE17B1_XIX_Physical: length=512, diag-pdu-type=DIAG-REQUEST
  dcm i pdu DCM_HCP5_CANFD01_XIX_TPCHType_CANHS_Flash_DIA_XIX_0x17FC17B2_XIX_0x17FE17B2_XIX_Physical: length=512, diag-pdu-type=DIAG-REQUEST
  dcm i pdu DCM_HCP5_CANFD01_XIX_TPCHType_CANHS_Flash_DIA_XIX_0x17FE16D0_XIX_0x17FC16D0_XIX_Physical: length=512, diag-pdu-type=DIAG-RESPONSE
  dcm i pdu DCM_HCP5_CANFD01_XIX_TPCHType_CANHS_Flash_DIA_XIX_0x17FE17B1_XIX_0x17FC17B1_XIX_Physical: length=512, diag-pdu-type=DIAG-RESPONSE
  dcm i pdu DCM_HCP5_CANFD01_XIX_TPCHType_CANHS_Flash_DIA_XIX_0x17FE17B2_XIX_0x17FC17B2_XIX_Physical: length=512, diag-pdu-type=DIAG-RESPONSE
  dcm i pdu DCM_HCP5_CANFD01_XIX_TPCHType_CANHS_ISO_Diagnose_XIX_0x17FC007B_XIX_0x17FE007B_XIX_Physical: length=512, diag-pdu-type=DIAG-REQUEST
  dcm i pdu DCM_HCP5_CANFD01_XIX_TPCHType_CANHS_ISO_Diagnose_XIX_0x17FE007B_XIX_0x17FC007B_XIX_Physical: length=512, diag-pdu-type=DIAG-RESPONSE
  dcm i pdu DCM_HCP5_CANFD01_XIX_TPCHType_CANHS_ISO_Diagnose_XIX_0x700_XIX_Functional: length=62, diag-pdu-type=DIAG-REQUEST
  dcm i pdu DCM_HCP5_CANFD01_XIX_TPCHType_CANHS_OBDC_SSN_Diagnose_XIX_0x17FC70D0_XIX_0x17FE70D0_XIX_Physical: length=512, diag-pdu-type=DIAG-REQUEST
  dcm i pdu DCM_HCP5_CANFD01_XIX_TPCHType_CANHS_OBDC_SSN_Diagnose_XIX_0x17FC71B1_XIX_0x17FE71B1_XIX_Physical: length=512, diag-pdu-type=DIAG-REQUEST
  dcm i pdu DCM_HCP5_CANFD01_XIX_TPCHType_CANHS_OBDC_SSN_Diagnose_XIX_0x17FC71B2_XIX_0x17FE71B2_XIX_Physical: length=512, diag-pdu-type=DIAG-REQUEST
  dcm i pdu DCM_HCP5_CANFD01_XIX_TPCHType_CANHS_OBDC_SSN_Diagnose_XIX_0x17FE70D0_XIX_0x17FC70D0_XIX_Physical: length=512, diag-pdu-type=DIAG-RESPONSE
  dcm i pdu DCM_HCP5_CANFD01_XIX_TPCHType_CANHS_OBDC_SSN_Diagnose_XIX_0x17FE71B1_XIX_0x17FC71B1_XIX_Physical: length=512, diag-pdu-type=DIAG-RESPONSE
  dcm i pdu DCM_HCP5_CANFD01_XIX_TPCHType_CANHS_OBDC_SSN_Diagnose_XIX_0x17FE71B2_XIX_0x17FC71B2_XIX_Physical: length=512, diag-pdu-type=DIAG-RESPONSE
  dcm i pdu DCM_HCP5_CANFD01_XIX_TPCHType_CANHS_OBDx_XIX_0x18DA05F1_XIX_0x18DAF105_XIX_Physical: length=512, diag-pdu-type=DIAG-REQUEST
  dcm i pdu DCM_HCP5_CANFD01_XIX_TPCHType_CANHS_OBDx_XIX_0x18DAF105_XIX_0x18DA05F1_XIX_Physical: length=512, diag-pdu-type=DIAG-RESPONSE
  dcm i pdu DCM_HCP5_CANFD01_XIX_TPCHType_CANHS_OBDx_XIX_0x18DB33F1_XIX_Functional: length=62, diag-pdu-type=DIAG-REQUEST
  pdu BMC_HV_01_XIX_HCP5_CANFD01_E2E: length=16, transmission-mode-true-timing=event-controlled-timing={number-of-repetitions=0, repetition-period=0}, unused-bit-pattern=0  # Fuer die Botschaft ist das Cyclic-Timing 0.01 zu verwenden.
    signal BMC_HV_01_CRC_XIX_BMC_HV_01_XIX_HCP5_CANFD01: start 0, 8 bit, little-endian, data-type-policy=OVERRIDE, i-signal-type=PRIMITIVE, init-value=0, base-type=BT_BMC_HV_01_CRC, compu-method=CM_BMC_HV_01_CRC, data-constr=DC_BMC_HV_01_CRC  # Für MLB: Berechnung siehe Lastenheft "Kommunikationsabsicherung für FlexRay und CAN" Ab MQB und MLBevo: Berechnung siehe Lastenheft "End-to-End Kommunikationsabsicherung" Endwerte siehe Begleitdokument "S-PDU Kennungsfolgen"
    signal BMC_HV_01_BZ_XIX_BMC_HV_01_XIX_HCP5_CANFD01: start 8, 4 bit, little-endian, data-type-policy=OVERRIDE, i-signal-type=PRIMITIVE, init-value=0, base-type=BT_BMC_HV_01_BZ, compu-method=CM_BMC_HV_01_BZ, data-constr=DC_BMC_HV_01_BZ  # 4bit Botschaftszähler, wird mit jeder Sendebotschaft inkrementiert
    signal BMC_Bankstatus_XIX_BMC_HV_01_XIX_HCP5_CANFD01: start 12, 4 bit, little-endian, data-type-policy=OVERRIDE, i-signal-type=PRIMITIVE, init-value=14, base-type=BT_BMC_Bankstatus, invalid-value=Invalid_BMC_Bankstatus_XIX_BMC_HV_01_XIX_HCP5_CANFD01:15, compu-method=CM_BMC_Bankstatus, data-constr=DC_BMC_Bankstatus  # Feedback vom BMS an den HVK welche Bank geschaltet wurde
    signal BMC_Spannung_XIX_BMC_HV_01_XIX_HCP5_CANFD01: start 16, 14 bit, little-endian, data-type-policy=OVERRIDE, i-signal-type=PRIMITIVE, init-value=16382, base-type=BT_BMC_Spannung, invalid-value=Invalid_BMC_Spannung_XIX_BMC_HV_01_XIX_HCP5_CANFD01:16383, compu-method=CM_BMC_Spannung, data-constr=DC_BMC_Spannung, unit=Unit_Unit_Volt  # actual voltage of the battery / Momentanwert: Batteriespannung
    signal BMC_HVK_EoHVL_Status_XIX_BMC_HV_01_XIX_HCP5_CANFD01: start 30, 2 bit, little-endian, data-type-policy=OVERRIDE, i-signal-type=PRIMITIVE, init-value=0, base-type=BT_BMC_HVK_EoHVL_Status, invalid-value=Invalid_BMC_HVK_EoHVL_Status_XIX_BMC_HV_01_XIX_HCP5_CANFD01:3, compu-method=CM_BMC_HVK_EoHVL_Status, data-constr=DC_BMC_HVK_EoHVL_Status  # Status der Erkennung offener HV-Leitung an der HV-Komponente, durch Messung an den HV-Anschlüssen
    signal BMC_Modus_XIX_BMC_HV_01_XIX_HCP5_CANFD01: start 32, 4 bit, little-endian, data-type-policy=OVERRIDE, i-signal-type=PRIMITIVE, init-value=15, base-type=BT_BMC_Modus, compu-method=CM_BMC_Modus, data-constr=DC_BMC_Modus  # Aktueller Betriebsmodus der Batterie 0: Standby; Schuetze geoeffnet; Kommunikation aktiv 1: Hauptschuetze geschlossen / HV-Netz aktiviert / normaler Fahrbetrieb 4: AC-Laden / HV Netz aktiv 5: interner Batteriefehler / angeforderter Modus kann nicht eingestellt werden 6: DC-Laden / HV Netz aktiv 15: Initialisierung
    signal BMC_HVK_Fehler_Intern_XIX_BMC_HV_01_XIX_HCP5_CANFD01: start 36, 2 bit, little-endian, data-type-policy=OVERRIDE, i-signal-type=PRIMITIVE, init-value=3, base-type=BT_BMC_HVK_Fehler_Intern, invalid-value=Invalid_BMC_HVK_Fehler_Intern_XIX_BMC_HV_01_XIX_HCP5_CANFD01:2, compu-method=CM_BMC_HVK_Fehler_Intern, data-constr=DC_BMC_HVK_Fehler_Intern  # HV-Status Keine Komponentenfunktion vom BMS zum HVK
    signal BMC_HVK_Fehler_SD_XIX_BMC_HV_01_XIX_HCP5_CANFD01: start 38, 2 bit, little-endian, data-type-policy=OVERRIDE, i-signal-type=PRIMITIVE, init-value=3, base-type=BT_BMC_HVK_Fehler_SD, invalid-value=Invalid_BMC_HVK_Fehler_SD_XIX_BMC_HV_01_XIX_HCP5_CANFD01:2, compu-method=CM_BMC_HVK_Fehler_SD, data-constr=DC_BMC_HVK_Fehler_SD  # Status zum ServiceDisconnect vom BMS zum HVK
    signal BMC_Spannung_ZwischenKreis_XIX_BMC_HV_01_XIX_HCP5_CANFD01: start 40, 14 bit, little-endian, data-type-policy=OVERRIDE, i-signal-type=PRIMITIVE, init-value=16382, base-type=BT_BMC_Spannung_ZwischenKreis, invalid-value=Invalid_BMC_Spannung_ZwischenKreis_XIX_BMC_HV_01_XIX_HCP5_CANFD01:16383, compu-method=CM_BMC_Spannung_ZwischenKreis, data-constr=DC_BMC_Spannung_ZwischenKreis, unit=Unit_Unit_Volt  # Momentanwert: Zwischenkreisspannung der Batterie.
    signal BMC_HVK_Fehler_HVIL_XIX_BMC_HV_01_XIX_HCP5_CANFD01: start 54, 2 bit, little-endian, data-type-policy=OVERRIDE, i-signal-type=PRIMITIVE, init-value=3, base-type=BT_BMC_HVK_Fehler_HVIL, invalid-value=Invalid_BMC_HVK_Fehler_HVIL_XIX_BMC_HV_01_XIX_HCP5_CANFD01:2, compu-method=CM_BMC_HVK_Fehler_HVIL, data-constr=DC_BMC_HVK_Fehler_HVIL  # Status zum HV-Interlock vom BMS zum HVK
    signal BMC_Strom_XIX_BMC_HV_01_XIX_HCP5_CANFD01: start 56, 16 bit, little-endian, data-type-policy=OVERRIDE, i-signal-type=PRIMITIVE, init-value=65534, base-type=BT_BMC_Strom, invalid-value=Invalid_BMC_Strom_XIX_BMC_HV_01_XIX_HCP5_CANFD01:65535, compu-method=CM_BMC_Strom, data-constr=DC_BMC_Strom, unit=Unit_Unit_Amper  # Momentanwert: Batteriestrom; Stromrichtung: ein Ladestrom wird mit positiven, ein Entladestrom mit negativen Werten angegeben
    signal BMC_Spannung_ZwischenKreis_2_XIX_BMC_HV_01_XIX_HCP5_CANFD01: start 72, 14 bit, little-endian, data-type-policy=OVERRIDE, i-signal-type=PRIMITIVE, init-value=16382, base-type=BT_BMC_Spannung_ZwischenKreis_2, invalid-value=Invalid_BMC_Spannung_ZwischenKreis_2_XIX_BMC_HV_01_XIX_HCP5_CANFD01:16383, compu-method=CM_BMC_Spannung_ZwischenKreis_2, data-constr=DC_BMC_Spannung_ZwischenKreis_2, unit=Unit_Unit_Volt  # Momentanwert: Zweite Zwischenkreisspannung für Batterien mit zwei HV Abgaengen (zwei HV Kreise)
    signal BMC_Status_Spgfreiheit_XIX_BMC_HV_01_XIX_HCP5_CANFD01: start 86, 2 bit, little-endian, data-type-policy=OVERRIDE, i-signal-type=PRIMITIVE, init-value=0, base-type=BT_BMC_Status_Spgfreiheit, compu-method=CM_BMC_Status_Spgfreiheit, data-constr=DC_BMC_Status_Spgfreiheit  # 0=Init (ohne Funktion) 1=BMS Zwischenkreis spannungsfrei (U_Zwkr < 20V) 2=BMS Zwischenkreis nicht spannungsfrei (U_Zwkr >/= 25V, Hysterese) 3=Fehler (z.B. Fehler in der Sensorik)
    signal BMC_Strom_Messzeit_XIX_BMC_HV_01_XIX_HCP5_CANFD01: start 88, 8 bit, little-endian, data-type-policy=OVERRIDE, i-signal-type=PRIMITIVE, init-value=254, base-type=BT_BMC_Strom_Messzeit, invalid-value=Invalid_BMC_Strom_Messzeit_XIX_BMC_HV_01_XIX_HCP5_CANFD01:255, compu-method=CM_BMC_Strom_Messzeit, data-constr=DC_BMC_Strom_Messzeit, unit=Unit_Unit_None  # Messzeit zu Signal BMC_Strom
    signal BMC_Spannung_Messzeit_XIX_BMC_HV_01_XIX_HCP5_CANFD01: start 96, 8 bit, little-endian, data-type-policy=OVERRIDE, i-signal-type=PRIMITIVE, init-value=254, base-type=BT_BMC_Spannung_Messzeit, invalid-value=Invalid_BMC_Spannung_Messzeit_XIX_BMC_HV_01_XIX_HCP5_CANFD01:255, compu-method=CM_BMC_Spannung_Messzeit, data-constr=DC_BMC_Spannung_Messzeit, unit=Unit_Unit_None  # Messzeit zu Signal BMC_Spannung
    signal BMC_Strom_02_XIX_BMC_HV_01_XIX_HCP5_CANFD01: start 104, 17 bit, little-endian, data-type-policy=OVERRIDE, i-signal-type=PRIMITIVE, init-value=131070, base-type=BT_BMC_Strom_02, invalid-value=Invalid_BMC_Strom_02_XIX_BMC_HV_01_XIX_HCP5_CANFD01:131071, compu-method=CM_BMC_Strom_02, data-constr=DC_BMC_Strom_02, unit=Unit_Unit_Amper  # Momentanwert: Batteriestrom; Stromrichtung: ein Ladestrom wird mit positiven, ein Entladestrom mit negativen Werten angegeben
    signal ISignalVoid_BMC_HV_01_XIX_HCP5_CANFD01_0: start 121, 7 bit, little-endian, system signal SignalVoid_BMC_HV_01_0, data-type-policy=OVERRIDE, i-signal-type=PRIMITIVE, base-type=BT_SignalVoid
    mapping SG_BMC_HV_01_XIX_HCP5_CANFD01: i-signal-group=SG_BMC_HV_01_XIX_HCP5_CANFD01, transfer-property=TRIGGERED-WITHOUT-REPETITION
  pdu BMC_HV_02_XIX_HCP5_CANFD01_E2E: length=44, transmission-mode-true-timing=event-controlled-timing={number-of-repetitions=0, repetition-period=0}, unused-bit-pattern=0  # Fuer die Botschaft ist das Cyclic-Timing 0.1 zu verwenden.
    signal BMC_HV_02_CRC_XIX_BMC_HV_02_XIX_HCP5_CANFD01: start 0, 8 bit, little-endian, data-type-policy=OVERRIDE, i-signal-type=PRIMITIVE, init-value=0, base-type=BT_BMC_HV_02_CRC, compu-method=CM_BMC_HV_02_CRC, data-constr=DC_BMC_HV_02_CRC  # Für MLB: Berechnung siehe Lastenheft "Kommunikationsabsicherung für FlexRay und CAN" Ab MQB und MLBevo: Berechnung siehe Lastenheft "End-to-End Kommunikationsabsicherung" Endwerte siehe Begleitdokument "S-PDU Kennungsfolgen"
    signal BMC_HV_02_BZ_XIX_BMC_HV_02_XIX_HCP5_CANFD01: start 8, 4 bit, little-endian, data-type-policy=OVERRIDE, i-signal-type=PRIMITIVE, init-value=0, base-type=BT_BMC_HV_02_BZ, compu-method=CM_BMC_HV_02_BZ, data-constr=DC_BMC_HV_02_BZ  # 4bit Botschaftszähler, wird mit jeder Sendebotschaft inkrementiert
    signal BMC_Vorlade_Zielspannung_XIX_BMC_HV_02_XIX_HCP5_CANFD01: start 12, 10 bit, little-endian, data-type-policy=OVERRIDE, i-signal-type=PRIMITIVE, init-value=1022, base-type=BT_BMC_Vorlade_Zielspannung, invalid-value=Invalid_BMC_Vorlade_Zielspannung_XIX_BMC_HV_02_XIX_HCP5_CANFD01:1023, compu-method=CM_BMC_Vorlade_Zielspannung, data-constr=DC_BMC_Vorlade_Zielspannung, unit=Unit_Unit_Volt  # Erwartete Zielspannung der Batterie in Abhängigkeit des angeforderten Bankmodus
    signal BMC_PerfInd_Laden_XIX_BMC_HV_02_XIX_HCP5_CANFD01: start 22, 10 bit, little-endian, data-type-policy=OVERRIDE, i-signal-type=PRIMITIVE, init-value=1022, base-type=BT_BMC_PerfInd_Laden, invalid-value=Invalid_BMC_PerfInd_Laden_XIX_BMC_HV_02_XIX_HCP5_CANFD01:1023, compu-method=CM_BMC_PerfInd_Laden, data-constr=DC_BMC_PerfInd_Laden, unit=Unit_Unit_PerCent  # Der Bereich 100...200% beschreibt die verbleibende Reserve, bis ein Derating der maximalen Ladeleistungsgrenze eintritt. Werte von 0 bis 100% beschreiben, auf welchen Teil der potentiell möglichen maximalen Ladeleistung die Ladeleistungsgrenze zurückgefahren worden ist.
    signal BMC_Max_Entladeleistung_XIX_BMC_HV_02_XIX_HCP5_CANFD01: start 32, 13 bit, little-endian, data-type-policy=OVERRIDE, i-signal-type=PRIMITIVE, init-value=8190, base-type=BT_BMC_Max_Entladeleistung, invalid-value=Invalid_BMC_Max_Entladeleistung_XIX_BMC_HV_02_XIX_HCP5_CANFD01:8191, compu-method=CM_BMC_Max_Entladeleistung, data-constr=DC_BMC_Max_Entladeleistung, unit=Unit_Unit_Watt  # Maximale Leistung, mit der die Batterie momentan belastet werden darf. Kurze Überschwinger aufgrund dynamischen Verhalten des Reglers sind nach Absprache möglich, aber hierbei muss unbedingt auch der maximale Entladestrom berücksichtigt werden.
    signal BMC_Status_DCLS_XIX_BMC_HV_02_XIX_HCP5_CANFD01: start 45, 2 bit, little-endian, data-type-policy=OVERRIDE, i-signal-type=PRIMITIVE, init-value=0, base-type=BT_BMC_Status_DCLS, compu-method=CM_BMC_Status_DCLS, data-constr=DC_BMC_Status_DCLS  # Status der Spannungsüberwachung an der DC-Ladeschnittstelle
    signal BMC_Bank_Notlauf_erlaubt_XIX_BMC_HV_02_XIX_HCP5_CANFD01: start 47, 1 bit, little-endian, data-type-policy=OVERRIDE, i-signal-type=PRIMITIVE, init-value=1, base-type=BT_BMC_Bank_Notlauf_erlaubt, compu-method=CM_BMC_Bank_Notlauf_erlaubt, data-constr=DC_BMC_Bank_Notlauf_erlaubt  # Feedback von BMC Notlauf
    signal BMC_Energieinhalt_XIX_BMC_HV_02_XIX_HCP5_CANFD01: start 48, 16 bit, little-endian, data-type-policy=OVERRIDE, i-signal-type=PRIMITIVE, init-value=65534, base-type=BT_BMC_Energieinhalt, invalid-value=Invalid_BMC_Energieinhalt_XIX_BMC_HV_02_XIX_HCP5_CANFD01:65535, compu-method=CM_BMC_Energieinhalt, data-constr=DC_BMC_Energieinhalt, unit=Unit_Unit_WattHour  # Aktueller Energieinhalt der Batterie unter Beruecksichtigung der Verluste (I_RWDS)
    signal BMC_Max_Ladeleistung_XIX_BMC_HV_02_XIX_HCP5_CANFD01: start 64, 13 bit, little-endian, data-type-policy=OVERRIDE, i-signal-type=PRIMITIVE, init-value=8190, base-type=BT_BMC_Max_Ladeleistung, invalid-value=Invalid_BMC_Max_Ladeleistung_XIX_BMC_HV_02_XIX_HCP5_CANFD01:8191, compu-method=CM_BMC_Max_Ladeleistung, data-constr=DC_BMC_Max_Ladeleistung, unit=Unit_Unit_Watt  # Maximale Leistung, mit der die Batterie aktuell geladen werden darf.Kurze Überschwinger aufgrund dynamischen Verhalten des Reglers sind nach Absprache möglich, aber hierbei muss unbedingt auch der maximale Ladestrom berücksichtigt werden.
    signal BMC_PerfInd_Entladen_XIX_BMC_HV_02_XIX_HCP5_CANFD01: start 77, 10 bit, little-endian, data-type-policy=OVERRIDE, i-signal-type=PRIMITIVE, init-value=1022, base-type=BT_BMC_PerfInd_Entladen, invalid-value=Invalid_BMC_PerfInd_Entladen_XIX_BMC_HV_02_XIX_HCP5_CANFD01:1023, compu-method=CM_BMC_PerfInd_Entladen, data-constr=DC_BMC_PerfInd_Entladen, unit=Unit_Unit_PerCent  # Der Bereich 100...200% beschreibt die verbleibende Reserve, bis ein Derating der maximalen Entladeleistungsgrenze eintritt. Werte von 0 bis 100% beschreiben, auf welchen Teil der potentiell möglichen maximalen Entladeleistung die Entladeleistungsgrenze zurückgefahren worden ist.
    signal BMC_Bank_parallel_erlaubt_XIX_BMC_HV_02_XIX_HCP5_CANFD01: start 87, 1 bit, little-endian, data-type-policy=OVERRIDE, i-signal-type=PRIMITIVE, init-value=1, base-type=BT_BMC_Bank_parallel_erlaubt, compu-method=CM_BMC_Bank_parallel_erlaubt, data-constr=DC_BMC_Bank_parallel_erlaubt  # Feedback von BMC ob paralleler Betrieb unterstützt ist
    signal BMC_Bank_seriell_erlaubt_XIX_BMC_HV_02_XIX_HCP5_CANFD01: start 88, 1 bit, little-endian, data-type-policy=OVERRIDE, i-signal-type=PRIMITIVE, init-value=1, base-type=BT_BMC_Bank_seriell_erlaubt, compu-method=CM_BMC_Bank_seriell_erlaubt, data-constr=DC_BMC_Bank_seriell_erlaubt  # Feedback von BMC ob serieller Betrieb unterstützt ist
    signal BMC_Spannung_DC_Ladesaeule_XIX_BMC_HV_02_XIX_HCP5_CANFD01: start 89, 15 bit, little-endian, data-type-policy=OVERRIDE, i-signal-type=PRIMITIVE, init-value=32766, base-type=BT_BMC_Spannung_DC_Ladesaeule, invalid-value=Invalid_BMC_Spannung_DC_Ladesaeule_XIX_BMC_HV_02_XIX_HCP5_CANFD01:32767, compu-method=CM_BMC_Spannung_DC_Ladesaeule, data-constr=DC_BMC_Spannung_DC_Ladesaeule, unit=Unit_Unit_Volt  # DC-Spannung der Ladesaeule. Messung zwischen den DC HV-Leitungen.
    signal BMC_Max_Ladestrom_XIX_BMC_HV_02_XIX_HCP5_CANFD01: start 104, 13 bit, little-endian, data-type-policy=OVERRIDE, i-signal-type=PRIMITIVE, init-value=8190, base-type=BT_BMC_Max_Ladestrom, invalid-value=Invalid_BMC_Max_Ladestrom_XIX_BMC_HV_02_XIX_HCP5_CANFD01:8191, compu-method=CM_BMC_Max_Ladestrom, data-constr=DC_BMC_Max_Ladestrom, unit=Unit_Unit_Amper  # Zwingend einzuhaltender Grenzwert für den Ladestrom der Batterie.Verletzungen werden protokolliert.
    signal BMC_Max_Entladestrom_XIX_BMC_HV_02_XIX_HCP5_CANFD01: start 117, 13 bit, little-endian, data-type-policy=OVERRIDE, i-signal-type=PRIMITIVE, init-value=8190, base-type=BT_BMC_Max_Entladestrom, invalid-value=Invalid_BMC_Max_Entladestrom_XIX_BMC_HV_02_XIX_HCP5_CANFD01:8191, compu-method=CM_BMC_Max_Entladestrom, data-constr=DC_BMC_Max_Entladestrom, unit=Unit_Unit_Amper  # Zwingend einzuhaltender Grenzwert für den Entladestrom der Batterie. Verletzungen werden protokolliert.
    signal BMC_IWU_Status_XIX_BMC_HV_02_XIX_HCP5_CANFD01: start 130, 3 bit, little-endian, data-type-policy=OVERRIDE, i-signal-type=PRIMITIVE, init-value=0, base-type=BT_BMC_IWU_Status, compu-method=CM_BMC_IWU_Status, data-constr=DC_BMC_IWU_Status  # Status der Iso-Messstelle
    signal BMC_Verbauinfo_ACSchuetz_XIX_BMC_HV_02_XIX_HCP5_CANFD01: start 133, 2 bit, little-endian, data-type-policy=OVERRIDE, i-signal-type=PRIMITIVE, init-value=0, base-type=BT_BMC_Verbauinfo_ACSchuetz, compu-method=CM_BMC_Verbauinfo_ACSchuetz, data-constr=DC_BMC_Verbauinfo_ACSchuetz  # Verbauzustand des HV-Schützes für den separaten Zwischenkreis des AC-Ladegerätes
    signal Hybrid_01_OBD_Lampe_Anf_XIX_BMC_HV_02_XIX_HCP5_CANFD01: start 135, 1 bit, little-endian, data-type-policy=OVERRIDE, i-signal-type=PRIMITIVE, init-value=0, base-type=BT_Hybrid_01_OBD_Lampe_Anf, compu-method=CM_Hybrid_01_OBD_Lampe_Anf, data-constr=DC_Hybrid_01_OBD_Lampe_Anf  # In allen VW-/Audi-Fahrzeugen ist ein MIL-Master-Konzept umgesetzt. Dazu ermittelt jedes OBD-Steuergerät den eigenen MIL-Status. Eine MIL-Ansteuerung wird vom betroffenen OBD-Steuergerät per MIL-Request an den MIL-Master weitergegeben.
    signal BMC_Fehler_Warnung_XIX_BMC_HV_02_XIX_HCP5_CANFD01: start 136, 2 bit, little-endian, data-type-policy=OVERRIDE, i-signal-type=PRIMITIVE, init-value=0, base-type=BT_BMC_Fehler_Warnung, compu-method=CM_BMC_Fehler_Warnung, data-constr=DC_BMC_Fehler_Warnung  # Fehlersignalisierung eines Komponentenfehlers ohne HV-Abschaltung jedoch mit potentieller Leistungseinschränkung
    signal BMC_MMTR_Status_XIX_BMC_HV_02_XIX_HCP5_CANFD01: start 138, 4 bit, little-endian, data-type-policy=OVERRIDE, i-signal-type=PRIMITIVE, init-value=14, base-type=BT_BMC_MMTR_Status, invalid-value=Invalid_BMC_MMTR_Status_XIX_BMC_HV_02_XIX_HCP5_CANFD01:15, compu-method=CM_BMC_MMTR_Status, data-constr=DC_BMC_MMTR_Status  # Status der Hochvoltbatterie zur Funktion Make me track ready
    signal ISignalVoid_BMC_HV_02_XIX_HCP5_CANFD01_0: start 142, 2 bit, little-endian, system signal SignalVoid_BMC_HV_02_0, data-type-policy=OVERRIDE, i-signal-type=PRIMITIVE, base-type=BT_SignalVoid
    signal BMC_DC_Laden_XIX_BMC_HV_02_XIX_HCP5_CANFD01: start 144, 2 bit, little-endian, data-type-policy=OVERRIDE, i-signal-type=PRIMITIVE, init-value=0, base-type=BT_BMC_DC_Laden, invalid-value=Invalid_BMC_DC_Laden_XIX_BMC_HV_02_XIX_HCP5_CANFD01:3, compu-method=CM_BMC_DC_Laden, data-constr=DC_BMC_DC_Laden  # Verfügbarkeit der HV-Batterie für einen DC-Ladevorgang
    signal BMC_AC_Laden_XIX_BMC_HV_02_XIX_HCP5_CANFD01: start 146, 2 bit, little-endian, data-type-policy=OVERRIDE, i-signal-type=PRIMITIVE, init-value=0, base-type=BT_BMC_AC_Laden, invalid-value=Invalid_BMC_AC_Laden_XIX_BMC_HV_02_XIX_HCP5_CANFD01:3, compu-method=CM_BMC_AC_Laden, data-constr=DC_BMC_AC_Laden  # Verfügbarkeit der HV-Batterie für einen AC-Ladevorgang
    signal BMC_NutzbarerSOC_XIX_BMC_HV_02_XIX_HCP5_CANFD01: start 148, 12 bit, little-endian, data-type-policy=OVERRIDE, i-signal-type=PRIMITIVE, init-value=4094, base-type=BT_BMC_NutzbarerSOC, invalid-value=Invalid_BMC_NutzbarerSOC_XIX_BMC_HV_02_XIX_HCP5_CANFD01:4095, compu-method=CM_BMC_NutzbarerSOC, data-constr=DC_BMC_NutzbarerSOC, unit=Unit_Unit_PerCent  # Aktueller relativer Ladezustand der HV-Batterie/Der angezeigte Bereich für Kunde ist von 0-100%/Reserve wird im negativen Bereich abgebildet/Werte über 100% signalisieren eine unzulässige Überladung. Physikalischer Wertebereich liegt zw. -20% bis 120%.
    signal BMC_IWU_Wert_neg_XIX_BMC_HV_02_XIX_HCP5_CANFD01: start 160, 16 bit, little-endian, data-type-policy=OVERRIDE, i-signal-type=PRIMITIVE, init-value=65534, base-type=BT_BMC_IWU_Wert_neg, invalid-value=Invalid_BMC_IWU_Wert_neg_XIX_BMC_HV_02_XIX_HCP5_CANFD01:65535, compu-method=CM_BMC_IWU_Wert_neg, data-constr=DC_BMC_IWU_Wert_neg, unit=Unit_Unit_Ohm  # Aktueller Isolationswert zwischen HV minus und Fahrzeug
    signal BMC_IWU_Wert_pos_XIX_BMC_HV_02_XIX_HCP5_CANFD01: start 176, 16 bit, little-endian, data-type-policy=OVERRIDE, i-signal-type=PRIMITIVE, init-value=65534, base-type=BT_BMC_IWU_Wert_pos, invalid-value=Invalid_BMC_IWU_Wert_pos_XIX_BMC_HV_02_XIX_HCP5_CANFD01:65535, compu-method=CM_BMC_IWU_Wert_pos, data-constr=DC_BMC_IWU_Wert_pos, unit=Unit_Unit_Ohm  # Aktueller Isolationswert zwischen HV plus und Fahrzeug
    signal Anzeige_SOC_XIX_BMC_HV_02_XIX_HCP5_CANFD01: start 192, 10 bit, little-endian, data-type-policy=OVERRIDE, i-signal-type=PRIMITIVE, init-value=1022, base-type=BT_Anzeige_SOC, invalid-value=Invalid_Anzeige_SOC_XIX_BMC_HV_02_XIX_HCP5_CANFD01:1023, compu-method=CM_Anzeige_SOC, data-constr=DC_Anzeige_SOC, unit=Unit_Unit_PerCent  # Der Anzeige-SOC soll für alle Energiestandsanzeigen der Batterie vor Kunde verwendet werden.
    signal BMC_Verbauinfo_Bank_XIX_BMC_HV_02_XIX_HCP5_CANFD01: start 202, 2 bit, little-endian, data-type-policy=OVERRIDE, i-signal-type=PRIMITIVE, init-value=0, base-type=BT_BMC_Verbauinfo_Bank, compu-method=CM_BMC_Verbauinfo_Bank, data-constr=DC_BMC_Verbauinfo_Bank  # Verbauzustand einer Bankverschaltung in der HV-Batterie
    signal BMC_Fehler_Leistungsred_XIX_BMC_HV_02_XIX_HCP5_CANFD01: start 204, 1 bit, little-endian, data-type-policy=OVERRIDE, i-signal-type=PRIMITIVE, init-value=0, base-type=BT_BMC_Fehler_Leistungsred, compu-method=CM_BMC_Fehler_Leistungsred, data-constr=DC_BMC_Fehler_Leistungsred  # Statusinformation bei aktiver Leistungsreduktion aufgrund eines Batteriefehlers
    signal BMC_Unterboden_Warnung_XIX_BMC_HV_02_XIX_HCP5_CANFD01: start 205, 3 bit, little-endian, data-type-policy=OVERRIDE, i-signal-type=PRIMITIVE, init-value=0, base-type=BT_BMC_Unterboden_Warnung, invalid-value=Invalid_BMC_Unterboden_Warnung_XIX_BMC_HV_02_XIX_HCP5_CANFD01:7, compu-method=CM_BMC_Unterboden_Warnung, data-constr=DC_BMC_Unterboden_Warnung  # Warnung bei Unterbodenbeschaedigung der HV Batterie
    signal BMC_MinDyn_Entladespannung_XIX_BMC_HV_02_XIX_HCP5_CANFD01: start 208, 10 bit, little-endian, data-type-policy=OVERRIDE, i-signal-type=PRIMITIVE, init-value=1022, base-type=BT_BMC_MinDyn_Entladespannung, invalid-value=Invalid_BMC_MinDyn_Entladespannung_XIX_BMC_HV_02_XIX_HCP5_CANFD01:1023, compu-method=CM_BMC_MinDyn_Entladespannung, data-constr=DC_BMC_MinDyn_Entladespannung, unit=Unit_Unit_None  # rechnerischer Wert: minimales, für eine Dauer von ~1s garantiertes Spannungsniveau, das unter Belastung mit BMC_Max_EntladeLeistung nicht unterschritten wird
    signal BMC_MinDyn_Ladespannung_XIX_BMC_HV_02_XIX_HCP5_CANFD01: start 218, 10 bit, little-endian, data-type-policy=OVERRIDE, i-signal-type=PRIMITIVE, init-value=1022, base-type=BT_BMC_MinDyn_Ladespannung, invalid-value=Invalid_BMC_MinDyn_Ladespannung_XIX_BMC_HV_02_XIX_HCP5_CANFD01:1023, compu-method=CM_BMC_MinDyn_Ladespannung, data-constr=DC_BMC_MinDyn_Ladespannung, unit=Unit_Unit_Volt  # rechnerischer Wert: minimales, für eine Dauer von ~1s garantiertes Spannungsniveau, das unter Belastung mit BMC_Max_LadeLeistung nicht unterschritten wird
    signal BMC_Leerlaufspannung_XIX_BMC_HV_02_XIX_HCP5_CANFD01: start 228, 10 bit, little-endian, data-type-policy=OVERRIDE, i-signal-type=PRIMITIVE, init-value=1022, base-type=BT_BMC_Leerlaufspannung, invalid-value=Invalid_BMC_Leerlaufspannung_XIX_BMC_HV_02_XIX_HCP5_CANFD01:1023, compu-method=CM_BMC_Leerlaufspannung, data-constr=DC_BMC_Leerlaufspannung, unit=Unit_Unit_Volt  # Lastfreie Spannung der HV Batterie
    signal BMC_IstZellspannungMax_XIX_BMC_HV_02_XIX_HCP5_CANFD01: start 238, 12 bit, little-endian, data-type-policy=OVERRIDE, i-signal-type=PRIMITIVE, init-value=4094, base-type=BT_BMC_IstZellspannungMax, invalid-value=Invalid_BMC_IstZellspannungMax_XIX_BMC_HV_02_XIX_HCP5_CANFD01:4095, compu-method=CM_BMC_IstZellspannungMax, data-constr=DC_BMC_IstZellspannungMax, unit=Unit_Unit_MilliVolt  # Aktuell höchste Zellspannung in der Batterie
    signal BMC_IstZellspannungMin_XIX_BMC_HV_02_XIX_HCP5_CANFD01: start 250, 12 bit, little-endian, data-type-policy=OVERRIDE, i-signal-type=PRIMITIVE, init-value=4094, base-type=BT_BMC_IstZellspannungMin, invalid-value=Invalid_BMC_IstZellspannungMin_XIX_BMC_HV_02_XIX_HCP5_CANFD01:4095, compu-method=CM_BMC_IstZellspannungMin, data-constr=DC_BMC_IstZellspannungMin, unit=Unit_Unit_MilliVolt  # Aktuell niedrigste Zellspannung in der Batterie
    signal BMC_PredLeistung_StuetzungNV_XIX_BMC_HV_02_XIX_HCP5_CANFD01: start 262, 12 bit, little-endian, data-type-policy=OVERRIDE, i-signal-type=PRIMITIVE, init-value=4094, base-type=BT_BMC_PredLeistung_StuetzungNV, invalid-value=Invalid_BMC_PredLeistung_StuetzungNV_XIX_BMC_HV_02_XIX_HCP5_CANFD01:4095, compu-method=CM_BMC_PredLeistung_StuetzungNV, data-constr=DC_BMC_PredLeistung_StuetzungNV, unit=Unit_Unit_Watt  # Entladeleistung der HV Batterie, garantiert für eine Periode von 2,5 Minuten unter der Annahme, dass diese nicht überschritten wird.
    signal BMC_TechnischerSOC_XIX_BMC_HV_02_XIX_HCP5_CANFD01: start 274, 11 bit, little-endian, data-type-policy=OVERRIDE, i-signal-type=PRIMITIVE, init-value=2046, base-type=BT_BMC_TechnischerSOC, invalid-value=Invalid_BMC_TechnischerSOC_XIX_BMC_HV_02_XIX_HCP5_CANFD01:2047, compu-method=CM_BMC_TechnischerSOC, data-constr=DC_BMC_TechnischerSOC, unit=Unit_Unit_PerCent  # State of Charge / aktueller Ladezustand der Batterie (höhere Auflösung)/technischer SOC
    signal BMC_Energie_Sockel_SoC_XIX_BMC_HV_02_XIX_HCP5_CANFD01: start 285, 10 bit, little-endian, data-type-policy=OVERRIDE, i-signal-type=PRIMITIVE, init-value=1022, base-type=BT_BMC_Energie_Sockel_SoC, invalid-value=Invalid_BMC_Energie_Sockel_SoC_XIX_BMC_HV_02_XIX_HCP5_CANFD01:1023, compu-method=CM_BMC_Energie_Sockel_SoC, data-constr=DC_BMC_Energie_Sockel_SoC, unit=Unit_Unit_PerCent  # (Kunden-) SoC der Batterie für Energieinhalt=0
    signal BMC_ZellTemp_virtuell_min_XIX_BMC_HV_02_XIX_HCP5_CANFD01: start 295, 10 bit, little-endian, data-type-policy=OVERRIDE, i-signal-type=PRIMITIVE, init-value=1022, base-type=BT_BMC_ZellTemp_virtuell_min, invalid-value=Invalid_BMC_ZellTemp_virtuell_min_XIX_BMC_HV_02_XIX_HCP5_CANFD01:1023, compu-method=CM_BMC_ZellTemp_virtuell_min, data-constr=DC_BMC_ZellTemp_virtuell_min, unit=Unit_Unit_DegreCelsi  # Minimaler berechneter Wert der Zelltemperatur der HVB
    signal BMC_ZellTemp_virtuell_max_XIX_BMC_HV_02_XIX_HCP5_CANFD01: start 305, 10 bit, little-endian, data-type-policy=OVERRIDE, i-signal-type=PRIMITIVE, init-value=1022, base-type=BT_BMC_ZellTemp_virtuell_max, invalid-value=Invalid_BMC_ZellTemp_virtuell_max_XIX_BMC_HV_02_XIX_HCP5_CANFD01:1023, compu-method=CM_BMC_ZellTemp_virtuell_max, data-constr=DC_BMC_ZellTemp_virtuell_max, unit=Unit_Unit_DegreCelsi  # Maximaler berechneter Wert der Zelltemperatur der HVB
    signal ISignalVoid_BMC_HV_02_XIX_HCP5_CANFD01_1: start 315, 5 bit, little-endian, system signal SignalVoid_BMC_HV_02_1, data-type-policy=OVERRIDE, i-signal-type=PRIMITIVE, base-type=BT_SignalVoid
    signal ISignalVoid_BMC_HV_02_XIX_HCP5_CANFD01_2: start 320, 8 bit, little-endian, system signal SignalVoid_BMC_HV_02_2, data-type-policy=OVERRIDE, i-signal-type=PRIMITIVE, base-type=BT_SignalVoid
    signal ISignalVoid_BMC_HV_02_XIX_HCP5_CANFD01_3: start 328, 8 bit, little-endian, system signal SignalVoid_BMC_HV_02_3, data-type-policy=OVERRIDE, i-signal-type=PRIMITIVE, base-type=BT_SignalVoid
    signal ISignalVoid_BMC_HV_02_XIX_HCP5_CANFD01_4: start 336, 8 bit, little-endian, system signal SignalVoid_BMC_HV_02_4, data-type-policy=OVERRIDE, i-signal-type=PRIMITIVE, base-type=BT_SignalVoid
    signal ISignalVoid_BMC_HV_02_XIX_HCP5_CANFD01_5: start 344, 8 bit, little-endian, system signal SignalVoid_BMC_HV_02_5, data-type-policy=OVERRIDE, i-signal-type=PRIMITIVE, base-type=BT_SignalVoid
    mapping SG_BMC_HV_02_XIX_HCP5_CANFD01: i-signal-group=SG_BMC_HV_02_XIX_HCP5_CANFD01, transfer-property=TRIGGERED-WITHOUT-REPETITION
  pdu BMC_HV_06_XIX_HCP5_CANFD01: length=8, minimum-delay=0.05, transmission-mode-true-timing={cyclic-timing={time-offset=0, time-period=0.5}, event-controlled-timing={number-of-repetitions=0, repetition-period=0}}, unused-bit-pattern=0
    signal BMC_Max_Spannung_XIX_BMC_HV_06_XIX_HCP5_CANFD01: start 12, 10 bit, little-endian, data-type-policy=OVERRIDE, i-signal-type=PRIMITIVE, init-value=1022, base-type=BT_BMC_Max_Spannung, invalid-value=Invalid_BMC_Max_Spannung_XIX_BMC_HV_06_XIX_HCP5_CANFD01:1023, compu-method=CM_BMC_Max_Spannung, data-constr=DC_BMC_Max_Spannung, unit=Unit_Unit_Volt, transfer-property=TRIGGERED-ON-CHANGE-WITHOUT-REPETITION  # max. voltage / maximal erlaubte Batteriespannung (zwingend einzuhaltender Grenzwert). Haengt vom Bank status ab. Bei NoBank wird der serielle Wert gesendet
    signal BMC_Min_Spannung_XIX_BMC_HV_06_XIX_HCP5_CANFD01: start 22, 10 bit, little-endian, data-type-policy=OVERRIDE, i-signal-type=PRIMITIVE, init-value=1022, base-type=BT_BMC_Min_Spannung, invalid-value=Invalid_BMC_Min_Spannung_XIX_BMC_HV_06_XIX_HCP5_CANFD01:1023, compu-method=CM_BMC_Min_Spannung, data-constr=DC_BMC_Min_Spannung, unit=Unit_Unit_Volt, transfer-property=TRIGGERED-ON-CHANGE-WITHOUT-REPETITION  # min. voltage / minimal erlaubte Batteriespannung (zwingend einzuhaltender Grenzwert); Haengt vom Bank status ab. Bei NoBank wird der serielle Wert gesendet
    signal BMC_KundenWarnung_XIX_BMC_HV_06_XIX_HCP5_CANFD01: start 32, 2 bit, little-endian, data-type-policy=OVERRIDE, i-signal-type=PRIMITIVE, init-value=0, base-type=BT_BMC_KundenWarnung, compu-method=CM_BMC_KundenWarnung, data-constr=DC_BMC_KundenWarnung, transfer-property=TRIGGERED-ON-CHANGE-WITHOUT-REPETITION  # Kundenwarnung aufgrund eines Batteriefehlers
    signal BMC_Bidi_Veto_Energie_XIX_BMC_HV_06_XIX_HCP5_CANFD01: start 34, 1 bit, little-endian, data-type-policy=OVERRIDE, i-signal-type=PRIMITIVE, init-value=0, base-type=BT_BMC_Bidi_Veto_Energie, compu-method=CM_BMC_Bidi_Veto_Energie, data-constr=DC_BMC_Bidi_Veto_Energie, transfer-property=PENDING  # Freigabestatus der Funktion Bidi in Abhängigkeit des Energiedurchsatzes
    signal BMC_Bidi_Freigabe_XIX_BMC_HV_06_XIX_HCP5_CANFD01: start 35, 2 bit, little-endian, data-type-policy=OVERRIDE, i-signal-type=PRIMITIVE, init-value=2, base-type=BT_BMC_Bidi_Freigabe, invalid-value=Invalid_BMC_Bidi_Freigabe_XIX_BMC_HV_06_XIX_HCP5_CANFD01:3, compu-method=CM_BMC_Bidi_Freigabe, data-constr=DC_BMC_Bidi_Freigabe, transfer-property=PENDING  # Freigabestatus der Funktion Bidi in Abhängigkeit der Ist-Temperatur und des Energiedurchsatzes ermitteln. Die Basis SW sendet die Information von "Bidi-Status" auf dem CAN Signal BMC_Bidi_Freigabe an das Steuergerät HCP5.
    signal BMC_Bidi_Energie_Absolut_XIX_BMC_HV_06_XIX_HCP5_CANFD01: start 48, 16 bit, little-endian, data-type-policy=OVERRIDE, i-signal-type=PRIMITIVE, init-value=65534, base-type=BT_BMC_Bidi_Energie_Absolut, invalid-value=Invalid_BMC_Bidi_Energie_Absolut_XIX_BMC_HV_06_XIX_HCP5_CANFD01:65535, compu-method=CM_BMC_Bidi_Energie_Absolut, data-constr=DC_BMC_Bidi_Energie_Absolut, unit=Unit_Unit_KiloWattHour, transfer-property=PENDING  # Beschreibt den maximal erlaubten Energiedurchsatz (Absolutwert, für Entladen) für die Funktion Bidi. Der Wert dient als zusätzliche Grenze für den Bauteilschutz der Zelle.
  pdu BMC_HV_07_XIX_HCP5_CANFD01: length=8, transmission-mode-true-timing=cyclic-timing={time-offset=0, time-period=0.2}, unused-bit-pattern=0
    signal BMC_Temperatur_hoechste_XIX_BMC_HV_07_XIX_HCP5_CANFD01: start 12, 10 bit, little-endian, data-type-policy=OVERRIDE, i-signal-type=PRIMITIVE, init-value=1022, base-type=BT_BMC_Temperatur_hoechste, invalid-value=Invalid_BMC_Temperatur_hoechste_XIX_BMC_HV_07_XIX_HCP5_CANFD01:1023, compu-method=CM_BMC_Temperatur_hoechste, data-constr=DC_BMC_Temperatur_hoechste, unit=Unit_Unit_DegreCelsi, transfer-property=PENDING  # aktuell höchste Temperatur in der Batterie
    signal BMC_Temperatur_niedrigste_XIX_BMC_HV_07_XIX_HCP5_CANFD01: start 22, 10 bit, little-endian, data-type-policy=OVERRIDE, i-signal-type=PRIMITIVE, init-value=1022, base-type=BT_BMC_Temperatur_niedrigste, invalid-value=Invalid_BMC_Temperatur_niedrigste_XIX_BMC_HV_07_XIX_HCP5_CANFD01:1023, compu-method=CM_BMC_Temperatur_niedrigste, data-constr=DC_BMC_Temperatur_niedrigste, unit=Unit_Unit_DegreCelsi, transfer-property=PENDING  # aktuell niedrigsteTemperatur in der Batterie
  pdu BMC_HV_08_XIX_HCP5_CANFD01: length=44, transmission-mode-true-timing=cyclic-timing={time-offset=0, time-period=1}, unused-bit-pattern=0
    signal BMC_IstTemperaturMin_Sensor_ID_XIX_BMC_HV_08_XIX_HCP5_CANFD01: start 12, 5 bit, little-endian, data-type-policy=OVERRIDE, i-signal-type=PRIMITIVE, init-value=31, base-type=BT_BMC_IstTemperaturMin_Sensor_ID, compu-method=CM_BMC_IstTemperaturMin_Sensor_ID, data-constr=DC_BMC_IstTemperaturMin_Sensor_ID, unit=Unit_Unit_None, transfer-property=PENDING  # RTM-Signal: Nummer (ID) des Sensors (innerhalb des Moduls) mit dem aktuell niedrigsten Temperaturmeßwert
    signal BMC_IstTemperaturMax_Sensor_ID_XIX_BMC_HV_08_XIX_HCP5_CANFD01: start 17, 5 bit, little-endian, data-type-policy=OVERRIDE, i-signal-type=PRIMITIVE, init-value=31, base-type=BT_BMC_IstTemperaturMax_Sensor_ID, compu-method=CM_BMC_IstTemperaturMax_Sensor_ID, data-constr=DC_BMC_IstTemperaturMax_Sensor_ID, unit=Unit_Unit_None, transfer-property=PENDING  # RTM-Signal: Nummer (ID) des Sensors (innerhalb des Moduls) mit dem aktuell höchsten Temperaturmeßwert
    signal BMC_RtmWarnUeberstrom_XIX_BMC_HV_08_XIX_HCP5_CANFD01: start 22, 3 bit, little-endian, data-type-policy=OVERRIDE, i-signal-type=PRIMITIVE, init-value=0, base-type=BT_BMC_RtmWarnUeberstrom, compu-method=CM_BMC_RtmWarnUeberstrom, data-constr=DC_BMC_RtmWarnUeberstrom, transfer-property=PENDING  # Real Time Monitor Over-current of overall current of traction battery
    signal BMC_RtmWarnPackKommunikation_XIX_BMC_HV_08_XIX_HCP5_CANFD01: start 25, 3 bit, little-endian, data-type-policy=OVERRIDE, i-signal-type=PRIMITIVE, init-value=0, base-type=BT_BMC_RtmWarnPackKommunikation, compu-method=CM_BMC_RtmWarnPackKommunikation, data-constr=DC_BMC_RtmWarnPackKommunikation, transfer-property=PENDING  # Real Time Monitor Traction battery CAN communication fault
    signal BMC_RtmWarnPackUeberladen_XIX_BMC_HV_08_XIX_HCP5_CANFD01: start 28, 3 bit, little-endian, data-type-policy=OVERRIDE, i-signal-type=PRIMITIVE, init-value=0, base-type=BT_BMC_RtmWarnPackUeberladen, compu-method=CM_BMC_RtmWarnPackUeberladen, data-constr=DC_BMC_RtmWarnPackUeberladen, transfer-property=PENDING  # RTM Signal Energy-storage over-charging warning
    signal BMC_RtmWarnSocHoch_XIX_BMC_HV_08_XIX_HCP5_CANFD01: start 31, 3 bit, little-endian, data-type-policy=OVERRIDE, i-signal-type=PRIMITIVE, init-value=0, base-type=BT_BMC_RtmWarnSocHoch, compu-method=CM_BMC_RtmWarnSocHoch, data-constr=DC_BMC_RtmWarnSocHoch, transfer-property=PENDING  # RTM Signal Excessively-high SOC warning
    signal BMC_RtmWarnSocNiedrig_XIX_BMC_HV_08_XIX_HCP5_CANFD01: start 34, 3 bit, little-endian, data-type-policy=OVERRIDE, i-signal-type=PRIMITIVE, init-value=0, base-type=BT_BMC_RtmWarnSocNiedrig, compu-method=CM_BMC_RtmWarnSocNiedrig, data-constr=DC_BMC_RtmWarnSocNiedrig, transfer-property=PENDING  # RTM Signal Low SOC warning
    signal BMC_RtmWarnSocSprung_XIX_BMC_HV_08_XIX_HCP5_CANFD01: start 37, 3 bit, little-endian, data-type-policy=OVERRIDE, i-signal-type=PRIMITIVE, init-value=0, base-type=BT_BMC_RtmWarnSocSprung, compu-method=CM_BMC_RtmWarnSocSprung, data-constr=DC_BMC_RtmWarnSocSprung, transfer-property=PENDING  # RTM Signal SOC jump warning
    signal BMC_RtmWarnTZelleDiff_XIX_BMC_HV_08_XIX_HCP5_CANFD01: start 40, 3 bit, little-endian, data-type-policy=OVERRIDE, i-signal-type=PRIMITIVE, init-value=0, base-type=BT_BMC_RtmWarnTZelleDiff, compu-method=CM_BMC_RtmWarnTZelleDiff, data-constr=DC_BMC_RtmWarnTZelleDiff, transfer-property=PENDING  # RTM Signal Temperature difference warning
    signal BMC_RtmWarnTZelleMax_XIX_BMC_HV_08_XIX_HCP5_CANFD01: start 43, 3 bit, little-endian, data-type-policy=OVERRIDE, i-signal-type=PRIMITIVE, init-value=0, base-type=BT_BMC_RtmWarnTZelleMax, compu-method=CM_BMC_RtmWarnTZelleMax, data-constr=DC_BMC_RtmWarnTZelleMax, transfer-property=PENDING  # RTM Signal Max_temperature_cell_Warning
    signal BMC_RtmWarnTZelleMin_XIX_BMC_HV_08_XIX_HCP5_CANFD01: start 46, 3 bit, little-endian, data-type-policy=OVERRIDE, i-signal-type=PRIMITIVE, init-value=0, base-type=BT_BMC_RtmWarnTZelleMin, compu-method=CM_BMC_RtmWarnTZelleMin, data-constr=DC_BMC_RtmWarnTZelleMin, transfer-property=PENDING  # RTM Signal Min_temperature_cell_Warning
    signal BMC_RtmWarnUPackMax_XIX_BMC_HV_08_XIX_HCP5_CANFD01: start 49, 3 bit, little-endian, data-type-policy=OVERRIDE, i-signal-type=PRIMITIVE, init-value=0, base-type=BT_BMC_RtmWarnUPackMax, compu-method=CM_BMC_RtmWarnUPackMax, data-constr=DC_BMC_RtmWarnUPackMax, transfer-property=PENDING  # RTM Signal Max_Voltage_of_battery_Warning
    signal BMC_RtmWarnUPackMin_XIX_BMC_HV_08_XIX_HCP5_CANFD01: start 52, 3 bit, little-endian, data-type-policy=OVERRIDE, i-signal-type=PRIMITIVE, init-value=0, base-type=BT_BMC_RtmWarnUPackMin, compu-method=CM_BMC_RtmWarnUPackMin, data-constr=DC_BMC_RtmWarnUPackMin, transfer-property=PENDING  # RTM Signal Min_Voltage_of_battery_Warning
    signal BMC_RtmWarnUZelleMax_XIX_BMC_HV_08_XIX_HCP5_CANFD01: start 55, 3 bit, little-endian, data-type-policy=OVERRIDE, i-signal-type=PRIMITIVE, init-value=0, base-type=BT_BMC_RtmWarnUZelleMax, compu-method=CM_BMC_RtmWarnUZelleMax, data-constr=DC_BMC_RtmWarnUZelleMax, transfer-property=PENDING  # RTM Signal Max_voltage_cell_Warning
    signal BMC_RtmWarnUZelleMin_XIX_BMC_HV_08_XIX_HCP5_CANFD01: start 58, 3 bit, little-endian, data-type-policy=OVERRIDE, i-signal-type=PRIMITIVE, init-value=0, base-type=BT_BMC_RtmWarnUZelleMin, compu-method=CM_BMC_RtmWarnUZelleMin, data-constr=DC_BMC_RtmWarnUZelleMin, transfer-property=PENDING  # RTM Signal Min_voltage_cell_Warning
    signal BMC_RtmWarnZelleZustand_XIX_BMC_HV_08_XIX_HCP5_CANFD01: start 61, 3 bit, little-endian, data-type-policy=OVERRIDE, i-signal-type=PRIMITIVE, init-value=0, base-type=BT_BMC_RtmWarnZelleZustand, compu-method=CM_BMC_RtmWarnZelleZustand, data-constr=DC_BMC_RtmWarnZelleZustand, transfer-property=PENDING  # RTM Signal Cell poor-consistency warning
    signal BMC_Pack_SN_01_XIX_BMC_HV_08_XIX_HCP5_CANFD01: start 64, 8 bit, little-endian, data-type-policy=OVERRIDE, i-signal-type=PRIMITIVE, init-value=255, base-type=BT_BMC_Pack_SN_01, compu-method=CM_BMC_Pack_SN_01, data-constr=DC_BMC_Pack_SN_01, transfer-property=PENDING  # Seriennummer der HV Batterie, Byte 1, ASCII Codierung
    signal BMC_Pack_SN_02_XIX_BMC_HV_08_XIX_HCP5_CANFD01: start 72, 8 bit, little-endian, data-type-policy=OVERRIDE, i-signal-type=PRIMITIVE, init-value=255, base-type=BT_BMC_Pack_SN_02, compu-method=CM_BMC_Pack_SN_02, data-constr=DC_BMC_Pack_SN_02, transfer-property=PENDING  # Seriennummer der HV Batterie, Byte 2, ASCII Codierung
    signal BMC_Pack_SN_03_XIX_BMC_HV_08_XIX_HCP5_CANFD01: start 80, 8 bit, little-endian, data-type-policy=OVERRIDE, i-signal-type=PRIMITIVE, init-value=255, base-type=BT_BMC_Pack_SN_03, compu-method=CM_BMC_Pack_SN_03, data-constr=DC_BMC_Pack_SN_03, transfer-property=PENDING  # Seriennummer der HV Batterie, Byte 3, ASCII Codierung
    signal BMC_Pack_SN_04_XIX_BMC_HV_08_XIX_HCP5_CANFD01: start 88, 8 bit, little-endian, data-type-policy=OVERRIDE, i-signal-type=PRIMITIVE, init-value=255, base-type=BT_BMC_Pack_SN_04, compu-method=CM_BMC_Pack_SN_04, data-constr=DC_BMC_Pack_SN_04, transfer-property=PENDING  # Seriennummer der HV Batterie, Byte 4, ASCII Codierung
    signal BMC_Pack_SN_05_XIX_BMC_HV_08_XIX_HCP5_CANFD01: start 96, 8 bit, little-endian, data-type-policy=OVERRIDE, i-signal-type=PRIMITIVE, init-value=255, base-type=BT_BMC_Pack_SN_05, compu-method=CM_BMC_Pack_SN_05, data-constr=DC_BMC_Pack_SN_05, transfer-property=PENDING  # Seriennummer der HV Batterie, Byte 5, ASCII Codierung
    signal BMC_Pack_SN_06_XIX_BMC_HV_08_XIX_HCP5_CANFD01: start 104, 8 bit, little-endian, data-type-policy=OVERRIDE, i-signal-type=PRIMITIVE, init-value=255, base-type=BT_BMC_Pack_SN_06, compu-method=CM_BMC_Pack_SN_06, data-constr=DC_BMC_Pack_SN_06, transfer-property=PENDING  # Seriennummer der HV Batterie, Byte 6, ASCII Codierung
    signal BMC_Pack_SN_07_XIX_BMC_HV_08_XIX_HCP5_CANFD01: start 112, 8 bit, little-endian, data-type-policy=OVERRIDE, i-signal-type=PRIMITIVE, init-value=255, base-type=BT_BMC_Pack_SN_07, compu-method=CM_BMC_Pack_SN_07, data-constr=DC_BMC_Pack_SN_07, transfer-property=PENDING  # Seriennummer der HV Batterie, Byte 7, ASCII Codierung
    signal BMC_Pack_SN_08_XIX_BMC_HV_08_XIX_HCP5_CANFD01: start 120, 8 bit, little-endian, data-type-policy=OVERRIDE, i-signal-type=PRIMITIVE, init-value=255, base-type=BT_BMC_Pack_SN_08, compu-method=CM_BMC_Pack_SN_08, data-constr=DC_BMC_Pack_SN_08, transfer-property=PENDING  # Seriennummer der HV Batterie, Byte 8, ASCII Codierung
    signal BMC_Pack_SN_09_XIX_BMC_HV_08_XIX_HCP5_CANFD01: start 128, 8 bit, little-endian, data-type-policy=OVERRIDE, i-signal-type=PRIMITIVE, init-value=255, base-type=BT_BMC_Pack_SN_09, compu-method=CM_BMC_Pack_SN_09, data-constr=DC_BMC_Pack_SN_09, transfer-property=PENDING  # Seriennummer der HV Batterie, Byte 9, ASCII Codierung
    signal BMC_Pack_SN_10_XIX_BMC_HV_08_XIX_HCP5_CANFD01: start 136, 8 bit, little-endian, data-type-policy=OVERRIDE, i-signal-type=PRIMITIVE, init-value=255, base-type=BT_BMC_Pack_SN_10, compu-method=CM_BMC_Pack_SN_10, data-constr=DC_BMC_Pack_SN_10, transfer-property=PENDING  # Seriennummer der HV Batterie, Byte 10, ASCII Codierung
    signal BMC_Pack_SN_11_XIX_BMC_HV_08_XIX_HCP5_CANFD01: start 144, 8 bit, little-endian, data-type-policy=OVERRIDE, i-signal-type=PRIMITIVE, init-value=255, base-type=BT_BMC_Pack_SN_11, compu-method=CM_BMC_Pack_SN_11, data-constr=DC_BMC_Pack_SN_11, transfer-property=PENDING  # Seriennummer der HV Batterie, Byte 11, ASCII Codierung
    signal BMC_Pack_SN_12_XIX_BMC_HV_08_XIX_HCP5_CANFD01: start 152, 8 bit, little-endian, data-type-policy=OVERRIDE, i-signal-type=PRIMITIVE, init-value=255, base-type=BT_BMC_Pack_SN_12, compu-method=CM_BMC_Pack_SN_12, data-constr=DC_BMC_Pack_SN_12, transfer-property=PENDING  # Seriennummer der HV Batterie, Byte 12, ASCII Codierung
    signal BMC_Pack_SN_13_XIX_BMC_HV_08_XIX_HCP5_CANFD01: start 160, 8 bit, little-endian, data-type-policy=OVERRIDE, i-signal-type=PRIMITIVE, init-value=255, base-type=BT_BMC_Pack_SN_13, compu-method=CM_BMC_Pack_SN_13, data-constr=DC_BMC_Pack_SN_13, transfer-property=PENDING  # Seriennummer der HV Batterie, Byte 13, ASCII Codierung
    signal BMC_Pack_SN_14_XIX_BMC_HV_08_XIX_HCP5_CANFD01: start 168, 8 bit, little-endian, data-type-policy=OVERRIDE, i-signal-type=PRIMITIVE, init-value=255, base-type=BT_BMC_Pack_SN_14, compu-method=CM_BMC_Pack_SN_14, data-constr=DC_BMC_Pack_SN_14, transfer-property=PENDING  # Seriennummer der HV Batterie, Byte 14, ASCII Codierung
    signal BMC_Pack_SN_15_XIX_BMC_HV_08_XIX_HCP5_CANFD01: start 176, 8 bit, little-endian, data-type-policy=OVERRIDE, i-signal-type=PRIMITIVE, init-value=255, base-type=BT_BMC_Pack_SN_15, compu-method=CM_BMC_Pack_SN_15, data-constr=DC_BMC_Pack_SN_15, transfer-property=PENDING  # Seriennummer der HV Batterie, Byte 15, ASCII Codierung
    signal BMC_Pack_SN_16_XIX_BMC_HV_08_XIX_HCP5_CANFD01: start 184, 8 bit, little-endian, data-type-policy=OVERRIDE, i-signal-type=PRIMITIVE, init-value=255, base-type=BT_BMC_Pack_SN_16, compu-method=CM_BMC_Pack_SN_16, data-constr=DC_BMC_Pack_SN_16, transfer-property=PENDING  # Seriennummer der HV Batterie, Byte 16, ASCII Codierung
    signal BMC_Pack_SN_17_XIX_BMC_HV_08_XIX_HCP5_CANFD01: start 192, 8 bit, little-endian, data-type-policy=OVERRIDE, i-signal-type=PRIMITIVE, init-value=255, base-type=BT_BMC_Pack_SN_17, compu-method=CM_BMC_Pack_SN_17, data-constr=DC_BMC_Pack_SN_17, transfer-property=PENDING  # Seriennummer der HV Batterie, Byte 17, ASCII Codierung
    signal BMC_Pack_SN_18_XIX_BMC_HV_08_XIX_HCP5_CANFD01: start 200, 8 bit, little-endian, data-type-policy=OVERRIDE, i-signal-type=PRIMITIVE, init-value=255, base-type=BT_BMC_Pack_SN_18, compu-method=CM_BMC_Pack_SN_18, data-constr=DC_BMC_Pack_SN_18, transfer-property=PENDING  # Seriennummer der HV Batterie, Byte 18, ASCII Codierung
    signal BMC_Pack_SN_19_XIX_BMC_HV_08_XIX_HCP5_CANFD01: start 208, 8 bit, little-endian, data-type-policy=OVERRIDE, i-signal-type=PRIMITIVE, init-value=255, base-type=BT_BMC_Pack_SN_19, compu-method=CM_BMC_Pack_SN_19, data-constr=DC_BMC_Pack_SN_19, transfer-property=PENDING  # Seriennummer der HV Batterie, Byte 19, ASCII Codierung
    signal BMC_Pack_SN_20_XIX_BMC_HV_08_XIX_HCP5_CANFD01: start 216, 8 bit, little-endian, data-type-policy=OVERRIDE, i-signal-type=PRIMITIVE, init-value=255, base-type=BT_BMC_Pack_SN_20, compu-method=CM_BMC_Pack_SN_20, data-constr=DC_BMC_Pack_SN_20, transfer-property=PENDING  # Seriennummer der HV Batterie, Byte 20, ASCII Codierung
    signal BMC_Pack_SN_21_XIX_BMC_HV_08_XIX_HCP5_CANFD01: start 224, 8 bit, little-endian, data-type-policy=OVERRIDE, i-signal-type=PRIMITIVE, init-value=255, base-type=BT_BMC_Pack_SN_21, compu-method=CM_BMC_Pack_SN_21, data-constr=DC_BMC_Pack_SN_21, transfer-property=PENDING  # Seriennummer der HV Batterie, Byte 21, ASCII Codierung
    signal BMC_Pack_SN_22_XIX_BMC_HV_08_XIX_HCP5_CANFD01: start 232, 8 bit, little-endian, data-type-policy=OVERRIDE, i-signal-type=PRIMITIVE, init-value=255, base-type=BT_BMC_Pack_SN_22, compu-method=CM_BMC_Pack_SN_22, data-constr=DC_BMC_Pack_SN_22, transfer-property=PENDING  # Seriennummer der HV Batterie, Byte 22, ASCII Codierung
    signal BMC_Pack_SN_23_XIX_BMC_HV_08_XIX_HCP5_CANFD01: start 240, 8 bit, little-endian, data-type-policy=OVERRIDE, i-signal-type=PRIMITIVE, init-value=255, base-type=BT_BMC_Pack_SN_23, compu-method=CM_BMC_Pack_SN_23, data-constr=DC_BMC_Pack_SN_23, transfer-property=PENDING  # Seriennummer der HV Batterie, Byte 23, ASCII Codierung
    signal BMC_Pack_SN_24_XIX_BMC_HV_08_XIX_HCP5_CANFD01: start 248, 8 bit, little-endian, data-type-policy=OVERRIDE, i-signal-type=PRIMITIVE, init-value=255, base-type=BT_BMC_Pack_SN_24, compu-method=CM_BMC_Pack_SN_24, data-constr=DC_BMC_Pack_SN_24, transfer-property=PENDING  # Seriennummer der HV Batterie, Byte 24, ASCII Codierung
    signal BMC_Pack_SN_25_XIX_BMC_HV_08_XIX_HCP5_CANFD01: start 256, 8 bit, little-endian, data-type-policy=OVERRIDE, i-signal-type=PRIMITIVE, init-value=255, base-type=BT_BMC_Pack_SN_25, compu-method=CM_BMC_Pack_SN_25, data-constr=DC_BMC_Pack_SN_25, transfer-property=PENDING  # Seriennummer der HV Batterie, Byte 25, ASCII Codierung
    signal BMC_Pack_SN_26_XIX_BMC_HV_08_XIX_HCP5_CANFD01: start 264, 8 bit, little-endian, data-type-policy=OVERRIDE, i-signal-type=PRIMITIVE, init-value=255, base-type=BT_BMC_Pack_SN_26, compu-method=CM_BMC_Pack_SN_26, data-constr=DC_BMC_Pack_SN_26, transfer-property=PENDING  # Seriennummer der HV Batterie, Byte 26, ASCII Codierung
    signal BMC_IstTemperaturMax_Modul_ID_XIX_BMC_HV_08_XIX_HCP5_CANFD01: start 272, 8 bit, little-endian, data-type-policy=OVERRIDE, i-signal-type=PRIMITIVE, init-value=255, base-type=BT_BMC_IstTemperaturMax_Modul_ID, compu-method=CM_BMC_IstTemperaturMax_Modul_ID, data-constr=DC_BMC_IstTemperaturMax_Modul_ID, unit=Unit_Unit_None, transfer-property=PENDING  # RTM-Signal: Nummer (ID) des Moduls mit dem aktuell höchsten Temperaturmeßwert
    signal BMC_IstTemperaturMin_Modul_ID_XIX_BMC_HV_08_XIX_HCP5_CANFD01: start 280, 8 bit, little-endian, data-type-policy=OVERRIDE, i-signal-type=PRIMITIVE, init-value=255, base-type=BT_BMC_IstTemperaturMin_Modul_ID, compu-method=CM_BMC_IstTemperaturMin_Modul_ID, data-constr=DC_BMC_IstTemperaturMin_Modul_ID, unit=Unit_Unit_None, transfer-property=PENDING  # RTM-Signal: Nummer (ID) des Moduls mit dem aktuell niedrigsten Temperaturmeßwert
    signal BMC_IstZellSpannungMin_Modul_ID_XIX_BMC_HV_08_XIX_HCP5_CANFD01: start 288, 8 bit, little-endian, data-type-policy=OVERRIDE, i-signal-type=PRIMITIVE, init-value=255, base-type=BT_BMC_IstZellSpannungMin_Modul_ID, compu-method=CM_BMC_IstZellSpannungMin_Modul_ID, data-constr=DC_BMC_IstZellSpannungMin_Modul_ID, unit=Unit_Unit_None, transfer-property=PENDING  # RTM-Signal: Nummer (ID) des Moduls mit der aktuell niedrigsten Zellspannung
    signal BMC_IstZellSpannungMax_Modul_ID_XIX_BMC_HV_08_XIX_HCP5_CANFD01: start 296, 8 bit, little-endian, data-type-policy=OVERRIDE, i-signal-type=PRIMITIVE, init-value=255, base-type=BT_BMC_IstZellSpannungMax_Modul_ID, compu-method=CM_BMC_IstZellSpannungMax_Modul_ID, data-constr=DC_BMC_IstZellSpannungMax_Modul_ID, unit=Unit_Unit_None, transfer-property=PENDING  # RTM-Signal: Nummer (ID) des Moduls mit der aktuell höchsten Zellspannung
    signal BMC_IstZellSpannungMin_Zell_ID_XIX_BMC_HV_08_XIX_HCP5_CANFD01: start 304, 8 bit, little-endian, data-type-policy=OVERRIDE, i-signal-type=PRIMITIVE, init-value=255, base-type=BT_BMC_IstZellSpannungMin_Zell_ID, compu-method=CM_BMC_IstZellSpannungMin_Zell_ID, data-constr=DC_BMC_IstZellSpannungMin_Zell_ID, unit=Unit_Unit_None, transfer-property=PENDING  # RTM-Signal: Nummer (ID) der Zelle (innerhalb des Moduls) mit der aktuell niedrigsten Zellspannung
    signal BMC_IstZellSpannungMax_Zell_ID_XIX_BMC_HV_08_XIX_HCP5_CANFD01: start 312, 8 bit, little-endian, data-type-policy=OVERRIDE, i-signal-type=PRIMITIVE, init-value=255, base-type=BT_BMC_IstZellSpannungMax_Zell_ID, compu-method=CM_BMC_IstZellSpannungMax_Zell_ID, data-constr=DC_BMC_IstZellSpannungMax_Zell_ID, unit=Unit_Unit_None, transfer-property=PENDING  # RTM-Signal: Nummer (ID) der Zelle (innerhalb des Moduls) mit der aktuell höchsten Zellspannung
    signal BMC_RtmWarnBattUnautorisiert_XIX_BMC_HV_08_XIX_HCP5_CANFD01: start 320, 3 bit, little-endian, data-type-policy=OVERRIDE, i-signal-type=PRIMITIVE, init-value=0, base-type=BT_BMC_RtmWarnBattUnautorisiert, compu-method=CM_BMC_RtmWarnBattUnautorisiert, data-constr=DC_BMC_RtmWarnBattUnautorisiert, transfer-property=PENDING  # RTM Signal battery unmatched warning
    signal BMC_ExtLadeleistung_XIX_BMC_HV_08_XIX_HCP5_CANFD01: start 328, 16 bit, little-endian, data-type-policy=OVERRIDE, i-signal-type=PRIMITIVE, init-value=65534, base-type=BT_BMC_ExtLadeleistung, invalid-value=Invalid_BMC_ExtLadeleistung_XIX_BMC_HV_08_XIX_HCP5_CANFD01:65535, compu-method=CM_BMC_ExtLadeleistung, data-constr=DC_BMC_ExtLadeleistung, unit=Unit_Unit_KiloWatt, transfer-property=PENDING  # Aktuell mögliche DC/AC- Ladeleistung
  pdu BMC_HV_09_XIX_HCP5_CANFD01: length=16, transmission-mode-true-timing=cyclic-timing={time-offset=0, time-period=0.1}, unused-bit-pattern=0
    signal BMC_Max_Entladestrom_02_XIX_BMC_HV_09_XIX_HCP5_CANFD01: start 12, 14 bit, little-endian, data-type-policy=OVERRIDE, i-signal-type=PRIMITIVE, init-value=16382, base-type=BT_BMC_Max_Entladestrom_02, invalid-value=Invalid_BMC_Max_Entladestrom_02_XIX_BMC_HV_09_XIX_HCP5_CANFD01:16383, compu-method=CM_BMC_Max_Entladestrom_02, data-constr=DC_BMC_Max_Entladestrom_02, unit=Unit_Unit_Amper, transfer-property=PENDING  # Zwingend einzuhaltender Grenzwert für den Entladestrom der Batterie. Verletzungen werden protokolliert.
    signal BMC_Max_Entladeleistung_02_XIX_BMC_HV_09_XIX_HCP5_CANFD01: start 26, 15 bit, little-endian, data-type-policy=OVERRIDE, i-signal-type=PRIMITIVE, init-value=32766, base-type=BT_BMC_Max_Entladeleistung_02, invalid-value=Invalid_BMC_Max_Entladeleistung_02_XIX_BMC_HV_09_XIX_HCP5_CANFD01:32767, compu-method=CM_BMC_Max_Entladeleistung_02, data-constr=DC_BMC_Max_Entladeleistung_02, unit=Unit_Unit_Watt, transfer-property=PENDING  # Maximale Leistung, mit der die Batterie momentan belastet werden darf. Kurze Überschwinger aufgrund dynamischen Verhalten des Reglers sind nach Absprache möglich, aber hierbei muss unbedingt auch der maximale Entladestrom berücksichtigt werden.
    signal BMC_Max_Ladeleistung_02_XIX_BMC_HV_09_XIX_HCP5_CANFD01: start 41, 15 bit, little-endian, data-type-policy=OVERRIDE, i-signal-type=PRIMITIVE, init-value=32766, base-type=BT_BMC_Max_Ladeleistung_02, invalid-value=Invalid_BMC_Max_Ladeleistung_02_XIX_BMC_HV_09_XIX_HCP5_CANFD01:32767, compu-method=CM_BMC_Max_Ladeleistung_02, data-constr=DC_BMC_Max_Ladeleistung_02, unit=Unit_Unit_Watt, transfer-property=PENDING  # Maximale Leistung, mit der die Batterie aktuell geladen werden darf.Kurze Überschwinger aufgrund dynamischen Verhalten des Reglers sind nach Absprache möglich, aber hierbei muss unbedingt auch der maximale Ladestrom berücksichtigt werden.
    signal BMC_Max_Ladestrom_02_XIX_BMC_HV_09_XIX_HCP5_CANFD01: start 56, 14 bit, little-endian, data-type-policy=OVERRIDE, i-signal-type=PRIMITIVE, init-value=16382, base-type=BT_BMC_Max_Ladestrom_02, invalid-value=Invalid_BMC_Max_Ladestrom_02_XIX_BMC_HV_09_XIX_HCP5_CANFD01:16383, compu-method=CM_BMC_Max_Ladestrom_02, data-constr=DC_BMC_Max_Ladestrom_02, unit=Unit_Unit_Amper, transfer-property=PENDING  # Zwingend einzuhaltender Grenzwert für den Ladestrom der Batterie.Verletzungen werden protokolliert.
    signal BMC_Dauer_Entladeleistung_02_XIX_BMC_HV_09_XIX_HCP5_CANFD01: start 70, 14 bit, little-endian, data-type-policy=OVERRIDE, i-signal-type=PRIMITIVE, init-value=16382, base-type=BT_BMC_Dauer_Entladeleistung_02, invalid-value=Invalid_BMC_Dauer_Entladeleistung_02_XIX_BMC_HV_09_XIX_HCP5_CANFD01:16383, compu-method=CM_BMC_Dauer_Entladeleistung_02, data-constr=DC_BMC_Dauer_Entladeleistung_02, unit=Unit_Unit_Watt, transfer-property=PENDING  # ist die aktuelle Dauer-Leistungsfähigkeit der Batterie. Wenn dieser Wert überschritten wird, kann ein zeitliches Derating der maximalen Leistungsgrenzen stattfindet. Die Dauerleistung ändert sich mit Batterietemperatur und Ladezustand.
    signal BMC_Dauer_Ladeleistung_02_XIX_BMC_HV_09_XIX_HCP5_CANFD01: start 84, 14 bit, little-endian, data-type-policy=OVERRIDE, i-signal-type=PRIMITIVE, init-value=16382, base-type=BT_BMC_Dauer_Ladeleistung_02, invalid-value=Invalid_BMC_Dauer_Ladeleistung_02_XIX_BMC_HV_09_XIX_HCP5_CANFD01:16383, compu-method=CM_BMC_Dauer_Ladeleistung_02, data-constr=DC_BMC_Dauer_Ladeleistung_02, unit=Unit_Unit_Watt, transfer-property=PENDING  # ist die aktuelle Dauer-Leistungsfähigkeit der Batterie. Wenn dieser Wert überschritten wird, kann ein zeitliches Derating der maximalen Leistungsgrenzen stattfindet. Die Dauerleistung ändert sich mit Batterietemperatur und Ladezustand.
  pdu BMC_HV_14_XIX_HCP5_CANFD01: length=12, transmission-mode-true-timing=cyclic-timing={time-offset=0, time-period=0.1}, unused-bit-pattern=0
    signal BMC_UBE_Indikator_XIX_BMC_HV_14_XIX_HCP5_CANFD01: start 12, 11 bit, little-endian, data-type-policy=OVERRIDE, i-signal-type=PRIMITIVE, init-value=2046, base-type=BT_BMC_UBE_Indikator, invalid-value=Invalid_BMC_UBE_Indikator_XIX_BMC_HV_14_XIX_HCP5_CANFD01:2047, compu-method=CM_BMC_UBE_Indikator, data-constr=DC_BMC_UBE_Indikator, unit=Unit_Unit_PerCent, transfer-property=PENDING  # Der UBE Indikator gibt das Verhältnis der aktuellen maximalen UBE (BMC_Max_UBE) zur maximalen UBE einer neuen HV Batterie wieder.
    signal BMC_Range_Indikator_XIX_BMC_HV_14_XIX_HCP5_CANFD01: start 23, 11 bit, little-endian, data-type-policy=OVERRIDE, i-signal-type=PRIMITIVE, init-value=2046, base-type=BT_BMC_Range_Indikator, invalid-value=Invalid_BMC_Range_Indikator_XIX_BMC_HV_14_XIX_HCP5_CANFD01:2047, compu-method=CM_BMC_Range_Indikator, data-constr=DC_BMC_Range_Indikator, unit=Unit_Unit_PerCent, transfer-property=PENDING  # Der Range-Indikator gibt das Verhältnis der aktuellen maximalen Reichweite zur maximalen Reichweite eines Neufahrzeugs wieder. Da die Reichweite primär von der UBE abhängt, wird dieser Wert im BMC berechnet
    signal BMC_UBE_Indik_last_update_km_XIX_BMC_HV_14_XIX_HCP5_CANFD01: start 34, 20 bit, little-endian, data-type-policy=OVERRIDE, i-signal-type=PRIMITIVE, init-value=1048574, base-type=BT_BMC_UBE_Indik_last_update_km, invalid-value=Invalid_BMC_UBE_Indik_last_update_km_XIX_BMC_HV_14_XIX_HCP5_CANFD01:1048575, compu-method=CM_BMC_UBE_Indik_last_update_km, data-constr=DC_BMC_UBE_Indik_last_update_km, unit=Unit_Unit_KiloMeter, transfer-property=PENDING  # Strecke seit letzter Aktualisierung des UBE-Indikators in Kilometern.
    signal BMC_EnergieVorhalt_XIX_BMC_HV_14_XIX_HCP5_CANFD01: start 54, 16 bit, little-endian, data-type-policy=OVERRIDE, i-signal-type=PRIMITIVE, init-value=65534, base-type=BT_BMC_EnergieVorhalt, invalid-value=Invalid_BMC_EnergieVorhalt_XIX_BMC_HV_14_XIX_HCP5_CANFD01:65535, compu-method=CM_BMC_EnergieVorhalt, data-constr=DC_BMC_EnergieVorhalt, unit=Unit_Unit_KiloWattHour, transfer-property=PENDING  # Energievorhalt der Batterie (z.B. als Alterungsreserve), welcher nicht in der aktuellen Betriebsstrategie verwendet werden kann, aber zu Kompensation der Alterung genutzt werden kann.
    signal BMC_PCM_VTD_Freeze_Req_XIX_BMC_HV_14_XIX_HCP5_CANFD01: start 70, 2 bit, little-endian, data-type-policy=OVERRIDE, i-signal-type=PRIMITIVE, init-value=2, base-type=BT_BMC_PCM_VTD_Freeze_Req, invalid-value=Invalid_BMC_PCM_VTD_Freeze_Req_XIX_BMC_HV_14_XIX_HCP5_CANFD01:3, compu-method=CM_BMC_PCM_VTD_Freeze_Req, data-constr=DC_BMC_PCM_VTD_Freeze_Req, transfer-property=PENDING  # Synchronisierung der Freeze-Condition für VTD-IT's zwischen BMC und HCP1
    signal BMC_PCM_VTD_LifeTimeReset_Req_XIX_BMC_HV_14_XIX_HCP5_CANFD01: start 72, 2 bit, little-endian, data-type-policy=OVERRIDE, i-signal-type=PRIMITIVE, init-value=2, base-type=BT_BMC_PCM_VTD_LifeTimeReset_Req, invalid-value=Invalid_BMC_PCM_VTD_LifeTimeReset_Req_XIX_BMC_HV_14_XIX_HCP5_CANFD01:3, compu-method=CM_BMC_PCM_VTD_LifeTimeReset_Req, data-constr=DC_BMC_PCM_VTD_LifeTimeReset_Req, transfer-property=PENDING  # Synchronisierung der Freeze-Condition für VTD-IT's zwischen BMC und HCP1
    signal BMC_PCM_VTD_LifeTimeReset_Resp_XIX_BMC_HV_14_XIX_HCP5_CANFD01: start 74, 2 bit, little-endian, data-type-policy=OVERRIDE, i-signal-type=PRIMITIVE, init-value=2, base-type=BT_BMC_PCM_VTD_LifeTimeReset_Resp, invalid-value=Invalid_BMC_PCM_VTD_LifeTimeReset_Resp_XIX_BMC_HV_14_XIX_HCP5_CANFD01:3, compu-method=CM_BMC_PCM_VTD_LifeTimeReset_Resp, data-constr=DC_BMC_PCM_VTD_LifeTimeReset_Resp, transfer-property=PENDING  # Synchronisierung der Freeze-Condition für VTD-IT's zwischen BMC und HCP1
    signal BMC_PCM_VTD_RecentReset_Req_XIX_BMC_HV_14_XIX_HCP5_CANFD01: start 76, 2 bit, little-endian, data-type-policy=OVERRIDE, i-signal-type=PRIMITIVE, init-value=2, base-type=BT_BMC_PCM_VTD_RecentReset_Req, invalid-value=Invalid_BMC_PCM_VTD_RecentReset_Req_XIX_BMC_HV_14_XIX_HCP5_CANFD01:3, compu-method=CM_BMC_PCM_VTD_RecentReset_Req, data-constr=DC_BMC_PCM_VTD_RecentReset_Req, transfer-property=PENDING  # Synchronisierung der Freeze-Condition für VTD-IT's zwischen BMC und HCP1
  pdu HVK_03_XIX_HCP5_CANFD01_E2E: length=8, minimum-delay=0.01, transmission-mode-true-timing=event-controlled-timing={number-of-repetitions=0, repetition-period=0}, unused-bit-pattern=0  # Fuer die Botschaft ist das Cyclic-Timing 0.1 zu verwenden.
    signal HVK_03_CRC_XIX_HVK_03_XIX_HCP5_CANFD01: start 0, 8 bit, little-endian, data-type-policy=OVERRIDE, i-signal-type=PRIMITIVE, init-value=0, base-type=BT_HVK_03_CRC, compu-method=CM_HVK_03_CRC, data-constr=DC_HVK_03_CRC, to BMC_HV(timeout 1 s)  # Für MLB: "Berechnung siehe Lastenheft "Kommunikationsabsicherung für FlexRay und CAN"" Ab MQB und MLBevo: "Berechnung siehe Lastenheft "End-to-End Kommunikationsabsicherung"" Endwerte siehe Begleitdokument "S-PDU Kennungsfolgen"
    signal HVK_03_BZ_XIX_HVK_03_XIX_HCP5_CANFD01: start 8, 4 bit, little-endian, data-type-policy=OVERRIDE, i-signal-type=PRIMITIVE, init-value=0, base-type=BT_HVK_03_BZ, compu-method=CM_HVK_03_BZ, data-constr=DC_HVK_03_BZ, to BMC_HV(timeout 1 s)
    signal HVK_Istmodus_Anf_XIX_HVK_03_XIX_HCP5_CANFD01: start 12, 1 bit, little-endian, data-type-policy=OVERRIDE, i-signal-type=PRIMITIVE, init-value=0, base-type=BT_HVK_Istmodus_Anf, compu-method=CM_HVK_Istmodus_Anf, data-constr=DC_HVK_Istmodus_Anf, to BMC_HV(timeout 1 s)  # HVK-Anforderung an alle HV-Komponenten deren Istmodus im schnellen Zyklus (Inhibitzeit) zu senden.
    signal HVK_BMC_Sollmodus_XIX_HVK_03_XIX_HCP5_CANFD01: start 13, 3 bit, little-endian, data-type-policy=OVERRIDE, i-signal-type=PRIMITIVE, init-value=7, base-type=BT_HVK_BMC_Sollmodus, compu-method=CM_HVK_BMC_Sollmodus, data-constr=DC_HVK_BMC_Sollmodus, to BMC_HV(timeout 1 s)  # Anforderung des Schaltzustand der HV-Batterie
    signal HVK_BMC_Spannung_Anf_XIX_HVK_03_XIX_HCP5_CANFD01: start 16, 4 bit, little-endian, data-type-policy=OVERRIDE, i-signal-type=PRIMITIVE, init-value=3, base-type=BT_HVK_BMC_Spannung_Anf, compu-method=CM_HVK_BMC_Spannung_Anf, data-constr=DC_HVK_BMC_Spannung_Anf, to BMC_HV(timeout 1 s)  # Anforderung der Spannungslage von der HV-Batterie
    signal HVK_HVHL_Sollmodus_XIX_HVK_03_XIX_HCP5_CANFD01: start 20, 2 bit, little-endian, data-type-policy=OVERRIDE, i-signal-type=PRIMITIVE, init-value=3, base-type=BT_HVK_HVHL_Sollmodus, compu-method=CM_HVK_HVHL_Sollmodus, data-constr=DC_HVK_HVHL_Sollmodus  # Kommandierung des HV-Heizer- Luft, als Teilnehmer der HV-Netzsteuerung
    signal HVK_HVHW_Sollmodus_XIX_HVK_03_XIX_HCP5_CANFD01: start 22, 2 bit, little-endian, data-type-policy=OVERRIDE, i-signal-type=PRIMITIVE, init-value=3, base-type=BT_HVK_HVHW_Sollmodus, compu-method=CM_HVK_HVHW_Sollmodus, data-constr=DC_HVK_HVHW_Sollmodus  # Kommandierung des HV-Heizer- Wasser, als Teilnehmer der HV-Netzsteuerung
    signal HVK_DCDC_Sollmodus_XIX_HVK_03_XIX_HCP5_CANFD01: start 24, 3 bit, little-endian, data-type-policy=OVERRIDE, i-signal-type=PRIMITIVE, init-value=7, base-type=BT_HVK_DCDC_Sollmodus, compu-method=CM_HVK_DCDC_Sollmodus, data-constr=DC_HVK_DCDC_Sollmodus  # angeforderte Soll-Betriebsart des DC/DC-Wandlers: 0: Standby; Kommunikation aktiv 1: Zwischenkreis des HV-Netzes wird vorgeladen; HV-Netz wird aktiviert und darf nicht belastet werden. 2: Tiefsetzen (HV --> BN 14,4V) Sollwertvorgabe projektabhängig vom BSG/BCM über Lin/BSS oder vom MSG über 'MO_DC_SollSpannung_NV' bzw. 'MY2_DC_uSetPLV' (PQ35/PL71: Sollwertvorgabe vom BSG) 3: Hochsetzen; Nachladen des HV-Energiespeichers aus dem NV-Energiespeicher 4: Prüfpuls für die 12V-Bordnetzdiagnose. Stromvorgabe kommt von 12V-Seite 5: nicht verfügbar / Rückmeldesignal für internen Fehler DC/DC-Wandler 6: Pruefpuls auf HV-Spannung von <60V durch den DCDC für die Prüfung der Ladeinfrastruktur vor dem Start des DC-Ladevorgangs 7: MSG befindet sich in der Init-Phase; aktuelle Signalwerte nicht gültig; DC/DC soll aktuellen Modus beibehalten (Beibehalten des aktuellen Modus ohne gültigen Sollmodus nur für eine maximale Dauer erlaubt t.b.d.)
    signal HVK_EKK_Sollmodus_XIX_HVK_03_XIX_HCP5_CANFD01: start 27, 3 bit, little-endian, data-type-policy=OVERRIDE, i-signal-type=PRIMITIVE, init-value=7, base-type=BT_HVK_EKK_Sollmodus, compu-method=CM_HVK_EKK_Sollmodus, data-constr=DC_HVK_EKK_Sollmodus  # Sollmodus elektrischer Klimakompressor
    signal HVK_ETM_Freigabe_XIX_HVK_03_XIX_HCP5_CANFD01: start 30, 2 bit, little-endian, data-type-policy=OVERRIDE, i-signal-type=PRIMITIVE, init-value=3, base-type=BT_HVK_ETM_Freigabe, compu-method=CM_HVK_ETM_Freigabe, data-constr=DC_HVK_ETM_Freigabe  # HV-Freigabe für den Antrieb (ETM - Elektr.TraktionsManager)
    signal HVK_HV_Netz_Zustand_XIX_HVK_03_XIX_HCP5_CANFD01: start 32, 4 bit, little-endian, data-type-policy=OVERRIDE, i-signal-type=PRIMITIVE, init-value=15, base-type=BT_HVK_HV_Netz_Zustand, compu-method=CM_HVK_HV_Netz_Zustand, data-constr=DC_HVK_HV_Netz_Zustand  # Aktueller Zustand des HV-Netzes
    signal HVK_Iso_Messung_Start_XIX_HVK_03_XIX_HCP5_CANFD01: start 36, 3 bit, little-endian, data-type-policy=OVERRIDE, i-signal-type=PRIMITIVE, init-value=0, base-type=BT_HVK_Iso_Messung_Start, compu-method=CM_HVK_Iso_Messung_Start, data-constr=DC_HVK_Iso_Messung_Start, to BMC_HV(timeout 1 s)  # Anforderung an die isolationswiderstandsüberwachenden HV-Komponenten zur Durchführung der Isolations-Widerstandsmessung.
    signal HVK_Vorladung_aktiv_XIX_HVK_03_XIX_HCP5_CANFD01: start 39, 1 bit, little-endian, data-type-policy=OVERRIDE, i-signal-type=PRIMITIVE, init-value=0, base-type=BT_HVK_Vorladung_aktiv, compu-method=CM_HVK_Vorladung_aktiv, data-constr=DC_HVK_Vorladung_aktiv  # Systeminformation, dass aktiv vorgeladen wird
    signal HVK_Gesamtst_Spgfreiheit_XIX_HVK_03_XIX_HCP5_CANFD01: start 40, 2 bit, little-endian, data-type-policy=OVERRIDE, i-signal-type=PRIMITIVE, init-value=0, base-type=BT_HVK_Gesamtst_Spgfreiheit, invalid-value=Invalid_HVK_Gesamtst_Spgfreiheit_XIX_HVK_03_XIX_HCP5_CANFD01:3, compu-method=CM_HVK_Gesamtst_Spgfreiheit, data-constr=DC_HVK_Gesamtst_Spgfreiheit  # Status des HV-Systems
    signal HVK_HV_Netz_Warnungen_XIX_HVK_03_XIX_HCP5_CANFD01: start 42, 2 bit, little-endian, data-type-policy=OVERRIDE, i-signal-type=PRIMITIVE, init-value=0, base-type=BT_HVK_HV_Netz_Warnungen, compu-method=CM_HVK_HV_Netz_Warnungen, data-constr=DC_HVK_HV_Netz_Warnungen  # Anforderung Warnung/Fehler HV-System im Kombi 0: Keine Warnung/Init 1:Anforderung_Anzeige_Warnung_HV-Netz (gelbes Symbol) 2:Anforderung_Anzeige_Fehler_HV-Netz (rotes Symbol) 3:Anforderung_Anzeige_Warnung_Kein_Wiederstart_möglich
    signal HVK_eKAT_Sollmodus_XIX_HVK_03_XIX_HCP5_CANFD01: start 44, 2 bit, little-endian, data-type-policy=OVERRIDE, i-signal-type=PRIMITIVE, init-value=3, base-type=BT_HVK_eKAT_Sollmodus, compu-method=CM_HVK_eKAT_Sollmodus, data-constr=DC_HVK_eKAT_Sollmodus  # Angeforderter Sollmodus für den eKAT
    signal HVK_AIAD_Sollmodus_XIX_HVK_03_XIX_HCP5_CANFD01: start 46, 2 bit, little-endian, data-type-policy=OVERRIDE, i-signal-type=PRIMITIVE, init-value=3, base-type=BT_HVK_AIAD_Sollmodus, compu-method=CM_HVK_AIAD_Sollmodus, data-constr=DC_HVK_AIAD_Sollmodus  # HV-Netz Sollmodus für das ADC
    signal HVK_HVLM_Sollmodus_XIX_HVK_03_XIX_HCP5_CANFD01: start 48, 3 bit, little-endian, data-type-policy=OVERRIDE, i-signal-type=PRIMITIVE, init-value=7, base-type=BT_HVK_HVLM_Sollmodus, compu-method=CM_HVK_HVLM_Sollmodus, data-constr=DC_HVK_HVLM_Sollmodus  # Angeforderter Sollmodus des Lademanagers.
    signal HV_Bordnetz_aktiv_XIX_HVK_03_XIX_HCP5_CANFD01: start 51, 1 bit, little-endian, data-type-policy=OVERRIDE, i-signal-type=PRIMITIVE, init-value=0, base-type=BT_HV_Bordnetz_aktiv, compu-method=CM_HV_Bordnetz_aktiv, data-constr=DC_HV_Bordnetz_aktiv  # Signalisiert ein aktives Hochvoltbordnetz. Für die Belastbarkeit des HV-Netzes müssen Strom- bzw. Leistungsgrenzen eingehalten werden
    signal HVK_AktiveEntladung_Anf_XIX_HVK_03_XIX_HCP5_CANFD01: start 52, 1 bit, little-endian, data-type-policy=OVERRIDE, i-signal-type=PRIMITIVE, init-value=0, base-type=BT_HVK_AktiveEntladung_Anf, compu-method=CM_HVK_AktiveEntladung_Anf, data-constr=DC_HVK_AktiveEntladung_Anf  # Anforderung zum aktiven Entladen des HV-Netzes, während der Abschaltung des HV-Netz.
    signal HV_Bordnetz_Fehler_XIX_HVK_03_XIX_HCP5_CANFD01: start 53, 1 bit, little-endian, data-type-policy=OVERRIDE, i-signal-type=PRIMITIVE, init-value=0, base-type=BT_HV_Bordnetz_Fehler, invalid-value=Invalid_HV_Bordnetz_Fehler_XIX_HVK_03_XIX_HCP5_CANFD01:1, compu-method=CM_HV_Bordnetz_Fehler, data-constr=DC_HV_Bordnetz_Fehler  # Status ob im HV-Netz ein Fehler detektiert wurde.
    signal ISignalVoid_HVK_03_XIX_HCP5_CANFD01_0: start 54, 2 bit, little-endian, system signal SignalVoid_HVK_03_0, data-type-policy=OVERRIDE, i-signal-type=PRIMITIVE, base-type=BT_SignalVoid
    signal ISignalVoid_HVK_03_XIX_HCP5_CANFD01_1: start 56, 8 bit, little-endian, system signal SignalVoid_HVK_03_1, data-type-policy=OVERRIDE, i-signal-type=PRIMITIVE, base-type=BT_SignalVoid
    mapping SG_HVK_03_XIX_HCP5_CANFD01: i-signal-group=SG_HVK_03_XIX_HCP5_CANFD01, transfer-property=TRIGGERED-WITHOUT-REPETITION
  pdu OBD_HCP1_XIX_HCP5_CANFD01: length=2, transmission-mode-true-timing=cyclic-timing={time-offset=0, time-period=0.32}, unused-bit-pattern=0
    signal OBDProtocol_req_XIX_OBD_HCP1_XIX_HCP5_CANFD01: start 0, 4 bit, little-endian, data-type-policy=OVERRIDE, i-signal-type=PRIMITIVE, init-value=14, base-type=BT_OBDProtocol_req, invalid-value=Invalid_OBDProtocol_req_XIX_OBD_HCP1_XIX_HCP5_CANFD01:15, compu-method=CM_OBDProtocol_req, data-constr=DC_OBDProtocol_req, transfer-property=PENDING, to BMC_HV(timeout 3.2 s)  # OBD protocol information 'used OBD protocol' from MIL master
    signal HCP1_Indc_StChk_XIX_OBD_HCP1_XIX_HCP5_CANFD01: start 4, 1 bit, little-endian, data-type-policy=OVERRIDE, i-signal-type=PRIMITIVE, init-value=1, base-type=BT_HCP1_Indc_StChk, compu-method=CM_HCP1_Indc_StChk, data-constr=DC_HCP1_Indc_StChk, transfer-property=PENDING  # EU7 OBM-Inducement Request TestNotCompletedThisOperationCycle
    signal HCP1_Indc_StFail_XIX_OBD_HCP1_XIX_HCP5_CANFD01: start 5, 1 bit, little-endian, data-type-policy=OVERRIDE, i-signal-type=PRIMITIVE, init-value=0, base-type=BT_HCP1_Indc_StFail, compu-method=CM_HCP1_Indc_StFail, data-constr=DC_HCP1_Indc_StFail, transfer-property=PENDING  # EU7 OBM-Inducement Request TestFailed
  pdu OBD_Hybrid_01_XIX_HCP5_CANFD01: length=2, transmission-mode-true-timing=cyclic-timing={time-offset=0, time-period=0.32}, unused-bit-pattern=0
    signal OBDProtocol_Hybrid_01_XIX_OBD_Hybrid_01_XIX_HCP5_CANFD01: start 0, 4 bit, little-endian, data-type-policy=OVERRIDE, i-signal-type=PRIMITIVE, init-value=14, base-type=BT_OBDProtocol_Hybrid_01, invalid-value=Invalid_OBDProtocol_Hybrid_01_XIX_OBD_Hybrid_01_XIX_HCP5_CANFD01:15, compu-method=CM_OBDProtocol_Hybrid_01, data-constr=DC_OBDProtocol_Hybrid_01, transfer-property=PENDING  # OBD protocol response 'used OBD protocol' from PrimaryOBDECUs to MIL_Master
    signal Hybrid_01_Indc_StChk_XIX_OBD_Hybrid_01_XIX_HCP5_CANFD01: start 4, 1 bit, little-endian, data-type-policy=OVERRIDE, i-signal-type=PRIMITIVE, init-value=1, base-type=BT_Hybrid_01_Indc_StChk, compu-method=CM_Hybrid_01_Indc_StChk, data-constr=DC_Hybrid_01_Indc_StChk, transfer-property=PENDING  # EU7 OBM-Inducement Request TestNotCompletedThisOperationCycle
    signal Hybrid_01_Indc_StFail_XIX_OBD_Hybrid_01_XIX_HCP5_CANFD01: start 5, 1 bit, little-endian, data-type-policy=OVERRIDE, i-signal-type=PRIMITIVE, init-value=0, base-type=BT_Hybrid_01_Indc_StFail, compu-method=CM_Hybrid_01_Indc_StFail, data-constr=DC_Hybrid_01_Indc_StFail, transfer-property=PENDING  # EU7 OBM-Inducement Request TestFailed
  pdu SOK_Zeit_Hybrid_01_Resp_01_XIX_HCP5_CANFD01: length=8, minimum-delay=0.1, transmission-mode-true-timing=event-controlled-timing={number-of-repetitions=0, repetition-period=0}, unused-bit-pattern=0
    signal SOK_Zeit_Hybrid_01_Zeit_XIX_SOK_Zeit_Hybrid_01_Resp_01_XIX_HCP5_CANFD01: start 0, 56 bit, opaque, data-type-policy=OVERRIDE, i-signal-type=ARRAY, base-type=BT_SOK_Zeit_Hybrid_01_Zeit, compu-method=CM_SOK_Zeit_Hybrid_01_Zeit, data-constr=DC_SOK_Zeit_Hybrid_01_Zeit, unit=Unit_Unit_None, transfer-property=TRIGGERED-ON-CHANGE-WITHOUT-REPETITION, to BMC_HV  # Response signal of SOK time server to challenge of an SOK participant, containing SOK time
  user defined i pdu CDD_HCP5_CANFD01_XIX_TPCHType_CANFD_DAAP_XIX_0x1C403F7B_XIX_0x1C423F7B_XIX_Physical: length=512, cdd-type=TPCHType_CANFD_DAAP
  user defined i pdu CDD_HCP5_CANFD01_XIX_TPCHType_CANFD_DAAP_XIX_0x1C413FDD_XIX_Functional: length=62, cdd-type=TPCHType_CANFD_DAAP
  user defined i pdu CDD_HCP5_CANFD01_XIX_TPCHType_CANFD_DAAP_XIX_0x1C423F7B_XIX_0x1C403F7B_XIX_Physical: length=512, cdd-type=TPCHType_CANFD_DAAP
package /IPDUGroup
  19 x i signal i pdu group:
    BMC_HV_XIX_BMC_CAN01_Rx: communication-direction=IN, communication-mode=CAN_Receive_All
      i-signal-i-pdus:
        UI1_{03..05}_XIX_BMC_CAN01
        UI2_04_XIX_BMC_CAN01
        UI1_Komponentenfehler_01_XIX_BMC_CAN01
        UI1_Komponentenfehler_02_XIX_BMC_CAN01
        UI2_Komponentenfehler_01_XIX_BMC_CAN01
        UI2_Komponentenfehler_02_XIX_BMC_CAN01
        UI2Sens02_CALID_01_XIX_BMC_CAN01
        UI2Sens02_CALID_02_XIX_BMC_CAN01
        UI2Sens02_CVN_XIX_BMC_CAN01
        UI2Sens01_CVN_XIX_BMC_CAN01
        UI2Sens01_CALID_01_XIX_BMC_CAN01
        UI2Sens01_CALID_02_XIX_BMC_CAN01
        BJB_CVN_01_XIX_BMC_CAN01
        BJB_CALID_01_XIX_BMC_CAN01
        BJB_CALID_02_XIX_BMC_CAN01
        BJB_08_XIX_BMC_CAN01
        UI1_01_XIX_BMC_CAN01_E2E
        UI1_02_XIX_BMC_CAN01_E2E
        UI2_{01..03}_XIX_BMC_CAN01_E2E
        BJB_{10..13}_XIX_BMC_CAN01_E2E
    BMC_HV_XIX_BMC_CAN01_Tx: communication-direction=OUT, communication-mode=CAN_Transmit_All
      i-signal-i-pdus:
        OTAMC_D_01_XIX_BMC_CAN01
        ORU_Control_D_01_XIX_BMC_CAN01
        ORU_Control_A_01_XIX_BMC_CAN01
        Systeminfo_01_XIX_BMC_CAN01
        ORU_01_XIX_BMC_CAN01
        ClampControl_01_XIX_BMC_CAN01
        OBD_03_XIX_BMC_CAN01
        OBD_04_XIX_BMC_CAN01
        BMC_HV_04_XIX_BMC_CAN01_E2E
        BMC_HV_{10..13}_XIX_BMC_CAN01_E2E
    BMC_HV_XIX_HCP5_CANFD01_Rx: communication-direction=IN, communication-mode=CAN_Receive_All
      i-signal-i-pdus:
        NVEM_12_XIX_HCP5_CANFD01
        HVLM_13_XIX_HCP5_CANFD01
        Airbag_10_XIX_HCP5_CANFD01
        Diagnose_01_XIX_HCP5_CANFD01
        Systeminfo_01_XIX_HCP5_CANFD01
        ORU_01_XIX_HCP5_CANFD01
        DCDC_04_XIX_HCP5_CANFD01
        SOK_NoAuthenticTime_01_XIX_HCP5_CANFD01
        ZeitMaster_01_XIX_HCP5_CANFD01
        WFS_02_XIX_HCP5_CANFD01
        ClampControl_01_XIX_HCP5_CANFD01
        Charisma_20_XIX_HCP5_CANFD01
        Thermomanagement_01_XIX_HCP5_CANFD01
        OTP_01_XIX_HCP5_CANFD01
        OBG_01_XIX_HCP5_CANFD01
        KS_Hybrid_01_Challenge_M_XIX_HCP5_CANFD01
        KS_Hybrid_01_Response_M_XIX_HCP5_CANFD01
        DEV_Hybrid_01_Req_00_XIX_HCP5_CANFD01
        OBD_03_XIX_HCP5_CANFD01
        VDSO_05_XIX_HCP5_CANFD01
        OBD_04_XIX_HCP5_CANFD01
        Zeitmaster_05_XIX_HCP5_CANFD01
        SOK_Zeit_Hybrid_01_Resp_01_XIX_HCP5_CANFD01
        HVEM_07_XIX_HCP5_CANFD01
        ELF_06_XIX_HCP5_CANFD01
        HCP1_17_XIX_HCP5_CANFD01
        DCDC_NV_CALID_XIX_HCP5_CANFD01
        DCDC_NV_CVN_XIX_HCP5_CANFD01
        DCDC_NV_Komponentenfehler_01_XIX_HCP5_CANFD01
        DCDC_NV_Komponentenfehler_03_XIX_HCP5_CANFD01
        DCDC_NV_Komponentenfehler_02_XIX_HCP5_CANFD01
        DCDC_NV_Komponentenfehler_04_XIX_HCP5_CANFD01
        OBD_HCP1_XIX_HCP5_CANFD01
        HVLM_14_XIX_HCP5_CANFD01_E2E
        ORU_Control_A_01_XIX_HCP5_CANFD01_E2E
        ORU_Control_D_01_XIX_HCP5_CANFD01_E2E
        OTAMC_D_01_XIX_HCP5_CANFD01_E2E
        HVK_03_XIX_HCP5_CANFD01_E2E
    BMC_HV_XIX_HCP5_CANFD01_Tx: communication-direction=OUT, communication-mode=CAN_Transmit_All
      i-signal-i-pdus:
        KN_Hybrid_01_XIX_HCP5_CANFD01
        BMC_HV_03_XIX_HCP5_CANFD01
        KS_Hybrid_01_Challenge_K_XIX_HCP5_CANFD01
        KS_Hybrid_01_ReqFrame_XIX_HCP5_CANFD01
        KS_Hybrid_01_Response_K_XIX_HCP5_CANFD01
        BMC_HV_05_XIX_HCP5_CANFD01
        BMC_HV_06_XIX_HCP5_CANFD01
        DEV_Hybrid_01_Resp_FF_XIX_HCP5_CANFD01
        DS_Hybrid_01_XIX_HCP5_CANFD01
        BMC_HV_07_XIX_HCP5_CANFD01
        BMC_HV_08_XIX_HCP5_CANFD01
        BMC_CMC_Zellspannung_05_XIX_HCP5_CANFD01
        BMC_CMC_Zellspannung_04_XIX_HCP5_CANFD01
        BMC_CMC_Zellspannung_03_XIX_HCP5_CANFD01
        BMC_CMC_Zellspannung_02_XIX_HCP5_CANFD01
        BMC_CMC_Zellspannung_01_XIX_HCP5_CANFD01
        BMC_CMC_Temperatur_02_XIX_HCP5_CANFD01
        BMC_CMC_Temperatur_01_XIX_HCP5_CANFD01
        SOK_Zeit_Hybrid_01_Chal_01_XIX_HCP5_CANFD01
        BMC_CMC_Temperatur_03_XIX_HCP5_CANFD01
        BMC_HV_09_XIX_HCP5_CANFD01
        BMC_HV_14_XIX_HCP5_CANFD01
        OBD_Hybrid_01_XIX_HCP5_CANFD01
        BMC_HV_01_XIX_HCP5_CANFD01_E2E
        BMC_HV_02_XIX_HCP5_CANFD01_E2E
    BMC_HV_XIX_PNC_01_CarWakeUp_Tx: communication-direction=OUT, communication-mode=Transmit_01_CarWakeUp, i-signal-i-pdus=[DS_Hybrid_01_XIX_HCP5_CANFD01, KN_Hybrid_01_XIX_HCP5_CANFD01]
    BMC_HV_XIX_PNC_02_Basefunction_Powertrain_Rx: communication-direction=IN, communication-mode=Receive_02_Basefunction_Powertrain, i-signal-i-pdus=[ORU_Control_D_01_XIX_HCP5_CANFD01_E2E, OTAMC_D_01_XIX_HCP5_CANFD01_E2E]
    BMC_HV_XIX_PNC_06_Basefunction_ComfortLight_Rx: communication-direction=IN, communication-mode=Receive_06_Basefunction_ComfortLight, i-signal-i-pdus=[ClampControl_01_XIX_HCP5_CANFD01, WFS_02_XIX_HCP5_CANFD01]
    BMC_HV_XIX_PNC_07_Basefunction_CrossSection_Rx: communication-direction=IN, communication-mode=Receive_07_Basefunction_CrossSection
      i-signal-i-pdus:
        Charisma_20_XIX_HCP5_CANFD01
        Diagnose_01_XIX_HCP5_CANFD01
        ORU_Control_A_01_XIX_HCP5_CANFD01_E2E
        Systeminfo_01_XIX_HCP5_CANFD01
    BMC_HV_XIX_PNC_10_Powertrain_Rx: communication-direction=IN, communication-mode=Receive_10_Powertrain, i-signal-i-pdus=[HCP1_17_XIX_HCP5_CANFD01, OBD_03_XIX_HCP5_CANFD01, OBD_04_XIX_HCP5_CANFD01, OBD_HCP1_XIX_HCP5_CANFD01]
    BMC_HV_XIX_PNC_11_Chassis_Rx: communication-direction=IN, communication-mode=Receive_11_Chassis, i-signal-i-pdus=VDSO_05_XIX_HCP5_CANFD01
    BMC_HV_XIX_PNC_13_Airbag_Rx: communication-direction=IN, communication-mode=Receive_13_Airbag, i-signal-i-pdus=Airbag_10_XIX_HCP5_CANFD01
    BMC_HV_XIX_PNC_24_ThermoManagement_Rx: communication-direction=IN, communication-mode=Receive_24_ThermoManagement, i-signal-i-pdus=[OTP_01_XIX_HCP5_CANFD01, Thermomanagement_01_XIX_HCP5_CANFD01]
    BMC_HV_XIX_PNC_26_HighVoltage_Charging_Rx: communication-direction=IN, communication-mode=Receive_26_HighVoltage_Charging
      i-signal-i-pdus:
        DCDC_04_XIX_HCP5_CANFD01
        DCDC_NV_Komponentenfehler_{01..04}_XIX_HCP5_CANFD01
        ELF_06_XIX_HCP5_CANFD01
        HVLM_13_XIX_HCP5_CANFD01
        HVLM_14_XIX_HCP5_CANFD01_E2E
        OBG_01_XIX_HCP5_CANFD01
    BMC_HV_XIX_PNC_26_HighVoltage_Charging_Tx: communication-direction=OUT, communication-mode=Transmit_26_HighVoltage_Charging
      i-signal-i-pdus:
        BMC_CMC_Temperatur_{01..03}_XIX_HCP5_CANFD01
        BMC_CMC_Zellspannung_{01..05}_XIX_HCP5_CANFD01
        BMC_HV_01_XIX_HCP5_CANFD01_E2E
        BMC_HV_02_XIX_HCP5_CANFD01_E2E
        BMC_HV_03_XIX_HCP5_CANFD01
        BMC_HV_{05..09}_XIX_HCP5_CANFD01
        BMC_HV_14_XIX_HCP5_CANFD01
    BMC_HV_XIX_PNC_27_Timemaster_Timer_Rx: communication-direction=IN, communication-mode=Receive_27_Timemaster_Timer, i-signal-i-pdus=[Diagnose_01_XIX_HCP5_CANFD01, ZeitMaster_01_XIX_HCP5_CANFD01, Zeitmaster_05_XIX_HCP5_CANFD01]
    BMC_HV_XIX_PNC_30_EnergyManagement_Rx: communication-direction=IN, communication-mode=Receive_30_EnergyManagement, i-signal-i-pdus=[HVEM_07_XIX_HCP5_CANFD01, HVK_03_XIX_HCP5_CANFD01_E2E, NVEM_12_XIX_HCP5_CANFD01]
    BMC_HV_XIX_PNC_30_EnergyManagement_Tx: communication-direction=OUT, communication-mode=Transmit_30_EnergyManagement, i-signal-i-pdus=[BMC_HV_01_XIX_HCP5_CANFD01_E2E, BMC_HV_02_XIX_HCP5_CANFD01_E2E]
    BMC_HV_XIX_PNC_40_Diagnosis_Energy_Rx: communication-direction=IN, communication-mode=Receive_40_Diagnosis_Energy, i-signal-i-pdus=[DCDC_NV_CALID_XIX_HCP5_CANFD01, DCDC_NV_CVN_XIX_HCP5_CANFD01]
    BMC_HV_XIX_PNC_40_Diagnosis_Energy_Tx: communication-direction=OUT, communication-mode=Transmit_40_Diagnosis_Energy
      i-signal-i-pdus:
        BMC_HV_02_XIX_HCP5_CANFD01_E2E
        DS_Hybrid_01_XIX_HCP5_CANFD01
        KN_Hybrid_01_XIX_HCP5_CANFD01
        OBD_Hybrid_01_XIX_HCP5_CANFD01
package /Gateway
  gateway BMC_HV: ecu=BMC_HV
    i-pdu-mappings:
      source-i-pdu=CHNL/PT_DEV_BJB_Resp_FF, target-i-pdu=CHNL/PT_DEV_BJB_Resp_FF
      source-i-pdu=CHNL/PT_DIA_BJB_Resp, target-i-pdu=CHNL/PT_DIA_BJB_Resp
      source-i-pdu=CHNL/PT_DIA_UI2Sens01_Resp, target-i-pdu=CHNL/PT_DIA_UI2Sens01_Resp
      source-i-pdu=CHNL/PT_DIA_UI2Sens02_Resp, target-i-pdu=CHNL/PT_DIA_UI2Sens02_Resp
      source-i-pdu=CHNL/PT_OBDC_SSN_BJB_Resp, target-i-pdu=CHNL/PT_OBDC_SSN_BJB_Resp
      source-i-pdu=CHNL/PT_OBDC_SSN_UI2Sens01_Resp, target-i-pdu=CHNL/PT_OBDC_SSN_UI2Sens01_Resp
      source-i-pdu=CHNL/PT_OBDC_SSN_UI2Sens02_Resp, target-i-pdu=CHNL/PT_OBDC_SSN_UI2Sens02_Resp
      source-i-pdu=CHNL/PT_XCP_BJB_DTO_01, target-i-pdu=CHNL/PT_XCP_BJB_DTO_01
      source-i-pdu=CHNL/PT_ClampControl_01, target-i-pdu=CHNL/PT_ClampControl_01
      source-i-pdu=CHNL/PT_DEV_BJB_Req_01, target-i-pdu=CHNL/PT_DEV_BJB_Req_01
      source-i-pdu=CHNL/PT_DIA_BJB_Req, target-i-pdu=CHNL/PT_DIA_BJB_Req
      source-i-pdu=CHNL/PT_DIA_UI2Sens01_Req, target-i-pdu=CHNL/PT_DIA_UI2Sens01_Req
      source-i-pdu=CHNL/PT_DIA_UI2Sens02_Req, target-i-pdu=CHNL/PT_DIA_UI2Sens02_Req
      source-i-pdu=PT_HCP5_CANFD01_XIX_TPCHType_CANFD_ISO_Diagnose_XIX_0x1C410000_XIX_Functional, target-i-pdu=PT_BMC_CAN01_XIX_TPCHType_CANHS_ISO_Diagnose_XIX_0x700_XIX_Functional
      source-i-pdu=PT_HCP5_CANFD01_XIX_TPCHType_CANFD_OBDC_Diagnose_XIX_0x1C410200_XIX_Functional, target-i-pdu=PT_BMC_CAN01_XIX_TPCHType_CANHS_OBDC_Diagnose_XIX_0x17FD0200_XIX_Functional
      source-i-pdu=CHNL/PT_ISO_Funktionaler_Req_All, target-i-pdu=CHNL/PT_ISO_Funktionaler_Req_All
      source-i-pdu=CHNL/PT_OBD_03, target-i-pdu=CHNL/PT_OBD_03
      source-i-pdu=CHNL/PT_OBD_04, target-i-pdu=CHNL/PT_OBD_04
      source-i-pdu=CHNL/PT_OBDC_SSN_BJB_Req, target-i-pdu=CHNL/PT_OBDC_SSN_BJB_Req
      source-i-pdu=CHNL/PT_OBDC_SSN_UI2Sens01_Req, target-i-pdu=CHNL/PT_OBDC_SSN_UI2Sens01_Req
      source-i-pdu=CHNL/PT_OBDC_SSN_UI2Sens02_Req, target-i-pdu=CHNL/PT_OBDC_SSN_UI2Sens02_Req
      source-i-pdu=CHNL/PT_OBDx_allOBD_Req, target-i-pdu=CHNL/PT_OBDx_allOBD_Req
      source-i-pdu=CHNL/PT_ORU_01, target-i-pdu=CHNL/PT_ORU_01
      source-i-pdu=PT_ORU_Control_A_01_E2E, target-i-pdu=PT_ORU_Control_A_01
      source-i-pdu=PT_ORU_Control_D_01_E2E, target-i-pdu=PT_ORU_Control_D_01
      source-i-pdu=PT_OTAMC_D_01_E2E, target-i-pdu=PT_OTAMC_D_01
      source-i-pdu=CHNL/PT_Systeminfo_01, target-i-pdu=CHNL/PT_Systeminfo_01
      source-i-pdu=CHNL/PT_XCP_BJB_CRO_01, target-i-pdu=CHNL/PT_XCP_BJB_CRO_01
package /E2E
  end to end protection set E2E_ProtectionSet
    21 x end to end protection:
      E2E_Protection_BJB_10_XIX_BMC_CAN01: end-to-end-profile={category=PROFILE_02, data-ids=[145, 246, 224, 228, 221, 250, 123, 231, 243, 56, 116, 41, 48, 15, 129, 141], data-length=64, crc-offset=0, counter-offset=8}, end-to-end-protection-i-signal-i-pdu{data-offset=0, i-signal-group=SG_BJB_10_XIX_BMC_CAN01, i-signal-i-pdu=BJB_10_XIX_BMC_CAN01_E2E}
      E2E_Protection_BJB_11_XIX_BMC_CAN01: end-to-end-profile={category=PROFILE_02, data-ids=[246, 228, 250, 231, 56, 41, 15, 141, 8, 38, 157, 236, 68, 166, 85, 213], data-length=64, crc-offset=0, counter-offset=8}, end-to-end-protection-i-signal-i-pdu{data-offset=0, i-signal-group=SG_BJB_11_XIX_BMC_CAN01, i-signal-i-pdu=BJB_11_XIX_BMC_CAN01_E2E}
      E2E_Protection_BJB_12_XIX_BMC_CAN01: end-to-end-profile={category=PROFILE_02, data-ids=[7, 98, 6, 232, 145, 53, 71, 13, 84, 246, 77, 170, 33, 4, 224, 206], data-length=64, crc-offset=0, counter-offset=8}, end-to-end-protection-i-signal-i-pdu{data-offset=0, i-signal-group=SG_BJB_12_XIX_BMC_CAN01, i-signal-i-pdu=BJB_12_XIX_BMC_CAN01_E2E}
      E2E_Protection_BJB_13_XIX_BMC_CAN01: end-to-end-profile={category=PROFILE_02, data-ids=[107, 108, 122, 145, 79, 106, 175, 246, 205, 17, 32, 224, 127, 43, 28, 228], data-length=64, crc-offset=0, counter-offset=8}, end-to-end-protection-i-signal-i-pdu{data-offset=0, i-signal-group=SG_BJB_13_XIX_BMC_CAN01, i-signal-i-pdu=BJB_13_XIX_BMC_CAN01_E2E}
      E2E_Protection_BMC_HV_01_XIX_HCP5_CANFD01: end-to-end-profile={category=PROFILE_02, data-ids=[24, 113, 16, 141, 215, 170, 176, 120, 172, 18, 174, 12, 221, 241, 133, 104], data-length=128, crc-offset=0, counter-offset=8}, end-to-end-protection-i-signal-i-pdu{data-offset=0, i-signal-group=SG_BMC_HV_01_XIX_HCP5_CANFD01, i-signal-i-pdu=BMC_HV_01_XIX_HCP5_CANFD01_E2E}
      E2E_Protection_BMC_HV_02_XIX_HCP5_CANFD01: end-to-end-profile={category=PROFILE_02, data-ids=[80, 166, 125, 107, 159, 169, 198, 62, 70, 114, 148, 77, 73, 64, 113, 157], data-length=352, crc-offset=0, counter-offset=8}, end-to-end-protection-i-signal-i-pdu{data-offset=0, i-signal-group=SG_BMC_HV_02_XIX_HCP5_CANFD01, i-signal-i-pdu=BMC_HV_02_XIX_HCP5_CANFD01_E2E}
      E2E_Protection_BMC_HV_04_XIX_BMC_CAN01: end-to-end-profile={category=PROFILE_02, data-ids=[32, 5, 204, 8, 239, 105, 176, 200, 60, 96, 235, 118, 145, 39, 4, 2], data-length=64, crc-offset=0, counter-offset=8}, end-to-end-protection-i-signal-i-pdu{data-offset=0, i-signal-group=SG_BMC_HV_04_XIX_BMC_CAN01, i-signal-i-pdu=BMC_HV_04_XIX_BMC_CAN01_E2E}
      E2E_Protection_BMC_HV_10_XIX_BMC_CAN01: end-to-end-profile={category=PROFILE_02, data-ids=[156, 109, 125, 136, 78, 19, 60, 69, 116, 217, 9, 119, 197, 240, 13, 173], data-length=64, crc-offset=0, counter-offset=8}, end-to-end-protection-i-signal-i-pdu{data-offset=0, i-signal-group=SG_BMC_HV_10_XIX_BMC_CAN01, i-signal-i-pdu=BMC_HV_10_XIX_BMC_CAN01_E2E}
      E2E_Protection_BMC_HV_11_XIX_BMC_CAN01: end-to-end-profile={category=PROFILE_02, data-ids=[184, 71, 136, 4, 43, 69, 85, 150, 119, 123, 219, 173, 50, 148, 80, 132], data-length=64, crc-offset=0, counter-offset=8}, end-to-end-protection-i-signal-i-pdu{data-offset=0, i-signal-group=SG_BMC_HV_11_XIX_BMC_CAN01, i-signal-i-pdu=BMC_HV_11_XIX_BMC_CAN01_E2E}
      E2E_Protection_BMC_HV_12_XIX_BMC_CAN01: end-to-end-profile={category=PROFILE_02, data-ids=[222, 23, 2, 122, 201, 111, 210, 106, 74, 176, 159, 205, 101, 78, 180, 224], data-length=64, crc-offset=0, counter-offset=8}, end-to-end-protection-i-signal-i-pdu{data-offset=0, i-signal-group=SG_BMC_HV_12_XIX_BMC_CAN01, i-signal-i-pdu=BMC_HV_12_XIX_BMC_CAN01_E2E}
      E2E_Protection_BMC_HV_13_XIX_BMC_CAN01: end-to-end-profile={category=PROFILE_02, data-ids=[134, 73, 210, 175, 158, 78, 207, 43, 232, 249, 229, 217, 198, 212, 104, 123], data-length=64, crc-offset=0, counter-offset=8}, end-to-end-protection-i-signal-i-pdu{data-offset=0, i-signal-group=SG_BMC_HV_13_XIX_BMC_CAN01, i-signal-i-pdu=BMC_HV_13_XIX_BMC_CAN01_E2E}
      E2E_Protection_HVK_03_XIX_HCP5_CANFD01: end-to-end-profile={category=PROFILE_02, data-ids=[228, 203, 196, 90, 76, 77, 3, 46, 179, 187, 98, 198, 54, 147, 243, 152], data-length=64, crc-offset=0, counter-offset=8}, end-to-end-protection-i-signal-i-pdu{data-offset=0, i-signal-group=SG_HVK_03_XIX_HCP5_CANFD01, i-signal-i-pdu=HVK_03_XIX_HCP5_CANFD01_E2E}
      E2E_Protection_HVLM_14_XIX_HCP5_CANFD01: end-to-end-profile={category=PROFILE_02, data-ids=[193, 59, 114, 227, 147, 125, 140, 134, 96, 101, 18, 49, 225, 188, 1, 89], data-length=64, crc-offset=0, counter-offset=8}, end-to-end-protection-i-signal-i-pdu{data-offset=0, i-signal-group=SG_HVLM_14_XIX_HCP5_CANFD01, i-signal-i-pdu=HVLM_14_XIX_HCP5_CANFD01_E2E}
      E2E_Protection_ORU_Control_A_01_XIX_HCP5_CANFD01: end-to-end-profile={category=PROFILE_02, data-ids=[151, 112, 132, 180, 184, 231, 32, 124, 14, 64, 147, 13, 78, 5, 91, 149], data-length=64, crc-offset=0, counter-offset=8}, end-to-end-protection-i-signal-i-pdu{data-offset=0, i-signal-group=SG_ORU_Control_A_01_XIX_HCP5_CANFD01, i-signal-i-pdu=ORU_Control_A_01_XIX_HCP5_CANFD01_E2E}
      E2E_Protection_ORU_Control_D_01_XIX_HCP5_CANFD01: end-to-end-profile={category=PROFILE_02, data-ids=[146, 27, 198, 145, 41, 90, 78, 240, 110, 67, 128, 40, 238, 163, 200, 62], data-length=64, crc-offset=0, counter-offset=8}, end-to-end-protection-i-signal-i-pdu{data-offset=0, i-signal-group=SG_ORU_Control_D_01_XIX_HCP5_CANFD01, i-signal-i-pdu=ORU_Control_D_01_XIX_HCP5_CANFD01_E2E}
      E2E_Protection_OTAMC_D_01_XIX_HCP5_CANFD01: end-to-end-profile={category=PROFILE_02, data-ids=[95, 24, 245, 113, 130, 16, 147, 141, 76, 215, 110, 170, 214, 176, 183, 120], data-length=32, crc-offset=0, counter-offset=8}, end-to-end-protection-i-signal-i-pdu{data-offset=0, i-signal-group=SG_OTAMC_D_01_XIX_HCP5_CANFD01, i-signal-i-pdu=OTAMC_D_01_XIX_HCP5_CANFD01_E2E}
      E2E_Protection_UI1_01_XIX_BMC_CAN01: end-to-end-profile={category=PROFILE_02, data-ids=[192, 199, 56, 3, 11, 150, 202, 147, 53, 57, 129, 178, 2, 163, 237, 101], data-length=64, crc-offset=0, counter-offset=8}, end-to-end-protection-i-signal-i-pdu{data-offset=0, i-signal-group=SG_UI1_01_XIX_BMC_CAN01, i-signal-i-pdu=UI1_01_XIX_BMC_CAN01_E2E}
      E2E_Protection_UI1_02_XIX_BMC_CAN01: end-to-end-profile={category=PROFILE_02, data-ids=[19, 210, 181, 92, 194, 22, 91, 86, 145, 225, 83, 85, 207, 62, 211, 93], data-length=64, crc-offset=0, counter-offset=8}, end-to-end-protection-i-signal-i-pdu{data-offset=0, i-signal-group=SG_UI1_02_XIX_BMC_CAN01, i-signal-i-pdu=UI1_02_XIX_BMC_CAN01_E2E}
      E2E_Protection_UI2_01_XIX_BMC_CAN01: end-to-end-profile={category=PROFILE_02, data-ids=[37, 13, 87, 137, 181, 195, 139, 103, 172, 1, 106, 11, 144, 146, 193, 76], data-length=64, crc-offset=0, counter-offset=8}, end-to-end-protection-i-signal-i-pdu{data-offset=0, i-signal-group=SG_UI2_01_XIX_BMC_CAN01, i-signal-i-pdu=UI2_01_XIX_BMC_CAN01_E2E}
      E2E_Protection_UI2_02_XIX_BMC_CAN01: end-to-end-profile={category=PROFILE_02, data-ids=[78, 163, 31, 15, 19, 114, 208, 218, 60, 51, 232, 17, 69, 189, 126, 75], data-length=64, crc-offset=0, counter-offset=8}, end-to-end-protection-i-signal-i-pdu{data-offset=0, i-signal-group=SG_UI2_02_XIX_BMC_CAN01, i-signal-i-pdu=UI2_02_XIX_BMC_CAN01_E2E}
      E2E_Protection_UI2_03_XIX_BMC_CAN01: end-to-end-profile={category=PROFILE_02, data-ids=[94, 237, 46, 45, 222, 152, 139, 138, 127, 14, 239, 245, 157, 116, 167, 135], data-length=64, crc-offset=0, counter-offset=8}, end-to-end-protection-i-signal-i-pdu{data-offset=0, i-signal-group=SG_UI2_03_XIX_BMC_CAN01, i-signal-i-pdu=UI2_03_XIX_BMC_CAN01_E2E}
package /ISignal
  29 x i signal group:
    SG_BJB_10_XIX_BMC_CAN01: i-signal=[BJB_10_CRC_XIX_BJB_10_XIX_BMC_CAN01, BJB_10_BZ_XIX_BJB_10_XIX_BMC_CAN01, BJB_Sperrung_Unterspannung_XIX_BJB_10_XIX_BMC_CAN01, BJB_Status_HV_Spannungssensorik_XIX_BJB_10_XIX_BMC_CAN01, BJB_Lebensdauer_Trennelemente_XIX_BJB_10_XIX_BMC_CAN01, BJB_Status_Trennelemente_XIX_BJB_10_XIX_BMC_CAN01, ISignalVoid_BJB_10_XIX_BMC_CAN01_0, ISignalVoid_BJB_10_XIX_BMC_CAN01_1, ISignalVoid_BJB_10_XIX_BMC_CAN01_2, ISignalVoid_BJB_10_XIX_BMC_CAN01_3], system-signal-group=SG_BJB_10  # Kennungsfolge: K_1960-0x91,0xf6,0xe0,0xe4,0xdd,0xfa,0x7b,0xe7,0xf3,0x38,0x74,0x29,0x30,0x0f,0x81,0x8d
    SG_BJB_11_XIX_BMC_CAN01: i-signal=[BJB_11_CRC_XIX_BJB_11_XIX_BMC_CAN01, BJB_11_BZ_XIX_BJB_11_XIX_BMC_CAN01, BJB_Sperrung_Ueberspannung_XIX_BJB_11_XIX_BMC_CAN01, BJB_Ueberspannungszaehler_CMC01_XIX_BJB_11_XIX_BMC_CAN01, BJB_Ueberspannungszaehler_CMC02_XIX_BJB_11_XIX_BMC_CAN01, BJB_Uebertemperaturzaehler_CMC01_XIX_BJB_11_XIX_BMC_CAN01, BJB_Uebertemperaturzaehler_CMC02_XIX_BJB_11_XIX_BMC_CAN01], system-signal-group=SG_BJB_11  # Kennungsfolge: K_1945-0xf6,0xe4,0xfa,0xe7,0x38,0x29,0x0f,0x8d,0x08,0x26,0x9d,0xec,0x44,0xa6,0x55,0xd5
    SG_BJB_12_XIX_BMC_CAN01: i-signal=[BJB_12_CRC_XIX_BJB_12_XIX_BMC_CAN01, BJB_12_BZ_XIX_BJB_12_XIX_BMC_CAN01, BJB_Sperrung_Uebertemperatur_XIX_BJB_12_XIX_BMC_CAN01, BJB_Ueberspannungszaehler_CMC03_XIX_BJB_12_XIX_BMC_CAN01, BJB_Ueberspannungszaehler_CMC04_XIX_BJB_12_XIX_BMC_CAN01, BJB_Uebertemperaturzaehler_CMC03_XIX_BJB_12_XIX_BMC_CAN01, BJB_Uebertemperaturzaehler_CMC04_XIX_BJB_12_XIX_BMC_CAN01], system-signal-group=SG_BJB_12  # Kennungsfolge: K_1947-0x07,0x62,0x06,0xe8,0x91,0x35,0x47,0x0d,0x54,0xf6,0x4d,0xaa,0x21,0x04,0xe0,0xce
    SG_BJB_13_XIX_BMC_CAN01: i-signal=[BJB_13_CRC_XIX_BJB_13_XIX_BMC_CAN01, BJB_13_BZ_XIX_BJB_13_XIX_BMC_CAN01, BJB_Unterspannungszaehler_CMC01_XIX_BJB_13_XIX_BMC_CAN01, BJB_Unterspannungszaehler_CMC02_XIX_BJB_13_XIX_BMC_CAN01, BJB_Unterspannungszaehler_CMC03_XIX_BJB_13_XIX_BMC_CAN01, BJB_Unterspannungszaehler_CMC04_XIX_BJB_13_XIX_BMC_CAN01, ISignalVoid_BJB_13_XIX_BMC_CAN01_0, ISignalVoid_BJB_13_XIX_BMC_CAN01_1], system-signal-group=SG_BJB_13  # Kennungsfolge: K_1950-0x6b,0x6c,0x7a,0x91,0x4f,0x6a,0xaf,0xf6,0xcd,0x11,0x20,0xe0,0x7f,0x2b,0x1c,0xe4
    SG_BMC_HV_01_XIX_HCP5_CANFD01: i-signal=[BMC_HV_01_CRC_XIX_BMC_HV_01_XIX_HCP5_CANFD01, BMC_HV_01_BZ_XIX_BMC_HV_01_XIX_HCP5_CANFD01, BMC_Bankstatus_XIX_BMC_HV_01_XIX_HCP5_CANFD01, BMC_Spannung_XIX_BMC_HV_01_XIX_HCP5_CANFD01, BMC_HVK_EoHVL_Status_XIX_BMC_HV_01_XIX_HCP5_CANFD01, BMC_Modus_XIX_BMC_HV_01_XIX_HCP5_CANFD01, BMC_HVK_Fehler_Intern_XIX_BMC_HV_01_XIX_HCP5_CANFD01, BMC_HVK_Fehler_SD_XIX_BMC_HV_01_XIX_HCP5_CANFD01, BMC_Spannung_ZwischenKreis_XIX_BMC_HV_01_XIX_HCP5_CANFD01, BMC_HVK_Fehler_HVIL_XIX_BMC_HV_01_XIX_HCP5_CANFD01, BMC_Strom_XIX_BMC_HV_01_XIX_HCP5_CANFD01, BMC_Spannung_ZwischenKreis_2_XIX_BMC_HV_01_XIX_HCP5_CANFD01, BMC_Status_Spgfreiheit_XIX_BMC_HV_01_XIX_HCP5_CANFD01, BMC_Strom_Messzeit_XIX_BMC_HV_01_XIX_HCP5_CANFD01, BMC_Spannung_Messzeit_XIX_BMC_HV_01_XIX_HCP5_CANFD01, BMC_Strom_02_XIX_BMC_HV_01_XIX_HCP5_CANFD01, ISignalVoid_BMC_HV_01_XIX_HCP5_CANFD01_0], system-signal-group=SG_BMC_HV_01  # Kennungsfolge: K_291-0x18,0x71,0x10,0x8d,0xd7,0xaa,0xb0,0x78,0xac,0x12,0xae,0x0c,0xdd,0xf1,0x85,0x68
    SG_BMC_HV_02_XIX_HCP5_CANFD01: i-signal=[BMC_HV_02_CRC_XIX_BMC_HV_02_XIX_HCP5_CANFD01, BMC_HV_02_BZ_XIX_BMC_HV_02_XIX_HCP5_CANFD01, BMC_Vorlade_Zielspannung_XIX_BMC_HV_02_XIX_HCP5_CANFD01, BMC_PerfInd_Laden_XIX_BMC_HV_02_XIX_HCP5_CANFD01, BMC_Max_Entladeleistung_XIX_BMC_HV_02_XIX_HCP5_CANFD01, BMC_Status_DCLS_XIX_BMC_HV_02_XIX_HCP5_CANFD01, BMC_Bank_Notlauf_erlaubt_XIX_BMC_HV_02_XIX_HCP5_CANFD01, BMC_Energieinhalt_XIX_BMC_HV_02_XIX_HCP5_CANFD01, BMC_Max_Ladeleistung_XIX_BMC_HV_02_XIX_HCP5_CANFD01, BMC_PerfInd_Entladen_XIX_BMC_HV_02_XIX_HCP5_CANFD01, BMC_Bank_parallel_erlaubt_XIX_BMC_HV_02_XIX_HCP5_CANFD01, BMC_Bank_seriell_erlaubt_XIX_BMC_HV_02_XIX_HCP5_CANFD01, BMC_Spannung_DC_Ladesaeule_XIX_BMC_HV_02_XIX_HCP5_CANFD01, BMC_Max_Ladestrom_XIX_BMC_HV_02_XIX_HCP5_CANFD01, BMC_Max_Entladestrom_XIX_BMC_HV_02_XIX_HCP5_CANFD01, BMC_IWU_Status_XIX_BMC_HV_02_XIX_HCP5_CANFD01, BMC_Verbauinfo_ACSchuetz_XIX_BMC_HV_02_XIX_HCP5_CANFD01, Hybrid_01_OBD_Lampe_Anf_XIX_BMC_HV_02_XIX_HCP5_CANFD01, BMC_Fehler_Warnung_XIX_BMC_HV_02_XIX_HCP5_CANFD01, BMC_MMTR_Status_XIX_BMC_HV_02_XIX_HCP5_CANFD01, ISignalVoid_BMC_HV_02_XIX_HCP5_CANFD01_0, BMC_DC_Laden_XIX_BMC_HV_02_XIX_HCP5_CANFD01, BMC_AC_Laden_XIX_BMC_HV_02_XIX_HCP5_CANFD01, BMC_NutzbarerSOC_XIX_BMC_HV_02_XIX_HCP5_CANFD01, BMC_IWU_Wert_neg_XIX_BMC_HV_02_XIX_HCP5_CANFD01, BMC_IWU_Wert_pos_XIX_BMC_HV_02_XIX_HCP5_CANFD01, Anzeige_SOC_XIX_BMC_HV_02_XIX_HCP5_CANFD01, BMC_Verbauinfo_Bank_XIX_BMC_HV_02_XIX_HCP5_CANFD01, BMC_Fehler_Leistungsred_XIX_BMC_HV_02_XIX_HCP5_CANFD01, BMC_Unterboden_Warnung_XIX_BMC_HV_02_XIX_HCP5_CANFD01, BMC_MinDyn_Entladespannung_XIX_BMC_HV_02_XIX_HCP5_CANFD01, BMC_MinDyn_Ladespannung_XIX_BMC_HV_02_XIX_HCP5_CANFD01, BMC_Leerlaufspannung_XIX_BMC_HV_02_XIX_HCP5_CANFD01, BMC_IstZellspannungMax_XIX_BMC_HV_02_XIX_HCP5_CANFD01, BMC_IstZellspannungMin_XIX_BMC_HV_02_XIX_HCP5_CANFD01, BMC_PredLeistung_StuetzungNV_XIX_BMC_HV_02_XIX_HCP5_CANFD01, BMC_TechnischerSOC_XIX_BMC_HV_02_XIX_HCP5_CANFD01, BMC_Energie_Sockel_SoC_XIX_BMC_HV_02_XIX_HCP5_CANFD01, BMC_ZellTemp_virtuell_min_XIX_BMC_HV_02_XIX_HCP5_CANFD01, BMC_ZellTemp_virtuell_max_XIX_BMC_HV_02_XIX_HCP5_CANFD01, ISignalVoid_BMC_HV_02_XIX_HCP5_CANFD01_1, ISignalVoid_BMC_HV_02_XIX_HCP5_CANFD01_2, ISignalVoid_BMC_HV_02_XIX_HCP5_CANFD01_3, ISignalVoid_BMC_HV_02_XIX_HCP5_CANFD01_4, ISignalVoid_BMC_HV_02_XIX_HCP5_CANFD01_5], system-signal-group=SG_BMC_HV_02  # Kennungsfolge: K_351-0x50,0xa6,0x7d,0x6b,0x9f,0xa9,0xc6,0x3e,0x46,0x72,0x94,0x4d,0x49,0x40,0x71,0x9d
    SG_BMC_HV_04_XIX_BMC_CAN01: i-signal=[BMC_HV_04_CRC_XIX_BMC_HV_04_XIX_BMC_CAN01, BMC_HV_04_BZ_XIX_BMC_HV_04_XIX_BMC_CAN01, BMC_Iso_Mode_Anf_XIX_BMC_HV_04_XIX_BMC_CAN01, BMC_UI1_Spannung1_Schalt_Anf_XIX_BMC_HV_04_XIX_BMC_CAN01, BMC_UI1_Spannung2_Schalt_Anf_XIX_BMC_HV_04_XIX_BMC_CAN01, BMC_UI2_Spannung1_Schalt_Anf_XIX_BMC_HV_04_XIX_BMC_CAN01, BMC_UI2_Spannung2_Schalt_Anf_XIX_BMC_HV_04_XIX_BMC_CAN01, BMC_Flash_Freigabe_XIX_BMC_HV_04_XIX_BMC_CAN01, BMC_Dev_Freigabe_XIX_BMC_HV_04_XIX_BMC_CAN01, ISignalVoid_BMC_HV_04_XIX_BMC_CAN01_0, ISignalVoid_BMC_HV_04_XIX_BMC_CAN01_1, ISignalVoid_BMC_HV_04_XIX_BMC_CAN01_2, ISignalVoid_BMC_HV_04_XIX_BMC_CAN01_3, ISignalVoid_BMC_HV_04_XIX_BMC_CAN01_4, ISignalVoid_BMC_HV_04_XIX_BMC_CAN01_5], system-signal-group=SG_BMC_HV_04  # Kennungsfolge: K_1518-0x20,0x05,0xcc,0x08,0xef,0x69,0xb0,0xc8,0x3c,0x60,0xeb,0x76,0x91,0x27,0x04,0x02
    SG_BMC_HV_10_XIX_BMC_CAN01: i-signal=[BMC_HV_10_CRC_XIX_BMC_HV_10_XIX_BMC_CAN01, BMC_HV_10_BZ_XIX_BMC_HV_10_XIX_BMC_CAN01, BMC_Sperrung_Unterspannung_XIX_BMC_HV_10_XIX_BMC_CAN01, BMC_Status_HV_Spannungssensorik_XIX_BMC_HV_10_XIX_BMC_CAN01, BMC_Lebensdauer_Trennelemente_XIX_BMC_HV_10_XIX_BMC_CAN01, BMC_Status_Trennelemente_XIX_BMC_HV_10_XIX_BMC_CAN01, BMC_Datenuebernahme_Anf_XIX_BMC_HV_10_XIX_BMC_CAN01, ISignalVoid_BMC_HV_10_XIX_BMC_CAN01_0, ISignalVoid_BMC_HV_10_XIX_BMC_CAN01_1, ISignalVoid_BMC_HV_10_XIX_BMC_CAN01_2, ISignalVoid_BMC_HV_10_XIX_BMC_CAN01_3], system-signal-group=SG_BMC_HV_10  # Kennungsfolge: K_1968-0x9c,0x6d,0x7d,0x88,0x4e,0x13,0x3c,0x45,0x74,0xd9,0x09,0x77,0xc5,0xf0,0x0d,0xad
    SG_BMC_HV_11_XIX_BMC_CAN01: i-signal=[BMC_HV_11_CRC_XIX_BMC_HV_11_XIX_BMC_CAN01, BMC_HV_11_BZ_XIX_BMC_HV_11_XIX_BMC_CAN01, BMC_Sperrung_Ueberspannung_XIX_BMC_HV_11_XIX_BMC_CAN01, BMC_Ueberspannungszaehler_CMC01_XIX_BMC_HV_11_XIX_BMC_CAN01, BMC_Ueberspannungszaehler_CMC02_XIX_BMC_HV_11_XIX_BMC_CAN01, BMC_Uebertemperaturzaehler_CMC01_XIX_BMC_HV_11_XIX_BMC_CAN01, BMC_Uebertemperaturzaehler_CMC02_XIX_BMC_HV_11_XIX_BMC_CAN01], system-signal-group=SG_BMC_HV_11  # Kennungsfolge: K_1951-0xb8,0x47,0x88,0x04,0x2b,0x45,0x55,0x96,0x77,0x7b,0xdb,0xad,0x32,0x94,0x50,0x84
    SG_BMC_HV_12_XIX_BMC_CAN01: i-signal=[BMC_HV_12_CRC_XIX_BMC_HV_12_XIX_BMC_CAN01, BMC_HV_12_BZ_XIX_BMC_HV_12_XIX_BMC_CAN01, BMC_Sperrung_Uebertemperatur_XIX_BMC_HV_12_XIX_BMC_CAN01, BMC_Ueberspannungszaehler_CMC03_XIX_BMC_HV_12_XIX_BMC_CAN01, BMC_Ueberspannungszaehler_CMC04_XIX_BMC_HV_12_XIX_BMC_CAN01, BMC_Uebertemperaturzaehler_CMC03_XIX_BMC_HV_12_XIX_BMC_CAN01, BMC_Uebertemperaturzaehler_CMC04_XIX_BMC_HV_12_XIX_BMC_CAN01], system-signal-group=SG_BMC_HV_12  # Kennungsfolge: K_1952-0xde,0x17,0x02,0x7a,0xc9,0x6f,0xd2,0x6a,0x4a,0xb0,0x9f,0xcd,0x65,0x4e,0xb4,0xe0
    SG_BMC_HV_13_XIX_BMC_CAN01: i-signal=[BMC_HV_13_CRC_XIX_BMC_HV_13_XIX_BMC_CAN01, BMC_HV_13_BZ_XIX_BMC_HV_13_XIX_BMC_CAN01, BMC_Unterspannungszaehler_CMC01_XIX_BMC_HV_13_XIX_BMC_CAN01, BMC_Unterspannungszaehler_CMC02_XIX_BMC_HV_13_XIX_BMC_CAN01, BMC_Unterspannungszaehler_CMC03_XIX_BMC_HV_13_XIX_BMC_CAN01, BMC_Unterspannungszaehler_CMC04_XIX_BMC_HV_13_XIX_BMC_CAN01, ISignalVoid_BMC_HV_13_XIX_BMC_CAN01_0, ISignalVoid_BMC_HV_13_XIX_BMC_CAN01_1], system-signal-group=SG_BMC_HV_13  # Kennungsfolge: K_1954-0x86,0x49,0xd2,0xaf,0x9e,0x4e,0xcf,0x2b,0xe8,0xf9,0xe5,0xd9,0xc6,0xd4,0x68,0x7b
    SG_HVK_03_XIX_HCP5_CANFD01: i-signal=[HVK_03_CRC_XIX_HVK_03_XIX_HCP5_CANFD01, HVK_03_BZ_XIX_HVK_03_XIX_HCP5_CANFD01, HVK_Istmodus_Anf_XIX_HVK_03_XIX_HCP5_CANFD01, HVK_BMC_Sollmodus_XIX_HVK_03_XIX_HCP5_CANFD01, HVK_BMC_Spannung_Anf_XIX_HVK_03_XIX_HCP5_CANFD01, HVK_HVHL_Sollmodus_XIX_HVK_03_XIX_HCP5_CANFD01, HVK_HVHW_Sollmodus_XIX_HVK_03_XIX_HCP5_CANFD01, HVK_DCDC_Sollmodus_XIX_HVK_03_XIX_HCP5_CANFD01, HVK_EKK_Sollmodus_XIX_HVK_03_XIX_HCP5_CANFD01, HVK_ETM_Freigabe_XIX_HVK_03_XIX_HCP5_CANFD01, HVK_HV_Netz_Zustand_XIX_HVK_03_XIX_HCP5_CANFD01, HVK_Iso_Messung_Start_XIX_HVK_03_XIX_HCP5_CANFD01, HVK_Vorladung_aktiv_XIX_HVK_03_XIX_HCP5_CANFD01, HVK_Gesamtst_Spgfreiheit_XIX_HVK_03_XIX_HCP5_CANFD01, HVK_HV_Netz_Warnungen_XIX_HVK_03_XIX_HCP5_CANFD01, HVK_eKAT_Sollmodus_XIX_HVK_03_XIX_HCP5_CANFD01, HVK_AIAD_Sollmodus_XIX_HVK_03_XIX_HCP5_CANFD01, HVK_HVLM_Sollmodus_XIX_HVK_03_XIX_HCP5_CANFD01, HV_Bordnetz_aktiv_XIX_HVK_03_XIX_HCP5_CANFD01, HVK_AktiveEntladung_Anf_XIX_HVK_03_XIX_HCP5_CANFD01, HV_Bordnetz_Fehler_XIX_HVK_03_XIX_HCP5_CANFD01, ISignalVoid_HVK_03_XIX_HCP5_CANFD01_0, ISignalVoid_HVK_03_XIX_HCP5_CANFD01_1], system-signal-group=SG_HVK_03  # Kennungsfolge: K_1389-0xe4,0xcb,0xc4,0x5a,0x4c,0x4d,0x03,0x2e,0xb3,0xbb,0x62,0xc6,0x36,0x93,0xf3,0x98
    SG_HVLM_14_XIX_HCP5_CANFD01: i-signal=[HVLM_14_CRC_XIX_HVLM_14_XIX_HCP5_CANFD01, HVLM_14_BZ_XIX_HVLM_14_XIX_HCP5_CANFD01, HVLM_Aktive_Ladeart_XIX_HVLM_14_XIX_HCP5_CANFD01, HVLM_Grundladen_Anf_XIX_HVLM_14_XIX_HCP5_CANFD01, ISignalVoid_HVLM_14_XIX_HCP5_CANFD01_0, HVLM_Pulsierstufe_XIX_HVLM_14_XIX_HCP5_CANFD01, HVLM_Intensitaet_Lk2_XIX_HVLM_14_XIX_HCP5_CANFD01, HVLM_PrkCtl_StAlyReq_XIX_HVLM_14_XIX_HCP5_CANFD01, HVLM_PrkCtl_StPrkLockReq_XIX_HVLM_14_XIX_HCP5_CANFD01, HVLM_WakeUpZaehlerResetAnf_XIX_HVLM_14_XIX_HCP5_CANFD01, ISignalVoid_HVLM_14_XIX_HCP5_CANFD01_1, HVLM_Steckerstatus_XIX_HVLM_14_XIX_HCP5_CANFD01, HVLM_Ladeniveau_Anf_XIX_HVLM_14_XIX_HCP5_CANFD01, HVLM_Ladenaktiv_Standzyklus_XIX_HVLM_14_XIX_HCP5_CANFD01, HVLM_Start_Pulserkennung_XIX_HVLM_14_XIX_HCP5_CANFD01, HVLM_ZustandLadeablauf_XIX_HVLM_14_XIX_HCP5_CANFD01, HVLM_DC_Aufstartmodus_XIX_HVLM_14_XIX_HCP5_CANFD01, HVLM_Ladeszenario_XIX_HVLM_14_XIX_HCP5_CANFD01, HVLM_Ladevorgang_Anf_XIX_HVLM_14_XIX_HCP5_CANFD01, HVLM_Intensitaet_Lk1_XIX_HVLM_14_XIX_HCP5_CANFD01, HVLM_Laden_ISO_Messung_Anf_XIX_HVLM_14_XIX_HCP5_CANFD01], system-signal-group=SG_HVLM_14  # Kennungsfolge: K_1460-0xc1,0x3b,0x72,0xe3,0x93,0x7d,0x8c,0x86,0x60,0x65,0x12,0x31,0xe1,0xbc,0x01,0x59
    SG_KS_Hybrid_01_Challenge_K_XIX_HCP5_CANFD01: i-signal=[KS_Hybrid_01_ChK_SID_XIX_KS_Hybrid_01_Challenge_K_XIX_HCP5_CANFD01, KS_Hybrid_01_ChK_IKACtr_XIX_KS_Hybrid_01_Challenge_K_XIX_HCP5_CANFD01, KS_Hybrid_01_ChK_XIX_KS_Hybrid_01_Challenge_K_XIX_HCP5_CANFD01], system-signal-group=SG_KS_Hybrid_01_Challenge_K  # custom ECU specified i-signal group
    SG_KS_Hybrid_01_Challenge_M_XIX_HCP5_CANFD01: i-signal=[KS_Hybrid_01_ChM_SID_XIX_KS_Hybrid_01_Challenge_M_XIX_HCP5_CANFD01, KS_Hybrid_01_ChM_IKACtr_XIX_KS_Hybrid_01_Challenge_M_XIX_HCP5_CANFD01, KS_Hybrid_01_ChM_XIX_KS_Hybrid_01_Challenge_M_XIX_HCP5_CANFD01], system-signal-group=SG_KS_Hybrid_01_Challenge_M  # custom ECU specified i-signal group
    SG_KS_Hybrid_01_ReqFrame_XIX_HCP5_CANFD01: i-signal=[KS_Hybrid_01_Req_SID_XIX_KS_Hybrid_01_ReqFrame_XIX_HCP5_CANFD01, KS_Hybrid_01_Req_Prio_XIX_KS_Hybrid_01_ReqFrame_XIX_HCP5_CANFD01, KS_Hybrid_01_Req_VKMS_Err_XIX_KS_Hybrid_01_ReqFrame_XIX_HCP5_CANFD01, KS_Hybrid_01_Req_IKA_Retry_XIX_KS_Hybrid_01_ReqFrame_XIX_HCP5_CANFD01, KS_Hybrid_01_Req_ErrCtr_XIX_KS_Hybrid_01_ReqFrame_XIX_HCP5_CANFD01, KS_Hybrid_01_Req_SWMaj_XIX_KS_Hybrid_01_ReqFrame_XIX_HCP5_CANFD01, KS_Hybrid_01_Req_SWMin_XIX_KS_Hybrid_01_ReqFrame_XIX_HCP5_CANFD01, KS_Hybrid_01_Req_SWPat_XIX_KS_Hybrid_01_ReqFrame_XIX_HCP5_CANFD01], system-signal-group=SG_KS_Hybrid_01_ReqFrame  # custom ECU specified i-signal group
    SG_KS_Hybrid_01_Response_K_XIX_HCP5_CANFD01: i-signal=[KS_Hybrid_01_ReK_SID_XIX_KS_Hybrid_01_Response_K_XIX_HCP5_CANFD01, KS_Hybrid_01_ReK_IKACtr_XIX_KS_Hybrid_01_Response_K_XIX_HCP5_CANFD01, KS_Hybrid_01_ReK_XIX_KS_Hybrid_01_Response_K_XIX_HCP5_CANFD01], system-signal-group=SG_KS_Hybrid_01_Response_K  # custom ECU specified i-signal group
    SG_KS_Hybrid_01_Response_M_XIX_HCP5_CANFD01: i-signal=[KS_Hybrid_01_ReM_SID_XIX_KS_Hybrid_01_Response_M_XIX_HCP5_CANFD01, KS_Hybrid_01_ReM_IKACtr_XIX_KS_Hybrid_01_Response_M_XIX_HCP5_CANFD01, KS_Hybrid_01_ReM_XIX_KS_Hybrid_01_Response_M_XIX_HCP5_CANFD01], system-signal-group=SG_KS_Hybrid_01_Response_M  # custom ECU specified i-signal group
    SG_ORU_Control_A_01_XIX_BMC_CAN01: i-signal=[ORU_Control_A_01_CRC_XIX_ORU_Control_A_01_XIX_BMC_CAN01, ORU_Control_A_01_BZ_XIX_ORU_Control_A_01_XIX_BMC_CAN01, OnlineRemoteUpdateControlA_XIX_ORU_Control_A_01_XIX_BMC_CAN01, OnlineRemoteUpdateControlOldA_XIX_ORU_Control_A_01_XIX_BMC_CAN01, OruVehicleLockRequestA_XIX_ORU_Control_A_01_XIX_BMC_CAN01, OruIntegrityCheckActiveA_XIX_ORU_Control_A_01_XIX_BMC_CAN01, OruControlReleaseA_XIX_ORU_Control_A_01_XIX_BMC_CAN01, OruControlStateA_XIX_ORU_Control_A_01_XIX_BMC_CAN01, OruReleasePartitionSwitchA_XIX_ORU_Control_A_01_XIX_BMC_CAN01, OruHostUpdateA_XIX_ORU_Control_A_01_XIX_BMC_CAN01, ISignalVoid_ORU_Control_A_01_XIX_BMC_CAN01_0, ISignalVoid_ORU_Control_A_01_XIX_BMC_CAN01_1], system-signal-group=SG_ORU_Control_A_01  # Kennungsfolge: K_1449-0x97,0x70,0x84,0xb4,0xb8,0xe7,0x20,0x7c,0x0e,0x40,0x93,0x0d,0x4e,0x05,0x5b,0x95
    SG_ORU_Control_A_01_XIX_HCP5_CANFD01: i-signal=[ORU_Control_A_01_CRC_XIX_ORU_Control_A_01_XIX_HCP5_CANFD01, ORU_Control_A_01_BZ_XIX_ORU_Control_A_01_XIX_HCP5_CANFD01, OnlineRemoteUpdateControlA_XIX_ORU_Control_A_01_XIX_HCP5_CANFD01, OnlineRemoteUpdateControlOldA_XIX_ORU_Control_A_01_XIX_HCP5_CANFD01, OruVehicleLockRequestA_XIX_ORU_Control_A_01_XIX_HCP5_CANFD01, OruIntegrityCheckActiveA_XIX_ORU_Control_A_01_XIX_HCP5_CANFD01, OruControlReleaseA_XIX_ORU_Control_A_01_XIX_HCP5_CANFD01, OruControlStateA_XIX_ORU_Control_A_01_XIX_HCP5_CANFD01, OruReleasePartitionSwitchA_XIX_ORU_Control_A_01_XIX_HCP5_CANFD01, OruHostUpdateA_XIX_ORU_Control_A_01_XIX_HCP5_CANFD01, ISignalVoid_ORU_Control_A_01_XIX_HCP5_CANFD01_0, ISignalVoid_ORU_Control_A_01_XIX_HCP5_CANFD01_1], system-signal-group=SG_ORU_Control_A_01  # Kennungsfolge: K_1449-0x97,0x70,0x84,0xb4,0xb8,0xe7,0x20,0x7c,0x0e,0x40,0x93,0x0d,0x4e,0x05,0x5b,0x95
    SG_ORU_Control_D_01_XIX_BMC_CAN01: i-signal=[ORU_Control_D_01_CRC_XIX_ORU_Control_D_01_XIX_BMC_CAN01, ORU_Control_D_01_BZ_XIX_ORU_Control_D_01_XIX_BMC_CAN01, OnlineRemoteUpdateControlD_XIX_ORU_Control_D_01_XIX_BMC_CAN01, OnlineRemoteUpdateControlOldD_XIX_ORU_Control_D_01_XIX_BMC_CAN01, OruVehicleLockRequestD_XIX_ORU_Control_D_01_XIX_BMC_CAN01, OruIntegrityCheckActiveD_XIX_ORU_Control_D_01_XIX_BMC_CAN01, OruControlReleaseD_XIX_ORU_Control_D_01_XIX_BMC_CAN01, OruControlStateD_XIX_ORU_Control_D_01_XIX_BMC_CAN01, OruReleasePartitionSwitchD_XIX_ORU_Control_D_01_XIX_BMC_CAN01, OruHostUpdateD_XIX_ORU_Control_D_01_XIX_BMC_CAN01, ISignalVoid_ORU_Control_D_01_XIX_BMC_CAN01_0, ISignalVoid_ORU_Control_D_01_XIX_BMC_CAN01_1], system-signal-group=SG_ORU_Control_D_01  # Kennungsfolge: K_1646-0x92,0x1b,0xc6,0x91,0x29,0x5a,0x4e,0xf0,0x6e,0x43,0x80,0x28,0xee,0xa3,0xc8,0x3e
    SG_ORU_Control_D_01_XIX_HCP5_CANFD01: i-signal=[ORU_Control_D_01_CRC_XIX_ORU_Control_D_01_XIX_HCP5_CANFD01, ORU_Control_D_01_BZ_XIX_ORU_Control_D_01_XIX_HCP5_CANFD01, OnlineRemoteUpdateControlD_XIX_ORU_Control_D_01_XIX_HCP5_CANFD01, OnlineRemoteUpdateControlOldD_XIX_ORU_Control_D_01_XIX_HCP5_CANFD01, OruVehicleLockRequestD_XIX_ORU_Control_D_01_XIX_HCP5_CANFD01, OruIntegrityCheckActiveD_XIX_ORU_Control_D_01_XIX_HCP5_CANFD01, OruControlReleaseD_XIX_ORU_Control_D_01_XIX_HCP5_CANFD01, OruControlStateD_XIX_ORU_Control_D_01_XIX_HCP5_CANFD01, OruReleasePartitionSwitchD_XIX_ORU_Control_D_01_XIX_HCP5_CANFD01, OruHostUpdateD_XIX_ORU_Control_D_01_XIX_HCP5_CANFD01, ISignalVoid_ORU_Control_D_01_XIX_HCP5_CANFD01_0, ISignalVoid_ORU_Control_D_01_XIX_HCP5_CANFD01_1], system-signal-group=SG_ORU_Control_D_01  # Kennungsfolge: K_1646-0x92,0x1b,0xc6,0x91,0x29,0x5a,0x4e,0xf0,0x6e,0x43,0x80,0x28,0xee,0xa3,0xc8,0x3e
    SG_OTAMC_D_01_XIX_BMC_CAN01: i-signal=[OTAMC_D_01_CRC_XIX_OTAMC_D_01_XIX_BMC_CAN01, OTAMC_D_01_BZ_XIX_OTAMC_D_01_XIX_BMC_CAN01, VehicleProtectedEnvironment_D_XIX_OTAMC_D_01_XIX_BMC_CAN01, ISignalVoid_OTAMC_D_01_XIX_BMC_CAN01_0, ISignalVoid_OTAMC_D_01_XIX_BMC_CAN01_1, ISignalVoid_OTAMC_D_01_XIX_BMC_CAN01_2], system-signal-group=SG_OTAMC_D_01  # Kennungsfolge: K_309-0x5f,0x18,0xf5,0x71,0x82,0x10,0x93,0x8d,0x4c,0xd7,0x6e,0xaa,0xd6,0xb0,0xb7,0x78
    SG_OTAMC_D_01_XIX_HCP5_CANFD01: i-signal=[OTAMC_D_01_CRC_XIX_OTAMC_D_01_XIX_HCP5_CANFD01, OTAMC_D_01_BZ_XIX_OTAMC_D_01_XIX_HCP5_CANFD01, VehicleProtectedEnvironment_D_XIX_OTAMC_D_01_XIX_HCP5_CANFD01, ISignalVoid_OTAMC_D_01_XIX_HCP5_CANFD01_0, ISignalVoid_OTAMC_D_01_XIX_HCP5_CANFD01_1, ISignalVoid_OTAMC_D_01_XIX_HCP5_CANFD01_2], system-signal-group=SG_OTAMC_D_01  # Kennungsfolge: K_309-0x5f,0x18,0xf5,0x71,0x82,0x10,0x93,0x8d,0x4c,0xd7,0x6e,0xaa,0xd6,0xb0,0xb7,0x78
    SG_UI1_01_XIX_BMC_CAN01: i-signal=[UISensorIso_01_CRC_XIX_UI1_01_XIX_BMC_CAN01, UISensorIso_01_BZ_XIX_UI1_01_XIX_BMC_CAN01, UI1_Strom_XIX_UI1_01_XIX_BMC_CAN01, UI1_KL30_Spannung_XIX_UI1_01_XIX_BMC_CAN01, ISignalVoid_UI1_01_XIX_BMC_CAN01_0, ISignalVoid_UI1_01_XIX_BMC_CAN01_1, ISignalVoid_UI1_01_XIX_BMC_CAN01_2], system-signal-group=SG_UI1_01  # Kennungsfolge: K_1509-0xc0,0xc7,0x38,0x03,0x0b,0x96,0xca,0x93,0x35,0x39,0x81,0xb2,0x02,0xa3,0xed,0x65
    SG_UI1_02_XIX_BMC_CAN01: i-signal=[UISensorIso_02_CRC_XIX_UI1_02_XIX_BMC_CAN01, UISensorIso_02_BZ_XIX_UI1_02_XIX_BMC_CAN01, UI1_Spannung1_XIX_UI1_02_XIX_BMC_CAN01, UI1_Spannung2_XIX_UI1_02_XIX_BMC_CAN01, UI1_Spannung3_XIX_UI1_02_XIX_BMC_CAN01, UI1_Spannung1_Schalt_Status_XIX_UI1_02_XIX_BMC_CAN01, UI1_Spannung2_Schalt_Status_XIX_UI1_02_XIX_BMC_CAN01, ISignalVoid_UI1_02_XIX_BMC_CAN01_0], system-signal-group=SG_UI1_02  # Kennungsfolge: K_1516-0x13,0xd2,0xb5,0x5c,0xc2,0x16,0x5b,0x56,0x91,0xe1,0x53,0x55,0xcf,0x3e,0xd3,0x5d
    SG_UI2_01_XIX_BMC_CAN01: i-signal=[UISensorPyro_01_CRC_XIX_UI2_01_XIX_BMC_CAN01, UISensorPyro_01_BZ_XIX_UI2_01_XIX_BMC_CAN01, UI2_Strom_XIX_UI2_01_XIX_BMC_CAN01, UI2_KL30_Spannung_XIX_UI2_01_XIX_BMC_CAN01, ISignalVoid_UI2_01_XIX_BMC_CAN01_0, ISignalVoid_UI2_01_XIX_BMC_CAN01_1, ISignalVoid_UI2_01_XIX_BMC_CAN01_2], system-signal-group=SG_UI2_01  # Kennungsfolge: K_1530-0x25,0x0d,0x57,0x89,0xb5,0xc3,0x8b,0x67,0xac,0x01,0x6a,0x0b,0x90,0x92,0xc1,0x4c
    SG_UI2_02_XIX_BMC_CAN01: i-signal=[UISensorPyro_02_CRC_XIX_UI2_02_XIX_BMC_CAN01, UISensorPyro_02_BZ_XIX_UI2_02_XIX_BMC_CAN01, UI2_Spannung1_XIX_UI2_02_XIX_BMC_CAN01, UI2_Spannung2_XIX_UI2_02_XIX_BMC_CAN01, UI2_Spannung3_XIX_UI2_02_XIX_BMC_CAN01, UI2_Spannung1_Schalt_Status_XIX_UI2_02_XIX_BMC_CAN01, UI2_Spannung2_Schalt_Status_XIX_UI2_02_XIX_BMC_CAN01, ISignalVoid_UI2_02_XIX_BMC_CAN01_0], system-signal-group=SG_UI2_02  # Kennungsfolge: K_1524-0x4e,0xa3,0x1f,0x0f,0x13,0x72,0xd0,0xda,0x3c,0x33,0xe8,0x11,0x45,0xbd,0x7e,0x4b
    SG_UI2_03_XIX_BMC_CAN01: i-signal=[UISensorPyro_03_CRC_XIX_UI2_03_XIX_BMC_CAN01, UISensorPyro_03_BZ_XIX_UI2_03_XIX_BMC_CAN01, UI2_Spannung4_XIX_UI2_03_XIX_BMC_CAN01, UI2_Spannung5_XIX_UI2_03_XIX_BMC_CAN01, UI2_Spannung6_XIX_UI2_03_XIX_BMC_CAN01, UI2_HW_Crashleitung_Status_XIX_UI2_03_XIX_BMC_CAN01, UI2_Pyro_Status_XIX_UI2_03_XIX_BMC_CAN01, ISignalVoid_UI2_03_XIX_BMC_CAN01_0], system-signal-group=SG_UI2_03  # Kennungsfolge: K_1517-0x5e,0xed,0x2e,0x2d,0xde,0x98,0x8b,0x8a,0x7f,0x0e,0xef,0xf5,0x9d,0x74,0xa7,0x87
package /Signal
  11 x system signal:
    ISO_ALL_01_Req_Data  # Funktionaler Request ALL
    SignalVoid_Airbag_10_{0..2}
    SignalVoid_WFS_02_{0..6}
  26 x system signal group:
    SG_BJB_10: system-signal=[BJB_Lebensdauer_Trennelemente, BJB_Sperrung_Unterspannung, BJB_Status_Trennelemente, BJB_Status_HV_Spannungssensorik, BJB_10_CRC, BJB_10_BZ, SignalVoid_BJB_10_0, SignalVoid_BJB_10_1, SignalVoid_BJB_10_2, SignalVoid_BJB_10_3]  # Signal Group
    SG_BJB_11: system-signal=[BJB_Uebertemperaturzaehler_CMC02, BJB_Ueberspannungszaehler_CMC01, BJB_Sperrung_Ueberspannung, BJB_Ueberspannungszaehler_CMC02, BJB_Uebertemperaturzaehler_CMC01, BJB_11_CRC, BJB_11_BZ]  # Signal Group
    SG_BJB_12: system-signal=[BJB_Ueberspannungszaehler_CMC04, BJB_Uebertemperaturzaehler_CMC03, BJB_Ueberspannungszaehler_CMC03, BJB_Sperrung_Uebertemperatur, BJB_Uebertemperaturzaehler_CMC04, BJB_12_CRC, BJB_12_BZ]  # Signal Group
    SG_BJB_13: system-signal=[BJB_Unterspannungszaehler_CMC03, BJB_Unterspannungszaehler_CMC01, BJB_Unterspannungszaehler_CMC02, BJB_Unterspannungszaehler_CMC04, BJB_13_CRC, BJB_13_BZ, SignalVoid_BJB_13_0, SignalVoid_BJB_13_1]  # Signal Group
    SG_BMC_HV_01: system-signal=[BMC_Bankstatus, BMC_Spannung, BMC_Modus, BMC_HVK_Fehler_SD, BMC_HVK_Fehler_HVIL, BMC_HVK_Fehler_Intern, BMC_HVK_EoHVL_Status, BMC_Status_Spgfreiheit, BMC_Spannung_ZwischenKreis, BMC_Strom, BMC_Spannung_ZwischenKreis_2, BMC_HV_01_BZ, BMC_HV_01_CRC, BMC_Strom_Messzeit, BMC_Spannung_Messzeit, BMC_Strom_02, SignalVoid_BMC_HV_01_0]  # Signal Group
    SG_BMC_HV_02: system-signal=[BMC_Bank_seriell_erlaubt, BMC_Bank_parallel_erlaubt, BMC_Bank_Notlauf_erlaubt, BMC_Vorlade_Zielspannung, BMC_IWU_Status, BMC_Max_Entladeleistung, BMC_Energieinhalt, BMC_PerfInd_Laden, BMC_Max_Ladeleistung, BMC_NutzbarerSOC, BMC_PerfInd_Entladen, BMC_Max_Ladestrom, BMC_Status_DCLS, BMC_Spannung_DC_Ladesaeule, BMC_Max_Entladestrom, BMC_IWU_Wert_pos, BMC_IWU_Wert_neg, BMC_AC_Laden, BMC_DC_Laden, BMC_Verbauinfo_ACSchuetz, Hybrid_01_OBD_Lampe_Anf, Anzeige_SOC, BMC_Fehler_Leistungsred, BMC_Verbauinfo_Bank, BMC_Unterboden_Warnung, BMC_MinDyn_Entladespannung, BMC_HV_02_BZ, BMC_MinDyn_Ladespannung, BMC_Leerlaufspannung, BMC_PredLeistung_StuetzungNV, BMC_IstZellspannungMin, BMC_IstZellspannungMax, BMC_HV_02_CRC, BMC_TechnischerSOC, BMC_Fehler_Warnung, BMC_Energie_Sockel_SoC, BMC_MMTR_Status, BMC_ZellTemp_virtuell_min, BMC_ZellTemp_virtuell_max, SignalVoid_BMC_HV_02_0, SignalVoid_BMC_HV_02_1, SignalVoid_BMC_HV_02_2, SignalVoid_BMC_HV_02_3, SignalVoid_BMC_HV_02_4, SignalVoid_BMC_HV_02_5]  # Signal Group
    SG_BMC_HV_04: system-signal=[BMC_Flash_Freigabe, BMC_Dev_Freigabe, BMC_UI1_Spannung1_Schalt_Anf, BMC_Iso_Mode_Anf, BMC_UI1_Spannung2_Schalt_Anf, BMC_UI2_Spannung2_Schalt_Anf, BMC_UI2_Spannung1_Schalt_Anf, BMC_HV_04_CRC, BMC_HV_04_BZ, SignalVoid_BMC_HV_04_0, SignalVoid_BMC_HV_04_1, SignalVoid_BMC_HV_04_2, SignalVoid_BMC_HV_04_3, SignalVoid_BMC_HV_04_4, SignalVoid_BMC_HV_04_5]  # Signal Group
    SG_BMC_HV_10: system-signal=[BMC_Datenuebernahme_Anf, BMC_Lebensdauer_Trennelemente, BMC_Status_Trennelemente, BMC_Sperrung_Unterspannung, BMC_Status_HV_Spannungssensorik, BMC_HV_10_CRC, BMC_HV_10_BZ, SignalVoid_BMC_HV_10_0, SignalVoid_BMC_HV_10_1, SignalVoid_BMC_HV_10_2, SignalVoid_BMC_HV_10_3]  # Signal Group
    SG_BMC_HV_11: system-signal=[BMC_Ueberspannungszaehler_CMC02, BMC_Sperrung_Ueberspannung, BMC_Ueberspannungszaehler_CMC01, BMC_Uebertemperaturzaehler_CMC01, BMC_Uebertemperaturzaehler_CMC02, BMC_HV_11_BZ, BMC_HV_11_CRC]  # Signal Group
    SG_BMC_HV_12: system-signal=[BMC_Sperrung_Uebertemperatur, BMC_Ueberspannungszaehler_CMC04, BMC_Ueberspannungszaehler_CMC03, BMC_Uebertemperaturzaehler_CMC03, BMC_Uebertemperaturzaehler_CMC04, BMC_HV_12_BZ, BMC_HV_12_CRC]  # Signal Group
    SG_BMC_HV_13: system-signal=[BMC_Unterspannungszaehler_CMC01, BMC_Unterspannungszaehler_CMC02, BMC_Unterspannungszaehler_CMC03, BMC_Unterspannungszaehler_CMC04, BMC_HV_13_BZ, BMC_HV_13_CRC, SignalVoid_BMC_HV_13_0, SignalVoid_BMC_HV_13_1]  # Signal Group
    SG_HVK_03: system-signal=[HVK_EKK_Sollmodus, HVK_DCDC_Sollmodus, HVK_HVLM_Sollmodus, HV_Bordnetz_aktiv, HVK_HV_Netz_Warnungen, HV_Bordnetz_Fehler, HVK_Gesamtst_Spgfreiheit, HVK_AktiveEntladung_Anf, HVK_Istmodus_Anf, HVK_Iso_Messung_Start, HVK_Vorladung_aktiv, HVK_ETM_Freigabe, HVK_HV_Netz_Zustand, HVK_HVHL_Sollmodus, HVK_BMC_Sollmodus, HVK_HVHW_Sollmodus, HVK_BMC_Spannung_Anf, HVK_AIAD_Sollmodus, HVK_eKAT_Sollmodus, HVK_03_BZ, HVK_03_CRC, SignalVoid_HVK_03_0, SignalVoid_HVK_03_1]  # Signal Group
    SG_HVLM_14: system-signal=[HVLM_ZustandLadeablauf, HVLM_Ladevorgang_Anf, HVLM_Ladeszenario, HVLM_Laden_ISO_Messung_Anf, HVLM_DC_Aufstartmodus, HVLM_Start_Pulserkennung, HVLM_WakeUpZaehlerResetAnf, HVLM_Aktive_Ladeart, HVLM_Steckerstatus, HVLM_Pulsierstufe, HVLM_Intensitaet_Lk1, HVLM_Intensitaet_Lk2, HVLM_14_BZ, HVLM_14_CRC, HVLM_Ladeniveau_Anf, HVLM_Ladenaktiv_Standzyklus, HVLM_PrkCtl_StPrkLockReq, HVLM_PrkCtl_StAlyReq, HVLM_Grundladen_Anf, SignalVoid_HVLM_14_0, SignalVoid_HVLM_14_1]  # Signal Group
    SG_KS_Hybrid_01_Challenge_K: system-signal=[KS_Hybrid_01_ChK_SID, KS_Hybrid_01_ChK_IKACtr, KS_Hybrid_01_ChK]  # custom ECU specified signal group
    SG_KS_Hybrid_01_Challenge_M: system-signal=[KS_Hybrid_01_ChM_SID, KS_Hybrid_01_ChM_IKACtr, KS_Hybrid_01_ChM]  # custom ECU specified signal group
    SG_KS_Hybrid_01_ReqFrame: system-signal=[KS_Hybrid_01_Req_SID, KS_Hybrid_01_Req_Prio, KS_Hybrid_01_Req_VKMS_Err, KS_Hybrid_01_Req_IKA_Retry, KS_Hybrid_01_Req_ErrCtr, KS_Hybrid_01_Req_SWMaj, KS_Hybrid_01_Req_SWMin, KS_Hybrid_01_Req_SWPat]  # custom ECU specified signal group
    SG_KS_Hybrid_01_Response_K: system-signal=[KS_Hybrid_01_ReK_SID, KS_Hybrid_01_ReK_IKACtr, KS_Hybrid_01_ReK]  # custom ECU specified signal group
    SG_KS_Hybrid_01_Response_M: system-signal=[KS_Hybrid_01_ReM_SID, KS_Hybrid_01_ReM_IKACtr, KS_Hybrid_01_ReM]  # custom ECU specified signal group
    SG_ORU_Control_A_01: system-signal=[OruVehicleLockRequestA, OruReleasePartitionSwitchA, OruIntegrityCheckActiveA, OruHostUpdateA, OruControlReleaseA, ORU_Control_A_01_CRC, ORU_Control_A_01_BZ, OnlineRemoteUpdateControlA, OnlineRemoteUpdateControlOldA, OruControlStateA, SignalVoid_ORU_Control_A_01_0, SignalVoid_ORU_Control_A_01_1]  # Signal Group
    SG_ORU_Control_D_01: system-signal=[OruControlReleaseD, OruVehicleLockRequestD, OruReleasePartitionSwitchD, OruHostUpdateD, OruIntegrityCheckActiveD, OnlineRemoteUpdateControlOldD, OnlineRemoteUpdateControlD, ORU_Control_D_01_BZ, ORU_Control_D_01_CRC, OruControlStateD, SignalVoid_ORU_Control_D_01_0, SignalVoid_ORU_Control_D_01_1]  # Signal Group
    SG_OTAMC_D_01: system-signal=[VehicleProtectedEnvironment_D, OTAMC_D_01_CRC, OTAMC_D_01_BZ, SignalVoid_OTAMC_D_01_0, SignalVoid_OTAMC_D_01_1, SignalVoid_OTAMC_D_01_2]  # Signal Group
    SG_UI1_01: system-signal=[UI1_Strom, UI1_KL30_Spannung, UISensorIso_01_BZ, UISensorIso_01_CRC, SignalVoid_UI1_01_0, SignalVoid_UI1_01_1, SignalVoid_UI1_01_2]  # Signal Group
    SG_UI1_02: system-signal=[UI1_Spannung3, UI1_Spannung2_Schalt_Status, UI1_Spannung1, UI1_Spannung2, UI1_Spannung1_Schalt_Status, UISensorIso_02_BZ, UISensorIso_02_CRC, SignalVoid_UI1_02_0]  # Signal Group
    SG_UI2_01: system-signal=[UI2_Strom, UI2_KL30_Spannung, UISensorPyro_01_BZ, UISensorPyro_01_CRC, SignalVoid_UI2_01_0, SignalVoid_UI2_01_1, SignalVoid_UI2_01_2]  # Signal Group
    SG_UI2_02: system-signal=[UI2_Spannung2_Schalt_Status, UI2_Spannung2, UI2_Spannung3, UI2_Spannung1, UI2_Spannung1_Schalt_Status, UISensorPyro_02_BZ, UISensorPyro_02_CRC, SignalVoid_UI2_02_0]  # Signal Group
    SG_UI2_03: system-signal=[UI2_Spannung6, UI2_Spannung5, UI2_Spannung4, UISensorPyro_03_BZ, UISensorPyro_03_CRC, UI2_HW_Crashleitung_Status, UI2_Pyro_Status, SignalVoid_UI2_03_0]  # Signal Group
package /TPConfig
  can tp config CanTPConfig_HCP5_CANFD01: communication-cluster=HCP5_CANFD01, can-tp-ecu=BMC_HV
    65 x can tp address:
      TA_0x17FC007B: tp-address=402391163
      TA_0x17FC008F: tp-address=402391183
      TA_0x17FC009C: tp-address=402391196
      TA_0x17FC00AE: tp-address=402391214
      TA_0x17FC00B4: tp-address=402391220
      TA_0x17FC00B9: tp-address=402391225
      TA_0x17FC16D0: tp-address=402396880
      TA_0x17FC17B1: tp-address=402397105
      TA_0x17FC17B2: tp-address=402397106
      TA_0x17FC70D0: tp-address=402419920
      TA_0x17FC71B1: tp-address=402420145
      TA_0x17FC71B2: tp-address=402420146
      TA_0x17FE007B: tp-address=402522235
      TA_0x17FE008F: tp-address=402522255
      TA_0x17FE009C: tp-address=402522268
      TA_0x17FE00AE: tp-address=402522286
      TA_0x17FE00B4: tp-address=402522292
      TA_0x17FE00B9: tp-address=402522297
      TA_0x17FE16D0: tp-address=402527952
      TA_0x17FE17B1: tp-address=402528177
      TA_0x17FE17B2: tp-address=402528178
      TA_0x17FE70D0: tp-address=402550992
      TA_0x17FE71B1: tp-address=402551217
      TA_0x17FE71B2: tp-address=402551218
      TA_0x1804000E: tp-address=402915342
      TA_0x18040015: tp-address=402915349
      TA_0x1804001B: tp-address=402915355
      TA_0x1804001C: tp-address=402915356
      TA_0x1804001D: tp-address=402915357
      TA_0x18040021: tp-address=402915361
      TA_0x1806000E: tp-address=403046414
      TA_0x18060015: tp-address=403046421
      TA_0x1806001B: tp-address=403046427
      TA_0x1806001C: tp-address=403046428
      TA_0x1806001D: tp-address=403046429
      TA_0x18060021: tp-address=403046433
      TA_0x18DA05F1: tp-address=416941553
      TA_0x18DAF105: tp-address=417001733
      TA_0x18DB33F1: tp-address=417018865
      TA_0x1C40007B: tp-address=473956475
      TA_0x1C40027B: tp-address=473956987
      TA_0x1C403F7B: tp-address=473972603
      TA_0x1C410000: tp-address=474021888
      TA_0x1C410200: tp-address=474022400
      TA_0x1C413FDD: tp-address=474038237
      TA_0x1C420044: tp-address=474087492
      TA_0x1C42007B: tp-address=474087547
      TA_0x1C42008F: tp-address=474087567
      TA_0x1C4200B9: tp-address=474087609
      TA_0x1C420244: tp-address=474088004
      TA_0x1C42027B: tp-address=474088059
      TA_0x1C42028F: tp-address=474088079
      TA_0x1C4202B9: tp-address=474088121
      TA_0x1C423F7B: tp-address=474103675
      TA_0x1C46001B: tp-address=474349595
      TA_0x1C46001C: tp-address=474349596
      TA_0x1C46001D: tp-address=474349597
      TA_0x1C46021B: tp-address=474350107
      TA_0x1C46021C: tp-address=474350108
      TA_0x1C46021D: tp-address=474350109
      TA_0x700: tp-address=1792
      TA_0x741: tp-address=1857
      TA_0x744: tp-address=1860
      TA_0x7AB: tp-address=1963
      TA_0x7AE: tp-address=1966
    16 x can tp channel, all with channel-mode=HALF-DUPLEX-MODE:
      TPC_HCP5_CANFD01_XIX_TPCHType_CANFD_DAAP_XIX_0x1C403F7B_XIX_0x1C423F7B_XIX_Physical: channel-id=1453778822
      TPC_HCP5_CANFD01_XIX_TPCHType_CANFD_DAAP_XIX_0x1C413FDD_XIX_Functional: channel-id=1824849867
      TPC_HCP5_CANFD01_XIX_TPCHType_CANFD_ISO_Diagnose_XIX_0x1C40007B_XIX_0x1C42007B_XIX_Physical: channel-id=649008242
      TPC_HCP5_CANFD01_XIX_TPCHType_CANFD_ISO_Diagnose_XIX_0x1C410000_XIX_Functional: channel-id=435765654
      TPC_HCP5_CANFD01_XIX_TPCHType_CANFD_OBDC_Diagnose_XIX_0x1C40027B_XIX_0x1C42027B_XIX_Physical: channel-id=1971298631
      TPC_HCP5_CANFD01_XIX_TPCHType_CANFD_OBDC_Diagnose_XIX_0x1C410200_XIX_Functional: channel-id=166078607
      TPC_HCP5_CANFD01_XIX_TPCHType_CANHS_Flash_DIA_XIX_0x17FC16D0_XIX_0x17FE16D0_XIX_Physical: channel-id=1611926648
      TPC_HCP5_CANFD01_XIX_TPCHType_CANHS_Flash_DIA_XIX_0x17FC17B1_XIX_0x17FE17B1_XIX_Physical: channel-id=1398000392
      TPC_HCP5_CANFD01_XIX_TPCHType_CANHS_Flash_DIA_XIX_0x17FC17B2_XIX_0x17FE17B2_XIX_Physical: channel-id=1210457320
      TPC_HCP5_CANFD01_XIX_TPCHType_CANHS_ISO_Diagnose_XIX_0x17FC007B_XIX_0x17FE007B_XIX_Physical: channel-id=690355579
      TPC_HCP5_CANFD01_XIX_TPCHType_CANHS_ISO_Diagnose_XIX_0x700_XIX_Functional: channel-id=1708026577
      TPC_HCP5_CANFD01_XIX_TPCHType_CANHS_OBDC_SSN_Diagnose_XIX_0x17FC70D0_XIX_0x17FE70D0_XIX_Physical: channel-id=789475177
      TPC_HCP5_CANFD01_XIX_TPCHType_CANHS_OBDC_SSN_Diagnose_XIX_0x17FC71B1_XIX_0x17FE71B1_XIX_Physical: channel-id=2074515433
      TPC_HCP5_CANFD01_XIX_TPCHType_CANHS_OBDC_SSN_Diagnose_XIX_0x17FC71B2_XIX_0x17FE71B2_XIX_Physical: channel-id=2032908791
      TPC_HCP5_CANFD01_XIX_TPCHType_CANHS_OBDx_XIX_0x18DA05F1_XIX_0x18DAF105_XIX_Physical: channel-id=1683031602
      TPC_HCP5_CANFD01_XIX_TPCHType_CANHS_OBDx_XIX_0x18DB33F1_XIX_Functional: channel-id=254423851
    can-tp-connection addressing-format=STANDARD, can-tp-channel=TPC_HCP5_CANFD01_XIX_TPCHType_CANFD_DAAP_XIX_0x1C403F7B_XIX_0x1C423F7B_XIX_Physical, cancellation=true, data-pdu=DAAP_Hybrid_01_Req_FD_XIX_HCP5_CANFD01, flow-control-pdu=DAAP_Hybrid_01_Resp_FD_XIX_HCP5_CANFD01, max-block-size=15, padding-activation=true, receiver=TPN_Hybrid_01_XIX_HCP5_CANFD01_XIX_474103675, ta-type=PHYSICAL, timeout-br=0.1, timeout-bs=1, timeout-cr=1, timeout-cs=0.2, tp-sdu=CDD_HCP5_CANFD01_XIX_TPCHType_CANFD_DAAP_XIX_0x1C403F7B_XIX_0x1C423F7B_XIX_Physical, transmitter=TPN_Gateway_XIX_HCP5_CANFD01_XIX_473972603:
      ident TPCN_HCP5_CANFD01_XIX_TPCHType_CANFD_DAAP_XIX_0x1C403F7B_Gateway_XIX_0x1C423F7B_Hybrid_01_XIX_Physical
    can-tp-connection addressing-format=STANDARD, can-tp-channel=TPC_HCP5_CANFD01_XIX_TPCHType_CANFD_DAAP_XIX_0x1C413FDD_XIX_Functional, cancellation=true, data-pdu=DAAP_Funkt_Req_MC_FD_XIX_HCP5_CANFD01, max-block-size=15, multicast=TA_0x1C413FDD, padding-activation=true, receiver=TPN_Hybrid_01_XIX_HCP5_CANFD01_XIX_474103675, ta-type=FUNCTIONAL, timeout-br=0.1, timeout-bs=1, timeout-cr=1, timeout-cs=0.2, tp-sdu=CDD_HCP5_CANFD01_XIX_TPCHType_CANFD_DAAP_XIX_0x1C413FDD_XIX_Functional, transmitter=TPN_Gateway_XIX_HCP5_CANFD01_XIX_473972603:
      ident TPCN_HCP5_CANFD01_XIX_TPCHType_CANFD_DAAP_XIX_0x1C413FDD_Gateway_XIX_Functional
    can-tp-connection addressing-format=STANDARD, can-tp-channel=TPC_HCP5_CANFD01_XIX_TPCHType_CANFD_DAAP_XIX_0x1C403F7B_XIX_0x1C423F7B_XIX_Physical, cancellation=true, data-pdu=DAAP_Hybrid_01_Resp_FD_XIX_HCP5_CANFD01, flow-control-pdu=DAAP_Hybrid_01_Req_FD_XIX_HCP5_CANFD01, max-block-size=15, padding-activation=true, receiver=TPN_Gateway_XIX_HCP5_CANFD01_XIX_473972603, ta-type=PHYSICAL, timeout-br=0.1, timeout-bs=1, timeout-cr=1, timeout-cs=0.2, tp-sdu=CDD_HCP5_CANFD01_XIX_TPCHType_CANFD_DAAP_XIX_0x1C423F7B_XIX_0x1C403F7B_XIX_Physical, transmitter=TPN_Hybrid_01_XIX_HCP5_CANFD01_XIX_474103675:
      ident TPCN_HCP5_CANFD01_XIX_TPCHType_CANFD_DAAP_XIX_0x1C423F7B_Hybrid_01_XIX_0x1C403F7B_Gateway_XIX_Physical
    can-tp-connection addressing-format=STANDARD, can-tp-channel=TPC_HCP5_CANFD01_XIX_TPCHType_CANFD_ISO_Diagnose_XIX_0x1C40007B_XIX_0x1C42007B_XIX_Physical, cancellation=true, data-pdu=ISOx_Hybrid_01_Req_FD_XIX_HCP5_CANFD01, flow-control-pdu=ISOx_Hybrid_01_Resp_FD_XIX_HCP5_CANFD01, max-block-size=15, padding-activation=true, receiver=TPN_Hybrid_01_XIX_HCP5_CANFD01_XIX_474087547, ta-type=PHYSICAL, timeout-br=0.1, timeout-bs=1, timeout-cr=1, timeout-cs=0.2, tp-sdu=DCM_HCP5_CANFD01_XIX_TPCHType_CANFD_ISO_Diagnose_XIX_0x1C40007B_XIX_0x1C42007B_XIX_Physical, transmitter=TPN_Gateway_XIX_HCP5_CANFD01_XIX_473956475:
      ident TPCN_HCP5_CANFD01_XIX_TPCHType_CANFD_ISO_Diagnose_XIX_0x1C40007B_Gateway_XIX_0x1C42007B_Hybrid_01_XIX_Physical
    can-tp-connection addressing-format=STANDARD, can-tp-channel=TPC_HCP5_CANFD01_XIX_TPCHType_CANFD_ISO_Diagnose_XIX_0x1C410000_XIX_Functional, cancellation=true, data-pdu=ISOx_Funkt_Req_All_FD_XIX_HCP5_CANFD01, max-block-size=15, multicast=TA_0x1C410000, padding-activation=true, receiver=[TPN_AWC_XIX_HCP5_CANFD01_XIX_474087492, TPN_AWC_XIX_HCP5_CANFD01_XIX_474087547, TPN_AWC_XIX_HCP5_CANFD01_XIX_474087567, TPN_AWC_XIX_HCP5_CANFD01_XIX_474087609, TPN_AWC_XIX_HCP5_CANFD01_XIX_474349595, TPN_AWC_XIX_HCP5_CANFD01_XIX_474349596, TPN_AWC_XIX_HCP5_CANFD01_XIX_474349597, TPN_Hybrid_01_XIX_HCP5_CANFD01_XIX_474087492, TPN_Hybrid_01_XIX_HCP5_CANFD01_XIX_474087547, TPN_Hybrid_01_XIX_HCP5_CANFD01_XIX_474087567, TPN_Hybrid_01_XIX_HCP5_CANFD01_XIX_474087609, TPN_Hybrid_01_XIX_HCP5_CANFD01_XIX_474349595, TPN_Hybrid_01_XIX_HCP5_CANFD01_XIX_474349596, TPN_Hybrid_01_XIX_HCP5_CANFD01_XIX_474349597, TPN_DCDC_NV_XIX_HCP5_CANFD01_XIX_474087492, TPN_DCDC_NV_XIX_HCP5_CANFD01_XIX_474087547, TPN_DCDC_NV_XIX_HCP5_CANFD01_XIX_474087567, TPN_DCDC_NV_XIX_HCP5_CANFD01_XIX_474087609, TPN_DCDC_NV_XIX_HCP5_CANFD01_XIX_474349595, TPN_DCDC_NV_XIX_HCP5_CANFD01_XIX_474349596, TPN_DCDC_NV_XIX_HCP5_CANFD01_XIX_474349597, TPN_HVZB_XIX_HCP5_CANFD01_XIX_474087492, TPN_HVZB_XIX_HCP5_CANFD01_XIX_474087547, TPN_HVZB_XIX_HCP5_CANFD01_XIX_474087567, TPN_HVZB_XIX_HCP5_CANFD01_XIX_474087609, TPN_HVZB_XIX_HCP5_CANFD01_XIX_474349595, TPN_HVZB_XIX_HCP5_CANFD01_XIX_474349596, TPN_HVZB_XIX_HCP5_CANFD01_XIX_474349597, TPN_SACID_1_XIX_HCP5_CANFD01_XIX_474087492, TPN_SACID_1_XIX_HCP5_CANFD01_XIX_474087547, TPN_SACID_1_XIX_HCP5_CANFD01_XIX_474087567, TPN_SACID_1_XIX_HCP5_CANFD01_XIX_474087609, TPN_SACID_1_XIX_HCP5_CANFD01_XIX_474349595, TPN_SACID_1_XIX_HCP5_CANFD01_XIX_474349596, TPN_SACID_1_XIX_HCP5_CANFD01_XIX_474349597, TPN_SACID_2_XIX_HCP5_CANFD01_XIX_474087492, TPN_SACID_2_XIX_HCP5_CANFD01_XIX_474087547, TPN_SACID_2_XIX_HCP5_CANFD01_XIX_474087567, TPN_SACID_2_XIX_HCP5_CANFD01_XIX_474087609, TPN_SACID_2_XIX_HCP5_CANFD01_XIX_474349595, TPN_SACID_2_XIX_HCP5_CANFD01_XIX_474349596, TPN_SACID_2_XIX_HCP5_CANFD01_XIX_474349597, TPN_Ladegeraet_XIX_HCP5_CANFD01_XIX_474087492, TPN_Ladegeraet_XIX_HCP5_CANFD01_XIX_474087547, TPN_Ladegeraet_XIX_HCP5_CANFD01_XIX_474087567, TPN_Ladegeraet_XIX_HCP5_CANFD01_XIX_474087609, TPN_Ladegeraet_XIX_HCP5_CANFD01_XIX_474349595, TPN_Ladegeraet_XIX_HCP5_CANFD01_XIX_474349596, TPN_Ladegeraet_XIX_HCP5_CANFD01_XIX_474349597], ta-type=FUNCTIONAL, timeout-br=0.1, timeout-bs=1, timeout-cr=1, timeout-cs=0.2, tp-sdu=DCM_HCP5_CANFD01_XIX_TPCHType_CANFD_ISO_Diagnose_XIX_0x1C410000_XIX_Functional, transmitter=TPN_Gateway_XIX_HCP5_CANFD01_XIX_474021888:
      ident TPCN_HCP5_CANFD01_XIX_TPCHType_CANFD_ISO_Diagnose_XIX_0x1C410000_Gateway_XIX_Functional
    can-tp-connection addressing-format=STANDARD, can-tp-channel=TPC_HCP5_CANFD01_XIX_TPCHType_CANFD_ISO_Diagnose_XIX_0x1C40007B_XIX_0x1C42007B_XIX_Physical, cancellation=true, data-pdu=ISOx_Hybrid_01_Resp_FD_XIX_HCP5_CANFD01, flow-control-pdu=ISOx_Hybrid_01_Req_FD_XIX_HCP5_CANFD01, max-block-size=15, padding-activation=true, receiver=TPN_Gateway_XIX_HCP5_CANFD01_XIX_473956475, ta-type=PHYSICAL, timeout-br=0.1, timeout-bs=1, timeout-cr=1, timeout-cs=0.2, tp-sdu=DCM_HCP5_CANFD01_XIX_TPCHType_CANFD_ISO_Diagnose_XIX_0x1C42007B_XIX_0x1C40007B_XIX_Physical, transmitter=TPN_Hybrid_01_XIX_HCP5_CANFD01_XIX_474087547:
      ident TPCN_HCP5_CANFD01_XIX_TPCHType_CANFD_ISO_Diagnose_XIX_0x1C42007B_Hybrid_01_XIX_0x1C40007B_Gateway_XIX_Physical
    can-tp-connection addressing-format=STANDARD, can-tp-channel=TPC_HCP5_CANFD01_XIX_TPCHType_CANFD_OBDC_Diagnose_XIX_0x1C40027B_XIX_0x1C42027B_XIX_Physical, cancellation=true, data-pdu=OBDC_Hybrid_01_Req_FD_XIX_HCP5_CANFD01, flow-control-pdu=OBDC_Hybrid_01_Resp_FD_XIX_HCP5_CANFD01, max-block-size=15, padding-activation=true, receiver=TPN_Hybrid_01_XIX_HCP5_CANFD01_XIX_474088059, ta-type=PHYSICAL, timeout-br=0.1, timeout-bs=1, timeout-cr=1, timeout-cs=0.2, tp-sdu=DCM_HCP5_CANFD01_XIX_TPCHType_CANFD_OBDC_Diagnose_XIX_0x1C40027B_XIX_0x1C42027B_XIX_Physical, transmitter=TPN_Gateway_XIX_HCP5_CANFD01_XIX_473956987:
      ident TPCN_HCP5_CANFD01_XIX_TPCHType_CANFD_OBDC_Diagnose_XIX_0x1C40027B_Gateway_XIX_0x1C42027B_Hybrid_01_XIX_Physical
    can-tp-connection addressing-format=STANDARD, can-tp-channel=TPC_HCP5_CANFD01_XIX_TPCHType_CANFD_OBDC_Diagnose_XIX_0x1C410200_XIX_Functional, cancellation=true, data-pdu=OBDC_Funktionaler_Req_All_FD_XIX_HCP5_CANFD01, max-block-size=15, multicast=TA_0x1C410200, padding-activation=true, receiver=[TPN_AWC_XIX_HCP5_CANFD01_XIX_474088004, TPN_AWC_XIX_HCP5_CANFD01_XIX_474088059, TPN_AWC_XIX_HCP5_CANFD01_XIX_474088079, TPN_AWC_XIX_HCP5_CANFD01_XIX_474088121, TPN_AWC_XIX_HCP5_CANFD01_XIX_474350107, TPN_AWC_XIX_HCP5_CANFD01_XIX_474350108, TPN_AWC_XIX_HCP5_CANFD01_XIX_474350109, TPN_Hybrid_01_XIX_HCP5_CANFD01_XIX_474088004, TPN_Hybrid_01_XIX_HCP5_CANFD01_XIX_474088059, TPN_Hybrid_01_XIX_HCP5_CANFD01_XIX_474088079, TPN_Hybrid_01_XIX_HCP5_CANFD01_XIX_474088121, TPN_Hybrid_01_XIX_HCP5_CANFD01_XIX_474350107, TPN_Hybrid_01_XIX_HCP5_CANFD01_XIX_474350108, TPN_Hybrid_01_XIX_HCP5_CANFD01_XIX_474350109, TPN_DCDC_NV_XIX_HCP5_CANFD01_XIX_474088004, TPN_DCDC_NV_XIX_HCP5_CANFD01_XIX_474088059, TPN_DCDC_NV_XIX_HCP5_CANFD01_XIX_474088079, TPN_DCDC_NV_XIX_HCP5_CANFD01_XIX_474088121, TPN_DCDC_NV_XIX_HCP5_CANFD01_XIX_474350107, TPN_DCDC_NV_XIX_HCP5_CANFD01_XIX_474350108, TPN_DCDC_NV_XIX_HCP5_CANFD01_XIX_474350109, TPN_HVZB_XIX_HCP5_CANFD01_XIX_474088004, TPN_HVZB_XIX_HCP5_CANFD01_XIX_474088059, TPN_HVZB_XIX_HCP5_CANFD01_XIX_474088079, TPN_HVZB_XIX_HCP5_CANFD01_XIX_474088121, TPN_HVZB_XIX_HCP5_CANFD01_XIX_474350107, TPN_HVZB_XIX_HCP5_CANFD01_XIX_474350108, TPN_HVZB_XIX_HCP5_CANFD01_XIX_474350109, TPN_SACID_1_XIX_HCP5_CANFD01_XIX_474088004, TPN_SACID_1_XIX_HCP5_CANFD01_XIX_474088059, TPN_SACID_1_XIX_HCP5_CANFD01_XIX_474088079, TPN_SACID_1_XIX_HCP5_CANFD01_XIX_474088121, TPN_SACID_1_XIX_HCP5_CANFD01_XIX_474350107, TPN_SACID_1_XIX_HCP5_CANFD01_XIX_474350108, TPN_SACID_1_XIX_HCP5_CANFD01_XIX_474350109, TPN_SACID_2_XIX_HCP5_CANFD01_XIX_474088004, TPN_SACID_2_XIX_HCP5_CANFD01_XIX_474088059, TPN_SACID_2_XIX_HCP5_CANFD01_XIX_474088079, TPN_SACID_2_XIX_HCP5_CANFD01_XIX_474088121, TPN_SACID_2_XIX_HCP5_CANFD01_XIX_474350107, TPN_SACID_2_XIX_HCP5_CANFD01_XIX_474350108, TPN_SACID_2_XIX_HCP5_CANFD01_XIX_474350109, TPN_Ladegeraet_XIX_HCP5_CANFD01_XIX_474088004, TPN_Ladegeraet_XIX_HCP5_CANFD01_XIX_474088059, TPN_Ladegeraet_XIX_HCP5_CANFD01_XIX_474088079, TPN_Ladegeraet_XIX_HCP5_CANFD01_XIX_474088121, TPN_Ladegeraet_XIX_HCP5_CANFD01_XIX_474350107, TPN_Ladegeraet_XIX_HCP5_CANFD01_XIX_474350108, TPN_Ladegeraet_XIX_HCP5_CANFD01_XIX_474350109], ta-type=FUNCTIONAL, timeout-br=0.1, timeout-bs=1, timeout-cr=1, timeout-cs=0.2, tp-sdu=DCM_HCP5_CANFD01_XIX_TPCHType_CANFD_OBDC_Diagnose_XIX_0x1C410200_XIX_Functional, transmitter=TPN_Gateway_XIX_HCP5_CANFD01_XIX_474022400:
      ident TPCN_HCP5_CANFD01_XIX_TPCHType_CANFD_OBDC_Diagnose_XIX_0x1C410200_Gateway_XIX_Functional
    can-tp-connection addressing-format=STANDARD, can-tp-channel=TPC_HCP5_CANFD01_XIX_TPCHType_CANFD_OBDC_Diagnose_XIX_0x1C40027B_XIX_0x1C42027B_XIX_Physical, cancellation=true, data-pdu=OBDC_Hybrid_01_Resp_FD_XIX_HCP5_CANFD01, flow-control-pdu=OBDC_Hybrid_01_Req_FD_XIX_HCP5_CANFD01, max-block-size=15, padding-activation=true, receiver=TPN_Gateway_XIX_HCP5_CANFD01_XIX_473956987, ta-type=PHYSICAL, timeout-br=0.1, timeout-bs=1, timeout-cr=1, timeout-cs=0.2, tp-sdu=DCM_HCP5_CANFD01_XIX_TPCHType_CANFD_OBDC_Diagnose_XIX_0x1C42027B_XIX_0x1C40027B_XIX_Physical, transmitter=TPN_Hybrid_01_XIX_HCP5_CANFD01_XIX_474088059:
      ident TPCN_HCP5_CANFD01_XIX_TPCHType_CANFD_OBDC_Diagnose_XIX_0x1C42027B_Hybrid_01_XIX_0x1C40027B_Gateway_XIX_Physical
    can-tp-connection addressing-format=STANDARD, can-tp-channel=TPC_HCP5_CANFD01_XIX_TPCHType_CANHS_Flash_DIA_XIX_0x17FC16D0_XIX_0x17FE16D0_XIX_Physical, cancellation=true, data-pdu=DIA_BJB_Req_XIX_HCP5_CANFD01, flow-control-pdu=DIA_BJB_Resp_XIX_HCP5_CANFD01, max-block-size=15, padding-activation=true, receiver=TPN_Hybrid_01_XIX_HCP5_CANFD01_XIX_402527952, ta-type=PHYSICAL, timeout-br=0.1, timeout-bs=1, timeout-cr=1, timeout-cs=0.2, tp-sdu=DCM_HCP5_CANFD01_XIX_TPCHType_CANHS_Flash_DIA_XIX_0x17FC16D0_XIX_0x17FE16D0_XIX_Physical, transmitter=TPN_Gateway_XIX_HCP5_CANFD01_XIX_402396880:
      ident TPCN_HCP5_CANFD01_XIX_TPCHType_CANHS_Flash_DIA_XIX_0x17FC16D0_Gateway_XIX_0x17FE16D0_Hybrid_01_XIX_Physical
    can-tp-connection addressing-format=STANDARD, can-tp-channel=TPC_HCP5_CANFD01_XIX_TPCHType_CANHS_Flash_DIA_XIX_0x17FC17B1_XIX_0x17FE17B1_XIX_Physical, cancellation=true, data-pdu=DIA_UI2Sens01_Req_XIX_HCP5_CANFD01, flow-control-pdu=DIA_UI2Sens01_Resp_XIX_HCP5_CANFD01, max-block-size=15, padding-activation=true, receiver=TPN_Hybrid_01_XIX_HCP5_CANFD01_XIX_402528177, ta-type=PHYSICAL, timeout-br=0.1, timeout-bs=1, timeout-cr=1, timeout-cs=0.2, tp-sdu=DCM_HCP5_CANFD01_XIX_TPCHType_CANHS_Flash_DIA_XIX_0x17FC17B1_XIX_0x17FE17B1_XIX_Physical, transmitter=TPN_Gateway_XIX_HCP5_CANFD01_XIX_402397105:
      ident TPCN_HCP5_CANFD01_XIX_TPCHType_CANHS_Flash_DIA_XIX_0x17FC17B1_Gateway_XIX_0x17FE17B1_Hybrid_01_XIX_Physical
    can-tp-connection addressing-format=STANDARD, can-tp-channel=TPC_HCP5_CANFD01_XIX_TPCHType_CANHS_Flash_DIA_XIX_0x17FC17B2_XIX_0x17FE17B2_XIX_Physical, cancellation=true, data-pdu=DIA_UI2Sens02_Req_XIX_HCP5_CANFD01, flow-control-pdu=DIA_UI2Sens02_Resp_XIX_HCP5_CANFD01, max-block-size=15, padding-activation=true, receiver=TPN_Hybrid_01_XIX_HCP5_CANFD01_XIX_402528178, ta-type=PHYSICAL, timeout-br=0.1, timeout-bs=1, timeout-cr=1, timeout-cs=0.2, tp-sdu=DCM_HCP5_CANFD01_XIX_TPCHType_CANHS_Flash_DIA_XIX_0x17FC17B2_XIX_0x17FE17B2_XIX_Physical, transmitter=TPN_Gateway_XIX_HCP5_CANFD01_XIX_402397106:
      ident TPCN_HCP5_CANFD01_XIX_TPCHType_CANHS_Flash_DIA_XIX_0x17FC17B2_Gateway_XIX_0x17FE17B2_Hybrid_01_XIX_Physical
    can-tp-connection addressing-format=STANDARD, can-tp-channel=TPC_HCP5_CANFD01_XIX_TPCHType_CANHS_Flash_DIA_XIX_0x17FC16D0_XIX_0x17FE16D0_XIX_Physical, cancellation=true, data-pdu=DIA_BJB_Resp_XIX_HCP5_CANFD01, flow-control-pdu=DIA_BJB_Req_XIX_HCP5_CANFD01, max-block-size=15, padding-activation=true, receiver=TPN_Gateway_XIX_HCP5_CANFD01_XIX_402396880, ta-type=PHYSICAL, timeout-br=0.1, timeout-bs=1, timeout-cr=1, timeout-cs=0.2, tp-sdu=DCM_HCP5_CANFD01_XIX_TPCHType_CANHS_Flash_DIA_XIX_0x17FE16D0_XIX_0x17FC16D0_XIX_Physical, transmitter=TPN_Hybrid_01_XIX_HCP5_CANFD01_XIX_402527952:
      ident TPCN_HCP5_CANFD01_XIX_TPCHType_CANHS_Flash_DIA_XIX_0x17FE16D0_Hybrid_01_XIX_0x17FC16D0_Gateway_XIX_Physical
    can-tp-connection addressing-format=STANDARD, can-tp-channel=TPC_HCP5_CANFD01_XIX_TPCHType_CANHS_Flash_DIA_XIX_0x17FC17B1_XIX_0x17FE17B1_XIX_Physical, cancellation=true, data-pdu=DIA_UI2Sens01_Resp_XIX_HCP5_CANFD01, flow-control-pdu=DIA_UI2Sens01_Req_XIX_HCP5_CANFD01, max-block-size=15, padding-activation=true, receiver=TPN_Gateway_XIX_HCP5_CANFD01_XIX_402397105, ta-type=PHYSICAL, timeout-br=0.1, timeout-bs=1, timeout-cr=1, timeout-cs=0.2, tp-sdu=DCM_HCP5_CANFD01_XIX_TPCHType_CANHS_Flash_DIA_XIX_0x17FE17B1_XIX_0x17FC17B1_XIX_Physical, transmitter=TPN_Hybrid_01_XIX_HCP5_CANFD01_XIX_402528177:
      ident TPCN_HCP5_CANFD01_XIX_TPCHType_CANHS_Flash_DIA_XIX_0x17FE17B1_Hybrid_01_XIX_0x17FC17B1_Gateway_XIX_Physical
    can-tp-connection addressing-format=STANDARD, can-tp-channel=TPC_HCP5_CANFD01_XIX_TPCHType_CANHS_Flash_DIA_XIX_0x17FC17B2_XIX_0x17FE17B2_XIX_Physical, cancellation=true, data-pdu=DIA_UI2Sens02_Resp_XIX_HCP5_CANFD01, flow-control-pdu=DIA_UI2Sens02_Req_XIX_HCP5_CANFD01, max-block-size=15, padding-activation=true, receiver=TPN_Gateway_XIX_HCP5_CANFD01_XIX_402397106, ta-type=PHYSICAL, timeout-br=0.1, timeout-bs=1, timeout-cr=1, timeout-cs=0.2, tp-sdu=DCM_HCP5_CANFD01_XIX_TPCHType_CANHS_Flash_DIA_XIX_0x17FE17B2_XIX_0x17FC17B2_XIX_Physical, transmitter=TPN_Hybrid_01_XIX_HCP5_CANFD01_XIX_402528178:
      ident TPCN_HCP5_CANFD01_XIX_TPCHType_CANHS_Flash_DIA_XIX_0x17FE17B2_Hybrid_01_XIX_0x17FC17B2_Gateway_XIX_Physical
    can-tp-connection addressing-format=STANDARD, can-tp-channel=TPC_HCP5_CANFD01_XIX_TPCHType_CANHS_ISO_Diagnose_XIX_0x17FC007B_XIX_0x17FE007B_XIX_Physical, cancellation=true, data-pdu=ISOx_Hybrid_01_Req_XIX_HCP5_CANFD01, flow-control-pdu=ISOx_Hybrid_01_Resp_XIX_HCP5_CANFD01, max-block-size=15, padding-activation=true, receiver=TPN_Hybrid_01_XIX_HCP5_CANFD01_XIX_402522235, ta-type=PHYSICAL, timeout-br=0.1, timeout-bs=1, timeout-cr=1, timeout-cs=0.2, tp-sdu=DCM_HCP5_CANFD01_XIX_TPCHType_CANHS_ISO_Diagnose_XIX_0x17FC007B_XIX_0x17FE007B_XIX_Physical, transmitter=TPN_Gateway_XIX_HCP5_CANFD01_XIX_402391163:
      ident TPCN_HCP5_CANFD01_XIX_TPCHType_CANHS_ISO_Diagnose_XIX_0x17FC007B_Gateway_XIX_0x17FE007B_Hybrid_01_XIX_Physical
    can-tp-connection addressing-format=STANDARD, can-tp-channel=TPC_HCP5_CANFD01_XIX_TPCHType_CANHS_ISO_Diagnose_XIX_0x17FC007B_XIX_0x17FE007B_XIX_Physical, cancellation=true, data-pdu=ISOx_Hybrid_01_Resp_XIX_HCP5_CANFD01, flow-control-pdu=ISOx_Hybrid_01_Req_XIX_HCP5_CANFD01, max-block-size=15, padding-activation=true, receiver=TPN_Gateway_XIX_HCP5_CANFD01_XIX_402391163, ta-type=PHYSICAL, timeout-br=0.1, timeout-bs=1, timeout-cr=1, timeout-cs=0.2, tp-sdu=DCM_HCP5_CANFD01_XIX_TPCHType_CANHS_ISO_Diagnose_XIX_0x17FE007B_XIX_0x17FC007B_XIX_Physical, transmitter=TPN_Hybrid_01_XIX_HCP5_CANFD01_XIX_402522235:
      ident TPCN_HCP5_CANFD01_XIX_TPCHType_CANHS_ISO_Diagnose_XIX_0x17FE007B_Hybrid_01_XIX_0x17FC007B_Gateway_XIX_Physical
    can-tp-connection addressing-format=STANDARD, can-tp-channel=TPC_HCP5_CANFD01_XIX_TPCHType_CANHS_ISO_Diagnose_XIX_0x700_XIX_Functional, cancellation=true, data-pdu=ISO_Funktionaler_Req_All_XIX_HCP5_CANFD01, max-block-size=15, multicast=CanTPConfig_HCP5_CANFD01/TA_0x700, padding-activation=true, receiver=[TPN_AWC_XIX_HCP5_CANFD01_XIX_402522255, TPN_Hybrid_01_XIX_HCP5_CANFD01_XIX_1963, TPN_Hybrid_01_XIX_HCP5_CANFD01_XIX_402522235, TPN_Hybrid_01_XIX_HCP5_CANFD01_XIX_402522268, TPN_Hybrid_01_XIX_HCP5_CANFD01_XIX_402522286, TPN_Hybrid_01_XIX_HCP5_CANFD01_XIX_402522292, TPN_Hybrid_01_XIX_HCP5_CANFD01_XIX_403046414, TPN_Hybrid_01_XIX_HCP5_CANFD01_XIX_403046421, TPN_Hybrid_01_XIX_HCP5_CANFD01_XIX_403046433, TPN_DCDC_NV_XIX_HCP5_CANFD01_XIX_402522297, TPN_HVZB_XIX_HCP5_CANFD01_XIX_403046429, TPN_SACID_1_XIX_HCP5_CANFD01_XIX_403046427, TPN_SACID_2_XIX_HCP5_CANFD01_XIX_403046428, TPN_Ladegeraet_XIX_HCP5_CANFD01_XIX_1966], ta-type=FUNCTIONAL, timeout-br=0.1, timeout-bs=1, timeout-cr=1, timeout-cs=0.2, tp-sdu=DCM_HCP5_CANFD01_XIX_TPCHType_CANHS_ISO_Diagnose_XIX_0x700_XIX_Functional, transmitter=TPN_Gateway_XIX_HCP5_CANFD01_XIX_1857:
      ident TPCN_HCP5_CANFD01_XIX_TPCHType_CANHS_ISO_Diagnose_XIX_0x700_Gateway_XIX_Functional
    can-tp-connection addressing-format=STANDARD, can-tp-channel=TPC_HCP5_CANFD01_XIX_TPCHType_CANHS_OBDC_SSN_Diagnose_XIX_0x17FC70D0_XIX_0x17FE70D0_XIX_Physical, cancellation=true, data-pdu=OBDC_SSN_BJB_Req_XIX_HCP5_CANFD01, flow-control-pdu=OBDC_SSN_BJB_Resp_XIX_HCP5_CANFD01, max-block-size=15, padding-activation=true, receiver=TPN_Hybrid_01_XIX_HCP5_CANFD01_XIX_402550992, ta-type=PHYSICAL, timeout-br=0.1, timeout-bs=1, timeout-cr=1, timeout-cs=0.2, tp-sdu=DCM_HCP5_CANFD01_XIX_TPCHType_CANHS_OBDC_SSN_Diagnose_XIX_0x17FC70D0_XIX_0x17FE70D0_XIX_Physical, transmitter=TPN_Gateway_XIX_HCP5_CANFD01_XIX_402419920:
      ident TPCN_HCP5_CANFD01_XIX_TPCHType_CANHS_OBDC_SSN_Diagnose_XIX_0x17FC70D0_Gateway_XIX_0x17FE70D0_Hybrid_01_XIX_Physical
    can-tp-connection addressing-format=STANDARD, can-tp-channel=TPC_HCP5_CANFD01_XIX_TPCHType_CANHS_OBDC_SSN_Diagnose_XIX_0x17FC71B1_XIX_0x17FE71B1_XIX_Physical, cancellation=true, data-pdu=OBDC_SSN_UI2Sens01_Req_XIX_HCP5_CANFD01, flow-control-pdu=OBDC_SSN_UI2Sens01_Resp_XIX_HCP5_CANFD01, max-block-size=15, padding-activation=true, receiver=TPN_Hybrid_01_XIX_HCP5_CANFD01_XIX_402551217, ta-type=PHYSICAL, timeout-br=0.1, timeout-bs=1, timeout-cr=1, timeout-cs=0.2, tp-sdu=DCM_HCP5_CANFD01_XIX_TPCHType_CANHS_OBDC_SSN_Diagnose_XIX_0x17FC71B1_XIX_0x17FE71B1_XIX_Physical, transmitter=TPN_Gateway_XIX_HCP5_CANFD01_XIX_402420145:
      ident TPCN_HCP5_CANFD01_XIX_TPCHType_CANHS_OBDC_SSN_Diagnose_XIX_0x17FC71B1_Gateway_XIX_0x17FE71B1_Hybrid_01_XIX_Physical
    can-tp-connection addressing-format=STANDARD, can-tp-channel=TPC_HCP5_CANFD01_XIX_TPCHType_CANHS_OBDC_SSN_Diagnose_XIX_0x17FC71B2_XIX_0x17FE71B2_XIX_Physical, cancellation=true, data-pdu=OBDC_SSN_UI2Sens02_Req_XIX_HCP5_CANFD01, flow-control-pdu=OBDC_SSN_UI2Sens02_Resp_XIX_HCP5_CANFD01, max-block-size=15, padding-activation=true, receiver=TPN_Hybrid_01_XIX_HCP5_CANFD01_XIX_402551218, ta-type=PHYSICAL, timeout-br=0.1, timeout-bs=1, timeout-cr=1, timeout-cs=0.2, tp-sdu=DCM_HCP5_CANFD01_XIX_TPCHType_CANHS_OBDC_SSN_Diagnose_XIX_0x17FC71B2_XIX_0x17FE71B2_XIX_Physical, transmitter=TPN_Gateway_XIX_HCP5_CANFD01_XIX_402420146:
      ident TPCN_HCP5_CANFD01_XIX_TPCHType_CANHS_OBDC_SSN_Diagnose_XIX_0x17FC71B2_Gateway_XIX_0x17FE71B2_Hybrid_01_XIX_Physical
    can-tp-connection addressing-format=STANDARD, can-tp-channel=TPC_HCP5_CANFD01_XIX_TPCHType_CANHS_OBDC_SSN_Diagnose_XIX_0x17FC70D0_XIX_0x17FE70D0_XIX_Physical, cancellation=true, data-pdu=OBDC_SSN_BJB_Resp_XIX_HCP5_CANFD01, flow-control-pdu=OBDC_SSN_BJB_Req_XIX_HCP5_CANFD01, max-block-size=15, padding-activation=true, receiver=TPN_Gateway_XIX_HCP5_CANFD01_XIX_402419920, ta-type=PHYSICAL, timeout-br=0.1, timeout-bs=1, timeout-cr=1, timeout-cs=0.2, tp-sdu=DCM_HCP5_CANFD01_XIX_TPCHType_CANHS_OBDC_SSN_Diagnose_XIX_0x17FE70D0_XIX_0x17FC70D0_XIX_Physical, transmitter=TPN_Hybrid_01_XIX_HCP5_CANFD01_XIX_402550992:
      ident TPCN_HCP5_CANFD01_XIX_TPCHType_CANHS_OBDC_SSN_Diagnose_XIX_0x17FE70D0_Hybrid_01_XIX_0x17FC70D0_Gateway_XIX_Physical
    can-tp-connection addressing-format=STANDARD, can-tp-channel=TPC_HCP5_CANFD01_XIX_TPCHType_CANHS_OBDC_SSN_Diagnose_XIX_0x17FC71B1_XIX_0x17FE71B1_XIX_Physical, cancellation=true, data-pdu=OBDC_SSN_UI2Sens01_Resp_XIX_HCP5_CANFD01, flow-control-pdu=OBDC_SSN_UI2Sens01_Req_XIX_HCP5_CANFD01, max-block-size=15, padding-activation=true, receiver=TPN_Gateway_XIX_HCP5_CANFD01_XIX_402420145, ta-type=PHYSICAL, timeout-br=0.1, timeout-bs=1, timeout-cr=1, timeout-cs=0.2, tp-sdu=DCM_HCP5_CANFD01_XIX_TPCHType_CANHS_OBDC_SSN_Diagnose_XIX_0x17FE71B1_XIX_0x17FC71B1_XIX_Physical, transmitter=TPN_Hybrid_01_XIX_HCP5_CANFD01_XIX_402551217:
      ident TPCN_HCP5_CANFD01_XIX_TPCHType_CANHS_OBDC_SSN_Diagnose_XIX_0x17FE71B1_Hybrid_01_XIX_0x17FC71B1_Gateway_XIX_Physical
    can-tp-connection addressing-format=STANDARD, can-tp-channel=TPC_HCP5_CANFD01_XIX_TPCHType_CANHS_OBDC_SSN_Diagnose_XIX_0x17FC71B2_XIX_0x17FE71B2_XIX_Physical, cancellation=true, data-pdu=OBDC_SSN_UI2Sens02_Resp_XIX_HCP5_CANFD01, flow-control-pdu=OBDC_SSN_UI2Sens02_Req_XIX_HCP5_CANFD01, max-block-size=15, padding-activation=true, receiver=TPN_Gateway_XIX_HCP5_CANFD01_XIX_402420146, ta-type=PHYSICAL, timeout-br=0.1, timeout-bs=1, timeout-cr=1, timeout-cs=0.2, tp-sdu=DCM_HCP5_CANFD01_XIX_TPCHType_CANHS_OBDC_SSN_Diagnose_XIX_0x17FE71B2_XIX_0x17FC71B2_XIX_Physical, transmitter=TPN_Hybrid_01_XIX_HCP5_CANFD01_XIX_402551218:
      ident TPCN_HCP5_CANFD01_XIX_TPCHType_CANHS_OBDC_SSN_Diagnose_XIX_0x17FE71B2_Hybrid_01_XIX_0x17FC71B2_Gateway_XIX_Physical
    can-tp-connection addressing-format=STANDARD, can-tp-channel=TPC_HCP5_CANFD01_XIX_TPCHType_CANHS_OBDx_XIX_0x18DA05F1_XIX_0x18DAF105_XIX_Physical, cancellation=true, data-pdu=OBDx_Hybrid_01_Req_XIX_HCP5_CANFD01, flow-control-pdu=OBDx_Hybrid_01_Resp_XIX_HCP5_CANFD01, max-block-size=15, padding-activation=true, receiver=TPN_Hybrid_01_XIX_HCP5_CANFD01_XIX_417001733, ta-type=PHYSICAL, timeout-br=0.001, timeout-bs=0.075, timeout-cr=0.15, timeout-cs=0.025, tp-sdu=DCM_HCP5_CANFD01_XIX_TPCHType_CANHS_OBDx_XIX_0x18DA05F1_XIX_0x18DAF105_XIX_Physical, transmitter=TPN_Gateway_XIX_HCP5_CANFD01_XIX_416941553:
      ident TPCN_HCP5_CANFD01_XIX_TPCHType_CANHS_OBDx_XIX_0x18DA05F1_Gateway_XIX_0x18DAF105_Hybrid_01_XIX_Physical
    can-tp-connection addressing-format=STANDARD, can-tp-channel=TPC_HCP5_CANFD01_XIX_TPCHType_CANHS_OBDx_XIX_0x18DA05F1_XIX_0x18DAF105_XIX_Physical, cancellation=true, data-pdu=OBDx_Hybrid_01_Resp_XIX_HCP5_CANFD01, flow-control-pdu=OBDx_Hybrid_01_Req_XIX_HCP5_CANFD01, max-block-size=15, padding-activation=true, receiver=TPN_Gateway_XIX_HCP5_CANFD01_XIX_416941553, ta-type=PHYSICAL, timeout-br=0.001, timeout-bs=0.075, timeout-cr=0.15, timeout-cs=0.025, tp-sdu=DCM_HCP5_CANFD01_XIX_TPCHType_CANHS_OBDx_XIX_0x18DAF105_XIX_0x18DA05F1_XIX_Physical, transmitter=TPN_Hybrid_01_XIX_HCP5_CANFD01_XIX_417001733:
      ident TPCN_HCP5_CANFD01_XIX_TPCHType_CANHS_OBDx_XIX_0x18DAF105_Hybrid_01_XIX_0x18DA05F1_Gateway_XIX_Physical
    can-tp-connection addressing-format=STANDARD, can-tp-channel=TPC_HCP5_CANFD01_XIX_TPCHType_CANHS_OBDx_XIX_0x18DB33F1_XIX_Functional, cancellation=true, data-pdu=OBDx_allOBD_Req_XIX_HCP5_CANFD01, max-block-size=15, multicast=TA_0x18DB33F1, padding-activation=true, receiver=[TPN_AWC_XIX_HCP5_CANFD01_XIX_417018865, TPN_Hybrid_01_XIX_HCP5_CANFD01_XIX_417018865, TPN_HVZB_XIX_HCP5_CANFD01_XIX_417018865, TPN_SACID_1_XIX_HCP5_CANFD01_XIX_417018865, TPN_SACID_2_XIX_HCP5_CANFD01_XIX_417018865, TPN_Ladegeraet_XIX_HCP5_CANFD01_XIX_417018865], ta-type=FUNCTIONAL, timeout-br=0.001, timeout-bs=0.075, timeout-cr=0.15, timeout-cs=0.025, tp-sdu=DCM_HCP5_CANFD01_XIX_TPCHType_CANHS_OBDx_XIX_0x18DB33F1_XIX_Functional, transmitter=TPN_Gateway_XIX_HCP5_CANFD01_XIX_417018865:
      ident TPCN_HCP5_CANFD01_XIX_TPCHType_CANHS_OBDx_XIX_0x18DB33F1_Gateway_XIX_Functional
    153 x can tp node, all with st-min=0.005:
      TPN_AWC_XIX_HCP5_CANFD01_XIX_402522255: max-fc-wait=15, timeout-ar=1, timeout-as=1, tp-address=TA_0x17FE008F
      TPN_AWC_XIX_HCP5_CANFD01_XIX_417018865: max-fc-wait=0, timeout-ar=0.025, timeout-as=0.025, tp-address=TA_0x18DB33F1
      TPN_AWC_XIX_HCP5_CANFD01_XIX_474087492: max-fc-wait=15, timeout-ar=1, timeout-as=1, tp-address=TA_0x1C420044
      TPN_AWC_XIX_HCP5_CANFD01_XIX_474087547: max-fc-wait=15, timeout-ar=1, timeout-as=1, tp-address=TA_0x1C42007B
      TPN_AWC_XIX_HCP5_CANFD01_XIX_474087567: max-fc-wait=15, timeout-ar=1, timeout-as=1, tp-address=TA_0x1C42008F
      TPN_AWC_XIX_HCP5_CANFD01_XIX_474087609: max-fc-wait=15, timeout-ar=1, timeout-as=1, tp-address=TA_0x1C4200B9
      TPN_AWC_XIX_HCP5_CANFD01_XIX_474088004: max-fc-wait=15, timeout-ar=1, timeout-as=1, tp-address=TA_0x1C420244
      TPN_AWC_XIX_HCP5_CANFD01_XIX_474088059: max-fc-wait=15, timeout-ar=1, timeout-as=1, tp-address=TA_0x1C42027B
      TPN_AWC_XIX_HCP5_CANFD01_XIX_474088079: max-fc-wait=15, timeout-ar=1, timeout-as=1, tp-address=TA_0x1C42028F
      TPN_AWC_XIX_HCP5_CANFD01_XIX_474088121: max-fc-wait=15, timeout-ar=1, timeout-as=1, tp-address=TA_0x1C4202B9
      TPN_AWC_XIX_HCP5_CANFD01_XIX_474349595: max-fc-wait=15, timeout-ar=1, timeout-as=1, tp-address=TA_0x1C46001B
      TPN_AWC_XIX_HCP5_CANFD01_XIX_474349596: max-fc-wait=15, timeout-ar=1, timeout-as=1, tp-address=TA_0x1C46001C
      TPN_AWC_XIX_HCP5_CANFD01_XIX_474349597: max-fc-wait=15, timeout-ar=1, timeout-as=1, tp-address=TA_0x1C46001D
      TPN_AWC_XIX_HCP5_CANFD01_XIX_474350107: max-fc-wait=15, timeout-ar=1, timeout-as=1, tp-address=TA_0x1C46021B
      TPN_AWC_XIX_HCP5_CANFD01_XIX_474350108: max-fc-wait=15, timeout-ar=1, timeout-as=1, tp-address=TA_0x1C46021C
      TPN_AWC_XIX_HCP5_CANFD01_XIX_474350109: max-fc-wait=15, timeout-ar=1, timeout-as=1, tp-address=TA_0x1C46021D
      TPN_Hybrid_01_XIX_HCP5_CANFD01_XIX_1963: connector=CN_HCP5_CANFD01, timeout-as=1, tp-address=TA_0x7AB
      TPN_Hybrid_01_XIX_HCP5_CANFD01_XIX_402522235: connector=CN_HCP5_CANFD01, max-fc-wait=15, timeout-ar=1, timeout-as=1, tp-address=TA_0x17FE007B
      TPN_Hybrid_01_XIX_HCP5_CANFD01_XIX_402522268: connector=CN_HCP5_CANFD01, max-fc-wait=15, timeout-ar=1, timeout-as=1, tp-address=TA_0x17FE009C
      TPN_Hybrid_01_XIX_HCP5_CANFD01_XIX_402522286: connector=CN_HCP5_CANFD01, max-fc-wait=15, timeout-ar=1, timeout-as=1, tp-address=TA_0x17FE00AE
      TPN_Hybrid_01_XIX_HCP5_CANFD01_XIX_402522292: connector=CN_HCP5_CANFD01, max-fc-wait=15, timeout-ar=1, timeout-as=1, tp-address=TA_0x17FE00B4
      TPN_Hybrid_01_XIX_HCP5_CANFD01_XIX_402527952: connector=CN_HCP5_CANFD01, max-fc-wait=15, timeout-ar=1, timeout-as=1, tp-address=CanTPConfig_HCP5_CANFD01/TA_0x17FE16D0
      TPN_Hybrid_01_XIX_HCP5_CANFD01_XIX_402528177: connector=CN_HCP5_CANFD01, max-fc-wait=15, timeout-ar=1, timeout-as=1, tp-address=CanTPConfig_HCP5_CANFD01/TA_0x17FE17B1
      TPN_Hybrid_01_XIX_HCP5_CANFD01_XIX_402528178: connector=CN_HCP5_CANFD01, max-fc-wait=15, timeout-ar=1, timeout-as=1, tp-address=CanTPConfig_HCP5_CANFD01/TA_0x17FE17B2
      TPN_Hybrid_01_XIX_HCP5_CANFD01_XIX_402550992: connector=CN_HCP5_CANFD01, max-fc-wait=15, timeout-ar=1, timeout-as=1, tp-address=CanTPConfig_HCP5_CANFD01/TA_0x17FE70D0
      TPN_Hybrid_01_XIX_HCP5_CANFD01_XIX_402551217: connector=CN_HCP5_CANFD01, max-fc-wait=15, timeout-ar=1, timeout-as=1, tp-address=CanTPConfig_HCP5_CANFD01/TA_0x17FE71B1
      TPN_Hybrid_01_XIX_HCP5_CANFD01_XIX_402551218: connector=CN_HCP5_CANFD01, max-fc-wait=15, timeout-ar=1, timeout-as=1, tp-address=CanTPConfig_HCP5_CANFD01/TA_0x17FE71B2
      TPN_Hybrid_01_XIX_HCP5_CANFD01_XIX_403046414: connector=CN_HCP5_CANFD01, max-fc-wait=15, timeout-ar=1, timeout-as=1, tp-address=TA_0x1806000E
      TPN_Hybrid_01_XIX_HCP5_CANFD01_XIX_403046421: connector=CN_HCP5_CANFD01, max-fc-wait=15, timeout-ar=1, timeout-as=1, tp-address=TA_0x18060015
      TPN_Hybrid_01_XIX_HCP5_CANFD01_XIX_403046433: connector=CN_HCP5_CANFD01, max-fc-wait=15, timeout-ar=1, timeout-as=1, tp-address=TA_0x18060021
      TPN_Hybrid_01_XIX_HCP5_CANFD01_XIX_417001733: connector=CN_HCP5_CANFD01, max-fc-wait=0, timeout-ar=0.025, timeout-as=0.025, tp-address=TA_0x18DAF105
      TPN_Hybrid_01_XIX_HCP5_CANFD01_XIX_417018865: connector=CN_HCP5_CANFD01, max-fc-wait=0, timeout-ar=0.025, timeout-as=0.025, tp-address=TA_0x18DB33F1
      TPN_Hybrid_01_XIX_HCP5_CANFD01_XIX_474087492: connector=CN_HCP5_CANFD01, max-fc-wait=15, timeout-ar=1, timeout-as=1, tp-address=TA_0x1C420044
      TPN_Hybrid_01_XIX_HCP5_CANFD01_XIX_474087547: connector=CN_HCP5_CANFD01, max-fc-wait=15, timeout-ar=1, timeout-as=1, tp-address=TA_0x1C42007B
      TPN_Hybrid_01_XIX_HCP5_CANFD01_XIX_474087567: connector=CN_HCP5_CANFD01, max-fc-wait=15, timeout-ar=1, timeout-as=1, tp-address=TA_0x1C42008F
      TPN_Hybrid_01_XIX_HCP5_CANFD01_XIX_474087609: connector=CN_HCP5_CANFD01, max-fc-wait=15, timeout-ar=1, timeout-as=1, tp-address=TA_0x1C4200B9
      TPN_Hybrid_01_XIX_HCP5_CANFD01_XIX_474088004: connector=CN_HCP5_CANFD01, max-fc-wait=15, timeout-ar=1, timeout-as=1, tp-address=TA_0x1C420244
      TPN_Hybrid_01_XIX_HCP5_CANFD01_XIX_474088059: connector=CN_HCP5_CANFD01, max-fc-wait=15, timeout-ar=1, timeout-as=1, tp-address=TA_0x1C42027B
      TPN_Hybrid_01_XIX_HCP5_CANFD01_XIX_474088079: connector=CN_HCP5_CANFD01, max-fc-wait=15, timeout-ar=1, timeout-as=1, tp-address=TA_0x1C42028F
      TPN_Hybrid_01_XIX_HCP5_CANFD01_XIX_474088121: connector=CN_HCP5_CANFD01, max-fc-wait=15, timeout-ar=1, timeout-as=1, tp-address=TA_0x1C4202B9
      TPN_Hybrid_01_XIX_HCP5_CANFD01_XIX_474103675: connector=CN_HCP5_CANFD01, max-fc-wait=15, timeout-ar=1, timeout-as=1, tp-address=TA_0x1C423F7B
      TPN_Hybrid_01_XIX_HCP5_CANFD01_XIX_474349595: connector=CN_HCP5_CANFD01, max-fc-wait=15, timeout-ar=1, timeout-as=1, tp-address=TA_0x1C46001B
      TPN_Hybrid_01_XIX_HCP5_CANFD01_XIX_474349596: connector=CN_HCP5_CANFD01, max-fc-wait=15, timeout-ar=1, timeout-as=1, tp-address=TA_0x1C46001C
      TPN_Hybrid_01_XIX_HCP5_CANFD01_XIX_474349597: connector=CN_HCP5_CANFD01, max-fc-wait=15, timeout-ar=1, timeout-as=1, tp-address=TA_0x1C46001D
      TPN_Hybrid_01_XIX_HCP5_CANFD01_XIX_474350107: connector=CN_HCP5_CANFD01, max-fc-wait=15, timeout-ar=1, timeout-as=1, tp-address=TA_0x1C46021B
      TPN_Hybrid_01_XIX_HCP5_CANFD01_XIX_474350108: connector=CN_HCP5_CANFD01, max-fc-wait=15, timeout-ar=1, timeout-as=1, tp-address=TA_0x1C46021C
      TPN_Hybrid_01_XIX_HCP5_CANFD01_XIX_474350109: connector=CN_HCP5_CANFD01, max-fc-wait=15, timeout-ar=1, timeout-as=1, tp-address=TA_0x1C46021D
      TPN_DCDC_NV_XIX_HCP5_CANFD01_XIX_402522297: max-fc-wait=15, timeout-ar=1, timeout-as=1, tp-address=TA_0x17FE00B9
      TPN_DCDC_NV_XIX_HCP5_CANFD01_XIX_474087492: max-fc-wait=15, timeout-ar=1, timeout-as=1, tp-address=TA_0x1C420044
      TPN_DCDC_NV_XIX_HCP5_CANFD01_XIX_474087547: max-fc-wait=15, timeout-ar=1, timeout-as=1, tp-address=TA_0x1C42007B
      TPN_DCDC_NV_XIX_HCP5_CANFD01_XIX_474087567: max-fc-wait=15, timeout-ar=1, timeout-as=1, tp-address=TA_0x1C42008F
      TPN_DCDC_NV_XIX_HCP5_CANFD01_XIX_474087609: max-fc-wait=15, timeout-ar=1, timeout-as=1, tp-address=TA_0x1C4200B9
      TPN_DCDC_NV_XIX_HCP5_CANFD01_XIX_474088004: max-fc-wait=15, timeout-ar=1, timeout-as=1, tp-address=TA_0x1C420244
      TPN_DCDC_NV_XIX_HCP5_CANFD01_XIX_474088059: max-fc-wait=15, timeout-ar=1, timeout-as=1, tp-address=TA_0x1C42027B
      TPN_DCDC_NV_XIX_HCP5_CANFD01_XIX_474088079: max-fc-wait=15, timeout-ar=1, timeout-as=1, tp-address=TA_0x1C42028F
      TPN_DCDC_NV_XIX_HCP5_CANFD01_XIX_474088121: max-fc-wait=15, timeout-ar=1, timeout-as=1, tp-address=TA_0x1C4202B9
      TPN_DCDC_NV_XIX_HCP5_CANFD01_XIX_474349595: max-fc-wait=15, timeout-ar=1, timeout-as=1, tp-address=TA_0x1C46001B
      TPN_DCDC_NV_XIX_HCP5_CANFD01_XIX_474349596: max-fc-wait=15, timeout-ar=1, timeout-as=1, tp-address=TA_0x1C46001C
      TPN_DCDC_NV_XIX_HCP5_CANFD01_XIX_474349597: max-fc-wait=15, timeout-ar=1, timeout-as=1, tp-address=TA_0x1C46001D
      TPN_DCDC_NV_XIX_HCP5_CANFD01_XIX_474350107: max-fc-wait=15, timeout-ar=1, timeout-as=1, tp-address=TA_0x1C46021B
      TPN_DCDC_NV_XIX_HCP5_CANFD01_XIX_474350108: max-fc-wait=15, timeout-ar=1, timeout-as=1, tp-address=TA_0x1C46021C
      TPN_DCDC_NV_XIX_HCP5_CANFD01_XIX_474350109: max-fc-wait=15, timeout-ar=1, timeout-as=1, tp-address=TA_0x1C46021D
      TPN_Gateway_XIX_HCP5_CANFD01_XIX_1857: max-fc-wait=15, timeout-ar=1, timeout-as=1, tp-address=TA_0x741
      TPN_Gateway_XIX_HCP5_CANFD01_XIX_1860: max-fc-wait=15, timeout-ar=1, timeout-as=1, tp-address=TA_0x744
      TPN_Gateway_XIX_HCP5_CANFD01_XIX_402391163: max-fc-wait=15, timeout-ar=1, timeout-as=1, tp-address=TA_0x17FC007B
      TPN_Gateway_XIX_HCP5_CANFD01_XIX_402391183: max-fc-wait=15, timeout-ar=1, timeout-as=1, tp-address=TA_0x17FC008F
      TPN_Gateway_XIX_HCP5_CANFD01_XIX_402391196: max-fc-wait=15, timeout-ar=1, timeout-as=1, tp-address=TA_0x17FC009C
      TPN_Gateway_XIX_HCP5_CANFD01_XIX_402391214: max-fc-wait=15, timeout-ar=1, timeout-as=1, tp-address=TA_0x17FC00AE
      TPN_Gateway_XIX_HCP5_CANFD01_XIX_402391220: max-fc-wait=15, timeout-ar=1, timeout-as=1, tp-address=TA_0x17FC00B4
      TPN_Gateway_XIX_HCP5_CANFD01_XIX_402391225: max-fc-wait=15, timeout-ar=1, timeout-as=1, tp-address=TA_0x17FC00B9
      TPN_Gateway_XIX_HCP5_CANFD01_XIX_402396880: max-fc-wait=15, timeout-ar=1, timeout-as=1, tp-address=CanTPConfig_HCP5_CANFD01/TA_0x17FC16D0
      TPN_Gateway_XIX_HCP5_CANFD01_XIX_402397105: max-fc-wait=15, timeout-ar=1, timeout-as=1, tp-address=CanTPConfig_HCP5_CANFD01/TA_0x17FC17B1
      TPN_Gateway_XIX_HCP5_CANFD01_XIX_402397106: max-fc-wait=15, timeout-ar=1, timeout-as=1, tp-address=CanTPConfig_HCP5_CANFD01/TA_0x17FC17B2
      TPN_Gateway_XIX_HCP5_CANFD01_XIX_402419920: max-fc-wait=15, timeout-ar=1, timeout-as=1, tp-address=CanTPConfig_HCP5_CANFD01/TA_0x17FC70D0
      TPN_Gateway_XIX_HCP5_CANFD01_XIX_402420145: max-fc-wait=15, timeout-ar=1, timeout-as=1, tp-address=CanTPConfig_HCP5_CANFD01/TA_0x17FC71B1
      TPN_Gateway_XIX_HCP5_CANFD01_XIX_402420146: max-fc-wait=15, timeout-ar=1, timeout-as=1, tp-address=CanTPConfig_HCP5_CANFD01/TA_0x17FC71B2
      TPN_Gateway_XIX_HCP5_CANFD01_XIX_402915342: max-fc-wait=15, timeout-ar=1, timeout-as=1, tp-address=TA_0x1804000E
      TPN_Gateway_XIX_HCP5_CANFD01_XIX_402915349: max-fc-wait=15, timeout-ar=1, timeout-as=1, tp-address=TA_0x18040015
      TPN_Gateway_XIX_HCP5_CANFD01_XIX_402915355: max-fc-wait=15, timeout-ar=1, timeout-as=1, tp-address=TA_0x1804001B
      TPN_Gateway_XIX_HCP5_CANFD01_XIX_402915356: max-fc-wait=15, timeout-ar=1, timeout-as=1, tp-address=TA_0x1804001C
      TPN_Gateway_XIX_HCP5_CANFD01_XIX_402915357: max-fc-wait=15, timeout-ar=1, timeout-as=1, tp-address=TA_0x1804001D
      TPN_Gateway_XIX_HCP5_CANFD01_XIX_402915361: max-fc-wait=15, timeout-ar=1, timeout-as=1, tp-address=TA_0x18040021
      TPN_Gateway_XIX_HCP5_CANFD01_XIX_416941553: max-fc-wait=0, timeout-ar=0.025, timeout-as=0.025, tp-address=TA_0x18DA05F1
      TPN_Gateway_XIX_HCP5_CANFD01_XIX_417018865: max-fc-wait=0, timeout-ar=0.025, timeout-as=0.025, tp-address=TA_0x18DB33F1
      TPN_Gateway_XIX_HCP5_CANFD01_XIX_473956475: max-fc-wait=15, timeout-ar=1, timeout-as=1, tp-address=TA_0x1C40007B
      TPN_Gateway_XIX_HCP5_CANFD01_XIX_473956987: max-fc-wait=15, timeout-ar=1, timeout-as=1, tp-address=TA_0x1C40027B
      TPN_Gateway_XIX_HCP5_CANFD01_XIX_473972603: max-fc-wait=15, timeout-ar=1, timeout-as=1, tp-address=TA_0x1C403F7B
      TPN_Gateway_XIX_HCP5_CANFD01_XIX_474021888: max-fc-wait=15, timeout-ar=1, timeout-as=1, tp-address=TA_0x1C410000
      TPN_Gateway_XIX_HCP5_CANFD01_XIX_474022400: max-fc-wait=15, timeout-ar=1, timeout-as=1, tp-address=TA_0x1C410200
      TPN_HVZB_XIX_HCP5_CANFD01_XIX_403046429: max-fc-wait=15, timeout-ar=1, timeout-as=1, tp-address=TA_0x1806001D
      TPN_HVZB_XIX_HCP5_CANFD01_XIX_417018865: max-fc-wait=0, timeout-ar=0.025, timeout-as=0.025, tp-address=TA_0x18DB33F1
      TPN_HVZB_XIX_HCP5_CANFD01_XIX_474087492: max-fc-wait=15, timeout-ar=1, timeout-as=1, tp-address=TA_0x1C420044
      TPN_HVZB_XIX_HCP5_CANFD01_XIX_474087547: max-fc-wait=15, timeout-ar=1, timeout-as=1, tp-address=TA_0x1C42007B
      TPN_HVZB_XIX_HCP5_CANFD01_XIX_474087567: max-fc-wait=15, timeout-ar=1, timeout-as=1, tp-address=TA_0x1C42008F
      TPN_HVZB_XIX_HCP5_CANFD01_XIX_474087609: max-fc-wait=15, timeout-ar=1, timeout-as=1, tp-address=TA_0x1C4200B9
      TPN_HVZB_XIX_HCP5_CANFD01_XIX_474088004: max-fc-wait=15, timeout-ar=1, timeout-as=1, tp-address=TA_0x1C420244
      TPN_HVZB_XIX_HCP5_CANFD01_XIX_474088059: max-fc-wait=15, timeout-ar=1, timeout-as=1, tp-address=TA_0x1C42027B
      TPN_HVZB_XIX_HCP5_CANFD01_XIX_474088079: max-fc-wait=15, timeout-ar=1, timeout-as=1, tp-address=TA_0x1C42028F
      TPN_HVZB_XIX_HCP5_CANFD01_XIX_474088121: max-fc-wait=15, timeout-ar=1, timeout-as=1, tp-address=TA_0x1C4202B9
      TPN_HVZB_XIX_HCP5_CANFD01_XIX_474349595: max-fc-wait=15, timeout-ar=1, timeout-as=1, tp-address=TA_0x1C46001B
      TPN_HVZB_XIX_HCP5_CANFD01_XIX_474349596: max-fc-wait=15, timeout-ar=1, timeout-as=1, tp-address=TA_0x1C46001C
      TPN_HVZB_XIX_HCP5_CANFD01_XIX_474349597: max-fc-wait=15, timeout-ar=1, timeout-as=1, tp-address=TA_0x1C46001D
      TPN_HVZB_XIX_HCP5_CANFD01_XIX_474350107: max-fc-wait=15, timeout-ar=1, timeout-as=1, tp-address=TA_0x1C46021B
      TPN_HVZB_XIX_HCP5_CANFD01_XIX_474350108: max-fc-wait=15, timeout-ar=1, timeout-as=1, tp-address=TA_0x1C46021C
      TPN_HVZB_XIX_HCP5_CANFD01_XIX_474350109: max-fc-wait=15, timeout-ar=1, timeout-as=1, tp-address=TA_0x1C46021D
      TPN_SACID_1_XIX_HCP5_CANFD01_XIX_403046427: max-fc-wait=15, timeout-ar=1, timeout-as=1, tp-address=TA_0x1806001B
      TPN_SACID_1_XIX_HCP5_CANFD01_XIX_417018865: max-fc-wait=0, timeout-ar=0.025, timeout-as=0.025, tp-address=TA_0x18DB33F1
      TPN_SACID_1_XIX_HCP5_CANFD01_XIX_474087492: max-fc-wait=15, timeout-ar=1, timeout-as=1, tp-address=TA_0x1C420044
      TPN_SACID_1_XIX_HCP5_CANFD01_XIX_474087547: max-fc-wait=15, timeout-ar=1, timeout-as=1, tp-address=TA_0x1C42007B
      TPN_SACID_1_XIX_HCP5_CANFD01_XIX_474087567: max-fc-wait=15, timeout-ar=1, timeout-as=1, tp-address=TA_0x1C42008F
      TPN_SACID_1_XIX_HCP5_CANFD01_XIX_474087609: max-fc-wait=15, timeout-ar=1, timeout-as=1, tp-address=TA_0x1C4200B9
      TPN_SACID_1_XIX_HCP5_CANFD01_XIX_474088004: max-fc-wait=15, timeout-ar=1, timeout-as=1, tp-address=TA_0x1C420244
      TPN_SACID_1_XIX_HCP5_CANFD01_XIX_474088059: max-fc-wait=15, timeout-ar=1, timeout-as=1, tp-address=TA_0x1C42027B
      TPN_SACID_1_XIX_HCP5_CANFD01_XIX_474088079: max-fc-wait=15, timeout-ar=1, timeout-as=1, tp-address=TA_0x1C42028F
      TPN_SACID_1_XIX_HCP5_CANFD01_XIX_474088121: max-fc-wait=15, timeout-ar=1, timeout-as=1, tp-address=TA_0x1C4202B9
      TPN_SACID_1_XIX_HCP5_CANFD01_XIX_474349595: max-fc-wait=15, timeout-ar=1, timeout-as=1, tp-address=TA_0x1C46001B
      TPN_SACID_1_XIX_HCP5_CANFD01_XIX_474349596: max-fc-wait=15, timeout-ar=1, timeout-as=1, tp-address=TA_0x1C46001C
      TPN_SACID_1_XIX_HCP5_CANFD01_XIX_474349597: max-fc-wait=15, timeout-ar=1, timeout-as=1, tp-address=TA_0x1C46001D
      TPN_SACID_1_XIX_HCP5_CANFD01_XIX_474350107: max-fc-wait=15, timeout-ar=1, timeout-as=1, tp-address=TA_0x1C46021B
      TPN_SACID_1_XIX_HCP5_CANFD01_XIX_474350108: max-fc-wait=15, timeout-ar=1, timeout-as=1, tp-address=TA_0x1C46021C
      TPN_SACID_1_XIX_HCP5_CANFD01_XIX_474350109: max-fc-wait=15, timeout-ar=1, timeout-as=1, tp-address=TA_0x1C46021D
      TPN_SACID_2_XIX_HCP5_CANFD01_XIX_403046428: max-fc-wait=15, timeout-ar=1, timeout-as=1, tp-address=TA_0x1806001C
      TPN_SACID_2_XIX_HCP5_CANFD01_XIX_417018865: max-fc-wait=0, timeout-ar=0.025, timeout-as=0.025, tp-address=TA_0x18DB33F1
      TPN_SACID_2_XIX_HCP5_CANFD01_XIX_474087492: max-fc-wait=15, timeout-ar=1, timeout-as=1, tp-address=TA_0x1C420044
      TPN_SACID_2_XIX_HCP5_CANFD01_XIX_474087547: max-fc-wait=15, timeout-ar=1, timeout-as=1, tp-address=TA_0x1C42007B
      TPN_SACID_2_XIX_HCP5_CANFD01_XIX_474087567: max-fc-wait=15, timeout-ar=1, timeout-as=1, tp-address=TA_0x1C42008F
      TPN_SACID_2_XIX_HCP5_CANFD01_XIX_474087609: max-fc-wait=15, timeout-ar=1, timeout-as=1, tp-address=TA_0x1C4200B9
      TPN_SACID_2_XIX_HCP5_CANFD01_XIX_474088004: max-fc-wait=15, timeout-ar=1, timeout-as=1, tp-address=TA_0x1C420244
      TPN_SACID_2_XIX_HCP5_CANFD01_XIX_474088059: max-fc-wait=15, timeout-ar=1, timeout-as=1, tp-address=TA_0x1C42027B
      TPN_SACID_2_XIX_HCP5_CANFD01_XIX_474088079: max-fc-wait=15, timeout-ar=1, timeout-as=1, tp-address=TA_0x1C42028F
      TPN_SACID_2_XIX_HCP5_CANFD01_XIX_474088121: max-fc-wait=15, timeout-ar=1, timeout-as=1, tp-address=TA_0x1C4202B9
      TPN_SACID_2_XIX_HCP5_CANFD01_XIX_474349595: max-fc-wait=15, timeout-ar=1, timeout-as=1, tp-address=TA_0x1C46001B
      TPN_SACID_2_XIX_HCP5_CANFD01_XIX_474349596: max-fc-wait=15, timeout-ar=1, timeout-as=1, tp-address=TA_0x1C46001C
      TPN_SACID_2_XIX_HCP5_CANFD01_XIX_474349597: max-fc-wait=15, timeout-ar=1, timeout-as=1, tp-address=TA_0x1C46001D
      TPN_SACID_2_XIX_HCP5_CANFD01_XIX_474350107: max-fc-wait=15, timeout-ar=1, timeout-as=1, tp-address=TA_0x1C46021B
      TPN_SACID_2_XIX_HCP5_CANFD01_XIX_474350108: max-fc-wait=15, timeout-ar=1, timeout-as=1, tp-address=TA_0x1C46021C
      TPN_SACID_2_XIX_HCP5_CANFD01_XIX_474350109: max-fc-wait=15, timeout-ar=1, timeout-as=1, tp-address=TA_0x1C46021D
      TPN_Ladegeraet_XIX_HCP5_CANFD01_XIX_1966: max-fc-wait=15, timeout-ar=1, timeout-as=1, tp-address=TA_0x7AE
      TPN_Ladegeraet_XIX_HCP5_CANFD01_XIX_417018865: max-fc-wait=0, timeout-ar=0.025, timeout-as=0.025, tp-address=TA_0x18DB33F1
      TPN_Ladegeraet_XIX_HCP5_CANFD01_XIX_474087492: max-fc-wait=15, timeout-ar=1, timeout-as=1, tp-address=TA_0x1C420044
      TPN_Ladegeraet_XIX_HCP5_CANFD01_XIX_474087547: max-fc-wait=15, timeout-ar=1, timeout-as=1, tp-address=TA_0x1C42007B
      TPN_Ladegeraet_XIX_HCP5_CANFD01_XIX_474087567: max-fc-wait=15, timeout-ar=1, timeout-as=1, tp-address=TA_0x1C42008F
      TPN_Ladegeraet_XIX_HCP5_CANFD01_XIX_474087609: max-fc-wait=15, timeout-ar=1, timeout-as=1, tp-address=TA_0x1C4200B9
      TPN_Ladegeraet_XIX_HCP5_CANFD01_XIX_474088004: max-fc-wait=15, timeout-ar=1, timeout-as=1, tp-address=TA_0x1C420244
      TPN_Ladegeraet_XIX_HCP5_CANFD01_XIX_474088059: max-fc-wait=15, timeout-ar=1, timeout-as=1, tp-address=TA_0x1C42027B
      TPN_Ladegeraet_XIX_HCP5_CANFD01_XIX_474088079: max-fc-wait=15, timeout-ar=1, timeout-as=1, tp-address=TA_0x1C42028F
      TPN_Ladegeraet_XIX_HCP5_CANFD01_XIX_474088121: max-fc-wait=15, timeout-ar=1, timeout-as=1, tp-address=TA_0x1C4202B9
      TPN_Ladegeraet_XIX_HCP5_CANFD01_XIX_474349595: max-fc-wait=15, timeout-ar=1, timeout-as=1, tp-address=TA_0x1C46001B
      TPN_Ladegeraet_XIX_HCP5_CANFD01_XIX_474349596: max-fc-wait=15, timeout-ar=1, timeout-as=1, tp-address=TA_0x1C46001C
      TPN_Ladegeraet_XIX_HCP5_CANFD01_XIX_474349597: max-fc-wait=15, timeout-ar=1, timeout-as=1, tp-address=TA_0x1C46001D
      TPN_Ladegeraet_XIX_HCP5_CANFD01_XIX_474350107: max-fc-wait=15, timeout-ar=1, timeout-as=1, tp-address=TA_0x1C46021B
      TPN_Ladegeraet_XIX_HCP5_CANFD01_XIX_474350108: max-fc-wait=15, timeout-ar=1, timeout-as=1, tp-address=TA_0x1C46021C
      TPN_Ladegeraet_XIX_HCP5_CANFD01_XIX_474350109: max-fc-wait=15, timeout-ar=1, timeout-as=1, tp-address=TA_0x1C46021D
  can tp config CanTPConfig_BMC_CAN01: communication-cluster=BMC_CAN01, can-tp-ecu=BMC_HV
    14 x can tp address:
      TA_0x17FC16D0: tp-address=402396880
      TA_0x17FC17B1: tp-address=402397105
      TA_0x17FC17B2: tp-address=402397106
      TA_0x17FC70D0: tp-address=402419920
      TA_0x17FC71B1: tp-address=402420145
      TA_0x17FC71B2: tp-address=402420146
      TA_0x17FD0200: tp-address=402457088
      TA_0x17FE16D0: tp-address=402527952
      TA_0x17FE17B1: tp-address=402528177
      TA_0x17FE17B2: tp-address=402528178
      TA_0x17FE70D0: tp-address=402550992
      TA_0x17FE71B1: tp-address=402551217
      TA_0x17FE71B2: tp-address=402551218
      TA_0x700: tp-address=1792
    8 x can tp channel, all with channel-mode=HALF-DUPLEX-MODE:
      TPC_BMC_CAN01_XIX_TPCHType_CANHS_Flash_DIA_XIX_0x17FC16D0_XIX_0x17FE16D0_XIX_Physical: channel-id=693351486
      TPC_BMC_CAN01_XIX_TPCHType_CANHS_Flash_DIA_XIX_0x17FC17B1_XIX_0x17FE17B1_XIX_Physical: channel-id=591688770
      TPC_BMC_CAN01_XIX_TPCHType_CANHS_Flash_DIA_XIX_0x17FC17B2_XIX_0x17FE17B2_XIX_Physical: channel-id=779231842
      TPC_BMC_CAN01_XIX_TPCHType_CANHS_ISO_Diagnose_XIX_0x700_XIX_Functional: channel-id=1806909241
      TPC_BMC_CAN01_XIX_TPCHType_CANHS_OBDC_Diagnose_XIX_0x17FD0200_XIX_Functional: channel-id=1890032509
      TPC_BMC_CAN01_XIX_TPCHType_CANHS_OBDC_SSN_Diagnose_XIX_0x17FC70D0_XIX_0x17FE70D0_XIX_Physical: channel-id=1086309555
      TPC_BMC_CAN01_XIX_TPCHType_CANHS_OBDC_SSN_Diagnose_XIX_0x17FC71B1_XIX_0x17FE71B1_XIX_Physical: channel-id=1923617485
      TPC_BMC_CAN01_XIX_TPCHType_CANHS_OBDC_SSN_Diagnose_XIX_0x17FC71B2_XIX_0x17FE71B2_XIX_Physical: channel-id=1736074413
    can-tp-connection addressing-format=STANDARD, can-tp-channel=TPC_BMC_CAN01_XIX_TPCHType_CANHS_Flash_DIA_XIX_0x17FC16D0_XIX_0x17FE16D0_XIX_Physical, cancellation=true, data-pdu=DIA_BJB_Req_XIX_BMC_CAN01, flow-control-pdu=DIA_BJB_Resp_XIX_BMC_CAN01, max-block-size=15, padding-activation=true, receiver=TPN_BJB_XIX_BMC_CAN01_XIX_402527952, ta-type=PHYSICAL, timeout-br=0.1, timeout-bs=1, timeout-cr=1, timeout-cs=0.2, tp-sdu=DCM_BMC_CAN01_XIX_TPCHType_CANHS_Flash_DIA_XIX_0x17FC16D0_XIX_0x17FE16D0_XIX_Physical, transmitter=TPN_Hybrid_01_XIX_BMC_CAN01_XIX_402396880:
      ident TPCN_BMC_CAN01_XIX_TPCHType_CANHS_Flash_DIA_XIX_0x17FC16D0_Hybrid_01_XIX_0x17FE16D0_BJB_XIX_Physical
    can-tp-connection addressing-format=STANDARD, can-tp-channel=TPC_BMC_CAN01_XIX_TPCHType_CANHS_Flash_DIA_XIX_0x17FC17B1_XIX_0x17FE17B1_XIX_Physical, cancellation=true, data-pdu=DIA_UI2Sens01_Req_XIX_BMC_CAN01, flow-control-pdu=DIA_UI2Sens01_Resp_XIX_BMC_CAN01, max-block-size=15, padding-activation=true, receiver=TPN_UI2Sens01_XIX_BMC_CAN01_XIX_402528177, ta-type=PHYSICAL, timeout-br=0.1, timeout-bs=1, timeout-cr=1, timeout-cs=0.2, tp-sdu=DCM_BMC_CAN01_XIX_TPCHType_CANHS_Flash_DIA_XIX_0x17FC17B1_XIX_0x17FE17B1_XIX_Physical, transmitter=TPN_Hybrid_01_XIX_BMC_CAN01_XIX_402397105:
      ident TPCN_BMC_CAN01_XIX_TPCHType_CANHS_Flash_DIA_XIX_0x17FC17B1_Hybrid_01_XIX_0x17FE17B1_UI2Sens01_XIX_Physical
    can-tp-connection addressing-format=STANDARD, can-tp-channel=TPC_BMC_CAN01_XIX_TPCHType_CANHS_Flash_DIA_XIX_0x17FC17B2_XIX_0x17FE17B2_XIX_Physical, cancellation=true, data-pdu=DIA_UI2Sens02_Req_XIX_BMC_CAN01, flow-control-pdu=DIA_UI2Sens02_Resp_XIX_BMC_CAN01, max-block-size=15, padding-activation=true, receiver=TPN_UI2Sens02_XIX_BMC_CAN01_XIX_402528178, ta-type=PHYSICAL, timeout-br=0.1, timeout-bs=1, timeout-cr=1, timeout-cs=0.2, tp-sdu=DCM_BMC_CAN01_XIX_TPCHType_CANHS_Flash_DIA_XIX_0x17FC17B2_XIX_0x17FE17B2_XIX_Physical, transmitter=TPN_Hybrid_01_XIX_BMC_CAN01_XIX_402397106:
      ident TPCN_BMC_CAN01_XIX_TPCHType_CANHS_Flash_DIA_XIX_0x17FC17B2_Hybrid_01_XIX_0x17FE17B2_UI2Sens02_XIX_Physical
    can-tp-connection addressing-format=STANDARD, can-tp-channel=TPC_BMC_CAN01_XIX_TPCHType_CANHS_Flash_DIA_XIX_0x17FC16D0_XIX_0x17FE16D0_XIX_Physical, cancellation=true, data-pdu=DIA_BJB_Resp_XIX_BMC_CAN01, flow-control-pdu=DIA_BJB_Req_XIX_BMC_CAN01, max-block-size=15, padding-activation=true, receiver=TPN_Hybrid_01_XIX_BMC_CAN01_XIX_402396880, ta-type=PHYSICAL, timeout-br=0.1, timeout-bs=1, timeout-cr=1, timeout-cs=0.2, tp-sdu=DCM_BMC_CAN01_XIX_TPCHType_CANHS_Flash_DIA_XIX_0x17FE16D0_XIX_0x17FC16D0_XIX_Physical, transmitter=TPN_BJB_XIX_BMC_CAN01_XIX_402527952:
      ident TPCN_BMC_CAN01_XIX_TPCHType_CANHS_Flash_DIA_XIX_0x17FE16D0_BJB_XIX_0x17FC16D0_Hybrid_01_XIX_Physical
    can-tp-connection addressing-format=STANDARD, can-tp-channel=TPC_BMC_CAN01_XIX_TPCHType_CANHS_Flash_DIA_XIX_0x17FC17B1_XIX_0x17FE17B1_XIX_Physical, cancellation=true, data-pdu=DIA_UI2Sens01_Resp_XIX_BMC_CAN01, flow-control-pdu=DIA_UI2Sens01_Req_XIX_BMC_CAN01, max-block-size=15, padding-activation=true, receiver=TPN_Hybrid_01_XIX_BMC_CAN01_XIX_402397105, ta-type=PHYSICAL, timeout-br=0.1, timeout-bs=1, timeout-cr=1, timeout-cs=0.2, tp-sdu=DCM_BMC_CAN01_XIX_TPCHType_CANHS_Flash_DIA_XIX_0x17FE17B1_XIX_0x17FC17B1_XIX_Physical, transmitter=TPN_UI2Sens01_XIX_BMC_CAN01_XIX_402528177:
      ident TPCN_BMC_CAN01_XIX_TPCHType_CANHS_Flash_DIA_XIX_0x17FE17B1_UI2Sens01_XIX_0x17FC17B1_Hybrid_01_XIX_Physical
    can-tp-connection addressing-format=STANDARD, can-tp-channel=TPC_BMC_CAN01_XIX_TPCHType_CANHS_Flash_DIA_XIX_0x17FC17B2_XIX_0x17FE17B2_XIX_Physical, cancellation=true, data-pdu=DIA_UI2Sens02_Resp_XIX_BMC_CAN01, flow-control-pdu=DIA_UI2Sens02_Req_XIX_BMC_CAN01, max-block-size=15, padding-activation=true, receiver=TPN_Hybrid_01_XIX_BMC_CAN01_XIX_402397106, ta-type=PHYSICAL, timeout-br=0.1, timeout-bs=1, timeout-cr=1, timeout-cs=0.2, tp-sdu=DCM_BMC_CAN01_XIX_TPCHType_CANHS_Flash_DIA_XIX_0x17FE17B2_XIX_0x17FC17B2_XIX_Physical, transmitter=TPN_UI2Sens02_XIX_BMC_CAN01_XIX_402528178:
      ident TPCN_BMC_CAN01_XIX_TPCHType_CANHS_Flash_DIA_XIX_0x17FE17B2_UI2Sens02_XIX_0x17FC17B2_Hybrid_01_XIX_Physical
    can-tp-connection addressing-format=STANDARD, can-tp-channel=TPC_BMC_CAN01_XIX_TPCHType_CANHS_ISO_Diagnose_XIX_0x700_XIX_Functional, cancellation=true, data-pdu=ISO_Funktionaler_Req_All_XIX_BMC_CAN01, max-block-size=15, multicast=CanTPConfig_BMC_CAN01/TA_0x700, padding-activation=true, receiver=[TPN_BJB_XIX_BMC_CAN01_XIX_402527952, TPN_BJB_XIX_BMC_CAN01_XIX_402528177, TPN_BJB_XIX_BMC_CAN01_XIX_402528178, TPN_UI2Sens01_XIX_BMC_CAN01_XIX_402527952, TPN_UI2Sens01_XIX_BMC_CAN01_XIX_402528177, TPN_UI2Sens01_XIX_BMC_CAN01_XIX_402528178, TPN_UI2Sens02_XIX_BMC_CAN01_XIX_402527952, TPN_UI2Sens02_XIX_BMC_CAN01_XIX_402528177, TPN_UI2Sens02_XIX_BMC_CAN01_XIX_402528178], ta-type=FUNCTIONAL, timeout-br=0.1, timeout-bs=1, timeout-cr=1, timeout-cs=0.2, tp-sdu=DCM_BMC_CAN01_XIX_TPCHType_CANHS_ISO_Diagnose_XIX_0x700_XIX_Functional, transmitter=TPN_Hybrid_01_XIX_BMC_CAN01_XIX_1792:
      ident TPCN_BMC_CAN01_XIX_TPCHType_CANHS_ISO_Diagnose_XIX_0x700_Hybrid_01_XIX_Functional
    can-tp-connection addressing-format=STANDARD, can-tp-channel=TPC_BMC_CAN01_XIX_TPCHType_CANHS_OBDC_Diagnose_XIX_0x17FD0200_XIX_Functional, cancellation=true, data-pdu=OBDC_Funktionaler_Req_All_XIX_BMC_CAN01, max-block-size=15, multicast=TA_0x17FD0200, padding-activation=true, receiver=[TPN_BJB_XIX_BMC_CAN01_XIX_402550992, TPN_BJB_XIX_BMC_CAN01_XIX_402551217, TPN_BJB_XIX_BMC_CAN01_XIX_402551218, TPN_UI2Sens01_XIX_BMC_CAN01_XIX_402550992, TPN_UI2Sens01_XIX_BMC_CAN01_XIX_402551217, TPN_UI2Sens01_XIX_BMC_CAN01_XIX_402551218, TPN_UI2Sens02_XIX_BMC_CAN01_XIX_402550992, TPN_UI2Sens02_XIX_BMC_CAN01_XIX_402551217, TPN_UI2Sens02_XIX_BMC_CAN01_XIX_402551218], ta-type=FUNCTIONAL, timeout-br=0.1, timeout-bs=1, timeout-cr=1, timeout-cs=0.2, tp-sdu=DCM_BMC_CAN01_XIX_TPCHType_CANHS_OBDC_Diagnose_XIX_0x17FD0200_XIX_Functional, transmitter=TPN_Hybrid_01_XIX_BMC_CAN01_XIX_402457088:
      ident TPCN_BMC_CAN01_XIX_TPCHType_CANHS_OBDC_Diagnose_XIX_0x17FD0200_Hybrid_01_XIX_Functional
    can-tp-connection addressing-format=STANDARD, can-tp-channel=TPC_BMC_CAN01_XIX_TPCHType_CANHS_OBDC_SSN_Diagnose_XIX_0x17FC70D0_XIX_0x17FE70D0_XIX_Physical, cancellation=true, data-pdu=OBDC_SSN_BJB_Req_XIX_BMC_CAN01, flow-control-pdu=OBDC_SSN_BJB_Resp_XIX_BMC_CAN01, max-block-size=15, padding-activation=true, receiver=TPN_BJB_XIX_BMC_CAN01_XIX_402550992, ta-type=PHYSICAL, timeout-br=0.1, timeout-bs=1, timeout-cr=1, timeout-cs=0.2, tp-sdu=DCM_BMC_CAN01_XIX_TPCHType_CANHS_OBDC_SSN_Diagnose_XIX_0x17FC70D0_XIX_0x17FE70D0_XIX_Physical, transmitter=TPN_Hybrid_01_XIX_BMC_CAN01_XIX_402419920:
      ident TPCN_BMC_CAN01_XIX_TPCHType_CANHS_OBDC_SSN_Diagnose_XIX_0x17FC70D0_Hybrid_01_XIX_0x17FE70D0_BJB_XIX_Physical
    can-tp-connection addressing-format=STANDARD, can-tp-channel=TPC_BMC_CAN01_XIX_TPCHType_CANHS_OBDC_SSN_Diagnose_XIX_0x17FC71B1_XIX_0x17FE71B1_XIX_Physical, cancellation=true, data-pdu=OBDC_SSN_UI2Sens01_Req_XIX_BMC_CAN01, flow-control-pdu=OBDC_SSN_UI2Sens01_Resp_XIX_BMC_CAN01, max-block-size=15, padding-activation=true, receiver=TPN_UI2Sens01_XIX_BMC_CAN01_XIX_402551217, ta-type=PHYSICAL, timeout-br=0.1, timeout-bs=1, timeout-cr=1, timeout-cs=0.2, tp-sdu=DCM_BMC_CAN01_XIX_TPCHType_CANHS_OBDC_SSN_Diagnose_XIX_0x17FC71B1_XIX_0x17FE71B1_XIX_Physical, transmitter=TPN_Hybrid_01_XIX_BMC_CAN01_XIX_402420145:
      ident TPCN_BMC_CAN01_XIX_TPCHType_CANHS_OBDC_SSN_Diagnose_XIX_0x17FC71B1_Hybrid_01_XIX_0x17FE71B1_UI2Sens01_XIX_Physical
    can-tp-connection addressing-format=STANDARD, can-tp-channel=TPC_BMC_CAN01_XIX_TPCHType_CANHS_OBDC_SSN_Diagnose_XIX_0x17FC71B2_XIX_0x17FE71B2_XIX_Physical, cancellation=true, data-pdu=OBDC_SSN_UI2Sens02_Req_XIX_BMC_CAN01, flow-control-pdu=OBDC_SSN_UI2Sens02_Resp_XIX_BMC_CAN01, max-block-size=15, padding-activation=true, receiver=TPN_UI2Sens02_XIX_BMC_CAN01_XIX_402551218, ta-type=PHYSICAL, timeout-br=0.1, timeout-bs=1, timeout-cr=1, timeout-cs=0.2, tp-sdu=DCM_BMC_CAN01_XIX_TPCHType_CANHS_OBDC_SSN_Diagnose_XIX_0x17FC71B2_XIX_0x17FE71B2_XIX_Physical, transmitter=TPN_Hybrid_01_XIX_BMC_CAN01_XIX_402420146:
      ident TPCN_BMC_CAN01_XIX_TPCHType_CANHS_OBDC_SSN_Diagnose_XIX_0x17FC71B2_Hybrid_01_XIX_0x17FE71B2_UI2Sens02_XIX_Physical
    can-tp-connection addressing-format=STANDARD, can-tp-channel=TPC_BMC_CAN01_XIX_TPCHType_CANHS_OBDC_SSN_Diagnose_XIX_0x17FC70D0_XIX_0x17FE70D0_XIX_Physical, cancellation=true, data-pdu=OBDC_SSN_BJB_Resp_XIX_BMC_CAN01, flow-control-pdu=OBDC_SSN_BJB_Req_XIX_BMC_CAN01, max-block-size=15, padding-activation=true, receiver=TPN_Hybrid_01_XIX_BMC_CAN01_XIX_402419920, ta-type=PHYSICAL, timeout-br=0.1, timeout-bs=1, timeout-cr=1, timeout-cs=0.2, tp-sdu=DCM_BMC_CAN01_XIX_TPCHType_CANHS_OBDC_SSN_Diagnose_XIX_0x17FE70D0_XIX_0x17FC70D0_XIX_Physical, transmitter=TPN_BJB_XIX_BMC_CAN01_XIX_402550992:
      ident TPCN_BMC_CAN01_XIX_TPCHType_CANHS_OBDC_SSN_Diagnose_XIX_0x17FE70D0_BJB_XIX_0x17FC70D0_Hybrid_01_XIX_Physical
    can-tp-connection addressing-format=STANDARD, can-tp-channel=TPC_BMC_CAN01_XIX_TPCHType_CANHS_OBDC_SSN_Diagnose_XIX_0x17FC71B1_XIX_0x17FE71B1_XIX_Physical, cancellation=true, data-pdu=OBDC_SSN_UI2Sens01_Resp_XIX_BMC_CAN01, flow-control-pdu=OBDC_SSN_UI2Sens01_Req_XIX_BMC_CAN01, max-block-size=15, padding-activation=true, receiver=TPN_Hybrid_01_XIX_BMC_CAN01_XIX_402420145, ta-type=PHYSICAL, timeout-br=0.1, timeout-bs=1, timeout-cr=1, timeout-cs=0.2, tp-sdu=DCM_BMC_CAN01_XIX_TPCHType_CANHS_OBDC_SSN_Diagnose_XIX_0x17FE71B1_XIX_0x17FC71B1_XIX_Physical, transmitter=TPN_UI2Sens01_XIX_BMC_CAN01_XIX_402551217:
      ident TPCN_BMC_CAN01_XIX_TPCHType_CANHS_OBDC_SSN_Diagnose_XIX_0x17FE71B1_UI2Sens01_XIX_0x17FC71B1_Hybrid_01_XIX_Physical
    can-tp-connection addressing-format=STANDARD, can-tp-channel=TPC_BMC_CAN01_XIX_TPCHType_CANHS_OBDC_SSN_Diagnose_XIX_0x17FC71B2_XIX_0x17FE71B2_XIX_Physical, cancellation=true, data-pdu=OBDC_SSN_UI2Sens02_Resp_XIX_BMC_CAN01, flow-control-pdu=OBDC_SSN_UI2Sens02_Req_XIX_BMC_CAN01, max-block-size=15, padding-activation=true, receiver=TPN_Hybrid_01_XIX_BMC_CAN01_XIX_402420146, ta-type=PHYSICAL, timeout-br=0.1, timeout-bs=1, timeout-cr=1, timeout-cs=0.2, tp-sdu=DCM_BMC_CAN01_XIX_TPCHType_CANHS_OBDC_SSN_Diagnose_XIX_0x17FE71B2_XIX_0x17FC71B2_XIX_Physical, transmitter=TPN_UI2Sens02_XIX_BMC_CAN01_XIX_402551218:
      ident TPCN_BMC_CAN01_XIX_TPCHType_CANHS_OBDC_SSN_Diagnose_XIX_0x17FE71B2_UI2Sens02_XIX_0x17FC71B2_Hybrid_01_XIX_Physical
    26 x can tp node, all with max-fc-wait=15, st-min=0.005, timeout-ar=1, timeout-as=1:
      TPN_BJB_XIX_BMC_CAN01_XIX_402527952: tp-address=CanTPConfig_BMC_CAN01/TA_0x17FE16D0
      TPN_BJB_XIX_BMC_CAN01_XIX_402528177: tp-address=CanTPConfig_BMC_CAN01/TA_0x17FE17B1
      TPN_BJB_XIX_BMC_CAN01_XIX_402528178: tp-address=CanTPConfig_BMC_CAN01/TA_0x17FE17B2
      TPN_BJB_XIX_BMC_CAN01_XIX_402550992: tp-address=CanTPConfig_BMC_CAN01/TA_0x17FE70D0
      TPN_BJB_XIX_BMC_CAN01_XIX_402551217: tp-address=CanTPConfig_BMC_CAN01/TA_0x17FE71B1
      TPN_BJB_XIX_BMC_CAN01_XIX_402551218: tp-address=CanTPConfig_BMC_CAN01/TA_0x17FE71B2
      TPN_Hybrid_01_XIX_BMC_CAN01_XIX_1792: connector=CN_BMC_CAN01, tp-address=CanTPConfig_BMC_CAN01/TA_0x700
      TPN_Hybrid_01_XIX_BMC_CAN01_XIX_402396880: connector=CN_BMC_CAN01, tp-address=CanTPConfig_BMC_CAN01/TA_0x17FC16D0
      TPN_Hybrid_01_XIX_BMC_CAN01_XIX_402397105: connector=CN_BMC_CAN01, tp-address=CanTPConfig_BMC_CAN01/TA_0x17FC17B1
      TPN_Hybrid_01_XIX_BMC_CAN01_XIX_402397106: connector=CN_BMC_CAN01, tp-address=CanTPConfig_BMC_CAN01/TA_0x17FC17B2
      TPN_Hybrid_01_XIX_BMC_CAN01_XIX_402419920: connector=CN_BMC_CAN01, tp-address=CanTPConfig_BMC_CAN01/TA_0x17FC70D0
      TPN_Hybrid_01_XIX_BMC_CAN01_XIX_402420145: connector=CN_BMC_CAN01, tp-address=CanTPConfig_BMC_CAN01/TA_0x17FC71B1
      TPN_Hybrid_01_XIX_BMC_CAN01_XIX_402420146: connector=CN_BMC_CAN01, tp-address=CanTPConfig_BMC_CAN01/TA_0x17FC71B2
      TPN_Hybrid_01_XIX_BMC_CAN01_XIX_402457088: connector=CN_BMC_CAN01, tp-address=TA_0x17FD0200
      TPN_UI2Sens01_XIX_BMC_CAN01_XIX_402527952: tp-address=CanTPConfig_BMC_CAN01/TA_0x17FE16D0
      TPN_UI2Sens01_XIX_BMC_CAN01_XIX_402528177: tp-address=CanTPConfig_BMC_CAN01/TA_0x17FE17B1
      TPN_UI2Sens01_XIX_BMC_CAN01_XIX_402528178: tp-address=CanTPConfig_BMC_CAN01/TA_0x17FE17B2
      TPN_UI2Sens01_XIX_BMC_CAN01_XIX_402550992: tp-address=CanTPConfig_BMC_CAN01/TA_0x17FE70D0
      TPN_UI2Sens01_XIX_BMC_CAN01_XIX_402551217: tp-address=CanTPConfig_BMC_CAN01/TA_0x17FE71B1
      TPN_UI2Sens01_XIX_BMC_CAN01_XIX_402551218: tp-address=CanTPConfig_BMC_CAN01/TA_0x17FE71B2
      TPN_UI2Sens02_XIX_BMC_CAN01_XIX_402527952: tp-address=CanTPConfig_BMC_CAN01/TA_0x17FE16D0
      TPN_UI2Sens02_XIX_BMC_CAN01_XIX_402528177: tp-address=CanTPConfig_BMC_CAN01/TA_0x17FE17B1
      TPN_UI2Sens02_XIX_BMC_CAN01_XIX_402528178: tp-address=CanTPConfig_BMC_CAN01/TA_0x17FE17B2
      TPN_UI2Sens02_XIX_BMC_CAN01_XIX_402550992: tp-address=CanTPConfig_BMC_CAN01/TA_0x17FE70D0
      TPN_UI2Sens02_XIX_BMC_CAN01_XIX_402551217: tp-address=CanTPConfig_BMC_CAN01/TA_0x17FE71B1
      TPN_UI2Sens02_XIX_BMC_CAN01_XIX_402551218: tp-address=CanTPConfig_BMC_CAN01/TA_0x17FE71B2
package /SecureCommunication
  secure communication props set SecureCommunicationPropsSet
    secure communication authentication props SecureCommunicationAuthenticationProps_XIX_32: category=VW_PROFILE, auth-algorithm=SipHash24, auth-info-tx-length=32
    secure communication authentication props SecureCommunicationAuthenticationProps_Aes128_XIX_32: category=VW_PROFILE, auth-algorithm=AES128, auth-info-tx-length=32
    secure communication authentication props SecureCommunicationAuthenticationProps_XIX_64: category=VW_PROFILE, auth-algorithm=SipHash24, auth-info-tx-length=64
    secure communication freshness props SecureCommunicationFreshnessProps: category=VW_PROFILE, freshness-value-length=64, freshness-value-tx-length=0
package /DiagnosticServices
  5 x diagnostic connection:
    DC_BMC_HV_XIX_TPCHType_CANFD_ISO_Diagnose: functional-request=TPCN_HCP5_CANFD01_XIX_TPCHType_CANFD_ISO_Diagnose_XIX_0x1C410000_Gateway_XIX_Functional, physical-request=TPCN_HCP5_CANFD01_XIX_TPCHType_CANFD_ISO_Diagnose_XIX_0x1C40007B_Gateway_XIX_0x1C42007B_Hybrid_01_XIX_Physical, response=TPCN_HCP5_CANFD01_XIX_TPCHType_CANFD_ISO_Diagnose_XIX_0x1C42007B_Hybrid_01_XIX_0x1C40007B_Gateway_XIX_Physical
    DC_BMC_HV_XIX_TPCHType_CANFD_OBDC_Diagnose: functional-request=TPCN_HCP5_CANFD01_XIX_TPCHType_CANFD_OBDC_Diagnose_XIX_0x1C410200_Gateway_XIX_Functional, physical-request=TPCN_HCP5_CANFD01_XIX_TPCHType_CANFD_OBDC_Diagnose_XIX_0x1C40027B_Gateway_XIX_0x1C42027B_Hybrid_01_XIX_Physical, response=TPCN_HCP5_CANFD01_XIX_TPCHType_CANFD_OBDC_Diagnose_XIX_0x1C42027B_Hybrid_01_XIX_0x1C40027B_Gateway_XIX_Physical
    DC_BMC_HV_XIX_TPCHType_CANHS_ISO_Diagnose:
      functional-request=[TPCN_BMC_CAN01_XIX_TPCHType_CANHS_ISO_Diagnose_XIX_0x700_Hybrid_01_XIX_Functional, TPCN_HCP5_CANFD01_XIX_TPCHType_CANHS_ISO_Diagnose_XIX_0x700_Gateway_XIX_Functional]
      physical-request=TPCN_HCP5_CANFD01_XIX_TPCHType_CANHS_ISO_Diagnose_XIX_0x17FC007B_Gateway_XIX_0x17FE007B_Hybrid_01_XIX_Physical
      response=TPCN_HCP5_CANFD01_XIX_TPCHType_CANHS_ISO_Diagnose_XIX_0x17FE007B_Hybrid_01_XIX_0x17FC007B_Gateway_XIX_Physical
    DC_BMC_HV_XIX_TPCHType_CANHS_OBDC_Diagnose: functional-request=TPCN_BMC_CAN01_XIX_TPCHType_CANHS_OBDC_Diagnose_XIX_0x17FD0200_Hybrid_01_XIX_Functional
    DC_BMC_HV_XIX_TPCHType_CANHS_OBDx: functional-request=TPCN_HCP5_CANFD01_XIX_TPCHType_CANHS_OBDx_XIX_0x18DB33F1_Gateway_XIX_Functional, physical-request=TPCN_HCP5_CANFD01_XIX_TPCHType_CANHS_OBDx_XIX_0x18DA05F1_Gateway_XIX_0x18DAF105_Hybrid_01_XIX_Physical, response=TPCN_HCP5_CANFD01_XIX_TPCHType_CANHS_OBDx_XIX_0x18DAF105_Hybrid_01_XIX_0x18DA05F1_Gateway_XIX_Physical
  diagnostic service table DST_BMC_HV: ecu-instance=BMC_HV
    diagnostic-connections:
      DC_BMC_HV_XIX_TPCHType_CANFD_ISO_Diagnose
      DC_BMC_HV_XIX_TPCHType_CANFD_OBDC_Diagnose
      DC_BMC_HV_XIX_TPCHType_CANHS_ISO_Diagnose
      DC_BMC_HV_XIX_TPCHType_CANHS_OBDC_Diagnose
      DC_BMC_HV_XIX_TPCHType_CANHS_OBDx
package /VectorAutosarExplorerGeneratedObjects/PDUS
  pdu Vishnu_Tx_NewPDU: length=8
    signal Vishnu_Tx_NewPDU_NewSignal: start 0, 8 bit, little-endian, system signal Vishnu_Tx_NewPDU_NewSignal_b2a9561a2fc7631b, data-type-policy=OVERRIDE, base-type=uint16
  pdu Vishnu_Test_100Bytes_PDU: length=64
    signal Vishnu_Test_100Bytes_PDU_NewSignal1: start 0, 20 bit, little-endian, system signal Vishnu_Test_100Bytes_PDU_NewSignal1_37542d23452fe910, data-type-policy=OVERRIDE, base-type=BT_AB_Abschaltanf_SIH_BF
    signal Vishnu_Test_100Bytes_PDU_NewSignal2: start 20, 20 bit, little-endian, system signal Vishnu_Test_100Bytes_PDU_NewSignal2_302017e93d94206c, data-type-policy=OVERRIDE, base-type=BT_AB_Abschaltanf_SIH_BF
    signal Vishnu_Test_100Bytes_PDU_NewSignal3: start 40, 20 bit, little-endian, system signal Vishnu_Test_100Bytes_PDU_NewSignal3_ebd34b418955d5b1, data-type-policy=OVERRIDE, base-type=BT_AB_Abschaltanf_SIH_BF
    signal Vishnu_Test_100Bytes_PDU_NewSignal4: start 60, 20 bit, little-endian, system signal Vishnu_Test_100Bytes_PDU_NewSignal4_21c239f862026de9, data-type-policy=OVERRIDE, base-type=BT_AB_Abschaltanf_SIH_BF
  pdu DTC_Test_PDU: length=8
    signal DTC_Test_PDU_Set_Signal: start 0, 8 bit, little-endian, system signal DTC_Test_PDU_Set_Signal_e68158b3301efab7, data-type-policy=OVERRIDE, base-type=BT_AB_Abschaltanf_SIH_BF, to BMC_HV
package /VectorAutosarExplorerGeneratedObjects/I_SIGNALS
  i signal Vishnu_Test_100Bytes_PDU_NewSignal5: data-type-policy=OVERRIDE, length=20, base-type=BT_AB_Abschaltanf_SIH_BF, system-signal=Vishnu_Test_100Bytes_PDU_NewSignal5_2a9e79b5a4a81ebd
package /VectorAutosarExplorerGeneratedObjects/FRAME
  can frame Vishnu_Tx: frame-length=8
    pdu to frame mapping PduToFrameMapping_2f2a0eeaacd55b6e: packing-byte-order=little-endian, pdu=Vishnu_Tx_NewPDU, start-position=0
  can frame Vishnu_Test_100Bytes: frame-length=64
    pdu to frame mapping PduToFrameMapping_02a90956f5ef4e4b: packing-byte-order=little-endian, pdu=Vishnu_Test_100Bytes_PDU, start-position=0
  can frame DTC_Test: frame-length=8
    pdu to frame mapping PduToFrameMapping_78da95e682b0bf29: packing-byte-order=little-endian, pdu=DTC_Test_PDU, start-position=0
package /VectorAutosarExplorerGeneratedObjects/SYSTEM_SIGNALS
  system signal Vishnu_Test_100Bytes_PDU_NewSignal5_2a9e79b5a4a81ebd
package /VectorAutosarExplorerGeneratedObjects/PDU_GROUP
  i signal i pdu group PduGroup_afac5c56b3b64c7983bb0f7ebfc92c5a_Tx: communication-direction=OUT
  i signal i pdu group PduGroup_7d6a32fb6b5340f18c0d3a0826764630_Tx: communication-direction=OUT
  i signal i pdu group PduGroup_bd14174e250b400999f7534078763f9f_Rx: communication-direction=IN
