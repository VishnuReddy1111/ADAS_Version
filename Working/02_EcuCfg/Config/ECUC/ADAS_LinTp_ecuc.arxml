AUTOSAR XML (schema 00048)
package /ActiveEcuC
  module config LinTp: implementation-config-variant=VARIANT-PRE-COMPILE, module-description=LinTp_Impl
    LinTpGlobalConfig: LinTpMaxNumberOfRespPendingFrames=3, LinTpNumberOfRxNSdu=2, LinTpNumberOfTxNSdu=3
      MasterReq_oLIN00_4a2bb011_Tx (LinTpTxNSdu): LinTpTxNSduNad=126, LinTpNas=0.1, LinTpTxNSduId=2, LinTpTxNSduChannelRef=CHNL_45618847, LinTpTxNSduPduRef=MasterReq_oLIN00_3234fe1b_Tx
      CHNL_45618847 (LinTpChannelConfig): LinTpDropNotRequestedNad=false, LinTpScheduleChangeDiag=true, LinTpP2Max=1.5, LinTpP2Timing=0.1, LinTpChannelRef=CHNL_45618847
      SlaveResp_Slave1_oLIN00_d5a41af0_Rx (LinTpRxNSdu):
        LinTpDl = 8
        LinTpRxNSduNad = 1
        LinTpRxNSduId = 0
        LinTpNcr = 0.15
        LinTpRxNSduChannelRef = CHNL_45618847
        LinTpRxNSduPduRef = SlaveResp_Slave1_oLIN00_82073045_Rx
      MasterReq_Slave1_oLIN00_e6eafa53_Tx (LinTpTxNSdu):
        LinTpTxNSduNad = 1
        LinTpNas = 0.1
        LinTpTxNSduId = 0
        LinTpNcs = 0.15
        LinTpTxNSduChannelRef = CHNL_45618847
        LinTpTxNSduPduRef = MasterReq_Slave1_oLIN00_7e4a8d3d_Tx
      MasterReq_Slave3_oLIN00_a4cffd2e_Tx (LinTpTxNSdu):
        LinTpTxNSduNad = 3
        LinTpNas = 0.1
        LinTpTxNSduId = 1
        LinTpNcs = 0.15
        LinTpTxNSduChannelRef = CHNL_45618847
        LinTpTxNSduPduRef = MasterReq_Slave3_oLIN00_93dc5ed4_Tx
      SlaveResp_Slave3_oLIN00_97811d8d_Rx (LinTpRxNSdu):
        LinTpDl = 8
        LinTpRxNSduNad = 3
        LinTpRxNSduId = 1
        LinTpNcr = 0.15
        LinTpRxNSduChannelRef = CHNL_45618847
        LinTpRxNSduPduRef = SlaveResp_Slave3_oLIN00_6f91e3ac_Rx
    LinTpGeneral:
      LinTpFunctionalRequestsSupported = true
      LinTpVersionInfoApi = true
      LinTpForwardRespPendingFrames = true
      LinTpRuntimeMeasurementSupport = true
      LinTpBroadcastRequestHandling = false
      LinTpMetaDataSupport = false
