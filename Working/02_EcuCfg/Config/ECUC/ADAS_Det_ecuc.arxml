AUTOSAR XML (schema 4-3-0)
package /ActiveEcuC
  module config Det: implementation-config-variant=VARIANT-PRE-COMPILE, module-description=Det_Impl
    DetGeneral:
      DetVersionInfoApi = true
      DetEnableDet = true
      DetExtDebugSupport = true
      DetGlobalFilterSize = 4
      DetBreakFilterSize = 0
      DetLogBufferSize = 0
      DetReportErrorRecursionLimit = 0
      DetReportRuntimeErrorRecursionLimit = 0
      DetReportTransientFaultRecursionLimit = 0
      DetDltFilterSize = 0
    DetConfigSet
    DetNotification: DetErrorHook=Demo_DetErrorHook
