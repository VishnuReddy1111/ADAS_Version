AUTOSAR XML (schema 4-3-0)
package /ActiveEcuC
  module config Xcp: implementation-config-variant=VARIANT-PRE-COMPILE, module-description=Xcp_Impl
    XcpCmdConfig: XcpOpenCommandInterface=false
      XcpStandard:
        XcpBlockUpload = false
        XcpCommunicationModeInfo = true
        XcpGetIdGeneric = false
        XcpMemoryReadProtection = false
        XcpSeedKey = false
        XcpUserDefinedCommand = false
      XcpAsynchMessage: XcpEventCodes=false, XcpServiceRequestMessage=false
      XcpDaqAndStim:
        XcpFixedTimestamp = false
        XcpGetDAQEventInfo = true
        XcpMaxNumberOfOdtDaq = 18
        XcpMaxNumberOfOdtEntries = 36
        XcpMaxNumberOfOdtStim = 18
        XcpOverrunIndication = true
        XcpResolutionInfo = true
        XcpResumeMode = false
        XcpSynchronousDataStimulation = true
        XcpWriteDAQMultiple = false
        XcpDAQMessageHeader = ODT
        XcpComplementaryDAQ = false
      XcpCalibration: XcpBlockDownload=true, XcpMIN_STForBlockDownload=0, XcpModifyBits=false, XcpShortDownload=true
    XcpGeneral:
      XcpDevErrorDetect = true
      XcpMainFunctionPeriod = 0.005
      XcpMaxEventChannel = 255
      XcpOnCanEnabled = true
      XcpOnCddEnabled = false
      XcpOnEthernetEnabled = false
      XcpOnFlexRayEnabled = false
      XcpPrescalerSupported = false
      XcpVersionInfoApi = true
      XcpBootloaderDownload = false
      XcpControl = false
      XcpMultiClientSupport = true
      XcpRuntimeMeasurementSupport = true
      XcpSafeBswChecks = false
      XcpSessionStatusAPI = false
      XcpTypeSafeCopy = false
      XcpDAQMemAccessByApplication = false
      XcpA2L:
        XcpTimeoutT1 = 2000
        XcpTimeoutT2 = 10000
        XcpTimeoutT{3..6} = 2000
        XcpTimeoutT7 = 0
        XcpOnFrFibex = FlexRay
        XcpOnFrClusterId = 0
    XcpConfig
      XcpTransportLayer
        XcpOnCan:
          XcpOnCanMaxCto = 8
          XcpOnCanMaxDto = 8
          XcpOnCanConfirmationTimeout = 10
          XcpOnCanMultiConnectionProtection = false
          XcpOnCanVariableDlc = false
          XcpPduMode = false
      XcpEventChannel_StartApplication (XcpEventChannel):
        XcpEventChannelMaxDaqList = 1
        XcpEventChannelNumber = 15
        XcpEventChannelTimeCycle = 250
        XcpEventChannelTimeUnit = TIMESTAMP_UNIT_1MS
        XcpEventChannelType = DAQ_STIM
        XcpEventChannelCoreRef = XcpCoreDefinition
      XcpCoreDefinition: XcpSendQueueSize=256
      15 x XcpEventChannel, all with XcpEventChannelMaxDaqList=1, XcpEventChannelTimeCycle=0, XcpEventChannelTimeUnit=TIMESTAMP_UNIT_1MS, XcpEventChannelType=DAQ, XcpEventChannelCoreRef=XcpCoreDefinition:
        Rtm_Evt: XcpEventChannelNumber=13
        Dbg_EvtIdleTask_OsCore0: XcpEventChannelNumber=8
        Dbg_EvtDefault_Appl_Init_Task: XcpEventChannelNumber=2
        Dbg_EvtDefault_BSW_Sync_Task: XcpEventChannelNumber=5
        Dbg_EvtDefault_Init_Task: XcpEventChannelNumber=6
        Dbg_EvtDefault_Appl_Task: XcpEventChannelNumber=3
        Dbg_EvtDefault_BSW_Async_Task: XcpEventChannelNumber=4
        Dbg_EvtDefault_RTE_Mode_switch_Task: XcpEventChannelNumber=7
        Dbg_EvtCounterIsr_SystemTimer: XcpEventChannelNumber=1
        XcpEventChannel_Firewall: XcpEventChannelNumber=14
        Dbg_EvtStartApplication_Appl_Task: XcpEventChannelNumber=10
        Dbg_EvtStartApplication_Appl_Init_Task: XcpEventChannelNumber=9
        Dbg_EvtStartApplication_NoSwc_Appl_Task: XcpEventChannelNumber=11
        Dbg_EvtStartApplication_NoSwc_Init_Task: XcpEventChannelNumber=12
        Dbg_EvtBswBackgroundTask: XcpEventChannelNumber=0  # /ActiveEcuC/Dbg PLAIN_TEXT XcpEventChannel for DbgStaticDID BswBackgroundTask
      XCP_Hybrid_01_CRO_01_FD_XIX_HCP5_CANFD01_f21b8ba9_Rx (XcpPdu)
        XCP_Hybrid_01_CRO_01_FD_XIX_HCP5_CANFD01_f21b8ba9_Rx (XcpRxPdu):
          XcpRxPduId = 0
          XcpRxPduRef = XCP_Hybrid_01_CRO_01_FD_XIX_HCP5_CANFD01_f21b8ba9_Rx
          XcpTxPduContRef = XCP_Hybrid_01_DTO_01_FD_XIX_HCP5_CANFD01_ee6930a2_Tx/XCP_Hybrid_01_DTO_01_FD_XIX_HCP5_CANFD01_ee6930a2_Tx
      XCP_Hybrid_01_DTO_01_FD_XIX_HCP5_CANFD01_ee6930a2_Tx (XcpPdu)
        XCP_Hybrid_01_DTO_01_FD_XIX_HCP5_CANFD01_ee6930a2_Tx (XcpTxPdu): XcpTxPduId=0, XcpTxPduRef=XCP_Hybrid_01_DTO_01_FD_XIX_HCP5_CANFD01_ee6930a2_Tx
