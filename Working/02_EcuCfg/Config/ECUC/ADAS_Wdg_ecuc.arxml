AUTOSAR XML (schema 4-3-0)
package /ActiveEcuC
  module config Wdg: implementation-config-variant=VARIANT-POST-BUILD, module-description=Wdg_Impl
    WdgGeneral:
      WdgDevErrorDetect = true
      WdgDisableAllowed = true
      WdgIndex = 0
      WdgInitialTimeout = 5
      WdgVersionInfoApi = true
      WdgMaxTimeout = 32
      WdgRunArea = ROM
      WdgTriggerLocation = NULL_PTR
      WdgSafetyEnable = true
      WdgInitCheckApi = false
      WdgTriggerTimerSelection = GTM_TIMER
      WdgInitApiMode = WDG_MCAL_SUPERVISOR
      WdgRuntimeApiMode = WDG_MCAL_SUPERVISOR
    WdgPublishedInformation: WdgTriggerMode=WDG_WINDOW
    WdgSettingsConfig_Core0 (WdgSettingsConfig):
      WdgDefaultMode = WDGIF_OFF_MODE
      WdgCoreId = 0
      WdgCPUDisableAllowed = true
      WdgCPUInitialTimeout = 5
      WdgCPUMaxTimeout = 32
      WdgCPUInitialPassword = 60
      WdgSystemClockRef = McuClockReferencePointConfig
      WdgSettingsFast: WdgFastModeTimeoutValue=0.01
      WdgSettingsOff
      WdgSettingsSlow: WdgSlowModeTimeoutValue=0.02
      WdgTriggerTimerSetting: WdgSlowRefreshTime=0.015, WdgFastRefreshTime=0.007
        GtmTimerConfiguration
          GtmTimerOutputModuleConfiguration: GtmTimerClockSelect=GTM_CONFIGURABLE_CLOCK_0, GtmTimerUsed=McuGtmAtomChannelAllocationConf_0
    WdgDemEventParameterRefs: WDG_E_MODE_FAILED=AutoCreatedDemEvent_WDG_E_MODE_FAILED, WDG_E_DISABLE_REJECTED=AutoCreatedDemEvent_WDG_E_DISABLE_REJECTED
    CommonPublishedInformation:
      ArMajorVersion = 4
      ArMinorVersion = 4
      ArPatchVersion = 0
      SwMajorVersion = 20
      SwMinorVersion = 20
      SwPatchVersion = 0
      ModuleId = 102
      VendorId = 17
      Release = _TRICORE_TC397_ADAS
      VendorApiInfix = Scu
    WdgSettingsConfig_Core1 (WdgSettingsConfig):
      WdgCoreId = 1
      WdgCPUDisableAllowed = true
      WdgCPUInitialTimeout = 5
      WdgCPUMaxTimeout = 32
      WdgCPUInitialPassword = 60
      WdgDefaultMode = WDGIF_OFF_MODE
      WdgSystemClockRef = McuClockReferencePointConfig
      WdgSettingsFast: WdgFastModeTimeoutValue=0.01
      WdgSettingsSlow: WdgSlowModeTimeoutValue=0.02
      WdgSettingsOff
      WdgTriggerTimerSetting: WdgSlowRefreshTime=0.015, WdgFastRefreshTime=0.007
        GtmTimerConfiguration
          GtmTimerOutputModuleConfiguration: GtmTimerClockSelect=GTM_CONFIGURABLE_CLOCK_0, GtmTimerUsed=McuGtmAtomChannelAllocationConf_0
