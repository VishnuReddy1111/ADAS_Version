AUTOSAR XML (schema 4-2-2)
package /ActiveEcuC
  module config EthSwt: implementation-config-variant=VARIANT-PRE-COMPILE
    EthSwtGeneral:
      EthSwtDevErrorDetect = (unset)
      EthSwtEnableVlanApi = (unset)
      EthSwtGetArlTableApi = (unset)
      EthSwtGetBufferLevelApi = (unset)
      EthSwtGetDropCountApi = (unset)
      EthSwtGetEtherStatsApi = (unset)
      EthSwtGetMacLearningModeApi = (unset)
      EthSwtGetPortMacAddrApi = (unset)
      EthSwtGetSwitchRegApi = (unset)
      EthSwtIndex = (unset)
      EthSwtPersistentConfigurationResult = (unset)
      EthSwtReadTrcvRegisterApi = (unset)
      EthSwtResetConfigurationApi = (unset)
      EthSwtSetMacLearningModeApi = (unset)
      EthSwtSetSwitchRegApi = (unset)
      EthSwtStoreConfigurationApi = (unset)
      EthSwtVersionInfoApi = (unset)
      EthSwtWriteTrcvRegisterApi = (unset)
