AUTOSAR XML (schema 4-3-0)
package /Port
  module config Port: implementation-config-variant=VARIANT-POST-BUILD, module-description=Port_Impl
    CommonPublishedInformation:
      ArMajorVersion = 4
      ArMinorVersion = 4
      ArPatchVersion = 0
      ModuleId = 124
      Release = _TRICORE_TC397_ADAS
      SwMajorVersion = 20
      SwMinorVersion = 10
      SwPatchVersion = 0
      VendorId = 17
    PortConfigSet
      15 x PortContainer:
        PortContainer_0: PortNumber=0, PortNumberOfPortPins=13
          13 x PortPin, all with PortPinControllerSelect=DISABLE, PortPinDirectionChangeable=false, PortPinEmergencyStop=false, PortPinEnableAnalogInputOnly=PORT_PIN_ANALOG_INPUT_DISABLE, PortPinInputPadLevel=PORT_INPUT_LEVEL_CMOS_AUTOMOTIVE, PortPinInputPullResistor=PORT_PIN_IN_PULL_UP, PortPinLevelValue=PORT_PIN_LEVEL_LOW, PortPinMode=PORT_PIN_MODE_ALL, PortPinModeChangeable=false, PortPinOutputPadDriveStrength=PORT_PIN_DEFAULT_DRIVER, PortPinOutputPinDriveMode=PORT_PIN_OUT_PUSHPULL:
            PortPin_0_12: PortPinDirection=PORT_PIN_IN, PortPinId=12, PortPinInitialMode=GPIO, PortPinSymbolicName=PORT_0_PIN_12
            PortPin_0_0: PortPinDirection=PORT_PIN_IN, PortPinId=0, PortPinInitialMode=GPIO, PortPinSymbolicName=PORT_0_PIN_0
            PortPin_0_1: PortPinDirection=PORT_PIN_IN, PortPinId=1, PortPinInitialMode=GPIO, PortPinSymbolicName=PORT_0_PIN_1
            PortPin_0_10: PortPinDirection=PORT_PIN_IN, PortPinId=10, PortPinInitialMode=GPIO, PortPinSymbolicName=PORT_0_PIN_10
            PortPin_0_11: PortPinDirection=PORT_PIN_IN, PortPinId=11, PortPinInitialMode=GPIO, PortPinSymbolicName=PORT_0_PIN_11
            PortPin_0_2: PortPinDirection=PORT_PIN_OUT, PortPinId=2, PortPinInitialMode=ALT3, PortPinSymbolicName=PORT_0_PIN_2
            PortPin_0_{3..9}: PortPinDirection=PORT_PIN_IN, PortPinId={3..9}, PortPinInitialMode=GPIO, PortPinSymbolicName=PORT_0_PIN_{3..9}
        PortContainer_2: PortNumber=2, PortNumberOfPortPins=9
          9 x PortPin, all with PortPinControllerSelect=DISABLE, PortPinDirection=PORT_PIN_IN, PortPinDirectionChangeable=false, PortPinEmergencyStop=false, PortPinEnableAnalogInputOnly=PORT_PIN_ANALOG_INPUT_DISABLE, PortPinInitialMode=GPIO, PortPinInputPadLevel=PORT_INPUT_LEVEL_CMOS_AUTOMOTIVE, PortPinInputPullResistor=PORT_PIN_IN_PULL_UP, PortPinLevelValue=PORT_PIN_LEVEL_LOW, PortPinMode=PORT_PIN_MODE_ALL, PortPinModeChangeable=false, PortPinOutputPadDriveStrength=PORT_PIN_DEFAULT_DRIVER, PortPinOutputPinDriveMode=PORT_PIN_OUT_PUSHPULL:
            PortPin_2_0: PortPinId=32, PortPinSymbolicName=PORT_2_PIN_0
            PortPin_2_1: PortPinId=33, PortPinSymbolicName=PORT_2_PIN_1
            PortPin_2_2: PortPinId=34, PortPinSymbolicName=PORT_2_PIN_2
            PortPin_2_3: PortPinId=35, PortPinSymbolicName=PORT_2_PIN_3
            PortPin_2_4: PortPinId=36, PortPinSymbolicName=PORT_2_PIN_4
            PortPin_2_5: PortPinId=37, PortPinSymbolicName=PORT_2_PIN_5
            PortPin_2_6: PortPinId=38, PortPinSymbolicName=PORT_2_PIN_6
            PortPin_2_7: PortPinId=39, PortPinSymbolicName=PORT_2_PIN_7
            PortPin_2_8: PortPinId=40, PortPinSymbolicName=PORT_2_PIN_8
        PortContainer_23: PortNumber=23, PortNumberOfPortPins=8
          8 x PortPin, all with PortPinControllerSelect=DISABLE, PortPinDirection=PORT_PIN_IN, PortPinDirectionChangeable=false, PortPinEmergencyStop=false, PortPinEnableAnalogInputOnly=PORT_PIN_ANALOG_INPUT_DISABLE, PortPinInitialMode=GPIO, PortPinInputPadLevel=PORT_INPUT_LEVEL_CMOS_AUTOMOTIVE, PortPinInputPullResistor=PORT_PIN_IN_PULL_UP, PortPinLevelValue=PORT_PIN_LEVEL_LOW, PortPinMode=PORT_PIN_MODE_ALL, PortPinModeChangeable=false, PortPinOutputPadDriveStrength=PORT_PIN_DEFAULT_DRIVER, PortPinOutputPinDriveMode=PORT_PIN_OUT_PUSHPULL:
            PortPin_23_0: PortPinId=368, PortPinSymbolicName=PORT_23_PIN_0
            PortPin_23_1: PortPinId=369, PortPinSymbolicName=PORT_23_PIN_1
            PortPin_23_2: PortPinId=370, PortPinSymbolicName=PORT_23_PIN_2
            PortPin_23_3: PortPinId=371, PortPinSymbolicName=PORT_23_PIN_3
            PortPin_23_4: PortPinId=372, PortPinSymbolicName=PORT_23_PIN_4
            PortPin_23_5: PortPinId=373, PortPinSymbolicName=PORT_23_PIN_5
            PortPin_23_6: PortPinId=374, PortPinSymbolicName=PORT_23_PIN_6
            PortPin_23_7: PortPinId=375, PortPinSymbolicName=PORT_23_PIN_7
        PortContainer_32: PortNumber=32, PortNumberOfPortPins=8
          8 x PortPin, all with PortPinControllerSelect=DISABLE, PortPinDirection=PORT_PIN_IN, PortPinDirectionChangeable=false, PortPinEmergencyStop=false, PortPinEnableAnalogInputOnly=PORT_PIN_ANALOG_INPUT_DISABLE, PortPinInitialMode=GPIO, PortPinInputPadLevel=PORT_INPUT_LEVEL_CMOS_AUTOMOTIVE, PortPinInputPullResistor=PORT_PIN_IN_PULL_UP, PortPinLevelValue=PORT_PIN_LEVEL_LOW, PortPinMode=PORT_PIN_MODE_ALL, PortPinModeChangeable=false, PortPinOutputPadDriveStrength=PORT_PIN_DEFAULT_DRIVER, PortPinOutputPinDriveMode=PORT_PIN_OUT_PUSHPULL:
            PortPin_32_0: PortPinId=512, PortPinSymbolicName=PORT_32_PIN_0
            PortPin_32_1: PortPinId=513, PortPinSymbolicName=PORT_32_PIN_1
            PortPin_32_2: PortPinId=514, PortPinSymbolicName=PORT_32_PIN_2
            PortPin_32_3: PortPinId=515, PortPinSymbolicName=PORT_32_PIN_3
            PortPin_32_4: PortPinId=516, PortPinSymbolicName=PORT_32_PIN_4
            PortPin_32_5: PortPinId=517, PortPinSymbolicName=PORT_32_PIN_5
            PortPin_32_6: PortPinId=518, PortPinSymbolicName=PORT_32_PIN_6
            PortPin_32_7: PortPinId=519, PortPinSymbolicName=PORT_32_PIN_7
        PortContainer_33: PortNumber=33, PortNumberOfPortPins=16
          16 x PortPin, all with PortPinControllerSelect=DISABLE, PortPinDirectionChangeable=false, PortPinEmergencyStop=false, PortPinEnableAnalogInputOnly=PORT_PIN_ANALOG_INPUT_DISABLE, PortPinInitialMode=GPIO, PortPinInputPadLevel=PORT_INPUT_LEVEL_CMOS_AUTOMOTIVE, PortPinInputPullResistor=PORT_PIN_IN_PULL_UP, PortPinLevelValue=PORT_PIN_LEVEL_LOW, PortPinMode=PORT_PIN_MODE_ALL, PortPinModeChangeable=false, PortPinOutputPadDriveStrength=PORT_PIN_DEFAULT_DRIVER, PortPinOutputPinDriveMode=PORT_PIN_OUT_PUSHPULL:
            PortPin_33_0: PortPinDirection=PORT_PIN_OUT, PortPinId=528, PortPinSymbolicName=PORT_33_PIN_0
            PortPin_33_1: PortPinDirection=PORT_PIN_OUT, PortPinId=529, PortPinSymbolicName=PORT_33_PIN_1
            PortPin_33_10: PortPinDirection=PORT_PIN_IN, PortPinId=538, PortPinSymbolicName=PORT_33_PIN_10
            PortPin_33_11: PortPinDirection=PORT_PIN_IN, PortPinId=539, PortPinSymbolicName=PORT_33_PIN_11
            PortPin_33_12: PortPinDirection=PORT_PIN_IN, PortPinId=540, PortPinSymbolicName=PORT_33_PIN_12
            PortPin_33_13: PortPinDirection=PORT_PIN_IN, PortPinId=541, PortPinSymbolicName=PORT_33_PIN_13
            PortPin_33_14: PortPinDirection=PORT_PIN_IN, PortPinId=542, PortPinSymbolicName=PORT_33_PIN_14
            PortPin_33_15: PortPinDirection=PORT_PIN_IN, PortPinId=543, PortPinSymbolicName=PORT_33_PIN_15
            PortPin_33_2: PortPinDirection=PORT_PIN_OUT, PortPinId=530, PortPinSymbolicName=PORT_33_PIN_2
            PortPin_33_3: PortPinDirection=PORT_PIN_OUT, PortPinId=531, PortPinSymbolicName=PORT_33_PIN_3
            PortPin_33_4: PortPinDirection=PORT_PIN_OUT, PortPinId=532, PortPinSymbolicName=PORT_33_PIN_4
            PortPin_33_5: PortPinDirection=PORT_PIN_IN, PortPinId=533, PortPinSymbolicName=PORT_33_PIN_5
            PortPin_33_6: PortPinDirection=PORT_PIN_IN, PortPinId=534, PortPinSymbolicName=PORT_33_PIN_6
            PortPin_33_7: PortPinDirection=PORT_PIN_IN, PortPinId=535, PortPinSymbolicName=PORT_33_PIN_7
            PortPin_33_8: PortPinDirection=PORT_PIN_IN, PortPinId=536, PortPinSymbolicName=PORT_33_PIN_8
            PortPin_33_9: PortPinDirection=PORT_PIN_IN, PortPinId=537, PortPinSymbolicName=PORT_33_PIN_9
        PortContainer_34: PortNumber=34, PortNumberOfPortPins=5
          5 x PortPin, all with PortPinControllerSelect=DISABLE, PortPinDirection=PORT_PIN_IN, PortPinDirectionChangeable=false, PortPinEmergencyStop=false, PortPinEnableAnalogInputOnly=PORT_PIN_ANALOG_INPUT_DISABLE, PortPinInitialMode=GPIO, PortPinInputPadLevel=PORT_INPUT_LEVEL_CMOS_AUTOMOTIVE, PortPinInputPullResistor=PORT_PIN_IN_PULL_UP, PortPinLevelValue=PORT_PIN_LEVEL_LOW, PortPinMode=PORT_PIN_MODE_ALL, PortPinModeChangeable=false, PortPinOutputPadDriveStrength=PORT_PIN_DEFAULT_DRIVER, PortPinOutputPinDriveMode=PORT_PIN_OUT_PUSHPULL:
            PortPin_34_1: PortPinId=545, PortPinSymbolicName=PORT_34_PIN_1
            PortPin_34_2: PortPinId=546, PortPinSymbolicName=PORT_34_PIN_2
            PortPin_34_3: PortPinId=547, PortPinSymbolicName=PORT_34_PIN_3
            PortPin_34_4: PortPinId=548, PortPinSymbolicName=PORT_34_PIN_4
            PortPin_34_5: PortPinId=549, PortPinSymbolicName=PORT_34_PIN_5
        PortContainer_40: PortNumber=40, PortNumberOfPortPins=9
          9 x PortPin, all with PortPinControllerSelect=DISABLE, PortPinDirection=PORT_PIN_IN, PortPinDirectionChangeable=false, PortPinEmergencyStop=false, PortPinEnableAnalogInputOnly=PORT_PIN_ANALOG_INPUT_DISABLE, PortPinInitialMode=GPIO, PortPinInputPadLevel=PORT_INPUT_LEVEL_CMOS_AUTOMOTIVE, PortPinInputPullResistor=PORT_PIN_IN_PULL_UP, PortPinLevelValue=PORT_PIN_LEVEL_LOW, PortPinMode=PORT_PIN_MODE_ALL, PortPinModeChangeable=false, PortPinOutputPadDriveStrength=PORT_PIN_DEFAULT_DRIVER, PortPinOutputPinDriveMode=PORT_PIN_OUT_PUSHPULL:
            PortPin_40_0: PortPinId=640, PortPinSymbolicName=PORT_40_PIN_0
            PortPin_40_1: PortPinId=641, PortPinSymbolicName=PORT_40_PIN_1
            PortPin_40_6: PortPinId=646, PortPinSymbolicName=PORT_40_PIN_6
            PortPin_40_7: PortPinId=647, PortPinSymbolicName=PORT_40_PIN_7
            PortPin_40_8: PortPinId=648, PortPinSymbolicName=PORT_40_PIN_8
            PortPin_40_9: PortPinId=649, PortPinSymbolicName=PORT_40_PIN_9
            PortPin_40_10: PortPinId=650, PortPinSymbolicName=PORT_40_PIN_10
            PortPin_40_11: PortPinId=651, PortPinSymbolicName=PORT_40_PIN_11
            PortPin_40_12: PortPinId=652, PortPinSymbolicName=PORT_40_PIN_12
        PortContainer_10: PortNumber=10, PortNumberOfPortPins=9
          9 x PortPin, all with PortPinControllerSelect=DISABLE, PortPinDirectionChangeable=false, PortPinEmergencyStop=false, PortPinEnableAnalogInputOnly=PORT_PIN_ANALOG_INPUT_DISABLE, PortPinInputPadLevel=PORT_INPUT_LEVEL_CMOS_AUTOMOTIVE, PortPinInputPullResistor=PORT_PIN_IN_PULL_UP, PortPinMode=PORT_PIN_MODE_ALL, PortPinModeChangeable=false, PortPinOutputPadDriveStrength=PORT_PIN_DEFAULT_DRIVER, PortPinOutputPinDriveMode=PORT_PIN_OUT_PUSHPULL:
            PortPin_10_0: PortPinDirection=PORT_PIN_IN, PortPinId=160, PortPinInitialMode=GPIO, PortPinLevelValue=PORT_PIN_LEVEL_LOW, PortPinSymbolicName=PORT_10_PIN_0
            PortPin_10_1: PortPinDirection=PORT_PIN_IN, PortPinId=161, PortPinInitialMode=GPIO, PortPinLevelValue=PORT_PIN_LEVEL_LOW, PortPinSymbolicName=PORT_10_PIN_1
            PortPin_10_2: PortPinDirection=PORT_PIN_IN, PortPinId=162, PortPinInitialMode=GPIO, PortPinLevelValue=PORT_PIN_LEVEL_LOW, PortPinSymbolicName=PORT_10_PIN_2
            PortPin_10_3: PortPinDirection=PORT_PIN_OUT, PortPinId=163, PortPinInitialMode=ALT6, PortPinLevelValue=PORT_PIN_LEVEL_LOW, PortPinSymbolicName=PORT_10_PIN_3
            PortPin_10_4: PortPinDirection=PORT_PIN_IN, PortPinId=164, PortPinInitialMode=GPIO, PortPinLevelValue=PORT_PIN_LEVEL_LOW, PortPinSymbolicName=PORT_10_PIN_4
            PortPin_10_5: PortPinDirection=PORT_PIN_OUT, PortPinId=165, PortPinInitialMode=ALT2, PortPinLevelValue=PORT_PIN_LEVEL_HIGH, PortPinSymbolicName=PORT_10_PIN_5
            PortPin_10_6: PortPinDirection=PORT_PIN_IN, PortPinId=166, PortPinInitialMode=GPIO, PortPinLevelValue=PORT_PIN_LEVEL_HIGH, PortPinSymbolicName=PORT_10_PIN_6
            PortPin_10_7: PortPinDirection=PORT_PIN_IN, PortPinId=167, PortPinInitialMode=GPIO, PortPinLevelValue=PORT_PIN_LEVEL_LOW, PortPinSymbolicName=PORT_10_PIN_7
            PortPin_10_8: PortPinDirection=PORT_PIN_IN, PortPinId=168, PortPinInitialMode=GPIO, PortPinLevelValue=PORT_PIN_LEVEL_LOW, PortPinSymbolicName=PORT_10_PIN_8
        PortContainer_11: PortNumber=11, PortNumberOfPortPins=16
          16 x PortPin, all with PortPinDirectionChangeable=false, PortPinEmergencyStop=false, PortPinEnableAnalogInputOnly=PORT_PIN_ANALOG_INPUT_DISABLE, PortPinInputPullResistor=PORT_PIN_IN_PULL_UP, PortPinMode=PORT_PIN_MODE_ALL, PortPinModeChangeable=false, PortPinOutputPinDriveMode=PORT_PIN_OUT_PUSHPULL:
            PortPin_11_0_ETH_TXD3_PortContainer_4: PortPinControllerSelect=ENABLE, PortPinDirection=PORT_PIN_OUT, PortPinId=176, PortPinInitialMode=ALT6, PortPinInputPadLevel=PORT_INPUT_LEVEL_CMOS_AUTOMOTIVE, PortPinLevelValue=PORT_PIN_LEVEL_LOW, PortPinOutputPadDriveStrength=PORT_PIN_RGMII_DRIVER, PortPinSymbolicName=PORT_11_PIN_0
            PortPin_11_10_ETH_RXD0_PortContainer_4: PortPinControllerSelect=DISABLE, PortPinDirection=PORT_PIN_IN, PortPinId=186, PortPinInitialMode=GPIO, PortPinInputPadLevel=PORT_RGMII_INPUT, PortPinLevelValue=PORT_PIN_LEVEL_LOW, PortPinOutputPadDriveStrength=PORT_PIN_DEFAULT_DRIVER, PortPinSymbolicName=PORT_11_PIN_10
            PortPin_11_11_ETH_RX_CTL_PortContainer_4: PortPinControllerSelect=DISABLE, PortPinDirection=PORT_PIN_IN, PortPinId=187, PortPinInitialMode=GPIO, PortPinInputPadLevel=PORT_RGMII_INPUT, PortPinLevelValue=PORT_PIN_LEVEL_LOW, PortPinOutputPadDriveStrength=PORT_PIN_DEFAULT_DRIVER, PortPinSymbolicName=PORT_11_PIN_11
            PortPin_11_12_ETH_RX_CLK_PortContainer_4: PortPinControllerSelect=DISABLE, PortPinDirection=PORT_PIN_IN, PortPinId=188, PortPinInitialMode=GPIO, PortPinInputPadLevel=PORT_RGMII_INPUT, PortPinLevelValue=PORT_PIN_LEVEL_LOW, PortPinOutputPadDriveStrength=PORT_PIN_DEFAULT_DRIVER, PortPinSymbolicName=PORT_11_PIN_12
            PortPin_11_13_PortContainer_4: PortPinControllerSelect=DISABLE, PortPinDirection=PORT_PIN_IN, PortPinId=189, PortPinInitialMode=GPIO, PortPinInputPadLevel=PORT_INPUT_LEVEL_CMOS_AUTOMOTIVE, PortPinLevelValue=PORT_PIN_LEVEL_LOW, PortPinOutputPadDriveStrength=PORT_PIN_DEFAULT_DRIVER, PortPinSymbolicName=PORT_11_PIN_13
            PortPin_11_14_PortContainer_4: PortPinControllerSelect=DISABLE, PortPinDirection=PORT_PIN_IN, PortPinId=190, PortPinInitialMode=GPIO, PortPinInputPadLevel=PORT_INPUT_LEVEL_CMOS_AUTOMOTIVE, PortPinLevelValue=PORT_PIN_LEVEL_LOW, PortPinOutputPadDriveStrength=PORT_PIN_DEFAULT_DRIVER, PortPinSymbolicName=PORT_11_PIN_14
            PortPin_11_15_PortContainer_4: PortPinControllerSelect=DISABLE, PortPinDirection=PORT_PIN_IN, PortPinId=191, PortPinInitialMode=GPIO, PortPinInputPadLevel=PORT_INPUT_LEVEL_CMOS_AUTOMOTIVE, PortPinLevelValue=PORT_PIN_LEVEL_LOW, PortPinOutputPadDriveStrength=PORT_PIN_DEFAULT_DRIVER, PortPinSymbolicName=PORT_11_PIN_15
            PortPin_11_1_ETH_TXD2_PortContainer_4: PortPinControllerSelect=ENABLE, PortPinDirection=PORT_PIN_OUT, PortPinId=177, PortPinInitialMode=ALT6, PortPinInputPadLevel=PORT_INPUT_LEVEL_CMOS_AUTOMOTIVE, PortPinLevelValue=PORT_PIN_LEVEL_LOW, PortPinOutputPadDriveStrength=PORT_PIN_RGMII_DRIVER, PortPinSymbolicName=PORT_11_PIN_1
            PortPin_11_2_ETH_TXD1_PortContainer_4: PortPinControllerSelect=ENABLE, PortPinDirection=PORT_PIN_OUT, PortPinId=178, PortPinInitialMode=ALT6, PortPinInputPadLevel=PORT_INPUT_LEVEL_CMOS_AUTOMOTIVE, PortPinLevelValue=PORT_PIN_LEVEL_LOW, PortPinOutputPadDriveStrength=PORT_PIN_RGMII_DRIVER, PortPinSymbolicName=PORT_11_PIN_2
            PortPin_11_3_ETH_TXD0_PortContainer_4: PortPinControllerSelect=ENABLE, PortPinDirection=PORT_PIN_OUT, PortPinId=179, PortPinInitialMode=ALT6, PortPinInputPadLevel=PORT_INPUT_LEVEL_CMOS_AUTOMOTIVE, PortPinLevelValue=PORT_PIN_LEVEL_LOW, PortPinOutputPadDriveStrength=PORT_PIN_RGMII_DRIVER, PortPinSymbolicName=PORT_11_PIN_3
            PortPin_11_4_ETH_TXERR_PortContainer_4: PortPinControllerSelect=ENABLE, PortPinDirection=PORT_PIN_OUT, PortPinId=180, PortPinInitialMode=ALT6, PortPinInputPadLevel=PORT_INPUT_LEVEL_CMOS_AUTOMOTIVE, PortPinLevelValue=PORT_PIN_LEVEL_LOW, PortPinOutputPadDriveStrength=PORT_PIN_RGMII_DRIVER, PortPinSymbolicName=PORT_11_PIN_4
            PortPin_11_5_ETH_REFCLK_PortContainer_4: PortPinControllerSelect=DISABLE, PortPinDirection=PORT_PIN_IN, PortPinId=181, PortPinInitialMode=GPIO, PortPinInputPadLevel=PORT_RGMII_INPUT, PortPinLevelValue=PORT_PIN_LEVEL_LOW, PortPinOutputPadDriveStrength=PORT_PIN_DEFAULT_DRIVER, PortPinSymbolicName=PORT_11_PIN_5
            PortPin_11_6_ETH_TX_EN_PortContainer_4: PortPinControllerSelect=ENABLE, PortPinDirection=PORT_PIN_OUT, PortPinId=182, PortPinInitialMode=ALT6, PortPinInputPadLevel=PORT_INPUT_LEVEL_CMOS_AUTOMOTIVE, PortPinLevelValue=PORT_PIN_LEVEL_HIGH, PortPinOutputPadDriveStrength=PORT_PIN_RGMII_DRIVER, PortPinSymbolicName=PORT_11_PIN_6
            PortPin_11_7_ETH_RXD3_PortContainer_4: PortPinControllerSelect=DISABLE, PortPinDirection=PORT_PIN_IN, PortPinId=183, PortPinInitialMode=GPIO, PortPinInputPadLevel=PORT_RGMII_INPUT, PortPinLevelValue=PORT_PIN_LEVEL_LOW, PortPinOutputPadDriveStrength=PORT_PIN_DEFAULT_DRIVER, PortPinSymbolicName=PORT_11_PIN_7
            PortPin_11_8_ETH_RXD2_PortContainer_4: PortPinControllerSelect=DISABLE, PortPinDirection=PORT_PIN_IN, PortPinId=184, PortPinInitialMode=GPIO, PortPinInputPadLevel=PORT_RGMII_INPUT, PortPinLevelValue=PORT_PIN_LEVEL_LOW, PortPinOutputPadDriveStrength=PORT_PIN_DEFAULT_DRIVER, PortPinSymbolicName=PORT_11_PIN_8
            PortPin_11_9_ETH_RXD1_PortContainer_4: PortPinControllerSelect=DISABLE, PortPinDirection=PORT_PIN_IN, PortPinId=185, PortPinInitialMode=GPIO, PortPinInputPadLevel=PORT_RGMII_INPUT, PortPinLevelValue=PORT_PIN_LEVEL_LOW, PortPinOutputPadDriveStrength=PORT_PIN_DEFAULT_DRIVER, PortPinSymbolicName=PORT_11_PIN_9
        PortContainer_12: PortNumber=12, PortNumberOfPortPins=2
          PortPin_12_0_ETH_MCD_PortContainer_5_0 (PortPin):
            PortPinControllerSelect = DISABLE
            PortPinDirection = PORT_PIN_OUT
            PortPinDirectionChangeable = false
            PortPinEmergencyStop = false
            PortPinEnableAnalogInputOnly = PORT_PIN_ANALOG_INPUT_DISABLE
            PortPinId = 192
            PortPinInitialMode = ALT6
            PortPinInputPadLevel = PORT_INPUT_LEVEL_CMOS_AUTOMOTIVE
            PortPinInputPullResistor = PORT_PIN_IN_PULL_UP
            PortPinLevelValue = PORT_PIN_LEVEL_LOW
            PortPinMode = PORT_PIN_MODE_ALL
            PortPinModeChangeable = false
            PortPinOutputPadDriveStrength = PORT_PIN_DEFAULT_DRIVER
            PortPinOutputPinDriveMode = PORT_PIN_OUT_PUSHPULL
            PortPinSymbolicName = PORT_12_PIN_0
          PortPin_12_1_ETH_MDIO_PortContainer_5_1 (PortPin):
            PortPinControllerSelect = DISABLE
            PortPinDirection = PORT_PIN_OUT
            PortPinEmergencyStop = false
            PortPinEnableAnalogInputOnly = PORT_PIN_ANALOG_INPUT_DISABLE
            PortPinId = 193
            PortPinInitialMode = GPIO
            PortPinInputPadLevel = PORT_INPUT_LEVEL_CMOS_AUTOMOTIVE
            PortPinInputPullResistor = PORT_PIN_IN_PULL_UP
            PortPinLevelValue = PORT_PIN_LEVEL_LOW
            PortPinMode = PORT_PIN_MODE_ALL
            PortPinOutputPadDriveStrength = PORT_PIN_MEDIUM_DRIVER_SHARP_EDGE
            PortPinOutputPinDriveMode = PORT_PIN_OUT_PUSHPULL
            PortPinSymbolicName = PORT_12_PIN_1
            PortPinModeChangeable = false
            PortPinDirectionChangeable = false
        PortContainer_14: PortNumber=14, PortNumberOfPortPins=11
          11 x PortPin, all with PortPinControllerSelect=DISABLE, PortPinDirection=PORT_PIN_IN, PortPinDirectionChangeable=false, PortPinEmergencyStop=false, PortPinEnableAnalogInputOnly=PORT_PIN_ANALOG_INPUT_DISABLE, PortPinInitialMode=GPIO, PortPinInputPadLevel=PORT_INPUT_LEVEL_CMOS_AUTOMOTIVE, PortPinInputPullResistor=PORT_PIN_IN_PULL_UP, PortPinLevelValue=PORT_PIN_LEVEL_LOW, PortPinMode=PORT_PIN_MODE_ALL, PortPinModeChangeable=false, PortPinOutputPadDriveStrength=PORT_PIN_DEFAULT_DRIVER, PortPinOutputPinDriveMode=PORT_PIN_OUT_PUSHPULL:
            PortPin_14_0: PortPinId=224, PortPinSymbolicName=PORT_14_PIN_0
            PortPin_14_1: PortPinId=225, PortPinSymbolicName=PORT_14_PIN_1
            PortPin_14_10: PortPinId=234, PortPinSymbolicName=PORT_14_PIN_10
            PortPin_14_2: PortPinId=226, PortPinSymbolicName=PORT_14_PIN_2
            PortPin_14_3: PortPinId=227, PortPinSymbolicName=PORT_14_PIN_3
            PortPin_14_4: PortPinId=228, PortPinSymbolicName=PORT_14_PIN_4
            PortPin_14_5: PortPinId=229, PortPinSymbolicName=PORT_14_PIN_5
            PortPin_14_6: PortPinId=230, PortPinSymbolicName=PORT_14_PIN_6
            PortPin_14_7: PortPinId=231, PortPinSymbolicName=PORT_14_PIN_7
            PortPin_14_8: PortPinId=232, PortPinSymbolicName=PORT_14_PIN_8
            PortPin_14_9: PortPinId=233, PortPinSymbolicName=PORT_14_PIN_9
          PortLVDS_0 (PortLVDS):
            PortLVDSMode = LVDSH
            PortLVDSPadSupply = V3_3
            PortLVDSPinPair = Pin_10_Pin_9
            PortLVDSRxEnController = PORT_CONTROLLED
            PortLVDSRxPathEnable = false
            PortLVDSRxTerminationMode = INTERNAL_TERMINATION
            PortLVDSTxEnController = PORT_CONTROLLED
            PortLVDSTxPathEnable = false
            PortLVDSTxPowerDownPullDown = DISABLE
        PortContainer_15: PortNumber=15, PortNumberOfPortPins=9
          9 x PortPin, all with PortPinControllerSelect=DISABLE, PortPinDirection=PORT_PIN_IN, PortPinDirectionChangeable=false, PortPinEmergencyStop=false, PortPinEnableAnalogInputOnly=PORT_PIN_ANALOG_INPUT_DISABLE, PortPinInitialMode=GPIO, PortPinInputPadLevel=PORT_INPUT_LEVEL_CMOS_AUTOMOTIVE, PortPinInputPullResistor=PORT_PIN_IN_PULL_UP, PortPinLevelValue=PORT_PIN_LEVEL_LOW, PortPinMode=PORT_PIN_MODE_ALL, PortPinModeChangeable=false, PortPinOutputPadDriveStrength=PORT_PIN_DEFAULT_DRIVER, PortPinOutputPinDriveMode=PORT_PIN_OUT_PUSHPULL:
            PortPin_15_0: PortPinId=240, PortPinSymbolicName=PORT_15_PIN_0
            PortPin_15_1: PortPinId=241, PortPinSymbolicName=PORT_15_PIN_1
            PortPin_15_2: PortPinId=242, PortPinSymbolicName=PORT_15_PIN_2
            PortPin_15_3: PortPinId=243, PortPinSymbolicName=PORT_15_PIN_3
            PortPin_15_4: PortPinId=244, PortPinSymbolicName=PORT_15_PIN_4
            PortPin_15_5: PortPinId=245, PortPinSymbolicName=PORT_15_PIN_5
            PortPin_15_6: PortPinId=246, PortPinSymbolicName=PORT_15_PIN_6
            PortPin_15_7: PortPinId=247, PortPinSymbolicName=PORT_15_PIN_7
            PortPin_15_8: PortPinId=248, PortPinSymbolicName=PORT_15_PIN_8
        PortContainer_20: PortNumber=20, PortNumberOfPortPins=13
          13 x PortPin, all with PortPinControllerSelect=DISABLE, PortPinDirection=PORT_PIN_IN, PortPinDirectionChangeable=false, PortPinEmergencyStop=false, PortPinEnableAnalogInputOnly=PORT_PIN_ANALOG_INPUT_DISABLE, PortPinInitialMode=GPIO, PortPinInputPadLevel=PORT_INPUT_LEVEL_CMOS_AUTOMOTIVE, PortPinInputPullResistor=PORT_PIN_IN_PULL_UP, PortPinLevelValue=PORT_PIN_LEVEL_LOW, PortPinMode=PORT_PIN_MODE_ALL, PortPinModeChangeable=false, PortPinOutputPadDriveStrength=PORT_PIN_DEFAULT_DRIVER, PortPinOutputPinDriveMode=PORT_PIN_OUT_PUSHPULL:
            PortPin_20_0: PortPinId=320, PortPinSymbolicName=PORT_20_PIN_0
            PortPin_20_1: PortPinId=321, PortPinSymbolicName=PORT_20_PIN_1
            PortPin_20_12: PortPinId=332, PortPinSymbolicName=PORT_20_PIN_12
            PortPin_20_13: PortPinId=333, PortPinSymbolicName=PORT_20_PIN_13
            PortPin_20_14: PortPinId=334, PortPinSymbolicName=PORT_20_PIN_14
            PortPin_20_2: PortPinId=322, PortPinSymbolicName=PORT_20_PIN_2
            PortPin_20_3: PortPinId=323, PortPinSymbolicName=PORT_20_PIN_3
            PortPin_20_6: PortPinId=326, PortPinSymbolicName=PORT_20_PIN_6
            PortPin_20_7: PortPinId=327, PortPinSymbolicName=PORT_20_PIN_7
            PortPin_20_8: PortPinId=328, PortPinSymbolicName=PORT_20_PIN_8
            PortPin_20_9: PortPinId=329, PortPinSymbolicName=PORT_20_PIN_9
            PortPin_20_10: PortPinId=330, PortPinSymbolicName=PORT_20_PIN_10
            PortPin_20_11: PortPinId=331, PortPinSymbolicName=PORT_20_PIN_11
        PortContainer_21: PortNumber=21, PortNumberOfPortPins=8
          8 x PortPin, all with PortPinControllerSelect=DISABLE, PortPinDirection=PORT_PIN_IN, PortPinDirectionChangeable=false, PortPinEmergencyStop=false, PortPinEnableAnalogInputOnly=PORT_PIN_ANALOG_INPUT_DISABLE, PortPinInitialMode=GPIO, PortPinInputPadLevel=PORT_INPUT_LEVEL_CMOS_AUTOMOTIVE, PortPinInputPullResistor=PORT_PIN_IN_PULL_UP, PortPinLevelValue=PORT_PIN_LEVEL_LOW, PortPinMode=PORT_PIN_MODE_ALL, PortPinModeChangeable=false, PortPinOutputPadDriveStrength=PORT_PIN_DEFAULT_DRIVER, PortPinOutputPinDriveMode=PORT_PIN_OUT_PUSHPULL:
            PortPin_21_0: PortPinId=336, PortPinSymbolicName=PORT_21_PIN_0
            PortPin_21_1: PortPinId=337, PortPinSymbolicName=PORT_21_PIN_1
            PortPin_21_2: PortPinId=338, PortPinSymbolicName=PORT_21_PIN_2
            PortPin_21_3: PortPinId=339, PortPinSymbolicName=PORT_21_PIN_3
            PortPin_21_4: PortPinId=340, PortPinSymbolicName=PORT_21_PIN_4
            PortPin_21_5: PortPinId=341, PortPinSymbolicName=PORT_21_PIN_5
            PortPin_21_6: PortPinId=342, PortPinSymbolicName=PORT_21_PIN_6
            PortPin_21_7: PortPinId=343, PortPinSymbolicName=PORT_21_PIN_7
          3 x PortLVDS, all with PortLVDSMode=LVDSH, PortLVDSPadSupply=V3_3, PortLVDSRxEnController=PORT_CONTROLLED, PortLVDSRxPathEnable=false, PortLVDSRxTerminationMode=INTERNAL_TERMINATION, PortLVDSTxEnController=PORT_CONTROLLED, PortLVDSTxPathEnable=false, PortLVDSTxPowerDownPullDown=DISABLE:
            PortLVDS_0: PortLVDSPinPair=Pin_0_Pin_1
            PortLVDS_1: PortLVDSPinPair=Pin_2_Pin_3
            PortLVDS_2: PortLVDSPinPair=Pin_4_Pin_5
        PortContainer_22: PortNumber=22, PortNumberOfPortPins=12
          12 x PortPin, all with PortPinControllerSelect=DISABLE, PortPinDirection=PORT_PIN_IN, PortPinDirectionChangeable=false, PortPinEmergencyStop=false, PortPinEnableAnalogInputOnly=PORT_PIN_ANALOG_INPUT_DISABLE, PortPinInitialMode=GPIO, PortPinInputPadLevel=PORT_INPUT_LEVEL_CMOS_AUTOMOTIVE, PortPinInputPullResistor=PORT_PIN_IN_PULL_UP, PortPinLevelValue=PORT_PIN_LEVEL_LOW, PortPinMode=PORT_PIN_MODE_ALL, PortPinModeChangeable=false, PortPinOutputPadDriveStrength=PORT_PIN_DEFAULT_DRIVER, PortPinOutputPinDriveMode=PORT_PIN_OUT_PUSHPULL:
            PortPin_22_0: PortPinId=352, PortPinSymbolicName=PORT_22_PIN_0
            PortPin_22_1: PortPinId=353, PortPinSymbolicName=PORT_22_PIN_1
            PortPin_22_10: PortPinId=362, PortPinSymbolicName=PORT_22_PIN_10
            PortPin_22_11: PortPinId=363, PortPinSymbolicName=PORT_22_PIN_11
            PortPin_22_2: PortPinId=354, PortPinSymbolicName=PORT_22_PIN_2
            PortPin_22_3: PortPinId=355, PortPinSymbolicName=PORT_22_PIN_3
            PortPin_22_4: PortPinId=356, PortPinSymbolicName=PORT_22_PIN_4
            PortPin_22_5: PortPinId=357, PortPinSymbolicName=PORT_22_PIN_5
            PortPin_22_6: PortPinId=358, PortPinSymbolicName=PORT_22_PIN_6
            PortPin_22_7: PortPinId=359, PortPinSymbolicName=PORT_22_PIN_7
            PortPin_22_8: PortPinId=360, PortPinSymbolicName=PORT_22_PIN_8
            PortPin_22_9: PortPinId=361, PortPinSymbolicName=PORT_22_PIN_9
          PortLVDS_0 (PortLVDS):
            PortLVDSMode = LVDSH
            PortLVDSPadSupply = V3_3
            PortLVDSPinPair = Pin_0_Pin_1
            PortLVDSRxEnController = PORT_CONTROLLED
            PortLVDSRxPathEnable = false
            PortLVDSRxTerminationMode = INTERNAL_TERMINATION
            PortLVDSTxEnController = PORT_CONTROLLED
            PortLVDSTxPathEnable = false
            PortLVDSTxPowerDownPullDown = DISABLE
          PortLVDS_1 (PortLVDS):
            PortLVDSMode = LVDSH
            PortLVDSPadSupply = V3_3
            PortLVDSPinPair = Pin_2_Pin_3
            PortLVDSRxEnController = PORT_CONTROLLED
            PortLVDSRxPathEnable = false
            PortLVDSRxTerminationMode = INTERNAL_TERMINATION
            PortLVDSTxEnController = PORT_CONTROLLED
            PortLVDSTxPathEnable = false
            PortLVDSTxPowerDownPullDown = DISABLE
    PortGeneral:
      PortDevErrorDetect = false
      PortInitApiMode = PORT_MCAL_SUPERVISOR
      PortInitCheckApi = false
      PortSafetyEnable = true
      PortSetPinDirectionApi = false
      PortSetPinModeApi = false
      PortVersionInfoApi = false
