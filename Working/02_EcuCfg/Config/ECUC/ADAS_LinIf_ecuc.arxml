AUTOSAR XML (schema 00048)
package /ActiveEcuC
  module config LinIf: implementation-config-variant=VARIANT-PRE-COMPILE, module-description=LinIf_Impl
    LinIfGeneral:
      LinIfJ2602ResponseToleranceSupport = false
      LinIfCancelTransmitSupported = false
      LinIfDevErrorDetect = true
      LinIfMultipleDriversSupported = false
      LinIfMultipleTrcvDriverSupported = false
      LinIfNcOptionalRequestSupported = true
      LinIfTpSupported = true
      LinIfTrcvDriverSupported = false
      LinIfVersionInfoApi = true
      LinIfEvtFrameSupported = false
      LinIfSporadicFrameSupported = false
      LinIfRuntimeMeasurementSupport = true
      LinIfSafeBswChecks = false
      LinIfBusMirroringSupported = false
      LinIfSeparateMainFunctionPostProcessing = false
      LinIfScheduleEndNotificationSupported = false
    LinIfGlobalConfig
      CHNL_45618847 (LinIfChannel):
        LinIfClusterTimeBase = 0.005
        LinIfChannelId = 0
        LinIfGotoSleepConfirmationUL = LIN_SM
        LinIfStartupState = SLEEP
        LinIfWakeupConfirmationUL = LIN_SM
        LinIfWakeupDelay = 0.1
        LinIfWakeupDelayExternal = 0.1
        LinIfBusIdleTimeoutPeriod = 4
        LinIfWakeupConfirmationTimeoutPeriod = 2
        LinIfScheduleRequestConfirmationUL = LIN_SM
        LinIfScheduleChangeNextTimeBase = false
        LinIfChannelRef = CN_LIN00_19b2d5e7
        LinIfComMNetworkHandleRef = CN_LIN00_19b2d5e7
        FT_MasterReq_355bc768_Tx (LinIfFrame): LinIfChecksumType=CLASSIC, LinIfFrameType=MRF, LinIfLength=8, LinIfPid=60
          LinIfPduDirection
            LinIfInternalPdu
        Diagnose_09c374bf (LinIfScheduleTable):
          LinIfRunMode = RUN_CONTINUOUS
          LinIfScheduleTableIndex = 1
          LinIfScheduleTableName = 
          LinIfResumePosition = START_FROM_BEGINNING
          LinIfScheduleMode = LINTP_APPLICATIVE_SCHEDULE
          Diagnose_2bf13451 (LinIfEntry): LinIfDelay=0.02, LinIfEntryIndex=1, LinIfFrameRef=FT_SlaveResp_9d5cbedc_Rx
          Diagnose_c4a382b0 (LinIfEntry): LinIfDelay=0.02, LinIfEntryIndex=0, LinIfFrameRef=FT_MasterReq_355bc768_Tx
        4 x LinIfFrame:
          FT_Frame_LinTr_MyECU_7a3322b5_Tx: LinIfChecksumType=ENHANCED, LinIfLength=1, LinIfPid=17, LinIfFrameType=UNCONDITIONAL
            LinIfPduDirection
              LinIfTxPdu_52dda9c7 (LinIfTxPdu): LinIfTxPduId=0, LinIfUserTxUL=PDUR, LinIfTxPduRef=Frame_LinTr_MyECU_oLIN00_392a06a5_Tx
          FT_Frame_LinTr_Slave3_95c9a842_Rx: LinIfChecksumType=ENHANCED, LinIfLength=3, LinIfPid=85, LinIfFrameType=UNCONDITIONAL
            LinIfPduDirection
              LinIfRxPdu: LinIfUserRxIndicationUL=PDUR, LinIfRxPduRef=Frame_LinTr_Slave3_oLIN00_eb2bd0ab_Rx
          FT_Frame_LinTr_MyECU2_a1a4ca2c_Tx: LinIfChecksumType=ENHANCED, LinIfLength=3, LinIfPid=211, LinIfFrameType=UNCONDITIONAL
            LinIfPduDirection
              LinIfTxPdu_754fc8ba (LinIfTxPdu): LinIfTxPduId=1, LinIfUserTxUL=PDUR, LinIfTxPduRef=Frame_LinTr_MyECU2_oLIN00_a05ec237_Tx
          FT_SlaveResp_9d5cbedc_Rx: LinIfChecksumType=CLASSIC, LinIfFrameType=SRF, LinIfLength=8, LinIfPid=125
            LinIfPduDirection
              LinIfInternalPdu
        Normal_48a571ca (LinIfScheduleTable):
          LinIfRunMode = RUN_CONTINUOUS
          LinIfScheduleTableIndex = 2
          LinIfScheduleTableName = 
          LinIfResumePosition = START_FROM_BEGINNING
          LinIfScheduleMode = LINTP_APPLICATIVE_SCHEDULE
          4 x LinIfEntry:
            Normal_d85c95d4: LinIfDelay=0.01, LinIfEntryIndex=3, LinIfFrameRef=FT_Frame_LinTr_Slave3_95c9a842_Rx
            Normal_370e2335: LinIfDelay=0.01, LinIfEntryIndex=2, LinIfFrameRef=FT_Frame_LinTr_MyECU2_a1a4ca2c_Tx
            Normal_32da48b6: LinIfDelay=0.005, LinIfEntryIndex=0, LinIfFrameRef=FT_Frame_LinTr_MyECU_7a3322b5_Tx
            Normal_dd88fe57: LinIfDelay=0.005, LinIfEntryIndex=1, LinIfFrameRef=FT_Frame_LinTr_Slave1_7bc7c96e_Rx
        NULLSchedule (LinIfScheduleTable): LinIfResumePosition=CONTINUE_AT_IT_POINT, LinIfRunMode=RUN_CONTINUOUS, LinIfScheduleMode=LINTP_APPLICATIVE_SCHEDULE, LinIfScheduleTableIndex=0
        FT_Frame_LinTr_Slave1_7bc7c96e_Rx (LinIfFrame): LinIfChecksumType=ENHANCED, LinIfLength=1, LinIfPid=146, LinIfFrameType=UNCONDITIONAL
          LinIfPduDirection
            LinIfRxPdu: LinIfUserRxIndicationUL=PDUR, LinIfRxPduRef=Frame_LinTr_Slave1_oLIN00_06bd0342_Rx
        LinIfNodeType  # CT_LIN00
          CT_LIN00_da1c1667 (LinIfMaster): LinIfJitter=0
