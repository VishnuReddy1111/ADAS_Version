[part 4 of 8: package /InitialEcuC]
AUTOSAR XML (schema 4-3-0)
package /InitialEcuC  (continued)
  module config Com  (continued)
    ComConfig  (continued)
      797 x ComSignal:  (continued)
        UI2_KompFehlerModus2_23_XIX_UI2_Komponentenfehler_01_XIX_BMC_CAN01_d27afab2_Rx: ComBitPosition=56, ComBitSize=2, ComSignalEndianness=LITTLE_ENDIAN, ComSignalInitValue=0, ComSignalType=UINT8, ComTimeout=1, ComSystemTemplateSystemSignalRef=UI2_KompFehlerModus2_23
        UI2_KompFehlerModus2_24_XIX_UI2_Komponentenfehler_01_XIX_BMC_CAN01_04a2539c_Rx: ComBitPosition=58, ComBitSize=2, ComSignalEndianness=LITTLE_ENDIAN, ComSignalInitValue=0, ComSignalType=UINT8, ComTimeout=1, ComSystemTemplateSystemSignalRef=UI2_KompFehlerModus2_24
        UI2_KompFehlerModus2_25_XIX_UI2_Komponentenfehler_01_XIX_BMC_CAN01_2e8a6bfe_Rx: ComBitPosition=60, ComBitSize=2, ComSignalEndianness=LITTLE_ENDIAN, ComSignalInitValue=0, ComSignalType=UINT8, ComTimeout=1, ComSystemTemplateSystemSignalRef=UI2_KompFehlerModus2_25
        UI2_KompFehlerModus2_26_XIX_UI2_Komponentenfehler_01_XIX_BMC_CAN01_50f22358_Rx: ComBitPosition=62, ComBitSize=2, ComSignalEndianness=LITTLE_ENDIAN, ComSignalInitValue=0, ComSignalType=UINT8, ComTimeout=1, ComSystemTemplateSystemSignalRef=UI2_KompFehlerModus2_26
        UI2_KompFehlerModus4_01_XIX_UI2_Komponentenfehler_02_XIX_BMC_CAN01_a76d8bc9_Rx: ComBitPosition=12, ComBitSize=3, ComSignalEndianness=LITTLE_ENDIAN, ComSignalInitValue=0, ComSignalType=UINT8, ComTimeout=1, ComSystemTemplateSystemSignalRef=UI2_KompFehlerModus4_01
        UI2_KompFehlerModus4_02_XIX_UI2_Komponentenfehler_02_XIX_BMC_CAN01_d915c36f_Rx: ComBitPosition=15, ComBitSize=3, ComSignalEndianness=LITTLE_ENDIAN, ComSignalInitValue=0, ComSignalType=UINT8, ComTimeout=1, ComSystemTemplateSystemSignalRef=UI2_KompFehlerModus4_02
        UI2_KompFehlerModus4_03_XIX_UI2_Komponentenfehler_02_XIX_BMC_CAN01_f33dfb0d_Rx: ComBitPosition=18, ComBitSize=3, ComSignalEndianness=LITTLE_ENDIAN, ComSignalInitValue=0, ComSignalType=UINT8, ComTimeout=1, ComSystemTemplateSystemSignalRef=UI2_KompFehlerModus4_03
        UI2_KompFehlerModus4_04_XIX_UI2_Komponentenfehler_02_XIX_BMC_CAN01_25e55223_Rx: ComBitPosition=21, ComBitSize=3, ComSignalEndianness=LITTLE_ENDIAN, ComSignalInitValue=0, ComSignalType=UINT8, ComTimeout=1, ComSystemTemplateSystemSignalRef=UI2_KompFehlerModus4_04
        UI2_KompFehlerModus4_05_XIX_UI2_Komponentenfehler_02_XIX_BMC_CAN01_0fcd6a41_Rx: ComBitPosition=24, ComBitSize=3, ComSignalEndianness=LITTLE_ENDIAN, ComSignalInitValue=0, ComSignalType=UINT8, ComTimeout=1, ComSystemTemplateSystemSignalRef=UI2_KompFehlerModus4_05
        UI2_KompFehlerModus4_06_XIX_UI2_Komponentenfehler_02_XIX_BMC_CAN01_71b522e7_Rx: ComBitPosition=27, ComBitSize=3, ComSignalEndianness=LITTLE_ENDIAN, ComSignalInitValue=0, ComSignalType=UINT8, ComTimeout=1, ComSystemTemplateSystemSignalRef=UI2_KompFehlerModus4_06
        UI2_KompFehlerModus4_07_XIX_UI2_Komponentenfehler_02_XIX_BMC_CAN01_5b9d1a85_Rx: ComBitPosition=30, ComBitSize=3, ComSignalEndianness=LITTLE_ENDIAN, ComSignalInitValue=0, ComSignalType=UINT8, ComTimeout=1, ComSystemTemplateSystemSignalRef=UI2_KompFehlerModus4_07
        UI2_KompFehlerModus4_08_XIX_UI2_Komponentenfehler_02_XIX_BMC_CAN01_077576fa_Rx: ComBitPosition=33, ComBitSize=3, ComSignalEndianness=LITTLE_ENDIAN, ComSignalInitValue=0, ComSignalType=UINT8, ComTimeout=1, ComSystemTemplateSystemSignalRef=UI2_KompFehlerModus4_08
        UI2_KompFehlerModus4_09_XIX_UI2_Komponentenfehler_02_XIX_BMC_CAN01_2d5d4e98_Rx: ComBitPosition=36, ComBitSize=3, ComSignalEndianness=LITTLE_ENDIAN, ComSignalInitValue=0, ComSignalType=UINT8, ComTimeout=1, ComSystemTemplateSystemSignalRef=UI2_KompFehlerModus4_09
        UI2_KompFehlerModus4_10_XIX_UI2_Komponentenfehler_02_XIX_BMC_CAN01_2ed39be7_Rx: ComBitPosition=39, ComBitSize=3, ComSignalEndianness=LITTLE_ENDIAN, ComSignalInitValue=0, ComSignalType=UINT8, ComTimeout=1, ComSystemTemplateSystemSignalRef=UI2_KompFehlerModus4_10
        UI2_KompFehlerModus4_11_XIX_UI2_Komponentenfehler_02_XIX_BMC_CAN01_04fba385_Rx: ComBitPosition=42, ComBitSize=3, ComSignalEndianness=LITTLE_ENDIAN, ComSignalInitValue=0, ComSignalType=UINT8, ComTimeout=1, ComSystemTemplateSystemSignalRef=UI2_KompFehlerModus4_11
        UI2_KompFehlerModus4_12_XIX_UI2_Komponentenfehler_02_XIX_BMC_CAN01_7a83eb23_Rx: ComBitPosition=45, ComBitSize=3, ComSignalEndianness=LITTLE_ENDIAN, ComSignalInitValue=0, ComSignalType=UINT8, ComTimeout=1, ComSystemTemplateSystemSignalRef=UI2_KompFehlerModus4_12
        UI2_KompFehlerModus4_13_XIX_UI2_Komponentenfehler_02_XIX_BMC_CAN01_50abd341_Rx: ComBitPosition=48, ComBitSize=3, ComSignalEndianness=LITTLE_ENDIAN, ComSignalInitValue=0, ComSignalType=UINT8, ComTimeout=1, ComSystemTemplateSystemSignalRef=UI2_KompFehlerModus4_13
        UI2_KompFehlerModus4_14_XIX_UI2_Komponentenfehler_02_XIX_BMC_CAN01_86737a6f_Rx: ComBitPosition=51, ComBitSize=3, ComSignalEndianness=LITTLE_ENDIAN, ComSignalInitValue=0, ComSignalType=UINT8, ComTimeout=1, ComSystemTemplateSystemSignalRef=UI2_KompFehlerModus4_14
        UI2_KompFehlerModus4_15_XIX_UI2_Komponentenfehler_02_XIX_BMC_CAN01_ac5b420d_Rx: ComBitPosition=54, ComBitSize=3, ComSignalEndianness=LITTLE_ENDIAN, ComSignalInitValue=0, ComSignalType=UINT8, ComTimeout=1, ComSystemTemplateSystemSignalRef=UI2_KompFehlerModus4_15
        UI2_KompFehlerModus4_16_XIX_UI2_Komponentenfehler_02_XIX_BMC_CAN01_d2230aab_Rx: ComBitPosition=57, ComBitSize=3, ComSignalEndianness=LITTLE_ENDIAN, ComSignalInitValue=0, ComSignalType=UINT8, ComTimeout=1, ComSystemTemplateSystemSignalRef=UI2_KompFehlerModus4_16
        UI2_Status_XIX_UI2_04_XIX_BMC_CAN01_1a276de9_Rx: ComBitPosition=15, ComBitSize=1, ComSignalEndianness=LITTLE_ENDIAN, ComSignalInitValue=0, ComSignalType=UINT8, ComTimeout=1, ComSystemTemplateSystemSignalRef=UI2_Status
        UI2_Stromintegral_Entladen_XIX_UI2_04_XIX_BMC_CAN01_f5109cf0_Rx: ComBitPosition=32, ComBitSize=16, ComSignalDataInvalidValue=65535, ComSignalEndianness=LITTLE_ENDIAN, ComSignalInitValue=65534, ComSignalType=UINT8, ComTimeout=1, ComSystemTemplateSystemSignalRef=UI2_Stromintegral_Entladen
        UI2_Stromintegral_Laden_XIX_UI2_04_XIX_BMC_CAN01_01ef1f59_Rx: ComBitPosition=16, ComBitSize=16, ComSignalDataInvalidValue=65535, ComSignalEndianness=LITTLE_ENDIAN, ComSignalInitValue=65534, ComSignalType=UINT8, ComTimeout=1, ComSystemTemplateSystemSignalRef=UI2_Stromintegral_Laden
        UI2_Temperatur_1_XIX_UI2_04_XIX_BMC_CAN01_d7558861_Rx: ComBitPosition=48, ComBitSize=8, ComSignalDataInvalidValue=255, ComSignalEndianness=LITTLE_ENDIAN, ComSignalInitValue=254, ComSignalType=UINT8, ComTimeout=1, ComSystemTemplateSystemSignalRef=UI2_Temperatur_1
        UI2_Temperatur_2_XIX_UI2_04_XIX_BMC_CAN01_25026599_Rx: ComBitPosition=56, ComBitSize=8, ComSignalDataInvalidValue=255, ComSignalEndianness=LITTLE_ENDIAN, ComSignalInitValue=254, ComSignalType=UINT8, ComTimeout=1, ComSystemTemplateSystemSignalRef=UI2_Temperatur_2
        VDSO_Vx3d_XIX_VDSO_05_XIX_HCP5_CANFD01_16f2eb37_Rx: ComBitPosition=12, ComBitSize=16, ComSignalDataInvalidValue=65535, ComSignalEndianness=LITTLE_ENDIAN, ComSignalInitValue=65534, ComSignalType=UINT8, ComTimeout=0.5, ComSystemTemplateSystemSignalRef=VDSO_Vx3d
        VIN_10_XIX_WFS_02_XIX_HCP5_CANFD01_8d48ee8f_Rx: ComBitPosition=88, ComBitSize=8, ComSignalEndianness=LITTLE_ENDIAN, ComSignalInitValue=45, ComSignalType=UINT8, ComTimeout=4, ComSystemTemplateSystemSignalRef=VIN_10
        VIN_11_XIX_WFS_02_XIX_HCP5_CANFD01_ee4f37ab_Rx: ComBitPosition=96, ComBitSize=8, ComSignalEndianness=LITTLE_ENDIAN, ComSignalInitValue=45, ComSignalType=UINT8, ComTimeout=4, ComSystemTemplateSystemSignalRef=VIN_11
        VIN_12_XIX_WFS_02_XIX_HCP5_CANFD01_4b475cc7_Rx: ComBitPosition=104, ComBitSize=8, ComSignalEndianness=LITTLE_ENDIAN, ComSignalInitValue=45, ComSignalType=UINT8, ComTimeout=4, ComSystemTemplateSystemSignalRef=VIN_12
        VIN_13_XIX_WFS_02_XIX_HCP5_CANFD01_284085e3_Rx: ComBitPosition=112, ComBitSize=8, ComSignalEndianness=LITTLE_ENDIAN, ComSignalInitValue=45, ComSignalType=UINT8, ComTimeout=4, ComSystemTemplateSystemSignalRef=VIN_13
        VIN_14_XIX_WFS_02_XIX_HCP5_CANFD01_da268c5e_Rx: ComBitPosition=120, ComBitSize=8, ComSignalEndianness=LITTLE_ENDIAN, ComSignalInitValue=45, ComSignalType=UINT8, ComTimeout=4, ComSystemTemplateSystemSignalRef=VIN_14
        VIN_15_XIX_WFS_02_XIX_HCP5_CANFD01_b921557a_Rx: ComBitPosition=128, ComBitSize=8, ComSignalEndianness=LITTLE_ENDIAN, ComSignalInitValue=45, ComSignalType=UINT8, ComTimeout=4, ComSystemTemplateSystemSignalRef=VIN_15
        VIN_16_XIX_WFS_02_XIX_HCP5_CANFD01_1c293e16_Rx: ComBitPosition=136, ComBitSize=8, ComSignalEndianness=LITTLE_ENDIAN, ComSignalInitValue=45, ComSignalType=UINT8, ComTimeout=4, ComSystemTemplateSystemSignalRef=VIN_16
        VIN_17_XIX_WFS_02_XIX_HCP5_CANFD01_7f2ee732_Rx: ComBitPosition=144, ComBitSize=8, ComSignalEndianness=LITTLE_ENDIAN, ComSignalInitValue=45, ComSignalType=UINT8, ComTimeout=4, ComSystemTemplateSystemSignalRef=VIN_17
        VIN_1_XIX_WFS_02_XIX_HCP5_CANFD01_7a318e94_Rx: ComBitPosition=16, ComBitSize=8, ComSignalEndianness=LITTLE_ENDIAN, ComSignalInitValue=45, ComSignalType=UINT8, ComTimeout=4, ComSystemTemplateSystemSignalRef=VIN_1
        VIN_2_XIX_WFS_02_XIX_HCP5_CANFD01_df39e5f8_Rx: ComBitPosition=24, ComBitSize=8, ComSignalEndianness=LITTLE_ENDIAN, ComSignalInitValue=45, ComSignalType=UINT8, ComTimeout=4, ComSystemTemplateSystemSignalRef=VIN_2
        VIN_3_XIX_WFS_02_XIX_HCP5_CANFD01_bc3e3cdc_Rx: ComBitPosition=32, ComBitSize=8, ComSignalEndianness=LITTLE_ENDIAN, ComSignalInitValue=45, ComSignalType=UINT8, ComTimeout=4, ComSystemTemplateSystemSignalRef=VIN_3
        VIN_4_XIX_WFS_02_XIX_HCP5_CANFD01_4e583561_Rx: ComBitPosition=40, ComBitSize=8, ComSignalEndianness=LITTLE_ENDIAN, ComSignalInitValue=45, ComSignalType=UINT8, ComTimeout=4, ComSystemTemplateSystemSignalRef=VIN_4
        VIN_5_XIX_WFS_02_XIX_HCP5_CANFD01_2d5fec45_Rx: ComBitPosition=48, ComBitSize=8, ComSignalEndianness=LITTLE_ENDIAN, ComSignalInitValue=45, ComSignalType=UINT8, ComTimeout=4, ComSystemTemplateSystemSignalRef=VIN_5
        VIN_6_XIX_WFS_02_XIX_HCP5_CANFD01_88578729_Rx: ComBitPosition=56, ComBitSize=8, ComSignalEndianness=LITTLE_ENDIAN, ComSignalInitValue=45, ComSignalType=UINT8, ComTimeout=4, ComSystemTemplateSystemSignalRef=VIN_6
        VIN_7_XIX_WFS_02_XIX_HCP5_CANFD01_eb505e0d_Rx: ComBitPosition=64, ComBitSize=8, ComSignalEndianness=LITTLE_ENDIAN, ComSignalInitValue=45, ComSignalType=UINT8, ComTimeout=4, ComSystemTemplateSystemSignalRef=VIN_7
        VIN_8_XIX_WFS_02_XIX_HCP5_CANFD01_b7ea9212_Rx: ComBitPosition=72, ComBitSize=8, ComSignalEndianness=LITTLE_ENDIAN, ComSignalInitValue=45, ComSignalType=UINT8, ComTimeout=4, ComSystemTemplateSystemSignalRef=VIN_8
        VIN_9_XIX_WFS_02_XIX_HCP5_CANFD01_d4ed4b36_Rx: ComBitPosition=80, ComBitSize=8, ComSignalEndianness=LITTLE_ENDIAN, ComSignalInitValue=45, ComSignalType=UINT8, ComTimeout=4, ComSystemTemplateSystemSignalRef=VIN_9
        ZM_HV_Auszeit_HiRes_XIX_Zeitmaster_05_XIX_HCP5_CANFD01_2f334ec5_Rx: ComBitPosition=32, ComBitSize=16, ComSignalDataInvalidValue=65535, ComSignalEndianness=LITTLE_ENDIAN, ComSignalInitValue=65534, ComSignalType=UINT8, ComTimeout=5, ComSystemTemplateSystemSignalRef=ZM_HV_Auszeit_HiRes
        ZM_HV_Auszeit_Status_XIX_ZeitMaster_01_XIX_HCP5_CANFD01_de3b0265_Rx: ComBitPosition=38, ComBitSize=2, ComSignalEndianness=LITTLE_ENDIAN, ComSignalInitValue=0, ComSignalType=UINT8, ComTimeout=5, ComSystemTemplateSystemSignalRef=ZM_HV_Auszeit_Status
        ZM_HV_Auszeit_XIX_ZeitMaster_01_XIX_HCP5_CANFD01_870dc7b8_Rx: ComBitPosition=52, ComBitSize=12, ComSignalDataInvalidValue=4095, ComSignalEndianness=LITTLE_ENDIAN, ComSignalInitValue=4094, ComSignalType=UINT8, ComTimeout=5, ComSystemTemplateSystemSignalRef=ZM_HV_Auszeit
      26 x ComSignalGroup, all with ComTransferProperty=TRIGGERED_WITHOUT_REPETITION:
        SG_BJB_10_XIX_BMC_CAN01_5b37bed6_Rx: ComSystemTemplateSignalGroupRef=SG_BJB_10_XIX_BMC_CAN01
          10 x ComGroupSignal, all with ComSignalEndianness=LITTLE_ENDIAN, ComSignalType=UINT8:
            BJB_10_BZ_XIX_BJB_10_XIX_BMC_CAN01_a6352113_Rx: ComBitPosition=8, ComBitSize=4, ComSignalInitValue=0, ComSystemTemplateSystemSignalRef=BJB_10_BZ
            BJB_10_CRC_XIX_BJB_10_XIX_BMC_CAN01_e5862de0_Rx: ComBitPosition=0, ComBitSize=8, ComSignalInitValue=0, ComSystemTemplateSystemSignalRef=BJB_10_CRC
            BJB_Lebensdauer_Trennelemente_XIX_BJB_10_XIX_BMC_CAN01_b0789cdc_Rx: ComBitPosition=15, ComBitSize=17, ComSignalDataInvalidValue=131071, ComSignalInitValue=131070, ComSystemTemplateSystemSignalRef=BJB_Lebensdauer_Trennelemente
            BJB_Sperrung_Unterspannung_XIX_BJB_10_XIX_BMC_CAN01_5ca05f2f_Rx: ComBitPosition=12, ComBitSize=2, ComSignalDataInvalidValue=3, ComSignalInitValue=2, ComSystemTemplateSystemSignalRef=BJB_Sperrung_Unterspannung
            BJB_Status_HV_Spannungssensorik_XIX_BJB_10_XIX_BMC_CAN01_cb195691_Rx: ComBitPosition=14, ComBitSize=1, ComSignalDataInvalidValue=1, ComSignalInitValue=0, ComSystemTemplateSystemSignalRef=BJB_Status_HV_Spannungssensorik
            BJB_Status_Trennelemente_XIX_BJB_10_XIX_BMC_CAN01_968ddb16_Rx: ComBitPosition=32, ComBitSize=3, ComSignalDataInvalidValue=7, ComSignalInitValue=6, ComSystemTemplateSystemSignalRef=BJB_Status_Trennelemente
            ISignalVoid_BJB_10_XIX_BMC_CAN01_0_d632535f_Rx: ComBitPosition=35, ComBitSize=5, ComSystemTemplateSystemSignalRef=SignalVoid_BJB_10_0
            ISignalVoid_BJB_10_XIX_BMC_CAN01_1_a13563c9_Rx: ComBitPosition=40, ComBitSize=8, ComSystemTemplateSystemSignalRef=SignalVoid_BJB_10_1
            ISignalVoid_BJB_10_XIX_BMC_CAN01_2_383c3273_Rx: ComBitPosition=48, ComBitSize=8, ComSystemTemplateSystemSignalRef=SignalVoid_BJB_10_2
            ISignalVoid_BJB_10_XIX_BMC_CAN01_3_4f3b02e5_Rx: ComBitPosition=56, ComBitSize=8, ComSystemTemplateSystemSignalRef=SignalVoid_BJB_10_3
        SG_BJB_11_XIX_BMC_CAN01_e2cc653e_Rx: ComSystemTemplateSignalGroupRef=SG_BJB_11_XIX_BMC_CAN01
          7 x ComGroupSignal, all with ComSignalEndianness=LITTLE_ENDIAN, ComSignalType=UINT8:
            BJB_11_BZ_XIX_BJB_11_XIX_BMC_CAN01_7cc923df_Rx: ComBitPosition=8, ComBitSize=4, ComSignalInitValue=0, ComSystemTemplateSystemSignalRef=BJB_11_BZ
            BJB_11_CRC_XIX_BJB_11_XIX_BMC_CAN01_601d1500_Rx: ComBitPosition=0, ComBitSize=8, ComSignalInitValue=0, ComSystemTemplateSystemSignalRef=BJB_11_CRC
            BJB_Sperrung_Ueberspannung_XIX_BJB_11_XIX_BMC_CAN01_4b1d8379_Rx: ComBitPosition=12, ComBitSize=2, ComSignalDataInvalidValue=3, ComSignalInitValue=2, ComSystemTemplateSystemSignalRef=BJB_Sperrung_Ueberspannung
            BJB_Ueberspannungszaehler_CMC01_XIX_BJB_11_XIX_BMC_CAN01_41d86b20_Rx: ComBitPosition=14, ComBitSize=9, ComSignalDataInvalidValue=511, ComSignalInitValue=510, ComSystemTemplateSystemSignalRef=BJB_Ueberspannungszaehler_CMC01
            BJB_Ueberspannungszaehler_CMC02_XIX_BJB_11_XIX_BMC_CAN01_b38f86d8_Rx: ComBitPosition=23, ComBitSize=9, ComSignalDataInvalidValue=511, ComSignalInitValue=510, ComSystemTemplateSystemSignalRef=BJB_Ueberspannungszaehler_CMC02
            BJB_Uebertemperaturzaehler_CMC01_XIX_BJB_11_XIX_BMC_CAN01_b2ff03fc_Rx: ComBitPosition=32, ComBitSize=16, ComSignalDataInvalidValue=65535, ComSignalInitValue=65534, ComSystemTemplateSystemSignalRef=BJB_Uebertemperaturzaehler_CMC01
            BJB_Uebertemperaturzaehler_CMC02_XIX_BJB_11_XIX_BMC_CAN01_40a8ee04_Rx: ComBitPosition=48, ComBitSize=16, ComSignalDataInvalidValue=65535, ComSignalInitValue=65534, ComSystemTemplateSystemSignalRef=BJB_Uebertemperaturzaehler_CMC02
        SG_BJB_12_XIX_BMC_CAN01_f3b10f47_Rx: ComSystemTemplateSignalGroupRef=SG_BJB_12_XIX_BMC_CAN01
          7 x ComGroupSignal, all with ComSignalEndianness=LITTLE_ENDIAN, ComSignalType=UINT8:
            BJB_12_BZ_XIX_BJB_12_XIX_BMC_CAN01_c8bc22ca_Rx: ComBitPosition=8, ComBitSize=4, ComSignalInitValue=0, ComSystemTemplateSystemSignalRef=BJB_12_BZ
            BJB_12_CRC_XIX_BJB_12_XIX_BMC_CAN01_35c15a61_Rx: ComBitPosition=0, ComBitSize=8, ComSignalInitValue=0, ComSystemTemplateSystemSignalRef=BJB_12_CRC
            BJB_Sperrung_Uebertemperatur_XIX_BJB_12_XIX_BMC_CAN01_7c0d3e2e_Rx: ComBitPosition=12, ComBitSize=2, ComSignalDataInvalidValue=3, ComSignalInitValue=2, ComSystemTemplateSystemSignalRef=BJB_Sperrung_Uebertemperatur
            BJB_Ueberspannungszaehler_CMC03_XIX_BJB_12_XIX_BMC_CAN01_45ef4a36_Rx: ComBitPosition=14, ComBitSize=9, ComSignalDataInvalidValue=511, ComSignalInitValue=510, ComSystemTemplateSystemSignalRef=BJB_Ueberspannungszaehler_CMC03
            BJB_Ueberspannungszaehler_CMC04_XIX_BJB_12_XIX_BMC_CAN01_9d2c3110_Rx: ComBitPosition=23, ComBitSize=9, ComSignalDataInvalidValue=511, ComSignalInitValue=510, ComSystemTemplateSystemSignalRef=BJB_Ueberspannungszaehler_CMC04
            BJB_Uebertemperaturzaehler_CMC03_XIX_BJB_12_XIX_BMC_CAN01_b6c822ea_Rx: ComBitPosition=32, ComBitSize=16, ComSignalDataInvalidValue=65535, ComSignalInitValue=65534, ComSystemTemplateSystemSignalRef=BJB_Uebertemperaturzaehler_CMC03
            BJB_Uebertemperaturzaehler_CMC04_XIX_BJB_12_XIX_BMC_CAN01_6e0b59cc_Rx: ComBitPosition=48, ComBitSize=16, ComSignalDataInvalidValue=65535, ComSignalInitValue=65534, ComSystemTemplateSystemSignalRef=BJB_Uebertemperaturzaehler_CMC04
        SG_BJB_13_XIX_BMC_CAN01_4a4ad4af_Rx: ComSystemTemplateSignalGroupRef=SG_BJB_13_XIX_BMC_CAN01
          8 x ComGroupSignal, all with ComSignalEndianness=LITTLE_ENDIAN, ComSignalType=UINT8:
            BJB_13_BZ_XIX_BJB_13_XIX_BMC_CAN01_12402006_Rx: ComBitPosition=8, ComBitSize=4, ComSignalInitValue=0, ComSystemTemplateSystemSignalRef=BJB_13_BZ
            BJB_13_CRC_XIX_BJB_13_XIX_BMC_CAN01_b05a6281_Rx: ComBitPosition=0, ComBitSize=8, ComSignalInitValue=0, ComSystemTemplateSystemSignalRef=BJB_13_CRC
            BJB_Unterspannungszaehler_CMC01_XIX_BJB_13_XIX_BMC_CAN01_0b46a161_Rx: ComBitPosition=12, ComBitSize=9, ComSignalDataInvalidValue=511, ComSignalInitValue=510, ComSystemTemplateSystemSignalRef=BJB_Unterspannungszaehler_CMC01
            BJB_Unterspannungszaehler_CMC02_XIX_BJB_13_XIX_BMC_CAN01_f9114c99_Rx: ComBitPosition=21, ComBitSize=9, ComSignalDataInvalidValue=511, ComSignalInitValue=510, ComSystemTemplateSystemSignalRef=BJB_Unterspannungszaehler_CMC02
            BJB_Unterspannungszaehler_CMC03_XIX_BJB_13_XIX_BMC_CAN01_1e0cea0e_Rx: ComBitPosition=30, ComBitSize=9, ComSignalDataInvalidValue=511, ComSignalInitValue=510, ComSystemTemplateSystemSignalRef=BJB_Unterspannungszaehler_CMC03
            BJB_Unterspannungszaehler_CMC04_XIX_BJB_13_XIX_BMC_CAN01_c6cf9128_Rx: ComBitPosition=39, ComBitSize=9, ComSignalDataInvalidValue=511, ComSignalInitValue=510, ComSystemTemplateSystemSignalRef=BJB_Unterspannungszaehler_CMC04
            ISignalVoid_BJB_13_XIX_BMC_CAN01_0_85a808db_Rx: ComBitPosition=48, ComBitSize=8, ComSystemTemplateSystemSignalRef=SignalVoid_BJB_13_0
            ISignalVoid_BJB_13_XIX_BMC_CAN01_1_f2af384d_Rx: ComBitPosition=56, ComBitSize=8, ComSystemTemplateSystemSignalRef=SignalVoid_BJB_13_1
        SG_BMC_HV_01_XIX_HCP5_CANFD01_efd99d38_Tx: ComSystemTemplateSignalGroupRef=SG_BMC_HV_01_XIX_HCP5_CANFD01
          17 x ComGroupSignal, all with ComSignalEndianness=LITTLE_ENDIAN, ComSignalType=UINT8:
            BMC_Bankstatus_XIX_BMC_HV_01_XIX_HCP5_CANFD01_0b765180_Tx: ComBitPosition=12, ComBitSize=4, ComSignalDataInvalidValue=15, ComSignalInitValue=14, ComSystemTemplateSystemSignalRef=BMC_Bankstatus
            BMC_HVK_EoHVL_Status_XIX_BMC_HV_01_XIX_HCP5_CANFD01_f332fab3_Tx: ComBitPosition=30, ComBitSize=2, ComSignalDataInvalidValue=3, ComSignalInitValue=0, ComSystemTemplateSystemSignalRef=BMC_HVK_EoHVL_Status
            BMC_HVK_Fehler_HVIL_XIX_BMC_HV_01_XIX_HCP5_CANFD01_a073e875_Tx: ComBitPosition=54, ComBitSize=2, ComSignalDataInvalidValue=2, ComSignalInitValue=3, ComSystemTemplateSystemSignalRef=BMC_HVK_Fehler_HVIL
            BMC_HVK_Fehler_Intern_XIX_BMC_HV_01_XIX_HCP5_CANFD01_ed40d4a6_Tx: ComBitPosition=36, ComBitSize=2, ComSignalDataInvalidValue=2, ComSignalInitValue=3, ComSystemTemplateSystemSignalRef=BMC_HVK_Fehler_Intern
            BMC_HVK_Fehler_SD_XIX_BMC_HV_01_XIX_HCP5_CANFD01_da1d4b3c_Tx: ComBitPosition=38, ComBitSize=2, ComSignalDataInvalidValue=2, ComSignalInitValue=3, ComSystemTemplateSystemSignalRef=BMC_HVK_Fehler_SD
            BMC_HV_01_BZ_XIX_BMC_HV_01_XIX_HCP5_CANFD01_3a361f22_Tx: ComBitPosition=8, ComBitSize=4, ComSignalInitValue=0, ComSystemTemplateSystemSignalRef=BMC_HV_01_BZ
            BMC_HV_01_CRC_XIX_BMC_HV_01_XIX_HCP5_CANFD01_403c41f5_Tx: ComBitPosition=0, ComBitSize=8, ComSignalInitValue=0, ComSystemTemplateSystemSignalRef=BMC_HV_01_CRC
            BMC_Modus_XIX_BMC_HV_01_XIX_HCP5_CANFD01_51805a50_Tx: ComBitPosition=32, ComBitSize=4, ComSignalInitValue=15, ComSystemTemplateSystemSignalRef=BMC_Modus
            BMC_Spannung_Messzeit_XIX_BMC_HV_01_XIX_HCP5_CANFD01_e49c7918_Tx: ComBitPosition=96, ComBitSize=8, ComSignalDataInvalidValue=255, ComSignalInitValue=254, ComSystemTemplateSystemSignalRef=BMC_Spannung_Messzeit
            BMC_Spannung_XIX_BMC_HV_01_XIX_HCP5_CANFD01_49e05688_Tx: ComBitPosition=16, ComBitSize=14, ComSignalDataInvalidValue=16383, ComSignalInitValue=16382, ComSystemTemplateSystemSignalRef=BMC_Spannung
            BMC_Spannung_ZwischenKreis_2_XIX_BMC_HV_01_XIX_HCP5_CANFD01_5762ebd7_Tx: ComBitPosition=72, ComBitSize=14, ComSignalDataInvalidValue=16383, ComSignalInitValue=16382, ComSystemTemplateSystemSignalRef=BMC_Spannung_ZwischenKreis_2
            BMC_Spannung_ZwischenKreis_XIX_BMC_HV_01_XIX_HCP5_CANFD01_69be15b1_Tx: ComBitPosition=40, ComBitSize=14, ComSignalDataInvalidValue=16383, ComSignalInitValue=16382, ComSystemTemplateSystemSignalRef=BMC_Spannung_ZwischenKreis
            BMC_Status_Spgfreiheit_XIX_BMC_HV_01_XIX_HCP5_CANFD01_cc0d64c0_Tx: ComBitPosition=86, ComBitSize=2, ComSignalInitValue=0, ComSystemTemplateSystemSignalRef=BMC_Status_Spgfreiheit
            BMC_Strom_02_XIX_BMC_HV_01_XIX_HCP5_CANFD01_f306148f_Tx: ComBitPosition=104, ComBitSize=17, ComSignalDataInvalidValue=131071, ComSignalInitValue=131070, ComSystemTemplateSystemSignalRef=BMC_Strom_02
            BMC_Strom_Messzeit_XIX_BMC_HV_01_XIX_HCP5_CANFD01_13ff988a_Tx: ComBitPosition=88, ComBitSize=8, ComSignalDataInvalidValue=255, ComSignalInitValue=254, ComSystemTemplateSystemSignalRef=BMC_Strom_Messzeit
            BMC_Strom_XIX_BMC_HV_01_XIX_HCP5_CANFD01_96bfb491_Tx: ComBitPosition=56, ComBitSize=16, ComSignalDataInvalidValue=65535, ComSignalInitValue=65534, ComSystemTemplateSystemSignalRef=BMC_Strom
            ISignalVoid_BMC_HV_01_XIX_HCP5_CANFD01_0_844e11d9_Tx: ComBitPosition=121, ComBitSize=7, ComSystemTemplateSystemSignalRef=SignalVoid_BMC_HV_01_0
        SG_BMC_HV_02_XIX_HCP5_CANFD01_055f405a_Tx: ComSystemTemplateSignalGroupRef=SG_BMC_HV_02_XIX_HCP5_CANFD01
          45 x ComGroupSignal, all with ComSignalEndianness=LITTLE_ENDIAN, ComSignalType=UINT8:
            Anzeige_SOC_XIX_BMC_HV_02_XIX_HCP5_CANFD01_33722566_Tx: ComBitPosition=192, ComBitSize=10, ComSignalDataInvalidValue=1023, ComSignalInitValue=1022, ComSystemTemplateSystemSignalRef=Anzeige_SOC
            BMC_AC_Laden_XIX_BMC_HV_02_XIX_HCP5_CANFD01_8ecbfecd_Tx: ComBitPosition=146, ComBitSize=2, ComSignalDataInvalidValue=3, ComSignalInitValue=0, ComSystemTemplateSystemSignalRef=BMC_AC_Laden
            BMC_Bank_Notlauf_erlaubt_XIX_BMC_HV_02_XIX_HCP5_CANFD01_b1b7657f_Tx: ComBitPosition=47, ComBitSize=1, ComSignalInitValue=1, ComSystemTemplateSystemSignalRef=BMC_Bank_Notlauf_erlaubt
            BMC_Bank_parallel_erlaubt_XIX_BMC_HV_02_XIX_HCP5_CANFD01_aa46a7a8_Tx: ComBitPosition=87, ComBitSize=1, ComSignalInitValue=1, ComSystemTemplateSystemSignalRef=BMC_Bank_parallel_erlaubt
            BMC_Bank_seriell_erlaubt_XIX_BMC_HV_02_XIX_HCP5_CANFD01_bf16937c_Tx: ComBitPosition=88, ComBitSize=1, ComSignalInitValue=1, ComSystemTemplateSystemSignalRef=BMC_Bank_seriell_erlaubt
            BMC_DC_Laden_XIX_BMC_HV_02_XIX_HCP5_CANFD01_2117dd81_Tx: ComBitPosition=144, ComBitSize=2, ComSignalDataInvalidValue=3, ComSignalInitValue=0, ComSystemTemplateSystemSignalRef=BMC_DC_Laden
            BMC_Energie_Sockel_SoC_XIX_BMC_HV_02_XIX_HCP5_CANFD01_eaf60dc0_Tx: ComBitPosition=285, ComBitSize=10, ComSignalDataInvalidValue=1023, ComSignalInitValue=1022, ComSystemTemplateSystemSignalRef=BMC_Energie_Sockel_SoC
            BMC_Energieinhalt_XIX_BMC_HV_02_XIX_HCP5_CANFD01_7eb2adbb_Tx: ComBitPosition=48, ComBitSize=16, ComSignalDataInvalidValue=65535, ComSignalInitValue=65534, ComSystemTemplateSystemSignalRef=BMC_Energieinhalt
            BMC_Fehler_Leistungsred_XIX_BMC_HV_02_XIX_HCP5_CANFD01_1063d945_Tx: ComBitPosition=204, ComBitSize=1, ComSignalInitValue=0, ComSystemTemplateSystemSignalRef=BMC_Fehler_Leistungsred
            BMC_Fehler_Warnung_XIX_BMC_HV_02_XIX_HCP5_CANFD01_c65ad143_Tx: ComBitPosition=136, ComBitSize=2, ComSignalInitValue=0, ComSystemTemplateSystemSignalRef=BMC_Fehler_Warnung
            BMC_HV_02_BZ_XIX_BMC_HV_02_XIX_HCP5_CANFD01_5b63fc59_Tx: ComBitPosition=8, ComBitSize=4, ComSignalInitValue=0, ComSystemTemplateSystemSignalRef=BMC_HV_02_BZ
            BMC_HV_02_CRC_XIX_BMC_HV_02_XIX_HCP5_CANFD01_ce5ae769_Tx: ComBitPosition=0, ComBitSize=8, ComSignalInitValue=0, ComSystemTemplateSystemSignalRef=BMC_HV_02_CRC
            BMC_IWU_Status_XIX_BMC_HV_02_XIX_HCP5_CANFD01_b8152992_Tx: ComBitPosition=130, ComBitSize=3, ComSignalInitValue=0, ComSystemTemplateSystemSignalRef=BMC_IWU_Status
            BMC_IWU_Wert_neg_XIX_BMC_HV_02_XIX_HCP5_CANFD01_475b0f1e_Tx: ComBitPosition=160, ComBitSize=16, ComSignalDataInvalidValue=65535, ComSignalInitValue=65534, ComSystemTemplateSystemSignalRef=BMC_IWU_Wert_neg
            BMC_IWU_Wert_pos_XIX_BMC_HV_02_XIX_HCP5_CANFD01_2b50ab04_Tx: ComBitPosition=176, ComBitSize=16, ComSignalDataInvalidValue=65535, ComSignalInitValue=65534, ComSystemTemplateSystemSignalRef=BMC_IWU_Wert_pos
            BMC_IstZellspannungMax_XIX_BMC_HV_02_XIX_HCP5_CANFD01_fe6df646_Tx: ComBitPosition=238, ComBitSize=12, ComSignalDataInvalidValue=4095, ComSignalInitValue=4094, ComSystemTemplateSystemSignalRef=BMC_IstZellspannungMax
            BMC_IstZellspannungMin_XIX_BMC_HV_02_XIX_HCP5_CANFD01_c69e0e49_Tx: ComBitPosition=250, ComBitSize=12, ComSignalDataInvalidValue=4095, ComSignalInitValue=4094, ComSystemTemplateSystemSignalRef=BMC_IstZellspannungMin
            BMC_Leerlaufspannung_XIX_BMC_HV_02_XIX_HCP5_CANFD01_d1e622c7_Tx: ComBitPosition=228, ComBitSize=10, ComSignalDataInvalidValue=1023, ComSignalInitValue=1022, ComSystemTemplateSystemSignalRef=BMC_Leerlaufspannung
            BMC_MMTR_Status_XIX_BMC_HV_02_XIX_HCP5_CANFD01_ebcb9fa7_Tx: ComBitPosition=138, ComBitSize=4, ComSignalDataInvalidValue=15, ComSignalInitValue=14, ComSystemTemplateSystemSignalRef=BMC_MMTR_Status
            BMC_Max_Entladeleistung_XIX_BMC_HV_02_XIX_HCP5_CANFD01_b29a42ba_Tx: ComBitPosition=32, ComBitSize=13, ComSignalDataInvalidValue=8191, ComSignalInitValue=8190, ComSystemTemplateSystemSignalRef=BMC_Max_Entladeleistung
            BMC_Max_Entladestrom_XIX_BMC_HV_02_XIX_HCP5_CANFD01_27287224_Tx: ComBitPosition=117, ComBitSize=13, ComSignalDataInvalidValue=8191, ComSignalInitValue=8190, ComSystemTemplateSystemSignalRef=BMC_Max_Entladestrom
            BMC_Max_Ladeleistung_XIX_BMC_HV_02_XIX_HCP5_CANFD01_f9f2d80f_Tx: ComBitPosition=64, ComBitSize=13, ComSignalDataInvalidValue=8191, ComSignalInitValue=8190, ComSystemTemplateSystemSignalRef=BMC_Max_Ladeleistung
            BMC_Max_Ladestrom_XIX_BMC_HV_02_XIX_HCP5_CANFD01_f2d66d83_Tx: ComBitPosition=104, ComBitSize=13, ComSignalDataInvalidValue=8191, ComSignalInitValue=8190, ComSystemTemplateSystemSignalRef=BMC_Max_Ladestrom
            BMC_MinDyn_Entladespannung_XIX_BMC_HV_02_XIX_HCP5_CANFD01_223599ce_Tx: ComBitPosition=208, ComBitSize=10, ComSignalDataInvalidValue=1023, ComSignalInitValue=1022, ComSystemTemplateSystemSignalRef=BMC_MinDyn_Entladespannung
            BMC_MinDyn_Ladespannung_XIX_BMC_HV_02_XIX_HCP5_CANFD01_f42858bf_Tx: ComBitPosition=218, ComBitSize=10, ComSignalDataInvalidValue=1023, ComSignalInitValue=1022, ComSystemTemplateSystemSignalRef=BMC_MinDyn_Ladespannung
            BMC_NutzbarerSOC_XIX_BMC_HV_02_XIX_HCP5_CANFD01_256e065e_Tx: ComBitPosition=148, ComBitSize=12, ComSignalDataInvalidValue=4095, ComSignalInitValue=4094, ComSystemTemplateSystemSignalRef=BMC_NutzbarerSOC
            BMC_PerfInd_Entladen_XIX_BMC_HV_02_XIX_HCP5_CANFD01_a6a6dabf_Tx: ComBitPosition=77, ComBitSize=10, ComSignalDataInvalidValue=1023, ComSignalInitValue=1022, ComSystemTemplateSystemSignalRef=BMC_PerfInd_Entladen
            BMC_PerfInd_Laden_XIX_BMC_HV_02_XIX_HCP5_CANFD01_56fee846_Tx: ComBitPosition=22, ComBitSize=10, ComSignalDataInvalidValue=1023, ComSignalInitValue=1022, ComSystemTemplateSystemSignalRef=BMC_PerfInd_Laden
            BMC_PredLeistung_StuetzungNV_XIX_BMC_HV_02_XIX_HCP5_CANFD01_7291cb43_Tx: ComBitPosition=262, ComBitSize=12, ComSignalDataInvalidValue=4095, ComSignalInitValue=4094, ComSystemTemplateSystemSignalRef=BMC_PredLeistung_StuetzungNV
            BMC_Spannung_DC_Ladesaeule_XIX_BMC_HV_02_XIX_HCP5_CANFD01_cf986e8b_Tx: ComBitPosition=89, ComBitSize=15, ComSignalDataInvalidValue=32767, ComSignalInitValue=32766, ComSystemTemplateSystemSignalRef=BMC_Spannung_DC_Ladesaeule
            BMC_Status_DCLS_XIX_BMC_HV_02_XIX_HCP5_CANFD01_9f28eb72_Tx: ComBitPosition=45, ComBitSize=2, ComSignalInitValue=0, ComSystemTemplateSystemSignalRef=BMC_Status_DCLS
            BMC_TechnischerSOC_XIX_BMC_HV_02_XIX_HCP5_CANFD01_d4a48305_Tx: ComBitPosition=274, ComBitSize=11, ComSignalDataInvalidValue=2047, ComSignalInitValue=2046, ComSystemTemplateSystemSignalRef=BMC_TechnischerSOC
            BMC_Unterboden_Warnung_XIX_BMC_HV_02_XIX_HCP5_CANFD01_8193ec14_Tx: ComBitPosition=205, ComBitSize=3, ComSignalDataInvalidValue=7, ComSignalInitValue=0, ComSystemTemplateSystemSignalRef=BMC_Unterboden_Warnung
            BMC_Verbauinfo_ACSchuetz_XIX_BMC_HV_02_XIX_HCP5_CANFD01_8875581d_Tx: ComBitPosition=133, ComBitSize=2, ComSignalInitValue=0, ComSystemTemplateSystemSignalRef=BMC_Verbauinfo_ACSchuetz
            BMC_Verbauinfo_Bank_XIX_BMC_HV_02_XIX_HCP5_CANFD01_106b9581_Tx: ComBitPosition=202, ComBitSize=2, ComSignalInitValue=0, ComSystemTemplateSystemSignalRef=BMC_Verbauinfo_Bank
            BMC_Vorlade_Zielspannung_XIX_BMC_HV_02_XIX_HCP5_CANFD01_a51a619b_Tx: ComBitPosition=12, ComBitSize=10, ComSignalDataInvalidValue=1023, ComSignalInitValue=1022, ComSystemTemplateSystemSignalRef=BMC_Vorlade_Zielspannung
            BMC_ZellTemp_virtuell_max_XIX_BMC_HV_02_XIX_HCP5_CANFD01_51ca2c01_Tx: ComBitPosition=305, ComBitSize=10, ComSignalDataInvalidValue=1023, ComSignalInitValue=1022, ComSystemTemplateSystemSignalRef=BMC_ZellTemp_virtuell_max
            BMC_ZellTemp_virtuell_min_XIX_BMC_HV_02_XIX_HCP5_CANFD01_6939d40e_Tx: ComBitPosition=295, ComBitSize=10, ComSignalDataInvalidValue=1023, ComSignalInitValue=1022, ComSystemTemplateSystemSignalRef=BMC_ZellTemp_virtuell_min
            Hybrid_01_OBD_Lampe_Anf_XIX_BMC_HV_02_XIX_HCP5_CANFD01_058f5c89_Tx: ComBitPosition=135, ComBitSize=1, ComSignalInitValue=0, ComSystemTemplateSystemSignalRef=Hybrid_01_OBD_Lampe_Anf
            ISignalVoid_BMC_HV_02_XIX_HCP5_CANFD01_0_2be75c13_Tx: ComBitPosition=142, ComBitSize=2, ComSystemTemplateSystemSignalRef=SignalVoid_BMC_HV_02_0
            ISignalVoid_BMC_HV_02_XIX_HCP5_CANFD01_1_5ce06c85_Tx: ComBitPosition=315, ComBitSize=5, ComSystemTemplateSystemSignalRef=SignalVoid_BMC_HV_02_1
            ISignalVoid_BMC_HV_02_XIX_HCP5_CANFD01_2_c5e93d3f_Tx: ComBitPosition=320, ComBitSize=8, ComSystemTemplateSystemSignalRef=SignalVoid_BMC_HV_02_2
            ISignalVoid_BMC_HV_02_XIX_HCP5_CANFD01_3_b2ee0da9_Tx: ComBitPosition=328, ComBitSize=8, ComSystemTemplateSystemSignalRef=SignalVoid_BMC_HV_02_3
            ISignalVoid_BMC_HV_02_XIX_HCP5_CANFD01_4_2c8a980a_Tx: ComBitPosition=336, ComBitSize=8, ComSystemTemplateSystemSignalRef=SignalVoid_BMC_HV_02_4
            ISignalVoid_BMC_HV_02_XIX_HCP5_CANFD01_5_5b8da89c_Tx: ComBitPosition=344, ComBitSize=8, ComSystemTemplateSystemSignalRef=SignalVoid_BMC_HV_02_5
        SG_BMC_HV_04_XIX_BMC_CAN01_0c592380_Tx: ComSystemTemplateSignalGroupRef=SG_BMC_HV_04_XIX_BMC_CAN01
          15 x ComGroupSignal, all with ComSignalEndianness=LITTLE_ENDIAN, ComSignalType=UINT8:
            BMC_Dev_Freigabe_XIX_BMC_HV_04_XIX_BMC_CAN01_61d04ea4_Tx: ComBitPosition=20, ComBitSize=1, ComSignalInitValue=0, ComSystemTemplateSystemSignalRef=BMC_Dev_Freigabe
            BMC_Flash_Freigabe_XIX_BMC_HV_04_XIX_BMC_CAN01_b37a831f_Tx: ComBitPosition=19, ComBitSize=1, ComSignalInitValue=0, ComSystemTemplateSystemSignalRef=BMC_Flash_Freigabe
            BMC_HV_04_BZ_XIX_BMC_HV_04_XIX_BMC_CAN01_508387a5_Tx: ComBitPosition=8, ComBitSize=4, ComSignalInitValue=0, ComSystemTemplateSystemSignalRef=BMC_HV_04_BZ
            BMC_HV_04_CRC_XIX_BMC_HV_04_XIX_BMC_CAN01_c70be3e6_Tx: ComBitPosition=0, ComBitSize=8, ComSignalInitValue=0, ComSystemTemplateSystemSignalRef=BMC_HV_04_CRC
            BMC_Iso_Mode_Anf_XIX_BMC_HV_04_XIX_BMC_CAN01_4e14e0ef_Tx: ComBitPosition=12, ComBitSize=3, ComSignalInitValue=0, ComSystemTemplateSystemSignalRef=BMC_Iso_Mode_Anf
            BMC_UI1_Spannung1_Schalt_Anf_XIX_BMC_HV_04_XIX_BMC_CAN01_6fcc6b71_Tx: ComBitPosition=15, ComBitSize=1, ComSignalInitValue=0, ComSystemTemplateSystemSignalRef=BMC_UI1_Spannung1_Schalt_Anf
            BMC_UI1_Spannung2_Schalt_Anf_XIX_BMC_HV_04_XIX_BMC_CAN01_4570dbf9_Tx: ComBitPosition=16, ComBitSize=1, ComSignalInitValue=0, ComSystemTemplateSystemSignalRef=BMC_UI1_Spannung2_Schalt_Anf
            BMC_UI2_Spannung1_Schalt_Anf_XIX_BMC_HV_04_XIX_BMC_CAN01_38ee4723_Tx: ComBitPosition=17, ComBitSize=1, ComSignalInitValue=0, ComSystemTemplateSystemSignalRef=BMC_UI2_Spannung1_Schalt_Anf
            BMC_UI2_Spannung2_Schalt_Anf_XIX_BMC_HV_04_XIX_BMC_CAN01_1252f7ab_Tx: ComBitPosition=18, ComBitSize=1, ComSignalInitValue=0, ComSystemTemplateSystemSignalRef=BMC_UI2_Spannung2_Schalt_Anf
            ISignalVoid_BMC_HV_04_XIX_BMC_CAN01_0_0d1efa8a_Tx: ComBitPosition=21, ComBitSize=3, ComSystemTemplateSystemSignalRef=SignalVoid_BMC_HV_04_0
            ISignalVoid_BMC_HV_04_XIX_BMC_CAN01_1_7a19ca1c_Tx: ComBitPosition=24, ComBitSize=8, ComSystemTemplateSystemSignalRef=SignalVoid_BMC_HV_04_1
            ISignalVoid_BMC_HV_04_XIX_BMC_CAN01_2_e3109ba6_Tx: ComBitPosition=32, ComBitSize=8, ComSystemTemplateSystemSignalRef=SignalVoid_BMC_HV_04_2
            ISignalVoid_BMC_HV_04_XIX_BMC_CAN01_3_9417ab30_Tx: ComBitPosition=40, ComBitSize=8, ComSystemTemplateSystemSignalRef=SignalVoid_BMC_HV_04_3
            ISignalVoid_BMC_HV_04_XIX_BMC_CAN01_4_0a733e93_Tx: ComBitPosition=48, ComBitSize=8, ComSystemTemplateSystemSignalRef=SignalVoid_BMC_HV_04_4
            ISignalVoid_BMC_HV_04_XIX_BMC_CAN01_5_7d740e05_Tx: ComBitPosition=56, ComBitSize=8, ComSystemTemplateSystemSignalRef=SignalVoid_BMC_HV_04_5
        SG_BMC_HV_10_XIX_BMC_CAN01_284dd772_Tx: ComSystemTemplateSignalGroupRef=SG_BMC_HV_10_XIX_BMC_CAN01
          11 x ComGroupSignal, all with ComSignalEndianness=LITTLE_ENDIAN, ComSignalType=UINT8:
            BMC_Datenuebernahme_Anf_XIX_BMC_HV_10_XIX_BMC_CAN01_5ffc7cd0_Tx: ComBitPosition=35, ComBitSize=1, ComSignalInitValue=0, ComSystemTemplateSystemSignalRef=BMC_Datenuebernahme_Anf
            BMC_HV_10_BZ_XIX_BMC_HV_10_XIX_BMC_CAN01_33eff98e_Tx: ComBitPosition=8, ComBitSize=4, ComSignalInitValue=0, ComSystemTemplateSystemSignalRef=BMC_HV_10_BZ
            BMC_HV_10_CRC_XIX_BMC_HV_10_XIX_BMC_CAN01_1c5705ee_Tx: ComBitPosition=0, ComBitSize=8, ComSignalInitValue=0, ComSystemTemplateSystemSignalRef=BMC_HV_10_CRC
            BMC_Lebensdauer_Trennelemente_XIX_BMC_HV_10_XIX_BMC_CAN01_16e3805b_Tx: ComBitPosition=15, ComBitSize=17, ComSignalDataInvalidValue=131071, ComSignalInitValue=131070, ComSystemTemplateSystemSignalRef=BMC_Lebensdauer_Trennelemente
            BMC_Sperrung_Unterspannung_XIX_BMC_HV_10_XIX_BMC_CAN01_71e0b0eb_Tx: ComBitPosition=12, ComBitSize=2, ComSignalDataInvalidValue=3, ComSignalInitValue=2, ComSystemTemplateSystemSignalRef=BMC_Sperrung_Unterspannung
            BMC_Status_HV_Spannungssensorik_XIX_BMC_HV_10_XIX_BMC_CAN01_2067c250_Tx: ComBitPosition=14, ComBitSize=1, ComSignalDataInvalidValue=1, ComSignalInitValue=0, ComSystemTemplateSystemSignalRef=BMC_Status_HV_Spannungssensorik
            BMC_Status_Trennelemente_XIX_BMC_HV_10_XIX_BMC_CAN01_15c64d44_Tx: ComBitPosition=32, ComBitSize=3, ComSignalDataInvalidValue=7, ComSignalInitValue=6, ComSystemTemplateSystemSignalRef=BMC_Status_Trennelemente
            ISignalVoid_BMC_HV_10_XIX_BMC_CAN01_0_91446ba4_Tx: ComBitPosition=36, ComBitSize=4, ComSystemTemplateSystemSignalRef=SignalVoid_BMC_HV_10_0
            ISignalVoid_BMC_HV_10_XIX_BMC_CAN01_1_e6435b32_Tx: ComBitPosition=40, ComBitSize=8, ComSystemTemplateSystemSignalRef=SignalVoid_BMC_HV_10_1
            ISignalVoid_BMC_HV_10_XIX_BMC_CAN01_2_7f4a0a88_Tx: ComBitPosition=48, ComBitSize=8, ComSystemTemplateSystemSignalRef=SignalVoid_BMC_HV_10_2
            ISignalVoid_BMC_HV_10_XIX_BMC_CAN01_3_084d3a1e_Tx: ComBitPosition=56, ComBitSize=8, ComSystemTemplateSystemSignalRef=SignalVoid_BMC_HV_10_3
        SG_BMC_HV_11_XIX_BMC_CAN01_91b60c9a_Tx: ComSystemTemplateSignalGroupRef=SG_BMC_HV_11_XIX_BMC_CAN01
          7 x ComGroupSignal, all with ComSignalEndianness=LITTLE_ENDIAN, ComSignalType=UINT8:
            BMC_HV_11_BZ_XIX_BMC_HV_11_XIX_BMC_CAN01_7bce27cc_Tx: ComBitPosition=8, ComBitSize=4, ComSignalInitValue=0, ComSystemTemplateSystemSignalRef=BMC_HV_11_BZ
            BMC_HV_11_CRC_XIX_BMC_HV_11_XIX_BMC_CAN01_935e4ef5_Tx: ComBitPosition=0, ComBitSize=8, ComSignalInitValue=0, ComSystemTemplateSystemSignalRef=BMC_HV_11_CRC
            BMC_Sperrung_Ueberspannung_XIX_BMC_HV_11_XIX_BMC_CAN01_d725cad5_Tx: ComBitPosition=12, ComBitSize=2, ComSignalDataInvalidValue=3, ComSignalInitValue=2, ComSystemTemplateSystemSignalRef=BMC_Sperrung_Ueberspannung
            BMC_Ueberspannungszaehler_CMC01_XIX_BMC_HV_11_XIX_BMC_CAN01_34d9816c_Tx: ComBitPosition=14, ComBitSize=9, ComSignalDataInvalidValue=511, ComSignalInitValue=510, ComSystemTemplateSystemSignalRef=BMC_Ueberspannungszaehler_CMC01
            BMC_Ueberspannungszaehler_CMC02_XIX_BMC_HV_11_XIX_BMC_CAN01_91d1ea00_Tx: ComBitPosition=23, ComBitSize=9, ComSignalDataInvalidValue=511, ComSignalInitValue=510, ComSystemTemplateSystemSignalRef=BMC_Ueberspannungszaehler_CMC02
            BMC_Uebertemperaturzaehler_CMC01_XIX_BMC_HV_11_XIX_BMC_CAN01_00b8f3d6_Tx: ComBitPosition=32, ComBitSize=16, ComSignalDataInvalidValue=65535, ComSignalInitValue=65534, ComSystemTemplateSystemSignalRef=BMC_Uebertemperaturzaehler_CMC01
            BMC_Uebertemperaturzaehler_CMC02_XIX_BMC_HV_11_XIX_BMC_CAN01_a5b098ba_Tx: ComBitPosition=48, ComBitSize=16, ComSignalDataInvalidValue=65535, ComSignalInitValue=65534, ComSystemTemplateSystemSignalRef=BMC_Uebertemperaturzaehler_CMC02
        SG_BMC_HV_12_XIX_BMC_CAN01_80cb66e3_Tx: ComSystemTemplateSignalGroupRef=SG_BMC_HV_12_XIX_BMC_CAN01
          7 x ComGroupSignal, all with ComSignalEndianness=LITTLE_ENDIAN, ComSignalType=UINT8:
            BMC_HV_12_BZ_XIX_BMC_HV_12_XIX_BMC_CAN01_a3ac450a_Tx: ComBitPosition=8, ComBitSize=4, ComSignalInitValue=0, ComSystemTemplateSystemSignalRef=BMC_HV_12_BZ
            BMC_HV_12_CRC_XIX_BMC_HV_12_XIX_BMC_CAN01_d9349599_Tx: ComBitPosition=0, ComBitSize=8, ComSignalInitValue=0, ComSystemTemplateSystemSignalRef=BMC_HV_12_CRC
            BMC_Sperrung_Uebertemperatur_XIX_BMC_HV_12_XIX_BMC_CAN01_2ce8de10_Tx: ComBitPosition=12, ComBitSize=2, ComSignalDataInvalidValue=3, ComSignalInitValue=2, ComSystemTemplateSystemSignalRef=BMC_Sperrung_Uebertemperatur
            BMC_Ueberspannungszaehler_CMC03_XIX_BMC_HV_12_XIX_BMC_CAN01_e3ab595d_Tx: ComBitPosition=14, ComBitSize=9, ComSignalDataInvalidValue=511, ComSignalInitValue=510, ComSystemTemplateSystemSignalRef=BMC_Ueberspannungszaehler_CMC03
            BMC_Ueberspannungszaehler_CMC04_XIX_BMC_HV_12_XIX_BMC_CAN01_11cd50e0_Tx: ComBitPosition=23, ComBitSize=9, ComSignalDataInvalidValue=511, ComSignalInitValue=510, ComSystemTemplateSystemSignalRef=BMC_Ueberspannungszaehler_CMC04
            BMC_Uebertemperaturzaehler_CMC03_XIX_BMC_HV_12_XIX_BMC_CAN01_d7ca2be7_Tx: ComBitPosition=32, ComBitSize=16, ComSignalDataInvalidValue=65535, ComSignalInitValue=65534, ComSystemTemplateSystemSignalRef=BMC_Uebertemperaturzaehler_CMC03
            BMC_Uebertemperaturzaehler_CMC04_XIX_BMC_HV_12_XIX_BMC_CAN01_25ac225a_Tx: ComBitPosition=48, ComBitSize=16, ComSignalDataInvalidValue=65535, ComSignalInitValue=65534, ComSystemTemplateSystemSignalRef=BMC_Uebertemperaturzaehler_CMC04
        SG_BMC_HV_13_XIX_BMC_CAN01_3930bd0b_Tx: ComSystemTemplateSignalGroupRef=SG_BMC_HV_13_XIX_BMC_CAN01
          8 x ComGroupSignal, all with ComSignalEndianness=LITTLE_ENDIAN, ComSignalType=UINT8:
            BMC_HV_13_BZ_XIX_BMC_HV_13_XIX_BMC_CAN01_eb8d9b48_Tx: ComBitPosition=8, ComBitSize=4, ComSignalInitValue=0, ComSystemTemplateSystemSignalRef=BMC_HV_13_BZ
            BMC_HV_13_CRC_XIX_BMC_HV_13_XIX_BMC_CAN01_563dde82_Tx: ComBitPosition=0, ComBitSize=8, ComSignalInitValue=0, ComSystemTemplateSystemSignalRef=BMC_HV_13_CRC
            BMC_Unterspannungszaehler_CMC01_XIX_BMC_HV_13_XIX_BMC_CAN01_ce713d44_Tx: ComBitPosition=12, ComBitSize=9, ComSignalDataInvalidValue=511, ComSignalInitValue=510, ComSystemTemplateSystemSignalRef=BMC_Unterspannungszaehler_CMC01
            BMC_Unterspannungszaehler_CMC02_XIX_BMC_HV_13_XIX_BMC_CAN01_6b795628_Tx: ComBitPosition=21, ComBitSize=9, ComSignalDataInvalidValue=511, ComSignalInitValue=510, ComSystemTemplateSystemSignalRef=BMC_Unterspannungszaehler_CMC02
            BMC_Unterspannungszaehler_CMC03_XIX_BMC_HV_13_XIX_BMC_CAN01_087e8f0c_Tx: ComBitPosition=30, ComBitSize=9, ComSignalDataInvalidValue=511, ComSignalInitValue=510, ComSystemTemplateSystemSignalRef=BMC_Unterspannungszaehler_CMC03
            BMC_Unterspannungszaehler_CMC04_XIX_BMC_HV_13_XIX_BMC_CAN01_fa1886b1_Tx: ComBitPosition=39, ComBitSize=9, ComSignalDataInvalidValue=511, ComSignalInitValue=510, ComSystemTemplateSystemSignalRef=BMC_Unterspannungszaehler_CMC04
            ISignalVoid_BMC_HV_13_XIX_BMC_CAN01_0_c2de3020_Tx: ComBitPosition=48, ComBitSize=8, ComSystemTemplateSystemSignalRef=SignalVoid_BMC_HV_13_0
            ISignalVoid_BMC_HV_13_XIX_BMC_CAN01_1_b5d900b6_Tx: ComBitPosition=56, ComBitSize=8, ComSystemTemplateSystemSignalRef=SignalVoid_BMC_HV_13_1
        SG_HVK_03_XIX_HCP5_CANFD01_2b81aede_Rx: ComSystemTemplateSignalGroupRef=SG_HVK_03_XIX_HCP5_CANFD01
          23 x ComGroupSignal, all with ComSignalEndianness=LITTLE_ENDIAN, ComSignalType=UINT8:
            HVK_03_BZ_XIX_HVK_03_XIX_HCP5_CANFD01_f1822d14_Rx: ComBitPosition=8, ComBitSize=4, ComSignalInitValue=0, ComSystemTemplateSystemSignalRef=HVK_03_BZ
            HVK_03_CRC_XIX_HVK_03_XIX_HCP5_CANFD01_d0e04876_Rx: ComBitPosition=0, ComBitSize=8, ComSignalInitValue=0, ComSystemTemplateSystemSignalRef=HVK_03_CRC
            HVK_AIAD_Sollmodus_XIX_HVK_03_XIX_HCP5_CANFD01_6d835f5e_Rx: ComBitPosition=46, ComBitSize=2, ComSignalInitValue=3, ComSystemTemplateSystemSignalRef=HVK_AIAD_Sollmodus
            HVK_AktiveEntladung_Anf_XIX_HVK_03_XIX_HCP5_CANFD01_c41b276e_Rx: ComBitPosition=52, ComBitSize=1, ComSignalInitValue=0, ComSystemTemplateSystemSignalRef=HVK_AktiveEntladung_Anf
            HVK_BMC_Sollmodus_XIX_HVK_03_XIX_HCP5_CANFD01_4f73c6c7_Rx: ComBitPosition=13, ComBitSize=3, ComSignalInitValue=7, ComSystemTemplateSystemSignalRef=HVK_BMC_Sollmodus
            HVK_BMC_Spannung_Anf_XIX_HVK_03_XIX_HCP5_CANFD01_c314cf2e_Rx: ComBitPosition=16, ComBitSize=4, ComSignalInitValue=3, ComSystemTemplateSystemSignalRef=HVK_BMC_Spannung_Anf
            HVK_DCDC_Sollmodus_XIX_HVK_03_XIX_HCP5_CANFD01_4ee29c42_Rx: ComBitPosition=24, ComBitSize=3, ComSignalInitValue=7, ComSystemTemplateSystemSignalRef=HVK_DCDC_Sollmodus
            HVK_EKK_Sollmodus_XIX_HVK_03_XIX_HCP5_CANFD01_f62409f8_Rx: ComBitPosition=27, ComBitSize=3, ComSignalInitValue=7, ComSystemTemplateSystemSignalRef=HVK_EKK_Sollmodus
            HVK_ETM_Freigabe_XIX_HVK_03_XIX_HCP5_CANFD01_edeb1f2b_Rx: ComBitPosition=30, ComBitSize=2, ComSignalInitValue=3, ComSystemTemplateSystemSignalRef=HVK_ETM_Freigabe
            HVK_Gesamtst_Spgfreiheit_XIX_HVK_03_XIX_HCP5_CANFD01_0729cb7e_Rx: ComBitPosition=40, ComBitSize=2, ComSignalDataInvalidValue=3, ComSignalInitValue=0, ComSystemTemplateSystemSignalRef=HVK_Gesamtst_Spgfreiheit
            HVK_HVHL_Sollmodus_XIX_HVK_03_XIX_HCP5_CANFD01_8bb1f684_Rx: ComBitPosition=20, ComBitSize=2, ComSignalInitValue=3, ComSystemTemplateSystemSignalRef=HVK_HVHL_Sollmodus
            HVK_HVHW_Sollmodus_XIX_HVK_03_XIX_HCP5_CANFD01_724712e2_Rx: ComBitPosition=22, ComBitSize=2, ComSignalInitValue=3, ComSystemTemplateSystemSignalRef=HVK_HVHW_Sollmodus
            HVK_HVLM_Sollmodus_XIX_HVK_03_XIX_HCP5_CANFD01_15b9bef2_Rx: ComBitPosition=48, ComBitSize=3, ComSignalInitValue=7, ComSystemTemplateSystemSignalRef=HVK_HVLM_Sollmodus
            HVK_HV_Netz_Warnungen_XIX_HVK_03_XIX_HCP5_CANFD01_ce1fd60e_Rx: ComBitPosition=42, ComBitSize=2, ComSignalInitValue=0, ComSystemTemplateSystemSignalRef=HVK_HV_Netz_Warnungen
            HVK_HV_Netz_Zustand_XIX_HVK_03_XIX_HCP5_CANFD01_9bc46e63_Rx: ComBitPosition=32, ComBitSize=4, ComSignalInitValue=15, ComSystemTemplateSystemSignalRef=HVK_HV_Netz_Zustand
            HVK_Iso_Messung_Start_XIX_HVK_03_XIX_HCP5_CANFD01_9030ca71_Rx: ComBitPosition=36, ComBitSize=3, ComSignalInitValue=0, ComSystemTemplateSystemSignalRef=HVK_Iso_Messung_Start
            HVK_Istmodus_Anf_XIX_HVK_03_XIX_HCP5_CANFD01_7cdd2f14_Rx: ComBitPosition=12, ComBitSize=1, ComSignalInitValue=0, ComSystemTemplateSystemSignalRef=HVK_Istmodus_Anf
            HVK_Vorladung_aktiv_XIX_HVK_03_XIX_HCP5_CANFD01_cca6e5eb_Rx: ComBitPosition=39, ComBitSize=1, ComSignalInitValue=0, ComSystemTemplateSystemSignalRef=HVK_Vorladung_aktiv
            HVK_eKAT_Sollmodus_XIX_HVK_03_XIX_HCP5_CANFD01_9a721cec_Rx: ComBitPosition=44, ComBitSize=2, ComSignalInitValue=3, ComSystemTemplateSystemSignalRef=HVK_eKAT_Sollmodus
            HV_Bordnetz_Fehler_XIX_HVK_03_XIX_HCP5_CANFD01_7d897576_Rx: ComBitPosition=53, ComBitSize=1, ComSignalDataInvalidValue=1, ComSignalInitValue=0, ComSystemTemplateSystemSignalRef=HV_Bordnetz_Fehler
            HV_Bordnetz_aktiv_XIX_HVK_03_XIX_HCP5_CANFD01_4f42f3b3_Rx: ComBitPosition=51, ComBitSize=1, ComSignalInitValue=0, ComSystemTemplateSystemSignalRef=HV_Bordnetz_aktiv
            ISignalVoid_HVK_03_XIX_HCP5_CANFD01_0_ba2f5215_Rx: ComBitPosition=54, ComBitSize=2, ComSystemTemplateSystemSignalRef=SignalVoid_HVK_03_0
            ISignalVoid_HVK_03_XIX_HCP5_CANFD01_1_cd286283_Rx: ComBitPosition=56, ComBitSize=8, ComSystemTemplateSystemSignalRef=SignalVoid_HVK_03_1
        SG_HVLM_14_XIX_HCP5_CANFD01_09e92b9c_Rx: ComSystemTemplateSignalGroupRef=SG_HVLM_14_XIX_HCP5_CANFD01
          21 x ComGroupSignal, all with ComSignalEndianness=LITTLE_ENDIAN, ComSignalType=UINT8:
            HVLM_14_BZ_XIX_HVLM_14_XIX_HCP5_CANFD01_95000b4e_Rx: ComBitPosition=8, ComBitSize=4, ComSignalInitValue=0, ComSystemTemplateSystemSignalRef=HVLM_14_BZ
            HVLM_14_CRC_XIX_HVLM_14_XIX_HCP5_CANFD01_fcfa0c25_Rx: ComBitPosition=0, ComBitSize=8, ComSignalInitValue=0, ComSystemTemplateSystemSignalRef=HVLM_14_CRC
            HVLM_Aktive_Ladeart_XIX_HVLM_14_XIX_HCP5_CANFD01_3e6c92a5_Rx: ComBitPosition=12, ComBitSize=3, ComSignalDataInvalidValue=7, ComSignalInitValue=0, ComSystemTemplateSystemSignalRef=HVLM_Aktive_Ladeart
            HVLM_DC_Aufstartmodus_XIX_HVLM_14_XIX_HCP5_CANFD01_c89fb2cb_Rx: ComBitPosition=46, ComBitSize=2, ComSignalInitValue=0, ComSystemTemplateSystemSignalRef=HVLM_DC_Aufstartmodus
            HVLM_Grundladen_Anf_XIX_HVLM_14_XIX_HCP5_CANFD01_f365712a_Rx: ComBitPosition=15, ComBitSize=1, ComSignalInitValue=0, ComSystemTemplateSystemSignalRef=HVLM_Grundladen_Anf
            HVLM_Intensitaet_Lk1_XIX_HVLM_14_XIX_HCP5_CANFD01_317a66db_Rx: ComBitPosition=56, ComBitSize=7, ComSignalDataInvalidValue=127, ComSignalInitValue=126, ComSystemTemplateSystemSignalRef=HVLM_Intensitaet_Lk1
            HVLM_Intensitaet_Lk2_XIX_HVLM_14_XIX_HCP5_CANFD01_75db43c3_Rx: ComBitPosition=20, ComBitSize=7, ComSignalDataInvalidValue=127, ComSignalInitValue=126, ComSystemTemplateSystemSignalRef=HVLM_Intensitaet_Lk2
            HVLM_Laden_ISO_Messung_Anf_XIX_HVLM_14_XIX_HCP5_CANFD01_81fe7f1f_Rx: ComBitPosition=63, ComBitSize=1, ComSignalInitValue=1, ComSystemTemplateSystemSignalRef=HVLM_Laden_ISO_Messung_Anf
            HVLM_Ladenaktiv_Standzyklus_XIX_HVLM_14_XIX_HCP5_CANFD01_268101c6_Rx: ComBitPosition=40, ComBitSize=1, ComSignalInitValue=0, ComSystemTemplateSystemSignalRef=HVLM_Ladenaktiv_Standzyklus
            HVLM_Ladeniveau_Anf_XIX_HVLM_14_XIX_HCP5_CANFD01_083f3bc2_Rx: ComBitPosition=37, ComBitSize=3, ComSignalDataInvalidValue=7, ComSignalInitValue=6, ComSystemTemplateSystemSignalRef=HVLM_Ladeniveau_Anf
            HVLM_Ladeszenario_XIX_HVLM_14_XIX_HCP5_CANFD01_9752bea6_Rx: ComBitPosition=48, ComBitSize=5, ComSignalDataInvalidValue=31, ComSignalInitValue=30, ComSystemTemplateSystemSignalRef=HVLM_Ladeszenario
            HVLM_Ladevorgang_Anf_XIX_HVLM_14_XIX_HCP5_CANFD01_4b9de30b_Rx: ComBitPosition=53, ComBitSize=3, ComSignalInitValue=0, ComSystemTemplateSystemSignalRef=HVLM_Ladevorgang_Anf
            HVLM_PrkCtl_StAlyReq_XIX_HVLM_14_XIX_HCP5_CANFD01_d9f73b2d_Rx: ComBitPosition=27, ComBitSize=3, ComSignalDataInvalidValue=7, ComSignalInitValue=6, ComSystemTemplateSystemSignalRef=HVLM_PrkCtl_StAlyReq
            HVLM_PrkCtl_StPrkLockReq_XIX_HVLM_14_XIX_HCP5_CANFD01_ac6108b6_Rx: ComBitPosition=30, ComBitSize=2, ComSignalDataInvalidValue=3, ComSignalInitValue=2, ComSystemTemplateSystemSignalRef=HVLM_PrkCtl_StPrkLockReq
            HVLM_Pulsierstufe_XIX_HVLM_14_XIX_HCP5_CANFD01_ff56f5e0_Rx: ComBitPosition=17, ComBitSize=3, ComSignalInitValue=0, ComSystemTemplateSystemSignalRef=HVLM_Pulsierstufe
            HVLM_Start_Pulserkennung_XIX_HVLM_14_XIX_HCP5_CANFD01_5376c852_Rx: ComBitPosition=41, ComBitSize=1, ComSignalInitValue=0, ComSystemTemplateSystemSignalRef=HVLM_Start_Pulserkennung
            HVLM_Steckerstatus_XIX_HVLM_14_XIX_HCP5_CANFD01_e501277b_Rx: ComBitPosition=35, ComBitSize=2, ComSignalDataInvalidValue=3, ComSignalInitValue=0, ComSystemTemplateSystemSignalRef=HVLM_Steckerstatus
            HVLM_WakeUpZaehlerResetAnf_XIX_HVLM_14_XIX_HCP5_CANFD01_40bfec16_Rx: ComBitPosition=32, ComBitSize=1, ComSignalInitValue=0, ComSystemTemplateSystemSignalRef=HVLM_WakeUpZaehlerResetAnf
            HVLM_ZustandLadeablauf_XIX_HVLM_14_XIX_HCP5_CANFD01_2597de22_Rx: ComBitPosition=42, ComBitSize=4, ComSignalDataInvalidValue=3, ComSignalInitValue=0, ComSystemTemplateSystemSignalRef=HVLM_ZustandLadeablauf
            ISignalVoid_HVLM_14_XIX_HCP5_CANFD01_0_fec5ceef_Rx: ComBitPosition=16, ComBitSize=1, ComSystemTemplateSystemSignalRef=SignalVoid_HVLM_14_0
            ISignalVoid_HVLM_14_XIX_HCP5_CANFD01_1_89c2fe79_Rx: ComBitPosition=33, ComBitSize=2, ComSystemTemplateSystemSignalRef=SignalVoid_HVLM_14_1
        SG_KS_Hybrid_01_Challenge_K_XIX_HCP5_CANFD01_aa09b31e_Tx: ComTimeout=0, ComSystemTemplateSignalGroupRef=SG_KS_Hybrid_01_Challenge_K_XIX_HCP5_CANFD01
          3 x ComGroupSignal:
            KS_Hybrid_01_ChK_IKACtr_XIX_KS_Hybrid_01_Challenge_K_XIX_HCP5_CANFD01_cabdb47b_Tx: ComBitPosition=16, ComBitSize=8, ComSignalEndianness=LITTLE_ENDIAN, ComSignalInitValue=0, ComSignalType=UINT8, ComSystemTemplateSystemSignalRef=KS_Hybrid_01_ChK_IKACtr
            KS_Hybrid_01_ChK_SID_XIX_KS_Hybrid_01_Challenge_K_XIX_HCP5_CANFD01_9b492ca3_Tx: ComBitPosition=0, ComBitSize=16, ComSignalEndianness=LITTLE_ENDIAN, ComSignalInitValue=0, ComSignalType=UINT8, ComSystemTemplateSystemSignalRef=KS_Hybrid_01_ChK_SID
            KS_Hybrid_01_ChK_XIX_KS_Hybrid_01_Challenge_K_XIX_HCP5_CANFD01_1c99de21_Tx: ComBitPosition=24, ComSignalEndianness=opaque, ComSignalInitValue=0 0 0 0 0 0 0 0, ComSignalLength=8, ComSignalType=UINT8_N, ComSystemTemplateSystemSignalRef=KS_Hybrid_01_ChK
        SG_KS_Hybrid_01_Challenge_M_XIX_HCP5_CANFD01_a4750f9b_Rx: ComTimeout=0, ComSystemTemplateSignalGroupRef=SG_KS_Hybrid_01_Challenge_M_XIX_HCP5_CANFD01
          3 x ComGroupSignal:
            KS_Hybrid_01_ChM_IKACtr_XIX_KS_Hybrid_01_Challenge_M_XIX_HCP5_CANFD01_c11cfd4a_Rx: ComBitPosition=16, ComBitSize=8, ComSignalEndianness=LITTLE_ENDIAN, ComSignalInitValue=0, ComSignalType=UINT8, ComSystemTemplateSystemSignalRef=KS_Hybrid_01_ChM_IKACtr
            KS_Hybrid_01_ChM_SID_XIX_KS_Hybrid_01_Challenge_M_XIX_HCP5_CANFD01_4420b38f_Rx: ComBitPosition=0, ComBitSize=16, ComSignalEndianness=LITTLE_ENDIAN, ComSignalInitValue=0, ComSignalType=UINT8, ComSystemTemplateSystemSignalRef=KS_Hybrid_01_ChM_SID
            KS_Hybrid_01_ChM_XIX_KS_Hybrid_01_Challenge_M_XIX_HCP5_CANFD01_be825fbb_Rx: ComBitPosition=24, ComSignalEndianness=opaque, ComSignalInitValue=0 0 0 0 0 0 0 0, ComSignalLength=8, ComSignalType=UINT8_N, ComSystemTemplateSystemSignalRef=KS_Hybrid_01_ChM
        SG_KS_Hybrid_01_ReqFrame_XIX_HCP5_CANFD01_619e85fb_Tx: ComTimeout=0, ComSystemTemplateSignalGroupRef=SG_KS_Hybrid_01_ReqFrame_XIX_HCP5_CANFD01
          8 x ComGroupSignal, all with ComSignalEndianness=LITTLE_ENDIAN, ComSignalInitValue=0, ComSignalType=UINT8:
            KS_Hybrid_01_Req_ErrCtr_XIX_KS_Hybrid_01_ReqFrame_XIX_HCP5_CANFD01_8e83ec82_Tx: ComBitPosition=24, ComBitSize=8, ComSystemTemplateSystemSignalRef=KS_Hybrid_01_Req_ErrCtr
            KS_Hybrid_01_Req_IKA_Retry_XIX_KS_Hybrid_01_ReqFrame_XIX_HCP5_CANFD01_9cc0e520_Tx: ComBitPosition=18, ComBitSize=1, ComSystemTemplateSystemSignalRef=KS_Hybrid_01_Req_IKA_Retry
            KS_Hybrid_01_Req_Prio_XIX_KS_Hybrid_01_ReqFrame_XIX_HCP5_CANFD01_10b8493f_Tx: ComBitPosition=16, ComBitSize=1, ComSystemTemplateSystemSignalRef=KS_Hybrid_01_Req_Prio
            KS_Hybrid_01_Req_SID_XIX_KS_Hybrid_01_ReqFrame_XIX_HCP5_CANFD01_1bcd362d_Tx: ComBitPosition=0, ComBitSize=16, ComSystemTemplateSystemSignalRef=KS_Hybrid_01_Req_SID
            KS_Hybrid_01_Req_SWMaj_XIX_KS_Hybrid_01_ReqFrame_XIX_HCP5_CANFD01_f8d0422c_Tx: ComBitPosition=32, ComBitSize=8, ComSystemTemplateSystemSignalRef=KS_Hybrid_01_Req_SWMaj
            KS_Hybrid_01_Req_SWMin_XIX_KS_Hybrid_01_ReqFrame_XIX_HCP5_CANFD01_4c96f203_Tx: ComBitPosition=40, ComBitSize=8, ComSystemTemplateSystemSignalRef=KS_Hybrid_01_Req_SWMin
            KS_Hybrid_01_Req_SWPat_XIX_KS_Hybrid_01_ReqFrame_XIX_HCP5_CANFD01_c36d1962_Tx: ComBitPosition=48, ComBitSize=8, ComSystemTemplateSystemSignalRef=KS_Hybrid_01_Req_SWPat
            KS_Hybrid_01_Req_VKMS_Err_XIX_KS_Hybrid_01_ReqFrame_XIX_HCP5_CANFD01_43fd6332_Tx: ComBitPosition=17, ComBitSize=1, ComSystemTemplateSystemSignalRef=KS_Hybrid_01_Req_VKMS_Err
        SG_KS_Hybrid_01_Response_K_XIX_HCP5_CANFD01_adb36dae_Tx: ComTimeout=0, ComSystemTemplateSignalGroupRef=SG_KS_Hybrid_01_Response_K_XIX_HCP5_CANFD01
          3 x ComGroupSignal:
            KS_Hybrid_01_ReK_IKACtr_XIX_KS_Hybrid_01_Response_K_XIX_HCP5_CANFD01_cc8f173c_Tx: ComBitPosition=16, ComBitSize=8, ComSignalEndianness=LITTLE_ENDIAN, ComSignalInitValue=0, ComSignalType=UINT8, ComSystemTemplateSystemSignalRef=KS_Hybrid_01_ReK_IKACtr
            KS_Hybrid_01_ReK_SID_XIX_KS_Hybrid_01_Response_K_XIX_HCP5_CANFD01_7371ae18_Tx: ComBitPosition=0, ComBitSize=16, ComSignalEndianness=LITTLE_ENDIAN, ComSignalInitValue=0, ComSignalType=UINT8, ComSystemTemplateSystemSignalRef=KS_Hybrid_01_ReK_SID
            KS_Hybrid_01_ReK_XIX_KS_Hybrid_01_Response_K_XIX_HCP5_CANFD01_e1783515_Tx: ComBitPosition=24, ComSignalEndianness=opaque, ComSignalInitValue=0 0 0 0 0 0 0 0, ComSignalLength=8, ComSignalType=UINT8_N, ComSystemTemplateSystemSignalRef=KS_Hybrid_01_ReK
        SG_KS_Hybrid_01_Response_M_XIX_HCP5_CANFD01_a3cfd12b_Rx: ComTimeout=0, ComSystemTemplateSignalGroupRef=SG_KS_Hybrid_01_Response_M_XIX_HCP5_CANFD01
          3 x ComGroupSignal:
            KS_Hybrid_01_ReM_IKACtr_XIX_KS_Hybrid_01_Response_M_XIX_HCP5_CANFD01_1f510c7e_Rx: ComBitPosition=16, ComBitSize=8, ComSignalEndianness=LITTLE_ENDIAN, ComSignalInitValue=0, ComSignalType=UINT8, ComSystemTemplateSystemSignalRef=KS_Hybrid_01_ReM_IKACtr
            KS_Hybrid_01_ReM_SID_XIX_KS_Hybrid_01_Response_M_XIX_HCP5_CANFD01_d3494a39_Rx: ComBitPosition=0, ComBitSize=16, ComSignalEndianness=LITTLE_ENDIAN, ComSignalInitValue=0, ComSignalType=UINT8, ComSystemTemplateSystemSignalRef=KS_Hybrid_01_ReM_SID
            KS_Hybrid_01_ReM_XIX_KS_Hybrid_01_Response_M_XIX_HCP5_CANFD01_34c0d6bb_Rx: ComBitPosition=24, ComSignalEndianness=opaque, ComSignalInitValue=0 0 0 0 0 0 0 0, ComSignalLength=8, ComSignalType=UINT8_N, ComSystemTemplateSystemSignalRef=KS_Hybrid_01_ReM
        SG_ORU_Control_A_01_XIX_HCP5_CANFD01_a8e78b2d_Rx: ComSystemTemplateSignalGroupRef=SG_ORU_Control_A_01_XIX_HCP5_CANFD01
          12 x ComGroupSignal, all with ComSignalEndianness=LITTLE_ENDIAN, ComSignalType=UINT8:
            ISignalVoid_ORU_Control_A_01_XIX_HCP5_CANFD01_0_d82ca1a5_Rx: ComBitPosition=53, ComBitSize=3, ComSystemTemplateSystemSignalRef=SignalVoid_ORU_Control_A_01_0
            ISignalVoid_ORU_Control_A_01_XIX_HCP5_CANFD01_1_af2b9133_Rx: ComBitPosition=56, ComBitSize=8, ComSystemTemplateSystemSignalRef=SignalVoid_ORU_Control_A_01_1
            ORU_Control_A_01_BZ_XIX_ORU_Control_A_01_XIX_HCP5_CANFD01_33cd8fe6_Rx: ComBitPosition=8, ComBitSize=4, ComSignalInitValue=0, ComSystemTemplateSystemSignalRef=ORU_Control_A_01_BZ
            ORU_Control_A_01_CRC_XIX_ORU_Control_A_01_XIX_HCP5_CANFD01_cd3556b4_Rx: ComBitPosition=0, ComBitSize=8, ComSignalInitValue=0, ComSystemTemplateSystemSignalRef=ORU_Control_A_01_CRC
            OnlineRemoteUpdateControlA_XIX_ORU_Control_A_01_XIX_HCP5_CANFD01_70378676_Rx: ComBitPosition=12, ComBitSize=4, ComSignalDataInvalidValue=15, ComSignalInitValue=0, ComSystemTemplateSystemSignalRef=OnlineRemoteUpdateControlA
            OnlineRemoteUpdateControlOldA_XIX_ORU_Control_A_01_XIX_HCP5_CANFD01_5f2b3492_Rx: ComBitPosition=16, ComBitSize=4, ComSignalDataInvalidValue=15, ComSignalInitValue=0, ComSystemTemplateSystemSignalRef=OnlineRemoteUpdateControlOldA
            OruControlReleaseA_XIX_ORU_Control_A_01_XIX_HCP5_CANFD01_e7faed30_Rx: ComBitPosition=24, ComBitSize=16, ComSignalInitValue=0, ComSystemTemplateSystemSignalRef=OruControlReleaseA
            OruControlStateA_XIX_ORU_Control_A_01_XIX_HCP5_CANFD01_1684c4c4_Rx: ComBitPosition=40, ComBitSize=8, ComSignalDataInvalidValue=129, ComSignalInitValue=0, ComSystemTemplateSystemSignalRef=OruControlStateA
            OruHostUpdateA_XIX_ORU_Control_A_01_XIX_HCP5_CANFD01_340b75b7_Rx: ComBitPosition=50, ComBitSize=3, ComSignalDataInvalidValue=4, ComSignalInitValue=0, ComSystemTemplateSystemSignalRef=OruHostUpdateA
            OruIntegrityCheckActiveA_XIX_ORU_Control_A_01_XIX_HCP5_CANFD01_3ef9195e_Rx: ComBitPosition=22, ComBitSize=2, ComSignalDataInvalidValue=3, ComSignalInitValue=0, ComSystemTemplateSystemSignalRef=OruIntegrityCheckActiveA
            OruReleasePartitionSwitchA_XIX_ORU_Control_A_01_XIX_HCP5_CANFD01_58bfa1dd_Rx: ComBitPosition=48, ComBitSize=2, ComSignalDataInvalidValue=3, ComSignalInitValue=0, ComSystemTemplateSystemSignalRef=OruReleasePartitionSwitchA
            OruVehicleLockRequestA_XIX_ORU_Control_A_01_XIX_HCP5_CANFD01_7602ad32_Rx: ComBitPosition=20, ComBitSize=2, ComSignalDataInvalidValue=3, ComSignalInitValue=0, ComSystemTemplateSystemSignalRef=OruVehicleLockRequestA
        SG_ORU_Control_D_01_XIX_HCP5_CANFD01_25c40c08_Rx: ComSystemTemplateSignalGroupRef=SG_ORU_Control_D_01_XIX_HCP5_CANFD01
          12 x ComGroupSignal, all with ComSignalEndianness=LITTLE_ENDIAN, ComSignalType=UINT8:
            ISignalVoid_ORU_Control_D_01_XIX_HCP5_CANFD01_0_4303eae2_Rx: ComBitPosition=53, ComBitSize=3, ComSystemTemplateSystemSignalRef=SignalVoid_ORU_Control_D_01_0
            ISignalVoid_ORU_Control_D_01_XIX_HCP5_CANFD01_1_3404da74_Rx: ComBitPosition=56, ComBitSize=8, ComSystemTemplateSystemSignalRef=SignalVoid_ORU_Control_D_01_1
            ORU_Control_D_01_BZ_XIX_ORU_Control_D_01_XIX_HCP5_CANFD01_feb38b7c_Rx: ComBitPosition=8, ComBitSize=4, ComSignalInitValue=0, ComSystemTemplateSystemSignalRef=ORU_Control_D_01_BZ
            ORU_Control_D_01_CRC_XIX_ORU_Control_D_01_XIX_HCP5_CANFD01_1b88220f_Rx: ComBitPosition=0, ComBitSize=8, ComSignalInitValue=0, ComSystemTemplateSystemSignalRef=ORU_Control_D_01_CRC
            OnlineRemoteUpdateControlD_XIX_ORU_Control_D_01_XIX_HCP5_CANFD01_52c8221f_Rx: ComBitPosition=12, ComBitSize=4, ComSignalDataInvalidValue=15, ComSignalInitValue=0, ComSystemTemplateSystemSignalRef=OnlineRemoteUpdateControlD
            OnlineRemoteUpdateControlOldD_XIX_ORU_Control_D_01_XIX_HCP5_CANFD01_7dd490fb_Rx: ComBitPosition=16, ComBitSize=4, ComSignalDataInvalidValue=15, ComSignalInitValue=0, ComSystemTemplateSystemSignalRef=OnlineRemoteUpdateControlOldD
            OruControlReleaseD_XIX_ORU_Control_D_01_XIX_HCP5_CANFD01_c5054959_Rx: ComBitPosition=24, ComBitSize=16, ComSignalInitValue=0, ComSystemTemplateSystemSignalRef=OruControlReleaseD
            OruControlStateD_XIX_ORU_Control_D_01_XIX_HCP5_CANFD01_347b60ad_Rx: ComBitPosition=40, ComBitSize=8, ComSignalDataInvalidValue=129, ComSignalInitValue=0, ComSystemTemplateSystemSignalRef=OruControlStateD
            OruHostUpdateD_XIX_ORU_Control_D_01_XIX_HCP5_CANFD01_16f4d1de_Rx: ComBitPosition=50, ComBitSize=3, ComSignalDataInvalidValue=4, ComSignalInitValue=0, ComSystemTemplateSystemSignalRef=OruHostUpdateD
            OruIntegrityCheckActiveD_XIX_ORU_Control_D_01_XIX_HCP5_CANFD01_1c06bd37_Rx: ComBitPosition=22, ComBitSize=2, ComSignalDataInvalidValue=3, ComSignalInitValue=0, ComSystemTemplateSystemSignalRef=OruIntegrityCheckActiveD
            OruReleasePartitionSwitchD_XIX_ORU_Control_D_01_XIX_HCP5_CANFD01_7a4005b4_Rx: ComBitPosition=48, ComBitSize=2, ComSignalDataInvalidValue=3, ComSignalInitValue=0, ComSystemTemplateSystemSignalRef=OruReleasePartitionSwitchD
            OruVehicleLockRequestD_XIX_ORU_Control_D_01_XIX_HCP5_CANFD01_54fd095b_Rx: ComBitPosition=20, ComBitSize=2, ComSignalDataInvalidValue=3, ComSignalInitValue=0, ComSystemTemplateSystemSignalRef=OruVehicleLockRequestD
        SG_OTAMC_D_01_XIX_HCP5_CANFD01_e331bc6d_Rx: ComSystemTemplateSignalGroupRef=SG_OTAMC_D_01_XIX_HCP5_CANFD01
          6 x ComGroupSignal, all with ComSignalEndianness=LITTLE_ENDIAN, ComSignalType=UINT8:
            ISignalVoid_OTAMC_D_01_XIX_HCP5_CANFD01_0_33510dd4_Rx: ComBitPosition=14, ComBitSize=2, ComSystemTemplateSystemSignalRef=SignalVoid_OTAMC_D_01_0
            ISignalVoid_OTAMC_D_01_XIX_HCP5_CANFD01_1_44563d42_Rx: ComBitPosition=16, ComBitSize=8, ComSystemTemplateSystemSignalRef=SignalVoid_OTAMC_D_01_1
            ISignalVoid_OTAMC_D_01_XIX_HCP5_CANFD01_2_dd5f6cf8_Rx: ComBitPosition=24, ComBitSize=8, ComSystemTemplateSystemSignalRef=SignalVoid_OTAMC_D_01_2
            OTAMC_D_01_BZ_XIX_OTAMC_D_01_XIX_HCP5_CANFD01_c1a59846_Rx: ComBitPosition=8, ComBitSize=4, ComSignalInitValue=0, ComSystemTemplateSystemSignalRef=OTAMC_D_01_BZ
            OTAMC_D_01_CRC_XIX_OTAMC_D_01_XIX_HCP5_CANFD01_194e47e0_Rx: ComBitPosition=0, ComBitSize=8, ComSignalInitValue=0, ComSystemTemplateSystemSignalRef=OTAMC_D_01_CRC
            VehicleProtectedEnvironment_D_XIX_OTAMC_D_01_XIX_HCP5_CANFD01_c9d358b3_Rx: ComBitPosition=12, ComBitSize=2, ComSignalInitValue=0, ComSystemTemplateSystemSignalRef=VehicleProtectedEnvironment_D
        SG_UI1_01_XIX_BMC_CAN01_cd9e369a_Rx: ComSystemTemplateSignalGroupRef=SG_UI1_01_XIX_BMC_CAN01
          7 x ComGroupSignal, all with ComSignalEndianness=LITTLE_ENDIAN, ComSignalType=UINT8:
            ISignalVoid_UI1_01_XIX_BMC_CAN01_0_699dceed_Rx: ComBitPosition=40, ComBitSize=8, ComSystemTemplateSystemSignalRef=SignalVoid_UI1_01_0
            ISignalVoid_UI1_01_XIX_BMC_CAN01_1_1e9afe7b_Rx: ComBitPosition=48, ComBitSize=8, ComSystemTemplateSystemSignalRef=SignalVoid_UI1_01_1
            ISignalVoid_UI1_01_XIX_BMC_CAN01_2_8793afc1_Rx: ComBitPosition=56, ComBitSize=8, ComSystemTemplateSystemSignalRef=SignalVoid_UI1_01_2
            UI1_KL30_Spannung_XIX_UI1_01_XIX_BMC_CAN01_3200e10f_Rx: ComBitPosition=32, ComBitSize=8, ComSignalDataInvalidValue=255, ComSignalInitValue=254, ComSystemTemplateSystemSignalRef=UI1_KL30_Spannung
            UI1_Strom_XIX_UI1_01_XIX_BMC_CAN01_3ab480fa_Rx: ComBitPosition=12, ComBitSize=20, ComSignalDataInvalidValue=1048575, ComSignalInitValue=1048574, ComSystemTemplateSystemSignalRef=UI1_Strom
            UISensorIso_01_BZ_XIX_UI1_01_XIX_BMC_CAN01_a5e1df82_Rx: ComBitPosition=8, ComBitSize=4, ComSignalInitValue=0, ComSystemTemplateSystemSignalRef=UISensorIso_01_BZ
            UISensorIso_01_CRC_XIX_UI1_01_XIX_BMC_CAN01_8bd876b3_Rx: ComBitPosition=0, ComBitSize=8, ComSignalInitValue=0, ComSystemTemplateSystemSignalRef=UISensorIso_01_CRC
        SG_UI1_02_XIX_BMC_CAN01_dce35ce3_Rx: ComSystemTemplateSignalGroupRef=SG_UI1_02_XIX_BMC_CAN01
          8 x ComGroupSignal, all with ComSignalEndianness=LITTLE_ENDIAN, ComSignalType=UINT8:
            ISignalVoid_UI1_02_XIX_BMC_CAN01_0_3a079569_Rx: ComBitPosition=63, ComBitSize=1, ComSystemTemplateSystemSignalRef=SignalVoid_UI1_02_0
            UI1_Spannung1_Schalt_Status_XIX_UI1_02_XIX_BMC_CAN01_283e718b_Rx: ComBitPosition=57, ComBitSize=3, ComSignalDataInvalidValue=7, ComSignalInitValue=6, ComSystemTemplateSystemSignalRef=UI1_Spannung1_Schalt_Status
            UI1_Spannung1_XIX_UI1_02_XIX_BMC_CAN01_51800a6b_Rx: ComBitPosition=12, ComBitSize=15, ComSignalDataInvalidValue=32767, ComSignalInitValue=32766, ComSystemTemplateSystemSignalRef=UI1_Spannung1
            UI1_Spannung2_Schalt_Status_XIX_UI1_02_XIX_BMC_CAN01_0282c103_Rx: ComBitPosition=60, ComBitSize=3, ComSignalDataInvalidValue=7, ComSignalInitValue=6, ComSystemTemplateSystemSignalRef=UI1_Spannung2_Schalt_Status
            UI1_Spannung2_XIX_UI1_02_XIX_BMC_CAN01_a3d7e793_Rx: ComBitPosition=27, ComBitSize=15, ComSignalDataInvalidValue=32767, ComSignalInitValue=32766, ComSystemTemplateSystemSignalRef=UI1_Spannung2
            UI1_Spannung3_XIX_UI1_02_XIX_BMC_CAN01_44ca4104_Rx: ComBitPosition=42, ComBitSize=15, ComSignalDataInvalidValue=32767, ComSignalInitValue=32766, ComSystemTemplateSystemSignalRef=UI1_Spannung3
            UISensorIso_02_BZ_XIX_UI1_02_XIX_BMC_CAN01_1194de97_Rx: ComBitPosition=8, ComBitSize=4, ComSignalInitValue=0, ComSystemTemplateSystemSignalRef=UISensorIso_02_BZ
            UISensorIso_02_CRC_XIX_UI1_02_XIX_BMC_CAN01_de0439d2_Rx: ComBitPosition=0, ComBitSize=8, ComSignalInitValue=0, ComSystemTemplateSystemSignalRef=UISensorIso_02_CRC
        SG_UI2_01_XIX_BMC_CAN01_2718ebf8_Rx: ComSystemTemplateSignalGroupRef=SG_UI2_01_XIX_BMC_CAN01
          7 x ComGroupSignal, all with ComSignalEndianness=LITTLE_ENDIAN, ComSignalType=UINT8:
            ISignalVoid_UI2_01_XIX_BMC_CAN01_0_c6348327_Rx: ComBitPosition=40, ComBitSize=8, ComSystemTemplateSystemSignalRef=SignalVoid_UI2_01_0
            ISignalVoid_UI2_01_XIX_BMC_CAN01_1_b133b3b1_Rx: ComBitPosition=48, ComBitSize=8, ComSystemTemplateSystemSignalRef=SignalVoid_UI2_01_1
            ISignalVoid_UI2_01_XIX_BMC_CAN01_2_283ae20b_Rx: ComBitPosition=56, ComBitSize=8, ComSystemTemplateSystemSignalRef=SignalVoid_UI2_01_2
            UI2_KL30_Spannung_XIX_UI2_01_XIX_BMC_CAN01_f23a8ce5_Rx: ComBitPosition=32, ComBitSize=8, ComSignalDataInvalidValue=255, ComSignalInitValue=254, ComSystemTemplateSystemSignalRef=UI2_KL30_Spannung
            UI2_Strom_XIX_UI2_01_XIX_BMC_CAN01_192d5527_Rx: ComBitPosition=12, ComBitSize=20, ComSignalDataInvalidValue=1048575, ComSignalInitValue=1048574, ComSystemTemplateSystemSignalRef=UI2_Strom
            UISensorPyro_01_BZ_XIX_UI2_01_XIX_BMC_CAN01_40400c5c_Rx: ComBitPosition=8, ComBitSize=4, ComSignalInitValue=0, ComSystemTemplateSystemSignalRef=UISensorPyro_01_BZ
            UISensorPyro_01_CRC_XIX_UI2_01_XIX_BMC_CAN01_a3867378_Rx: ComBitPosition=0, ComBitSize=8, ComSignalInitValue=0, ComSystemTemplateSystemSignalRef=UISensorPyro_01_CRC
        SG_UI2_02_XIX_BMC_CAN01_36658181_Rx: ComSystemTemplateSignalGroupRef=SG_UI2_02_XIX_BMC_CAN01
          8 x ComGroupSignal, all with ComSignalEndianness=LITTLE_ENDIAN, ComSignalType=UINT8:
            ISignalVoid_UI2_02_XIX_BMC_CAN01_0_95aed8a3_Rx: ComBitPosition=63, ComBitSize=1, ComSystemTemplateSystemSignalRef=SignalVoid_UI2_02_0
            UI2_Spannung1_Schalt_Status_XIX_UI2_02_XIX_BMC_CAN01_959a80bb_Rx: ComBitPosition=57, ComBitSize=3, ComSignalDataInvalidValue=7, ComSignalInitValue=6, ComSystemTemplateSystemSignalRef=UI2_Spannung1_Schalt_Status
            UI2_Spannung1_XIX_UI2_02_XIX_BMC_CAN01_dfe6acf7_Rx: ComBitPosition=12, ComBitSize=15, ComSignalDataInvalidValue=32767, ComSignalInitValue=32766, ComSystemTemplateSystemSignalRef=UI2_Spannung1
            UI2_Spannung2_Schalt_Status_XIX_UI2_02_XIX_BMC_CAN01_bf263033_Rx: ComBitPosition=60, ComBitSize=3, ComSignalDataInvalidValue=7, ComSignalInitValue=6, ComSystemTemplateSystemSignalRef=UI2_Spannung2_Schalt_Status
            UI2_Spannung2_XIX_UI2_02_XIX_BMC_CAN01_2db1410f_Rx: ComBitPosition=27, ComBitSize=15, ComSignalDataInvalidValue=32767, ComSignalInitValue=32766, ComSystemTemplateSystemSignalRef=UI2_Spannung2
            UI2_Spannung3_XIX_UI2_02_XIX_BMC_CAN01_caace798_Rx: ComBitPosition=42, ComBitSize=15, ComSignalDataInvalidValue=32767, ComSignalInitValue=32766, ComSystemTemplateSystemSignalRef=UI2_Spannung3
            UISensorPyro_02_BZ_XIX_UI2_02_XIX_BMC_CAN01_f4350d49_Rx: ComBitPosition=8, ComBitSize=4, ComSignalInitValue=0, ComSystemTemplateSystemSignalRef=UISensorPyro_02_BZ
            UISensorPyro_02_CRC_XIX_UI2_02_XIX_BMC_CAN01_f65a3c19_Rx: ComBitPosition=0, ComBitSize=8, ComSignalInitValue=0, ComSystemTemplateSystemSignalRef=UISensorPyro_02_CRC
        SG_UI2_03_XIX_BMC_CAN01_8f9e5a69_Rx: ComSystemTemplateSignalGroupRef=SG_UI2_03_XIX_BMC_CAN01
          8 x ComGroupSignal, all with ComSignalEndianness=LITTLE_ENDIAN, ComSignalType=UINT8:
            ISignalVoid_UI2_03_XIX_BMC_CAN01_0_120813e0_Rx: ComBitPosition=63, ComBitSize=1, ComSystemTemplateSystemSignalRef=SignalVoid_UI2_03_0
            UI2_HW_Crashleitung_Status_XIX_UI2_03_XIX_BMC_CAN01_ebcebdeb_Rx: ComBitPosition=57, ComBitSize=3, ComSignalDataInvalidValue=1, ComSignalInitValue=0, ComSystemTemplateSystemSignalRef=UI2_HW_Crashleitung_Status
            UI2_Pyro_Status_XIX_UI2_03_XIX_BMC_CAN01_0ab0a689_Rx: ComBitPosition=60, ComBitSize=3, ComSignalDataInvalidValue=1, ComSignalInitValue=0, ComSystemTemplateSystemSignalRef=UI2_Pyro_Status
            UI2_Spannung4_XIX_UI2_03_XIX_BMC_CAN01_ab944756_Rx: ComBitPosition=12, ComBitSize=15, ComSignalDataInvalidValue=32767, ComSignalInitValue=32766, ComSystemTemplateSystemSignalRef=UI2_Spannung4
            UI2_Spannung5_XIX_UI2_03_XIX_BMC_CAN01_4c89e1c1_Rx: ComBitPosition=27, ComBitSize=15, ComSignalDataInvalidValue=32767, ComSignalInitValue=32766, ComSystemTemplateSystemSignalRef=UI2_Spannung5
            UI2_Spannung6_XIX_UI2_03_XIX_BMC_CAN01_bede0c39_Rx: ComBitPosition=42, ComBitSize=15, ComSignalDataInvalidValue=32767, ComSignalInitValue=32766, ComSystemTemplateSystemSignalRef=UI2_Spannung6
            UISensorPyro_03_BZ_XIX_UI2_03_XIX_BMC_CAN01_2ec90f85_Rx: ComBitPosition=8, ComBitSize=4, ComSignalInitValue=0, ComSystemTemplateSystemSignalRef=UISensorPyro_03_BZ
            UISensorPyro_03_CRC_XIX_UI2_03_XIX_BMC_CAN01_73c104f9_Rx: ComBitPosition=0, ComBitSize=8, ComSignalInitValue=0, ComSystemTemplateSystemSignalRef=UISensorPyro_03_CRC
    ComGeneral
  module config ComM
    ComMConfigSet: ComMPncEnabled=true
      CN_BMC_CAN01_78a85e89 (ComMChannel): ComMBusType=COMM_BUS_TYPE_CAN, ComMChannelId=0
        ComMNetworkManagement: ComMNmVariant=FULL
        CN_BMC_CAN01_30c09f28 (ComMUserPerChannel): ComMUserChannel=CN_BMC_CAN01_908d0059
      CN_HCP5_CANFD01_54d90215 (ComMChannel): ComMBusType=COMM_BUS_TYPE_CAN, ComMChannelId=1, ComMPncGatewayType=COMM_GATEWAY_TYPE_NONE
        ComMNetworkManagement: ComMNmVariant=FULL
        CN_HCP5_CANFD01_828294e2 (ComMUserPerChannel): ComMUserChannel=CN_HCP5_CANFD01_84d44928
      48 x ComMPnc, all with ComMChannelPerPnc=ComMConfigSet/CN_HCP5_CANFD01_54d90215:
        PNC_01_CarWakeUp_d7102746: ComMPncId=8, ComMChannelPerPnc=ComMConfigSet/CN_BMC_CAN01_78a85e89, ComMUserPerPnc=PNC_01_CarWakeUp_bf3ce487
          ComSignalPnc_EIRA_CAN_Rx_1e4792f2 (ComMPncComSignal): ComMPncComSignalDirection=RX, ComMPncComSignalKind=EIRA, ComMPncComSignalRef=ComSignalPnc_EIRA_CAN_Rx
          NM_Hybrid_01_FCAB_XIX_NM_Hybrid_01_XIX_HCP5_CANFD01_38c188fa_Tx_8c6d3281 (ComMPncComSignal):
            ComMPncComSignalDirection = TX
            ComMPncComSignalKind = EIRA
            ComMPncComSignalChannelRef = ComMConfigSet/CN_HCP5_CANFD01_54d90215
            ComMPncComSignalRef = NM_Hybrid_01_FCAB_XIX_NM_Hybrid_01_XIX_HCP5_CANFD01_38c188fa_Tx
        PNC_02_Basefunction_Powertrain_6b6ac64e: ComMPncId=9, ComMUserPerPnc=PNC_02_Basefunction_Powertrain_6e8e3f0b
          ComSignalPnc_EIRA_CAN_Rx_1e4792f2 (ComMPncComSignal): ComMPncComSignalDirection=RX, ComMPncComSignalKind=EIRA, ComMPncComSignalRef=ComSignalPnc_EIRA_CAN_Rx
          NM_Hybrid_01_FCAB_XIX_NM_Hybrid_01_XIX_HCP5_CANFD01_38c188fa_Tx_8c6d3281 (ComMPncComSignal):
            ComMPncComSignalDirection = TX
            ComMPncComSignalKind = EIRA
            ComMPncComSignalChannelRef = ComMConfigSet/CN_HCP5_CANFD01_54d90215
            ComMPncComSignalRef = NM_Hybrid_01_FCAB_XIX_NM_Hybrid_01_XIX_HCP5_CANFD01_38c188fa_Tx
        PNC_03_Basefunction_Chassis_a155dfc3: ComMPncId=10, ComMUserPerPnc=PNC_03_Basefunction_Chassis_74381a7a
          ComSignalPnc_EIRA_CAN_Rx_1e4792f2 (ComMPncComSignal): ComMPncComSignalDirection=RX, ComMPncComSignalKind=EIRA, ComMPncComSignalRef=ComSignalPnc_EIRA_CAN_Rx
          NM_Hybrid_01_FCAB_XIX_NM_Hybrid_01_XIX_HCP5_CANFD01_38c188fa_Tx_8c6d3281 (ComMPncComSignal):
            ComMPncComSignalDirection = TX
            ComMPncComSignalKind = EIRA
            ComMPncComSignalChannelRef = ComMConfigSet/CN_HCP5_CANFD01_54d90215
            ComMPncComSignalRef = NM_Hybrid_01_FCAB_XIX_NM_Hybrid_01_XIX_HCP5_CANFD01_38c188fa_Tx
        PNC_04_Basefunction_DrivingAssistance_f26b19b4: ComMPncId=11, ComMUserPerPnc=PNC_04_Basefunction_DrivingAssistance_2e755e80
          ComSignalPnc_EIRA_CAN_Rx_1e4792f2 (ComMPncComSignal): ComMPncComSignalDirection=RX, ComMPncComSignalKind=EIRA, ComMPncComSignalRef=ComSignalPnc_EIRA_CAN_Rx
          NM_Hybrid_01_FCAB_XIX_NM_Hybrid_01_XIX_HCP5_CANFD01_38c188fa_Tx_8c6d3281 (ComMPncComSignal):
            ComMPncComSignalDirection = TX
            ComMPncComSignalKind = EIRA
            ComMPncComSignalChannelRef = ComMConfigSet/CN_HCP5_CANFD01_54d90215
            ComMPncComSignalRef = NM_Hybrid_01_FCAB_XIX_NM_Hybrid_01_XIX_HCP5_CANFD01_38c188fa_Tx
        PNC_05_Basefunction_Infotainment_f043623b: ComMPncId=12, ComMUserPerPnc=PNC_05_Basefunction_Infotainment_d739ca28
          ComSignalPnc_EIRA_CAN_Rx_1e4792f2 (ComMPncComSignal): ComMPncComSignalDirection=RX, ComMPncComSignalKind=EIRA, ComMPncComSignalRef=ComSignalPnc_EIRA_CAN_Rx
          NM_Hybrid_01_FCAB_XIX_NM_Hybrid_01_XIX_HCP5_CANFD01_38c188fa_Tx_8c6d3281 (ComMPncComSignal):
            ComMPncComSignalDirection = TX
            ComMPncComSignalKind = EIRA
            ComMPncComSignalChannelRef = ComMConfigSet/CN_HCP5_CANFD01_54d90215
            ComMPncComSignalRef = NM_Hybrid_01_FCAB_XIX_NM_Hybrid_01_XIX_HCP5_CANFD01_38c188fa_Tx
        PNC_06_Basefunction_ComfortLight_d2d0a736: ComMPncId=13, ComMUserPerPnc=PNC_06_Basefunction_ComfortLight_8074acb0
          ComSignalPnc_EIRA_CAN_Rx_1e4792f2 (ComMPncComSignal): ComMPncComSignalDirection=RX, ComMPncComSignalKind=EIRA, ComMPncComSignalRef=ComSignalPnc_EIRA_CAN_Rx
          NM_Hybrid_01_FCAB_XIX_NM_Hybrid_01_XIX_HCP5_CANFD01_38c188fa_Tx_8c6d3281 (ComMPncComSignal):
            ComMPncComSignalDirection = TX
            ComMPncComSignalKind = EIRA
            ComMPncComSignalChannelRef = ComMConfigSet/CN_HCP5_CANFD01_54d90215
            ComMPncComSignalRef = NM_Hybrid_01_FCAB_XIX_NM_Hybrid_01_XIX_HCP5_CANFD01_38c188fa_Tx
        PNC_07_Basefunction_CrossSection_7b625db2: ComMPncId=14, ComMUserPerPnc=PNC_07_Basefunction_CrossSection_5c9febde
          ComSignalPnc_EIRA_CAN_Rx_1e4792f2 (ComMPncComSignal): ComMPncComSignalDirection=RX, ComMPncComSignalKind=EIRA, ComMPncComSignalRef=ComSignalPnc_EIRA_CAN_Rx
          NM_Hybrid_01_FCAB_XIX_NM_Hybrid_01_XIX_HCP5_CANFD01_38c188fa_Tx_8c6d3281 (ComMPncComSignal):
            ComMPncComSignalDirection = TX
            ComMPncComSignalKind = EIRA
            ComMPncComSignalChannelRef = ComMConfigSet/CN_HCP5_CANFD01_54d90215
            ComMPncComSignalRef = NM_Hybrid_01_FCAB_XIX_NM_Hybrid_01_XIX_HCP5_CANFD01_38c188fa_Tx
        PNC_08_Basefunction_Connectivity_56f2bd6b: ComMPncId=15, ComMUserPerPnc=PNC_08_Basefunction_Connectivity_33115909
          ComSignalPnc_EIRA_CAN_Rx_1e4792f2 (ComMPncComSignal): ComMPncComSignalDirection=RX, ComMPncComSignalKind=EIRA, ComMPncComSignalRef=ComSignalPnc_EIRA_CAN_Rx
          NM_Hybrid_01_FCAB_XIX_NM_Hybrid_01_XIX_HCP5_CANFD01_38c188fa_Tx_8c6d3281 (ComMPncComSignal):
            ComMPncComSignalDirection = TX
            ComMPncComSignalKind = EIRA
            ComMPncComSignalChannelRef = ComMConfigSet/CN_HCP5_CANFD01_54d90215
            ComMPncComSignalRef = NM_Hybrid_01_FCAB_XIX_NM_Hybrid_01_XIX_HCP5_CANFD01_38c188fa_Tx
        PNC_10_Powertrain_b3959ad4: ComMPncId=17, ComMUserPerPnc=PNC_10_Powertrain_5fe7c550
          ComSignalPnc_EIRA_CAN_Rx_1e4792f2 (ComMPncComSignal): ComMPncComSignalDirection=RX, ComMPncComSignalKind=EIRA, ComMPncComSignalRef=ComSignalPnc_EIRA_CAN_Rx
          NM_Hybrid_01_FCAB_XIX_NM_Hybrid_01_XIX_HCP5_CANFD01_38c188fa_Tx_8c6d3281 (ComMPncComSignal):
            ComMPncComSignalDirection = TX
            ComMPncComSignalKind = EIRA
            ComMPncComSignalChannelRef = ComMConfigSet/CN_HCP5_CANFD01_54d90215
            ComMPncComSignalRef = NM_Hybrid_01_FCAB_XIX_NM_Hybrid_01_XIX_HCP5_CANFD01_38c188fa_Tx
        PNC_11_Chassis_dce36bbc: ComMPncId=18, ComMUserPerPnc=PNC_11_Chassis_fd87aaa6
          ComSignalPnc_EIRA_CAN_Rx_1e4792f2 (ComMPncComSignal): ComMPncComSignalDirection=RX, ComMPncComSignalKind=EIRA, ComMPncComSignalRef=ComSignalPnc_EIRA_CAN_Rx
          NM_Hybrid_01_FCAB_XIX_NM_Hybrid_01_XIX_HCP5_CANFD01_38c188fa_Tx_8c6d3281 (ComMPncComSignal):
            ComMPncComSignalDirection = TX
            ComMPncComSignalKind = EIRA
            ComMPncComSignalChannelRef = ComMConfigSet/CN_HCP5_CANFD01_54d90215
            ComMPncComSignalRef = NM_Hybrid_01_FCAB_XIX_NM_Hybrid_01_XIX_HCP5_CANFD01_38c188fa_Tx
        PNC_12_GearSelector_9f4a754a: ComMPncId=19, ComMUserPerPnc=PNC_12_GearSelector_2aa5ddd0
          ComSignalPnc_EIRA_CAN_Rx_1e4792f2 (ComMPncComSignal): ComMPncComSignalDirection=RX, ComMPncComSignalKind=EIRA, ComMPncComSignalRef=ComSignalPnc_EIRA_CAN_Rx
          NM_Hybrid_01_FCAB_XIX_NM_Hybrid_01_XIX_HCP5_CANFD01_38c188fa_Tx_8c6d3281 (ComMPncComSignal):
            ComMPncComSignalDirection = TX
            ComMPncComSignalKind = EIRA
            ComMPncComSignalChannelRef = ComMConfigSet/CN_HCP5_CANFD01_54d90215
            ComMPncComSignalRef = NM_Hybrid_01_FCAB_XIX_NM_Hybrid_01_XIX_HCP5_CANFD01_38c188fa_Tx
        PNC_13_Airbag_727cecad: ComMPncId=20, ComMUserPerPnc=PNC_13_Airbag_2554061c
          ComSignalPnc_EIRA_CAN_Rx_1e4792f2 (ComMPncComSignal): ComMPncComSignalDirection=RX, ComMPncComSignalKind=EIRA, ComMPncComSignalRef=ComSignalPnc_EIRA_CAN_Rx
          NM_Hybrid_01_FCAB_XIX_NM_Hybrid_01_XIX_HCP5_CANFD01_38c188fa_Tx_8c6d3281 (ComMPncComSignal):
            ComMPncComSignalDirection = TX
            ComMPncComSignalKind = EIRA
            ComMPncComSignalChannelRef = ComMConfigSet/CN_HCP5_CANFD01_54d90215
            ComMPncComSignalRef = NM_Hybrid_01_FCAB_XIX_NM_Hybrid_01_XIX_HCP5_CANFD01_38c188fa_Tx
        PNC_14_InfotainmentExtensions_ca9cb1f5: ComMPncId=21, ComMUserPerPnc=PNC_14_InfotainmentExtensions_d7c4346a
          ComSignalPnc_EIRA_CAN_Rx_1e4792f2 (ComMPncComSignal): ComMPncComSignalDirection=RX, ComMPncComSignalKind=EIRA, ComMPncComSignalRef=ComSignalPnc_EIRA_CAN_Rx
          NM_Hybrid_01_FCAB_XIX_NM_Hybrid_01_XIX_HCP5_CANFD01_38c188fa_Tx_8c6d3281 (ComMPncComSignal):
            ComMPncComSignalDirection = TX
            ComMPncComSignalKind = EIRA
            ComMPncComSignalChannelRef = ComMConfigSet/CN_HCP5_CANFD01_54d90215
            ComMPncComSignalRef = NM_Hybrid_01_FCAB_XIX_NM_Hybrid_01_XIX_HCP5_CANFD01_38c188fa_Tx
        PNC_15_InstrumentclusterDisplay_afd3c636: ComMPncId=22, ComMUserPerPnc=PNC_15_InstrumentclusterDisplay_1a610817
          ComSignalPnc_EIRA_CAN_Rx_1e4792f2 (ComMPncComSignal): ComMPncComSignalDirection=RX, ComMPncComSignalKind=EIRA, ComMPncComSignalRef=ComSignalPnc_EIRA_CAN_Rx
          NM_Hybrid_01_FCAB_XIX_NM_Hybrid_01_XIX_HCP5_CANFD01_38c188fa_Tx_8c6d3281 (ComMPncComSignal):
            ComMPncComSignalDirection = TX
            ComMPncComSignalKind = EIRA
            ComMPncComSignalChannelRef = ComMConfigSet/CN_HCP5_CANFD01_54d90215
            ComMPncComSignalRef = NM_Hybrid_01_FCAB_XIX_NM_Hybrid_01_XIX_HCP5_CANFD01_38c188fa_Tx
        PNC_16_InfotainmentDisplay_e8d84b12: ComMPncId=23, ComMUserPerPnc=PNC_16_InfotainmentDisplay_1d18259d
          ComSignalPnc_EIRA_CAN_Rx_1e4792f2 (ComMPncComSignal): ComMPncComSignalDirection=RX, ComMPncComSignalKind=EIRA, ComMPncComSignalRef=ComSignalPnc_EIRA_CAN_Rx
          NM_Hybrid_01_FCAB_XIX_NM_Hybrid_01_XIX_HCP5_CANFD01_38c188fa_Tx_8c6d3281 (ComMPncComSignal):
            ComMPncComSignalDirection = TX
            ComMPncComSignalKind = EIRA
            ComMPncComSignalChannelRef = ComMConfigSet/CN_HCP5_CANFD01_54d90215
            ComMPncComSignalRef = NM_Hybrid_01_FCAB_XIX_NM_Hybrid_01_XIX_HCP5_CANFD01_38c188fa_Tx
        PNC_17_Audio_8cbcad43: ComMPncId=24, ComMUserPerPnc=PNC_17_Audio_d11279f4
          ComSignalPnc_EIRA_CAN_Rx_1e4792f2 (ComMPncComSignal): ComMPncComSignalDirection=RX, ComMPncComSignalKind=EIRA, ComMPncComSignalRef=ComSignalPnc_EIRA_CAN_Rx
          NM_Hybrid_01_FCAB_XIX_NM_Hybrid_01_XIX_HCP5_CANFD01_38c188fa_Tx_8c6d3281 (ComMPncComSignal):
            ComMPncComSignalDirection = TX
            ComMPncComSignalKind = EIRA
            ComMPncComSignalChannelRef = ComMConfigSet/CN_HCP5_CANFD01_54d90215
            ComMPncComSignalRef = NM_Hybrid_01_FCAB_XIX_NM_Hybrid_01_XIX_HCP5_CANFD01_38c188fa_Tx
        PNC_18_VirtualSideMirrors_5814f436: ComMPncId=25, ComMUserPerPnc=PNC_18_VirtualSideMirrors_dca4d4b3
          ComSignalPnc_EIRA_CAN_Rx_1e4792f2 (ComMPncComSignal): ComMPncComSignalDirection=RX, ComMPncComSignalKind=EIRA, ComMPncComSignalRef=ComSignalPnc_EIRA_CAN_Rx
          NM_Hybrid_01_FCAB_XIX_NM_Hybrid_01_XIX_HCP5_CANFD01_38c188fa_Tx_8c6d3281 (ComMPncComSignal):
            ComMPncComSignalDirection = TX
            ComMPncComSignalKind = EIRA
            ComMPncComSignalChannelRef = ComMConfigSet/CN_HCP5_CANFD01_54d90215
            ComMPncComSignalRef = NM_Hybrid_01_FCAB_XIX_NM_Hybrid_01_XIX_HCP5_CANFD01_38c188fa_Tx
        PNC_19_Doors_Hatches_6a90831c: ComMPncId=26, ComMUserPerPnc=PNC_19_Doors_Hatches_58052c40
          ComSignalPnc_EIRA_CAN_Rx_1e4792f2 (ComMPncComSignal): ComMPncComSignalDirection=RX, ComMPncComSignalKind=EIRA, ComMPncComSignalRef=ComSignalPnc_EIRA_CAN_Rx
          NM_Hybrid_01_FCAB_XIX_NM_Hybrid_01_XIX_HCP5_CANFD01_38c188fa_Tx_8c6d3281 (ComMPncComSignal):
            ComMPncComSignalDirection = TX
            ComMPncComSignalKind = EIRA
            ComMPncComSignalChannelRef = ComMConfigSet/CN_HCP5_CANFD01_54d90215
            ComMPncComSignalRef = NM_Hybrid_01_FCAB_XIX_NM_Hybrid_01_XIX_HCP5_CANFD01_38c188fa_Tx
        PNC_20_OptionalComfort_769509a7: ComMPncId=27, ComMUserPerPnc=PNC_20_OptionalComfort_76e30655
          ComSignalPnc_EIRA_CAN_Rx_1e4792f2 (ComMPncComSignal): ComMPncComSignalDirection=RX, ComMPncComSignalKind=EIRA, ComMPncComSignalRef=ComSignalPnc_EIRA_CAN_Rx
          NM_Hybrid_01_FCAB_XIX_NM_Hybrid_01_XIX_HCP5_CANFD01_38c188fa_Tx_8c6d3281 (ComMPncComSignal):
            ComMPncComSignalDirection = TX
            ComMPncComSignalKind = EIRA
            ComMPncComSignalChannelRef = ComMConfigSet/CN_HCP5_CANFD01_54d90215
            ComMPncComSignalRef = NM_Hybrid_01_FCAB_XIX_NM_Hybrid_01_XIX_HCP5_CANFD01_38c188fa_Tx
        PNC_21_AirSuspension_32658f46: ComMPncId=28, ComMUserPerPnc=PNC_21_AirSuspension_3e4d6d03
          ComSignalPnc_EIRA_CAN_Rx_1e4792f2 (ComMPncComSignal): ComMPncComSignalDirection=RX, ComMPncComSignalKind=EIRA, ComMPncComSignalRef=ComSignalPnc_EIRA_CAN_Rx
          NM_Hybrid_01_FCAB_XIX_NM_Hybrid_01_XIX_HCP5_CANFD01_38c188fa_Tx_8c6d3281 (ComMPncComSignal):
            ComMPncComSignalDirection = TX
            ComMPncComSignalKind = EIRA
            ComMPncComSignalChannelRef = ComMConfigSet/CN_HCP5_CANFD01_54d90215
            ComMPncComSignalRef = NM_Hybrid_01_FCAB_XIX_NM_Hybrid_01_XIX_HCP5_CANFD01_38c188fa_Tx
        PNC_22_ExteriorLights_ee477910: ComMPncId=29, ComMUserPerPnc=PNC_22_ExteriorLights_3bdfbcd3
          ComSignalPnc_EIRA_CAN_Rx_1e4792f2 (ComMPncComSignal): ComMPncComSignalDirection=RX, ComMPncComSignalKind=EIRA, ComMPncComSignalRef=ComSignalPnc_EIRA_CAN_Rx
          NM_Hybrid_01_FCAB_XIX_NM_Hybrid_01_XIX_HCP5_CANFD01_38c188fa_Tx_8c6d3281 (ComMPncComSignal):
            ComMPncComSignalDirection = TX
            ComMPncComSignalKind = EIRA
            ComMPncComSignalChannelRef = ComMConfigSet/CN_HCP5_CANFD01_54d90215
            ComMPncComSignalRef = NM_Hybrid_01_FCAB_XIX_NM_Hybrid_01_XIX_HCP5_CANFD01_38c188fa_Tx
        PNC_23_Climate_ab0b2697: ComMPncId=30, ComMUserPerPnc=PNC_23_Climate_69d3b4ed
          ComSignalPnc_EIRA_CAN_Rx_1e4792f2 (ComMPncComSignal): ComMPncComSignalDirection=RX, ComMPncComSignalKind=EIRA, ComMPncComSignalRef=ComSignalPnc_EIRA_CAN_Rx
          NM_Hybrid_01_FCAB_XIX_NM_Hybrid_01_XIX_HCP5_CANFD01_38c188fa_Tx_8c6d3281 (ComMPncComSignal):
            ComMPncComSignalDirection = TX
            ComMPncComSignalKind = EIRA
            ComMPncComSignalChannelRef = ComMConfigSet/CN_HCP5_CANFD01_54d90215
            ComMPncComSignalRef = NM_Hybrid_01_FCAB_XIX_NM_Hybrid_01_XIX_HCP5_CANFD01_38c188fa_Tx
        PNC_24_ThermoManagement_4f639819: ComMPncId=31, ComMUserPerPnc=PNC_24_ThermoManagement_31b4f0b3
          ComSignalPnc_EIRA_CAN_Rx_1e4792f2 (ComMPncComSignal): ComMPncComSignalDirection=RX, ComMPncComSignalKind=EIRA, ComMPncComSignalRef=ComSignalPnc_EIRA_CAN_Rx
          NM_Hybrid_01_FCAB_XIX_NM_Hybrid_01_XIX_HCP5_CANFD01_38c188fa_Tx_8c6d3281 (ComMPncComSignal):
            ComMPncComSignalDirection = TX
            ComMPncComSignalKind = EIRA
            ComMPncComSignalChannelRef = ComMConfigSet/CN_HCP5_CANFD01_54d90215
            ComMPncComSignalRef = NM_Hybrid_01_FCAB_XIX_NM_Hybrid_01_XIX_HCP5_CANFD01_38c188fa_Tx
        PNC_25_AccessSystemSensors_0f593a4b: ComMPncId=32, ComMUserPerPnc=PNC_25_AccessSystemSensors_863389c2
          ComSignalPnc_EIRA_CAN_Rx_1e4792f2 (ComMPncComSignal): ComMPncComSignalDirection=RX, ComMPncComSignalKind=EIRA, ComMPncComSignalRef=ComSignalPnc_EIRA_CAN_Rx
          NM_Hybrid_01_FCAB_XIX_NM_Hybrid_01_XIX_HCP5_CANFD01_38c188fa_Tx_8c6d3281 (ComMPncComSignal):
            ComMPncComSignalDirection = TX
            ComMPncComSignalKind = EIRA
            ComMPncComSignalChannelRef = ComMConfigSet/CN_HCP5_CANFD01_54d90215
            ComMPncComSignalRef = NM_Hybrid_01_FCAB_XIX_NM_Hybrid_01_XIX_HCP5_CANFD01_38c188fa_Tx
        PNC_26_HighVoltage_Charging_24d89ab8: ComMPncId=33, ComMUserPerPnc=PNC_26_HighVoltage_Charging_c00f85a2
          ComSignalPnc_EIRA_CAN_Rx_1e4792f2 (ComMPncComSignal): ComMPncComSignalDirection=RX, ComMPncComSignalKind=EIRA, ComMPncComSignalRef=ComSignalPnc_EIRA_CAN_Rx
          NM_Hybrid_01_FCAB_XIX_NM_Hybrid_01_XIX_HCP5_CANFD01_38c188fa_Tx_8c6d3281 (ComMPncComSignal):
            ComMPncComSignalDirection = TX
            ComMPncComSignalKind = EIRA
            ComMPncComSignalChannelRef = ComMConfigSet/CN_HCP5_CANFD01_54d90215
            ComMPncComSignalRef = NM_Hybrid_01_FCAB_XIX_NM_Hybrid_01_XIX_HCP5_CANFD01_38c188fa_Tx
        PNC_27_Timemaster_Timer_8da5bb27: ComMPncId=34, ComMUserPerPnc=PNC_27_Timemaster_Timer_53539b48
          ComSignalPnc_EIRA_CAN_Rx_1e4792f2 (ComMPncComSignal): ComMPncComSignalDirection=RX, ComMPncComSignalKind=EIRA, ComMPncComSignalRef=ComSignalPnc_EIRA_CAN_Rx
          NM_Hybrid_01_FCAB_XIX_NM_Hybrid_01_XIX_HCP5_CANFD01_38c188fa_Tx_8c6d3281 (ComMPncComSignal):
            ComMPncComSignalDirection = TX
            ComMPncComSignalKind = EIRA
            ComMPncComSignalChannelRef = ComMConfigSet/CN_HCP5_CANFD01_54d90215
            ComMPncComSignalRef = NM_Hybrid_01_FCAB_XIX_NM_Hybrid_01_XIX_HCP5_CANFD01_38c188fa_Tx
        PNC_28_OnboardTester_DataCollector_1afa9561: ComMPncId=35, ComMUserPerPnc=PNC_28_OnboardTester_DataCollector_c7d92e04
          ComSignalPnc_EIRA_CAN_Rx_1e4792f2 (ComMPncComSignal): ComMPncComSignalDirection=RX, ComMPncComSignalKind=EIRA, ComMPncComSignalRef=ComSignalPnc_EIRA_CAN_Rx
          NM_Hybrid_01_FCAB_XIX_NM_Hybrid_01_XIX_HCP5_CANFD01_38c188fa_Tx_8c6d3281 (ComMPncComSignal):
            ComMPncComSignalDirection = TX
            ComMPncComSignalKind = EIRA
            ComMPncComSignalChannelRef = ComMConfigSet/CN_HCP5_CANFD01_54d90215
            ComMPncComSignalRef = NM_Hybrid_01_FCAB_XIX_NM_Hybrid_01_XIX_HCP5_CANFD01_38c188fa_Tx
        PNC_29_SteeringColumnLock_af7c21af: ComMPncId=36, ComMUserPerPnc=PNC_29_SteeringColumnLock_44a1738d
          ComSignalPnc_EIRA_CAN_Rx_1e4792f2 (ComMPncComSignal): ComMPncComSignalDirection=RX, ComMPncComSignalKind=EIRA, ComMPncComSignalRef=ComSignalPnc_EIRA_CAN_Rx
          NM_Hybrid_01_FCAB_XIX_NM_Hybrid_01_XIX_HCP5_CANFD01_38c188fa_Tx_8c6d3281 (ComMPncComSignal):
            ComMPncComSignalDirection = TX
            ComMPncComSignalKind = EIRA
            ComMPncComSignalChannelRef = ComMConfigSet/CN_HCP5_CANFD01_54d90215
            ComMPncComSignalRef = NM_Hybrid_01_FCAB_XIX_NM_Hybrid_01_XIX_HCP5_CANFD01_38c188fa_Tx
        PNC_30_EnergyManagement_9072504c: ComMPncId=37, ComMUserPerPnc=PNC_30_EnergyManagement_82f39188
          ComSignalPnc_EIRA_CAN_Rx_1e4792f2 (ComMPncComSignal): ComMPncComSignalDirection=RX, ComMPncComSignalKind=EIRA, ComMPncComSignalRef=ComSignalPnc_EIRA_CAN_Rx
          NM_Hybrid_01_FCAB_XIX_NM_Hybrid_01_XIX_HCP5_CANFD01_38c188fa_Tx_8c6d3281 (ComMPncComSignal):
            ComMPncComSignalDirection = TX
            ComMPncComSignalKind = EIRA
            ComMPncComSignalChannelRef = ComMConfigSet/CN_HCP5_CANFD01_54d90215
            ComMPncComSignalRef = NM_Hybrid_01_FCAB_XIX_NM_Hybrid_01_XIX_HCP5_CANFD01_38c188fa_Tx
        PNC_31_MultifunctionalSteeringWheel_4e0a8e7c: ComMPncId=38, ComMUserPerPnc=PNC_31_MultifunctionalSteeringWheel_48e6d667
          ComSignalPnc_EIRA_CAN_Rx_1e4792f2 (ComMPncComSignal): ComMPncComSignalDirection=RX, ComMPncComSignalKind=EIRA, ComMPncComSignalRef=ComSignalPnc_EIRA_CAN_Rx
          NM_Hybrid_01_FCAB_XIX_NM_Hybrid_01_XIX_HCP5_CANFD01_38c188fa_Tx_8c6d3281 (ComMPncComSignal):
            ComMPncComSignalDirection = TX
            ComMPncComSignalKind = EIRA
            ComMPncComSignalChannelRef = ComMConfigSet/CN_HCP5_CANFD01_54d90215
            ComMPncComSignalRef = NM_Hybrid_01_FCAB_XIX_NM_Hybrid_01_XIX_HCP5_CANFD01_38c188fa_Tx
        PNC_32_OnlineAccess_91b6041d: ComMPncId=39, ComMUserPerPnc=PNC_32_OnlineAccess_c5b851bc
          ComSignalPnc_EIRA_CAN_Rx_1e4792f2 (ComMPncComSignal): ComMPncComSignalDirection=RX, ComMPncComSignalKind=EIRA, ComMPncComSignalRef=ComSignalPnc_EIRA_CAN_Rx
          NM_Hybrid_01_FCAB_XIX_NM_Hybrid_01_XIX_HCP5_CANFD01_38c188fa_Tx_8c6d3281 (ComMPncComSignal):
            ComMPncComSignalDirection = TX
            ComMPncComSignalKind = EIRA
            ComMPncComSignalChannelRef = ComMConfigSet/CN_HCP5_CANFD01_54d90215
            ComMPncComSignalRef = NM_Hybrid_01_FCAB_XIX_NM_Hybrid_01_XIX_HCP5_CANFD01_38c188fa_Tx
        PNC_33_ExternalWirelessCommunication_85f99735: ComMPncId=40, ComMUserPerPnc=PNC_33_ExternalWirelessCommunication_779a8708
          ComSignalPnc_EIRA_CAN_Rx_1e4792f2 (ComMPncComSignal): ComMPncComSignalDirection=RX, ComMPncComSignalKind=EIRA, ComMPncComSignalRef=ComSignalPnc_EIRA_CAN_Rx
          NM_Hybrid_01_FCAB_XIX_NM_Hybrid_01_XIX_HCP5_CANFD01_38c188fa_Tx_8c6d3281 (ComMPncComSignal):
            ComMPncComSignalDirection = TX
            ComMPncComSignalKind = EIRA
            ComMPncComSignalChannelRef = ComMConfigSet/CN_HCP5_CANFD01_54d90215
            ComMPncComSignalRef = NM_Hybrid_01_FCAB_XIX_NM_Hybrid_01_XIX_HCP5_CANFD01_38c188fa_Tx
        PNC_34_GPS_Lokalization_74821ca8: ComMPncId=41, ComMUserPerPnc=PNC_34_GPS_Lokalization_72b0f580
          ComSignalPnc_EIRA_CAN_Rx_1e4792f2 (ComMPncComSignal): ComMPncComSignalDirection=RX, ComMPncComSignalKind=EIRA, ComMPncComSignalRef=ComSignalPnc_EIRA_CAN_Rx
          NM_Hybrid_01_FCAB_XIX_NM_Hybrid_01_XIX_HCP5_CANFD01_38c188fa_Tx_8c6d3281 (ComMPncComSignal):
            ComMPncComSignalDirection = TX
            ComMPncComSignalKind = EIRA
            ComMPncComSignalChannelRef = ComMConfigSet/CN_HCP5_CANFD01_54d90215
            ComMPncComSignalRef = NM_Hybrid_01_FCAB_XIX_NM_Hybrid_01_XIX_HCP5_CANFD01_38c188fa_Tx
        PNC_35_ExteriorSound_90ecdcdb: ComMPncId=42, ComMUserPerPnc=PNC_35_ExteriorSound_9764238b
          ComSignalPnc_EIRA_CAN_Rx_1e4792f2 (ComMPncComSignal): ComMPncComSignalDirection=RX, ComMPncComSignalKind=EIRA, ComMPncComSignalRef=ComSignalPnc_EIRA_CAN_Rx
          NM_Hybrid_01_FCAB_XIX_NM_Hybrid_01_XIX_HCP5_CANFD01_38c188fa_Tx_8c6d3281 (ComMPncComSignal):
            ComMPncComSignalDirection = TX
            ComMPncComSignalKind = EIRA
            ComMPncComSignalChannelRef = ComMConfigSet/CN_HCP5_CANFD01_54d90215
            ComMPncComSignalRef = NM_Hybrid_01_FCAB_XIX_NM_Hybrid_01_XIX_HCP5_CANFD01_38c188fa_Tx
        PNC_36_Preheater_b14f0d7f: ComMPncId=43, ComMUserPerPnc=PNC_36_Preheater_5e289989
          ComSignalPnc_EIRA_CAN_Rx_1e4792f2 (ComMPncComSignal): ComMPncComSignalDirection=RX, ComMPncComSignalKind=EIRA, ComMPncComSignalRef=ComSignalPnc_EIRA_CAN_Rx
          NM_Hybrid_01_FCAB_XIX_NM_Hybrid_01_XIX_HCP5_CANFD01_38c188fa_Tx_8c6d3281 (ComMPncComSignal):
            ComMPncComSignalDirection = TX
            ComMPncComSignalKind = EIRA
            ComMPncComSignalChannelRef = ComMConfigSet/CN_HCP5_CANFD01_54d90215
            ComMPncComSignalRef = NM_Hybrid_01_FCAB_XIX_NM_Hybrid_01_XIX_HCP5_CANFD01_38c188fa_Tx
        PNC_37_HighVoltage_WirelessChargingStation_717f15f0: ComMPncId=44, ComMUserPerPnc=PNC_37_HighVoltage_WirelessChargingStation_f111c76f
          ComSignalPnc_EIRA_CAN_Rx_1e4792f2 (ComMPncComSignal): ComMPncComSignalDirection=RX, ComMPncComSignalKind=EIRA, ComMPncComSignalRef=ComSignalPnc_EIRA_CAN_Rx
          NM_Hybrid_01_FCAB_XIX_NM_Hybrid_01_XIX_HCP5_CANFD01_38c188fa_Tx_8c6d3281 (ComMPncComSignal):
            ComMPncComSignalDirection = TX
            ComMPncComSignalKind = EIRA
            ComMPncComSignalChannelRef = ComMConfigSet/CN_HCP5_CANFD01_54d90215
            ComMPncComSignalRef = NM_Hybrid_01_FCAB_XIX_NM_Hybrid_01_XIX_HCP5_CANFD01_38c188fa_Tx
        PNC_40_Diagnosis_Energy_40b20ab8: ComMPncId=47, ComMUserPerPnc=PNC_40_Diagnosis_Energy_532c6fb4
          ComSignalPnc_EIRA_CAN_Rx_1e4792f2 (ComMPncComSignal): ComMPncComSignalDirection=RX, ComMPncComSignalKind=EIRA, ComMPncComSignalRef=ComSignalPnc_EIRA_CAN_Rx
          NM_Hybrid_01_FCAB_XIX_NM_Hybrid_01_XIX_HCP5_CANFD01_38c188fa_Tx_8c6d3281 (ComMPncComSignal):
            ComMPncComSignalDirection = TX
            ComMPncComSignalKind = EIRA
            ComMPncComSignalChannelRef = ComMConfigSet/CN_HCP5_CANFD01_54d90215
            ComMPncComSignalRef = NM_Hybrid_01_FCAB_XIX_NM_Hybrid_01_XIX_HCP5_CANFD01_38c188fa_Tx
        PNC_41_Diagnosis_Powertrain_d7bd9faf: ComMPncId=48, ComMUserPerPnc=PNC_41_Diagnosis_Powertrain_0ac6ac8b
          ComSignalPnc_EIRA_CAN_Rx_1e4792f2 (ComMPncComSignal): ComMPncComSignalDirection=RX, ComMPncComSignalKind=EIRA, ComMPncComSignalRef=ComSignalPnc_EIRA_CAN_Rx
          NM_Hybrid_01_FCAB_XIX_NM_Hybrid_01_XIX_HCP5_CANFD01_38c188fa_Tx_8c6d3281 (ComMPncComSignal):
            ComMPncComSignalDirection = TX
            ComMPncComSignalKind = EIRA
            ComMPncComSignalChannelRef = ComMConfigSet/CN_HCP5_CANFD01_54d90215
            ComMPncComSignalRef = NM_Hybrid_01_FCAB_XIX_NM_Hybrid_01_XIX_HCP5_CANFD01_38c188fa_Tx
        PNC_42_Diagnosis_FlexRay_e9cd26c7: ComMPncId=49, ComMUserPerPnc=PNC_42_Diagnosis_FlexRay_f6dcf44d
          ComSignalPnc_EIRA_CAN_Rx_1e4792f2 (ComMPncComSignal): ComMPncComSignalDirection=RX, ComMPncComSignalKind=EIRA, ComMPncComSignalRef=ComSignalPnc_EIRA_CAN_Rx
          NM_Hybrid_01_FCAB_XIX_NM_Hybrid_01_XIX_HCP5_CANFD01_38c188fa_Tx_8c6d3281 (ComMPncComSignal):
            ComMPncComSignalDirection = TX
            ComMPncComSignalKind = EIRA
            ComMPncComSignalChannelRef = ComMConfigSet/CN_HCP5_CANFD01_54d90215
            ComMPncComSignalRef = NM_Hybrid_01_FCAB_XIX_NM_Hybrid_01_XIX_HCP5_CANFD01_38c188fa_Tx
        PNC_43_Diagnosis_DrivingAssistance_906b6e52: ComMPncId=50, ComMUserPerPnc=PNC_43_Diagnosis_DrivingAssistance_84f09039
          ComSignalPnc_EIRA_CAN_Rx_1e4792f2 (ComMPncComSignal): ComMPncComSignalDirection=RX, ComMPncComSignalKind=EIRA, ComMPncComSignalRef=ComSignalPnc_EIRA_CAN_Rx
          NM_Hybrid_01_FCAB_XIX_NM_Hybrid_01_XIX_HCP5_CANFD01_38c188fa_Tx_8c6d3281 (ComMPncComSignal):
            ComMPncComSignalDirection = TX
            ComMPncComSignalKind = EIRA
            ComMPncComSignalChannelRef = ComMConfigSet/CN_HCP5_CANFD01_54d90215
            ComMPncComSignalRef = NM_Hybrid_01_FCAB_XIX_NM_Hybrid_01_XIX_HCP5_CANFD01_38c188fa_Tx
        PNC_44_Diagnosis_Infotainment_d2af29c0: ComMPncId=51, ComMUserPerPnc=PNC_44_Diagnosis_Infotainment_3909218a
          ComSignalPnc_EIRA_CAN_Rx_1e4792f2 (ComMPncComSignal): ComMPncComSignalDirection=RX, ComMPncComSignalKind=EIRA, ComMPncComSignalRef=ComSignalPnc_EIRA_CAN_Rx
          NM_Hybrid_01_FCAB_XIX_NM_Hybrid_01_XIX_HCP5_CANFD01_38c188fa_Tx_8c6d3281 (ComMPncComSignal):
            ComMPncComSignalDirection = TX
            ComMPncComSignalKind = EIRA
            ComMPncComSignalChannelRef = ComMConfigSet/CN_HCP5_CANFD01_54d90215
            ComMPncComSignalRef = NM_Hybrid_01_FCAB_XIX_NM_Hybrid_01_XIX_HCP5_CANFD01_38c188fa_Tx
        PNC_45_Diagnosis_Comfort_54b3da15: ComMPncId=52, ComMUserPerPnc=PNC_45_Diagnosis_Comfort_7eea372a
          ComSignalPnc_EIRA_CAN_Rx_1e4792f2 (ComMPncComSignal): ComMPncComSignalDirection=RX, ComMPncComSignalKind=EIRA, ComMPncComSignalRef=ComSignalPnc_EIRA_CAN_Rx
          NM_Hybrid_01_FCAB_XIX_NM_Hybrid_01_XIX_HCP5_CANFD01_38c188fa_Tx_8c6d3281 (ComMPncComSignal):
            ComMPncComSignalDirection = TX
            ComMPncComSignalKind = EIRA
            ComMPncComSignalChannelRef = ComMConfigSet/CN_HCP5_CANFD01_54d90215
            ComMPncComSignalRef = NM_Hybrid_01_FCAB_XIX_NM_Hybrid_01_XIX_HCP5_CANFD01_38c188fa_Tx
        PNC_46_Diagnosis_Light_2422ec0e: ComMPncId=53, ComMUserPerPnc=PNC_46_Diagnosis_Light_5140c135
          ComSignalPnc_EIRA_CAN_Rx_1e4792f2 (ComMPncComSignal): ComMPncComSignalDirection=RX, ComMPncComSignalKind=EIRA, ComMPncComSignalRef=ComSignalPnc_EIRA_CAN_Rx
          NM_Hybrid_01_FCAB_XIX_NM_Hybrid_01_XIX_HCP5_CANFD01_38c188fa_Tx_8c6d3281 (ComMPncComSignal):
            ComMPncComSignalDirection = TX
            ComMPncComSignalKind = EIRA
            ComMPncComSignalChannelRef = ComMConfigSet/CN_HCP5_CANFD01_54d90215
            ComMPncComSignalRef = NM_Hybrid_01_FCAB_XIX_NM_Hybrid_01_XIX_HCP5_CANFD01_38c188fa_Tx
        PNC_47_Diagnosis_ComfortLINs_fb22fd75: ComMPncId=54, ComMUserPerPnc=PNC_47_Diagnosis_ComfortLINs_70cf0372
          ComSignalPnc_EIRA_CAN_Rx_1e4792f2 (ComMPncComSignal): ComMPncComSignalDirection=RX, ComMPncComSignalKind=EIRA, ComMPncComSignalRef=ComSignalPnc_EIRA_CAN_Rx
          NM_Hybrid_01_FCAB_XIX_NM_Hybrid_01_XIX_HCP5_CANFD01_38c188fa_Tx_8c6d3281 (ComMPncComSignal):
            ComMPncComSignalDirection = TX
            ComMPncComSignalKind = EIRA
            ComMPncComSignalChannelRef = ComMConfigSet/CN_HCP5_CANFD01_54d90215
            ComMPncComSignalRef = NM_Hybrid_01_FCAB_XIX_NM_Hybrid_01_XIX_HCP5_CANFD01_38c188fa_Tx
        PNC_48_Diagnosis_ClimateTmeLINs_cce3bfb2: ComMPncId=55, ComMUserPerPnc=PNC_48_Diagnosis_ClimateTmeLINs_b4c40b49
          ComSignalPnc_EIRA_CAN_Rx_1e4792f2 (ComMPncComSignal): ComMPncComSignalDirection=RX, ComMPncComSignalKind=EIRA, ComMPncComSignalRef=ComSignalPnc_EIRA_CAN_Rx
          NM_Hybrid_01_FCAB_XIX_NM_Hybrid_01_XIX_HCP5_CANFD01_38c188fa_Tx_8c6d3281 (ComMPncComSignal):
            ComMPncComSignalDirection = TX
            ComMPncComSignalKind = EIRA
            ComMPncComSignalChannelRef = ComMConfigSet/CN_HCP5_CANFD01_54d90215
            ComMPncComSignalRef = NM_Hybrid_01_FCAB_XIX_NM_Hybrid_01_XIX_HCP5_CANFD01_38c188fa_Tx
        PNC_53_Lock_Unlock_51015b9a: ComMPncId=60, ComMUserPerPnc=PNC_53_Lock_Unlock_bfb0b2ca
          ComSignalPnc_EIRA_CAN_Rx_1e4792f2 (ComMPncComSignal): ComMPncComSignalDirection=RX, ComMPncComSignalKind=EIRA, ComMPncComSignalRef=ComSignalPnc_EIRA_CAN_Rx
          NM_Hybrid_01_FCAB_XIX_NM_Hybrid_01_XIX_HCP5_CANFD01_38c188fa_Tx_8c6d3281 (ComMPncComSignal):
            ComMPncComSignalDirection = TX
            ComMPncComSignalKind = EIRA
            ComMPncComSignalChannelRef = ComMConfigSet/CN_HCP5_CANFD01_54d90215
            ComMPncComSignalRef = NM_Hybrid_01_FCAB_XIX_NM_Hybrid_01_XIX_HCP5_CANFD01_38c188fa_Tx
        PNC_55_Dimming_ea37854f: ComMPncId=62, ComMUserPerPnc=PNC_55_Dimming_4909a14c
          ComSignalPnc_EIRA_CAN_Rx_1e4792f2 (ComMPncComSignal): ComMPncComSignalDirection=RX, ComMPncComSignalKind=EIRA, ComMPncComSignalRef=ComSignalPnc_EIRA_CAN_Rx
          NM_Hybrid_01_FCAB_XIX_NM_Hybrid_01_XIX_HCP5_CANFD01_38c188fa_Tx_8c6d3281 (ComMPncComSignal):
            ComMPncComSignalDirection = TX
            ComMPncComSignalKind = EIRA
            ComMPncComSignalChannelRef = ComMConfigSet/CN_HCP5_CANFD01_54d90215
            ComMPncComSignalRef = NM_Hybrid_01_FCAB_XIX_NM_Hybrid_01_XIX_HCP5_CANFD01_38c188fa_Tx
        PNC_56_Charging_Status_19bd3663: ComMPncId=63, ComMUserPerPnc=PNC_56_Charging_Status_cad5dfb4
          ComSignalPnc_EIRA_CAN_Rx_1e4792f2 (ComMPncComSignal): ComMPncComSignalDirection=RX, ComMPncComSignalKind=EIRA, ComMPncComSignalRef=ComSignalPnc_EIRA_CAN_Rx
          NM_Hybrid_01_FCAB_XIX_NM_Hybrid_01_XIX_HCP5_CANFD01_38c188fa_Tx_8c6d3281 (ComMPncComSignal):
            ComMPncComSignalDirection = TX
            ComMPncComSignalKind = EIRA
            ComMPncComSignalChannelRef = ComMConfigSet/CN_HCP5_CANFD01_54d90215
            ComMPncComSignalRef = NM_Hybrid_01_FCAB_XIX_NM_Hybrid_01_XIX_HCP5_CANFD01_38c188fa_Tx
      50 x ComMUser:
        CN_BMC_CAN01_908d0059
        CN_HCP5_CANFD01_84d44928
        PNC_01_CarWakeUp_bf3ce487
        PNC_02_Basefunction_Powertrain_6e8e3f0b
        PNC_03_Basefunction_Chassis_74381a7a
        PNC_04_Basefunction_DrivingAssistance_2e755e80
        PNC_05_Basefunction_Infotainment_d739ca28
        PNC_06_Basefunction_ComfortLight_8074acb0
        PNC_07_Basefunction_CrossSection_5c9febde
        PNC_08_Basefunction_Connectivity_33115909
        PNC_10_Powertrain_5fe7c550
        PNC_11_Chassis_fd87aaa6
        PNC_12_GearSelector_2aa5ddd0
        PNC_13_Airbag_2554061c
        PNC_14_InfotainmentExtensions_d7c4346a
        PNC_15_InstrumentclusterDisplay_1a610817
        PNC_16_InfotainmentDisplay_1d18259d
        PNC_17_Audio_d11279f4
        PNC_18_VirtualSideMirrors_dca4d4b3
        PNC_19_Doors_Hatches_58052c40
        PNC_20_OptionalComfort_76e30655
        PNC_21_AirSuspension_3e4d6d03
        PNC_22_ExteriorLights_3bdfbcd3
        PNC_23_Climate_69d3b4ed
        PNC_24_ThermoManagement_31b4f0b3
        PNC_25_AccessSystemSensors_863389c2
        PNC_26_HighVoltage_Charging_c00f85a2
        PNC_27_Timemaster_Timer_53539b48
        PNC_28_OnboardTester_DataCollector_c7d92e04
        PNC_29_SteeringColumnLock_44a1738d
        PNC_30_EnergyManagement_82f39188
        PNC_31_MultifunctionalSteeringWheel_48e6d667
        PNC_32_OnlineAccess_c5b851bc
        PNC_33_ExternalWirelessCommunication_779a8708
        PNC_34_GPS_Lokalization_72b0f580
        PNC_35_ExteriorSound_9764238b
        PNC_36_Preheater_5e289989
        PNC_37_HighVoltage_WirelessChargingStation_f111c76f
        PNC_40_Diagnosis_Energy_532c6fb4
        PNC_41_Diagnosis_Powertrain_0ac6ac8b
        PNC_42_Diagnosis_FlexRay_f6dcf44d
        PNC_43_Diagnosis_DrivingAssistance_84f09039
        PNC_44_Diagnosis_Infotainment_3909218a
        PNC_45_Diagnosis_Comfort_7eea372a
        PNC_46_Diagnosis_Light_5140c135
        PNC_47_Diagnosis_ComfortLINs_70cf0372
        PNC_48_Diagnosis_ClimateTmeLINs_b4c40b49
        PNC_53_Lock_Unlock_bfb0b2ca
        PNC_55_Dimming_4909a14c
        PNC_56_Charging_Status_cad5dfb4
    ComMGeneral: ComMPncGatewayEnabled=false, ComMPncIdCounting=COMM_PNC_ID_COUNT_FROM_NM_MESSAGE, ComMPncPrepareSleepTimer=0, ComMPncSupport=true
  module config Dcm
    DcmConfigSet  # Diagnostics Data Import
      DcmDsl
        DcmDslProtocol
          DcmDslProtocolRow_29812fbf (DcmDslProtocolRow)
            4 x DcmDslConnection:
              DC_BMC_HV_XIX_TPCHType_CANFD_ISO_Diagnose_dfd423dc
                DC_BMC_HV_XIX_TPCHType_CANFD_ISO_Diagnose_dfd423dc (DcmDslMainConnection): DcmDslProtocolRxTesterSourceAddr=123
                  DCM_HCP5_CANFD01_XIX_TPCHType_CANFD_ISO_Diagnose_XIX_0x1C40007B_XIX_0x1C42007B_XIX_Physical_238d3514_Rx_0eb3e0c5 (DcmDslProtocolRx):
                    DcmDslProtocolRxAddrType = DCM_PHYSICAL_TYPE
                    DcmDslProtocolRxPduId = 1
                    DcmDslProtocolRxComMChannelRef = ComMConfigSet/CN_HCP5_CANFD01_54d90215
                    DcmDslProtocolRxPduRef = DCM_HCP5_CANFD01_XIX_TPCHType_CANFD_ISO_Diagnose_XIX_0x1C40007B_XIX_0x1C42007B_XIX_Physical_238d3514_Rx
                  DCM_HCP5_CANFD01_XIX_TPCHType_CANFD_ISO_Diagnose_XIX_0x1C410000_XIX_Functional_012ca6ee_Rx_de537ab2 (DcmDslProtocolRx):
                    DcmDslProtocolRxAddrType = DCM_FUNCTIONAL_TYPE
                    DcmDslProtocolRxPduId = 2
                    DcmDslProtocolRxComMChannelRef = ComMConfigSet/CN_HCP5_CANFD01_54d90215
                    DcmDslProtocolRxPduRef = DCM_HCP5_CANFD01_XIX_TPCHType_CANFD_ISO_Diagnose_XIX_0x1C410000_XIX_Functional_012ca6ee_Rx
                  DCM_HCP5_CANFD01_XIX_TPCHType_CANFD_ISO_Diagnose_XIX_0x1C42007B_XIX_0x1C40007B_XIX_Physical_4bbc7f71_Tx_29646996 (DcmDslProtocolTx):
                    DcmDslTxConfirmationPduId = 0
                    DcmDslProtocolTxPduRef = EcucPduCollection/DCM_HCP5_CANFD01_XIX_TPCHType_CANFD_ISO_Diagnose_XIX_0x1C42007B_XIX_0x1C40007B_XIX_Physical_4bbc7f71_Tx
              DC_BMC_HV_XIX_TPCHType_CANFD_OBDC_Diagnose_5cd3446c
                DC_BMC_HV_XIX_TPCHType_CANFD_OBDC_Diagnose_5cd3446c (DcmDslMainConnection): DcmDslProtocolRxTesterSourceAddr=635
                  DCM_HCP5_CANFD01_XIX_TPCHType_CANFD_OBDC_Diagnose_XIX_0x1C40027B_XIX_0x1C42027B_XIX_Physical_a0b6e66f_Rx_3f2403cf (DcmDslProtocolRx):
                    DcmDslProtocolRxAddrType = DCM_PHYSICAL_TYPE
                    DcmDslProtocolRxPduId = 4
                    DcmDslProtocolRxComMChannelRef = ComMConfigSet/CN_HCP5_CANFD01_54d90215
                    DcmDslProtocolRxPduRef = DCM_HCP5_CANFD01_XIX_TPCHType_CANFD_OBDC_Diagnose_XIX_0x1C40027B_XIX_0x1C42027B_XIX_Physical_a0b6e66f_Rx
                  DCM_HCP5_CANFD01_XIX_TPCHType_CANFD_OBDC_Diagnose_XIX_0x1C410200_XIX_Functional_967cb818_Rx_064eb1bf (DcmDslProtocolRx):
                    DcmDslProtocolRxAddrType = DCM_FUNCTIONAL_TYPE
                    DcmDslProtocolRxPduId = 5
                    DcmDslProtocolRxComMChannelRef = ComMConfigSet/CN_HCP5_CANFD01_54d90215
                    DcmDslProtocolRxPduRef = DCM_HCP5_CANFD01_XIX_TPCHType_CANFD_OBDC_Diagnose_XIX_0x1C410200_XIX_Functional_967cb818_Rx
                  DCM_HCP5_CANFD01_XIX_TPCHType_CANFD_OBDC_Diagnose_XIX_0x1C42027B_XIX_0x1C40027B_XIX_Physical_c887ac0a_Tx_5714768d (DcmDslProtocolTx):
                    DcmDslTxConfirmationPduId = 3
                    DcmDslProtocolTxPduRef = EcucPduCollection/DCM_HCP5_CANFD01_XIX_TPCHType_CANFD_OBDC_Diagnose_XIX_0x1C42027B_XIX_0x1C40027B_XIX_Physical_c887ac0a_Tx
              DC_BMC_HV_XIX_TPCHType_CANHS_ISO_Diagnose_31d8ad05
                DC_BMC_HV_XIX_TPCHType_CANHS_ISO_Diagnose_31d8ad05 (DcmDslMainConnection): DcmDslProtocolRxTesterSourceAddr=123
                  DCM_HCP5_CANFD01_XIX_TPCHType_CANHS_ISO_Diagnose_XIX_0x17FC007B_XIX_0x17FE007B_XIX_Physical_f4a1250c_Rx_ab17daed (DcmDslProtocolRx):
                    DcmDslProtocolRxAddrType = DCM_PHYSICAL_TYPE
                    DcmDslProtocolRxPduId = 7
                    DcmDslProtocolRxComMChannelRef = ComMConfigSet/CN_HCP5_CANFD01_54d90215
                    DcmDslProtocolRxPduRef = DCM_HCP5_CANFD01_XIX_TPCHType_CANHS_ISO_Diagnose_XIX_0x17FC007B_XIX_0x17FE007B_XIX_Physical_f4a1250c_Rx
                  DCM_HCP5_CANFD01_XIX_TPCHType_CANHS_ISO_Diagnose_XIX_0x700_XIX_Functional_7a5202d2_Rx_a0f2cf13 (DcmDslProtocolRx):
                    DcmDslProtocolRxAddrType = DCM_FUNCTIONAL_TYPE
                    DcmDslProtocolRxPduId = 8
                    DcmDslProtocolRxComMChannelRef = ComMConfigSet/CN_HCP5_CANFD01_54d90215
                    DcmDslProtocolRxPduRef = DCM_HCP5_CANFD01_XIX_TPCHType_CANHS_ISO_Diagnose_XIX_0x700_XIX_Functional_7a5202d2_Rx
                  DCM_HCP5_CANFD01_XIX_TPCHType_CANHS_ISO_Diagnose_XIX_0x17FE007B_XIX_0x17FC007B_XIX_Physical_4cf2fba3_Tx_920245bd (DcmDslProtocolTx):
                    DcmDslTxConfirmationPduId = 6
                    DcmDslProtocolTxPduRef = EcucPduCollection/DCM_HCP5_CANFD01_XIX_TPCHType_CANHS_ISO_Diagnose_XIX_0x17FE007B_XIX_0x17FC007B_XIX_Physical_4cf2fba3_Tx
              DC_BMC_HV_XIX_TPCHType_CANHS_OBDx_e24363dc
                DC_BMC_HV_XIX_TPCHType_CANHS_OBDx_e24363dc (DcmDslMainConnection): DcmDslProtocolRxTesterSourceAddr=1521
                  DCM_HCP5_CANFD01_XIX_TPCHType_CANHS_OBDx_XIX_0x18DA05F1_XIX_0x18DAF105_XIX_Physical_c08ed539_Rx_739699a5 (DcmDslProtocolRx):
                    DcmDslProtocolRxAddrType = DCM_PHYSICAL_TYPE
                    DcmDslProtocolRxPduId = 10
                    DcmDslProtocolRxComMChannelRef = ComMConfigSet/CN_HCP5_CANFD01_54d90215
                    DcmDslProtocolRxPduRef = DCM_HCP5_CANFD01_XIX_TPCHType_CANHS_OBDx_XIX_0x18DA05F1_XIX_0x18DAF105_XIX_Physical_c08ed539_Rx
                  DCM_HCP5_CANFD01_XIX_TPCHType_CANHS_OBDx_XIX_0x18DB33F1_XIX_Functional_1f67dc03_Rx_bb021fbf (DcmDslProtocolRx):
                    DcmDslProtocolRxAddrType = DCM_FUNCTIONAL_TYPE
                    DcmDslProtocolRxPduId = 11
                    DcmDslProtocolRxComMChannelRef = ComMConfigSet/CN_HCP5_CANFD01_54d90215
                    DcmDslProtocolRxPduRef = DCM_HCP5_CANFD01_XIX_TPCHType_CANHS_OBDx_XIX_0x18DB33F1_XIX_Functional_1f67dc03_Rx
                  DCM_HCP5_CANFD01_XIX_TPCHType_CANHS_OBDx_XIX_0x18DAF105_XIX_0x18DA05F1_XIX_Physical_9db247ca_Tx_acb0bc5a (DcmDslProtocolTx):
                    DcmDslTxConfirmationPduId = 9
                    DcmDslProtocolTxPduRef = EcucPduCollection/DCM_HCP5_CANFD01_XIX_TPCHType_CANHS_OBDx_XIX_0x18DAF105_XIX_0x18DA05F1_XIX_Physical_9db247ca_Tx
      DcmDsp: DcmDspMaxDidToRead=8  # Diagnostics Data Import
        ComControl (DcmDspComControl)  # Diagnostics Data Import
          DspComContolAllChannel (DcmDspComControlAllChannel)  # Diagnostics Data Import
        DspRoe (DcmDspRoe)  # Diagnostics Data Import
        DcmDspSession  # Diagnostics Data Import
          3 x DcmDspSessionRow, all with DcmDspSessionP2ServerMax=0.05, DcmDspSessionP2StarServerMax=5:
            ST_Exten: DcmDspSessionLevel=3, DcmDspSessionForBoot=DCM_NO_BOOT  # Diagnostics Data Import
            ST_Progr: DcmDspSessionLevel=2  # Diagnostics Data Import
            ST_Defau: DcmDspSessionLevel=1, DcmDspSessionForBoot=DCM_NO_BOOT  # Diagnostics Data Import
        DcmDspAuthentication: DcmDspAuthenticationRoleSize=1, DcmDspAuthenticationDeauthenticatedRoleRef=ST_Unsec  # Diagnostics Data Import
          ST_EndToEnd (DcmDspAuthenticationRow): DcmDspAuthenticationRoleBitPosition=1  # Diagnostics Data Import
          ST_Unsec (DcmDspAuthenticationRow): DcmDspAuthenticationRoleBitPosition=0  # Diagnostics Data Import
        47 x DcmDspRoutineInfo:
          RoutineInfo_DiagnServi_RoutiContrCheckProgrDepen  # Diagnostics Data Import
            DcmDspStartRoutineOut  # Diagnostics Data Import
              ResData (DcmDspStartRoutineOutSignal): DcmDspRoutineSignalLength=8, DcmDspRoutineSignalType=UINT8_N, DcmDspRoutineSignalEndianness=opaque, DcmDspRoutineSignalPos=0  # Diagnostics Data Import
            DcmDspRoutineAuthorization: DcmDspRoutineSessionRef=ST_Progr  # Diagnostics Data Import
          RoutineInfo_DiagnServi_Get_Charge_Power_Start_Routine  # Diagnostics Data Import
            DcmDspRoutineRequestResOut  # Diagnostics Data Import
              ResData (DcmDspRoutineRequestResOutSignal): DcmDspRoutineSignalLength=2320, DcmDspRoutineSignalType=VARIABLE_LENGTH, DcmDspRoutineSignalEndianness=opaque, DcmDspRoutineSignalPos=0  # Diagnostics Data Import
            DcmDspRoutineStopOut  # Diagnostics Data Import
              ResData (DcmDspRoutineStopOutSignal): DcmDspRoutineSignalLength=8, DcmDspRoutineSignalType=UINT8_N, DcmDspRoutineSignalEndianness=opaque, DcmDspRoutineSignalPos=0  # Diagnostics Data Import
            DcmDspStartRoutineOut  # Diagnostics Data Import
              ResData (DcmDspStartRoutineOutSignal): DcmDspRoutineSignalLength=8, DcmDspRoutineSignalType=UINT8_N, DcmDspRoutineSignalEndianness=opaque, DcmDspRoutineSignalPos=0  # Diagnostics Data Import
            DcmDspStartRoutineIn  # Diagnostics Data Import
              ReqData (DcmDspStartRoutineInSignal): DcmDspRoutineSignalLength=1936, DcmDspRoutineSignalType=VARIABLE_LENGTH, DcmDspRoutineSignalEndianness=opaque, DcmDspRoutineSignalPos=0  # Diagnostics Data Import
            DcmDspRoutineAuthorization: DcmDspRoutineSessionRef=ST_Defau, DcmDspRoutineSessionRef=ST_Exten  # Diagnostics Data Import
          RoutineInfo_Get_Energy_from_SOC_Start_Routine  # Diagnostics Data Import
            DcmDspRoutineRequestResOut  # Diagnostics Data Import
              ResData (DcmDspRoutineRequestResOutSignal): DcmDspRoutineSignalLength=72, DcmDspRoutineSignalType=VARIABLE_LENGTH, DcmDspRoutineSignalEndianness=opaque, DcmDspRoutineSignalPos=0  # Diagnostics Data Import
            DcmDspRoutineStopOut  # Diagnostics Data Import
              ResData (DcmDspRoutineStopOutSignal): DcmDspRoutineSignalLength=8, DcmDspRoutineSignalType=UINT8_N, DcmDspRoutineSignalEndianness=opaque, DcmDspRoutineSignalPos=0  # Diagnostics Data Import
            DcmDspStartRoutineOut  # Diagnostics Data Import
              ResData (DcmDspStartRoutineOutSignal): DcmDspRoutineSignalLength=8, DcmDspRoutineSignalType=UINT8_N, DcmDspRoutineSignalEndianness=opaque, DcmDspRoutineSignalPos=0  # Diagnostics Data Import
            DcmDspStartRoutineIn  # Diagnostics Data Import
              ReqData (DcmDspStartRoutineInSignal): DcmDspRoutineSignalLength=144, DcmDspRoutineSignalType=VARIABLE_LENGTH, DcmDspRoutineSignalEndianness=opaque, DcmDspRoutineSignalPos=0  # Diagnostics Data Import
            DcmDspRoutineAuthorization: DcmDspRoutineSessionRef=ST_Defau, DcmDspRoutineSessionRef=ST_Exten  # Diagnostics Data Import
          RoutineInfo_TABROW_SOKFunctDeact_Start_Routine_COP  # Diagnostics Data Import
            DcmDspRoutineRequestResOut  # Diagnostics Data Import
              ResData (DcmDspRoutineRequestResOutSignal): DcmDspRoutineSignalLength=24, DcmDspRoutineSignalType=UINT8_N, DcmDspRoutineSignalEndianness=opaque, DcmDspRoutineSignalPos=0  # Diagnostics Data Import
            DcmDspRoutineStopOut  # Diagnostics Data Import
              ResData (DcmDspRoutineStopOutSignal): DcmDspRoutineSignalLength=8, DcmDspRoutineSignalType=UINT8_N, DcmDspRoutineSignalEndianness=opaque, DcmDspRoutineSignalPos=0  # Diagnostics Data Import
            DcmDspStartRoutineOut  # Diagnostics Data Import
              ResData (DcmDspStartRoutineOutSignal): DcmDspRoutineSignalLength=8, DcmDspRoutineSignalType=UINT8_N, DcmDspRoutineSignalEndianness=opaque, DcmDspRoutineSignalPos=0  # Diagnostics Data Import
            DcmDspStartRoutineIn  # Diagnostics Data Import
              ReqData (DcmDspStartRoutineInSignal): DcmDspRoutineSignalLength=8, DcmDspRoutineSignalType=UINT8_N, DcmDspRoutineSignalEndianness=opaque, DcmDspRoutineSignalPos=0  # Diagnostics Data Import
            DcmDspRoutineAuthorization: DcmDspRoutineSessionRef=ST_Exten  # Diagnostics Data Import
          RoutineInfo_TABROW_CheckCalibPreCondi_Start_Routine  # Diagnostics Data Import
            DcmDspStartRoutineOut  # Diagnostics Data Import
              ResData (DcmDspStartRoutineOutSignal): DcmDspRoutineSignalLength=2072, DcmDspRoutineSignalType=VARIABLE_LENGTH, DcmDspRoutineSignalEndianness=opaque, DcmDspRoutineSignalPos=0  # Diagnostics Data Import
            DcmDspStartRoutineIn  # Diagnostics Data Import
              ReqData (DcmDspStartRoutineInSignal): DcmDspRoutineSignalLength=24, DcmDspRoutineSignalType=UINT8_N, DcmDspRoutineSignalEndianness=opaque, DcmDspRoutineSignalPos=0  # Diagnostics Data Import
            DcmDspRoutineAuthorization: DcmDspRoutineSessionRef=ST_Exten  # Diagnostics Data Import
          RoutineInfo_TABROW_EndOfWritiSecurDataOfProteOfVehicDiagn_Start_Routine  # Diagnostics Data Import
            DcmDspStartRoutineOut  # Diagnostics Data Import
              ResData (DcmDspStartRoutineOutSignal): DcmDspRoutineSignalLength=16, DcmDspRoutineSignalType=UINT8_N, DcmDspRoutineSignalEndianness=opaque, DcmDspRoutineSignalPos=0  # Diagnostics Data Import
            DcmDspStartRoutineIn  # Diagnostics Data Import
              ReqData (DcmDspStartRoutineInSignal): DcmDspRoutineSignalLength=8, DcmDspRoutineSignalType=UINT8_N, DcmDspRoutineSignalEndianness=opaque, DcmDspRoutineSignalPos=0  # Diagnostics Data Import
            DcmDspRoutineAuthorization: DcmDspRoutineSessionRef=ST_Exten  # Diagnostics Data Import
          RoutineInfo_DiagnServi_TABROW_BeginOfWritiOfSecurDataOfProteOfVehicDiagn_Start_Routine  # Diagnostics Data Import
            DcmDspStartRoutineOut  # Diagnostics Data Import
              ResData (DcmDspStartRoutineOutSignal): DcmDspRoutineSignalLength=16, DcmDspRoutineSignalType=UINT8_N, DcmDspRoutineSignalEndianness=opaque, DcmDspRoutineSignalPos=0  # Diagnostics Data Import
            DcmDspStartRoutineIn  # Diagnostics Data Import
              ReqData (DcmDspStartRoutineInSignal): DcmDspRoutineSignalLength=8192, DcmDspRoutineSignalType=VARIABLE_LENGTH, DcmDspRoutineSignalEndianness=opaque, DcmDspRoutineSignalPos=0  # Diagnostics Data Import
            DcmDspRoutineAuthorization: DcmDspRoutineSessionRef=ST_Exten  # Diagnostics Data Import
          RoutineInfo_DiagnServi_TABROW_VkmsGetState_Start_Routine  # Diagnostics Data Import
            DcmDspRoutineRequestResOut  # Diagnostics Data Import
              ResData (DcmDspRoutineRequestResOutSignal): DcmDspRoutineSignalLength=96, DcmDspRoutineSignalType=UINT8_N, DcmDspRoutineSignalEndianness=opaque, DcmDspRoutineSignalPos=0  # Diagnostics Data Import
            DcmDspStartRoutineIn  # Diagnostics Data Import
              ReqData (DcmDspStartRoutineInSignal): DcmDspRoutineSignalLength=8, DcmDspRoutineSignalType=UINT8_N, DcmDspRoutineSignalEndianness=opaque, DcmDspRoutineSignalPos=0  # Diagnostics Data Import
            DcmDspRoutineAuthorization: DcmDspRoutineSessionRef=ST_Exten  # Diagnostics Data Import
          RoutineInfo_DiagnServi_TABROW_VkmsGetPssHash_Start_Routine  # Diagnostics Data Import
            DcmDspRoutineRequestResOut  # Diagnostics Data Import
              ResData (DcmDspRoutineRequestResOutSignal): DcmDspRoutineSignalLength=144, DcmDspRoutineSignalType=UINT8_N, DcmDspRoutineSignalEndianness=opaque, DcmDspRoutineSignalPos=0  # Diagnostics Data Import
            DcmDspStartRoutineIn  # Diagnostics Data Import
              ReqData (DcmDspStartRoutineInSignal): DcmDspRoutineSignalLength=8, DcmDspRoutineSignalType=UINT8_N, DcmDspRoutineSignalEndianness=opaque, DcmDspRoutineSignalPos=0  # Diagnostics Data Import
            DcmDspRoutineAuthorization: DcmDspRoutineSessionRef=ST_Exten  # Diagnostics Data Import
          RoutineInfo_DiagnServi_TABROW_VkmsGetIdentHash_Start_Routine  # Diagnostics Data Import
            DcmDspRoutineRequestResOut  # Diagnostics Data Import
              ResData (DcmDspRoutineRequestResOutSignal): DcmDspRoutineSignalLength=144, DcmDspRoutineSignalType=UINT8_N, DcmDspRoutineSignalEndianness=opaque, DcmDspRoutineSignalPos=0  # Diagnostics Data Import
            DcmDspStartRoutineIn  # Diagnostics Data Import
              ReqData (DcmDspStartRoutineInSignal): DcmDspRoutineSignalLength=136, DcmDspRoutineSignalType=UINT8_N, DcmDspRoutineSignalEndianness=opaque, DcmDspRoutineSignalPos=0  # Diagnostics Data Import
            DcmDspRoutineAuthorization: DcmDspRoutineSessionRef=ST_Exten  # Diagnostics Data Import
          RoutineInfo_DiagnServi_TABROW_VkmsCheckVerifHash_Start_Routine  # Diagnostics Data Import
            DcmDspRoutineRequestResOut  # Diagnostics Data Import
              ResData (DcmDspRoutineRequestResOutSignal): DcmDspRoutineSignalLength=16, DcmDspRoutineSignalType=UINT8_N, DcmDspRoutineSignalEndianness=opaque, DcmDspRoutineSignalPos=0  # Diagnostics Data Import
            DcmDspStartRoutineIn  # Diagnostics Data Import
              ReqData (DcmDspStartRoutineInSignal): DcmDspRoutineSignalLength=136, DcmDspRoutineSignalType=UINT8_N, DcmDspRoutineSignalEndianness=opaque, DcmDspRoutineSignalPos=0  # Diagnostics Data Import
            DcmDspRoutineAuthorization: DcmDspRoutineSessionRef=ST_Exten  # Diagnostics Data Import
          RoutineInfo_TABROW_VkmsHandlDownl_Start_Routine  # Diagnostics Data Import
            DcmDspRoutineRequestResOut  # Diagnostics Data Import
              ResData (DcmDspRoutineRequestResOutSignal): DcmDspRoutineSignalLength=16, DcmDspRoutineSignalType=UINT8_N, DcmDspRoutineSignalEndianness=opaque, DcmDspRoutineSignalPos=0  # Diagnostics Data Import
            DcmDspStartRoutineIn  # Diagnostics Data Import
              ReqData (DcmDspStartRoutineInSignal): DcmDspRoutineSignalLength=4104, DcmDspRoutineSignalType=VARIABLE_LENGTH, DcmDspRoutineSignalEndianness=opaque, DcmDspRoutineSignalPos=0  # Diagnostics Data Import
            DcmDspRoutineAuthorization: DcmDspRoutineSessionRef=ST_Exten  # Diagnostics Data Import
          RoutineInfo_DiagnServi_TABROW_RequeLoggiDataOfProteOfVehicDiagn_Start_Routine  # Diagnostics Data Import
            DcmDspStartRoutineOut  # Diagnostics Data Import
              ResData (DcmDspStartRoutineOutSignal): DcmDspRoutineSignalLength=784, DcmDspRoutineSignalType=VARIABLE_LENGTH, DcmDspRoutineSignalEndianness=opaque, DcmDspRoutineSignalPos=0  # Diagnostics Data Import
            DcmDspStartRoutineIn  # Diagnostics Data Import
              ReqData (DcmDspStartRoutineInSignal): DcmDspRoutineSignalLength=8, DcmDspRoutineSignalType=UINT8_N, DcmDspRoutineSignalEndianness=opaque, DcmDspRoutineSignalPos=0  # Diagnostics Data Import
            DcmDspRoutineAuthorization: DcmDspRoutineSessionRef=ST_Exten  # Diagnostics Data Import
          RoutineInfo_DiagnServi_TABROW_RequeDataOfProteOfVehicDiagn_Start_Routine  # Diagnostics Data Import
            DcmDspStartRoutineOut  # Diagnostics Data Import
              ResData (DcmDspStartRoutineOutSignal): DcmDspRoutineSignalLength=3544, DcmDspRoutineSignalType=VARIABLE_LENGTH, DcmDspRoutineSignalEndianness=opaque, DcmDspRoutineSignalPos=0  # Diagnostics Data Import
            DcmDspStartRoutineIn  # Diagnostics Data Import
              ReqData (DcmDspStartRoutineInSignal): DcmDspRoutineSignalLength=8, DcmDspRoutineSignalType=UINT8_N, DcmDspRoutineSignalEndianness=opaque, DcmDspRoutineSignalPos=0  # Diagnostics Data Import
            DcmDspRoutineAuthorization: DcmDspRoutineSessionRef=ST_Defau, DcmDspRoutineSessionRef=ST_Exten  # Diagnostics Data Import
          RoutineInfo_DiagnServi_TABROW_ResetProteOfVehicDiagn_Start_Routine  # Diagnostics Data Import
            DcmDspStartRoutineOut  # Diagnostics Data Import
              ResData (DcmDspStartRoutineOutSignal): DcmDspRoutineSignalLength=16, DcmDspRoutineSignalType=UINT8_N, DcmDspRoutineSignalEndianness=opaque, DcmDspRoutineSignalPos=0  # Diagnostics Data Import
            DcmDspStartRoutineIn  # Diagnostics Data Import
              ReqData (DcmDspStartRoutineInSignal): DcmDspRoutineSignalLength=3736, DcmDspRoutineSignalType=VARIABLE_LENGTH, DcmDspRoutineSignalEndianness=opaque, DcmDspRoutineSignalPos=0  # Diagnostics Data Import
            DcmDspRoutineAuthorization: DcmDspRoutineSessionRef=ST_Exten  # Diagnostics Data Import
          RoutineInfo_TABROW_LockProteOfVehicDiagn_Start_Routine  # Diagnostics Data Import
            DcmDspStartRoutineOut  # Diagnostics Data Import
              ResData (DcmDspStartRoutineOutSignal): DcmDspRoutineSignalLength=16, DcmDspRoutineSignalType=UINT8_N, DcmDspRoutineSignalEndianness=opaque, DcmDspRoutineSignalPos=0  # Diagnostics Data Import
            DcmDspRoutineAuthorization: DcmDspRoutineSessionRef=ST_Exten  # Diagnostics Data Import
          RoutineInfo_DiagnServi_TABROW_UnlocProteOfVehicDiagn_Start_Routine  # Diagnostics Data Import
            DcmDspStartRoutineOut  # Diagnostics Data Import
              ResData (DcmDspStartRoutineOutSignal): DcmDspRoutineSignalLength=16, DcmDspRoutineSignalType=UINT8_N, DcmDspRoutineSignalEndianness=opaque, DcmDspRoutineSignalPos=0  # Diagnostics Data Import
            DcmDspStartRoutineIn  # Diagnostics Data Import
              ReqData (DcmDspStartRoutineInSignal): DcmDspRoutineSignalLength=3760, DcmDspRoutineSignalType=VARIABLE_LENGTH, DcmDspRoutineSignalEndianness=opaque, DcmDspRoutineSignalPos=0  # Diagnostics Data Import
            DcmDspRoutineAuthorization: DcmDspRoutineSessionRef=ST_Exten  # Diagnostics Data Import
          RoutineInfo_DiagnServi_TABROW_CalcuConfiStateFingeOfProteOfVehicDiagn_Start_Routine  # Diagnostics Data Import
            DcmDspStartRoutineOut  # Diagnostics Data Import
              ResData (DcmDspStartRoutineOutSignal): DcmDspRoutineSignalLength=272, DcmDspRoutineSignalType=VARIABLE_LENGTH, DcmDspRoutineSignalEndianness=opaque, DcmDspRoutineSignalPos=0  # Diagnostics Data Import
            DcmDspStartRoutineIn  # Diagnostics Data Import
              ReqData (DcmDspStartRoutineInSignal): DcmDspRoutineSignalLength=4120, DcmDspRoutineSignalType=VARIABLE_LENGTH, DcmDspRoutineSignalEndianness=opaque, DcmDspRoutineSignalPos=0  # Diagnostics Data Import
            DcmDspRoutineAuthorization: DcmDspRoutineSessionRef=ST_Defau, DcmDspRoutineSessionRef=ST_Exten  # Diagnostics Data Import
          RoutineInfo_DiagnServi_TABROW_RequeConfiOfProteOfVehicDiagn_Start_Routine  # Diagnostics Data Import
            DcmDspStartRoutineOut  # Diagnostics Data Import
              ResData (DcmDspStartRoutineOutSignal): DcmDspRoutineSignalLength=7712, DcmDspRoutineSignalType=VARIABLE_LENGTH, DcmDspRoutineSignalEndianness=opaque, DcmDspRoutineSignalPos=0  # Diagnostics Data Import
            DcmDspStartRoutineIn  # Diagnostics Data Import
              ReqData (DcmDspStartRoutineInSignal): DcmDspRoutineSignalLength=8, DcmDspRoutineSignalType=UINT8_N, DcmDspRoutineSignalEndianness=opaque, DcmDspRoutineSignalPos=0  # Diagnostics Data Import
            DcmDspRoutineAuthorization: DcmDspRoutineSessionRef=ST_Exten  # Diagnostics Data Import
          RoutineInfo_DiagnServi_TABROW_ResetHealiInhib_Start_Routine  # Diagnostics Data Import
            DcmDspStartRoutineOut  # Diagnostics Data Import
              ResData (DcmDspStartRoutineOutSignal): DcmDspRoutineSignalLength=8, DcmDspRoutineSignalType=UINT8_N, DcmDspRoutineSignalEndianness=opaque, DcmDspRoutineSignalPos=0  # Diagnostics Data Import
            DcmDspStartRoutineIn  # Diagnostics Data Import
              ReqData (DcmDspStartRoutineInSignal): DcmDspRoutineSignalLength=8, DcmDspRoutineSignalType=UINT8_N, DcmDspRoutineSignalEndianness=opaque, DcmDspRoutineSignalPos=0  # Diagnostics Data Import
            DcmDspRoutineAuthorization: DcmDspRoutineSessionRef=ST_Exten  # Diagnostics Data Import
          RoutineInfo_DiagnServi_TABROW_ClearDowngProteData_Start_Routine_COP  # Diagnostics Data Import
            DcmDspRoutineRequestResOut  # Diagnostics Data Import
              ResData (DcmDspRoutineRequestResOutSignal): DcmDspRoutineSignalLength=8, DcmDspRoutineSignalType=UINT8_N, DcmDspRoutineSignalEndianness=opaque, DcmDspRoutineSignalPos=0  # Diagnostics Data Import
            DcmDspRoutineStopOut  # Diagnostics Data Import
              ResData (DcmDspRoutineStopOutSignal): DcmDspRoutineSignalLength=8, DcmDspRoutineSignalType=UINT8_N, DcmDspRoutineSignalEndianness=opaque, DcmDspRoutineSignalPos=0  # Diagnostics Data Import
            DcmDspStartRoutineOut  # Diagnostics Data Import
              ResData (DcmDspStartRoutineOutSignal): DcmDspRoutineSignalLength=8, DcmDspRoutineSignalType=UINT8_N, DcmDspRoutineSignalEndianness=opaque, DcmDspRoutineSignalPos=0  # Diagnostics Data Import
            DcmDspRoutineAuthorization: DcmDspRoutineSessionRef=ST_Defau, DcmDspRoutineSessionRef=ST_Exten  # Diagnostics Data Import
          RoutineInfo_TABROW_VkmsDebug_Start_Routine  # Diagnostics Data Import
            DcmDspRoutineRequestResOut  # Diagnostics Data Import
              ResData (DcmDspRoutineRequestResOutSignal): DcmDspRoutineSignalLength=524296, DcmDspRoutineSignalType=VARIABLE_LENGTH, DcmDspRoutineSignalEndianness=opaque, DcmDspRoutineSignalPos=0  # Diagnostics Data Import
            DcmDspStartRoutineIn  # Diagnostics Data Import
              ReqData (DcmDspStartRoutineInSignal): DcmDspRoutineSignalLength=4104, DcmDspRoutineSignalType=VARIABLE_LENGTH, DcmDspRoutineSignalEndianness=opaque, DcmDspRoutineSignalPos=0  # Diagnostics Data Import
            DcmDspRoutineAuthorization: DcmDspRoutineSessionRef=ST_Exten  # Diagnostics Data Import
          RoutineInfo_DiagnServi_Verify_partial_software_checksum_Start_Routine  # Diagnostics Data Import
            DcmDspStartRoutineOut  # Diagnostics Data Import
              ResData (DcmDspStartRoutineOutSignal): DcmDspRoutineSignalLength=8, DcmDspRoutineSignalType=UINT8_N, DcmDspRoutineSignalEndianness=opaque, DcmDspRoutineSignalPos=0  # Diagnostics Data Import
            DcmDspStartRoutineIn  # Diagnostics Data Import
              ReqData (DcmDspStartRoutineInSignal): DcmDspRoutineSignalLength=32904, DcmDspRoutineSignalType=VARIABLE_LENGTH, DcmDspRoutineSignalEndianness=opaque, DcmDspRoutineSignalPos=0  # Diagnostics Data Import
            DcmDspRoutineAuthorization  # Diagnostics Data Import
          RoutineInfo_DiagnServi_TABROW_ResetHardCrashFlag_Start_Routine  # Diagnostics Data Import
            DcmDspRoutineRequestResOut  # Diagnostics Data Import
              ResData (DcmDspRoutineRequestResOutSignal): DcmDspRoutineSignalLength=8, DcmDspRoutineSignalType=UINT8_N, DcmDspRoutineSignalEndianness=opaque, DcmDspRoutineSignalPos=0  # Diagnostics Data Import
            DcmDspRoutineStopOut  # Diagnostics Data Import
              ResData (DcmDspRoutineStopOutSignal): DcmDspRoutineSignalLength=8, DcmDspRoutineSignalType=UINT8_N, DcmDspRoutineSignalEndianness=opaque, DcmDspRoutineSignalPos=0  # Diagnostics Data Import
            DcmDspStartRoutineOut  # Diagnostics Data Import
              ResData (DcmDspStartRoutineOutSignal): DcmDspRoutineSignalLength=8, DcmDspRoutineSignalType=UINT8_N, DcmDspRoutineSignalEndianness=opaque, DcmDspRoutineSignalPos=0  # Diagnostics Data Import
            DcmDspRoutineAuthorization: DcmDspRoutineSessionRef=ST_Exten  # Diagnostics Data Import
          RoutineInfo_DiagnServi_TABROW_ResetToFactoSetti_Start_Routine_COP  # Diagnostics Data Import
            DcmDspRoutineRequestResOut  # Diagnostics Data Import
              ResData (DcmDspRoutineRequestResOutSignal): DcmDspRoutineSignalLength=8, DcmDspRoutineSignalType=UINT8_N, DcmDspRoutineSignalEndianness=opaque, DcmDspRoutineSignalPos=0  # Diagnostics Data Import
            DcmDspRoutineStopOut  # Diagnostics Data Import
              ResData (DcmDspRoutineStopOutSignal): DcmDspRoutineSignalLength=8, DcmDspRoutineSignalType=UINT8_N, DcmDspRoutineSignalEndianness=opaque, DcmDspRoutineSignalPos=0  # Diagnostics Data Import
            DcmDspStartRoutineOut  # Diagnostics Data Import
              ResData (DcmDspStartRoutineOutSignal): DcmDspRoutineSignalLength=8, DcmDspRoutineSignalType=UINT8_N, DcmDspRoutineSignalEndianness=opaque, DcmDspRoutineSignalPos=0  # Diagnostics Data Import
            DcmDspStartRoutineIn  # Diagnostics Data Import
              ReqData (DcmDspStartRoutineInSignal): DcmDspRoutineSignalLength=24, DcmDspRoutineSignalType=UINT8_N, DcmDspRoutineSignalEndianness=opaque, DcmDspRoutineSignalPos=0  # Diagnostics Data Import
            DcmDspRoutineAuthorization: DcmDspRoutineSessionRef=ST_Exten  # Diagnostics Data Import
          RoutineInfo_DiagnServi_TABROW_AdaptOfCellBalan_Start_Routine  # Diagnostics Data Import
            DcmDspRoutineRequestResOut  # Diagnostics Data Import
              ResData (DcmDspRoutineRequestResOutSignal): DcmDspRoutineSignalLength=16, DcmDspRoutineSignalType=UINT8_N, DcmDspRoutineSignalEndianness=opaque, DcmDspRoutineSignalPos=0  # Diagnostics Data Import
            DcmDspRoutineStopOut  # Diagnostics Data Import
              ResData (DcmDspRoutineStopOutSignal): DcmDspRoutineSignalLength=8, DcmDspRoutineSignalType=UINT8_N, DcmDspRoutineSignalEndianness=opaque, DcmDspRoutineSignalPos=0  # Diagnostics Data Import
            DcmDspStartRoutineOut  # Diagnostics Data Import
              ResData (DcmDspStartRoutineOutSignal): DcmDspRoutineSignalLength=8, DcmDspRoutineSignalType=UINT8_N, DcmDspRoutineSignalEndianness=opaque, DcmDspRoutineSignalPos=0  # Diagnostics Data Import
            DcmDspStartRoutineIn  # Diagnostics Data Import
              ReqData (DcmDspStartRoutineInSignal): DcmDspRoutineSignalLength=120, DcmDspRoutineSignalType=UINT8_N, DcmDspRoutineSignalEndianness=opaque, DcmDspRoutineSignalPos=0  # Diagnostics Data Import
            DcmDspRoutineAuthorization: DcmDspRoutineSessionRef=ST_Exten  # Diagnostics Data Import
          RoutineInfo_DiagnServi_TABROW_NewRoutiBasicSetti_Start_Routine  # Diagnostics Data Import
            DcmDspRoutineRequestResOut  # Diagnostics Data Import
              ResData (DcmDspRoutineRequestResOutSignal): DcmDspRoutineSignalLength=8, DcmDspRoutineSignalType=UINT8_N, DcmDspRoutineSignalEndianness=opaque, DcmDspRoutineSignalPos=0  # Diagnostics Data Import
            DcmDspRoutineStopOut  # Diagnostics Data Import
              ResData (DcmDspRoutineStopOutSignal): DcmDspRoutineSignalLength=8, DcmDspRoutineSignalType=UINT8_N, DcmDspRoutineSignalEndianness=opaque, DcmDspRoutineSignalPos=0  # Diagnostics Data Import
            DcmDspStartRoutineOut  # Diagnostics Data Import
              ResData (DcmDspStartRoutineOutSignal): DcmDspRoutineSignalLength=8, DcmDspRoutineSignalType=UINT8_N, DcmDspRoutineSignalEndianness=opaque, DcmDspRoutineSignalPos=0  # Diagnostics Data Import
            DcmDspRoutineAuthorization: DcmDspRoutineSessionRef=ST_Exten  # Diagnostics Data Import
          RoutineInfo_DiagnServi_TABROW_AdaptOfBatteBankMode_Start_Routine  # Diagnostics Data Import
            DcmDspRoutineRequestResOut  # Diagnostics Data Import
              ResData (DcmDspRoutineRequestResOutSignal): DcmDspRoutineSignalLength=32, DcmDspRoutineSignalType=UINT8_N, DcmDspRoutineSignalEndianness=opaque, DcmDspRoutineSignalPos=0  # Diagnostics Data Import
            DcmDspRoutineStopOut  # Diagnostics Data Import
              ResData (DcmDspRoutineStopOutSignal): DcmDspRoutineSignalLength=8, DcmDspRoutineSignalType=UINT8_N, DcmDspRoutineSignalEndianness=opaque, DcmDspRoutineSignalPos=0  # Diagnostics Data Import
            DcmDspStartRoutineOut  # Diagnostics Data Import
              ResData (DcmDspStartRoutineOutSignal): DcmDspRoutineSignalLength=8, DcmDspRoutineSignalType=UINT8_N, DcmDspRoutineSignalEndianness=opaque, DcmDspRoutineSignalPos=0  # Diagnostics Data Import
            DcmDspStartRoutineIn  # Diagnostics Data Import
              ReqData (DcmDspStartRoutineInSignal): DcmDspRoutineSignalLength=8, DcmDspRoutineSignalType=UINT8_N, DcmDspRoutineSignalEndianness=opaque, DcmDspRoutineSignalPos=0  # Diagnostics Data Import
            DcmDspRoutineAuthorization: DcmDspRoutineSessionRef=ST_Exten  # Diagnostics Data Import
          RoutineInfo_DiagnServi_TABROW_ResetOfAllAdapt_Start_Routine_COP  # Diagnostics Data Import
            DcmDspRoutineRequestResOut  # Diagnostics Data Import
              ResData (DcmDspRoutineRequestResOutSignal): DcmDspRoutineSignalLength=8, DcmDspRoutineSignalType=UINT8_N, DcmDspRoutineSignalEndianness=opaque, DcmDspRoutineSignalPos=0  # Diagnostics Data Import
            DcmDspRoutineStopOut  # Diagnostics Data Import
              ResData (DcmDspRoutineStopOutSignal): DcmDspRoutineSignalLength=8, DcmDspRoutineSignalType=UINT8_N, DcmDspRoutineSignalEndianness=opaque, DcmDspRoutineSignalPos=0  # Diagnostics Data Import
            DcmDspStartRoutineOut  # Diagnostics Data Import
              ResData (DcmDspStartRoutineOutSignal): DcmDspRoutineSignalLength=8, DcmDspRoutineSignalType=UINT8_N, DcmDspRoutineSignalEndianness=opaque, DcmDspRoutineSignalPos=0  # Diagnostics Data Import
            DcmDspStartRoutineIn  # Diagnostics Data Import
              ReqData (DcmDspStartRoutineInSignal): DcmDspRoutineSignalLength=24, DcmDspRoutineSignalType=UINT8_N, DcmDspRoutineSignalEndianness=opaque, DcmDspRoutineSignalPos=0  # Diagnostics Data Import
            DcmDspRoutineAuthorization: DcmDspRoutineSessionRef=ST_Exten  # Diagnostics Data Import
          RoutineInfo_DiagnServi_TABROW_IsolaMeasuDeactMode_Start_Routine_1  # Diagnostics Data Import
            DcmDspRoutineRequestResOut  # Diagnostics Data Import
              ResData (DcmDspRoutineRequestResOutSignal): DcmDspRoutineSignalLength=24, DcmDspRoutineSignalType=UINT8_N, DcmDspRoutineSignalEndianness=opaque, DcmDspRoutineSignalPos=0  # Diagnostics Data Import
            DcmDspRoutineStopOut  # Diagnostics Data Import
              ResData (DcmDspRoutineStopOutSignal): DcmDspRoutineSignalLength=8, DcmDspRoutineSignalType=UINT8_N, DcmDspRoutineSignalEndianness=opaque, DcmDspRoutineSignalPos=0  # Diagnostics Data Import
            DcmDspStartRoutineOut  # Diagnostics Data Import
              ResData (DcmDspStartRoutineOutSignal): DcmDspRoutineSignalLength=8, DcmDspRoutineSignalType=UINT8_N, DcmDspRoutineSignalEndianness=opaque, DcmDspRoutineSignalPos=0  # Diagnostics Data Import
            DcmDspStartRoutineIn  # Diagnostics Data Import
              ReqData (DcmDspStartRoutineInSignal): DcmDspRoutineSignalLength=8, DcmDspRoutineSignalType=UINT8_N, DcmDspRoutineSignalEndianness=opaque, DcmDspRoutineSignalPos=0  # Diagnostics Data Import
            DcmDspRoutineAuthorization: DcmDspRoutineSessionRef=ST_Exten  # Diagnostics Data Import
          RoutineInfo_DiagnServi_TABROW_ResetHVBatteAfterSepar_Start_Routine  # Diagnostics Data Import
            DcmDspRoutineRequestResOut  # Diagnostics Data Import
              ResData (DcmDspRoutineRequestResOutSignal): DcmDspRoutineSignalLength=40, DcmDspRoutineSignalType=UINT8_N, DcmDspRoutineSignalEndianness=opaque, DcmDspRoutineSignalPos=0  # Diagnostics Data Import
            DcmDspRoutineStopOut  # Diagnostics Data Import
              ResData (DcmDspRoutineStopOutSignal): DcmDspRoutineSignalLength=8, DcmDspRoutineSignalType=UINT8_N, DcmDspRoutineSignalEndianness=opaque, DcmDspRoutineSignalPos=0  # Diagnostics Data Import
            DcmDspStartRoutineOut  # Diagnostics Data Import
              ResData (DcmDspStartRoutineOutSignal): DcmDspRoutineSignalLength=8, DcmDspRoutineSignalType=UINT8_N, DcmDspRoutineSignalEndianness=opaque, DcmDspRoutineSignalPos=0  # Diagnostics Data Import
            DcmDspRoutineAuthorization: DcmDspRoutineSessionRef=ST_Exten  # Diagnostics Data Import
          RoutineInfo_DiagnServi_TABROW_NeuRoutiBasicSetti_Start_Routine_4_2  # Diagnostics Data Import
            DcmDspRoutineRequestResOut  # Diagnostics Data Import
              ResData (DcmDspRoutineRequestResOutSignal): DcmDspRoutineSignalLength=8, DcmDspRoutineSignalType=UINT8_N, DcmDspRoutineSignalEndianness=opaque, DcmDspRoutineSignalPos=0  # Diagnostics Data Import
            DcmDspRoutineStopOut  # Diagnostics Data Import
              ResData (DcmDspRoutineStopOutSignal): DcmDspRoutineSignalLength=8, DcmDspRoutineSignalType=UINT8_N, DcmDspRoutineSignalEndianness=opaque, DcmDspRoutineSignalPos=0  # Diagnostics Data Import
            DcmDspStartRoutineOut  # Diagnostics Data Import
              ResData (DcmDspStartRoutineOutSignal): DcmDspRoutineSignalLength=8, DcmDspRoutineSignalType=UINT8_N, DcmDspRoutineSignalEndianness=opaque, DcmDspRoutineSignalPos=0  # Diagnostics Data Import
            DcmDspRoutineAuthorization: DcmDspRoutineSessionRef=ST_Exten  # Diagnostics Data Import
          RoutineInfo_DiagnServi_TABROW_NeuRoutiBasicSetti_Start_Routine_5  # Diagnostics Data Import
            DcmDspRoutineRequestResOut  # Diagnostics Data Import
              ResData (DcmDspRoutineRequestResOutSignal): DcmDspRoutineSignalLength=8, DcmDspRoutineSignalType=UINT8_N, DcmDspRoutineSignalEndianness=opaque, DcmDspRoutineSignalPos=0  # Diagnostics Data Import
            DcmDspRoutineStopOut  # Diagnostics Data Import
              ResData (DcmDspRoutineStopOutSignal): DcmDspRoutineSignalLength=8, DcmDspRoutineSignalType=UINT8_N, DcmDspRoutineSignalEndianness=opaque, DcmDspRoutineSignalPos=0  # Diagnostics Data Import
            DcmDspStartRoutineOut  # Diagnostics Data Import
              ResData (DcmDspStartRoutineOutSignal): DcmDspRoutineSignalLength=8, DcmDspRoutineSignalType=UINT8_N, DcmDspRoutineSignalEndianness=opaque, DcmDspRoutineSignalPos=0  # Diagnostics Data Import
            DcmDspRoutineAuthorization: DcmDspRoutineSessionRef=ST_Exten  # Diagnostics Data Import
          RoutineInfo_DiagnServi_TABROW_NeuRoutiImmedResul_Start_Routine  # Diagnostics Data Import
            DcmDspStartRoutineOut  # Diagnostics Data Import
              ResData (DcmDspStartRoutineOutSignal): DcmDspRoutineSignalLength=800, DcmDspRoutineSignalType=UINT8_N, DcmDspRoutineSignalEndianness=opaque, DcmDspRoutineSignalPos=0  # Diagnostics Data Import
            DcmDspStartRoutineIn  # Diagnostics Data Import
              ReqData (DcmDspStartRoutineInSignal): DcmDspRoutineSignalLength=8, DcmDspRoutineSignalType=UINT8_N, DcmDspRoutineSignalEndianness=opaque, DcmDspRoutineSignalPos=0  # Diagnostics Data Import
            DcmDspRoutineAuthorization: DcmDspRoutineSessionRef=ST_Exten  # Diagnostics Data Import
          RoutineInfo_DiagnServi_TABROW_NeuRoutiBasicSetti_Start_Routine_4  # Diagnostics Data Import
            DcmDspRoutineRequestResOut  # Diagnostics Data Import
              ResData (DcmDspRoutineRequestResOutSignal): DcmDspRoutineSignalLength=8, DcmDspRoutineSignalType=UINT8_N, DcmDspRoutineSignalEndianness=opaque, DcmDspRoutineSignalPos=0  # Diagnostics Data Import
            DcmDspRoutineStopOut  # Diagnostics Data Import
              ResData (DcmDspRoutineStopOutSignal): DcmDspRoutineSignalLength=8, DcmDspRoutineSignalType=UINT8_N, DcmDspRoutineSignalEndianness=opaque, DcmDspRoutineSignalPos=0  # Diagnostics Data Import
            DcmDspStartRoutineOut  # Diagnostics Data Import
              ResData (DcmDspStartRoutineOutSignal): DcmDspRoutineSignalLength=8, DcmDspRoutineSignalType=UINT8_N, DcmDspRoutineSignalEndianness=opaque, DcmDspRoutineSignalPos=0  # Diagnostics Data Import
            DcmDspRoutineAuthorization: DcmDspRoutineSessionRef=ST_Exten  # Diagnostics Data Import
          RoutineInfo_DiagnServi_TABROW_NeuRoutiBasicSetti_Start_Routine  # Diagnostics Data Import
            DcmDspRoutineRequestResOut  # Diagnostics Data Import
              ResData (DcmDspRoutineRequestResOutSignal): DcmDspRoutineSignalLength=8, DcmDspRoutineSignalType=UINT8_N, DcmDspRoutineSignalEndianness=opaque, DcmDspRoutineSignalPos=0  # Diagnostics Data Import
            DcmDspRoutineStopOut  # Diagnostics Data Import
              ResData (DcmDspRoutineStopOutSignal): DcmDspRoutineSignalLength=8, DcmDspRoutineSignalType=UINT8_N, DcmDspRoutineSignalEndianness=opaque, DcmDspRoutineSignalPos=0  # Diagnostics Data Import
            DcmDspStartRoutineOut  # Diagnostics Data Import
              ResData (DcmDspStartRoutineOutSignal): DcmDspRoutineSignalLength=8, DcmDspRoutineSignalType=UINT8_N, DcmDspRoutineSignalEndianness=opaque, DcmDspRoutineSignalPos=0  # Diagnostics Data Import
            DcmDspStartRoutineIn  # Diagnostics Data Import
              ReqData (DcmDspStartRoutineInSignal): DcmDspRoutineSignalLength=8, DcmDspRoutineSignalType=UINT8_N, DcmDspRoutineSignalEndianness=opaque, DcmDspRoutineSignalPos=0  # Diagnostics Data Import
            DcmDspRoutineAuthorization: DcmDspRoutineSessionRef=ST_Exten  # Diagnostics Data Import
          RoutineInfo_DiagnServi_TABROW_ResetOfModulParam_Start_Routine  # Diagnostics Data Import
            DcmDspRoutineRequestResOut  # Diagnostics Data Import
              ResData (DcmDspRoutineRequestResOutSignal): DcmDspRoutineSignalLength=8, DcmDspRoutineSignalType=UINT8_N, DcmDspRoutineSignalEndianness=opaque, DcmDspRoutineSignalPos=0  # Diagnostics Data Import
            DcmDspRoutineStopOut  # Diagnostics Data Import
              ResData (DcmDspRoutineStopOutSignal): DcmDspRoutineSignalLength=8, DcmDspRoutineSignalType=UINT8_N, DcmDspRoutineSignalEndianness=opaque, DcmDspRoutineSignalPos=0  # Diagnostics Data Import
            DcmDspStartRoutineOut  # Diagnostics Data Import
              ResData (DcmDspStartRoutineOutSignal): DcmDspRoutineSignalLength=8, DcmDspRoutineSignalType=UINT8_N, DcmDspRoutineSignalEndianness=opaque, DcmDspRoutineSignalPos=0  # Diagnostics Data Import
            DcmDspStartRoutineIn  # Diagnostics Data Import
              ReqData (DcmDspStartRoutineInSignal): DcmDspRoutineSignalLength=8, DcmDspRoutineSignalType=UINT8_N, DcmDspRoutineSignalEndianness=opaque, DcmDspRoutineSignalPos=0  # Diagnostics Data Import
            DcmDspRoutineAuthorization: DcmDspRoutineSessionRef=ST_Exten  # Diagnostics Data Import
          RoutineInfo_DiagnServi_TABROW_NeuRoutiBasicSetti_Start_Routine_2  # Diagnostics Data Import
            DcmDspRoutineRequestResOut  # Diagnostics Data Import
              ResData (DcmDspRoutineRequestResOutSignal): DcmDspRoutineSignalLength=24, DcmDspRoutineSignalType=UINT8_N, DcmDspRoutineSignalEndianness=opaque, DcmDspRoutineSignalPos=0  # Diagnostics Data Import
            DcmDspRoutineStopOut  # Diagnostics Data Import
              ResData (DcmDspRoutineStopOutSignal): DcmDspRoutineSignalLength=8, DcmDspRoutineSignalType=UINT8_N, DcmDspRoutineSignalEndianness=opaque, DcmDspRoutineSignalPos=0  # Diagnostics Data Import
            DcmDspStartRoutineOut  # Diagnostics Data Import
              ResData (DcmDspStartRoutineOutSignal): DcmDspRoutineSignalLength=8, DcmDspRoutineSignalType=UINT8_N, DcmDspRoutineSignalEndianness=opaque, DcmDspRoutineSignalPos=0  # Diagnostics Data Import
            DcmDspRoutineAuthorization: DcmDspRoutineSessionRef=ST_Exten  # Diagnostics Data Import
          RoutineInfo_DiagnServi_TABROW_NeuRoutiBasicSetti_Start_Routine_3  # Diagnostics Data Import
            DcmDspRoutineRequestResOut  # Diagnostics Data Import
              ResData (DcmDspRoutineRequestResOutSignal): DcmDspRoutineSignalLength=8, DcmDspRoutineSignalType=UINT8_N, DcmDspRoutineSignalEndianness=opaque, DcmDspRoutineSignalPos=0  # Diagnostics Data Import
            DcmDspRoutineStopOut  # Diagnostics Data Import
              ResData (DcmDspRoutineStopOutSignal): DcmDspRoutineSignalLength=8, DcmDspRoutineSignalType=UINT8_N, DcmDspRoutineSignalEndianness=opaque, DcmDspRoutineSignalPos=0  # Diagnostics Data Import
            DcmDspStartRoutineOut  # Diagnostics Data Import
              ResData (DcmDspStartRoutineOutSignal): DcmDspRoutineSignalLength=8, DcmDspRoutineSignalType=UINT8_N, DcmDspRoutineSignalEndianness=opaque, DcmDspRoutineSignalPos=0  # Diagnostics Data Import
            DcmDspRoutineAuthorization: DcmDspRoutineSessionRef=ST_Exten  # Diagnostics Data Import
          RoutineInfo_DiagnServi_TABROW_NeuRoutiBasicSetti_Start_Routine_1  # Diagnostics Data Import
            DcmDspRoutineRequestResOut  # Diagnostics Data Import
              ResData (DcmDspRoutineRequestResOutSignal): DcmDspRoutineSignalLength=8, DcmDspRoutineSignalType=UINT8_N, DcmDspRoutineSignalEndianness=opaque, DcmDspRoutineSignalPos=0  # Diagnostics Data Import
            DcmDspRoutineStopOut  # Diagnostics Data Import
              ResData (DcmDspRoutineStopOutSignal): DcmDspRoutineSignalLength=8, DcmDspRoutineSignalType=UINT8_N, DcmDspRoutineSignalEndianness=opaque, DcmDspRoutineSignalPos=0  # Diagnostics Data Import
            DcmDspStartRoutineOut  # Diagnostics Data Import
              ResData (DcmDspStartRoutineOutSignal): DcmDspRoutineSignalLength=8, DcmDspRoutineSignalType=UINT8_N, DcmDspRoutineSignalEndianness=opaque, DcmDspRoutineSignalPos=0  # Diagnostics Data Import
            DcmDspRoutineAuthorization: DcmDspRoutineSessionRef=ST_Exten  # Diagnostics Data Import
          RoutineInfo_DiagnServi_TABROW_AdaptOfVoltaMeasuChann_Start_Routine  # Diagnostics Data Import
            DcmDspRoutineRequestResOut  # Diagnostics Data Import
              ResData (DcmDspRoutineRequestResOutSignal): DcmDspRoutineSignalLength=48, DcmDspRoutineSignalType=UINT8_N, DcmDspRoutineSignalEndianness=opaque, DcmDspRoutineSignalPos=0  # Diagnostics Data Import
            DcmDspRoutineStopOut  # Diagnostics Data Import
              ResData (DcmDspRoutineStopOutSignal): DcmDspRoutineSignalLength=8, DcmDspRoutineSignalType=UINT8_N, DcmDspRoutineSignalEndianness=opaque, DcmDspRoutineSignalPos=0  # Diagnostics Data Import
            DcmDspStartRoutineOut  # Diagnostics Data Import
              ResData (DcmDspStartRoutineOutSignal): DcmDspRoutineSignalLength=8, DcmDspRoutineSignalType=UINT8_N, DcmDspRoutineSignalEndianness=opaque, DcmDspRoutineSignalPos=0  # Diagnostics Data Import
            DcmDspStartRoutineIn  # Diagnostics Data Import
              ReqData (DcmDspStartRoutineInSignal): DcmDspRoutineSignalLength=8, DcmDspRoutineSignalType=UINT8_N, DcmDspRoutineSignalEndianness=opaque, DcmDspRoutineSignalPos=0  # Diagnostics Data Import
            DcmDspRoutineAuthorization: DcmDspRoutineSessionRef=ST_Exten  # Diagnostics Data Import
          RoutineInfo_DiagnServi_TABROW_ResetOfContaError_Start_Routine  # Diagnostics Data Import
            DcmDspRoutineRequestResOut  # Diagnostics Data Import
              ResData (DcmDspRoutineRequestResOutSignal): DcmDspRoutineSignalLength=8, DcmDspRoutineSignalType=UINT8_N, DcmDspRoutineSignalEndianness=opaque, DcmDspRoutineSignalPos=0  # Diagnostics Data Import
            DcmDspRoutineStopOut  # Diagnostics Data Import
              ResData (DcmDspRoutineStopOutSignal): DcmDspRoutineSignalLength=8, DcmDspRoutineSignalType=UINT8_N, DcmDspRoutineSignalEndianness=opaque, DcmDspRoutineSignalPos=0  # Diagnostics Data Import
            DcmDspStartRoutineOut  # Diagnostics Data Import
              ResData (DcmDspStartRoutineOutSignal): DcmDspRoutineSignalLength=8, DcmDspRoutineSignalType=UINT8_N, DcmDspRoutineSignalEndianness=opaque, DcmDspRoutineSignalPos=0  # Diagnostics Data Import
            DcmDspRoutineAuthorization: DcmDspRoutineSessionRef=ST_Exten  # Diagnostics Data Import
          RoutineInfo_DiagnServi_TABROW_IsolaMeasuDeactMode_Start_Routine  # Diagnostics Data Import
            DcmDspRoutineRequestResOut  # Diagnostics Data Import
              ResData (DcmDspRoutineRequestResOutSignal): DcmDspRoutineSignalLength=8, DcmDspRoutineSignalType=UINT8_N, DcmDspRoutineSignalEndianness=opaque, DcmDspRoutineSignalPos=0  # Diagnostics Data Import
            DcmDspRoutineStopOut  # Diagnostics Data Import
              ResData (DcmDspRoutineStopOutSignal): DcmDspRoutineSignalLength=8, DcmDspRoutineSignalType=UINT8_N, DcmDspRoutineSignalEndianness=opaque, DcmDspRoutineSignalPos=0  # Diagnostics Data Import
            DcmDspStartRoutineOut  # Diagnostics Data Import
              ResData (DcmDspStartRoutineOutSignal): DcmDspRoutineSignalLength=8, DcmDspRoutineSignalType=UINT8_N, DcmDspRoutineSignalEndianness=opaque, DcmDspRoutineSignalPos=0  # Diagnostics Data Import
            DcmDspStartRoutineIn  # Diagnostics Data Import
              ReqData (DcmDspStartRoutineInSignal): DcmDspRoutineSignalLength=8, DcmDspRoutineSignalType=UINT8_N, DcmDspRoutineSignalEndianness=opaque, DcmDspRoutineSignalPos=0  # Diagnostics Data Import
            DcmDspRoutineAuthorization: DcmDspRoutineSessionRef=ST_Exten  # Diagnostics Data Import
          RoutineInfo_DiagnServi_TABROW_CalcuModulHashValue_Start_Routine_COP  # Diagnostics Data Import
            DcmDspRoutineRequestResOut  # Diagnostics Data Import
              ResData (DcmDspRoutineRequestResOutSignal): DcmDspRoutineSignalLength=296, DcmDspRoutineSignalType=VARIABLE_LENGTH, DcmDspRoutineSignalEndianness=opaque, DcmDspRoutineSignalPos=0  # Diagnostics Data Import
            DcmDspRoutineStopOut  # Diagnostics Data Import
              ResData (DcmDspRoutineStopOutSignal): DcmDspRoutineSignalLength=8, DcmDspRoutineSignalType=UINT8_N, DcmDspRoutineSignalEndianness=opaque, DcmDspRoutineSignalPos=0  # Diagnostics Data Import
            DcmDspStartRoutineOut  # Diagnostics Data Import
              ResData (DcmDspStartRoutineOutSignal): DcmDspRoutineSignalLength=8, DcmDspRoutineSignalType=UINT8_N, DcmDspRoutineSignalEndianness=opaque, DcmDspRoutineSignalPos=0  # Diagnostics Data Import
            DcmDspStartRoutineIn  # Diagnostics Data Import
              ReqData (DcmDspStartRoutineInSignal): DcmDspRoutineSignalLength=16, DcmDspRoutineSignalType=UINT8_N, DcmDspRoutineSignalEndianness=opaque, DcmDspRoutineSignalPos=0  # Diagnostics Data Import
            DcmDspRoutineAuthorization: DcmDspRoutineSessionRef=ST_Defau, DcmDspRoutineSessionRef=ST_Exten  # Diagnostics Data Import
          RoutineInfo_DiagnServi_TABROW_CalcuIndivHashValue_Start_Routine  # Diagnostics Data Import
            DcmDspStartRoutineOut  # Diagnostics Data Import
              ResData (DcmDspStartRoutineOutSignal): DcmDspRoutineSignalLength=2600, DcmDspRoutineSignalType=VARIABLE_LENGTH, DcmDspRoutineSignalEndianness=opaque, DcmDspRoutineSignalPos=0  # Diagnostics Data Import
            DcmDspStartRoutineIn  # Diagnostics Data Import
              ReqData (DcmDspStartRoutineInSignal): DcmDspRoutineSignalLength=32, DcmDspRoutineSignalType=UINT8_N, DcmDspRoutineSignalEndianness=opaque, DcmDspRoutineSignalPos=0  # Diagnostics Data Import
            DcmDspRoutineAuthorization: DcmDspRoutineSessionRef=ST_Defau, DcmDspRoutineSessionRef=ST_Exten  # Diagnostics Data Import
          RoutineInfo_DiagnServi_TABROW_CalcuIntegValidData_Start_Routine  # Diagnostics Data Import
            DcmDspStartRoutineOut  # Diagnostics Data Import
              ResData (DcmDspStartRoutineOutSignal): DcmDspRoutineSignalLength=272, DcmDspRoutineSignalType=VARIABLE_LENGTH, DcmDspRoutineSignalEndianness=opaque, DcmDspRoutineSignalPos=0  # Diagnostics Data Import
            DcmDspStartRoutineIn  # Diagnostics Data Import
              ReqData (DcmDspStartRoutineInSignal): DcmDspRoutineSignalLength=16, DcmDspRoutineSignalType=UINT8_N, DcmDspRoutineSignalEndianness=opaque, DcmDspRoutineSignalPos=0  # Diagnostics Data Import
            DcmDspRoutineAuthorization: DcmDspRoutineSessionRef=ST_Defau, DcmDspRoutineSessionRef=ST_Exten  # Diagnostics Data Import
          RoutineInfo_DiagnServi_RoutiContrCheckProgrPreco  # Diagnostics Data Import
            DcmDspStartRoutineOut  # Diagnostics Data Import
              ResData (DcmDspStartRoutineOutSignal): DcmDspRoutineSignalLength=2040, DcmDspRoutineSignalType=VARIABLE_LENGTH, DcmDspRoutineSignalEndianness=opaque, DcmDspRoutineSignalPos=0  # Diagnostics Data Import
            DcmDspRoutineAuthorization: DcmDspRoutineSessionRef=ST_Defau, DcmDspRoutineSessionRef=ST_Exten  # Diagnostics Data Import
