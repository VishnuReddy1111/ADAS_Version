[part 3 of 8: package /InitialEcuC]
AUTOSAR XML (schema 4-3-0)
package /InitialEcuC  (continued)
  module config Com  (continued)
    ComConfig  (continued)
      797 x ComSignal:  (continued)
        BMC_CMC_Zellspannung_049_XIX_BMC_CMC_Zellspannung_02_XIX_HCP5_CANFD01_6220ee97_Tx: ComBitPosition=120, ComBitSize=12, ComSignalDataInvalidValue=4095, ComSignalEndianness=LITTLE_ENDIAN, ComSignalInitValue=4094, ComSignalType=UINT8, ComTransferProperty=PENDING, ComSystemTemplateSystemSignalRef=BMC_CMC_Zellspannung_049
        BMC_CMC_Zellspannung_04_Messzeit_XIX_BMC_CMC_Zellspannung_04_XIX_HCP5_CANFD01_eb17b214_Tx: ComBitPosition=480, ComBitSize=8, ComSignalDataInvalidValue=255, ComSignalEndianness=LITTLE_ENDIAN, ComSignalInitValue=254, ComSignalType=UINT8, ComTransferProperty=PENDING, ComSystemTemplateSystemSignalRef=BMC_CMC_Zellspannung_04_Messzeit
        BMC_CMC_Zellspannung_050_XIX_BMC_CMC_Zellspannung_02_XIX_HCP5_CANFD01_3c3eae7b_Tx: ComBitPosition=132, ComBitSize=12, ComSignalDataInvalidValue=4095, ComSignalEndianness=LITTLE_ENDIAN, ComSignalInitValue=4094, ComSignalType=UINT8, ComTransferProperty=PENDING, ComSystemTemplateSystemSignalRef=BMC_CMC_Zellspannung_050
        BMC_CMC_Zellspannung_051_XIX_BMC_CMC_Zellspannung_02_XIX_HCP5_CANFD01_43f735e8_Tx: ComBitPosition=144, ComBitSize=12, ComSignalDataInvalidValue=4095, ComSignalEndianness=LITTLE_ENDIAN, ComSignalInitValue=4094, ComSignalType=UINT8, ComTransferProperty=PENDING, ComSystemTemplateSystemSignalRef=BMC_CMC_Zellspannung_051
        BMC_CMC_Zellspannung_052_XIX_BMC_CMC_Zellspannung_02_XIX_HCP5_CANFD01_c3ad995d_Tx: ComBitPosition=156, ComBitSize=12, ComSignalDataInvalidValue=4095, ComSignalEndianness=LITTLE_ENDIAN, ComSignalInitValue=4094, ComSignalType=UINT8, ComTransferProperty=PENDING, ComSystemTemplateSystemSignalRef=BMC_CMC_Zellspannung_052
        BMC_CMC_Zellspannung_053_XIX_BMC_CMC_Zellspannung_02_XIX_HCP5_CANFD01_bc6402ce_Tx: ComBitPosition=168, ComBitSize=12, ComSignalDataInvalidValue=4095, ComSignalEndianness=LITTLE_ENDIAN, ComSignalInitValue=4094, ComSignalType=UINT8, ComTransferProperty=PENDING, ComSystemTemplateSystemSignalRef=BMC_CMC_Zellspannung_053
        BMC_CMC_Zellspannung_054_XIX_BMC_CMC_Zellspannung_02_XIX_HCP5_CANFD01_1869c676_Tx: ComBitPosition=180, ComBitSize=12, ComSignalDataInvalidValue=4095, ComSignalEndianness=LITTLE_ENDIAN, ComSignalInitValue=4094, ComSignalType=UINT8, ComTransferProperty=PENDING, ComSystemTemplateSystemSignalRef=BMC_CMC_Zellspannung_054
        BMC_CMC_Zellspannung_055_XIX_BMC_CMC_Zellspannung_02_XIX_HCP5_CANFD01_67a05de5_Tx: ComBitPosition=192, ComBitSize=12, ComSignalDataInvalidValue=4095, ComSignalEndianness=LITTLE_ENDIAN, ComSignalInitValue=4094, ComSignalType=UINT8, ComTransferProperty=PENDING, ComSystemTemplateSystemSignalRef=BMC_CMC_Zellspannung_055
        BMC_CMC_Zellspannung_056_XIX_BMC_CMC_Zellspannung_02_XIX_HCP5_CANFD01_e7faf150_Tx: ComBitPosition=204, ComBitSize=12, ComSignalDataInvalidValue=4095, ComSignalEndianness=LITTLE_ENDIAN, ComSignalInitValue=4094, ComSignalType=UINT8, ComTransferProperty=PENDING, ComSystemTemplateSystemSignalRef=BMC_CMC_Zellspannung_056
        BMC_CMC_Zellspannung_057_XIX_BMC_CMC_Zellspannung_02_XIX_HCP5_CANFD01_98336ac3_Tx: ComBitPosition=216, ComBitSize=12, ComSignalDataInvalidValue=4095, ComSignalEndianness=LITTLE_ENDIAN, ComSignalInitValue=4094, ComSignalType=UINT8, ComTransferProperty=PENDING, ComSystemTemplateSystemSignalRef=BMC_CMC_Zellspannung_057
        BMC_CMC_Zellspannung_058_XIX_BMC_CMC_Zellspannung_02_XIX_HCP5_CANFD01_74907e61_Tx: ComBitPosition=228, ComBitSize=12, ComSignalDataInvalidValue=4095, ComSignalEndianness=LITTLE_ENDIAN, ComSignalInitValue=4094, ComSignalType=UINT8, ComTransferProperty=PENDING, ComSystemTemplateSystemSignalRef=BMC_CMC_Zellspannung_058
        BMC_CMC_Zellspannung_059_XIX_BMC_CMC_Zellspannung_02_XIX_HCP5_CANFD01_0b59e5f2_Tx: ComBitPosition=240, ComBitSize=12, ComSignalDataInvalidValue=4095, ComSignalEndianness=LITTLE_ENDIAN, ComSignalInitValue=4094, ComSignalType=UINT8, ComTransferProperty=PENDING, ComSystemTemplateSystemSignalRef=BMC_CMC_Zellspannung_059
        BMC_CMC_Zellspannung_05_Messzeit_XIX_BMC_CMC_Zellspannung_05_XIX_HCP5_CANFD01_2646b7e5_Tx: ComBitPosition=444, ComBitSize=8, ComSignalDataInvalidValue=255, ComSignalEndianness=LITTLE_ENDIAN, ComSignalInitValue=254, ComSignalType=UINT8, ComTransferProperty=PENDING, ComSystemTemplateSystemSignalRef=BMC_CMC_Zellspannung_05_Messzeit
        BMC_CMC_Zellspannung_060_XIX_BMC_CMC_Zellspannung_02_XIX_HCP5_CANFD01_87b5b3d4_Tx: ComBitPosition=252, ComBitSize=12, ComSignalDataInvalidValue=4095, ComSignalEndianness=LITTLE_ENDIAN, ComSignalInitValue=4094, ComSignalType=UINT8, ComTransferProperty=PENDING, ComSystemTemplateSystemSignalRef=BMC_CMC_Zellspannung_060
        BMC_CMC_Zellspannung_061_XIX_BMC_CMC_Zellspannung_02_XIX_HCP5_CANFD01_f87c2847_Tx: ComBitPosition=264, ComBitSize=12, ComSignalDataInvalidValue=4095, ComSignalEndianness=LITTLE_ENDIAN, ComSignalInitValue=4094, ComSignalType=UINT8, ComTransferProperty=PENDING, ComSystemTemplateSystemSignalRef=BMC_CMC_Zellspannung_061
        BMC_CMC_Zellspannung_062_XIX_BMC_CMC_Zellspannung_02_XIX_HCP5_CANFD01_782684f2_Tx: ComBitPosition=276, ComBitSize=12, ComSignalDataInvalidValue=4095, ComSignalEndianness=LITTLE_ENDIAN, ComSignalInitValue=4094, ComSignalType=UINT8, ComTransferProperty=PENDING, ComSystemTemplateSystemSignalRef=BMC_CMC_Zellspannung_062
        BMC_CMC_Zellspannung_063_XIX_BMC_CMC_Zellspannung_02_XIX_HCP5_CANFD01_07ef1f61_Tx: ComBitPosition=288, ComBitSize=12, ComSignalDataInvalidValue=4095, ComSignalEndianness=LITTLE_ENDIAN, ComSignalInitValue=4094, ComSignalType=UINT8, ComTransferProperty=PENDING, ComSystemTemplateSystemSignalRef=BMC_CMC_Zellspannung_063
        BMC_CMC_Zellspannung_064_XIX_BMC_CMC_Zellspannung_02_XIX_HCP5_CANFD01_a3e2dbd9_Tx: ComBitPosition=300, ComBitSize=12, ComSignalDataInvalidValue=4095, ComSignalEndianness=LITTLE_ENDIAN, ComSignalInitValue=4094, ComSignalType=UINT8, ComTransferProperty=PENDING, ComSystemTemplateSystemSignalRef=BMC_CMC_Zellspannung_064
        BMC_CMC_Zellspannung_065_XIX_BMC_CMC_Zellspannung_02_XIX_HCP5_CANFD01_dc2b404a_Tx: ComBitPosition=312, ComBitSize=12, ComSignalDataInvalidValue=4095, ComSignalEndianness=LITTLE_ENDIAN, ComSignalInitValue=4094, ComSignalType=UINT8, ComTransferProperty=PENDING, ComSystemTemplateSystemSignalRef=BMC_CMC_Zellspannung_065
        BMC_CMC_Zellspannung_066_XIX_BMC_CMC_Zellspannung_02_XIX_HCP5_CANFD01_5c71ecff_Tx: ComBitPosition=324, ComBitSize=12, ComSignalDataInvalidValue=4095, ComSignalEndianness=LITTLE_ENDIAN, ComSignalInitValue=4094, ComSignalType=UINT8, ComTransferProperty=PENDING, ComSystemTemplateSystemSignalRef=BMC_CMC_Zellspannung_066
        BMC_CMC_Zellspannung_067_XIX_BMC_CMC_Zellspannung_02_XIX_HCP5_CANFD01_23b8776c_Tx: ComBitPosition=336, ComBitSize=12, ComSignalDataInvalidValue=4095, ComSignalEndianness=LITTLE_ENDIAN, ComSignalInitValue=4094, ComSignalType=UINT8, ComTransferProperty=PENDING, ComSystemTemplateSystemSignalRef=BMC_CMC_Zellspannung_067
        BMC_CMC_Zellspannung_068_XIX_BMC_CMC_Zellspannung_02_XIX_HCP5_CANFD01_cf1b63ce_Tx: ComBitPosition=348, ComBitSize=12, ComSignalDataInvalidValue=4095, ComSignalEndianness=LITTLE_ENDIAN, ComSignalInitValue=4094, ComSignalType=UINT8, ComTransferProperty=PENDING, ComSystemTemplateSystemSignalRef=BMC_CMC_Zellspannung_068
        BMC_CMC_Zellspannung_069_XIX_BMC_CMC_Zellspannung_02_XIX_HCP5_CANFD01_b0d2f85d_Tx: ComBitPosition=360, ComBitSize=12, ComSignalDataInvalidValue=4095, ComSignalEndianness=LITTLE_ENDIAN, ComSignalInitValue=4094, ComSignalType=UINT8, ComTransferProperty=PENDING, ComSystemTemplateSystemSignalRef=BMC_CMC_Zellspannung_069
        BMC_CMC_Zellspannung_070_XIX_BMC_CMC_Zellspannung_02_XIX_HCP5_CANFD01_eeccb8b1_Tx: ComBitPosition=372, ComBitSize=12, ComSignalDataInvalidValue=4095, ComSignalEndianness=LITTLE_ENDIAN, ComSignalInitValue=4094, ComSignalType=UINT8, ComTransferProperty=PENDING, ComSystemTemplateSystemSignalRef=BMC_CMC_Zellspannung_070
        BMC_CMC_Zellspannung_071_XIX_BMC_CMC_Zellspannung_02_XIX_HCP5_CANFD01_91052322_Tx: ComBitPosition=384, ComBitSize=12, ComSignalDataInvalidValue=4095, ComSignalEndianness=LITTLE_ENDIAN, ComSignalInitValue=4094, ComSignalType=UINT8, ComTransferProperty=PENDING, ComSystemTemplateSystemSignalRef=BMC_CMC_Zellspannung_071
        BMC_CMC_Zellspannung_072_XIX_BMC_CMC_Zellspannung_02_XIX_HCP5_CANFD01_115f8f97_Tx: ComBitPosition=396, ComBitSize=12, ComSignalDataInvalidValue=4095, ComSignalEndianness=LITTLE_ENDIAN, ComSignalInitValue=4094, ComSignalType=UINT8, ComTransferProperty=PENDING, ComSystemTemplateSystemSignalRef=BMC_CMC_Zellspannung_072
        BMC_CMC_Zellspannung_073_XIX_BMC_CMC_Zellspannung_02_XIX_HCP5_CANFD01_6e961404_Tx: ComBitPosition=408, ComBitSize=12, ComSignalDataInvalidValue=4095, ComSignalEndianness=LITTLE_ENDIAN, ComSignalInitValue=4094, ComSignalType=UINT8, ComTransferProperty=PENDING, ComSystemTemplateSystemSignalRef=BMC_CMC_Zellspannung_073
        BMC_CMC_Zellspannung_074_XIX_BMC_CMC_Zellspannung_02_XIX_HCP5_CANFD01_ca9bd0bc_Tx: ComBitPosition=420, ComBitSize=12, ComSignalDataInvalidValue=4095, ComSignalEndianness=LITTLE_ENDIAN, ComSignalInitValue=4094, ComSignalType=UINT8, ComTransferProperty=PENDING, ComSystemTemplateSystemSignalRef=BMC_CMC_Zellspannung_074
        BMC_CMC_Zellspannung_075_XIX_BMC_CMC_Zellspannung_02_XIX_HCP5_CANFD01_b5524b2f_Tx: ComBitPosition=432, ComBitSize=12, ComSignalDataInvalidValue=4095, ComSignalEndianness=LITTLE_ENDIAN, ComSignalInitValue=4094, ComSignalType=UINT8, ComTransferProperty=PENDING, ComSystemTemplateSystemSignalRef=BMC_CMC_Zellspannung_075
        BMC_CMC_Zellspannung_076_XIX_BMC_CMC_Zellspannung_02_XIX_HCP5_CANFD01_3508e79a_Tx: ComBitPosition=444, ComBitSize=12, ComSignalDataInvalidValue=4095, ComSignalEndianness=LITTLE_ENDIAN, ComSignalInitValue=4094, ComSignalType=UINT8, ComTransferProperty=PENDING, ComSystemTemplateSystemSignalRef=BMC_CMC_Zellspannung_076
        BMC_CMC_Zellspannung_077_XIX_BMC_CMC_Zellspannung_02_XIX_HCP5_CANFD01_4ac17c09_Tx: ComBitPosition=456, ComBitSize=12, ComSignalDataInvalidValue=4095, ComSignalEndianness=LITTLE_ENDIAN, ComSignalInitValue=4094, ComSignalType=UINT8, ComTransferProperty=PENDING, ComSystemTemplateSystemSignalRef=BMC_CMC_Zellspannung_077
        BMC_CMC_Zellspannung_078_XIX_BMC_CMC_Zellspannung_02_XIX_HCP5_CANFD01_a66268ab_Tx: ComBitPosition=468, ComBitSize=12, ComSignalDataInvalidValue=4095, ComSignalEndianness=LITTLE_ENDIAN, ComSignalInitValue=4094, ComSignalType=UINT8, ComTransferProperty=PENDING, ComSystemTemplateSystemSignalRef=BMC_CMC_Zellspannung_078
        BMC_CMC_Zellspannung_079_XIX_BMC_CMC_Zellspannung_03_XIX_HCP5_CANFD01_36f945d9_Tx: ComBitPosition=12, ComBitSize=12, ComSignalDataInvalidValue=4095, ComSignalEndianness=LITTLE_ENDIAN, ComSignalInitValue=4094, ComSignalType=UINT8, ComTransferProperty=PENDING, ComSystemTemplateSystemSignalRef=BMC_CMC_Zellspannung_079
        BMC_CMC_Zellspannung_080_XIX_BMC_CMC_Zellspannung_03_XIX_HCP5_CANFD01_39aa6f80_Tx: ComBitPosition=24, ComBitSize=12, ComSignalDataInvalidValue=4095, ComSignalEndianness=LITTLE_ENDIAN, ComSignalInitValue=4094, ComSignalType=UINT8, ComTransferProperty=PENDING, ComSystemTemplateSystemSignalRef=BMC_CMC_Zellspannung_080
        BMC_CMC_Zellspannung_081_XIX_BMC_CMC_Zellspannung_03_XIX_HCP5_CANFD01_4663f413_Tx: ComBitPosition=36, ComBitSize=12, ComSignalDataInvalidValue=4095, ComSignalEndianness=LITTLE_ENDIAN, ComSignalInitValue=4094, ComSignalType=UINT8, ComTransferProperty=PENDING, ComSystemTemplateSystemSignalRef=BMC_CMC_Zellspannung_081
        BMC_CMC_Zellspannung_082_XIX_BMC_CMC_Zellspannung_03_XIX_HCP5_CANFD01_c63958a6_Tx: ComBitPosition=48, ComBitSize=12, ComSignalDataInvalidValue=4095, ComSignalEndianness=LITTLE_ENDIAN, ComSignalInitValue=4094, ComSignalType=UINT8, ComTransferProperty=PENDING, ComSystemTemplateSystemSignalRef=BMC_CMC_Zellspannung_082
        BMC_CMC_Zellspannung_083_XIX_BMC_CMC_Zellspannung_03_XIX_HCP5_CANFD01_b9f0c335_Tx: ComBitPosition=60, ComBitSize=12, ComSignalDataInvalidValue=4095, ComSignalEndianness=LITTLE_ENDIAN, ComSignalInitValue=4094, ComSignalType=UINT8, ComTransferProperty=PENDING, ComSystemTemplateSystemSignalRef=BMC_CMC_Zellspannung_083
        BMC_CMC_Zellspannung_084_XIX_BMC_CMC_Zellspannung_03_XIX_HCP5_CANFD01_1dfd078d_Tx: ComBitPosition=72, ComBitSize=12, ComSignalDataInvalidValue=4095, ComSignalEndianness=LITTLE_ENDIAN, ComSignalInitValue=4094, ComSignalType=UINT8, ComTransferProperty=PENDING, ComSystemTemplateSystemSignalRef=BMC_CMC_Zellspannung_084
        BMC_CMC_Zellspannung_085_XIX_BMC_CMC_Zellspannung_03_XIX_HCP5_CANFD01_62349c1e_Tx: ComBitPosition=84, ComBitSize=12, ComSignalDataInvalidValue=4095, ComSignalEndianness=LITTLE_ENDIAN, ComSignalInitValue=4094, ComSignalType=UINT8, ComTransferProperty=PENDING, ComSystemTemplateSystemSignalRef=BMC_CMC_Zellspannung_085
        BMC_CMC_Zellspannung_086_XIX_BMC_CMC_Zellspannung_03_XIX_HCP5_CANFD01_e26e30ab_Tx: ComBitPosition=96, ComBitSize=12, ComSignalDataInvalidValue=4095, ComSignalEndianness=LITTLE_ENDIAN, ComSignalInitValue=4094, ComSignalType=UINT8, ComTransferProperty=PENDING, ComSystemTemplateSystemSignalRef=BMC_CMC_Zellspannung_086
        BMC_CMC_Zellspannung_087_XIX_BMC_CMC_Zellspannung_03_XIX_HCP5_CANFD01_9da7ab38_Tx: ComBitPosition=108, ComBitSize=12, ComSignalDataInvalidValue=4095, ComSignalEndianness=LITTLE_ENDIAN, ComSignalInitValue=4094, ComSignalType=UINT8, ComTransferProperty=PENDING, ComSystemTemplateSystemSignalRef=BMC_CMC_Zellspannung_087
        BMC_CMC_Zellspannung_088_XIX_BMC_CMC_Zellspannung_03_XIX_HCP5_CANFD01_7104bf9a_Tx: ComBitPosition=120, ComBitSize=12, ComSignalDataInvalidValue=4095, ComSignalEndianness=LITTLE_ENDIAN, ComSignalInitValue=4094, ComSignalType=UINT8, ComTransferProperty=PENDING, ComSystemTemplateSystemSignalRef=BMC_CMC_Zellspannung_088
        BMC_CMC_Zellspannung_089_XIX_BMC_CMC_Zellspannung_03_XIX_HCP5_CANFD01_0ecd2409_Tx: ComBitPosition=132, ComBitSize=12, ComSignalDataInvalidValue=4095, ComSignalEndianness=LITTLE_ENDIAN, ComSignalInitValue=4094, ComSignalType=UINT8, ComTransferProperty=PENDING, ComSystemTemplateSystemSignalRef=BMC_CMC_Zellspannung_089
        BMC_CMC_Zellspannung_090_XIX_BMC_CMC_Zellspannung_03_XIX_HCP5_CANFD01_50d364e5_Tx: ComBitPosition=144, ComBitSize=12, ComSignalDataInvalidValue=4095, ComSignalEndianness=LITTLE_ENDIAN, ComSignalInitValue=4094, ComSignalType=UINT8, ComTransferProperty=PENDING, ComSystemTemplateSystemSignalRef=BMC_CMC_Zellspannung_090
        BMC_CMC_Zellspannung_091_XIX_BMC_CMC_Zellspannung_03_XIX_HCP5_CANFD01_2f1aff76_Tx: ComBitPosition=156, ComBitSize=12, ComSignalDataInvalidValue=4095, ComSignalEndianness=LITTLE_ENDIAN, ComSignalInitValue=4094, ComSignalType=UINT8, ComTransferProperty=PENDING, ComSystemTemplateSystemSignalRef=BMC_CMC_Zellspannung_091
        BMC_CMC_Zellspannung_092_XIX_BMC_CMC_Zellspannung_03_XIX_HCP5_CANFD01_af4053c3_Tx: ComBitPosition=168, ComBitSize=12, ComSignalDataInvalidValue=4095, ComSignalEndianness=LITTLE_ENDIAN, ComSignalInitValue=4094, ComSignalType=UINT8, ComTransferProperty=PENDING, ComSystemTemplateSystemSignalRef=BMC_CMC_Zellspannung_092
        BMC_CMC_Zellspannung_093_XIX_BMC_CMC_Zellspannung_03_XIX_HCP5_CANFD01_d089c850_Tx: ComBitPosition=180, ComBitSize=12, ComSignalDataInvalidValue=4095, ComSignalEndianness=LITTLE_ENDIAN, ComSignalInitValue=4094, ComSignalType=UINT8, ComTransferProperty=PENDING, ComSystemTemplateSystemSignalRef=BMC_CMC_Zellspannung_093
        BMC_CMC_Zellspannung_094_XIX_BMC_CMC_Zellspannung_03_XIX_HCP5_CANFD01_74840ce8_Tx: ComBitPosition=192, ComBitSize=12, ComSignalDataInvalidValue=4095, ComSignalEndianness=LITTLE_ENDIAN, ComSignalInitValue=4094, ComSignalType=UINT8, ComTransferProperty=PENDING, ComSystemTemplateSystemSignalRef=BMC_CMC_Zellspannung_094
        BMC_CMC_Zellspannung_095_XIX_BMC_CMC_Zellspannung_03_XIX_HCP5_CANFD01_0b4d977b_Tx: ComBitPosition=204, ComBitSize=12, ComSignalDataInvalidValue=4095, ComSignalEndianness=LITTLE_ENDIAN, ComSignalInitValue=4094, ComSignalType=UINT8, ComTransferProperty=PENDING, ComSystemTemplateSystemSignalRef=BMC_CMC_Zellspannung_095
        BMC_CMC_Zellspannung_096_XIX_BMC_CMC_Zellspannung_03_XIX_HCP5_CANFD01_8b173bce_Tx: ComBitPosition=216, ComBitSize=12, ComSignalDataInvalidValue=4095, ComSignalEndianness=LITTLE_ENDIAN, ComSignalInitValue=4094, ComSignalType=UINT8, ComTransferProperty=PENDING, ComSystemTemplateSystemSignalRef=BMC_CMC_Zellspannung_096
        BMC_CMC_Zellspannung_097_XIX_BMC_CMC_Zellspannung_03_XIX_HCP5_CANFD01_f4dea05d_Tx: ComBitPosition=228, ComBitSize=12, ComSignalDataInvalidValue=4095, ComSignalEndianness=LITTLE_ENDIAN, ComSignalInitValue=4094, ComSignalType=UINT8, ComTransferProperty=PENDING, ComSystemTemplateSystemSignalRef=BMC_CMC_Zellspannung_097
        BMC_CMC_Zellspannung_098_XIX_BMC_CMC_Zellspannung_03_XIX_HCP5_CANFD01_187db4ff_Tx: ComBitPosition=240, ComBitSize=12, ComSignalDataInvalidValue=4095, ComSignalEndianness=LITTLE_ENDIAN, ComSignalInitValue=4094, ComSignalType=UINT8, ComTransferProperty=PENDING, ComSystemTemplateSystemSignalRef=BMC_CMC_Zellspannung_098
        BMC_CMC_Zellspannung_099_XIX_BMC_CMC_Zellspannung_03_XIX_HCP5_CANFD01_67b42f6c_Tx: ComBitPosition=252, ComBitSize=12, ComSignalDataInvalidValue=4095, ComSignalEndianness=LITTLE_ENDIAN, ComSignalInitValue=4094, ComSignalType=UINT8, ComTransferProperty=PENDING, ComSystemTemplateSystemSignalRef=BMC_CMC_Zellspannung_099
        BMC_CMC_Zellspannung_100_XIX_BMC_CMC_Zellspannung_03_XIX_HCP5_CANFD01_f931d4f6_Tx: ComBitPosition=264, ComBitSize=12, ComSignalDataInvalidValue=4095, ComSignalEndianness=LITTLE_ENDIAN, ComSignalInitValue=4094, ComSignalType=UINT8, ComTransferProperty=PENDING, ComSystemTemplateSystemSignalRef=BMC_CMC_Zellspannung_100
        BMC_CMC_Zellspannung_101_XIX_BMC_CMC_Zellspannung_03_XIX_HCP5_CANFD01_86f84f65_Tx: ComBitPosition=276, ComBitSize=12, ComSignalDataInvalidValue=4095, ComSignalEndianness=LITTLE_ENDIAN, ComSignalInitValue=4094, ComSignalType=UINT8, ComTransferProperty=PENDING, ComSystemTemplateSystemSignalRef=BMC_CMC_Zellspannung_101
        BMC_CMC_Zellspannung_102_XIX_BMC_CMC_Zellspannung_03_XIX_HCP5_CANFD01_06a2e3d0_Tx: ComBitPosition=288, ComBitSize=12, ComSignalDataInvalidValue=4095, ComSignalEndianness=LITTLE_ENDIAN, ComSignalInitValue=4094, ComSignalType=UINT8, ComTransferProperty=PENDING, ComSystemTemplateSystemSignalRef=BMC_CMC_Zellspannung_102
        BMC_CMC_Zellspannung_103_XIX_BMC_CMC_Zellspannung_03_XIX_HCP5_CANFD01_796b7843_Tx: ComBitPosition=300, ComBitSize=12, ComSignalDataInvalidValue=4095, ComSignalEndianness=LITTLE_ENDIAN, ComSignalInitValue=4094, ComSignalType=UINT8, ComTransferProperty=PENDING, ComSystemTemplateSystemSignalRef=BMC_CMC_Zellspannung_103
        BMC_CMC_Zellspannung_104_XIX_BMC_CMC_Zellspannung_03_XIX_HCP5_CANFD01_dd66bcfb_Tx: ComBitPosition=312, ComBitSize=12, ComSignalDataInvalidValue=4095, ComSignalEndianness=LITTLE_ENDIAN, ComSignalInitValue=4094, ComSignalType=UINT8, ComTransferProperty=PENDING, ComSystemTemplateSystemSignalRef=BMC_CMC_Zellspannung_104
        BMC_CMC_Zellspannung_105_XIX_BMC_CMC_Zellspannung_03_XIX_HCP5_CANFD01_a2af2768_Tx: ComBitPosition=324, ComBitSize=12, ComSignalDataInvalidValue=4095, ComSignalEndianness=LITTLE_ENDIAN, ComSignalInitValue=4094, ComSignalType=UINT8, ComTransferProperty=PENDING, ComSystemTemplateSystemSignalRef=BMC_CMC_Zellspannung_105
        BMC_CMC_Zellspannung_106_XIX_BMC_CMC_Zellspannung_03_XIX_HCP5_CANFD01_22f58bdd_Tx: ComBitPosition=336, ComBitSize=12, ComSignalDataInvalidValue=4095, ComSignalEndianness=LITTLE_ENDIAN, ComSignalInitValue=4094, ComSignalType=UINT8, ComTransferProperty=PENDING, ComSystemTemplateSystemSignalRef=BMC_CMC_Zellspannung_106
        BMC_CMC_Zellspannung_107_XIX_BMC_CMC_Zellspannung_03_XIX_HCP5_CANFD01_5d3c104e_Tx: ComBitPosition=348, ComBitSize=12, ComSignalDataInvalidValue=4095, ComSignalEndianness=LITTLE_ENDIAN, ComSignalInitValue=4094, ComSignalType=UINT8, ComTransferProperty=PENDING, ComSystemTemplateSystemSignalRef=BMC_CMC_Zellspannung_107
        BMC_CMC_Zellspannung_108_XIX_BMC_CMC_Zellspannung_03_XIX_HCP5_CANFD01_b19f04ec_Tx: ComBitPosition=360, ComBitSize=12, ComSignalDataInvalidValue=4095, ComSignalEndianness=LITTLE_ENDIAN, ComSignalInitValue=4094, ComSignalType=UINT8, ComTransferProperty=PENDING, ComSystemTemplateSystemSignalRef=BMC_CMC_Zellspannung_108
        BMC_CMC_Zellspannung_109_XIX_BMC_CMC_Zellspannung_03_XIX_HCP5_CANFD01_ce569f7f_Tx: ComBitPosition=372, ComBitSize=12, ComSignalDataInvalidValue=4095, ComSignalEndianness=LITTLE_ENDIAN, ComSignalInitValue=4094, ComSignalType=UINT8, ComTransferProperty=PENDING, ComSystemTemplateSystemSignalRef=BMC_CMC_Zellspannung_109
        BMC_CMC_Zellspannung_110_XIX_BMC_CMC_Zellspannung_03_XIX_HCP5_CANFD01_9048df93_Tx: ComBitPosition=384, ComBitSize=12, ComSignalDataInvalidValue=4095, ComSignalEndianness=LITTLE_ENDIAN, ComSignalInitValue=4094, ComSignalType=UINT8, ComTransferProperty=PENDING, ComSystemTemplateSystemSignalRef=BMC_CMC_Zellspannung_110
        BMC_CMC_Zellspannung_111_XIX_BMC_CMC_Zellspannung_03_XIX_HCP5_CANFD01_ef814400_Tx: ComBitPosition=396, ComBitSize=12, ComSignalDataInvalidValue=4095, ComSignalEndianness=LITTLE_ENDIAN, ComSignalInitValue=4094, ComSignalType=UINT8, ComTransferProperty=PENDING, ComSystemTemplateSystemSignalRef=BMC_CMC_Zellspannung_111
        BMC_CMC_Zellspannung_112_XIX_BMC_CMC_Zellspannung_03_XIX_HCP5_CANFD01_6fdbe8b5_Tx: ComBitPosition=408, ComBitSize=12, ComSignalDataInvalidValue=4095, ComSignalEndianness=LITTLE_ENDIAN, ComSignalInitValue=4094, ComSignalType=UINT8, ComTransferProperty=PENDING, ComSystemTemplateSystemSignalRef=BMC_CMC_Zellspannung_112
        BMC_CMC_Zellspannung_113_XIX_BMC_CMC_Zellspannung_03_XIX_HCP5_CANFD01_10127326_Tx: ComBitPosition=420, ComBitSize=12, ComSignalDataInvalidValue=4095, ComSignalEndianness=LITTLE_ENDIAN, ComSignalInitValue=4094, ComSignalType=UINT8, ComTransferProperty=PENDING, ComSystemTemplateSystemSignalRef=BMC_CMC_Zellspannung_113
        BMC_CMC_Zellspannung_114_XIX_BMC_CMC_Zellspannung_03_XIX_HCP5_CANFD01_b41fb79e_Tx: ComBitPosition=432, ComBitSize=12, ComSignalDataInvalidValue=4095, ComSignalEndianness=LITTLE_ENDIAN, ComSignalInitValue=4094, ComSignalType=UINT8, ComTransferProperty=PENDING, ComSystemTemplateSystemSignalRef=BMC_CMC_Zellspannung_114
        BMC_CMC_Zellspannung_115_XIX_BMC_CMC_Zellspannung_03_XIX_HCP5_CANFD01_cbd62c0d_Tx: ComBitPosition=444, ComBitSize=12, ComSignalDataInvalidValue=4095, ComSignalEndianness=LITTLE_ENDIAN, ComSignalInitValue=4094, ComSignalType=UINT8, ComTransferProperty=PENDING, ComSystemTemplateSystemSignalRef=BMC_CMC_Zellspannung_115
        BMC_CMC_Zellspannung_116_XIX_BMC_CMC_Zellspannung_03_XIX_HCP5_CANFD01_4b8c80b8_Tx: ComBitPosition=456, ComBitSize=12, ComSignalDataInvalidValue=4095, ComSignalEndianness=LITTLE_ENDIAN, ComSignalInitValue=4094, ComSignalType=UINT8, ComTransferProperty=PENDING, ComSystemTemplateSystemSignalRef=BMC_CMC_Zellspannung_116
        BMC_CMC_Zellspannung_117_XIX_BMC_CMC_Zellspannung_03_XIX_HCP5_CANFD01_34451b2b_Tx: ComBitPosition=468, ComBitSize=12, ComSignalDataInvalidValue=4095, ComSignalEndianness=LITTLE_ENDIAN, ComSignalInitValue=4094, ComSignalType=UINT8, ComTransferProperty=PENDING, ComSystemTemplateSystemSignalRef=BMC_CMC_Zellspannung_117
        BMC_CMC_Zellspannung_118_XIX_BMC_CMC_Zellspannung_04_XIX_HCP5_CANFD01_39c805ed_Tx: ComBitPosition=12, ComBitSize=12, ComSignalDataInvalidValue=4095, ComSignalEndianness=LITTLE_ENDIAN, ComSignalInitValue=4094, ComSignalType=UINT8, ComTransferProperty=PENDING, ComSystemTemplateSystemSignalRef=BMC_CMC_Zellspannung_118
        BMC_CMC_Zellspannung_119_XIX_BMC_CMC_Zellspannung_04_XIX_HCP5_CANFD01_46019e7e_Tx: ComBitPosition=24, ComBitSize=12, ComSignalDataInvalidValue=4095, ComSignalEndianness=LITTLE_ENDIAN, ComSignalInitValue=4094, ComSignalType=UINT8, ComTransferProperty=PENDING, ComSystemTemplateSystemSignalRef=BMC_CMC_Zellspannung_119
        BMC_CMC_Zellspannung_120_XIX_BMC_CMC_Zellspannung_04_XIX_HCP5_CANFD01_caedc858_Tx: ComBitPosition=36, ComBitSize=12, ComSignalDataInvalidValue=4095, ComSignalEndianness=LITTLE_ENDIAN, ComSignalInitValue=4094, ComSignalType=UINT8, ComTransferProperty=PENDING, ComSystemTemplateSystemSignalRef=BMC_CMC_Zellspannung_120
        BMC_CMC_Zellspannung_121_XIX_BMC_CMC_Zellspannung_04_XIX_HCP5_CANFD01_b52453cb_Tx: ComBitPosition=48, ComBitSize=12, ComSignalDataInvalidValue=4095, ComSignalEndianness=LITTLE_ENDIAN, ComSignalInitValue=4094, ComSignalType=UINT8, ComTransferProperty=PENDING, ComSystemTemplateSystemSignalRef=BMC_CMC_Zellspannung_121
        BMC_CMC_Zellspannung_122_XIX_BMC_CMC_Zellspannung_04_XIX_HCP5_CANFD01_357eff7e_Tx: ComBitPosition=60, ComBitSize=12, ComSignalDataInvalidValue=4095, ComSignalEndianness=LITTLE_ENDIAN, ComSignalInitValue=4094, ComSignalType=UINT8, ComTransferProperty=PENDING, ComSystemTemplateSystemSignalRef=BMC_CMC_Zellspannung_122
        BMC_CMC_Zellspannung_123_XIX_BMC_CMC_Zellspannung_04_XIX_HCP5_CANFD01_4ab764ed_Tx: ComBitPosition=72, ComBitSize=12, ComSignalDataInvalidValue=4095, ComSignalEndianness=LITTLE_ENDIAN, ComSignalInitValue=4094, ComSignalType=UINT8, ComTransferProperty=PENDING, ComSystemTemplateSystemSignalRef=BMC_CMC_Zellspannung_123
        BMC_CMC_Zellspannung_124_XIX_BMC_CMC_Zellspannung_04_XIX_HCP5_CANFD01_eebaa055_Tx: ComBitPosition=84, ComBitSize=12, ComSignalDataInvalidValue=4095, ComSignalEndianness=LITTLE_ENDIAN, ComSignalInitValue=4094, ComSignalType=UINT8, ComTransferProperty=PENDING, ComSystemTemplateSystemSignalRef=BMC_CMC_Zellspannung_124
        BMC_CMC_Zellspannung_125_XIX_BMC_CMC_Zellspannung_04_XIX_HCP5_CANFD01_91733bc6_Tx: ComBitPosition=96, ComBitSize=12, ComSignalDataInvalidValue=4095, ComSignalEndianness=LITTLE_ENDIAN, ComSignalInitValue=4094, ComSignalType=UINT8, ComTransferProperty=PENDING, ComSystemTemplateSystemSignalRef=BMC_CMC_Zellspannung_125
        BMC_CMC_Zellspannung_126_XIX_BMC_CMC_Zellspannung_04_XIX_HCP5_CANFD01_11299773_Tx: ComBitPosition=108, ComBitSize=12, ComSignalDataInvalidValue=4095, ComSignalEndianness=LITTLE_ENDIAN, ComSignalInitValue=4094, ComSignalType=UINT8, ComTransferProperty=PENDING, ComSystemTemplateSystemSignalRef=BMC_CMC_Zellspannung_126
        BMC_CMC_Zellspannung_127_XIX_BMC_CMC_Zellspannung_04_XIX_HCP5_CANFD01_6ee00ce0_Tx: ComBitPosition=120, ComBitSize=12, ComSignalDataInvalidValue=4095, ComSignalEndianness=LITTLE_ENDIAN, ComSignalInitValue=4094, ComSignalType=UINT8, ComTransferProperty=PENDING, ComSystemTemplateSystemSignalRef=BMC_CMC_Zellspannung_127
        BMC_CMC_Zellspannung_128_XIX_BMC_CMC_Zellspannung_04_XIX_HCP5_CANFD01_82431842_Tx: ComBitPosition=132, ComBitSize=12, ComSignalDataInvalidValue=4095, ComSignalEndianness=LITTLE_ENDIAN, ComSignalInitValue=4094, ComSignalType=UINT8, ComTransferProperty=PENDING, ComSystemTemplateSystemSignalRef=BMC_CMC_Zellspannung_128
        BMC_CMC_Zellspannung_129_XIX_BMC_CMC_Zellspannung_04_XIX_HCP5_CANFD01_fd8a83d1_Tx: ComBitPosition=144, ComBitSize=12, ComSignalDataInvalidValue=4095, ComSignalEndianness=LITTLE_ENDIAN, ComSignalInitValue=4094, ComSignalType=UINT8, ComTransferProperty=PENDING, ComSystemTemplateSystemSignalRef=BMC_CMC_Zellspannung_129
        BMC_CMC_Zellspannung_130_XIX_BMC_CMC_Zellspannung_04_XIX_HCP5_CANFD01_a394c33d_Tx: ComBitPosition=156, ComBitSize=12, ComSignalDataInvalidValue=4095, ComSignalEndianness=LITTLE_ENDIAN, ComSignalInitValue=4094, ComSignalType=UINT8, ComTransferProperty=PENDING, ComSystemTemplateSystemSignalRef=BMC_CMC_Zellspannung_130
        BMC_CMC_Zellspannung_131_XIX_BMC_CMC_Zellspannung_04_XIX_HCP5_CANFD01_dc5d58ae_Tx: ComBitPosition=168, ComBitSize=12, ComSignalDataInvalidValue=4095, ComSignalEndianness=LITTLE_ENDIAN, ComSignalInitValue=4094, ComSignalType=UINT8, ComTransferProperty=PENDING, ComSystemTemplateSystemSignalRef=BMC_CMC_Zellspannung_131
        BMC_CMC_Zellspannung_132_XIX_BMC_CMC_Zellspannung_04_XIX_HCP5_CANFD01_5c07f41b_Tx: ComBitPosition=180, ComBitSize=12, ComSignalDataInvalidValue=4095, ComSignalEndianness=LITTLE_ENDIAN, ComSignalInitValue=4094, ComSignalType=UINT8, ComTransferProperty=PENDING, ComSystemTemplateSystemSignalRef=BMC_CMC_Zellspannung_132
        BMC_CMC_Zellspannung_133_XIX_BMC_CMC_Zellspannung_04_XIX_HCP5_CANFD01_23ce6f88_Tx: ComBitPosition=192, ComBitSize=12, ComSignalDataInvalidValue=4095, ComSignalEndianness=LITTLE_ENDIAN, ComSignalInitValue=4094, ComSignalType=UINT8, ComTransferProperty=PENDING, ComSystemTemplateSystemSignalRef=BMC_CMC_Zellspannung_133
        BMC_CMC_Zellspannung_134_XIX_BMC_CMC_Zellspannung_04_XIX_HCP5_CANFD01_87c3ab30_Tx: ComBitPosition=204, ComBitSize=12, ComSignalDataInvalidValue=4095, ComSignalEndianness=LITTLE_ENDIAN, ComSignalInitValue=4094, ComSignalType=UINT8, ComTransferProperty=PENDING, ComSystemTemplateSystemSignalRef=BMC_CMC_Zellspannung_134
        BMC_CMC_Zellspannung_135_XIX_BMC_CMC_Zellspannung_04_XIX_HCP5_CANFD01_f80a30a3_Tx: ComBitPosition=216, ComBitSize=12, ComSignalDataInvalidValue=4095, ComSignalEndianness=LITTLE_ENDIAN, ComSignalInitValue=4094, ComSignalType=UINT8, ComTransferProperty=PENDING, ComSystemTemplateSystemSignalRef=BMC_CMC_Zellspannung_135
        BMC_CMC_Zellspannung_136_XIX_BMC_CMC_Zellspannung_04_XIX_HCP5_CANFD01_78509c16_Tx: ComBitPosition=228, ComBitSize=12, ComSignalDataInvalidValue=4095, ComSignalEndianness=LITTLE_ENDIAN, ComSignalInitValue=4094, ComSignalType=UINT8, ComTransferProperty=PENDING, ComSystemTemplateSystemSignalRef=BMC_CMC_Zellspannung_136
        BMC_CMC_Zellspannung_137_XIX_BMC_CMC_Zellspannung_04_XIX_HCP5_CANFD01_07990785_Tx: ComBitPosition=240, ComBitSize=12, ComSignalDataInvalidValue=4095, ComSignalEndianness=LITTLE_ENDIAN, ComSignalInitValue=4094, ComSignalType=UINT8, ComTransferProperty=PENDING, ComSystemTemplateSystemSignalRef=BMC_CMC_Zellspannung_137
        BMC_CMC_Zellspannung_138_XIX_BMC_CMC_Zellspannung_04_XIX_HCP5_CANFD01_eb3a1327_Tx: ComBitPosition=252, ComBitSize=12, ComSignalDataInvalidValue=4095, ComSignalEndianness=LITTLE_ENDIAN, ComSignalInitValue=4094, ComSignalType=UINT8, ComTransferProperty=PENDING, ComSystemTemplateSystemSignalRef=BMC_CMC_Zellspannung_138
        BMC_CMC_Zellspannung_139_XIX_BMC_CMC_Zellspannung_04_XIX_HCP5_CANFD01_94f388b4_Tx: ComBitPosition=264, ComBitSize=12, ComSignalDataInvalidValue=4095, ComSignalEndianness=LITTLE_ENDIAN, ComSignalInitValue=4094, ComSignalType=UINT8, ComTransferProperty=PENDING, ComSystemTemplateSystemSignalRef=BMC_CMC_Zellspannung_139
        BMC_CMC_Zellspannung_140_XIX_BMC_CMC_Zellspannung_04_XIX_HCP5_CANFD01_668af547_Tx: ComBitPosition=276, ComBitSize=12, ComSignalDataInvalidValue=4095, ComSignalEndianness=LITTLE_ENDIAN, ComSignalInitValue=4094, ComSignalType=UINT8, ComTransferProperty=PENDING, ComSystemTemplateSystemSignalRef=BMC_CMC_Zellspannung_140
        BMC_CMC_Zellspannung_141_XIX_BMC_CMC_Zellspannung_04_XIX_HCP5_CANFD01_19436ed4_Tx: ComBitPosition=288, ComBitSize=12, ComSignalDataInvalidValue=4095, ComSignalEndianness=LITTLE_ENDIAN, ComSignalInitValue=4094, ComSignalType=UINT8, ComTransferProperty=PENDING, ComSystemTemplateSystemSignalRef=BMC_CMC_Zellspannung_141
        BMC_CMC_Zellspannung_142_XIX_BMC_CMC_Zellspannung_04_XIX_HCP5_CANFD01_9919c261_Tx: ComBitPosition=300, ComBitSize=12, ComSignalDataInvalidValue=4095, ComSignalEndianness=LITTLE_ENDIAN, ComSignalInitValue=4094, ComSignalType=UINT8, ComTransferProperty=PENDING, ComSystemTemplateSystemSignalRef=BMC_CMC_Zellspannung_142
        BMC_CMC_Zellspannung_143_XIX_BMC_CMC_Zellspannung_04_XIX_HCP5_CANFD01_e6d059f2_Tx: ComBitPosition=312, ComBitSize=12, ComSignalDataInvalidValue=4095, ComSignalEndianness=LITTLE_ENDIAN, ComSignalInitValue=4094, ComSignalType=UINT8, ComTransferProperty=PENDING, ComSystemTemplateSystemSignalRef=BMC_CMC_Zellspannung_143
        BMC_CMC_Zellspannung_144_XIX_BMC_CMC_Zellspannung_04_XIX_HCP5_CANFD01_42dd9d4a_Tx: ComBitPosition=324, ComBitSize=12, ComSignalDataInvalidValue=4095, ComSignalEndianness=LITTLE_ENDIAN, ComSignalInitValue=4094, ComSignalType=UINT8, ComTransferProperty=PENDING, ComSystemTemplateSystemSignalRef=BMC_CMC_Zellspannung_144
        BMC_CMC_Zellspannung_145_XIX_BMC_CMC_Zellspannung_04_XIX_HCP5_CANFD01_3d1406d9_Tx: ComBitPosition=336, ComBitSize=12, ComSignalDataInvalidValue=4095, ComSignalEndianness=LITTLE_ENDIAN, ComSignalInitValue=4094, ComSignalType=UINT8, ComTransferProperty=PENDING, ComSystemTemplateSystemSignalRef=BMC_CMC_Zellspannung_145
        BMC_CMC_Zellspannung_146_XIX_BMC_CMC_Zellspannung_04_XIX_HCP5_CANFD01_bd4eaa6c_Tx: ComBitPosition=348, ComBitSize=12, ComSignalDataInvalidValue=4095, ComSignalEndianness=LITTLE_ENDIAN, ComSignalInitValue=4094, ComSignalType=UINT8, ComTransferProperty=PENDING, ComSystemTemplateSystemSignalRef=BMC_CMC_Zellspannung_146
        BMC_CMC_Zellspannung_147_XIX_BMC_CMC_Zellspannung_04_XIX_HCP5_CANFD01_c28731ff_Tx: ComBitPosition=360, ComBitSize=12, ComSignalDataInvalidValue=4095, ComSignalEndianness=LITTLE_ENDIAN, ComSignalInitValue=4094, ComSignalType=UINT8, ComTransferProperty=PENDING, ComSystemTemplateSystemSignalRef=BMC_CMC_Zellspannung_147
        BMC_CMC_Zellspannung_148_XIX_BMC_CMC_Zellspannung_04_XIX_HCP5_CANFD01_2e24255d_Tx: ComBitPosition=372, ComBitSize=12, ComSignalDataInvalidValue=4095, ComSignalEndianness=LITTLE_ENDIAN, ComSignalInitValue=4094, ComSignalType=UINT8, ComTransferProperty=PENDING, ComSystemTemplateSystemSignalRef=BMC_CMC_Zellspannung_148
        BMC_CMC_Zellspannung_149_XIX_BMC_CMC_Zellspannung_04_XIX_HCP5_CANFD01_51edbece_Tx: ComBitPosition=384, ComBitSize=12, ComSignalDataInvalidValue=4095, ComSignalEndianness=LITTLE_ENDIAN, ComSignalInitValue=4094, ComSignalType=UINT8, ComTransferProperty=PENDING, ComSystemTemplateSystemSignalRef=BMC_CMC_Zellspannung_149
        BMC_CMC_Zellspannung_150_XIX_BMC_CMC_Zellspannung_04_XIX_HCP5_CANFD01_0ff3fe22_Tx: ComBitPosition=396, ComBitSize=12, ComSignalDataInvalidValue=4095, ComSignalEndianness=LITTLE_ENDIAN, ComSignalInitValue=4094, ComSignalType=UINT8, ComTransferProperty=PENDING, ComSystemTemplateSystemSignalRef=BMC_CMC_Zellspannung_150
        BMC_CMC_Zellspannung_151_XIX_BMC_CMC_Zellspannung_04_XIX_HCP5_CANFD01_703a65b1_Tx: ComBitPosition=408, ComBitSize=12, ComSignalDataInvalidValue=4095, ComSignalEndianness=LITTLE_ENDIAN, ComSignalInitValue=4094, ComSignalType=UINT8, ComTransferProperty=PENDING, ComSystemTemplateSystemSignalRef=BMC_CMC_Zellspannung_151
        BMC_CMC_Zellspannung_152_XIX_BMC_CMC_Zellspannung_04_XIX_HCP5_CANFD01_f060c904_Tx: ComBitPosition=420, ComBitSize=12, ComSignalDataInvalidValue=4095, ComSignalEndianness=LITTLE_ENDIAN, ComSignalInitValue=4094, ComSignalType=UINT8, ComTransferProperty=PENDING, ComSystemTemplateSystemSignalRef=BMC_CMC_Zellspannung_152
        BMC_CMC_Zellspannung_153_XIX_BMC_CMC_Zellspannung_04_XIX_HCP5_CANFD01_8fa95297_Tx: ComBitPosition=432, ComBitSize=12, ComSignalDataInvalidValue=4095, ComSignalEndianness=LITTLE_ENDIAN, ComSignalInitValue=4094, ComSignalType=UINT8, ComTransferProperty=PENDING, ComSystemTemplateSystemSignalRef=BMC_CMC_Zellspannung_153
        BMC_CMC_Zellspannung_154_XIX_BMC_CMC_Zellspannung_04_XIX_HCP5_CANFD01_2ba4962f_Tx: ComBitPosition=444, ComBitSize=12, ComSignalDataInvalidValue=4095, ComSignalEndianness=LITTLE_ENDIAN, ComSignalInitValue=4094, ComSignalType=UINT8, ComTransferProperty=PENDING, ComSystemTemplateSystemSignalRef=BMC_CMC_Zellspannung_154
        BMC_CMC_Zellspannung_155_XIX_BMC_CMC_Zellspannung_04_XIX_HCP5_CANFD01_546d0dbc_Tx: ComBitPosition=456, ComBitSize=12, ComSignalDataInvalidValue=4095, ComSignalEndianness=LITTLE_ENDIAN, ComSignalInitValue=4094, ComSignalType=UINT8, ComTransferProperty=PENDING, ComSystemTemplateSystemSignalRef=BMC_CMC_Zellspannung_155
        BMC_CMC_Zellspannung_156_XIX_BMC_CMC_Zellspannung_04_XIX_HCP5_CANFD01_d437a109_Tx: ComBitPosition=468, ComBitSize=12, ComSignalDataInvalidValue=4095, ComSignalEndianness=LITTLE_ENDIAN, ComSignalInitValue=4094, ComSignalType=UINT8, ComTransferProperty=PENDING, ComSystemTemplateSystemSignalRef=BMC_CMC_Zellspannung_156
        BMC_CMC_Zellspannung_157_XIX_BMC_CMC_Zellspannung_05_XIX_HCP5_CANFD01_44ac8c7b_Tx: ComBitPosition=12, ComBitSize=12, ComSignalDataInvalidValue=4095, ComSignalEndianness=LITTLE_ENDIAN, ComSignalInitValue=4094, ComSignalType=UINT8, ComTransferProperty=PENDING, ComSystemTemplateSystemSignalRef=BMC_CMC_Zellspannung_157
        BMC_CMC_Zellspannung_158_XIX_BMC_CMC_Zellspannung_05_XIX_HCP5_CANFD01_a80f98d9_Tx: ComBitPosition=24, ComBitSize=12, ComSignalDataInvalidValue=4095, ComSignalEndianness=LITTLE_ENDIAN, ComSignalInitValue=4094, ComSignalType=UINT8, ComTransferProperty=PENDING, ComSystemTemplateSystemSignalRef=BMC_CMC_Zellspannung_158
        BMC_CMC_Zellspannung_159_XIX_BMC_CMC_Zellspannung_05_XIX_HCP5_CANFD01_d7c6034a_Tx: ComBitPosition=36, ComBitSize=12, ComSignalDataInvalidValue=4095, ComSignalEndianness=LITTLE_ENDIAN, ComSignalInitValue=4094, ComSignalType=UINT8, ComTransferProperty=PENDING, ComSystemTemplateSystemSignalRef=BMC_CMC_Zellspannung_159
        BMC_CMC_Zellspannung_160_XIX_BMC_CMC_Zellspannung_05_XIX_HCP5_CANFD01_5b2a556c_Tx: ComBitPosition=48, ComBitSize=12, ComSignalDataInvalidValue=4095, ComSignalEndianness=LITTLE_ENDIAN, ComSignalInitValue=4094, ComSignalType=UINT8, ComTransferProperty=PENDING, ComSystemTemplateSystemSignalRef=BMC_CMC_Zellspannung_160
        BMC_CMC_Zellspannung_161_XIX_BMC_CMC_Zellspannung_05_XIX_HCP5_CANFD01_24e3ceff_Tx: ComBitPosition=60, ComBitSize=12, ComSignalDataInvalidValue=4095, ComSignalEndianness=LITTLE_ENDIAN, ComSignalInitValue=4094, ComSignalType=UINT8, ComTransferProperty=PENDING, ComSystemTemplateSystemSignalRef=BMC_CMC_Zellspannung_161
        BMC_CMC_Zellspannung_162_XIX_BMC_CMC_Zellspannung_05_XIX_HCP5_CANFD01_a4b9624a_Tx: ComBitPosition=72, ComBitSize=12, ComSignalDataInvalidValue=4095, ComSignalEndianness=LITTLE_ENDIAN, ComSignalInitValue=4094, ComSignalType=UINT8, ComTransferProperty=PENDING, ComSystemTemplateSystemSignalRef=BMC_CMC_Zellspannung_162
        BMC_CMC_Zellspannung_163_XIX_BMC_CMC_Zellspannung_05_XIX_HCP5_CANFD01_db70f9d9_Tx: ComBitPosition=84, ComBitSize=12, ComSignalDataInvalidValue=4095, ComSignalEndianness=LITTLE_ENDIAN, ComSignalInitValue=4094, ComSignalType=UINT8, ComTransferProperty=PENDING, ComSystemTemplateSystemSignalRef=BMC_CMC_Zellspannung_163
        BMC_CMC_Zellspannung_164_XIX_BMC_CMC_Zellspannung_05_XIX_HCP5_CANFD01_7f7d3d61_Tx: ComBitPosition=96, ComBitSize=12, ComSignalDataInvalidValue=4095, ComSignalEndianness=LITTLE_ENDIAN, ComSignalInitValue=4094, ComSignalType=UINT8, ComTransferProperty=PENDING, ComSystemTemplateSystemSignalRef=BMC_CMC_Zellspannung_164
        BMC_CMC_Zellspannung_165_XIX_BMC_CMC_Zellspannung_05_XIX_HCP5_CANFD01_00b4a6f2_Tx: ComBitPosition=108, ComBitSize=12, ComSignalDataInvalidValue=4095, ComSignalEndianness=LITTLE_ENDIAN, ComSignalInitValue=4094, ComSignalType=UINT8, ComTransferProperty=PENDING, ComSystemTemplateSystemSignalRef=BMC_CMC_Zellspannung_165
        BMC_CMC_Zellspannung_166_XIX_BMC_CMC_Zellspannung_05_XIX_HCP5_CANFD01_80ee0a47_Tx: ComBitPosition=120, ComBitSize=12, ComSignalDataInvalidValue=4095, ComSignalEndianness=LITTLE_ENDIAN, ComSignalInitValue=4094, ComSignalType=UINT8, ComTransferProperty=PENDING, ComSystemTemplateSystemSignalRef=BMC_CMC_Zellspannung_166
        BMC_CMC_Zellspannung_167_XIX_BMC_CMC_Zellspannung_05_XIX_HCP5_CANFD01_ff2791d4_Tx: ComBitPosition=132, ComBitSize=12, ComSignalDataInvalidValue=4095, ComSignalEndianness=LITTLE_ENDIAN, ComSignalInitValue=4094, ComSignalType=UINT8, ComTransferProperty=PENDING, ComSystemTemplateSystemSignalRef=BMC_CMC_Zellspannung_167
        BMC_CMC_Zellspannung_168_XIX_BMC_CMC_Zellspannung_05_XIX_HCP5_CANFD01_13848576_Tx: ComBitPosition=144, ComBitSize=12, ComSignalDataInvalidValue=4095, ComSignalEndianness=LITTLE_ENDIAN, ComSignalInitValue=4094, ComSignalType=UINT8, ComTransferProperty=PENDING, ComSystemTemplateSystemSignalRef=BMC_CMC_Zellspannung_168
        BMC_CMC_Zellspannung_169_XIX_BMC_CMC_Zellspannung_05_XIX_HCP5_CANFD01_6c4d1ee5_Tx: ComBitPosition=156, ComBitSize=12, ComSignalDataInvalidValue=4095, ComSignalEndianness=LITTLE_ENDIAN, ComSignalInitValue=4094, ComSignalType=UINT8, ComTransferProperty=PENDING, ComSystemTemplateSystemSignalRef=BMC_CMC_Zellspannung_169
        BMC_CMC_Zellspannung_170_XIX_BMC_CMC_Zellspannung_05_XIX_HCP5_CANFD01_32535e09_Tx: ComBitPosition=168, ComBitSize=12, ComSignalDataInvalidValue=4095, ComSignalEndianness=LITTLE_ENDIAN, ComSignalInitValue=4094, ComSignalType=UINT8, ComTransferProperty=PENDING, ComSystemTemplateSystemSignalRef=BMC_CMC_Zellspannung_170
        BMC_CMC_Zellspannung_171_XIX_BMC_CMC_Zellspannung_05_XIX_HCP5_CANFD01_4d9ac59a_Tx: ComBitPosition=180, ComBitSize=12, ComSignalDataInvalidValue=4095, ComSignalEndianness=LITTLE_ENDIAN, ComSignalInitValue=4094, ComSignalType=UINT8, ComTransferProperty=PENDING, ComSystemTemplateSystemSignalRef=BMC_CMC_Zellspannung_171
        BMC_CMC_Zellspannung_172_XIX_BMC_CMC_Zellspannung_05_XIX_HCP5_CANFD01_cdc0692f_Tx: ComBitPosition=192, ComBitSize=12, ComSignalDataInvalidValue=4095, ComSignalEndianness=LITTLE_ENDIAN, ComSignalInitValue=4094, ComSignalType=UINT8, ComTransferProperty=PENDING, ComSystemTemplateSystemSignalRef=BMC_CMC_Zellspannung_172
        BMC_CMC_Zellspannung_173_XIX_BMC_CMC_Zellspannung_05_XIX_HCP5_CANFD01_b209f2bc_Tx: ComBitPosition=204, ComBitSize=12, ComSignalDataInvalidValue=4095, ComSignalEndianness=LITTLE_ENDIAN, ComSignalInitValue=4094, ComSignalType=UINT8, ComTransferProperty=PENDING, ComSystemTemplateSystemSignalRef=BMC_CMC_Zellspannung_173
        BMC_CMC_Zellspannung_174_XIX_BMC_CMC_Zellspannung_05_XIX_HCP5_CANFD01_16043604_Tx: ComBitPosition=216, ComBitSize=12, ComSignalDataInvalidValue=4095, ComSignalEndianness=LITTLE_ENDIAN, ComSignalInitValue=4094, ComSignalType=UINT8, ComTransferProperty=PENDING, ComSystemTemplateSystemSignalRef=BMC_CMC_Zellspannung_174
        BMC_CMC_Zellspannung_175_XIX_BMC_CMC_Zellspannung_05_XIX_HCP5_CANFD01_69cdad97_Tx: ComBitPosition=228, ComBitSize=12, ComSignalDataInvalidValue=4095, ComSignalEndianness=LITTLE_ENDIAN, ComSignalInitValue=4094, ComSignalType=UINT8, ComTransferProperty=PENDING, ComSystemTemplateSystemSignalRef=BMC_CMC_Zellspannung_175
        BMC_CMC_Zellspannung_176_XIX_BMC_CMC_Zellspannung_05_XIX_HCP5_CANFD01_e9970122_Tx: ComBitPosition=240, ComBitSize=12, ComSignalDataInvalidValue=4095, ComSignalEndianness=LITTLE_ENDIAN, ComSignalInitValue=4094, ComSignalType=UINT8, ComTransferProperty=PENDING, ComSystemTemplateSystemSignalRef=BMC_CMC_Zellspannung_176
        BMC_CMC_Zellspannung_177_XIX_BMC_CMC_Zellspannung_05_XIX_HCP5_CANFD01_965e9ab1_Tx: ComBitPosition=252, ComBitSize=12, ComSignalDataInvalidValue=4095, ComSignalEndianness=LITTLE_ENDIAN, ComSignalInitValue=4094, ComSignalType=UINT8, ComTransferProperty=PENDING, ComSystemTemplateSystemSignalRef=BMC_CMC_Zellspannung_177
        BMC_CMC_Zellspannung_178_XIX_BMC_CMC_Zellspannung_05_XIX_HCP5_CANFD01_7afd8e13_Tx: ComBitPosition=264, ComBitSize=12, ComSignalDataInvalidValue=4095, ComSignalEndianness=LITTLE_ENDIAN, ComSignalInitValue=4094, ComSignalType=UINT8, ComTransferProperty=PENDING, ComSystemTemplateSystemSignalRef=BMC_CMC_Zellspannung_178
        BMC_CMC_Zellspannung_179_XIX_BMC_CMC_Zellspannung_05_XIX_HCP5_CANFD01_05341580_Tx: ComBitPosition=276, ComBitSize=12, ComSignalDataInvalidValue=4095, ComSignalEndianness=LITTLE_ENDIAN, ComSignalInitValue=4094, ComSignalType=UINT8, ComTransferProperty=PENDING, ComSystemTemplateSystemSignalRef=BMC_CMC_Zellspannung_179
        BMC_CMC_Zellspannung_180_XIX_BMC_CMC_Zellspannung_05_XIX_HCP5_CANFD01_0a673fd9_Tx: ComBitPosition=288, ComBitSize=12, ComSignalDataInvalidValue=4095, ComSignalEndianness=LITTLE_ENDIAN, ComSignalInitValue=4094, ComSignalType=UINT8, ComTransferProperty=PENDING, ComSystemTemplateSystemSignalRef=BMC_CMC_Zellspannung_180
        BMC_CMC_Zellspannung_181_XIX_BMC_CMC_Zellspannung_05_XIX_HCP5_CANFD01_75aea44a_Tx: ComBitPosition=300, ComBitSize=12, ComSignalDataInvalidValue=4095, ComSignalEndianness=LITTLE_ENDIAN, ComSignalInitValue=4094, ComSignalType=UINT8, ComTransferProperty=PENDING, ComSystemTemplateSystemSignalRef=BMC_CMC_Zellspannung_181
        BMC_CMC_Zellspannung_182_XIX_BMC_CMC_Zellspannung_05_XIX_HCP5_CANFD01_f5f408ff_Tx: ComBitPosition=312, ComBitSize=12, ComSignalDataInvalidValue=4095, ComSignalEndianness=LITTLE_ENDIAN, ComSignalInitValue=4094, ComSignalType=UINT8, ComTransferProperty=PENDING, ComSystemTemplateSystemSignalRef=BMC_CMC_Zellspannung_182
        BMC_CMC_Zellspannung_183_XIX_BMC_CMC_Zellspannung_05_XIX_HCP5_CANFD01_8a3d936c_Tx: ComBitPosition=324, ComBitSize=12, ComSignalDataInvalidValue=4095, ComSignalEndianness=LITTLE_ENDIAN, ComSignalInitValue=4094, ComSignalType=UINT8, ComTransferProperty=PENDING, ComSystemTemplateSystemSignalRef=BMC_CMC_Zellspannung_183
        BMC_CMC_Zellspannung_184_XIX_BMC_CMC_Zellspannung_05_XIX_HCP5_CANFD01_2e3057d4_Tx: ComBitPosition=336, ComBitSize=12, ComSignalDataInvalidValue=4095, ComSignalEndianness=LITTLE_ENDIAN, ComSignalInitValue=4094, ComSignalType=UINT8, ComTransferProperty=PENDING, ComSystemTemplateSystemSignalRef=BMC_CMC_Zellspannung_184
        BMC_CMC_Zellspannung_185_XIX_BMC_CMC_Zellspannung_05_XIX_HCP5_CANFD01_51f9cc47_Tx: ComBitPosition=348, ComBitSize=12, ComSignalDataInvalidValue=4095, ComSignalEndianness=LITTLE_ENDIAN, ComSignalInitValue=4094, ComSignalType=UINT8, ComTransferProperty=PENDING, ComSystemTemplateSystemSignalRef=BMC_CMC_Zellspannung_185
        BMC_CMC_Zellspannung_186_XIX_BMC_CMC_Zellspannung_05_XIX_HCP5_CANFD01_d1a360f2_Tx: ComBitPosition=360, ComBitSize=12, ComSignalDataInvalidValue=4095, ComSignalEndianness=LITTLE_ENDIAN, ComSignalInitValue=4094, ComSignalType=UINT8, ComTransferProperty=PENDING, ComSystemTemplateSystemSignalRef=BMC_CMC_Zellspannung_186
        BMC_CMC_Zellspannung_187_XIX_BMC_CMC_Zellspannung_05_XIX_HCP5_CANFD01_ae6afb61_Tx: ComBitPosition=372, ComBitSize=12, ComSignalDataInvalidValue=4095, ComSignalEndianness=LITTLE_ENDIAN, ComSignalInitValue=4094, ComSignalType=UINT8, ComTransferProperty=PENDING, ComSystemTemplateSystemSignalRef=BMC_CMC_Zellspannung_187
        BMC_CMC_Zellspannung_188_XIX_BMC_CMC_Zellspannung_05_XIX_HCP5_CANFD01_42c9efc3_Tx: ComBitPosition=384, ComBitSize=12, ComSignalDataInvalidValue=4095, ComSignalEndianness=LITTLE_ENDIAN, ComSignalInitValue=4094, ComSignalType=UINT8, ComTransferProperty=PENDING, ComSystemTemplateSystemSignalRef=BMC_CMC_Zellspannung_188
        BMC_CMC_Zellspannung_189_XIX_BMC_CMC_Zellspannung_05_XIX_HCP5_CANFD01_3d007450_Tx: ComBitPosition=396, ComBitSize=12, ComSignalDataInvalidValue=4095, ComSignalEndianness=LITTLE_ENDIAN, ComSignalInitValue=4094, ComSignalType=UINT8, ComTransferProperty=PENDING, ComSystemTemplateSystemSignalRef=BMC_CMC_Zellspannung_189
        BMC_CMC_Zellspannung_190_XIX_BMC_CMC_Zellspannung_05_XIX_HCP5_CANFD01_631e34bc_Tx: ComBitPosition=408, ComBitSize=12, ComSignalDataInvalidValue=4095, ComSignalEndianness=LITTLE_ENDIAN, ComSignalInitValue=4094, ComSignalType=UINT8, ComTransferProperty=PENDING, ComSystemTemplateSystemSignalRef=BMC_CMC_Zellspannung_190
        BMC_CMC_Zellspannung_191_XIX_BMC_CMC_Zellspannung_05_XIX_HCP5_CANFD01_1cd7af2f_Tx: ComBitPosition=420, ComBitSize=12, ComSignalDataInvalidValue=4095, ComSignalEndianness=LITTLE_ENDIAN, ComSignalInitValue=4094, ComSignalType=UINT8, ComTransferProperty=PENDING, ComSystemTemplateSystemSignalRef=BMC_CMC_Zellspannung_191
        BMC_CMC_Zellspannung_192_XIX_BMC_CMC_Zellspannung_05_XIX_HCP5_CANFD01_9c8d039a_Tx: ComBitPosition=432, ComBitSize=12, ComSignalDataInvalidValue=4095, ComSignalEndianness=LITTLE_ENDIAN, ComSignalInitValue=4094, ComSignalType=UINT8, ComTransferProperty=PENDING, ComSystemTemplateSystemSignalRef=BMC_CMC_Zellspannung_192
        BMC_Dauer_Entladeleistung_02_XIX_BMC_HV_09_XIX_HCP5_CANFD01_c6e0343a_Tx: ComBitPosition=70, ComBitSize=14, ComSignalDataInvalidValue=16383, ComSignalEndianness=LITTLE_ENDIAN, ComSignalInitValue=16382, ComSignalType=UINT8, ComTransferProperty=PENDING, ComSystemTemplateSystemSignalRef=BMC_Dauer_Entladeleistung_02
        BMC_Dauer_Entladeleistung_XIX_BMC_HV_03_XIX_HCP5_CANFD01_eeda29b5_Tx: ComBitPosition=68, ComBitSize=12, ComSignalDataInvalidValue=4095, ComSignalEndianness=LITTLE_ENDIAN, ComSignalInitValue=4094, ComSignalType=UINT8, ComTransferProperty=PENDING, ComSystemTemplateSystemSignalRef=BMC_Dauer_Entladeleistung
        BMC_Dauer_Ladeleistung_02_XIX_BMC_HV_09_XIX_HCP5_CANFD01_1af3699d_Tx: ComBitPosition=84, ComBitSize=14, ComSignalDataInvalidValue=16383, ComSignalEndianness=LITTLE_ENDIAN, ComSignalInitValue=16382, ComSignalType=UINT8, ComTransferProperty=PENDING, ComSystemTemplateSystemSignalRef=BMC_Dauer_Ladeleistung_02
        BMC_Dauer_Ladeleistung_XIX_BMC_HV_03_XIX_HCP5_CANFD01_680da831_Tx: ComBitPosition=80, ComBitSize=12, ComSignalDataInvalidValue=4095, ComSignalEndianness=LITTLE_ENDIAN, ComSignalInitValue=4094, ComSignalType=UINT8, ComTransferProperty=PENDING, ComSystemTemplateSystemSignalRef=BMC_Dauer_Ladeleistung
        BMC_EnergieVorhalt_XIX_BMC_HV_14_XIX_HCP5_CANFD01_33ff2903_Tx: ComBitPosition=54, ComBitSize=16, ComSignalDataInvalidValue=65535, ComSignalEndianness=LITTLE_ENDIAN, ComSignalInitValue=65534, ComSignalType=UINT8, ComTransferProperty=PENDING, ComSystemTemplateSystemSignalRef=BMC_EnergieVorhalt
        BMC_Energie_Entladen_XIX_BMC_HV_03_XIX_HCP5_CANFD01_9fbaffd3_Tx: ComBitPosition=128, ComBitSize=16, ComSignalDataInvalidValue=65535, ComSignalEndianness=LITTLE_ENDIAN, ComSignalInitValue=65534, ComSignalType=UINT8, ComTransferProperty=PENDING, ComSystemTemplateSystemSignalRef=BMC_Energie_Entladen
        BMC_Energie_Laden_XIX_BMC_HV_03_XIX_HCP5_CANFD01_44ca086e_Tx: ComBitPosition=144, ComBitSize=16, ComSignalDataInvalidValue=65535, ComSignalEndianness=LITTLE_ENDIAN, ComSignalInitValue=65534, ComSignalType=UINT8, ComTransferProperty=PENDING, ComSystemTemplateSystemSignalRef=BMC_Energie_Laden
        BMC_ExtLadeleistung_XIX_BMC_HV_08_XIX_HCP5_CANFD01_0def2e7f_Tx: ComBitPosition=328, ComBitSize=16, ComSignalDataInvalidValue=65535, ComSignalEndianness=LITTLE_ENDIAN, ComSignalInitValue=65534, ComSignalType=UINT8, ComTransferProperty=PENDING, ComSystemTemplateSystemSignalRef=BMC_ExtLadeleistung
        BMC_IstTemperaturMax_Modul_ID_XIX_BMC_HV_08_XIX_HCP5_CANFD01_26033124_Tx: ComBitPosition=272, ComBitSize=8, ComSignalEndianness=LITTLE_ENDIAN, ComSignalInitValue=255, ComSignalType=UINT8, ComTransferProperty=PENDING, ComSystemTemplateSystemSignalRef=BMC_IstTemperaturMax_Modul_ID
        BMC_IstTemperaturMax_Sensor_ID_XIX_BMC_HV_08_XIX_HCP5_CANFD01_ea25f749_Tx: ComBitPosition=17, ComBitSize=5, ComSignalEndianness=LITTLE_ENDIAN, ComSignalInitValue=31, ComSignalType=UINT8, ComTransferProperty=PENDING, ComSystemTemplateSystemSignalRef=BMC_IstTemperaturMax_Sensor_ID
        BMC_IstTemperaturMin_Modul_ID_XIX_BMC_HV_08_XIX_HCP5_CANFD01_688b548e_Tx: ComBitPosition=280, ComBitSize=8, ComSignalEndianness=LITTLE_ENDIAN, ComSignalInitValue=255, ComSignalType=UINT8, ComTransferProperty=PENDING, ComSystemTemplateSystemSignalRef=BMC_IstTemperaturMin_Modul_ID
        BMC_IstTemperaturMin_Sensor_ID_XIX_BMC_HV_08_XIX_HCP5_CANFD01_dc6835da_Tx: ComBitPosition=12, ComBitSize=5, ComSignalEndianness=LITTLE_ENDIAN, ComSignalInitValue=31, ComSignalType=UINT8, ComTransferProperty=PENDING, ComSystemTemplateSystemSignalRef=BMC_IstTemperaturMin_Sensor_ID
        BMC_IstZellSpannungMax_Modul_ID_XIX_BMC_HV_08_XIX_HCP5_CANFD01_4cf696ba_Tx: ComBitPosition=296, ComBitSize=8, ComSignalEndianness=LITTLE_ENDIAN, ComSignalInitValue=255, ComSignalType=UINT8, ComTransferProperty=PENDING, ComSystemTemplateSystemSignalRef=BMC_IstZellSpannungMax_Modul_ID
        BMC_IstZellSpannungMax_Zell_ID_XIX_BMC_HV_08_XIX_HCP5_CANFD01_b2be9152_Tx: ComBitPosition=312, ComBitSize=8, ComSignalEndianness=LITTLE_ENDIAN, ComSignalInitValue=255, ComSignalType=UINT8, ComTransferProperty=PENDING, ComSystemTemplateSystemSignalRef=BMC_IstZellSpannungMax_Zell_ID
        BMC_IstZellSpannungMin_Modul_ID_XIX_BMC_HV_08_XIX_HCP5_CANFD01_027ef310_Tx: ComBitPosition=288, ComBitSize=8, ComSignalEndianness=LITTLE_ENDIAN, ComSignalInitValue=255, ComSignalType=UINT8, ComTransferProperty=PENDING, ComSystemTemplateSystemSignalRef=BMC_IstZellSpannungMin_Modul_ID
        BMC_IstZellSpannungMin_Zell_ID_XIX_BMC_HV_08_XIX_HCP5_CANFD01_3e586fb0_Tx: ComBitPosition=304, ComBitSize=8, ComSignalEndianness=LITTLE_ENDIAN, ComSignalInitValue=255, ComSignalType=UINT8, ComTransferProperty=PENDING, ComSystemTemplateSystemSignalRef=BMC_IstZellSpannungMin_Zell_ID
        BMC_Konditionierung_Anf_XIX_BMC_HV_03_XIX_HCP5_CANFD01_f6c01bb8_Tx: ComBitPosition=160, ComBitSize=1, ComSignalEndianness=LITTLE_ENDIAN, ComSignalInitValue=0, ComSignalType=UINT8, ComTransferProperty=PENDING, ComSystemTemplateSystemSignalRef=BMC_Konditionierung_Anf
        BMC_KundenWarnung_XIX_BMC_HV_06_XIX_HCP5_CANFD01_8664a2d8_Tx: ComBitPosition=32, ComBitSize=2, ComSignalEndianness=LITTLE_ENDIAN, ComSignalInitValue=0, ComSignalType=UINT8, ComTransferProperty=TRIGGERED_ON_CHANGE_WITHOUT_REPETITION, ComSystemTemplateSystemSignalRef=BMC_KundenWarnung
        BMC_MaxEnergieinhalt_XIX_BMC_HV_03_XIX_HCP5_CANFD01_bd0ef2f1_Tx: ComBitPosition=112, ComBitSize=16, ComSignalDataInvalidValue=65535, ComSignalEndianness=LITTLE_ENDIAN, ComSignalInitValue=65534, ComSignalType=UINT8, ComTransferProperty=PENDING, ComSystemTemplateSystemSignalRef=BMC_MaxEnergieinhalt
        BMC_Max_Entladeleistung_02_XIX_BMC_HV_09_XIX_HCP5_CANFD01_a2b30339_Tx: ComBitPosition=26, ComBitSize=15, ComSignalDataInvalidValue=32767, ComSignalEndianness=LITTLE_ENDIAN, ComSignalInitValue=32766, ComSignalType=UINT8, ComTransferProperty=PENDING, ComSystemTemplateSystemSignalRef=BMC_Max_Entladeleistung_02
        BMC_Max_Entladestrom_02_XIX_BMC_HV_09_XIX_HCP5_CANFD01_af177205_Tx: ComBitPosition=12, ComBitSize=14, ComSignalDataInvalidValue=16383, ComSignalEndianness=LITTLE_ENDIAN, ComSignalInitValue=16382, ComSignalType=UINT8, ComTransferProperty=PENDING, ComSystemTemplateSystemSignalRef=BMC_Max_Entladestrom_02
        BMC_Max_Ladeleistung_02_XIX_BMC_HV_09_XIX_HCP5_CANFD01_a9e1b473_Tx: ComBitPosition=41, ComBitSize=15, ComSignalDataInvalidValue=32767, ComSignalEndianness=LITTLE_ENDIAN, ComSignalInitValue=32766, ComSignalType=UINT8, ComTransferProperty=PENDING, ComSystemTemplateSystemSignalRef=BMC_Max_Ladeleistung_02
        BMC_Max_Ladestrom_02_XIX_BMC_HV_09_XIX_HCP5_CANFD01_e47fe8b0_Tx: ComBitPosition=56, ComBitSize=14, ComSignalDataInvalidValue=16383, ComSignalEndianness=LITTLE_ENDIAN, ComSignalInitValue=16382, ComSignalType=UINT8, ComTransferProperty=PENDING, ComSystemTemplateSystemSignalRef=BMC_Max_Ladestrom_02
        BMC_Max_Spannung_XIX_BMC_HV_06_XIX_HCP5_CANFD01_ed13d04e_Tx: ComBitPosition=12, ComBitSize=10, ComSignalDataInvalidValue=1023, ComSignalEndianness=LITTLE_ENDIAN, ComSignalInitValue=1022, ComSignalType=UINT8, ComTransferProperty=TRIGGERED_ON_CHANGE_WITHOUT_REPETITION, ComSystemTemplateSystemSignalRef=BMC_Max_Spannung
        BMC_Min_Spannung_XIX_BMC_HV_06_XIX_HCP5_CANFD01_a39bb5e4_Tx: ComBitPosition=22, ComBitSize=10, ComSignalDataInvalidValue=1023, ComSignalEndianness=LITTLE_ENDIAN, ComSignalInitValue=1022, ComSignalType=UINT8, ComTransferProperty=TRIGGERED_ON_CHANGE_WITHOUT_REPETITION, ComSystemTemplateSystemSignalRef=BMC_Min_Spannung
        BMC_NutzbareKapazitaet_XIX_BMC_HV_03_XIX_HCP5_CANFD01_b7a047cf_Tx: ComBitPosition=56, ComBitSize=12, ComSignalDataInvalidValue=4095, ComSignalEndianness=LITTLE_ENDIAN, ComSignalInitValue=4094, ComSignalType=UINT8, ComTransferProperty=PENDING, ComSystemTemplateSystemSignalRef=BMC_NutzbareKapazitaet
        BMC_PCM_VTD_Freeze_Req_XIX_BMC_HV_14_XIX_HCP5_CANFD01_f4d42d86_Tx: ComBitPosition=70, ComBitSize=2, ComSignalDataInvalidValue=3, ComSignalEndianness=LITTLE_ENDIAN, ComSignalInitValue=2, ComSignalType=UINT8, ComTransferProperty=PENDING, ComSystemTemplateSystemSignalRef=BMC_PCM_VTD_Freeze_Req
        BMC_PCM_VTD_LifeTimeReset_Req_XIX_BMC_HV_14_XIX_HCP5_CANFD01_85186af1_Tx: ComBitPosition=72, ComBitSize=2, ComSignalDataInvalidValue=3, ComSignalEndianness=LITTLE_ENDIAN, ComSignalInitValue=2, ComSignalType=UINT8, ComTransferProperty=PENDING, ComSystemTemplateSystemSignalRef=BMC_PCM_VTD_LifeTimeReset_Req
        BMC_PCM_VTD_LifeTimeReset_Resp_XIX_BMC_HV_14_XIX_HCP5_CANFD01_fcdaf120_Tx: ComBitPosition=74, ComBitSize=2, ComSignalDataInvalidValue=3, ComSignalEndianness=LITTLE_ENDIAN, ComSignalInitValue=2, ComSignalType=UINT8, ComTransferProperty=PENDING, ComSystemTemplateSystemSignalRef=BMC_PCM_VTD_LifeTimeReset_Resp
        BMC_PCM_VTD_RecentReset_Req_XIX_BMC_HV_14_XIX_HCP5_CANFD01_827fd905_Tx: ComBitPosition=76, ComBitSize=2, ComSignalDataInvalidValue=3, ComSignalEndianness=LITTLE_ENDIAN, ComSignalInitValue=2, ComSignalType=UINT8, ComTransferProperty=PENDING, ComSystemTemplateSystemSignalRef=BMC_PCM_VTD_RecentReset_Req
        BMC_Pack_SN_01_XIX_BMC_HV_08_XIX_HCP5_CANFD01_d934ed9b_Tx: ComBitPosition=64, ComBitSize=8, ComSignalEndianness=LITTLE_ENDIAN, ComSignalInitValue=255, ComSignalType=UINT8, ComTransferProperty=PENDING, ComSystemTemplateSystemSignalRef=BMC_Pack_SN_01
        BMC_Pack_SN_02_XIX_BMC_HV_08_XIX_HCP5_CANFD01_102be524_Tx: ComBitPosition=72, ComBitSize=8, ComSignalEndianness=LITTLE_ENDIAN, ComSignalInitValue=255, ComSignalType=UINT8, ComTransferProperty=PENDING, ComSystemTemplateSystemSignalRef=BMC_Pack_SN_02
        BMC_Pack_SN_03_XIX_BMC_HV_08_XIX_HCP5_CANFD01_e1f1e08e_Tx: ComBitPosition=80, ComBitSize=8, ComSignalEndianness=LITTLE_ENDIAN, ComSignalInitValue=255, ComSignalType=UINT8, ComTransferProperty=PENDING, ComSystemTemplateSystemSignalRef=BMC_Pack_SN_03
        BMC_Pack_SN_04_XIX_BMC_HV_08_XIX_HCP5_CANFD01_5964f21b_Tx: ComBitPosition=88, ComBitSize=8, ComSignalEndianness=LITTLE_ENDIAN, ComSignalInitValue=255, ComSignalType=UINT8, ComTransferProperty=PENDING, ComSystemTemplateSystemSignalRef=BMC_Pack_SN_04
        BMC_Pack_SN_05_XIX_BMC_HV_08_XIX_HCP5_CANFD01_a8bef7b1_Tx: ComBitPosition=96, ComBitSize=8, ComSignalEndianness=LITTLE_ENDIAN, ComSignalInitValue=255, ComSignalType=UINT8, ComTransferProperty=PENDING, ComSystemTemplateSystemSignalRef=BMC_Pack_SN_05
        BMC_Pack_SN_06_XIX_BMC_HV_08_XIX_HCP5_CANFD01_61a1ff0e_Tx: ComBitPosition=104, ComBitSize=8, ComSignalEndianness=LITTLE_ENDIAN, ComSignalInitValue=255, ComSignalType=UINT8, ComTransferProperty=PENDING, ComSystemTemplateSystemSignalRef=BMC_Pack_SN_06
        BMC_Pack_SN_07_XIX_BMC_HV_08_XIX_HCP5_CANFD01_907bfaa4_Tx: ComBitPosition=112, ComBitSize=8, ComSignalEndianness=LITTLE_ENDIAN, ComSignalInitValue=255, ComSignalType=UINT8, ComTransferProperty=PENDING, ComSystemTemplateSystemSignalRef=BMC_Pack_SN_07
        BMC_Pack_SN_08_XIX_BMC_HV_08_XIX_HCP5_CANFD01_cbfadc65_Tx: ComBitPosition=120, ComBitSize=8, ComSignalEndianness=LITTLE_ENDIAN, ComSignalInitValue=255, ComSignalType=UINT8, ComTransferProperty=PENDING, ComSystemTemplateSystemSignalRef=BMC_Pack_SN_08
        BMC_Pack_SN_09_XIX_BMC_HV_08_XIX_HCP5_CANFD01_3a20d9cf_Tx: ComBitPosition=128, ComBitSize=8, ComSignalEndianness=LITTLE_ENDIAN, ComSignalInitValue=255, ComSignalType=UINT8, ComTransferProperty=PENDING, ComSystemTemplateSystemSignalRef=BMC_Pack_SN_09
        BMC_Pack_SN_10_XIX_BMC_HV_08_XIX_HCP5_CANFD01_1e1c78c2_Tx: ComBitPosition=136, ComBitSize=8, ComSignalEndianness=LITTLE_ENDIAN, ComSignalInitValue=255, ComSignalType=UINT8, ComTransferProperty=PENDING, ComSystemTemplateSystemSignalRef=BMC_Pack_SN_10
        BMC_Pack_SN_11_XIX_BMC_HV_08_XIX_HCP5_CANFD01_efc67d68_Tx: ComBitPosition=144, ComBitSize=8, ComSignalEndianness=LITTLE_ENDIAN, ComSignalInitValue=255, ComSignalType=UINT8, ComTransferProperty=PENDING, ComSystemTemplateSystemSignalRef=BMC_Pack_SN_11
        BMC_Pack_SN_12_XIX_BMC_HV_08_XIX_HCP5_CANFD01_26d975d7_Tx: ComBitPosition=152, ComBitSize=8, ComSignalEndianness=LITTLE_ENDIAN, ComSignalInitValue=255, ComSignalType=UINT8, ComTransferProperty=PENDING, ComSystemTemplateSystemSignalRef=BMC_Pack_SN_12
        BMC_Pack_SN_13_XIX_BMC_HV_08_XIX_HCP5_CANFD01_d703707d_Tx: ComBitPosition=160, ComBitSize=8, ComSignalEndianness=LITTLE_ENDIAN, ComSignalInitValue=255, ComSignalType=UINT8, ComTransferProperty=PENDING, ComSystemTemplateSystemSignalRef=BMC_Pack_SN_13
        BMC_Pack_SN_14_XIX_BMC_HV_08_XIX_HCP5_CANFD01_6f9662e8_Tx: ComBitPosition=168, ComBitSize=8, ComSignalEndianness=LITTLE_ENDIAN, ComSignalInitValue=255, ComSignalType=UINT8, ComTransferProperty=PENDING, ComSystemTemplateSystemSignalRef=BMC_Pack_SN_14
        BMC_Pack_SN_15_XIX_BMC_HV_08_XIX_HCP5_CANFD01_9e4c6742_Tx: ComBitPosition=176, ComBitSize=8, ComSignalEndianness=LITTLE_ENDIAN, ComSignalInitValue=255, ComSignalType=UINT8, ComTransferProperty=PENDING, ComSystemTemplateSystemSignalRef=BMC_Pack_SN_15
        BMC_Pack_SN_16_XIX_BMC_HV_08_XIX_HCP5_CANFD01_57536ffd_Tx: ComBitPosition=184, ComBitSize=8, ComSignalEndianness=LITTLE_ENDIAN, ComSignalInitValue=255, ComSignalType=UINT8, ComTransferProperty=PENDING, ComSystemTemplateSystemSignalRef=BMC_Pack_SN_16
        BMC_Pack_SN_17_XIX_BMC_HV_08_XIX_HCP5_CANFD01_a6896a57_Tx: ComBitPosition=192, ComBitSize=8, ComSignalEndianness=LITTLE_ENDIAN, ComSignalInitValue=255, ComSignalType=UINT8, ComTransferProperty=PENDING, ComSystemTemplateSystemSignalRef=BMC_Pack_SN_17
        BMC_Pack_SN_18_XIX_BMC_HV_08_XIX_HCP5_CANFD01_fd084c96_Tx: ComBitPosition=200, ComBitSize=8, ComSignalEndianness=LITTLE_ENDIAN, ComSignalInitValue=255, ComSignalType=UINT8, ComTransferProperty=PENDING, ComSystemTemplateSystemSignalRef=BMC_Pack_SN_18
        BMC_Pack_SN_19_XIX_BMC_HV_08_XIX_HCP5_CANFD01_0cd2493c_Tx: ComBitPosition=208, ComBitSize=8, ComSignalEndianness=LITTLE_ENDIAN, ComSignalInitValue=255, ComSignalType=UINT8, ComTransferProperty=PENDING, ComSystemTemplateSystemSignalRef=BMC_Pack_SN_19
        BMC_Pack_SN_20_XIX_BMC_HV_08_XIX_HCP5_CANFD01_450bc9d7_Tx: ComBitPosition=216, ComBitSize=8, ComSignalEndianness=LITTLE_ENDIAN, ComSignalInitValue=255, ComSignalType=UINT8, ComTransferProperty=PENDING, ComSystemTemplateSystemSignalRef=BMC_Pack_SN_20
        BMC_Pack_SN_21_XIX_BMC_HV_08_XIX_HCP5_CANFD01_b4d1cc7d_Tx: ComBitPosition=224, ComBitSize=8, ComSignalEndianness=LITTLE_ENDIAN, ComSignalInitValue=255, ComSignalType=UINT8, ComTransferProperty=PENDING, ComSystemTemplateSystemSignalRef=BMC_Pack_SN_21
        BMC_Pack_SN_22_XIX_BMC_HV_08_XIX_HCP5_CANFD01_7dcec4c2_Tx: ComBitPosition=232, ComBitSize=8, ComSignalEndianness=LITTLE_ENDIAN, ComSignalInitValue=255, ComSignalType=UINT8, ComTransferProperty=PENDING, ComSystemTemplateSystemSignalRef=BMC_Pack_SN_22
        BMC_Pack_SN_23_XIX_BMC_HV_08_XIX_HCP5_CANFD01_8c14c168_Tx: ComBitPosition=240, ComBitSize=8, ComSignalEndianness=LITTLE_ENDIAN, ComSignalInitValue=255, ComSignalType=UINT8, ComTransferProperty=PENDING, ComSystemTemplateSystemSignalRef=BMC_Pack_SN_23
        BMC_Pack_SN_24_XIX_BMC_HV_08_XIX_HCP5_CANFD01_3481d3fd_Tx: ComBitPosition=248, ComBitSize=8, ComSignalEndianness=LITTLE_ENDIAN, ComSignalInitValue=255, ComSignalType=UINT8, ComTransferProperty=PENDING, ComSystemTemplateSystemSignalRef=BMC_Pack_SN_24
        BMC_Pack_SN_25_XIX_BMC_HV_08_XIX_HCP5_CANFD01_c55bd657_Tx: ComBitPosition=256, ComBitSize=8, ComSignalEndianness=LITTLE_ENDIAN, ComSignalInitValue=255, ComSignalType=UINT8, ComTransferProperty=PENDING, ComSystemTemplateSystemSignalRef=BMC_Pack_SN_25
        BMC_Pack_SN_26_XIX_BMC_HV_08_XIX_HCP5_CANFD01_0c44dee8_Tx: ComBitPosition=264, ComBitSize=8, ComSignalEndianness=LITTLE_ENDIAN, ComSignalInitValue=255, ComSignalType=UINT8, ComTransferProperty=PENDING, ComSystemTemplateSystemSignalRef=BMC_Pack_SN_26
        BMC_Range_Indikator_XIX_BMC_HV_14_XIX_HCP5_CANFD01_21f53466_Tx: ComBitPosition=23, ComBitSize=11, ComSignalDataInvalidValue=2047, ComSignalEndianness=LITTLE_ENDIAN, ComSignalInitValue=2046, ComSignalType=UINT8, ComTransferProperty=PENDING, ComSystemTemplateSystemSignalRef=BMC_Range_Indikator
        BMC_Rekuperation_Ueberlauf_XIX_BMC_HV_05_XIX_HCP5_CANFD01_34ba06c8_Tx: ComBitPosition=14, ComBitSize=1, ComSignalEndianness=LITTLE_ENDIAN, ComSignalInitValue=0, ComSignalType=UINT8, ComTransferProperty=PENDING, ComSystemTemplateSystemSignalRef=BMC_Rekuperation_Ueberlauf
        BMC_Rekuperation_XIX_BMC_HV_05_XIX_HCP5_CANFD01_0550c77c_Tx: ComBitPosition=32, ComBitSize=16, ComSignalEndianness=LITTLE_ENDIAN, ComSignalInitValue=0, ComSignalType=UINT8, ComTransferProperty=PENDING, ComSystemTemplateSystemSignalRef=BMC_Rekuperation
        BMC_RtmWarnBattUnautorisiert_XIX_BMC_HV_08_XIX_HCP5_CANFD01_afa1cdce_Tx: ComBitPosition=320, ComBitSize=3, ComSignalEndianness=LITTLE_ENDIAN, ComSignalInitValue=0, ComSignalType=UINT8, ComTransferProperty=PENDING, ComSystemTemplateSystemSignalRef=BMC_RtmWarnBattUnautorisiert
        BMC_RtmWarnPackKommunikation_XIX_BMC_HV_08_XIX_HCP5_CANFD01_49192821_Tx: ComBitPosition=25, ComBitSize=3, ComSignalEndianness=LITTLE_ENDIAN, ComSignalInitValue=0, ComSignalType=UINT8, ComTransferProperty=PENDING, ComSystemTemplateSystemSignalRef=BMC_RtmWarnPackKommunikation
        BMC_RtmWarnPackUeberladen_XIX_BMC_HV_08_XIX_HCP5_CANFD01_cef699a9_Tx: ComBitPosition=28, ComBitSize=3, ComSignalEndianness=LITTLE_ENDIAN, ComSignalInitValue=0, ComSignalType=UINT8, ComTransferProperty=PENDING, ComSystemTemplateSystemSignalRef=BMC_RtmWarnPackUeberladen
        BMC_RtmWarnSocHoch_XIX_BMC_HV_08_XIX_HCP5_CANFD01_3e921985_Tx: ComBitPosition=31, ComBitSize=3, ComSignalEndianness=LITTLE_ENDIAN, ComSignalInitValue=0, ComSignalType=UINT8, ComTransferProperty=PENDING, ComSystemTemplateSystemSignalRef=BMC_RtmWarnSocHoch
        BMC_RtmWarnSocNiedrig_XIX_BMC_HV_08_XIX_HCP5_CANFD01_e8831b4c_Tx: ComBitPosition=34, ComBitSize=3, ComSignalEndianness=LITTLE_ENDIAN, ComSignalInitValue=0, ComSignalType=UINT8, ComTransferProperty=PENDING, ComSystemTemplateSystemSignalRef=BMC_RtmWarnSocNiedrig
        BMC_RtmWarnSocSprung_XIX_BMC_HV_08_XIX_HCP5_CANFD01_4f634010_Tx: ComBitPosition=37, ComBitSize=3, ComSignalEndianness=LITTLE_ENDIAN, ComSignalInitValue=0, ComSignalType=UINT8, ComTransferProperty=PENDING, ComSystemTemplateSystemSignalRef=BMC_RtmWarnSocSprung
        BMC_RtmWarnTZelleDiff_XIX_BMC_HV_08_XIX_HCP5_CANFD01_733ec90e_Tx: ComBitPosition=40, ComBitSize=3, ComSignalEndianness=LITTLE_ENDIAN, ComSignalInitValue=0, ComSignalType=UINT8, ComTransferProperty=PENDING, ComSystemTemplateSystemSignalRef=BMC_RtmWarnTZelleDiff
        BMC_RtmWarnTZelleMax_XIX_BMC_HV_08_XIX_HCP5_CANFD01_45027cb0_Tx: ComBitPosition=43, ComBitSize=3, ComSignalEndianness=LITTLE_ENDIAN, ComSignalInitValue=0, ComSignalType=UINT8, ComTransferProperty=PENDING, ComSystemTemplateSystemSignalRef=BMC_RtmWarnTZelleMax
        BMC_RtmWarnTZelleMin_XIX_BMC_HV_08_XIX_HCP5_CANFD01_7df184bf_Tx: ComBitPosition=46, ComBitSize=3, ComSignalEndianness=LITTLE_ENDIAN, ComSignalInitValue=0, ComSignalType=UINT8, ComTransferProperty=PENDING, ComSystemTemplateSystemSignalRef=BMC_RtmWarnTZelleMin
        BMC_RtmWarnUPackMax_XIX_BMC_HV_08_XIX_HCP5_CANFD01_d9381a91_Tx: ComBitPosition=49, ComBitSize=3, ComSignalEndianness=LITTLE_ENDIAN, ComSignalInitValue=0, ComSignalType=UINT8, ComTransferProperty=PENDING, ComSystemTemplateSystemSignalRef=BMC_RtmWarnUPackMax
        BMC_RtmWarnUPackMin_XIX_BMC_HV_08_XIX_HCP5_CANFD01_e1cbe29e_Tx: ComBitPosition=52, ComBitSize=3, ComSignalEndianness=LITTLE_ENDIAN, ComSignalInitValue=0, ComSignalType=UINT8, ComTransferProperty=PENDING, ComSystemTemplateSystemSignalRef=BMC_RtmWarnUPackMin
        BMC_RtmWarnUZelleMax_XIX_BMC_HV_08_XIX_HCP5_CANFD01_ea46eef7_Tx: ComBitPosition=55, ComBitSize=3, ComSignalEndianness=LITTLE_ENDIAN, ComSignalInitValue=0, ComSignalType=UINT8, ComTransferProperty=PENDING, ComSystemTemplateSystemSignalRef=BMC_RtmWarnUZelleMax
        BMC_RtmWarnUZelleMin_XIX_BMC_HV_08_XIX_HCP5_CANFD01_d2b516f8_Tx: ComBitPosition=58, ComBitSize=3, ComSignalEndianness=LITTLE_ENDIAN, ComSignalInitValue=0, ComSignalType=UINT8, ComTransferProperty=PENDING, ComSystemTemplateSystemSignalRef=BMC_RtmWarnUZelleMin
        BMC_RtmWarnUeberstrom_XIX_BMC_HV_08_XIX_HCP5_CANFD01_e0808499_Tx: ComBitPosition=22, ComBitSize=3, ComSignalEndianness=LITTLE_ENDIAN, ComSignalInitValue=0, ComSignalType=UINT8, ComTransferProperty=PENDING, ComSystemTemplateSystemSignalRef=BMC_RtmWarnUeberstrom
        BMC_RtmWarnZelleZustand_XIX_BMC_HV_08_XIX_HCP5_CANFD01_688df887_Tx: ComBitPosition=61, ComBitSize=3, ComSignalEndianness=LITTLE_ENDIAN, ComSignalInitValue=0, ComSignalType=UINT8, ComTransferProperty=PENDING, ComSystemTemplateSystemSignalRef=BMC_RtmWarnZelleZustand
        BMC_RuecklaufTemperatur_XIX_BMC_HV_03_XIX_HCP5_CANFD01_73222ba7_Tx: ComBitPosition=26, ComBitSize=10, ComSignalDataInvalidValue=1023, ComSignalEndianness=LITTLE_ENDIAN, ComSignalInitValue=1022, ComSignalType=UINT8, ComTransferProperty=PENDING, ComSystemTemplateSystemSignalRef=BMC_RuecklaufTemperatur
        BMC_Temperatur_XIX_BMC_HV_03_XIX_HCP5_CANFD01_eb74ed8d_Tx: ComBitPosition=36, ComBitSize=10, ComSignalDataInvalidValue=1023, ComSignalEndianness=LITTLE_ENDIAN, ComSignalInitValue=1022, ComSignalType=UINT8, ComTransferProperty=PENDING, ComSystemTemplateSystemSignalRef=BMC_Temperatur
        BMC_Temperatur_hoechste_XIX_BMC_HV_07_XIX_HCP5_CANFD01_70360ca3_Tx: ComBitPosition=12, ComBitSize=10, ComSignalDataInvalidValue=1023, ComSignalEndianness=LITTLE_ENDIAN, ComSignalInitValue=1022, ComSignalType=UINT8, ComTransferProperty=PENDING, ComSystemTemplateSystemSignalRef=BMC_Temperatur_hoechste
        BMC_Temperatur_niedrigste_XIX_BMC_HV_07_XIX_HCP5_CANFD01_2e3528f4_Tx: ComBitPosition=22, ComBitSize=10, ComSignalDataInvalidValue=1023, ComSignalEndianness=LITTLE_ENDIAN, ComSignalInitValue=1022, ComSignalType=UINT8, ComTransferProperty=PENDING, ComSystemTemplateSystemSignalRef=BMC_Temperatur_niedrigste
        BMC_ThermAuslastung_XIX_BMC_HV_03_XIX_HCP5_CANFD01_5abb920e_Tx: ComBitPosition=105, ComBitSize=7, ComSignalDataInvalidValue=127, ComSignalEndianness=LITTLE_ENDIAN, ComSignalInitValue=126, ComSignalType=UINT8, ComTransferProperty=PENDING, ComSystemTemplateSystemSignalRef=BMC_ThermAuslastung
        BMC_ThermSpreizung_XIX_BMC_HV_03_XIX_HCP5_CANFD01_fd3f685b_Tx: ComBitPosition=12, ComBitSize=4, ComSignalDataInvalidValue=15, ComSignalEndianness=LITTLE_ENDIAN, ComSignalInitValue=14, ComSignalType=UINT8, ComTransferProperty=PENDING, ComSystemTemplateSystemSignalRef=BMC_ThermSpreizung
        BMC_UBE_Indik_last_update_km_XIX_BMC_HV_14_XIX_HCP5_CANFD01_c953ffca_Tx: ComBitPosition=34, ComBitSize=20, ComSignalDataInvalidValue=1048575, ComSignalEndianness=LITTLE_ENDIAN, ComSignalInitValue=1048574, ComSignalType=UINT8, ComTransferProperty=PENDING, ComSystemTemplateSystemSignalRef=BMC_UBE_Indik_last_update_km
        BMC_UBE_Indikator_XIX_BMC_HV_14_XIX_HCP5_CANFD01_be7dd75f_Tx: ComBitPosition=12, ComBitSize=11, ComSignalDataInvalidValue=2047, ComSignalEndianness=LITTLE_ENDIAN, ComSignalInitValue=2046, ComSignalType=UINT8, ComTransferProperty=PENDING, ComSystemTemplateSystemSignalRef=BMC_UBE_Indikator
        BMC_Verbrauch_Ueberlauf_XIX_BMC_HV_05_XIX_HCP5_CANFD01_3d34bbf6_Tx: ComBitPosition=12, ComBitSize=1, ComSignalEndianness=LITTLE_ENDIAN, ComSignalInitValue=0, ComSignalType=UINT8, ComTransferProperty=PENDING, ComSystemTemplateSystemSignalRef=BMC_Verbrauch_Ueberlauf
        BMC_Verbrauch_XIX_BMC_HV_05_XIX_HCP5_CANFD01_8e72d45b_Tx: ComBitPosition=16, ComBitSize=16, ComSignalEndianness=LITTLE_ENDIAN, ComSignalInitValue=0, ComSignalType=UINT8, ComTransferProperty=PENDING, ComSystemTemplateSystemSignalRef=BMC_Verbrauch
        BMC_VerlustEnergie_XIX_BMC_HV_03_XIX_HCP5_CANFD01_c05628a7_Tx: ComBitPosition=92, ComBitSize=13, ComSignalDataInvalidValue=8191, ComSignalEndianness=LITTLE_ENDIAN, ComSignalInitValue=8190, ComSignalType=UINT8, ComTransferProperty=PENDING, ComSystemTemplateSystemSignalRef=BMC_VerlustEnergie
        BMC_VorlaufTemperatur_XIX_BMC_HV_03_XIX_HCP5_CANFD01_b115c7c1_Tx: ComBitPosition=16, ComBitSize=10, ComSignalDataInvalidValue=1023, ComSignalEndianness=LITTLE_ENDIAN, ComSignalInitValue=1022, ComSignalType=UINT8, ComTransferProperty=PENDING, ComSystemTemplateSystemSignalRef=BMC_VorlaufTemperatur
        CHA_ReqPrgBms_XIX_Charisma_20_XIX_HCP5_CANFD01_9364cd45_Rx: ComBitPosition=12, ComBitSize=4, ComSignalEndianness=LITTLE_ENDIAN, ComSignalInitValue=0, ComSignalType=UINT8, ComTimeout=5, ComSystemTemplateSystemSignalRef=CHA_ReqPrgBms
        ComSignalPnc_EIRA_CAN_Rx: ComSignalLength=7, ComSignalType=UINT8_N
        DCDC_NV_CALID_Index_01_XIX_DCDC_NV_CALID_XIX_HCP5_CANFD01_8f57e482_Rx: ComBitPosition=0, ComBitSize=8, ComSignalEndianness=LITTLE_ENDIAN, ComSignalInitValue=63, ComSignalType=UINT8, ComTimeout=5, ComSystemTemplateSystemSignalRef=DCDC_NV_CALID_Index_01
        DCDC_NV_CALID_Index_02_XIX_DCDC_NV_CALID_XIX_HCP5_CANFD01_ebb79f7c_Rx: ComBitPosition=8, ComBitSize=8, ComSignalEndianness=LITTLE_ENDIAN, ComSignalInitValue=63, ComSignalType=UINT8, ComTimeout=5, ComSystemTemplateSystemSignalRef=DCDC_NV_CALID_Index_02
        DCDC_NV_CALID_Index_03_XIX_DCDC_NV_CALID_XIX_HCP5_CANFD01_7ec74be9_Rx: ComBitPosition=16, ComBitSize=8, ComSignalEndianness=LITTLE_ENDIAN, ComSignalInitValue=63, ComSignalType=UINT8, ComTimeout=5, ComSystemTemplateSystemSignalRef=DCDC_NV_CALID_Index_03
        DCDC_NV_CALID_Index_04_XIX_DCDC_NV_CALID_XIX_HCP5_CANFD01_22776880_Rx: ComBitPosition=24, ComBitSize=8, ComSignalEndianness=LITTLE_ENDIAN, ComSignalInitValue=63, ComSignalType=UINT8, ComTimeout=5, ComSystemTemplateSystemSignalRef=DCDC_NV_CALID_Index_04
        DCDC_NV_CALID_Index_05_XIX_DCDC_NV_CALID_XIX_HCP5_CANFD01_b707bc15_Rx: ComBitPosition=32, ComBitSize=8, ComSignalEndianness=LITTLE_ENDIAN, ComSignalInitValue=63, ComSignalType=UINT8, ComTimeout=5, ComSystemTemplateSystemSignalRef=DCDC_NV_CALID_Index_05
        DCDC_NV_CALID_Index_06_XIX_DCDC_NV_CALID_XIX_HCP5_CANFD01_d3e7c7eb_Rx: ComBitPosition=40, ComBitSize=8, ComSignalEndianness=LITTLE_ENDIAN, ComSignalInitValue=63, ComSignalType=UINT8, ComTimeout=5, ComSystemTemplateSystemSignalRef=DCDC_NV_CALID_Index_06
        DCDC_NV_CALID_Index_07_XIX_DCDC_NV_CALID_XIX_HCP5_CANFD01_4697137e_Rx: ComBitPosition=48, ComBitSize=8, ComSignalEndianness=LITTLE_ENDIAN, ComSignalInitValue=63, ComSignalType=UINT8, ComTimeout=5, ComSystemTemplateSystemSignalRef=DCDC_NV_CALID_Index_07
        DCDC_NV_CALID_Index_08_XIX_DCDC_NV_CALID_XIX_HCP5_CANFD01_6a878139_Rx: ComBitPosition=56, ComBitSize=8, ComSignalEndianness=LITTLE_ENDIAN, ComSignalInitValue=63, ComSignalType=UINT8, ComTimeout=5, ComSystemTemplateSystemSignalRef=DCDC_NV_CALID_Index_08
        DCDC_NV_CALID_Index_09_XIX_DCDC_NV_CALID_XIX_HCP5_CANFD01_fff755ac_Rx: ComBitPosition=64, ComBitSize=8, ComSignalEndianness=LITTLE_ENDIAN, ComSignalInitValue=63, ComSignalType=UINT8, ComTimeout=5, ComSystemTemplateSystemSignalRef=DCDC_NV_CALID_Index_09
        DCDC_NV_CALID_Index_10_XIX_DCDC_NV_CALID_XIX_HCP5_CANFD01_9ad72708_Rx: ComBitPosition=72, ComBitSize=8, ComSignalEndianness=LITTLE_ENDIAN, ComSignalInitValue=63, ComSignalType=UINT8, ComTimeout=5, ComSystemTemplateSystemSignalRef=DCDC_NV_CALID_Index_10
        DCDC_NV_CALID_Index_11_XIX_DCDC_NV_CALID_XIX_HCP5_CANFD01_0fa7f39d_Rx: ComBitPosition=80, ComBitSize=8, ComSignalEndianness=LITTLE_ENDIAN, ComSignalInitValue=63, ComSignalType=UINT8, ComTimeout=5, ComSystemTemplateSystemSignalRef=DCDC_NV_CALID_Index_11
        DCDC_NV_CALID_Index_12_XIX_DCDC_NV_CALID_XIX_HCP5_CANFD01_6b478863_Rx: ComBitPosition=88, ComBitSize=8, ComSignalEndianness=LITTLE_ENDIAN, ComSignalInitValue=63, ComSignalType=UINT8, ComTimeout=5, ComSystemTemplateSystemSignalRef=DCDC_NV_CALID_Index_12
        DCDC_NV_CALID_Index_13_XIX_DCDC_NV_CALID_XIX_HCP5_CANFD01_fe375cf6_Rx: ComBitPosition=96, ComBitSize=8, ComSignalEndianness=LITTLE_ENDIAN, ComSignalInitValue=63, ComSignalType=UINT8, ComTimeout=5, ComSystemTemplateSystemSignalRef=DCDC_NV_CALID_Index_13
        DCDC_NV_CALID_Index_14_XIX_DCDC_NV_CALID_XIX_HCP5_CANFD01_a2877f9f_Rx: ComBitPosition=104, ComBitSize=8, ComSignalEndianness=LITTLE_ENDIAN, ComSignalInitValue=63, ComSignalType=UINT8, ComTimeout=5, ComSystemTemplateSystemSignalRef=DCDC_NV_CALID_Index_14
        DCDC_NV_CALID_Index_15_XIX_DCDC_NV_CALID_XIX_HCP5_CANFD01_37f7ab0a_Rx: ComBitPosition=112, ComBitSize=8, ComSignalEndianness=LITTLE_ENDIAN, ComSignalInitValue=63, ComSignalType=UINT8, ComTimeout=5, ComSystemTemplateSystemSignalRef=DCDC_NV_CALID_Index_15
        DCDC_NV_CALID_Index_16_XIX_DCDC_NV_CALID_XIX_HCP5_CANFD01_5317d0f4_Rx: ComBitPosition=120, ComBitSize=8, ComSignalEndianness=LITTLE_ENDIAN, ComSignalInitValue=63, ComSignalType=UINT8, ComTimeout=5, ComSystemTemplateSystemSignalRef=DCDC_NV_CALID_Index_16
        DCDC_NV_CVN_Byte_1_XIX_DCDC_NV_CVN_XIX_HCP5_CANFD01_f6f9fc9d_Rx: ComBitPosition=1, ComBitSize=8, ComSignalEndianness=LITTLE_ENDIAN, ComSignalInitValue=0, ComSignalType=UINT8, ComTimeout=5, ComSystemTemplateSystemSignalRef=DCDC_NV_CVN_Byte_1
        DCDC_NV_CVN_Byte_2_XIX_DCDC_NV_CVN_XIX_HCP5_CANFD01_9b7f0fc7_Rx: ComBitPosition=9, ComBitSize=8, ComSignalEndianness=LITTLE_ENDIAN, ComSignalInitValue=0, ComSignalType=UINT8, ComTimeout=5, ComSystemTemplateSystemSignalRef=DCDC_NV_CVN_Byte_2
        DCDC_NV_CVN_Byte_3_XIX_DCDC_NV_CVN_XIX_HCP5_CANFD01_bffd5ef1_Rx: ComBitPosition=17, ComBitSize=8, ComSignalEndianness=LITTLE_ENDIAN, ComSignalInitValue=0, ComSignalType=UINT8, ComTimeout=5, ComSystemTemplateSystemSignalRef=DCDC_NV_CVN_Byte_3
        DCDC_NV_CVN_Byte_4_XIX_DCDC_NV_CVN_XIX_HCP5_CANFD01_4072e973_Rx: ComBitPosition=25, ComBitSize=8, ComSignalEndianness=LITTLE_ENDIAN, ComSignalInitValue=0, ComSignalType=UINT8, ComTimeout=5, ComSystemTemplateSystemSignalRef=DCDC_NV_CVN_Byte_4
        DCDC_NV_CVN_VLD_XIX_DCDC_NV_CVN_XIX_HCP5_CANFD01_0c97b82e_Rx: ComBitPosition=0, ComBitSize=1, ComSignalEndianness=LITTLE_ENDIAN, ComSignalInitValue=0, ComSignalType=UINT8, ComTimeout=5, ComSystemTemplateSystemSignalRef=DCDC_NV_CVN_VLD
        DCDC_NV_Komponentenfehler_01_XIX_DCDC_NV_Komponentenfehler_01_XIX_HCP5_CANFD01_d45848d1_Rx: ComBitPosition=0, ComBitSize=2, ComSignalEndianness=LITTLE_ENDIAN, ComSignalInitValue=0, ComSignalType=UINT8, ComTimeout=5, ComSystemTemplateSystemSignalRef=DCDC_NV_Komponentenfehler_01
        DCDC_NV_Komponentenfehler_02_XIX_DCDC_NV_Komponentenfehler_01_XIX_HCP5_CANFD01_516a5a25_Rx: ComBitPosition=2, ComBitSize=2, ComSignalEndianness=LITTLE_ENDIAN, ComSignalInitValue=0, ComSignalType=UINT8, ComTimeout=5, ComSystemTemplateSystemSignalRef=DCDC_NV_Komponentenfehler_02
        DCDC_NV_Komponentenfehler_03_XIX_DCDC_NV_Komponentenfehler_01_XIX_HCP5_CANFD01_9b54a9b6_Rx: ComBitPosition=4, ComBitSize=2, ComSignalEndianness=LITTLE_ENDIAN, ComSignalInitValue=0, ComSignalType=UINT8, ComTimeout=5, ComSystemTemplateSystemSignalRef=DCDC_NV_Komponentenfehler_03
        DCDC_NV_Komponentenfehler_04_XIX_DCDC_NV_Komponentenfehler_01_XIX_HCP5_CANFD01_807f798c_Rx: ComBitPosition=6, ComBitSize=2, ComSignalEndianness=LITTLE_ENDIAN, ComSignalInitValue=0, ComSignalType=UINT8, ComTimeout=5, ComSystemTemplateSystemSignalRef=DCDC_NV_Komponentenfehler_04
        DCDC_NV_Komponentenfehler_05_XIX_DCDC_NV_Komponentenfehler_01_XIX_HCP5_CANFD01_4a418a1f_Rx: ComBitPosition=8, ComBitSize=2, ComSignalEndianness=LITTLE_ENDIAN, ComSignalInitValue=0, ComSignalType=UINT8, ComTimeout=5, ComSystemTemplateSystemSignalRef=DCDC_NV_Komponentenfehler_05
        DCDC_NV_Komponentenfehler_06_XIX_DCDC_NV_Komponentenfehler_01_XIX_HCP5_CANFD01_cf7398eb_Rx: ComBitPosition=10, ComBitSize=2, ComSignalEndianness=LITTLE_ENDIAN, ComSignalInitValue=0, ComSignalType=UINT8, ComTimeout=5, ComSystemTemplateSystemSignalRef=DCDC_NV_Komponentenfehler_06
        DCDC_NV_Komponentenfehler_07_XIX_DCDC_NV_Komponentenfehler_01_XIX_HCP5_CANFD01_054d6b78_Rx: ComBitPosition=12, ComBitSize=2, ComSignalEndianness=LITTLE_ENDIAN, ComSignalInitValue=0, ComSignalType=UINT8, ComTimeout=5, ComSystemTemplateSystemSignalRef=DCDC_NV_Komponentenfehler_07
        DCDC_NV_Komponentenfehler_08_XIX_DCDC_NV_Komponentenfehler_01_XIX_HCP5_CANFD01_f924389f_Rx: ComBitPosition=14, ComBitSize=2, ComSignalEndianness=LITTLE_ENDIAN, ComSignalInitValue=0, ComSignalType=UINT8, ComTimeout=5, ComSystemTemplateSystemSignalRef=DCDC_NV_Komponentenfehler_08
        DCDC_NV_Komponentenfehler_09_XIX_DCDC_NV_Komponentenfehler_01_XIX_HCP5_CANFD01_331acb0c_Rx: ComBitPosition=16, ComBitSize=2, ComSignalEndianness=LITTLE_ENDIAN, ComSignalInitValue=0, ComSignalType=UINT8, ComTimeout=5, ComSystemTemplateSystemSignalRef=DCDC_NV_Komponentenfehler_09
        DCDC_NV_Komponentenfehler_10_XIX_DCDC_NV_Komponentenfehler_01_XIX_HCP5_CANFD01_77aa474f_Rx: ComBitPosition=18, ComBitSize=2, ComSignalEndianness=LITTLE_ENDIAN, ComSignalInitValue=0, ComSignalType=UINT8, ComTimeout=5, ComSystemTemplateSystemSignalRef=DCDC_NV_Komponentenfehler_10
        DCDC_NV_Komponentenfehler_11_XIX_DCDC_NV_Komponentenfehler_01_XIX_HCP5_CANFD01_bd94b4dc_Rx: ComBitPosition=20, ComBitSize=2, ComSignalEndianness=LITTLE_ENDIAN, ComSignalInitValue=0, ComSignalType=UINT8, ComTimeout=5, ComSystemTemplateSystemSignalRef=DCDC_NV_Komponentenfehler_11
        DCDC_NV_Komponentenfehler_12_XIX_DCDC_NV_Komponentenfehler_01_XIX_HCP5_CANFD01_38a6a628_Rx: ComBitPosition=22, ComBitSize=2, ComSignalEndianness=LITTLE_ENDIAN, ComSignalInitValue=0, ComSignalType=UINT8, ComTimeout=5, ComSystemTemplateSystemSignalRef=DCDC_NV_Komponentenfehler_12
        DCDC_NV_Komponentenfehler_13_XIX_DCDC_NV_Komponentenfehler_01_XIX_HCP5_CANFD01_f29855bb_Rx: ComBitPosition=24, ComBitSize=2, ComSignalEndianness=LITTLE_ENDIAN, ComSignalInitValue=0, ComSignalType=UINT8, ComTimeout=5, ComSystemTemplateSystemSignalRef=DCDC_NV_Komponentenfehler_13
        DCDC_NV_Komponentenfehler_14_XIX_DCDC_NV_Komponentenfehler_01_XIX_HCP5_CANFD01_e9b38581_Rx: ComBitPosition=26, ComBitSize=2, ComSignalEndianness=LITTLE_ENDIAN, ComSignalInitValue=0, ComSignalType=UINT8, ComTimeout=5, ComSystemTemplateSystemSignalRef=DCDC_NV_Komponentenfehler_14
        DCDC_NV_Komponentenfehler_15_XIX_DCDC_NV_Komponentenfehler_01_XIX_HCP5_CANFD01_238d7612_Rx: ComBitPosition=28, ComBitSize=2, ComSignalEndianness=LITTLE_ENDIAN, ComSignalInitValue=0, ComSignalType=UINT8, ComTimeout=5, ComSystemTemplateSystemSignalRef=DCDC_NV_Komponentenfehler_15
        DCDC_NV_Komponentenfehler_16_XIX_DCDC_NV_Komponentenfehler_01_XIX_HCP5_CANFD01_a6bf64e6_Rx: ComBitPosition=30, ComBitSize=2, ComSignalEndianness=LITTLE_ENDIAN, ComSignalInitValue=0, ComSignalType=UINT8, ComTimeout=5, ComSystemTemplateSystemSignalRef=DCDC_NV_Komponentenfehler_16
        DCDC_NV_Komponentenfehler_17_XIX_DCDC_NV_Komponentenfehler_01_XIX_HCP5_CANFD01_6c819775_Rx: ComBitPosition=32, ComBitSize=2, ComSignalEndianness=LITTLE_ENDIAN, ComSignalInitValue=0, ComSignalType=UINT8, ComTimeout=5, ComSystemTemplateSystemSignalRef=DCDC_NV_Komponentenfehler_17
        DCDC_NV_Komponentenfehler_18_XIX_DCDC_NV_Komponentenfehler_01_XIX_HCP5_CANFD01_90e8c492_Rx: ComBitPosition=34, ComBitSize=2, ComSignalEndianness=LITTLE_ENDIAN, ComSignalInitValue=0, ComSignalType=UINT8, ComTimeout=5, ComSystemTemplateSystemSignalRef=DCDC_NV_Komponentenfehler_18
        DCDC_NV_Komponentenfehler_19_XIX_DCDC_NV_Komponentenfehler_01_XIX_HCP5_CANFD01_5ad63701_Rx: ComBitPosition=36, ComBitSize=2, ComSignalEndianness=LITTLE_ENDIAN, ComSignalInitValue=0, ComSignalType=UINT8, ComTimeout=5, ComSystemTemplateSystemSignalRef=DCDC_NV_Komponentenfehler_19
        DCDC_NV_Komponentenfehler_20_XIX_DCDC_NV_Komponentenfehler_01_XIX_HCP5_CANFD01_cdff4358_Rx: ComBitPosition=38, ComBitSize=2, ComSignalEndianness=LITTLE_ENDIAN, ComSignalInitValue=0, ComSignalType=UINT8, ComTimeout=5, ComSystemTemplateSystemSignalRef=DCDC_NV_Komponentenfehler_20
        DCDC_NV_Komponentenfehler_21_XIX_DCDC_NV_Komponentenfehler_01_XIX_HCP5_CANFD01_07c1b0cb_Rx: ComBitPosition=40, ComBitSize=2, ComSignalEndianness=LITTLE_ENDIAN, ComSignalInitValue=0, ComSignalType=UINT8, ComTimeout=5, ComSystemTemplateSystemSignalRef=DCDC_NV_Komponentenfehler_21
        DCDC_NV_Komponentenfehler_22_XIX_DCDC_NV_Komponentenfehler_01_XIX_HCP5_CANFD01_82f3a23f_Rx: ComBitPosition=42, ComBitSize=2, ComSignalEndianness=LITTLE_ENDIAN, ComSignalInitValue=0, ComSignalType=UINT8, ComTimeout=5, ComSystemTemplateSystemSignalRef=DCDC_NV_Komponentenfehler_22
        DCDC_NV_Komponentenfehler_23_XIX_DCDC_NV_Komponentenfehler_01_XIX_HCP5_CANFD01_48cd51ac_Rx: ComBitPosition=44, ComBitSize=2, ComSignalEndianness=LITTLE_ENDIAN, ComSignalInitValue=0, ComSignalType=UINT8, ComTimeout=5, ComSystemTemplateSystemSignalRef=DCDC_NV_Komponentenfehler_23
        DCDC_NV_Komponentenfehler_24_XIX_DCDC_NV_Komponentenfehler_01_XIX_HCP5_CANFD01_53e68196_Rx: ComBitPosition=46, ComBitSize=2, ComSignalEndianness=LITTLE_ENDIAN, ComSignalInitValue=0, ComSignalType=UINT8, ComTimeout=5, ComSystemTemplateSystemSignalRef=DCDC_NV_Komponentenfehler_24
        DCDC_NV_Komponentenfehler_25_XIX_DCDC_NV_Komponentenfehler_01_XIX_HCP5_CANFD01_99d87205_Rx: ComBitPosition=48, ComBitSize=2, ComSignalEndianness=LITTLE_ENDIAN, ComSignalInitValue=0, ComSignalType=UINT8, ComTimeout=5, ComSystemTemplateSystemSignalRef=DCDC_NV_Komponentenfehler_25
        DCDC_NV_Komponentenfehler_26_XIX_DCDC_NV_Komponentenfehler_01_XIX_HCP5_CANFD01_1cea60f1_Rx: ComBitPosition=50, ComBitSize=2, ComSignalEndianness=LITTLE_ENDIAN, ComSignalInitValue=0, ComSignalType=UINT8, ComTimeout=5, ComSystemTemplateSystemSignalRef=DCDC_NV_Komponentenfehler_26
        DCDC_NV_Komponentenfehler_27_XIX_DCDC_NV_Komponentenfehler_01_XIX_HCP5_CANFD01_d6d49362_Rx: ComBitPosition=52, ComBitSize=2, ComSignalEndianness=LITTLE_ENDIAN, ComSignalInitValue=0, ComSignalType=UINT8, ComTimeout=5, ComSystemTemplateSystemSignalRef=DCDC_NV_Komponentenfehler_27
        DCDC_NV_Komponentenfehler_28_XIX_DCDC_NV_Komponentenfehler_01_XIX_HCP5_CANFD01_2abdc085_Rx: ComBitPosition=54, ComBitSize=2, ComSignalEndianness=LITTLE_ENDIAN, ComSignalInitValue=0, ComSignalType=UINT8, ComTimeout=5, ComSystemTemplateSystemSignalRef=DCDC_NV_Komponentenfehler_28
        DCDC_NV_Komponentenfehler_29_XIX_DCDC_NV_Komponentenfehler_01_XIX_HCP5_CANFD01_e0833316_Rx: ComBitPosition=56, ComBitSize=2, ComSignalEndianness=LITTLE_ENDIAN, ComSignalInitValue=0, ComSignalType=UINT8, ComTimeout=5, ComSystemTemplateSystemSignalRef=DCDC_NV_Komponentenfehler_29
        DCDC_NV_Komponentenfehler_30_XIX_DCDC_NV_Komponentenfehler_02_XIX_HCP5_CANFD01_4eb56237_Rx: ComBitPosition=0, ComBitSize=2, ComSignalEndianness=LITTLE_ENDIAN, ComSignalInitValue=0, ComSignalType=UINT8, ComTimeout=5, ComSystemTemplateSystemSignalRef=DCDC_NV_Komponentenfehler_30
        DCDC_NV_Komponentenfehler_31_XIX_DCDC_NV_Komponentenfehler_02_XIX_HCP5_CANFD01_848b91a4_Rx: ComBitPosition=2, ComBitSize=2, ComSignalEndianness=LITTLE_ENDIAN, ComSignalInitValue=0, ComSignalType=UINT8, ComTimeout=5, ComSystemTemplateSystemSignalRef=DCDC_NV_Komponentenfehler_31
        DCDC_NV_Komponentenfehler_32_XIX_DCDC_NV_Komponentenfehler_02_XIX_HCP5_CANFD01_01b98350_Rx: ComBitPosition=4, ComBitSize=2, ComSignalEndianness=LITTLE_ENDIAN, ComSignalInitValue=0, ComSignalType=UINT8, ComTimeout=5, ComSystemTemplateSystemSignalRef=DCDC_NV_Komponentenfehler_32
        DCDC_NV_Komponentenfehler_33_XIX_DCDC_NV_Komponentenfehler_02_XIX_HCP5_CANFD01_cb8770c3_Rx: ComBitPosition=6, ComBitSize=2, ComSignalEndianness=LITTLE_ENDIAN, ComSignalInitValue=0, ComSignalType=UINT8, ComTimeout=5, ComSystemTemplateSystemSignalRef=DCDC_NV_Komponentenfehler_33
        DCDC_NV_Komponentenfehler_34_XIX_DCDC_NV_Komponentenfehler_02_XIX_HCP5_CANFD01_d0aca0f9_Rx: ComBitPosition=8, ComBitSize=2, ComSignalEndianness=LITTLE_ENDIAN, ComSignalInitValue=0, ComSignalType=UINT8, ComTimeout=5, ComSystemTemplateSystemSignalRef=DCDC_NV_Komponentenfehler_34
        DCDC_NV_Komponentenfehler_35_XIX_DCDC_NV_Komponentenfehler_02_XIX_HCP5_CANFD01_1a92536a_Rx: ComBitPosition=10, ComBitSize=2, ComSignalEndianness=LITTLE_ENDIAN, ComSignalInitValue=0, ComSignalType=UINT8, ComTimeout=5, ComSystemTemplateSystemSignalRef=DCDC_NV_Komponentenfehler_35
        DCDC_NV_Komponentenfehler_36_XIX_DCDC_NV_Komponentenfehler_02_XIX_HCP5_CANFD01_9fa0419e_Rx: ComBitPosition=12, ComBitSize=2, ComSignalEndianness=LITTLE_ENDIAN, ComSignalInitValue=0, ComSignalType=UINT8, ComTimeout=5, ComSystemTemplateSystemSignalRef=DCDC_NV_Komponentenfehler_36
        DCDC_NV_Komponentenfehler_37_XIX_DCDC_NV_Komponentenfehler_02_XIX_HCP5_CANFD01_559eb20d_Rx: ComBitPosition=14, ComBitSize=2, ComSignalEndianness=LITTLE_ENDIAN, ComSignalInitValue=0, ComSignalType=UINT8, ComTimeout=5, ComSystemTemplateSystemSignalRef=DCDC_NV_Komponentenfehler_37
        DCDC_NV_Komponentenfehler_38_XIX_DCDC_NV_Komponentenfehler_02_XIX_HCP5_CANFD01_a9f7e1ea_Rx: ComBitPosition=16, ComBitSize=2, ComSignalEndianness=LITTLE_ENDIAN, ComSignalInitValue=0, ComSignalType=UINT8, ComTimeout=5, ComSystemTemplateSystemSignalRef=DCDC_NV_Komponentenfehler_38
        DCDC_NV_Komponentenfehler_39_XIX_DCDC_NV_Komponentenfehler_02_XIX_HCP5_CANFD01_63c91279_Rx: ComBitPosition=18, ComBitSize=2, ComSignalEndianness=LITTLE_ENDIAN, ComSignalInitValue=0, ComSignalType=UINT8, ComTimeout=5, ComSystemTemplateSystemSignalRef=DCDC_NV_Komponentenfehler_39
        DCDC_NV_Komponentenfehler_3_10_XIX_DCDC_NV_Komponentenfehler_04_XIX_HCP5_CANFD01_5d91a7d8_Rx: ComBitPosition=27, ComBitSize=3, ComSignalEndianness=LITTLE_ENDIAN, ComSignalInitValue=0, ComSignalType=UINT8, ComTimeout=5, ComSystemTemplateSystemSignalRef=DCDC_NV_Komponentenfehler_3_10
        DCDC_NV_Komponentenfehler_3_11_XIX_DCDC_NV_Komponentenfehler_04_XIX_HCP5_CANFD01_97af544b_Rx: ComBitPosition=30, ComBitSize=3, ComSignalEndianness=LITTLE_ENDIAN, ComSignalInitValue=0, ComSignalType=UINT8, ComTimeout=5, ComSystemTemplateSystemSignalRef=DCDC_NV_Komponentenfehler_3_11
        DCDC_NV_Komponentenfehler_3_12_XIX_DCDC_NV_Komponentenfehler_04_XIX_HCP5_CANFD01_129d46bf_Rx: ComBitPosition=33, ComBitSize=3, ComSignalEndianness=LITTLE_ENDIAN, ComSignalInitValue=0, ComSignalType=UINT8, ComTimeout=5, ComSystemTemplateSystemSignalRef=DCDC_NV_Komponentenfehler_3_12
        DCDC_NV_Komponentenfehler_3_13_XIX_DCDC_NV_Komponentenfehler_04_XIX_HCP5_CANFD01_d8a3b52c_Rx: ComBitPosition=36, ComBitSize=3, ComSignalEndianness=LITTLE_ENDIAN, ComSignalInitValue=0, ComSignalType=UINT8, ComTimeout=5, ComSystemTemplateSystemSignalRef=DCDC_NV_Komponentenfehler_3_13
        DCDC_NV_Komponentenfehler_3_14_XIX_DCDC_NV_Komponentenfehler_04_XIX_HCP5_CANFD01_c3886516_Rx: ComBitPosition=39, ComBitSize=3, ComSignalEndianness=LITTLE_ENDIAN, ComSignalInitValue=0, ComSignalType=UINT8, ComTimeout=5, ComSystemTemplateSystemSignalRef=DCDC_NV_Komponentenfehler_3_14
        DCDC_NV_Komponentenfehler_3_15_XIX_DCDC_NV_Komponentenfehler_04_XIX_HCP5_CANFD01_09b69685_Rx: ComBitPosition=42, ComBitSize=3, ComSignalEndianness=LITTLE_ENDIAN, ComSignalInitValue=0, ComSignalType=UINT8, ComTimeout=5, ComSystemTemplateSystemSignalRef=DCDC_NV_Komponentenfehler_3_15
        DCDC_NV_Komponentenfehler_3_16_XIX_DCDC_NV_Komponentenfehler_04_XIX_HCP5_CANFD01_8c848471_Rx: ComBitPosition=45, ComBitSize=3, ComSignalEndianness=LITTLE_ENDIAN, ComSignalInitValue=0, ComSignalType=UINT8, ComTimeout=5, ComSystemTemplateSystemSignalRef=DCDC_NV_Komponentenfehler_3_16
        DCDC_NV_Komponentenfehler_3_1_XIX_DCDC_NV_Komponentenfehler_04_XIX_HCP5_CANFD01_4d423624_Rx: ComBitPosition=0, ComBitSize=3, ComSignalEndianness=LITTLE_ENDIAN, ComSignalInitValue=0, ComSignalType=UINT8, ComTimeout=5, ComSystemTemplateSystemSignalRef=DCDC_NV_Komponentenfehler_3_1
        DCDC_NV_Komponentenfehler_3_2_XIX_DCDC_NV_Komponentenfehler_04_XIX_HCP5_CANFD01_c87024d0_Rx: ComBitPosition=3, ComBitSize=3, ComSignalEndianness=LITTLE_ENDIAN, ComSignalInitValue=0, ComSignalType=UINT8, ComTimeout=5, ComSystemTemplateSystemSignalRef=DCDC_NV_Komponentenfehler_3_2
        DCDC_NV_Komponentenfehler_3_3_XIX_DCDC_NV_Komponentenfehler_04_XIX_HCP5_CANFD01_024ed743_Rx: ComBitPosition=6, ComBitSize=3, ComSignalEndianness=LITTLE_ENDIAN, ComSignalInitValue=0, ComSignalType=UINT8, ComTimeout=5, ComSystemTemplateSystemSignalRef=DCDC_NV_Komponentenfehler_3_3
        DCDC_NV_Komponentenfehler_3_4_XIX_DCDC_NV_Komponentenfehler_04_XIX_HCP5_CANFD01_19650779_Rx: ComBitPosition=9, ComBitSize=3, ComSignalEndianness=LITTLE_ENDIAN, ComSignalInitValue=0, ComSignalType=UINT8, ComTimeout=5, ComSystemTemplateSystemSignalRef=DCDC_NV_Komponentenfehler_3_4
        DCDC_NV_Komponentenfehler_3_5_XIX_DCDC_NV_Komponentenfehler_04_XIX_HCP5_CANFD01_d35bf4ea_Rx: ComBitPosition=12, ComBitSize=3, ComSignalEndianness=LITTLE_ENDIAN, ComSignalInitValue=0, ComSignalType=UINT8, ComTimeout=5, ComSystemTemplateSystemSignalRef=DCDC_NV_Komponentenfehler_3_5
        DCDC_NV_Komponentenfehler_3_6_XIX_DCDC_NV_Komponentenfehler_04_XIX_HCP5_CANFD01_5669e61e_Rx: ComBitPosition=15, ComBitSize=3, ComSignalEndianness=LITTLE_ENDIAN, ComSignalInitValue=0, ComSignalType=UINT8, ComTimeout=5, ComSystemTemplateSystemSignalRef=DCDC_NV_Komponentenfehler_3_6
        DCDC_NV_Komponentenfehler_3_7_XIX_DCDC_NV_Komponentenfehler_04_XIX_HCP5_CANFD01_9c57158d_Rx: ComBitPosition=18, ComBitSize=3, ComSignalEndianness=LITTLE_ENDIAN, ComSignalInitValue=0, ComSignalType=UINT8, ComTimeout=5, ComSystemTemplateSystemSignalRef=DCDC_NV_Komponentenfehler_3_7
        DCDC_NV_Komponentenfehler_3_8_XIX_DCDC_NV_Komponentenfehler_04_XIX_HCP5_CANFD01_603e466a_Rx: ComBitPosition=21, ComBitSize=3, ComSignalEndianness=LITTLE_ENDIAN, ComSignalInitValue=0, ComSignalType=UINT8, ComTimeout=5, ComSystemTemplateSystemSignalRef=DCDC_NV_Komponentenfehler_3_8
        DCDC_NV_Komponentenfehler_3_9_XIX_DCDC_NV_Komponentenfehler_04_XIX_HCP5_CANFD01_aa00b5f9_Rx: ComBitPosition=24, ComBitSize=3, ComSignalEndianness=LITTLE_ENDIAN, ComSignalInitValue=0, ComSignalType=UINT8, ComTimeout=5, ComSystemTemplateSystemSignalRef=DCDC_NV_Komponentenfehler_3_9
        DCDC_NV_Komponentenfehler_40_XIX_DCDC_NV_Komponentenfehler_02_XIX_HCP5_CANFD01_88a29055_Rx: ComBitPosition=20, ComBitSize=2, ComSignalEndianness=LITTLE_ENDIAN, ComSignalInitValue=0, ComSignalType=UINT8, ComTimeout=5, ComSystemTemplateSystemSignalRef=DCDC_NV_Komponentenfehler_40
        DCDC_NV_Komponentenfehler_41_XIX_DCDC_NV_Komponentenfehler_02_XIX_HCP5_CANFD01_429c63c6_Rx: ComBitPosition=22, ComBitSize=2, ComSignalEndianness=LITTLE_ENDIAN, ComSignalInitValue=0, ComSignalType=UINT8, ComTimeout=5, ComSystemTemplateSystemSignalRef=DCDC_NV_Komponentenfehler_41
        DCDC_NV_Komponentenfehler_42_XIX_DCDC_NV_Komponentenfehler_02_XIX_HCP5_CANFD01_c7ae7132_Rx: ComBitPosition=24, ComBitSize=2, ComSignalEndianness=LITTLE_ENDIAN, ComSignalInitValue=0, ComSignalType=UINT8, ComTimeout=5, ComSystemTemplateSystemSignalRef=DCDC_NV_Komponentenfehler_42
        DCDC_NV_Komponentenfehler_43_XIX_DCDC_NV_Komponentenfehler_02_XIX_HCP5_CANFD01_0d9082a1_Rx: ComBitPosition=26, ComBitSize=2, ComSignalEndianness=LITTLE_ENDIAN, ComSignalInitValue=0, ComSignalType=UINT8, ComTimeout=5, ComSystemTemplateSystemSignalRef=DCDC_NV_Komponentenfehler_43
        DCDC_NV_Komponentenfehler_44_XIX_DCDC_NV_Komponentenfehler_02_XIX_HCP5_CANFD01_16bb529b_Rx: ComBitPosition=28, ComBitSize=2, ComSignalEndianness=LITTLE_ENDIAN, ComSignalInitValue=0, ComSignalType=UINT8, ComTimeout=5, ComSystemTemplateSystemSignalRef=DCDC_NV_Komponentenfehler_44
        DCDC_NV_Komponentenfehler_45_XIX_DCDC_NV_Komponentenfehler_02_XIX_HCP5_CANFD01_dc85a108_Rx: ComBitPosition=30, ComBitSize=2, ComSignalEndianness=LITTLE_ENDIAN, ComSignalInitValue=0, ComSignalType=UINT8, ComTimeout=5, ComSystemTemplateSystemSignalRef=DCDC_NV_Komponentenfehler_45
        DCDC_NV_Komponentenfehler_46_XIX_DCDC_NV_Komponentenfehler_02_XIX_HCP5_CANFD01_59b7b3fc_Rx: ComBitPosition=32, ComBitSize=2, ComSignalEndianness=LITTLE_ENDIAN, ComSignalInitValue=0, ComSignalType=UINT8, ComTimeout=5, ComSystemTemplateSystemSignalRef=DCDC_NV_Komponentenfehler_46
        DCDC_NV_Komponentenfehler_47_XIX_DCDC_NV_Komponentenfehler_02_XIX_HCP5_CANFD01_9389406f_Rx: ComBitPosition=34, ComBitSize=2, ComSignalEndianness=LITTLE_ENDIAN, ComSignalInitValue=0, ComSignalType=UINT8, ComTimeout=5, ComSystemTemplateSystemSignalRef=DCDC_NV_Komponentenfehler_47
        DCDC_NV_Komponentenfehler_48_XIX_DCDC_NV_Komponentenfehler_02_XIX_HCP5_CANFD01_6fe01388_Rx: ComBitPosition=36, ComBitSize=2, ComSignalEndianness=LITTLE_ENDIAN, ComSignalInitValue=0, ComSignalType=UINT8, ComTimeout=5, ComSystemTemplateSystemSignalRef=DCDC_NV_Komponentenfehler_48
        DCDC_NV_Komponentenfehler_49_XIX_DCDC_NV_Komponentenfehler_02_XIX_HCP5_CANFD01_a5dee01b_Rx: ComBitPosition=38, ComBitSize=2, ComSignalEndianness=LITTLE_ENDIAN, ComSignalInitValue=0, ComSignalType=UINT8, ComTimeout=5, ComSystemTemplateSystemSignalRef=DCDC_NV_Komponentenfehler_49
        DCDC_NV_Komponentenfehler_50_XIX_DCDC_NV_Komponentenfehler_02_XIX_HCP5_CANFD01_e16e6c58_Rx: ComBitPosition=40, ComBitSize=2, ComSignalEndianness=LITTLE_ENDIAN, ComSignalInitValue=0, ComSignalType=UINT8, ComTimeout=5, ComSystemTemplateSystemSignalRef=DCDC_NV_Komponentenfehler_50
        DCDC_NV_Komponentenfehler_51_XIX_DCDC_NV_Komponentenfehler_02_XIX_HCP5_CANFD01_2b509fcb_Rx: ComBitPosition=42, ComBitSize=2, ComSignalEndianness=LITTLE_ENDIAN, ComSignalInitValue=0, ComSignalType=UINT8, ComTimeout=5, ComSystemTemplateSystemSignalRef=DCDC_NV_Komponentenfehler_51
        DCDC_NV_Komponentenfehler_52_XIX_DCDC_NV_Komponentenfehler_02_XIX_HCP5_CANFD01_ae628d3f_Rx: ComBitPosition=44, ComBitSize=2, ComSignalEndianness=LITTLE_ENDIAN, ComSignalInitValue=0, ComSignalType=UINT8, ComTimeout=5, ComSystemTemplateSystemSignalRef=DCDC_NV_Komponentenfehler_52
        DCDC_NV_Komponentenfehler_53_XIX_DCDC_NV_Komponentenfehler_02_XIX_HCP5_CANFD01_645c7eac_Rx: ComBitPosition=46, ComBitSize=2, ComSignalEndianness=LITTLE_ENDIAN, ComSignalInitValue=0, ComSignalType=UINT8, ComTimeout=5, ComSystemTemplateSystemSignalRef=DCDC_NV_Komponentenfehler_53
        DCDC_NV_Komponentenfehler_54_XIX_DCDC_NV_Komponentenfehler_02_XIX_HCP5_CANFD01_7f77ae96_Rx: ComBitPosition=48, ComBitSize=2, ComSignalEndianness=LITTLE_ENDIAN, ComSignalInitValue=0, ComSignalType=UINT8, ComTimeout=5, ComSystemTemplateSystemSignalRef=DCDC_NV_Komponentenfehler_54
        DCDC_NV_Komponentenfehler_55_XIX_DCDC_NV_Komponentenfehler_02_XIX_HCP5_CANFD01_b5495d05_Rx: ComBitPosition=50, ComBitSize=2, ComSignalEndianness=LITTLE_ENDIAN, ComSignalInitValue=0, ComSignalType=UINT8, ComTimeout=5, ComSystemTemplateSystemSignalRef=DCDC_NV_Komponentenfehler_55
        DCDC_NV_Komponentenfehler_56_XIX_DCDC_NV_Komponentenfehler_02_XIX_HCP5_CANFD01_307b4ff1_Rx: ComBitPosition=52, ComBitSize=2, ComSignalEndianness=LITTLE_ENDIAN, ComSignalInitValue=0, ComSignalType=UINT8, ComTimeout=5, ComSystemTemplateSystemSignalRef=DCDC_NV_Komponentenfehler_56
        DCDC_NV_Komponentenfehler_57_XIX_DCDC_NV_Komponentenfehler_02_XIX_HCP5_CANFD01_fa45bc62_Rx: ComBitPosition=54, ComBitSize=2, ComSignalEndianness=LITTLE_ENDIAN, ComSignalInitValue=0, ComSignalType=UINT8, ComTimeout=5, ComSystemTemplateSystemSignalRef=DCDC_NV_Komponentenfehler_57
        DCDC_NV_Komponentenfehler_58_XIX_DCDC_NV_Komponentenfehler_02_XIX_HCP5_CANFD01_062cef85_Rx: ComBitPosition=56, ComBitSize=2, ComSignalEndianness=LITTLE_ENDIAN, ComSignalInitValue=0, ComSignalType=UINT8, ComTimeout=5, ComSystemTemplateSystemSignalRef=DCDC_NV_Komponentenfehler_58
        DCDC_NV_Komponentenfehler_59_XIX_DCDC_NV_Komponentenfehler_02_XIX_HCP5_CANFD01_cc121c16_Rx: ComBitPosition=58, ComBitSize=2, ComSignalEndianness=LITTLE_ENDIAN, ComSignalInitValue=0, ComSignalType=UINT8, ComTimeout=5, ComSystemTemplateSystemSignalRef=DCDC_NV_Komponentenfehler_59
        DCDC_NV_Komponentenfehler_60_XIX_DCDC_NV_Komponentenfehler_02_XIX_HCP5_CANFD01_5b3b684f_Rx: ComBitPosition=60, ComBitSize=2, ComSignalEndianness=LITTLE_ENDIAN, ComSignalInitValue=0, ComSignalType=UINT8, ComTimeout=5, ComSystemTemplateSystemSignalRef=DCDC_NV_Komponentenfehler_60
        DCDC_NV_Komponentenfehler_61_XIX_DCDC_NV_Komponentenfehler_03_XIX_HCP5_CANFD01_7e572d3d_Rx: ComBitPosition=0, ComBitSize=2, ComSignalEndianness=LITTLE_ENDIAN, ComSignalInitValue=0, ComSignalType=UINT8, ComTimeout=5, ComSystemTemplateSystemSignalRef=DCDC_NV_Komponentenfehler_61
        DCDC_NV_Komponentenfehler_62_XIX_DCDC_NV_Komponentenfehler_03_XIX_HCP5_CANFD01_fb653fc9_Rx: ComBitPosition=2, ComBitSize=2, ComSignalEndianness=LITTLE_ENDIAN, ComSignalInitValue=0, ComSignalType=UINT8, ComTimeout=5, ComSystemTemplateSystemSignalRef=DCDC_NV_Komponentenfehler_62
        DCDC_NV_Komponentenfehler_63_XIX_DCDC_NV_Komponentenfehler_03_XIX_HCP5_CANFD01_315bcc5a_Rx: ComBitPosition=4, ComBitSize=2, ComSignalEndianness=LITTLE_ENDIAN, ComSignalInitValue=0, ComSignalType=UINT8, ComTimeout=5, ComSystemTemplateSystemSignalRef=DCDC_NV_Komponentenfehler_63
        DCDC_NV_Komponentenfehler_64_XIX_DCDC_NV_Komponentenfehler_03_XIX_HCP5_CANFD01_2a701c60_Rx: ComBitPosition=6, ComBitSize=2, ComSignalEndianness=LITTLE_ENDIAN, ComSignalInitValue=0, ComSignalType=UINT8, ComTimeout=5, ComSystemTemplateSystemSignalRef=DCDC_NV_Komponentenfehler_64
        DCDC_NV_Komponentenfehler_65_XIX_DCDC_NV_Komponentenfehler_03_XIX_HCP5_CANFD01_e04eeff3_Rx: ComBitPosition=8, ComBitSize=2, ComSignalEndianness=LITTLE_ENDIAN, ComSignalInitValue=0, ComSignalType=UINT8, ComTimeout=5, ComSystemTemplateSystemSignalRef=DCDC_NV_Komponentenfehler_65
        DCDC_NV_Komponentenfehler_66_XIX_DCDC_NV_Komponentenfehler_03_XIX_HCP5_CANFD01_657cfd07_Rx: ComBitPosition=10, ComBitSize=2, ComSignalEndianness=LITTLE_ENDIAN, ComSignalInitValue=0, ComSignalType=UINT8, ComTimeout=5, ComSystemTemplateSystemSignalRef=DCDC_NV_Komponentenfehler_66
        DCDC_NV_Komponentenfehler_67_XIX_DCDC_NV_Komponentenfehler_03_XIX_HCP5_CANFD01_af420e94_Rx: ComBitPosition=12, ComBitSize=2, ComSignalEndianness=LITTLE_ENDIAN, ComSignalInitValue=0, ComSignalType=UINT8, ComTimeout=5, ComSystemTemplateSystemSignalRef=DCDC_NV_Komponentenfehler_67
        DCDC_NV_Komponentenfehler_68_XIX_DCDC_NV_Komponentenfehler_03_XIX_HCP5_CANFD01_532b5d73_Rx: ComBitPosition=14, ComBitSize=2, ComSignalEndianness=LITTLE_ENDIAN, ComSignalInitValue=0, ComSignalType=UINT8, ComTimeout=5, ComSystemTemplateSystemSignalRef=DCDC_NV_Komponentenfehler_68
        DCDC_NV_Komponentenfehler_69_XIX_DCDC_NV_Komponentenfehler_03_XIX_HCP5_CANFD01_9915aee0_Rx: ComBitPosition=16, ComBitSize=2, ComSignalEndianness=LITTLE_ENDIAN, ComSignalInitValue=0, ComSignalType=UINT8, ComTimeout=5, ComSystemTemplateSystemSignalRef=DCDC_NV_Komponentenfehler_69
        DCDC_NV_Komponentenfehler_70_XIX_DCDC_NV_Komponentenfehler_03_XIX_HCP5_CANFD01_dda522a3_Rx: ComBitPosition=18, ComBitSize=2, ComSignalEndianness=LITTLE_ENDIAN, ComSignalInitValue=0, ComSignalType=UINT8, ComTimeout=5, ComSystemTemplateSystemSignalRef=DCDC_NV_Komponentenfehler_70
        DCDC_NV_Komponentenfehler_71_XIX_DCDC_NV_Komponentenfehler_03_XIX_HCP5_CANFD01_179bd130_Rx: ComBitPosition=20, ComBitSize=2, ComSignalEndianness=LITTLE_ENDIAN, ComSignalInitValue=0, ComSignalType=UINT8, ComTimeout=5, ComSystemTemplateSystemSignalRef=DCDC_NV_Komponentenfehler_71
        DCDC_NV_Komponentenfehler_72_XIX_DCDC_NV_Komponentenfehler_03_XIX_HCP5_CANFD01_92a9c3c4_Rx: ComBitPosition=22, ComBitSize=2, ComSignalEndianness=LITTLE_ENDIAN, ComSignalInitValue=0, ComSignalType=UINT8, ComTimeout=5, ComSystemTemplateSystemSignalRef=DCDC_NV_Komponentenfehler_72
        DCDC_NV_Komponentenfehler_73_XIX_DCDC_NV_Komponentenfehler_03_XIX_HCP5_CANFD01_58973057_Rx: ComBitPosition=24, ComBitSize=2, ComSignalEndianness=LITTLE_ENDIAN, ComSignalInitValue=0, ComSignalType=UINT8, ComTimeout=5, ComSystemTemplateSystemSignalRef=DCDC_NV_Komponentenfehler_73
        DCDC_NV_Komponentenfehler_74_XIX_DCDC_NV_Komponentenfehler_03_XIX_HCP5_CANFD01_43bce06d_Rx: ComBitPosition=26, ComBitSize=2, ComSignalEndianness=LITTLE_ENDIAN, ComSignalInitValue=0, ComSignalType=UINT8, ComTimeout=5, ComSystemTemplateSystemSignalRef=DCDC_NV_Komponentenfehler_74
        DCDC_NV_Komponentenfehler_75_XIX_DCDC_NV_Komponentenfehler_03_XIX_HCP5_CANFD01_898213fe_Rx: ComBitPosition=28, ComBitSize=2, ComSignalEndianness=LITTLE_ENDIAN, ComSignalInitValue=0, ComSignalType=UINT8, ComTimeout=5, ComSystemTemplateSystemSignalRef=DCDC_NV_Komponentenfehler_75
        DCDC_NV_Komponentenfehler_76_XIX_DCDC_NV_Komponentenfehler_03_XIX_HCP5_CANFD01_0cb0010a_Rx: ComBitPosition=30, ComBitSize=2, ComSignalEndianness=LITTLE_ENDIAN, ComSignalInitValue=0, ComSignalType=UINT8, ComTimeout=5, ComSystemTemplateSystemSignalRef=DCDC_NV_Komponentenfehler_76
        DCDC_NV_Komponentenfehler_77_XIX_DCDC_NV_Komponentenfehler_03_XIX_HCP5_CANFD01_c68ef299_Rx: ComBitPosition=32, ComBitSize=2, ComSignalEndianness=LITTLE_ENDIAN, ComSignalInitValue=0, ComSignalType=UINT8, ComTimeout=5, ComSystemTemplateSystemSignalRef=DCDC_NV_Komponentenfehler_77
        DCDC_NV_Komponentenfehler_78_XIX_DCDC_NV_Komponentenfehler_03_XIX_HCP5_CANFD01_3ae7a17e_Rx: ComBitPosition=34, ComBitSize=2, ComSignalEndianness=LITTLE_ENDIAN, ComSignalInitValue=0, ComSignalType=UINT8, ComTimeout=5, ComSystemTemplateSystemSignalRef=DCDC_NV_Komponentenfehler_78
        DCDC_NV_Komponentenfehler_79_XIX_DCDC_NV_Komponentenfehler_03_XIX_HCP5_CANFD01_f0d952ed_Rx: ComBitPosition=36, ComBitSize=2, ComSignalEndianness=LITTLE_ENDIAN, ComSignalInitValue=0, ComSignalType=UINT8, ComTimeout=5, ComSystemTemplateSystemSignalRef=DCDC_NV_Komponentenfehler_79
        DCDC_NV_Komponentenfehler_80_XIX_DCDC_NV_Komponentenfehler_03_XIX_HCP5_CANFD01_e3373c2b_Rx: ComBitPosition=38, ComBitSize=2, ComSignalEndianness=LITTLE_ENDIAN, ComSignalInitValue=0, ComSignalType=UINT8, ComTimeout=5, ComSystemTemplateSystemSignalRef=DCDC_NV_Komponentenfehler_80
        DCDC_NV_Komponentenfehler_VLD_XIX_DCDC_NV_Komponentenfehler_01_XIX_HCP5_CANFD01_edf78d03_Rx: ComBitPosition=63, ComBitSize=1, ComSignalEndianness=LITTLE_ENDIAN, ComSignalInitValue=0, ComSignalType=UINT8, ComTimeout=5, ComSystemTemplateSystemSignalRef=DCDC_NV_Komponentenfehler_VLD
        DC_IstLeistung_HV_XIX_DCDC_04_XIX_HCP5_CANFD01_7ce6573a_Rx: ComBitPosition=54, ComBitSize=10, ComSignalDataInvalidValue=1023, ComSignalEndianness=LITTLE_ENDIAN, ComSignalInitValue=1022, ComSignalType=UINT8, ComTimeout=0.5, ComSystemTemplateSystemSignalRef=DC_IstLeistung_HV
        DEV_Hybrid_01_Req_00_FD_Data_XIX_DEV_Hybrid_01_Req_00_XIX_HCP5_CANFD01_5095de8e_Rx: ComBitPosition=0, ComSignalEndianness=opaque, ComSignalInitValue=0 0 0 0 0 0 0 0 0 0 0 0 0 0 0 0 0 0 0 0 0 0 0 0 0 0 0 0 0 0 0 0 0 0 0 0 0 0 0 0 0 0 0 0 0 0 0 0 0 0 0 0 0 0 0 0 0 0 0 0 0 0 0 0, ComSignalLength=64, ComSignalType=UINT8_N, ComSystemTemplateSystemSignalRef=DEV_Hybrid_01_Req_00_FD_Data
        DEV_Hybrid_01_Resp_FF_FD_Data_XIX_DEV_Hybrid_01_Resp_FF_XIX_HCP5_CANFD01_c5a91adf_Tx: ComBitPosition=0, ComSignalEndianness=opaque, ComSignalInitValue=0 0 0 0 0 0 0 0 0 0 0 0 0 0 0 0 0 0 0 0 0 0 0 0 0 0 0 0 0 0 0 0 0 0 0 0 0 0 0 0 0 0 0 0 0 0 0 0 0 0 0 0 0 0 0 0 0 0 0 0 0 0 0 0, ComSignalLength=64, ComSignalType=UINT8_N, ComTransferProperty=TRIGGERED_ON_CHANGE_WITHOUT_REPETITION, ComSystemTemplateSystemSignalRef=DEV_Hybrid_01_Resp_FF_FD_Data
        DS_Hybrid_01_ConfDTCChanged_XIX_DS_Hybrid_01_XIX_HCP5_CANFD01_2044f478_Tx: ComBitPosition=17, ComBitSize=1, ComSignalEndianness=LITTLE_ENDIAN, ComSignalInitValue=0, ComSignalType=UINT8, ComTransferProperty=TRIGGERED_ON_CHANGE_WITHOUT_REPETITION, ComSystemTemplateSystemSignalRef=DS_Hybrid_01_ConfDTCChanged
        DS_Hybrid_01_DiagAdr_XIX_DS_Hybrid_01_XIX_HCP5_CANFD01_ecf98c5e_Tx: ComBitPosition=0, ComBitSize=16, ComSignalEndianness=LITTLE_ENDIAN, ComSignalInitValue=140, ComSignalType=UINT8, ComTransferProperty=PENDING, ComSystemTemplateSystemSignalRef=DS_Hybrid_01_DiagAdr
        DS_Hybrid_01_IdentValid_XIX_DS_Hybrid_01_XIX_HCP5_CANFD01_1ffc9aaf_Tx: ComBitPosition=22, ComBitSize=1, ComSignalEndianness=LITTLE_ENDIAN, ComSignalInitValue=1, ComSignalType=UINT8, ComTransferProperty=TRIGGERED_ON_CHANGE_WITHOUT_REPETITION, ComSystemTemplateSystemSignalRef=DS_Hybrid_01_IdentValid
        DS_Hybrid_01_Lokalaktiv_XIX_DS_Hybrid_01_XIX_HCP5_CANFD01_8a807ec5_Tx: ComBitPosition=23, ComBitSize=1, ComSignalEndianness=LITTLE_ENDIAN, ComSignalInitValue=0, ComSignalType=UINT8, ComTransferProperty=PENDING, ComSystemTemplateSystemSignalRef=DS_Hybrid_01_Lokalaktiv
        DS_Hybrid_01_MemSel10Changed_XIX_DS_Hybrid_01_XIX_HCP5_CANFD01_040fbf45_Tx: ComBitPosition=20, ComBitSize=1, ComSignalEndianness=LITTLE_ENDIAN, ComSignalInitValue=0, ComSignalType=UINT8, ComTransferProperty=TRIGGERED_ON_CHANGE_WITHOUT_REPETITION, ComSystemTemplateSystemSignalRef=DS_Hybrid_01_MemSel10Changed
        DS_Hybrid_01_MemSelChanged_XIX_DS_Hybrid_01_XIX_HCP5_CANFD01_a7dec6c2_Tx: ComBitPosition=21, ComBitSize=1, ComSignalEndianness=LITTLE_ENDIAN, ComSignalInitValue=0, ComSignalType=UINT8, ComTransferProperty=TRIGGERED_ON_CHANGE_WITHOUT_REPETITION, ComSystemTemplateSystemSignalRef=DS_Hybrid_01_MemSelChanged
        DS_Hybrid_01_StMemChanged_XIX_DS_Hybrid_01_XIX_HCP5_CANFD01_c527befd_Tx: ComBitPosition=19, ComBitSize=1, ComSignalEndianness=LITTLE_ENDIAN, ComSignalInitValue=0, ComSignalType=UINT8, ComTransferProperty=TRIGGERED_ON_CHANGE_WITHOUT_REPETITION, ComSystemTemplateSystemSignalRef=DS_Hybrid_01_StMemChanged
        DS_Hybrid_01_Subsystemaktiv_XIX_DS_Hybrid_01_XIX_HCP5_CANFD01_cb6ff8bb_Tx: ComBitPosition=24, ComBitSize=1, ComSignalEndianness=LITTLE_ENDIAN, ComSignalInitValue=0, ComSignalType=UINT8, ComTransferProperty=PENDING, ComSystemTemplateSystemSignalRef=DS_Hybrid_01_Subsystemaktiv
        DS_Hybrid_01_TestFailedChanged_XIX_DS_Hybrid_01_XIX_HCP5_CANFD01_f799e5e7_Tx: ComBitPosition=16, ComBitSize=1, ComSignalEndianness=LITTLE_ENDIAN, ComSignalInitValue=0, ComSignalType=UINT8, ComTransferProperty=TRIGGERED_ON_CHANGE_WITHOUT_REPETITION, ComSystemTemplateSystemSignalRef=DS_Hybrid_01_TestFailedChanged
        DS_Hybrid_01_WIRChanged_XIX_DS_Hybrid_01_XIX_HCP5_CANFD01_296545f7_Tx: ComBitPosition=18, ComBitSize=1, ComSignalEndianness=LITTLE_ENDIAN, ComSignalInitValue=0, ComSignalType=UINT8, ComTransferProperty=TRIGGERED_ON_CHANGE_WITHOUT_REPETITION, ComSystemTemplateSystemSignalRef=DS_Hybrid_01_WIRChanged
        DW_Kilometerstand_XIX_Diagnose_01_XIX_HCP5_CANFD01_78853316_Rx: ComBitPosition=8, ComBitSize=20, ComSignalDataInvalidValue=1048575, ComSignalEndianness=LITTLE_ENDIAN, ComSignalInitValue=1048574, ComSignalType=UINT8, ComTimeout=5, ComSystemTemplateSystemSignalRef=DW_Kilometerstand
        EKK_HVK_EoHVL_Status_XIX_Thermomanagement_01_XIX_HCP5_CANFD01_0b35afaa_Rx: ComBitPosition=58, ComBitSize=2, ComSignalDataInvalidValue=3, ComSignalEndianness=LITTLE_ENDIAN, ComSignalInitValue=0, ComSignalType=UINT8, ComTimeout=1, ComSystemTemplateSystemSignalRef=EKK_HVK_EoHVL_Status
        HVEM_BMC_CHA_Wunschleistung_02_XIX_HVEM_07_XIX_HCP5_CANFD01_7eeecd70_Rx: ComBitPosition=213, ComBitSize=15, ComSignalDataInvalidValue=32767, ComSignalEndianness=LITTLE_ENDIAN, ComSignalInitValue=32766, ComSignalType=UINT8, ComTimeout=0.8, ComSystemTemplateSystemSignalRef=HVEM_BMC_CHA_Wunschleistung_02
        HVEM_BMC_CHA_Wunschleistung_XIX_HVEM_07_XIX_HCP5_CANFD01_7884fa49_Rx: ComBitPosition=147, ComBitSize=13, ComSignalDataInvalidValue=8191, ComSignalEndianness=LITTLE_ENDIAN, ComSignalInitValue=8190, ComSignalType=UINT8, ComTimeout=0.8, ComSystemTemplateSystemSignalRef=HVEM_BMC_CHA_Wunschleistung
        HVEM_MMTR_State_XIX_HVEM_07_XIX_HCP5_CANFD01_6d943f0f_Rx: ComBitPosition=179, ComBitSize=4, ComSignalDataInvalidValue=15, ComSignalEndianness=LITTLE_ENDIAN, ComSignalInitValue=0, ComSignalType=UINT8, ComTimeout=0.8, ComSystemTemplateSystemSignalRef=HVEM_MMTR_State
        HVEM_SystemMinLeistungsgrenze_XIX_HVEM_07_XIX_HCP5_CANFD01_b8be9fb0_Rx: ComBitPosition=160, ComBitSize=7, ComSignalDataInvalidValue=127, ComSignalEndianness=LITTLE_ENDIAN, ComSignalInitValue=126, ComSignalType=UINT8, ComTimeout=0.8, ComSystemTemplateSystemSignalRef=HVEM_SystemMinLeistungsgrenze
        HVLE_IstSpannung_HV_XIX_OBG_01_XIX_HCP5_CANFD01_577040d9_Rx: ComBitPosition=12, ComBitSize=10, ComSignalDataInvalidValue=1023, ComSignalEndianness=LITTLE_ENDIAN, ComSignalInitValue=1022, ComSignalType=UINT8, ComTimeout=1, ComSystemTemplateSystemSignalRef=HVLE_IstSpannung_HV
        HVLE_OBG_IstModus_XIX_OBG_01_XIX_HCP5_CANFD01_6564feea_Rx: ComBitPosition=133, ComBitSize=3, ComSignalDataInvalidValue=7, ComSignalEndianness=LITTLE_ENDIAN, ComSignalInitValue=6, ComSignalType=UINT8, ComTimeout=1, ComSystemTemplateSystemSignalRef=HVLE_OBG_IstModus
        HVLM_BCAM_Aktiv_XIX_ELF_06_XIX_HCP5_CANFD01_9b6861e7_Rx: ComBitPosition=45, ComBitSize=1, ComSignalEndianness=LITTLE_ENDIAN, ComSignalInitValue=0, ComSignalType=UINT8, ComTimeout=2, ComSystemTemplateSystemSignalRef=HVLM_BCAM_Aktiv
        HVLM_BidiLadeModus_XIX_HVLM_13_XIX_HCP5_CANFD01_0594f11a_Rx: ComBitPosition=224, ComBitSize=2, ComSignalEndianness=LITTLE_ENDIAN, ComSignalInitValue=0, ComSignalType=UINT8, ComTimeout=1, ComSystemTemplateSystemSignalRef=HVLM_BidiLadeModus
        Hybrid_01_Indc_StChk_XIX_OBD_Hybrid_01_XIX_HCP5_CANFD01_0ff5b24f_Tx: ComBitPosition=4, ComBitSize=1, ComSignalEndianness=LITTLE_ENDIAN, ComSignalInitValue=1, ComSignalType=UINT8, ComTransferProperty=PENDING, ComSystemTemplateSystemSignalRef=Hybrid_01_Indc_StChk
        Hybrid_01_Indc_StFail_XIX_OBD_Hybrid_01_XIX_HCP5_CANFD01_6c961b98_Tx: ComBitPosition=5, ComBitSize=1, ComSignalEndianness=LITTLE_ENDIAN, ComSignalInitValue=0, ComSignalType=UINT8, ComTransferProperty=PENDING, ComSystemTemplateSystemSignalRef=Hybrid_01_Indc_StFail
        Hybrid_01_KD_Fehler_XIX_KN_Hybrid_01_XIX_HCP5_CANFD01_3ce83ada_Tx: ComBitPosition=23, ComBitSize=1, ComSignalEndianness=LITTLE_ENDIAN, ComSignalInitValue=0, ComSignalType=UINT8, ComTransferProperty=PENDING, ComSystemTemplateSystemSignalRef=Hybrid_01_KD_Fehler
        Hybrid_01_KompSchutz_XIX_KN_Hybrid_01_XIX_HCP5_CANFD01_b32281c3_Tx: ComBitPosition=0, ComBitSize=1, ComSignalEndianness=LITTLE_ENDIAN, ComSignalInitValue=0, ComSignalType=UINT8, ComTransferProperty=PENDING, ComSystemTemplateSystemSignalRef=Hybrid_01_KompSchutz
        Hybrid_01_Nachlauftyp_XIX_KN_Hybrid_01_XIX_HCP5_CANFD01_26798f2d_Tx: ComBitPosition=4, ComBitSize=4, ComSignalEndianness=LITTLE_ENDIAN, ComSignalInitValue=2, ComSignalType=UINT8, ComTransferProperty=PENDING, ComSystemTemplateSystemSignalRef=Hybrid_01_Nachlauftyp
        Hybrid_01_SNI_10_XIX_KN_Hybrid_01_XIX_HCP5_CANFD01_ea872ae4_Tx: ComBitPosition=8, ComBitSize=10, ComSignalEndianness=LITTLE_ENDIAN, ComSignalInitValue=123, ComSignalType=UINT8, ComTransferProperty=PENDING, ComSystemTemplateSystemSignalRef=Hybrid_01_SNI_10
        KN_Hybrid_01_BusKnockOutTimer_XIX_KN_Hybrid_01_XIX_HCP5_CANFD01_e5089bb3_Tx: ComBitPosition=32, ComBitSize=8, ComSignalEndianness=LITTLE_ENDIAN, ComSignalInitValue=15, ComSignalType=UINT8, ComTransferProperty=PENDING, ComSystemTemplateSystemSignalRef=KN_Hybrid_01_BusKnockOutTimer
        KN_Hybrid_01_BusKnockOut_XIX_KN_Hybrid_01_XIX_HCP5_CANFD01_b162d19d_Tx: ComBitPosition=30, ComBitSize=2, ComSignalEndianness=LITTLE_ENDIAN, ComSignalInitValue=0, ComSignalType=UINT8, ComTransferProperty=PENDING, ComSystemTemplateSystemSignalRef=KN_Hybrid_01_BusKnockOut
        KN_Hybrid_01_DiagPfad_V12_XIX_KN_Hybrid_01_XIX_HCP5_CANFD01_9879167d_Tx: ComBitPosition=20, ComBitSize=1, ComSignalEndianness=LITTLE_ENDIAN, ComSignalInitValue=0, ComSignalType=UINT8, ComTransferProperty=PENDING, ComSystemTemplateSystemSignalRef=KN_Hybrid_01_DiagPfad_V12
        KN_Hybrid_01_ECUKnockOutTimer_XIX_KN_Hybrid_01_XIX_HCP5_CANFD01_7ea3be84_Tx: ComBitPosition=24, ComBitSize=6, ComSignalEndianness=LITTLE_ENDIAN, ComSignalInitValue=15, ComSignalType=UINT8, ComTransferProperty=PENDING, ComSystemTemplateSystemSignalRef=KN_Hybrid_01_ECUKnockOutTimer
        KN_Hybrid_01_ECUKnockOut_XIX_KN_Hybrid_01_XIX_HCP5_CANFD01_dd88c4a5_Tx: ComBitPosition=18, ComBitSize=2, ComSignalEndianness=LITTLE_ENDIAN, ComSignalInitValue=0, ComSignalType=UINT8, ComTransferProperty=PENDING, ComSystemTemplateSystemSignalRef=KN_Hybrid_01_ECUKnockOut
        KST_KL_15_XIX_ClampControl_01_XIX_HCP5_CANFD01_06301fa5_Rx: ComBitPosition=17, ComBitSize=1, ComSignalEndianness=LITTLE_ENDIAN, ComSignalInitValue=0, ComSignalType=UINT8, ComTimeout=1, ComSystemTemplateSystemSignalRef=KST_KL_15
        MM_PropulsionSystemActive_XIX_OBD_04_XIX_HCP5_CANFD01_e1fc58e2_Rx: ComBitPosition=24, ComBitSize=1, ComSignalEndianness=LITTLE_ENDIAN, ComSignalInitValue=0, ComSignalType=UINT8, ComTimeout=3.2, ComSystemTemplateSystemSignalRef=MM_PropulsionSystemActive
        NM_Hybrid_01_CAB_V12_XIX_NMH_Hybrid_01_XIX_BMC_CAN01_6448e8c9_Tx: ComBitPosition=24, ComSignalEndianness=opaque, ComSignalInitValue=0 0 0, ComSignalLength=3, ComSignalType=UINT8_N, ComTransferProperty=TRIGGERED, ComSystemTemplateSystemSignalRef=NM_Hybrid_01_CAB_V12
        NM_Hybrid_01_FCAB_XIX_NM_Hybrid_01_XIX_HCP5_CANFD01_38c188fa_Tx: ComBitPosition=0, ComSignalEndianness=opaque, ComSignalInitValue=0 0 0 0 0 0 0, ComSignalLength=7, ComSignalType=UINT8_N, ComTransferProperty=TRIGGERED_ON_CHANGE, ComSystemTemplateSystemSignalRef=NM_Hybrid_01_FCAB
        NM_Hybrid_01_FCIB_XIX_KN_Hybrid_01_XIX_HCP5_CANFD01_7ed68506_Tx: ComBitPosition=40, ComSignalEndianness=opaque, ComSignalInitValue=1 0 0 34 128 0 0, ComSignalLength=7, ComSignalType=UINT8_N, ComTransferProperty=PENDING, ComSystemTemplateSystemSignalRef=NM_Hybrid_01_FCIB
        NM_Hybrid_01_Lokalaktiv_XIX_KN_Hybrid_01_XIX_HCP5_CANFD01_905d7818_Tx: ComBitPosition=21, ComBitSize=1, ComSignalEndianness=LITTLE_ENDIAN, ComSignalInitValue=0, ComSignalType=UINT8, ComTransferProperty=PENDING, ComSystemTemplateSystemSignalRef=NM_Hybrid_01_Lokalaktiv
        NM_Hybrid_01_NM_State_XIX_NMH_Hybrid_01_XIX_BMC_CAN01_20dc868b_Tx: ComBitPosition=0, ComBitSize=6, ComSignalEndianness=LITTLE_ENDIAN, ComSignalInitValue=0, ComSignalType=UINT8, ComTransferProperty=TRIGGERED_ON_CHANGE, ComSystemTemplateSystemSignalRef=NM_Hybrid_01_NM_State
        NM_Hybrid_01_NM_State_XIX_NM_Hybrid_01_XIX_HCP5_CANFD01_9a9758f9_Tx: ComBitPosition=136, ComBitSize=6, ComSignalEndianness=LITTLE_ENDIAN, ComSignalInitValue=0, ComSignalType=UINT8, ComTransferProperty=TRIGGERED, ComSystemTemplateSystemSignalRef=NM_Hybrid_01_NM_State
        NM_Hybrid_01_NM_aktiv_Diag_XIX_NMH_Hybrid_01_XIX_BMC_CAN01_537ad98b_Tx: ComBitPosition=9, ComBitSize=1, ComSignalEndianness=LITTLE_ENDIAN, ComSignalInitValue=0, ComSignalType=UINT8, ComTransferProperty=TRIGGERED, ComSystemTemplateSystemSignalRef=NM_Hybrid_01_NM_aktiv_Diag
        NM_Hybrid_01_NM_aktiv_Diag_XIX_NM_Hybrid_01_XIX_HCP5_CANFD01_6143673a_Tx: ComBitPosition=153, ComBitSize=1, ComSignalEndianness=LITTLE_ENDIAN, ComSignalInitValue=0, ComSignalType=UINT8, ComTransferProperty=TRIGGERED, ComSystemTemplateSystemSignalRef=NM_Hybrid_01_NM_aktiv_Diag
        NM_Hybrid_01_NM_aktiv_KL15_XIX_NMH_Hybrid_01_XIX_BMC_CAN01_7114d801_Tx: ComBitPosition=8, ComBitSize=1, ComSignalEndianness=LITTLE_ENDIAN, ComSignalInitValue=0, ComSignalType=UINT8, ComTransferProperty=TRIGGERED, ComSystemTemplateSystemSignalRef=NM_Hybrid_01_NM_aktiv_KL15
        NM_Hybrid_01_NM_aktiv_KL15_XIX_NM_Hybrid_01_XIX_HCP5_CANFD01_d7280503_Tx: ComBitPosition=152, ComBitSize=1, ComSignalEndianness=LITTLE_ENDIAN, ComSignalInitValue=0, ComSignalType=UINT8, ComTransferProperty=TRIGGERED, ComSystemTemplateSystemSignalRef=NM_Hybrid_01_NM_aktiv_KL15
        NM_Hybrid_01_NM_aktiv_Tmin_XIX_NMH_Hybrid_01_XIX_BMC_CAN01_9fd576ae_Tx: ComBitPosition=10, ComBitSize=1, ComSignalEndianness=LITTLE_ENDIAN, ComSignalInitValue=0, ComSignalType=UINT8, ComTransferProperty=TRIGGERED, ComSystemTemplateSystemSignalRef=NM_Hybrid_01_NM_aktiv_Tmin
        NM_Hybrid_01_NM_aktiv_Tmin_XIX_NM_Hybrid_01_XIX_HCP5_CANFD01_cfd9c50b_Tx: ComBitPosition=154, ComBitSize=1, ComSignalEndianness=LITTLE_ENDIAN, ComSignalInitValue=0, ComSignalType=UINT8, ComTransferProperty=TRIGGERED, ComSystemTemplateSystemSignalRef=NM_Hybrid_01_NM_aktiv_Tmin
        NM_Hybrid_01_SNI_10_XIX_NM_Hybrid_01_XIX_HCP5_CANFD01_4ea5afc8_Tx: ComBitPosition=120, ComBitSize=10, ComSignalEndianness=LITTLE_ENDIAN, ComSignalInitValue=123, ComSignalType=UINT8, ComTransferProperty=TRIGGERED, ComSystemTemplateSystemSignalRef=NM_Hybrid_01_SNI_10
        NM_Hybrid_01_Subsystemaktiv_XIX_KN_Hybrid_01_XIX_HCP5_CANFD01_0d256d16_Tx: ComBitPosition=22, ComBitSize=1, ComSignalEndianness=LITTLE_ENDIAN, ComSignalInitValue=0, ComSignalType=UINT8, ComTransferProperty=PENDING, ComSystemTemplateSystemSignalRef=NM_Hybrid_01_Subsystemaktiv
        NM_Hybrid_01_UDS_CC_XIX_NM_Hybrid_01_XIX_HCP5_CANFD01_d82615ea_Tx: ComBitPosition=143, ComBitSize=1, ComSignalEndianness=LITTLE_ENDIAN, ComSignalInitValue=0, ComSignalType=UINT8, ComTransferProperty=TRIGGERED, ComSystemTemplateSystemSignalRef=NM_Hybrid_01_UDS_CC
        NM_Hybrid_01_Wakeup_V12_XIX_NM_Hybrid_01_XIX_HCP5_CANFD01_450fdf96_Tx: ComBitPosition=144, ComBitSize=8, ComSignalEndianness=LITTLE_ENDIAN, ComSignalInitValue=0, ComSignalType=UINT8, ComTransferProperty=TRIGGERED, ComSystemTemplateSystemSignalRef=NM_Hybrid_01_Wakeup_V12
        NM_aktiv_Konditionierungsbedarf_XIX_NMH_Hybrid_01_XIX_BMC_CAN01_514ad247_Tx: ComBitPosition=11, ComBitSize=1, ComSignalEndianness=LITTLE_ENDIAN, ComSignalInitValue=0, ComSignalType=UINT8, ComTransferProperty=TRIGGERED, ComSystemTemplateSystemSignalRef=NM_aktiv_Konditionierungsbedarf
        NM_aktiv_Konditionierungsbedarf_XIX_NM_Hybrid_01_XIX_HCP5_CANFD01_91de24c0_Tx: ComBitPosition=155, ComBitSize=1, ComSignalEndianness=LITTLE_ENDIAN, ComSignalInitValue=0, ComSignalType=UINT8, ComTransferProperty=TRIGGERED, ComSystemTemplateSystemSignalRef=NM_aktiv_Konditionierungsbedarf
        NM_aktiv_SubbusSteuerung_BMC_HV_XIX_NMH_Hybrid_01_XIX_BMC_CAN01_c2e71061_Tx: ComBitPosition=12, ComBitSize=1, ComSignalEndianness=LITTLE_ENDIAN, ComSignalInitValue=0, ComSignalType=UINT8, ComTransferProperty=TRIGGERED, ComSystemTemplateSystemSignalRef=NM_aktiv_SubbusSteuerung_BMC_HV
        NM_aktiv_SubbusSteuerung_BMC_HV_XIX_NM_Hybrid_01_XIX_HCP5_CANFD01_276a97d5_Tx: ComBitPosition=156, ComBitSize=1, ComSignalEndianness=LITTLE_ENDIAN, ComSignalInitValue=0, ComSignalType=UINT8, ComTransferProperty=TRIGGERED, ComSystemTemplateSystemSignalRef=NM_aktiv_SubbusSteuerung_BMC_HV
        NVEM_Abschaltstufe_XIX_NVEM_12_XIX_HCP5_CANFD01_cc082583_Rx: ComBitPosition=19, ComBitSize=2, ComSignalEndianness=LITTLE_ENDIAN, ComSignalInitValue=0, ComSignalType=UINT8, ComTimeout=1, ComSystemTemplateSystemSignalRef=NVEM_Abschaltstufe
        OBDProtocol_Hybrid_01_XIX_OBD_Hybrid_01_XIX_HCP5_CANFD01_aa11071d_Tx: ComBitPosition=0, ComBitSize=4, ComSignalDataInvalidValue=15, ComSignalEndianness=LITTLE_ENDIAN, ComSignalInitValue=14, ComSignalType=UINT8, ComTransferProperty=PENDING, ComSystemTemplateSystemSignalRef=OBDProtocol_Hybrid_01
        OBDProtocol_req_XIX_OBD_HCP1_XIX_HCP5_CANFD01_70c5c055_Rx: ComBitPosition=0, ComBitSize=4, ComSignalDataInvalidValue=15, ComSignalEndianness=LITTLE_ENDIAN, ComSignalInitValue=14, ComSignalType=UINT8, ComTimeout=3.2, ComSystemTemplateSystemSignalRef=OBDProtocol_req
        OBD_Abs_Pedal_Pos_XIX_OBD_03_XIX_HCP5_CANFD01_ce8f11ec_Rx: ComBitPosition=44, ComBitSize=8, ComSignalEndianness=LITTLE_ENDIAN, ComSignalInitValue=255, ComSignalType=UINT8, ComTimeout=3.2, ComSystemTemplateSystemSignalRef=OBD_Abs_Pedal_Pos
        OBD_Aussen_Temp_gef_XIX_OBD_03_XIX_HCP5_CANFD01_4d95c3af_Rx: ComBitPosition=52, ComBitSize=8, ComSignalDataInvalidValue=255, ComSignalEndianness=LITTLE_ENDIAN, ComSignalInitValue=254, ComSignalType=UINT8, ComTimeout=3.2, ComSystemTemplateSystemSignalRef=OBD_Aussen_Temp_gef
        OBD_Barometric_Pressure_XIX_OBD_04_XIX_HCP5_CANFD01_26455454_Rx: ComBitPosition=56, ComBitSize=8, ComSignalEndianness=LITTLE_ENDIAN, ComSignalInitValue=0, ComSignalType=UINT8, ComTimeout=3.2, ComSystemTemplateSystemSignalRef=OBD_Barometric_Pressure
        OBD_Calc_Load_Val_XIX_OBD_04_XIX_HCP5_CANFD01_8b454e40_Rx: ComBitPosition=12, ComBitSize=8, ComSignalEndianness=LITTLE_ENDIAN, ComSignalInitValue=255, ComSignalType=UINT8, ComTimeout=3.2, ComSystemTemplateSystemSignalRef=OBD_Calc_Load_Val
        OBD_ClearMem_Inhibit_XIX_OBD_04_XIX_HCP5_CANFD01_6714a457_Rx: ComBitPosition=20, ComBitSize=1, ComSignalEndianness=LITTLE_ENDIAN, ComSignalInitValue=0, ComSignalType=UINT8, ComTimeout=3.2, ComSystemTemplateSystemSignalRef=OBD_ClearMem_Inhibit
        OBD_Driving_Cycle_XIX_OBD_03_XIX_HCP5_CANFD01_88844414_Rx: ComBitPosition=61, ComBitSize=1, ComSignalEndianness=LITTLE_ENDIAN, ComSignalInitValue=0, ComSignalType=UINT8, ComTimeout=3.2, ComSystemTemplateSystemSignalRef=OBD_Driving_Cycle
        OBD_Eng_Cool_Temp_XIX_OBD_03_XIX_HCP5_CANFD01_d0429a53_Rx: ComBitPosition=12, ComBitSize=8, ComSignalEndianness=LITTLE_ENDIAN, ComSignalInitValue=255, ComSignalType=UINT8, ComTimeout=3.2, ComSystemTemplateSystemSignalRef=OBD_Eng_Cool_Temp
        OBD_Engine_RPM_XIX_OBD_04_XIX_HCP5_CANFD01_78b10114_Rx: ComBitPosition=40, ComBitSize=16, ComSignalEndianness=LITTLE_ENDIAN, ComSignalInitValue=0, ComSignalType=UINT8, ComTimeout=3.2, ComSystemTemplateSystemSignalRef=OBD_Engine_RPM
        OBD_Kaltstart_Denominator_XIX_OBD_04_XIX_HCP5_CANFD01_6c8e10da_Rx: ComBitPosition=23, ComBitSize=1, ComSignalEndianness=LITTLE_ENDIAN, ComSignalInitValue=0, ComSignalType=UINT8, ComTimeout=3.2, ComSystemTemplateSystemSignalRef=OBD_Kaltstart_Denominator
        OBD_Minimum_Trip_XIX_OBD_03_XIX_HCP5_CANFD01_1da08ec9_Rx: ComBitPosition=60, ComBitSize=1, ComSignalEndianness=LITTLE_ENDIAN, ComSignalInitValue=0, ComSignalType=UINT8, ComTimeout=3.2, ComSystemTemplateSystemSignalRef=OBD_Minimum_Trip
        OBD_Normed_Trip_XIX_OBD_03_XIX_HCP5_CANFD01_aff42920_Rx: ComBitPosition=63, ComBitSize=1, ComSignalEndianness=LITTLE_ENDIAN, ComSignalInitValue=0, ComSignalType=UINT8, ComTimeout=3.2, ComSystemTemplateSystemSignalRef=OBD_Normed_Trip
        OBD_NumDcyMilOnReq_XIX_OBD_04_XIX_HCP5_CANFD01_fc3c8d9d_Rx: ComBitPosition=28, ComBitSize=8, ComSignalEndianness=LITTLE_ENDIAN, ComSignalInitValue=0, ComSignalType=UINT8, ComTimeout=3.2, ComSystemTemplateSystemSignalRef=OBD_NumDcyMilOnReq
        OBD_QBit_Aussen_Temp_XIX_OBD_04_XIX_HCP5_CANFD01_2cf7f3a2_Rx: ComBitPosition=27, ComBitSize=1, ComSignalEndianness=LITTLE_ENDIAN, ComSignalInitValue=1, ComSignalType=UINT8, ComTimeout=3.2, ComSystemTemplateSystemSignalRef=OBD_QBit_Aussen_Temp
        OBD_Sperrung_IUMPR_XIX_OBD_04_XIX_HCP5_CANFD01_d58d72d8_Rx: ComBitPosition=21, ComBitSize=1, ComSignalEndianness=LITTLE_ENDIAN, ComSignalInitValue=0, ComSignalType=UINT8, ComTimeout=3.2, ComSystemTemplateSystemSignalRef=OBD_Sperrung_IUMPR
        OBD_Sperrung_Kaltstart_Denom_XIX_OBD_04_XIX_HCP5_CANFD01_9ec37dc6_Rx: ComBitPosition=22, ComBitSize=1, ComSignalEndianness=LITTLE_ENDIAN, ComSignalInitValue=0, ComSignalType=UINT8, ComTimeout=3.2, ComSystemTemplateSystemSignalRef=OBD_Sperrung_Kaltstart_Denom
        OBD_Typ_XIX_OBD_04_XIX_HCP5_CANFD01_f88154eb_Rx: ComBitPosition=25, ComBitSize=1, ComSignalEndianness=LITTLE_ENDIAN, ComSignalInitValue=0, ComSignalType=UINT8, ComTimeout=3.2, ComSystemTemplateSystemSignalRef=OBD_Typ
        OBD_Warm_Up_Cycle_XIX_OBD_03_XIX_HCP5_CANFD01_eb6d4da0_Rx: ComBitPosition=62, ComBitSize=1, ComSignalEndianness=LITTLE_ENDIAN, ComSignalInitValue=0, ComSignalType=UINT8, ComTimeout=3.2, ComSystemTemplateSystemSignalRef=OBD_Warm_Up_Cycle
        ORU_Status_XIX_ORU_01_XIX_HCP5_CANFD01_ee2b347d_Rx: ComBitPosition=61, ComBitSize=3, ComSignalEndianness=LITTLE_ENDIAN, ComSignalInitValue=0, ComSignalType=UINT8, ComTimeout=5, ComSystemTemplateSystemSignalRef=ORU_Status
        OTP_Aussen_Temp_OBD_XIX_OTP_01_XIX_HCP5_CANFD01_6e627cce_Rx: ComBitPosition=32, ComBitSize=1, ComSignalEndianness=LITTLE_ENDIAN, ComSignalInitValue=1, ComSignalType=UINT8, ComTimeout=2, ComSystemTemplateSystemSignalRef=OTP_Aussen_Temp_OBD
        OTP_Aussen_Temp_ungef_XIX_OTP_01_XIX_HCP5_CANFD01_c0bbb4b6_Rx: ComBitPosition=24, ComBitSize=8, ComSignalDataInvalidValue=255, ComSignalEndianness=LITTLE_ENDIAN, ComSignalInitValue=254, ComSignalType=UINT8, ComTimeout=2, ComSystemTemplateSystemSignalRef=OTP_Aussen_Temp_ungef
        PCM_BMC_VTD_Freeze_Req_XIX_HCP1_17_XIX_HCP5_CANFD01_4dcab581_Rx: ComBitPosition=34, ComBitSize=2, ComSignalDataInvalidValue=3, ComSignalEndianness=LITTLE_ENDIAN, ComSignalInitValue=2, ComSignalType=UINT8, ComTimeout=5, ComSystemTemplateSystemSignalRef=PCM_BMC_VTD_Freeze_Req
        PCM_BMC_VTD_LifeTimeReset_Req_XIX_HCP1_17_XIX_HCP5_CANFD01_b7cc45cb_Rx: ComBitPosition=36, ComBitSize=2, ComSignalDataInvalidValue=3, ComSignalEndianness=LITTLE_ENDIAN, ComSignalInitValue=2, ComSignalType=UINT8, ComTimeout=5, ComSystemTemplateSystemSignalRef=PCM_BMC_VTD_LifeTimeReset_Req
        PCM_BMC_VTD_LifeTimeReset_Resp_XIX_HCP1_17_XIX_HCP5_CANFD01_37f0f42a_Rx: ComBitPosition=38, ComBitSize=2, ComSignalDataInvalidValue=3, ComSignalEndianness=LITTLE_ENDIAN, ComSignalInitValue=2, ComSignalType=UINT8, ComTimeout=5, ComSystemTemplateSystemSignalRef=PCM_BMC_VTD_LifeTimeReset_Resp
        PCM_BMC_VTD_RecentReset_Req_XIX_HCP1_17_XIX_HCP5_CANFD01_6b228b48_Rx: ComBitPosition=40, ComBitSize=2, ComSignalDataInvalidValue=3, ComSignalEndianness=LITTLE_ENDIAN, ComSignalInitValue=2, ComSignalType=UINT8, ComTimeout=5, ComSystemTemplateSystemSignalRef=PCM_BMC_VTD_RecentReset_Req
        SI_NWDF_30_XIX_Systeminfo_01_XIX_HCP5_CANFD01_b3e489e1_Rx: ComBitPosition=31, ComBitSize=1, ComSignalEndianness=LITTLE_ENDIAN, ComSignalInitValue=0, ComSignalType=UINT8, ComTimeout=5, ComSystemTemplateSystemSignalRef=SI_NWDF_30
        SI_NWDF_XIX_Systeminfo_01_XIX_HCP5_CANFD01_5ddebbee_Rx: ComBitPosition=10, ComBitSize=1, ComSignalEndianness=LITTLE_ENDIAN, ComSignalInitValue=0, ComSignalType=UINT8, ComTimeout=5, ComSystemTemplateSystemSignalRef=SI_NWDF
        SI_P_Mode_XIX_Systeminfo_01_XIX_HCP5_CANFD01_171f38d4_Rx: ComBitPosition=15, ComBitSize=1, ComSignalEndianness=LITTLE_ENDIAN, ComSignalInitValue=0, ComSignalType=UINT8, ComTimeout=5, ComSystemTemplateSystemSignalRef=SI_P_Mode
        SI_P_Mode_gueltig_XIX_Systeminfo_01_XIX_HCP5_CANFD01_f5c30274_Rx: ComBitPosition=6, ComBitSize=1, ComSignalEndianness=LITTLE_ENDIAN, ComSignalInitValue=0, ComSignalType=UINT8, ComTimeout=5, ComSystemTemplateSystemSignalRef=SI_P_Mode_gueltig
        SI_T_Mode_XIX_Systeminfo_01_XIX_HCP5_CANFD01_01a376d2_Rx: ComBitPosition=9, ComBitSize=1, ComSignalEndianness=LITTLE_ENDIAN, ComSignalInitValue=0, ComSignalType=UINT8, ComTimeout=5, ComSystemTemplateSystemSignalRef=SI_T_Mode
        SOK_Zeit_Hybrid_01_Challenge_XIX_SOK_Zeit_Hybrid_01_Chal_01_XIX_HCP5_CANFD01_13ac3f94_Tx: ComBitPosition=0, ComSignalEndianness=opaque, ComSignalLength=8, ComSignalType=UINT8_N, ComTransferProperty=TRIGGERED_ON_CHANGE_WITHOUT_REPETITION, ComSystemTemplateSystemSignalRef=SOK_Zeit_Hybrid_01_Challenge
        SOK_Zeit_Hybrid_01_Zeit_XIX_SOK_Zeit_Hybrid_01_Resp_01_XIX_HCP5_CANFD01_41d20ae9_Rx: ComBitPosition=0, ComSignalEndianness=opaque, ComSignalLength=7, ComSignalType=UINT8_N, ComSystemTemplateSystemSignalRef=SOK_Zeit_Hybrid_01_Zeit
        SOK_ungeschuetzte_Zeit_XIX_SOK_NoAuthenticTime_01_XIX_HCP5_CANFD01_d9562906_Rx: ComBitPosition=8, ComSignalEndianness=opaque, ComSignalInitValue=0 0 0 0 0 0 0, ComSignalLength=7, ComSignalType=UINT8_N, ComSystemTemplateSystemSignalRef=SOK_ungeschuetzte_Zeit
        TME_Batt_Kond_Verf_XIX_Thermomanagement_01_XIX_HCP5_CANFD01_ac1763e7_Rx: ComBitPosition=120, ComBitSize=3, ComSignalEndianness=LITTLE_ENDIAN, ComSignalInitValue=0, ComSignalType=UINT8, ComTimeout=1, ComSystemTemplateSystemSignalRef=TME_Batt_Kond_Verf
        TME_Therm_IstLeistung_HVBatterie_XIX_Thermomanagement_01_XIX_HCP5_CANFD01_705b15a6_Rx: ComBitPosition=289, ComBitSize=9, ComSignalDataInvalidValue=511, ComSignalEndianness=LITTLE_ENDIAN, ComSignalInitValue=510, ComSignalType=UINT8, ComTimeout=1, ComSystemTemplateSystemSignalRef=TME_Therm_IstLeistung_HVBatterie
        UH_Jahr_XIX_Diagnose_01_XIX_HCP5_CANFD01_d17ea5cb_Rx: ComBitPosition=28, ComBitSize=7, ComSignalEndianness=LITTLE_ENDIAN, ComSignalInitValue=0, ComSignalType=UINT8, ComTimeout=5, ComSystemTemplateSystemSignalRef=UH_Jahr
        UH_Minute_XIX_Diagnose_01_XIX_HCP5_CANFD01_a1eb26ec_Rx: ComBitPosition=49, ComBitSize=6, ComSignalEndianness=LITTLE_ENDIAN, ComSignalInitValue=0, ComSignalType=UINT8, ComTimeout=5, ComSystemTemplateSystemSignalRef=UH_Minute
        UH_Monat_XIX_Diagnose_01_XIX_HCP5_CANFD01_f93e0419_Rx: ComBitPosition=35, ComBitSize=4, ComSignalDataInvalidValue=15, ComSignalEndianness=LITTLE_ENDIAN, ComSignalInitValue=0, ComSignalType=UINT8, ComTimeout=5, ComSystemTemplateSystemSignalRef=UH_Monat
        UH_Sekunde_XIX_Diagnose_01_XIX_HCP5_CANFD01_7411385f_Rx: ComBitPosition=55, ComBitSize=6, ComSignalEndianness=LITTLE_ENDIAN, ComSignalInitValue=0, ComSignalType=UINT8, ComTimeout=5, ComSystemTemplateSystemSignalRef=UH_Sekunde
        UH_Stunde_XIX_Diagnose_01_XIX_HCP5_CANFD01_7d2acaf0_Rx: ComBitPosition=44, ComBitSize=5, ComSignalEndianness=LITTLE_ENDIAN, ComSignalInitValue=0, ComSignalType=UINT8, ComTimeout=5, ComSystemTemplateSystemSignalRef=UH_Stunde
        UH_Tag_XIX_Diagnose_01_XIX_HCP5_CANFD01_743028a3_Rx: ComBitPosition=39, ComBitSize=5, ComSignalEndianness=LITTLE_ENDIAN, ComSignalInitValue=0, ComSignalType=UINT8, ComTimeout=5, ComSystemTemplateSystemSignalRef=UH_Tag
        UI1_Iso_Neg_XIX_UI1_05_XIX_BMC_CAN01_4b0788a9_Rx: ComBitPosition=48, ComBitSize=16, ComSignalDataInvalidValue=65535, ComSignalEndianness=LITTLE_ENDIAN, ComSignalInitValue=65534, ComSignalType=UINT8, ComTimeout=1, ComSystemTemplateSystemSignalRef=UI1_Iso_Neg
        UI1_Iso_Pos_XIX_UI1_05_XIX_BMC_CAN01_c7179271_Rx: ComBitPosition=32, ComBitSize=16, ComSignalDataInvalidValue=65535, ComSignalEndianness=LITTLE_ENDIAN, ComSignalInitValue=65534, ComSignalType=UINT8, ComTimeout=1, ComSystemTemplateSystemSignalRef=UI1_Iso_Pos
        UI1_Iso_Status_XIX_UI1_05_XIX_BMC_CAN01_a67d930e_Rx: ComBitPosition=29, ComBitSize=3, ComSignalDataInvalidValue=1, ComSignalEndianness=LITTLE_ENDIAN, ComSignalInitValue=0, ComSignalType=UINT8, ComTimeout=1, ComSystemTemplateSystemSignalRef=UI1_Iso_Status
        UI1_KompFehlerModus2_01_XIX_UI1_Komponentenfehler_01_XIX_BMC_CAN01_34b9d7af_Rx: ComBitPosition=12, ComBitSize=2, ComSignalEndianness=LITTLE_ENDIAN, ComSignalInitValue=0, ComSignalType=UINT8, ComTimeout=1, ComSystemTemplateSystemSignalRef=UI1_KompFehlerModus2_01
        UI1_KompFehlerModus2_02_XIX_UI1_Komponentenfehler_01_XIX_BMC_CAN01_4ac19f09_Rx: ComBitPosition=14, ComBitSize=2, ComSignalEndianness=LITTLE_ENDIAN, ComSignalInitValue=0, ComSignalType=UINT8, ComTimeout=1, ComSystemTemplateSystemSignalRef=UI1_KompFehlerModus2_02
        UI1_KompFehlerModus2_03_XIX_UI1_Komponentenfehler_01_XIX_BMC_CAN01_60e9a76b_Rx: ComBitPosition=16, ComBitSize=2, ComSignalEndianness=LITTLE_ENDIAN, ComSignalInitValue=0, ComSignalType=UINT8, ComTimeout=1, ComSystemTemplateSystemSignalRef=UI1_KompFehlerModus2_03
        UI1_KompFehlerModus2_04_XIX_UI1_Komponentenfehler_01_XIX_BMC_CAN01_b6310e45_Rx: ComBitPosition=18, ComBitSize=2, ComSignalEndianness=LITTLE_ENDIAN, ComSignalInitValue=0, ComSignalType=UINT8, ComTimeout=1, ComSystemTemplateSystemSignalRef=UI1_KompFehlerModus2_04
        UI1_KompFehlerModus2_05_XIX_UI1_Komponentenfehler_01_XIX_BMC_CAN01_9c193627_Rx: ComBitPosition=20, ComBitSize=2, ComSignalEndianness=LITTLE_ENDIAN, ComSignalInitValue=0, ComSignalType=UINT8, ComTimeout=1, ComSystemTemplateSystemSignalRef=UI1_KompFehlerModus2_05
        UI1_KompFehlerModus2_06_XIX_UI1_Komponentenfehler_01_XIX_BMC_CAN01_e2617e81_Rx: ComBitPosition=22, ComBitSize=2, ComSignalEndianness=LITTLE_ENDIAN, ComSignalInitValue=0, ComSignalType=UINT8, ComTimeout=1, ComSystemTemplateSystemSignalRef=UI1_KompFehlerModus2_06
        UI1_KompFehlerModus2_07_XIX_UI1_Komponentenfehler_01_XIX_BMC_CAN01_c84946e3_Rx: ComBitPosition=24, ComBitSize=2, ComSignalEndianness=LITTLE_ENDIAN, ComSignalInitValue=0, ComSignalType=UINT8, ComTimeout=1, ComSystemTemplateSystemSignalRef=UI1_KompFehlerModus2_07
        UI1_KompFehlerModus2_08_XIX_UI1_Komponentenfehler_01_XIX_BMC_CAN01_94a12a9c_Rx: ComBitPosition=26, ComBitSize=2, ComSignalEndianness=LITTLE_ENDIAN, ComSignalInitValue=0, ComSignalType=UINT8, ComTimeout=1, ComSystemTemplateSystemSignalRef=UI1_KompFehlerModus2_08
        UI1_KompFehlerModus2_09_XIX_UI1_Komponentenfehler_01_XIX_BMC_CAN01_be8912fe_Rx: ComBitPosition=28, ComBitSize=2, ComSignalEndianness=LITTLE_ENDIAN, ComSignalInitValue=0, ComSignalType=UINT8, ComTimeout=1, ComSystemTemplateSystemSignalRef=UI1_KompFehlerModus2_09
        UI1_KompFehlerModus2_10_XIX_UI1_Komponentenfehler_01_XIX_BMC_CAN01_bd07c781_Rx: ComBitPosition=30, ComBitSize=2, ComSignalEndianness=LITTLE_ENDIAN, ComSignalInitValue=0, ComSignalType=UINT8, ComTimeout=1, ComSystemTemplateSystemSignalRef=UI1_KompFehlerModus2_10
        UI1_KompFehlerModus2_11_XIX_UI1_Komponentenfehler_01_XIX_BMC_CAN01_972fffe3_Rx: ComBitPosition=32, ComBitSize=2, ComSignalEndianness=LITTLE_ENDIAN, ComSignalInitValue=0, ComSignalType=UINT8, ComTimeout=1, ComSystemTemplateSystemSignalRef=UI1_KompFehlerModus2_11
        UI1_KompFehlerModus2_12_XIX_UI1_Komponentenfehler_01_XIX_BMC_CAN01_e957b745_Rx: ComBitPosition=34, ComBitSize=2, ComSignalEndianness=LITTLE_ENDIAN, ComSignalInitValue=0, ComSignalType=UINT8, ComTimeout=1, ComSystemTemplateSystemSignalRef=UI1_KompFehlerModus2_12
        UI1_KompFehlerModus2_13_XIX_UI1_Komponentenfehler_01_XIX_BMC_CAN01_c37f8f27_Rx: ComBitPosition=36, ComBitSize=2, ComSignalEndianness=LITTLE_ENDIAN, ComSignalInitValue=0, ComSignalType=UINT8, ComTimeout=1, ComSystemTemplateSystemSignalRef=UI1_KompFehlerModus2_13
        UI1_KompFehlerModus2_14_XIX_UI1_Komponentenfehler_01_XIX_BMC_CAN01_15a72609_Rx: ComBitPosition=38, ComBitSize=2, ComSignalEndianness=LITTLE_ENDIAN, ComSignalInitValue=0, ComSignalType=UINT8, ComTimeout=1, ComSystemTemplateSystemSignalRef=UI1_KompFehlerModus2_14
        UI1_KompFehlerModus2_15_XIX_UI1_Komponentenfehler_01_XIX_BMC_CAN01_3f8f1e6b_Rx: ComBitPosition=40, ComBitSize=2, ComSignalEndianness=LITTLE_ENDIAN, ComSignalInitValue=0, ComSignalType=UINT8, ComTimeout=1, ComSystemTemplateSystemSignalRef=UI1_KompFehlerModus2_15
        UI1_KompFehlerModus2_16_XIX_UI1_Komponentenfehler_01_XIX_BMC_CAN01_41f756cd_Rx: ComBitPosition=42, ComBitSize=2, ComSignalEndianness=LITTLE_ENDIAN, ComSignalInitValue=0, ComSignalType=UINT8, ComTimeout=1, ComSystemTemplateSystemSignalRef=UI1_KompFehlerModus2_16
        UI1_KompFehlerModus2_17_XIX_UI1_Komponentenfehler_01_XIX_BMC_CAN01_6bdf6eaf_Rx: ComBitPosition=44, ComBitSize=2, ComSignalEndianness=LITTLE_ENDIAN, ComSignalInitValue=0, ComSignalType=UINT8, ComTimeout=1, ComSystemTemplateSystemSignalRef=UI1_KompFehlerModus2_17
        UI1_KompFehlerModus2_18_XIX_UI1_Komponentenfehler_01_XIX_BMC_CAN01_373702d0_Rx: ComBitPosition=46, ComBitSize=2, ComSignalEndianness=LITTLE_ENDIAN, ComSignalInitValue=0, ComSignalType=UINT8, ComTimeout=1, ComSystemTemplateSystemSignalRef=UI1_KompFehlerModus2_18
        UI1_KompFehlerModus2_19_XIX_UI1_Komponentenfehler_01_XIX_BMC_CAN01_1d1f3ab2_Rx: ComBitPosition=48, ComBitSize=2, ComSignalEndianness=LITTLE_ENDIAN, ComSignalInitValue=0, ComSignalType=UINT8, ComTimeout=1, ComSystemTemplateSystemSignalRef=UI1_KompFehlerModus2_19
        UI1_KompFehlerModus2_20_XIX_UI1_Komponentenfehler_01_XIX_BMC_CAN01_82ccb914_Rx: ComBitPosition=50, ComBitSize=2, ComSignalEndianness=LITTLE_ENDIAN, ComSignalInitValue=0, ComSignalType=UINT8, ComTimeout=1, ComSystemTemplateSystemSignalRef=UI1_KompFehlerModus2_20
        UI1_KompFehlerModus2_21_XIX_UI1_Komponentenfehler_01_XIX_BMC_CAN01_a8e48176_Rx: ComBitPosition=52, ComBitSize=2, ComSignalEndianness=LITTLE_ENDIAN, ComSignalInitValue=0, ComSignalType=UINT8, ComTimeout=1, ComSystemTemplateSystemSignalRef=UI1_KompFehlerModus2_21
        UI1_KompFehlerModus2_22_XIX_UI1_Komponentenfehler_01_XIX_BMC_CAN01_d69cc9d0_Rx: ComBitPosition=54, ComBitSize=2, ComSignalEndianness=LITTLE_ENDIAN, ComSignalInitValue=0, ComSignalType=UINT8, ComTimeout=1, ComSystemTemplateSystemSignalRef=UI1_KompFehlerModus2_22
        UI1_KompFehlerModus2_23_XIX_UI1_Komponentenfehler_01_XIX_BMC_CAN01_fcb4f1b2_Rx: ComBitPosition=56, ComBitSize=2, ComSignalEndianness=LITTLE_ENDIAN, ComSignalInitValue=0, ComSignalType=UINT8, ComTimeout=1, ComSystemTemplateSystemSignalRef=UI1_KompFehlerModus2_23
        UI1_KompFehlerModus2_24_XIX_UI1_Komponentenfehler_01_XIX_BMC_CAN01_2a6c589c_Rx: ComBitPosition=58, ComBitSize=2, ComSignalEndianness=LITTLE_ENDIAN, ComSignalInitValue=0, ComSignalType=UINT8, ComTimeout=1, ComSystemTemplateSystemSignalRef=UI1_KompFehlerModus2_24
        UI1_KompFehlerModus2_25_XIX_UI1_Komponentenfehler_01_XIX_BMC_CAN01_004460fe_Rx: ComBitPosition=60, ComBitSize=2, ComSignalEndianness=LITTLE_ENDIAN, ComSignalInitValue=0, ComSignalType=UINT8, ComTimeout=1, ComSystemTemplateSystemSignalRef=UI1_KompFehlerModus2_25
        UI1_KompFehlerModus2_26_XIX_UI1_Komponentenfehler_01_XIX_BMC_CAN01_7e3c2858_Rx: ComBitPosition=62, ComBitSize=2, ComSignalEndianness=LITTLE_ENDIAN, ComSignalInitValue=0, ComSignalType=UINT8, ComTimeout=1, ComSystemTemplateSystemSignalRef=UI1_KompFehlerModus2_26
        UI1_KompFehlerModus4_01_XIX_UI1_Komponentenfehler_02_XIX_BMC_CAN01_89a380c9_Rx: ComBitPosition=12, ComBitSize=3, ComSignalEndianness=LITTLE_ENDIAN, ComSignalInitValue=0, ComSignalType=UINT8, ComTimeout=1, ComSystemTemplateSystemSignalRef=UI1_KompFehlerModus4_01
        UI1_KompFehlerModus4_02_XIX_UI1_Komponentenfehler_02_XIX_BMC_CAN01_f7dbc86f_Rx: ComBitPosition=15, ComBitSize=3, ComSignalEndianness=LITTLE_ENDIAN, ComSignalInitValue=0, ComSignalType=UINT8, ComTimeout=1, ComSystemTemplateSystemSignalRef=UI1_KompFehlerModus4_02
        UI1_KompFehlerModus4_03_XIX_UI1_Komponentenfehler_02_XIX_BMC_CAN01_ddf3f00d_Rx: ComBitPosition=18, ComBitSize=3, ComSignalEndianness=LITTLE_ENDIAN, ComSignalInitValue=0, ComSignalType=UINT8, ComTimeout=1, ComSystemTemplateSystemSignalRef=UI1_KompFehlerModus4_03
        UI1_KompFehlerModus4_04_XIX_UI1_Komponentenfehler_02_XIX_BMC_CAN01_0b2b5923_Rx: ComBitPosition=21, ComBitSize=3, ComSignalEndianness=LITTLE_ENDIAN, ComSignalInitValue=0, ComSignalType=UINT8, ComTimeout=1, ComSystemTemplateSystemSignalRef=UI1_KompFehlerModus4_04
        UI1_KompFehlerModus4_05_XIX_UI1_Komponentenfehler_02_XIX_BMC_CAN01_21036141_Rx: ComBitPosition=24, ComBitSize=3, ComSignalEndianness=LITTLE_ENDIAN, ComSignalInitValue=0, ComSignalType=UINT8, ComTimeout=1, ComSystemTemplateSystemSignalRef=UI1_KompFehlerModus4_05
        UI1_KompFehlerModus4_06_XIX_UI1_Komponentenfehler_02_XIX_BMC_CAN01_5f7b29e7_Rx: ComBitPosition=27, ComBitSize=3, ComSignalEndianness=LITTLE_ENDIAN, ComSignalInitValue=0, ComSignalType=UINT8, ComTimeout=1, ComSystemTemplateSystemSignalRef=UI1_KompFehlerModus4_06
        UI1_KompFehlerModus4_07_XIX_UI1_Komponentenfehler_02_XIX_BMC_CAN01_75531185_Rx: ComBitPosition=30, ComBitSize=3, ComSignalEndianness=LITTLE_ENDIAN, ComSignalInitValue=0, ComSignalType=UINT8, ComTimeout=1, ComSystemTemplateSystemSignalRef=UI1_KompFehlerModus4_07
        UI1_KompFehlerModus4_08_XIX_UI1_Komponentenfehler_02_XIX_BMC_CAN01_29bb7dfa_Rx: ComBitPosition=33, ComBitSize=3, ComSignalEndianness=LITTLE_ENDIAN, ComSignalInitValue=0, ComSignalType=UINT8, ComTimeout=1, ComSystemTemplateSystemSignalRef=UI1_KompFehlerModus4_08
        UI1_KompFehlerModus4_09_XIX_UI1_Komponentenfehler_02_XIX_BMC_CAN01_03934598_Rx: ComBitPosition=36, ComBitSize=3, ComSignalEndianness=LITTLE_ENDIAN, ComSignalInitValue=0, ComSignalType=UINT8, ComTimeout=1, ComSystemTemplateSystemSignalRef=UI1_KompFehlerModus4_09
        UI1_KompFehlerModus4_10_XIX_UI1_Komponentenfehler_02_XIX_BMC_CAN01_001d90e7_Rx: ComBitPosition=39, ComBitSize=3, ComSignalEndianness=LITTLE_ENDIAN, ComSignalInitValue=0, ComSignalType=UINT8, ComTimeout=1, ComSystemTemplateSystemSignalRef=UI1_KompFehlerModus4_10
        UI1_KompFehlerModus4_11_XIX_UI1_Komponentenfehler_02_XIX_BMC_CAN01_2a35a885_Rx: ComBitPosition=42, ComBitSize=3, ComSignalEndianness=LITTLE_ENDIAN, ComSignalInitValue=0, ComSignalType=UINT8, ComTimeout=1, ComSystemTemplateSystemSignalRef=UI1_KompFehlerModus4_11
        UI1_KompFehlerModus4_12_XIX_UI1_Komponentenfehler_02_XIX_BMC_CAN01_544de023_Rx: ComBitPosition=45, ComBitSize=3, ComSignalEndianness=LITTLE_ENDIAN, ComSignalInitValue=0, ComSignalType=UINT8, ComTimeout=1, ComSystemTemplateSystemSignalRef=UI1_KompFehlerModus4_12
        UI1_KompFehlerModus4_13_XIX_UI1_Komponentenfehler_02_XIX_BMC_CAN01_7e65d841_Rx: ComBitPosition=48, ComBitSize=3, ComSignalEndianness=LITTLE_ENDIAN, ComSignalInitValue=0, ComSignalType=UINT8, ComTimeout=1, ComSystemTemplateSystemSignalRef=UI1_KompFehlerModus4_13
        UI1_KompFehlerModus4_14_XIX_UI1_Komponentenfehler_02_XIX_BMC_CAN01_a8bd716f_Rx: ComBitPosition=51, ComBitSize=3, ComSignalEndianness=LITTLE_ENDIAN, ComSignalInitValue=0, ComSignalType=UINT8, ComTimeout=1, ComSystemTemplateSystemSignalRef=UI1_KompFehlerModus4_14
        UI1_KompFehlerModus4_15_XIX_UI1_Komponentenfehler_02_XIX_BMC_CAN01_8295490d_Rx: ComBitPosition=54, ComBitSize=3, ComSignalEndianness=LITTLE_ENDIAN, ComSignalInitValue=0, ComSignalType=UINT8, ComTimeout=1, ComSystemTemplateSystemSignalRef=UI1_KompFehlerModus4_15
        UI1_KompFehlerModus4_16_XIX_UI1_Komponentenfehler_02_XIX_BMC_CAN01_fced01ab_Rx: ComBitPosition=57, ComBitSize=3, ComSignalEndianness=LITTLE_ENDIAN, ComSignalInitValue=0, ComSignalType=UINT8, ComTimeout=1, ComSystemTemplateSystemSignalRef=UI1_KompFehlerModus4_16
        UI1_Spannung4_XIX_UI1_03_XIX_BMC_CAN01_25f2e1ca_Rx: ComBitPosition=12, ComBitSize=15, ComSignalDataInvalidValue=32767, ComSignalEndianness=LITTLE_ENDIAN, ComSignalInitValue=32766, ComSignalType=UINT8, ComTimeout=0.5, ComSystemTemplateSystemSignalRef=UI1_Spannung4
        UI1_Spannung5_XIX_UI1_03_XIX_BMC_CAN01_c2ef475d_Rx: ComBitPosition=27, ComBitSize=15, ComSignalDataInvalidValue=32767, ComSignalEndianness=LITTLE_ENDIAN, ComSignalInitValue=32766, ComSignalType=UINT8, ComTimeout=0.5, ComSystemTemplateSystemSignalRef=UI1_Spannung5
        UI1_Spannung6_XIX_UI1_03_XIX_BMC_CAN01_30b8aaa5_Rx: ComBitPosition=42, ComBitSize=15, ComSignalDataInvalidValue=32767, ComSignalEndianness=LITTLE_ENDIAN, ComSignalInitValue=32766, ComSignalType=UINT8, ComTimeout=0.5, ComSystemTemplateSystemSignalRef=UI1_Spannung6
        UI1_Status_XIX_UI1_04_XIX_BMC_CAN01_abb6019e_Rx: ComBitPosition=15, ComBitSize=1, ComSignalEndianness=LITTLE_ENDIAN, ComSignalInitValue=0, ComSignalType=UINT8, ComTimeout=1, ComSystemTemplateSystemSignalRef=UI1_Status
        UI1_Stromintegral_Entladen_XIX_UI1_04_XIX_BMC_CAN01_550f36e6_Rx: ComBitPosition=48, ComBitSize=16, ComSignalDataInvalidValue=65535, ComSignalEndianness=LITTLE_ENDIAN, ComSignalInitValue=65534, ComSignalType=UINT8, ComTimeout=1, ComSystemTemplateSystemSignalRef=UI1_Stromintegral_Entladen
        UI1_Stromintegral_Laden_XIX_UI1_04_XIX_BMC_CAN01_6b336e8e_Rx: ComBitPosition=32, ComBitSize=16, ComSignalDataInvalidValue=65535, ComSignalEndianness=LITTLE_ENDIAN, ComSignalInitValue=65534, ComSignalType=UINT8, ComTimeout=1, ComSystemTemplateSystemSignalRef=UI1_Stromintegral_Laden
        UI1_Temperatur_1_XIX_UI1_04_XIX_BMC_CAN01_ee4849f8_Rx: ComBitPosition=24, ComBitSize=8, ComSignalDataInvalidValue=255, ComSignalEndianness=LITTLE_ENDIAN, ComSignalInitValue=254, ComSignalType=UINT8, ComTimeout=1, ComSystemTemplateSystemSignalRef=UI1_Temperatur_1
        UI1_Temperatur_2_XIX_UI1_04_XIX_BMC_CAN01_1c1fa400_Rx: ComBitPosition=16, ComBitSize=8, ComSignalDataInvalidValue=255, ComSignalEndianness=LITTLE_ENDIAN, ComSignalInitValue=254, ComSignalType=UINT8, ComTimeout=1, ComSystemTemplateSystemSignalRef=UI1_Temperatur_2
        UI2Sens01_CALID_Index_01_XIX_UI2Sens01_CALID_01_XIX_BMC_CAN01_70cabfee_Rx: ComBitPosition=0, ComBitSize=8, ComSignalEndianness=LITTLE_ENDIAN, ComSignalInitValue=63, ComSignalType=UINT8, ComTimeout=5, ComSystemTemplateSystemSignalRef=UI2Sens01_CALID_Index_01
        UI2Sens01_CALID_Index_02_XIX_UI2Sens01_CALID_01_XIX_BMC_CAN01_3d22bf89_Rx: ComBitPosition=8, ComBitSize=8, ComSignalEndianness=LITTLE_ENDIAN, ComSignalInitValue=63, ComSignalType=UINT8, ComTimeout=5, ComSystemTemplateSystemSignalRef=UI2Sens01_CALID_Index_02
        UI2Sens01_CALID_Index_03_XIX_UI2Sens01_CALID_01_XIX_BMC_CAN01_b0aa426b_Rx: ComBitPosition=16, ComBitSize=8, ComSignalEndianness=LITTLE_ENDIAN, ComSignalInitValue=63, ComSignalType=UINT8, ComTimeout=5, ComSystemTemplateSystemSignalRef=UI2Sens01_CALID_Index_03
        UI2Sens01_CALID_Index_04_XIX_UI2Sens01_CALID_01_XIX_BMC_CAN01_a6f2bf47_Rx: ComBitPosition=24, ComBitSize=8, ComSignalEndianness=LITTLE_ENDIAN, ComSignalInitValue=63, ComSignalType=UINT8, ComTimeout=5, ComSystemTemplateSystemSignalRef=UI2Sens01_CALID_Index_04
        UI2Sens01_CALID_Index_05_XIX_UI2Sens01_CALID_01_XIX_BMC_CAN01_2b7a42a5_Rx: ComBitPosition=32, ComBitSize=8, ComSignalEndianness=LITTLE_ENDIAN, ComSignalInitValue=63, ComSignalType=UINT8, ComTimeout=5, ComSystemTemplateSystemSignalRef=UI2Sens01_CALID_Index_05
        UI2Sens01_CALID_Index_06_XIX_UI2Sens01_CALID_01_XIX_BMC_CAN01_669242c2_Rx: ComBitPosition=40, ComBitSize=8, ComSignalEndianness=LITTLE_ENDIAN, ComSignalInitValue=63, ComSignalType=UINT8, ComTimeout=5, ComSystemTemplateSystemSignalRef=UI2Sens01_CALID_Index_06
        UI2Sens01_CALID_Index_07_XIX_UI2Sens01_CALID_01_XIX_BMC_CAN01_eb1abf20_Rx: ComBitPosition=48, ComBitSize=8, ComSignalEndianness=LITTLE_ENDIAN, ComSignalInitValue=63, ComSignalType=UINT8, ComTimeout=5, ComSystemTemplateSystemSignalRef=UI2Sens01_CALID_Index_07
        UI2Sens01_CALID_Index_08_XIX_UI2Sens01_CALID_01_XIX_BMC_CAN01_4a23b89a_Rx: ComBitPosition=56, ComBitSize=8, ComSignalEndianness=LITTLE_ENDIAN, ComSignalInitValue=63, ComSignalType=UINT8, ComTimeout=5, ComSystemTemplateSystemSignalRef=UI2Sens01_CALID_Index_08
        UI2Sens01_CALID_Index_09_XIX_UI2Sens01_CALID_02_XIX_BMC_CAN01_d6d62f01_Rx: ComBitPosition=0, ComBitSize=8, ComSignalEndianness=LITTLE_ENDIAN, ComSignalInitValue=63, ComSignalType=UINT8, ComTimeout=5, ComSystemTemplateSystemSignalRef=UI2Sens01_CALID_Index_09
        UI2Sens01_CALID_Index_10_XIX_UI2Sens01_CALID_02_XIX_BMC_CAN01_a2b623dc_Rx: ComBitPosition=8, ComBitSize=8, ComSignalEndianness=LITTLE_ENDIAN, ComSignalInitValue=63, ComSignalType=UINT8, ComTimeout=5, ComSystemTemplateSystemSignalRef=UI2Sens01_CALID_Index_10
        UI2Sens01_CALID_Index_11_XIX_UI2Sens01_CALID_02_XIX_BMC_CAN01_2f3ede3e_Rx: ComBitPosition=16, ComBitSize=8, ComSignalEndianness=LITTLE_ENDIAN, ComSignalInitValue=63, ComSignalType=UINT8, ComTimeout=5, ComSystemTemplateSystemSignalRef=UI2Sens01_CALID_Index_11
        UI2Sens01_CALID_Index_12_XIX_UI2Sens01_CALID_02_XIX_BMC_CAN01_62d6de59_Rx: ComBitPosition=24, ComBitSize=8, ComSignalEndianness=LITTLE_ENDIAN, ComSignalInitValue=63, ComSignalType=UINT8, ComTimeout=5, ComSystemTemplateSystemSignalRef=UI2Sens01_CALID_Index_12
        UI2Sens01_CALID_Index_13_XIX_UI2Sens01_CALID_02_XIX_BMC_CAN01_ef5e23bb_Rx: ComBitPosition=32, ComBitSize=8, ComSignalEndianness=LITTLE_ENDIAN, ComSignalInitValue=63, ComSignalType=UINT8, ComTimeout=5, ComSystemTemplateSystemSignalRef=UI2Sens01_CALID_Index_13
        UI2Sens01_CALID_Index_14_XIX_UI2Sens01_CALID_02_XIX_BMC_CAN01_f906de97_Rx: ComBitPosition=40, ComBitSize=8, ComSignalEndianness=LITTLE_ENDIAN, ComSignalInitValue=63, ComSignalType=UINT8, ComTimeout=5, ComSystemTemplateSystemSignalRef=UI2Sens01_CALID_Index_14
        UI2Sens01_CALID_Index_15_XIX_UI2Sens01_CALID_02_XIX_BMC_CAN01_748e2375_Rx: ComBitPosition=48, ComBitSize=8, ComSignalEndianness=LITTLE_ENDIAN, ComSignalInitValue=63, ComSignalType=UINT8, ComTimeout=5, ComSystemTemplateSystemSignalRef=UI2Sens01_CALID_Index_15
        UI2Sens01_CALID_Index_16_XIX_UI2Sens01_CALID_02_XIX_BMC_CAN01_39662312_Rx: ComBitPosition=56, ComBitSize=8, ComSignalEndianness=LITTLE_ENDIAN, ComSignalInitValue=63, ComSignalType=UINT8, ComTimeout=5, ComSystemTemplateSystemSignalRef=UI2Sens01_CALID_Index_16
        UI2Sens01_CVN_Byte_1_XIX_UI2Sens01_CVN_XIX_BMC_CAN01_0510ee62_Rx: ComBitPosition=1, ComBitSize=8, ComSignalEndianness=LITTLE_ENDIAN, ComSignalInitValue=0, ComSignalType=UINT8, ComTimeout=5, ComSystemTemplateSystemSignalRef=UI2Sens01_CVN_Byte_1
        UI2Sens01_CVN_Byte_2_XIX_UI2Sens01_CVN_XIX_BMC_CAN01_5e075f77_Rx: ComBitPosition=9, ComBitSize=8, ComSignalEndianness=LITTLE_ENDIAN, ComSignalInitValue=0, ComSignalType=UINT8, ComTimeout=5, ComSystemTemplateSystemSignalRef=UI2Sens01_CVN_Byte_2
        UI2Sens01_CVN_Byte_3_XIX_UI2Sens01_CVN_XIX_BMC_CAN01_68f5cf84_Rx: ComBitPosition=17, ComBitSize=8, ComSignalEndianness=LITTLE_ENDIAN, ComSignalInitValue=0, ComSignalType=UINT8, ComTimeout=5, ComSystemTemplateSystemSignalRef=UI2Sens01_CVN_Byte_3
        UI2Sens01_CVN_Byte_4_XIX_UI2Sens01_CVN_XIX_BMC_CAN01_e8283d5d_Rx: ComBitPosition=25, ComBitSize=8, ComSignalEndianness=LITTLE_ENDIAN, ComSignalInitValue=0, ComSignalType=UINT8, ComTimeout=5, ComSystemTemplateSystemSignalRef=UI2Sens01_CVN_Byte_4
        UI2Sens01_CVN_VLD_XIX_UI2Sens01_CVN_XIX_BMC_CAN01_56f8ef91_Rx: ComBitPosition=0, ComBitSize=1, ComSignalEndianness=LITTLE_ENDIAN, ComSignalInitValue=0, ComSignalType=UINT8, ComTimeout=5, ComSystemTemplateSystemSignalRef=UI2Sens01_CVN_VLD
        UI2Sens01_ErrMem_State_XIX_UI1_04_XIX_BMC_CAN01_2781c1ec_Rx: ComBitPosition=13, ComBitSize=2, ComSignalEndianness=LITTLE_ENDIAN, ComSignalInitValue=2, ComSignalType=UINT8, ComTimeout=1, ComSystemTemplateSystemSignalRef=UI2Sens01_ErrMem_State
        UI2Sens02_CALID_Index_01_XIX_UI2Sens02_CALID_01_XIX_BMC_CAN01_abbdc605_Rx: ComBitPosition=0, ComBitSize=8, ComSignalEndianness=LITTLE_ENDIAN, ComSignalInitValue=63, ComSignalType=UINT8, ComTimeout=5, ComSystemTemplateSystemSignalRef=UI2Sens02_CALID_Index_01
        UI2Sens02_CALID_Index_02_XIX_UI2Sens02_CALID_01_XIX_BMC_CAN01_e655c662_Rx: ComBitPosition=8, ComBitSize=8, ComSignalEndianness=LITTLE_ENDIAN, ComSignalInitValue=63, ComSignalType=UINT8, ComTimeout=5, ComSystemTemplateSystemSignalRef=UI2Sens02_CALID_Index_02
        UI2Sens02_CALID_Index_03_XIX_UI2Sens02_CALID_01_XIX_BMC_CAN01_6bdd3b80_Rx: ComBitPosition=16, ComBitSize=8, ComSignalEndianness=LITTLE_ENDIAN, ComSignalInitValue=63, ComSignalType=UINT8, ComTimeout=5, ComSystemTemplateSystemSignalRef=UI2Sens02_CALID_Index_03
        UI2Sens02_CALID_Index_04_XIX_UI2Sens02_CALID_01_XIX_BMC_CAN01_7d85c6ac_Rx: ComBitPosition=24, ComBitSize=8, ComSignalEndianness=LITTLE_ENDIAN, ComSignalInitValue=63, ComSignalType=UINT8, ComTimeout=5, ComSystemTemplateSystemSignalRef=UI2Sens02_CALID_Index_04
        UI2Sens02_CALID_Index_05_XIX_UI2Sens02_CALID_01_XIX_BMC_CAN01_f00d3b4e_Rx: ComBitPosition=32, ComBitSize=8, ComSignalEndianness=LITTLE_ENDIAN, ComSignalInitValue=63, ComSignalType=UINT8, ComTimeout=5, ComSystemTemplateSystemSignalRef=UI2Sens02_CALID_Index_05
        UI2Sens02_CALID_Index_06_XIX_UI2Sens02_CALID_01_XIX_BMC_CAN01_bde53b29_Rx: ComBitPosition=40, ComBitSize=8, ComSignalEndianness=LITTLE_ENDIAN, ComSignalInitValue=63, ComSignalType=UINT8, ComTimeout=5, ComSystemTemplateSystemSignalRef=UI2Sens02_CALID_Index_06
        UI2Sens02_CALID_Index_07_XIX_UI2Sens02_CALID_01_XIX_BMC_CAN01_306dc6cb_Rx: ComBitPosition=48, ComBitSize=8, ComSignalEndianness=LITTLE_ENDIAN, ComSignalInitValue=63, ComSignalType=UINT8, ComTimeout=5, ComSystemTemplateSystemSignalRef=UI2Sens02_CALID_Index_07
        UI2Sens02_CALID_Index_08_XIX_UI2Sens02_CALID_01_XIX_BMC_CAN01_9154c171_Rx: ComBitPosition=56, ComBitSize=8, ComSignalEndianness=LITTLE_ENDIAN, ComSignalInitValue=63, ComSignalType=UINT8, ComTimeout=5, ComSystemTemplateSystemSignalRef=UI2Sens02_CALID_Index_08
        UI2Sens02_CALID_Index_09_XIX_UI2Sens02_CALID_02_XIX_BMC_CAN01_0da156ea_Rx: ComBitPosition=0, ComBitSize=8, ComSignalEndianness=LITTLE_ENDIAN, ComSignalInitValue=63, ComSignalType=UINT8, ComTimeout=5, ComSystemTemplateSystemSignalRef=UI2Sens02_CALID_Index_09
        UI2Sens02_CALID_Index_10_XIX_UI2Sens02_CALID_02_XIX_BMC_CAN01_79c15a37_Rx: ComBitPosition=8, ComBitSize=8, ComSignalEndianness=LITTLE_ENDIAN, ComSignalInitValue=63, ComSignalType=UINT8, ComTimeout=5, ComSystemTemplateSystemSignalRef=UI2Sens02_CALID_Index_10
        UI2Sens02_CALID_Index_11_XIX_UI2Sens02_CALID_02_XIX_BMC_CAN01_f449a7d5_Rx: ComBitPosition=16, ComBitSize=8, ComSignalEndianness=LITTLE_ENDIAN, ComSignalInitValue=63, ComSignalType=UINT8, ComTimeout=5, ComSystemTemplateSystemSignalRef=UI2Sens02_CALID_Index_11
        UI2Sens02_CALID_Index_12_XIX_UI2Sens02_CALID_02_XIX_BMC_CAN01_b9a1a7b2_Rx: ComBitPosition=24, ComBitSize=8, ComSignalEndianness=LITTLE_ENDIAN, ComSignalInitValue=63, ComSignalType=UINT8, ComTimeout=5, ComSystemTemplateSystemSignalRef=UI2Sens02_CALID_Index_12
        UI2Sens02_CALID_Index_13_XIX_UI2Sens02_CALID_02_XIX_BMC_CAN01_34295a50_Rx: ComBitPosition=32, ComBitSize=8, ComSignalEndianness=LITTLE_ENDIAN, ComSignalInitValue=63, ComSignalType=UINT8, ComTimeout=5, ComSystemTemplateSystemSignalRef=UI2Sens02_CALID_Index_13
        UI2Sens02_CALID_Index_14_XIX_UI2Sens02_CALID_02_XIX_BMC_CAN01_2271a77c_Rx: ComBitPosition=40, ComBitSize=8, ComSignalEndianness=LITTLE_ENDIAN, ComSignalInitValue=63, ComSignalType=UINT8, ComTimeout=5, ComSystemTemplateSystemSignalRef=UI2Sens02_CALID_Index_14
        UI2Sens02_CALID_Index_15_XIX_UI2Sens02_CALID_02_XIX_BMC_CAN01_aff95a9e_Rx: ComBitPosition=48, ComBitSize=8, ComSignalEndianness=LITTLE_ENDIAN, ComSignalInitValue=63, ComSignalType=UINT8, ComTimeout=5, ComSystemTemplateSystemSignalRef=UI2Sens02_CALID_Index_15
        UI2Sens02_CALID_Index_16_XIX_UI2Sens02_CALID_02_XIX_BMC_CAN01_e2115af9_Rx: ComBitPosition=56, ComBitSize=8, ComSignalEndianness=LITTLE_ENDIAN, ComSignalInitValue=63, ComSignalType=UINT8, ComTimeout=5, ComSystemTemplateSystemSignalRef=UI2Sens02_CALID_Index_16
        UI2Sens02_CVN_Byte_1_XIX_UI2Sens02_CVN_XIX_BMC_CAN01_d83e206d_Rx: ComBitPosition=1, ComBitSize=8, ComSignalEndianness=LITTLE_ENDIAN, ComSignalInitValue=0, ComSignalType=UINT8, ComTimeout=5, ComSystemTemplateSystemSignalRef=UI2Sens02_CVN_Byte_1
        UI2Sens02_CVN_Byte_2_XIX_UI2Sens02_CVN_XIX_BMC_CAN01_83299178_Rx: ComBitPosition=9, ComBitSize=8, ComSignalEndianness=LITTLE_ENDIAN, ComSignalInitValue=0, ComSignalType=UINT8, ComTimeout=5, ComSystemTemplateSystemSignalRef=UI2Sens02_CVN_Byte_2
        UI2Sens02_CVN_Byte_3_XIX_UI2Sens02_CVN_XIX_BMC_CAN01_b5db018b_Rx: ComBitPosition=17, ComBitSize=8, ComSignalEndianness=LITTLE_ENDIAN, ComSignalInitValue=0, ComSignalType=UINT8, ComTimeout=5, ComSystemTemplateSystemSignalRef=UI2Sens02_CVN_Byte_3
        UI2Sens02_CVN_Byte_4_XIX_UI2Sens02_CVN_XIX_BMC_CAN01_3506f352_Rx: ComBitPosition=25, ComBitSize=8, ComSignalEndianness=LITTLE_ENDIAN, ComSignalInitValue=0, ComSignalType=UINT8, ComTimeout=5, ComSystemTemplateSystemSignalRef=UI2Sens02_CVN_Byte_4
        UI2Sens02_CVN_VLD_XIX_UI2Sens02_CVN_XIX_BMC_CAN01_16e7de9a_Rx: ComBitPosition=0, ComBitSize=1, ComSignalEndianness=LITTLE_ENDIAN, ComSignalInitValue=0, ComSignalType=UINT8, ComTimeout=5, ComSystemTemplateSystemSignalRef=UI2Sens02_CVN_VLD
        UI2Sens02_ErrMem_State_XIX_UI2_04_XIX_BMC_CAN01_1e9c0075_Rx: ComBitPosition=13, ComBitSize=2, ComSignalEndianness=LITTLE_ENDIAN, ComSignalInitValue=2, ComSignalType=UINT8, ComTimeout=1, ComSystemTemplateSystemSignalRef=UI2Sens02_ErrMem_State
        UI2_KompFehlerModus2_01_XIX_UI2_Komponentenfehler_01_XIX_BMC_CAN01_1a77dcaf_Rx: ComBitPosition=12, ComBitSize=2, ComSignalEndianness=LITTLE_ENDIAN, ComSignalInitValue=0, ComSignalType=UINT8, ComTimeout=1, ComSystemTemplateSystemSignalRef=UI2_KompFehlerModus2_01
        UI2_KompFehlerModus2_02_XIX_UI2_Komponentenfehler_01_XIX_BMC_CAN01_640f9409_Rx: ComBitPosition=14, ComBitSize=2, ComSignalEndianness=LITTLE_ENDIAN, ComSignalInitValue=0, ComSignalType=UINT8, ComTimeout=1, ComSystemTemplateSystemSignalRef=UI2_KompFehlerModus2_02
        UI2_KompFehlerModus2_03_XIX_UI2_Komponentenfehler_01_XIX_BMC_CAN01_4e27ac6b_Rx: ComBitPosition=16, ComBitSize=2, ComSignalEndianness=LITTLE_ENDIAN, ComSignalInitValue=0, ComSignalType=UINT8, ComTimeout=1, ComSystemTemplateSystemSignalRef=UI2_KompFehlerModus2_03
        UI2_KompFehlerModus2_04_XIX_UI2_Komponentenfehler_01_XIX_BMC_CAN01_98ff0545_Rx: ComBitPosition=18, ComBitSize=2, ComSignalEndianness=LITTLE_ENDIAN, ComSignalInitValue=0, ComSignalType=UINT8, ComTimeout=1, ComSystemTemplateSystemSignalRef=UI2_KompFehlerModus2_04
        UI2_KompFehlerModus2_05_XIX_UI2_Komponentenfehler_01_XIX_BMC_CAN01_b2d73d27_Rx: ComBitPosition=20, ComBitSize=2, ComSignalEndianness=LITTLE_ENDIAN, ComSignalInitValue=0, ComSignalType=UINT8, ComTimeout=1, ComSystemTemplateSystemSignalRef=UI2_KompFehlerModus2_05
        UI2_KompFehlerModus2_06_XIX_UI2_Komponentenfehler_01_XIX_BMC_CAN01_ccaf7581_Rx: ComBitPosition=22, ComBitSize=2, ComSignalEndianness=LITTLE_ENDIAN, ComSignalInitValue=0, ComSignalType=UINT8, ComTimeout=1, ComSystemTemplateSystemSignalRef=UI2_KompFehlerModus2_06
        UI2_KompFehlerModus2_07_XIX_UI2_Komponentenfehler_01_XIX_BMC_CAN01_e6874de3_Rx: ComBitPosition=24, ComBitSize=2, ComSignalEndianness=LITTLE_ENDIAN, ComSignalInitValue=0, ComSignalType=UINT8, ComTimeout=1, ComSystemTemplateSystemSignalRef=UI2_KompFehlerModus2_07
        UI2_KompFehlerModus2_08_XIX_UI2_Komponentenfehler_01_XIX_BMC_CAN01_ba6f219c_Rx: ComBitPosition=26, ComBitSize=2, ComSignalEndianness=LITTLE_ENDIAN, ComSignalInitValue=0, ComSignalType=UINT8, ComTimeout=1, ComSystemTemplateSystemSignalRef=UI2_KompFehlerModus2_08
        UI2_KompFehlerModus2_09_XIX_UI2_Komponentenfehler_01_XIX_BMC_CAN01_904719fe_Rx: ComBitPosition=28, ComBitSize=2, ComSignalEndianness=LITTLE_ENDIAN, ComSignalInitValue=0, ComSignalType=UINT8, ComTimeout=1, ComSystemTemplateSystemSignalRef=UI2_KompFehlerModus2_09
        UI2_KompFehlerModus2_10_XIX_UI2_Komponentenfehler_01_XIX_BMC_CAN01_93c9cc81_Rx: ComBitPosition=30, ComBitSize=2, ComSignalEndianness=LITTLE_ENDIAN, ComSignalInitValue=0, ComSignalType=UINT8, ComTimeout=1, ComSystemTemplateSystemSignalRef=UI2_KompFehlerModus2_10
        UI2_KompFehlerModus2_11_XIX_UI2_Komponentenfehler_01_XIX_BMC_CAN01_b9e1f4e3_Rx: ComBitPosition=32, ComBitSize=2, ComSignalEndianness=LITTLE_ENDIAN, ComSignalInitValue=0, ComSignalType=UINT8, ComTimeout=1, ComSystemTemplateSystemSignalRef=UI2_KompFehlerModus2_11
        UI2_KompFehlerModus2_12_XIX_UI2_Komponentenfehler_01_XIX_BMC_CAN01_c799bc45_Rx: ComBitPosition=34, ComBitSize=2, ComSignalEndianness=LITTLE_ENDIAN, ComSignalInitValue=0, ComSignalType=UINT8, ComTimeout=1, ComSystemTemplateSystemSignalRef=UI2_KompFehlerModus2_12
        UI2_KompFehlerModus2_13_XIX_UI2_Komponentenfehler_01_XIX_BMC_CAN01_edb18427_Rx: ComBitPosition=36, ComBitSize=2, ComSignalEndianness=LITTLE_ENDIAN, ComSignalInitValue=0, ComSignalType=UINT8, ComTimeout=1, ComSystemTemplateSystemSignalRef=UI2_KompFehlerModus2_13
        UI2_KompFehlerModus2_14_XIX_UI2_Komponentenfehler_01_XIX_BMC_CAN01_3b692d09_Rx: ComBitPosition=38, ComBitSize=2, ComSignalEndianness=LITTLE_ENDIAN, ComSignalInitValue=0, ComSignalType=UINT8, ComTimeout=1, ComSystemTemplateSystemSignalRef=UI2_KompFehlerModus2_14
        UI2_KompFehlerModus2_15_XIX_UI2_Komponentenfehler_01_XIX_BMC_CAN01_1141156b_Rx: ComBitPosition=40, ComBitSize=2, ComSignalEndianness=LITTLE_ENDIAN, ComSignalInitValue=0, ComSignalType=UINT8, ComTimeout=1, ComSystemTemplateSystemSignalRef=UI2_KompFehlerModus2_15
        UI2_KompFehlerModus2_16_XIX_UI2_Komponentenfehler_01_XIX_BMC_CAN01_6f395dcd_Rx: ComBitPosition=42, ComBitSize=2, ComSignalEndianness=LITTLE_ENDIAN, ComSignalInitValue=0, ComSignalType=UINT8, ComTimeout=1, ComSystemTemplateSystemSignalRef=UI2_KompFehlerModus2_16
        UI2_KompFehlerModus2_17_XIX_UI2_Komponentenfehler_01_XIX_BMC_CAN01_451165af_Rx: ComBitPosition=44, ComBitSize=2, ComSignalEndianness=LITTLE_ENDIAN, ComSignalInitValue=0, ComSignalType=UINT8, ComTimeout=1, ComSystemTemplateSystemSignalRef=UI2_KompFehlerModus2_17
        UI2_KompFehlerModus2_18_XIX_UI2_Komponentenfehler_01_XIX_BMC_CAN01_19f909d0_Rx: ComBitPosition=46, ComBitSize=2, ComSignalEndianness=LITTLE_ENDIAN, ComSignalInitValue=0, ComSignalType=UINT8, ComTimeout=1, ComSystemTemplateSystemSignalRef=UI2_KompFehlerModus2_18
        UI2_KompFehlerModus2_19_XIX_UI2_Komponentenfehler_01_XIX_BMC_CAN01_33d131b2_Rx: ComBitPosition=48, ComBitSize=2, ComSignalEndianness=LITTLE_ENDIAN, ComSignalInitValue=0, ComSignalType=UINT8, ComTimeout=1, ComSystemTemplateSystemSignalRef=UI2_KompFehlerModus2_19
        UI2_KompFehlerModus2_20_XIX_UI2_Komponentenfehler_01_XIX_BMC_CAN01_ac02b214_Rx: ComBitPosition=50, ComBitSize=2, ComSignalEndianness=LITTLE_ENDIAN, ComSignalInitValue=0, ComSignalType=UINT8, ComTimeout=1, ComSystemTemplateSystemSignalRef=UI2_KompFehlerModus2_20
        UI2_KompFehlerModus2_21_XIX_UI2_Komponentenfehler_01_XIX_BMC_CAN01_862a8a76_Rx: ComBitPosition=52, ComBitSize=2, ComSignalEndianness=LITTLE_ENDIAN, ComSignalInitValue=0, ComSignalType=UINT8, ComTimeout=1, ComSystemTemplateSystemSignalRef=UI2_KompFehlerModus2_21
        UI2_KompFehlerModus2_22_XIX_UI2_Komponentenfehler_01_XIX_BMC_CAN01_f852c2d0_Rx: ComBitPosition=54, ComBitSize=2, ComSignalEndianness=LITTLE_ENDIAN, ComSignalInitValue=0, ComSignalType=UINT8, ComTimeout=1, ComSystemTemplateSystemSignalRef=UI2_KompFehlerModus2_22
