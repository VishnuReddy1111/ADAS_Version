[part 2 of 8: package /InitialEcuC]
AUTOSAR XML (schema 4-3-0)
package /InitialEcuC  (continued)
  module config Com
    ComConfig
      98 x ComIPdu:
        Airbag_10_XIX_HCP5_CANFD01_7f2c77c5_Rx: ComIPduDirection=RECEIVE, ComIPduType=NORMAL, ComIPduGroupRef=BMC_HV_XIX_HCP5_CANFD01_Rx_6dfafc5f, ComIPduGroupRef=BMC_HV_XIX_PNC_13_Airbag_Rx_29234cf7, ComIPduSignalRef=AB_Deaktivierung_HV_XIX_Airbag_10_XIX_HCP5_CANFD01_e8982158_Rx, ComPduIdRef=EcucPduCollection/Airbag_10_XIX_HCP5_CANFD01_7f2c77c5_Rx
        BJB_08_XIX_BMC_CAN01_1db9ae10_Rx: ComIPduDirection=RECEIVE, ComIPduType=NORMAL, ComIPduGroupRef=BMC_HV_XIX_BMC_CAN01_Rx_7b388810, ComIPduSignalRef=BJB_ErrMem_State_XIX_BJB_08_XIX_BMC_CAN01_418604a2_Rx, ComPduIdRef=EcucPduCollection/BJB_08_XIX_BMC_CAN01_1db9ae10_Rx
        BJB_10_XIX_BMC_CAN01_E2E_968516b3_Rx: ComIPduDirection=RECEIVE, ComIPduType=NORMAL, ComIPduGroupRef=BMC_HV_XIX_BMC_CAN01_Rx_7b388810, ComIPduSignalGroupRef=SG_BJB_10_XIX_BMC_CAN01_5b37bed6_Rx, ComPduIdRef=EcucPduCollection/BJB_10_XIX_BMC_CAN01_E2E_968516b3_Rx
        BJB_11_XIX_BMC_CAN01_E2E_416796eb_Rx: ComIPduDirection=RECEIVE, ComIPduType=NORMAL, ComIPduGroupRef=BMC_HV_XIX_BMC_CAN01_Rx_7b388810, ComIPduSignalGroupRef=SG_BJB_11_XIX_BMC_CAN01_e2cc653e_Rx, ComPduIdRef=EcucPduCollection/BJB_11_XIX_BMC_CAN01_E2E_416796eb_Rx
        BJB_12_XIX_BMC_CAN01_E2E_e2311042_Rx: ComIPduDirection=RECEIVE, ComIPduType=NORMAL, ComIPduGroupRef=BMC_HV_XIX_BMC_CAN01_Rx_7b388810, ComIPduSignalGroupRef=SG_BJB_12_XIX_BMC_CAN01_f3b10f47_Rx, ComPduIdRef=EcucPduCollection/BJB_12_XIX_BMC_CAN01_E2E_e2311042_Rx
        BJB_13_XIX_BMC_CAN01_E2E_35d3901a_Rx: ComIPduDirection=RECEIVE, ComIPduType=NORMAL, ComIPduGroupRef=BMC_HV_XIX_BMC_CAN01_Rx_7b388810, ComIPduSignalGroupRef=SG_BJB_13_XIX_BMC_CAN01_4a4ad4af_Rx, ComPduIdRef=EcucPduCollection/BJB_13_XIX_BMC_CAN01_E2E_35d3901a_Rx
        BJB_CALID_01_XIX_BMC_CAN01_adee7d66_Rx: ComIPduDirection=RECEIVE, ComIPduType=NORMAL, ComIPduGroupRef=BMC_HV_XIX_BMC_CAN01_Rx_7b388810, ComIPduSignalRef=BJB_CALID_Index_01_XIX_BJB_CALID_01_XIX_BMC_CAN01_14e77ef7_Rx, ComIPduSignalRef=BJB_CALID_Index_02_XIX_BJB_CALID_01_XIX_BMC_CAN01_ddf87648_Rx, ComIPduSignalRef=BJB_CALID_Index_03_XIX_BJB_CALID_01_XIX_BMC_CAN01_2c2273e2_Rx, ComIPduSignalRef=BJB_CALID_Index_04_XIX_BJB_CALID_01_XIX_BMC_CAN01_94b76177_Rx, ComIPduSignalRef=BJB_CALID_Index_05_XIX_BJB_CALID_01_XIX_BMC_CAN01_656d64dd_Rx, ComIPduSignalRef=BJB_CALID_Index_06_XIX_BJB_CALID_01_XIX_BMC_CAN01_ac726c62_Rx, ComIPduSignalRef=BJB_CALID_Index_07_XIX_BJB_CALID_01_XIX_BMC_CAN01_5da869c8_Rx, ComIPduSignalRef=BJB_CALID_Index_08_XIX_BJB_CALID_01_XIX_BMC_CAN01_06294f09_Rx, ComPduIdRef=EcucPduCollection/BJB_CALID_01_XIX_BMC_CAN01_adee7d66_Rx
        BJB_CALID_02_XIX_BMC_CAN01_bc93171f_Rx: ComIPduDirection=RECEIVE, ComIPduType=NORMAL, ComIPduGroupRef=BMC_HV_XIX_BMC_CAN01_Rx_7b388810, ComIPduSignalRef=BJB_CALID_Index_09_XIX_BJB_CALID_02_XIX_BMC_CAN01_e68e20da_Rx, ComIPduSignalRef=BJB_CALID_Index_10_XIX_BJB_CALID_02_XIX_BMC_CAN01_c2b281d7_Rx, ComIPduSignalRef=BJB_CALID_Index_11_XIX_BJB_CALID_02_XIX_BMC_CAN01_3368847d_Rx, ComIPduSignalRef=BJB_CALID_Index_12_XIX_BJB_CALID_02_XIX_BMC_CAN01_fa778cc2_Rx, ComIPduSignalRef=BJB_CALID_Index_13_XIX_BJB_CALID_02_XIX_BMC_CAN01_0bad8968_Rx, ComIPduSignalRef=BJB_CALID_Index_14_XIX_BJB_CALID_02_XIX_BMC_CAN01_b3389bfd_Rx, ComIPduSignalRef=BJB_CALID_Index_15_XIX_BJB_CALID_02_XIX_BMC_CAN01_42e29e57_Rx, ComIPduSignalRef=BJB_CALID_Index_16_XIX_BJB_CALID_02_XIX_BMC_CAN01_8bfd96e8_Rx, ComPduIdRef=EcucPduCollection/BJB_CALID_02_XIX_BMC_CAN01_bc93171f_Rx
        BJB_CVN_01_XIX_BMC_CAN01_301c1ddb_Rx: ComIPduDirection=RECEIVE, ComIPduType=NORMAL, ComIPduGroupRef=BMC_HV_XIX_BMC_CAN01_Rx_7b388810, ComIPduSignalRef=BJB_CVN_Byte_1_XIX_BJB_CVN_01_XIX_BMC_CAN01_18856d37_Rx, ComIPduSignalRef=BJB_CVN_Byte_2_XIX_BJB_CVN_01_XIX_BMC_CAN01_5c24482f_Rx, ComIPduSignalRef=BJB_CVN_Byte_3_XIX_BJB_CVN_01_XIX_BMC_CAN01_6044ab27_Rx, ComIPduSignalRef=BJB_CVN_Byte_4_XIX_BJB_CVN_01_XIX_BMC_CAN01_d566021f_Rx, ComIPduSignalRef=BJB_CVN_VLD_XIX_BJB_CVN_01_XIX_BMC_CAN01_7412dbc7_Rx, ComPduIdRef=EcucPduCollection/BJB_CVN_01_XIX_BMC_CAN01_301c1ddb_Rx
        BMC_CMC_Temperatur_01_XIX_HCP5_CANFD01_13d55235_Tx: ComIPduDirection=SEND, ComIPduType=NORMAL, ComIPduGroupRef=BMC_HV_XIX_HCP5_CANFD01_Tx_3ba05bd9, ComIPduGroupRef=BMC_HV_XIX_PNC_26_HighVoltage_Charging_Tx_20012544, ComIPduSignalRef=BMC_CMC_Temperatur_001_XIX_BMC_CMC_Temperatur_01_XIX_HCP5_CANFD01_19554342_Tx, ComIPduSignalRef=BMC_CMC_Temperatur_002_XIX_BMC_CMC_Temperatur_01_XIX_HCP5_CANFD01_672d0be4_Tx, ComIPduSignalRef=BMC_CMC_Temperatur_003_XIX_BMC_CMC_Temperatur_01_XIX_HCP5_CANFD01_4d053386_Tx, ComIPduSignalRef=BMC_CMC_Temperatur_004_XIX_BMC_CMC_Temperatur_01_XIX_HCP5_CANFD01_9bdd9aa8_Tx, ComIPduSignalRef=BMC_CMC_Temperatur_005_XIX_BMC_CMC_Temperatur_01_XIX_HCP5_CANFD01_b1f5a2ca_Tx, ComIPduSignalRef=BMC_CMC_Temperatur_006_XIX_BMC_CMC_Temperatur_01_XIX_HCP5_CANFD01_cf8dea6c_Tx, ComIPduSignalRef=BMC_CMC_Temperatur_007_XIX_BMC_CMC_Temperatur_01_XIX_HCP5_CANFD01_e5a5d20e_Tx, ComIPduSignalRef=BMC_CMC_Temperatur_008_XIX_BMC_CMC_Temperatur_01_XIX_HCP5_CANFD01_b94dbe71_Tx, ComIPduSignalRef=BMC_CMC_Temperatur_009_XIX_BMC_CMC_Temperatur_01_XIX_HCP5_CANFD01_93658613_Tx, ComIPduSignalRef=BMC_CMC_Temperatur_010_XIX_BMC_CMC_Temperatur_01_XIX_HCP5_CANFD01_90eb536c_Tx, ComIPduSignalRef=BMC_CMC_Temperatur_011_XIX_BMC_CMC_Temperatur_01_XIX_HCP5_CANFD01_bac36b0e_Tx, ComIPduSignalRef=BMC_CMC_Temperatur_012_XIX_BMC_CMC_Temperatur_01_XIX_HCP5_CANFD01_c4bb23a8_Tx, ComIPduSignalRef=BMC_CMC_Temperatur_013_XIX_BMC_CMC_Temperatur_01_XIX_HCP5_CANFD01_ee931bca_Tx, ComIPduSignalRef=BMC_CMC_Temperatur_014_XIX_BMC_CMC_Temperatur_01_XIX_HCP5_CANFD01_384bb2e4_Tx, ComIPduSignalRef=BMC_CMC_Temperatur_015_XIX_BMC_CMC_Temperatur_01_XIX_HCP5_CANFD01_12638a86_Tx, ComIPduSignalRef=BMC_CMC_Temperatur_016_XIX_BMC_CMC_Temperatur_01_XIX_HCP5_CANFD01_6c1bc220_Tx, ComIPduSignalRef=BMC_CMC_Temperatur_017_XIX_BMC_CMC_Temperatur_01_XIX_HCP5_CANFD01_4633fa42_Tx, ComIPduSignalRef=BMC_CMC_Temperatur_018_XIX_BMC_CMC_Temperatur_01_XIX_HCP5_CANFD01_1adb963d_Tx, ComIPduSignalRef=BMC_CMC_Temperatur_019_XIX_BMC_CMC_Temperatur_01_XIX_HCP5_CANFD01_30f3ae5f_Tx, ComIPduSignalRef=BMC_CMC_Temperatur_01_Messzeit_XIX_BMC_CMC_Temperatur_01_XIX_HCP5_CANFD01_e5c4df8c_Tx, ComIPduSignalRef=BMC_CMC_Temperatur_020_XIX_BMC_CMC_Temperatur_01_XIX_HCP5_CANFD01_af202df9_Tx, ComIPduSignalRef=BMC_CMC_Temperatur_021_XIX_BMC_CMC_Temperatur_01_XIX_HCP5_CANFD01_8508159b_Tx, ComIPduSignalRef=BMC_CMC_Temperatur_022_XIX_BMC_CMC_Temperatur_01_XIX_HCP5_CANFD01_fb705d3d_Tx, ComIPduSignalRef=BMC_CMC_Temperatur_023_XIX_BMC_CMC_Temperatur_01_XIX_HCP5_CANFD01_d158655f_Tx, ComIPduSignalRef=BMC_CMC_Temperatur_024_XIX_BMC_CMC_Temperatur_01_XIX_HCP5_CANFD01_0780cc71_Tx, ComIPduSignalRef=BMC_CMC_Temperatur_025_XIX_BMC_CMC_Temperatur_01_XIX_HCP5_CANFD01_2da8f413_Tx, ComIPduSignalRef=BMC_CMC_Temperatur_026_XIX_BMC_CMC_Temperatur_01_XIX_HCP5_CANFD01_53d0bcb5_Tx, ComIPduSignalRef=BMC_CMC_Temperatur_027_XIX_BMC_CMC_Temperatur_01_XIX_HCP5_CANFD01_79f884d7_Tx, ComIPduSignalRef=BMC_CMC_Temperatur_028_XIX_BMC_CMC_Temperatur_01_XIX_HCP5_CANFD01_2510e8a8_Tx, ComIPduSignalRef=BMC_CMC_Temperatur_029_XIX_BMC_CMC_Temperatur_01_XIX_HCP5_CANFD01_0f38d0ca_Tx, ComIPduSignalRef=BMC_CMC_Temperatur_030_XIX_BMC_CMC_Temperatur_01_XIX_HCP5_CANFD01_0cb605b5_Tx, ComIPduSignalRef=BMC_CMC_Temperatur_031_XIX_BMC_CMC_Temperatur_01_XIX_HCP5_CANFD01_269e3dd7_Tx, ComIPduSignalRef=BMC_CMC_Temperatur_032_XIX_BMC_CMC_Temperatur_01_XIX_HCP5_CANFD01_58e67571_Tx, ComIPduSignalRef=BMC_CMC_Temperatur_033_XIX_BMC_CMC_Temperatur_01_XIX_HCP5_CANFD01_72ce4d13_Tx, ComIPduSignalRef=BMC_CMC_Temperatur_034_XIX_BMC_CMC_Temperatur_01_XIX_HCP5_CANFD01_a416e43d_Tx, ComIPduSignalRef=BMC_CMC_Temperatur_035_XIX_BMC_CMC_Temperatur_01_XIX_HCP5_CANFD01_8e3edc5f_Tx, ComIPduSignalRef=BMC_CMC_Temperatur_036_XIX_BMC_CMC_Temperatur_01_XIX_HCP5_CANFD01_f04694f9_Tx, ComIPduSignalRef=BMC_CMC_Temperatur_037_XIX_BMC_CMC_Temperatur_01_XIX_HCP5_CANFD01_da6eac9b_Tx, ComIPduSignalRef=BMC_CMC_Temperatur_038_XIX_BMC_CMC_Temperatur_01_XIX_HCP5_CANFD01_8686c0e4_Tx, ComIPduSignalRef=BMC_CMC_Temperatur_039_XIX_BMC_CMC_Temperatur_01_XIX_HCP5_CANFD01_acaef886_Tx, ComIPduSignalRef=BMC_CMC_Temperatur_040_XIX_BMC_CMC_Temperatur_01_XIX_HCP5_CANFD01_d0b6d0d3_Tx, ComIPduSignalRef=BMC_CMC_Temperatur_041_XIX_BMC_CMC_Temperatur_01_XIX_HCP5_CANFD01_fa9ee8b1_Tx, ComIPduSignalRef=BMC_CMC_Temperatur_042_XIX_BMC_CMC_Temperatur_01_XIX_HCP5_CANFD01_84e6a017_Tx, ComIPduSignalRef=BMC_CMC_Temperatur_043_XIX_BMC_CMC_Temperatur_01_XIX_HCP5_CANFD01_aece9875_Tx, ComIPduSignalRef=BMC_CMC_Temperatur_044_XIX_BMC_CMC_Temperatur_01_XIX_HCP5_CANFD01_7816315b_Tx, ComIPduSignalRef=BMC_CMC_Temperatur_045_XIX_BMC_CMC_Temperatur_01_XIX_HCP5_CANFD01_523e0939_Tx, ComIPduSignalRef=BMC_CMC_Temperatur_046_XIX_BMC_CMC_Temperatur_01_XIX_HCP5_CANFD01_2c46419f_Tx, ComIPduSignalRef=BMC_CMC_Temperatur_047_XIX_BMC_CMC_Temperatur_01_XIX_HCP5_CANFD01_066e79fd_Tx, ComIPduSignalRef=BMC_CMC_Temperatur_048_XIX_BMC_CMC_Temperatur_01_XIX_HCP5_CANFD01_5a861582_Tx, ComIPduSignalRef=BMC_CMC_Temperatur_049_XIX_BMC_CMC_Temperatur_01_XIX_HCP5_CANFD01_70ae2de0_Tx, ComIPduSignalRef=BMC_CMC_Temperatur_050_XIX_BMC_CMC_Temperatur_01_XIX_HCP5_CANFD01_7320f89f_Tx, ComIPduSignalRef=BMC_CMC_Temperatur_051_XIX_BMC_CMC_Temperatur_01_XIX_HCP5_CANFD01_5908c0fd_Tx, ComIPduSignalRef=BMC_CMC_Temperatur_052_XIX_BMC_CMC_Temperatur_01_XIX_HCP5_CANFD01_2770885b_Tx, ComIPduSignalRef=BMC_CMC_Temperatur_053_XIX_BMC_CMC_Temperatur_01_XIX_HCP5_CANFD01_0d58b039_Tx, ComIPduSignalRef=BMC_CMC_Temperatur_054_XIX_BMC_CMC_Temperatur_01_XIX_HCP5_CANFD01_db801917_Tx, ComIPduSignalRef=BMC_CMC_Temperatur_055_XIX_BMC_CMC_Temperatur_01_XIX_HCP5_CANFD01_f1a82175_Tx, ComIPduSignalRef=BMC_CMC_Temperatur_056_XIX_BMC_CMC_Temperatur_01_XIX_HCP5_CANFD01_8fd069d3_Tx, ComIPduSignalRef=BMC_CMC_Temperatur_057_XIX_BMC_CMC_Temperatur_01_XIX_HCP5_CANFD01_a5f851b1_Tx, ComIPduSignalRef=BMC_CMC_Temperatur_058_XIX_BMC_CMC_Temperatur_01_XIX_HCP5_CANFD01_f9103dce_Tx, ComPduIdRef=EcucPduCollection/BMC_CMC_Temperatur_01_XIX_HCP5_CANFD01_13d55235_Tx
          ComTxIPdu: ComTxIPduUnusedAreasDefault=0
            ComTxModeTrue
              ComTxMode: ComTxModeMode=PERIODIC, ComTxModeTimeOffset=0, ComTxModeTimePeriod=1
        BMC_CMC_Temperatur_02_XIX_HCP5_CANFD01_f9538f57_Tx: ComIPduDirection=SEND, ComIPduType=NORMAL, ComIPduGroupRef=BMC_HV_XIX_HCP5_CANFD01_Tx_3ba05bd9, ComIPduGroupRef=BMC_HV_XIX_PNC_26_HighVoltage_Charging_Tx_20012544, ComIPduSignalRef=BMC_CMC_Temperatur_02_Messzeit_XIX_BMC_CMC_Temperatur_02_XIX_HCP5_CANFD01_8c2bd22d_Tx, ComIPduSignalRef=BMC_CMC_Temperatur_059_XIX_BMC_CMC_Temperatur_02_XIX_HCP5_CANFD01_39bed8ce_Tx, ComIPduSignalRef=BMC_CMC_Temperatur_060_XIX_BMC_CMC_Temperatur_02_XIX_HCP5_CANFD01_a66d5b68_Tx, ComIPduSignalRef=BMC_CMC_Temperatur_061_XIX_BMC_CMC_Temperatur_02_XIX_HCP5_CANFD01_8c45630a_Tx, ComIPduSignalRef=BMC_CMC_Temperatur_062_XIX_BMC_CMC_Temperatur_02_XIX_HCP5_CANFD01_f23d2bac_Tx, ComIPduSignalRef=BMC_CMC_Temperatur_063_XIX_BMC_CMC_Temperatur_02_XIX_HCP5_CANFD01_d81513ce_Tx, ComIPduSignalRef=BMC_CMC_Temperatur_064_XIX_BMC_CMC_Temperatur_02_XIX_HCP5_CANFD01_0ecdbae0_Tx, ComIPduSignalRef=BMC_CMC_Temperatur_065_XIX_BMC_CMC_Temperatur_02_XIX_HCP5_CANFD01_24e58282_Tx, ComIPduSignalRef=BMC_CMC_Temperatur_066_XIX_BMC_CMC_Temperatur_02_XIX_HCP5_CANFD01_5a9dca24_Tx, ComIPduSignalRef=BMC_CMC_Temperatur_067_XIX_BMC_CMC_Temperatur_02_XIX_HCP5_CANFD01_70b5f246_Tx, ComIPduSignalRef=BMC_CMC_Temperatur_068_XIX_BMC_CMC_Temperatur_02_XIX_HCP5_CANFD01_2c5d9e39_Tx, ComIPduSignalRef=BMC_CMC_Temperatur_069_XIX_BMC_CMC_Temperatur_02_XIX_HCP5_CANFD01_0675a65b_Tx, ComIPduSignalRef=BMC_CMC_Temperatur_070_XIX_BMC_CMC_Temperatur_02_XIX_HCP5_CANFD01_05fb7324_Tx, ComIPduSignalRef=BMC_CMC_Temperatur_071_XIX_BMC_CMC_Temperatur_02_XIX_HCP5_CANFD01_2fd34b46_Tx, ComIPduSignalRef=BMC_CMC_Temperatur_072_XIX_BMC_CMC_Temperatur_02_XIX_HCP5_CANFD01_51ab03e0_Tx, ComPduIdRef=EcucPduCollection/BMC_CMC_Temperatur_02_XIX_HCP5_CANFD01_f9538f57_Tx
          ComTxIPdu: ComTxIPduUnusedAreasDefault=0
            ComTxModeTrue
              ComTxMode: ComTxModeMode=PERIODIC, ComTxModeTimeOffset=0, ComTxModeTimePeriod=1
        BMC_CMC_Temperatur_03_XIX_HCP5_CANFD01_160139b6_Tx: ComIPduDirection=SEND, ComIPduType=NORMAL, ComIPduGroupRef=BMC_HV_XIX_HCP5_CANFD01_Tx_3ba05bd9, ComIPduGroupRef=BMC_HV_XIX_PNC_26_HighVoltage_Charging_Tx_20012544, ComIPduSignalRef=BMC_CMC_Temperatur_03_Messzeit_XIX_BMC_CMC_Temperatur_03_XIX_HCP5_CANFD01_1da1d48d_Tx, ComIPduSignalRef=BMC_CMC_Temperatur_073_XIX_BMC_CMC_Temperatur_03_XIX_HCP5_CANFD01_94d18d63_Tx, ComIPduSignalRef=BMC_CMC_Temperatur_074_XIX_BMC_CMC_Temperatur_03_XIX_HCP5_CANFD01_4209244d_Tx, ComIPduSignalRef=BMC_CMC_Temperatur_075_XIX_BMC_CMC_Temperatur_03_XIX_HCP5_CANFD01_68211c2f_Tx, ComIPduSignalRef=BMC_CMC_Temperatur_076_XIX_BMC_CMC_Temperatur_03_XIX_HCP5_CANFD01_16595489_Tx, ComIPduSignalRef=BMC_CMC_Temperatur_077_XIX_BMC_CMC_Temperatur_03_XIX_HCP5_CANFD01_3c716ceb_Tx, ComIPduSignalRef=BMC_CMC_Temperatur_078_XIX_BMC_CMC_Temperatur_03_XIX_HCP5_CANFD01_60990094_Tx, ComIPduSignalRef=BMC_CMC_Temperatur_079_XIX_BMC_CMC_Temperatur_03_XIX_HCP5_CANFD01_4ab138f6_Tx, ComIPduSignalRef=BMC_CMC_Temperatur_080_XIX_BMC_CMC_Temperatur_03_XIX_HCP5_CANFD01_2a4f4104_Tx, ComIPduSignalRef=BMC_CMC_Temperatur_081_XIX_BMC_CMC_Temperatur_03_XIX_HCP5_CANFD01_00677966_Tx, ComIPduSignalRef=BMC_CMC_Temperatur_082_XIX_BMC_CMC_Temperatur_03_XIX_HCP5_CANFD01_7e1f31c0_Tx, ComIPduSignalRef=BMC_CMC_Temperatur_083_XIX_BMC_CMC_Temperatur_03_XIX_HCP5_CANFD01_543709a2_Tx, ComIPduSignalRef=BMC_CMC_Temperatur_084_XIX_BMC_CMC_Temperatur_03_XIX_HCP5_CANFD01_82efa08c_Tx, ComIPduSignalRef=BMC_CMC_Temperatur_085_XIX_BMC_CMC_Temperatur_03_XIX_HCP5_CANFD01_a8c798ee_Tx, ComIPduSignalRef=BMC_CMC_Temperatur_086_XIX_BMC_CMC_Temperatur_03_XIX_HCP5_CANFD01_d6bfd048_Tx, ComIPduSignalRef=BMC_CMC_Temperatur_087_XIX_BMC_CMC_Temperatur_03_XIX_HCP5_CANFD01_fc97e82a_Tx, ComIPduSignalRef=BMC_CMC_Temperatur_088_XIX_BMC_CMC_Temperatur_03_XIX_HCP5_CANFD01_a07f8455_Tx, ComIPduSignalRef=BMC_CMC_Temperatur_089_XIX_BMC_CMC_Temperatur_03_XIX_HCP5_CANFD01_8a57bc37_Tx, ComIPduSignalRef=BMC_CMC_Temperatur_090_XIX_BMC_CMC_Temperatur_03_XIX_HCP5_CANFD01_89d96948_Tx, ComIPduSignalRef=BMC_CMC_Temperatur_091_XIX_BMC_CMC_Temperatur_03_XIX_HCP5_CANFD01_a3f1512a_Tx, ComIPduSignalRef=BMC_CMC_Temperatur_092_XIX_BMC_CMC_Temperatur_03_XIX_HCP5_CANFD01_dd89198c_Tx, ComIPduSignalRef=BMC_CMC_Temperatur_093_XIX_BMC_CMC_Temperatur_03_XIX_HCP5_CANFD01_f7a121ee_Tx, ComIPduSignalRef=BMC_CMC_Temperatur_094_XIX_BMC_CMC_Temperatur_03_XIX_HCP5_CANFD01_217988c0_Tx, ComIPduSignalRef=BMC_CMC_Temperatur_095_XIX_BMC_CMC_Temperatur_03_XIX_HCP5_CANFD01_0b51b0a2_Tx, ComIPduSignalRef=BMC_CMC_Temperatur_096_XIX_BMC_CMC_Temperatur_03_XIX_HCP5_CANFD01_7529f804_Tx, ComPduIdRef=EcucPduCollection/BMC_CMC_Temperatur_03_XIX_HCP5_CANFD01_160139b6_Tx
          ComTxIPdu: ComTxIPduUnusedAreasDefault=0
            ComTxModeTrue
              ComTxMode: ComTxModeMode=PERIODIC, ComTxModeTimeOffset=0, ComTxModeTimePeriod=1
        BMC_CMC_Zellspannung_01_XIX_HCP5_CANFD01_f76fbfe9_Tx: ComIPduDirection=SEND, ComIPduType=NORMAL, ComIPduGroupRef=BMC_HV_XIX_HCP5_CANFD01_Tx_3ba05bd9, ComIPduGroupRef=BMC_HV_XIX_PNC_26_HighVoltage_Charging_Tx_20012544, ComIPduSignalRef=BMC_CMC_Zellspannung_001_XIX_BMC_CMC_Zellspannung_01_XIX_HCP5_CANFD01_be9dc83a_Tx, ComIPduSignalRef=BMC_CMC_Zellspannung_002_XIX_BMC_CMC_Zellspannung_01_XIX_HCP5_CANFD01_3ec7648f_Tx, ComIPduSignalRef=BMC_CMC_Zellspannung_003_XIX_BMC_CMC_Zellspannung_01_XIX_HCP5_CANFD01_410eff1c_Tx, ComIPduSignalRef=BMC_CMC_Zellspannung_004_XIX_BMC_CMC_Zellspannung_01_XIX_HCP5_CANFD01_e5033ba4_Tx, ComIPduSignalRef=BMC_CMC_Zellspannung_005_XIX_BMC_CMC_Zellspannung_01_XIX_HCP5_CANFD01_9acaa037_Tx, ComIPduSignalRef=BMC_CMC_Zellspannung_006_XIX_BMC_CMC_Zellspannung_01_XIX_HCP5_CANFD01_1a900c82_Tx, ComIPduSignalRef=BMC_CMC_Zellspannung_007_XIX_BMC_CMC_Zellspannung_01_XIX_HCP5_CANFD01_65599711_Tx, ComIPduSignalRef=BMC_CMC_Zellspannung_008_XIX_BMC_CMC_Zellspannung_01_XIX_HCP5_CANFD01_89fa83b3_Tx, ComIPduSignalRef=BMC_CMC_Zellspannung_009_XIX_BMC_CMC_Zellspannung_01_XIX_HCP5_CANFD01_f6331820_Tx, ComIPduSignalRef=BMC_CMC_Zellspannung_010_XIX_BMC_CMC_Zellspannung_01_XIX_HCP5_CANFD01_a82d58cc_Tx, ComIPduSignalRef=BMC_CMC_Zellspannung_011_XIX_BMC_CMC_Zellspannung_01_XIX_HCP5_CANFD01_d7e4c35f_Tx, ComIPduSignalRef=BMC_CMC_Zellspannung_012_XIX_BMC_CMC_Zellspannung_01_XIX_HCP5_CANFD01_57be6fea_Tx, ComIPduSignalRef=BMC_CMC_Zellspannung_013_XIX_BMC_CMC_Zellspannung_01_XIX_HCP5_CANFD01_2877f479_Tx, ComIPduSignalRef=BMC_CMC_Zellspannung_014_XIX_BMC_CMC_Zellspannung_01_XIX_HCP5_CANFD01_8c7a30c1_Tx, ComIPduSignalRef=BMC_CMC_Zellspannung_015_XIX_BMC_CMC_Zellspannung_01_XIX_HCP5_CANFD01_f3b3ab52_Tx, ComIPduSignalRef=BMC_CMC_Zellspannung_016_XIX_BMC_CMC_Zellspannung_01_XIX_HCP5_CANFD01_73e907e7_Tx, ComIPduSignalRef=BMC_CMC_Zellspannung_017_XIX_BMC_CMC_Zellspannung_01_XIX_HCP5_CANFD01_0c209c74_Tx, ComIPduSignalRef=BMC_CMC_Zellspannung_018_XIX_BMC_CMC_Zellspannung_01_XIX_HCP5_CANFD01_e08388d6_Tx, ComIPduSignalRef=BMC_CMC_Zellspannung_019_XIX_BMC_CMC_Zellspannung_01_XIX_HCP5_CANFD01_9f4a1345_Tx, ComIPduSignalRef=BMC_CMC_Zellspannung_01_Messzeit_XIX_BMC_CMC_Zellspannung_01_XIX_HCP5_CANFD01_a5e0aca3_Tx, ComIPduSignalRef=BMC_CMC_Zellspannung_020_XIX_BMC_CMC_Zellspannung_01_XIX_HCP5_CANFD01_13a64563_Tx, ComIPduSignalRef=BMC_CMC_Zellspannung_021_XIX_BMC_CMC_Zellspannung_01_XIX_HCP5_CANFD01_6c6fdef0_Tx, ComIPduSignalRef=BMC_CMC_Zellspannung_022_XIX_BMC_CMC_Zellspannung_01_XIX_HCP5_CANFD01_ec357245_Tx, ComIPduSignalRef=BMC_CMC_Zellspannung_023_XIX_BMC_CMC_Zellspannung_01_XIX_HCP5_CANFD01_93fce9d6_Tx, ComIPduSignalRef=BMC_CMC_Zellspannung_024_XIX_BMC_CMC_Zellspannung_01_XIX_HCP5_CANFD01_37f12d6e_Tx, ComIPduSignalRef=BMC_CMC_Zellspannung_025_XIX_BMC_CMC_Zellspannung_01_XIX_HCP5_CANFD01_4838b6fd_Tx, ComIPduSignalRef=BMC_CMC_Zellspannung_026_XIX_BMC_CMC_Zellspannung_01_XIX_HCP5_CANFD01_c8621a48_Tx, ComIPduSignalRef=BMC_CMC_Zellspannung_027_XIX_BMC_CMC_Zellspannung_01_XIX_HCP5_CANFD01_b7ab81db_Tx, ComIPduSignalRef=BMC_CMC_Zellspannung_028_XIX_BMC_CMC_Zellspannung_01_XIX_HCP5_CANFD01_5b089579_Tx, ComIPduSignalRef=BMC_CMC_Zellspannung_029_XIX_BMC_CMC_Zellspannung_01_XIX_HCP5_CANFD01_24c10eea_Tx, ComIPduSignalRef=BMC_CMC_Zellspannung_030_XIX_BMC_CMC_Zellspannung_01_XIX_HCP5_CANFD01_7adf4e06_Tx, ComIPduSignalRef=BMC_CMC_Zellspannung_031_XIX_BMC_CMC_Zellspannung_01_XIX_HCP5_CANFD01_0516d595_Tx, ComIPduSignalRef=BMC_CMC_Zellspannung_032_XIX_BMC_CMC_Zellspannung_01_XIX_HCP5_CANFD01_854c7920_Tx, ComIPduSignalRef=BMC_CMC_Zellspannung_033_XIX_BMC_CMC_Zellspannung_01_XIX_HCP5_CANFD01_fa85e2b3_Tx, ComIPduSignalRef=BMC_CMC_Zellspannung_034_XIX_BMC_CMC_Zellspannung_01_XIX_HCP5_CANFD01_5e88260b_Tx, ComIPduSignalRef=BMC_CMC_Zellspannung_035_XIX_BMC_CMC_Zellspannung_01_XIX_HCP5_CANFD01_2141bd98_Tx, ComIPduSignalRef=BMC_CMC_Zellspannung_036_XIX_BMC_CMC_Zellspannung_01_XIX_HCP5_CANFD01_a11b112d_Tx, ComIPduSignalRef=BMC_CMC_Zellspannung_037_XIX_BMC_CMC_Zellspannung_01_XIX_HCP5_CANFD01_ded28abe_Tx, ComIPduSignalRef=BMC_CMC_Zellspannung_038_XIX_BMC_CMC_Zellspannung_01_XIX_HCP5_CANFD01_32719e1c_Tx, ComIPduSignalRef=BMC_CMC_Zellspannung_039_XIX_BMC_CMC_Zellspannung_01_XIX_HCP5_CANFD01_4db8058f_Tx, ComPduIdRef=EcucPduCollection/BMC_CMC_Zellspannung_01_XIX_HCP5_CANFD01_f76fbfe9_Tx
          ComTxIPdu: ComTxIPduUnusedAreasDefault=0
            ComTxModeTrue
              ComTxMode: ComTxModeMode=PERIODIC, ComTxModeTimeOffset=0, ComTxModeTimePeriod=1
        BMC_CMC_Zellspannung_02_XIX_HCP5_CANFD01_1de9628b_Tx: ComIPduDirection=SEND, ComIPduType=NORMAL, ComIPduGroupRef=BMC_HV_XIX_HCP5_CANFD01_Tx_3ba05bd9, ComIPduGroupRef=BMC_HV_XIX_PNC_26_HighVoltage_Charging_Tx_20012544, ComIPduSignalRef=BMC_CMC_Zellspannung_02_Messzeit_XIX_BMC_CMC_Zellspannung_02_XIX_HCP5_CANFD01_2962a4f1_Tx, ComIPduSignalRef=BMC_CMC_Zellspannung_040_XIX_BMC_CMC_Zellspannung_02_XIX_HCP5_CANFD01_5547a51e_Tx, ComIPduSignalRef=BMC_CMC_Zellspannung_041_XIX_BMC_CMC_Zellspannung_02_XIX_HCP5_CANFD01_2a8e3e8d_Tx, ComIPduSignalRef=BMC_CMC_Zellspannung_042_XIX_BMC_CMC_Zellspannung_02_XIX_HCP5_CANFD01_aad49238_Tx, ComIPduSignalRef=BMC_CMC_Zellspannung_043_XIX_BMC_CMC_Zellspannung_02_XIX_HCP5_CANFD01_d51d09ab_Tx, ComIPduSignalRef=BMC_CMC_Zellspannung_044_XIX_BMC_CMC_Zellspannung_02_XIX_HCP5_CANFD01_7110cd13_Tx, ComIPduSignalRef=BMC_CMC_Zellspannung_045_XIX_BMC_CMC_Zellspannung_02_XIX_HCP5_CANFD01_0ed95680_Tx, ComIPduSignalRef=BMC_CMC_Zellspannung_046_XIX_BMC_CMC_Zellspannung_02_XIX_HCP5_CANFD01_8e83fa35_Tx, ComIPduSignalRef=BMC_CMC_Zellspannung_047_XIX_BMC_CMC_Zellspannung_02_XIX_HCP5_CANFD01_f14a61a6_Tx, ComIPduSignalRef=BMC_CMC_Zellspannung_048_XIX_BMC_CMC_Zellspannung_02_XIX_HCP5_CANFD01_1de97504_Tx, ComIPduSignalRef=BMC_CMC_Zellspannung_049_XIX_BMC_CMC_Zellspannung_02_XIX_HCP5_CANFD01_6220ee97_Tx, ComIPduSignalRef=BMC_CMC_Zellspannung_050_XIX_BMC_CMC_Zellspannung_02_XIX_HCP5_CANFD01_3c3eae7b_Tx, ComIPduSignalRef=BMC_CMC_Zellspannung_051_XIX_BMC_CMC_Zellspannung_02_XIX_HCP5_CANFD01_43f735e8_Tx, ComIPduSignalRef=BMC_CMC_Zellspannung_052_XIX_BMC_CMC_Zellspannung_02_XIX_HCP5_CANFD01_c3ad995d_Tx, ComIPduSignalRef=BMC_CMC_Zellspannung_053_XIX_BMC_CMC_Zellspannung_02_XIX_HCP5_CANFD01_bc6402ce_Tx, ComIPduSignalRef=BMC_CMC_Zellspannung_054_XIX_BMC_CMC_Zellspannung_02_XIX_HCP5_CANFD01_1869c676_Tx, ComIPduSignalRef=BMC_CMC_Zellspannung_055_XIX_BMC_CMC_Zellspannung_02_XIX_HCP5_CANFD01_67a05de5_Tx, ComIPduSignalRef=BMC_CMC_Zellspannung_056_XIX_BMC_CMC_Zellspannung_02_XIX_HCP5_CANFD01_e7faf150_Tx, ComIPduSignalRef=BMC_CMC_Zellspannung_057_XIX_BMC_CMC_Zellspannung_02_XIX_HCP5_CANFD01_98336ac3_Tx, ComIPduSignalRef=BMC_CMC_Zellspannung_058_XIX_BMC_CMC_Zellspannung_02_XIX_HCP5_CANFD01_74907e61_Tx, ComIPduSignalRef=BMC_CMC_Zellspannung_059_XIX_BMC_CMC_Zellspannung_02_XIX_HCP5_CANFD01_0b59e5f2_Tx, ComIPduSignalRef=BMC_CMC_Zellspannung_060_XIX_BMC_CMC_Zellspannung_02_XIX_HCP5_CANFD01_87b5b3d4_Tx, ComIPduSignalRef=BMC_CMC_Zellspannung_061_XIX_BMC_CMC_Zellspannung_02_XIX_HCP5_CANFD01_f87c2847_Tx, ComIPduSignalRef=BMC_CMC_Zellspannung_062_XIX_BMC_CMC_Zellspannung_02_XIX_HCP5_CANFD01_782684f2_Tx, ComIPduSignalRef=BMC_CMC_Zellspannung_063_XIX_BMC_CMC_Zellspannung_02_XIX_HCP5_CANFD01_07ef1f61_Tx, ComIPduSignalRef=BMC_CMC_Zellspannung_064_XIX_BMC_CMC_Zellspannung_02_XIX_HCP5_CANFD01_a3e2dbd9_Tx, ComIPduSignalRef=BMC_CMC_Zellspannung_065_XIX_BMC_CMC_Zellspannung_02_XIX_HCP5_CANFD01_dc2b404a_Tx, ComIPduSignalRef=BMC_CMC_Zellspannung_066_XIX_BMC_CMC_Zellspannung_02_XIX_HCP5_CANFD01_5c71ecff_Tx, ComIPduSignalRef=BMC_CMC_Zellspannung_067_XIX_BMC_CMC_Zellspannung_02_XIX_HCP5_CANFD01_23b8776c_Tx, ComIPduSignalRef=BMC_CMC_Zellspannung_068_XIX_BMC_CMC_Zellspannung_02_XIX_HCP5_CANFD01_cf1b63ce_Tx, ComIPduSignalRef=BMC_CMC_Zellspannung_069_XIX_BMC_CMC_Zellspannung_02_XIX_HCP5_CANFD01_b0d2f85d_Tx, ComIPduSignalRef=BMC_CMC_Zellspannung_070_XIX_BMC_CMC_Zellspannung_02_XIX_HCP5_CANFD01_eeccb8b1_Tx, ComIPduSignalRef=BMC_CMC_Zellspannung_071_XIX_BMC_CMC_Zellspannung_02_XIX_HCP5_CANFD01_91052322_Tx, ComIPduSignalRef=BMC_CMC_Zellspannung_072_XIX_BMC_CMC_Zellspannung_02_XIX_HCP5_CANFD01_115f8f97_Tx, ComIPduSignalRef=BMC_CMC_Zellspannung_073_XIX_BMC_CMC_Zellspannung_02_XIX_HCP5_CANFD01_6e961404_Tx, ComIPduSignalRef=BMC_CMC_Zellspannung_074_XIX_BMC_CMC_Zellspannung_02_XIX_HCP5_CANFD01_ca9bd0bc_Tx, ComIPduSignalRef=BMC_CMC_Zellspannung_075_XIX_BMC_CMC_Zellspannung_02_XIX_HCP5_CANFD01_b5524b2f_Tx, ComIPduSignalRef=BMC_CMC_Zellspannung_076_XIX_BMC_CMC_Zellspannung_02_XIX_HCP5_CANFD01_3508e79a_Tx, ComIPduSignalRef=BMC_CMC_Zellspannung_077_XIX_BMC_CMC_Zellspannung_02_XIX_HCP5_CANFD01_4ac17c09_Tx, ComIPduSignalRef=BMC_CMC_Zellspannung_078_XIX_BMC_CMC_Zellspannung_02_XIX_HCP5_CANFD01_a66268ab_Tx, ComPduIdRef=EcucPduCollection/BMC_CMC_Zellspannung_02_XIX_HCP5_CANFD01_1de9628b_Tx
          ComTxIPdu: ComTxIPduUnusedAreasDefault=0
            ComTxModeTrue
              ComTxMode: ComTxModeMode=PERIODIC, ComTxModeTimeOffset=0, ComTxModeTimePeriod=1
        BMC_CMC_Zellspannung_03_XIX_HCP5_CANFD01_f2bbd46a_Tx: ComIPduDirection=SEND, ComIPduType=NORMAL, ComIPduGroupRef=BMC_HV_XIX_HCP5_CANFD01_Tx_3ba05bd9, ComIPduGroupRef=BMC_HV_XIX_PNC_26_HighVoltage_Charging_Tx_20012544, ComIPduSignalRef=BMC_CMC_Zellspannung_03_Messzeit_XIX_BMC_CMC_Zellspannung_03_XIX_HCP5_CANFD01_e433a100_Tx, ComIPduSignalRef=BMC_CMC_Zellspannung_079_XIX_BMC_CMC_Zellspannung_03_XIX_HCP5_CANFD01_36f945d9_Tx, ComIPduSignalRef=BMC_CMC_Zellspannung_080_XIX_BMC_CMC_Zellspannung_03_XIX_HCP5_CANFD01_39aa6f80_Tx, ComIPduSignalRef=BMC_CMC_Zellspannung_081_XIX_BMC_CMC_Zellspannung_03_XIX_HCP5_CANFD01_4663f413_Tx, ComIPduSignalRef=BMC_CMC_Zellspannung_082_XIX_BMC_CMC_Zellspannung_03_XIX_HCP5_CANFD01_c63958a6_Tx, ComIPduSignalRef=BMC_CMC_Zellspannung_083_XIX_BMC_CMC_Zellspannung_03_XIX_HCP5_CANFD01_b9f0c335_Tx, ComIPduSignalRef=BMC_CMC_Zellspannung_084_XIX_BMC_CMC_Zellspannung_03_XIX_HCP5_CANFD01_1dfd078d_Tx, ComIPduSignalRef=BMC_CMC_Zellspannung_085_XIX_BMC_CMC_Zellspannung_03_XIX_HCP5_CANFD01_62349c1e_Tx, ComIPduSignalRef=BMC_CMC_Zellspannung_086_XIX_BMC_CMC_Zellspannung_03_XIX_HCP5_CANFD01_e26e30ab_Tx, ComIPduSignalRef=BMC_CMC_Zellspannung_087_XIX_BMC_CMC_Zellspannung_03_XIX_HCP5_CANFD01_9da7ab38_Tx, ComIPduSignalRef=BMC_CMC_Zellspannung_088_XIX_BMC_CMC_Zellspannung_03_XIX_HCP5_CANFD01_7104bf9a_Tx, ComIPduSignalRef=BMC_CMC_Zellspannung_089_XIX_BMC_CMC_Zellspannung_03_XIX_HCP5_CANFD01_0ecd2409_Tx, ComIPduSignalRef=BMC_CMC_Zellspannung_090_XIX_BMC_CMC_Zellspannung_03_XIX_HCP5_CANFD01_50d364e5_Tx, ComIPduSignalRef=BMC_CMC_Zellspannung_091_XIX_BMC_CMC_Zellspannung_03_XIX_HCP5_CANFD01_2f1aff76_Tx, ComIPduSignalRef=BMC_CMC_Zellspannung_092_XIX_BMC_CMC_Zellspannung_03_XIX_HCP5_CANFD01_af4053c3_Tx, ComIPduSignalRef=BMC_CMC_Zellspannung_093_XIX_BMC_CMC_Zellspannung_03_XIX_HCP5_CANFD01_d089c850_Tx, ComIPduSignalRef=BMC_CMC_Zellspannung_094_XIX_BMC_CMC_Zellspannung_03_XIX_HCP5_CANFD01_74840ce8_Tx, ComIPduSignalRef=BMC_CMC_Zellspannung_095_XIX_BMC_CMC_Zellspannung_03_XIX_HCP5_CANFD01_0b4d977b_Tx, ComIPduSignalRef=BMC_CMC_Zellspannung_096_XIX_BMC_CMC_Zellspannung_03_XIX_HCP5_CANFD01_8b173bce_Tx, ComIPduSignalRef=BMC_CMC_Zellspannung_097_XIX_BMC_CMC_Zellspannung_03_XIX_HCP5_CANFD01_f4dea05d_Tx, ComIPduSignalRef=BMC_CMC_Zellspannung_098_XIX_BMC_CMC_Zellspannung_03_XIX_HCP5_CANFD01_187db4ff_Tx, ComIPduSignalRef=BMC_CMC_Zellspannung_099_XIX_BMC_CMC_Zellspannung_03_XIX_HCP5_CANFD01_67b42f6c_Tx, ComIPduSignalRef=BMC_CMC_Zellspannung_100_XIX_BMC_CMC_Zellspannung_03_XIX_HCP5_CANFD01_f931d4f6_Tx, ComIPduSignalRef=BMC_CMC_Zellspannung_101_XIX_BMC_CMC_Zellspannung_03_XIX_HCP5_CANFD01_86f84f65_Tx, ComIPduSignalRef=BMC_CMC_Zellspannung_102_XIX_BMC_CMC_Zellspannung_03_XIX_HCP5_CANFD01_06a2e3d0_Tx, ComIPduSignalRef=BMC_CMC_Zellspannung_103_XIX_BMC_CMC_Zellspannung_03_XIX_HCP5_CANFD01_796b7843_Tx, ComIPduSignalRef=BMC_CMC_Zellspannung_104_XIX_BMC_CMC_Zellspannung_03_XIX_HCP5_CANFD01_dd66bcfb_Tx, ComIPduSignalRef=BMC_CMC_Zellspannung_105_XIX_BMC_CMC_Zellspannung_03_XIX_HCP5_CANFD01_a2af2768_Tx, ComIPduSignalRef=BMC_CMC_Zellspannung_106_XIX_BMC_CMC_Zellspannung_03_XIX_HCP5_CANFD01_22f58bdd_Tx, ComIPduSignalRef=BMC_CMC_Zellspannung_107_XIX_BMC_CMC_Zellspannung_03_XIX_HCP5_CANFD01_5d3c104e_Tx, ComIPduSignalRef=BMC_CMC_Zellspannung_108_XIX_BMC_CMC_Zellspannung_03_XIX_HCP5_CANFD01_b19f04ec_Tx, ComIPduSignalRef=BMC_CMC_Zellspannung_109_XIX_BMC_CMC_Zellspannung_03_XIX_HCP5_CANFD01_ce569f7f_Tx, ComIPduSignalRef=BMC_CMC_Zellspannung_110_XIX_BMC_CMC_Zellspannung_03_XIX_HCP5_CANFD01_9048df93_Tx, ComIPduSignalRef=BMC_CMC_Zellspannung_111_XIX_BMC_CMC_Zellspannung_03_XIX_HCP5_CANFD01_ef814400_Tx, ComIPduSignalRef=BMC_CMC_Zellspannung_112_XIX_BMC_CMC_Zellspannung_03_XIX_HCP5_CANFD01_6fdbe8b5_Tx, ComIPduSignalRef=BMC_CMC_Zellspannung_113_XIX_BMC_CMC_Zellspannung_03_XIX_HCP5_CANFD01_10127326_Tx, ComIPduSignalRef=BMC_CMC_Zellspannung_114_XIX_BMC_CMC_Zellspannung_03_XIX_HCP5_CANFD01_b41fb79e_Tx, ComIPduSignalRef=BMC_CMC_Zellspannung_115_XIX_BMC_CMC_Zellspannung_03_XIX_HCP5_CANFD01_cbd62c0d_Tx, ComIPduSignalRef=BMC_CMC_Zellspannung_116_XIX_BMC_CMC_Zellspannung_03_XIX_HCP5_CANFD01_4b8c80b8_Tx, ComIPduSignalRef=BMC_CMC_Zellspannung_117_XIX_BMC_CMC_Zellspannung_03_XIX_HCP5_CANFD01_34451b2b_Tx, ComPduIdRef=EcucPduCollection/BMC_CMC_Zellspannung_03_XIX_HCP5_CANFD01_f2bbd46a_Tx
          ComTxIPdu: ComTxIPduUnusedAreasDefault=0
            ComTxModeTrue
              ComTxMode: ComTxModeMode=PERIODIC, ComTxModeTimeOffset=0, ComTxModeTimePeriod=1
        BMC_CMC_Zellspannung_04_XIX_HCP5_CANFD01_1395de0e_Tx: ComIPduDirection=SEND, ComIPduType=NORMAL, ComIPduGroupRef=BMC_HV_XIX_HCP5_CANFD01_Tx_3ba05bd9, ComIPduGroupRef=BMC_HV_XIX_PNC_26_HighVoltage_Charging_Tx_20012544, ComIPduSignalRef=BMC_CMC_Zellspannung_04_Messzeit_XIX_BMC_CMC_Zellspannung_04_XIX_HCP5_CANFD01_eb17b214_Tx, ComIPduSignalRef=BMC_CMC_Zellspannung_118_XIX_BMC_CMC_Zellspannung_04_XIX_HCP5_CANFD01_39c805ed_Tx, ComIPduSignalRef=BMC_CMC_Zellspannung_119_XIX_BMC_CMC_Zellspannung_04_XIX_HCP5_CANFD01_46019e7e_Tx, ComIPduSignalRef=BMC_CMC_Zellspannung_120_XIX_BMC_CMC_Zellspannung_04_XIX_HCP5_CANFD01_caedc858_Tx, ComIPduSignalRef=BMC_CMC_Zellspannung_121_XIX_BMC_CMC_Zellspannung_04_XIX_HCP5_CANFD01_b52453cb_Tx, ComIPduSignalRef=BMC_CMC_Zellspannung_122_XIX_BMC_CMC_Zellspannung_04_XIX_HCP5_CANFD01_357eff7e_Tx, ComIPduSignalRef=BMC_CMC_Zellspannung_123_XIX_BMC_CMC_Zellspannung_04_XIX_HCP5_CANFD01_4ab764ed_Tx, ComIPduSignalRef=BMC_CMC_Zellspannung_124_XIX_BMC_CMC_Zellspannung_04_XIX_HCP5_CANFD01_eebaa055_Tx, ComIPduSignalRef=BMC_CMC_Zellspannung_125_XIX_BMC_CMC_Zellspannung_04_XIX_HCP5_CANFD01_91733bc6_Tx, ComIPduSignalRef=BMC_CMC_Zellspannung_126_XIX_BMC_CMC_Zellspannung_04_XIX_HCP5_CANFD01_11299773_Tx, ComIPduSignalRef=BMC_CMC_Zellspannung_127_XIX_BMC_CMC_Zellspannung_04_XIX_HCP5_CANFD01_6ee00ce0_Tx, ComIPduSignalRef=BMC_CMC_Zellspannung_128_XIX_BMC_CMC_Zellspannung_04_XIX_HCP5_CANFD01_82431842_Tx, ComIPduSignalRef=BMC_CMC_Zellspannung_129_XIX_BMC_CMC_Zellspannung_04_XIX_HCP5_CANFD01_fd8a83d1_Tx, ComIPduSignalRef=BMC_CMC_Zellspannung_130_XIX_BMC_CMC_Zellspannung_04_XIX_HCP5_CANFD01_a394c33d_Tx, ComIPduSignalRef=BMC_CMC_Zellspannung_131_XIX_BMC_CMC_Zellspannung_04_XIX_HCP5_CANFD01_dc5d58ae_Tx, ComIPduSignalRef=BMC_CMC_Zellspannung_132_XIX_BMC_CMC_Zellspannung_04_XIX_HCP5_CANFD01_5c07f41b_Tx, ComIPduSignalRef=BMC_CMC_Zellspannung_133_XIX_BMC_CMC_Zellspannung_04_XIX_HCP5_CANFD01_23ce6f88_Tx, ComIPduSignalRef=BMC_CMC_Zellspannung_134_XIX_BMC_CMC_Zellspannung_04_XIX_HCP5_CANFD01_87c3ab30_Tx, ComIPduSignalRef=BMC_CMC_Zellspannung_135_XIX_BMC_CMC_Zellspannung_04_XIX_HCP5_CANFD01_f80a30a3_Tx, ComIPduSignalRef=BMC_CMC_Zellspannung_136_XIX_BMC_CMC_Zellspannung_04_XIX_HCP5_CANFD01_78509c16_Tx, ComIPduSignalRef=BMC_CMC_Zellspannung_137_XIX_BMC_CMC_Zellspannung_04_XIX_HCP5_CANFD01_07990785_Tx, ComIPduSignalRef=BMC_CMC_Zellspannung_138_XIX_BMC_CMC_Zellspannung_04_XIX_HCP5_CANFD01_eb3a1327_Tx, ComIPduSignalRef=BMC_CMC_Zellspannung_139_XIX_BMC_CMC_Zellspannung_04_XIX_HCP5_CANFD01_94f388b4_Tx, ComIPduSignalRef=BMC_CMC_Zellspannung_140_XIX_BMC_CMC_Zellspannung_04_XIX_HCP5_CANFD01_668af547_Tx, ComIPduSignalRef=BMC_CMC_Zellspannung_141_XIX_BMC_CMC_Zellspannung_04_XIX_HCP5_CANFD01_19436ed4_Tx, ComIPduSignalRef=BMC_CMC_Zellspannung_142_XIX_BMC_CMC_Zellspannung_04_XIX_HCP5_CANFD01_9919c261_Tx, ComIPduSignalRef=BMC_CMC_Zellspannung_143_XIX_BMC_CMC_Zellspannung_04_XIX_HCP5_CANFD01_e6d059f2_Tx, ComIPduSignalRef=BMC_CMC_Zellspannung_144_XIX_BMC_CMC_Zellspannung_04_XIX_HCP5_CANFD01_42dd9d4a_Tx, ComIPduSignalRef=BMC_CMC_Zellspannung_145_XIX_BMC_CMC_Zellspannung_04_XIX_HCP5_CANFD01_3d1406d9_Tx, ComIPduSignalRef=BMC_CMC_Zellspannung_146_XIX_BMC_CMC_Zellspannung_04_XIX_HCP5_CANFD01_bd4eaa6c_Tx, ComIPduSignalRef=BMC_CMC_Zellspannung_147_XIX_BMC_CMC_Zellspannung_04_XIX_HCP5_CANFD01_c28731ff_Tx, ComIPduSignalRef=BMC_CMC_Zellspannung_148_XIX_BMC_CMC_Zellspannung_04_XIX_HCP5_CANFD01_2e24255d_Tx, ComIPduSignalRef=BMC_CMC_Zellspannung_149_XIX_BMC_CMC_Zellspannung_04_XIX_HCP5_CANFD01_51edbece_Tx, ComIPduSignalRef=BMC_CMC_Zellspannung_150_XIX_BMC_CMC_Zellspannung_04_XIX_HCP5_CANFD01_0ff3fe22_Tx, ComIPduSignalRef=BMC_CMC_Zellspannung_151_XIX_BMC_CMC_Zellspannung_04_XIX_HCP5_CANFD01_703a65b1_Tx, ComIPduSignalRef=BMC_CMC_Zellspannung_152_XIX_BMC_CMC_Zellspannung_04_XIX_HCP5_CANFD01_f060c904_Tx, ComIPduSignalRef=BMC_CMC_Zellspannung_153_XIX_BMC_CMC_Zellspannung_04_XIX_HCP5_CANFD01_8fa95297_Tx, ComIPduSignalRef=BMC_CMC_Zellspannung_154_XIX_BMC_CMC_Zellspannung_04_XIX_HCP5_CANFD01_2ba4962f_Tx, ComIPduSignalRef=BMC_CMC_Zellspannung_155_XIX_BMC_CMC_Zellspannung_04_XIX_HCP5_CANFD01_546d0dbc_Tx, ComIPduSignalRef=BMC_CMC_Zellspannung_156_XIX_BMC_CMC_Zellspannung_04_XIX_HCP5_CANFD01_d437a109_Tx, ComPduIdRef=EcucPduCollection/BMC_CMC_Zellspannung_04_XIX_HCP5_CANFD01_1395de0e_Tx
          ComTxIPdu: ComTxIPduUnusedAreasDefault=0
            ComTxModeTrue
              ComTxMode: ComTxModeMode=PERIODIC, ComTxModeTimeOffset=0, ComTxModeTimePeriod=1
        BMC_CMC_Zellspannung_05_XIX_HCP5_CANFD01_fcc768ef_Tx: ComIPduDirection=SEND, ComIPduType=NORMAL, ComIPduGroupRef=BMC_HV_XIX_HCP5_CANFD01_Tx_3ba05bd9, ComIPduGroupRef=BMC_HV_XIX_PNC_26_HighVoltage_Charging_Tx_20012544, ComIPduSignalRef=BMC_CMC_Zellspannung_05_Messzeit_XIX_BMC_CMC_Zellspannung_05_XIX_HCP5_CANFD01_2646b7e5_Tx, ComIPduSignalRef=BMC_CMC_Zellspannung_157_XIX_BMC_CMC_Zellspannung_05_XIX_HCP5_CANFD01_44ac8c7b_Tx, ComIPduSignalRef=BMC_CMC_Zellspannung_158_XIX_BMC_CMC_Zellspannung_05_XIX_HCP5_CANFD01_a80f98d9_Tx, ComIPduSignalRef=BMC_CMC_Zellspannung_159_XIX_BMC_CMC_Zellspannung_05_XIX_HCP5_CANFD01_d7c6034a_Tx, ComIPduSignalRef=BMC_CMC_Zellspannung_160_XIX_BMC_CMC_Zellspannung_05_XIX_HCP5_CANFD01_5b2a556c_Tx, ComIPduSignalRef=BMC_CMC_Zellspannung_161_XIX_BMC_CMC_Zellspannung_05_XIX_HCP5_CANFD01_24e3ceff_Tx, ComIPduSignalRef=BMC_CMC_Zellspannung_162_XIX_BMC_CMC_Zellspannung_05_XIX_HCP5_CANFD01_a4b9624a_Tx, ComIPduSignalRef=BMC_CMC_Zellspannung_163_XIX_BMC_CMC_Zellspannung_05_XIX_HCP5_CANFD01_db70f9d9_Tx, ComIPduSignalRef=BMC_CMC_Zellspannung_164_XIX_BMC_CMC_Zellspannung_05_XIX_HCP5_CANFD01_7f7d3d61_Tx, ComIPduSignalRef=BMC_CMC_Zellspannung_165_XIX_BMC_CMC_Zellspannung_05_XIX_HCP5_CANFD01_00b4a6f2_Tx, ComIPduSignalRef=BMC_CMC_Zellspannung_166_XIX_BMC_CMC_Zellspannung_05_XIX_HCP5_CANFD01_80ee0a47_Tx, ComIPduSignalRef=BMC_CMC_Zellspannung_167_XIX_BMC_CMC_Zellspannung_05_XIX_HCP5_CANFD01_ff2791d4_Tx, ComIPduSignalRef=BMC_CMC_Zellspannung_168_XIX_BMC_CMC_Zellspannung_05_XIX_HCP5_CANFD01_13848576_Tx, ComIPduSignalRef=BMC_CMC_Zellspannung_169_XIX_BMC_CMC_Zellspannung_05_XIX_HCP5_CANFD01_6c4d1ee5_Tx, ComIPduSignalRef=BMC_CMC_Zellspannung_170_XIX_BMC_CMC_Zellspannung_05_XIX_HCP5_CANFD01_32535e09_Tx, ComIPduSignalRef=BMC_CMC_Zellspannung_171_XIX_BMC_CMC_Zellspannung_05_XIX_HCP5_CANFD01_4d9ac59a_Tx, ComIPduSignalRef=BMC_CMC_Zellspannung_172_XIX_BMC_CMC_Zellspannung_05_XIX_HCP5_CANFD01_cdc0692f_Tx, ComIPduSignalRef=BMC_CMC_Zellspannung_173_XIX_BMC_CMC_Zellspannung_05_XIX_HCP5_CANFD01_b209f2bc_Tx, ComIPduSignalRef=BMC_CMC_Zellspannung_174_XIX_BMC_CMC_Zellspannung_05_XIX_HCP5_CANFD01_16043604_Tx, ComIPduSignalRef=BMC_CMC_Zellspannung_175_XIX_BMC_CMC_Zellspannung_05_XIX_HCP5_CANFD01_69cdad97_Tx, ComIPduSignalRef=BMC_CMC_Zellspannung_176_XIX_BMC_CMC_Zellspannung_05_XIX_HCP5_CANFD01_e9970122_Tx, ComIPduSignalRef=BMC_CMC_Zellspannung_177_XIX_BMC_CMC_Zellspannung_05_XIX_HCP5_CANFD01_965e9ab1_Tx, ComIPduSignalRef=BMC_CMC_Zellspannung_178_XIX_BMC_CMC_Zellspannung_05_XIX_HCP5_CANFD01_7afd8e13_Tx, ComIPduSignalRef=BMC_CMC_Zellspannung_179_XIX_BMC_CMC_Zellspannung_05_XIX_HCP5_CANFD01_05341580_Tx, ComIPduSignalRef=BMC_CMC_Zellspannung_180_XIX_BMC_CMC_Zellspannung_05_XIX_HCP5_CANFD01_0a673fd9_Tx, ComIPduSignalRef=BMC_CMC_Zellspannung_181_XIX_BMC_CMC_Zellspannung_05_XIX_HCP5_CANFD01_75aea44a_Tx, ComIPduSignalRef=BMC_CMC_Zellspannung_182_XIX_BMC_CMC_Zellspannung_05_XIX_HCP5_CANFD01_f5f408ff_Tx, ComIPduSignalRef=BMC_CMC_Zellspannung_183_XIX_BMC_CMC_Zellspannung_05_XIX_HCP5_CANFD01_8a3d936c_Tx, ComIPduSignalRef=BMC_CMC_Zellspannung_184_XIX_BMC_CMC_Zellspannung_05_XIX_HCP5_CANFD01_2e3057d4_Tx, ComIPduSignalRef=BMC_CMC_Zellspannung_185_XIX_BMC_CMC_Zellspannung_05_XIX_HCP5_CANFD01_51f9cc47_Tx, ComIPduSignalRef=BMC_CMC_Zellspannung_186_XIX_BMC_CMC_Zellspannung_05_XIX_HCP5_CANFD01_d1a360f2_Tx, ComIPduSignalRef=BMC_CMC_Zellspannung_187_XIX_BMC_CMC_Zellspannung_05_XIX_HCP5_CANFD01_ae6afb61_Tx, ComIPduSignalRef=BMC_CMC_Zellspannung_188_XIX_BMC_CMC_Zellspannung_05_XIX_HCP5_CANFD01_42c9efc3_Tx, ComIPduSignalRef=BMC_CMC_Zellspannung_189_XIX_BMC_CMC_Zellspannung_05_XIX_HCP5_CANFD01_3d007450_Tx, ComIPduSignalRef=BMC_CMC_Zellspannung_190_XIX_BMC_CMC_Zellspannung_05_XIX_HCP5_CANFD01_631e34bc_Tx, ComIPduSignalRef=BMC_CMC_Zellspannung_191_XIX_BMC_CMC_Zellspannung_05_XIX_HCP5_CANFD01_1cd7af2f_Tx, ComIPduSignalRef=BMC_CMC_Zellspannung_192_XIX_BMC_CMC_Zellspannung_05_XIX_HCP5_CANFD01_9c8d039a_Tx, ComPduIdRef=EcucPduCollection/BMC_CMC_Zellspannung_05_XIX_HCP5_CANFD01_fcc768ef_Tx
          ComTxIPdu: ComTxIPduUnusedAreasDefault=0
            ComTxModeTrue
              ComTxMode: ComTxModeMode=PERIODIC, ComTxModeTimeOffset=0, ComTxModeTimePeriod=1
        BMC_HV_01_XIX_HCP5_CANFD01_E2E_fcbbcae3_Tx: ComIPduDirection=SEND, ComIPduType=NORMAL, ComIPduGroupRef=BMC_HV_XIX_HCP5_CANFD01_Tx_3ba05bd9, ComIPduGroupRef=BMC_HV_XIX_PNC_26_HighVoltage_Charging_Tx_20012544, ComIPduGroupRef=BMC_HV_XIX_PNC_30_EnergyManagement_Tx_ff32adc5, ComIPduSignalGroupRef=SG_BMC_HV_01_XIX_HCP5_CANFD01_efd99d38_Tx, ComPduIdRef=EcucPduCollection/BMC_HV_01_XIX_HCP5_CANFD01_E2E_fcbbcae3_Tx
          ComTxIPdu: ComTxIPduUnusedAreasDefault=0
            ComTxModeTrue
              ComTxMode: ComTxModeMode=DIRECT, ComTxModeNumberOfRepetitions=0, ComTxModeRepetitionPeriod=0
        BMC_HV_02_XIX_HCP5_CANFD01_E2E_c5c367a3_Tx: ComIPduDirection=SEND, ComIPduType=NORMAL, ComIPduGroupRef=BMC_HV_XIX_HCP5_CANFD01_Tx_3ba05bd9, ComIPduGroupRef=BMC_HV_XIX_PNC_26_HighVoltage_Charging_Tx_20012544, ComIPduGroupRef=BMC_HV_XIX_PNC_30_EnergyManagement_Tx_ff32adc5, ComIPduGroupRef=BMC_HV_XIX_PNC_40_Diagnosis_Energy_Tx_60b361f6, ComIPduSignalGroupRef=SG_BMC_HV_02_XIX_HCP5_CANFD01_055f405a_Tx, ComPduIdRef=EcucPduCollection/BMC_HV_02_XIX_HCP5_CANFD01_E2E_c5c367a3_Tx
          ComTxIPdu: ComTxIPduUnusedAreasDefault=0
            ComTxModeTrue
              ComTxMode: ComTxModeMode=DIRECT, ComTxModeNumberOfRepetitions=0, ComTxModeRepetitionPeriod=0
        BMC_HV_03_XIX_HCP5_CANFD01_0617c15c_Tx: ComIPduDirection=SEND, ComIPduType=NORMAL, ComIPduGroupRef=BMC_HV_XIX_HCP5_CANFD01_Tx_3ba05bd9, ComIPduGroupRef=BMC_HV_XIX_PNC_26_HighVoltage_Charging_Tx_20012544, ComIPduSignalRef=BMC_Abschaltankuendigung_XIX_BMC_HV_03_XIX_HCP5_CANFD01_971531f5_Tx, ComIPduSignalRef=BMC_Bidi_GenutzteEnergie_XIX_BMC_HV_03_XIX_HCP5_CANFD01_71b918c9_Tx, ComIPduSignalRef=BMC_Bidi_Max_SoC_XIX_BMC_HV_03_XIX_HCP5_CANFD01_efab2d0f_Tx, ComIPduSignalRef=BMC_Bidi_Min_SoC_XIX_BMC_HV_03_XIX_HCP5_CANFD01_1b8c15d1_Tx, ComIPduSignalRef=BMC_Bidi_Veto_Temp_XIX_BMC_HV_03_XIX_HCP5_CANFD01_1db44959_Tx, ComIPduSignalRef=BMC_Dauer_Entladeleistung_XIX_BMC_HV_03_XIX_HCP5_CANFD01_eeda29b5_Tx, ComIPduSignalRef=BMC_Dauer_Ladeleistung_XIX_BMC_HV_03_XIX_HCP5_CANFD01_680da831_Tx, ComIPduSignalRef=BMC_Energie_Entladen_XIX_BMC_HV_03_XIX_HCP5_CANFD01_9fbaffd3_Tx, ComIPduSignalRef=BMC_Energie_Laden_XIX_BMC_HV_03_XIX_HCP5_CANFD01_44ca086e_Tx, ComIPduSignalRef=BMC_Konditionierung_Anf_XIX_BMC_HV_03_XIX_HCP5_CANFD01_f6c01bb8_Tx, ComIPduSignalRef=BMC_MaxEnergieinhalt_XIX_BMC_HV_03_XIX_HCP5_CANFD01_bd0ef2f1_Tx, ComIPduSignalRef=BMC_NutzbareKapazitaet_XIX_BMC_HV_03_XIX_HCP5_CANFD01_b7a047cf_Tx, ComIPduSignalRef=BMC_RuecklaufTemperatur_XIX_BMC_HV_03_XIX_HCP5_CANFD01_73222ba7_Tx, ComIPduSignalRef=BMC_Temperatur_XIX_BMC_HV_03_XIX_HCP5_CANFD01_eb74ed8d_Tx, ComIPduSignalRef=BMC_ThermAuslastung_XIX_BMC_HV_03_XIX_HCP5_CANFD01_5abb920e_Tx, ComIPduSignalRef=BMC_ThermSpreizung_XIX_BMC_HV_03_XIX_HCP5_CANFD01_fd3f685b_Tx, ComIPduSignalRef=BMC_VerlustEnergie_XIX_BMC_HV_03_XIX_HCP5_CANFD01_c05628a7_Tx, ComIPduSignalRef=BMC_VorlaufTemperatur_XIX_BMC_HV_03_XIX_HCP5_CANFD01_b115c7c1_Tx, ComPduIdRef=EcucPduCollection/BMC_HV_03_XIX_HCP5_CANFD01_0617c15c_Tx
          ComTxIPdu: ComTxIPduUnusedAreasDefault=0
            ComTxModeTrue
              ComTxMode: ComTxModeMode=PERIODIC, ComTxModeTimeOffset=0, ComTxModeTimePeriod=0.5
        BMC_HV_04_XIX_BMC_CAN01_E2E_a4a2e7f5_Tx: ComIPduDirection=SEND, ComIPduType=NORMAL, ComIPduGroupRef=BMC_HV_XIX_BMC_CAN01_Tx_2d622f96, ComIPduSignalGroupRef=SG_BMC_HV_04_XIX_BMC_CAN01_0c592380_Tx, ComPduIdRef=EcucPduCollection/BMC_HV_04_XIX_BMC_CAN01_E2E_a4a2e7f5_Tx
          ComTxIPdu: ComMinimumDelayTime=0.05, ComTxIPduUnusedAreasDefault=0
            ComTxModeTrue
              ComTxMode: ComTxModeMode=DIRECT, ComTxModeNumberOfRepetitions=0, ComTxModeRepetitionPeriod=0
        BMC_HV_05_XIX_HCP5_CANFD01_086b7dd9_Tx: ComIPduDirection=SEND, ComIPduType=NORMAL, ComIPduGroupRef=BMC_HV_XIX_HCP5_CANFD01_Tx_3ba05bd9, ComIPduGroupRef=BMC_HV_XIX_PNC_26_HighVoltage_Charging_Tx_20012544, ComIPduSignalRef=BMC_Rekuperation_Ueberlauf_XIX_BMC_HV_05_XIX_HCP5_CANFD01_34ba06c8_Tx, ComIPduSignalRef=BMC_Rekuperation_XIX_BMC_HV_05_XIX_HCP5_CANFD01_0550c77c_Tx, ComIPduSignalRef=BMC_Verbrauch_Ueberlauf_XIX_BMC_HV_05_XIX_HCP5_CANFD01_3d34bbf6_Tx, ComIPduSignalRef=BMC_Verbrauch_XIX_BMC_HV_05_XIX_HCP5_CANFD01_8e72d45b_Tx, ComPduIdRef=EcucPduCollection/BMC_HV_05_XIX_HCP5_CANFD01_086b7dd9_Tx
          ComTxIPdu: ComTxIPduUnusedAreasDefault=0
            ComTxModeTrue
              ComTxMode: ComTxModeMode=PERIODIC, ComTxModeTimeOffset=0, ComTxModeTimePeriod=0.05
        BMC_HV_06_XIX_HCP5_CANFD01_e2eda0bb_Tx: ComIPduDirection=SEND, ComIPduType=NORMAL, ComIPduGroupRef=BMC_HV_XIX_HCP5_CANFD01_Tx_3ba05bd9, ComIPduGroupRef=BMC_HV_XIX_PNC_26_HighVoltage_Charging_Tx_20012544, ComIPduSignalRef=BMC_Bidi_Energie_Absolut_XIX_BMC_HV_06_XIX_HCP5_CANFD01_b94683d1_Tx, ComIPduSignalRef=BMC_Bidi_Freigabe_XIX_BMC_HV_06_XIX_HCP5_CANFD01_da88ae89_Tx, ComIPduSignalRef=BMC_Bidi_Veto_Energie_XIX_BMC_HV_06_XIX_HCP5_CANFD01_c682e8ed_Tx, ComIPduSignalRef=BMC_KundenWarnung_XIX_BMC_HV_06_XIX_HCP5_CANFD01_8664a2d8_Tx, ComIPduSignalRef=BMC_Max_Spannung_XIX_BMC_HV_06_XIX_HCP5_CANFD01_ed13d04e_Tx, ComIPduSignalRef=BMC_Min_Spannung_XIX_BMC_HV_06_XIX_HCP5_CANFD01_a39bb5e4_Tx, ComPduIdRef=EcucPduCollection/BMC_HV_06_XIX_HCP5_CANFD01_e2eda0bb_Tx
          ComTxIPdu: ComMinimumDelayTime=0.05, ComTxIPduUnusedAreasDefault=0
            ComTxModeTrue
              ComTxMode: ComTxModeMode=MIXED, ComTxModeNumberOfRepetitions=0, ComTxModeRepetitionPeriod=0, ComTxModeTimeOffset=0, ComTxModeTimePeriod=0.5
        BMC_HV_07_XIX_HCP5_CANFD01_0dbf165a_Tx: ComIPduDirection=SEND, ComIPduType=NORMAL, ComIPduGroupRef=BMC_HV_XIX_HCP5_CANFD01_Tx_3ba05bd9, ComIPduGroupRef=BMC_HV_XIX_PNC_26_HighVoltage_Charging_Tx_20012544, ComIPduSignalRef=BMC_Temperatur_hoechste_XIX_BMC_HV_07_XIX_HCP5_CANFD01_70360ca3_Tx, ComIPduSignalRef=BMC_Temperatur_niedrigste_XIX_BMC_HV_07_XIX_HCP5_CANFD01_2e3528f4_Tx, ComPduIdRef=EcucPduCollection/BMC_HV_07_XIX_HCP5_CANFD01_0dbf165a_Tx
          ComTxIPdu: ComTxIPduUnusedAreasDefault=0
            ComTxModeTrue
              ComTxMode: ComTxModeMode=PERIODIC, ComTxModeTimeOffset=0, ComTxModeTimePeriod=0.2
        BMC_HV_08_XIX_HCP5_CANFD01_fbc0b232_Tx: ComIPduDirection=SEND, ComIPduType=NORMAL, ComIPduGroupRef=BMC_HV_XIX_HCP5_CANFD01_Tx_3ba05bd9, ComIPduGroupRef=BMC_HV_XIX_PNC_26_HighVoltage_Charging_Tx_20012544, ComIPduSignalRef=BMC_ExtLadeleistung_XIX_BMC_HV_08_XIX_HCP5_CANFD01_0def2e7f_Tx, ComIPduSignalRef=BMC_IstTemperaturMax_Modul_ID_XIX_BMC_HV_08_XIX_HCP5_CANFD01_26033124_Tx, ComIPduSignalRef=BMC_IstTemperaturMax_Sensor_ID_XIX_BMC_HV_08_XIX_HCP5_CANFD01_ea25f749_Tx, ComIPduSignalRef=BMC_IstTemperaturMin_Modul_ID_XIX_BMC_HV_08_XIX_HCP5_CANFD01_688b548e_Tx, ComIPduSignalRef=BMC_IstTemperaturMin_Sensor_ID_XIX_BMC_HV_08_XIX_HCP5_CANFD01_dc6835da_Tx, ComIPduSignalRef=BMC_IstZellSpannungMax_Modul_ID_XIX_BMC_HV_08_XIX_HCP5_CANFD01_4cf696ba_Tx, ComIPduSignalRef=BMC_IstZellSpannungMax_Zell_ID_XIX_BMC_HV_08_XIX_HCP5_CANFD01_b2be9152_Tx, ComIPduSignalRef=BMC_IstZellSpannungMin_Modul_ID_XIX_BMC_HV_08_XIX_HCP5_CANFD01_027ef310_Tx, ComIPduSignalRef=BMC_IstZellSpannungMin_Zell_ID_XIX_BMC_HV_08_XIX_HCP5_CANFD01_3e586fb0_Tx, ComIPduSignalRef=BMC_Pack_SN_01_XIX_BMC_HV_08_XIX_HCP5_CANFD01_d934ed9b_Tx, ComIPduSignalRef=BMC_Pack_SN_02_XIX_BMC_HV_08_XIX_HCP5_CANFD01_102be524_Tx, ComIPduSignalRef=BMC_Pack_SN_03_XIX_BMC_HV_08_XIX_HCP5_CANFD01_e1f1e08e_Tx, ComIPduSignalRef=BMC_Pack_SN_04_XIX_BMC_HV_08_XIX_HCP5_CANFD01_5964f21b_Tx, ComIPduSignalRef=BMC_Pack_SN_05_XIX_BMC_HV_08_XIX_HCP5_CANFD01_a8bef7b1_Tx, ComIPduSignalRef=BMC_Pack_SN_06_XIX_BMC_HV_08_XIX_HCP5_CANFD01_61a1ff0e_Tx, ComIPduSignalRef=BMC_Pack_SN_07_XIX_BMC_HV_08_XIX_HCP5_CANFD01_907bfaa4_Tx, ComIPduSignalRef=BMC_Pack_SN_08_XIX_BMC_HV_08_XIX_HCP5_CANFD01_cbfadc65_Tx, ComIPduSignalRef=BMC_Pack_SN_09_XIX_BMC_HV_08_XIX_HCP5_CANFD01_3a20d9cf_Tx, ComIPduSignalRef=BMC_Pack_SN_10_XIX_BMC_HV_08_XIX_HCP5_CANFD01_1e1c78c2_Tx, ComIPduSignalRef=BMC_Pack_SN_11_XIX_BMC_HV_08_XIX_HCP5_CANFD01_efc67d68_Tx, ComIPduSignalRef=BMC_Pack_SN_12_XIX_BMC_HV_08_XIX_HCP5_CANFD01_26d975d7_Tx, ComIPduSignalRef=BMC_Pack_SN_13_XIX_BMC_HV_08_XIX_HCP5_CANFD01_d703707d_Tx, ComIPduSignalRef=BMC_Pack_SN_14_XIX_BMC_HV_08_XIX_HCP5_CANFD01_6f9662e8_Tx, ComIPduSignalRef=BMC_Pack_SN_15_XIX_BMC_HV_08_XIX_HCP5_CANFD01_9e4c6742_Tx, ComIPduSignalRef=BMC_Pack_SN_16_XIX_BMC_HV_08_XIX_HCP5_CANFD01_57536ffd_Tx, ComIPduSignalRef=BMC_Pack_SN_17_XIX_BMC_HV_08_XIX_HCP5_CANFD01_a6896a57_Tx, ComIPduSignalRef=BMC_Pack_SN_18_XIX_BMC_HV_08_XIX_HCP5_CANFD01_fd084c96_Tx, ComIPduSignalRef=BMC_Pack_SN_19_XIX_BMC_HV_08_XIX_HCP5_CANFD01_0cd2493c_Tx, ComIPduSignalRef=BMC_Pack_SN_20_XIX_BMC_HV_08_XIX_HCP5_CANFD01_450bc9d7_Tx, ComIPduSignalRef=BMC_Pack_SN_21_XIX_BMC_HV_08_XIX_HCP5_CANFD01_b4d1cc7d_Tx, ComIPduSignalRef=BMC_Pack_SN_22_XIX_BMC_HV_08_XIX_HCP5_CANFD01_7dcec4c2_Tx, ComIPduSignalRef=BMC_Pack_SN_23_XIX_BMC_HV_08_XIX_HCP5_CANFD01_8c14c168_Tx, ComIPduSignalRef=BMC_Pack_SN_24_XIX_BMC_HV_08_XIX_HCP5_CANFD01_3481d3fd_Tx, ComIPduSignalRef=BMC_Pack_SN_25_XIX_BMC_HV_08_XIX_HCP5_CANFD01_c55bd657_Tx, ComIPduSignalRef=BMC_Pack_SN_26_XIX_BMC_HV_08_XIX_HCP5_CANFD01_0c44dee8_Tx, ComIPduSignalRef=BMC_RtmWarnBattUnautorisiert_XIX_BMC_HV_08_XIX_HCP5_CANFD01_afa1cdce_Tx, ComIPduSignalRef=BMC_RtmWarnPackKommunikation_XIX_BMC_HV_08_XIX_HCP5_CANFD01_49192821_Tx, ComIPduSignalRef=BMC_RtmWarnPackUeberladen_XIX_BMC_HV_08_XIX_HCP5_CANFD01_cef699a9_Tx, ComIPduSignalRef=BMC_RtmWarnSocHoch_XIX_BMC_HV_08_XIX_HCP5_CANFD01_3e921985_Tx, ComIPduSignalRef=BMC_RtmWarnSocNiedrig_XIX_BMC_HV_08_XIX_HCP5_CANFD01_e8831b4c_Tx, ComIPduSignalRef=BMC_RtmWarnSocSprung_XIX_BMC_HV_08_XIX_HCP5_CANFD01_4f634010_Tx, ComIPduSignalRef=BMC_RtmWarnTZelleDiff_XIX_BMC_HV_08_XIX_HCP5_CANFD01_733ec90e_Tx, ComIPduSignalRef=BMC_RtmWarnTZelleMax_XIX_BMC_HV_08_XIX_HCP5_CANFD01_45027cb0_Tx, ComIPduSignalRef=BMC_RtmWarnTZelleMin_XIX_BMC_HV_08_XIX_HCP5_CANFD01_7df184bf_Tx, ComIPduSignalRef=BMC_RtmWarnUPackMax_XIX_BMC_HV_08_XIX_HCP5_CANFD01_d9381a91_Tx, ComIPduSignalRef=BMC_RtmWarnUPackMin_XIX_BMC_HV_08_XIX_HCP5_CANFD01_e1cbe29e_Tx, ComIPduSignalRef=BMC_RtmWarnUZelleMax_XIX_BMC_HV_08_XIX_HCP5_CANFD01_ea46eef7_Tx, ComIPduSignalRef=BMC_RtmWarnUZelleMin_XIX_BMC_HV_08_XIX_HCP5_CANFD01_d2b516f8_Tx, ComIPduSignalRef=BMC_RtmWarnUeberstrom_XIX_BMC_HV_08_XIX_HCP5_CANFD01_e0808499_Tx, ComIPduSignalRef=BMC_RtmWarnZelleZustand_XIX_BMC_HV_08_XIX_HCP5_CANFD01_688df887_Tx, ComPduIdRef=EcucPduCollection/BMC_HV_08_XIX_HCP5_CANFD01_fbc0b232_Tx
          ComTxIPdu: ComTxIPduUnusedAreasDefault=0
            ComTxModeTrue
              ComTxMode: ComTxModeMode=PERIODIC, ComTxModeTimeOffset=0, ComTxModeTimePeriod=1
        BMC_HV_09_XIX_HCP5_CANFD01_149204d3_Tx: ComIPduDirection=SEND, ComIPduType=NORMAL, ComIPduGroupRef=BMC_HV_XIX_HCP5_CANFD01_Tx_3ba05bd9, ComIPduGroupRef=BMC_HV_XIX_PNC_26_HighVoltage_Charging_Tx_20012544, ComIPduSignalRef=BMC_Dauer_Entladeleistung_02_XIX_BMC_HV_09_XIX_HCP5_CANFD01_c6e0343a_Tx, ComIPduSignalRef=BMC_Dauer_Ladeleistung_02_XIX_BMC_HV_09_XIX_HCP5_CANFD01_1af3699d_Tx, ComIPduSignalRef=BMC_Max_Entladeleistung_02_XIX_BMC_HV_09_XIX_HCP5_CANFD01_a2b30339_Tx, ComIPduSignalRef=BMC_Max_Entladestrom_02_XIX_BMC_HV_09_XIX_HCP5_CANFD01_af177205_Tx, ComIPduSignalRef=BMC_Max_Ladeleistung_02_XIX_BMC_HV_09_XIX_HCP5_CANFD01_a9e1b473_Tx, ComIPduSignalRef=BMC_Max_Ladestrom_02_XIX_BMC_HV_09_XIX_HCP5_CANFD01_e47fe8b0_Tx, ComPduIdRef=EcucPduCollection/BMC_HV_09_XIX_HCP5_CANFD01_149204d3_Tx
          ComTxIPdu: ComTxIPduUnusedAreasDefault=0
            ComTxModeTrue
              ComTxMode: ComTxModeMode=PERIODIC, ComTxModeTimeOffset=0, ComTxModeTimePeriod=0.1
        BMC_HV_10_XIX_BMC_CAN01_E2E_28add151_Tx: ComIPduDirection=SEND, ComIPduType=NORMAL, ComIPduGroupRef=BMC_HV_XIX_BMC_CAN01_Tx_2d622f96, ComIPduSignalGroupRef=SG_BMC_HV_10_XIX_BMC_CAN01_284dd772_Tx, ComPduIdRef=EcucPduCollection/BMC_HV_10_XIX_BMC_CAN01_E2E_28add151_Tx
          ComTxIPdu: ComTxIPduUnusedAreasDefault=0
            ComTxModeTrue
              ComTxMode: ComTxModeMode=DIRECT, ComTxModeNumberOfRepetitions=0, ComTxModeRepetitionPeriod=0
        BMC_HV_11_XIX_BMC_CAN01_E2E_ff4f5109_Tx: ComIPduDirection=SEND, ComIPduType=NORMAL, ComIPduGroupRef=BMC_HV_XIX_BMC_CAN01_Tx_2d622f96, ComIPduSignalGroupRef=SG_BMC_HV_11_XIX_BMC_CAN01_91b60c9a_Tx, ComPduIdRef=EcucPduCollection/BMC_HV_11_XIX_BMC_CAN01_E2E_ff4f5109_Tx
          ComTxIPdu: ComTxIPduUnusedAreasDefault=0
            ComTxModeTrue
              ComTxMode: ComTxModeMode=DIRECT, ComTxModeNumberOfRepetitions=0, ComTxModeRepetitionPeriod=0
        BMC_HV_12_XIX_BMC_CAN01_E2E_5c19d7a0_Tx: ComIPduDirection=SEND, ComIPduType=NORMAL, ComIPduGroupRef=BMC_HV_XIX_BMC_CAN01_Tx_2d622f96, ComIPduSignalGroupRef=SG_BMC_HV_12_XIX_BMC_CAN01_80cb66e3_Tx, ComPduIdRef=EcucPduCollection/BMC_HV_12_XIX_BMC_CAN01_E2E_5c19d7a0_Tx
          ComTxIPdu: ComTxIPduUnusedAreasDefault=0
            ComTxModeTrue
              ComTxMode: ComTxModeMode=DIRECT, ComTxModeNumberOfRepetitions=0, ComTxModeRepetitionPeriod=0
        BMC_HV_13_XIX_BMC_CAN01_E2E_8bfb57f8_Tx: ComIPduDirection=SEND, ComIPduType=NORMAL, ComIPduGroupRef=BMC_HV_XIX_BMC_CAN01_Tx_2d622f96, ComIPduSignalGroupRef=SG_BMC_HV_13_XIX_BMC_CAN01_3930bd0b_Tx, ComPduIdRef=EcucPduCollection/BMC_HV_13_XIX_BMC_CAN01_E2E_8bfb57f8_Tx
          ComTxIPdu: ComTxIPduUnusedAreasDefault=0
            ComTxModeTrue
              ComTxMode: ComTxModeMode=DIRECT, ComTxModeNumberOfRepetitions=0, ComTxModeRepetitionPeriod=0
        BMC_HV_14_XIX_HCP5_CANFD01_30db4b60_Tx: ComIPduDirection=SEND, ComIPduType=NORMAL, ComIPduGroupRef=BMC_HV_XIX_HCP5_CANFD01_Tx_3ba05bd9, ComIPduGroupRef=BMC_HV_XIX_PNC_26_HighVoltage_Charging_Tx_20012544, ComIPduSignalRef=BMC_EnergieVorhalt_XIX_BMC_HV_14_XIX_HCP5_CANFD01_33ff2903_Tx, ComIPduSignalRef=BMC_PCM_VTD_Freeze_Req_XIX_BMC_HV_14_XIX_HCP5_CANFD01_f4d42d86_Tx, ComIPduSignalRef=BMC_PCM_VTD_LifeTimeReset_Req_XIX_BMC_HV_14_XIX_HCP5_CANFD01_85186af1_Tx, ComIPduSignalRef=BMC_PCM_VTD_LifeTimeReset_Resp_XIX_BMC_HV_14_XIX_HCP5_CANFD01_fcdaf120_Tx, ComIPduSignalRef=BMC_PCM_VTD_RecentReset_Req_XIX_BMC_HV_14_XIX_HCP5_CANFD01_827fd905_Tx, ComIPduSignalRef=BMC_Range_Indikator_XIX_BMC_HV_14_XIX_HCP5_CANFD01_21f53466_Tx, ComIPduSignalRef=BMC_UBE_Indik_last_update_km_XIX_BMC_HV_14_XIX_HCP5_CANFD01_c953ffca_Tx, ComIPduSignalRef=BMC_UBE_Indikator_XIX_BMC_HV_14_XIX_HCP5_CANFD01_be7dd75f_Tx, ComPduIdRef=EcucPduCollection/BMC_HV_14_XIX_HCP5_CANFD01_30db4b60_Tx
          ComTxIPdu: ComTxIPduUnusedAreasDefault=0
            ComTxModeTrue
              ComTxMode: ComTxModeMode=PERIODIC, ComTxModeTimeOffset=0, ComTxModeTimePeriod=0.1
        Charisma_20_XIX_HCP5_CANFD01_f51eced8_Rx: ComIPduDirection=RECEIVE, ComIPduType=NORMAL, ComIPduGroupRef=BMC_HV_XIX_HCP5_CANFD01_Rx_6dfafc5f, ComIPduGroupRef=BMC_HV_XIX_PNC_07_Basefunction_CrossSection_Rx_4fb7c882, ComIPduSignalRef=CHA_ReqPrgBms_XIX_Charisma_20_XIX_HCP5_CANFD01_9364cd45_Rx, ComPduIdRef=EcucPduCollection/Charisma_20_XIX_HCP5_CANFD01_f51eced8_Rx
        ClampControl_01_XIX_HCP5_CANFD01_8c24343b_Rx: ComIPduDirection=RECEIVE, ComIPduType=NORMAL, ComIPduGroupRef=BMC_HV_XIX_HCP5_CANFD01_Rx_6dfafc5f, ComIPduGroupRef=BMC_HV_XIX_PNC_06_Basefunction_ComfortLight_Rx_7861a7a5, ComIPduSignalRef=KST_KL_15_XIX_ClampControl_01_XIX_HCP5_CANFD01_06301fa5_Rx, ComPduIdRef=EcucPduCollection/ClampControl_01_XIX_HCP5_CANFD01_8c24343b_Rx
        ComIPduPnc_EIRA_CAN_Rx: ComIPduDirection=RECEIVE, ComIPduSignalRef=ComSignalPnc_EIRA_CAN_Rx, ComPduIdRef=PduPnc_EIRA_CAN_Rx
        DCDC_04_XIX_HCP5_CANFD01_8ca88b97_Rx: ComIPduDirection=RECEIVE, ComIPduType=NORMAL, ComIPduGroupRef=BMC_HV_XIX_HCP5_CANFD01_Rx_6dfafc5f, ComIPduGroupRef=BMC_HV_XIX_PNC_26_HighVoltage_Charging_Rx_765b82c2, ComIPduSignalRef=DC_IstLeistung_HV_XIX_DCDC_04_XIX_HCP5_CANFD01_7ce6573a_Rx, ComPduIdRef=EcucPduCollection/DCDC_04_XIX_HCP5_CANFD01_8ca88b97_Rx
        DCDC_NV_CALID_XIX_HCP5_CANFD01_46b970f2_Rx: ComIPduDirection=RECEIVE, ComIPduType=NORMAL, ComIPduGroupRef=BMC_HV_XIX_HCP5_CANFD01_Rx_6dfafc5f, ComIPduGroupRef=BMC_HV_XIX_PNC_40_Diagnosis_Energy_Rx_36e9c670, ComIPduSignalRef=DCDC_NV_CALID_Index_01_XIX_DCDC_NV_CALID_XIX_HCP5_CANFD01_8f57e482_Rx, ComIPduSignalRef=DCDC_NV_CALID_Index_02_XIX_DCDC_NV_CALID_XIX_HCP5_CANFD01_ebb79f7c_Rx, ComIPduSignalRef=DCDC_NV_CALID_Index_03_XIX_DCDC_NV_CALID_XIX_HCP5_CANFD01_7ec74be9_Rx, ComIPduSignalRef=DCDC_NV_CALID_Index_04_XIX_DCDC_NV_CALID_XIX_HCP5_CANFD01_22776880_Rx, ComIPduSignalRef=DCDC_NV_CALID_Index_05_XIX_DCDC_NV_CALID_XIX_HCP5_CANFD01_b707bc15_Rx, ComIPduSignalRef=DCDC_NV_CALID_Index_06_XIX_DCDC_NV_CALID_XIX_HCP5_CANFD01_d3e7c7eb_Rx, ComIPduSignalRef=DCDC_NV_CALID_Index_07_XIX_DCDC_NV_CALID_XIX_HCP5_CANFD01_4697137e_Rx, ComIPduSignalRef=DCDC_NV_CALID_Index_08_XIX_DCDC_NV_CALID_XIX_HCP5_CANFD01_6a878139_Rx, ComIPduSignalRef=DCDC_NV_CALID_Index_09_XIX_DCDC_NV_CALID_XIX_HCP5_CANFD01_fff755ac_Rx, ComIPduSignalRef=DCDC_NV_CALID_Index_10_XIX_DCDC_NV_CALID_XIX_HCP5_CANFD01_9ad72708_Rx, ComIPduSignalRef=DCDC_NV_CALID_Index_11_XIX_DCDC_NV_CALID_XIX_HCP5_CANFD01_0fa7f39d_Rx, ComIPduSignalRef=DCDC_NV_CALID_Index_12_XIX_DCDC_NV_CALID_XIX_HCP5_CANFD01_6b478863_Rx, ComIPduSignalRef=DCDC_NV_CALID_Index_13_XIX_DCDC_NV_CALID_XIX_HCP5_CANFD01_fe375cf6_Rx, ComIPduSignalRef=DCDC_NV_CALID_Index_14_XIX_DCDC_NV_CALID_XIX_HCP5_CANFD01_a2877f9f_Rx, ComIPduSignalRef=DCDC_NV_CALID_Index_15_XIX_DCDC_NV_CALID_XIX_HCP5_CANFD01_37f7ab0a_Rx, ComIPduSignalRef=DCDC_NV_CALID_Index_16_XIX_DCDC_NV_CALID_XIX_HCP5_CANFD01_5317d0f4_Rx, ComPduIdRef=EcucPduCollection/DCDC_NV_CALID_XIX_HCP5_CANFD01_46b970f2_Rx
        DCDC_NV_CVN_XIX_HCP5_CANFD01_55665719_Rx: ComIPduDirection=RECEIVE, ComIPduType=NORMAL, ComIPduGroupRef=BMC_HV_XIX_HCP5_CANFD01_Rx_6dfafc5f, ComIPduGroupRef=BMC_HV_XIX_PNC_40_Diagnosis_Energy_Rx_36e9c670, ComIPduSignalRef=DCDC_NV_CVN_Byte_1_XIX_DCDC_NV_CVN_XIX_HCP5_CANFD01_f6f9fc9d_Rx, ComIPduSignalRef=DCDC_NV_CVN_Byte_2_XIX_DCDC_NV_CVN_XIX_HCP5_CANFD01_9b7f0fc7_Rx, ComIPduSignalRef=DCDC_NV_CVN_Byte_3_XIX_DCDC_NV_CVN_XIX_HCP5_CANFD01_bffd5ef1_Rx, ComIPduSignalRef=DCDC_NV_CVN_Byte_4_XIX_DCDC_NV_CVN_XIX_HCP5_CANFD01_4072e973_Rx, ComIPduSignalRef=DCDC_NV_CVN_VLD_XIX_DCDC_NV_CVN_XIX_HCP5_CANFD01_0c97b82e_Rx, ComPduIdRef=EcucPduCollection/DCDC_NV_CVN_XIX_HCP5_CANFD01_55665719_Rx
        DCDC_NV_Komponentenfehler_01_XIX_HCP5_CANFD01_dd687766_Rx: ComIPduDirection=RECEIVE, ComIPduType=NORMAL, ComIPduGroupRef=BMC_HV_XIX_HCP5_CANFD01_Rx_6dfafc5f, ComIPduGroupRef=BMC_HV_XIX_PNC_26_HighVoltage_Charging_Rx_765b82c2, ComIPduSignalRef=DCDC_NV_Komponentenfehler_01_XIX_DCDC_NV_Komponentenfehler_01_XIX_HCP5_CANFD01_d45848d1_Rx, ComIPduSignalRef=DCDC_NV_Komponentenfehler_02_XIX_DCDC_NV_Komponentenfehler_01_XIX_HCP5_CANFD01_516a5a25_Rx, ComIPduSignalRef=DCDC_NV_Komponentenfehler_03_XIX_DCDC_NV_Komponentenfehler_01_XIX_HCP5_CANFD01_9b54a9b6_Rx, ComIPduSignalRef=DCDC_NV_Komponentenfehler_04_XIX_DCDC_NV_Komponentenfehler_01_XIX_HCP5_CANFD01_807f798c_Rx, ComIPduSignalRef=DCDC_NV_Komponentenfehler_05_XIX_DCDC_NV_Komponentenfehler_01_XIX_HCP5_CANFD01_4a418a1f_Rx, ComIPduSignalRef=DCDC_NV_Komponentenfehler_06_XIX_DCDC_NV_Komponentenfehler_01_XIX_HCP5_CANFD01_cf7398eb_Rx, ComIPduSignalRef=DCDC_NV_Komponentenfehler_07_XIX_DCDC_NV_Komponentenfehler_01_XIX_HCP5_CANFD01_054d6b78_Rx, ComIPduSignalRef=DCDC_NV_Komponentenfehler_08_XIX_DCDC_NV_Komponentenfehler_01_XIX_HCP5_CANFD01_f924389f_Rx, ComIPduSignalRef=DCDC_NV_Komponentenfehler_09_XIX_DCDC_NV_Komponentenfehler_01_XIX_HCP5_CANFD01_331acb0c_Rx, ComIPduSignalRef=DCDC_NV_Komponentenfehler_10_XIX_DCDC_NV_Komponentenfehler_01_XIX_HCP5_CANFD01_77aa474f_Rx, ComIPduSignalRef=DCDC_NV_Komponentenfehler_11_XIX_DCDC_NV_Komponentenfehler_01_XIX_HCP5_CANFD01_bd94b4dc_Rx, ComIPduSignalRef=DCDC_NV_Komponentenfehler_12_XIX_DCDC_NV_Komponentenfehler_01_XIX_HCP5_CANFD01_38a6a628_Rx, ComIPduSignalRef=DCDC_NV_Komponentenfehler_13_XIX_DCDC_NV_Komponentenfehler_01_XIX_HCP5_CANFD01_f29855bb_Rx, ComIPduSignalRef=DCDC_NV_Komponentenfehler_14_XIX_DCDC_NV_Komponentenfehler_01_XIX_HCP5_CANFD01_e9b38581_Rx, ComIPduSignalRef=DCDC_NV_Komponentenfehler_15_XIX_DCDC_NV_Komponentenfehler_01_XIX_HCP5_CANFD01_238d7612_Rx, ComIPduSignalRef=DCDC_NV_Komponentenfehler_16_XIX_DCDC_NV_Komponentenfehler_01_XIX_HCP5_CANFD01_a6bf64e6_Rx, ComIPduSignalRef=DCDC_NV_Komponentenfehler_17_XIX_DCDC_NV_Komponentenfehler_01_XIX_HCP5_CANFD01_6c819775_Rx, ComIPduSignalRef=DCDC_NV_Komponentenfehler_18_XIX_DCDC_NV_Komponentenfehler_01_XIX_HCP5_CANFD01_90e8c492_Rx, ComIPduSignalRef=DCDC_NV_Komponentenfehler_19_XIX_DCDC_NV_Komponentenfehler_01_XIX_HCP5_CANFD01_5ad63701_Rx, ComIPduSignalRef=DCDC_NV_Komponentenfehler_20_XIX_DCDC_NV_Komponentenfehler_01_XIX_HCP5_CANFD01_cdff4358_Rx, ComIPduSignalRef=DCDC_NV_Komponentenfehler_21_XIX_DCDC_NV_Komponentenfehler_01_XIX_HCP5_CANFD01_07c1b0cb_Rx, ComIPduSignalRef=DCDC_NV_Komponentenfehler_22_XIX_DCDC_NV_Komponentenfehler_01_XIX_HCP5_CANFD01_82f3a23f_Rx, ComIPduSignalRef=DCDC_NV_Komponentenfehler_23_XIX_DCDC_NV_Komponentenfehler_01_XIX_HCP5_CANFD01_48cd51ac_Rx, ComIPduSignalRef=DCDC_NV_Komponentenfehler_24_XIX_DCDC_NV_Komponentenfehler_01_XIX_HCP5_CANFD01_53e68196_Rx, ComIPduSignalRef=DCDC_NV_Komponentenfehler_25_XIX_DCDC_NV_Komponentenfehler_01_XIX_HCP5_CANFD01_99d87205_Rx, ComIPduSignalRef=DCDC_NV_Komponentenfehler_26_XIX_DCDC_NV_Komponentenfehler_01_XIX_HCP5_CANFD01_1cea60f1_Rx, ComIPduSignalRef=DCDC_NV_Komponentenfehler_27_XIX_DCDC_NV_Komponentenfehler_01_XIX_HCP5_CANFD01_d6d49362_Rx, ComIPduSignalRef=DCDC_NV_Komponentenfehler_28_XIX_DCDC_NV_Komponentenfehler_01_XIX_HCP5_CANFD01_2abdc085_Rx, ComIPduSignalRef=DCDC_NV_Komponentenfehler_29_XIX_DCDC_NV_Komponentenfehler_01_XIX_HCP5_CANFD01_e0833316_Rx, ComIPduSignalRef=DCDC_NV_Komponentenfehler_VLD_XIX_DCDC_NV_Komponentenfehler_01_XIX_HCP5_CANFD01_edf78d03_Rx, ComPduIdRef=EcucPduCollection/DCDC_NV_Komponentenfehler_01_XIX_HCP5_CANFD01_dd687766_Rx
        DCDC_NV_Komponentenfehler_02_XIX_HCP5_CANFD01_37eeaa04_Rx: ComIPduDirection=RECEIVE, ComIPduType=NORMAL, ComIPduGroupRef=BMC_HV_XIX_HCP5_CANFD01_Rx_6dfafc5f, ComIPduGroupRef=BMC_HV_XIX_PNC_26_HighVoltage_Charging_Rx_765b82c2, ComIPduSignalRef=DCDC_NV_Komponentenfehler_30_XIX_DCDC_NV_Komponentenfehler_02_XIX_HCP5_CANFD01_4eb56237_Rx, ComIPduSignalRef=DCDC_NV_Komponentenfehler_31_XIX_DCDC_NV_Komponentenfehler_02_XIX_HCP5_CANFD01_848b91a4_Rx, ComIPduSignalRef=DCDC_NV_Komponentenfehler_32_XIX_DCDC_NV_Komponentenfehler_02_XIX_HCP5_CANFD01_01b98350_Rx, ComIPduSignalRef=DCDC_NV_Komponentenfehler_33_XIX_DCDC_NV_Komponentenfehler_02_XIX_HCP5_CANFD01_cb8770c3_Rx, ComIPduSignalRef=DCDC_NV_Komponentenfehler_34_XIX_DCDC_NV_Komponentenfehler_02_XIX_HCP5_CANFD01_d0aca0f9_Rx, ComIPduSignalRef=DCDC_NV_Komponentenfehler_35_XIX_DCDC_NV_Komponentenfehler_02_XIX_HCP5_CANFD01_1a92536a_Rx, ComIPduSignalRef=DCDC_NV_Komponentenfehler_36_XIX_DCDC_NV_Komponentenfehler_02_XIX_HCP5_CANFD01_9fa0419e_Rx, ComIPduSignalRef=DCDC_NV_Komponentenfehler_37_XIX_DCDC_NV_Komponentenfehler_02_XIX_HCP5_CANFD01_559eb20d_Rx, ComIPduSignalRef=DCDC_NV_Komponentenfehler_38_XIX_DCDC_NV_Komponentenfehler_02_XIX_HCP5_CANFD01_a9f7e1ea_Rx, ComIPduSignalRef=DCDC_NV_Komponentenfehler_39_XIX_DCDC_NV_Komponentenfehler_02_XIX_HCP5_CANFD01_63c91279_Rx, ComIPduSignalRef=DCDC_NV_Komponentenfehler_40_XIX_DCDC_NV_Komponentenfehler_02_XIX_HCP5_CANFD01_88a29055_Rx, ComIPduSignalRef=DCDC_NV_Komponentenfehler_41_XIX_DCDC_NV_Komponentenfehler_02_XIX_HCP5_CANFD01_429c63c6_Rx, ComIPduSignalRef=DCDC_NV_Komponentenfehler_42_XIX_DCDC_NV_Komponentenfehler_02_XIX_HCP5_CANFD01_c7ae7132_Rx, ComIPduSignalRef=DCDC_NV_Komponentenfehler_43_XIX_DCDC_NV_Komponentenfehler_02_XIX_HCP5_CANFD01_0d9082a1_Rx, ComIPduSignalRef=DCDC_NV_Komponentenfehler_44_XIX_DCDC_NV_Komponentenfehler_02_XIX_HCP5_CANFD01_16bb529b_Rx, ComIPduSignalRef=DCDC_NV_Komponentenfehler_45_XIX_DCDC_NV_Komponentenfehler_02_XIX_HCP5_CANFD01_dc85a108_Rx, ComIPduSignalRef=DCDC_NV_Komponentenfehler_46_XIX_DCDC_NV_Komponentenfehler_02_XIX_HCP5_CANFD01_59b7b3fc_Rx, ComIPduSignalRef=DCDC_NV_Komponentenfehler_47_XIX_DCDC_NV_Komponentenfehler_02_XIX_HCP5_CANFD01_9389406f_Rx, ComIPduSignalRef=DCDC_NV_Komponentenfehler_48_XIX_DCDC_NV_Komponentenfehler_02_XIX_HCP5_CANFD01_6fe01388_Rx, ComIPduSignalRef=DCDC_NV_Komponentenfehler_49_XIX_DCDC_NV_Komponentenfehler_02_XIX_HCP5_CANFD01_a5dee01b_Rx, ComIPduSignalRef=DCDC_NV_Komponentenfehler_50_XIX_DCDC_NV_Komponentenfehler_02_XIX_HCP5_CANFD01_e16e6c58_Rx, ComIPduSignalRef=DCDC_NV_Komponentenfehler_51_XIX_DCDC_NV_Komponentenfehler_02_XIX_HCP5_CANFD01_2b509fcb_Rx, ComIPduSignalRef=DCDC_NV_Komponentenfehler_52_XIX_DCDC_NV_Komponentenfehler_02_XIX_HCP5_CANFD01_ae628d3f_Rx, ComIPduSignalRef=DCDC_NV_Komponentenfehler_53_XIX_DCDC_NV_Komponentenfehler_02_XIX_HCP5_CANFD01_645c7eac_Rx, ComIPduSignalRef=DCDC_NV_Komponentenfehler_54_XIX_DCDC_NV_Komponentenfehler_02_XIX_HCP5_CANFD01_7f77ae96_Rx, ComIPduSignalRef=DCDC_NV_Komponentenfehler_55_XIX_DCDC_NV_Komponentenfehler_02_XIX_HCP5_CANFD01_b5495d05_Rx, ComIPduSignalRef=DCDC_NV_Komponentenfehler_56_XIX_DCDC_NV_Komponentenfehler_02_XIX_HCP5_CANFD01_307b4ff1_Rx, ComIPduSignalRef=DCDC_NV_Komponentenfehler_57_XIX_DCDC_NV_Komponentenfehler_02_XIX_HCP5_CANFD01_fa45bc62_Rx, ComIPduSignalRef=DCDC_NV_Komponentenfehler_58_XIX_DCDC_NV_Komponentenfehler_02_XIX_HCP5_CANFD01_062cef85_Rx, ComIPduSignalRef=DCDC_NV_Komponentenfehler_59_XIX_DCDC_NV_Komponentenfehler_02_XIX_HCP5_CANFD01_cc121c16_Rx, ComIPduSignalRef=DCDC_NV_Komponentenfehler_60_XIX_DCDC_NV_Komponentenfehler_02_XIX_HCP5_CANFD01_5b3b684f_Rx, ComPduIdRef=EcucPduCollection/DCDC_NV_Komponentenfehler_02_XIX_HCP5_CANFD01_37eeaa04_Rx
        DCDC_NV_Komponentenfehler_03_XIX_HCP5_CANFD01_d8bc1ce5_Rx: ComIPduDirection=RECEIVE, ComIPduType=NORMAL, ComIPduGroupRef=BMC_HV_XIX_HCP5_CANFD01_Rx_6dfafc5f, ComIPduGroupRef=BMC_HV_XIX_PNC_26_HighVoltage_Charging_Rx_765b82c2, ComIPduSignalRef=DCDC_NV_Komponentenfehler_61_XIX_DCDC_NV_Komponentenfehler_03_XIX_HCP5_CANFD01_7e572d3d_Rx, ComIPduSignalRef=DCDC_NV_Komponentenfehler_62_XIX_DCDC_NV_Komponentenfehler_03_XIX_HCP5_CANFD01_fb653fc9_Rx, ComIPduSignalRef=DCDC_NV_Komponentenfehler_63_XIX_DCDC_NV_Komponentenfehler_03_XIX_HCP5_CANFD01_315bcc5a_Rx, ComIPduSignalRef=DCDC_NV_Komponentenfehler_64_XIX_DCDC_NV_Komponentenfehler_03_XIX_HCP5_CANFD01_2a701c60_Rx, ComIPduSignalRef=DCDC_NV_Komponentenfehler_65_XIX_DCDC_NV_Komponentenfehler_03_XIX_HCP5_CANFD01_e04eeff3_Rx, ComIPduSignalRef=DCDC_NV_Komponentenfehler_66_XIX_DCDC_NV_Komponentenfehler_03_XIX_HCP5_CANFD01_657cfd07_Rx, ComIPduSignalRef=DCDC_NV_Komponentenfehler_67_XIX_DCDC_NV_Komponentenfehler_03_XIX_HCP5_CANFD01_af420e94_Rx, ComIPduSignalRef=DCDC_NV_Komponentenfehler_68_XIX_DCDC_NV_Komponentenfehler_03_XIX_HCP5_CANFD01_532b5d73_Rx, ComIPduSignalRef=DCDC_NV_Komponentenfehler_69_XIX_DCDC_NV_Komponentenfehler_03_XIX_HCP5_CANFD01_9915aee0_Rx, ComIPduSignalRef=DCDC_NV_Komponentenfehler_70_XIX_DCDC_NV_Komponentenfehler_03_XIX_HCP5_CANFD01_dda522a3_Rx, ComIPduSignalRef=DCDC_NV_Komponentenfehler_71_XIX_DCDC_NV_Komponentenfehler_03_XIX_HCP5_CANFD01_179bd130_Rx, ComIPduSignalRef=DCDC_NV_Komponentenfehler_72_XIX_DCDC_NV_Komponentenfehler_03_XIX_HCP5_CANFD01_92a9c3c4_Rx, ComIPduSignalRef=DCDC_NV_Komponentenfehler_73_XIX_DCDC_NV_Komponentenfehler_03_XIX_HCP5_CANFD01_58973057_Rx, ComIPduSignalRef=DCDC_NV_Komponentenfehler_74_XIX_DCDC_NV_Komponentenfehler_03_XIX_HCP5_CANFD01_43bce06d_Rx, ComIPduSignalRef=DCDC_NV_Komponentenfehler_75_XIX_DCDC_NV_Komponentenfehler_03_XIX_HCP5_CANFD01_898213fe_Rx, ComIPduSignalRef=DCDC_NV_Komponentenfehler_76_XIX_DCDC_NV_Komponentenfehler_03_XIX_HCP5_CANFD01_0cb0010a_Rx, ComIPduSignalRef=DCDC_NV_Komponentenfehler_77_XIX_DCDC_NV_Komponentenfehler_03_XIX_HCP5_CANFD01_c68ef299_Rx, ComIPduSignalRef=DCDC_NV_Komponentenfehler_78_XIX_DCDC_NV_Komponentenfehler_03_XIX_HCP5_CANFD01_3ae7a17e_Rx, ComIPduSignalRef=DCDC_NV_Komponentenfehler_79_XIX_DCDC_NV_Komponentenfehler_03_XIX_HCP5_CANFD01_f0d952ed_Rx, ComIPduSignalRef=DCDC_NV_Komponentenfehler_80_XIX_DCDC_NV_Komponentenfehler_03_XIX_HCP5_CANFD01_e3373c2b_Rx, ComPduIdRef=EcucPduCollection/DCDC_NV_Komponentenfehler_03_XIX_HCP5_CANFD01_d8bc1ce5_Rx
        DCDC_NV_Komponentenfehler_04_XIX_HCP5_CANFD01_39921681_Rx: ComIPduDirection=RECEIVE, ComIPduType=NORMAL, ComIPduGroupRef=BMC_HV_XIX_HCP5_CANFD01_Rx_6dfafc5f, ComIPduGroupRef=BMC_HV_XIX_PNC_26_HighVoltage_Charging_Rx_765b82c2, ComIPduSignalRef=DCDC_NV_Komponentenfehler_3_10_XIX_DCDC_NV_Komponentenfehler_04_XIX_HCP5_CANFD01_5d91a7d8_Rx, ComIPduSignalRef=DCDC_NV_Komponentenfehler_3_11_XIX_DCDC_NV_Komponentenfehler_04_XIX_HCP5_CANFD01_97af544b_Rx, ComIPduSignalRef=DCDC_NV_Komponentenfehler_3_12_XIX_DCDC_NV_Komponentenfehler_04_XIX_HCP5_CANFD01_129d46bf_Rx, ComIPduSignalRef=DCDC_NV_Komponentenfehler_3_13_XIX_DCDC_NV_Komponentenfehler_04_XIX_HCP5_CANFD01_d8a3b52c_Rx, ComIPduSignalRef=DCDC_NV_Komponentenfehler_3_14_XIX_DCDC_NV_Komponentenfehler_04_XIX_HCP5_CANFD01_c3886516_Rx, ComIPduSignalRef=DCDC_NV_Komponentenfehler_3_15_XIX_DCDC_NV_Komponentenfehler_04_XIX_HCP5_CANFD01_09b69685_Rx, ComIPduSignalRef=DCDC_NV_Komponentenfehler_3_16_XIX_DCDC_NV_Komponentenfehler_04_XIX_HCP5_CANFD01_8c848471_Rx, ComIPduSignalRef=DCDC_NV_Komponentenfehler_3_1_XIX_DCDC_NV_Komponentenfehler_04_XIX_HCP5_CANFD01_4d423624_Rx, ComIPduSignalRef=DCDC_NV_Komponentenfehler_3_2_XIX_DCDC_NV_Komponentenfehler_04_XIX_HCP5_CANFD01_c87024d0_Rx, ComIPduSignalRef=DCDC_NV_Komponentenfehler_3_3_XIX_DCDC_NV_Komponentenfehler_04_XIX_HCP5_CANFD01_024ed743_Rx, ComIPduSignalRef=DCDC_NV_Komponentenfehler_3_4_XIX_DCDC_NV_Komponentenfehler_04_XIX_HCP5_CANFD01_19650779_Rx, ComIPduSignalRef=DCDC_NV_Komponentenfehler_3_5_XIX_DCDC_NV_Komponentenfehler_04_XIX_HCP5_CANFD01_d35bf4ea_Rx, ComIPduSignalRef=DCDC_NV_Komponentenfehler_3_6_XIX_DCDC_NV_Komponentenfehler_04_XIX_HCP5_CANFD01_5669e61e_Rx, ComIPduSignalRef=DCDC_NV_Komponentenfehler_3_7_XIX_DCDC_NV_Komponentenfehler_04_XIX_HCP5_CANFD01_9c57158d_Rx, ComIPduSignalRef=DCDC_NV_Komponentenfehler_3_8_XIX_DCDC_NV_Komponentenfehler_04_XIX_HCP5_CANFD01_603e466a_Rx, ComIPduSignalRef=DCDC_NV_Komponentenfehler_3_9_XIX_DCDC_NV_Komponentenfehler_04_XIX_HCP5_CANFD01_aa00b5f9_Rx, ComPduIdRef=EcucPduCollection/DCDC_NV_Komponentenfehler_04_XIX_HCP5_CANFD01_39921681_Rx
        DEV_Hybrid_01_Req_00_XIX_HCP5_CANFD01_5661b344_Rx: ComIPduDirection=RECEIVE, ComIPduType=NORMAL, ComIPduGroupRef=BMC_HV_XIX_HCP5_CANFD01_Rx_6dfafc5f, ComIPduSignalRef=DEV_Hybrid_01_Req_00_FD_Data_XIX_DEV_Hybrid_01_Req_00_XIX_HCP5_CANFD01_5095de8e_Rx, ComPduIdRef=EcucPduCollection/DEV_Hybrid_01_Req_00_XIX_HCP5_CANFD01_5661b344_Rx
        DEV_Hybrid_01_Resp_FF_XIX_HCP5_CANFD01_7b20ac63_Tx: ComIPduDirection=SEND, ComIPduType=NORMAL, ComIPduGroupRef=BMC_HV_XIX_HCP5_CANFD01_Tx_3ba05bd9, ComIPduSignalRef=DEV_Hybrid_01_Resp_FF_FD_Data_XIX_DEV_Hybrid_01_Resp_FF_XIX_HCP5_CANFD01_c5a91adf_Tx, ComPduIdRef=EcucPduCollection/DEV_Hybrid_01_Resp_FF_XIX_HCP5_CANFD01_7b20ac63_Tx
          ComTxIPdu: ComTxIPduUnusedAreasDefault=0
            ComTxModeTrue
              ComTxMode: ComTxModeMode=DIRECT, ComTxModeNumberOfRepetitions=0, ComTxModeRepetitionPeriod=0
        DS_Hybrid_01_XIX_HCP5_CANFD01_b3d0b839_Tx: ComIPduDirection=SEND, ComIPduType=NORMAL, ComIPduGroupRef=BMC_HV_XIX_HCP5_CANFD01_Tx_3ba05bd9, ComIPduGroupRef=BMC_HV_XIX_PNC_01_CarWakeUp_Tx_29969a84, ComIPduGroupRef=BMC_HV_XIX_PNC_40_Diagnosis_Energy_Tx_60b361f6, ComIPduSignalRef=DS_Hybrid_01_ConfDTCChanged_XIX_DS_Hybrid_01_XIX_HCP5_CANFD01_2044f478_Tx, ComIPduSignalRef=DS_Hybrid_01_DiagAdr_XIX_DS_Hybrid_01_XIX_HCP5_CANFD01_ecf98c5e_Tx, ComIPduSignalRef=DS_Hybrid_01_IdentValid_XIX_DS_Hybrid_01_XIX_HCP5_CANFD01_1ffc9aaf_Tx, ComIPduSignalRef=DS_Hybrid_01_Lokalaktiv_XIX_DS_Hybrid_01_XIX_HCP5_CANFD01_8a807ec5_Tx, ComIPduSignalRef=DS_Hybrid_01_MemSel10Changed_XIX_DS_Hybrid_01_XIX_HCP5_CANFD01_040fbf45_Tx, ComIPduSignalRef=DS_Hybrid_01_MemSelChanged_XIX_DS_Hybrid_01_XIX_HCP5_CANFD01_a7dec6c2_Tx, ComIPduSignalRef=DS_Hybrid_01_StMemChanged_XIX_DS_Hybrid_01_XIX_HCP5_CANFD01_c527befd_Tx, ComIPduSignalRef=DS_Hybrid_01_Subsystemaktiv_XIX_DS_Hybrid_01_XIX_HCP5_CANFD01_cb6ff8bb_Tx, ComIPduSignalRef=DS_Hybrid_01_TestFailedChanged_XIX_DS_Hybrid_01_XIX_HCP5_CANFD01_f799e5e7_Tx, ComIPduSignalRef=DS_Hybrid_01_WIRChanged_XIX_DS_Hybrid_01_XIX_HCP5_CANFD01_296545f7_Tx, ComPduIdRef=EcucPduCollection/DS_Hybrid_01_XIX_HCP5_CANFD01_b3d0b839_Tx
          ComTxIPdu: ComMinimumDelayTime=0.08, ComTxIPduUnusedAreasDefault=0
            ComTxModeTrue
              ComTxMode: ComTxModeMode=MIXED, ComTxModeNumberOfRepetitions=0, ComTxModeRepetitionPeriod=0, ComTxModeTimeOffset=0, ComTxModeTimePeriod=1
        Diagnose_01_XIX_HCP5_CANFD01_426f0ab5_Rx: ComIPduDirection=RECEIVE, ComIPduType=NORMAL, ComIPduGroupRef=BMC_HV_XIX_HCP5_CANFD01_Rx_6dfafc5f, ComIPduGroupRef=BMC_HV_XIX_PNC_07_Basefunction_CrossSection_Rx_4fb7c882, ComIPduGroupRef=BMC_HV_XIX_PNC_27_Timemaster_Timer_Rx_2db6b092, ComIPduSignalRef=DW_Kilometerstand_XIX_Diagnose_01_XIX_HCP5_CANFD01_78853316_Rx, ComIPduSignalRef=UH_Jahr_XIX_Diagnose_01_XIX_HCP5_CANFD01_d17ea5cb_Rx, ComIPduSignalRef=UH_Minute_XIX_Diagnose_01_XIX_HCP5_CANFD01_a1eb26ec_Rx, ComIPduSignalRef=UH_Monat_XIX_Diagnose_01_XIX_HCP5_CANFD01_f93e0419_Rx, ComIPduSignalRef=UH_Sekunde_XIX_Diagnose_01_XIX_HCP5_CANFD01_7411385f_Rx, ComIPduSignalRef=UH_Stunde_XIX_Diagnose_01_XIX_HCP5_CANFD01_7d2acaf0_Rx, ComIPduSignalRef=UH_Tag_XIX_Diagnose_01_XIX_HCP5_CANFD01_743028a3_Rx, ComPduIdRef=EcucPduCollection/Diagnose_01_XIX_HCP5_CANFD01_426f0ab5_Rx
        ELF_06_XIX_HCP5_CANFD01_d78b945c_Rx: ComIPduDirection=RECEIVE, ComIPduType=NORMAL, ComIPduGroupRef=BMC_HV_XIX_HCP5_CANFD01_Rx_6dfafc5f, ComIPduGroupRef=BMC_HV_XIX_PNC_26_HighVoltage_Charging_Rx_765b82c2, ComIPduSignalRef=HVLM_BCAM_Aktiv_XIX_ELF_06_XIX_HCP5_CANFD01_9b6861e7_Rx, ComPduIdRef=EcucPduCollection/ELF_06_XIX_HCP5_CANFD01_d78b945c_Rx
        HCP1_17_XIX_HCP5_CANFD01_3398d6b5_Rx: ComIPduDirection=RECEIVE, ComIPduType=NORMAL, ComIPduGroupRef=BMC_HV_XIX_HCP5_CANFD01_Rx_6dfafc5f, ComIPduGroupRef=BMC_HV_XIX_PNC_10_Powertrain_Rx_c7039922, ComIPduSignalRef=PCM_BMC_VTD_Freeze_Req_XIX_HCP1_17_XIX_HCP5_CANFD01_4dcab581_Rx, ComIPduSignalRef=PCM_BMC_VTD_LifeTimeReset_Req_XIX_HCP1_17_XIX_HCP5_CANFD01_b7cc45cb_Rx, ComIPduSignalRef=PCM_BMC_VTD_LifeTimeReset_Resp_XIX_HCP1_17_XIX_HCP5_CANFD01_37f0f42a_Rx, ComIPduSignalRef=PCM_BMC_VTD_RecentReset_Req_XIX_HCP1_17_XIX_HCP5_CANFD01_6b228b48_Rx, ComPduIdRef=EcucPduCollection/HCP1_17_XIX_HCP5_CANFD01_3398d6b5_Rx
        HVEM_07_XIX_HCP5_CANFD01_839f516f_Rx: ComIPduDirection=RECEIVE, ComIPduType=NORMAL, ComIPduGroupRef=BMC_HV_XIX_HCP5_CANFD01_Rx_6dfafc5f, ComIPduGroupRef=BMC_HV_XIX_PNC_30_EnergyManagement_Rx_a9680a43, ComIPduSignalRef=HVEM_BMC_CHA_Wunschleistung_02_XIX_HVEM_07_XIX_HCP5_CANFD01_7eeecd70_Rx, ComIPduSignalRef=HVEM_BMC_CHA_Wunschleistung_XIX_HVEM_07_XIX_HCP5_CANFD01_7884fa49_Rx, ComIPduSignalRef=HVEM_MMTR_State_XIX_HVEM_07_XIX_HCP5_CANFD01_6d943f0f_Rx, ComIPduSignalRef=HVEM_SystemMinLeistungsgrenze_XIX_HVEM_07_XIX_HCP5_CANFD01_b8be9fb0_Rx, ComPduIdRef=EcucPduCollection/HVEM_07_XIX_HCP5_CANFD01_839f516f_Rx
        HVK_03_XIX_HCP5_CANFD01_E2E_8a76edcb_Rx: ComIPduDirection=RECEIVE, ComIPduType=NORMAL, ComIPduGroupRef=BMC_HV_XIX_HCP5_CANFD01_Rx_6dfafc5f, ComIPduGroupRef=BMC_HV_XIX_PNC_30_EnergyManagement_Rx_a9680a43, ComIPduSignalGroupRef=SG_HVK_03_XIX_HCP5_CANFD01_2b81aede_Rx, ComPduIdRef=EcucPduCollection/HVK_03_XIX_HCP5_CANFD01_E2E_8a76edcb_Rx
        HVLM_13_XIX_HCP5_CANFD01_f1be44f1_Rx: ComIPduDirection=RECEIVE, ComIPduType=NORMAL, ComIPduGroupRef=BMC_HV_XIX_HCP5_CANFD01_Rx_6dfafc5f, ComIPduGroupRef=BMC_HV_XIX_PNC_26_HighVoltage_Charging_Rx_765b82c2, ComIPduSignalRef=HVLM_BidiLadeModus_XIX_HVLM_13_XIX_HCP5_CANFD01_0594f11a_Rx, ComPduIdRef=EcucPduCollection/HVLM_13_XIX_HCP5_CANFD01_f1be44f1_Rx
        HVLM_14_XIX_HCP5_CANFD01_E2E_b3d1458f_Rx: ComIPduDirection=RECEIVE, ComIPduType=NORMAL, ComIPduGroupRef=BMC_HV_XIX_HCP5_CANFD01_Rx_6dfafc5f, ComIPduGroupRef=BMC_HV_XIX_PNC_26_HighVoltage_Charging_Rx_765b82c2, ComIPduSignalGroupRef=SG_HVLM_14_XIX_HCP5_CANFD01_09e92b9c_Rx, ComPduIdRef=EcucPduCollection/HVLM_14_XIX_HCP5_CANFD01_E2E_b3d1458f_Rx
        KN_Hybrid_01_XIX_HCP5_CANFD01_fef84477_Tx: ComIPduDirection=SEND, ComIPduType=NORMAL, ComIPduGroupRef=BMC_HV_XIX_HCP5_CANFD01_Tx_3ba05bd9, ComIPduGroupRef=BMC_HV_XIX_PNC_01_CarWakeUp_Tx_29969a84, ComIPduGroupRef=BMC_HV_XIX_PNC_40_Diagnosis_Energy_Tx_60b361f6, ComIPduSignalRef=Hybrid_01_KD_Fehler_XIX_KN_Hybrid_01_XIX_HCP5_CANFD01_3ce83ada_Tx, ComIPduSignalRef=Hybrid_01_KompSchutz_XIX_KN_Hybrid_01_XIX_HCP5_CANFD01_b32281c3_Tx, ComIPduSignalRef=Hybrid_01_Nachlauftyp_XIX_KN_Hybrid_01_XIX_HCP5_CANFD01_26798f2d_Tx, ComIPduSignalRef=Hybrid_01_SNI_10_XIX_KN_Hybrid_01_XIX_HCP5_CANFD01_ea872ae4_Tx, ComIPduSignalRef=KN_Hybrid_01_BusKnockOutTimer_XIX_KN_Hybrid_01_XIX_HCP5_CANFD01_e5089bb3_Tx, ComIPduSignalRef=KN_Hybrid_01_BusKnockOut_XIX_KN_Hybrid_01_XIX_HCP5_CANFD01_b162d19d_Tx, ComIPduSignalRef=KN_Hybrid_01_DiagPfad_V12_XIX_KN_Hybrid_01_XIX_HCP5_CANFD01_9879167d_Tx, ComIPduSignalRef=KN_Hybrid_01_ECUKnockOutTimer_XIX_KN_Hybrid_01_XIX_HCP5_CANFD01_7ea3be84_Tx, ComIPduSignalRef=KN_Hybrid_01_ECUKnockOut_XIX_KN_Hybrid_01_XIX_HCP5_CANFD01_dd88c4a5_Tx, ComIPduSignalRef=NM_Hybrid_01_FCIB_XIX_KN_Hybrid_01_XIX_HCP5_CANFD01_7ed68506_Tx, ComIPduSignalRef=NM_Hybrid_01_Lokalaktiv_XIX_KN_Hybrid_01_XIX_HCP5_CANFD01_905d7818_Tx, ComIPduSignalRef=NM_Hybrid_01_Subsystemaktiv_XIX_KN_Hybrid_01_XIX_HCP5_CANFD01_0d256d16_Tx, ComPduIdRef=EcucPduCollection/KN_Hybrid_01_XIX_HCP5_CANFD01_fef84477_Tx
          ComTxIPdu: ComTxIPduUnusedAreasDefault=0
            ComTxModeTrue
              ComTxMode: ComTxModeMode=PERIODIC, ComTxModeTimeOffset=0, ComTxModeTimePeriod=0.5
        KS_Hybrid_01_Challenge_K_XIX_HCP5_CANFD01_306d69bd_Tx: ComIPduDirection=SEND, ComIPduType=NORMAL, ComIPduGroupRef=BMC_HV_XIX_HCP5_CANFD01_Tx_3ba05bd9, ComIPduSignalGroupRef=SG_KS_Hybrid_01_Challenge_K_XIX_HCP5_CANFD01_aa09b31e_Tx, ComPduIdRef=EcucPduCollection/KS_Hybrid_01_Challenge_K_XIX_HCP5_CANFD01_306d69bd_Tx
          ComTxIPdu: ComTxIPduUnusedAreasDefault=0
            ComTxModeTrue
              ComTxMode: ComTxModeMode=DIRECT, ComTxModeNumberOfRepetitions=0, ComTxModeRepetitionPeriod=0
        KS_Hybrid_01_Challenge_M_XIX_HCP5_CANFD01_3e11d538_Rx: ComIPduDirection=RECEIVE, ComIPduType=NORMAL, ComIPduGroupRef=BMC_HV_XIX_HCP5_CANFD01_Rx_6dfafc5f, ComIPduSignalGroupRef=SG_KS_Hybrid_01_Challenge_M_XIX_HCP5_CANFD01_a4750f9b_Rx, ComPduIdRef=EcucPduCollection/KS_Hybrid_01_Challenge_M_XIX_HCP5_CANFD01_3e11d538_Rx
        KS_Hybrid_01_ReqFrame_XIX_HCP5_CANFD01_b04c52dd_Tx: ComIPduDirection=SEND, ComIPduType=NORMAL, ComIPduGroupRef=BMC_HV_XIX_HCP5_CANFD01_Tx_3ba05bd9, ComIPduSignalGroupRef=SG_KS_Hybrid_01_ReqFrame_XIX_HCP5_CANFD01_619e85fb_Tx, ComPduIdRef=EcucPduCollection/KS_Hybrid_01_ReqFrame_XIX_HCP5_CANFD01_b04c52dd_Tx
          ComTxIPdu: ComTxIPduUnusedAreasDefault=0
            ComTxModeTrue
              ComTxMode: ComTxModeMode=DIRECT, ComTxModeNumberOfRepetitions=0, ComTxModeRepetitionPeriod=0
        KS_Hybrid_01_Response_K_XIX_HCP5_CANFD01_76da782f_Tx: ComIPduDirection=SEND, ComIPduType=NORMAL, ComIPduGroupRef=BMC_HV_XIX_HCP5_CANFD01_Tx_3ba05bd9, ComIPduSignalGroupRef=SG_KS_Hybrid_01_Response_K_XIX_HCP5_CANFD01_adb36dae_Tx, ComPduIdRef=EcucPduCollection/KS_Hybrid_01_Response_K_XIX_HCP5_CANFD01_76da782f_Tx
          ComTxIPdu: ComTxIPduUnusedAreasDefault=0
            ComTxModeTrue
              ComTxMode: ComTxModeMode=DIRECT, ComTxModeNumberOfRepetitions=0, ComTxModeRepetitionPeriod=0
        KS_Hybrid_01_Response_M_XIX_HCP5_CANFD01_78a6c4aa_Rx: ComIPduDirection=RECEIVE, ComIPduType=NORMAL, ComIPduGroupRef=BMC_HV_XIX_HCP5_CANFD01_Rx_6dfafc5f, ComIPduSignalGroupRef=SG_KS_Hybrid_01_Response_M_XIX_HCP5_CANFD01_a3cfd12b_Rx, ComPduIdRef=EcucPduCollection/KS_Hybrid_01_Response_M_XIX_HCP5_CANFD01_78a6c4aa_Rx
        NMH_Hybrid_01_XIX_BMC_CAN01_b22e17f1_Tx: ComIPduDirection=SEND, ComIPduType=NORMAL, ComIPduSignalRef=NM_Hybrid_01_CAB_V12_XIX_NMH_Hybrid_01_XIX_BMC_CAN01_6448e8c9_Tx, ComIPduSignalRef=NM_Hybrid_01_NM_State_XIX_NMH_Hybrid_01_XIX_BMC_CAN01_20dc868b_Tx, ComIPduSignalRef=NM_Hybrid_01_NM_aktiv_Diag_XIX_NMH_Hybrid_01_XIX_BMC_CAN01_537ad98b_Tx, ComIPduSignalRef=NM_Hybrid_01_NM_aktiv_KL15_XIX_NMH_Hybrid_01_XIX_BMC_CAN01_7114d801_Tx, ComIPduSignalRef=NM_Hybrid_01_NM_aktiv_Tmin_XIX_NMH_Hybrid_01_XIX_BMC_CAN01_9fd576ae_Tx, ComIPduSignalRef=NM_aktiv_Konditionierungsbedarf_XIX_NMH_Hybrid_01_XIX_BMC_CAN01_514ad247_Tx, ComIPduSignalRef=NM_aktiv_SubbusSteuerung_BMC_HV_XIX_NMH_Hybrid_01_XIX_BMC_CAN01_c2e71061_Tx, ComPduIdRef=EcucPduCollection/NMH_Hybrid_01_XIX_BMC_CAN01_b22e17f1_Tx
          ComTxIPdu: ComTxIPduUnusedAreasDefault=0  # NMH_Hybrid_01_XIX_BMC_CAN01
        NM_Hybrid_01_XIX_HCP5_CANFD01_c84ff8a5_Tx: ComIPduDirection=SEND, ComIPduType=NORMAL, ComIPduSignalRef=NM_Hybrid_01_FCAB_XIX_NM_Hybrid_01_XIX_HCP5_CANFD01_38c188fa_Tx, ComIPduSignalRef=NM_Hybrid_01_NM_State_XIX_NM_Hybrid_01_XIX_HCP5_CANFD01_9a9758f9_Tx, ComIPduSignalRef=NM_Hybrid_01_NM_aktiv_Diag_XIX_NM_Hybrid_01_XIX_HCP5_CANFD01_6143673a_Tx, ComIPduSignalRef=NM_Hybrid_01_NM_aktiv_KL15_XIX_NM_Hybrid_01_XIX_HCP5_CANFD01_d7280503_Tx, ComIPduSignalRef=NM_Hybrid_01_NM_aktiv_Tmin_XIX_NM_Hybrid_01_XIX_HCP5_CANFD01_cfd9c50b_Tx, ComIPduSignalRef=NM_Hybrid_01_SNI_10_XIX_NM_Hybrid_01_XIX_HCP5_CANFD01_4ea5afc8_Tx, ComIPduSignalRef=NM_Hybrid_01_UDS_CC_XIX_NM_Hybrid_01_XIX_HCP5_CANFD01_d82615ea_Tx, ComIPduSignalRef=NM_Hybrid_01_Wakeup_V12_XIX_NM_Hybrid_01_XIX_HCP5_CANFD01_450fdf96_Tx, ComIPduSignalRef=NM_aktiv_Konditionierungsbedarf_XIX_NM_Hybrid_01_XIX_HCP5_CANFD01_91de24c0_Tx, ComIPduSignalRef=NM_aktiv_SubbusSteuerung_BMC_HV_XIX_NM_Hybrid_01_XIX_HCP5_CANFD01_276a97d5_Tx, ComPduIdRef=EcucPduCollection/NM_Hybrid_01_XIX_HCP5_CANFD01_c84ff8a5_Tx
          ComTxIPdu: ComTxIPduUnusedAreasDefault=0  # NM_Hybrid_01_XIX_HCP5_CANFD01
        NVEM_12_XIX_HCP5_CANFD01_00bae280_Rx: ComIPduDirection=RECEIVE, ComIPduType=NORMAL, ComIPduGroupRef=BMC_HV_XIX_HCP5_CANFD01_Rx_6dfafc5f, ComIPduGroupRef=BMC_HV_XIX_PNC_30_EnergyManagement_Rx_a9680a43, ComIPduSignalRef=NVEM_Abschaltstufe_XIX_NVEM_12_XIX_HCP5_CANFD01_cc082583_Rx, ComPduIdRef=EcucPduCollection/NVEM_12_XIX_HCP5_CANFD01_00bae280_Rx
        OBD_03_XIX_HCP5_CANFD01_f1281889_Rx: ComIPduDirection=RECEIVE, ComIPduType=NORMAL, ComIPduGroupRef=BMC_HV_XIX_HCP5_CANFD01_Rx_6dfafc5f, ComIPduGroupRef=BMC_HV_XIX_PNC_10_Powertrain_Rx_c7039922, ComIPduSignalRef=OBD_Abs_Pedal_Pos_XIX_OBD_03_XIX_HCP5_CANFD01_ce8f11ec_Rx, ComIPduSignalRef=OBD_Aussen_Temp_gef_XIX_OBD_03_XIX_HCP5_CANFD01_4d95c3af_Rx, ComIPduSignalRef=OBD_Driving_Cycle_XIX_OBD_03_XIX_HCP5_CANFD01_88844414_Rx, ComIPduSignalRef=OBD_Eng_Cool_Temp_XIX_OBD_03_XIX_HCP5_CANFD01_d0429a53_Rx, ComIPduSignalRef=OBD_Minimum_Trip_XIX_OBD_03_XIX_HCP5_CANFD01_1da08ec9_Rx, ComIPduSignalRef=OBD_Normed_Trip_XIX_OBD_03_XIX_HCP5_CANFD01_aff42920_Rx, ComIPduSignalRef=OBD_Warm_Up_Cycle_XIX_OBD_03_XIX_HCP5_CANFD01_eb6d4da0_Rx, ComPduIdRef=EcucPduCollection/OBD_03_XIX_HCP5_CANFD01_f1281889_Rx
        OBD_04_XIX_HCP5_CANFD01_100612ed_Rx: ComIPduDirection=RECEIVE, ComIPduType=NORMAL, ComIPduGroupRef=BMC_HV_XIX_HCP5_CANFD01_Rx_6dfafc5f, ComIPduGroupRef=BMC_HV_XIX_PNC_10_Powertrain_Rx_c7039922, ComIPduSignalRef=MM_PropulsionSystemActive_XIX_OBD_04_XIX_HCP5_CANFD01_e1fc58e2_Rx, ComIPduSignalRef=OBD_Barometric_Pressure_XIX_OBD_04_XIX_HCP5_CANFD01_26455454_Rx, ComIPduSignalRef=OBD_Calc_Load_Val_XIX_OBD_04_XIX_HCP5_CANFD01_8b454e40_Rx, ComIPduSignalRef=OBD_ClearMem_Inhibit_XIX_OBD_04_XIX_HCP5_CANFD01_6714a457_Rx, ComIPduSignalRef=OBD_Engine_RPM_XIX_OBD_04_XIX_HCP5_CANFD01_78b10114_Rx, ComIPduSignalRef=OBD_Kaltstart_Denominator_XIX_OBD_04_XIX_HCP5_CANFD01_6c8e10da_Rx, ComIPduSignalRef=OBD_NumDcyMilOnReq_XIX_OBD_04_XIX_HCP5_CANFD01_fc3c8d9d_Rx, ComIPduSignalRef=OBD_QBit_Aussen_Temp_XIX_OBD_04_XIX_HCP5_CANFD01_2cf7f3a2_Rx, ComIPduSignalRef=OBD_Sperrung_IUMPR_XIX_OBD_04_XIX_HCP5_CANFD01_d58d72d8_Rx, ComIPduSignalRef=OBD_Sperrung_Kaltstart_Denom_XIX_OBD_04_XIX_HCP5_CANFD01_9ec37dc6_Rx, ComIPduSignalRef=OBD_Typ_XIX_OBD_04_XIX_HCP5_CANFD01_f88154eb_Rx, ComPduIdRef=EcucPduCollection/OBD_04_XIX_HCP5_CANFD01_100612ed_Rx
        OBD_HCP1_XIX_HCP5_CANFD01_1b389b6c_Rx: ComIPduDirection=RECEIVE, ComIPduType=NORMAL, ComIPduGroupRef=BMC_HV_XIX_HCP5_CANFD01_Rx_6dfafc5f, ComIPduGroupRef=BMC_HV_XIX_PNC_10_Powertrain_Rx_c7039922, ComIPduSignalRef=OBDProtocol_req_XIX_OBD_HCP1_XIX_HCP5_CANFD01_70c5c055_Rx, ComPduIdRef=EcucPduCollection/OBD_HCP1_XIX_HCP5_CANFD01_1b389b6c_Rx
        OBD_Hybrid_01_XIX_HCP5_CANFD01_40f9dae5_Tx: ComIPduDirection=SEND, ComIPduType=NORMAL, ComIPduGroupRef=BMC_HV_XIX_HCP5_CANFD01_Tx_3ba05bd9, ComIPduGroupRef=BMC_HV_XIX_PNC_40_Diagnosis_Energy_Tx_60b361f6, ComIPduSignalRef=Hybrid_01_Indc_StChk_XIX_OBD_Hybrid_01_XIX_HCP5_CANFD01_0ff5b24f_Tx, ComIPduSignalRef=Hybrid_01_Indc_StFail_XIX_OBD_Hybrid_01_XIX_HCP5_CANFD01_6c961b98_Tx, ComIPduSignalRef=OBDProtocol_Hybrid_01_XIX_OBD_Hybrid_01_XIX_HCP5_CANFD01_aa11071d_Tx, ComPduIdRef=EcucPduCollection/OBD_Hybrid_01_XIX_HCP5_CANFD01_40f9dae5_Tx
          ComTxIPdu: ComTxIPduUnusedAreasDefault=0
            ComTxModeTrue
              ComTxMode: ComTxModeMode=PERIODIC, ComTxModeTimeOffset=0, ComTxModeTimePeriod=0.32
        OBG_01_XIX_HCP5_CANFD01_8fe2f1e9_Rx: ComIPduDirection=RECEIVE, ComIPduType=NORMAL, ComIPduGroupRef=BMC_HV_XIX_HCP5_CANFD01_Rx_6dfafc5f, ComIPduGroupRef=BMC_HV_XIX_PNC_26_HighVoltage_Charging_Rx_765b82c2, ComIPduSignalRef=HVLE_IstSpannung_HV_XIX_OBG_01_XIX_HCP5_CANFD01_577040d9_Rx, ComIPduSignalRef=HVLE_OBG_IstModus_XIX_OBG_01_XIX_HCP5_CANFD01_6564feea_Rx, ComPduIdRef=EcucPduCollection/OBG_01_XIX_HCP5_CANFD01_8fe2f1e9_Rx
        ORU_01_XIX_HCP5_CANFD01_8935a839_Rx: ComIPduDirection=RECEIVE, ComIPduType=NORMAL, ComIPduGroupRef=BMC_HV_XIX_HCP5_CANFD01_Rx_6dfafc5f, ComIPduSignalRef=ORU_Status_XIX_ORU_01_XIX_HCP5_CANFD01_ee2b347d_Rx, ComPduIdRef=EcucPduCollection/ORU_01_XIX_HCP5_CANFD01_8935a839_Rx
        ORU_Control_A_01_XIX_HCP5_CANFD01_E2E_3007747a_Rx: ComIPduDirection=RECEIVE, ComIPduType=NORMAL, ComIPduGroupRef=BMC_HV_XIX_HCP5_CANFD01_Rx_6dfafc5f, ComIPduGroupRef=BMC_HV_XIX_PNC_07_Basefunction_CrossSection_Rx_4fb7c882, ComIPduSignalGroupRef=SG_ORU_Control_A_01_XIX_HCP5_CANFD01_a8e78b2d_Rx, ComPduIdRef=EcucPduCollection/ORU_Control_A_01_XIX_HCP5_CANFD01_E2E_3007747a_Rx
        ORU_Control_D_01_XIX_HCP5_CANFD01_E2E_6e31ae8f_Rx: ComIPduDirection=RECEIVE, ComIPduType=NORMAL, ComIPduGroupRef=BMC_HV_XIX_HCP5_CANFD01_Rx_6dfafc5f, ComIPduGroupRef=BMC_HV_XIX_PNC_02_Basefunction_Powertrain_Rx_dc518468, ComIPduSignalGroupRef=SG_ORU_Control_D_01_XIX_HCP5_CANFD01_25c40c08_Rx, ComPduIdRef=EcucPduCollection/ORU_Control_D_01_XIX_HCP5_CANFD01_E2E_6e31ae8f_Rx
        OTAMC_D_01_XIX_HCP5_CANFD01_E2E_c199b3e6_Rx: ComIPduDirection=RECEIVE, ComIPduType=NORMAL, ComIPduGroupRef=BMC_HV_XIX_HCP5_CANFD01_Rx_6dfafc5f, ComIPduGroupRef=BMC_HV_XIX_PNC_02_Basefunction_Powertrain_Rx_dc518468, ComIPduSignalGroupRef=SG_OTAMC_D_01_XIX_HCP5_CANFD01_e331bc6d_Rx, ComPduIdRef=EcucPduCollection/OTAMC_D_01_XIX_HCP5_CANFD01_E2E_c199b3e6_Rx
        OTP_01_XIX_HCP5_CANFD01_76e7759c_Rx: ComIPduDirection=RECEIVE, ComIPduType=NORMAL, ComIPduGroupRef=BMC_HV_XIX_HCP5_CANFD01_Rx_6dfafc5f, ComIPduGroupRef=BMC_HV_XIX_PNC_24_ThermoManagement_Rx_9f1a6723, ComIPduSignalRef=OTP_Aussen_Temp_OBD_XIX_OTP_01_XIX_HCP5_CANFD01_6e627cce_Rx, ComIPduSignalRef=OTP_Aussen_Temp_ungef_XIX_OTP_01_XIX_HCP5_CANFD01_c0bbb4b6_Rx, ComPduIdRef=EcucPduCollection/OTP_01_XIX_HCP5_CANFD01_76e7759c_Rx
        SOK_NoAuthenticTime_01_XIX_HCP5_CANFD01_a407ae2f_Rx: ComIPduDirection=RECEIVE, ComIPduType=NORMAL, ComIPduGroupRef=BMC_HV_XIX_HCP5_CANFD01_Rx_6dfafc5f, ComIPduSignalRef=SOK_ungeschuetzte_Zeit_XIX_SOK_NoAuthenticTime_01_XIX_HCP5_CANFD01_d9562906_Rx, ComPduIdRef=EcucPduCollection/SOK_NoAuthenticTime_01_XIX_HCP5_CANFD01_a407ae2f_Rx
        SOK_Zeit_Hybrid_01_Chal_01_XIX_HCP5_CANFD01_5939048b_Tx: ComIPduDirection=SEND, ComIPduType=NORMAL, ComIPduGroupRef=BMC_HV_XIX_HCP5_CANFD01_Tx_3ba05bd9, ComIPduSignalRef=SOK_Zeit_Hybrid_01_Challenge_XIX_SOK_Zeit_Hybrid_01_Chal_01_XIX_HCP5_CANFD01_13ac3f94_Tx, ComPduIdRef=EcucPduCollection/SOK_Zeit_Hybrid_01_Chal_01_XIX_HCP5_CANFD01_5939048b_Tx
          ComTxIPdu: ComMinimumDelayTime=0.1, ComTxIPduUnusedAreasDefault=0
            ComTxModeTrue
              ComTxMode: ComTxModeMode=DIRECT, ComTxModeNumberOfRepetitions=0, ComTxModeRepetitionPeriod=0
        SOK_Zeit_Hybrid_01_Resp_01_XIX_HCP5_CANFD01_c7a98a10_Rx: ComIPduDirection=RECEIVE, ComIPduType=NORMAL, ComIPduGroupRef=BMC_HV_XIX_HCP5_CANFD01_Rx_6dfafc5f, ComIPduSignalRef=SOK_Zeit_Hybrid_01_Zeit_XIX_SOK_Zeit_Hybrid_01_Resp_01_XIX_HCP5_CANFD01_41d20ae9_Rx, ComPduIdRef=EcucPduCollection/SOK_Zeit_Hybrid_01_Resp_01_XIX_HCP5_CANFD01_c7a98a10_Rx
        Systeminfo_01_XIX_HCP5_CANFD01_fb27c5ed_Rx: ComIPduDirection=RECEIVE, ComIPduType=NORMAL, ComIPduGroupRef=BMC_HV_XIX_HCP5_CANFD01_Rx_6dfafc5f, ComIPduGroupRef=BMC_HV_XIX_PNC_07_Basefunction_CrossSection_Rx_4fb7c882, ComIPduSignalRef=SI_NWDF_30_XIX_Systeminfo_01_XIX_HCP5_CANFD01_b3e489e1_Rx, ComIPduSignalRef=SI_NWDF_XIX_Systeminfo_01_XIX_HCP5_CANFD01_5ddebbee_Rx, ComIPduSignalRef=SI_P_Mode_XIX_Systeminfo_01_XIX_HCP5_CANFD01_171f38d4_Rx, ComIPduSignalRef=SI_P_Mode_gueltig_XIX_Systeminfo_01_XIX_HCP5_CANFD01_f5c30274_Rx, ComIPduSignalRef=SI_T_Mode_XIX_Systeminfo_01_XIX_HCP5_CANFD01_01a376d2_Rx, ComPduIdRef=EcucPduCollection/Systeminfo_01_XIX_HCP5_CANFD01_fb27c5ed_Rx
        Thermomanagement_01_XIX_HCP5_CANFD01_60e8cf38_Rx: ComIPduDirection=RECEIVE, ComIPduType=NORMAL, ComIPduGroupRef=BMC_HV_XIX_HCP5_CANFD01_Rx_6dfafc5f, ComIPduGroupRef=BMC_HV_XIX_PNC_24_ThermoManagement_Rx_9f1a6723, ComIPduSignalRef=EKK_HVK_EoHVL_Status_XIX_Thermomanagement_01_XIX_HCP5_CANFD01_0b35afaa_Rx, ComIPduSignalRef=TME_Batt_Kond_Verf_XIX_Thermomanagement_01_XIX_HCP5_CANFD01_ac1763e7_Rx, ComIPduSignalRef=TME_Therm_IstLeistung_HVBatterie_XIX_Thermomanagement_01_XIX_HCP5_CANFD01_705b15a6_Rx, ComPduIdRef=EcucPduCollection/Thermomanagement_01_XIX_HCP5_CANFD01_60e8cf38_Rx
        UI1_01_XIX_BMC_CAN01_E2E_cec88adf_Rx: ComIPduDirection=RECEIVE, ComIPduType=NORMAL, ComIPduGroupRef=BMC_HV_XIX_BMC_CAN01_Rx_7b388810, ComIPduSignalGroupRef=SG_UI1_01_XIX_BMC_CAN01_cd9e369a_Rx, ComPduIdRef=EcucPduCollection/UI1_01_XIX_BMC_CAN01_E2E_cec88adf_Rx
        UI1_02_XIX_BMC_CAN01_E2E_6d9e0c76_Rx: ComIPduDirection=RECEIVE, ComIPduType=NORMAL, ComIPduGroupRef=BMC_HV_XIX_BMC_CAN01_Rx_7b388810, ComIPduSignalGroupRef=SG_UI1_02_XIX_BMC_CAN01_dce35ce3_Rx, ComPduIdRef=EcucPduCollection/UI1_02_XIX_BMC_CAN01_E2E_6d9e0c76_Rx
        UI1_03_XIX_BMC_CAN01_4277cadb_Rx: ComIPduDirection=RECEIVE, ComIPduType=NORMAL, ComIPduGroupRef=BMC_HV_XIX_BMC_CAN01_Rx_7b388810, ComIPduSignalRef=UI1_Spannung4_XIX_UI1_03_XIX_BMC_CAN01_25f2e1ca_Rx, ComIPduSignalRef=UI1_Spannung5_XIX_UI1_03_XIX_BMC_CAN01_c2ef475d_Rx, ComIPduSignalRef=UI1_Spannung6_XIX_UI1_03_XIX_BMC_CAN01_30b8aaa5_Rx, ComPduIdRef=EcucPduCollection/UI1_03_XIX_BMC_CAN01_4277cadb_Rx
        UI1_04_XIX_BMC_CAN01_d976c5c1_Rx: ComIPduDirection=RECEIVE, ComIPduType=NORMAL, ComIPduGroupRef=BMC_HV_XIX_BMC_CAN01_Rx_7b388810, ComIPduSignalRef=UI1_Status_XIX_UI1_04_XIX_BMC_CAN01_abb6019e_Rx, ComIPduSignalRef=UI1_Stromintegral_Entladen_XIX_UI1_04_XIX_BMC_CAN01_550f36e6_Rx, ComIPduSignalRef=UI1_Stromintegral_Laden_XIX_UI1_04_XIX_BMC_CAN01_6b336e8e_Rx, ComIPduSignalRef=UI1_Temperatur_1_XIX_UI1_04_XIX_BMC_CAN01_ee4849f8_Rx, ComIPduSignalRef=UI1_Temperatur_2_XIX_UI1_04_XIX_BMC_CAN01_1c1fa400_Rx, ComIPduSignalRef=UI2Sens01_ErrMem_State_XIX_UI1_04_XIX_BMC_CAN01_2781c1ec_Rx, ComPduIdRef=EcucPduCollection/UI1_04_XIX_BMC_CAN01_d976c5c1_Rx
        UI1_05_XIX_BMC_CAN01_608d1e29_Rx: ComIPduDirection=RECEIVE, ComIPduType=NORMAL, ComIPduGroupRef=BMC_HV_XIX_BMC_CAN01_Rx_7b388810, ComIPduSignalRef=UI1_Iso_Neg_XIX_UI1_05_XIX_BMC_CAN01_4b0788a9_Rx, ComIPduSignalRef=UI1_Iso_Pos_XIX_UI1_05_XIX_BMC_CAN01_c7179271_Rx, ComIPduSignalRef=UI1_Iso_Status_XIX_UI1_05_XIX_BMC_CAN01_a67d930e_Rx, ComPduIdRef=EcucPduCollection/UI1_05_XIX_BMC_CAN01_608d1e29_Rx
        UI1_Komponentenfehler_01_XIX_BMC_CAN01_08861f77_Rx: ComIPduDirection=RECEIVE, ComIPduType=NORMAL, ComIPduGroupRef=BMC_HV_XIX_BMC_CAN01_Rx_7b388810, ComIPduSignalRef=UI1_KompFehlerModus2_01_XIX_UI1_Komponentenfehler_01_XIX_BMC_CAN01_34b9d7af_Rx, ComIPduSignalRef=UI1_KompFehlerModus2_02_XIX_UI1_Komponentenfehler_01_XIX_BMC_CAN01_4ac19f09_Rx, ComIPduSignalRef=UI1_KompFehlerModus2_03_XIX_UI1_Komponentenfehler_01_XIX_BMC_CAN01_60e9a76b_Rx, ComIPduSignalRef=UI1_KompFehlerModus2_04_XIX_UI1_Komponentenfehler_01_XIX_BMC_CAN01_b6310e45_Rx, ComIPduSignalRef=UI1_KompFehlerModus2_05_XIX_UI1_Komponentenfehler_01_XIX_BMC_CAN01_9c193627_Rx, ComIPduSignalRef=UI1_KompFehlerModus2_06_XIX_UI1_Komponentenfehler_01_XIX_BMC_CAN01_e2617e81_Rx, ComIPduSignalRef=UI1_KompFehlerModus2_07_XIX_UI1_Komponentenfehler_01_XIX_BMC_CAN01_c84946e3_Rx, ComIPduSignalRef=UI1_KompFehlerModus2_08_XIX_UI1_Komponentenfehler_01_XIX_BMC_CAN01_94a12a9c_Rx, ComIPduSignalRef=UI1_KompFehlerModus2_09_XIX_UI1_Komponentenfehler_01_XIX_BMC_CAN01_be8912fe_Rx, ComIPduSignalRef=UI1_KompFehlerModus2_10_XIX_UI1_Komponentenfehler_01_XIX_BMC_CAN01_bd07c781_Rx, ComIPduSignalRef=UI1_KompFehlerModus2_11_XIX_UI1_Komponentenfehler_01_XIX_BMC_CAN01_972fffe3_Rx, ComIPduSignalRef=UI1_KompFehlerModus2_12_XIX_UI1_Komponentenfehler_01_XIX_BMC_CAN01_e957b745_Rx, ComIPduSignalRef=UI1_KompFehlerModus2_13_XIX_UI1_Komponentenfehler_01_XIX_BMC_CAN01_c37f8f27_Rx, ComIPduSignalRef=UI1_KompFehlerModus2_14_XIX_UI1_Komponentenfehler_01_XIX_BMC_CAN01_15a72609_Rx, ComIPduSignalRef=UI1_KompFehlerModus2_15_XIX_UI1_Komponentenfehler_01_XIX_BMC_CAN01_3f8f1e6b_Rx, ComIPduSignalRef=UI1_KompFehlerModus2_16_XIX_UI1_Komponentenfehler_01_XIX_BMC_CAN01_41f756cd_Rx, ComIPduSignalRef=UI1_KompFehlerModus2_17_XIX_UI1_Komponentenfehler_01_XIX_BMC_CAN01_6bdf6eaf_Rx, ComIPduSignalRef=UI1_KompFehlerModus2_18_XIX_UI1_Komponentenfehler_01_XIX_BMC_CAN01_373702d0_Rx, ComIPduSignalRef=UI1_KompFehlerModus2_19_XIX_UI1_Komponentenfehler_01_XIX_BMC_CAN01_1d1f3ab2_Rx, ComIPduSignalRef=UI1_KompFehlerModus2_20_XIX_UI1_Komponentenfehler_01_XIX_BMC_CAN01_82ccb914_Rx, ComIPduSignalRef=UI1_KompFehlerModus2_21_XIX_UI1_Komponentenfehler_01_XIX_BMC_CAN01_a8e48176_Rx, ComIPduSignalRef=UI1_KompFehlerModus2_22_XIX_UI1_Komponentenfehler_01_XIX_BMC_CAN01_d69cc9d0_Rx, ComIPduSignalRef=UI1_KompFehlerModus2_23_XIX_UI1_Komponentenfehler_01_XIX_BMC_CAN01_fcb4f1b2_Rx, ComIPduSignalRef=UI1_KompFehlerModus2_24_XIX_UI1_Komponentenfehler_01_XIX_BMC_CAN01_2a6c589c_Rx, ComIPduSignalRef=UI1_KompFehlerModus2_25_XIX_UI1_Komponentenfehler_01_XIX_BMC_CAN01_004460fe_Rx, ComIPduSignalRef=UI1_KompFehlerModus2_26_XIX_UI1_Komponentenfehler_01_XIX_BMC_CAN01_7e3c2858_Rx, ComPduIdRef=EcucPduCollection/UI1_Komponentenfehler_01_XIX_BMC_CAN01_08861f77_Rx
        UI1_Komponentenfehler_02_XIX_BMC_CAN01_19fb750e_Rx: ComIPduDirection=RECEIVE, ComIPduType=NORMAL, ComIPduGroupRef=BMC_HV_XIX_BMC_CAN01_Rx_7b388810, ComIPduSignalRef=UI1_KompFehlerModus4_01_XIX_UI1_Komponentenfehler_02_XIX_BMC_CAN01_89a380c9_Rx, ComIPduSignalRef=UI1_KompFehlerModus4_02_XIX_UI1_Komponentenfehler_02_XIX_BMC_CAN01_f7dbc86f_Rx, ComIPduSignalRef=UI1_KompFehlerModus4_03_XIX_UI1_Komponentenfehler_02_XIX_BMC_CAN01_ddf3f00d_Rx, ComIPduSignalRef=UI1_KompFehlerModus4_04_XIX_UI1_Komponentenfehler_02_XIX_BMC_CAN01_0b2b5923_Rx, ComIPduSignalRef=UI1_KompFehlerModus4_05_XIX_UI1_Komponentenfehler_02_XIX_BMC_CAN01_21036141_Rx, ComIPduSignalRef=UI1_KompFehlerModus4_06_XIX_UI1_Komponentenfehler_02_XIX_BMC_CAN01_5f7b29e7_Rx, ComIPduSignalRef=UI1_KompFehlerModus4_07_XIX_UI1_Komponentenfehler_02_XIX_BMC_CAN01_75531185_Rx, ComIPduSignalRef=UI1_KompFehlerModus4_08_XIX_UI1_Komponentenfehler_02_XIX_BMC_CAN01_29bb7dfa_Rx, ComIPduSignalRef=UI1_KompFehlerModus4_09_XIX_UI1_Komponentenfehler_02_XIX_BMC_CAN01_03934598_Rx, ComIPduSignalRef=UI1_KompFehlerModus4_10_XIX_UI1_Komponentenfehler_02_XIX_BMC_CAN01_001d90e7_Rx, ComIPduSignalRef=UI1_KompFehlerModus4_11_XIX_UI1_Komponentenfehler_02_XIX_BMC_CAN01_2a35a885_Rx, ComIPduSignalRef=UI1_KompFehlerModus4_12_XIX_UI1_Komponentenfehler_02_XIX_BMC_CAN01_544de023_Rx, ComIPduSignalRef=UI1_KompFehlerModus4_13_XIX_UI1_Komponentenfehler_02_XIX_BMC_CAN01_7e65d841_Rx, ComIPduSignalRef=UI1_KompFehlerModus4_14_XIX_UI1_Komponentenfehler_02_XIX_BMC_CAN01_a8bd716f_Rx, ComIPduSignalRef=UI1_KompFehlerModus4_15_XIX_UI1_Komponentenfehler_02_XIX_BMC_CAN01_8295490d_Rx, ComIPduSignalRef=UI1_KompFehlerModus4_16_XIX_UI1_Komponentenfehler_02_XIX_BMC_CAN01_fced01ab_Rx, ComPduIdRef=EcucPduCollection/UI1_Komponentenfehler_02_XIX_BMC_CAN01_19fb750e_Rx
        UI2Sens01_CALID_01_XIX_BMC_CAN01_f3c92280_Rx: ComIPduDirection=RECEIVE, ComIPduType=NORMAL, ComIPduGroupRef=BMC_HV_XIX_BMC_CAN01_Rx_7b388810, ComIPduSignalRef=UI2Sens01_CALID_Index_01_XIX_UI2Sens01_CALID_01_XIX_BMC_CAN01_70cabfee_Rx, ComIPduSignalRef=UI2Sens01_CALID_Index_02_XIX_UI2Sens01_CALID_01_XIX_BMC_CAN01_3d22bf89_Rx, ComIPduSignalRef=UI2Sens01_CALID_Index_03_XIX_UI2Sens01_CALID_01_XIX_BMC_CAN01_b0aa426b_Rx, ComIPduSignalRef=UI2Sens01_CALID_Index_04_XIX_UI2Sens01_CALID_01_XIX_BMC_CAN01_a6f2bf47_Rx, ComIPduSignalRef=UI2Sens01_CALID_Index_05_XIX_UI2Sens01_CALID_01_XIX_BMC_CAN01_2b7a42a5_Rx, ComIPduSignalRef=UI2Sens01_CALID_Index_06_XIX_UI2Sens01_CALID_01_XIX_BMC_CAN01_669242c2_Rx, ComIPduSignalRef=UI2Sens01_CALID_Index_07_XIX_UI2Sens01_CALID_01_XIX_BMC_CAN01_eb1abf20_Rx, ComIPduSignalRef=UI2Sens01_CALID_Index_08_XIX_UI2Sens01_CALID_01_XIX_BMC_CAN01_4a23b89a_Rx, ComPduIdRef=EcucPduCollection/UI2Sens01_CALID_01_XIX_BMC_CAN01_f3c92280_Rx
        UI2Sens01_CALID_02_XIX_BMC_CAN01_e2b448f9_Rx: ComIPduDirection=RECEIVE, ComIPduType=NORMAL, ComIPduGroupRef=BMC_HV_XIX_BMC_CAN01_Rx_7b388810, ComIPduSignalRef=UI2Sens01_CALID_Index_09_XIX_UI2Sens01_CALID_02_XIX_BMC_CAN01_d6d62f01_Rx, ComIPduSignalRef=UI2Sens01_CALID_Index_10_XIX_UI2Sens01_CALID_02_XIX_BMC_CAN01_a2b623dc_Rx, ComIPduSignalRef=UI2Sens01_CALID_Index_11_XIX_UI2Sens01_CALID_02_XIX_BMC_CAN01_2f3ede3e_Rx, ComIPduSignalRef=UI2Sens01_CALID_Index_12_XIX_UI2Sens01_CALID_02_XIX_BMC_CAN01_62d6de59_Rx, ComIPduSignalRef=UI2Sens01_CALID_Index_13_XIX_UI2Sens01_CALID_02_XIX_BMC_CAN01_ef5e23bb_Rx, ComIPduSignalRef=UI2Sens01_CALID_Index_14_XIX_UI2Sens01_CALID_02_XIX_BMC_CAN01_f906de97_Rx, ComIPduSignalRef=UI2Sens01_CALID_Index_15_XIX_UI2Sens01_CALID_02_XIX_BMC_CAN01_748e2375_Rx, ComIPduSignalRef=UI2Sens01_CALID_Index_16_XIX_UI2Sens01_CALID_02_XIX_BMC_CAN01_39662312_Rx, ComPduIdRef=EcucPduCollection/UI2Sens01_CALID_02_XIX_BMC_CAN01_e2b448f9_Rx
        UI2Sens01_CVN_XIX_BMC_CAN01_fe6b52fc_Rx: ComIPduDirection=RECEIVE, ComIPduType=NORMAL, ComIPduGroupRef=BMC_HV_XIX_BMC_CAN01_Rx_7b388810, ComIPduSignalRef=UI2Sens01_CVN_Byte_1_XIX_UI2Sens01_CVN_XIX_BMC_CAN01_0510ee62_Rx, ComIPduSignalRef=UI2Sens01_CVN_Byte_2_XIX_UI2Sens01_CVN_XIX_BMC_CAN01_5e075f77_Rx, ComIPduSignalRef=UI2Sens01_CVN_Byte_3_XIX_UI2Sens01_CVN_XIX_BMC_CAN01_68f5cf84_Rx, ComIPduSignalRef=UI2Sens01_CVN_Byte_4_XIX_UI2Sens01_CVN_XIX_BMC_CAN01_e8283d5d_Rx, ComIPduSignalRef=UI2Sens01_CVN_VLD_XIX_UI2Sens01_CVN_XIX_BMC_CAN01_56f8ef91_Rx, ComPduIdRef=EcucPduCollection/UI2Sens01_CVN_XIX_BMC_CAN01_fe6b52fc_Rx
        UI2Sens02_CALID_01_XIX_BMC_CAN01_abd78ba8_Rx: ComIPduDirection=RECEIVE, ComIPduType=NORMAL, ComIPduGroupRef=BMC_HV_XIX_BMC_CAN01_Rx_7b388810, ComIPduSignalRef=UI2Sens02_CALID_Index_01_XIX_UI2Sens02_CALID_01_XIX_BMC_CAN01_abbdc605_Rx, ComIPduSignalRef=UI2Sens02_CALID_Index_02_XIX_UI2Sens02_CALID_01_XIX_BMC_CAN01_e655c662_Rx, ComIPduSignalRef=UI2Sens02_CALID_Index_03_XIX_UI2Sens02_CALID_01_XIX_BMC_CAN01_6bdd3b80_Rx, ComIPduSignalRef=UI2Sens02_CALID_Index_04_XIX_UI2Sens02_CALID_01_XIX_BMC_CAN01_7d85c6ac_Rx, ComIPduSignalRef=UI2Sens02_CALID_Index_05_XIX_UI2Sens02_CALID_01_XIX_BMC_CAN01_f00d3b4e_Rx, ComIPduSignalRef=UI2Sens02_CALID_Index_06_XIX_UI2Sens02_CALID_01_XIX_BMC_CAN01_bde53b29_Rx, ComIPduSignalRef=UI2Sens02_CALID_Index_07_XIX_UI2Sens02_CALID_01_XIX_BMC_CAN01_306dc6cb_Rx, ComIPduSignalRef=UI2Sens02_CALID_Index_08_XIX_UI2Sens02_CALID_01_XIX_BMC_CAN01_9154c171_Rx, ComPduIdRef=EcucPduCollection/UI2Sens02_CALID_01_XIX_BMC_CAN01_abd78ba8_Rx
        UI2Sens02_CALID_02_XIX_BMC_CAN01_baaae1d1_Rx: ComIPduDirection=RECEIVE, ComIPduType=NORMAL, ComIPduGroupRef=BMC_HV_XIX_BMC_CAN01_Rx_7b388810, ComIPduSignalRef=UI2Sens02_CALID_Index_09_XIX_UI2Sens02_CALID_02_XIX_BMC_CAN01_0da156ea_Rx, ComIPduSignalRef=UI2Sens02_CALID_Index_10_XIX_UI2Sens02_CALID_02_XIX_BMC_CAN01_79c15a37_Rx, ComIPduSignalRef=UI2Sens02_CALID_Index_11_XIX_UI2Sens02_CALID_02_XIX_BMC_CAN01_f449a7d5_Rx, ComIPduSignalRef=UI2Sens02_CALID_Index_12_XIX_UI2Sens02_CALID_02_XIX_BMC_CAN01_b9a1a7b2_Rx, ComIPduSignalRef=UI2Sens02_CALID_Index_13_XIX_UI2Sens02_CALID_02_XIX_BMC_CAN01_34295a50_Rx, ComIPduSignalRef=UI2Sens02_CALID_Index_14_XIX_UI2Sens02_CALID_02_XIX_BMC_CAN01_2271a77c_Rx, ComIPduSignalRef=UI2Sens02_CALID_Index_15_XIX_UI2Sens02_CALID_02_XIX_BMC_CAN01_aff95a9e_Rx, ComIPduSignalRef=UI2Sens02_CALID_Index_16_XIX_UI2Sens02_CALID_02_XIX_BMC_CAN01_e2115af9_Rx, ComPduIdRef=EcucPduCollection/UI2Sens02_CALID_02_XIX_BMC_CAN01_baaae1d1_Rx
        UI2Sens02_CVN_XIX_BMC_CAN01_5d3dd455_Rx: ComIPduDirection=RECEIVE, ComIPduType=NORMAL, ComIPduGroupRef=BMC_HV_XIX_BMC_CAN01_Rx_7b388810, ComIPduSignalRef=UI2Sens02_CVN_Byte_1_XIX_UI2Sens02_CVN_XIX_BMC_CAN01_d83e206d_Rx, ComIPduSignalRef=UI2Sens02_CVN_Byte_2_XIX_UI2Sens02_CVN_XIX_BMC_CAN01_83299178_Rx, ComIPduSignalRef=UI2Sens02_CVN_Byte_3_XIX_UI2Sens02_CVN_XIX_BMC_CAN01_b5db018b_Rx, ComIPduSignalRef=UI2Sens02_CVN_Byte_4_XIX_UI2Sens02_CVN_XIX_BMC_CAN01_3506f352_Rx, ComIPduSignalRef=UI2Sens02_CVN_VLD_XIX_UI2Sens02_CVN_XIX_BMC_CAN01_16e7de9a_Rx, ComPduIdRef=EcucPduCollection/UI2Sens02_CVN_XIX_BMC_CAN01_5d3dd455_Rx
        UI2_01_XIX_BMC_CAN01_E2E_f7b0279f_Rx: ComIPduDirection=RECEIVE, ComIPduType=NORMAL, ComIPduGroupRef=BMC_HV_XIX_BMC_CAN01_Rx_7b388810, ComIPduSignalGroupRef=SG_UI2_01_XIX_BMC_CAN01_2718ebf8_Rx, ComPduIdRef=EcucPduCollection/UI2_01_XIX_BMC_CAN01_E2E_f7b0279f_Rx
        UI2_02_XIX_BMC_CAN01_E2E_54e6a136_Rx: ComIPduDirection=RECEIVE, ComIPduType=NORMAL, ComIPduGroupRef=BMC_HV_XIX_BMC_CAN01_Rx_7b388810, ComIPduSignalGroupRef=SG_UI2_02_XIX_BMC_CAN01_36658181_Rx, ComPduIdRef=EcucPduCollection/UI2_02_XIX_BMC_CAN01_E2E_54e6a136_Rx
        UI2_03_XIX_BMC_CAN01_E2E_8304216e_Rx: ComIPduDirection=RECEIVE, ComIPduType=NORMAL, ComIPduGroupRef=BMC_HV_XIX_BMC_CAN01_Rx_7b388810, ComIPduSignalGroupRef=SG_UI2_03_XIX_BMC_CAN01_8f9e5a69_Rx, ComPduIdRef=EcucPduCollection/UI2_03_XIX_BMC_CAN01_E2E_8304216e_Rx
        UI2_04_XIX_BMC_CAN01_33f018a3_Rx: ComIPduDirection=RECEIVE, ComIPduType=NORMAL, ComIPduGroupRef=BMC_HV_XIX_BMC_CAN01_Rx_7b388810, ComIPduSignalRef=UI2Sens02_ErrMem_State_XIX_UI2_04_XIX_BMC_CAN01_1e9c0075_Rx, ComIPduSignalRef=UI2_Status_XIX_UI2_04_XIX_BMC_CAN01_1a276de9_Rx, ComIPduSignalRef=UI2_Stromintegral_Entladen_XIX_UI2_04_XIX_BMC_CAN01_f5109cf0_Rx, ComIPduSignalRef=UI2_Stromintegral_Laden_XIX_UI2_04_XIX_BMC_CAN01_01ef1f59_Rx, ComIPduSignalRef=UI2_Temperatur_1_XIX_UI2_04_XIX_BMC_CAN01_d7558861_Rx, ComIPduSignalRef=UI2_Temperatur_2_XIX_UI2_04_XIX_BMC_CAN01_25026599_Rx, ComPduIdRef=EcucPduCollection/UI2_04_XIX_BMC_CAN01_33f018a3_Rx
        UI2_Komponentenfehler_01_XIX_BMC_CAN01_6c666489_Rx: ComIPduDirection=RECEIVE, ComIPduType=NORMAL, ComIPduGroupRef=BMC_HV_XIX_BMC_CAN01_Rx_7b388810, ComIPduSignalRef=UI2_KompFehlerModus2_01_XIX_UI2_Komponentenfehler_01_XIX_BMC_CAN01_1a77dcaf_Rx, ComIPduSignalRef=UI2_KompFehlerModus2_02_XIX_UI2_Komponentenfehler_01_XIX_BMC_CAN01_640f9409_Rx, ComIPduSignalRef=UI2_KompFehlerModus2_03_XIX_UI2_Komponentenfehler_01_XIX_BMC_CAN01_4e27ac6b_Rx, ComIPduSignalRef=UI2_KompFehlerModus2_04_XIX_UI2_Komponentenfehler_01_XIX_BMC_CAN01_98ff0545_Rx, ComIPduSignalRef=UI2_KompFehlerModus2_05_XIX_UI2_Komponentenfehler_01_XIX_BMC_CAN01_b2d73d27_Rx, ComIPduSignalRef=UI2_KompFehlerModus2_06_XIX_UI2_Komponentenfehler_01_XIX_BMC_CAN01_ccaf7581_Rx, ComIPduSignalRef=UI2_KompFehlerModus2_07_XIX_UI2_Komponentenfehler_01_XIX_BMC_CAN01_e6874de3_Rx, ComIPduSignalRef=UI2_KompFehlerModus2_08_XIX_UI2_Komponentenfehler_01_XIX_BMC_CAN01_ba6f219c_Rx, ComIPduSignalRef=UI2_KompFehlerModus2_09_XIX_UI2_Komponentenfehler_01_XIX_BMC_CAN01_904719fe_Rx, ComIPduSignalRef=UI2_KompFehlerModus2_10_XIX_UI2_Komponentenfehler_01_XIX_BMC_CAN01_93c9cc81_Rx, ComIPduSignalRef=UI2_KompFehlerModus2_11_XIX_UI2_Komponentenfehler_01_XIX_BMC_CAN01_b9e1f4e3_Rx, ComIPduSignalRef=UI2_KompFehlerModus2_12_XIX_UI2_Komponentenfehler_01_XIX_BMC_CAN01_c799bc45_Rx, ComIPduSignalRef=UI2_KompFehlerModus2_13_XIX_UI2_Komponentenfehler_01_XIX_BMC_CAN01_edb18427_Rx, ComIPduSignalRef=UI2_KompFehlerModus2_14_XIX_UI2_Komponentenfehler_01_XIX_BMC_CAN01_3b692d09_Rx, ComIPduSignalRef=UI2_KompFehlerModus2_15_XIX_UI2_Komponentenfehler_01_XIX_BMC_CAN01_1141156b_Rx, ComIPduSignalRef=UI2_KompFehlerModus2_16_XIX_UI2_Komponentenfehler_01_XIX_BMC_CAN01_6f395dcd_Rx, ComIPduSignalRef=UI2_KompFehlerModus2_17_XIX_UI2_Komponentenfehler_01_XIX_BMC_CAN01_451165af_Rx, ComIPduSignalRef=UI2_KompFehlerModus2_18_XIX_UI2_Komponentenfehler_01_XIX_BMC_CAN01_19f909d0_Rx, ComIPduSignalRef=UI2_KompFehlerModus2_19_XIX_UI2_Komponentenfehler_01_XIX_BMC_CAN01_33d131b2_Rx, ComIPduSignalRef=UI2_KompFehlerModus2_20_XIX_UI2_Komponentenfehler_01_XIX_BMC_CAN01_ac02b214_Rx, ComIPduSignalRef=UI2_KompFehlerModus2_21_XIX_UI2_Komponentenfehler_01_XIX_BMC_CAN01_862a8a76_Rx, ComIPduSignalRef=UI2_KompFehlerModus2_22_XIX_UI2_Komponentenfehler_01_XIX_BMC_CAN01_f852c2d0_Rx, ComIPduSignalRef=UI2_KompFehlerModus2_23_XIX_UI2_Komponentenfehler_01_XIX_BMC_CAN01_d27afab2_Rx, ComIPduSignalRef=UI2_KompFehlerModus2_24_XIX_UI2_Komponentenfehler_01_XIX_BMC_CAN01_04a2539c_Rx, ComIPduSignalRef=UI2_KompFehlerModus2_25_XIX_UI2_Komponentenfehler_01_XIX_BMC_CAN01_2e8a6bfe_Rx, ComIPduSignalRef=UI2_KompFehlerModus2_26_XIX_UI2_Komponentenfehler_01_XIX_BMC_CAN01_50f22358_Rx, ComPduIdRef=EcucPduCollection/UI2_Komponentenfehler_01_XIX_BMC_CAN01_6c666489_Rx
        UI2_Komponentenfehler_02_XIX_BMC_CAN01_7d1b0ef0_Rx: ComIPduDirection=RECEIVE, ComIPduType=NORMAL, ComIPduGroupRef=BMC_HV_XIX_BMC_CAN01_Rx_7b388810, ComIPduSignalRef=UI2_KompFehlerModus4_01_XIX_UI2_Komponentenfehler_02_XIX_BMC_CAN01_a76d8bc9_Rx, ComIPduSignalRef=UI2_KompFehlerModus4_02_XIX_UI2_Komponentenfehler_02_XIX_BMC_CAN01_d915c36f_Rx, ComIPduSignalRef=UI2_KompFehlerModus4_03_XIX_UI2_Komponentenfehler_02_XIX_BMC_CAN01_f33dfb0d_Rx, ComIPduSignalRef=UI2_KompFehlerModus4_04_XIX_UI2_Komponentenfehler_02_XIX_BMC_CAN01_25e55223_Rx, ComIPduSignalRef=UI2_KompFehlerModus4_05_XIX_UI2_Komponentenfehler_02_XIX_BMC_CAN01_0fcd6a41_Rx, ComIPduSignalRef=UI2_KompFehlerModus4_06_XIX_UI2_Komponentenfehler_02_XIX_BMC_CAN01_71b522e7_Rx, ComIPduSignalRef=UI2_KompFehlerModus4_07_XIX_UI2_Komponentenfehler_02_XIX_BMC_CAN01_5b9d1a85_Rx, ComIPduSignalRef=UI2_KompFehlerModus4_08_XIX_UI2_Komponentenfehler_02_XIX_BMC_CAN01_077576fa_Rx, ComIPduSignalRef=UI2_KompFehlerModus4_09_XIX_UI2_Komponentenfehler_02_XIX_BMC_CAN01_2d5d4e98_Rx, ComIPduSignalRef=UI2_KompFehlerModus4_10_XIX_UI2_Komponentenfehler_02_XIX_BMC_CAN01_2ed39be7_Rx, ComIPduSignalRef=UI2_KompFehlerModus4_11_XIX_UI2_Komponentenfehler_02_XIX_BMC_CAN01_04fba385_Rx, ComIPduSignalRef=UI2_KompFehlerModus4_12_XIX_UI2_Komponentenfehler_02_XIX_BMC_CAN01_7a83eb23_Rx, ComIPduSignalRef=UI2_KompFehlerModus4_13_XIX_UI2_Komponentenfehler_02_XIX_BMC_CAN01_50abd341_Rx, ComIPduSignalRef=UI2_KompFehlerModus4_14_XIX_UI2_Komponentenfehler_02_XIX_BMC_CAN01_86737a6f_Rx, ComIPduSignalRef=UI2_KompFehlerModus4_15_XIX_UI2_Komponentenfehler_02_XIX_BMC_CAN01_ac5b420d_Rx, ComIPduSignalRef=UI2_KompFehlerModus4_16_XIX_UI2_Komponentenfehler_02_XIX_BMC_CAN01_d2230aab_Rx, ComPduIdRef=EcucPduCollection/UI2_Komponentenfehler_02_XIX_BMC_CAN01_7d1b0ef0_Rx
        VDSO_05_XIX_HCP5_CANFD01_48366f26_Rx: ComIPduDirection=RECEIVE, ComIPduType=NORMAL, ComIPduGroupRef=BMC_HV_XIX_HCP5_CANFD01_Rx_6dfafc5f, ComIPduGroupRef=BMC_HV_XIX_PNC_11_Chassis_Rx_1f7dfb2f, ComIPduSignalRef=VDSO_Vx3d_XIX_VDSO_05_XIX_HCP5_CANFD01_16f2eb37_Rx, ComPduIdRef=EcucPduCollection/VDSO_05_XIX_HCP5_CANFD01_48366f26_Rx
        WFS_02_XIX_HCP5_CANFD01_61136cb6_Rx: ComIPduDirection=RECEIVE, ComIPduType=NORMAL, ComIPduGroupRef=BMC_HV_XIX_HCP5_CANFD01_Rx_6dfafc5f, ComIPduGroupRef=BMC_HV_XIX_PNC_06_Basefunction_ComfortLight_Rx_7861a7a5, ComIPduSignalRef=VIN_10_XIX_WFS_02_XIX_HCP5_CANFD01_8d48ee8f_Rx, ComIPduSignalRef=VIN_11_XIX_WFS_02_XIX_HCP5_CANFD01_ee4f37ab_Rx, ComIPduSignalRef=VIN_12_XIX_WFS_02_XIX_HCP5_CANFD01_4b475cc7_Rx, ComIPduSignalRef=VIN_13_XIX_WFS_02_XIX_HCP5_CANFD01_284085e3_Rx, ComIPduSignalRef=VIN_14_XIX_WFS_02_XIX_HCP5_CANFD01_da268c5e_Rx, ComIPduSignalRef=VIN_15_XIX_WFS_02_XIX_HCP5_CANFD01_b921557a_Rx, ComIPduSignalRef=VIN_16_XIX_WFS_02_XIX_HCP5_CANFD01_1c293e16_Rx, ComIPduSignalRef=VIN_17_XIX_WFS_02_XIX_HCP5_CANFD01_7f2ee732_Rx, ComIPduSignalRef=VIN_1_XIX_WFS_02_XIX_HCP5_CANFD01_7a318e94_Rx, ComIPduSignalRef=VIN_2_XIX_WFS_02_XIX_HCP5_CANFD01_df39e5f8_Rx, ComIPduSignalRef=VIN_3_XIX_WFS_02_XIX_HCP5_CANFD01_bc3e3cdc_Rx, ComIPduSignalRef=VIN_4_XIX_WFS_02_XIX_HCP5_CANFD01_4e583561_Rx, ComIPduSignalRef=VIN_5_XIX_WFS_02_XIX_HCP5_CANFD01_2d5fec45_Rx, ComIPduSignalRef=VIN_6_XIX_WFS_02_XIX_HCP5_CANFD01_88578729_Rx, ComIPduSignalRef=VIN_7_XIX_WFS_02_XIX_HCP5_CANFD01_eb505e0d_Rx, ComIPduSignalRef=VIN_8_XIX_WFS_02_XIX_HCP5_CANFD01_b7ea9212_Rx, ComIPduSignalRef=VIN_9_XIX_WFS_02_XIX_HCP5_CANFD01_d4ed4b36_Rx, ComPduIdRef=EcucPduCollection/WFS_02_XIX_HCP5_CANFD01_61136cb6_Rx
        ZeitMaster_01_XIX_HCP5_CANFD01_dad73d21_Rx: ComIPduDirection=RECEIVE, ComIPduType=NORMAL, ComIPduGroupRef=BMC_HV_XIX_HCP5_CANFD01_Rx_6dfafc5f, ComIPduGroupRef=BMC_HV_XIX_PNC_27_Timemaster_Timer_Rx_2db6b092, ComIPduSignalRef=ZM_HV_Auszeit_Status_XIX_ZeitMaster_01_XIX_HCP5_CANFD01_de3b0265_Rx, ComIPduSignalRef=ZM_HV_Auszeit_XIX_ZeitMaster_01_XIX_HCP5_CANFD01_870dc7b8_Rx, ComPduIdRef=EcucPduCollection/ZeitMaster_01_XIX_HCP5_CANFD01_dad73d21_Rx
        Zeitmaster_05_XIX_HCP5_CANFD01_5eaa5a96_Rx: ComIPduDirection=RECEIVE, ComIPduType=NORMAL, ComIPduGroupRef=BMC_HV_XIX_HCP5_CANFD01_Rx_6dfafc5f, ComIPduGroupRef=BMC_HV_XIX_PNC_27_Timemaster_Timer_Rx_2db6b092, ComIPduSignalRef=ZM_HV_Auszeit_HiRes_XIX_Zeitmaster_05_XIX_HCP5_CANFD01_2f334ec5_Rx, ComPduIdRef=EcucPduCollection/Zeitmaster_05_XIX_HCP5_CANFD01_5eaa5a96_Rx
      19 x ComIPduGroup:
        BMC_HV_XIX_BMC_CAN01_Rx_7b388810
        BMC_HV_XIX_BMC_CAN01_Tx_2d622f96
        BMC_HV_XIX_HCP5_CANFD01_Rx_6dfafc5f
        BMC_HV_XIX_HCP5_CANFD01_Tx_3ba05bd9
        BMC_HV_XIX_PNC_01_CarWakeUp_Tx_29969a84
        BMC_HV_XIX_PNC_02_Basefunction_Powertrain_Rx_dc518468
        BMC_HV_XIX_PNC_06_Basefunction_ComfortLight_Rx_7861a7a5
        BMC_HV_XIX_PNC_07_Basefunction_CrossSection_Rx_4fb7c882
        BMC_HV_XIX_PNC_10_Powertrain_Rx_c7039922
        BMC_HV_XIX_PNC_11_Chassis_Rx_1f7dfb2f
        BMC_HV_XIX_PNC_13_Airbag_Rx_29234cf7
        BMC_HV_XIX_PNC_24_ThermoManagement_Rx_9f1a6723
        BMC_HV_XIX_PNC_26_HighVoltage_Charging_Rx_765b82c2
        BMC_HV_XIX_PNC_26_HighVoltage_Charging_Tx_20012544
        BMC_HV_XIX_PNC_27_Timemaster_Timer_Rx_2db6b092
        BMC_HV_XIX_PNC_30_EnergyManagement_Rx_a9680a43
        BMC_HV_XIX_PNC_30_EnergyManagement_Tx_ff32adc5
        BMC_HV_XIX_PNC_40_Diagnosis_Energy_Rx_36e9c670
        BMC_HV_XIX_PNC_40_Diagnosis_Energy_Tx_60b361f6
      797 x ComSignal:
        AB_Deaktivierung_HV_XIX_Airbag_10_XIX_HCP5_CANFD01_e8982158_Rx: ComBitPosition=83, ComBitSize=3, ComSignalDataInvalidValue=7, ComSignalEndianness=LITTLE_ENDIAN, ComSignalInitValue=0, ComSignalType=UINT8, ComTimeout=0.5, ComSystemTemplateSystemSignalRef=AB_Deaktivierung_HV
        BJB_CALID_Index_01_XIX_BJB_CALID_01_XIX_BMC_CAN01_14e77ef7_Rx: ComBitPosition=0, ComBitSize=8, ComSignalEndianness=LITTLE_ENDIAN, ComSignalInitValue=63, ComSignalType=UINT8, ComTimeout=5, ComSystemTemplateSystemSignalRef=BJB_CALID_Index_01
        BJB_CALID_Index_02_XIX_BJB_CALID_01_XIX_BMC_CAN01_ddf87648_Rx: ComBitPosition=8, ComBitSize=8, ComSignalEndianness=LITTLE_ENDIAN, ComSignalInitValue=63, ComSignalType=UINT8, ComTimeout=5, ComSystemTemplateSystemSignalRef=BJB_CALID_Index_02
        BJB_CALID_Index_03_XIX_BJB_CALID_01_XIX_BMC_CAN01_2c2273e2_Rx: ComBitPosition=16, ComBitSize=8, ComSignalEndianness=LITTLE_ENDIAN, ComSignalInitValue=63, ComSignalType=UINT8, ComTimeout=5, ComSystemTemplateSystemSignalRef=BJB_CALID_Index_03
        BJB_CALID_Index_04_XIX_BJB_CALID_01_XIX_BMC_CAN01_94b76177_Rx: ComBitPosition=24, ComBitSize=8, ComSignalEndianness=LITTLE_ENDIAN, ComSignalInitValue=63, ComSignalType=UINT8, ComTimeout=5, ComSystemTemplateSystemSignalRef=BJB_CALID_Index_04
        BJB_CALID_Index_05_XIX_BJB_CALID_01_XIX_BMC_CAN01_656d64dd_Rx: ComBitPosition=32, ComBitSize=8, ComSignalEndianness=LITTLE_ENDIAN, ComSignalInitValue=63, ComSignalType=UINT8, ComTimeout=5, ComSystemTemplateSystemSignalRef=BJB_CALID_Index_05
        BJB_CALID_Index_06_XIX_BJB_CALID_01_XIX_BMC_CAN01_ac726c62_Rx: ComBitPosition=40, ComBitSize=8, ComSignalEndianness=LITTLE_ENDIAN, ComSignalInitValue=63, ComSignalType=UINT8, ComTimeout=5, ComSystemTemplateSystemSignalRef=BJB_CALID_Index_06
        BJB_CALID_Index_07_XIX_BJB_CALID_01_XIX_BMC_CAN01_5da869c8_Rx: ComBitPosition=48, ComBitSize=8, ComSignalEndianness=LITTLE_ENDIAN, ComSignalInitValue=63, ComSignalType=UINT8, ComTimeout=5, ComSystemTemplateSystemSignalRef=BJB_CALID_Index_07
        BJB_CALID_Index_08_XIX_BJB_CALID_01_XIX_BMC_CAN01_06294f09_Rx: ComBitPosition=56, ComBitSize=8, ComSignalEndianness=LITTLE_ENDIAN, ComSignalInitValue=63, ComSignalType=UINT8, ComTimeout=5, ComSystemTemplateSystemSignalRef=BJB_CALID_Index_08
        BJB_CALID_Index_09_XIX_BJB_CALID_02_XIX_BMC_CAN01_e68e20da_Rx: ComBitPosition=0, ComBitSize=8, ComSignalEndianness=LITTLE_ENDIAN, ComSignalInitValue=63, ComSignalType=UINT8, ComTimeout=5, ComSystemTemplateSystemSignalRef=BJB_CALID_Index_09
        BJB_CALID_Index_10_XIX_BJB_CALID_02_XIX_BMC_CAN01_c2b281d7_Rx: ComBitPosition=8, ComBitSize=8, ComSignalEndianness=LITTLE_ENDIAN, ComSignalInitValue=63, ComSignalType=UINT8, ComTimeout=5, ComSystemTemplateSystemSignalRef=BJB_CALID_Index_10
        BJB_CALID_Index_11_XIX_BJB_CALID_02_XIX_BMC_CAN01_3368847d_Rx: ComBitPosition=16, ComBitSize=8, ComSignalEndianness=LITTLE_ENDIAN, ComSignalInitValue=63, ComSignalType=UINT8, ComTimeout=5, ComSystemTemplateSystemSignalRef=BJB_CALID_Index_11
        BJB_CALID_Index_12_XIX_BJB_CALID_02_XIX_BMC_CAN01_fa778cc2_Rx: ComBitPosition=24, ComBitSize=8, ComSignalEndianness=LITTLE_ENDIAN, ComSignalInitValue=63, ComSignalType=UINT8, ComTimeout=5, ComSystemTemplateSystemSignalRef=BJB_CALID_Index_12
        BJB_CALID_Index_13_XIX_BJB_CALID_02_XIX_BMC_CAN01_0bad8968_Rx: ComBitPosition=32, ComBitSize=8, ComSignalEndianness=LITTLE_ENDIAN, ComSignalInitValue=63, ComSignalType=UINT8, ComTimeout=5, ComSystemTemplateSystemSignalRef=BJB_CALID_Index_13
        BJB_CALID_Index_14_XIX_BJB_CALID_02_XIX_BMC_CAN01_b3389bfd_Rx: ComBitPosition=40, ComBitSize=8, ComSignalEndianness=LITTLE_ENDIAN, ComSignalInitValue=63, ComSignalType=UINT8, ComTimeout=5, ComSystemTemplateSystemSignalRef=BJB_CALID_Index_14
        BJB_CALID_Index_15_XIX_BJB_CALID_02_XIX_BMC_CAN01_42e29e57_Rx: ComBitPosition=48, ComBitSize=8, ComSignalEndianness=LITTLE_ENDIAN, ComSignalInitValue=63, ComSignalType=UINT8, ComTimeout=5, ComSystemTemplateSystemSignalRef=BJB_CALID_Index_15
        BJB_CALID_Index_16_XIX_BJB_CALID_02_XIX_BMC_CAN01_8bfd96e8_Rx: ComBitPosition=56, ComBitSize=8, ComSignalEndianness=LITTLE_ENDIAN, ComSignalInitValue=63, ComSignalType=UINT8, ComTimeout=5, ComSystemTemplateSystemSignalRef=BJB_CALID_Index_16
        BJB_CVN_Byte_1_XIX_BJB_CVN_01_XIX_BMC_CAN01_18856d37_Rx: ComBitPosition=1, ComBitSize=8, ComSignalEndianness=LITTLE_ENDIAN, ComSignalInitValue=0, ComSignalType=UINT8, ComTimeout=5, ComSystemTemplateSystemSignalRef=BJB_CVN_Byte_1
        BJB_CVN_Byte_2_XIX_BJB_CVN_01_XIX_BMC_CAN01_5c24482f_Rx: ComBitPosition=9, ComBitSize=8, ComSignalEndianness=LITTLE_ENDIAN, ComSignalInitValue=0, ComSignalType=UINT8, ComTimeout=5, ComSystemTemplateSystemSignalRef=BJB_CVN_Byte_2
        BJB_CVN_Byte_3_XIX_BJB_CVN_01_XIX_BMC_CAN01_6044ab27_Rx: ComBitPosition=17, ComBitSize=8, ComSignalEndianness=LITTLE_ENDIAN, ComSignalInitValue=0, ComSignalType=UINT8, ComTimeout=5, ComSystemTemplateSystemSignalRef=BJB_CVN_Byte_3
        BJB_CVN_Byte_4_XIX_BJB_CVN_01_XIX_BMC_CAN01_d566021f_Rx: ComBitPosition=25, ComBitSize=8, ComSignalEndianness=LITTLE_ENDIAN, ComSignalInitValue=0, ComSignalType=UINT8, ComTimeout=5, ComSystemTemplateSystemSignalRef=BJB_CVN_Byte_4
        BJB_CVN_VLD_XIX_BJB_CVN_01_XIX_BMC_CAN01_7412dbc7_Rx: ComBitPosition=0, ComBitSize=1, ComSignalEndianness=LITTLE_ENDIAN, ComSignalInitValue=0, ComSignalType=UINT8, ComTimeout=5, ComSystemTemplateSystemSignalRef=BJB_CVN_VLD
        BJB_ErrMem_State_XIX_BJB_08_XIX_BMC_CAN01_418604a2_Rx: ComBitPosition=12, ComBitSize=2, ComSignalEndianness=LITTLE_ENDIAN, ComSignalInitValue=2, ComSignalType=UINT8, ComTimeout=1, ComSystemTemplateSystemSignalRef=BJB_ErrMem_State
        BMC_Abschaltankuendigung_XIX_BMC_HV_03_XIX_HCP5_CANFD01_971531f5_Tx: ComBitPosition=46, ComBitSize=10, ComSignalDataInvalidValue=1023, ComSignalEndianness=LITTLE_ENDIAN, ComSignalInitValue=1022, ComSignalType=UINT8, ComTransferProperty=PENDING, ComSystemTemplateSystemSignalRef=BMC_Abschaltankuendigung
        BMC_Bidi_Energie_Absolut_XIX_BMC_HV_06_XIX_HCP5_CANFD01_b94683d1_Tx: ComBitPosition=48, ComBitSize=16, ComSignalDataInvalidValue=65535, ComSignalEndianness=LITTLE_ENDIAN, ComSignalInitValue=65534, ComSignalType=UINT8, ComTransferProperty=PENDING, ComSystemTemplateSystemSignalRef=BMC_Bidi_Energie_Absolut
        BMC_Bidi_Freigabe_XIX_BMC_HV_06_XIX_HCP5_CANFD01_da88ae89_Tx: ComBitPosition=35, ComBitSize=2, ComSignalDataInvalidValue=3, ComSignalEndianness=LITTLE_ENDIAN, ComSignalInitValue=2, ComSignalType=UINT8, ComTransferProperty=PENDING, ComSystemTemplateSystemSignalRef=BMC_Bidi_Freigabe
        BMC_Bidi_GenutzteEnergie_XIX_BMC_HV_03_XIX_HCP5_CANFD01_71b918c9_Tx: ComBitPosition=168, ComBitSize=16, ComSignalDataInvalidValue=65535, ComSignalEndianness=LITTLE_ENDIAN, ComSignalInitValue=65534, ComSignalType=UINT8, ComTransferProperty=PENDING, ComSystemTemplateSystemSignalRef=BMC_Bidi_GenutzteEnergie
        BMC_Bidi_Max_SoC_XIX_BMC_HV_03_XIX_HCP5_CANFD01_efab2d0f_Tx: ComBitPosition=185, ComBitSize=7, ComSignalDataInvalidValue=127, ComSignalEndianness=LITTLE_ENDIAN, ComSignalInitValue=126, ComSignalType=UINT8, ComTransferProperty=PENDING, ComSystemTemplateSystemSignalRef=BMC_Bidi_Max_SoC
        BMC_Bidi_Min_SoC_XIX_BMC_HV_03_XIX_HCP5_CANFD01_1b8c15d1_Tx: ComBitPosition=161, ComBitSize=7, ComSignalDataInvalidValue=127, ComSignalEndianness=LITTLE_ENDIAN, ComSignalInitValue=126, ComSignalType=UINT8, ComTransferProperty=PENDING, ComSystemTemplateSystemSignalRef=BMC_Bidi_Min_SoC
        BMC_Bidi_Veto_Energie_XIX_BMC_HV_06_XIX_HCP5_CANFD01_c682e8ed_Tx: ComBitPosition=34, ComBitSize=1, ComSignalEndianness=LITTLE_ENDIAN, ComSignalInitValue=0, ComSignalType=UINT8, ComTransferProperty=PENDING, ComSystemTemplateSystemSignalRef=BMC_Bidi_Veto_Energie
        BMC_Bidi_Veto_Temp_XIX_BMC_HV_03_XIX_HCP5_CANFD01_1db44959_Tx: ComBitPosition=184, ComBitSize=1, ComSignalEndianness=LITTLE_ENDIAN, ComSignalInitValue=0, ComSignalType=UINT8, ComTransferProperty=PENDING, ComSystemTemplateSystemSignalRef=BMC_Bidi_Veto_Temp
        BMC_CMC_Temperatur_001_XIX_BMC_CMC_Temperatur_01_XIX_HCP5_CANFD01_19554342_Tx: ComBitPosition=16, ComBitSize=8, ComSignalDataInvalidValue=255, ComSignalEndianness=LITTLE_ENDIAN, ComSignalInitValue=254, ComSignalType=UINT8, ComTransferProperty=PENDING, ComSystemTemplateSystemSignalRef=BMC_CMC_Temperatur_001
        BMC_CMC_Temperatur_002_XIX_BMC_CMC_Temperatur_01_XIX_HCP5_CANFD01_672d0be4_Tx: ComBitPosition=24, ComBitSize=8, ComSignalDataInvalidValue=255, ComSignalEndianness=LITTLE_ENDIAN, ComSignalInitValue=254, ComSignalType=UINT8, ComTransferProperty=PENDING, ComSystemTemplateSystemSignalRef=BMC_CMC_Temperatur_002
        BMC_CMC_Temperatur_003_XIX_BMC_CMC_Temperatur_01_XIX_HCP5_CANFD01_4d053386_Tx: ComBitPosition=32, ComBitSize=8, ComSignalDataInvalidValue=255, ComSignalEndianness=LITTLE_ENDIAN, ComSignalInitValue=254, ComSignalType=UINT8, ComTransferProperty=PENDING, ComSystemTemplateSystemSignalRef=BMC_CMC_Temperatur_003
        BMC_CMC_Temperatur_004_XIX_BMC_CMC_Temperatur_01_XIX_HCP5_CANFD01_9bdd9aa8_Tx: ComBitPosition=40, ComBitSize=8, ComSignalDataInvalidValue=255, ComSignalEndianness=LITTLE_ENDIAN, ComSignalInitValue=254, ComSignalType=UINT8, ComTransferProperty=PENDING, ComSystemTemplateSystemSignalRef=BMC_CMC_Temperatur_004
        BMC_CMC_Temperatur_005_XIX_BMC_CMC_Temperatur_01_XIX_HCP5_CANFD01_b1f5a2ca_Tx: ComBitPosition=48, ComBitSize=8, ComSignalDataInvalidValue=255, ComSignalEndianness=LITTLE_ENDIAN, ComSignalInitValue=254, ComSignalType=UINT8, ComTransferProperty=PENDING, ComSystemTemplateSystemSignalRef=BMC_CMC_Temperatur_005
        BMC_CMC_Temperatur_006_XIX_BMC_CMC_Temperatur_01_XIX_HCP5_CANFD01_cf8dea6c_Tx: ComBitPosition=56, ComBitSize=8, ComSignalDataInvalidValue=255, ComSignalEndianness=LITTLE_ENDIAN, ComSignalInitValue=254, ComSignalType=UINT8, ComTransferProperty=PENDING, ComSystemTemplateSystemSignalRef=BMC_CMC_Temperatur_006
        BMC_CMC_Temperatur_007_XIX_BMC_CMC_Temperatur_01_XIX_HCP5_CANFD01_e5a5d20e_Tx: ComBitPosition=64, ComBitSize=8, ComSignalDataInvalidValue=255, ComSignalEndianness=LITTLE_ENDIAN, ComSignalInitValue=254, ComSignalType=UINT8, ComTransferProperty=PENDING, ComSystemTemplateSystemSignalRef=BMC_CMC_Temperatur_007
        BMC_CMC_Temperatur_008_XIX_BMC_CMC_Temperatur_01_XIX_HCP5_CANFD01_b94dbe71_Tx: ComBitPosition=72, ComBitSize=8, ComSignalDataInvalidValue=255, ComSignalEndianness=LITTLE_ENDIAN, ComSignalInitValue=254, ComSignalType=UINT8, ComTransferProperty=PENDING, ComSystemTemplateSystemSignalRef=BMC_CMC_Temperatur_008
        BMC_CMC_Temperatur_009_XIX_BMC_CMC_Temperatur_01_XIX_HCP5_CANFD01_93658613_Tx: ComBitPosition=80, ComBitSize=8, ComSignalDataInvalidValue=255, ComSignalEndianness=LITTLE_ENDIAN, ComSignalInitValue=254, ComSignalType=UINT8, ComTransferProperty=PENDING, ComSystemTemplateSystemSignalRef=BMC_CMC_Temperatur_009
        BMC_CMC_Temperatur_010_XIX_BMC_CMC_Temperatur_01_XIX_HCP5_CANFD01_90eb536c_Tx: ComBitPosition=88, ComBitSize=8, ComSignalDataInvalidValue=255, ComSignalEndianness=LITTLE_ENDIAN, ComSignalInitValue=254, ComSignalType=UINT8, ComTransferProperty=PENDING, ComSystemTemplateSystemSignalRef=BMC_CMC_Temperatur_010
        BMC_CMC_Temperatur_011_XIX_BMC_CMC_Temperatur_01_XIX_HCP5_CANFD01_bac36b0e_Tx: ComBitPosition=96, ComBitSize=8, ComSignalDataInvalidValue=255, ComSignalEndianness=LITTLE_ENDIAN, ComSignalInitValue=254, ComSignalType=UINT8, ComTransferProperty=PENDING, ComSystemTemplateSystemSignalRef=BMC_CMC_Temperatur_011
        BMC_CMC_Temperatur_012_XIX_BMC_CMC_Temperatur_01_XIX_HCP5_CANFD01_c4bb23a8_Tx: ComBitPosition=104, ComBitSize=8, ComSignalDataInvalidValue=255, ComSignalEndianness=LITTLE_ENDIAN, ComSignalInitValue=254, ComSignalType=UINT8, ComTransferProperty=PENDING, ComSystemTemplateSystemSignalRef=BMC_CMC_Temperatur_012
        BMC_CMC_Temperatur_013_XIX_BMC_CMC_Temperatur_01_XIX_HCP5_CANFD01_ee931bca_Tx: ComBitPosition=112, ComBitSize=8, ComSignalDataInvalidValue=255, ComSignalEndianness=LITTLE_ENDIAN, ComSignalInitValue=254, ComSignalType=UINT8, ComTransferProperty=PENDING, ComSystemTemplateSystemSignalRef=BMC_CMC_Temperatur_013
        BMC_CMC_Temperatur_014_XIX_BMC_CMC_Temperatur_01_XIX_HCP5_CANFD01_384bb2e4_Tx: ComBitPosition=120, ComBitSize=8, ComSignalDataInvalidValue=255, ComSignalEndianness=LITTLE_ENDIAN, ComSignalInitValue=254, ComSignalType=UINT8, ComTransferProperty=PENDING, ComSystemTemplateSystemSignalRef=BMC_CMC_Temperatur_014
        BMC_CMC_Temperatur_015_XIX_BMC_CMC_Temperatur_01_XIX_HCP5_CANFD01_12638a86_Tx: ComBitPosition=128, ComBitSize=8, ComSignalDataInvalidValue=255, ComSignalEndianness=LITTLE_ENDIAN, ComSignalInitValue=254, ComSignalType=UINT8, ComTransferProperty=PENDING, ComSystemTemplateSystemSignalRef=BMC_CMC_Temperatur_015
        BMC_CMC_Temperatur_016_XIX_BMC_CMC_Temperatur_01_XIX_HCP5_CANFD01_6c1bc220_Tx: ComBitPosition=136, ComBitSize=8, ComSignalDataInvalidValue=255, ComSignalEndianness=LITTLE_ENDIAN, ComSignalInitValue=254, ComSignalType=UINT8, ComTransferProperty=PENDING, ComSystemTemplateSystemSignalRef=BMC_CMC_Temperatur_016
        BMC_CMC_Temperatur_017_XIX_BMC_CMC_Temperatur_01_XIX_HCP5_CANFD01_4633fa42_Tx: ComBitPosition=144, ComBitSize=8, ComSignalDataInvalidValue=255, ComSignalEndianness=LITTLE_ENDIAN, ComSignalInitValue=254, ComSignalType=UINT8, ComTransferProperty=PENDING, ComSystemTemplateSystemSignalRef=BMC_CMC_Temperatur_017
        BMC_CMC_Temperatur_018_XIX_BMC_CMC_Temperatur_01_XIX_HCP5_CANFD01_1adb963d_Tx: ComBitPosition=152, ComBitSize=8, ComSignalDataInvalidValue=255, ComSignalEndianness=LITTLE_ENDIAN, ComSignalInitValue=254, ComSignalType=UINT8, ComTransferProperty=PENDING, ComSystemTemplateSystemSignalRef=BMC_CMC_Temperatur_018
        BMC_CMC_Temperatur_019_XIX_BMC_CMC_Temperatur_01_XIX_HCP5_CANFD01_30f3ae5f_Tx: ComBitPosition=160, ComBitSize=8, ComSignalDataInvalidValue=255, ComSignalEndianness=LITTLE_ENDIAN, ComSignalInitValue=254, ComSignalType=UINT8, ComTransferProperty=PENDING, ComSystemTemplateSystemSignalRef=BMC_CMC_Temperatur_019
        BMC_CMC_Temperatur_01_Messzeit_XIX_BMC_CMC_Temperatur_01_XIX_HCP5_CANFD01_e5c4df8c_Tx: ComBitPosition=480, ComBitSize=8, ComSignalDataInvalidValue=255, ComSignalEndianness=LITTLE_ENDIAN, ComSignalInitValue=254, ComSignalType=UINT8, ComTransferProperty=PENDING, ComSystemTemplateSystemSignalRef=BMC_CMC_Temperatur_01_Messzeit
        BMC_CMC_Temperatur_020_XIX_BMC_CMC_Temperatur_01_XIX_HCP5_CANFD01_af202df9_Tx: ComBitPosition=168, ComBitSize=8, ComSignalDataInvalidValue=255, ComSignalEndianness=LITTLE_ENDIAN, ComSignalInitValue=254, ComSignalType=UINT8, ComTransferProperty=PENDING, ComSystemTemplateSystemSignalRef=BMC_CMC_Temperatur_020
        BMC_CMC_Temperatur_021_XIX_BMC_CMC_Temperatur_01_XIX_HCP5_CANFD01_8508159b_Tx: ComBitPosition=176, ComBitSize=8, ComSignalDataInvalidValue=255, ComSignalEndianness=LITTLE_ENDIAN, ComSignalInitValue=254, ComSignalType=UINT8, ComTransferProperty=PENDING, ComSystemTemplateSystemSignalRef=BMC_CMC_Temperatur_021
        BMC_CMC_Temperatur_022_XIX_BMC_CMC_Temperatur_01_XIX_HCP5_CANFD01_fb705d3d_Tx: ComBitPosition=184, ComBitSize=8, ComSignalDataInvalidValue=255, ComSignalEndianness=LITTLE_ENDIAN, ComSignalInitValue=254, ComSignalType=UINT8, ComTransferProperty=PENDING, ComSystemTemplateSystemSignalRef=BMC_CMC_Temperatur_022
        BMC_CMC_Temperatur_023_XIX_BMC_CMC_Temperatur_01_XIX_HCP5_CANFD01_d158655f_Tx: ComBitPosition=192, ComBitSize=8, ComSignalDataInvalidValue=255, ComSignalEndianness=LITTLE_ENDIAN, ComSignalInitValue=254, ComSignalType=UINT8, ComTransferProperty=PENDING, ComSystemTemplateSystemSignalRef=BMC_CMC_Temperatur_023
        BMC_CMC_Temperatur_024_XIX_BMC_CMC_Temperatur_01_XIX_HCP5_CANFD01_0780cc71_Tx: ComBitPosition=200, ComBitSize=8, ComSignalDataInvalidValue=255, ComSignalEndianness=LITTLE_ENDIAN, ComSignalInitValue=254, ComSignalType=UINT8, ComTransferProperty=PENDING, ComSystemTemplateSystemSignalRef=BMC_CMC_Temperatur_024
        BMC_CMC_Temperatur_025_XIX_BMC_CMC_Temperatur_01_XIX_HCP5_CANFD01_2da8f413_Tx: ComBitPosition=208, ComBitSize=8, ComSignalDataInvalidValue=255, ComSignalEndianness=LITTLE_ENDIAN, ComSignalInitValue=254, ComSignalType=UINT8, ComTransferProperty=PENDING, ComSystemTemplateSystemSignalRef=BMC_CMC_Temperatur_025
        BMC_CMC_Temperatur_026_XIX_BMC_CMC_Temperatur_01_XIX_HCP5_CANFD01_53d0bcb5_Tx: ComBitPosition=216, ComBitSize=8, ComSignalDataInvalidValue=255, ComSignalEndianness=LITTLE_ENDIAN, ComSignalInitValue=254, ComSignalType=UINT8, ComTransferProperty=PENDING, ComSystemTemplateSystemSignalRef=BMC_CMC_Temperatur_026
        BMC_CMC_Temperatur_027_XIX_BMC_CMC_Temperatur_01_XIX_HCP5_CANFD01_79f884d7_Tx: ComBitPosition=224, ComBitSize=8, ComSignalDataInvalidValue=255, ComSignalEndianness=LITTLE_ENDIAN, ComSignalInitValue=254, ComSignalType=UINT8, ComTransferProperty=PENDING, ComSystemTemplateSystemSignalRef=BMC_CMC_Temperatur_027
        BMC_CMC_Temperatur_028_XIX_BMC_CMC_Temperatur_01_XIX_HCP5_CANFD01_2510e8a8_Tx: ComBitPosition=232, ComBitSize=8, ComSignalDataInvalidValue=255, ComSignalEndianness=LITTLE_ENDIAN, ComSignalInitValue=254, ComSignalType=UINT8, ComTransferProperty=PENDING, ComSystemTemplateSystemSignalRef=BMC_CMC_Temperatur_028
        BMC_CMC_Temperatur_029_XIX_BMC_CMC_Temperatur_01_XIX_HCP5_CANFD01_0f38d0ca_Tx: ComBitPosition=240, ComBitSize=8, ComSignalDataInvalidValue=255, ComSignalEndianness=LITTLE_ENDIAN, ComSignalInitValue=254, ComSignalType=UINT8, ComTransferProperty=PENDING, ComSystemTemplateSystemSignalRef=BMC_CMC_Temperatur_029
        BMC_CMC_Temperatur_02_Messzeit_XIX_BMC_CMC_Temperatur_02_XIX_HCP5_CANFD01_8c2bd22d_Tx: ComBitPosition=128, ComBitSize=8, ComSignalDataInvalidValue=255, ComSignalEndianness=LITTLE_ENDIAN, ComSignalInitValue=254, ComSignalType=UINT8, ComTransferProperty=PENDING, ComSystemTemplateSystemSignalRef=BMC_CMC_Temperatur_02_Messzeit
        BMC_CMC_Temperatur_030_XIX_BMC_CMC_Temperatur_01_XIX_HCP5_CANFD01_0cb605b5_Tx: ComBitPosition=248, ComBitSize=8, ComSignalDataInvalidValue=255, ComSignalEndianness=LITTLE_ENDIAN, ComSignalInitValue=254, ComSignalType=UINT8, ComTransferProperty=PENDING, ComSystemTemplateSystemSignalRef=BMC_CMC_Temperatur_030
        BMC_CMC_Temperatur_031_XIX_BMC_CMC_Temperatur_01_XIX_HCP5_CANFD01_269e3dd7_Tx: ComBitPosition=256, ComBitSize=8, ComSignalDataInvalidValue=255, ComSignalEndianness=LITTLE_ENDIAN, ComSignalInitValue=254, ComSignalType=UINT8, ComTransferProperty=PENDING, ComSystemTemplateSystemSignalRef=BMC_CMC_Temperatur_031
        BMC_CMC_Temperatur_032_XIX_BMC_CMC_Temperatur_01_XIX_HCP5_CANFD01_58e67571_Tx: ComBitPosition=264, ComBitSize=8, ComSignalDataInvalidValue=255, ComSignalEndianness=LITTLE_ENDIAN, ComSignalInitValue=254, ComSignalType=UINT8, ComTransferProperty=PENDING, ComSystemTemplateSystemSignalRef=BMC_CMC_Temperatur_032
        BMC_CMC_Temperatur_033_XIX_BMC_CMC_Temperatur_01_XIX_HCP5_CANFD01_72ce4d13_Tx: ComBitPosition=272, ComBitSize=8, ComSignalDataInvalidValue=255, ComSignalEndianness=LITTLE_ENDIAN, ComSignalInitValue=254, ComSignalType=UINT8, ComTransferProperty=PENDING, ComSystemTemplateSystemSignalRef=BMC_CMC_Temperatur_033
        BMC_CMC_Temperatur_034_XIX_BMC_CMC_Temperatur_01_XIX_HCP5_CANFD01_a416e43d_Tx: ComBitPosition=280, ComBitSize=8, ComSignalDataInvalidValue=255, ComSignalEndianness=LITTLE_ENDIAN, ComSignalInitValue=254, ComSignalType=UINT8, ComTransferProperty=PENDING, ComSystemTemplateSystemSignalRef=BMC_CMC_Temperatur_034
        BMC_CMC_Temperatur_035_XIX_BMC_CMC_Temperatur_01_XIX_HCP5_CANFD01_8e3edc5f_Tx: ComBitPosition=288, ComBitSize=8, ComSignalDataInvalidValue=255, ComSignalEndianness=LITTLE_ENDIAN, ComSignalInitValue=254, ComSignalType=UINT8, ComTransferProperty=PENDING, ComSystemTemplateSystemSignalRef=BMC_CMC_Temperatur_035
        BMC_CMC_Temperatur_036_XIX_BMC_CMC_Temperatur_01_XIX_HCP5_CANFD01_f04694f9_Tx: ComBitPosition=296, ComBitSize=8, ComSignalDataInvalidValue=255, ComSignalEndianness=LITTLE_ENDIAN, ComSignalInitValue=254, ComSignalType=UINT8, ComTransferProperty=PENDING, ComSystemTemplateSystemSignalRef=BMC_CMC_Temperatur_036
        BMC_CMC_Temperatur_037_XIX_BMC_CMC_Temperatur_01_XIX_HCP5_CANFD01_da6eac9b_Tx: ComBitPosition=304, ComBitSize=8, ComSignalDataInvalidValue=255, ComSignalEndianness=LITTLE_ENDIAN, ComSignalInitValue=254, ComSignalType=UINT8, ComTransferProperty=PENDING, ComSystemTemplateSystemSignalRef=BMC_CMC_Temperatur_037
        BMC_CMC_Temperatur_038_XIX_BMC_CMC_Temperatur_01_XIX_HCP5_CANFD01_8686c0e4_Tx: ComBitPosition=312, ComBitSize=8, ComSignalDataInvalidValue=255, ComSignalEndianness=LITTLE_ENDIAN, ComSignalInitValue=254, ComSignalType=UINT8, ComTransferProperty=PENDING, ComSystemTemplateSystemSignalRef=BMC_CMC_Temperatur_038
        BMC_CMC_Temperatur_039_XIX_BMC_CMC_Temperatur_01_XIX_HCP5_CANFD01_acaef886_Tx: ComBitPosition=320, ComBitSize=8, ComSignalDataInvalidValue=255, ComSignalEndianness=LITTLE_ENDIAN, ComSignalInitValue=254, ComSignalType=UINT8, ComTransferProperty=PENDING, ComSystemTemplateSystemSignalRef=BMC_CMC_Temperatur_039
        BMC_CMC_Temperatur_03_Messzeit_XIX_BMC_CMC_Temperatur_03_XIX_HCP5_CANFD01_1da1d48d_Tx: ComBitPosition=480, ComBitSize=8, ComSignalDataInvalidValue=255, ComSignalEndianness=LITTLE_ENDIAN, ComSignalInitValue=254, ComSignalType=UINT8, ComTransferProperty=PENDING, ComSystemTemplateSystemSignalRef=BMC_CMC_Temperatur_03_Messzeit
        BMC_CMC_Temperatur_040_XIX_BMC_CMC_Temperatur_01_XIX_HCP5_CANFD01_d0b6d0d3_Tx: ComBitPosition=328, ComBitSize=8, ComSignalDataInvalidValue=255, ComSignalEndianness=LITTLE_ENDIAN, ComSignalInitValue=254, ComSignalType=UINT8, ComTransferProperty=PENDING, ComSystemTemplateSystemSignalRef=BMC_CMC_Temperatur_040
        BMC_CMC_Temperatur_041_XIX_BMC_CMC_Temperatur_01_XIX_HCP5_CANFD01_fa9ee8b1_Tx: ComBitPosition=336, ComBitSize=8, ComSignalDataInvalidValue=255, ComSignalEndianness=LITTLE_ENDIAN, ComSignalInitValue=254, ComSignalType=UINT8, ComTransferProperty=PENDING, ComSystemTemplateSystemSignalRef=BMC_CMC_Temperatur_041
        BMC_CMC_Temperatur_042_XIX_BMC_CMC_Temperatur_01_XIX_HCP5_CANFD01_84e6a017_Tx: ComBitPosition=344, ComBitSize=8, ComSignalDataInvalidValue=255, ComSignalEndianness=LITTLE_ENDIAN, ComSignalInitValue=254, ComSignalType=UINT8, ComTransferProperty=PENDING, ComSystemTemplateSystemSignalRef=BMC_CMC_Temperatur_042
        BMC_CMC_Temperatur_043_XIX_BMC_CMC_Temperatur_01_XIX_HCP5_CANFD01_aece9875_Tx: ComBitPosition=352, ComBitSize=8, ComSignalDataInvalidValue=255, ComSignalEndianness=LITTLE_ENDIAN, ComSignalInitValue=254, ComSignalType=UINT8, ComTransferProperty=PENDING, ComSystemTemplateSystemSignalRef=BMC_CMC_Temperatur_043
        BMC_CMC_Temperatur_044_XIX_BMC_CMC_Temperatur_01_XIX_HCP5_CANFD01_7816315b_Tx: ComBitPosition=360, ComBitSize=8, ComSignalDataInvalidValue=255, ComSignalEndianness=LITTLE_ENDIAN, ComSignalInitValue=254, ComSignalType=UINT8, ComTransferProperty=PENDING, ComSystemTemplateSystemSignalRef=BMC_CMC_Temperatur_044
        BMC_CMC_Temperatur_045_XIX_BMC_CMC_Temperatur_01_XIX_HCP5_CANFD01_523e0939_Tx: ComBitPosition=368, ComBitSize=8, ComSignalDataInvalidValue=255, ComSignalEndianness=LITTLE_ENDIAN, ComSignalInitValue=254, ComSignalType=UINT8, ComTransferProperty=PENDING, ComSystemTemplateSystemSignalRef=BMC_CMC_Temperatur_045
        BMC_CMC_Temperatur_046_XIX_BMC_CMC_Temperatur_01_XIX_HCP5_CANFD01_2c46419f_Tx: ComBitPosition=376, ComBitSize=8, ComSignalDataInvalidValue=255, ComSignalEndianness=LITTLE_ENDIAN, ComSignalInitValue=254, ComSignalType=UINT8, ComTransferProperty=PENDING, ComSystemTemplateSystemSignalRef=BMC_CMC_Temperatur_046
        BMC_CMC_Temperatur_047_XIX_BMC_CMC_Temperatur_01_XIX_HCP5_CANFD01_066e79fd_Tx: ComBitPosition=384, ComBitSize=8, ComSignalDataInvalidValue=255, ComSignalEndianness=LITTLE_ENDIAN, ComSignalInitValue=254, ComSignalType=UINT8, ComTransferProperty=PENDING, ComSystemTemplateSystemSignalRef=BMC_CMC_Temperatur_047
        BMC_CMC_Temperatur_048_XIX_BMC_CMC_Temperatur_01_XIX_HCP5_CANFD01_5a861582_Tx: ComBitPosition=392, ComBitSize=8, ComSignalDataInvalidValue=255, ComSignalEndianness=LITTLE_ENDIAN, ComSignalInitValue=254, ComSignalType=UINT8, ComTransferProperty=PENDING, ComSystemTemplateSystemSignalRef=BMC_CMC_Temperatur_048
        BMC_CMC_Temperatur_049_XIX_BMC_CMC_Temperatur_01_XIX_HCP5_CANFD01_70ae2de0_Tx: ComBitPosition=400, ComBitSize=8, ComSignalDataInvalidValue=255, ComSignalEndianness=LITTLE_ENDIAN, ComSignalInitValue=254, ComSignalType=UINT8, ComTransferProperty=PENDING, ComSystemTemplateSystemSignalRef=BMC_CMC_Temperatur_049
        BMC_CMC_Temperatur_050_XIX_BMC_CMC_Temperatur_01_XIX_HCP5_CANFD01_7320f89f_Tx: ComBitPosition=408, ComBitSize=8, ComSignalDataInvalidValue=255, ComSignalEndianness=LITTLE_ENDIAN, ComSignalInitValue=254, ComSignalType=UINT8, ComTransferProperty=PENDING, ComSystemTemplateSystemSignalRef=BMC_CMC_Temperatur_050
        BMC_CMC_Temperatur_051_XIX_BMC_CMC_Temperatur_01_XIX_HCP5_CANFD01_5908c0fd_Tx: ComBitPosition=416, ComBitSize=8, ComSignalDataInvalidValue=255, ComSignalEndianness=LITTLE_ENDIAN, ComSignalInitValue=254, ComSignalType=UINT8, ComTransferProperty=PENDING, ComSystemTemplateSystemSignalRef=BMC_CMC_Temperatur_051
        BMC_CMC_Temperatur_052_XIX_BMC_CMC_Temperatur_01_XIX_HCP5_CANFD01_2770885b_Tx: ComBitPosition=424, ComBitSize=8, ComSignalDataInvalidValue=255, ComSignalEndianness=LITTLE_ENDIAN, ComSignalInitValue=254, ComSignalType=UINT8, ComTransferProperty=PENDING, ComSystemTemplateSystemSignalRef=BMC_CMC_Temperatur_052
        BMC_CMC_Temperatur_053_XIX_BMC_CMC_Temperatur_01_XIX_HCP5_CANFD01_0d58b039_Tx: ComBitPosition=432, ComBitSize=8, ComSignalDataInvalidValue=255, ComSignalEndianness=LITTLE_ENDIAN, ComSignalInitValue=254, ComSignalType=UINT8, ComTransferProperty=PENDING, ComSystemTemplateSystemSignalRef=BMC_CMC_Temperatur_053
        BMC_CMC_Temperatur_054_XIX_BMC_CMC_Temperatur_01_XIX_HCP5_CANFD01_db801917_Tx: ComBitPosition=440, ComBitSize=8, ComSignalDataInvalidValue=255, ComSignalEndianness=LITTLE_ENDIAN, ComSignalInitValue=254, ComSignalType=UINT8, ComTransferProperty=PENDING, ComSystemTemplateSystemSignalRef=BMC_CMC_Temperatur_054
        BMC_CMC_Temperatur_055_XIX_BMC_CMC_Temperatur_01_XIX_HCP5_CANFD01_f1a82175_Tx: ComBitPosition=448, ComBitSize=8, ComSignalDataInvalidValue=255, ComSignalEndianness=LITTLE_ENDIAN, ComSignalInitValue=254, ComSignalType=UINT8, ComTransferProperty=PENDING, ComSystemTemplateSystemSignalRef=BMC_CMC_Temperatur_055
        BMC_CMC_Temperatur_056_XIX_BMC_CMC_Temperatur_01_XIX_HCP5_CANFD01_8fd069d3_Tx: ComBitPosition=456, ComBitSize=8, ComSignalDataInvalidValue=255, ComSignalEndianness=LITTLE_ENDIAN, ComSignalInitValue=254, ComSignalType=UINT8, ComTransferProperty=PENDING, ComSystemTemplateSystemSignalRef=BMC_CMC_Temperatur_056
        BMC_CMC_Temperatur_057_XIX_BMC_CMC_Temperatur_01_XIX_HCP5_CANFD01_a5f851b1_Tx: ComBitPosition=464, ComBitSize=8, ComSignalDataInvalidValue=255, ComSignalEndianness=LITTLE_ENDIAN, ComSignalInitValue=254, ComSignalType=UINT8, ComTransferProperty=PENDING, ComSystemTemplateSystemSignalRef=BMC_CMC_Temperatur_057
        BMC_CMC_Temperatur_058_XIX_BMC_CMC_Temperatur_01_XIX_HCP5_CANFD01_f9103dce_Tx: ComBitPosition=472, ComBitSize=8, ComSignalDataInvalidValue=255, ComSignalEndianness=LITTLE_ENDIAN, ComSignalInitValue=254, ComSignalType=UINT8, ComTransferProperty=PENDING, ComSystemTemplateSystemSignalRef=BMC_CMC_Temperatur_058
        BMC_CMC_Temperatur_059_XIX_BMC_CMC_Temperatur_02_XIX_HCP5_CANFD01_39bed8ce_Tx: ComBitPosition=16, ComBitSize=8, ComSignalDataInvalidValue=255, ComSignalEndianness=LITTLE_ENDIAN, ComSignalInitValue=254, ComSignalType=UINT8, ComTransferProperty=PENDING, ComSystemTemplateSystemSignalRef=BMC_CMC_Temperatur_059
        BMC_CMC_Temperatur_060_XIX_BMC_CMC_Temperatur_02_XIX_HCP5_CANFD01_a66d5b68_Tx: ComBitPosition=24, ComBitSize=8, ComSignalDataInvalidValue=255, ComSignalEndianness=LITTLE_ENDIAN, ComSignalInitValue=254, ComSignalType=UINT8, ComTransferProperty=PENDING, ComSystemTemplateSystemSignalRef=BMC_CMC_Temperatur_060
        BMC_CMC_Temperatur_061_XIX_BMC_CMC_Temperatur_02_XIX_HCP5_CANFD01_8c45630a_Tx: ComBitPosition=32, ComBitSize=8, ComSignalDataInvalidValue=255, ComSignalEndianness=LITTLE_ENDIAN, ComSignalInitValue=254, ComSignalType=UINT8, ComTransferProperty=PENDING, ComSystemTemplateSystemSignalRef=BMC_CMC_Temperatur_061
        BMC_CMC_Temperatur_062_XIX_BMC_CMC_Temperatur_02_XIX_HCP5_CANFD01_f23d2bac_Tx: ComBitPosition=40, ComBitSize=8, ComSignalDataInvalidValue=255, ComSignalEndianness=LITTLE_ENDIAN, ComSignalInitValue=254, ComSignalType=UINT8, ComTransferProperty=PENDING, ComSystemTemplateSystemSignalRef=BMC_CMC_Temperatur_062
        BMC_CMC_Temperatur_063_XIX_BMC_CMC_Temperatur_02_XIX_HCP5_CANFD01_d81513ce_Tx: ComBitPosition=48, ComBitSize=8, ComSignalDataInvalidValue=255, ComSignalEndianness=LITTLE_ENDIAN, ComSignalInitValue=254, ComSignalType=UINT8, ComTransferProperty=PENDING, ComSystemTemplateSystemSignalRef=BMC_CMC_Temperatur_063
        BMC_CMC_Temperatur_064_XIX_BMC_CMC_Temperatur_02_XIX_HCP5_CANFD01_0ecdbae0_Tx: ComBitPosition=56, ComBitSize=8, ComSignalDataInvalidValue=255, ComSignalEndianness=LITTLE_ENDIAN, ComSignalInitValue=254, ComSignalType=UINT8, ComTransferProperty=PENDING, ComSystemTemplateSystemSignalRef=BMC_CMC_Temperatur_064
        BMC_CMC_Temperatur_065_XIX_BMC_CMC_Temperatur_02_XIX_HCP5_CANFD01_24e58282_Tx: ComBitPosition=64, ComBitSize=8, ComSignalDataInvalidValue=255, ComSignalEndianness=LITTLE_ENDIAN, ComSignalInitValue=254, ComSignalType=UINT8, ComTransferProperty=PENDING, ComSystemTemplateSystemSignalRef=BMC_CMC_Temperatur_065
        BMC_CMC_Temperatur_066_XIX_BMC_CMC_Temperatur_02_XIX_HCP5_CANFD01_5a9dca24_Tx: ComBitPosition=72, ComBitSize=8, ComSignalDataInvalidValue=255, ComSignalEndianness=LITTLE_ENDIAN, ComSignalInitValue=254, ComSignalType=UINT8, ComTransferProperty=PENDING, ComSystemTemplateSystemSignalRef=BMC_CMC_Temperatur_066
        BMC_CMC_Temperatur_067_XIX_BMC_CMC_Temperatur_02_XIX_HCP5_CANFD01_70b5f246_Tx: ComBitPosition=80, ComBitSize=8, ComSignalDataInvalidValue=255, ComSignalEndianness=LITTLE_ENDIAN, ComSignalInitValue=254, ComSignalType=UINT8, ComTransferProperty=PENDING, ComSystemTemplateSystemSignalRef=BMC_CMC_Temperatur_067
        BMC_CMC_Temperatur_068_XIX_BMC_CMC_Temperatur_02_XIX_HCP5_CANFD01_2c5d9e39_Tx: ComBitPosition=88, ComBitSize=8, ComSignalDataInvalidValue=255, ComSignalEndianness=LITTLE_ENDIAN, ComSignalInitValue=254, ComSignalType=UINT8, ComTransferProperty=PENDING, ComSystemTemplateSystemSignalRef=BMC_CMC_Temperatur_068
        BMC_CMC_Temperatur_069_XIX_BMC_CMC_Temperatur_02_XIX_HCP5_CANFD01_0675a65b_Tx: ComBitPosition=96, ComBitSize=8, ComSignalDataInvalidValue=255, ComSignalEndianness=LITTLE_ENDIAN, ComSignalInitValue=254, ComSignalType=UINT8, ComTransferProperty=PENDING, ComSystemTemplateSystemSignalRef=BMC_CMC_Temperatur_069
        BMC_CMC_Temperatur_070_XIX_BMC_CMC_Temperatur_02_XIX_HCP5_CANFD01_05fb7324_Tx: ComBitPosition=104, ComBitSize=8, ComSignalDataInvalidValue=255, ComSignalEndianness=LITTLE_ENDIAN, ComSignalInitValue=254, ComSignalType=UINT8, ComTransferProperty=PENDING, ComSystemTemplateSystemSignalRef=BMC_CMC_Temperatur_070
        BMC_CMC_Temperatur_071_XIX_BMC_CMC_Temperatur_02_XIX_HCP5_CANFD01_2fd34b46_Tx: ComBitPosition=112, ComBitSize=8, ComSignalDataInvalidValue=255, ComSignalEndianness=LITTLE_ENDIAN, ComSignalInitValue=254, ComSignalType=UINT8, ComTransferProperty=PENDING, ComSystemTemplateSystemSignalRef=BMC_CMC_Temperatur_071
        BMC_CMC_Temperatur_072_XIX_BMC_CMC_Temperatur_02_XIX_HCP5_CANFD01_51ab03e0_Tx: ComBitPosition=120, ComBitSize=8, ComSignalDataInvalidValue=255, ComSignalEndianness=LITTLE_ENDIAN, ComSignalInitValue=254, ComSignalType=UINT8, ComTransferProperty=PENDING, ComSystemTemplateSystemSignalRef=BMC_CMC_Temperatur_072
        BMC_CMC_Temperatur_073_XIX_BMC_CMC_Temperatur_03_XIX_HCP5_CANFD01_94d18d63_Tx: ComBitPosition=16, ComBitSize=8, ComSignalDataInvalidValue=255, ComSignalEndianness=LITTLE_ENDIAN, ComSignalInitValue=254, ComSignalType=UINT8, ComTransferProperty=PENDING, ComSystemTemplateSystemSignalRef=BMC_CMC_Temperatur_073
        BMC_CMC_Temperatur_074_XIX_BMC_CMC_Temperatur_03_XIX_HCP5_CANFD01_4209244d_Tx: ComBitPosition=24, ComBitSize=8, ComSignalDataInvalidValue=255, ComSignalEndianness=LITTLE_ENDIAN, ComSignalInitValue=254, ComSignalType=UINT8, ComTransferProperty=PENDING, ComSystemTemplateSystemSignalRef=BMC_CMC_Temperatur_074
        BMC_CMC_Temperatur_075_XIX_BMC_CMC_Temperatur_03_XIX_HCP5_CANFD01_68211c2f_Tx: ComBitPosition=32, ComBitSize=8, ComSignalDataInvalidValue=255, ComSignalEndianness=LITTLE_ENDIAN, ComSignalInitValue=254, ComSignalType=UINT8, ComTransferProperty=PENDING, ComSystemTemplateSystemSignalRef=BMC_CMC_Temperatur_075
        BMC_CMC_Temperatur_076_XIX_BMC_CMC_Temperatur_03_XIX_HCP5_CANFD01_16595489_Tx: ComBitPosition=40, ComBitSize=8, ComSignalDataInvalidValue=255, ComSignalEndianness=LITTLE_ENDIAN, ComSignalInitValue=254, ComSignalType=UINT8, ComTransferProperty=PENDING, ComSystemTemplateSystemSignalRef=BMC_CMC_Temperatur_076
        BMC_CMC_Temperatur_077_XIX_BMC_CMC_Temperatur_03_XIX_HCP5_CANFD01_3c716ceb_Tx: ComBitPosition=48, ComBitSize=8, ComSignalDataInvalidValue=255, ComSignalEndianness=LITTLE_ENDIAN, ComSignalInitValue=254, ComSignalType=UINT8, ComTransferProperty=PENDING, ComSystemTemplateSystemSignalRef=BMC_CMC_Temperatur_077
        BMC_CMC_Temperatur_078_XIX_BMC_CMC_Temperatur_03_XIX_HCP5_CANFD01_60990094_Tx: ComBitPosition=56, ComBitSize=8, ComSignalDataInvalidValue=255, ComSignalEndianness=LITTLE_ENDIAN, ComSignalInitValue=254, ComSignalType=UINT8, ComTransferProperty=PENDING, ComSystemTemplateSystemSignalRef=BMC_CMC_Temperatur_078
        BMC_CMC_Temperatur_079_XIX_BMC_CMC_Temperatur_03_XIX_HCP5_CANFD01_4ab138f6_Tx: ComBitPosition=64, ComBitSize=8, ComSignalDataInvalidValue=255, ComSignalEndianness=LITTLE_ENDIAN, ComSignalInitValue=254, ComSignalType=UINT8, ComTransferProperty=PENDING, ComSystemTemplateSystemSignalRef=BMC_CMC_Temperatur_079
        BMC_CMC_Temperatur_080_XIX_BMC_CMC_Temperatur_03_XIX_HCP5_CANFD01_2a4f4104_Tx: ComBitPosition=72, ComBitSize=8, ComSignalDataInvalidValue=255, ComSignalEndianness=LITTLE_ENDIAN, ComSignalInitValue=254, ComSignalType=UINT8, ComTransferProperty=PENDING, ComSystemTemplateSystemSignalRef=BMC_CMC_Temperatur_080
        BMC_CMC_Temperatur_081_XIX_BMC_CMC_Temperatur_03_XIX_HCP5_CANFD01_00677966_Tx: ComBitPosition=80, ComBitSize=8, ComSignalDataInvalidValue=255, ComSignalEndianness=LITTLE_ENDIAN, ComSignalInitValue=254, ComSignalType=UINT8, ComTransferProperty=PENDING, ComSystemTemplateSystemSignalRef=BMC_CMC_Temperatur_081
        BMC_CMC_Temperatur_082_XIX_BMC_CMC_Temperatur_03_XIX_HCP5_CANFD01_7e1f31c0_Tx: ComBitPosition=88, ComBitSize=8, ComSignalDataInvalidValue=255, ComSignalEndianness=LITTLE_ENDIAN, ComSignalInitValue=254, ComSignalType=UINT8, ComTransferProperty=PENDING, ComSystemTemplateSystemSignalRef=BMC_CMC_Temperatur_082
        BMC_CMC_Temperatur_083_XIX_BMC_CMC_Temperatur_03_XIX_HCP5_CANFD01_543709a2_Tx: ComBitPosition=96, ComBitSize=8, ComSignalDataInvalidValue=255, ComSignalEndianness=LITTLE_ENDIAN, ComSignalInitValue=254, ComSignalType=UINT8, ComTransferProperty=PENDING, ComSystemTemplateSystemSignalRef=BMC_CMC_Temperatur_083
        BMC_CMC_Temperatur_084_XIX_BMC_CMC_Temperatur_03_XIX_HCP5_CANFD01_82efa08c_Tx: ComBitPosition=104, ComBitSize=8, ComSignalDataInvalidValue=255, ComSignalEndianness=LITTLE_ENDIAN, ComSignalInitValue=254, ComSignalType=UINT8, ComTransferProperty=PENDING, ComSystemTemplateSystemSignalRef=BMC_CMC_Temperatur_084
        BMC_CMC_Temperatur_085_XIX_BMC_CMC_Temperatur_03_XIX_HCP5_CANFD01_a8c798ee_Tx: ComBitPosition=112, ComBitSize=8, ComSignalDataInvalidValue=255, ComSignalEndianness=LITTLE_ENDIAN, ComSignalInitValue=254, ComSignalType=UINT8, ComTransferProperty=PENDING, ComSystemTemplateSystemSignalRef=BMC_CMC_Temperatur_085
        BMC_CMC_Temperatur_086_XIX_BMC_CMC_Temperatur_03_XIX_HCP5_CANFD01_d6bfd048_Tx: ComBitPosition=120, ComBitSize=8, ComSignalDataInvalidValue=255, ComSignalEndianness=LITTLE_ENDIAN, ComSignalInitValue=254, ComSignalType=UINT8, ComTransferProperty=PENDING, ComSystemTemplateSystemSignalRef=BMC_CMC_Temperatur_086
        BMC_CMC_Temperatur_087_XIX_BMC_CMC_Temperatur_03_XIX_HCP5_CANFD01_fc97e82a_Tx: ComBitPosition=128, ComBitSize=8, ComSignalDataInvalidValue=255, ComSignalEndianness=LITTLE_ENDIAN, ComSignalInitValue=254, ComSignalType=UINT8, ComTransferProperty=PENDING, ComSystemTemplateSystemSignalRef=BMC_CMC_Temperatur_087
        BMC_CMC_Temperatur_088_XIX_BMC_CMC_Temperatur_03_XIX_HCP5_CANFD01_a07f8455_Tx: ComBitPosition=136, ComBitSize=8, ComSignalDataInvalidValue=255, ComSignalEndianness=LITTLE_ENDIAN, ComSignalInitValue=254, ComSignalType=UINT8, ComTransferProperty=PENDING, ComSystemTemplateSystemSignalRef=BMC_CMC_Temperatur_088
        BMC_CMC_Temperatur_089_XIX_BMC_CMC_Temperatur_03_XIX_HCP5_CANFD01_8a57bc37_Tx: ComBitPosition=144, ComBitSize=8, ComSignalDataInvalidValue=255, ComSignalEndianness=LITTLE_ENDIAN, ComSignalInitValue=254, ComSignalType=UINT8, ComTransferProperty=PENDING, ComSystemTemplateSystemSignalRef=BMC_CMC_Temperatur_089
        BMC_CMC_Temperatur_090_XIX_BMC_CMC_Temperatur_03_XIX_HCP5_CANFD01_89d96948_Tx: ComBitPosition=152, ComBitSize=8, ComSignalDataInvalidValue=255, ComSignalEndianness=LITTLE_ENDIAN, ComSignalInitValue=254, ComSignalType=UINT8, ComTransferProperty=PENDING, ComSystemTemplateSystemSignalRef=BMC_CMC_Temperatur_090
        BMC_CMC_Temperatur_091_XIX_BMC_CMC_Temperatur_03_XIX_HCP5_CANFD01_a3f1512a_Tx: ComBitPosition=160, ComBitSize=8, ComSignalDataInvalidValue=255, ComSignalEndianness=LITTLE_ENDIAN, ComSignalInitValue=254, ComSignalType=UINT8, ComTransferProperty=PENDING, ComSystemTemplateSystemSignalRef=BMC_CMC_Temperatur_091
        BMC_CMC_Temperatur_092_XIX_BMC_CMC_Temperatur_03_XIX_HCP5_CANFD01_dd89198c_Tx: ComBitPosition=168, ComBitSize=8, ComSignalDataInvalidValue=255, ComSignalEndianness=LITTLE_ENDIAN, ComSignalInitValue=254, ComSignalType=UINT8, ComTransferProperty=PENDING, ComSystemTemplateSystemSignalRef=BMC_CMC_Temperatur_092
        BMC_CMC_Temperatur_093_XIX_BMC_CMC_Temperatur_03_XIX_HCP5_CANFD01_f7a121ee_Tx: ComBitPosition=176, ComBitSize=8, ComSignalDataInvalidValue=255, ComSignalEndianness=LITTLE_ENDIAN, ComSignalInitValue=254, ComSignalType=UINT8, ComTransferProperty=PENDING, ComSystemTemplateSystemSignalRef=BMC_CMC_Temperatur_093
        BMC_CMC_Temperatur_094_XIX_BMC_CMC_Temperatur_03_XIX_HCP5_CANFD01_217988c0_Tx: ComBitPosition=184, ComBitSize=8, ComSignalDataInvalidValue=255, ComSignalEndianness=LITTLE_ENDIAN, ComSignalInitValue=254, ComSignalType=UINT8, ComTransferProperty=PENDING, ComSystemTemplateSystemSignalRef=BMC_CMC_Temperatur_094
        BMC_CMC_Temperatur_095_XIX_BMC_CMC_Temperatur_03_XIX_HCP5_CANFD01_0b51b0a2_Tx: ComBitPosition=192, ComBitSize=8, ComSignalDataInvalidValue=255, ComSignalEndianness=LITTLE_ENDIAN, ComSignalInitValue=254, ComSignalType=UINT8, ComTransferProperty=PENDING, ComSystemTemplateSystemSignalRef=BMC_CMC_Temperatur_095
        BMC_CMC_Temperatur_096_XIX_BMC_CMC_Temperatur_03_XIX_HCP5_CANFD01_7529f804_Tx: ComBitPosition=200, ComBitSize=8, ComSignalDataInvalidValue=255, ComSignalEndianness=LITTLE_ENDIAN, ComSignalInitValue=254, ComSignalType=UINT8, ComTransferProperty=PENDING, ComSystemTemplateSystemSignalRef=BMC_CMC_Temperatur_096
        BMC_CMC_Zellspannung_001_XIX_BMC_CMC_Zellspannung_01_XIX_HCP5_CANFD01_be9dc83a_Tx: ComBitPosition=12, ComBitSize=12, ComSignalDataInvalidValue=4095, ComSignalEndianness=LITTLE_ENDIAN, ComSignalInitValue=4094, ComSignalType=UINT8, ComTransferProperty=PENDING, ComSystemTemplateSystemSignalRef=BMC_CMC_Zellspannung_001
        BMC_CMC_Zellspannung_002_XIX_BMC_CMC_Zellspannung_01_XIX_HCP5_CANFD01_3ec7648f_Tx: ComBitPosition=24, ComBitSize=12, ComSignalDataInvalidValue=4095, ComSignalEndianness=LITTLE_ENDIAN, ComSignalInitValue=4094, ComSignalType=UINT8, ComTransferProperty=PENDING, ComSystemTemplateSystemSignalRef=BMC_CMC_Zellspannung_002
        BMC_CMC_Zellspannung_003_XIX_BMC_CMC_Zellspannung_01_XIX_HCP5_CANFD01_410eff1c_Tx: ComBitPosition=36, ComBitSize=12, ComSignalDataInvalidValue=4095, ComSignalEndianness=LITTLE_ENDIAN, ComSignalInitValue=4094, ComSignalType=UINT8, ComTransferProperty=PENDING, ComSystemTemplateSystemSignalRef=BMC_CMC_Zellspannung_003
        BMC_CMC_Zellspannung_004_XIX_BMC_CMC_Zellspannung_01_XIX_HCP5_CANFD01_e5033ba4_Tx: ComBitPosition=48, ComBitSize=12, ComSignalDataInvalidValue=4095, ComSignalEndianness=LITTLE_ENDIAN, ComSignalInitValue=4094, ComSignalType=UINT8, ComTransferProperty=PENDING, ComSystemTemplateSystemSignalRef=BMC_CMC_Zellspannung_004
        BMC_CMC_Zellspannung_005_XIX_BMC_CMC_Zellspannung_01_XIX_HCP5_CANFD01_9acaa037_Tx: ComBitPosition=60, ComBitSize=12, ComSignalDataInvalidValue=4095, ComSignalEndianness=LITTLE_ENDIAN, ComSignalInitValue=4094, ComSignalType=UINT8, ComTransferProperty=PENDING, ComSystemTemplateSystemSignalRef=BMC_CMC_Zellspannung_005
        BMC_CMC_Zellspannung_006_XIX_BMC_CMC_Zellspannung_01_XIX_HCP5_CANFD01_1a900c82_Tx: ComBitPosition=72, ComBitSize=12, ComSignalDataInvalidValue=4095, ComSignalEndianness=LITTLE_ENDIAN, ComSignalInitValue=4094, ComSignalType=UINT8, ComTransferProperty=PENDING, ComSystemTemplateSystemSignalRef=BMC_CMC_Zellspannung_006
        BMC_CMC_Zellspannung_007_XIX_BMC_CMC_Zellspannung_01_XIX_HCP5_CANFD01_65599711_Tx: ComBitPosition=84, ComBitSize=12, ComSignalDataInvalidValue=4095, ComSignalEndianness=LITTLE_ENDIAN, ComSignalInitValue=4094, ComSignalType=UINT8, ComTransferProperty=PENDING, ComSystemTemplateSystemSignalRef=BMC_CMC_Zellspannung_007
        BMC_CMC_Zellspannung_008_XIX_BMC_CMC_Zellspannung_01_XIX_HCP5_CANFD01_89fa83b3_Tx: ComBitPosition=96, ComBitSize=12, ComSignalDataInvalidValue=4095, ComSignalEndianness=LITTLE_ENDIAN, ComSignalInitValue=4094, ComSignalType=UINT8, ComTransferProperty=PENDING, ComSystemTemplateSystemSignalRef=BMC_CMC_Zellspannung_008
        BMC_CMC_Zellspannung_009_XIX_BMC_CMC_Zellspannung_01_XIX_HCP5_CANFD01_f6331820_Tx: ComBitPosition=108, ComBitSize=12, ComSignalDataInvalidValue=4095, ComSignalEndianness=LITTLE_ENDIAN, ComSignalInitValue=4094, ComSignalType=UINT8, ComTransferProperty=PENDING, ComSystemTemplateSystemSignalRef=BMC_CMC_Zellspannung_009
        BMC_CMC_Zellspannung_010_XIX_BMC_CMC_Zellspannung_01_XIX_HCP5_CANFD01_a82d58cc_Tx: ComBitPosition=120, ComBitSize=12, ComSignalDataInvalidValue=4095, ComSignalEndianness=LITTLE_ENDIAN, ComSignalInitValue=4094, ComSignalType=UINT8, ComTransferProperty=PENDING, ComSystemTemplateSystemSignalRef=BMC_CMC_Zellspannung_010
        BMC_CMC_Zellspannung_011_XIX_BMC_CMC_Zellspannung_01_XIX_HCP5_CANFD01_d7e4c35f_Tx: ComBitPosition=132, ComBitSize=12, ComSignalDataInvalidValue=4095, ComSignalEndianness=LITTLE_ENDIAN, ComSignalInitValue=4094, ComSignalType=UINT8, ComTransferProperty=PENDING, ComSystemTemplateSystemSignalRef=BMC_CMC_Zellspannung_011
        BMC_CMC_Zellspannung_012_XIX_BMC_CMC_Zellspannung_01_XIX_HCP5_CANFD01_57be6fea_Tx: ComBitPosition=144, ComBitSize=12, ComSignalDataInvalidValue=4095, ComSignalEndianness=LITTLE_ENDIAN, ComSignalInitValue=4094, ComSignalType=UINT8, ComTransferProperty=PENDING, ComSystemTemplateSystemSignalRef=BMC_CMC_Zellspannung_012
        BMC_CMC_Zellspannung_013_XIX_BMC_CMC_Zellspannung_01_XIX_HCP5_CANFD01_2877f479_Tx: ComBitPosition=156, ComBitSize=12, ComSignalDataInvalidValue=4095, ComSignalEndianness=LITTLE_ENDIAN, ComSignalInitValue=4094, ComSignalType=UINT8, ComTransferProperty=PENDING, ComSystemTemplateSystemSignalRef=BMC_CMC_Zellspannung_013
        BMC_CMC_Zellspannung_014_XIX_BMC_CMC_Zellspannung_01_XIX_HCP5_CANFD01_8c7a30c1_Tx: ComBitPosition=168, ComBitSize=12, ComSignalDataInvalidValue=4095, ComSignalEndianness=LITTLE_ENDIAN, ComSignalInitValue=4094, ComSignalType=UINT8, ComTransferProperty=PENDING, ComSystemTemplateSystemSignalRef=BMC_CMC_Zellspannung_014
        BMC_CMC_Zellspannung_015_XIX_BMC_CMC_Zellspannung_01_XIX_HCP5_CANFD01_f3b3ab52_Tx: ComBitPosition=180, ComBitSize=12, ComSignalDataInvalidValue=4095, ComSignalEndianness=LITTLE_ENDIAN, ComSignalInitValue=4094, ComSignalType=UINT8, ComTransferProperty=PENDING, ComSystemTemplateSystemSignalRef=BMC_CMC_Zellspannung_015
        BMC_CMC_Zellspannung_016_XIX_BMC_CMC_Zellspannung_01_XIX_HCP5_CANFD01_73e907e7_Tx: ComBitPosition=192, ComBitSize=12, ComSignalDataInvalidValue=4095, ComSignalEndianness=LITTLE_ENDIAN, ComSignalInitValue=4094, ComSignalType=UINT8, ComTransferProperty=PENDING, ComSystemTemplateSystemSignalRef=BMC_CMC_Zellspannung_016
        BMC_CMC_Zellspannung_017_XIX_BMC_CMC_Zellspannung_01_XIX_HCP5_CANFD01_0c209c74_Tx: ComBitPosition=204, ComBitSize=12, ComSignalDataInvalidValue=4095, ComSignalEndianness=LITTLE_ENDIAN, ComSignalInitValue=4094, ComSignalType=UINT8, ComTransferProperty=PENDING, ComSystemTemplateSystemSignalRef=BMC_CMC_Zellspannung_017
        BMC_CMC_Zellspannung_018_XIX_BMC_CMC_Zellspannung_01_XIX_HCP5_CANFD01_e08388d6_Tx: ComBitPosition=216, ComBitSize=12, ComSignalDataInvalidValue=4095, ComSignalEndianness=LITTLE_ENDIAN, ComSignalInitValue=4094, ComSignalType=UINT8, ComTransferProperty=PENDING, ComSystemTemplateSystemSignalRef=BMC_CMC_Zellspannung_018
        BMC_CMC_Zellspannung_019_XIX_BMC_CMC_Zellspannung_01_XIX_HCP5_CANFD01_9f4a1345_Tx: ComBitPosition=228, ComBitSize=12, ComSignalDataInvalidValue=4095, ComSignalEndianness=LITTLE_ENDIAN, ComSignalInitValue=4094, ComSignalType=UINT8, ComTransferProperty=PENDING, ComSystemTemplateSystemSignalRef=BMC_CMC_Zellspannung_019
        BMC_CMC_Zellspannung_01_Messzeit_XIX_BMC_CMC_Zellspannung_01_XIX_HCP5_CANFD01_a5e0aca3_Tx: ComBitPosition=480, ComBitSize=8, ComSignalDataInvalidValue=255, ComSignalEndianness=LITTLE_ENDIAN, ComSignalInitValue=254, ComSignalType=UINT8, ComTransferProperty=PENDING, ComSystemTemplateSystemSignalRef=BMC_CMC_Zellspannung_01_Messzeit
        BMC_CMC_Zellspannung_020_XIX_BMC_CMC_Zellspannung_01_XIX_HCP5_CANFD01_13a64563_Tx: ComBitPosition=240, ComBitSize=12, ComSignalDataInvalidValue=4095, ComSignalEndianness=LITTLE_ENDIAN, ComSignalInitValue=4094, ComSignalType=UINT8, ComTransferProperty=PENDING, ComSystemTemplateSystemSignalRef=BMC_CMC_Zellspannung_020
        BMC_CMC_Zellspannung_021_XIX_BMC_CMC_Zellspannung_01_XIX_HCP5_CANFD01_6c6fdef0_Tx: ComBitPosition=252, ComBitSize=12, ComSignalDataInvalidValue=4095, ComSignalEndianness=LITTLE_ENDIAN, ComSignalInitValue=4094, ComSignalType=UINT8, ComTransferProperty=PENDING, ComSystemTemplateSystemSignalRef=BMC_CMC_Zellspannung_021
        BMC_CMC_Zellspannung_022_XIX_BMC_CMC_Zellspannung_01_XIX_HCP5_CANFD01_ec357245_Tx: ComBitPosition=264, ComBitSize=12, ComSignalDataInvalidValue=4095, ComSignalEndianness=LITTLE_ENDIAN, ComSignalInitValue=4094, ComSignalType=UINT8, ComTransferProperty=PENDING, ComSystemTemplateSystemSignalRef=BMC_CMC_Zellspannung_022
        BMC_CMC_Zellspannung_023_XIX_BMC_CMC_Zellspannung_01_XIX_HCP5_CANFD01_93fce9d6_Tx: ComBitPosition=276, ComBitSize=12, ComSignalDataInvalidValue=4095, ComSignalEndianness=LITTLE_ENDIAN, ComSignalInitValue=4094, ComSignalType=UINT8, ComTransferProperty=PENDING, ComSystemTemplateSystemSignalRef=BMC_CMC_Zellspannung_023
        BMC_CMC_Zellspannung_024_XIX_BMC_CMC_Zellspannung_01_XIX_HCP5_CANFD01_37f12d6e_Tx: ComBitPosition=288, ComBitSize=12, ComSignalDataInvalidValue=4095, ComSignalEndianness=LITTLE_ENDIAN, ComSignalInitValue=4094, ComSignalType=UINT8, ComTransferProperty=PENDING, ComSystemTemplateSystemSignalRef=BMC_CMC_Zellspannung_024
        BMC_CMC_Zellspannung_025_XIX_BMC_CMC_Zellspannung_01_XIX_HCP5_CANFD01_4838b6fd_Tx: ComBitPosition=300, ComBitSize=12, ComSignalDataInvalidValue=4095, ComSignalEndianness=LITTLE_ENDIAN, ComSignalInitValue=4094, ComSignalType=UINT8, ComTransferProperty=PENDING, ComSystemTemplateSystemSignalRef=BMC_CMC_Zellspannung_025
        BMC_CMC_Zellspannung_026_XIX_BMC_CMC_Zellspannung_01_XIX_HCP5_CANFD01_c8621a48_Tx: ComBitPosition=312, ComBitSize=12, ComSignalDataInvalidValue=4095, ComSignalEndianness=LITTLE_ENDIAN, ComSignalInitValue=4094, ComSignalType=UINT8, ComTransferProperty=PENDING, ComSystemTemplateSystemSignalRef=BMC_CMC_Zellspannung_026
        BMC_CMC_Zellspannung_027_XIX_BMC_CMC_Zellspannung_01_XIX_HCP5_CANFD01_b7ab81db_Tx: ComBitPosition=324, ComBitSize=12, ComSignalDataInvalidValue=4095, ComSignalEndianness=LITTLE_ENDIAN, ComSignalInitValue=4094, ComSignalType=UINT8, ComTransferProperty=PENDING, ComSystemTemplateSystemSignalRef=BMC_CMC_Zellspannung_027
        BMC_CMC_Zellspannung_028_XIX_BMC_CMC_Zellspannung_01_XIX_HCP5_CANFD01_5b089579_Tx: ComBitPosition=336, ComBitSize=12, ComSignalDataInvalidValue=4095, ComSignalEndianness=LITTLE_ENDIAN, ComSignalInitValue=4094, ComSignalType=UINT8, ComTransferProperty=PENDING, ComSystemTemplateSystemSignalRef=BMC_CMC_Zellspannung_028
        BMC_CMC_Zellspannung_029_XIX_BMC_CMC_Zellspannung_01_XIX_HCP5_CANFD01_24c10eea_Tx: ComBitPosition=348, ComBitSize=12, ComSignalDataInvalidValue=4095, ComSignalEndianness=LITTLE_ENDIAN, ComSignalInitValue=4094, ComSignalType=UINT8, ComTransferProperty=PENDING, ComSystemTemplateSystemSignalRef=BMC_CMC_Zellspannung_029
        BMC_CMC_Zellspannung_02_Messzeit_XIX_BMC_CMC_Zellspannung_02_XIX_HCP5_CANFD01_2962a4f1_Tx: ComBitPosition=480, ComBitSize=8, ComSignalDataInvalidValue=255, ComSignalEndianness=LITTLE_ENDIAN, ComSignalInitValue=254, ComSignalType=UINT8, ComTransferProperty=PENDING, ComSystemTemplateSystemSignalRef=BMC_CMC_Zellspannung_02_Messzeit
        BMC_CMC_Zellspannung_030_XIX_BMC_CMC_Zellspannung_01_XIX_HCP5_CANFD01_7adf4e06_Tx: ComBitPosition=360, ComBitSize=12, ComSignalDataInvalidValue=4095, ComSignalEndianness=LITTLE_ENDIAN, ComSignalInitValue=4094, ComSignalType=UINT8, ComTransferProperty=PENDING, ComSystemTemplateSystemSignalRef=BMC_CMC_Zellspannung_030
        BMC_CMC_Zellspannung_031_XIX_BMC_CMC_Zellspannung_01_XIX_HCP5_CANFD01_0516d595_Tx: ComBitPosition=372, ComBitSize=12, ComSignalDataInvalidValue=4095, ComSignalEndianness=LITTLE_ENDIAN, ComSignalInitValue=4094, ComSignalType=UINT8, ComTransferProperty=PENDING, ComSystemTemplateSystemSignalRef=BMC_CMC_Zellspannung_031
        BMC_CMC_Zellspannung_032_XIX_BMC_CMC_Zellspannung_01_XIX_HCP5_CANFD01_854c7920_Tx: ComBitPosition=384, ComBitSize=12, ComSignalDataInvalidValue=4095, ComSignalEndianness=LITTLE_ENDIAN, ComSignalInitValue=4094, ComSignalType=UINT8, ComTransferProperty=PENDING, ComSystemTemplateSystemSignalRef=BMC_CMC_Zellspannung_032
        BMC_CMC_Zellspannung_033_XIX_BMC_CMC_Zellspannung_01_XIX_HCP5_CANFD01_fa85e2b3_Tx: ComBitPosition=396, ComBitSize=12, ComSignalDataInvalidValue=4095, ComSignalEndianness=LITTLE_ENDIAN, ComSignalInitValue=4094, ComSignalType=UINT8, ComTransferProperty=PENDING, ComSystemTemplateSystemSignalRef=BMC_CMC_Zellspannung_033
        BMC_CMC_Zellspannung_034_XIX_BMC_CMC_Zellspannung_01_XIX_HCP5_CANFD01_5e88260b_Tx: ComBitPosition=408, ComBitSize=12, ComSignalDataInvalidValue=4095, ComSignalEndianness=LITTLE_ENDIAN, ComSignalInitValue=4094, ComSignalType=UINT8, ComTransferProperty=PENDING, ComSystemTemplateSystemSignalRef=BMC_CMC_Zellspannung_034
        BMC_CMC_Zellspannung_035_XIX_BMC_CMC_Zellspannung_01_XIX_HCP5_CANFD01_2141bd98_Tx: ComBitPosition=420, ComBitSize=12, ComSignalDataInvalidValue=4095, ComSignalEndianness=LITTLE_ENDIAN, ComSignalInitValue=4094, ComSignalType=UINT8, ComTransferProperty=PENDING, ComSystemTemplateSystemSignalRef=BMC_CMC_Zellspannung_035
        BMC_CMC_Zellspannung_036_XIX_BMC_CMC_Zellspannung_01_XIX_HCP5_CANFD01_a11b112d_Tx: ComBitPosition=432, ComBitSize=12, ComSignalDataInvalidValue=4095, ComSignalEndianness=LITTLE_ENDIAN, ComSignalInitValue=4094, ComSignalType=UINT8, ComTransferProperty=PENDING, ComSystemTemplateSystemSignalRef=BMC_CMC_Zellspannung_036
        BMC_CMC_Zellspannung_037_XIX_BMC_CMC_Zellspannung_01_XIX_HCP5_CANFD01_ded28abe_Tx: ComBitPosition=444, ComBitSize=12, ComSignalDataInvalidValue=4095, ComSignalEndianness=LITTLE_ENDIAN, ComSignalInitValue=4094, ComSignalType=UINT8, ComTransferProperty=PENDING, ComSystemTemplateSystemSignalRef=BMC_CMC_Zellspannung_037
        BMC_CMC_Zellspannung_038_XIX_BMC_CMC_Zellspannung_01_XIX_HCP5_CANFD01_32719e1c_Tx: ComBitPosition=456, ComBitSize=12, ComSignalDataInvalidValue=4095, ComSignalEndianness=LITTLE_ENDIAN, ComSignalInitValue=4094, ComSignalType=UINT8, ComTransferProperty=PENDING, ComSystemTemplateSystemSignalRef=BMC_CMC_Zellspannung_038
        BMC_CMC_Zellspannung_039_XIX_BMC_CMC_Zellspannung_01_XIX_HCP5_CANFD01_4db8058f_Tx: ComBitPosition=468, ComBitSize=12, ComSignalDataInvalidValue=4095, ComSignalEndianness=LITTLE_ENDIAN, ComSignalInitValue=4094, ComSignalType=UINT8, ComTransferProperty=PENDING, ComSystemTemplateSystemSignalRef=BMC_CMC_Zellspannung_039
        BMC_CMC_Zellspannung_03_Messzeit_XIX_BMC_CMC_Zellspannung_03_XIX_HCP5_CANFD01_e433a100_Tx: ComBitPosition=480, ComBitSize=8, ComSignalDataInvalidValue=255, ComSignalEndianness=LITTLE_ENDIAN, ComSignalInitValue=254, ComSignalType=UINT8, ComTransferProperty=PENDING, ComSystemTemplateSystemSignalRef=BMC_CMC_Zellspannung_03_Messzeit
        BMC_CMC_Zellspannung_040_XIX_BMC_CMC_Zellspannung_02_XIX_HCP5_CANFD01_5547a51e_Tx: ComBitPosition=12, ComBitSize=12, ComSignalDataInvalidValue=4095, ComSignalEndianness=LITTLE_ENDIAN, ComSignalInitValue=4094, ComSignalType=UINT8, ComTransferProperty=PENDING, ComSystemTemplateSystemSignalRef=BMC_CMC_Zellspannung_040
        BMC_CMC_Zellspannung_041_XIX_BMC_CMC_Zellspannung_02_XIX_HCP5_CANFD01_2a8e3e8d_Tx: ComBitPosition=24, ComBitSize=12, ComSignalDataInvalidValue=4095, ComSignalEndianness=LITTLE_ENDIAN, ComSignalInitValue=4094, ComSignalType=UINT8, ComTransferProperty=PENDING, ComSystemTemplateSystemSignalRef=BMC_CMC_Zellspannung_041
        BMC_CMC_Zellspannung_042_XIX_BMC_CMC_Zellspannung_02_XIX_HCP5_CANFD01_aad49238_Tx: ComBitPosition=36, ComBitSize=12, ComSignalDataInvalidValue=4095, ComSignalEndianness=LITTLE_ENDIAN, ComSignalInitValue=4094, ComSignalType=UINT8, ComTransferProperty=PENDING, ComSystemTemplateSystemSignalRef=BMC_CMC_Zellspannung_042
        BMC_CMC_Zellspannung_043_XIX_BMC_CMC_Zellspannung_02_XIX_HCP5_CANFD01_d51d09ab_Tx: ComBitPosition=48, ComBitSize=12, ComSignalDataInvalidValue=4095, ComSignalEndianness=LITTLE_ENDIAN, ComSignalInitValue=4094, ComSignalType=UINT8, ComTransferProperty=PENDING, ComSystemTemplateSystemSignalRef=BMC_CMC_Zellspannung_043
        BMC_CMC_Zellspannung_044_XIX_BMC_CMC_Zellspannung_02_XIX_HCP5_CANFD01_7110cd13_Tx: ComBitPosition=60, ComBitSize=12, ComSignalDataInvalidValue=4095, ComSignalEndianness=LITTLE_ENDIAN, ComSignalInitValue=4094, ComSignalType=UINT8, ComTransferProperty=PENDING, ComSystemTemplateSystemSignalRef=BMC_CMC_Zellspannung_044
        BMC_CMC_Zellspannung_045_XIX_BMC_CMC_Zellspannung_02_XIX_HCP5_CANFD01_0ed95680_Tx: ComBitPosition=72, ComBitSize=12, ComSignalDataInvalidValue=4095, ComSignalEndianness=LITTLE_ENDIAN, ComSignalInitValue=4094, ComSignalType=UINT8, ComTransferProperty=PENDING, ComSystemTemplateSystemSignalRef=BMC_CMC_Zellspannung_045
        BMC_CMC_Zellspannung_046_XIX_BMC_CMC_Zellspannung_02_XIX_HCP5_CANFD01_8e83fa35_Tx: ComBitPosition=84, ComBitSize=12, ComSignalDataInvalidValue=4095, ComSignalEndianness=LITTLE_ENDIAN, ComSignalInitValue=4094, ComSignalType=UINT8, ComTransferProperty=PENDING, ComSystemTemplateSystemSignalRef=BMC_CMC_Zellspannung_046
        BMC_CMC_Zellspannung_047_XIX_BMC_CMC_Zellspannung_02_XIX_HCP5_CANFD01_f14a61a6_Tx: ComBitPosition=96, ComBitSize=12, ComSignalDataInvalidValue=4095, ComSignalEndianness=LITTLE_ENDIAN, ComSignalInitValue=4094, ComSignalType=UINT8, ComTransferProperty=PENDING, ComSystemTemplateSystemSignalRef=BMC_CMC_Zellspannung_047
        BMC_CMC_Zellspannung_048_XIX_BMC_CMC_Zellspannung_02_XIX_HCP5_CANFD01_1de97504_Tx: ComBitPosition=108, ComBitSize=12, ComSignalDataInvalidValue=4095, ComSignalEndianness=LITTLE_ENDIAN, ComSignalInitValue=4094, ComSignalType=UINT8, ComTransferProperty=PENDING, ComSystemTemplateSystemSignalRef=BMC_CMC_Zellspannung_048
