[part 7 of 8: package /InitialEcuC]
AUTOSAR XML (schema 4-3-0)
package /InitialEcuC  (continued)
  module config Dcm  (continued)
    DcmConfigSet  (continued)
      DcmDsp: DcmDspMaxDidToRead=8  (continued)
        Data_DiagnServi_TABROW_NeuMeasu_Read_82 (DcmDspData): DcmDspDataSize=8, DcmDspDataType=UINT8_N, DcmDspDataInfoRef=DataInfo_DiagnServi_TABROW_NeuMeasu_Read_82  # Diagnostics Data Import
        DataInfo_DiagnServi_TABROW_NeuMeasu_Read_83 (DcmDspDataInfo): DcmDspDataFixedLength=true  # Diagnostics Data Import
        Data_DiagnServi_TABROW_NeuMeasu_Read_83 (DcmDspData): DcmDspDataSize=32, DcmDspDataType=UINT8_N, DcmDspDataInfoRef=DataInfo_DiagnServi_TABROW_NeuMeasu_Read_83  # Diagnostics Data Import
        DataInfo_DiagnServi_TABROW_NeuMeasu_Read_84 (DcmDspDataInfo): DcmDspDataFixedLength=true  # Diagnostics Data Import
        Data_DiagnServi_TABROW_NeuMeasu_Read_84 (DcmDspData): DcmDspDataSize=32, DcmDspDataType=UINT8_N, DcmDspDataInfoRef=DataInfo_DiagnServi_TABROW_NeuMeasu_Read_84  # Diagnostics Data Import
        DataInfo_DiagnServi_TABROW_NeuMeasu_Read_9_2_1_1_2 (DcmDspDataInfo): DcmDspDataFixedLength=true  # Diagnostics Data Import
        Data_DiagnServi_TABROW_NeuMeasu_Read_9_2_1_1_2 (DcmDspData): DcmDspDataSize=16, DcmDspDataType=UINT8_N, DcmDspDataInfoRef=DataInfo_DiagnServi_TABROW_NeuMeasu_Read_9_2_1_1_2  # Diagnostics Data Import
        DataInfo_DiagnServi_TABROW_NeuMeasu_Read_9 (DcmDspDataInfo): DcmDspDataFixedLength=true  # Diagnostics Data Import
        Data_DiagnServi_TABROW_NeuMeasu_Read_9 (DcmDspData): DcmDspDataSize=8, DcmDspDataType=UINT8_N, DcmDspDataInfoRef=DataInfo_DiagnServi_TABROW_NeuMeasu_Read_9  # Diagnostics Data Import
        DataInfo_DiagnServi_TABROW_NeuMeasu_Read_9_2 (DcmDspDataInfo): DcmDspDataFixedLength=true  # Diagnostics Data Import
        Data_DiagnServi_TABROW_NeuMeasu_Read_9_2 (DcmDspData): DcmDspDataSize=8, DcmDspDataType=UINT8_N, DcmDspDataInfoRef=DataInfo_DiagnServi_TABROW_NeuMeasu_Read_9_2  # Diagnostics Data Import
        DataInfo_DiagnServi_TABROW_NeuMeasu_Read_21_2 (DcmDspDataInfo): DcmDspDataFixedLength=true  # Diagnostics Data Import
        Data_DiagnServi_TABROW_NeuMeasu_Read_21_2 (DcmDspData): DcmDspDataSize=880, DcmDspDataType=UINT8_N, DcmDspDataInfoRef=DataInfo_DiagnServi_TABROW_NeuMeasu_Read_21_2  # Diagnostics Data Import
        DataInfo_DiagnServi_TABROW_NeuMeasu_Read_70 (DcmDspDataInfo): DcmDspDataFixedLength=true  # Diagnostics Data Import
        Data_DiagnServi_TABROW_NeuMeasu_Read_70 (DcmDspData): DcmDspDataSize=3088, DcmDspDataType=UINT8_N, DcmDspDataInfoRef=DataInfo_DiagnServi_TABROW_NeuMeasu_Read_70  # Diagnostics Data Import
        DataInfo_DiagnServi_TABROW_NeuMeasu1_Read (DcmDspDataInfo): DcmDspDataFixedLength=true  # Diagnostics Data Import
        Data_DiagnServi_TABROW_NeuMeasu1_Read (DcmDspData): DcmDspDataSize=16, DcmDspDataType=UINT8_N, DcmDspDataInfoRef=DataInfo_DiagnServi_TABROW_NeuMeasu1_Read  # Diagnostics Data Import
        DataInfo_DiagnServi_TABROW_NeuMeasu2_Read (DcmDspDataInfo): DcmDspDataFixedLength=true  # Diagnostics Data Import
        Data_DiagnServi_TABROW_NeuMeasu2_Read (DcmDspData): DcmDspDataSize=8, DcmDspDataType=UINT8_N, DcmDspDataInfoRef=DataInfo_DiagnServi_TABROW_NeuMeasu2_Read  # Diagnostics Data Import
        DataInfo_DiagnServi_TABROW_NeuMeasu_Read_23 (DcmDspDataInfo): DcmDspDataFixedLength=true  # Diagnostics Data Import
        Data_DiagnServi_TABROW_NeuMeasu_Read_23 (DcmDspData): DcmDspDataSize=48, DcmDspDataType=UINT8_N, DcmDspDataInfoRef=DataInfo_DiagnServi_TABROW_NeuMeasu_Read_23  # Diagnostics Data Import
        DataInfo_DiagnServi_TABROW_NeuMeasu_Read_24 (DcmDspDataInfo): DcmDspDataFixedLength=true  # Diagnostics Data Import
        Data_DiagnServi_TABROW_NeuMeasu_Read_24 (DcmDspData): DcmDspDataSize=8, DcmDspDataType=UINT8_N, DcmDspDataInfoRef=DataInfo_DiagnServi_TABROW_NeuMeasu_Read_24  # Diagnostics Data Import
        DataInfo_DiagnServi_TABROW_NeuMeasu_Read_26 (DcmDspDataInfo): DcmDspDataFixedLength=true  # Diagnostics Data Import
        Data_DiagnServi_TABROW_NeuMeasu_Read_26 (DcmDspData): DcmDspDataSize=8, DcmDspDataType=UINT8_N, DcmDspDataInfoRef=DataInfo_DiagnServi_TABROW_NeuMeasu_Read_26  # Diagnostics Data Import
        DataInfo_DiagnServi_TABROW_NeuMeasu_Read_25 (DcmDspDataInfo): DcmDspDataFixedLength=true  # Diagnostics Data Import
        Data_DiagnServi_TABROW_NeuMeasu_Read_25 (DcmDspData): DcmDspDataSize=16, DcmDspDataType=UINT8_N, DcmDspDataInfoRef=DataInfo_DiagnServi_TABROW_NeuMeasu_Read_25  # Diagnostics Data Import
        DataInfo_DiagnServi_TABROW_NeuMeasu_Read_7_1 (DcmDspDataInfo): DcmDspDataFixedLength=true  # Diagnostics Data Import
        Data_DiagnServi_TABROW_NeuMeasu_Read_7_1 (DcmDspData): DcmDspDataSize=8, DcmDspDataType=UINT8_N, DcmDspDataInfoRef=DataInfo_DiagnServi_TABROW_NeuMeasu_Read_7_1  # Diagnostics Data Import
        DataInfo_DiagnServi_TABROW_NeuMeasu_Read_22_1 (DcmDspDataInfo): DcmDspDataFixedLength=true  # Diagnostics Data Import
        Data_DiagnServi_TABROW_NeuMeasu_Read_22_1 (DcmDspData): DcmDspDataSize=16, DcmDspDataType=UINT8_N, DcmDspDataInfoRef=DataInfo_DiagnServi_TABROW_NeuMeasu_Read_22_1  # Diagnostics Data Import
        DataInfo_DiagnServi_TABROW_NeuMeasu_Read_8_1 (DcmDspDataInfo): DcmDspDataFixedLength=true  # Diagnostics Data Import
        Data_DiagnServi_TABROW_NeuMeasu_Read_8_1 (DcmDspData): DcmDspDataSize=16, DcmDspDataType=UINT8_N, DcmDspDataInfoRef=DataInfo_DiagnServi_TABROW_NeuMeasu_Read_8_1  # Diagnostics Data Import
        DataInfo_DiagnServi_TABROW_NeuMeasu_Read_21_1 (DcmDspDataInfo): DcmDspDataFixedLength=true  # Diagnostics Data Import
        Data_DiagnServi_TABROW_NeuMeasu_Read_21_1 (DcmDspData): DcmDspDataSize=8, DcmDspDataType=UINT8_N, DcmDspDataInfoRef=DataInfo_DiagnServi_TABROW_NeuMeasu_Read_21_1  # Diagnostics Data Import
        DataInfo_Battery_isolation_measurement_actual_and_requested_state_Read_Data_By_Identifier (DcmDspDataInfo): DcmDspDataFixedLength=true  # Diagnostics Data Import
        Data_Battery_isolation_measurement_actual_and_requested_state_Read_Data_By_Identifier (DcmDspData):  # Diagnostics Data Import
          DcmDspDataSize = 16
          DcmDspDataType = UINT8_N
          DcmDspDataInfoRef = DataInfo_Battery_isolation_measurement_actual_and_requested_state_Read_Data_By_Identifier
        DataInfo_DiagnServi_TABROW_NeuMeasu_Read_28 (DcmDspDataInfo): DcmDspDataFixedLength=true  # Diagnostics Data Import
        Data_DiagnServi_TABROW_NeuMeasu_Read_28 (DcmDspData): DcmDspDataSize=64, DcmDspDataType=UINT8_N, DcmDspDataInfoRef=DataInfo_DiagnServi_TABROW_NeuMeasu_Read_28  # Diagnostics Data Import
        DataInfo_DiagnServi_TABROW_NeuMeasu_Read_27 (DcmDspDataInfo): DcmDspDataFixedLength=true  # Diagnostics Data Import
        Data_DiagnServi_TABROW_NeuMeasu_Read_27 (DcmDspData): DcmDspDataSize=216, DcmDspDataType=UINT8_N, DcmDspDataInfoRef=DataInfo_DiagnServi_TABROW_NeuMeasu_Read_27  # Diagnostics Data Import
        DataInfo_DiagnServi_TABROW_NeuMeasu_Read_27_1 (DcmDspDataInfo): DcmDspDataFixedLength=true  # Diagnostics Data Import
        Data_DiagnServi_TABROW_NeuMeasu_Read_27_1 (DcmDspData): DcmDspDataSize=216, DcmDspDataType=UINT8_N, DcmDspDataInfoRef=DataInfo_DiagnServi_TABROW_NeuMeasu_Read_27_1  # Diagnostics Data Import
        DataInfo_DiagnServi_TABROW_NeuMeasu_Read_27_2 (DcmDspDataInfo): DcmDspDataFixedLength=true  # Diagnostics Data Import
        Data_DiagnServi_TABROW_NeuMeasu_Read_27_2 (DcmDspData): DcmDspDataSize=216, DcmDspDataType=UINT8_N, DcmDspDataInfoRef=DataInfo_DiagnServi_TABROW_NeuMeasu_Read_27_2  # Diagnostics Data Import
        DataInfo_DiagnServi_TABROW_NeuMeasu_Read_27_3 (DcmDspDataInfo): DcmDspDataFixedLength=true  # Diagnostics Data Import
        Data_DiagnServi_TABROW_NeuMeasu_Read_27_3 (DcmDspData): DcmDspDataSize=216, DcmDspDataType=UINT8_N, DcmDspDataInfoRef=DataInfo_DiagnServi_TABROW_NeuMeasu_Read_27_3  # Diagnostics Data Import
        DataInfo_DiagnServi_TABROW_NeuMeasu_Read_27_1_1 (DcmDspDataInfo): DcmDspDataFixedLength=true  # Diagnostics Data Import
        Data_DiagnServi_TABROW_NeuMeasu_Read_27_1_1 (DcmDspData): DcmDspDataSize=216, DcmDspDataType=UINT8_N, DcmDspDataInfoRef=DataInfo_DiagnServi_TABROW_NeuMeasu_Read_27_1_1  # Diagnostics Data Import
        DataInfo_DiagnServi_TABROW_NeuMeasu_Read_27_2_1 (DcmDspDataInfo): DcmDspDataFixedLength=true  # Diagnostics Data Import
        Data_DiagnServi_TABROW_NeuMeasu_Read_27_2_1 (DcmDspData): DcmDspDataSize=216, DcmDspDataType=UINT8_N, DcmDspDataInfoRef=DataInfo_DiagnServi_TABROW_NeuMeasu_Read_27_2_1  # Diagnostics Data Import
        DataInfo_DiagnServi_TABROW_NeuMeasu_Read_27_3_1 (DcmDspDataInfo): DcmDspDataFixedLength=true  # Diagnostics Data Import
        Data_DiagnServi_TABROW_NeuMeasu_Read_27_3_1 (DcmDspData): DcmDspDataSize=216, DcmDspDataType=UINT8_N, DcmDspDataInfoRef=DataInfo_DiagnServi_TABROW_NeuMeasu_Read_27_3_1  # Diagnostics Data Import
        DataInfo_DiagnServi_TABROW_NeuMeasu_Read_27_4 (DcmDspDataInfo): DcmDspDataFixedLength=true  # Diagnostics Data Import
        Data_DiagnServi_TABROW_NeuMeasu_Read_27_4 (DcmDspData): DcmDspDataSize=216, DcmDspDataType=UINT8_N, DcmDspDataInfoRef=DataInfo_DiagnServi_TABROW_NeuMeasu_Read_27_4  # Diagnostics Data Import
        DataInfo_DiagnServi_TABROW_NeuMeasu_Read_27_1_1_1 (DcmDspDataInfo): DcmDspDataFixedLength=true  # Diagnostics Data Import
        Data_DiagnServi_TABROW_NeuMeasu_Read_27_1_1_1 (DcmDspData): DcmDspDataSize=216, DcmDspDataType=UINT8_N, DcmDspDataInfoRef=DataInfo_DiagnServi_TABROW_NeuMeasu_Read_27_1_1_1  # Diagnostics Data Import
        DataInfo_DiagnServi_TABROW_NeuMeasu_Read_27_2_1_1 (DcmDspDataInfo): DcmDspDataFixedLength=true  # Diagnostics Data Import
        Data_DiagnServi_TABROW_NeuMeasu_Read_27_2_1_1 (DcmDspData): DcmDspDataSize=216, DcmDspDataType=UINT8_N, DcmDspDataInfoRef=DataInfo_DiagnServi_TABROW_NeuMeasu_Read_27_2_1_1  # Diagnostics Data Import
        DataInfo_DiagnServi_TABROW_NeuMeasu_Read_27_3_1_1 (DcmDspDataInfo): DcmDspDataFixedLength=true  # Diagnostics Data Import
        Data_DiagnServi_TABROW_NeuMeasu_Read_27_3_1_1 (DcmDspData): DcmDspDataSize=216, DcmDspDataType=UINT8_N, DcmDspDataInfoRef=DataInfo_DiagnServi_TABROW_NeuMeasu_Read_27_3_1_1  # Diagnostics Data Import
        DataInfo_DiagnServi_TABROW_NeuMeasu_Read_30 (DcmDspDataInfo): DcmDspDataFixedLength=true  # Diagnostics Data Import
        Data_DiagnServi_TABROW_NeuMeasu_Read_30 (DcmDspData): DcmDspDataSize=16, DcmDspDataType=UINT8_N, DcmDspDataInfoRef=DataInfo_DiagnServi_TABROW_NeuMeasu_Read_30  # Diagnostics Data Import
        DataInfo_DiagnServi_TABROW_NeuMeasu_Read_29_1 (DcmDspDataInfo): DcmDspDataFixedLength=true  # Diagnostics Data Import
        Data_DiagnServi_TABROW_NeuMeasu_Read_29_1 (DcmDspData): DcmDspDataSize=96, DcmDspDataType=UINT8_N, DcmDspDataInfoRef=DataInfo_DiagnServi_TABROW_NeuMeasu_Read_29_1  # Diagnostics Data Import
        DataInfo_DiagnServi_TABROW_NeuMeasu_Read_31 (DcmDspDataInfo): DcmDspDataFixedLength=true  # Diagnostics Data Import
        Data_DiagnServi_TABROW_NeuMeasu_Read_31 (DcmDspData): DcmDspDataSize=8, DcmDspDataType=UINT8_N, DcmDspDataInfoRef=DataInfo_DiagnServi_TABROW_NeuMeasu_Read_31  # Diagnostics Data Import
        DataInfo_DiagnServi_TABROW_NeuMeasu_Read_32 (DcmDspDataInfo): DcmDspDataFixedLength=true  # Diagnostics Data Import
        Data_DiagnServi_TABROW_NeuMeasu_Read_32 (DcmDspData): DcmDspDataSize=8, DcmDspDataType=UINT8_N, DcmDspDataInfoRef=DataInfo_DiagnServi_TABROW_NeuMeasu_Read_32  # Diagnostics Data Import
        DataInfo_DiagnServi_TABROW_NeuMeasu_Read_9_1 (DcmDspDataInfo): DcmDspDataFixedLength=true  # Diagnostics Data Import
        Data_DiagnServi_TABROW_NeuMeasu_Read_9_1 (DcmDspData): DcmDspDataSize=8, DcmDspDataType=UINT8_N, DcmDspDataInfoRef=DataInfo_DiagnServi_TABROW_NeuMeasu_Read_9_1  # Diagnostics Data Import
        DataInfo_DiagnServi_TABROW_NeuMeasu_Read_29 (DcmDspDataInfo): DcmDspDataFixedLength=true  # Diagnostics Data Import
        Data_DiagnServi_TABROW_NeuMeasu_Read_29 (DcmDspData): DcmDspDataSize=96, DcmDspDataType=UINT8_N, DcmDspDataInfoRef=DataInfo_DiagnServi_TABROW_NeuMeasu_Read_29  # Diagnostics Data Import
        DataInfo_DiagnServi_TABROW_NeuMeasu_Read_27_4_1 (DcmDspDataInfo): DcmDspDataFixedLength=true  # Diagnostics Data Import
        Data_DiagnServi_TABROW_NeuMeasu_Read_27_4_1 (DcmDspData): DcmDspDataSize=216, DcmDspDataType=UINT8_N, DcmDspDataInfoRef=DataInfo_DiagnServi_TABROW_NeuMeasu_Read_27_4_1  # Diagnostics Data Import
        DataInfo_DiagnServi_TABROW_NeuMeasu_Read_33 (DcmDspDataInfo): DcmDspDataFixedLength=true  # Diagnostics Data Import
        Data_DiagnServi_TABROW_NeuMeasu_Read_33 (DcmDspData): DcmDspDataSize=24, DcmDspDataType=UINT8_N, DcmDspDataInfoRef=DataInfo_DiagnServi_TABROW_NeuMeasu_Read_33  # Diagnostics Data Import
        DataInfo_DiagnServi_TABROW_NeuMeasu_Read_15 (DcmDspDataInfo): DcmDspDataFixedLength=true  # Diagnostics Data Import
        Data_DiagnServi_TABROW_NeuMeasu_Read_15 (DcmDspData): DcmDspDataSize=8, DcmDspDataType=UINT8_N, DcmDspDataInfoRef=DataInfo_DiagnServi_TABROW_NeuMeasu_Read_15  # Diagnostics Data Import
        DataInfo_DiagnServi_TABROW_NeuMeasu_Read_57_1 (DcmDspDataInfo): DcmDspDataFixedLength=true  # Diagnostics Data Import
        Data_DiagnServi_TABROW_NeuMeasu_Read_57_1 (DcmDspData): DcmDspDataSize=16, DcmDspDataType=UINT8_N, DcmDspDataInfoRef=DataInfo_DiagnServi_TABROW_NeuMeasu_Read_57_1  # Diagnostics Data Import
        DataInfo_DiagnServi_TABROW_NeuMeasu_Read_57_11 (DcmDspDataInfo): DcmDspDataFixedLength=false  # Diagnostics Data Import
        Data_DiagnServi_TABROW_NeuMeasu_Read_57_11 (DcmDspData): DcmDspDataSize=1920, DcmDspDataType=UINT8_N, DcmDspDataInfoRef=DataInfo_DiagnServi_TABROW_NeuMeasu_Read_57_11  # Diagnostics Data Import
        DataInfo_DiagnServi_TABROW_VWCodinValue_Read (DcmDspDataInfo): DcmDspDataFixedLength=true  # Diagnostics Data Import
        Data_DiagnServi_TABROW_VWCodinValue_Read (DcmDspData): DcmDspDataSize=8, DcmDspDataType=UINT8_N, DcmDspDataInfoRef=DataInfo_DiagnServi_TABROW_VWCodinValue_Read  # Diagnostics Data Import
        DataInfo_DiagnServi_TABROW_NeuMeasu_Read_56 (DcmDspDataInfo): DcmDspDataFixedLength=true  # Diagnostics Data Import
        Data_DiagnServi_TABROW_NeuMeasu_Read_56 (DcmDspData): DcmDspDataSize=8, DcmDspDataType=UINT8_N, DcmDspDataInfoRef=DataInfo_DiagnServi_TABROW_NeuMeasu_Read_56  # Diagnostics Data Import
        DataInfo_DiagnServi_TABROW_NeuMeasu_Read_55 (DcmDspDataInfo): DcmDspDataFixedLength=true  # Diagnostics Data Import
        Data_DiagnServi_TABROW_NeuMeasu_Read_55 (DcmDspData): DcmDspDataSize=880, DcmDspDataType=UINT8_N, DcmDspDataInfoRef=DataInfo_DiagnServi_TABROW_NeuMeasu_Read_55  # Diagnostics Data Import
        DataInfo_DiagnServi_TABROW_NeuMeasu_Read_52 (DcmDspDataInfo): DcmDspDataFixedLength=true  # Diagnostics Data Import
        Data_DiagnServi_TABROW_NeuMeasu_Read_52 (DcmDspData): DcmDspDataSize=384, DcmDspDataType=UINT8_N, DcmDspDataInfoRef=DataInfo_DiagnServi_TABROW_NeuMeasu_Read_52  # Diagnostics Data Import
        DataInfo_DiagnServi_TABROW_NeuMeasu_Read_53 (DcmDspDataInfo): DcmDspDataFixedLength=true  # Diagnostics Data Import
        Data_DiagnServi_TABROW_NeuMeasu_Read_53 (DcmDspData): DcmDspDataSize=96, DcmDspDataType=UINT8_N, DcmDspDataInfoRef=DataInfo_DiagnServi_TABROW_NeuMeasu_Read_53  # Diagnostics Data Import
        DataInfo_DiagnServi_TABROW_NeuMeasu_Read_45 (DcmDspDataInfo): DcmDspDataFixedLength=true  # Diagnostics Data Import
        Data_DiagnServi_TABROW_NeuMeasu_Read_45 (DcmDspData): DcmDspDataSize=48, DcmDspDataType=UINT8_N, DcmDspDataInfoRef=DataInfo_DiagnServi_TABROW_NeuMeasu_Read_45  # Diagnostics Data Import
        DataInfo_DiagnServi_TABROW_NeuMeasu_Read_46_1_1_1_1_1_1_2_3 (DcmDspDataInfo): DcmDspDataFixedLength=true  # Diagnostics Data Import
        Data_DiagnServi_TABROW_NeuMeasu_Read_46_1_1_1_1_1_1_2_3 (DcmDspData): DcmDspDataSize=1216, DcmDspDataType=UINT8_N, DcmDspDataInfoRef=DataInfo_DiagnServi_TABROW_NeuMeasu_Read_46_1_1_1_1_1_1_2_3  # Diagnostics Data Import
        DataInfo_DiagnServi_TABROW_NeuMeasu_Read_46_1_1_1_1_1_1_2_2 (DcmDspDataInfo): DcmDspDataFixedLength=true  # Diagnostics Data Import
        Data_DiagnServi_TABROW_NeuMeasu_Read_46_1_1_1_1_1_1_2_2 (DcmDspData): DcmDspDataSize=1216, DcmDspDataType=UINT8_N, DcmDspDataInfoRef=DataInfo_DiagnServi_TABROW_NeuMeasu_Read_46_1_1_1_1_1_1_2_2  # Diagnostics Data Import
        DataInfo_DiagnServi_TABROW_NeuMeasu_Read_46_1_1_1_1_1_1_2_1 (DcmDspDataInfo): DcmDspDataFixedLength=true  # Diagnostics Data Import
        Data_DiagnServi_TABROW_NeuMeasu_Read_46_1_1_1_1_1_1_2_1 (DcmDspData): DcmDspDataSize=1216, DcmDspDataType=UINT8_N, DcmDspDataInfoRef=DataInfo_DiagnServi_TABROW_NeuMeasu_Read_46_1_1_1_1_1_1_2_1  # Diagnostics Data Import
        DataInfo_DiagnServi_TABROW_NeuMeasu_Read_46_1_1_1_1_1_1_2 (DcmDspDataInfo): DcmDspDataFixedLength=true  # Diagnostics Data Import
        Data_DiagnServi_TABROW_NeuMeasu_Read_46_1_1_1_1_1_1_2 (DcmDspData): DcmDspDataSize=1216, DcmDspDataType=UINT8_N, DcmDspDataInfoRef=DataInfo_DiagnServi_TABROW_NeuMeasu_Read_46_1_1_1_1_1_1_2  # Diagnostics Data Import
        DataInfo_DiagnServi_TABROW_NeuMeasu_Read_46_1_1_1_1_1_1_1 (DcmDspDataInfo): DcmDspDataFixedLength=true  # Diagnostics Data Import
        Data_DiagnServi_TABROW_NeuMeasu_Read_46_1_1_1_1_1_1_1 (DcmDspData): DcmDspDataSize=1216, DcmDspDataType=UINT8_N, DcmDspDataInfoRef=DataInfo_DiagnServi_TABROW_NeuMeasu_Read_46_1_1_1_1_1_1_1  # Diagnostics Data Import
        DataInfo_DiagnServi_TABROW_NeuMeasu_Read_46_1_1_1_1_1_1 (DcmDspDataInfo): DcmDspDataFixedLength=true  # Diagnostics Data Import
        Data_DiagnServi_TABROW_NeuMeasu_Read_46_1_1_1_1_1_1 (DcmDspData): DcmDspDataSize=1216, DcmDspDataType=UINT8_N, DcmDspDataInfoRef=DataInfo_DiagnServi_TABROW_NeuMeasu_Read_46_1_1_1_1_1_1  # Diagnostics Data Import
        DataInfo_DiagnServi_TABROW_NeuMeasu_Read_46_1_1_1_1_1 (DcmDspDataInfo): DcmDspDataFixedLength=true  # Diagnostics Data Import
        Data_DiagnServi_TABROW_NeuMeasu_Read_46_1_1_1_1_1 (DcmDspData): DcmDspDataSize=1216, DcmDspDataType=UINT8_N, DcmDspDataInfoRef=DataInfo_DiagnServi_TABROW_NeuMeasu_Read_46_1_1_1_1_1  # Diagnostics Data Import
        DataInfo_DiagnServi_TABROW_NeuMeasu_Read_46_1_1_1_1 (DcmDspDataInfo): DcmDspDataFixedLength=true  # Diagnostics Data Import
        Data_DiagnServi_TABROW_NeuMeasu_Read_46_1_1_1_1 (DcmDspData): DcmDspDataSize=1216, DcmDspDataType=UINT8_N, DcmDspDataInfoRef=DataInfo_DiagnServi_TABROW_NeuMeasu_Read_46_1_1_1_1  # Diagnostics Data Import
        DataInfo_DiagnServi_TABROW_NeuMeasu_Read_46_1_1_1 (DcmDspDataInfo): DcmDspDataFixedLength=true  # Diagnostics Data Import
        Data_DiagnServi_TABROW_NeuMeasu_Read_46_1_1_1 (DcmDspData): DcmDspDataSize=1216, DcmDspDataType=UINT8_N, DcmDspDataInfoRef=DataInfo_DiagnServi_TABROW_NeuMeasu_Read_46_1_1_1  # Diagnostics Data Import
        DataInfo_DiagnServi_TABROW_NeuMeasu_Read_46_1_1 (DcmDspDataInfo): DcmDspDataFixedLength=true  # Diagnostics Data Import
        Data_DiagnServi_TABROW_NeuMeasu_Read_46_1_1 (DcmDspData): DcmDspDataSize=1216, DcmDspDataType=UINT8_N, DcmDspDataInfoRef=DataInfo_DiagnServi_TABROW_NeuMeasu_Read_46_1_1  # Diagnostics Data Import
        DataInfo_DiagnServi_TABROW_NeuMeasu_Read_46_1 (DcmDspDataInfo): DcmDspDataFixedLength=true  # Diagnostics Data Import
        Data_DiagnServi_TABROW_NeuMeasu_Read_46_1 (DcmDspData): DcmDspDataSize=1216, DcmDspDataType=UINT8_N, DcmDspDataInfoRef=DataInfo_DiagnServi_TABROW_NeuMeasu_Read_46_1  # Diagnostics Data Import
        DataInfo_DiagnServi_TABROW_NeuMeasu_Read_46 (DcmDspDataInfo): DcmDspDataFixedLength=true  # Diagnostics Data Import
        Data_DiagnServi_TABROW_NeuMeasu_Read_46 (DcmDspData): DcmDspDataSize=1216, DcmDspDataType=UINT8_N, DcmDspDataInfoRef=DataInfo_DiagnServi_TABROW_NeuMeasu_Read_46  # Diagnostics Data Import
        DataInfo_High_voltage_battery_total_voltage_Read_Data_By_Identifier (DcmDspDataInfo): DcmDspDataFixedLength=true  # Diagnostics Data Import
        Data_High_voltage_battery_total_voltage_Read_Data_By_Identifier (DcmDspData): DcmDspDataSize=32, DcmDspDataType=UINT8_N, DcmDspDataInfoRef=DataInfo_High_voltage_battery_total_voltage_Read_Data_By_Identifier  # Diagnostics Data Import
        DataInfo_DiagnServi_TABROW_NeuMeasu_Read_17 (DcmDspDataInfo): DcmDspDataFixedLength=true  # Diagnostics Data Import
        Data_DiagnServi_TABROW_NeuMeasu_Read_17 (DcmDspData): DcmDspDataSize=8, DcmDspDataType=UINT8_N, DcmDspDataInfoRef=DataInfo_DiagnServi_TABROW_NeuMeasu_Read_17  # Diagnostics Data Import
        DataInfo_DiagnServi_TABROW_NeuMeasu_Read_18 (DcmDspDataInfo): DcmDspDataFixedLength=true  # Diagnostics Data Import
        Data_DiagnServi_TABROW_NeuMeasu_Read_18 (DcmDspData): DcmDspDataSize=8, DcmDspDataType=UINT8_N, DcmDspDataInfoRef=DataInfo_DiagnServi_TABROW_NeuMeasu_Read_18  # Diagnostics Data Import
        DataInfo_DiagnServi_TABROW_NeuMeasu_Read_6 (DcmDspDataInfo): DcmDspDataFixedLength=true  # Diagnostics Data Import
        Data_DiagnServi_TABROW_NeuMeasu_Read_6 (DcmDspData): DcmDspDataSize=16, DcmDspDataType=UINT8_N, DcmDspDataInfoRef=DataInfo_DiagnServi_TABROW_NeuMeasu_Read_6  # Diagnostics Data Import
        DataInfo_DiagnServi_TABROW_DID0xEFD_Read_3 (DcmDspDataInfo): DcmDspDataFixedLength=true  # Diagnostics Data Import
        Data_DiagnServi_TABROW_DID0xEFD_Read_3 (DcmDspData): DcmDspDataSize=16, DcmDspDataType=UINT8_N, DcmDspDataInfoRef=DataInfo_DiagnServi_TABROW_DID0xEFD_Read_3  # Diagnostics Data Import
        DataInfo_DiagnServi_TABROW_NeuMeasu_Read_10 (DcmDspDataInfo): DcmDspDataFixedLength=true  # Diagnostics Data Import
        Data_DiagnServi_TABROW_NeuMeasu_Read_10 (DcmDspData): DcmDspDataSize=16, DcmDspDataType=UINT8_N, DcmDspDataInfoRef=DataInfo_DiagnServi_TABROW_NeuMeasu_Read_10  # Diagnostics Data Import
        DataInfo_DiagnServi_TABROW_NeuMeasu_Read_4 (DcmDspDataInfo): DcmDspDataFixedLength=true  # Diagnostics Data Import
        Data_DiagnServi_TABROW_NeuMeasu_Read_4 (DcmDspData): DcmDspDataSize=8, DcmDspDataType=UINT8_N, DcmDspDataInfoRef=DataInfo_DiagnServi_TABROW_NeuMeasu_Read_4  # Diagnostics Data Import
        DataInfo_DiagnServi_TABROW_NeuMeasu_Read_11 (DcmDspDataInfo): DcmDspDataFixedLength=true  # Diagnostics Data Import
        Data_DiagnServi_TABROW_NeuMeasu_Read_11 (DcmDspData): DcmDspDataSize=24, DcmDspDataType=UINT8_N, DcmDspDataInfoRef=DataInfo_DiagnServi_TABROW_NeuMeasu_Read_11  # Diagnostics Data Import
        DataInfo_DiagnServi_TABROW_DID0xEFD_Read (DcmDspDataInfo): DcmDspDataFixedLength=true  # Diagnostics Data Import
        Data_DiagnServi_TABROW_DID0xEFD_Read (DcmDspData): DcmDspDataSize=32, DcmDspDataType=UINT8_N, DcmDspDataInfoRef=DataInfo_DiagnServi_TABROW_DID0xEFD_Read  # Diagnostics Data Import
        DataInfo_DiagnServi_TABROW_NeuMeasu_Read_12 (DcmDspDataInfo): DcmDspDataFixedLength=true  # Diagnostics Data Import
        Data_DiagnServi_TABROW_NeuMeasu_Read_12 (DcmDspData): DcmDspDataSize=24, DcmDspDataType=UINT8_N, DcmDspDataInfoRef=DataInfo_DiagnServi_TABROW_NeuMeasu_Read_12  # Diagnostics Data Import
        DataInfo_DiagnServi_TABROW_DID0xEFD_Read_1 (DcmDspDataInfo): DcmDspDataFixedLength=true  # Diagnostics Data Import
        Data_DiagnServi_TABROW_DID0xEFD_Read_1 (DcmDspData): DcmDspDataSize=32, DcmDspDataType=UINT8_N, DcmDspDataInfoRef=DataInfo_DiagnServi_TABROW_DID0xEFD_Read_1  # Diagnostics Data Import
        DataInfo_DiagnServi_TABROW_DID0xEFD_Read_1_1 (DcmDspDataInfo): DcmDspDataFixedLength=true  # Diagnostics Data Import
        Data_DiagnServi_TABROW_DID0xEFD_Read_1_1 (DcmDspData): DcmDspDataSize=32, DcmDspDataType=UINT8_N, DcmDspDataInfoRef=DataInfo_DiagnServi_TABROW_DID0xEFD_Read_1_1  # Diagnostics Data Import
        DataInfo_DiagnServi_TABROW_DID0xEFD_Read_2 (DcmDspDataInfo): DcmDspDataFixedLength=true  # Diagnostics Data Import
        Data_DiagnServi_TABROW_DID0xEFD_Read_2 (DcmDspData): DcmDspDataSize=32, DcmDspDataType=UINT8_N, DcmDspDataInfoRef=DataInfo_DiagnServi_TABROW_DID0xEFD_Read_2  # Diagnostics Data Import
        DataInfo_DiagnServi_TABROW_DID0xEFD_Read_1_2 (DcmDspDataInfo): DcmDspDataFixedLength=true  # Diagnostics Data Import
        Data_DiagnServi_TABROW_DID0xEFD_Read_1_2 (DcmDspData): DcmDspDataSize=32, DcmDspDataType=UINT8_N, DcmDspDataInfoRef=DataInfo_DiagnServi_TABROW_DID0xEFD_Read_1_2  # Diagnostics Data Import
        DataInfo_DiagnServi_TABROW_DID0xEFD_Read_1_1_1 (DcmDspDataInfo): DcmDspDataFixedLength=true  # Diagnostics Data Import
        Data_DiagnServi_TABROW_DID0xEFD_Read_1_1_1 (DcmDspData): DcmDspDataSize=32, DcmDspDataType=UINT8_N, DcmDspDataInfoRef=DataInfo_DiagnServi_TABROW_DID0xEFD_Read_1_1_1  # Diagnostics Data Import
        DataInfo_DiagnServi_TABROW_NeuMeasu_Read_37 (DcmDspDataInfo): DcmDspDataFixedLength=true  # Diagnostics Data Import
        Data_DiagnServi_TABROW_NeuMeasu_Read_37 (DcmDspData): DcmDspDataSize=16, DcmDspDataType=UINT8_N, DcmDspDataInfoRef=DataInfo_DiagnServi_TABROW_NeuMeasu_Read_37  # Diagnostics Data Import
        DataInfo_DiagnServi_TABROW_NeuMeasu_Read_42 (DcmDspDataInfo): DcmDspDataFixedLength=true  # Diagnostics Data Import
        Data_DiagnServi_TABROW_NeuMeasu_Read_42 (DcmDspData): DcmDspDataSize=8, DcmDspDataType=UINT8_N, DcmDspDataInfoRef=DataInfo_DiagnServi_TABROW_NeuMeasu_Read_42  # Diagnostics Data Import
        DataInfo_DiagnServi_TABROW_NeuMeasu_Read_16 (DcmDspDataInfo): DcmDspDataFixedLength=true  # Diagnostics Data Import
        Data_DiagnServi_TABROW_NeuMeasu_Read_16 (DcmDspData): DcmDspDataSize=8, DcmDspDataType=UINT8_N, DcmDspDataInfoRef=DataInfo_DiagnServi_TABROW_NeuMeasu_Read_16  # Diagnostics Data Import
        DataInfo_DiagnServi_TABROW_NeuMeasu_Read_35 (DcmDspDataInfo): DcmDspDataFixedLength=true  # Diagnostics Data Import
        Data_DiagnServi_TABROW_NeuMeasu_Read_35 (DcmDspData): DcmDspDataSize=40, DcmDspDataType=UINT8_N, DcmDspDataInfoRef=DataInfo_DiagnServi_TABROW_NeuMeasu_Read_35  # Diagnostics Data Import
        DataInfo_DiagnServi_TABROW_NeuMeasu_Read_19 (DcmDspDataInfo): DcmDspDataFixedLength=true  # Diagnostics Data Import
        Data_DiagnServi_TABROW_NeuMeasu_Read_19 (DcmDspData): DcmDspDataSize=24, DcmDspDataType=UINT8_N, DcmDspDataInfoRef=DataInfo_DiagnServi_TABROW_NeuMeasu_Read_19  # Diagnostics Data Import
        DataInfo_DiagnServi_TABROW_NeuMeasu_Read_38 (DcmDspDataInfo): DcmDspDataFixedLength=true  # Diagnostics Data Import
        Data_DiagnServi_TABROW_NeuMeasu_Read_38 (DcmDspData): DcmDspDataSize=8, DcmDspDataType=UINT8_N, DcmDspDataInfoRef=DataInfo_DiagnServi_TABROW_NeuMeasu_Read_38  # Diagnostics Data Import
        DataInfo_DiagnServi_TABROW_NeuMeasu_Read_13 (DcmDspDataInfo): DcmDspDataFixedLength=true  # Diagnostics Data Import
        Data_DiagnServi_TABROW_NeuMeasu_Read_13 (DcmDspData): DcmDspDataSize=48, DcmDspDataType=UINT8_N, DcmDspDataInfoRef=DataInfo_DiagnServi_TABROW_NeuMeasu_Read_13  # Diagnostics Data Import
        DataInfo_DiagnServi_TABROW_NeuMeasu_Read_39 (DcmDspDataInfo): DcmDspDataFixedLength=true  # Diagnostics Data Import
        Data_DiagnServi_TABROW_NeuMeasu_Read_39 (DcmDspData): DcmDspDataSize=8, DcmDspDataType=UINT8_N, DcmDspDataInfoRef=DataInfo_DiagnServi_TABROW_NeuMeasu_Read_39  # Diagnostics Data Import
        DataInfo_DiagnServi_TABROW_NeuMeasu_Read_40 (DcmDspDataInfo): DcmDspDataFixedLength=true  # Diagnostics Data Import
        Data_DiagnServi_TABROW_NeuMeasu_Read_40 (DcmDspData): DcmDspDataSize=32, DcmDspDataType=UINT8_N, DcmDspDataInfoRef=DataInfo_DiagnServi_TABROW_NeuMeasu_Read_40  # Diagnostics Data Import
        DataInfo_DiagnServi_TABROW_NeuMeasu_Read_41 (DcmDspDataInfo): DcmDspDataFixedLength=true  # Diagnostics Data Import
        Data_DiagnServi_TABROW_NeuMeasu_Read_41 (DcmDspData): DcmDspDataSize=112, DcmDspDataType=UINT8_N, DcmDspDataInfoRef=DataInfo_DiagnServi_TABROW_NeuMeasu_Read_41  # Diagnostics Data Import
        DataInfo_DiagnServi_TABROW_NeuMeasu_Read_20 (DcmDspDataInfo): DcmDspDataFixedLength=true  # Diagnostics Data Import
        Data_DiagnServi_TABROW_NeuMeasu_Read_20 (DcmDspData): DcmDspDataSize=8, DcmDspDataType=UINT8_N, DcmDspDataInfoRef=DataInfo_DiagnServi_TABROW_NeuMeasu_Read_20  # Diagnostics Data Import
        DataInfo_DiagnServi_TABROW_NeuMeasu_Read_49 (DcmDspDataInfo): DcmDspDataFixedLength=true  # Diagnostics Data Import
        Data_DiagnServi_TABROW_NeuMeasu_Read_49 (DcmDspData): DcmDspDataSize=16, DcmDspDataType=UINT8_N, DcmDspDataInfoRef=DataInfo_DiagnServi_TABROW_NeuMeasu_Read_49  # Diagnostics Data Import
        DataInfo_DiagnServi_TABROW_NeuMeasu_Read_47 (DcmDspDataInfo): DcmDspDataFixedLength=true  # Diagnostics Data Import
        Data_DiagnServi_TABROW_NeuMeasu_Read_47 (DcmDspData): DcmDspDataSize=16, DcmDspDataType=UINT8_N, DcmDspDataInfoRef=DataInfo_DiagnServi_TABROW_NeuMeasu_Read_47  # Diagnostics Data Import
        DataInfo_DiagnServi_TABROW_NeuMeasu_Read_49_1 (DcmDspDataInfo): DcmDspDataFixedLength=true  # Diagnostics Data Import
        Data_DiagnServi_TABROW_NeuMeasu_Read_49_1 (DcmDspData): DcmDspDataSize=16, DcmDspDataType=UINT8_N, DcmDspDataInfoRef=DataInfo_DiagnServi_TABROW_NeuMeasu_Read_49_1  # Diagnostics Data Import
        DataInfo_DiagnServi_TABROW_NeuMeasu_Read_43 (DcmDspDataInfo): DcmDspDataFixedLength=true  # Diagnostics Data Import
        Data_DiagnServi_TABROW_NeuMeasu_Read_43 (DcmDspData): DcmDspDataSize=512, DcmDspDataType=UINT8_N, DcmDspDataInfoRef=DataInfo_DiagnServi_TABROW_NeuMeasu_Read_43  # Diagnostics Data Import
        DataInfo_DiagnServi_TABROW_NeuMeasu_Read_43_1 (DcmDspDataInfo): DcmDspDataFixedLength=true  # Diagnostics Data Import
        Data_DiagnServi_TABROW_NeuMeasu_Read_43_1 (DcmDspData): DcmDspDataSize=512, DcmDspDataType=UINT8_N, DcmDspDataInfoRef=DataInfo_DiagnServi_TABROW_NeuMeasu_Read_43_1  # Diagnostics Data Import
        DataInfo_DiagnServi_TABROW_NeuMeasu_Read_43_1_1 (DcmDspDataInfo): DcmDspDataFixedLength=true  # Diagnostics Data Import
        Data_DiagnServi_TABROW_NeuMeasu_Read_43_1_1 (DcmDspData): DcmDspDataSize=512, DcmDspDataType=UINT8_N, DcmDspDataInfoRef=DataInfo_DiagnServi_TABROW_NeuMeasu_Read_43_1_1  # Diagnostics Data Import
        DataInfo_DiagnServi_TABROW_NeuMeasu_Read_43_1_1_1 (DcmDspDataInfo): DcmDspDataFixedLength=true  # Diagnostics Data Import
        Data_DiagnServi_TABROW_NeuMeasu_Read_43_1_1_1 (DcmDspData): DcmDspDataSize=512, DcmDspDataType=UINT8_N, DcmDspDataInfoRef=DataInfo_DiagnServi_TABROW_NeuMeasu_Read_43_1_1_1  # Diagnostics Data Import
        DataInfo_DiagnServi_TABROW_NeuMeasu_Read_43_1_1_1_1 (DcmDspDataInfo): DcmDspDataFixedLength=true  # Diagnostics Data Import
        Data_DiagnServi_TABROW_NeuMeasu_Read_43_1_1_1_1 (DcmDspData): DcmDspDataSize=512, DcmDspDataType=UINT8_N, DcmDspDataInfoRef=DataInfo_DiagnServi_TABROW_NeuMeasu_Read_43_1_1_1_1  # Diagnostics Data Import
        DataInfo_DiagnServi_TABROW_NeuMeasu_Read_43_1_1_1_1_1 (DcmDspDataInfo): DcmDspDataFixedLength=true  # Diagnostics Data Import
        Data_DiagnServi_TABROW_NeuMeasu_Read_43_1_1_1_1_1 (DcmDspData): DcmDspDataSize=512, DcmDspDataType=UINT8_N, DcmDspDataInfoRef=DataInfo_DiagnServi_TABROW_NeuMeasu_Read_43_1_1_1_1_1  # Diagnostics Data Import
        DataInfo_DiagnServi_TABROW_NeuMeasu_Read_43_1_1_1_1_1_1 (DcmDspDataInfo): DcmDspDataFixedLength=true  # Diagnostics Data Import
        Data_DiagnServi_TABROW_NeuMeasu_Read_43_1_1_1_1_1_1 (DcmDspData): DcmDspDataSize=512, DcmDspDataType=UINT8_N, DcmDspDataInfoRef=DataInfo_DiagnServi_TABROW_NeuMeasu_Read_43_1_1_1_1_1_1  # Diagnostics Data Import
        DataInfo_DiagnServi_TABROW_NeuMeasu_Read_43_1_1_1_1_1_1_1 (DcmDspDataInfo): DcmDspDataFixedLength=true  # Diagnostics Data Import
        Data_DiagnServi_TABROW_NeuMeasu_Read_43_1_1_1_1_1_1_1 (DcmDspData): DcmDspDataSize=512, DcmDspDataType=UINT8_N, DcmDspDataInfoRef=DataInfo_DiagnServi_TABROW_NeuMeasu_Read_43_1_1_1_1_1_1_1  # Diagnostics Data Import
        DataInfo_DiagnServi_TABROW_NeuMeasu_Read_43_1_1_1_1_1_1_1_1_1_1 (DcmDspDataInfo): DcmDspDataFixedLength=true  # Diagnostics Data Import
        Data_DiagnServi_TABROW_NeuMeasu_Read_43_1_1_1_1_1_1_1_1_1_1 (DcmDspData): DcmDspDataSize=512, DcmDspDataType=UINT8_N, DcmDspDataInfoRef=DataInfo_DiagnServi_TABROW_NeuMeasu_Read_43_1_1_1_1_1_1_1_1_1_1  # Diagnostics Data Import
        DataInfo_DiagnServi_TABROW_NeuMeasu_Read_43_1_1_1_1_1_1_1_1 (DcmDspDataInfo): DcmDspDataFixedLength=true  # Diagnostics Data Import
        Data_DiagnServi_TABROW_NeuMeasu_Read_43_1_1_1_1_1_1_1_1 (DcmDspData): DcmDspDataSize=512, DcmDspDataType=UINT8_N, DcmDspDataInfoRef=DataInfo_DiagnServi_TABROW_NeuMeasu_Read_43_1_1_1_1_1_1_1_1  # Diagnostics Data Import
        DataInfo_DiagnServi_TABROW_NeuMeasu_Read_43_1_1_1_1_1_1_1_1_1 (DcmDspDataInfo): DcmDspDataFixedLength=true  # Diagnostics Data Import
        Data_DiagnServi_TABROW_NeuMeasu_Read_43_1_1_1_1_1_1_1_1_1 (DcmDspData): DcmDspDataSize=512, DcmDspDataType=UINT8_N, DcmDspDataInfoRef=DataInfo_DiagnServi_TABROW_NeuMeasu_Read_43_1_1_1_1_1_1_1_1_1  # Diagnostics Data Import
        DataInfo_DiagnServi_TABROW_NeuMeasu_Read_43_1_1_1_1_1_1_1_1_1_1_1 (DcmDspDataInfo): DcmDspDataFixedLength=true  # Diagnostics Data Import
        Data_DiagnServi_TABROW_NeuMeasu_Read_43_1_1_1_1_1_1_1_1_1_1_1 (DcmDspData): DcmDspDataSize=512, DcmDspDataType=UINT8_N, DcmDspDataInfoRef=DataInfo_DiagnServi_TABROW_NeuMeasu_Read_43_1_1_1_1_1_1_1_1_1_1_1  # Diagnostics Data Import
        DataInfo_DiagnServi_TABROW_NeuMeasu_Read_50 (DcmDspDataInfo): DcmDspDataFixedLength=true  # Diagnostics Data Import
        Data_DiagnServi_TABROW_NeuMeasu_Read_50 (DcmDspData): DcmDspDataSize=16, DcmDspDataType=UINT8_N, DcmDspDataInfoRef=DataInfo_DiagnServi_TABROW_NeuMeasu_Read_50  # Diagnostics Data Import
        DataInfo_DiagnServi_TABROW_NeuMeasu_Read_48 (DcmDspDataInfo): DcmDspDataFixedLength=true  # Diagnostics Data Import
        Data_DiagnServi_TABROW_NeuMeasu_Read_48 (DcmDspData): DcmDspDataSize=192, DcmDspDataType=UINT8_N, DcmDspDataInfoRef=DataInfo_DiagnServi_TABROW_NeuMeasu_Read_48  # Diagnostics Data Import
        DataInfo_DiagnServi_TABROW_DID0x0EF_Read (DcmDspDataInfo): DcmDspDataFixedLength=true  # Diagnostics Data Import
        Data_DiagnServi_TABROW_DID0x0EF_Read (DcmDspData): DcmDspDataSize=192, DcmDspDataType=UINT8_N, DcmDspDataInfoRef=DataInfo_DiagnServi_TABROW_DID0x0EF_Read  # Diagnostics Data Import
        DataInfo_DiagnServi_TABROW_NeuMeasu_Read_33_1_1_1_1_1_1_1_1_1_1_1_1_1_1_1_1_1_1_1_1_1_1_1_2_1 (DcmDspDataInfo): DcmDspDataFixedLength=true  # Diagnostics Data Import
        Data_DiagnServi_TABROW_NeuMeasu_Read_33_1_1_1_1_1_1_1_1_1_1_1_1_1_1_1_1_1_1_1_1_1_1_1_2_1 (DcmDspData):  # Diagnostics Data Import
          DcmDspDataSize = 72
          DcmDspDataType = UINT8_N
          DcmDspDataInfoRef = DataInfo_DiagnServi_TABROW_NeuMeasu_Read_33_1_1_1_1_1_1_1_1_1_1_1_1_1_1_1_1_1_1_1_1_1_1_1_2_1
        DataInfo_DiagnServi_TABROW_NeuMeasu_Read_33_1_1_1_1_1_1_1_1_1_1_1_1_1_1_1_1_1_1_1_1_1_1_1_2_1_1_1 (DcmDspDataInfo): DcmDspDataFixedLength=true  # Diagnostics Data Import
        Data_DiagnServi_TABROW_NeuMeasu_Read_33_1_1_1_1_1_1_1_1_1_1_1_1_1_1_1_1_1_1_1_1_1_1_1_2_1_1_1 (DcmDspData):  # Diagnostics Data Import
          DcmDspDataSize = 384
          DcmDspDataType = UINT8_N
          DcmDspDataInfoRef = DataInfo_DiagnServi_TABROW_NeuMeasu_Read_33_1_1_1_1_1_1_1_1_1_1_1_1_1_1_1_1_1_1_1_1_1_1_1_2_1_1_1
        DataInfo_DiagnServi_TABROW_NeuMeasu_Read_3 (DcmDspDataInfo): DcmDspDataFixedLength=true  # Diagnostics Data Import
        Data_DiagnServi_TABROW_NeuMeasu_Read_3 (DcmDspData): DcmDspDataSize=8, DcmDspDataType=UINT8_N, DcmDspDataInfoRef=DataInfo_DiagnServi_TABROW_NeuMeasu_Read_3  # Diagnostics Data Import
        DataInfo_DiagnServi_TABROW_NeuMeasu_Read_2 (DcmDspDataInfo): DcmDspDataFixedLength=true  # Diagnostics Data Import
        Data_DiagnServi_TABROW_NeuMeasu_Read_2 (DcmDspData): DcmDspDataSize=8, DcmDspDataType=UINT8_N, DcmDspDataInfoRef=DataInfo_DiagnServi_TABROW_NeuMeasu_Read_2  # Diagnostics Data Import
        DataInfo_DiagnServi_TABROW_NeuMeasu_Read_5 (DcmDspDataInfo): DcmDspDataFixedLength=true  # Diagnostics Data Import
        Data_DiagnServi_TABROW_NeuMeasu_Read_5 (DcmDspData): DcmDspDataSize=8, DcmDspDataType=UINT8_N, DcmDspDataInfoRef=DataInfo_DiagnServi_TABROW_NeuMeasu_Read_5  # Diagnostics Data Import
        DataInfo_DiagnServi_TABROW_NeuMeasu_Read_34 (DcmDspDataInfo): DcmDspDataFixedLength=true  # Diagnostics Data Import
        Data_DiagnServi_TABROW_NeuMeasu_Read_34 (DcmDspData): DcmDspDataSize=8, DcmDspDataType=UINT8_N, DcmDspDataInfoRef=DataInfo_DiagnServi_TABROW_NeuMeasu_Read_34  # Diagnostics Data Import
        DataInfo_BMC_Vorlade_Zielspannung_Read_Data_By_Identifier (DcmDspDataInfo): DcmDspDataFixedLength=true  # Diagnostics Data Import
        Data_BMC_Vorlade_Zielspannung_Read_Data_By_Identifier (DcmDspData): DcmDspDataSize=16, DcmDspDataType=UINT8_N, DcmDspDataInfoRef=DataInfo_BMC_Vorlade_Zielspannung_Read_Data_By_Identifier  # Diagnostics Data Import
        DataInfo_BMC_Mode_Read_Data_By_Identifier (DcmDspDataInfo): DcmDspDataFixedLength=true  # Diagnostics Data Import
        Data_BMC_Mode_Read_Data_By_Identifier (DcmDspData): DcmDspDataSize=8, DcmDspDataType=UINT8_N, DcmDspDataInfoRef=DataInfo_BMC_Mode_Read_Data_By_Identifier  # Diagnostics Data Import
        DataInfo_BMC_Strom_Read_Data_By_Identifier (DcmDspDataInfo): DcmDspDataFixedLength=true  # Diagnostics Data Import
        Data_BMC_Strom_Read_Data_By_Identifier (DcmDspData): DcmDspDataSize=16, DcmDspDataType=UINT8_N, DcmDspDataInfoRef=DataInfo_BMC_Strom_Read_Data_By_Identifier  # Diagnostics Data Import
        DataInfo_DiagnServi_TABROW_Produ_Read (DcmDspDataInfo): DcmDspDataFixedLength=true  # Diagnostics Data Import
        Data_DiagnServi_TABROW_Produ_Read (DcmDspData): DcmDspDataSize=24, DcmDspDataType=UINT8_N, DcmDspDataInfoRef=DataInfo_DiagnServi_TABROW_Produ_Read  # Diagnostics Data Import
        DataInfo_DiagnServi_TABROW_ProduDeact_Read (DcmDspDataInfo): DcmDspDataFixedLength=true  # Diagnostics Data Import
        Data_DiagnServi_TABROW_ProduDeact_Read (DcmDspData): DcmDspDataSize=24, DcmDspDataType=UINT8_N, DcmDspDataInfoRef=DataInfo_DiagnServi_TABROW_ProduDeact_Read  # Diagnostics Data Import
        DataInfo_TABROW_ProgrPreco_Read (DcmDspDataInfo): DcmDspDataFixedLength=false  # Diagnostics Data Import
        Data_TABROW_ProgrPreco_Read (DcmDspData): DcmDspDataSize=2048, DcmDspDataType=UINT8_N, DcmDspDataInfoRef=DataInfo_TABROW_ProgrPreco_Read  # Diagnostics Data Import
        DataInfo_DiagnServi_TABROW_BootlTPBlock_Read (DcmDspDataInfo): DcmDspDataFixedLength=true  # Diagnostics Data Import
        Data_DiagnServi_TABROW_BootlTPBlock_Read (DcmDspData): DcmDspDataSize=8, DcmDspDataType=UINT8_N, DcmDspDataInfoRef=DataInfo_DiagnServi_TABROW_BootlTPBlock_Read  # Diagnostics Data Import
        DataInfo_TABROW_VWLogicSoftwBlockLockValue_Read (DcmDspDataInfo)  # Diagnostics Data Import
        Data_TABROW_VWLogicSoftwBlockLockValue_Read (DcmDspData): DcmDspDataType=UINT8_N, DcmDspDataInfoRef=DataInfo_TABROW_VWLogicSoftwBlockLockValue_Read  # Diagnostics Data Import
        DataInfo_TABROW_VWLogicSoftwBlockCountOfProgrAttem_Read (DcmDspDataInfo)  # Diagnostics Data Import
        Data_TABROW_VWLogicSoftwBlockCountOfProgrAttem_Read (DcmDspData): DcmDspDataType=UINT8_N, DcmDspDataInfoRef=DataInfo_TABROW_VWLogicSoftwBlockCountOfProgrAttem_Read  # Diagnostics Data Import
        DataInfo_DiagnServi_Assembly_part_number_Read (DcmDspDataInfo): DcmDspDataFixedLength=true  # Diagnostics Data Import
        Data_DiagnServi_Assembly_part_number_Read (DcmDspData): DcmDspDataSize=88, DcmDspDataType=UINT8_N, DcmDspDataInfoRef=DataInfo_DiagnServi_Assembly_part_number_Read  # Diagnostics Data Import
        DataInfo_DiagnServi_BCUe_part_number_Read (DcmDspDataInfo): DcmDspDataFixedLength=true  # Diagnostics Data Import
        Data_DiagnServi_BCUe_part_number_Read (DcmDspData): DcmDspDataSize=88, DcmDspDataType=UINT8_N, DcmDspDataInfoRef=DataInfo_DiagnServi_BCUe_part_number_Read  # Diagnostics Data Import
        DataInfo_BMC_Status_DCLS_Read_Data_By_Identifier (DcmDspDataInfo): DcmDspDataFixedLength=true  # Diagnostics Data Import
        Data_BMC_Status_DCLS_Read_Data_By_Identifier (DcmDspData): DcmDspDataSize=8, DcmDspDataType=UINT8_N, DcmDspDataInfoRef=DataInfo_BMC_Status_DCLS_Read_Data_By_Identifier  # Diagnostics Data Import
        DataInfo_DiagnServi_BMCE_part_number_Read (DcmDspDataInfo): DcmDspDataFixedLength=true  # Diagnostics Data Import
        Data_DiagnServi_BMCE_part_number_Read (DcmDspData): DcmDspDataSize=88, DcmDspDataType=UINT8_N, DcmDspDataInfoRef=DataInfo_DiagnServi_BMCE_part_number_Read  # Diagnostics Data Import
        DataInfo_DiagnServi_Cell_part_number_Read (DcmDspDataInfo): DcmDspDataFixedLength=true  # Diagnostics Data Import
        Data_DiagnServi_Cell_part_number_Read (DcmDspData): DcmDspDataSize=88, DcmDspDataType=UINT8_N, DcmDspDataInfoRef=DataInfo_DiagnServi_Cell_part_number_Read  # Diagnostics Data Import
        DataInfo_DiagnServi_BMC_serial_number_Read (DcmDspDataInfo): DcmDspDataFixedLength=true  # Diagnostics Data Import
        Data_DiagnServi_BMC_serial_number_Read (DcmDspData): DcmDspDataSize=80, DcmDspDataType=UINT8_N, DcmDspDataInfoRef=DataInfo_DiagnServi_BMC_serial_number_Read  # Diagnostics Data Import
        DataInfo_DiagnServi_Module_part_number_Read (DcmDspDataInfo): DcmDspDataFixedLength=true  # Diagnostics Data Import
        Data_DiagnServi_Module_part_number_Read (DcmDspData): DcmDspDataSize=88, DcmDspDataType=UINT8_N, DcmDspDataInfoRef=DataInfo_DiagnServi_Module_part_number_Read  # Diagnostics Data Import
        DataInfo_DiagnServi_SOH_Read (DcmDspDataInfo): DcmDspDataFixedLength=true  # Diagnostics Data Import
        Data_DiagnServi_SOH_Read (DcmDspData): DcmDspDataSize=8, DcmDspDataType=UINT8_N, DcmDspDataInfoRef=DataInfo_DiagnServi_SOH_Read  # Diagnostics Data Import
        DataInfo_TABROW_StatePCM_ReadDataByIdent (DcmDspDataInfo): DcmDspDataFixedLength=true  # Diagnostics Data Import
        Data_TABROW_StatePCM_ReadDataByIdent (DcmDspData): DcmDspDataSize=8, DcmDspDataType=UINT8_N, DcmDspDataInfoRef=DataInfo_TABROW_StatePCM_ReadDataByIdent  # Diagnostics Data Import
        DataInfo_DiagnServi_Type_number_assembly_Read (DcmDspDataInfo): DcmDspDataFixedLength=true  # Diagnostics Data Import
        Data_DiagnServi_Type_number_assembly_Read (DcmDspData): DcmDspDataSize=88, DcmDspDataType=UINT8_N, DcmDspDataInfoRef=DataInfo_DiagnServi_Type_number_assembly_Read  # Diagnostics Data Import
        DataInfo_DiagnServi_Type_number_BCUe_Read (DcmDspDataInfo): DcmDspDataFixedLength=true  # Diagnostics Data Import
        Data_DiagnServi_Type_number_BCUe_Read (DcmDspData): DcmDspDataSize=88, DcmDspDataType=UINT8_N, DcmDspDataInfoRef=DataInfo_DiagnServi_Type_number_BCUe_Read  # Diagnostics Data Import
        DataInfo_DiagnServi_Type_number_BMCE_Read (DcmDspDataInfo): DcmDspDataFixedLength=true  # Diagnostics Data Import
        Data_DiagnServi_Type_number_BMCE_Read (DcmDspData): DcmDspDataSize=88, DcmDspDataType=UINT8_N, DcmDspDataInfoRef=DataInfo_DiagnServi_Type_number_BMCE_Read  # Diagnostics Data Import
        DataInfo_Battery_amount_of_modules_Read_Data_By_Identifier (DcmDspDataInfo): DcmDspDataFixedLength=true  # Diagnostics Data Import
        Data_Battery_amount_of_modules_Read_Data_By_Identifier (DcmDspData): DcmDspDataSize=8, DcmDspDataType=UINT8_N, DcmDspDataInfoRef=DataInfo_Battery_amount_of_modules_Read_Data_By_Identifier  # Diagnostics Data Import
        DataInfo_DiagnServi_Assembly_production_data_Read (DcmDspDataInfo): DcmDspDataFixedLength=true  # Diagnostics Data Import
        Data_DiagnServi_Assembly_production_data_Read (DcmDspData): DcmDspDataSize=176, DcmDspDataType=UINT8_N, DcmDspDataInfoRef=DataInfo_DiagnServi_Assembly_production_data_Read  # Diagnostics Data Import
        DataInfo_State_Of_Charge_Battery_customer_Read_Data_By_Identifier (DcmDspDataInfo): DcmDspDataFixedLength=true  # Diagnostics Data Import
        Data_State_Of_Charge_Battery_customer_Read_Data_By_Identifier (DcmDspData): DcmDspDataSize=16, DcmDspDataType=UINT8_N, DcmDspDataInfoRef=DataInfo_State_Of_Charge_Battery_customer_Read_Data_By_Identifier  # Diagnostics Data Import
        DataInfo_Battery_return_flow_temperature_Read_Data_By_Identifier (DcmDspDataInfo): DcmDspDataFixedLength=true  # Diagnostics Data Import
        Data_Battery_return_flow_temperature_Read_Data_By_Identifier (DcmDspData): DcmDspDataSize=16, DcmDspDataType=UINT8_N, DcmDspDataInfoRef=DataInfo_Battery_return_flow_temperature_Read_Data_By_Identifier  # Diagnostics Data Import
        DataInfo_TABROW_BMCHVKFehleInter_Read_Data_By_Identifier (DcmDspDataInfo): DcmDspDataFixedLength=true  # Diagnostics Data Import
        Data_TABROW_BMCHVKFehleInter_Read_Data_By_Identifier (DcmDspData): DcmDspDataSize=8, DcmDspDataType=UINT8_N, DcmDspDataInfoRef=DataInfo_TABROW_BMCHVKFehleInter_Read_Data_By_Identifier  # Diagnostics Data Import
        DataInfo_HV_battery_performance_indicator_discharging_Read_Data_By_Identifier (DcmDspDataInfo): DcmDspDataFixedLength=true  # Diagnostics Data Import
        Data_HV_battery_performance_indicator_discharging_Read_Data_By_Identifier (DcmDspData): DcmDspDataSize=16, DcmDspDataType=UINT8_N, DcmDspDataInfoRef=DataInfo_HV_battery_performance_indicator_discharging_Read_Data_By_Identifier  # Diagnostics Data Import
        DataInfo_HV_battery_performance_indicator_charging_Read_Data_By_Identifier (DcmDspDataInfo): DcmDspDataFixedLength=true  # Diagnostics Data Import
        Data_HV_battery_performance_indicator_charging_Read_Data_By_Identifier (DcmDspData): DcmDspDataSize=16, DcmDspDataType=UINT8_N, DcmDspDataInfoRef=DataInfo_HV_battery_performance_indicator_charging_Read_Data_By_Identifier  # Diagnostics Data Import
        DataInfo_HV_battery_continuous_discharge_power_Read_Data_By_Identifier (DcmDspDataInfo): DcmDspDataFixedLength=true  # Diagnostics Data Import
        Data_HV_battery_continuous_discharge_power_Read_Data_By_Identifier (DcmDspData): DcmDspDataSize=16, DcmDspDataType=UINT8_N, DcmDspDataInfoRef=DataInfo_HV_battery_continuous_discharge_power_Read_Data_By_Identifier  # Diagnostics Data Import
        DataInfo_HV_Battery_thermal_load_Read_Data_By_Identifier (DcmDspDataInfo): DcmDspDataFixedLength=true  # Diagnostics Data Import
        Data_HV_Battery_thermal_load_Read_Data_By_Identifier (DcmDspData): DcmDspDataSize=800, DcmDspDataType=UINT8_N, DcmDspDataInfoRef=DataInfo_HV_Battery_thermal_load_Read_Data_By_Identifier  # Diagnostics Data Import
        DataInfo_TABROW_BMCHVKFehleHVIL_Read_Data_By_Identifier (DcmDspDataInfo): DcmDspDataFixedLength=true  # Diagnostics Data Import
        Data_TABROW_BMCHVKFehleHVIL_Read_Data_By_Identifier (DcmDspData): DcmDspDataSize=8, DcmDspDataType=UINT8_N, DcmDspDataInfoRef=DataInfo_TABROW_BMCHVKFehleHVIL_Read_Data_By_Identifier  # Diagnostics Data Import
        DataInfo_HV_battery_continuous_charging_power_Read_Data_By_Identifier (DcmDspDataInfo): DcmDspDataFixedLength=true  # Diagnostics Data Import
        Data_HV_battery_continuous_charging_power_Read_Data_By_Identifier (DcmDspData): DcmDspDataSize=16, DcmDspDataType=UINT8_N, DcmDspDataInfoRef=DataInfo_HV_battery_continuous_charging_power_Read_Data_By_Identifier  # Diagnostics Data Import
        DataInfo_Strommesung_Read_Data_By_Identifier (DcmDspDataInfo): DcmDspDataFixedLength=true  # Diagnostics Data Import
        Data_Strommesung_Read_Data_By_Identifier (DcmDspData): DcmDspDataSize=32, DcmDspDataType=UINT8_N, DcmDspDataInfoRef=DataInfo_Strommesung_Read_Data_By_Identifier  # Diagnostics Data Import
        DataInfo_TABROW_HVBatteBackFlowTempeWrite_Read (DcmDspDataInfo): DcmDspDataFixedLength=true  # Diagnostics Data Import
        Data_TABROW_HVBatteBackFlowTempeWrite_Read (DcmDspData): DcmDspDataSize=64, DcmDspDataType=UINT8_N, DcmDspDataInfoRef=DataInfo_TABROW_HVBatteBackFlowTempeWrite_Read  # Diagnostics Data Import
        DataInfo_TABROW_OBDClassDescr_Read_Data_By_Identifier (DcmDspDataInfo): DcmDspDataFixedLength=true  # Diagnostics Data Import
        Data_TABROW_OBDClassDescr_Read_Data_By_Identifier (DcmDspData): DcmDspDataSize=16, DcmDspDataType=UINT8_N, DcmDspDataInfoRef=DataInfo_TABROW_OBDClassDescr_Read_Data_By_Identifier  # Diagnostics Data Import
        DataInfo_TABROW_OBDType_Read (DcmDspDataInfo): DcmDspDataFixedLength=true  # Diagnostics Data Import
        Data_TABROW_OBDType_Read (DcmDspData): DcmDspDataSize=8, DcmDspDataType=UINT8_N, DcmDspDataInfoRef=DataInfo_TABROW_OBDType_Read  # Diagnostics Data Import
        DataInfo_TABROW_KnockTimer_Read (DcmDspDataInfo): DcmDspDataFixedLength=true  # Diagnostics Data Import
        Data_TABROW_KnockTimer_Read (DcmDspData): DcmDspDataSize=16, DcmDspDataType=UINT8_N, DcmDspDataInfoRef=DataInfo_TABROW_KnockTimer_Read  # Diagnostics Data Import
        DataInfo_TABROW_KnockCount_Read (DcmDspDataInfo): DcmDspDataFixedLength=true  # Diagnostics Data Import
        Data_TABROW_KnockCount_Read (DcmDspData): DcmDspDataSize=16, DcmDspDataType=UINT8_N, DcmDspDataInfoRef=DataInfo_TABROW_KnockCount_Read  # Diagnostics Data Import
        DataInfo_TABROW_StandAmbieCondi_ReadDataByIdent (DcmDspDataInfo): DcmDspDataFixedLength=true  # Diagnostics Data Import
        Data_TABROW_StandAmbieCondi_ReadDataByIdent (DcmDspData): DcmDspDataSize=72, DcmDspDataType=UINT8_N, DcmDspDataInfoRef=DataInfo_TABROW_StandAmbieCondi_ReadDataByIdent  # Diagnostics Data Import
        DataInfo_DiagnServi_TABROW_TABRORespo_Read_Data_By_Identifier (DcmDspDataInfo): DcmDspDataFixedLength=true  # Diagnostics Data Import
        Data_DiagnServi_TABROW_TABRORespo_Read_Data_By_Identifier (DcmDspData): DcmDspDataSize=8, DcmDspDataType=UINT8_N, DcmDspDataInfoRef=DataInfo_DiagnServi_TABROW_TABRORespo_Read_Data_By_Identifier  # Diagnostics Data Import
        DataInfo_DiagnServi_TABROW_NeuMeasu_Read_51 (DcmDspDataInfo): DcmDspDataFixedLength=true  # Diagnostics Data Import
        Data_DiagnServi_TABROW_NeuMeasu_Read_51 (DcmDspData): DcmDspDataSize=8, DcmDspDataType=UINT8_N, DcmDspDataInfoRef=DataInfo_DiagnServi_TABROW_NeuMeasu_Read_51  # Diagnostics Data Import
        DataInfo_DiagnServi_TABROW_TABROOBDDr_Read_Data_By_Identifier (DcmDspDataInfo): DcmDspDataFixedLength=true  # Diagnostics Data Import
        Data_DiagnServi_TABROW_TABROOBDDr_Read_Data_By_Identifier (DcmDspData): DcmDspDataSize=8, DcmDspDataType=UINT8_N, DcmDspDataInfoRef=DataInfo_DiagnServi_TABROW_TABROOBDDr_Read_Data_By_Identifier  # Diagnostics Data Import
        DataInfo_DiagnServi_TABROW_IntegValidDataConfiList_Read (DcmDspDataInfo): DcmDspDataFixedLength=false  # Diagnostics Data Import
        Data_DiagnServi_TABROW_IntegValidDataConfiList_Read (DcmDspData): DcmDspDataSize=4016, DcmDspDataType=UINT8_N, DcmDspDataInfoRef=DataInfo_DiagnServi_TABROW_IntegValidDataConfiList_Read  # Diagnostics Data Import
        DataInfo_TABROW_ProgrHash_Read (DcmDspDataInfo): DcmDspDataFixedLength=true  # Diagnostics Data Import
        Data_TABROW_ProgrHash_Read (DcmDspData): DcmDspDataSize=256, DcmDspDataType=UINT8_N, DcmDspDataInfoRef=DataInfo_TABROW_ProgrHash_Read  # Diagnostics Data Import
        DataInfo_TABROW_ConfiHash_Read (DcmDspDataInfo): DcmDspDataFixedLength=true  # Diagnostics Data Import
        Data_TABROW_ConfiHash_Read (DcmDspData): DcmDspDataSize=256, DcmDspDataType=UINT8_N, DcmDspDataInfoRef=DataInfo_TABROW_ConfiHash_Read  # Diagnostics Data Import
        DataInfo_TABROW_StatuProdu_Read_Data_By_Identifier (DcmDspDataInfo): DcmDspDataFixedLength=true  # Diagnostics Data Import
        Data_TABROW_StatuProdu_Read_Data_By_Identifier (DcmDspData): DcmDspDataSize=8, DcmDspDataType=UINT8_N, DcmDspDataInfoRef=DataInfo_TABROW_StatuProdu_Read_Data_By_Identifier  # Diagnostics Data Import
        DataInfo_TABROW_SOKMissiKeyList_Read_Data_By_Identifier (DcmDspDataInfo): DcmDspDataFixedLength=false  # Diagnostics Data Import
        Data_TABROW_SOKMissiKeyList_Read_Data_By_Identifier (DcmDspData): DcmDspDataSize=4096, DcmDspDataType=UINT8_N, DcmDspDataInfoRef=DataInfo_TABROW_SOKMissiKeyList_Read_Data_By_Identifier  # Diagnostics Data Import
        DataInfo_TABROW_SOKFreshInfor_Read_Data_By_Identifier (DcmDspDataInfo): DcmDspDataFixedLength=false  # Diagnostics Data Import
        Data_TABROW_SOKFreshInfor_Read_Data_By_Identifier (DcmDspData): DcmDspDataSize=28576, DcmDspDataType=UINT8_N, DcmDspDataInfoRef=DataInfo_TABROW_SOKFreshInfor_Read_Data_By_Identifier  # Diagnostics Data Import
        DataInfo_TABROW_SOKTimeInfor_Read_Data_By_Identifier (DcmDspDataInfo): DcmDspDataFixedLength=true  # Diagnostics Data Import
        Data_TABROW_SOKTimeInfor_Read_Data_By_Identifier (DcmDspData): DcmDspDataSize=88, DcmDspDataType=UINT8_N, DcmDspDataInfoRef=DataInfo_TABROW_SOKTimeInfor_Read_Data_By_Identifier  # Diagnostics Data Import
        DataInfo_TABROW_SOKGenerInfor_Read_Data_By_Identifier (DcmDspDataInfo): DcmDspDataFixedLength=true  # Diagnostics Data Import
        Data_TABROW_SOKGenerInfor_Read_Data_By_Identifier (DcmDspData): DcmDspDataSize=24, DcmDspDataType=UINT8_N, DcmDspDataInfoRef=DataInfo_TABROW_SOKGenerInfor_Read_Data_By_Identifier  # Diagnostics Data Import
        DataInfo_TABROW_SOKSignaFaileList_Read_Data_By_Identifier (DcmDspDataInfo): DcmDspDataFixedLength=false  # Diagnostics Data Import
        Data_TABROW_SOKSignaFaileList_Read_Data_By_Identifier (DcmDspData): DcmDspDataSize=4096, DcmDspDataType=UINT8_N, DcmDspDataInfoRef=DataInfo_TABROW_SOKSignaFaileList_Read_Data_By_Identifier  # Diagnostics Data Import
        DataInfo_TABROW_SOKVerifFaileList_Read_Data_By_Identifier (DcmDspDataInfo): DcmDspDataFixedLength=false  # Diagnostics Data Import
        Data_TABROW_SOKVerifFaileList_Read_Data_By_Identifier (DcmDspData): DcmDspDataSize=4096, DcmDspDataType=UINT8_N, DcmDspDataInfoRef=DataInfo_TABROW_SOKVerifFaileList_Read_Data_By_Identifier  # Diagnostics Data Import
        DataInfo_TABROW_InUseMonitPerfoRatio_Read_Data_By_Identifier (DcmDspDataInfo)  # Diagnostics Data Import
        Data_TABROW_InUseMonitPerfoRatio_Read_Data_By_Identifier (DcmDspData): DcmDspDataType=UINT8_N, DcmDspDataInfoRef=DataInfo_TABROW_InUseMonitPerfoRatio_Read_Data_By_Identifier  # Diagnostics Data Import
        DataInfo_DiagnServi_ReadDataByIdentVWLogicBlockDowngProteVersi (DcmDspDataInfo)  # Diagnostics Data Import
        Data_DiagnServi_ReadDataByIdentVWLogicBlockDowngProteVersi (DcmDspData): DcmDspDataType=UINT8_N, DcmDspDataInfoRef=DataInfo_DiagnServi_ReadDataByIdentVWLogicBlockDowngProteVersi  # Diagnostics Data Import
        DataInfo_DiagnServi_TABROW_UnlocStatuOfECUOfProteOfVehicDiagn_Read (DcmDspDataInfo): DcmDspDataFixedLength=true  # Diagnostics Data Import
        Data_DiagnServi_TABROW_UnlocStatuOfECUOfProteOfVehicDiagn_Read (DcmDspData): DcmDspDataSize=32, DcmDspDataType=UINT8_N, DcmDspDataInfoRef=DataInfo_DiagnServi_TABROW_UnlocStatuOfECUOfProteOfVehicDiagn_Read  # Diagnostics Data Import
        DataInfo_DiagnServi_ReadDataByIdentBasicSettiStatu (DcmDspDataInfo): DcmDspDataFixedLength=true  # Diagnostics Data Import
        Data_DiagnServi_ReadDataByIdentBasicSettiStatu (DcmDspData): DcmDspDataSize=8, DcmDspDataType=UINT8_N, DcmDspDataInfoRef=DataInfo_DiagnServi_ReadDataByIdentBasicSettiStatu  # Diagnostics Data Import
      DcmDsd  # Diagnostics Data Import
        DcmDsdServiceTable  # Diagnostics Data Import
          11 x DcmDsdService:
            ResponseOnEvent: DcmDsdSidTabServiceId=134, DcmDsdSidTabSubfuncAvail=true, DcmDsdSidTabSessionLevelRef=ST_Defau, DcmDsdSidTabSessionLevelRef=ST_Exten  # Diagnostics Data Import
              4 x DcmDsdSubService, all with DcmDsdSubServiceSessionLevelRef=ST_Defau, DcmDsdSubServiceSessionLevelRef=ST_Exten:
                Clear: DcmDsdSubServiceId=6  # Diagnostics Data Import
                Start: DcmDsdSubServiceId=5  # Diagnostics Data Import
                OnDtcStatChg: DcmDsdSubServiceId=1  # Diagnostics Data Import
                Stop: DcmDsdSubServiceId=0  # Diagnostics Data Import
            ControlDtcSetting: DcmDsdSidTabServiceId=133, DcmDsdSidTabSubfuncAvail=true, DcmDsdSidTabSessionLevelRef=ST_Exten, DcmDsdSidTabSessionLevelRef=ST_Progr  # Diagnostics Data Import
              Disable (DcmDsdSubService): DcmDsdSubServiceId=2, DcmDsdSubServiceSessionLevelRef=ST_Exten, DcmDsdSubServiceSessionLevelRef=ST_Progr  # Diagnostics Data Import
              Enable (DcmDsdSubService): DcmDsdSubServiceId=1, DcmDsdSubServiceSessionLevelRef=ST_Exten, DcmDsdSubServiceSessionLevelRef=ST_Progr  # Diagnostics Data Import
            TesterPresent: DcmDsdSidTabServiceId=62, DcmDsdSidTabSubfuncAvail=true  # Diagnostics Data Import
              TesterPresent (DcmDsdSubService): DcmDsdSubServiceId=0  # Diagnostics Data Import
            RoutineControl: DcmDsdSidTabServiceId=49, DcmDsdSidTabSubfuncAvail=true  # Diagnostics Data Import
            WriteDataById: DcmDsdSidTabServiceId=46, DcmDsdSidTabSubfuncAvail=false  # Diagnostics Data Import
            CommunicationControl: DcmDsdSidTabServiceId=40, DcmDsdSidTabSubfuncAvail=true, DcmDsdSidTabSessionLevelRef=ST_Exten, DcmDsdSidTabSessionLevelRef=ST_Progr  # Diagnostics Data Import
              EnableRxAndDisableTx (DcmDsdSubService): DcmDsdSubServiceId=1, DcmDsdSubServiceSessionLevelRef=ST_Exten, DcmDsdSubServiceSessionLevelRef=ST_Progr  # Diagnostics Data Import
              EnableRxAndTx (DcmDsdSubService): DcmDsdSubServiceId=0, DcmDsdSubServiceSessionLevelRef=ST_Exten, DcmDsdSubServiceSessionLevelRef=ST_Progr  # Diagnostics Data Import
            ReadDataById: DcmDsdSidTabServiceId=34, DcmDsdSidTabSubfuncAvail=false  # Diagnostics Data Import
            ReadDtcInfo: DcmDsdSidTabServiceId=25, DcmDsdSidTabSubfuncAvail=true  # Diagnostics Data Import
              11 x DcmDsdSubService:
                RDTCBRGI: DcmDsdSubServiceId=86  # Diagnostics Data Import
                RWWHOBDDTCWPS: DcmDsdSubServiceId=85  # Diagnostics Data Import
                RWWHOBDDTCBMR: DcmDsdSubServiceId=66  # Diagnostics Data Import
                RDTCEDI: DcmDsdSubServiceId=26  # Diagnostics Data Import
                RDTCFDC: DcmDsdSubServiceId=20  # Diagnostics Data Import
                RMRCDTC: DcmDsdSubServiceId=14, DcmDsdSubServiceSessionLevelRef=ST_Defau, DcmDsdSubServiceSessionLevelRef=ST_Exten  # Diagnostics Data Import
                RDTCEDRBDN: DcmDsdSubServiceId=6, DcmDsdSubServiceSessionLevelRef=ST_Defau, DcmDsdSubServiceSessionLevelRef=ST_Exten  # Diagnostics Data Import
                RDTCSSBDTC: DcmDsdSubServiceId=4, DcmDsdSubServiceSessionLevelRef=ST_Defau, DcmDsdSubServiceSessionLevelRef=ST_Exten  # Diagnostics Data Import
                RDTCSSI: DcmDsdSubServiceId=3, DcmDsdSubServiceSessionLevelRef=ST_Defau, DcmDsdSubServiceSessionLevelRef=ST_Exten  # Diagnostics Data Import
                RDTCBSM: DcmDsdSubServiceId=2, DcmDsdSubServiceSessionLevelRef=ST_Defau, DcmDsdSubServiceSessionLevelRef=ST_Exten  # Diagnostics Data Import
                RNODTCBSM: DcmDsdSubServiceId=1, DcmDsdSubServiceSessionLevelRef=ST_Defau, DcmDsdSubServiceSessionLevelRef=ST_Exten  # Diagnostics Data Import
            ClearDiagInfo: DcmDsdSidTabServiceId=20, DcmDsdSidTabSubfuncAvail=false  # Diagnostics Data Import
            EcuReset: DcmDsdSidTabServiceId=17, DcmDsdSidTabSubfuncAvail=true  # Diagnostics Data Import
              KeyOffOn (DcmDsdSubService): DcmDsdSubServiceId=2, DcmDsdSubServiceSessionLevelRef=ST_Defau, DcmDsdSubServiceSessionLevelRef=ST_Exten  # Diagnostics Data Import
              Hard (DcmDsdSubService): DcmDsdSubServiceId=1  # Diagnostics Data Import
            DiagSessionControl: DcmDsdSidTabServiceId=16, DcmDsdSidTabSubfuncAvail=true  # Diagnostics Data Import
              3 x DcmDsdSubService:
                Extended: DcmDsdSubServiceId=3  # Diagnostics Data Import
                Programming: DcmDsdSubServiceId=2, DcmDsdSubServiceSessionLevelRef=ST_Exten, DcmDsdSubServiceSessionLevelRef=ST_Progr  # Diagnostics Data Import
                Default: DcmDsdSubServiceId=1  # Diagnostics Data Import
      DcmGeneral: DcmResetToFblAfterSessionFinalResponseEnabled=false  # Diagnostics Data Import
  module config Dem
    DemGeneral:  # Diagnostics Data Import
      DemAgingCycleCounterProcessing = DEM_PROCESS_AGINGCTR_INTERN
      DemPTOSupport = false
      DemTriggerDcmReports = true
      DemTypeOfDTCSupported = DEM_DTC_TRANSLATION_ISO14229_1
      DemSupportService19x1A = true
      DemSupportService19x56 = true
      DemDtcStatusAvailabilityMask = 255
      DemGeneralOBD: DemOBDPermanentForWWHOBD=true  # Diagnostics Data Import
      17 x DemDataClass, all with DemDataElementUsePort=USE_DATA_CLIENT_SERVER_PORT, DemDataElementStoreNonVolatile=true:
        Data_StandardFreezeFrame1_Param_Reser: DemDataElementDataSize=1  # Diagnostics Data Import
        Data_PID_0x1f_Param_TimeSinceEnginStart: DemDataElementDataSize=2, DemDataElementDataType=UINT8_N, DemDataElementEndianness=opaque  # Diagnostics Data Import
        Data_PID_0xc_Param_EnginRPM: DemDataElementDataSize=2, DemDataElementDataType=UINT8_N, DemDataElementEndianness=opaque  # Diagnostics Data Import
        Data_PID_0x42_Param_ContrModulVolta: DemDataElementDataSize=2, DemDataElementDataType=UINT8_N, DemDataElementEndianness=opaque  # Diagnostics Data Import
        Data_PID_0xd_Param_VehicSpeedSenso: DemDataElementDataSize=1, DemDataElementDataType=UINT8_N, DemDataElementEndianness=opaque  # Diagnostics Data Import
        Data_PID_0x5_Param_EnginCoolaTempe: DemDataElementDataSize=1, DemDataElementDataType=UINT8_N, DemDataElementEndianness=opaque  # Diagnostics Data Import
        Data_PID_0x4_Param_CalcuLOADValue: DemDataElementDataSize=1, DemDataElementDataType=UINT8_N, DemDataElementEndianness=opaque  # Diagnostics Data Import
        Data_PID_0x49_Param_AccelPedalPositD: DemDataElementDataSize=1, DemDataElementDataType=UINT8_N, DemDataElementEndianness=opaque  # Diagnostics Data Import
        Data_StandardFreezeFrame1_Param_TimeStamp_STRUC_Bitfi: DemDataElementDataSize=5, DemDataElementDataType=UINT8_N, DemDataElementEndianness=opaque  # Diagnostics Data Import
        Data_StandardFreezeFrame1_Param_KmMilea_1: DemDataElementDataSize=3, DemDataElementDataType=UINT8_N, DemDataElementEndianness=opaque  # Diagnostics Data Import
        Data_Vishnu_ExtData_Param_VishnRes: DemDataElementDataSize=1, DemDataElementDataType=UINT8  # Diagnostics Data Import
        Data_Vishnu_ExtData_Param_VishnDOB: DemDataElementDataSize=1, DemDataElementDataType=UINT8  # Diagnostics Data Import
        Data_SupplementalMonitorActivityData_Param_StoreMonitActivRatio: DemDataElementDataSize=1, DemDataElementDataType=UINT8  # Diagnostics Data Import
        Data_StandardDTCInformation_Param_OccurCount: DemDataElementDataSize=1, DemDataElementDataType=UINT8  # Diagnostics Data Import
        Data_SupplementalMonitorActivityData_Param_MonitActivNumerCount: DemDataElementDataSize=1, DemDataElementDataType=UINT8  # Diagnostics Data Import
        Data_StandardDTCInformation_Param_DTCPrior: DemDataElementDataSize=1, DemDataElementDataType=UINT8  # Diagnostics Data Import
        Data_StandardFreezeFrame1_Param_AgingCount: DemDataElementDataSize=1, DemDataElementDataType=UINT8  # Diagnostics Data Import
      PowerCycle (DemOperationCycle): DemOperationCycleType=DEM_OPCYC_POWER  # Diagnostics Data Import
      FreezeFrame_51eb4bef (DemFreezeFrameClass):  # Diagnostics Data Import
        DemDidClassRef = DID_DiagnServi_TABROW_CalcuLOADValue_Read_0xf404
        DemDidClassRef = DID_DiagnServi_TABROW_EnginCoolaTempe_Read_0xf405
        DemDidClassRef = DID_DiagnServi_TABROW_EnginRPM_Read_0xf40c
        DemDidClassRef = DID_DiagnServi_TABROW_VehicSpeedSenso_Read_0xf40d
        DemDidClassRef = DID_DiagnServi_TABROW_TimeSinceEnginStart_Read_0xf41f
        DemDidClassRef = DID_DiagnServi_TABROW_ContrModulVolta_Read_0xf442
        DemDidClassRef = DID_DiagnServi_TABROW_AccelPedalPositD_Read_0xf449
      4 x DemExtendedDataRecordClass, all with DemExtendedDataRecordUpdate=DEM_UPDATE_RECORD_NO:
        ExtendedDataRecord_SupplementalMonitorActivityData: DemExtendedDataRecordNumber=147, DemDataClassRef=Data_SupplementalMonitorActivityData_Param_MonitActivNumerCount, DemDataClassRef=Data_SupplementalMonitorActivityData_Param_StoreMonitActivRatio  # Diagnostics Data Import
        ExtendedDataRecord_Vishnu_ExtData: DemExtendedDataRecordNumber=3, DemDataClassRef=Data_Vishnu_ExtData_Param_VishnDOB, DemDataClassRef=Data_Vishnu_ExtData_Param_VishnRes  # Diagnostics Data Import
        ExtendedDataRecord_StandardFreezeFrame1: DemExtendedDataRecordNumber=2, DemDataClassRef=Data_StandardFreezeFrame1_Param_AgingCount, DemDataClassRef=Data_StandardFreezeFrame1_Param_KmMilea_1, DemDataClassRef=Data_StandardFreezeFrame1_Param_Reser, DemDataClassRef=Data_StandardFreezeFrame1_Param_TimeStamp_STRUC_Bitfi  # Diagnostics Data Import
        ExtendedDataRecord_StandardDTCInformation: DemExtendedDataRecordNumber=1, DemDataClassRef=Data_StandardDTCInformation_Param_DTCPrior, DemDataClassRef=Data_StandardDTCInformation_Param_OccurCount  # Diagnostics Data Import
      ExtendedDataClass_4af7fffc (DemExtendedDataClass):  # Diagnostics Data Import
        DemExtendedDataRecordClassRef = ExtendedDataRecord_StandardDTCInformation
        DemExtendedDataRecordClassRef = ExtendedDataRecord_StandardFreezeFrame1
        DemExtendedDataRecordClassRef = ExtendedDataRecord_Vishnu_ExtData
        DemExtendedDataRecordClassRef = ExtendedDataRecord_SupplementalMonitorActivityData
      7 x DemDidClass:
        DID_DiagnServi_TABROW_AccelPedalPositD_Read_0xf449: DemDidIdentifier=62537, DemDidDataClassRef=Data_PID_0x49_Param_AccelPedalPositD  # Diagnostics Data Import
        DID_DiagnServi_TABROW_ContrModulVolta_Read_0xf442: DemDidIdentifier=62530, DemDidDataClassRef=Data_PID_0x42_Param_ContrModulVolta  # Diagnostics Data Import
        DID_DiagnServi_TABROW_TimeSinceEnginStart_Read_0xf41f: DemDidIdentifier=62495, DemDidDataClassRef=Data_PID_0x1f_Param_TimeSinceEnginStart  # Diagnostics Data Import
        DID_DiagnServi_TABROW_VehicSpeedSenso_Read_0xf40d: DemDidIdentifier=62477, DemDidDataClassRef=Data_PID_0xd_Param_VehicSpeedSenso  # Diagnostics Data Import
        DID_DiagnServi_TABROW_EnginRPM_Read_0xf40c: DemDidIdentifier=62476, DemDidDataClassRef=Data_PID_0xc_Param_EnginRPM  # Diagnostics Data Import
        DID_DiagnServi_TABROW_EnginCoolaTempe_Read_0xf405: DemDidIdentifier=62469, DemDidDataClassRef=Data_PID_0x5_Param_EnginCoolaTempe  # Diagnostics Data Import
        DID_DiagnServi_TABROW_CalcuLOADValue_Read_0xf404: DemDidIdentifier=62468, DemDidDataClassRef=Data_PID_0x4_Param_CalcuLOADValue  # Diagnostics Data Import
      DemEventMemorySet  # Diagnostics Data Import
        PrimaryMemory (DemPrimaryMemory): DemTypeOfFreezeFrameRecordNumeration=DEM_FF_RECNUM_CONFIGURED  # Diagnostics Data Import
    DemConfigSet  # Diagnostics Data Import
      DTC_0xe40013 (DemEventParameter):  # Diagnostics Data Import
        DemEventKind = DEM_EVENT_KIND_SWC
        DemDTCClassRef = DtcClass_DTC_0xe40013
        DemExtendedDataClassRef = ExtendedDataClass_4af7fffc
        DemFreezeFrameRecNumClassRef = /InitialEcuC/
        DemOBDFreezeFrameClassRef = FreezeFrame_51eb4bef
        DemEventClass: DemEventSignificance=DEM_EVENT_SIGNIFICANCE_FAULT, DemAgingCycleRef=PowerCycle, DemOperationCycleRef=PowerCycle  # Diagnostics Data Import
          DemDebounceAlgorithmClass  # Diagnostics Data Import
            DemDebounceMonitorInternal  # Diagnostics Data Import
              DemCallbackGetFDC  # Diagnostics Data Import
      DtcClass_DTC_0xe40013 (DemDTCClass): DemUdsDTC=14942227, DemFunctionalGroupIdentifier=51, DemDTCAttributesRef=DtcAttributes_41914fb7  # Diagnostics Data Import
      DTC_0xe40012 (DemEventParameter):  # Diagnostics Data Import
        DemEventKind = DEM_EVENT_KIND_SWC
        DemDTCClassRef = DtcClass_DTC_0xe40012
        DemExtendedDataClassRef = ExtendedDataClass_4af7fffc
        DemFreezeFrameRecNumClassRef = /InitialEcuC/
        DemOBDFreezeFrameClassRef = FreezeFrame_51eb4bef
        DemEventClass: DemEventSignificance=DEM_EVENT_SIGNIFICANCE_FAULT, DemAgingCycleRef=PowerCycle, DemOperationCycleRef=PowerCycle  # Diagnostics Data Import
          DemDebounceAlgorithmClass  # Diagnostics Data Import
            DemDebounceMonitorInternal  # Diagnostics Data Import
              DemCallbackGetFDC  # Diagnostics Data Import
      DtcClass_DTC_0xe40012 (DemDTCClass): DemUdsDTC=14942226, DemFunctionalGroupIdentifier=51, DemDTCAttributesRef=DtcAttributes_41914fb7  # Diagnostics Data Import
      DTC_0xe40011 (DemEventParameter):  # Diagnostics Data Import
        DemEventKind = DEM_EVENT_KIND_SWC
        DemDTCClassRef = DtcClass_DTC_0xe40011
        DemExtendedDataClassRef = ExtendedDataClass_4af7fffc
        DemFreezeFrameRecNumClassRef = /InitialEcuC/
        DemOBDFreezeFrameClassRef = FreezeFrame_51eb4bef
        DemEventClass: DemEventSignificance=DEM_EVENT_SIGNIFICANCE_FAULT, DemAgingCycleRef=PowerCycle, DemOperationCycleRef=PowerCycle  # Diagnostics Data Import
          DemDebounceAlgorithmClass  # Diagnostics Data Import
            DemDebounceMonitorInternal  # Diagnostics Data Import
              DemCallbackGetFDC  # Diagnostics Data Import
      DtcClass_DTC_0xe40011 (DemDTCClass): DemUdsDTC=14942225, DemFunctionalGroupIdentifier=51, DemDTCAttributesRef=DtcAttributes_41914fb7  # Diagnostics Data Import
      DTC_0xe40010 (DemEventParameter):  # Diagnostics Data Import
        DemEventKind = DEM_EVENT_KIND_SWC
        DemDTCClassRef = DtcClass_DTC_0xe40010
        DemExtendedDataClassRef = ExtendedDataClass_4af7fffc
        DemFreezeFrameRecNumClassRef = /InitialEcuC/
        DemOBDFreezeFrameClassRef = FreezeFrame_51eb4bef
        DemEventClass: DemEventSignificance=DEM_EVENT_SIGNIFICANCE_FAULT, DemAgingCycleRef=PowerCycle, DemOperationCycleRef=PowerCycle  # Diagnostics Data Import
          DemDebounceAlgorithmClass  # Diagnostics Data Import
            DemDebounceMonitorInternal  # Diagnostics Data Import
              DemCallbackGetFDC  # Diagnostics Data Import
      DtcClass_DTC_0xe40010 (DemDTCClass): DemUdsDTC=14942224, DemFunctionalGroupIdentifier=51, DemDTCAttributesRef=DtcAttributes_41914fb7  # Diagnostics Data Import
      DTC_0xe40009 (DemEventParameter):  # Diagnostics Data Import
        DemEventKind = DEM_EVENT_KIND_SWC
        DemDTCClassRef = DtcClass_DTC_0xe40009
        DemExtendedDataClassRef = ExtendedDataClass_4af7fffc
        DemFreezeFrameRecNumClassRef = /InitialEcuC/
        DemOBDFreezeFrameClassRef = FreezeFrame_51eb4bef
        DemEventClass: DemEventSignificance=DEM_EVENT_SIGNIFICANCE_FAULT, DemAgingCycleRef=PowerCycle, DemOperationCycleRef=PowerCycle  # Diagnostics Data Import
          DemDebounceAlgorithmClass  # Diagnostics Data Import
            DemDebounceMonitorInternal  # Diagnostics Data Import
              DemCallbackGetFDC  # Diagnostics Data Import
      DtcClass_DTC_0xe40009 (DemDTCClass): DemUdsDTC=14942217, DemFunctionalGroupIdentifier=51, DemDTCAttributesRef=DtcAttributes_41914fb7  # Diagnostics Data Import
      DTC_0xe40008 (DemEventParameter):  # Diagnostics Data Import
        DemEventKind = DEM_EVENT_KIND_SWC
        DemDTCClassRef = DtcClass_DTC_0xe40008
        DemExtendedDataClassRef = ExtendedDataClass_4af7fffc
        DemFreezeFrameRecNumClassRef = /InitialEcuC/
        DemOBDFreezeFrameClassRef = FreezeFrame_51eb4bef
        DemEventClass: DemEventSignificance=DEM_EVENT_SIGNIFICANCE_FAULT, DemAgingCycleRef=PowerCycle, DemOperationCycleRef=PowerCycle  # Diagnostics Data Import
          DemDebounceAlgorithmClass  # Diagnostics Data Import
            DemDebounceMonitorInternal  # Diagnostics Data Import
              DemCallbackGetFDC  # Diagnostics Data Import
      DtcClass_DTC_0xe40008 (DemDTCClass): DemUdsDTC=14942216, DemFunctionalGroupIdentifier=51, DemDTCAttributesRef=DtcAttributes_41914fb7  # Diagnostics Data Import
      DTC_0xe40007 (DemEventParameter):  # Diagnostics Data Import
        DemEventKind = DEM_EVENT_KIND_SWC
        DemDTCClassRef = DtcClass_DTC_0xe40007
        DemExtendedDataClassRef = ExtendedDataClass_4af7fffc
        DemFreezeFrameRecNumClassRef = /InitialEcuC/
        DemOBDFreezeFrameClassRef = FreezeFrame_51eb4bef
        DemEventClass: DemEventSignificance=DEM_EVENT_SIGNIFICANCE_FAULT, DemAgingCycleRef=PowerCycle, DemOperationCycleRef=PowerCycle  # Diagnostics Data Import
          DemDebounceAlgorithmClass  # Diagnostics Data Import
            DemDebounceMonitorInternal  # Diagnostics Data Import
              DemCallbackGetFDC  # Diagnostics Data Import
      DtcClass_DTC_0xe40007 (DemDTCClass): DemUdsDTC=14942215, DemFunctionalGroupIdentifier=51, DemDTCAttributesRef=DtcAttributes_41914fb7  # Diagnostics Data Import
      DTC_0xe40006 (DemEventParameter):  # Diagnostics Data Import
        DemEventKind = DEM_EVENT_KIND_SWC
        DemDTCClassRef = DtcClass_DTC_0xe40006
        DemExtendedDataClassRef = ExtendedDataClass_4af7fffc
        DemFreezeFrameRecNumClassRef = /InitialEcuC/
        DemOBDFreezeFrameClassRef = FreezeFrame_51eb4bef
        DemEventClass: DemEventSignificance=DEM_EVENT_SIGNIFICANCE_FAULT, DemAgingCycleRef=PowerCycle, DemOperationCycleRef=PowerCycle  # Diagnostics Data Import
          DemDebounceAlgorithmClass  # Diagnostics Data Import
            DemDebounceMonitorInternal  # Diagnostics Data Import
              DemCallbackGetFDC  # Diagnostics Data Import
      DtcClass_DTC_0xe40006 (DemDTCClass): DemUdsDTC=14942214, DemFunctionalGroupIdentifier=51, DemDTCAttributesRef=DtcAttributes_41914fb7  # Diagnostics Data Import
      DTC_0xe40005 (DemEventParameter):  # Diagnostics Data Import
        DemEventKind = DEM_EVENT_KIND_SWC
        DemDTCClassRef = DtcClass_DTC_0xe40005
        DemExtendedDataClassRef = ExtendedDataClass_4af7fffc
        DemFreezeFrameRecNumClassRef = /InitialEcuC/
        DemOBDFreezeFrameClassRef = FreezeFrame_51eb4bef
        DemEventClass: DemEventSignificance=DEM_EVENT_SIGNIFICANCE_FAULT, DemAgingCycleRef=PowerCycle, DemOperationCycleRef=PowerCycle  # Diagnostics Data Import
          DemDebounceAlgorithmClass  # Diagnostics Data Import
            DemDebounceMonitorInternal  # Diagnostics Data Import
              DemCallbackGetFDC  # Diagnostics Data Import
      DtcClass_DTC_0xe40005 (DemDTCClass): DemUdsDTC=14942213, DemFunctionalGroupIdentifier=51, DemDTCAttributesRef=DtcAttributes_41914fb7  # Diagnostics Data Import
      DTC_0xe40004 (DemEventParameter):  # Diagnostics Data Import
        DemEventKind = DEM_EVENT_KIND_SWC
        DemDTCClassRef = DtcClass_DTC_0xe40004
        DemExtendedDataClassRef = ExtendedDataClass_4af7fffc
        DemFreezeFrameRecNumClassRef = /InitialEcuC/
        DemOBDFreezeFrameClassRef = FreezeFrame_51eb4bef
        DemEventClass: DemEventSignificance=DEM_EVENT_SIGNIFICANCE_FAULT, DemAgingCycleRef=PowerCycle, DemOperationCycleRef=PowerCycle  # Diagnostics Data Import
          DemDebounceAlgorithmClass  # Diagnostics Data Import
            DemDebounceMonitorInternal  # Diagnostics Data Import
              DemCallbackGetFDC  # Diagnostics Data Import
      DtcClass_DTC_0xe40004 (DemDTCClass): DemUdsDTC=14942212, DemFunctionalGroupIdentifier=51, DemDTCAttributesRef=DtcAttributes_41914fb7  # Diagnostics Data Import
      DTC_0xe40003 (DemEventParameter):  # Diagnostics Data Import
        DemEventKind = DEM_EVENT_KIND_SWC
        DemDTCClassRef = DtcClass_DTC_0xe40003
        DemExtendedDataClassRef = ExtendedDataClass_4af7fffc
        DemFreezeFrameRecNumClassRef = /InitialEcuC/
        DemOBDFreezeFrameClassRef = FreezeFrame_51eb4bef
        DemEventClass: DemEventSignificance=DEM_EVENT_SIGNIFICANCE_FAULT, DemAgingCycleRef=PowerCycle, DemOperationCycleRef=PowerCycle  # Diagnostics Data Import
          DemDebounceAlgorithmClass  # Diagnostics Data Import
            DemDebounceMonitorInternal  # Diagnostics Data Import
              DemCallbackGetFDC  # Diagnostics Data Import
      DtcClass_DTC_0xe40003 (DemDTCClass): DemUdsDTC=14942211, DemFunctionalGroupIdentifier=51, DemDTCAttributesRef=DtcAttributes_41914fb7  # Diagnostics Data Import
      DTC_0xe40002 (DemEventParameter):  # Diagnostics Data Import
        DemEventKind = DEM_EVENT_KIND_SWC
        DemDTCClassRef = DtcClass_DTC_0xe40002
        DemExtendedDataClassRef = ExtendedDataClass_4af7fffc
        DemFreezeFrameRecNumClassRef = /InitialEcuC/
        DemOBDFreezeFrameClassRef = FreezeFrame_51eb4bef
        DemEventClass: DemEventSignificance=DEM_EVENT_SIGNIFICANCE_FAULT, DemAgingCycleRef=PowerCycle, DemOperationCycleRef=PowerCycle  # Diagnostics Data Import
          DemDebounceAlgorithmClass  # Diagnostics Data Import
            DemDebounceMonitorInternal  # Diagnostics Data Import
              DemCallbackGetFDC  # Diagnostics Data Import
      DtcClass_DTC_0xe40002 (DemDTCClass): DemUdsDTC=14942210, DemFunctionalGroupIdentifier=51, DemDTCAttributesRef=DtcAttributes_41914fb7  # Diagnostics Data Import
      DTC_0xe40001 (DemEventParameter):  # Diagnostics Data Import
        DemEventKind = DEM_EVENT_KIND_SWC
        DemDTCClassRef = DtcClass_DTC_0xe40001
        DemExtendedDataClassRef = ExtendedDataClass_4af7fffc
        DemFreezeFrameRecNumClassRef = /InitialEcuC/
        DemOBDFreezeFrameClassRef = FreezeFrame_51eb4bef
        DemEventClass: DemEventSignificance=DEM_EVENT_SIGNIFICANCE_FAULT, DemAgingCycleRef=PowerCycle, DemOperationCycleRef=PowerCycle  # Diagnostics Data Import
          DemDebounceAlgorithmClass  # Diagnostics Data Import
            DemDebounceMonitorInternal  # Diagnostics Data Import
              DemCallbackGetFDC  # Diagnostics Data Import
      DtcClass_DTC_0xe40001 (DemDTCClass): DemUdsDTC=14942209, DemFunctionalGroupIdentifier=51, DemDTCAttributesRef=DtcAttributes_41914fb7  # Diagnostics Data Import
      DTC_0xe40000 (DemEventParameter):  # Diagnostics Data Import
        DemEventKind = DEM_EVENT_KIND_SWC
        DemDTCClassRef = DtcClass_DTC_0xe40000
        DemExtendedDataClassRef = ExtendedDataClass_4af7fffc
        DemFreezeFrameRecNumClassRef = /InitialEcuC/
        DemOBDFreezeFrameClassRef = FreezeFrame_51eb4bef
        DemEventClass: DemEventSignificance=DEM_EVENT_SIGNIFICANCE_FAULT, DemAgingCycleRef=PowerCycle, DemOperationCycleRef=PowerCycle  # Diagnostics Data Import
          DemDebounceAlgorithmClass  # Diagnostics Data Import
            DemDebounceMonitorInternal  # Diagnostics Data Import
              DemCallbackGetFDC  # Diagnostics Data Import
      DtcClass_DTC_0xe40000 (DemDTCClass): DemUdsDTC=14942208, DemFunctionalGroupIdentifier=51, DemDTCAttributesRef=DtcAttributes_41914fb7  # Diagnostics Data Import
      DTC_0xd40200 (DemEventParameter):  # Diagnostics Data Import
        DemEventKind = DEM_EVENT_KIND_SWC
        DemDTCClassRef = DtcClass_DTC_0xd40200
        DemExtendedDataClassRef = ExtendedDataClass_4af7fffc
        DemFreezeFrameRecNumClassRef = /InitialEcuC/
        DemOBDFreezeFrameClassRef = FreezeFrame_51eb4bef
        DemEventClass: DemEventSignificance=DEM_EVENT_SIGNIFICANCE_FAULT, DemAgingCycleRef=PowerCycle, DemOperationCycleRef=PowerCycle  # Diagnostics Data Import
          DemDebounceAlgorithmClass  # Diagnostics Data Import
            DemDebounceMonitorInternal  # Diagnostics Data Import
              DemCallbackGetFDC  # Diagnostics Data Import
      DtcClass_DTC_0xd40200 (DemDTCClass): DemUdsDTC=13894144, DemFunctionalGroupIdentifier=51, DemDTCAttributesRef=DtcAttributes_41914fb7  # Diagnostics Data Import
      DTC_0xd40100 (DemEventParameter):  # Diagnostics Data Import
        DemEventKind = DEM_EVENT_KIND_SWC
        DemDTCClassRef = DtcClass_DTC_0xd40100
        DemExtendedDataClassRef = ExtendedDataClass_4af7fffc
        DemFreezeFrameRecNumClassRef = /InitialEcuC/
        DemOBDFreezeFrameClassRef = FreezeFrame_51eb4bef
        DemEventClass: DemEventSignificance=DEM_EVENT_SIGNIFICANCE_FAULT, DemAgingCycleRef=PowerCycle, DemOperationCycleRef=PowerCycle  # Diagnostics Data Import
          DemDebounceAlgorithmClass  # Diagnostics Data Import
            DemDebounceMonitorInternal  # Diagnostics Data Import
              DemCallbackGetFDC  # Diagnostics Data Import
      DtcClass_DTC_0xd40100 (DemDTCClass): DemUdsDTC=13893888, DemFunctionalGroupIdentifier=51, DemDTCAttributesRef=DtcAttributes_41914fb7  # Diagnostics Data Import
      DTC_0xd13b51 (DemEventParameter):  # Diagnostics Data Import
        DemEventKind = DEM_EVENT_KIND_SWC
        DemDTCClassRef = DtcClass_DTC_0xd13b51
        DemExtendedDataClassRef = ExtendedDataClass_4af7fffc
        DemFreezeFrameRecNumClassRef = /InitialEcuC/
        DemOBDFreezeFrameClassRef = FreezeFrame_51eb4bef
        DemEventClass: DemEventSignificance=DEM_EVENT_SIGNIFICANCE_FAULT, DemAgingCycleRef=PowerCycle, DemOperationCycleRef=PowerCycle  # Diagnostics Data Import
          DemDebounceAlgorithmClass  # Diagnostics Data Import
            DemDebounceMonitorInternal  # Diagnostics Data Import
              DemCallbackGetFDC  # Diagnostics Data Import
      DtcClass_DTC_0xd13b51 (DemDTCClass): DemUdsDTC=13712209, DemFunctionalGroupIdentifier=51, DemDTCAttributesRef=DtcAttributes_41914fb7  # Diagnostics Data Import
      DTC_0xd13b50 (DemEventParameter):  # Diagnostics Data Import
        DemEventKind = DEM_EVENT_KIND_SWC
        DemDTCClassRef = DtcClass_DTC_0xd13b50
        DemExtendedDataClassRef = ExtendedDataClass_4af7fffc
        DemFreezeFrameRecNumClassRef = /InitialEcuC/
        DemOBDFreezeFrameClassRef = FreezeFrame_51eb4bef
        DemEventClass: DemEventSignificance=DEM_EVENT_SIGNIFICANCE_FAULT, DemAgingCycleRef=PowerCycle, DemOperationCycleRef=PowerCycle  # Diagnostics Data Import
          DemDebounceAlgorithmClass  # Diagnostics Data Import
            DemDebounceMonitorInternal  # Diagnostics Data Import
              DemCallbackGetFDC  # Diagnostics Data Import
      DtcClass_DTC_0xd13b50 (DemDTCClass): DemUdsDTC=13712208, DemFunctionalGroupIdentifier=51, DemDTCAttributesRef=DtcAttributes_41914fb7  # Diagnostics Data Import
      DTC_0xd1311f (DemEventParameter):  # Diagnostics Data Import
        DemEventKind = DEM_EVENT_KIND_SWC
        DemDTCClassRef = DtcClass_DTC_0xd1311f
        DemExtendedDataClassRef = ExtendedDataClass_4af7fffc
        DemFreezeFrameRecNumClassRef = /InitialEcuC/
        DemOBDFreezeFrameClassRef = FreezeFrame_51eb4bef
        DemEventClass: DemEventSignificance=DEM_EVENT_SIGNIFICANCE_FAULT, DemAgingCycleRef=PowerCycle, DemOperationCycleRef=PowerCycle  # Diagnostics Data Import
          DemDebounceAlgorithmClass  # Diagnostics Data Import
            DemDebounceMonitorInternal  # Diagnostics Data Import
              DemCallbackGetFDC  # Diagnostics Data Import
      DtcClass_DTC_0xd1311f (DemDTCClass): DemUdsDTC=13709599, DemFunctionalGroupIdentifier=51, DemDTCAttributesRef=DtcAttributes_41914fb7  # Diagnostics Data Import
      DTC_0xd1311d (DemEventParameter):  # Diagnostics Data Import
        DemEventKind = DEM_EVENT_KIND_SWC
        DemDTCClassRef = DtcClass_DTC_0xd1311d
        DemExtendedDataClassRef = ExtendedDataClass_4af7fffc
        DemFreezeFrameRecNumClassRef = /InitialEcuC/
        DemOBDFreezeFrameClassRef = FreezeFrame_51eb4bef
        DemEventClass: DemEventSignificance=DEM_EVENT_SIGNIFICANCE_FAULT, DemAgingCycleRef=PowerCycle, DemOperationCycleRef=PowerCycle  # Diagnostics Data Import
          DemDebounceAlgorithmClass  # Diagnostics Data Import
            DemDebounceMonitorInternal  # Diagnostics Data Import
              DemCallbackGetFDC  # Diagnostics Data Import
      DtcClass_DTC_0xd1311d (DemDTCClass): DemUdsDTC=13709597, DemFunctionalGroupIdentifier=51, DemDTCAttributesRef=DtcAttributes_41914fb7  # Diagnostics Data Import
      DTC_0xd13026 (DemEventParameter):  # Diagnostics Data Import
        DemEventKind = DEM_EVENT_KIND_SWC
        DemDTCClassRef = DtcClass_DTC_0xd13026
        DemExtendedDataClassRef = ExtendedDataClass_4af7fffc
        DemFreezeFrameRecNumClassRef = /InitialEcuC/
        DemOBDFreezeFrameClassRef = FreezeFrame_51eb4bef
        DemEventClass: DemEventSignificance=DEM_EVENT_SIGNIFICANCE_FAULT, DemAgingCycleRef=PowerCycle, DemOperationCycleRef=PowerCycle  # Diagnostics Data Import
          DemDebounceAlgorithmClass  # Diagnostics Data Import
            DemDebounceMonitorInternal  # Diagnostics Data Import
              DemCallbackGetFDC  # Diagnostics Data Import
      DtcClass_DTC_0xd13026 (DemDTCClass): DemUdsDTC=13709350, DemFunctionalGroupIdentifier=51, DemDTCAttributesRef=DtcAttributes_41914fb7  # Diagnostics Data Import
      DTC_0xd12c30 (DemEventParameter):  # Diagnostics Data Import
        DemEventKind = DEM_EVENT_KIND_SWC
        DemDTCClassRef = DtcClass_DTC_0xd12c30
        DemExtendedDataClassRef = ExtendedDataClass_4af7fffc
        DemFreezeFrameRecNumClassRef = /InitialEcuC/
        DemOBDFreezeFrameClassRef = FreezeFrame_51eb4bef
        DemEventClass: DemEventSignificance=DEM_EVENT_SIGNIFICANCE_FAULT, DemAgingCycleRef=PowerCycle, DemOperationCycleRef=PowerCycle  # Diagnostics Data Import
          DemDebounceAlgorithmClass  # Diagnostics Data Import
            DemDebounceMonitorInternal  # Diagnostics Data Import
              DemCallbackGetFDC  # Diagnostics Data Import
      DtcClass_DTC_0xd12c30 (DemDTCClass): DemUdsDTC=13708336, DemFunctionalGroupIdentifier=51, DemDTCAttributesRef=DtcAttributes_41914fb7  # Diagnostics Data Import
      DTC_0xd12c23 (DemEventParameter):  # Diagnostics Data Import
        DemEventKind = DEM_EVENT_KIND_SWC
        DemDTCClassRef = DtcClass_DTC_0xd12c23
        DemExtendedDataClassRef = ExtendedDataClass_4af7fffc
        DemFreezeFrameRecNumClassRef = /InitialEcuC/
        DemOBDFreezeFrameClassRef = FreezeFrame_51eb4bef
        DemEventClass: DemEventSignificance=DEM_EVENT_SIGNIFICANCE_FAULT, DemAgingCycleRef=PowerCycle, DemOperationCycleRef=PowerCycle  # Diagnostics Data Import
          DemDebounceAlgorithmClass  # Diagnostics Data Import
            DemDebounceMonitorInternal  # Diagnostics Data Import
              DemCallbackGetFDC  # Diagnostics Data Import
      DtcClass_DTC_0xd12c23 (DemDTCClass): DemUdsDTC=13708323, DemFunctionalGroupIdentifier=51, DemDTCAttributesRef=DtcAttributes_41914fb7  # Diagnostics Data Import
      DTC_0xd12c21 (DemEventParameter):  # Diagnostics Data Import
        DemEventKind = DEM_EVENT_KIND_SWC
        DemDTCClassRef = DtcClass_DTC_0xd12c21
        DemExtendedDataClassRef = ExtendedDataClass_4af7fffc
        DemFreezeFrameRecNumClassRef = /InitialEcuC/
        DemOBDFreezeFrameClassRef = FreezeFrame_51eb4bef
        DemEventClass: DemEventSignificance=DEM_EVENT_SIGNIFICANCE_FAULT, DemAgingCycleRef=PowerCycle, DemOperationCycleRef=PowerCycle  # Diagnostics Data Import
          DemDebounceAlgorithmClass  # Diagnostics Data Import
            DemDebounceMonitorInternal  # Diagnostics Data Import
              DemCallbackGetFDC  # Diagnostics Data Import
      DtcClass_DTC_0xd12c21 (DemDTCClass): DemUdsDTC=13708321, DemFunctionalGroupIdentifier=51, DemDTCAttributesRef=DtcAttributes_41914fb7  # Diagnostics Data Import
      DTC_0xd12c20 (DemEventParameter):  # Diagnostics Data Import
        DemEventKind = DEM_EVENT_KIND_SWC
        DemDTCClassRef = DtcClass_DTC_0xd12c20
        DemExtendedDataClassRef = ExtendedDataClass_4af7fffc
        DemFreezeFrameRecNumClassRef = /InitialEcuC/
        DemOBDFreezeFrameClassRef = FreezeFrame_51eb4bef
        DemEventClass: DemEventSignificance=DEM_EVENT_SIGNIFICANCE_FAULT, DemAgingCycleRef=PowerCycle, DemOperationCycleRef=PowerCycle  # Diagnostics Data Import
          DemDebounceAlgorithmClass  # Diagnostics Data Import
            DemDebounceMonitorInternal  # Diagnostics Data Import
              DemCallbackGetFDC  # Diagnostics Data Import
      DtcClass_DTC_0xd12c20 (DemDTCClass): DemUdsDTC=13708320, DemFunctionalGroupIdentifier=51, DemDTCAttributesRef=DtcAttributes_41914fb7  # Diagnostics Data Import
      DTC_0xd12c18 (DemEventParameter):  # Diagnostics Data Import
        DemEventKind = DEM_EVENT_KIND_SWC
        DemDTCClassRef = DtcClass_DTC_0xd12c18
        DemExtendedDataClassRef = ExtendedDataClass_4af7fffc
        DemFreezeFrameRecNumClassRef = /InitialEcuC/
        DemOBDFreezeFrameClassRef = FreezeFrame_51eb4bef
        DemEventClass: DemEventSignificance=DEM_EVENT_SIGNIFICANCE_FAULT, DemAgingCycleRef=PowerCycle, DemOperationCycleRef=PowerCycle  # Diagnostics Data Import
          DemDebounceAlgorithmClass  # Diagnostics Data Import
            DemDebounceMonitorInternal  # Diagnostics Data Import
              DemCallbackGetFDC  # Diagnostics Data Import
      DtcClass_DTC_0xd12c18 (DemDTCClass): DemUdsDTC=13708312, DemFunctionalGroupIdentifier=51, DemDTCAttributesRef=DtcAttributes_41914fb7  # Diagnostics Data Import
      DTC_0xd12c17 (DemEventParameter):  # Diagnostics Data Import
        DemEventKind = DEM_EVENT_KIND_SWC
        DemDTCClassRef = DtcClass_DTC_0xd12c17
        DemExtendedDataClassRef = ExtendedDataClass_4af7fffc
        DemFreezeFrameRecNumClassRef = /InitialEcuC/
        DemOBDFreezeFrameClassRef = FreezeFrame_51eb4bef
        DemEventClass: DemEventSignificance=DEM_EVENT_SIGNIFICANCE_FAULT, DemAgingCycleRef=PowerCycle, DemOperationCycleRef=PowerCycle  # Diagnostics Data Import
          DemDebounceAlgorithmClass  # Diagnostics Data Import
            DemDebounceMonitorInternal  # Diagnostics Data Import
              DemCallbackGetFDC  # Diagnostics Data Import
      DtcClass_DTC_0xd12c17 (DemDTCClass): DemUdsDTC=13708311, DemFunctionalGroupIdentifier=51, DemDTCAttributesRef=DtcAttributes_41914fb7  # Diagnostics Data Import
      DTC_0xd12c16 (DemEventParameter):  # Diagnostics Data Import
        DemEventKind = DEM_EVENT_KIND_SWC
        DemDTCClassRef = DtcClass_DTC_0xd12c16
        DemExtendedDataClassRef = ExtendedDataClass_4af7fffc
        DemFreezeFrameRecNumClassRef = /InitialEcuC/
        DemOBDFreezeFrameClassRef = FreezeFrame_51eb4bef
        DemEventClass: DemEventSignificance=DEM_EVENT_SIGNIFICANCE_FAULT, DemAgingCycleRef=PowerCycle, DemOperationCycleRef=PowerCycle  # Diagnostics Data Import
          DemDebounceAlgorithmClass  # Diagnostics Data Import
            DemDebounceMonitorInternal  # Diagnostics Data Import
              DemCallbackGetFDC  # Diagnostics Data Import
      DtcClass_DTC_0xd12c16 (DemDTCClass): DemUdsDTC=13708310, DemFunctionalGroupIdentifier=51, DemDTCAttributesRef=DtcAttributes_41914fb7  # Diagnostics Data Import
      DTC_0xd12c14 (DemEventParameter):  # Diagnostics Data Import
        DemEventKind = DEM_EVENT_KIND_SWC
        DemDTCClassRef = DtcClass_DTC_0xd12c14
        DemExtendedDataClassRef = ExtendedDataClass_4af7fffc
        DemFreezeFrameRecNumClassRef = /InitialEcuC/
        DemOBDFreezeFrameClassRef = FreezeFrame_51eb4bef
        DemEventClass: DemEventSignificance=DEM_EVENT_SIGNIFICANCE_FAULT, DemAgingCycleRef=PowerCycle, DemOperationCycleRef=PowerCycle  # Diagnostics Data Import
          DemDebounceAlgorithmClass  # Diagnostics Data Import
            DemDebounceMonitorInternal  # Diagnostics Data Import
              DemCallbackGetFDC  # Diagnostics Data Import
      DtcClass_DTC_0xd12c14 (DemDTCClass): DemUdsDTC=13708308, DemFunctionalGroupIdentifier=51, DemDTCAttributesRef=DtcAttributes_41914fb7  # Diagnostics Data Import
      DTC_0xd12c08 (DemEventParameter):  # Diagnostics Data Import
        DemEventKind = DEM_EVENT_KIND_SWC
        DemDTCClassRef = DtcClass_DTC_0xd12c08
        DemExtendedDataClassRef = ExtendedDataClass_4af7fffc
        DemFreezeFrameRecNumClassRef = /InitialEcuC/
        DemOBDFreezeFrameClassRef = FreezeFrame_51eb4bef
        DemEventClass: DemEventSignificance=DEM_EVENT_SIGNIFICANCE_FAULT, DemAgingCycleRef=PowerCycle, DemOperationCycleRef=PowerCycle  # Diagnostics Data Import
          DemDebounceAlgorithmClass  # Diagnostics Data Import
            DemDebounceMonitorInternal  # Diagnostics Data Import
              DemCallbackGetFDC  # Diagnostics Data Import
      DtcClass_DTC_0xd12c08 (DemDTCClass): DemUdsDTC=13708296, DemFunctionalGroupIdentifier=51, DemDTCAttributesRef=DtcAttributes_41914fb7  # Diagnostics Data Import
      DTC_0xd12c01 (DemEventParameter):  # Diagnostics Data Import
        DemEventKind = DEM_EVENT_KIND_SWC
        DemDTCClassRef = DtcClass_DTC_0xd12c01
        DemExtendedDataClassRef = ExtendedDataClass_4af7fffc
        DemFreezeFrameRecNumClassRef = /InitialEcuC/
        DemOBDFreezeFrameClassRef = FreezeFrame_51eb4bef
        DemEventClass: DemEventSignificance=DEM_EVENT_SIGNIFICANCE_FAULT, DemAgingCycleRef=PowerCycle, DemOperationCycleRef=PowerCycle  # Diagnostics Data Import
          DemDebounceAlgorithmClass  # Diagnostics Data Import
            DemDebounceMonitorInternal  # Diagnostics Data Import
              DemCallbackGetFDC  # Diagnostics Data Import
      DtcClass_DTC_0xd12c01 (DemDTCClass): DemUdsDTC=13708289, DemFunctionalGroupIdentifier=51, DemDTCAttributesRef=DtcAttributes_41914fb7  # Diagnostics Data Import
      DTC_0xd12c00 (DemEventParameter):  # Diagnostics Data Import
        DemEventKind = DEM_EVENT_KIND_SWC
        DemDTCClassRef = DtcClass_DTC_0xd12c00
        DemExtendedDataClassRef = ExtendedDataClass_4af7fffc
        DemFreezeFrameRecNumClassRef = /InitialEcuC/
        DemOBDFreezeFrameClassRef = FreezeFrame_51eb4bef
        DemEventClass: DemEventSignificance=DEM_EVENT_SIGNIFICANCE_FAULT, DemAgingCycleRef=PowerCycle, DemOperationCycleRef=PowerCycle  # Diagnostics Data Import
          DemDebounceAlgorithmClass  # Diagnostics Data Import
            DemDebounceMonitorInternal  # Diagnostics Data Import
              DemCallbackGetFDC  # Diagnostics Data Import
      DtcClass_DTC_0xd12c00 (DemDTCClass): DemUdsDTC=13708288, DemFunctionalGroupIdentifier=51, DemDTCAttributesRef=DtcAttributes_41914fb7  # Diagnostics Data Import
      DTC_0xd12161 (DemEventParameter):  # Diagnostics Data Import
        DemEventKind = DEM_EVENT_KIND_SWC
        DemDTCClassRef = DtcClass_DTC_0xd12161
        DemExtendedDataClassRef = ExtendedDataClass_4af7fffc
        DemFreezeFrameRecNumClassRef = /InitialEcuC/
        DemOBDFreezeFrameClassRef = FreezeFrame_51eb4bef
        DemEventClass: DemEventSignificance=DEM_EVENT_SIGNIFICANCE_FAULT, DemAgingCycleRef=PowerCycle, DemOperationCycleRef=PowerCycle  # Diagnostics Data Import
          DemDebounceAlgorithmClass  # Diagnostics Data Import
            DemDebounceMonitorInternal  # Diagnostics Data Import
              DemCallbackGetFDC  # Diagnostics Data Import
      DtcClass_DTC_0xd12161 (DemDTCClass): DemUdsDTC=13705569, DemFunctionalGroupIdentifier=51, DemDTCAttributesRef=DtcAttributes_41914fb7  # Diagnostics Data Import
      DTC_0xd12160 (DemEventParameter):  # Diagnostics Data Import
        DemEventKind = DEM_EVENT_KIND_SWC
        DemDTCClassRef = DtcClass_DTC_0xd12160
        DemExtendedDataClassRef = ExtendedDataClass_4af7fffc
        DemFreezeFrameRecNumClassRef = /InitialEcuC/
        DemOBDFreezeFrameClassRef = FreezeFrame_51eb4bef
        DemEventClass: DemEventSignificance=DEM_EVENT_SIGNIFICANCE_FAULT, DemAgingCycleRef=PowerCycle, DemOperationCycleRef=PowerCycle  # Diagnostics Data Import
          DemDebounceAlgorithmClass  # Diagnostics Data Import
            DemDebounceMonitorInternal  # Diagnostics Data Import
              DemCallbackGetFDC  # Diagnostics Data Import
      DtcClass_DTC_0xd12160 (DemDTCClass): DemUdsDTC=13705568, DemFunctionalGroupIdentifier=51, DemDTCAttributesRef=DtcAttributes_41914fb7  # Diagnostics Data Import
      DTC_0xd12159 (DemEventParameter):  # Diagnostics Data Import
        DemEventKind = DEM_EVENT_KIND_SWC
        DemDTCClassRef = DtcClass_DTC_0xd12159
        DemExtendedDataClassRef = ExtendedDataClass_4af7fffc
        DemFreezeFrameRecNumClassRef = /InitialEcuC/
        DemOBDFreezeFrameClassRef = FreezeFrame_51eb4bef
        DemEventClass: DemEventSignificance=DEM_EVENT_SIGNIFICANCE_FAULT, DemAgingCycleRef=PowerCycle, DemOperationCycleRef=PowerCycle  # Diagnostics Data Import
          DemDebounceAlgorithmClass  # Diagnostics Data Import
            DemDebounceMonitorInternal  # Diagnostics Data Import
              DemCallbackGetFDC  # Diagnostics Data Import
      DtcClass_DTC_0xd12159 (DemDTCClass): DemUdsDTC=13705561, DemFunctionalGroupIdentifier=51, DemDTCAttributesRef=DtcAttributes_41914fb7  # Diagnostics Data Import
      DTC_0xd1211d (DemEventParameter):  # Diagnostics Data Import
        DemEventKind = DEM_EVENT_KIND_SWC
        DemDTCClassRef = DtcClass_DTC_0xd1211d
        DemExtendedDataClassRef = ExtendedDataClass_4af7fffc
        DemFreezeFrameRecNumClassRef = /InitialEcuC/
        DemOBDFreezeFrameClassRef = FreezeFrame_51eb4bef
        DemEventClass: DemEventSignificance=DEM_EVENT_SIGNIFICANCE_FAULT, DemAgingCycleRef=PowerCycle, DemOperationCycleRef=PowerCycle  # Diagnostics Data Import
          DemDebounceAlgorithmClass  # Diagnostics Data Import
            DemDebounceMonitorInternal  # Diagnostics Data Import
              DemCallbackGetFDC  # Diagnostics Data Import
      DtcClass_DTC_0xd1211d (DemDTCClass): DemUdsDTC=13705501, DemFunctionalGroupIdentifier=51, DemDTCAttributesRef=DtcAttributes_41914fb7  # Diagnostics Data Import
      DTC_0xd12119 (DemEventParameter):  # Diagnostics Data Import
        DemEventKind = DEM_EVENT_KIND_SWC
        DemDTCClassRef = DtcClass_DTC_0xd12119
        DemExtendedDataClassRef = ExtendedDataClass_4af7fffc
        DemFreezeFrameRecNumClassRef = /InitialEcuC/
        DemOBDFreezeFrameClassRef = FreezeFrame_51eb4bef
        DemEventClass: DemEventSignificance=DEM_EVENT_SIGNIFICANCE_FAULT, DemAgingCycleRef=PowerCycle, DemOperationCycleRef=PowerCycle  # Diagnostics Data Import
          DemDebounceAlgorithmClass  # Diagnostics Data Import
            DemDebounceMonitorInternal  # Diagnostics Data Import
              DemCallbackGetFDC  # Diagnostics Data Import
      DtcClass_DTC_0xd12119 (DemDTCClass): DemUdsDTC=13705497, DemFunctionalGroupIdentifier=51, DemDTCAttributesRef=DtcAttributes_41914fb7  # Diagnostics Data Import
      DTC_0xd12118 (DemEventParameter):  # Diagnostics Data Import
        DemEventKind = DEM_EVENT_KIND_SWC
        DemDTCClassRef = DtcClass_DTC_0xd12118
        DemExtendedDataClassRef = ExtendedDataClass_4af7fffc
        DemFreezeFrameRecNumClassRef = /InitialEcuC/
        DemOBDFreezeFrameClassRef = FreezeFrame_51eb4bef
        DemEventClass: DemEventSignificance=DEM_EVENT_SIGNIFICANCE_FAULT, DemAgingCycleRef=PowerCycle, DemOperationCycleRef=PowerCycle  # Diagnostics Data Import
          DemDebounceAlgorithmClass  # Diagnostics Data Import
            DemDebounceMonitorInternal  # Diagnostics Data Import
              DemCallbackGetFDC  # Diagnostics Data Import
      DtcClass_DTC_0xd12118 (DemDTCClass): DemUdsDTC=13705496, DemFunctionalGroupIdentifier=51, DemDTCAttributesRef=DtcAttributes_41914fb7  # Diagnostics Data Import
      DTC_0xd12117 (DemEventParameter):  # Diagnostics Data Import
        DemEventKind = DEM_EVENT_KIND_SWC
        DemDTCClassRef = DtcClass_DTC_0xd12117
        DemExtendedDataClassRef = ExtendedDataClass_4af7fffc
        DemFreezeFrameRecNumClassRef = /InitialEcuC/
        DemOBDFreezeFrameClassRef = FreezeFrame_51eb4bef
        DemEventClass: DemEventSignificance=DEM_EVENT_SIGNIFICANCE_FAULT, DemAgingCycleRef=PowerCycle, DemOperationCycleRef=PowerCycle  # Diagnostics Data Import
          DemDebounceAlgorithmClass  # Diagnostics Data Import
            DemDebounceMonitorInternal  # Diagnostics Data Import
              DemCallbackGetFDC  # Diagnostics Data Import
      DtcClass_DTC_0xd12117 (DemDTCClass): DemUdsDTC=13705495, DemFunctionalGroupIdentifier=51, DemDTCAttributesRef=DtcAttributes_41914fb7  # Diagnostics Data Import
      DTC_0xd12116 (DemEventParameter):  # Diagnostics Data Import
        DemEventKind = DEM_EVENT_KIND_SWC
        DemDTCClassRef = DtcClass_DTC_0xd12116
        DemExtendedDataClassRef = ExtendedDataClass_4af7fffc
        DemFreezeFrameRecNumClassRef = /InitialEcuC/
        DemOBDFreezeFrameClassRef = FreezeFrame_51eb4bef
        DemEventClass: DemEventSignificance=DEM_EVENT_SIGNIFICANCE_FAULT, DemAgingCycleRef=PowerCycle, DemOperationCycleRef=PowerCycle  # Diagnostics Data Import
          DemDebounceAlgorithmClass  # Diagnostics Data Import
            DemDebounceMonitorInternal  # Diagnostics Data Import
              DemCallbackGetFDC  # Diagnostics Data Import
      DtcClass_DTC_0xd12116 (DemDTCClass): DemUdsDTC=13705494, DemFunctionalGroupIdentifier=51, DemDTCAttributesRef=DtcAttributes_41914fb7  # Diagnostics Data Import
      DTC_0xd12115 (DemEventParameter):  # Diagnostics Data Import
        DemEventKind = DEM_EVENT_KIND_SWC
        DemDTCClassRef = DtcClass_DTC_0xd12115
        DemExtendedDataClassRef = ExtendedDataClass_4af7fffc
        DemFreezeFrameRecNumClassRef = /InitialEcuC/
        DemOBDFreezeFrameClassRef = FreezeFrame_51eb4bef
        DemEventClass: DemEventSignificance=DEM_EVENT_SIGNIFICANCE_FAULT, DemAgingCycleRef=PowerCycle, DemOperationCycleRef=PowerCycle  # Diagnostics Data Import
          DemDebounceAlgorithmClass  # Diagnostics Data Import
            DemDebounceMonitorInternal  # Diagnostics Data Import
              DemCallbackGetFDC  # Diagnostics Data Import
      DtcClass_DTC_0xd12115 (DemDTCClass): DemUdsDTC=13705493, DemFunctionalGroupIdentifier=51, DemDTCAttributesRef=DtcAttributes_41914fb7  # Diagnostics Data Import
      DTC_0xd12114 (DemEventParameter):  # Diagnostics Data Import
        DemEventKind = DEM_EVENT_KIND_SWC
        DemDTCClassRef = DtcClass_DTC_0xd12114
        DemExtendedDataClassRef = ExtendedDataClass_4af7fffc
        DemFreezeFrameRecNumClassRef = /InitialEcuC/
        DemOBDFreezeFrameClassRef = FreezeFrame_51eb4bef
        DemEventClass: DemEventSignificance=DEM_EVENT_SIGNIFICANCE_FAULT, DemAgingCycleRef=PowerCycle, DemOperationCycleRef=PowerCycle  # Diagnostics Data Import
          DemDebounceAlgorithmClass  # Diagnostics Data Import
            DemDebounceMonitorInternal  # Diagnostics Data Import
              DemCallbackGetFDC  # Diagnostics Data Import
      DtcClass_DTC_0xd12114 (DemDTCClass): DemUdsDTC=13705492, DemFunctionalGroupIdentifier=51, DemDTCAttributesRef=DtcAttributes_41914fb7  # Diagnostics Data Import
      DTC_0xd12112 (DemEventParameter):  # Diagnostics Data Import
        DemEventKind = DEM_EVENT_KIND_SWC
        DemDTCClassRef = DtcClass_DTC_0xd12112
        DemExtendedDataClassRef = ExtendedDataClass_4af7fffc
        DemFreezeFrameRecNumClassRef = /InitialEcuC/
        DemOBDFreezeFrameClassRef = FreezeFrame_51eb4bef
        DemEventClass: DemEventSignificance=DEM_EVENT_SIGNIFICANCE_FAULT, DemAgingCycleRef=PowerCycle, DemOperationCycleRef=PowerCycle  # Diagnostics Data Import
          DemDebounceAlgorithmClass  # Diagnostics Data Import
            DemDebounceMonitorInternal  # Diagnostics Data Import
              DemCallbackGetFDC  # Diagnostics Data Import
      DtcClass_DTC_0xd12112 (DemDTCClass): DemUdsDTC=13705490, DemFunctionalGroupIdentifier=51, DemDTCAttributesRef=DtcAttributes_41914fb7  # Diagnostics Data Import
      DTC_0xd1210f (DemEventParameter):  # Diagnostics Data Import
        DemEventKind = DEM_EVENT_KIND_SWC
        DemDTCClassRef = DtcClass_DTC_0xd1210f
        DemExtendedDataClassRef = ExtendedDataClass_4af7fffc
        DemFreezeFrameRecNumClassRef = /InitialEcuC/
        DemOBDFreezeFrameClassRef = FreezeFrame_51eb4bef
        DemEventClass: DemEventSignificance=DEM_EVENT_SIGNIFICANCE_FAULT, DemAgingCycleRef=PowerCycle, DemOperationCycleRef=PowerCycle  # Diagnostics Data Import
          DemDebounceAlgorithmClass  # Diagnostics Data Import
            DemDebounceMonitorInternal  # Diagnostics Data Import
              DemCallbackGetFDC  # Diagnostics Data Import
      DtcClass_DTC_0xd1210f (DemDTCClass): DemUdsDTC=13705487, DemFunctionalGroupIdentifier=51, DemDTCAttributesRef=DtcAttributes_41914fb7  # Diagnostics Data Import
      DTC_0xd1210e (DemEventParameter):  # Diagnostics Data Import
        DemEventKind = DEM_EVENT_KIND_SWC
        DemDTCClassRef = DtcClass_DTC_0xd1210e
        DemExtendedDataClassRef = ExtendedDataClass_4af7fffc
        DemFreezeFrameRecNumClassRef = /InitialEcuC/
        DemOBDFreezeFrameClassRef = FreezeFrame_51eb4bef
        DemEventClass: DemEventSignificance=DEM_EVENT_SIGNIFICANCE_FAULT, DemAgingCycleRef=PowerCycle, DemOperationCycleRef=PowerCycle  # Diagnostics Data Import
          DemDebounceAlgorithmClass  # Diagnostics Data Import
            DemDebounceMonitorInternal  # Diagnostics Data Import
              DemCallbackGetFDC  # Diagnostics Data Import
      DtcClass_DTC_0xd1210e (DemDTCClass): DemUdsDTC=13705486, DemFunctionalGroupIdentifier=51, DemDTCAttributesRef=DtcAttributes_41914fb7  # Diagnostics Data Import
      DTC_0xd1210d (DemEventParameter):  # Diagnostics Data Import
        DemEventKind = DEM_EVENT_KIND_SWC
        DemDTCClassRef = DtcClass_DTC_0xd1210d
        DemExtendedDataClassRef = ExtendedDataClass_4af7fffc
        DemFreezeFrameRecNumClassRef = /InitialEcuC/
        DemOBDFreezeFrameClassRef = FreezeFrame_51eb4bef
        DemEventClass: DemEventSignificance=DEM_EVENT_SIGNIFICANCE_FAULT, DemAgingCycleRef=PowerCycle, DemOperationCycleRef=PowerCycle  # Diagnostics Data Import
          DemDebounceAlgorithmClass  # Diagnostics Data Import
            DemDebounceMonitorInternal  # Diagnostics Data Import
              DemCallbackGetFDC  # Diagnostics Data Import
      DtcClass_DTC_0xd1210d (DemDTCClass): DemUdsDTC=13705485, DemFunctionalGroupIdentifier=51, DemDTCAttributesRef=DtcAttributes_41914fb7  # Diagnostics Data Import
      DTC_0xd1210c (DemEventParameter):  # Diagnostics Data Import
        DemEventKind = DEM_EVENT_KIND_SWC
        DemDTCClassRef = DtcClass_DTC_0xd1210c
        DemExtendedDataClassRef = ExtendedDataClass_4af7fffc
        DemFreezeFrameRecNumClassRef = /InitialEcuC/
        DemOBDFreezeFrameClassRef = FreezeFrame_51eb4bef
        DemEventClass: DemEventSignificance=DEM_EVENT_SIGNIFICANCE_FAULT, DemAgingCycleRef=PowerCycle, DemOperationCycleRef=PowerCycle  # Diagnostics Data Import
          DemDebounceAlgorithmClass  # Diagnostics Data Import
            DemDebounceMonitorInternal  # Diagnostics Data Import
              DemCallbackGetFDC  # Diagnostics Data Import
      DtcClass_DTC_0xd1210c (DemDTCClass): DemUdsDTC=13705484, DemFunctionalGroupIdentifier=51, DemDTCAttributesRef=DtcAttributes_41914fb7  # Diagnostics Data Import
      DTC_0xd1210b (DemEventParameter):  # Diagnostics Data Import
        DemEventKind = DEM_EVENT_KIND_SWC
        DemDTCClassRef = DtcClass_DTC_0xd1210b
        DemExtendedDataClassRef = ExtendedDataClass_4af7fffc
        DemFreezeFrameRecNumClassRef = /InitialEcuC/
        DemOBDFreezeFrameClassRef = FreezeFrame_51eb4bef
        DemEventClass: DemEventSignificance=DEM_EVENT_SIGNIFICANCE_FAULT, DemAgingCycleRef=PowerCycle, DemOperationCycleRef=PowerCycle  # Diagnostics Data Import
          DemDebounceAlgorithmClass  # Diagnostics Data Import
            DemDebounceMonitorInternal  # Diagnostics Data Import
              DemCallbackGetFDC  # Diagnostics Data Import
      DtcClass_DTC_0xd1210b (DemDTCClass): DemUdsDTC=13705483, DemFunctionalGroupIdentifier=51, DemDTCAttributesRef=DtcAttributes_41914fb7  # Diagnostics Data Import
      DTC_0xd12103 (DemEventParameter):  # Diagnostics Data Import
        DemEventKind = DEM_EVENT_KIND_SWC
        DemDTCClassRef = DtcClass_DTC_0xd12103
        DemExtendedDataClassRef = ExtendedDataClass_4af7fffc
        DemFreezeFrameRecNumClassRef = /InitialEcuC/
        DemOBDFreezeFrameClassRef = FreezeFrame_51eb4bef
        DemEventClass: DemEventSignificance=DEM_EVENT_SIGNIFICANCE_FAULT, DemAgingCycleRef=PowerCycle, DemOperationCycleRef=PowerCycle  # Diagnostics Data Import
          DemDebounceAlgorithmClass  # Diagnostics Data Import
            DemDebounceMonitorInternal  # Diagnostics Data Import
              DemCallbackGetFDC  # Diagnostics Data Import
      DtcClass_DTC_0xd12103 (DemDTCClass): DemUdsDTC=13705475, DemFunctionalGroupIdentifier=51, DemDTCAttributesRef=DtcAttributes_41914fb7  # Diagnostics Data Import
      DTC_0xd12102 (DemEventParameter):  # Diagnostics Data Import
        DemEventKind = DEM_EVENT_KIND_SWC
        DemDTCClassRef = DtcClass_DTC_0xd12102
        DemExtendedDataClassRef = ExtendedDataClass_4af7fffc
        DemFreezeFrameRecNumClassRef = /InitialEcuC/
        DemOBDFreezeFrameClassRef = FreezeFrame_51eb4bef
        DemEventClass: DemEventSignificance=DEM_EVENT_SIGNIFICANCE_FAULT, DemAgingCycleRef=PowerCycle, DemOperationCycleRef=PowerCycle  # Diagnostics Data Import
          DemDebounceAlgorithmClass  # Diagnostics Data Import
            DemDebounceMonitorInternal  # Diagnostics Data Import
              DemCallbackGetFDC  # Diagnostics Data Import
      DtcClass_DTC_0xd12102 (DemDTCClass): DemUdsDTC=13705474, DemFunctionalGroupIdentifier=51, DemDTCAttributesRef=DtcAttributes_41914fb7  # Diagnostics Data Import
      DTC_0xd12101 (DemEventParameter):  # Diagnostics Data Import
        DemEventKind = DEM_EVENT_KIND_SWC
        DemDTCClassRef = DtcClass_DTC_0xd12101
        DemExtendedDataClassRef = ExtendedDataClass_4af7fffc
        DemFreezeFrameRecNumClassRef = /InitialEcuC/
        DemOBDFreezeFrameClassRef = FreezeFrame_51eb4bef
        DemEventClass: DemEventSignificance=DEM_EVENT_SIGNIFICANCE_FAULT, DemAgingCycleRef=PowerCycle, DemOperationCycleRef=PowerCycle  # Diagnostics Data Import
          DemDebounceAlgorithmClass  # Diagnostics Data Import
            DemDebounceMonitorInternal  # Diagnostics Data Import
              DemCallbackGetFDC  # Diagnostics Data Import
      DtcClass_DTC_0xd12101 (DemDTCClass): DemUdsDTC=13705473, DemFunctionalGroupIdentifier=51, DemDTCAttributesRef=DtcAttributes_41914fb7  # Diagnostics Data Import
      DTC_0xd12026 (DemEventParameter):  # Diagnostics Data Import
        DemEventKind = DEM_EVENT_KIND_SWC
        DemDTCClassRef = DtcClass_DTC_0xd12026
        DemExtendedDataClassRef = ExtendedDataClass_4af7fffc
        DemFreezeFrameRecNumClassRef = /InitialEcuC/
        DemOBDFreezeFrameClassRef = FreezeFrame_51eb4bef
        DemEventClass: DemEventSignificance=DEM_EVENT_SIGNIFICANCE_FAULT, DemAgingCycleRef=PowerCycle, DemOperationCycleRef=PowerCycle  # Diagnostics Data Import
          DemDebounceAlgorithmClass  # Diagnostics Data Import
            DemDebounceMonitorInternal  # Diagnostics Data Import
              DemCallbackGetFDC  # Diagnostics Data Import
      DtcClass_DTC_0xd12026 (DemDTCClass): DemUdsDTC=13705254, DemFunctionalGroupIdentifier=51, DemDTCAttributesRef=DtcAttributes_41914fb7  # Diagnostics Data Import
      DTC_0xd12025 (DemEventParameter):  # Diagnostics Data Import
        DemEventKind = DEM_EVENT_KIND_SWC
        DemDTCClassRef = DtcClass_DTC_0xd12025
        DemExtendedDataClassRef = ExtendedDataClass_4af7fffc
        DemFreezeFrameRecNumClassRef = /InitialEcuC/
        DemOBDFreezeFrameClassRef = FreezeFrame_51eb4bef
        DemEventClass: DemEventSignificance=DEM_EVENT_SIGNIFICANCE_FAULT, DemAgingCycleRef=PowerCycle, DemOperationCycleRef=PowerCycle  # Diagnostics Data Import
          DemDebounceAlgorithmClass  # Diagnostics Data Import
            DemDebounceMonitorInternal  # Diagnostics Data Import
              DemCallbackGetFDC  # Diagnostics Data Import
      DtcClass_DTC_0xd12025 (DemDTCClass): DemUdsDTC=13705253, DemFunctionalGroupIdentifier=51, DemDTCAttributesRef=DtcAttributes_41914fb7  # Diagnostics Data Import
      DTC_0xd12011 (DemEventParameter):  # Diagnostics Data Import
        DemEventKind = DEM_EVENT_KIND_SWC
        DemDTCClassRef = DtcClass_DTC_0xd12011
        DemExtendedDataClassRef = ExtendedDataClass_4af7fffc
        DemFreezeFrameRecNumClassRef = /InitialEcuC/
        DemOBDFreezeFrameClassRef = FreezeFrame_51eb4bef
        DemEventClass: DemEventSignificance=DEM_EVENT_SIGNIFICANCE_FAULT, DemAgingCycleRef=PowerCycle, DemOperationCycleRef=PowerCycle  # Diagnostics Data Import
          DemDebounceAlgorithmClass  # Diagnostics Data Import
            DemDebounceMonitorInternal  # Diagnostics Data Import
              DemCallbackGetFDC  # Diagnostics Data Import
      DtcClass_DTC_0xd12011 (DemDTCClass): DemUdsDTC=13705233, DemFunctionalGroupIdentifier=51, DemDTCAttributesRef=DtcAttributes_41914fb7  # Diagnostics Data Import
      DTC_0xd12004 (DemEventParameter):  # Diagnostics Data Import
        DemEventKind = DEM_EVENT_KIND_SWC
        DemDTCClassRef = DtcClass_DTC_0xd12004
        DemExtendedDataClassRef = ExtendedDataClass_4af7fffc
        DemFreezeFrameRecNumClassRef = /InitialEcuC/
        DemOBDFreezeFrameClassRef = FreezeFrame_51eb4bef
        DemEventClass: DemEventSignificance=DEM_EVENT_SIGNIFICANCE_FAULT, DemAgingCycleRef=PowerCycle, DemOperationCycleRef=PowerCycle  # Diagnostics Data Import
          DemDebounceAlgorithmClass  # Diagnostics Data Import
            DemDebounceMonitorInternal  # Diagnostics Data Import
              DemCallbackGetFDC  # Diagnostics Data Import
      DtcClass_DTC_0xd12004 (DemDTCClass): DemUdsDTC=13705220, DemFunctionalGroupIdentifier=51, DemDTCAttributesRef=DtcAttributes_41914fb7  # Diagnostics Data Import
      DTC_0xd12002 (DemEventParameter):  # Diagnostics Data Import
        DemEventKind = DEM_EVENT_KIND_SWC
        DemDTCClassRef = DtcClass_DTC_0xd12002
        DemExtendedDataClassRef = ExtendedDataClass_4af7fffc
        DemFreezeFrameRecNumClassRef = /InitialEcuC/
        DemOBDFreezeFrameClassRef = FreezeFrame_51eb4bef
        DemEventClass: DemEventSignificance=DEM_EVENT_SIGNIFICANCE_FAULT, DemAgingCycleRef=PowerCycle, DemOperationCycleRef=PowerCycle  # Diagnostics Data Import
          DemDebounceAlgorithmClass  # Diagnostics Data Import
            DemDebounceMonitorInternal  # Diagnostics Data Import
              DemCallbackGetFDC  # Diagnostics Data Import
      DtcClass_DTC_0xd12002 (DemDTCClass): DemUdsDTC=13705218, DemFunctionalGroupIdentifier=51, DemDTCAttributesRef=DtcAttributes_41914fb7  # Diagnostics Data Import
      DTC_0xd12001 (DemEventParameter):  # Diagnostics Data Import
        DemEventKind = DEM_EVENT_KIND_SWC
        DemDTCClassRef = DtcClass_DTC_0xd12001
        DemExtendedDataClassRef = ExtendedDataClass_4af7fffc
        DemFreezeFrameRecNumClassRef = /InitialEcuC/
        DemOBDFreezeFrameClassRef = FreezeFrame_51eb4bef
        DemEventClass: DemEventSignificance=DEM_EVENT_SIGNIFICANCE_FAULT, DemAgingCycleRef=PowerCycle, DemOperationCycleRef=PowerCycle  # Diagnostics Data Import
          DemDebounceAlgorithmClass  # Diagnostics Data Import
            DemDebounceMonitorInternal  # Diagnostics Data Import
              DemCallbackGetFDC  # Diagnostics Data Import
      DtcClass_DTC_0xd12001 (DemDTCClass): DemUdsDTC=13705217, DemFunctionalGroupIdentifier=51, DemDTCAttributesRef=DtcAttributes_41914fb7  # Diagnostics Data Import
      DTC_0xd12000 (DemEventParameter):  # Diagnostics Data Import
        DemEventKind = DEM_EVENT_KIND_SWC
        DemDTCClassRef = DtcClass_DTC_0xd12000
        DemExtendedDataClassRef = ExtendedDataClass_4af7fffc
        DemFreezeFrameRecNumClassRef = /InitialEcuC/
        DemOBDFreezeFrameClassRef = FreezeFrame_51eb4bef
        DemEventClass: DemEventSignificance=DEM_EVENT_SIGNIFICANCE_FAULT, DemAgingCycleRef=PowerCycle, DemOperationCycleRef=PowerCycle  # Diagnostics Data Import
          DemDebounceAlgorithmClass  # Diagnostics Data Import
            DemDebounceMonitorInternal  # Diagnostics Data Import
              DemCallbackGetFDC  # Diagnostics Data Import
      DtcClass_DTC_0xd12000 (DemDTCClass): DemUdsDTC=13705216, DemFunctionalGroupIdentifier=51, DemDTCAttributesRef=DtcAttributes_41914fb7  # Diagnostics Data Import
      DTC_0xd10301 (DemEventParameter):  # Diagnostics Data Import
        DemEventKind = DEM_EVENT_KIND_SWC
        DemDTCClassRef = DtcClass_DTC_0xd10301
        DemExtendedDataClassRef = ExtendedDataClass_4af7fffc
        DemFreezeFrameRecNumClassRef = /InitialEcuC/
        DemOBDFreezeFrameClassRef = FreezeFrame_51eb4bef
        DemEventClass: DemEventSignificance=DEM_EVENT_SIGNIFICANCE_FAULT, DemAgingCycleRef=PowerCycle, DemOperationCycleRef=PowerCycle  # Diagnostics Data Import
          DemDebounceAlgorithmClass  # Diagnostics Data Import
            DemDebounceMonitorInternal  # Diagnostics Data Import
              DemCallbackGetFDC  # Diagnostics Data Import
      DtcClass_DTC_0xd10301 (DemDTCClass): DemUdsDTC=13697793, DemFunctionalGroupIdentifier=51, DemDTCAttributesRef=DtcAttributes_41914fb7  # Diagnostics Data Import
      DTC_0xd10300 (DemEventParameter):  # Diagnostics Data Import
        DemEventKind = DEM_EVENT_KIND_SWC
        DemDTCClassRef = DtcClass_DTC_0xd10300
        DemExtendedDataClassRef = ExtendedDataClass_4af7fffc
        DemFreezeFrameRecNumClassRef = /InitialEcuC/
        DemOBDFreezeFrameClassRef = FreezeFrame_51eb4bef
        DemEventClass: DemEventSignificance=DEM_EVENT_SIGNIFICANCE_FAULT, DemAgingCycleRef=PowerCycle, DemOperationCycleRef=PowerCycle  # Diagnostics Data Import
          DemDebounceAlgorithmClass  # Diagnostics Data Import
            DemDebounceMonitorInternal  # Diagnostics Data Import
              DemCallbackGetFDC  # Diagnostics Data Import
      DtcClass_DTC_0xd10300 (DemDTCClass): DemUdsDTC=13697792, DemFunctionalGroupIdentifier=51, DemDTCAttributesRef=DtcAttributes_41914fb7  # Diagnostics Data Import
      DTC_0xd01200 (DemEventParameter):  # Diagnostics Data Import
        DemEventKind = DEM_EVENT_KIND_SWC
        DemDTCClassRef = DtcClass_DTC_0xd01200
        DemExtendedDataClassRef = ExtendedDataClass_4af7fffc
        DemFreezeFrameRecNumClassRef = /InitialEcuC/
        DemOBDFreezeFrameClassRef = FreezeFrame_51eb4bef
        DemEventClass: DemEventSignificance=DEM_EVENT_SIGNIFICANCE_FAULT, DemAgingCycleRef=PowerCycle, DemOperationCycleRef=PowerCycle  # Diagnostics Data Import
          DemDebounceAlgorithmClass  # Diagnostics Data Import
            DemDebounceMonitorInternal  # Diagnostics Data Import
              DemCallbackGetFDC  # Diagnostics Data Import
      DtcClass_DTC_0xd01200 (DemDTCClass): DemUdsDTC=13636096, DemFunctionalGroupIdentifier=51, DemDTCAttributesRef=DtcAttributes_41914fb7  # Diagnostics Data Import
      DTC_0xd01100 (DemEventParameter):  # Diagnostics Data Import
        DemEventKind = DEM_EVENT_KIND_SWC
        DemDTCClassRef = DtcClass_DTC_0xd01100
        DemExtendedDataClassRef = ExtendedDataClass_4af7fffc
        DemFreezeFrameRecNumClassRef = /InitialEcuC/
        DemOBDFreezeFrameClassRef = FreezeFrame_51eb4bef
        DemEventClass: DemEventSignificance=DEM_EVENT_SIGNIFICANCE_FAULT, DemAgingCycleRef=PowerCycle, DemOperationCycleRef=PowerCycle  # Diagnostics Data Import
          DemDebounceAlgorithmClass  # Diagnostics Data Import
            DemDebounceMonitorInternal  # Diagnostics Data Import
              DemCallbackGetFDC  # Diagnostics Data Import
      DtcClass_DTC_0xd01100 (DemDTCClass): DemUdsDTC=13635840, DemFunctionalGroupIdentifier=51, DemDTCAttributesRef=DtcAttributes_41914fb7  # Diagnostics Data Import
      DTC_0xc12490 (DemEventParameter):  # Diagnostics Data Import
        DemEventKind = DEM_EVENT_KIND_SWC
        DemDTCClassRef = DtcClass_DTC_0xc12490
        DemExtendedDataClassRef = ExtendedDataClass_4af7fffc
        DemFreezeFrameRecNumClassRef = /InitialEcuC/
        DemOBDFreezeFrameClassRef = FreezeFrame_51eb4bef
        DemEventClass: DemEventSignificance=DEM_EVENT_SIGNIFICANCE_FAULT, DemAgingCycleRef=PowerCycle, DemOperationCycleRef=PowerCycle  # Diagnostics Data Import
          DemDebounceAlgorithmClass  # Diagnostics Data Import
            DemDebounceMonitorInternal  # Diagnostics Data Import
              DemCallbackGetFDC  # Diagnostics Data Import
      DtcClass_DTC_0xc12490 (DemDTCClass): DemUdsDTC=12657808, DemFunctionalGroupIdentifier=51, DemDTCAttributesRef=DtcAttributes_41914fb7  # Diagnostics Data Import
      DTC_0x333000 (DemEventParameter):  # Diagnostics Data Import
        DemEventKind = DEM_EVENT_KIND_SWC
        DemDTCClassRef = DtcClass_DTC_0x333000
        DemExtendedDataClassRef = ExtendedDataClass_4af7fffc
        DemFreezeFrameRecNumClassRef = /InitialEcuC/
        DemOBDFreezeFrameClassRef = FreezeFrame_51eb4bef
        DemEventClass: DemEventSignificance=DEM_EVENT_SIGNIFICANCE_FAULT, DemAgingCycleRef=PowerCycle, DemOperationCycleRef=PowerCycle  # Diagnostics Data Import
          DemDebounceAlgorithmClass  # Diagnostics Data Import
            DemDebounceMonitorInternal  # Diagnostics Data Import
              DemCallbackGetFDC  # Diagnostics Data Import
      DtcClass_DTC_0x333000 (DemDTCClass): DemUdsDTC=3354624, DemFunctionalGroupIdentifier=51, DemDTCAttributesRef=DtcAttributes_41914fb7  # Diagnostics Data Import
      DTC_0x1d5af0 (DemEventParameter):  # Diagnostics Data Import
        DemEventKind = DEM_EVENT_KIND_SWC
        DemDTCClassRef = DtcClass_DTC_0x1d5af0
        DemExtendedDataClassRef = ExtendedDataClass_4af7fffc
        DemFreezeFrameRecNumClassRef = /InitialEcuC/
        DemOBDFreezeFrameClassRef = FreezeFrame_51eb4bef
        DemEventClass: DemEventSignificance=DEM_EVENT_SIGNIFICANCE_FAULT, DemAgingCycleRef=PowerCycle, DemOperationCycleRef=PowerCycle  # Diagnostics Data Import
          DemDebounceAlgorithmClass  # Diagnostics Data Import
            DemDebounceMonitorInternal  # Diagnostics Data Import
              DemCallbackGetFDC  # Diagnostics Data Import
      DtcClass_DTC_0x1d5af0 (DemDTCClass): DemUdsDTC=1923824, DemFunctionalGroupIdentifier=51, DemDTCAttributesRef=DtcAttributes_41914fb7  # Diagnostics Data Import
      DTC_0x184c00 (DemEventParameter):  # Diagnostics Data Import
        DemEventKind = DEM_EVENT_KIND_SWC
        DemDTCClassRef = DtcClass_DTC_0x184c00
        DemExtendedDataClassRef = ExtendedDataClass_4af7fffc
        DemFreezeFrameRecNumClassRef = /InitialEcuC/
        DemOBDFreezeFrameClassRef = FreezeFrame_51eb4bef
        DemEventClass: DemEventSignificance=DEM_EVENT_SIGNIFICANCE_FAULT, DemAgingCycleRef=PowerCycle, DemOperationCycleRef=PowerCycle  # Diagnostics Data Import
          DemDebounceAlgorithmClass  # Diagnostics Data Import
            DemDebounceMonitorInternal  # Diagnostics Data Import
              DemCallbackGetFDC  # Diagnostics Data Import
      DtcClass_DTC_0x184c00 (DemDTCClass): DemUdsDTC=1592320, DemFunctionalGroupIdentifier=51, DemDTCAttributesRef=DtcAttributes_41914fb7  # Diagnostics Data Import
      DTC_0x170612 (DemEventParameter):  # Diagnostics Data Import
        DemEventKind = DEM_EVENT_KIND_SWC
        DemDTCClassRef = DtcClass_DTC_0x170612
        DemExtendedDataClassRef = ExtendedDataClass_4af7fffc
        DemFreezeFrameRecNumClassRef = /InitialEcuC/
        DemOBDFreezeFrameClassRef = FreezeFrame_51eb4bef
        DemEventClass: DemEventSignificance=DEM_EVENT_SIGNIFICANCE_FAULT, DemAgingCycleRef=PowerCycle, DemOperationCycleRef=PowerCycle  # Diagnostics Data Import
          DemDebounceAlgorithmClass  # Diagnostics Data Import
            DemDebounceMonitorInternal  # Diagnostics Data Import
              DemCallbackGetFDC  # Diagnostics Data Import
      DtcClass_DTC_0x170612 (DemDTCClass): DemUdsDTC=1508882, DemFunctionalGroupIdentifier=51, DemDTCAttributesRef=DtcAttributes_41914fb7  # Diagnostics Data Import
      DTC_0x170611 (DemEventParameter):  # Diagnostics Data Import
        DemEventKind = DEM_EVENT_KIND_SWC
        DemDTCClassRef = DtcClass_DTC_0x170611
        DemExtendedDataClassRef = ExtendedDataClass_4af7fffc
        DemFreezeFrameRecNumClassRef = /InitialEcuC/
        DemOBDFreezeFrameClassRef = FreezeFrame_51eb4bef
        DemEventClass: DemEventSignificance=DEM_EVENT_SIGNIFICANCE_FAULT, DemAgingCycleRef=PowerCycle, DemOperationCycleRef=PowerCycle  # Diagnostics Data Import
          DemDebounceAlgorithmClass  # Diagnostics Data Import
            DemDebounceMonitorInternal  # Diagnostics Data Import
              DemCallbackGetFDC  # Diagnostics Data Import
      DtcClass_DTC_0x170611 (DemDTCClass): DemUdsDTC=1508881, DemFunctionalGroupIdentifier=51, DemDTCAttributesRef=DtcAttributes_41914fb7  # Diagnostics Data Import
      DTC_0x170610 (DemEventParameter):  # Diagnostics Data Import
        DemEventKind = DEM_EVENT_KIND_SWC
        DemDTCClassRef = DtcClass_DTC_0x170610
        DemExtendedDataClassRef = ExtendedDataClass_4af7fffc
        DemFreezeFrameRecNumClassRef = /InitialEcuC/
        DemOBDFreezeFrameClassRef = FreezeFrame_51eb4bef
        DemEventClass: DemEventSignificance=DEM_EVENT_SIGNIFICANCE_FAULT, DemAgingCycleRef=PowerCycle, DemOperationCycleRef=PowerCycle  # Diagnostics Data Import
          DemDebounceAlgorithmClass  # Diagnostics Data Import
            DemDebounceMonitorInternal  # Diagnostics Data Import
              DemCallbackGetFDC  # Diagnostics Data Import
      DtcClass_DTC_0x170610 (DemDTCClass): DemUdsDTC=1508880, DemFunctionalGroupIdentifier=51, DemDTCAttributesRef=DtcAttributes_41914fb7  # Diagnostics Data Import
      DTC_0x170600 (DemEventParameter):  # Diagnostics Data Import
        DemEventKind = DEM_EVENT_KIND_SWC
        DemDTCClassRef = DtcClass_DTC_0x170600
        DemExtendedDataClassRef = ExtendedDataClass_4af7fffc
        DemFreezeFrameRecNumClassRef = /InitialEcuC/
        DemOBDFreezeFrameClassRef = FreezeFrame_51eb4bef
        DemEventClass: DemEventSignificance=DEM_EVENT_SIGNIFICANCE_FAULT, DemAgingCycleRef=PowerCycle, DemOperationCycleRef=PowerCycle  # Diagnostics Data Import
          DemDebounceAlgorithmClass  # Diagnostics Data Import
            DemDebounceMonitorInternal  # Diagnostics Data Import
              DemCallbackGetFDC  # Diagnostics Data Import
      DtcClass_DTC_0x170600 (DemDTCClass): DemUdsDTC=1508864, DemFunctionalGroupIdentifier=51, DemDTCAttributesRef=DtcAttributes_41914fb7  # Diagnostics Data Import
      DTC_0x170500 (DemEventParameter):  # Diagnostics Data Import
        DemEventKind = DEM_EVENT_KIND_SWC
        DemDTCClassRef = DtcClass_DTC_0x170500
        DemExtendedDataClassRef = ExtendedDataClass_4af7fffc
        DemFreezeFrameRecNumClassRef = /InitialEcuC/
        DemOBDFreezeFrameClassRef = FreezeFrame_51eb4bef
        DemEventClass: DemEventSignificance=DEM_EVENT_SIGNIFICANCE_FAULT, DemAgingCycleRef=PowerCycle, DemOperationCycleRef=PowerCycle  # Diagnostics Data Import
          DemDebounceAlgorithmClass  # Diagnostics Data Import
            DemDebounceMonitorInternal  # Diagnostics Data Import
              DemCallbackGetFDC  # Diagnostics Data Import
      DtcClass_DTC_0x170500 (DemDTCClass): DemUdsDTC=1508608, DemFunctionalGroupIdentifier=51, DemDTCAttributesRef=DtcAttributes_41914fb7  # Diagnostics Data Import
      DTC_0x170400 (DemEventParameter):  # Diagnostics Data Import
        DemEventKind = DEM_EVENT_KIND_SWC
        DemDTCClassRef = DtcClass_DTC_0x170400
        DemExtendedDataClassRef = ExtendedDataClass_4af7fffc
        DemFreezeFrameRecNumClassRef = /InitialEcuC/
        DemOBDFreezeFrameClassRef = FreezeFrame_51eb4bef
        DemEventClass: DemEventSignificance=DEM_EVENT_SIGNIFICANCE_FAULT, DemAgingCycleRef=PowerCycle, DemOperationCycleRef=PowerCycle  # Diagnostics Data Import
          DemDebounceAlgorithmClass  # Diagnostics Data Import
            DemDebounceMonitorInternal  # Diagnostics Data Import
              DemCallbackGetFDC  # Diagnostics Data Import
      DtcClass_DTC_0x170400 (DemDTCClass): DemUdsDTC=1508352, DemFunctionalGroupIdentifier=51, DemDTCAttributesRef=DtcAttributes_41914fb7  # Diagnostics Data Import
      DTC_0x12cb04 (DemEventParameter):  # Diagnostics Data Import
        DemEventKind = DEM_EVENT_KIND_SWC
        DemDTCClassRef = DtcClass_DTC_0x12cb04
        DemExtendedDataClassRef = ExtendedDataClass_4af7fffc
        DemFreezeFrameRecNumClassRef = /InitialEcuC/
        DemOBDFreezeFrameClassRef = FreezeFrame_51eb4bef
        DemEventClass: DemEventSignificance=DEM_EVENT_SIGNIFICANCE_FAULT, DemAgingCycleRef=PowerCycle, DemOperationCycleRef=PowerCycle  # Diagnostics Data Import
          DemDebounceAlgorithmClass  # Diagnostics Data Import
            DemDebounceMonitorInternal  # Diagnostics Data Import
              DemCallbackGetFDC  # Diagnostics Data Import
      DtcClass_DTC_0x12cb04 (DemDTCClass): DemUdsDTC=1231620, DemFunctionalGroupIdentifier=51, DemDTCAttributesRef=DtcAttributes_41914fb7  # Diagnostics Data Import
      DTC_0x12cb03 (DemEventParameter):  # Diagnostics Data Import
        DemEventKind = DEM_EVENT_KIND_SWC
        DemDTCClassRef = DtcClass_DTC_0x12cb03
        DemExtendedDataClassRef = ExtendedDataClass_4af7fffc
        DemFreezeFrameRecNumClassRef = /InitialEcuC/
        DemOBDFreezeFrameClassRef = FreezeFrame_51eb4bef
        DemEventClass: DemEventSignificance=DEM_EVENT_SIGNIFICANCE_FAULT, DemAgingCycleRef=PowerCycle, DemOperationCycleRef=PowerCycle  # Diagnostics Data Import
          DemDebounceAlgorithmClass  # Diagnostics Data Import
            DemDebounceMonitorInternal  # Diagnostics Data Import
              DemCallbackGetFDC  # Diagnostics Data Import
      DtcClass_DTC_0x12cb03 (DemDTCClass): DemUdsDTC=1231619, DemFunctionalGroupIdentifier=51, DemDTCAttributesRef=DtcAttributes_41914fb7  # Diagnostics Data Import
      DTC_0x12cb02 (DemEventParameter):  # Diagnostics Data Import
        DemEventKind = DEM_EVENT_KIND_SWC
        DemDTCClassRef = DtcClass_DTC_0x12cb02
        DemExtendedDataClassRef = ExtendedDataClass_4af7fffc
        DemFreezeFrameRecNumClassRef = /InitialEcuC/
        DemOBDFreezeFrameClassRef = FreezeFrame_51eb4bef
        DemEventClass: DemEventSignificance=DEM_EVENT_SIGNIFICANCE_FAULT, DemAgingCycleRef=PowerCycle, DemOperationCycleRef=PowerCycle  # Diagnostics Data Import
          DemDebounceAlgorithmClass  # Diagnostics Data Import
            DemDebounceMonitorInternal  # Diagnostics Data Import
              DemCallbackGetFDC  # Diagnostics Data Import
      DtcClass_DTC_0x12cb02 (DemDTCClass): DemUdsDTC=1231618, DemFunctionalGroupIdentifier=51, DemDTCAttributesRef=DtcAttributes_41914fb7  # Diagnostics Data Import
      DTC_0x12cb01 (DemEventParameter):  # Diagnostics Data Import
        DemEventKind = DEM_EVENT_KIND_SWC
        DemDTCClassRef = DtcClass_DTC_0x12cb01
        DemExtendedDataClassRef = ExtendedDataClass_4af7fffc
        DemFreezeFrameRecNumClassRef = /InitialEcuC/
        DemOBDFreezeFrameClassRef = FreezeFrame_51eb4bef
        DemEventClass: DemEventSignificance=DEM_EVENT_SIGNIFICANCE_FAULT, DemAgingCycleRef=PowerCycle, DemOperationCycleRef=PowerCycle  # Diagnostics Data Import
          DemDebounceAlgorithmClass  # Diagnostics Data Import
            DemDebounceMonitorInternal  # Diagnostics Data Import
              DemCallbackGetFDC  # Diagnostics Data Import
      DtcClass_DTC_0x12cb01 (DemDTCClass): DemUdsDTC=1231617, DemFunctionalGroupIdentifier=51, DemDTCAttributesRef=DtcAttributes_41914fb7  # Diagnostics Data Import
      DTC_0x120022 (DemEventParameter):  # Diagnostics Data Import
        DemEventKind = DEM_EVENT_KIND_SWC
        DemDTCClassRef = DtcClass_DTC_0x120022
        DemExtendedDataClassRef = ExtendedDataClass_4af7fffc
        DemFreezeFrameRecNumClassRef = /InitialEcuC/
        DemOBDFreezeFrameClassRef = FreezeFrame_51eb4bef
        DemEventClass: DemEventSignificance=DEM_EVENT_SIGNIFICANCE_FAULT, DemAgingCycleRef=PowerCycle, DemOperationCycleRef=PowerCycle  # Diagnostics Data Import
          DemDebounceAlgorithmClass  # Diagnostics Data Import
            DemDebounceMonitorInternal  # Diagnostics Data Import
              DemCallbackGetFDC  # Diagnostics Data Import
      DtcClass_DTC_0x120022 (DemDTCClass): DemUdsDTC=1179682, DemFunctionalGroupIdentifier=51, DemDTCAttributesRef=DtcAttributes_41914fb7  # Diagnostics Data Import
      DTC_0x120020 (DemEventParameter):  # Diagnostics Data Import
        DemEventKind = DEM_EVENT_KIND_SWC
        DemDTCClassRef = DtcClass_DTC_0x120020
        DemExtendedDataClassRef = ExtendedDataClass_4af7fffc
        DemFreezeFrameRecNumClassRef = /InitialEcuC/
        DemOBDFreezeFrameClassRef = FreezeFrame_51eb4bef
        DemEventClass: DemEventSignificance=DEM_EVENT_SIGNIFICANCE_FAULT, DemAgingCycleRef=PowerCycle, DemOperationCycleRef=PowerCycle  # Diagnostics Data Import
          DemDebounceAlgorithmClass  # Diagnostics Data Import
            DemDebounceMonitorInternal  # Diagnostics Data Import
              DemCallbackGetFDC  # Diagnostics Data Import
      DtcClass_DTC_0x120020 (DemDTCClass): DemUdsDTC=1179680, DemFunctionalGroupIdentifier=51, DemDTCAttributesRef=DtcAttributes_41914fb7  # Diagnostics Data Import
      DTC_0x100203 (DemEventParameter):  # Diagnostics Data Import
        DemEventKind = DEM_EVENT_KIND_SWC
        DemDTCClassRef = DtcClass_DTC_0x100203
        DemExtendedDataClassRef = ExtendedDataClass_4af7fffc
        DemFreezeFrameRecNumClassRef = /InitialEcuC/
        DemOBDFreezeFrameClassRef = FreezeFrame_51eb4bef
        DemEventClass: DemEventSignificance=DEM_EVENT_SIGNIFICANCE_FAULT, DemAgingCycleRef=PowerCycle, DemOperationCycleRef=PowerCycle  # Diagnostics Data Import
          DemDebounceAlgorithmClass  # Diagnostics Data Import
            DemDebounceMonitorInternal  # Diagnostics Data Import
              DemCallbackGetFDC  # Diagnostics Data Import
      DtcClass_DTC_0x100203 (DemDTCClass): DemUdsDTC=1049091, DemFunctionalGroupIdentifier=51, DemDTCAttributesRef=DtcAttributes_41914fb7  # Diagnostics Data Import
      DTC_0x100044 (DemEventParameter):  # Diagnostics Data Import
        DemEventKind = DEM_EVENT_KIND_SWC
        DemDTCClassRef = DtcClass_DTC_0x100044
        DemExtendedDataClassRef = ExtendedDataClass_4af7fffc
        DemFreezeFrameRecNumClassRef = /InitialEcuC/
        DemOBDFreezeFrameClassRef = FreezeFrame_51eb4bef
        DemEventClass: DemEventSignificance=DEM_EVENT_SIGNIFICANCE_FAULT, DemAgingCycleRef=PowerCycle, DemOperationCycleRef=PowerCycle  # Diagnostics Data Import
          DemDebounceAlgorithmClass  # Diagnostics Data Import
            DemDebounceMonitorInternal  # Diagnostics Data Import
              DemCallbackGetFDC  # Diagnostics Data Import
      DtcClass_DTC_0x100044 (DemDTCClass): DemUdsDTC=1048644, DemFunctionalGroupIdentifier=51, DemDTCAttributesRef=DtcAttributes_41914fb7  # Diagnostics Data Import
      DTC_0x100043 (DemEventParameter):  # Diagnostics Data Import
        DemEventKind = DEM_EVENT_KIND_SWC
        DemDTCClassRef = DtcClass_DTC_0x100043
        DemExtendedDataClassRef = ExtendedDataClass_4af7fffc
        DemFreezeFrameRecNumClassRef = /InitialEcuC/
        DemOBDFreezeFrameClassRef = FreezeFrame_51eb4bef
        DemEventClass: DemEventSignificance=DEM_EVENT_SIGNIFICANCE_FAULT, DemAgingCycleRef=PowerCycle, DemOperationCycleRef=PowerCycle  # Diagnostics Data Import
          DemDebounceAlgorithmClass  # Diagnostics Data Import
            DemDebounceMonitorInternal  # Diagnostics Data Import
              DemCallbackGetFDC  # Diagnostics Data Import
      DtcClass_DTC_0x100043 (DemDTCClass): DemUdsDTC=1048643, DemFunctionalGroupIdentifier=51, DemDTCAttributesRef=DtcAttributes_41914fb7  # Diagnostics Data Import
      DTC_0x100042 (DemEventParameter):  # Diagnostics Data Import
        DemEventKind = DEM_EVENT_KIND_SWC
        DemDTCClassRef = DtcClass_DTC_0x100042
        DemExtendedDataClassRef = ExtendedDataClass_4af7fffc
        DemFreezeFrameRecNumClassRef = /InitialEcuC/
        DemOBDFreezeFrameClassRef = FreezeFrame_51eb4bef
        DemEventClass: DemEventSignificance=DEM_EVENT_SIGNIFICANCE_FAULT, DemAgingCycleRef=PowerCycle, DemOperationCycleRef=PowerCycle  # Diagnostics Data Import
          DemDebounceAlgorithmClass  # Diagnostics Data Import
            DemDebounceMonitorInternal  # Diagnostics Data Import
              DemCallbackGetFDC  # Diagnostics Data Import
      DtcClass_DTC_0x100042 (DemDTCClass): DemUdsDTC=1048642, DemFunctionalGroupIdentifier=51, DemDTCAttributesRef=DtcAttributes_41914fb7  # Diagnostics Data Import
      DTC_0x100041 (DemEventParameter):  # Diagnostics Data Import
        DemEventKind = DEM_EVENT_KIND_SWC
        DemDTCClassRef = DtcClass_DTC_0x100041
        DemExtendedDataClassRef = ExtendedDataClass_4af7fffc
        DemFreezeFrameRecNumClassRef = /InitialEcuC/
        DemOBDFreezeFrameClassRef = FreezeFrame_51eb4bef
        DemEventClass: DemEventSignificance=DEM_EVENT_SIGNIFICANCE_FAULT, DemAgingCycleRef=PowerCycle, DemOperationCycleRef=PowerCycle  # Diagnostics Data Import
          DemDebounceAlgorithmClass  # Diagnostics Data Import
            DemDebounceMonitorInternal  # Diagnostics Data Import
              DemCallbackGetFDC  # Diagnostics Data Import
      DtcClass_DTC_0x100041 (DemDTCClass): DemUdsDTC=1048641, DemFunctionalGroupIdentifier=51, DemDTCAttributesRef=DtcAttributes_41914fb7  # Diagnostics Data Import
      DTC_0x100036 (DemEventParameter):  # Diagnostics Data Import
        DemEventKind = DEM_EVENT_KIND_SWC
        DemDTCClassRef = DtcClass_DTC_0x100036
        DemExtendedDataClassRef = ExtendedDataClass_4af7fffc
        DemFreezeFrameRecNumClassRef = /InitialEcuC/
        DemOBDFreezeFrameClassRef = FreezeFrame_51eb4bef
        DemEventClass: DemEventSignificance=DEM_EVENT_SIGNIFICANCE_FAULT, DemAgingCycleRef=PowerCycle, DemOperationCycleRef=PowerCycle  # Diagnostics Data Import
          DemDebounceAlgorithmClass  # Diagnostics Data Import
            DemDebounceMonitorInternal  # Diagnostics Data Import
              DemCallbackGetFDC  # Diagnostics Data Import
      DtcClass_DTC_0x100036 (DemDTCClass): DemUdsDTC=1048630, DemFunctionalGroupIdentifier=51, DemDTCAttributesRef=DtcAttributes_41914fb7  # Diagnostics Data Import
      DTC_0x100035 (DemEventParameter):  # Diagnostics Data Import
        DemEventKind = DEM_EVENT_KIND_SWC
        DemDTCClassRef = DtcClass_DTC_0x100035
        DemExtendedDataClassRef = ExtendedDataClass_4af7fffc
        DemFreezeFrameRecNumClassRef = /InitialEcuC/
        DemOBDFreezeFrameClassRef = FreezeFrame_51eb4bef
        DemEventClass: DemEventSignificance=DEM_EVENT_SIGNIFICANCE_FAULT, DemAgingCycleRef=PowerCycle, DemOperationCycleRef=PowerCycle  # Diagnostics Data Import
          DemDebounceAlgorithmClass  # Diagnostics Data Import
            DemDebounceMonitorInternal  # Diagnostics Data Import
              DemCallbackGetFDC  # Diagnostics Data Import
      DtcClass_DTC_0x100035 (DemDTCClass): DemUdsDTC=1048629, DemFunctionalGroupIdentifier=51, DemDTCAttributesRef=DtcAttributes_41914fb7  # Diagnostics Data Import
      DTC_0x100034 (DemEventParameter):  # Diagnostics Data Import
        DemEventKind = DEM_EVENT_KIND_SWC
        DemDTCClassRef = DtcClass_DTC_0x100034
        DemExtendedDataClassRef = ExtendedDataClass_4af7fffc
        DemFreezeFrameRecNumClassRef = /InitialEcuC/
        DemOBDFreezeFrameClassRef = FreezeFrame_51eb4bef
        DemEventClass: DemEventSignificance=DEM_EVENT_SIGNIFICANCE_FAULT, DemAgingCycleRef=PowerCycle, DemOperationCycleRef=PowerCycle  # Diagnostics Data Import
          DemDebounceAlgorithmClass  # Diagnostics Data Import
            DemDebounceMonitorInternal  # Diagnostics Data Import
              DemCallbackGetFDC  # Diagnostics Data Import
      DtcClass_DTC_0x100034 (DemDTCClass): DemUdsDTC=1048628, DemFunctionalGroupIdentifier=51, DemDTCAttributesRef=DtcAttributes_41914fb7  # Diagnostics Data Import
      DTC_0x100033 (DemEventParameter):  # Diagnostics Data Import
        DemEventKind = DEM_EVENT_KIND_SWC
        DemDTCClassRef = DtcClass_DTC_0x100033
        DemExtendedDataClassRef = ExtendedDataClass_4af7fffc
        DemFreezeFrameRecNumClassRef = /InitialEcuC/
        DemOBDFreezeFrameClassRef = FreezeFrame_51eb4bef
        DemEventClass: DemEventSignificance=DEM_EVENT_SIGNIFICANCE_FAULT, DemAgingCycleRef=PowerCycle, DemOperationCycleRef=PowerCycle  # Diagnostics Data Import
          DemDebounceAlgorithmClass  # Diagnostics Data Import
            DemDebounceMonitorInternal  # Diagnostics Data Import
              DemCallbackGetFDC  # Diagnostics Data Import
      DtcClass_DTC_0x100033 (DemDTCClass): DemUdsDTC=1048627, DemFunctionalGroupIdentifier=51, DemDTCAttributesRef=DtcAttributes_41914fb7  # Diagnostics Data Import
      DTC_0x100032 (DemEventParameter):  # Diagnostics Data Import
        DemEventKind = DEM_EVENT_KIND_SWC
        DemDTCClassRef = DtcClass_DTC_0x100032
        DemExtendedDataClassRef = ExtendedDataClass_4af7fffc
        DemFreezeFrameRecNumClassRef = /InitialEcuC/
        DemOBDFreezeFrameClassRef = FreezeFrame_51eb4bef
        DemEventClass: DemEventSignificance=DEM_EVENT_SIGNIFICANCE_FAULT, DemAgingCycleRef=PowerCycle, DemOperationCycleRef=PowerCycle  # Diagnostics Data Import
          DemDebounceAlgorithmClass  # Diagnostics Data Import
            DemDebounceMonitorInternal  # Diagnostics Data Import
              DemCallbackGetFDC  # Diagnostics Data Import
      DtcClass_DTC_0x100032 (DemDTCClass): DemUdsDTC=1048626, DemFunctionalGroupIdentifier=51, DemDTCAttributesRef=DtcAttributes_41914fb7  # Diagnostics Data Import
      DTC_0x100031 (DemEventParameter):  # Diagnostics Data Import
        DemEventKind = DEM_EVENT_KIND_SWC
        DemDTCClassRef = DtcClass_DTC_0x100031
        DemExtendedDataClassRef = ExtendedDataClass_4af7fffc
        DemFreezeFrameRecNumClassRef = /InitialEcuC/
        DemOBDFreezeFrameClassRef = FreezeFrame_51eb4bef
        DemEventClass: DemEventSignificance=DEM_EVENT_SIGNIFICANCE_FAULT, DemAgingCycleRef=PowerCycle, DemOperationCycleRef=PowerCycle  # Diagnostics Data Import
          DemDebounceAlgorithmClass  # Diagnostics Data Import
            DemDebounceMonitorInternal  # Diagnostics Data Import
              DemCallbackGetFDC  # Diagnostics Data Import
      DtcClass_DTC_0x100031 (DemDTCClass): DemUdsDTC=1048625, DemFunctionalGroupIdentifier=51, DemDTCAttributesRef=DtcAttributes_41914fb7  # Diagnostics Data Import
      DTC_0x10001c (DemEventParameter):  # Diagnostics Data Import
        DemEventKind = DEM_EVENT_KIND_SWC
        DemDTCClassRef = DtcClass_DTC_0x10001c
        DemExtendedDataClassRef = ExtendedDataClass_4af7fffc
        DemFreezeFrameRecNumClassRef = /InitialEcuC/
        DemOBDFreezeFrameClassRef = FreezeFrame_51eb4bef
        DemEventClass: DemEventSignificance=DEM_EVENT_SIGNIFICANCE_FAULT, DemAgingCycleRef=PowerCycle, DemOperationCycleRef=PowerCycle  # Diagnostics Data Import
          DemDebounceAlgorithmClass  # Diagnostics Data Import
            DemDebounceMonitorInternal  # Diagnostics Data Import
              DemCallbackGetFDC  # Diagnostics Data Import
      DtcClass_DTC_0x10001c (DemDTCClass): DemUdsDTC=1048604, DemFunctionalGroupIdentifier=51, DemDTCAttributesRef=DtcAttributes_41914fb7  # Diagnostics Data Import
      DTC_0x10001a (DemEventParameter):  # Diagnostics Data Import
        DemEventKind = DEM_EVENT_KIND_SWC
        DemDTCClassRef = DtcClass_DTC_0x10001a
        DemExtendedDataClassRef = ExtendedDataClass_4af7fffc
        DemFreezeFrameRecNumClassRef = /InitialEcuC/
        DemOBDFreezeFrameClassRef = FreezeFrame_51eb4bef
        DemEventClass: DemEventSignificance=DEM_EVENT_SIGNIFICANCE_FAULT, DemAgingCycleRef=PowerCycle, DemOperationCycleRef=PowerCycle  # Diagnostics Data Import
          DemDebounceAlgorithmClass  # Diagnostics Data Import
            DemDebounceMonitorInternal  # Diagnostics Data Import
              DemCallbackGetFDC  # Diagnostics Data Import
      DtcClass_DTC_0x10001a (DemDTCClass): DemUdsDTC=1048602, DemFunctionalGroupIdentifier=51, DemDTCAttributesRef=DtcAttributes_41914fb7  # Diagnostics Data Import
      DTC_0x100013 (DemEventParameter):  # Diagnostics Data Import
        DemEventKind = DEM_EVENT_KIND_SWC
        DemDTCClassRef = DtcClass_DTC_0x100013
        DemExtendedDataClassRef = ExtendedDataClass_4af7fffc
        DemFreezeFrameRecNumClassRef = /InitialEcuC/
        DemOBDFreezeFrameClassRef = FreezeFrame_51eb4bef
        DemEventClass: DemEventSignificance=DEM_EVENT_SIGNIFICANCE_FAULT, DemAgingCycleRef=PowerCycle, DemOperationCycleRef=PowerCycle  # Diagnostics Data Import
          DemDebounceAlgorithmClass  # Diagnostics Data Import
            DemDebounceMonitorInternal  # Diagnostics Data Import
              DemCallbackGetFDC  # Diagnostics Data Import
      DtcClass_DTC_0x100013 (DemDTCClass): DemUdsDTC=1048595, DemFunctionalGroupIdentifier=51, DemDTCAttributesRef=DtcAttributes_41914fb7  # Diagnostics Data Import
      DTC_0x100012 (DemEventParameter):  # Diagnostics Data Import
        DemEventKind = DEM_EVENT_KIND_SWC
        DemDTCClassRef = DtcClass_DTC_0x100012
        DemExtendedDataClassRef = ExtendedDataClass_4af7fffc
        DemFreezeFrameRecNumClassRef = /InitialEcuC/
        DemOBDFreezeFrameClassRef = FreezeFrame_51eb4bef
        DemEventClass: DemEventSignificance=DEM_EVENT_SIGNIFICANCE_FAULT, DemAgingCycleRef=PowerCycle, DemOperationCycleRef=PowerCycle  # Diagnostics Data Import
          DemDebounceAlgorithmClass  # Diagnostics Data Import
            DemDebounceMonitorInternal  # Diagnostics Data Import
              DemCallbackGetFDC  # Diagnostics Data Import
      DtcClass_DTC_0x100012 (DemDTCClass): DemUdsDTC=1048594, DemFunctionalGroupIdentifier=51, DemDTCAttributesRef=DtcAttributes_41914fb7  # Diagnostics Data Import
      DTC_0x100011 (DemEventParameter):  # Diagnostics Data Import
        DemEventKind = DEM_EVENT_KIND_SWC
        DemDTCClassRef = DtcClass_DTC_0x100011
        DemExtendedDataClassRef = ExtendedDataClass_4af7fffc
        DemFreezeFrameRecNumClassRef = /InitialEcuC/
        DemOBDFreezeFrameClassRef = FreezeFrame_51eb4bef
        DemEventClass: DemEventSignificance=DEM_EVENT_SIGNIFICANCE_FAULT, DemAgingCycleRef=PowerCycle, DemOperationCycleRef=PowerCycle  # Diagnostics Data Import
          DemDebounceAlgorithmClass  # Diagnostics Data Import
            DemDebounceMonitorInternal  # Diagnostics Data Import
              DemCallbackGetFDC  # Diagnostics Data Import
      DtcClass_DTC_0x100011 (DemDTCClass): DemUdsDTC=1048593, DemFunctionalGroupIdentifier=51, DemDTCAttributesRef=DtcAttributes_41914fb7  # Diagnostics Data Import
      DTC_0x100010 (DemEventParameter):  # Diagnostics Data Import
        DemEventKind = DEM_EVENT_KIND_SWC
        DemDTCClassRef = DtcClass_DTC_0x100010
        DemExtendedDataClassRef = ExtendedDataClass_4af7fffc
        DemFreezeFrameRecNumClassRef = /InitialEcuC/
        DemOBDFreezeFrameClassRef = FreezeFrame_51eb4bef
        DemEventClass: DemEventSignificance=DEM_EVENT_SIGNIFICANCE_FAULT, DemAgingCycleRef=PowerCycle, DemOperationCycleRef=PowerCycle  # Diagnostics Data Import
          DemDebounceAlgorithmClass  # Diagnostics Data Import
            DemDebounceMonitorInternal  # Diagnostics Data Import
              DemCallbackGetFDC  # Diagnostics Data Import
      DtcClass_DTC_0x100010 (DemDTCClass): DemUdsDTC=1048592, DemFunctionalGroupIdentifier=51, DemDTCAttributesRef=DtcAttributes_41914fb7  # Diagnostics Data Import
      DTC_0x10000f (DemEventParameter):  # Diagnostics Data Import
        DemEventKind = DEM_EVENT_KIND_SWC
        DemDTCClassRef = DtcClass_DTC_0x10000f
        DemExtendedDataClassRef = ExtendedDataClass_4af7fffc
        DemFreezeFrameRecNumClassRef = /InitialEcuC/
        DemOBDFreezeFrameClassRef = FreezeFrame_51eb4bef
        DemEventClass: DemEventSignificance=DEM_EVENT_SIGNIFICANCE_FAULT, DemAgingCycleRef=PowerCycle, DemOperationCycleRef=PowerCycle  # Diagnostics Data Import
          DemDebounceAlgorithmClass  # Diagnostics Data Import
            DemDebounceMonitorInternal  # Diagnostics Data Import
              DemCallbackGetFDC  # Diagnostics Data Import
      DtcClass_DTC_0x10000f (DemDTCClass): DemUdsDTC=1048591, DemFunctionalGroupIdentifier=51, DemDTCAttributesRef=DtcAttributes_41914fb7  # Diagnostics Data Import
      DTC_0x10000e (DemEventParameter):  # Diagnostics Data Import
        DemEventKind = DEM_EVENT_KIND_SWC
        DemDTCClassRef = DtcClass_DTC_0x10000e
        DemExtendedDataClassRef = ExtendedDataClass_4af7fffc
        DemFreezeFrameRecNumClassRef = /InitialEcuC/
        DemOBDFreezeFrameClassRef = FreezeFrame_51eb4bef
        DemEventClass: DemEventSignificance=DEM_EVENT_SIGNIFICANCE_FAULT, DemAgingCycleRef=PowerCycle, DemOperationCycleRef=PowerCycle  # Diagnostics Data Import
          DemDebounceAlgorithmClass  # Diagnostics Data Import
            DemDebounceMonitorInternal  # Diagnostics Data Import
              DemCallbackGetFDC  # Diagnostics Data Import
      DtcClass_DTC_0x10000e (DemDTCClass): DemUdsDTC=1048590, DemFunctionalGroupIdentifier=51, DemDTCAttributesRef=DtcAttributes_41914fb7  # Diagnostics Data Import
      DTC_0x10000d (DemEventParameter):  # Diagnostics Data Import
        DemEventKind = DEM_EVENT_KIND_SWC
        DemDTCClassRef = DtcClass_DTC_0x10000d
        DemExtendedDataClassRef = ExtendedDataClass_4af7fffc
        DemFreezeFrameRecNumClassRef = /InitialEcuC/
        DemOBDFreezeFrameClassRef = FreezeFrame_51eb4bef
        DemEventClass: DemEventSignificance=DEM_EVENT_SIGNIFICANCE_FAULT, DemAgingCycleRef=PowerCycle, DemOperationCycleRef=PowerCycle  # Diagnostics Data Import
          DemDebounceAlgorithmClass  # Diagnostics Data Import
            DemDebounceMonitorInternal  # Diagnostics Data Import
              DemCallbackGetFDC  # Diagnostics Data Import
      DtcClass_DTC_0x10000d (DemDTCClass): DemUdsDTC=1048589, DemFunctionalGroupIdentifier=51, DemDTCAttributesRef=DtcAttributes_41914fb7  # Diagnostics Data Import
      DTC_0x10000b (DemEventParameter):  # Diagnostics Data Import
        DemEventKind = DEM_EVENT_KIND_SWC
        DemDTCClassRef = DtcClass_DTC_0x10000b
        DemExtendedDataClassRef = ExtendedDataClass_4af7fffc
        DemFreezeFrameRecNumClassRef = /InitialEcuC/
        DemOBDFreezeFrameClassRef = FreezeFrame_51eb4bef
        DemEventClass: DemEventSignificance=DEM_EVENT_SIGNIFICANCE_FAULT, DemAgingCycleRef=PowerCycle, DemOperationCycleRef=PowerCycle  # Diagnostics Data Import
          DemDebounceAlgorithmClass  # Diagnostics Data Import
            DemDebounceMonitorInternal  # Diagnostics Data Import
              DemCallbackGetFDC  # Diagnostics Data Import
      DtcClass_DTC_0x10000b (DemDTCClass): DemUdsDTC=1048587, DemFunctionalGroupIdentifier=51, DemDTCAttributesRef=DtcAttributes_41914fb7  # Diagnostics Data Import
      DTC_0x10000a (DemEventParameter):  # Diagnostics Data Import
        DemEventKind = DEM_EVENT_KIND_SWC
        DemDTCClassRef = DtcClass_DTC_0x10000a
        DemExtendedDataClassRef = ExtendedDataClass_4af7fffc
        DemFreezeFrameRecNumClassRef = /InitialEcuC/
        DemOBDFreezeFrameClassRef = FreezeFrame_51eb4bef
        DemEventClass: DemEventSignificance=DEM_EVENT_SIGNIFICANCE_FAULT, DemAgingCycleRef=PowerCycle, DemOperationCycleRef=PowerCycle  # Diagnostics Data Import
          DemDebounceAlgorithmClass  # Diagnostics Data Import
            DemDebounceMonitorInternal  # Diagnostics Data Import
              DemCallbackGetFDC  # Diagnostics Data Import
      DtcClass_DTC_0x10000a (DemDTCClass): DemUdsDTC=1048586, DemFunctionalGroupIdentifier=51, DemDTCAttributesRef=DtcAttributes_41914fb7  # Diagnostics Data Import
      DTC_0x100009 (DemEventParameter):  # Diagnostics Data Import
        DemEventKind = DEM_EVENT_KIND_SWC
        DemDTCClassRef = DtcClass_DTC_0x100009
        DemExtendedDataClassRef = ExtendedDataClass_4af7fffc
        DemFreezeFrameRecNumClassRef = /InitialEcuC/
        DemOBDFreezeFrameClassRef = FreezeFrame_51eb4bef
        DemEventClass: DemEventSignificance=DEM_EVENT_SIGNIFICANCE_FAULT, DemAgingCycleRef=PowerCycle, DemOperationCycleRef=PowerCycle  # Diagnostics Data Import
          DemDebounceAlgorithmClass  # Diagnostics Data Import
            DemDebounceMonitorInternal  # Diagnostics Data Import
              DemCallbackGetFDC  # Diagnostics Data Import
      DtcClass_DTC_0x100009 (DemDTCClass): DemUdsDTC=1048585, DemFunctionalGroupIdentifier=51, DemDTCAttributesRef=DtcAttributes_41914fb7  # Diagnostics Data Import
      DTC_0x100003 (DemEventParameter):  # Diagnostics Data Import
        DemEventKind = DEM_EVENT_KIND_SWC
        DemDTCClassRef = DtcClass_DTC_0x100003
        DemExtendedDataClassRef = ExtendedDataClass_4af7fffc
        DemFreezeFrameRecNumClassRef = /InitialEcuC/
        DemOBDFreezeFrameClassRef = FreezeFrame_51eb4bef
        DemEventClass: DemEventSignificance=DEM_EVENT_SIGNIFICANCE_FAULT, DemAgingCycleRef=PowerCycle, DemOperationCycleRef=PowerCycle  # Diagnostics Data Import
          DemDebounceAlgorithmClass  # Diagnostics Data Import
            DemDebounceMonitorInternal  # Diagnostics Data Import
              DemCallbackGetFDC  # Diagnostics Data Import
      DtcClass_DTC_0x100003 (DemDTCClass): DemUdsDTC=1048579, DemFunctionalGroupIdentifier=51, DemDTCAttributesRef=DtcAttributes_41914fb7  # Diagnostics Data Import
      DTC_0x100002 (DemEventParameter):  # Diagnostics Data Import
        DemEventKind = DEM_EVENT_KIND_SWC
        DemDTCClassRef = DtcClass_DTC_0x100002
        DemExtendedDataClassRef = ExtendedDataClass_4af7fffc
        DemFreezeFrameRecNumClassRef = /InitialEcuC/
        DemOBDFreezeFrameClassRef = FreezeFrame_51eb4bef
        DemEventClass: DemEventSignificance=DEM_EVENT_SIGNIFICANCE_FAULT, DemAgingCycleRef=PowerCycle, DemOperationCycleRef=PowerCycle  # Diagnostics Data Import
          DemDebounceAlgorithmClass  # Diagnostics Data Import
            DemDebounceMonitorInternal  # Diagnostics Data Import
              DemCallbackGetFDC  # Diagnostics Data Import
      DtcClass_DTC_0x100002 (DemDTCClass): DemUdsDTC=1048578, DemFunctionalGroupIdentifier=51, DemDTCAttributesRef=DtcAttributes_41914fb7  # Diagnostics Data Import
      DTC_0x100000 (DemEventParameter):  # Diagnostics Data Import
        DemEventKind = DEM_EVENT_KIND_SWC
        DemDTCClassRef = DtcClass_DTC_0x100000
        DemExtendedDataClassRef = ExtendedDataClass_4af7fffc
        DemFreezeFrameRecNumClassRef = /InitialEcuC/
        DemOBDFreezeFrameClassRef = FreezeFrame_51eb4bef
        DemEventClass: DemEventSignificance=DEM_EVENT_SIGNIFICANCE_FAULT, DemAgingCycleRef=PowerCycle, DemOperationCycleRef=PowerCycle  # Diagnostics Data Import
          DemDebounceAlgorithmClass  # Diagnostics Data Import
            DemDebounceMonitorInternal  # Diagnostics Data Import
              DemCallbackGetFDC  # Diagnostics Data Import
      DtcClass_DTC_0x100000 (DemDTCClass): DemUdsDTC=1048576, DemFunctionalGroupIdentifier=51, DemDTCAttributesRef=DtcAttributes_41914fb7  # Diagnostics Data Import
      DTC_0x00b050 (DemEventParameter):  # Diagnostics Data Import
        DemEventKind = DEM_EVENT_KIND_SWC
        DemDTCClassRef = DtcClass_DTC_0x00b050
        DemExtendedDataClassRef = ExtendedDataClass_4af7fffc
        DemFreezeFrameRecNumClassRef = /InitialEcuC/
        DemOBDFreezeFrameClassRef = FreezeFrame_51eb4bef
        DemEventClass: DemEventSignificance=DEM_EVENT_SIGNIFICANCE_FAULT, DemAgingCycleRef=PowerCycle, DemOperationCycleRef=PowerCycle  # Diagnostics Data Import
          DemDebounceAlgorithmClass  # Diagnostics Data Import
            DemDebounceMonitorInternal  # Diagnostics Data Import
              DemCallbackGetFDC  # Diagnostics Data Import
      DtcClass_DTC_0x00b050 (DemDTCClass): DemUdsDTC=45136, DemFunctionalGroupIdentifier=51, DemDTCAttributesRef=DtcAttributes_41914fb7  # Diagnostics Data Import
      DTC_0x00a00b (DemEventParameter):  # Diagnostics Data Import
        DemEventKind = DEM_EVENT_KIND_SWC
        DemDTCClassRef = DtcClass_DTC_0x00a00b
        DemExtendedDataClassRef = ExtendedDataClass_4af7fffc
        DemFreezeFrameRecNumClassRef = /InitialEcuC/
        DemOBDFreezeFrameClassRef = FreezeFrame_51eb4bef
        DemEventClass: DemEventSignificance=DEM_EVENT_SIGNIFICANCE_FAULT, DemAgingCycleRef=PowerCycle, DemOperationCycleRef=PowerCycle  # Diagnostics Data Import
          DemDebounceAlgorithmClass  # Diagnostics Data Import
            DemDebounceMonitorInternal  # Diagnostics Data Import
              DemCallbackGetFDC  # Diagnostics Data Import
      DtcClass_DTC_0x00a00b (DemDTCClass): DemUdsDTC=40971, DemFunctionalGroupIdentifier=51, DemDTCAttributesRef=DtcAttributes_41914fb7  # Diagnostics Data Import
      DTC_0x00a00a (DemEventParameter):  # Diagnostics Data Import
        DemEventKind = DEM_EVENT_KIND_SWC
        DemDTCClassRef = DtcClass_DTC_0x00a00a
        DemExtendedDataClassRef = ExtendedDataClass_4af7fffc
        DemFreezeFrameRecNumClassRef = /InitialEcuC/
        DemOBDFreezeFrameClassRef = FreezeFrame_51eb4bef
        DemEventClass: DemEventSignificance=DEM_EVENT_SIGNIFICANCE_FAULT, DemAgingCycleRef=PowerCycle, DemOperationCycleRef=PowerCycle  # Diagnostics Data Import
          DemDebounceAlgorithmClass  # Diagnostics Data Import
            DemDebounceMonitorInternal  # Diagnostics Data Import
              DemCallbackGetFDC  # Diagnostics Data Import
      DtcClass_DTC_0x00a00a (DemDTCClass): DemUdsDTC=40970, DemFunctionalGroupIdentifier=51, DemDTCAttributesRef=DtcAttributes_41914fb7  # Diagnostics Data Import
      DTC_0x00a009 (DemEventParameter):  # Diagnostics Data Import
        DemEventKind = DEM_EVENT_KIND_SWC
        DemDTCClassRef = DtcClass_DTC_0x00a009
        DemExtendedDataClassRef = ExtendedDataClass_4af7fffc
        DemFreezeFrameRecNumClassRef = /InitialEcuC/
        DemOBDFreezeFrameClassRef = FreezeFrame_51eb4bef
        DemEventClass: DemEventSignificance=DEM_EVENT_SIGNIFICANCE_FAULT, DemAgingCycleRef=PowerCycle, DemOperationCycleRef=PowerCycle  # Diagnostics Data Import
          DemDebounceAlgorithmClass  # Diagnostics Data Import
            DemDebounceMonitorInternal  # Diagnostics Data Import
              DemCallbackGetFDC  # Diagnostics Data Import
      DtcClass_DTC_0x00a009 (DemDTCClass): DemUdsDTC=40969, DemFunctionalGroupIdentifier=51, DemDTCAttributesRef=DtcAttributes_41914fb7  # Diagnostics Data Import
      DTC_0x000080 (DemEventParameter):  # Diagnostics Data Import
        DemEventKind = DEM_EVENT_KIND_SWC
        DemDTCClassRef = DtcClass_DTC_0x000080
        DemExtendedDataClassRef = ExtendedDataClass_4af7fffc
        DemFreezeFrameRecNumClassRef = /InitialEcuC/
        DemOBDFreezeFrameClassRef = FreezeFrame_51eb4bef
        DemEventClass: DemEventSignificance=DEM_EVENT_SIGNIFICANCE_FAULT, DemAgingCycleRef=PowerCycle, DemOperationCycleRef=PowerCycle  # Diagnostics Data Import
          DemDebounceAlgorithmClass  # Diagnostics Data Import
            DemDebounceMonitorInternal  # Diagnostics Data Import
              DemCallbackGetFDC  # Diagnostics Data Import
      DtcClass_DTC_0x000080 (DemDTCClass): DemUdsDTC=128, DemFunctionalGroupIdentifier=51, DemDTCAttributesRef=DtcAttributes_41914fb7  # Diagnostics Data Import
      DTC_0x000018 (DemEventParameter):  # Diagnostics Data Import
        DemEventKind = DEM_EVENT_KIND_SWC
        DemDTCClassRef = DtcClass_DTC_0x000018
        DemExtendedDataClassRef = ExtendedDataClass_4af7fffc
        DemFreezeFrameRecNumClassRef = /InitialEcuC/
        DemOBDFreezeFrameClassRef = FreezeFrame_51eb4bef
        DemEventClass: DemEventSignificance=DEM_EVENT_SIGNIFICANCE_FAULT, DemAgingCycleRef=PowerCycle, DemOperationCycleRef=PowerCycle  # Diagnostics Data Import
          DemDebounceAlgorithmClass  # Diagnostics Data Import
            DemDebounceMonitorInternal  # Diagnostics Data Import
              DemCallbackGetFDC  # Diagnostics Data Import
      DtcClass_DTC_0x000018 (DemDTCClass): DemUdsDTC=24, DemFunctionalGroupIdentifier=51, DemDTCAttributesRef=DtcAttributes_41914fb7  # Diagnostics Data Import
      DTC_0x000016 (DemEventParameter):  # Diagnostics Data Import
        DemEventKind = DEM_EVENT_KIND_SWC
        DemDTCClassRef = DtcClass_DTC_0x000016
        DemExtendedDataClassRef = ExtendedDataClass_4af7fffc
        DemFreezeFrameRecNumClassRef = /InitialEcuC/
        DemOBDFreezeFrameClassRef = FreezeFrame_51eb4bef
        DemEventClass: DemEventSignificance=DEM_EVENT_SIGNIFICANCE_FAULT, DemAgingCycleRef=PowerCycle, DemOperationCycleRef=PowerCycle  # Diagnostics Data Import
          DemDebounceAlgorithmClass  # Diagnostics Data Import
            DemDebounceMonitorInternal  # Diagnostics Data Import
              DemCallbackGetFDC  # Diagnostics Data Import
      DtcClass_DTC_0x000016 (DemDTCClass): DemUdsDTC=22, DemFunctionalGroupIdentifier=51, DemDTCAttributesRef=DtcAttributes_41914fb7  # Diagnostics Data Import
      DTC_0x000015 (DemEventParameter):  # Diagnostics Data Import
        DemEventKind = DEM_EVENT_KIND_SWC
        DemDTCClassRef = DtcClass_DTC_0x000015
        DemExtendedDataClassRef = ExtendedDataClass_4af7fffc
        DemFreezeFrameRecNumClassRef = /InitialEcuC/
        DemOBDFreezeFrameClassRef = FreezeFrame_51eb4bef
        DemEventClass: DemEventSignificance=DEM_EVENT_SIGNIFICANCE_FAULT, DemAgingCycleRef=PowerCycle, DemOperationCycleRef=PowerCycle  # Diagnostics Data Import
          DemDebounceAlgorithmClass  # Diagnostics Data Import
            DemDebounceMonitorInternal  # Diagnostics Data Import
              DemCallbackGetFDC  # Diagnostics Data Import
      DtcClass_DTC_0x000015 (DemDTCClass): DemUdsDTC=21, DemFunctionalGroupIdentifier=51, DemDTCAttributesRef=DtcAttributes_41914fb7  # Diagnostics Data Import
      DTC_0x000012 (DemEventParameter):  # Diagnostics Data Import
        DemEventKind = DEM_EVENT_KIND_SWC
        DemDTCClassRef = DtcClass_DTC_0x000012
        DemExtendedDataClassRef = ExtendedDataClass_4af7fffc
        DemFreezeFrameRecNumClassRef = /InitialEcuC/
        DemOBDFreezeFrameClassRef = FreezeFrame_51eb4bef
        DemEventClass: DemEventSignificance=DEM_EVENT_SIGNIFICANCE_FAULT, DemAgingCycleRef=PowerCycle, DemOperationCycleRef=PowerCycle  # Diagnostics Data Import
          DemDebounceAlgorithmClass  # Diagnostics Data Import
            DemDebounceMonitorInternal  # Diagnostics Data Import
              DemCallbackGetFDC  # Diagnostics Data Import
      DtcClass_DTC_0x000012 (DemDTCClass): DemUdsDTC=18, DemFunctionalGroupIdentifier=51, DemDTCAttributesRef=DtcAttributes_41914fb7  # Diagnostics Data Import
      DtcAttributes_41914fb7 (DemDTCAttributes): DemMemoryDestinationRef=PrimaryMemory  # Diagnostics Data Import
