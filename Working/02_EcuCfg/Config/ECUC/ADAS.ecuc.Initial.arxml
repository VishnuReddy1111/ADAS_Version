[part 8 of 8: package /InitialEcuC]
AUTOSAR XML (schema 4-3-0)
package /InitialEcuC  (continued)
  module config EcuC
    EcucPduCollection: PduIdTypeEnum=UINT16, PduLengthTypeEnum=UINT16
      356 x Pdu:
        Airbag_10_XIX_HCP5_CANFD01_6624abf2_Rx: DynamicLength=false, PduLength=16, SysTPduToFrameMappingRef=PTF_Airbag_10_XIX_HCP5_CANFD01
        Airbag_10_XIX_HCP5_CANFD01_7f2c77c5_Rx: DynamicLength=false, PduLength=16
        BJB_08_XIX_BMC_CAN01_1db9ae10_Rx: DynamicLength=false, PduLength=8
        BJB_08_XIX_BMC_CAN01_7b6df5c6_Rx: DynamicLength=false, PduLength=8, SysTPduToFrameMappingRef=PTF_BJB_08_XIX_BMC_CAN01
        BJB_10_XIX_BMC_CAN01_E2E_04bd7411_Rx: DynamicLength=false, PduLength=8, SysTPduToFrameMappingRef=PTF_BJB_10_E2E_XIX_BMC_CAN01
        BJB_10_XIX_BMC_CAN01_E2E_968516b3_Rx: DynamicLength=false, PduLength=8
        BJB_11_XIX_BMC_CAN01_E2E_416796eb_Rx: DynamicLength=false, PduLength=8
        BJB_11_XIX_BMC_CAN01_E2E_893589f3_Rx: DynamicLength=false, PduLength=8, SysTPduToFrameMappingRef=PTF_BJB_11_E2E_XIX_BMC_CAN01
        BJB_12_XIX_BMC_CAN01_E2E_c4dd8994_Rx: DynamicLength=false, PduLength=8, SysTPduToFrameMappingRef=PTF_BJB_12_E2E_XIX_BMC_CAN01
        BJB_12_XIX_BMC_CAN01_E2E_e2311042_Rx: DynamicLength=false, PduLength=8
        BJB_13_XIX_BMC_CAN01_E2E_35d3901a_Rx: DynamicLength=false, PduLength=8
        BJB_13_XIX_BMC_CAN01_E2E_49557476_Rx: DynamicLength=false, PduLength=8, SysTPduToFrameMappingRef=PTF_BJB_13_E2E_XIX_BMC_CAN01
        BJB_CALID_01_XIX_BMC_CAN01_89dc60ad_Rx: DynamicLength=false, PduLength=8, SysTPduToFrameMappingRef=PTF_BJB_CALID_01_XIX_BMC_CAN01
        BJB_CALID_01_XIX_BMC_CAN01_adee7d66_Rx: DynamicLength=false, PduLength=8
        BJB_CALID_02_XIX_BMC_CAN01_bc93171f_Rx: DynamicLength=false, PduLength=8
        BJB_CALID_02_XIX_BMC_CAN01_e45a93f7_Rx: DynamicLength=false, PduLength=8, SysTPduToFrameMappingRef=PTF_BJB_CALID_02_XIX_BMC_CAN01
        BJB_CVN_01_XIX_BMC_CAN01_301c1ddb_Rx: DynamicLength=false, PduLength=8
        BJB_CVN_01_XIX_BMC_CAN01_4f7fa9e3_Rx: DynamicLength=false, PduLength=8, SysTPduToFrameMappingRef=PTF_BJB_CVN_01_XIX_BMC_CAN01
        BMC_CMC_Temperatur_01_XIX_HCP5_CANFD01_0fcecf3e_Tx: DynamicLength=false, PduLength=64, SysTPduToFrameMappingRef=PTF_BMC_CMC_Temperatur_01_XIX_HCP5_CANFD01
        BMC_CMC_Temperatur_01_XIX_HCP5_CANFD01_13d55235_Tx: DynamicLength=false, PduLength=64
        BMC_CMC_Temperatur_02_XIX_HCP5_CANFD01_25727fb6_Tx: DynamicLength=false, PduLength=24, SysTPduToFrameMappingRef=PTF_BMC_CMC_Temperatur_02_XIX_HCP5_CANFD01
        BMC_CMC_Temperatur_02_XIX_HCP5_CANFD01_f9538f57_Tx: DynamicLength=false, PduLength=24
        BMC_CMC_Temperatur_03_XIX_HCP5_CANFD01_160139b6_Tx: DynamicLength=false, PduLength=64
        BMC_CMC_Temperatur_03_XIX_HCP5_CANFD01_8a36edf1_Tx: DynamicLength=false, PduLength=64, SysTPduToFrameMappingRef=PTF_BMC_CMC_Temperatur_03_XIX_HCP5_CANFD01
        BMC_CMC_Zellspannung_01_XIX_HCP5_CANFD01_e1187d1c_Tx: DynamicLength=false, PduLength=64, SysTPduToFrameMappingRef=PTF_BMC_CMC_Zellspannung_01_XIX_HCP5_CANFD01
        BMC_CMC_Zellspannung_01_XIX_HCP5_CANFD01_f76fbfe9_Tx: DynamicLength=false, PduLength=64
        BMC_CMC_Zellspannung_02_XIX_HCP5_CANFD01_1de9628b_Tx: DynamicLength=false, PduLength=64
        BMC_CMC_Zellspannung_02_XIX_HCP5_CANFD01_cba4cd94_Tx: DynamicLength=false, PduLength=64, SysTPduToFrameMappingRef=PTF_BMC_CMC_Zellspannung_02_XIX_HCP5_CANFD01
        BMC_CMC_Zellspannung_03_XIX_HCP5_CANFD01_64e05fd3_Tx: DynamicLength=false, PduLength=64, SysTPduToFrameMappingRef=PTF_BMC_CMC_Zellspannung_03_XIX_HCP5_CANFD01
        BMC_CMC_Zellspannung_03_XIX_HCP5_CANFD01_f2bbd46a_Tx: DynamicLength=false, PduLength=64
        BMC_CMC_Zellspannung_04_XIX_HCP5_CANFD01_1395de0e_Tx: DynamicLength=false, PduLength=64
        BMC_CMC_Zellspannung_04_XIX_HCP5_CANFD01_9eddac84_Tx: DynamicLength=false, PduLength=64, SysTPduToFrameMappingRef=PTF_BMC_CMC_Zellspannung_04_XIX_HCP5_CANFD01
        BMC_CMC_Zellspannung_05_XIX_HCP5_CANFD01_31993ec3_Tx: DynamicLength=false, PduLength=64, SysTPduToFrameMappingRef=PTF_BMC_CMC_Zellspannung_05_XIX_HCP5_CANFD01
        BMC_CMC_Zellspannung_05_XIX_HCP5_CANFD01_fcc768ef_Tx: DynamicLength=false, PduLength=64
        BMC_HV_01_E2E_SOK_XIX_HCP5_CANFD01_09a7f969_Tx: DynamicLength=false, PduLength=20, SysTPduToFrameMappingRef=PTF_BMC_HV_01_E2E_SOK_XIX_HCP5_CANFD01
        BMC_HV_01_E2E_SOK_XIX_HCP5_CANFD01_ad756307_Tx: DynamicLength=false, PduLength=20
        BMC_HV_01_XIX_HCP5_CANFD01_E2E_fcbbcae3_Tx: DynamicLength=false, PduLength=16
        BMC_HV_02_E2E_SOK_XIX_HCP5_CANFD01_4f75cc0d_Tx: DynamicLength=false, PduLength=48, SysTPduToFrameMappingRef=PTF_BMC_HV_02_E2E_SOK_XIX_HCP5_CANFD01
        BMC_HV_02_E2E_SOK_XIX_HCP5_CANFD01_5f228eff_Tx: DynamicLength=false, PduLength=48
        BMC_HV_02_XIX_HCP5_CANFD01_E2E_c5c367a3_Tx: DynamicLength=false, PduLength=44
        BMC_HV_03_XIX_HCP5_CANFD01_0617c15c_Tx: DynamicLength=false, PduLength=24
        BMC_HV_03_XIX_HCP5_CANFD01_58321150_Tx: DynamicLength=false, PduLength=24, SysTPduToFrameMappingRef=PTF_BMC_HV_03_XIX_HCP5_CANFD01
        BMC_HV_04_XIX_BMC_CAN01_E2E_24b17933_Tx: DynamicLength=false, PduLength=8, SysTPduToFrameMappingRef=PTF_BMC_HV_04_E2E_XIX_BMC_CAN01
        BMC_HV_04_XIX_BMC_CAN01_E2E_a4a2e7f5_Tx: DynamicLength=false, PduLength=8
        BMC_HV_05_XIX_HCP5_CANFD01_086b7dd9_Tx: DynamicLength=false, PduLength=8
        BMC_HV_05_XIX_HCP5_CANFD01_0d4b7040_Tx: DynamicLength=false, PduLength=8, SysTPduToFrameMappingRef=PTF_BMC_HV_05_XIX_HCP5_CANFD01
        BMC_HV_06_SOK_XIX_HCP5_CANFD01_daff2390_Tx: DynamicLength=false, PduLength=12, SysTPduToFrameMappingRef=PTF_BMC_HV_06_SOK_XIX_HCP5_CANFD01
        BMC_HV_06_SOK_XIX_HCP5_CANFD01_e20cafa8_Tx: DynamicLength=false, PduLength=12
        BMC_HV_06_XIX_HCP5_CANFD01_e2eda0bb_Tx: DynamicLength=false, PduLength=8
        BMC_HV_07_SOK_XIX_HCP5_CANFD01_f0d71bf2_Tx: DynamicLength=false, PduLength=12, SysTPduToFrameMappingRef=PTF_BMC_HV_07_SOK_XIX_HCP5_CANFD01
        BMC_HV_07_SOK_XIX_HCP5_CANFD01_f524cb68_Tx: DynamicLength=false, PduLength=12
        BMC_HV_07_XIX_HCP5_CANFD01_0dbf165a_Tx: DynamicLength=false, PduLength=8
        BMC_HV_08_SOK_XIX_HCP5_CANFD01_29bed328_Tx: DynamicLength=false, PduLength=48
        BMC_HV_08_SOK_XIX_HCP5_CANFD01_ac3f778d_Tx: DynamicLength=false, PduLength=48, SysTPduToFrameMappingRef=PTF_BMC_HV_08_SOK_XIX_HCP5_CANFD01
        BMC_HV_08_XIX_HCP5_CANFD01_fbc0b232_Tx: DynamicLength=false, PduLength=44
        BMC_HV_09_SOK_XIX_HCP5_CANFD01_3e96b7e8_Tx: DynamicLength=false, PduLength=20
        BMC_HV_09_SOK_XIX_HCP5_CANFD01_86174fef_Tx: DynamicLength=false, PduLength=20, SysTPduToFrameMappingRef=PTF_BMC_HV_09_SOK_XIX_HCP5_CANFD01
        BMC_HV_09_XIX_HCP5_CANFD01_149204d3_Tx: DynamicLength=false, PduLength=16
        BMC_HV_10_XIX_BMC_CAN01_E2E_28add151_Tx: DynamicLength=false, PduLength=8
        BMC_HV_10_XIX_BMC_CAN01_E2E_31888fd1_Tx: DynamicLength=false, PduLength=8, SysTPduToFrameMappingRef=PTF_BMC_HV_10_E2E_XIX_BMC_CAN01
        BMC_HV_11_XIX_BMC_CAN01_E2E_bc007233_Tx: DynamicLength=false, PduLength=8, SysTPduToFrameMappingRef=PTF_BMC_HV_11_E2E_XIX_BMC_CAN01
        BMC_HV_11_XIX_BMC_CAN01_E2E_ff4f5109_Tx: DynamicLength=false, PduLength=8
        BMC_HV_12_XIX_BMC_CAN01_E2E_5c19d7a0_Tx: DynamicLength=false, PduLength=8
        BMC_HV_12_XIX_BMC_CAN01_E2E_f1e87254_Tx: DynamicLength=false, PduLength=8, SysTPduToFrameMappingRef=PTF_BMC_HV_12_E2E_XIX_BMC_CAN01
        BMC_HV_13_XIX_BMC_CAN01_E2E_7c608fb6_Tx: DynamicLength=false, PduLength=8, SysTPduToFrameMappingRef=PTF_BMC_HV_13_E2E_XIX_BMC_CAN01
        BMC_HV_13_XIX_BMC_CAN01_E2E_8bfb57f8_Tx: DynamicLength=false, PduLength=8
        BMC_HV_14_SOK_XIX_HCP5_CANFD01_2d397b18_Tx: DynamicLength=false, PduLength=16, SysTPduToFrameMappingRef=PTF_BMC_HV_14_SOK_XIX_HCP5_CANFD01
        BMC_HV_14_SOK_XIX_HCP5_CANFD01_572f8cfc_Tx: DynamicLength=false, PduLength=16
        BMC_HV_14_XIX_HCP5_CANFD01_30db4b60_Tx: DynamicLength=false, PduLength=12
        CDD_DEV_BJB_Req_01_XIX_BMC_CAN01_3719e18f_Tx: PduLength=8, SysTPduToFrameMappingRef=PTF_DEV_BJB_Req_01_XIX_BMC_CAN01
        CDD_DEV_BJB_Req_01_XIX_HCP5_CANFD01_c982c041_Rx: PduLength=8, SysTPduToFrameMappingRef=PTF_DEV_BJB_Req_01_XIX_HCP5_CANFD01
        CDD_DEV_BJB_Resp_FF_XIX_BMC_CAN01_19d429a9_Rx: PduLength=8, SysTPduToFrameMappingRef=PTF_DEV_BJB_Resp_FF_XIX_BMC_CAN01
        CDD_DEV_BJB_Resp_FF_XIX_HCP5_CANFD01_77e6d841_Tx: PduLength=8, SysTPduToFrameMappingRef=PTF_DEV_BJB_Resp_FF_XIX_HCP5_CANFD01
        CDD_DEV_BMS_Resp_00_XIX_BMC_CAN01_7e9f0997_Rx: PduLength=8, SysTPduToFrameMappingRef=PTF_DEV_BMS_Resp_00_XIX_BMC_CAN01
        CDD_DEV_BMS_Resp_01_XIX_BMC_CAN01_5a1d58a1_Rx: PduLength=8, SysTPduToFrameMappingRef=PTF_DEV_BMS_Resp_01_XIX_BMC_CAN01
        CDD_DEV_BMS_Resp_176_XIX_BMC_CAN01_b99d2149_Rx: PduLength=8, SysTPduToFrameMappingRef=PTF_DEV_BMS_Resp_176_XIX_BMC_CAN01
        CDD_DEV_BMS_Resp_177_XIX_BMC_CAN01_9d1f707f_Rx: PduLength=8, SysTPduToFrameMappingRef=PTF_DEV_BMS_Resp_177_XIX_BMC_CAN01
        CDD_DEV_BMS_Resp_178_XIX_BMC_CAN01_9df3480c_Rx: PduLength=8, SysTPduToFrameMappingRef=PTF_DEV_BMS_Resp_178_XIX_BMC_CAN01
        CDD_DEV_BMS_Resp_192_XIX_BMC_CAN01_2d06bee7_Rx: PduLength=8, SysTPduToFrameMappingRef=PTF_DEV_BMS_Resp_192_XIX_BMC_CAN01
        CDD_DEV_BMS_Resp_193_XIX_BMC_CAN01_0984efd1_Rx: PduLength=8, SysTPduToFrameMappingRef=PTF_DEV_BMS_Resp_193_XIX_BMC_CAN01
        CDD_DEV_BMS_Resp_194_XIX_BMC_CAN01_f60b5853_Rx: PduLength=8, SysTPduToFrameMappingRef=PTF_DEV_BMS_Resp_194_XIX_BMC_CAN01
        CDD_HCP5_CANFD01_XIX_TPCHType_CANFD_DAAP_XIX_0x1C403F7B_XIX_0x1C423F7B_XIX_Physical_1330e22e_Rx: PduLength=512
        CDD_HCP5_CANFD01_XIX_TPCHType_CANFD_DAAP_XIX_0x1C403F7B_XIX_0x1C423F7B_XIX_Physical_3bee6131_Rx: PduLength=512
        CDD_HCP5_CANFD01_XIX_TPCHType_CANFD_DAAP_XIX_0x1C413FDD_XIX_Functional_6530545d_Rx: PduLength=62
        CDD_HCP5_CANFD01_XIX_TPCHType_CANFD_DAAP_XIX_0x1C413FDD_XIX_Functional_880c97f7_Rx: PduLength=62
        CDD_HCP5_CANFD01_XIX_TPCHType_CANFD_DAAP_XIX_0x1C423F7B_XIX_0x1C403F7B_XIX_Physical_53df2b54_Tx: PduLength=512
        CDD_HCP5_CANFD01_XIX_TPCHType_CANFD_DAAP_XIX_0x1C423F7B_XIX_0x1C403F7B_XIX_Physical_d2cfa6c1_Tx: PduLength=512
        CDD_XCP_BJB_CRO_01_XIX_BMC_CAN01_9130eaf8_Tx: PduLength=8, SysTPduToFrameMappingRef=PTF_XCP_BJB_CRO_01_XIX_BMC_CAN01
        CDD_XCP_BJB_CRO_01_XIX_HCP5_CANFD01_a8ba0d4f_Rx: PduLength=8, SysTPduToFrameMappingRef=PTF_XCP_BJB_CRO_01_XIX_HCP5_CANFD01
        CDD_XCP_BJB_DTO_01_XIX_BMC_CAN01_382ede28_Rx: PduLength=8, SysTPduToFrameMappingRef=PTF_XCP_BJB_DTO_01_XIX_BMC_CAN01
        CDD_XCP_BJB_DTO_01_XIX_HCP5_CANFD01_884a4965_Tx: PduLength=8, SysTPduToFrameMappingRef=PTF_XCP_BJB_DTO_01_XIX_HCP5_CANFD01
        Charisma_20_XIX_HCP5_CANFD01_be5e5e8a_Rx: DynamicLength=false, PduLength=20, SysTPduToFrameMappingRef=PTF_Charisma_20_XIX_HCP5_CANFD01
        Charisma_20_XIX_HCP5_CANFD01_f51eced8_Rx: DynamicLength=false, PduLength=20
        ClampControl_01_XIX_BMC_CAN01_6c74ee25_Tx: DynamicLength=false, PduLength=8, SysTPduToFrameMappingRef=PTF_ClampControl_01_XIX_BMC_CAN01
        ClampControl_01_XIX_HCP5_CANFD01_5af08b97_Rx: DynamicLength=false, PduLength=8, SysTPduToFrameMappingRef=PTF_ClampControl_01_XIX_HCP5_CANFD01
        ClampControl_01_XIX_HCP5_CANFD01_8c24343b_Rx: DynamicLength=false, PduLength=8
        DAAP_Funkt_Req_MC_FD_XIX_HCP5_CANFD01_dbe988f8_Rx: DynamicLength=false, PduLength=8, SysTPduToFrameMappingRef=PTF_DAAP_Funkt_Req_MC_FD_XIX_HCP5_CANFD01
        DAAP_Hybrid_01_Req_FD_XIX_HCP5_CANFD01_25e2ca12_Rx: DynamicLength=false, PduLength=64, SysTPduToFrameMappingRef=PTF_DAAP_Hybrid_01_Req_FD_XIX_HCP5_CANFD01
        DAAP_Hybrid_01_Resp_FD_XIX_HCP5_CANFD01_a869e288_Tx: DynamicLength=false, PduLength=64, SysTPduToFrameMappingRef=PTF_DAAP_Hybrid_01_Resp_FD_XIX_HCP5_CANFD01
        DCDC_04_XIX_HCP5_CANFD01_622db5e5_Rx: DynamicLength=false, PduLength=8, SysTPduToFrameMappingRef=PTF_DCDC_04_XIX_HCP5_CANFD01
        DCDC_04_XIX_HCP5_CANFD01_8ca88b97_Rx: DynamicLength=false, PduLength=8
        DCDC_NV_CALID_XIX_HCP5_CANFD01_004a20bd_Rx: DynamicLength=false, PduLength=16, SysTPduToFrameMappingRef=PTF_DCDC_NV_CALID_XIX_HCP5_CANFD01
        DCDC_NV_CALID_XIX_HCP5_CANFD01_46b970f2_Rx: DynamicLength=false, PduLength=16
        DCDC_NV_CVN_XIX_HCP5_CANFD01_01267e2b_Rx: DynamicLength=false, PduLength=8, SysTPduToFrameMappingRef=PTF_DCDC_NV_CVN_XIX_HCP5_CANFD01
        DCDC_NV_CVN_XIX_HCP5_CANFD01_55665719_Rx: DynamicLength=false, PduLength=8
        DCDC_NV_Komponentenfehler_01_XIX_HCP5_CANFD01_2b1a3644_Rx: DynamicLength=false, PduLength=8, SysTPduToFrameMappingRef=PTF_DCDC_NV_Komponentenfehler_01_XIX_HCP5_CANFD01
        DCDC_NV_Komponentenfehler_01_XIX_HCP5_CANFD01_dd687766_Rx: DynamicLength=false, PduLength=8
        DCDC_NV_Komponentenfehler_02_XIX_HCP5_CANFD01_01a686cc_Rx: DynamicLength=false, PduLength=8, SysTPduToFrameMappingRef=PTF_DCDC_NV_Komponentenfehler_02_XIX_HCP5_CANFD01
        DCDC_NV_Komponentenfehler_02_XIX_HCP5_CANFD01_37eeaa04_Rx: DynamicLength=false, PduLength=8
        DCDC_NV_Komponentenfehler_03_XIX_HCP5_CANFD01_aee2148b_Rx: DynamicLength=false, PduLength=8, SysTPduToFrameMappingRef=PTF_DCDC_NV_Komponentenfehler_03_XIX_HCP5_CANFD01
        DCDC_NV_Komponentenfehler_03_XIX_HCP5_CANFD01_d8bc1ce5_Rx: DynamicLength=false, PduLength=8
        DCDC_NV_Komponentenfehler_04_XIX_HCP5_CANFD01_39921681_Rx: DynamicLength=false, PduLength=8
        DCDC_NV_Komponentenfehler_04_XIX_HCP5_CANFD01_54dfe7dc_Rx: DynamicLength=false, PduLength=8, SysTPduToFrameMappingRef=PTF_DCDC_NV_Komponentenfehler_04_XIX_HCP5_CANFD01
        DCM_BMC_CAN01_XIX_TPCHType_CANHS_Flash_DIA_XIX_0x17FC16D0_XIX_0x17FE16D0_XIX_Physical_970a5f86_Tx: DynamicLength=true, PduLength=512
        DCM_BMC_CAN01_XIX_TPCHType_CANHS_Flash_DIA_XIX_0x17FC16D0_XIX_0x17FE16D0_XIX_Physical_9f19b594_Tx: DynamicLength=true, PduLength=512
        DCM_BMC_CAN01_XIX_TPCHType_CANHS_Flash_DIA_XIX_0x17FC17B1_XIX_0x17FE17B1_XIX_Physical_62358056_Tx: DynamicLength=true, PduLength=512
        DCM_BMC_CAN01_XIX_TPCHType_CANHS_Flash_DIA_XIX_0x17FC17B1_XIX_0x17FE17B1_XIX_Physical_91cacfde_Tx: DynamicLength=true, PduLength=512
        DCM_BMC_CAN01_XIX_TPCHType_CANHS_Flash_DIA_XIX_0x17FC17B2_XIX_0x17FE17B2_XIX_Physical_8c0f4baf_Tx: DynamicLength=true, PduLength=512
        DCM_BMC_CAN01_XIX_TPCHType_CANHS_Flash_DIA_XIX_0x17FC17B2_XIX_0x17FE17B2_XIX_Physical_bb5ccee1_Tx: DynamicLength=true, PduLength=512
        DCM_BMC_CAN01_XIX_TPCHType_CANHS_Flash_DIA_XIX_0x17FE16D0_XIX_0x17FC16D0_XIX_Physical_2f598129_Rx: DynamicLength=true, PduLength=512
        DCM_BMC_CAN01_XIX_TPCHType_CANHS_Flash_DIA_XIX_0x17FE16D0_XIX_0x17FC16D0_XIX_Physical_8400c53b_Rx: DynamicLength=true, PduLength=512
        DCM_BMC_CAN01_XIX_TPCHType_CANHS_Flash_DIA_XIX_0x17FE17B1_XIX_0x17FC17B1_XIX_Physical_8ad3bf71_Rx: DynamicLength=true, PduLength=512
        DCM_BMC_CAN01_XIX_TPCHType_CANHS_Flash_DIA_XIX_0x17FE17B1_XIX_0x17FC17B1_XIX_Physical_da665ef9_Rx: DynamicLength=true, PduLength=512
        DCM_BMC_CAN01_XIX_TPCHType_CANHS_Flash_DIA_XIX_0x17FE17B2_XIX_0x17FC17B2_XIX_Physical_030f104e_Rx: DynamicLength=true, PduLength=512
        DCM_BMC_CAN01_XIX_TPCHType_CANHS_Flash_DIA_XIX_0x17FE17B2_XIX_0x17FC17B2_XIX_Physical_97163b00_Rx: DynamicLength=true, PduLength=512
        DCM_BMC_CAN01_XIX_TPCHType_CANHS_ISO_Diagnose_XIX_0x700_XIX_Functional_770cc244_Tx: DynamicLength=true, PduLength=6
        DCM_BMC_CAN01_XIX_TPCHType_CANHS_OBDC_Diagnose_XIX_0x17FD0200_XIX_Functional_e9b636f2_Tx: DynamicLength=true, PduLength=6
        DCM_BMC_CAN01_XIX_TPCHType_CANHS_OBDC_SSN_Diagnose_XIX_0x17FC70D0_XIX_0x17FE70D0_XIX_Physical_50ea923c_Tx: DynamicLength=true, PduLength=512
        DCM_BMC_CAN01_XIX_TPCHType_CANHS_OBDC_SSN_Diagnose_XIX_0x17FC70D0_XIX_0x17FE70D0_XIX_Physical_ec851d39_Tx: DynamicLength=true, PduLength=512
        DCM_BMC_CAN01_XIX_TPCHType_CANHS_OBDC_SSN_Diagnose_XIX_0x17FC71B1_XIX_0x17FE71B1_XIX_Physical_a5d54dec_Tx: DynamicLength=true, PduLength=512
        DCM_BMC_CAN01_XIX_TPCHType_CANHS_OBDC_SSN_Diagnose_XIX_0x17FC71B1_XIX_0x17FE71B1_XIX_Physical_e2566773_Tx: DynamicLength=true, PduLength=512
        DCM_BMC_CAN01_XIX_TPCHType_CANHS_OBDC_SSN_Diagnose_XIX_0x17FC71B2_XIX_0x17FE71B2_XIX_Physical_7cbc035b_Tx: DynamicLength=true, PduLength=512
        DCM_BMC_CAN01_XIX_TPCHType_CANHS_OBDC_SSN_Diagnose_XIX_0x17FC71B2_XIX_0x17FE71B2_XIX_Physical_ff93e302_Tx: DynamicLength=true, PduLength=512
        DCM_BMC_CAN01_XIX_TPCHType_CANHS_OBDC_SSN_Diagnose_XIX_0x17FE70D0_XIX_0x17FC70D0_XIX_Physical_e8b94c93_Rx: DynamicLength=true, PduLength=512
        DCM_BMC_CAN01_XIX_TPCHType_CANHS_OBDC_SSN_Diagnose_XIX_0x17FE70D0_XIX_0x17FC70D0_XIX_Physical_f79c6d96_Rx: DynamicLength=true, PduLength=512
        DCM_BMC_CAN01_XIX_TPCHType_CANHS_OBDC_SSN_Diagnose_XIX_0x17FE71B1_XIX_0x17FC71B1_XIX_Physical_1d869343_Rx: DynamicLength=true, PduLength=512
        DCM_BMC_CAN01_XIX_TPCHType_CANHS_OBDC_SSN_Diagnose_XIX_0x17FE71B1_XIX_0x17FC71B1_XIX_Physical_f94f17dc_Rx: DynamicLength=true, PduLength=512
        DCM_BMC_CAN01_XIX_TPCHType_CANHS_OBDC_SSN_Diagnose_XIX_0x17FE71B2_XIX_0x17FC71B2_XIX_Physical_c4efddf4_Rx: DynamicLength=true, PduLength=512
        DCM_BMC_CAN01_XIX_TPCHType_CANHS_OBDC_SSN_Diagnose_XIX_0x17FE71B2_XIX_0x17FC71B2_XIX_Physical_e48a93ad_Rx: DynamicLength=true, PduLength=512
        DCM_HCP5_CANFD01_XIX_TPCHType_CANFD_ISO_Diagnose_XIX_0x1C40007B_XIX_0x1C42007B_XIX_Physical_238d3514_Rx: DynamicLength=true, PduLength=512
        DCM_HCP5_CANFD01_XIX_TPCHType_CANFD_ISO_Diagnose_XIX_0x1C40007B_XIX_0x1C42007B_XIX_Physical_e79447d3_Rx: DynamicLength=true, PduLength=512
        DCM_HCP5_CANFD01_XIX_TPCHType_CANFD_ISO_Diagnose_XIX_0x1C410000_XIX_Functional_012ca6ee_Rx: DynamicLength=true, PduLength=62
        DCM_HCP5_CANFD01_XIX_TPCHType_CANFD_ISO_Diagnose_XIX_0x1C410000_XIX_Functional_905f44f1_Rx: DynamicLength=true, PduLength=62
        DCM_HCP5_CANFD01_XIX_TPCHType_CANFD_ISO_Diagnose_XIX_0x1C42007B_XIX_0x1C40007B_XIX_Physical_266b033c_Tx: DynamicLength=true, PduLength=512
        DCM_HCP5_CANFD01_XIX_TPCHType_CANFD_ISO_Diagnose_XIX_0x1C42007B_XIX_0x1C40007B_XIX_Physical_4bbc7f71_Tx: DynamicLength=true, PduLength=512
        DCM_HCP5_CANFD01_XIX_TPCHType_CANFD_OBDC_Diagnose_XIX_0x1C40027B_XIX_0x1C42027B_XIX_Physical_8b2e4924_Rx: DynamicLength=true, PduLength=512
        DCM_HCP5_CANFD01_XIX_TPCHType_CANFD_OBDC_Diagnose_XIX_0x1C40027B_XIX_0x1C42027B_XIX_Physical_a0b6e66f_Rx: DynamicLength=true, PduLength=512
        DCM_HCP5_CANFD01_XIX_TPCHType_CANFD_OBDC_Diagnose_XIX_0x1C410200_XIX_Functional_967cb818_Rx: DynamicLength=true, PduLength=62
        DCM_HCP5_CANFD01_XIX_TPCHType_CANFD_OBDC_Diagnose_XIX_0x1C410200_XIX_Functional_c81dd985_Rx: DynamicLength=true, PduLength=62
        DCM_HCP5_CANFD01_XIX_TPCHType_CANFD_OBDC_Diagnose_XIX_0x1C42027B_XIX_0x1C40027B_XIX_Physical_4ad10dcb_Tx: DynamicLength=true, PduLength=512
        DCM_HCP5_CANFD01_XIX_TPCHType_CANFD_OBDC_Diagnose_XIX_0x1C42027B_XIX_0x1C40027B_XIX_Physical_c887ac0a_Tx: DynamicLength=true, PduLength=512
        DCM_HCP5_CANFD01_XIX_TPCHType_CANHS_Flash_DIA_XIX_0x17FC16D0_XIX_0x17FE16D0_XIX_Physical_33952be0_Rx: DynamicLength=true, PduLength=512
        DCM_HCP5_CANFD01_XIX_TPCHType_CANHS_Flash_DIA_XIX_0x17FC16D0_XIX_0x17FE16D0_XIX_Physical_cdd15d85_Rx: DynamicLength=true, PduLength=512
        DCM_HCP5_CANFD01_XIX_TPCHType_CANHS_Flash_DIA_XIX_0x17FC17B1_XIX_0x17FE17B1_XIX_Physical_38ee8255_Rx: DynamicLength=true, PduLength=512
        DCM_HCP5_CANFD01_XIX_TPCHType_CANHS_Flash_DIA_XIX_0x17FC17B1_XIX_0x17FE17B1_XIX_Physical_849231ea_Rx: DynamicLength=true, PduLength=512
        DCM_HCP5_CANFD01_XIX_TPCHType_CANHS_Flash_DIA_XIX_0x17FC17B2_XIX_0x17FE17B2_XIX_Physical_654058e0_Rx: DynamicLength=true, PduLength=512
        DCM_HCP5_CANFD01_XIX_TPCHType_CANHS_Flash_DIA_XIX_0x17FC17B2_XIX_0x17FE17B2_XIX_Physical_e187cce2_Rx: DynamicLength=true, PduLength=512
        DCM_HCP5_CANFD01_XIX_TPCHType_CANHS_Flash_DIA_XIX_0x17FE16D0_XIX_0x17FC16D0_XIX_Physical_7582832a_Tx: DynamicLength=true, PduLength=512
        DCM_HCP5_CANFD01_XIX_TPCHType_CANHS_Flash_DIA_XIX_0x17FE16D0_XIX_0x17FC16D0_XIX_Physical_aae5e090_Tx: DynamicLength=true, PduLength=512
        DCM_HCP5_CANFD01_XIX_TPCHType_CANHS_Flash_DIA_XIX_0x17FE17B1_XIX_0x17FC17B1_XIX_Physical_1de2fa9a_Tx: DynamicLength=true, PduLength=512
        DCM_HCP5_CANFD01_XIX_TPCHType_CANHS_Flash_DIA_XIX_0x17FE17B1_XIX_0x17FC17B1_XIX_Physical_80bd5cfa_Tx: DynamicLength=true, PduLength=512
        DCM_HCP5_CANFD01_XIX_TPCHType_CANHS_Flash_DIA_XIX_0x17FE17B2_XIX_0x17FC17B2_XIX_Physical_59d4124d_Tx: DynamicLength=true, PduLength=512
        DCM_HCP5_CANFD01_XIX_TPCHType_CANHS_Flash_DIA_XIX_0x17FE17B2_XIX_0x17FC17B2_XIX_Physical_fc309390_Tx: DynamicLength=true, PduLength=512
        DCM_HCP5_CANFD01_XIX_TPCHType_CANHS_ISO_Diagnose_XIX_0x17FC007B_XIX_0x17FE007B_XIX_Physical_f4a1250c_Rx: DynamicLength=true, PduLength=512
        DCM_HCP5_CANFD01_XIX_TPCHType_CANHS_ISO_Diagnose_XIX_0x17FC007B_XIX_0x17FE007B_XIX_Physical_fb6bd0a7_Rx: DynamicLength=true, PduLength=512
        DCM_HCP5_CANFD01_XIX_TPCHType_CANHS_ISO_Diagnose_XIX_0x17FE007B_XIX_0x17FC007B_XIX_Physical_4cf2fba3_Tx: DynamicLength=true, PduLength=512
        DCM_HCP5_CANFD01_XIX_TPCHType_CANHS_ISO_Diagnose_XIX_0x17FE007B_XIX_0x17FC007B_XIX_Physical_621b1bd7_Tx: DynamicLength=true, PduLength=512
        DCM_HCP5_CANFD01_XIX_TPCHType_CANHS_ISO_Diagnose_XIX_0x700_XIX_Functional_7a5202d2_Rx: DynamicLength=true, PduLength=62
        DCM_HCP5_CANFD01_XIX_TPCHType_CANHS_ISO_Diagnose_XIX_0x700_XIX_Functional_e754bff6_Rx: DynamicLength=true, PduLength=62
        DCM_HCP5_CANFD01_XIX_TPCHType_CANHS_OBDC_SSN_Diagnose_XIX_0x17FC70D0_XIX_0x17FE70D0_XIX_Physical_43a0bf70_Rx: DynamicLength=true, PduLength=512
        DCM_HCP5_CANFD01_XIX_TPCHType_CANHS_OBDC_SSN_Diagnose_XIX_0x17FC70D0_XIX_0x17FE70D0_XIX_Physical_cd403ce5_Rx: DynamicLength=true, PduLength=512
        DCM_HCP5_CANFD01_XIX_TPCHType_CANHS_OBDC_SSN_Diagnose_XIX_0x17FC71B1_XIX_0x17FE71B1_XIX_Physical_7a4726ef_Rx: DynamicLength=true, PduLength=512
        DCM_HCP5_CANFD01_XIX_TPCHType_CANHS_OBDC_SSN_Diagnose_XIX_0x17FC71B1_XIX_0x17FE71B1_XIX_Physical_b69f60a0_Rx: DynamicLength=true, PduLength=512
        DCM_HCP5_CANFD01_XIX_TPCHType_CANHS_OBDC_SSN_Diagnose_XIX_0x17FC71B2_XIX_0x17FE71B2_XIX_Physical_6ff62e17_Rx: DynamicLength=true, PduLength=512
        DCM_HCP5_CANFD01_XIX_TPCHType_CANHS_OBDC_SSN_Diagnose_XIX_0x17FC71B2_XIX_0x17FE71B2_XIX_Physical_9b954fe5_Rx: DynamicLength=true, PduLength=512
        DCM_HCP5_CANFD01_XIX_TPCHType_CANHS_OBDC_SSN_Diagnose_XIX_0x17FE70D0_XIX_0x17FC70D0_XIX_Physical_5430f795_Tx: DynamicLength=true, PduLength=512
        DCM_HCP5_CANFD01_XIX_TPCHType_CANHS_OBDC_SSN_Diagnose_XIX_0x17FE70D0_XIX_0x17FC70D0_XIX_Physical_fbf361df_Tx: DynamicLength=true, PduLength=512
        DCM_HCP5_CANFD01_XIX_TPCHType_CANHS_OBDC_SSN_Diagnose_XIX_0x17FE71B1_XIX_0x17FC71B1_XIX_Physical_0eccbe0f_Tx: DynamicLength=true, PduLength=512
        DCM_HCP5_CANFD01_XIX_TPCHType_CANHS_OBDC_SSN_Diagnose_XIX_0x17FE71B1_XIX_0x17FC71B1_XIX_Physical_e337ed9f_Tx: DynamicLength=true, PduLength=512
        DCM_HCP5_CANFD01_XIX_TPCHType_CANHS_OBDC_SSN_Diagnose_XIX_0x17FE71B2_XIX_0x17FC71B2_XIX_Physical_02e58495_Tx: DynamicLength=true, PduLength=512
        DCM_HCP5_CANFD01_XIX_TPCHType_CANHS_OBDC_SSN_Diagnose_XIX_0x17FE71B2_XIX_0x17FC71B2_XIX_Physical_d7a5f0b8_Tx: DynamicLength=true, PduLength=512
        DCM_HCP5_CANFD01_XIX_TPCHType_CANHS_OBDx_XIX_0x18DA05F1_XIX_0x18DAF105_XIX_Physical_31397855_Rx: DynamicLength=true, PduLength=512
        DCM_HCP5_CANFD01_XIX_TPCHType_CANHS_OBDx_XIX_0x18DA05F1_XIX_0x18DAF105_XIX_Physical_c08ed539_Rx: DynamicLength=true, PduLength=512
        DCM_HCP5_CANFD01_XIX_TPCHType_CANHS_OBDx_XIX_0x18DAF105_XIX_0x18DA05F1_XIX_Physical_71746075_Tx: DynamicLength=true, PduLength=512
        DCM_HCP5_CANFD01_XIX_TPCHType_CANHS_OBDx_XIX_0x18DAF105_XIX_0x18DA05F1_XIX_Physical_9db247ca_Tx: DynamicLength=true, PduLength=512
        DCM_HCP5_CANFD01_XIX_TPCHType_CANHS_OBDx_XIX_0x18DB33F1_XIX_Functional_06e701c6_Rx: DynamicLength=true, PduLength=62
        DCM_HCP5_CANFD01_XIX_TPCHType_CANHS_OBDx_XIX_0x18DB33F1_XIX_Functional_1f67dc03_Rx: DynamicLength=true, PduLength=62
        DEV_Hybrid_01_Req_00_XIX_HCP5_CANFD01_5661b344_Rx: DynamicLength=false, PduLength=64
        DEV_Hybrid_01_Req_00_XIX_HCP5_CANFD01_91241766_Rx: DynamicLength=false, PduLength=64, SysTPduToFrameMappingRef=PTF_DEV_Hybrid_01_Req_00_XIX_HCP5_CANFD01
        DEV_Hybrid_01_Resp_FF_XIX_HCP5_CANFD01_3aa35b5c_Tx: DynamicLength=false, PduLength=64, SysTPduToFrameMappingRef=PTF_DEV_Hybrid_01_Resp_FF_XIX_HCP5_CANFD01
        DEV_Hybrid_01_Resp_FF_XIX_HCP5_CANFD01_7b20ac63_Tx: DynamicLength=false, PduLength=64
        DIA_BJB_Req_XIX_BMC_CAN01_6c84b0d8_Tx: DynamicLength=false, PduLength=8, SysTPduToFrameMappingRef=PTF_DIA_BJB_Req_XIX_BMC_CAN01
        DIA_BJB_Req_XIX_HCP5_CANFD01_f2b9e65d_Rx: DynamicLength=false, PduLength=8, SysTPduToFrameMappingRef=PTF_DIA_BJB_Req_XIX_HCP5_CANFD01
        DIA_BJB_Resp_XIX_BMC_CAN01_c04d7636_Rx: DynamicLength=false, PduLength=8, SysTPduToFrameMappingRef=PTF_DIA_BJB_Resp_XIX_BMC_CAN01
        DIA_BJB_Resp_XIX_HCP5_CANFD01_6385845c_Tx: DynamicLength=false, PduLength=8, SysTPduToFrameMappingRef=PTF_DIA_BJB_Resp_XIX_HCP5_CANFD01
        DIA_UI2Sens01_Req_XIX_BMC_CAN01_47b20c58_Tx: DynamicLength=false, PduLength=8, SysTPduToFrameMappingRef=PTF_DIA_UI2Sens01_Req_XIX_BMC_CAN01
        DIA_UI2Sens01_Req_XIX_HCP5_CANFD01_d86619ec_Rx: DynamicLength=false, PduLength=8, SysTPduToFrameMappingRef=PTF_DIA_UI2Sens01_Req_XIX_HCP5_CANFD01
        DIA_UI2Sens01_Resp_XIX_BMC_CAN01_2ddec3aa_Rx: DynamicLength=false, PduLength=8, SysTPduToFrameMappingRef=PTF_DIA_UI2Sens01_Resp_XIX_BMC_CAN01
        DIA_UI2Sens01_Resp_XIX_HCP5_CANFD01_dfc9d8b9_Tx: DynamicLength=false, PduLength=8, SysTPduToFrameMappingRef=PTF_DIA_UI2Sens01_Resp_XIX_HCP5_CANFD01
        DIA_UI2Sens02_Req_XIX_BMC_CAN01_0a5a0c3f_Tx: DynamicLength=false, PduLength=8, SysTPduToFrameMappingRef=PTF_DIA_UI2Sens02_Req_XIX_BMC_CAN01
        DIA_UI2Sens02_Req_XIX_HCP5_CANFD01_a61e514a_Rx: DynamicLength=false, PduLength=8, SysTPduToFrameMappingRef=PTF_DIA_UI2Sens02_Req_XIX_HCP5_CANFD01
        DIA_UI2Sens02_Resp_XIX_BMC_CAN01_fe45df51_Rx: DynamicLength=false, PduLength=8, SysTPduToFrameMappingRef=PTF_DIA_UI2Sens02_Resp_XIX_BMC_CAN01
        DIA_UI2Sens02_Resp_XIX_HCP5_CANFD01_e002a62c_Tx: DynamicLength=false, PduLength=8, SysTPduToFrameMappingRef=PTF_DIA_UI2Sens02_Resp_XIX_HCP5_CANFD01
        DS_Hybrid_01_XIX_HCP5_CANFD01_b3d0b839_Tx: DynamicLength=false, PduLength=8
        DS_Hybrid_01_XIX_HCP5_CANFD01_ed9ff9e4_Tx: DynamicLength=false, PduLength=8, SysTPduToFrameMappingRef=PTF_DS_Hybrid_01_XIX_HCP5_CANFD01
        Diagnose_01_XIX_HCP5_CANFD01_426f0ab5_Rx: DynamicLength=false, PduLength=8
        Diagnose_01_XIX_HCP5_CANFD01_95a294dc_Rx: DynamicLength=false, PduLength=8, SysTPduToFrameMappingRef=PTF_Diagnose_01_XIX_HCP5_CANFD01
        ELF_06_XIX_HCP5_CANFD01_21ac90a0_Rx: DynamicLength=false, PduLength=8, SysTPduToFrameMappingRef=PTF_ELF_06_XIX_HCP5_CANFD01
        ELF_06_XIX_HCP5_CANFD01_d78b945c_Rx: DynamicLength=false, PduLength=8
        HCP1_17_XIX_HCP5_CANFD01_3398d6b5_Rx: DynamicLength=false, PduLength=8
        HCP1_17_XIX_HCP5_CANFD01_c544c746_Rx: DynamicLength=false, PduLength=8, SysTPduToFrameMappingRef=PTF_HCP1_17_XIX_HCP5_CANFD01
        HVEM_07_XIX_HCP5_CANFD01_6bc428a9_Rx: DynamicLength=false, PduLength=32, SysTPduToFrameMappingRef=PTF_HVEM_07_XIX_HCP5_CANFD01
        HVEM_07_XIX_HCP5_CANFD01_839f516f_Rx: DynamicLength=false, PduLength=32
        HVK_03_E2E_SOK_XIX_HCP5_CANFD01_17f9ff97_Rx: DynamicLength=false, PduLength=12, SysTPduToFrameMappingRef=PTF_HVK_03_E2E_SOK_XIX_HCP5_CANFD01
        HVK_03_E2E_SOK_XIX_HCP5_CANFD01_32c3c9b9_Rx: DynamicLength=false, PduLength=12
        HVK_03_XIX_HCP5_CANFD01_E2E_8a76edcb_Rx: DynamicLength=false, PduLength=8
        HVLM_13_XIX_HCP5_CANFD01_f1be44f1_Rx: DynamicLength=false, PduLength=32
        HVLM_13_XIX_HCP5_CANFD01_f34a06e4_Rx: DynamicLength=false, PduLength=32, SysTPduToFrameMappingRef=PTF_HVLM_13_XIX_HCP5_CANFD01
        HVLM_14_XIX_HCP5_CANFD01_E2E_2623685a_Rx: DynamicLength=false, PduLength=8, SysTPduToFrameMappingRef=PTF_HVLM_14_E2E_XIX_HCP5_CANFD01
        HVLM_14_XIX_HCP5_CANFD01_E2E_b3d1458f_Rx: DynamicLength=false, PduLength=8
        ISO_Funktionaler_Req_All_XIX_BMC_CAN01_aaf5996b_Tx: DynamicLength=false, PduLength=8, SysTPduToFrameMappingRef=PTF_ISO_Funktionaler_Req_All_XIX_BMC_CAN01
        ISO_Funktionaler_Req_All_XIX_HCP5_CANFD01_e497e7f8_Rx: DynamicLength=false, PduLength=8, SysTPduToFrameMappingRef=PTF_ISO_Funktionaler_Req_All_XIX_HCP5_CANFD01
        ISOx_Funkt_Req_All_FD_XIX_HCP5_CANFD01_1dbb1bad_Rx: DynamicLength=false, PduLength=64, SysTPduToFrameMappingRef=PTF_ISOx_Funkt_Req_All_FD_XIX_HCP5_CANFD01
        ISOx_Hybrid_01_Req_FD_XIX_HCP5_CANFD01_5affd0fb_Rx: DynamicLength=false, PduLength=64, SysTPduToFrameMappingRef=PTF_ISOx_Hybrid_01_Req_FD_XIX_HCP5_CANFD01
        ISOx_Hybrid_01_Req_XIX_HCP5_CANFD01_bd99bbef_Rx: DynamicLength=false, PduLength=8, SysTPduToFrameMappingRef=PTF_ISOx_Hybrid_01_Req_XIX_HCP5_CANFD01
        ISOx_Hybrid_01_Resp_FD_XIX_HCP5_CANFD01_71c0a54e_Tx: DynamicLength=false, PduLength=64, SysTPduToFrameMappingRef=PTF_ISOx_Hybrid_01_Resp_FD_XIX_HCP5_CANFD01
        ISOx_Hybrid_01_Resp_XIX_HCP5_CANFD01_46a576a1_Tx: DynamicLength=false, PduLength=8, SysTPduToFrameMappingRef=PTF_ISOx_Hybrid_01_Resp_XIX_HCP5_CANFD01
        KN_Hybrid_01_XIX_HCP5_CANFD01_3c12b6a6_Tx: DynamicLength=false, PduLength=16, SysTPduToFrameMappingRef=PTF_KN_Hybrid_01_XIX_HCP5_CANFD01
        KN_Hybrid_01_XIX_HCP5_CANFD01_fef84477_Tx: DynamicLength=false, PduLength=16
        KS_Hybrid_01_Challenge_K_XIX_HCP5_CANFD01_306d69bd_Tx: DynamicLength=false, PduLength=12
        KS_Hybrid_01_Challenge_K_XIX_HCP5_CANFD01_f262895d_Tx: DynamicLength=false, PduLength=12, SysTPduToFrameMappingRef=PTF_KS_Hybrid_01_Challenge_K_XIX_HCP5_CANFD01
        KS_Hybrid_01_Challenge_M_XIX_HCP5_CANFD01_3e11d538_Rx: DynamicLength=false, PduLength=12
        KS_Hybrid_01_Challenge_M_XIX_HCP5_CANFD01_a71be84d_Rx: DynamicLength=false, PduLength=12, SysTPduToFrameMappingRef=PTF_KS_Hybrid_01_Challenge_M_XIX_HCP5_CANFD01
        KS_Hybrid_01_ReqFrame_XIX_HCP5_CANFD01_b04c52dd_Tx: DynamicLength=false, PduLength=8
        KS_Hybrid_01_ReqFrame_XIX_HCP5_CANFD01_d7f937e5_Tx: DynamicLength=false, PduLength=8, SysTPduToFrameMappingRef=PTF_KS_Hybrid_01_ReqFrame_XIX_HCP5_CANFD01
        KS_Hybrid_01_Response_K_XIX_HCP5_CANFD01_4e4d208b_Tx: DynamicLength=false, PduLength=12, SysTPduToFrameMappingRef=PTF_KS_Hybrid_01_Response_K_XIX_HCP5_CANFD01
        KS_Hybrid_01_Response_K_XIX_HCP5_CANFD01_76da782f_Tx: DynamicLength=false, PduLength=12
        KS_Hybrid_01_Response_M_XIX_HCP5_CANFD01_1b34419b_Rx: DynamicLength=false, PduLength=12, SysTPduToFrameMappingRef=PTF_KS_Hybrid_01_Response_M_XIX_HCP5_CANFD01
        KS_Hybrid_01_Response_M_XIX_HCP5_CANFD01_78a6c4aa_Rx: DynamicLength=false, PduLength=12
        NMH_Hybrid_01_XIX_BMC_CAN01_30f8f2db_Tx: DynamicLength=false, PduLength=8, SysTPduToFrameMappingRef=PTF_NMH_Hybrid_01_XIX_BMC_CAN01
        NMH_Hybrid_01_XIX_BMC_CAN01_b22e17f1_Tx: PduLength=6
        NM_Hybrid_01_XIX_HCP5_CANFD01_3f17aba9_Tx: DynamicLength=false, PduLength=24, SysTPduToFrameMappingRef=PTF_NM_Hybrid_01_XIX_HCP5_CANFD01
        NM_Hybrid_01_XIX_HCP5_CANFD01_c84ff8a5_Tx: PduLength=23
        NVEM_12_XIX_HCP5_CANFD01_00bae280_Rx: DynamicLength=false, PduLength=12
        NVEM_12_XIX_HCP5_CANFD01_27d236bb_Rx: DynamicLength=false, PduLength=12, SysTPduToFrameMappingRef=PTF_NVEM_12_XIX_HCP5_CANFD01
        NmNode_BMC_HV_XIX_BMC_CAN01_a39ed100_Rx: PduLength=8, SysTPduToFrameMappingRef=PTF_NM_Dummy01_XIX_BMC_CAN01
        NmNode_BMC_HV_XIX_HCP5_CANFD01_c8c687b4_Rx: PduLength=24
        OBDC_Funktionaler_Req_All_FD_XIX_HCP5_CANFD01_d0af7a5a_Rx: DynamicLength=false, PduLength=64, SysTPduToFrameMappingRef=PTF_OBDC_Funktionaler_Req_All_FD_XIX_HCP5_CANFD01
        OBDC_Funktionaler_Req_All_XIX_BMC_CAN01_c40642be_Tx: DynamicLength=false, PduLength=8, SysTPduToFrameMappingRef=PTF_OBDC_Funktionaler_Req_All_XIX_BMC_CAN01
        OBDC_Hybrid_01_Req_FD_XIX_HCP5_CANFD01_38935bdf_Rx: DynamicLength=false, PduLength=64, SysTPduToFrameMappingRef=PTF_OBDC_Hybrid_01_Req_FD_XIX_HCP5_CANFD01
        OBDC_Hybrid_01_Resp_FD_XIX_HCP5_CANFD01_4da12d14_Tx: DynamicLength=false, PduLength=64, SysTPduToFrameMappingRef=PTF_OBDC_Hybrid_01_Resp_FD_XIX_HCP5_CANFD01
        OBDC_SSN_BJB_Req_XIX_BMC_CAN01_31b63a85_Tx: DynamicLength=false, PduLength=8, SysTPduToFrameMappingRef=PTF_OBDC_SSN_BJB_Req_XIX_BMC_CAN01
        OBDC_SSN_BJB_Req_XIX_HCP5_CANFD01_87b9d88e_Rx: DynamicLength=false, PduLength=8, SysTPduToFrameMappingRef=PTF_OBDC_SSN_BJB_Req_XIX_HCP5_CANFD01
        OBDC_SSN_BJB_Resp_XIX_BMC_CAN01_d5ca69f5_Rx: DynamicLength=false, PduLength=8, SysTPduToFrameMappingRef=PTF_OBDC_SSN_BJB_Resp_XIX_BMC_CAN01
        OBDC_SSN_BJB_Resp_XIX_HCP5_CANFD01_7c2a070c_Tx: DynamicLength=false, PduLength=8, SysTPduToFrameMappingRef=PTF_OBDC_SSN_BJB_Resp_XIX_HCP5_CANFD01
        OBDC_SSN_UI2Sens01_Req_XIX_BMC_CAN01_32b2328b_Tx: DynamicLength=false, PduLength=8, SysTPduToFrameMappingRef=PTF_OBDC_SSN_UI2Sens01_Req_XIX_BMC_CAN01
        OBDC_SSN_UI2Sens01_Req_XIX_HCP5_CANFD01_00e7db31_Rx: DynamicLength=false, PduLength=8, SysTPduToFrameMappingRef=PTF_OBDC_SSN_UI2Sens01_Req_XIX_HCP5_CANFD01
        OBDC_SSN_UI2Sens01_Resp_XIX_BMC_CAN01_327140fa_Rx: DynamicLength=false, PduLength=8, SysTPduToFrameMappingRef=PTF_OBDC_SSN_UI2Sens01_Resp_XIX_BMC_CAN01
        OBDC_SSN_UI2Sens01_Resp_XIX_HCP5_CANFD01_2773f712_Tx: DynamicLength=false, PduLength=8, SysTPduToFrameMappingRef=PTF_OBDC_SSN_UI2Sens01_Resp_XIX_HCP5_CANFD01
        OBDC_SSN_UI2Sens02_Req_XIX_BMC_CAN01_7f5a32ec_Tx: DynamicLength=false, PduLength=8, SysTPduToFrameMappingRef=PTF_OBDC_SSN_UI2Sens02_Req_XIX_BMC_CAN01
        OBDC_SSN_UI2Sens02_Req_XIX_HCP5_CANFD01_7e9f9397_Rx: DynamicLength=false, PduLength=8, SysTPduToFrameMappingRef=PTF_OBDC_SSN_UI2Sens02_Req_XIX_HCP5_CANFD01
        OBDC_SSN_UI2Sens02_Resp_XIX_BMC_CAN01_e1ea5c01_Rx: DynamicLength=false, PduLength=8, SysTPduToFrameMappingRef=PTF_OBDC_SSN_UI2Sens02_Resp_XIX_BMC_CAN01
        OBDC_SSN_UI2Sens02_Resp_XIX_HCP5_CANFD01_18b88987_Tx: DynamicLength=false, PduLength=8, SysTPduToFrameMappingRef=PTF_OBDC_SSN_UI2Sens02_Resp_XIX_HCP5_CANFD01
        OBD_03_XIX_BMC_CAN01_5c2c79fc_Tx: DynamicLength=false, PduLength=8, SysTPduToFrameMappingRef=PTF_OBD_03_XIX_BMC_CAN01
        OBD_03_XIX_HCP5_CANFD01_2635ffad_Rx: DynamicLength=false, PduLength=8, SysTPduToFrameMappingRef=PTF_OBD_03_XIX_HCP5_CANFD01
        OBD_03_XIX_HCP5_CANFD01_f1281889_Rx: DynamicLength=false, PduLength=8
        OBD_04_XIX_BMC_CAN01_a3a3ce7e_Tx: DynamicLength=false, PduLength=8, SysTPduToFrameMappingRef=PTF_OBD_04_XIX_BMC_CAN01
        OBD_04_XIX_HCP5_CANFD01_100612ed_Rx: DynamicLength=false, PduLength=8
        OBD_04_XIX_HCP5_CANFD01_dc080cfa_Rx: DynamicLength=false, PduLength=8, SysTPduToFrameMappingRef=PTF_OBD_04_XIX_HCP5_CANFD01
        OBD_HCP1_SOK_XIX_HCP5_CANFD01_499f5f1b_Rx: DynamicLength=false, PduLength=6
        OBD_HCP1_SOK_XIX_HCP5_CANFD01_a5806350_Rx: DynamicLength=false, PduLength=6, SysTPduToFrameMappingRef=PTF_OBD_HCP1_SOK_XIX_HCP5_CANFD01
        OBD_HCP1_XIX_HCP5_CANFD01_1b389b6c_Rx: DynamicLength=false, PduLength=2
        OBD_Hybrid_01_SOK_XIX_HCP5_CANFD01_86ce2f2e_Tx: DynamicLength=false, PduLength=6
        OBD_Hybrid_01_SOK_XIX_HCP5_CANFD01_c373a414_Tx: DynamicLength=false, PduLength=6, SysTPduToFrameMappingRef=PTF_OBD_Hybrid_01_SOK_XIX_HCP5_CANFD01
        OBD_Hybrid_01_XIX_HCP5_CANFD01_40f9dae5_Tx: DynamicLength=false, PduLength=2
        OBDx_Hybrid_01_Req_XIX_HCP5_CANFD01_5cba35a0_Rx: DynamicLength=false, PduLength=8, SysTPduToFrameMappingRef=PTF_OBDx_Hybrid_01_Req_XIX_HCP5_CANFD01
        OBDx_Hybrid_01_Resp_XIX_HCP5_CANFD01_a027092e_Tx: DynamicLength=false, PduLength=8, SysTPduToFrameMappingRef=PTF_OBDx_Hybrid_01_Resp_XIX_HCP5_CANFD01
        OBDx_allOBD_Req_XIX_BMC_CAN01_9cfd1e51_Tx: DynamicLength=false, PduLength=8, SysTPduToFrameMappingRef=PTF_OBDx_allOBD_Req_XIX_BMC_CAN01
        OBDx_allOBD_Req_XIX_HCP5_CANFD01_a7e21e7c_Rx: DynamicLength=false, PduLength=8, SysTPduToFrameMappingRef=PTF_OBDx_allOBD_Req_XIX_HCP5_CANFD01
        OBG_01_XIX_HCP5_CANFD01_6af9c66f_Rx: DynamicLength=false, PduLength=60, SysTPduToFrameMappingRef=PTF_OBG_01_XIX_HCP5_CANFD01
        OBG_01_XIX_HCP5_CANFD01_8fe2f1e9_Rx: DynamicLength=false, PduLength=60
        ORU_01_XIX_BMC_CAN01_4256635f_Tx: DynamicLength=false, PduLength=8, SysTPduToFrameMappingRef=PTF_ORU_01_XIX_BMC_CAN01
        ORU_01_XIX_HCP5_CANFD01_81d7dd4c_Rx: DynamicLength=false, PduLength=8, SysTPduToFrameMappingRef=PTF_ORU_01_XIX_HCP5_CANFD01
        ORU_01_XIX_HCP5_CANFD01_8935a839_Rx: DynamicLength=false, PduLength=8
        ORU_Control_A_01_XIX_BMC_CAN01_e1a4f99a_Tx: DynamicLength=false, PduLength=8, SysTPduToFrameMappingRef=PTF_ORU_Control_A_01_XIX_BMC_CAN01
        ORU_Control_A_01_XIX_HCP5_CANFD01_E2E_3007747a_Rx: DynamicLength=false, PduLength=8
        ORU_Control_A_01_XIX_HCP5_CANFD01_E2E_893c1989_Rx: DynamicLength=false, PduLength=8, SysTPduToFrameMappingRef=PTF_ORU_Control_A_01_E2E_XIX_HCP5_CANFD01
        ORU_Control_D_01_XIX_BMC_CAN01_0f07b83a_Tx: DynamicLength=false, PduLength=8, SysTPduToFrameMappingRef=PTF_ORU_Control_D_01_XIX_BMC_CAN01
        ORU_Control_D_01_XIX_HCP5_CANFD01_E2E_6e31ae8f_Rx: DynamicLength=false, PduLength=8
        ORU_Control_D_01_XIX_HCP5_CANFD01_E2E_9ed03939_Rx: DynamicLength=false, PduLength=8, SysTPduToFrameMappingRef=PTF_ORU_Control_D_01_E2E_XIX_HCP5_CANFD01
        OTAMC_D_01_XIX_BMC_CAN01_5e0c6077_Tx: DynamicLength=false, PduLength=4, SysTPduToFrameMappingRef=PTF_OTAMC_D_01_XIX_BMC_CAN01
        OTAMC_D_01_XIX_HCP5_CANFD01_E2E_8283a85d_Rx: DynamicLength=false, PduLength=4, SysTPduToFrameMappingRef=PTF_OTAMC_D_01_E2E_XIX_HCP5_CANFD01
        OTAMC_D_01_XIX_HCP5_CANFD01_E2E_c199b3e6_Rx: DynamicLength=false, PduLength=4
        OTP_01_XIX_HCP5_CANFD01_76e7759c_Rx: DynamicLength=false, PduLength=8
        OTP_01_XIX_HCP5_CANFD01_fd0a6756_Rx: DynamicLength=false, PduLength=8, SysTPduToFrameMappingRef=PTF_OTP_01_XIX_HCP5_CANFD01
        PduPnc_EIRA_CAN_Rx: PduLength=7
        SOK_NoAuthenticTime_01_XIX_HCP5_CANFD01_8db7a3c2_Rx: DynamicLength=false, PduLength=8, SysTPduToFrameMappingRef=PTF_SOK_NoAuthenticTime_01_XIX_HCP5_CANFD01
        SOK_NoAuthenticTime_01_XIX_HCP5_CANFD01_a407ae2f_Rx: DynamicLength=false, PduLength=8
        SOK_Zeit_Hybrid_01_Chal_01_XIX_HCP5_CANFD01_441f0aae_Tx: DynamicLength=false, PduLength=8, SysTPduToFrameMappingRef=PTF_SOK_Zeit_Hybrid_01_Chal_01_XIX_HCP5_CANFD01
        SOK_Zeit_Hybrid_01_Chal_01_XIX_HCP5_CANFD01_5939048b_Tx: DynamicLength=false, PduLength=8
        SOK_Zeit_Hybrid_01_Resp_01_SOK_XIX_HCP5_CANFD01_7ac24361_Rx: DynamicLength=false, PduLength=16, SysTPduToFrameMappingRef=PTF_SOK_Zeit_Hybrid_01_Resp_01_SOK_XIX_HCP5_CANFD01
        SOK_Zeit_Hybrid_01_Resp_01_SOK_XIX_HCP5_CANFD01_92adacdc_Rx: DynamicLength=false, PduLength=16
        SOK_Zeit_Hybrid_01_Resp_01_XIX_HCP5_CANFD01_c7a98a10_Rx: DynamicLength=false, PduLength=8
        Systeminfo_01_XIX_BMC_CAN01_e1870ca9_Tx: DynamicLength=false, PduLength=8, SysTPduToFrameMappingRef=PTF_Systeminfo_01_XIX_BMC_CAN01
        Systeminfo_01_XIX_HCP5_CANFD01_1ca8fa11_Rx: DynamicLength=false, PduLength=8, SysTPduToFrameMappingRef=PTF_Systeminfo_01_XIX_HCP5_CANFD01
        Systeminfo_01_XIX_HCP5_CANFD01_fb27c5ed_Rx: DynamicLength=false, PduLength=8
        Thermomanagement_01_XIX_HCP5_CANFD01_60e8cf38_Rx: DynamicLength=false, PduLength=64
        Thermomanagement_01_XIX_HCP5_CANFD01_bb71c5fe_Rx: DynamicLength=false, PduLength=64, SysTPduToFrameMappingRef=PTF_Thermomanagement_01_XIX_HCP5_CANFD01
        UI1_01_XIX_BMC_CAN01_E2E_cec88adf_Rx: DynamicLength=false, PduLength=8
        UI1_01_XIX_BMC_CAN01_E2E_e77bac14_Rx: DynamicLength=false, PduLength=8, SysTPduToFrameMappingRef=PTF_UI1_01_E2E_XIX_BMC_CAN01
        UI1_02_XIX_BMC_CAN01_E2E_6d9e0c76_Rx: DynamicLength=false, PduLength=8
        UI1_02_XIX_BMC_CAN01_E2E_aa93ac73_Rx: DynamicLength=false, PduLength=8, SysTPduToFrameMappingRef=PTF_UI1_02_E2E_XIX_BMC_CAN01
        UI1_03_XIX_BMC_CAN01_0abdbc10_Rx: DynamicLength=false, PduLength=8, SysTPduToFrameMappingRef=PTF_UI1_03_XIX_BMC_CAN01
        UI1_03_XIX_BMC_CAN01_4277cadb_Rx: DynamicLength=false, PduLength=8
        UI1_04_XIX_BMC_CAN01_d976c5c1_Rx: DynamicLength=false, PduLength=8
        UI1_04_XIX_BMC_CAN01_f5320b92_Rx: DynamicLength=false, PduLength=8, SysTPduToFrameMappingRef=PTF_UI1_04_XIX_BMC_CAN01
        UI1_05_XIX_BMC_CAN01_608d1e29_Rx: DynamicLength=false, PduLength=8
        UI1_05_XIX_BMC_CAN01_d1b05aa4_Rx: DynamicLength=false, PduLength=8, SysTPduToFrameMappingRef=PTF_UI1_05_XIX_BMC_CAN01
        UI1_Komponentenfehler_01_XIX_BMC_CAN01_08861f77_Rx: DynamicLength=false, PduLength=8
        UI1_Komponentenfehler_01_XIX_BMC_CAN01_0b0d2b23_Rx: DynamicLength=false, PduLength=8, SysTPduToFrameMappingRef=PTF_UI1_Komponentenfehler_01_XIX_BMC_CAN01
        UI1_Komponentenfehler_02_XIX_BMC_CAN01_19fb750e_Rx: DynamicLength=false, PduLength=8
        UI1_Komponentenfehler_02_XIX_BMC_CAN01_668bd879_Rx: DynamicLength=false, PduLength=8, SysTPduToFrameMappingRef=PTF_UI1_Komponentenfehler_02_XIX_BMC_CAN01
        UI2Sens01_CALID_01_XIX_BMC_CAN01_6126d1bc_Rx: DynamicLength=false, PduLength=8, SysTPduToFrameMappingRef=PTF_UI2Sens01_CALID_01_XIX_BMC_CAN01
        UI2Sens01_CALID_01_XIX_BMC_CAN01_f3c92280_Rx: DynamicLength=false, PduLength=8
        UI2Sens01_CALID_02_XIX_BMC_CAN01_0ca022e6_Rx: DynamicLength=false, PduLength=8, SysTPduToFrameMappingRef=PTF_UI2Sens01_CALID_02_XIX_BMC_CAN01
        UI2Sens01_CALID_02_XIX_BMC_CAN01_e2b448f9_Rx: DynamicLength=false, PduLength=8
        UI2Sens01_CVN_XIX_BMC_CAN01_7910df29_Rx: DynamicLength=false, PduLength=8, SysTPduToFrameMappingRef=PTF_UI2Sens01_CVN_XIX_BMC_CAN01
        UI2Sens01_CVN_XIX_BMC_CAN01_fe6b52fc_Rx: DynamicLength=false, PduLength=8
        UI2Sens02_CALID_01_XIX_BMC_CAN01_a812cab1_Rx: DynamicLength=false, PduLength=8, SysTPduToFrameMappingRef=PTF_UI2Sens02_CALID_01_XIX_BMC_CAN01
        UI2Sens02_CALID_01_XIX_BMC_CAN01_abd78ba8_Rx: DynamicLength=false, PduLength=8
        UI2Sens02_CALID_02_XIX_BMC_CAN01_baaae1d1_Rx: DynamicLength=false, PduLength=8
        UI2Sens02_CALID_02_XIX_BMC_CAN01_c59439eb_Rx: DynamicLength=false, PduLength=8, SysTPduToFrameMappingRef=PTF_UI2Sens02_CALID_02_XIX_BMC_CAN01
        UI2Sens02_CVN_XIX_BMC_CAN01_34f8df4e_Rx: DynamicLength=false, PduLength=8, SysTPduToFrameMappingRef=PTF_UI2Sens02_CVN_XIX_BMC_CAN01
        UI2Sens02_CVN_XIX_BMC_CAN01_5d3dd455_Rx: DynamicLength=false, PduLength=8
        UI2_01_XIX_BMC_CAN01_E2E_04321bb6_Rx: DynamicLength=false, PduLength=8, SysTPduToFrameMappingRef=PTF_UI2_01_E2E_XIX_BMC_CAN01
        UI2_01_XIX_BMC_CAN01_E2E_f7b0279f_Rx: DynamicLength=false, PduLength=8
        UI2_02_XIX_BMC_CAN01_E2E_49da1bd1_Rx: DynamicLength=false, PduLength=8, SysTPduToFrameMappingRef=PTF_UI2_02_E2E_XIX_BMC_CAN01
        UI2_02_XIX_BMC_CAN01_E2E_54e6a136_Rx: DynamicLength=false, PduLength=8
        UI2_03_XIX_BMC_CAN01_E2E_8304216e_Rx: DynamicLength=false, PduLength=8
        UI2_03_XIX_BMC_CAN01_E2E_c452e633_Rx: DynamicLength=false, PduLength=8, SysTPduToFrameMappingRef=PTF_UI2_03_E2E_XIX_BMC_CAN01
        UI2_04_XIX_BMC_CAN01_33f018a3_Rx: DynamicLength=false, PduLength=8
        UI2_04_XIX_BMC_CAN01_af5334f2_Rx: DynamicLength=false, PduLength=8, SysTPduToFrameMappingRef=PTF_UI2_04_XIX_BMC_CAN01
        UI2_Komponentenfehler_01_XIX_BMC_CAN01_6c666489_Rx: DynamicLength=false, PduLength=8
        UI2_Komponentenfehler_01_XIX_BMC_CAN01_6d09fe13_Rx: DynamicLength=false, PduLength=8, SysTPduToFrameMappingRef=PTF_UI2_Komponentenfehler_01_XIX_BMC_CAN01
        UI2_Komponentenfehler_02_XIX_BMC_CAN01_008f0d49_Rx: DynamicLength=false, PduLength=8, SysTPduToFrameMappingRef=PTF_UI2_Komponentenfehler_02_XIX_BMC_CAN01
        UI2_Komponentenfehler_02_XIX_BMC_CAN01_7d1b0ef0_Rx: DynamicLength=false, PduLength=8
        VDSO_05_XIX_HCP5_CANFD01_48366f26_Rx: DynamicLength=false, PduLength=8
        VDSO_05_XIX_HCP5_CANFD01_f45d20ad_Rx: DynamicLength=false, PduLength=8, SysTPduToFrameMappingRef=PTF_VDSO_05_XIX_HCP5_CANFD01
        WFS_02_XIX_HCP5_CANFD01_61136cb6_Rx: DynamicLength=false, PduLength=28
        WFS_02_XIX_HCP5_CANFD01_a0e8c21d_Rx: DynamicLength=false, PduLength=28, SysTPduToFrameMappingRef=PTF_WFS_02_XIX_HCP5_CANFD01
        XCP_Hybrid_01_CRO_01_FD_XIX_HCP5_CANFD01_f21b8ba9_Rx: DynamicLength=true, PduLength=64, SysTPduToFrameMappingRef=PTF_XCP_Hybrid_01_CRO_01_FD_XIX_HCP5_CANFD01
        XCP_Hybrid_01_DTO_01_FD_XIX_HCP5_CANFD01_ee6930a2_Tx: DynamicLength=true, PduLength=64, SysTPduToFrameMappingRef=PTF_XCP_Hybrid_01_DTO_01_FD_XIX_HCP5_CANFD01
        ZeitMaster_01_XIX_HCP5_CANFD01_16302e51_Rx: DynamicLength=false, PduLength=8, SysTPduToFrameMappingRef=PTF_ZeitMaster_01_XIX_HCP5_CANFD01
        ZeitMaster_01_XIX_HCP5_CANFD01_dad73d21_Rx: DynamicLength=false, PduLength=8
        Zeitmaster_05_XIX_HCP5_CANFD01_1d48ef0a_Rx: DynamicLength=false, PduLength=8, SysTPduToFrameMappingRef=PTF_Zeitmaster_05_XIX_HCP5_CANFD01
        Zeitmaster_05_XIX_HCP5_CANFD01_5eaa5a96_Rx: DynamicLength=false, PduLength=8
  module config EcuM
    EcuMConfiguration
      EcuMCommonConfiguration
        EcuMDriverInitListOne
        EcuMDriverRestartList
        CN_BMC_CAN01_78a85e89 (EcuMWakeupSource): EcuMWakeupSourceId=5, EcuMComMChannelRef=ComMConfigSet/CN_BMC_CAN01_78a85e89
        CN_HCP5_CANFD01_54d90215 (EcuMWakeupSource): EcuMWakeupSourceId=6, EcuMComMChannelRef=ComMConfigSet/CN_HCP5_CANFD01_54d90215
      EcuMFlexConfiguration: EcuMFlexModuleConfigurationRef=CanConfigSet
  module config Nm
    CN_BMC_CAN01_78a85e89 (NmChannelConfig): NmChannelSleepMaster=false, NmSynchronizingNetwork=false, NmComMChannelRef=ComMConfigSet/CN_BMC_CAN01_78a85e89
      NmCluster_BMC_CAN01_44a705e0 (NmBusType)
        NmStandardBusNmConfig: NmStandardBusType=NM_BUSNM_CANNM  # NmCluster_BMC_CAN01
    CN_HCP5_CANFD01_54d90215 (NmChannelConfig): NmChannelSleepMaster=false, NmSynchronizingNetwork=false, NmComMChannelRef=ComMConfigSet/CN_HCP5_CANFD01_54d90215
      NmCluster_HCP5_CANFD01_da2f6b88 (NmBusType)
        NmStandardBusNmConfig: NmStandardBusType=NM_BUSNM_CANNM  # NmCluster_HCP5_CANFD01
    NmGlobalConfig
      NmGlobalFeatures:
        NmComControlEnabled = false
        NmComUserDataSupport = true
        NmNodeDetectionEnabled = false
        NmNodeIdEnabled = false
        NmPduRxIndicationEnabled = true
        NmRemoteSleepIndEnabled = false
        NmRepeatMsgIndEnabled = false
        NmStateChangeIndEnabled = true
        NmUserDataEnabled = true
      NmGlobalProperties
  module config PduR
    PduRGeneral
    PduRRoutingTables
      PduRRoutingTable
        166 x PduRRoutingPath:
          Airbag_10_XIX_HCP5_CANFD01_6624abf2_Rx
            Airbag_10_XIX_HCP5_CANFD01_6624abf2_Rx_ec64b73a_Rx (PduRDestPdu): PduRDestPduRef=EcucPduCollection/Airbag_10_XIX_HCP5_CANFD01_7f2c77c5_Rx
            PduRSrcPdu_ec64b73a (PduRSrcPdu): PduRSrcPduRef=EcucPduCollection/Airbag_10_XIX_HCP5_CANFD01_6624abf2_Rx
          BJB_08_XIX_BMC_CAN01_7b6df5c6_Rx
            BJB_08_XIX_BMC_CAN01_7b6df5c6_Rx_e991396e_Rx (PduRDestPdu): PduRDestPduRef=EcucPduCollection/BJB_08_XIX_BMC_CAN01_1db9ae10_Rx
            PduRSrcPdu_e991396e (PduRSrcPdu): PduRSrcPduRef=EcucPduCollection/BJB_08_XIX_BMC_CAN01_7b6df5c6_Rx
          BJB_10_XIX_BMC_CAN01_E2E_04bd7411_Rx
            BJB_10_XIX_BMC_CAN01_E2E_04bd7411_Rx_b8b879bb_Rx (PduRDestPdu): PduRDestPduRef=EcucPduCollection/BJB_10_XIX_BMC_CAN01_E2E_968516b3_Rx
            PduRSrcPdu_b8b879bb (PduRSrcPdu): PduRSrcPduRef=EcucPduCollection/BJB_10_XIX_BMC_CAN01_E2E_04bd7411_Rx
          BJB_11_XIX_BMC_CAN01_E2E_893589f3_Rx
            BJB_11_XIX_BMC_CAN01_E2E_893589f3_Rx_6f2be595_Rx (PduRDestPdu): PduRDestPduRef=EcucPduCollection/BJB_11_XIX_BMC_CAN01_E2E_416796eb_Rx
            PduRSrcPdu_6f2be595 (PduRSrcPdu): PduRSrcPduRef=EcucPduCollection/BJB_11_XIX_BMC_CAN01_E2E_893589f3_Rx
          BJB_12_XIX_BMC_CAN01_E2E_c4dd8994_Rx
            BJB_12_XIX_BMC_CAN01_E2E_c4dd8994_Rx_7a49b272_Rx (PduRDestPdu): PduRDestPduRef=EcucPduCollection/BJB_12_XIX_BMC_CAN01_E2E_e2311042_Rx
            PduRSrcPdu_7a49b272 (PduRSrcPdu): PduRSrcPduRef=EcucPduCollection/BJB_12_XIX_BMC_CAN01_E2E_c4dd8994_Rx
          BJB_13_XIX_BMC_CAN01_E2E_49557476_Rx
            BJB_13_XIX_BMC_CAN01_E2E_49557476_Rx_739faa04_Rx (PduRDestPdu): PduRDestPduRef=EcucPduCollection/BJB_13_XIX_BMC_CAN01_E2E_35d3901a_Rx
            PduRSrcPdu_739faa04 (PduRSrcPdu): PduRSrcPduRef=EcucPduCollection/BJB_13_XIX_BMC_CAN01_E2E_49557476_Rx
          BJB_CALID_01_XIX_BMC_CAN01_89dc60ad_Rx
            BJB_CALID_01_XIX_BMC_CAN01_89dc60ad_Rx_41bc7e76_Rx (PduRDestPdu): PduRDestPduRef=EcucPduCollection/BJB_CALID_01_XIX_BMC_CAN01_adee7d66_Rx
            PduRSrcPdu_41bc7e76 (PduRSrcPdu): PduRSrcPduRef=EcucPduCollection/BJB_CALID_01_XIX_BMC_CAN01_89dc60ad_Rx
          BJB_CALID_02_XIX_BMC_CAN01_e45a93f7_Rx
            BJB_CALID_02_XIX_BMC_CAN01_e45a93f7_Rx_88b46475_Rx (PduRDestPdu): PduRDestPduRef=EcucPduCollection/BJB_CALID_02_XIX_BMC_CAN01_bc93171f_Rx
            PduRSrcPdu_88b46475 (PduRSrcPdu): PduRSrcPduRef=EcucPduCollection/BJB_CALID_02_XIX_BMC_CAN01_e45a93f7_Rx
          BJB_CVN_01_XIX_BMC_CAN01_4f7fa9e3_Rx
            BJB_CVN_01_XIX_BMC_CAN01_4f7fa9e3_Rx_f31ef42c_Rx (PduRDestPdu): PduRDestPduRef=EcucPduCollection/BJB_CVN_01_XIX_BMC_CAN01_301c1ddb_Rx
            PduRSrcPdu_f31ef42c (PduRSrcPdu): PduRSrcPduRef=EcucPduCollection/BJB_CVN_01_XIX_BMC_CAN01_4f7fa9e3_Rx
          BMC_CMC_Temperatur_01_XIX_HCP5_CANFD01_13d55235_Tx
            BMC_CMC_Temperatur_01_XIX_HCP5_CANFD01_0fcecf3e_Tx (PduRDestPdu): PduRDestPduRef=EcucPduCollection/BMC_CMC_Temperatur_01_XIX_HCP5_CANFD01_0fcecf3e_Tx
            PduRSrcPdu_4390fcc7 (PduRSrcPdu): PduRSrcPduRef=EcucPduCollection/BMC_CMC_Temperatur_01_XIX_HCP5_CANFD01_13d55235_Tx
          BMC_CMC_Temperatur_02_XIX_HCP5_CANFD01_f9538f57_Tx
            BMC_CMC_Temperatur_02_XIX_HCP5_CANFD01_25727fb6_Tx (PduRDestPdu): PduRDestPduRef=EcucPduCollection/BMC_CMC_Temperatur_02_XIX_HCP5_CANFD01_25727fb6_Tx
            PduRSrcPdu_3151cb09 (PduRSrcPdu): PduRSrcPduRef=EcucPduCollection/BMC_CMC_Temperatur_02_XIX_HCP5_CANFD01_f9538f57_Tx
          BMC_CMC_Temperatur_03_XIX_HCP5_CANFD01_160139b6_Tx
            BMC_CMC_Temperatur_03_XIX_HCP5_CANFD01_8a36edf1_Tx (PduRDestPdu): PduRDestPduRef=EcucPduCollection/BMC_CMC_Temperatur_03_XIX_HCP5_CANFD01_8a36edf1_Tx
            PduRSrcPdu_685d637f (PduRSrcPdu): PduRSrcPduRef=EcucPduCollection/BMC_CMC_Temperatur_03_XIX_HCP5_CANFD01_160139b6_Tx
          BMC_CMC_Zellspannung_01_XIX_HCP5_CANFD01_f76fbfe9_Tx
            BMC_CMC_Zellspannung_01_XIX_HCP5_CANFD01_e1187d1c_Tx (PduRDestPdu): PduRDestPduRef=EcucPduCollection/BMC_CMC_Zellspannung_01_XIX_HCP5_CANFD01_e1187d1c_Tx
            PduRSrcPdu_07a5ffeb (PduRSrcPdu): PduRSrcPduRef=EcucPduCollection/BMC_CMC_Zellspannung_01_XIX_HCP5_CANFD01_f76fbfe9_Tx
          BMC_CMC_Zellspannung_02_XIX_HCP5_CANFD01_1de9628b_Tx
            BMC_CMC_Zellspannung_02_XIX_HCP5_CANFD01_cba4cd94_Tx (PduRDestPdu): PduRDestPduRef=EcucPduCollection/BMC_CMC_Zellspannung_02_XIX_HCP5_CANFD01_cba4cd94_Tx
            PduRSrcPdu_1b71b75a (PduRSrcPdu): PduRSrcPduRef=EcucPduCollection/BMC_CMC_Zellspannung_02_XIX_HCP5_CANFD01_1de9628b_Tx
          BMC_CMC_Zellspannung_03_XIX_HCP5_CANFD01_f2bbd46a_Tx
            BMC_CMC_Zellspannung_03_XIX_HCP5_CANFD01_64e05fd3_Tx (PduRDestPdu): PduRDestPduRef=EcucPduCollection/BMC_CMC_Zellspannung_03_XIX_HCP5_CANFD01_64e05fd3_Tx
            PduRSrcPdu_6125e2af (PduRSrcPdu): PduRSrcPduRef=EcucPduCollection/BMC_CMC_Zellspannung_03_XIX_HCP5_CANFD01_f2bbd46a_Tx
          BMC_CMC_Zellspannung_04_XIX_HCP5_CANFD01_1395de0e_Tx
            BMC_CMC_Zellspannung_04_XIX_HCP5_CANFD01_9eddac84_Tx (PduRDestPdu): PduRDestPduRef=EcucPduCollection/BMC_CMC_Zellspannung_04_XIX_HCP5_CANFD01_9eddac84_Tx
            PduRSrcPdu_025474df (PduRSrcPdu): PduRSrcPduRef=EcucPduCollection/BMC_CMC_Zellspannung_04_XIX_HCP5_CANFD01_1395de0e_Tx
          BMC_CMC_Zellspannung_05_XIX_HCP5_CANFD01_fcc768ef_Tx
            BMC_CMC_Zellspannung_05_XIX_HCP5_CANFD01_31993ec3_Tx (PduRDestPdu): PduRDestPduRef=EcucPduCollection/BMC_CMC_Zellspannung_05_XIX_HCP5_CANFD01_31993ec3_Tx
            PduRSrcPdu_95e0194f (PduRSrcPdu): PduRSrcPduRef=EcucPduCollection/BMC_CMC_Zellspannung_05_XIX_HCP5_CANFD01_fcc768ef_Tx
          BMC_HV_01_E2E_SOK_XIX_HCP5_CANFD01_ad756307_Tx
            BMC_HV_01_E2E_SOK_XIX_HCP5_CANFD01_09a7f969_Tx (PduRDestPdu): PduRDestPduRef=EcucPduCollection/BMC_HV_01_E2E_SOK_XIX_HCP5_CANFD01_09a7f969_Tx
            PduRSrcPdu_09a5b367 (PduRSrcPdu): PduRSrcPduRef=EcucPduCollection/BMC_HV_01_E2E_SOK_XIX_HCP5_CANFD01_ad756307_Tx
          BMC_HV_01_XIX_HCP5_CANFD01_E2E_fcbbcae3_Tx
            BMC_HV_01_XIX_HCP5_CANFD01_E2E_fcbbcae3_Tx (PduRDestPdu): PduRDestPduRef=EcucPduCollection/BMC_HV_01_XIX_HCP5_CANFD01_E2E_fcbbcae3_Tx
            PduRSrcPdu_afcd3b20 (PduRSrcPdu): PduRSrcPduRef=EcucPduCollection/BMC_HV_01_XIX_HCP5_CANFD01_E2E_fcbbcae3_Tx
          BMC_HV_02_E2E_SOK_XIX_HCP5_CANFD01_5f228eff_Tx
            BMC_HV_02_E2E_SOK_XIX_HCP5_CANFD01_4f75cc0d_Tx (PduRDestPdu): PduRDestPduRef=EcucPduCollection/BMC_HV_02_E2E_SOK_XIX_HCP5_CANFD01_4f75cc0d_Tx
            PduRSrcPdu_868743d6 (PduRSrcPdu): PduRSrcPduRef=EcucPduCollection/BMC_HV_02_E2E_SOK_XIX_HCP5_CANFD01_5f228eff_Tx
          BMC_HV_02_XIX_HCP5_CANFD01_E2E_c5c367a3_Tx
            BMC_HV_02_XIX_HCP5_CANFD01_E2E_c5c367a3_Tx (PduRDestPdu): PduRDestPduRef=EcucPduCollection/BMC_HV_02_XIX_HCP5_CANFD01_E2E_c5c367a3_Tx
            PduRSrcPdu_d75bfe16 (PduRSrcPdu): PduRSrcPduRef=EcucPduCollection/BMC_HV_02_XIX_HCP5_CANFD01_E2E_c5c367a3_Tx
          BMC_HV_03_XIX_HCP5_CANFD01_0617c15c_Tx
            BMC_HV_03_XIX_HCP5_CANFD01_58321150_Tx (PduRDestPdu): PduRDestPduRef=EcucPduCollection/BMC_HV_03_XIX_HCP5_CANFD01_58321150_Tx
            PduRSrcPdu_7e555779 (PduRSrcPdu): PduRSrcPduRef=EcucPduCollection/BMC_HV_03_XIX_HCP5_CANFD01_0617c15c_Tx
          BMC_HV_04_XIX_BMC_CAN01_E2E_a4a2e7f5_Tx
            BMC_HV_04_XIX_BMC_CAN01_E2E_24b17933_Tx (PduRDestPdu): PduRDestPduRef=EcucPduCollection/BMC_HV_04_XIX_BMC_CAN01_E2E_24b17933_Tx
            PduRSrcPdu_ade43efa (PduRSrcPdu): PduRSrcPduRef=EcucPduCollection/BMC_HV_04_XIX_BMC_CAN01_E2E_a4a2e7f5_Tx
          BMC_HV_05_XIX_HCP5_CANFD01_086b7dd9_Tx
            BMC_HV_05_XIX_HCP5_CANFD01_0d4b7040_Tx (PduRDestPdu): PduRDestPduRef=EcucPduCollection/BMC_HV_05_XIX_HCP5_CANFD01_0d4b7040_Tx
            PduRSrcPdu_ba63e0cc (PduRSrcPdu): PduRSrcPduRef=EcucPduCollection/BMC_HV_05_XIX_HCP5_CANFD01_086b7dd9_Tx
          BMC_HV_06_SOK_XIX_HCP5_CANFD01_e20cafa8_Tx
            BMC_HV_06_SOK_XIX_HCP5_CANFD01_daff2390_Tx (PduRDestPdu): PduRDestPduRef=EcucPduCollection/BMC_HV_06_SOK_XIX_HCP5_CANFD01_daff2390_Tx
            PduRSrcPdu_30b6f94e (PduRSrcPdu): PduRSrcPduRef=EcucPduCollection/BMC_HV_06_SOK_XIX_HCP5_CANFD01_e20cafa8_Tx
          BMC_HV_06_XIX_HCP5_CANFD01_e2eda0bb_Tx
            BMC_HV_06_XIX_HCP5_CANFD01_e2eda0bb_Tx (PduRDestPdu): PduRDestPduRef=EcucPduCollection/BMC_HV_06_XIX_HCP5_CANFD01_e2eda0bb_Tx
            PduRSrcPdu_29efbb20 (PduRSrcPdu): PduRSrcPduRef=EcucPduCollection/BMC_HV_06_XIX_HCP5_CANFD01_e2eda0bb_Tx
          BMC_HV_07_SOK_XIX_HCP5_CANFD01_f524cb68_Tx
            BMC_HV_07_SOK_XIX_HCP5_CANFD01_f0d71bf2_Tx (PduRDestPdu): PduRDestPduRef=EcucPduCollection/BMC_HV_07_SOK_XIX_HCP5_CANFD01_f0d71bf2_Tx
            PduRSrcPdu_982247bd (PduRSrcPdu): PduRSrcPduRef=EcucPduCollection/BMC_HV_07_SOK_XIX_HCP5_CANFD01_f524cb68_Tx
          BMC_HV_07_XIX_HCP5_CANFD01_0dbf165a_Tx
            BMC_HV_07_XIX_HCP5_CANFD01_0dbf165a_Tx (PduRDestPdu): PduRDestPduRef=EcucPduCollection/BMC_HV_07_XIX_HCP5_CANFD01_0dbf165a_Tx
            PduRSrcPdu_e322036a (PduRSrcPdu): PduRSrcPduRef=EcucPduCollection/BMC_HV_07_XIX_HCP5_CANFD01_0dbf165a_Tx
          BMC_HV_080e5c5f_Rx
            BMC_HV_d112dd40_Tx (PduRDestPdu): PduRDestPduRef=OBDC_SSN_BJB_Resp_XIX_HCP5_CANFD01_7c2a070c_Tx
            PduRSrcPdu_29be98f1 (PduRSrcPdu): PduRSrcPduRef=OBDC_SSN_BJB_Resp_XIX_BMC_CAN01_d5ca69f5_Rx
          BMC_HV_08_SOK_XIX_HCP5_CANFD01_29bed328_Tx
            BMC_HV_08_SOK_XIX_HCP5_CANFD01_ac3f778d_Tx (PduRDestPdu): PduRDestPduRef=EcucPduCollection/BMC_HV_08_SOK_XIX_HCP5_CANFD01_ac3f778d_Tx
            PduRSrcPdu_56bec0d4 (PduRSrcPdu): PduRSrcPduRef=EcucPduCollection/BMC_HV_08_SOK_XIX_HCP5_CANFD01_29bed328_Tx
          BMC_HV_08_XIX_HCP5_CANFD01_fbc0b232_Tx
            BMC_HV_08_XIX_HCP5_CANFD01_fbc0b232_Tx (PduRDestPdu): PduRDestPduRef=EcucPduCollection/BMC_HV_08_XIX_HCP5_CANFD01_fbc0b232_Tx
            PduRSrcPdu_a805d9a1 (PduRSrcPdu): PduRSrcPduRef=EcucPduCollection/BMC_HV_08_XIX_HCP5_CANFD01_fbc0b232_Tx
          BMC_HV_09_SOK_XIX_HCP5_CANFD01_3e96b7e8_Tx
            BMC_HV_09_SOK_XIX_HCP5_CANFD01_86174fef_Tx (PduRDestPdu): PduRDestPduRef=EcucPduCollection/BMC_HV_09_SOK_XIX_HCP5_CANFD01_86174fef_Tx
            PduRSrcPdu_4946679d (PduRSrcPdu): PduRSrcPduRef=EcucPduCollection/BMC_HV_09_SOK_XIX_HCP5_CANFD01_3e96b7e8_Tx
          BMC_HV_09_XIX_HCP5_CANFD01_149204d3_Tx
            BMC_HV_09_XIX_HCP5_CANFD01_149204d3_Tx (PduRDestPdu): PduRDestPduRef=EcucPduCollection/BMC_HV_09_XIX_HCP5_CANFD01_149204d3_Tx
            PduRSrcPdu_842fa7a9 (PduRSrcPdu): PduRSrcPduRef=EcucPduCollection/BMC_HV_09_XIX_HCP5_CANFD01_149204d3_Tx
          BMC_HV_0b268b06_Rx
            BMC_HV_d79e3995_Tx (PduRDestPdu): PduRDestPduRef=DIA_UI2Sens02_Req_XIX_BMC_CAN01_0a5a0c3f_Tx
            PduRSrcPdu_dbb16064 (PduRSrcPdu): PduRSrcPduRef=DIA_UI2Sens02_Req_XIX_HCP5_CANFD01_a61e514a_Rx
          BMC_HV_0bbdd542_Rx
            BMC_HV_0bbdd542_Rx_31fc5fb2_Rx (PduRDestPdu): PduRDestPduRef=DCM_HCP5_CANFD01_XIX_TPCHType_CANFD_OBDC_Diagnose_XIX_0x1C410200_XIX_Functional_967cb818_Rx
            BMC_HV_d297f2ea_Tx (PduRDestPdu): PduRDestPduRef=DCM_BMC_CAN01_XIX_TPCHType_CANHS_OBDC_Diagnose_XIX_0x17FD0200_XIX_Functional_e9b636f2_Tx
            PduRSrcPdu_31fc5fb2 (PduRSrcPdu): PduRSrcPduRef=DCM_HCP5_CANFD01_XIX_TPCHType_CANFD_OBDC_Diagnose_XIX_0x1C410200_XIX_Functional_c81dd985_Rx
          BMC_HV_0d72e9ae_Rx
            BMC_HV_0d72e9ae_Rx_e0f26de2_Rx (PduRDestPdu): PduRDestPduRef=EcucPduCollection/ClampControl_01_XIX_HCP5_CANFD01_8c24343b_Rx
            BMC_HV_29370756_Tx (PduRDestPdu): PduRDestPduRef=ClampControl_01_XIX_BMC_CAN01_6c74ee25_Tx
            PduRSrcPdu_e0f26de2 (PduRSrcPdu): PduRSrcPduRef=ClampControl_01_XIX_HCP5_CANFD01_5af08b97_Rx
          BMC_HV_0ef050eb_Rx
            BMC_HV_f78d7c04_Tx (PduRDestPdu): PduRDestPduRef=CDD_XCP_BJB_DTO_01_XIX_HCP5_CANFD01_884a4965_Tx
            PduRSrcPdu_44b17292 (PduRSrcPdu): PduRSrcPduRef=CDD_XCP_BJB_DTO_01_XIX_BMC_CAN01_382ede28_Rx
          BMC_HV_10_XIX_BMC_CAN01_E2E_28add151_Tx
            BMC_HV_10_XIX_BMC_CAN01_E2E_31888fd1_Tx (PduRDestPdu): PduRDestPduRef=EcucPduCollection/BMC_HV_10_XIX_BMC_CAN01_E2E_31888fd1_Tx
            PduRSrcPdu_8f77f31b (PduRSrcPdu): PduRSrcPduRef=EcucPduCollection/BMC_HV_10_XIX_BMC_CAN01_E2E_28add151_Tx
          BMC_HV_11_XIX_BMC_CAN01_E2E_ff4f5109_Tx
            BMC_HV_11_XIX_BMC_CAN01_E2E_bc007233_Tx (PduRDestPdu): PduRDestPduRef=EcucPduCollection/BMC_HV_11_XIX_BMC_CAN01_E2E_bc007233_Tx
            PduRSrcPdu_1c3c454f (PduRSrcPdu): PduRSrcPduRef=EcucPduCollection/BMC_HV_11_XIX_BMC_CAN01_E2E_ff4f5109_Tx
          BMC_HV_12_XIX_BMC_CAN01_E2E_5c19d7a0_Tx
            BMC_HV_12_XIX_BMC_CAN01_E2E_f1e87254_Tx (PduRDestPdu): PduRDestPduRef=EcucPduCollection/BMC_HV_12_XIX_BMC_CAN01_E2E_f1e87254_Tx
            PduRSrcPdu_e5700097 (PduRSrcPdu): PduRSrcPduRef=EcucPduCollection/BMC_HV_12_XIX_BMC_CAN01_E2E_5c19d7a0_Tx
          BMC_HV_13_XIX_BMC_CAN01_E2E_8bfb57f8_Tx
            BMC_HV_13_XIX_BMC_CAN01_E2E_7c608fb6_Tx (PduRDestPdu): PduRDestPduRef=EcucPduCollection/BMC_HV_13_XIX_BMC_CAN01_E2E_7c608fb6_Tx
            PduRSrcPdu_23881bac (PduRSrcPdu): PduRSrcPduRef=EcucPduCollection/BMC_HV_13_XIX_BMC_CAN01_E2E_8bfb57f8_Tx
          BMC_HV_14_SOK_XIX_HCP5_CANFD01_572f8cfc_Tx
            BMC_HV_14_SOK_XIX_HCP5_CANFD01_2d397b18_Tx (PduRDestPdu): PduRDestPduRef=EcucPduCollection/BMC_HV_14_SOK_XIX_HCP5_CANFD01_2d397b18_Tx
            PduRSrcPdu_0601150c (PduRSrcPdu): PduRSrcPduRef=EcucPduCollection/BMC_HV_14_SOK_XIX_HCP5_CANFD01_572f8cfc_Tx
          BMC_HV_14_XIX_HCP5_CANFD01_30db4b60_Tx
            BMC_HV_14_XIX_HCP5_CANFD01_30db4b60_Tx (PduRDestPdu): PduRDestPduRef=EcucPduCollection/BMC_HV_14_XIX_HCP5_CANFD01_30db4b60_Tx
            PduRSrcPdu_861f8eb1 (PduRSrcPdu): PduRSrcPduRef=EcucPduCollection/BMC_HV_14_XIX_HCP5_CANFD01_30db4b60_Tx
          BMC_HV_1b004d69_Rx
            BMC_HV_a00eedd8_Tx (PduRDestPdu): PduRDestPduRef=DIA_UI2Sens01_Resp_XIX_HCP5_CANFD01_dfc9d8b9_Tx
            PduRSrcPdu_347cf23a (PduRSrcPdu): PduRSrcPduRef=DIA_UI2Sens01_Resp_XIX_BMC_CAN01_2ddec3aa_Rx
          BMC_HV_1b8f642d_Rx
            BMC_HV_4d2c4eba_Tx (PduRDestPdu): PduRDestPduRef=CDD_DEV_BJB_Resp_FF_XIX_HCP5_CANFD01_77e6d841_Tx
            PduRSrcPdu_4b1bc202 (PduRSrcPdu): PduRSrcPduRef=CDD_DEV_BJB_Resp_FF_XIX_BMC_CAN01_19d429a9_Rx
          BMC_HV_1ef3b795_Rx
            BMC_HV_1ef3b795_Rx_5bfe58e1_Rx (PduRDestPdu): PduRDestPduRef=EcucPduCollection/Systeminfo_01_XIX_HCP5_CANFD01_fb27c5ed_Rx
            BMC_HV_5d87886d_Tx (PduRDestPdu): PduRDestPduRef=Systeminfo_01_XIX_BMC_CAN01_e1870ca9_Tx
            PduRSrcPdu_5bfe58e1 (PduRSrcPdu): PduRSrcPduRef=Systeminfo_01_XIX_HCP5_CANFD01_1ca8fa11_Rx
          BMC_HV_2f7dd3f7_Rx
            BMC_HV_6d61cb02_Tx (PduRDestPdu): PduRDestPduRef=DIA_BJB_Req_XIX_BMC_CAN01_6c84b0d8_Tx
            PduRSrcPdu_fbeacdb4 (PduRSrcPdu): PduRSrcPduRef=DIA_BJB_Req_XIX_HCP5_CANFD01_f2b9e65d_Rx
          BMC_HV_3cdd220c_Rx
            BMC_HV_3cdd220c_Rx_eff70935_Rx (PduRDestPdu): PduRDestPduRef=DCM_HCP5_CANFD01_XIX_TPCHType_CANFD_ISO_Diagnose_XIX_0x1C410000_XIX_Functional_012ca6ee_Rx
            BMC_HV_f3c8ab19_Tx (PduRDestPdu): PduRDestPduRef=DCM_BMC_CAN01_XIX_TPCHType_CANHS_ISO_Diagnose_XIX_0x700_XIX_Functional_770cc244_Tx
            PduRSrcPdu_eff70935 (PduRSrcPdu): PduRSrcPduRef=DCM_HCP5_CANFD01_XIX_TPCHType_CANFD_ISO_Diagnose_XIX_0x1C410000_XIX_Functional_905f44f1_Rx
          BMC_HV_4032211c_Rx
            BMC_HV_1fc2e024_Tx (PduRDestPdu): PduRDestPduRef=OBD_03_XIX_BMC_CAN01_5c2c79fc_Tx
            BMC_HV_4032211c_Rx_aa61ac1d_Rx (PduRDestPdu): PduRDestPduRef=EcucPduCollection/OBD_03_XIX_HCP5_CANFD01_f1281889_Rx
            PduRSrcPdu_aa61ac1d (PduRSrcPdu): PduRSrcPduRef=OBD_03_XIX_HCP5_CANFD01_2635ffad_Rx
          BMC_HV_4cd2864d_Rx
            BMC_HV_47583a15_Tx (PduRDestPdu): PduRDestPduRef=OBDC_SSN_UI2Sens02_Resp_XIX_HCP5_CANFD01_18b88987_Tx
            PduRSrcPdu_023365d6 (PduRSrcPdu): PduRSrcPduRef=OBDC_SSN_UI2Sens02_Resp_XIX_BMC_CAN01_e1ea5c01_Rx
          BMC_HV_6854b429_Rx
            BMC_HV_6006bc36_Tx (PduRDestPdu): PduRDestPduRef=OTAMC_D_01_XIX_BMC_CAN01_5e0c6077_Tx
            BMC_HV_6854b429_Rx_c4a7c837_Rx (PduRDestPdu): PduRDestPduRef=EcucPduCollection/OTAMC_D_01_XIX_HCP5_CANFD01_E2E_c199b3e6_Rx
            PduRSrcPdu_c4a7c837 (PduRSrcPdu): PduRSrcPduRef=OTAMC_D_01_XIX_HCP5_CANFD01_E2E_8283a85d_Rx
          BMC_HV_755ec3a0_Rx
            BMC_HV_9a7639f2_Tx (PduRDestPdu): PduRDestPduRef=DIA_UI2Sens01_Req_XIX_BMC_CAN01_47b20c58_Tx
            PduRSrcPdu_d092ae82 (PduRSrcPdu): PduRSrcPduRef=DIA_UI2Sens01_Req_XIX_HCP5_CANFD01_d86619ec_Rx
          BMC_HV_9ba409ae_Rx
            BMC_HV_20083886_Tx (PduRDestPdu): PduRDestPduRef=OBDC_SSN_UI2Sens02_Req_XIX_BMC_CAN01_7f5a32ec_Tx
            PduRSrcPdu_206bd44b (PduRSrcPdu): PduRSrcPduRef=OBDC_SSN_UI2Sens02_Req_XIX_HCP5_CANFD01_7e9f9397_Rx
          BMC_HV_9f499ab6_Rx
            BMC_HV_78934480_Tx (PduRDestPdu): PduRDestPduRef=OBDC_SSN_UI2Sens01_Resp_XIX_HCP5_CANFD01_2773f712_Tx
            PduRSrcPdu_611d700c (PduRSrcPdu): PduRSrcPduRef=OBDC_SSN_UI2Sens01_Resp_XIX_BMC_CAN01_327140fa_Rx
          BMC_HV_a369f88b_Rx
            BMC_HV_28ed9af5_Tx (PduRDestPdu): PduRDestPduRef=ORU_Control_A_01_XIX_BMC_CAN01_e1a4f99a_Tx
            BMC_HV_a369f88b_Rx_1a7ba619_Rx (PduRDestPdu): PduRDestPduRef=EcucPduCollection/ORU_Control_A_01_XIX_HCP5_CANFD01_E2E_3007747a_Rx
            PduRSrcPdu_1a7ba619 (PduRSrcPdu): PduRSrcPduRef=ORU_Control_A_01_XIX_HCP5_CANFD01_E2E_893c1989_Rx
          BMC_HV_a64aa887_Rx
            BMC_HV_555b0a9f_Tx (PduRDestPdu): PduRDestPduRef=DIA_BJB_Resp_XIX_HCP5_CANFD01_6385845c_Tx
            PduRSrcPdu_6d136cb6 (PduRSrcPdu): PduRSrcPduRef=DIA_BJB_Resp_XIX_BMC_CAN01_c04d7636_Rx
          BMC_HV_b485d83b_Rx
            BMC_HV_b485d83b_Rx_1e673584_Rx (PduRDestPdu): PduRDestPduRef=EcucPduCollection/ORU_Control_D_01_XIX_HCP5_CANFD01_E2E_6e31ae8f_Rx
            BMC_HV_c64edb55_Tx (PduRDestPdu): PduRDestPduRef=ORU_Control_D_01_XIX_BMC_CAN01_0f07b83a_Tx
            PduRSrcPdu_1e673584 (PduRSrcPdu): PduRSrcPduRef=ORU_Control_D_01_XIX_HCP5_CANFD01_E2E_9ed03939_Rx
          BMC_HV_b645f520_Rx
            BMC_HV_01c76f4c_Tx (PduRDestPdu): PduRDestPduRef=CDD_DEV_BJB_Req_01_XIX_BMC_CAN01_3719e18f_Tx
            PduRSrcPdu_8bc3fac3 (PduRSrcPdu): PduRSrcPduRef=CDD_DEV_BJB_Req_01_XIX_HCP5_CANFD01_c982c041_Rx
          BMC_HV_ba0fd24b_Rx
            BMC_HV_ba0fd24b_Rx_3290d1c3_Rx (PduRDestPdu): PduRDestPduRef=EcucPduCollection/OBD_04_XIX_HCP5_CANFD01_100612ed_Rx
            BMC_HV_e04d57a6_Tx (PduRDestPdu): PduRDestPduRef=OBD_04_XIX_BMC_CAN01_a3a3ce7e_Tx
            PduRSrcPdu_3290d1c3 (PduRSrcPdu): PduRSrcPduRef=OBD_04_XIX_HCP5_CANFD01_dc080cfa_Rx
          BMC_HV_c89b5192_Rx
            BMC_HV_9fc5934d_Tx (PduRDestPdu): PduRDestPduRef=DIA_UI2Sens02_Resp_XIX_HCP5_CANFD01_e002a62c_Tx
            PduRSrcPdu_ae5d409e (PduRSrcPdu): PduRSrcPduRef=DIA_UI2Sens02_Resp_XIX_BMC_CAN01_fe45df51_Rx
          BMC_HV_d77d382e_Rx
            BMC_HV_a7ee643b_Tx (PduRDestPdu): PduRDestPduRef=CDD_XCP_BJB_CRO_01_XIX_BMC_CAN01_9130eaf8_Tx
            PduRSrcPdu_1d15be7d (PduRSrcPdu): PduRSrcPduRef=CDD_XCP_BJB_CRO_01_XIX_HCP5_CANFD01_a8ba0d4f_Rx
          BMC_HV_d8ebd2e4_Rx
            BMC_HV_f8ff59ea_Tx (PduRDestPdu): PduRDestPduRef=OBDC_SSN_BJB_Req_XIX_BMC_CAN01_31b63a85_Tx
            PduRSrcPdu_c8be0ac4 (PduRSrcPdu): PduRSrcPduRef=OBDC_SSN_BJB_Req_XIX_HCP5_CANFD01_87b9d88e_Rx
          BMC_HV_e5dc4108_Rx
            BMC_HV_6de038e1_Tx (PduRDestPdu): PduRDestPduRef=OBDC_SSN_UI2Sens01_Req_XIX_BMC_CAN01_32b2328b_Tx
            PduRSrcPdu_387b2e73 (PduRSrcPdu): PduRSrcPduRef=OBDC_SSN_UI2Sens01_Req_XIX_HCP5_CANFD01_00e7db31_Rx
          BMC_HV_e7d003fd_Rx
            BMC_HV_01b8fa87_Tx (PduRDestPdu): PduRDestPduRef=ORU_01_XIX_BMC_CAN01_4256635f_Tx
            BMC_HV_e7d003fd_Rx_68280502_Rx (PduRDestPdu): PduRDestPduRef=EcucPduCollection/ORU_01_XIX_HCP5_CANFD01_8935a839_Rx
            PduRSrcPdu_68280502 (PduRSrcPdu): PduRSrcPduRef=ORU_01_XIX_HCP5_CANFD01_81d7dd4c_Rx
          BMC_HV_f0607c45_Rx
            BMC_HV_d9bef722_Tx (PduRDestPdu): PduRDestPduRef=OBDx_allOBD_Req_XIX_BMC_CAN01_9cfd1e51_Tx
            PduRSrcPdu_b7f9d39f (PduRSrcPdu): PduRSrcPduRef=OBDx_allOBD_Req_XIX_HCP5_CANFD01_a7e21e7c_Rx
          BMC_HV_fac9f523_Rx
            BMC_HV_d532ac0a_Tx (PduRDestPdu): PduRDestPduRef=ISO_Funktionaler_Req_All_XIX_BMC_CAN01_aaf5996b_Tx
            PduRSrcPdu_33fb826e (PduRSrcPdu): PduRSrcPduRef=ISO_Funktionaler_Req_All_XIX_HCP5_CANFD01_e497e7f8_Rx
          CDD_HCP5_CANFD01_XIX_TPCHType_CANFD_DAAP_XIX_0x1C403F7B_XIX_0x1C423F7B_XIX_Physical_1330e22e_Rx
            CDD_HCP5_CANFD01_XIX_TPCHType_CANFD_DAAP_XIX_0x1C403F7B_XIX_0x1C423F7B_XIX_Physical_1330e22e_Rx_2c0fff33_Rx (PduRDestPdu): PduRDestPduRef=CDD_HCP5_CANFD01_XIX_TPCHType_CANFD_DAAP_XIX_0x1C403F7B_XIX_0x1C423F7B_XIX_Physical_3bee6131_Rx
            PduRSrcPdu_2c0fff33 (PduRSrcPdu): PduRSrcPduRef=EcucPduCollection/CDD_HCP5_CANFD01_XIX_TPCHType_CANFD_DAAP_XIX_0x1C403F7B_XIX_0x1C423F7B_XIX_Physical_1330e22e_Rx
          CDD_HCP5_CANFD01_XIX_TPCHType_CANFD_DAAP_XIX_0x1C413FDD_XIX_Functional_880c97f7_Rx
            CDD_HCP5_CANFD01_XIX_TPCHType_CANFD_DAAP_XIX_0x1C413FDD_XIX_Functional_880c97f7_Rx_17800f7b_Rx (PduRDestPdu): PduRDestPduRef=CDD_HCP5_CANFD01_XIX_TPCHType_CANFD_DAAP_XIX_0x1C413FDD_XIX_Functional_6530545d_Rx
            PduRSrcPdu_17800f7b (PduRSrcPdu): PduRSrcPduRef=EcucPduCollection/CDD_HCP5_CANFD01_XIX_TPCHType_CANFD_DAAP_XIX_0x1C413FDD_XIX_Functional_880c97f7_Rx
          CDD_HCP5_CANFD01_XIX_TPCHType_CANFD_DAAP_XIX_0x1C423F7B_XIX_0x1C403F7B_XIX_Physical_53df2b54_Tx
            CDD_HCP5_CANFD01_XIX_TPCHType_CANFD_DAAP_XIX_0x1C423F7B_XIX_0x1C403F7B_XIX_Physical_d2cfa6c1_Tx (PduRDestPdu): PduRDestPduRef=EcucPduCollection/CDD_HCP5_CANFD01_XIX_TPCHType_CANFD_DAAP_XIX_0x1C423F7B_XIX_0x1C403F7B_XIX_Physical_d2cfa6c1_Tx
            PduRSrcPdu_80070619 (PduRSrcPdu): PduRSrcPduRef=EcucPduCollection/CDD_HCP5_CANFD01_XIX_TPCHType_CANFD_DAAP_XIX_0x1C423F7B_XIX_0x1C403F7B_XIX_Physical_53df2b54_Tx
          Charisma_20_XIX_HCP5_CANFD01_be5e5e8a_Rx
            Charisma_20_XIX_HCP5_CANFD01_be5e5e8a_Rx_6ffd659a_Rx (PduRDestPdu): PduRDestPduRef=EcucPduCollection/Charisma_20_XIX_HCP5_CANFD01_f51eced8_Rx
            PduRSrcPdu_6ffd659a (PduRSrcPdu): PduRSrcPduRef=EcucPduCollection/Charisma_20_XIX_HCP5_CANFD01_be5e5e8a_Rx
          ComIPduPnc_EIRA_CAN_Rx_cca0f11f_Rx
            ComIPduPnc_EIRA_CAN_Rx_cca0f11f_Rx_bb7efc37_Rx (PduRDestPdu): PduRDestPduRef=PduPnc_EIRA_CAN_Rx
            PduRSrcPdu_bb7efc37 (PduRSrcPdu): PduRSrcPduRef=PduPnc_EIRA_CAN_Rx
          DCDC_04_XIX_HCP5_CANFD01_622db5e5_Rx
            DCDC_04_XIX_HCP5_CANFD01_622db5e5_Rx_5df8757b_Rx (PduRDestPdu): PduRDestPduRef=EcucPduCollection/DCDC_04_XIX_HCP5_CANFD01_8ca88b97_Rx
            PduRSrcPdu_5df8757b (PduRSrcPdu): PduRSrcPduRef=EcucPduCollection/DCDC_04_XIX_HCP5_CANFD01_622db5e5_Rx
          DCDC_NV_CALID_XIX_HCP5_CANFD01_004a20bd_Rx
            DCDC_NV_CALID_XIX_HCP5_CANFD01_004a20bd_Rx_e1d44665_Rx (PduRDestPdu): PduRDestPduRef=EcucPduCollection/DCDC_NV_CALID_XIX_HCP5_CANFD01_46b970f2_Rx
            PduRSrcPdu_e1d44665 (PduRSrcPdu): PduRSrcPduRef=EcucPduCollection/DCDC_NV_CALID_XIX_HCP5_CANFD01_004a20bd_Rx
          DCDC_NV_CVN_XIX_HCP5_CANFD01_01267e2b_Rx
            DCDC_NV_CVN_XIX_HCP5_CANFD01_01267e2b_Rx_e7e304e9_Rx (PduRDestPdu): PduRDestPduRef=EcucPduCollection/DCDC_NV_CVN_XIX_HCP5_CANFD01_55665719_Rx
            PduRSrcPdu_e7e304e9 (PduRSrcPdu): PduRSrcPduRef=EcucPduCollection/DCDC_NV_CVN_XIX_HCP5_CANFD01_01267e2b_Rx
          DCDC_NV_Komponentenfehler_01_XIX_HCP5_CANFD01_2b1a3644_Rx
            DCDC_NV_Komponentenfehler_01_XIX_HCP5_CANFD01_2b1a3644_Rx_e509db44_Rx (PduRDestPdu): PduRDestPduRef=EcucPduCollection/DCDC_NV_Komponentenfehler_01_XIX_HCP5_CANFD01_dd687766_Rx
            PduRSrcPdu_e509db44 (PduRSrcPdu): PduRSrcPduRef=EcucPduCollection/DCDC_NV_Komponentenfehler_01_XIX_HCP5_CANFD01_2b1a3644_Rx
          DCDC_NV_Komponentenfehler_02_XIX_HCP5_CANFD01_01a686cc_Rx
            DCDC_NV_Komponentenfehler_02_XIX_HCP5_CANFD01_01a686cc_Rx_58b8b145_Rx (PduRDestPdu): PduRDestPduRef=EcucPduCollection/DCDC_NV_Komponentenfehler_02_XIX_HCP5_CANFD01_37eeaa04_Rx
            PduRSrcPdu_58b8b145 (PduRSrcPdu): PduRSrcPduRef=EcucPduCollection/DCDC_NV_Komponentenfehler_02_XIX_HCP5_CANFD01_01a686cc_Rx
          DCDC_NV_Komponentenfehler_03_XIX_HCP5_CANFD01_aee2148b_Rx
            DCDC_NV_Komponentenfehler_03_XIX_HCP5_CANFD01_aee2148b_Rx_9b9e540a_Rx (PduRDestPdu): PduRDestPduRef=EcucPduCollection/DCDC_NV_Komponentenfehler_03_XIX_HCP5_CANFD01_d8bc1ce5_Rx
            PduRSrcPdu_9b9e540a (PduRSrcPdu): PduRSrcPduRef=EcucPduCollection/DCDC_NV_Komponentenfehler_03_XIX_HCP5_CANFD01_aee2148b_Rx
          DCDC_NV_Komponentenfehler_04_XIX_HCP5_CANFD01_54dfe7dc_Rx
            DCDC_NV_Komponentenfehler_04_XIX_HCP5_CANFD01_54dfe7dc_Rx_624bad38_Rx (PduRDestPdu): PduRDestPduRef=EcucPduCollection/DCDC_NV_Komponentenfehler_04_XIX_HCP5_CANFD01_39921681_Rx
            PduRSrcPdu_624bad38 (PduRSrcPdu): PduRSrcPduRef=EcucPduCollection/DCDC_NV_Komponentenfehler_04_XIX_HCP5_CANFD01_54dfe7dc_Rx
          DCM_BMC_CAN01_XIX_TPCHType_CANHS_Flash_DIA_XIX_0x17FC16D0_XIX_0x17FE16D0_XIX_Physical_970a5f86_Tx
            DCM_BMC_CAN01_XIX_TPCHType_CANHS_Flash_DIA_XIX_0x17FC16D0_XIX_0x17FE16D0_XIX_Physical_9f19b594_Tx (PduRDestPdu): PduRDestPduRef=EcucPduCollection/DCM_BMC_CAN01_XIX_TPCHType_CANHS_Flash_DIA_XIX_0x17FC16D0_XIX_0x17FE16D0_XIX_Physical_9f19b594_Tx
            PduRSrcPdu_a4be8235 (PduRSrcPdu): PduRSrcPduRef=EcucPduCollection/DCM_BMC_CAN01_XIX_TPCHType_CANHS_Flash_DIA_XIX_0x17FC16D0_XIX_0x17FE16D0_XIX_Physical_970a5f86_Tx
          DCM_BMC_CAN01_XIX_TPCHType_CANHS_Flash_DIA_XIX_0x17FC17B1_XIX_0x17FE17B1_XIX_Physical_62358056_Tx
            DCM_BMC_CAN01_XIX_TPCHType_CANHS_Flash_DIA_XIX_0x17FC17B1_XIX_0x17FE17B1_XIX_Physical_91cacfde_Tx (PduRDestPdu): PduRDestPduRef=EcucPduCollection/DCM_BMC_CAN01_XIX_TPCHType_CANHS_Flash_DIA_XIX_0x17FC17B1_XIX_0x17FE17B1_XIX_Physical_91cacfde_Tx
            PduRSrcPdu_ff9c4424 (PduRSrcPdu): PduRSrcPduRef=EcucPduCollection/DCM_BMC_CAN01_XIX_TPCHType_CANHS_Flash_DIA_XIX_0x17FC17B1_XIX_0x17FE17B1_XIX_Physical_62358056_Tx
          DCM_BMC_CAN01_XIX_TPCHType_CANHS_Flash_DIA_XIX_0x17FC17B2_XIX_0x17FE17B2_XIX_Physical_bb5ccee1_Tx
            DCM_BMC_CAN01_XIX_TPCHType_CANHS_Flash_DIA_XIX_0x17FC17B2_XIX_0x17FE17B2_XIX_Physical_8c0f4baf_Tx (PduRDestPdu): PduRDestPduRef=EcucPduCollection/DCM_BMC_CAN01_XIX_TPCHType_CANHS_Flash_DIA_XIX_0x17FC17B2_XIX_0x17FE17B2_XIX_Physical_8c0f4baf_Tx
            PduRSrcPdu_a7f76620 (PduRSrcPdu): PduRSrcPduRef=EcucPduCollection/DCM_BMC_CAN01_XIX_TPCHType_CANHS_Flash_DIA_XIX_0x17FC17B2_XIX_0x17FE17B2_XIX_Physical_bb5ccee1_Tx
          DCM_BMC_CAN01_XIX_TPCHType_CANHS_Flash_DIA_XIX_0x17FE16D0_XIX_0x17FC16D0_XIX_Physical_8400c53b_Rx
            DCM_BMC_CAN01_XIX_TPCHType_CANHS_Flash_DIA_XIX_0x17FE16D0_XIX_0x17FC16D0_XIX_Physical_8400c53b_Rx_4ea50a02_Rx (PduRDestPdu): PduRDestPduRef=DCM_BMC_CAN01_XIX_TPCHType_CANHS_Flash_DIA_XIX_0x17FE16D0_XIX_0x17FC16D0_XIX_Physical_2f598129_Rx
            PduRSrcPdu_4ea50a02 (PduRSrcPdu): PduRSrcPduRef=EcucPduCollection/DCM_BMC_CAN01_XIX_TPCHType_CANHS_Flash_DIA_XIX_0x17FE16D0_XIX_0x17FC16D0_XIX_Physical_8400c53b_Rx
          DCM_BMC_CAN01_XIX_TPCHType_CANHS_Flash_DIA_XIX_0x17FE17B1_XIX_0x17FC17B1_XIX_Physical_8ad3bf71_Rx
            DCM_BMC_CAN01_XIX_TPCHType_CANHS_Flash_DIA_XIX_0x17FE17B1_XIX_0x17FC17B1_XIX_Physical_8ad3bf71_Rx_357e5107_Rx (PduRDestPdu): PduRDestPduRef=DCM_BMC_CAN01_XIX_TPCHType_CANHS_Flash_DIA_XIX_0x17FE17B1_XIX_0x17FC17B1_XIX_Physical_da665ef9_Rx
            PduRSrcPdu_357e5107 (PduRSrcPdu): PduRSrcPduRef=EcucPduCollection/DCM_BMC_CAN01_XIX_TPCHType_CANHS_Flash_DIA_XIX_0x17FE17B1_XIX_0x17FC17B1_XIX_Physical_8ad3bf71_Rx
          DCM_BMC_CAN01_XIX_TPCHType_CANHS_Flash_DIA_XIX_0x17FE17B2_XIX_0x17FC17B2_XIX_Physical_97163b00_Rx
            DCM_BMC_CAN01_XIX_TPCHType_CANHS_Flash_DIA_XIX_0x17FE17B2_XIX_0x17FC17B2_XIX_Physical_97163b00_Rx_356e33af_Rx (PduRDestPdu): PduRDestPduRef=DCM_BMC_CAN01_XIX_TPCHType_CANHS_Flash_DIA_XIX_0x17FE17B2_XIX_0x17FC17B2_XIX_Physical_030f104e_Rx
            PduRSrcPdu_356e33af (PduRSrcPdu): PduRSrcPduRef=EcucPduCollection/DCM_BMC_CAN01_XIX_TPCHType_CANHS_Flash_DIA_XIX_0x17FE17B2_XIX_0x17FC17B2_XIX_Physical_97163b00_Rx
          DCM_BMC_CAN01_XIX_TPCHType_CANHS_OBDC_SSN_Diagnose_XIX_0x17FC70D0_XIX_0x17FE70D0_XIX_Physical_50ea923c_Tx
            DCM_BMC_CAN01_XIX_TPCHType_CANHS_OBDC_SSN_Diagnose_XIX_0x17FC70D0_XIX_0x17FE70D0_XIX_Physical_ec851d39_Tx (PduRDestPdu): PduRDestPduRef=EcucPduCollection/DCM_BMC_CAN01_XIX_TPCHType_CANHS_OBDC_SSN_Diagnose_XIX_0x17FC70D0_XIX_0x17FE70D0_XIX_Physical_ec851d39_Tx
            PduRSrcPdu_a3670d68 (PduRSrcPdu): PduRSrcPduRef=EcucPduCollection/DCM_BMC_CAN01_XIX_TPCHType_CANHS_OBDC_SSN_Diagnose_XIX_0x17FC70D0_XIX_0x17FE70D0_XIX_Physical_50ea923c_Tx
          DCM_BMC_CAN01_XIX_TPCHType_CANHS_OBDC_SSN_Diagnose_XIX_0x17FC71B1_XIX_0x17FE71B1_XIX_Physical_a5d54dec_Tx
            DCM_BMC_CAN01_XIX_TPCHType_CANHS_OBDC_SSN_Diagnose_XIX_0x17FC71B1_XIX_0x17FE71B1_XIX_Physical_e2566773_Tx (PduRDestPdu): PduRDestPduRef=EcucPduCollection/DCM_BMC_CAN01_XIX_TPCHType_CANHS_OBDC_SSN_Diagnose_XIX_0x17FC71B1_XIX_0x17FE71B1_XIX_Physical_e2566773_Tx
            PduRSrcPdu_c2ef4745 (PduRSrcPdu): PduRSrcPduRef=EcucPduCollection/DCM_BMC_CAN01_XIX_TPCHType_CANHS_OBDC_SSN_Diagnose_XIX_0x17FC71B1_XIX_0x17FE71B1_XIX_Physical_a5d54dec_Tx
          DCM_BMC_CAN01_XIX_TPCHType_CANHS_OBDC_SSN_Diagnose_XIX_0x17FC71B2_XIX_0x17FE71B2_XIX_Physical_7cbc035b_Tx
            DCM_BMC_CAN01_XIX_TPCHType_CANHS_OBDC_SSN_Diagnose_XIX_0x17FC71B2_XIX_0x17FE71B2_XIX_Physical_ff93e302_Tx (PduRDestPdu): PduRDestPduRef=EcucPduCollection/DCM_BMC_CAN01_XIX_TPCHType_CANHS_OBDC_SSN_Diagnose_XIX_0x17FC71B2_XIX_0x17FE71B2_XIX_Physical_ff93e302_Tx
            PduRSrcPdu_72c8cb4e (PduRSrcPdu): PduRSrcPduRef=EcucPduCollection/DCM_BMC_CAN01_XIX_TPCHType_CANHS_OBDC_SSN_Diagnose_XIX_0x17FC71B2_XIX_0x17FE71B2_XIX_Physical_7cbc035b_Tx
          DCM_BMC_CAN01_XIX_TPCHType_CANHS_OBDC_SSN_Diagnose_XIX_0x17FE70D0_XIX_0x17FC70D0_XIX_Physical_f79c6d96_Rx
            DCM_BMC_CAN01_XIX_TPCHType_CANHS_OBDC_SSN_Diagnose_XIX_0x17FE70D0_XIX_0x17FC70D0_XIX_Physical_f79c6d96_Rx_4cd67485_Rx (PduRDestPdu): PduRDestPduRef=DCM_BMC_CAN01_XIX_TPCHType_CANHS_OBDC_SSN_Diagnose_XIX_0x17FE70D0_XIX_0x17FC70D0_XIX_Physical_e8b94c93_Rx
            PduRSrcPdu_4cd67485 (PduRSrcPdu): PduRSrcPduRef=EcucPduCollection/DCM_BMC_CAN01_XIX_TPCHType_CANHS_OBDC_SSN_Diagnose_XIX_0x17FE70D0_XIX_0x17FC70D0_XIX_Physical_f79c6d96_Rx
          DCM_BMC_CAN01_XIX_TPCHType_CANHS_OBDC_SSN_Diagnose_XIX_0x17FE71B1_XIX_0x17FC71B1_XIX_Physical_f94f17dc_Rx
            DCM_BMC_CAN01_XIX_TPCHType_CANHS_OBDC_SSN_Diagnose_XIX_0x17FE71B1_XIX_0x17FC71B1_XIX_Physical_f94f17dc_Rx_1ddf6bc9_Rx (PduRDestPdu): PduRDestPduRef=DCM_BMC_CAN01_XIX_TPCHType_CANHS_OBDC_SSN_Diagnose_XIX_0x17FE71B1_XIX_0x17FC71B1_XIX_Physical_1d869343_Rx
            PduRSrcPdu_1ddf6bc9 (PduRSrcPdu): PduRSrcPduRef=EcucPduCollection/DCM_BMC_CAN01_XIX_TPCHType_CANHS_OBDC_SSN_Diagnose_XIX_0x17FE71B1_XIX_0x17FC71B1_XIX_Physical_f94f17dc_Rx
          DCM_BMC_CAN01_XIX_TPCHType_CANHS_OBDC_SSN_Diagnose_XIX_0x17FE71B2_XIX_0x17FC71B2_XIX_Physical_e48a93ad_Rx
            DCM_BMC_CAN01_XIX_TPCHType_CANHS_OBDC_SSN_Diagnose_XIX_0x17FE71B2_XIX_0x17FC71B2_XIX_Physical_e48a93ad_Rx_71659d97_Rx (PduRDestPdu): PduRDestPduRef=DCM_BMC_CAN01_XIX_TPCHType_CANHS_OBDC_SSN_Diagnose_XIX_0x17FE71B2_XIX_0x17FC71B2_XIX_Physical_c4efddf4_Rx
            PduRSrcPdu_71659d97 (PduRSrcPdu): PduRSrcPduRef=EcucPduCollection/DCM_BMC_CAN01_XIX_TPCHType_CANHS_OBDC_SSN_Diagnose_XIX_0x17FE71B2_XIX_0x17FC71B2_XIX_Physical_e48a93ad_Rx
          DCM_HCP5_CANFD01_XIX_TPCHType_CANFD_ISO_Diagnose_XIX_0x1C40007B_XIX_0x1C42007B_XIX_Physical_e79447d3_Rx
            DCM_HCP5_CANFD01_XIX_TPCHType_CANFD_ISO_Diagnose_XIX_0x1C40007B_XIX_0x1C42007B_XIX_Physical_e79447d3_Rx_d8567614_Rx (PduRDestPdu): PduRDestPduRef=DCM_HCP5_CANFD01_XIX_TPCHType_CANFD_ISO_Diagnose_XIX_0x1C40007B_XIX_0x1C42007B_XIX_Physical_238d3514_Rx
            PduRSrcPdu_d8567614 (PduRSrcPdu): PduRSrcPduRef=EcucPduCollection/DCM_HCP5_CANFD01_XIX_TPCHType_CANFD_ISO_Diagnose_XIX_0x1C40007B_XIX_0x1C42007B_XIX_Physical_e79447d3_Rx
          DCM_HCP5_CANFD01_XIX_TPCHType_CANFD_ISO_Diagnose_XIX_0x1C42007B_XIX_0x1C40007B_XIX_Physical_4bbc7f71_Tx
            DCM_HCP5_CANFD01_XIX_TPCHType_CANFD_ISO_Diagnose_XIX_0x1C42007B_XIX_0x1C40007B_XIX_Physical_266b033c_Tx (PduRDestPdu): PduRDestPduRef=EcucPduCollection/DCM_HCP5_CANFD01_XIX_TPCHType_CANFD_ISO_Diagnose_XIX_0x1C42007B_XIX_0x1C40007B_XIX_Physical_266b033c_Tx
            PduRSrcPdu_00f99798 (PduRSrcPdu): PduRSrcPduRef=EcucPduCollection/DCM_HCP5_CANFD01_XIX_TPCHType_CANFD_ISO_Diagnose_XIX_0x1C42007B_XIX_0x1C40007B_XIX_Physical_4bbc7f71_Tx
          DCM_HCP5_CANFD01_XIX_TPCHType_CANFD_OBDC_Diagnose_XIX_0x1C40027B_XIX_0x1C42027B_XIX_Physical_8b2e4924_Rx
            DCM_HCP5_CANFD01_XIX_TPCHType_CANFD_OBDC_Diagnose_XIX_0x1C40027B_XIX_0x1C42027B_XIX_Physical_8b2e4924_Rx_2f2c828e_Rx (PduRDestPdu): PduRDestPduRef=DCM_HCP5_CANFD01_XIX_TPCHType_CANFD_OBDC_Diagnose_XIX_0x1C40027B_XIX_0x1C42027B_XIX_Physical_a0b6e66f_Rx
            PduRSrcPdu_2f2c828e (PduRSrcPdu): PduRSrcPduRef=EcucPduCollection/DCM_HCP5_CANFD01_XIX_TPCHType_CANFD_OBDC_Diagnose_XIX_0x1C40027B_XIX_0x1C42027B_XIX_Physical_8b2e4924_Rx
          DCM_HCP5_CANFD01_XIX_TPCHType_CANFD_OBDC_Diagnose_XIX_0x1C42027B_XIX_0x1C40027B_XIX_Physical_c887ac0a_Tx
            DCM_HCP5_CANFD01_XIX_TPCHType_CANFD_OBDC_Diagnose_XIX_0x1C42027B_XIX_0x1C40027B_XIX_Physical_4ad10dcb_Tx (PduRDestPdu): PduRDestPduRef=EcucPduCollection/DCM_HCP5_CANFD01_XIX_TPCHType_CANFD_OBDC_Diagnose_XIX_0x1C42027B_XIX_0x1C40027B_XIX_Physical_4ad10dcb_Tx
            PduRSrcPdu_b085c674 (PduRSrcPdu): PduRSrcPduRef=EcucPduCollection/DCM_HCP5_CANFD01_XIX_TPCHType_CANFD_OBDC_Diagnose_XIX_0x1C42027B_XIX_0x1C40027B_XIX_Physical_c887ac0a_Tx
          DCM_HCP5_CANFD01_XIX_TPCHType_CANHS_Flash_DIA_XIX_0x17FC16D0_XIX_0x17FE16D0_XIX_Physical_33952be0_Rx
            DCM_HCP5_CANFD01_XIX_TPCHType_CANHS_Flash_DIA_XIX_0x17FC16D0_XIX_0x17FE16D0_XIX_Physical_33952be0_Rx_02e2f47b_Rx (PduRDestPdu): PduRDestPduRef=DCM_HCP5_CANFD01_XIX_TPCHType_CANHS_Flash_DIA_XIX_0x17FC16D0_XIX_0x17FE16D0_XIX_Physical_cdd15d85_Rx
            PduRSrcPdu_02e2f47b (PduRSrcPdu): PduRSrcPduRef=EcucPduCollection/DCM_HCP5_CANFD01_XIX_TPCHType_CANHS_Flash_DIA_XIX_0x17FC16D0_XIX_0x17FE16D0_XIX_Physical_33952be0_Rx
          DCM_HCP5_CANFD01_XIX_TPCHType_CANHS_Flash_DIA_XIX_0x17FC17B1_XIX_0x17FE17B1_XIX_Physical_849231ea_Rx
            DCM_HCP5_CANFD01_XIX_TPCHType_CANHS_Flash_DIA_XIX_0x17FC17B1_XIX_0x17FE17B1_XIX_Physical_849231ea_Rx_13840e84_Rx (PduRDestPdu): PduRDestPduRef=DCM_HCP5_CANFD01_XIX_TPCHType_CANHS_Flash_DIA_XIX_0x17FC17B1_XIX_0x17FE17B1_XIX_Physical_38ee8255_Rx
            PduRSrcPdu_13840e84 (PduRSrcPdu): PduRSrcPduRef=EcucPduCollection/DCM_HCP5_CANFD01_XIX_TPCHType_CANHS_Flash_DIA_XIX_0x17FC17B1_XIX_0x17FE17B1_XIX_Physical_849231ea_Rx
          DCM_HCP5_CANFD01_XIX_TPCHType_CANHS_Flash_DIA_XIX_0x17FC17B2_XIX_0x17FE17B2_XIX_Physical_654058e0_Rx
            DCM_HCP5_CANFD01_XIX_TPCHType_CANHS_Flash_DIA_XIX_0x17FC17B2_XIX_0x17FE17B2_XIX_Physical_654058e0_Rx_3b2af8f9_Rx (PduRDestPdu): PduRDestPduRef=DCM_HCP5_CANFD01_XIX_TPCHType_CANHS_Flash_DIA_XIX_0x17FC17B2_XIX_0x17FE17B2_XIX_Physical_e187cce2_Rx
            PduRSrcPdu_3b2af8f9 (PduRSrcPdu): PduRSrcPduRef=EcucPduCollection/DCM_HCP5_CANFD01_XIX_TPCHType_CANHS_Flash_DIA_XIX_0x17FC17B2_XIX_0x17FE17B2_XIX_Physical_654058e0_Rx
          DCM_HCP5_CANFD01_XIX_TPCHType_CANHS_Flash_DIA_XIX_0x17FE16D0_XIX_0x17FC16D0_XIX_Physical_7582832a_Tx
            DCM_HCP5_CANFD01_XIX_TPCHType_CANHS_Flash_DIA_XIX_0x17FE16D0_XIX_0x17FC16D0_XIX_Physical_aae5e090_Tx (PduRDestPdu): PduRDestPduRef=EcucPduCollection/DCM_HCP5_CANFD01_XIX_TPCHType_CANHS_Flash_DIA_XIX_0x17FE16D0_XIX_0x17FC16D0_XIX_Physical_aae5e090_Tx
            PduRSrcPdu_98350578 (PduRSrcPdu): PduRSrcPduRef=EcucPduCollection/DCM_HCP5_CANFD01_XIX_TPCHType_CANHS_Flash_DIA_XIX_0x17FE16D0_XIX_0x17FC16D0_XIX_Physical_7582832a_Tx
          DCM_HCP5_CANFD01_XIX_TPCHType_CANHS_Flash_DIA_XIX_0x17FE17B1_XIX_0x17FC17B1_XIX_Physical_80bd5cfa_Tx
            DCM_HCP5_CANFD01_XIX_TPCHType_CANHS_Flash_DIA_XIX_0x17FE17B1_XIX_0x17FC17B1_XIX_Physical_1de2fa9a_Tx (PduRDestPdu): PduRDestPduRef=EcucPduCollection/DCM_HCP5_CANFD01_XIX_TPCHType_CANHS_Flash_DIA_XIX_0x17FE17B1_XIX_0x17FC17B1_XIX_Physical_1de2fa9a_Tx
            PduRSrcPdu_bc997d9e (PduRSrcPdu): PduRSrcPduRef=EcucPduCollection/DCM_HCP5_CANFD01_XIX_TPCHType_CANHS_Flash_DIA_XIX_0x17FE17B1_XIX_0x17FC17B1_XIX_Physical_80bd5cfa_Tx
          DCM_HCP5_CANFD01_XIX_TPCHType_CANHS_Flash_DIA_XIX_0x17FE17B2_XIX_0x17FC17B2_XIX_Physical_59d4124d_Tx
            DCM_HCP5_CANFD01_XIX_TPCHType_CANHS_Flash_DIA_XIX_0x17FE17B2_XIX_0x17FC17B2_XIX_Physical_fc309390_Tx (PduRDestPdu): PduRDestPduRef=EcucPduCollection/DCM_HCP5_CANFD01_XIX_TPCHType_CANHS_Flash_DIA_XIX_0x17FE17B2_XIX_0x17FC17B2_XIX_Physical_fc309390_Tx
            PduRSrcPdu_faaa589d (PduRSrcPdu): PduRSrcPduRef=EcucPduCollection/DCM_HCP5_CANFD01_XIX_TPCHType_CANHS_Flash_DIA_XIX_0x17FE17B2_XIX_0x17FC17B2_XIX_Physical_59d4124d_Tx
          DCM_HCP5_CANFD01_XIX_TPCHType_CANHS_ISO_Diagnose_XIX_0x17FC007B_XIX_0x17FE007B_XIX_Physical_fb6bd0a7_Rx
            DCM_HCP5_CANFD01_XIX_TPCHType_CANHS_ISO_Diagnose_XIX_0x17FC007B_XIX_0x17FE007B_XIX_Physical_fb6bd0a7_Rx_aace39c6_Rx (PduRDestPdu): PduRDestPduRef=DCM_HCP5_CANFD01_XIX_TPCHType_CANHS_ISO_Diagnose_XIX_0x17FC007B_XIX_0x17FE007B_XIX_Physical_f4a1250c_Rx
            PduRSrcPdu_aace39c6 (PduRSrcPdu): PduRSrcPduRef=EcucPduCollection/DCM_HCP5_CANFD01_XIX_TPCHType_CANHS_ISO_Diagnose_XIX_0x17FC007B_XIX_0x17FE007B_XIX_Physical_fb6bd0a7_Rx
          DCM_HCP5_CANFD01_XIX_TPCHType_CANHS_ISO_Diagnose_XIX_0x17FE007B_XIX_0x17FC007B_XIX_Physical_4cf2fba3_Tx
            DCM_HCP5_CANFD01_XIX_TPCHType_CANHS_ISO_Diagnose_XIX_0x17FE007B_XIX_0x17FC007B_XIX_Physical_621b1bd7_Tx (PduRDestPdu): PduRDestPduRef=EcucPduCollection/DCM_HCP5_CANFD01_XIX_TPCHType_CANHS_ISO_Diagnose_XIX_0x17FE007B_XIX_0x17FC007B_XIX_Physical_621b1bd7_Tx
            PduRSrcPdu_bb9fbbb3 (PduRSrcPdu): PduRSrcPduRef=EcucPduCollection/DCM_HCP5_CANFD01_XIX_TPCHType_CANHS_ISO_Diagnose_XIX_0x17FE007B_XIX_0x17FC007B_XIX_Physical_4cf2fba3_Tx
          DCM_HCP5_CANFD01_XIX_TPCHType_CANHS_ISO_Diagnose_XIX_0x700_XIX_Functional_e754bff6_Rx
            DCM_HCP5_CANFD01_XIX_TPCHType_CANHS_ISO_Diagnose_XIX_0x700_XIX_Functional_e754bff6_Rx_ec16b563_Rx (PduRDestPdu): PduRDestPduRef=DCM_HCP5_CANFD01_XIX_TPCHType_CANHS_ISO_Diagnose_XIX_0x700_XIX_Functional_7a5202d2_Rx
            PduRSrcPdu_ec16b563 (PduRSrcPdu): PduRSrcPduRef=EcucPduCollection/DCM_HCP5_CANFD01_XIX_TPCHType_CANHS_ISO_Diagnose_XIX_0x700_XIX_Functional_e754bff6_Rx
          DCM_HCP5_CANFD01_XIX_TPCHType_CANHS_OBDC_SSN_Diagnose_XIX_0x17FC70D0_XIX_0x17FE70D0_XIX_Physical_cd403ce5_Rx
            DCM_HCP5_CANFD01_XIX_TPCHType_CANHS_OBDC_SSN_Diagnose_XIX_0x17FC70D0_XIX_0x17FE70D0_XIX_Physical_cd403ce5_Rx_01348a4e_Rx (PduRDestPdu): PduRDestPduRef=DCM_HCP5_CANFD01_XIX_TPCHType_CANHS_OBDC_SSN_Diagnose_XIX_0x17FC70D0_XIX_0x17FE70D0_XIX_Physical_43a0bf70_Rx
            PduRSrcPdu_01348a4e (PduRSrcPdu): PduRSrcPduRef=EcucPduCollection/DCM_HCP5_CANFD01_XIX_TPCHType_CANHS_OBDC_SSN_Diagnose_XIX_0x17FC70D0_XIX_0x17FE70D0_XIX_Physical_cd403ce5_Rx
          DCM_HCP5_CANFD01_XIX_TPCHType_CANHS_OBDC_SSN_Diagnose_XIX_0x17FC71B1_XIX_0x17FE71B1_XIX_Physical_7a4726ef_Rx
            DCM_HCP5_CANFD01_XIX_TPCHType_CANHS_OBDC_SSN_Diagnose_XIX_0x17FC71B1_XIX_0x17FE71B1_XIX_Physical_7a4726ef_Rx_83b1a2f8_Rx (PduRDestPdu): PduRDestPduRef=DCM_HCP5_CANFD01_XIX_TPCHType_CANHS_OBDC_SSN_Diagnose_XIX_0x17FC71B1_XIX_0x17FE71B1_XIX_Physical_b69f60a0_Rx
            PduRSrcPdu_83b1a2f8 (PduRSrcPdu): PduRSrcPduRef=EcucPduCollection/DCM_HCP5_CANFD01_XIX_TPCHType_CANHS_OBDC_SSN_Diagnose_XIX_0x17FC71B1_XIX_0x17FE71B1_XIX_Physical_7a4726ef_Rx
          DCM_HCP5_CANFD01_XIX_TPCHType_CANHS_OBDC_SSN_Diagnose_XIX_0x17FC71B2_XIX_0x17FE71B2_XIX_Physical_9b954fe5_Rx
            DCM_HCP5_CANFD01_XIX_TPCHType_CANHS_OBDC_SSN_Diagnose_XIX_0x17FC71B2_XIX_0x17FE71B2_XIX_Physical_9b954fe5_Rx_2e62150c_Rx (PduRDestPdu): PduRDestPduRef=DCM_HCP5_CANFD01_XIX_TPCHType_CANHS_OBDC_SSN_Diagnose_XIX_0x17FC71B2_XIX_0x17FE71B2_XIX_Physical_6ff62e17_Rx
            PduRSrcPdu_2e62150c (PduRSrcPdu): PduRSrcPduRef=EcucPduCollection/DCM_HCP5_CANFD01_XIX_TPCHType_CANHS_OBDC_SSN_Diagnose_XIX_0x17FC71B2_XIX_0x17FE71B2_XIX_Physical_9b954fe5_Rx
          DCM_HCP5_CANFD01_XIX_TPCHType_CANHS_OBDC_SSN_Diagnose_XIX_0x17FE70D0_XIX_0x17FC70D0_XIX_Physical_fbf361df_Tx
            DCM_HCP5_CANFD01_XIX_TPCHType_CANHS_OBDC_SSN_Diagnose_XIX_0x17FE70D0_XIX_0x17FC70D0_XIX_Physical_5430f795_Tx (PduRDestPdu):
              PduRDestPduRef = EcucPduCollection/DCM_HCP5_CANFD01_XIX_TPCHType_CANHS_OBDC_SSN_Diagnose_XIX_0x17FE70D0_XIX_0x17FC70D0_XIX_Physical_5430f795_Tx
            PduRSrcPdu_f87e2763 (PduRSrcPdu): PduRSrcPduRef=EcucPduCollection/DCM_HCP5_CANFD01_XIX_TPCHType_CANHS_OBDC_SSN_Diagnose_XIX_0x17FE70D0_XIX_0x17FC70D0_XIX_Physical_fbf361df_Tx
          DCM_HCP5_CANFD01_XIX_TPCHType_CANHS_OBDC_SSN_Diagnose_XIX_0x17FE71B1_XIX_0x17FC71B1_XIX_Physical_0eccbe0f_Tx
            DCM_HCP5_CANFD01_XIX_TPCHType_CANHS_OBDC_SSN_Diagnose_XIX_0x17FE71B1_XIX_0x17FC71B1_XIX_Physical_e337ed9f_Tx (PduRDestPdu):
              PduRDestPduRef = EcucPduCollection/DCM_HCP5_CANFD01_XIX_TPCHType_CANHS_OBDC_SSN_Diagnose_XIX_0x17FE71B1_XIX_0x17FC71B1_XIX_Physical_e337ed9f_Tx
            PduRSrcPdu_9d8c054b (PduRSrcPdu): PduRSrcPduRef=EcucPduCollection/DCM_HCP5_CANFD01_XIX_TPCHType_CANHS_OBDC_SSN_Diagnose_XIX_0x17FE71B1_XIX_0x17FC71B1_XIX_Physical_0eccbe0f_Tx
          DCM_HCP5_CANFD01_XIX_TPCHType_CANHS_OBDC_SSN_Diagnose_XIX_0x17FE71B2_XIX_0x17FC71B2_XIX_Physical_d7a5f0b8_Tx
            DCM_HCP5_CANFD01_XIX_TPCHType_CANHS_OBDC_SSN_Diagnose_XIX_0x17FE71B2_XIX_0x17FC71B2_XIX_Physical_02e58495_Tx (PduRDestPdu):
              PduRDestPduRef = EcucPduCollection/DCM_HCP5_CANFD01_XIX_TPCHType_CANHS_OBDC_SSN_Diagnose_XIX_0x17FE71B2_XIX_0x17FC71B2_XIX_Physical_02e58495_Tx
            PduRSrcPdu_85a62c68 (PduRSrcPdu): PduRSrcPduRef=EcucPduCollection/DCM_HCP5_CANFD01_XIX_TPCHType_CANHS_OBDC_SSN_Diagnose_XIX_0x17FE71B2_XIX_0x17FC71B2_XIX_Physical_d7a5f0b8_Tx
          DCM_HCP5_CANFD01_XIX_TPCHType_CANHS_OBDx_XIX_0x18DA05F1_XIX_0x18DAF105_XIX_Physical_31397855_Rx
            DCM_HCP5_CANFD01_XIX_TPCHType_CANHS_OBDx_XIX_0x18DA05F1_XIX_0x18DAF105_XIX_Physical_31397855_Rx_2f3fa766_Rx (PduRDestPdu): PduRDestPduRef=DCM_HCP5_CANFD01_XIX_TPCHType_CANHS_OBDx_XIX_0x18DA05F1_XIX_0x18DAF105_XIX_Physical_c08ed539_Rx
            PduRSrcPdu_2f3fa766 (PduRSrcPdu): PduRSrcPduRef=EcucPduCollection/DCM_HCP5_CANFD01_XIX_TPCHType_CANHS_OBDx_XIX_0x18DA05F1_XIX_0x18DAF105_XIX_Physical_31397855_Rx
          DCM_HCP5_CANFD01_XIX_TPCHType_CANHS_OBDx_XIX_0x18DAF105_XIX_0x18DA05F1_XIX_Physical_9db247ca_Tx
            DCM_HCP5_CANFD01_XIX_TPCHType_CANHS_OBDx_XIX_0x18DAF105_XIX_0x18DA05F1_XIX_Physical_71746075_Tx (PduRDestPdu): PduRDestPduRef=EcucPduCollection/DCM_HCP5_CANFD01_XIX_TPCHType_CANHS_OBDx_XIX_0x18DAF105_XIX_0x18DA05F1_XIX_Physical_71746075_Tx
            PduRSrcPdu_8c8ce63b (PduRSrcPdu): PduRSrcPduRef=EcucPduCollection/DCM_HCP5_CANFD01_XIX_TPCHType_CANHS_OBDx_XIX_0x18DAF105_XIX_0x18DA05F1_XIX_Physical_9db247ca_Tx
          DCM_HCP5_CANFD01_XIX_TPCHType_CANHS_OBDx_XIX_0x18DB33F1_XIX_Functional_06e701c6_Rx
            DCM_HCP5_CANFD01_XIX_TPCHType_CANHS_OBDx_XIX_0x18DB33F1_XIX_Functional_06e701c6_Rx_4f93e0e1_Rx (PduRDestPdu): PduRDestPduRef=DCM_HCP5_CANFD01_XIX_TPCHType_CANHS_OBDx_XIX_0x18DB33F1_XIX_Functional_1f67dc03_Rx
            PduRSrcPdu_4f93e0e1 (PduRSrcPdu): PduRSrcPduRef=EcucPduCollection/DCM_HCP5_CANFD01_XIX_TPCHType_CANHS_OBDx_XIX_0x18DB33F1_XIX_Functional_06e701c6_Rx
          DEV_Hybrid_01_Req_00_XIX_HCP5_CANFD01_91241766_Rx
            DEV_Hybrid_01_Req_00_XIX_HCP5_CANFD01_91241766_Rx_69081bae_Rx (PduRDestPdu): PduRDestPduRef=EcucPduCollection/DEV_Hybrid_01_Req_00_XIX_HCP5_CANFD01_5661b344_Rx
            PduRSrcPdu_69081bae (PduRSrcPdu): PduRSrcPduRef=EcucPduCollection/DEV_Hybrid_01_Req_00_XIX_HCP5_CANFD01_91241766_Rx
          DEV_Hybrid_01_Resp_FF_XIX_HCP5_CANFD01_7b20ac63_Tx
            DEV_Hybrid_01_Resp_FF_XIX_HCP5_CANFD01_3aa35b5c_Tx (PduRDestPdu): PduRDestPduRef=EcucPduCollection/DEV_Hybrid_01_Resp_FF_XIX_HCP5_CANFD01_3aa35b5c_Tx
            PduRSrcPdu_50b5fcd7 (PduRSrcPdu): PduRSrcPduRef=EcucPduCollection/DEV_Hybrid_01_Resp_FF_XIX_HCP5_CANFD01_7b20ac63_Tx
          DS_Hybrid_01_XIX_HCP5_CANFD01_b3d0b839_Tx
            DS_Hybrid_01_XIX_HCP5_CANFD01_ed9ff9e4_Tx (PduRDestPdu): PduRDestPduRef=EcucPduCollection/DS_Hybrid_01_XIX_HCP5_CANFD01_ed9ff9e4_Tx
            PduRSrcPdu_9d79cb4c (PduRSrcPdu): PduRSrcPduRef=EcucPduCollection/DS_Hybrid_01_XIX_HCP5_CANFD01_b3d0b839_Tx
          Diagnose_01_XIX_HCP5_CANFD01_95a294dc_Rx
            Diagnose_01_XIX_HCP5_CANFD01_95a294dc_Rx_38b07996_Rx (PduRDestPdu): PduRDestPduRef=EcucPduCollection/Diagnose_01_XIX_HCP5_CANFD01_426f0ab5_Rx
            PduRSrcPdu_38b07996 (PduRSrcPdu): PduRSrcPduRef=EcucPduCollection/Diagnose_01_XIX_HCP5_CANFD01_95a294dc_Rx
          ELF_06_XIX_HCP5_CANFD01_21ac90a0_Rx
            ELF_06_XIX_HCP5_CANFD01_21ac90a0_Rx_f83a5697_Rx (PduRDestPdu): PduRDestPduRef=EcucPduCollection/ELF_06_XIX_HCP5_CANFD01_d78b945c_Rx
            PduRSrcPdu_f83a5697 (PduRSrcPdu): PduRSrcPduRef=EcucPduCollection/ELF_06_XIX_HCP5_CANFD01_21ac90a0_Rx
          HCP1_17_XIX_HCP5_CANFD01_c544c746_Rx
            HCP1_17_XIX_HCP5_CANFD01_c544c746_Rx_d4862e32_Rx (PduRDestPdu): PduRDestPduRef=EcucPduCollection/HCP1_17_XIX_HCP5_CANFD01_3398d6b5_Rx
            PduRSrcPdu_d4862e32 (PduRSrcPdu): PduRSrcPduRef=EcucPduCollection/HCP1_17_XIX_HCP5_CANFD01_c544c746_Rx
          HVEM_07_XIX_HCP5_CANFD01_6bc428a9_Rx
            HVEM_07_XIX_HCP5_CANFD01_6bc428a9_Rx_0e19c894_Rx (PduRDestPdu): PduRDestPduRef=EcucPduCollection/HVEM_07_XIX_HCP5_CANFD01_839f516f_Rx
            PduRSrcPdu_0e19c894 (PduRSrcPdu): PduRSrcPduRef=EcucPduCollection/HVEM_07_XIX_HCP5_CANFD01_6bc428a9_Rx
          HVK_03_E2E_SOK_XIX_HCP5_CANFD01_17f9ff97_Rx
            HVK_03_E2E_SOK_XIX_HCP5_CANFD01_17f9ff97_Rx_69fab053_Rx (PduRDestPdu): PduRDestPduRef=EcucPduCollection/HVK_03_E2E_SOK_XIX_HCP5_CANFD01_32c3c9b9_Rx
            PduRSrcPdu_69fab053 (PduRSrcPdu): PduRSrcPduRef=EcucPduCollection/HVK_03_E2E_SOK_XIX_HCP5_CANFD01_17f9ff97_Rx
          HVK_03_XIX_HCP5_CANFD01_E2E_8a76edcb_Rx
            HVK_03_XIX_HCP5_CANFD01_E2E_8a76edcb_Rx (PduRDestPdu): PduRDestPduRef=EcucPduCollection/HVK_03_XIX_HCP5_CANFD01_E2E_8a76edcb_Rx
            PduRSrcPdu_352c0879 (PduRSrcPdu): PduRSrcPduRef=EcucPduCollection/HVK_03_XIX_HCP5_CANFD01_E2E_8a76edcb_Rx
          HVLM_13_XIX_HCP5_CANFD01_f34a06e4_Rx
            HVLM_13_XIX_HCP5_CANFD01_f34a06e4_Rx_a57e9da9_Rx (PduRDestPdu): PduRDestPduRef=EcucPduCollection/HVLM_13_XIX_HCP5_CANFD01_f1be44f1_Rx
            PduRSrcPdu_a57e9da9 (PduRSrcPdu): PduRSrcPduRef=EcucPduCollection/HVLM_13_XIX_HCP5_CANFD01_f34a06e4_Rx
          HVLM_14_XIX_HCP5_CANFD01_E2E_2623685a_Rx
            HVLM_14_XIX_HCP5_CANFD01_E2E_2623685a_Rx_f33ff981_Rx (PduRDestPdu): PduRDestPduRef=EcucPduCollection/HVLM_14_XIX_HCP5_CANFD01_E2E_b3d1458f_Rx
            PduRSrcPdu_f33ff981 (PduRSrcPdu): PduRSrcPduRef=EcucPduCollection/HVLM_14_XIX_HCP5_CANFD01_E2E_2623685a_Rx
          KN_Hybrid_01_XIX_HCP5_CANFD01_fef84477_Tx
            KN_Hybrid_01_XIX_HCP5_CANFD01_3c12b6a6_Tx (PduRDestPdu): PduRDestPduRef=EcucPduCollection/KN_Hybrid_01_XIX_HCP5_CANFD01_3c12b6a6_Tx
            PduRSrcPdu_6ffd86c6 (PduRSrcPdu): PduRSrcPduRef=EcucPduCollection/KN_Hybrid_01_XIX_HCP5_CANFD01_fef84477_Tx
          KS_Hybrid_01_Challenge_K_XIX_HCP5_CANFD01_306d69bd_Tx
            KS_Hybrid_01_Challenge_K_XIX_HCP5_CANFD01_f262895d_Tx (PduRDestPdu): PduRDestPduRef=EcucPduCollection/KS_Hybrid_01_Challenge_K_XIX_HCP5_CANFD01_f262895d_Tx
            PduRSrcPdu_b10cf005 (PduRSrcPdu): PduRSrcPduRef=EcucPduCollection/KS_Hybrid_01_Challenge_K_XIX_HCP5_CANFD01_306d69bd_Tx
          KS_Hybrid_01_Challenge_M_XIX_HCP5_CANFD01_a71be84d_Rx
            KS_Hybrid_01_Challenge_M_XIX_HCP5_CANFD01_a71be84d_Rx_60261c85_Rx (PduRDestPdu): PduRDestPduRef=EcucPduCollection/KS_Hybrid_01_Challenge_M_XIX_HCP5_CANFD01_3e11d538_Rx
            PduRSrcPdu_60261c85 (PduRSrcPdu): PduRSrcPduRef=EcucPduCollection/KS_Hybrid_01_Challenge_M_XIX_HCP5_CANFD01_a71be84d_Rx
          KS_Hybrid_01_ReqFrame_XIX_HCP5_CANFD01_b04c52dd_Tx
            KS_Hybrid_01_ReqFrame_XIX_HCP5_CANFD01_d7f937e5_Tx (PduRDestPdu): PduRDestPduRef=EcucPduCollection/KS_Hybrid_01_ReqFrame_XIX_HCP5_CANFD01_d7f937e5_Tx
            PduRSrcPdu_ff6c54d6 (PduRSrcPdu): PduRSrcPduRef=EcucPduCollection/KS_Hybrid_01_ReqFrame_XIX_HCP5_CANFD01_b04c52dd_Tx
          KS_Hybrid_01_Response_K_XIX_HCP5_CANFD01_76da782f_Tx
            KS_Hybrid_01_Response_K_XIX_HCP5_CANFD01_4e4d208b_Tx (PduRDestPdu): PduRDestPduRef=EcucPduCollection/KS_Hybrid_01_Response_K_XIX_HCP5_CANFD01_4e4d208b_Tx
            PduRSrcPdu_77f84512 (PduRSrcPdu): PduRSrcPduRef=EcucPduCollection/KS_Hybrid_01_Response_K_XIX_HCP5_CANFD01_76da782f_Tx
          KS_Hybrid_01_Response_M_XIX_HCP5_CANFD01_1b34419b_Rx
            KS_Hybrid_01_Response_M_XIX_HCP5_CANFD01_1b34419b_Rx_150a78db_Rx (PduRDestPdu): PduRDestPduRef=EcucPduCollection/KS_Hybrid_01_Response_M_XIX_HCP5_CANFD01_78a6c4aa_Rx
            PduRSrcPdu_150a78db (PduRSrcPdu): PduRSrcPduRef=EcucPduCollection/KS_Hybrid_01_Response_M_XIX_HCP5_CANFD01_1b34419b_Rx
          NMH_Hybrid_01_XIX_BMC_CAN01_b22e17f1_Tx
            NMH_Hybrid_01_XIX_BMC_CAN01_b22e17f1_Tx_dcfa7b44_Tx (PduRDestPdu): PduRDestPduRef=EcucPduCollection/NMH_Hybrid_01_XIX_BMC_CAN01_b22e17f1_Tx
            PduRSrcPdu_dcfa7b44 (PduRSrcPdu): PduRSrcPduRef=EcucPduCollection/NMH_Hybrid_01_XIX_BMC_CAN01_b22e17f1_Tx
          NM_Hybrid_01_XIX_HCP5_CANFD01_c84ff8a5_Tx
            NM_Hybrid_01_XIX_HCP5_CANFD01_c84ff8a5_Tx_448d0b52_Tx (PduRDestPdu): PduRDestPduRef=EcucPduCollection/NM_Hybrid_01_XIX_HCP5_CANFD01_c84ff8a5_Tx
            PduRSrcPdu_448d0b52 (PduRSrcPdu): PduRSrcPduRef=EcucPduCollection/NM_Hybrid_01_XIX_HCP5_CANFD01_c84ff8a5_Tx
          NVEM_12_XIX_HCP5_CANFD01_27d236bb_Rx
            NVEM_12_XIX_HCP5_CANFD01_27d236bb_Rx_8ee67ae6_Rx (PduRDestPdu): PduRDestPduRef=EcucPduCollection/NVEM_12_XIX_HCP5_CANFD01_00bae280_Rx
            PduRSrcPdu_8ee67ae6 (PduRSrcPdu): PduRSrcPduRef=EcucPduCollection/NVEM_12_XIX_HCP5_CANFD01_27d236bb_Rx
          OBD_HCP1_SOK_XIX_HCP5_CANFD01_a5806350_Rx
            OBD_HCP1_SOK_XIX_HCP5_CANFD01_a5806350_Rx_12c1a9c9_Rx (PduRDestPdu): PduRDestPduRef=EcucPduCollection/OBD_HCP1_SOK_XIX_HCP5_CANFD01_499f5f1b_Rx
            PduRSrcPdu_12c1a9c9 (PduRSrcPdu): PduRSrcPduRef=EcucPduCollection/OBD_HCP1_SOK_XIX_HCP5_CANFD01_a5806350_Rx
          OBD_HCP1_XIX_HCP5_CANFD01_1b389b6c_Rx
            OBD_HCP1_XIX_HCP5_CANFD01_1b389b6c_Rx (PduRDestPdu): PduRDestPduRef=EcucPduCollection/OBD_HCP1_XIX_HCP5_CANFD01_1b389b6c_Rx
            PduRSrcPdu_5b8ddcf4 (PduRSrcPdu): PduRSrcPduRef=EcucPduCollection/OBD_HCP1_XIX_HCP5_CANFD01_1b389b6c_Rx
          OBD_Hybrid_01_SOK_XIX_HCP5_CANFD01_86ce2f2e_Tx
            OBD_Hybrid_01_SOK_XIX_HCP5_CANFD01_c373a414_Tx (PduRDestPdu): PduRDestPduRef=EcucPduCollection/OBD_Hybrid_01_SOK_XIX_HCP5_CANFD01_c373a414_Tx
            PduRSrcPdu_519fcae0 (PduRSrcPdu): PduRSrcPduRef=EcucPduCollection/OBD_Hybrid_01_SOK_XIX_HCP5_CANFD01_86ce2f2e_Tx
          OBD_Hybrid_01_XIX_HCP5_CANFD01_40f9dae5_Tx
            OBD_Hybrid_01_XIX_HCP5_CANFD01_40f9dae5_Tx (PduRDestPdu): PduRDestPduRef=EcucPduCollection/OBD_Hybrid_01_XIX_HCP5_CANFD01_40f9dae5_Tx
            PduRSrcPdu_1d84387f (PduRSrcPdu): PduRSrcPduRef=EcucPduCollection/OBD_Hybrid_01_XIX_HCP5_CANFD01_40f9dae5_Tx
          OBG_01_XIX_HCP5_CANFD01_6af9c66f_Rx
            OBG_01_XIX_HCP5_CANFD01_6af9c66f_Rx_4d6fef81_Rx (PduRDestPdu): PduRDestPduRef=EcucPduCollection/OBG_01_XIX_HCP5_CANFD01_8fe2f1e9_Rx
            PduRSrcPdu_4d6fef81 (PduRSrcPdu): PduRSrcPduRef=EcucPduCollection/OBG_01_XIX_HCP5_CANFD01_6af9c66f_Rx
          OTP_01_XIX_HCP5_CANFD01_fd0a6756_Rx
            OTP_01_XIX_HCP5_CANFD01_fd0a6756_Rx_c5c247d5_Rx (PduRDestPdu): PduRDestPduRef=EcucPduCollection/OTP_01_XIX_HCP5_CANFD01_76e7759c_Rx
            PduRSrcPdu_c5c247d5 (PduRSrcPdu): PduRSrcPduRef=EcucPduCollection/OTP_01_XIX_HCP5_CANFD01_fd0a6756_Rx
          SOK_NoAuthenticTime_01_XIX_HCP5_CANFD01_8db7a3c2_Rx
            SOK_NoAuthenticTime_01_XIX_HCP5_CANFD01_8db7a3c2_Rx_80319ce0_Rx (PduRDestPdu): PduRDestPduRef=EcucPduCollection/SOK_NoAuthenticTime_01_XIX_HCP5_CANFD01_a407ae2f_Rx
            PduRSrcPdu_80319ce0 (PduRSrcPdu): PduRSrcPduRef=EcucPduCollection/SOK_NoAuthenticTime_01_XIX_HCP5_CANFD01_8db7a3c2_Rx
          SOK_Zeit_Hybrid_01_Chal_01_XIX_HCP5_CANFD01_5939048b_Tx
            SOK_Zeit_Hybrid_01_Chal_01_XIX_HCP5_CANFD01_441f0aae_Tx (PduRDestPdu): PduRDestPduRef=EcucPduCollection/SOK_Zeit_Hybrid_01_Chal_01_XIX_HCP5_CANFD01_441f0aae_Tx
            PduRSrcPdu_bda03fc7 (PduRSrcPdu): PduRSrcPduRef=EcucPduCollection/SOK_Zeit_Hybrid_01_Chal_01_XIX_HCP5_CANFD01_5939048b_Tx
          SOK_Zeit_Hybrid_01_Resp_01_SOK_XIX_HCP5_CANFD01_7ac24361_Rx
            SOK_Zeit_Hybrid_01_Resp_01_SOK_XIX_HCP5_CANFD01_7ac24361_Rx_e4ce0dcf_Rx (PduRDestPdu): PduRDestPduRef=EcucPduCollection/SOK_Zeit_Hybrid_01_Resp_01_SOK_XIX_HCP5_CANFD01_92adacdc_Rx
            PduRSrcPdu_e4ce0dcf (PduRSrcPdu): PduRSrcPduRef=EcucPduCollection/SOK_Zeit_Hybrid_01_Resp_01_SOK_XIX_HCP5_CANFD01_7ac24361_Rx
          SOK_Zeit_Hybrid_01_Resp_01_XIX_HCP5_CANFD01_c7a98a10_Rx
            SOK_Zeit_Hybrid_01_Resp_01_XIX_HCP5_CANFD01_c7a98a10_Rx (PduRDestPdu): PduRDestPduRef=EcucPduCollection/SOK_Zeit_Hybrid_01_Resp_01_XIX_HCP5_CANFD01_c7a98a10_Rx
            PduRSrcPdu_c1028dd0 (PduRSrcPdu): PduRSrcPduRef=EcucPduCollection/SOK_Zeit_Hybrid_01_Resp_01_XIX_HCP5_CANFD01_c7a98a10_Rx
          Thermomanagement_01_XIX_HCP5_CANFD01_bb71c5fe_Rx
            Thermomanagement_01_XIX_HCP5_CANFD01_bb71c5fe_Rx_0b89624e_Rx (PduRDestPdu): PduRDestPduRef=EcucPduCollection/Thermomanagement_01_XIX_HCP5_CANFD01_60e8cf38_Rx
            PduRSrcPdu_0b89624e (PduRSrcPdu): PduRSrcPduRef=EcucPduCollection/Thermomanagement_01_XIX_HCP5_CANFD01_bb71c5fe_Rx
          UI1_01_XIX_BMC_CAN01_E2E_e77bac14_Rx
            UI1_01_XIX_BMC_CAN01_E2E_e77bac14_Rx_9e0787f4_Rx (PduRDestPdu): PduRDestPduRef=EcucPduCollection/UI1_01_XIX_BMC_CAN01_E2E_cec88adf_Rx
            PduRSrcPdu_9e0787f4 (PduRSrcPdu): PduRSrcPduRef=EcucPduCollection/UI1_01_XIX_BMC_CAN01_E2E_e77bac14_Rx
          UI1_02_XIX_BMC_CAN01_E2E_aa93ac73_Rx
            UI1_02_XIX_BMC_CAN01_E2E_aa93ac73_Rx_ca25ded9_Rx (PduRDestPdu): PduRDestPduRef=EcucPduCollection/UI1_02_XIX_BMC_CAN01_E2E_6d9e0c76_Rx
            PduRSrcPdu_ca25ded9 (PduRSrcPdu): PduRSrcPduRef=EcucPduCollection/UI1_02_XIX_BMC_CAN01_E2E_aa93ac73_Rx
          UI1_03_XIX_BMC_CAN01_0abdbc10_Rx
            UI1_03_XIX_BMC_CAN01_0abdbc10_Rx_47a5a20b_Rx (PduRDestPdu): PduRDestPduRef=EcucPduCollection/UI1_03_XIX_BMC_CAN01_4277cadb_Rx
            PduRSrcPdu_47a5a20b (PduRSrcPdu): PduRSrcPduRef=EcucPduCollection/UI1_03_XIX_BMC_CAN01_0abdbc10_Rx
          UI1_04_XIX_BMC_CAN01_f5320b92_Rx
            UI1_04_XIX_BMC_CAN01_f5320b92_Rx_a68bd2dd_Rx (PduRDestPdu): PduRDestPduRef=EcucPduCollection/UI1_04_XIX_BMC_CAN01_d976c5c1_Rx
            PduRSrcPdu_a68bd2dd (PduRSrcPdu): PduRSrcPduRef=EcucPduCollection/UI1_04_XIX_BMC_CAN01_f5320b92_Rx
          UI1_05_XIX_BMC_CAN01_d1b05aa4_Rx
            UI1_05_XIX_BMC_CAN01_d1b05aa4_Rx_472804b0_Rx (PduRDestPdu): PduRDestPduRef=EcucPduCollection/UI1_05_XIX_BMC_CAN01_608d1e29_Rx
            PduRSrcPdu_472804b0 (PduRSrcPdu): PduRSrcPduRef=EcucPduCollection/UI1_05_XIX_BMC_CAN01_d1b05aa4_Rx
          UI1_Komponentenfehler_01_XIX_BMC_CAN01_0b0d2b23_Rx
            UI1_Komponentenfehler_01_XIX_BMC_CAN01_0b0d2b23_Rx_58b056a0_Rx (PduRDestPdu): PduRDestPduRef=EcucPduCollection/UI1_Komponentenfehler_01_XIX_BMC_CAN01_08861f77_Rx
            PduRSrcPdu_58b056a0 (PduRSrcPdu): PduRSrcPduRef=EcucPduCollection/UI1_Komponentenfehler_01_XIX_BMC_CAN01_0b0d2b23_Rx
          UI1_Komponentenfehler_02_XIX_BMC_CAN01_668bd879_Rx
            UI1_Komponentenfehler_02_XIX_BMC_CAN01_668bd879_Rx_8494a485_Rx (PduRDestPdu): PduRDestPduRef=EcucPduCollection/UI1_Komponentenfehler_02_XIX_BMC_CAN01_19fb750e_Rx
            PduRSrcPdu_8494a485 (PduRSrcPdu): PduRSrcPduRef=EcucPduCollection/UI1_Komponentenfehler_02_XIX_BMC_CAN01_668bd879_Rx
          UI2Sens01_CALID_01_XIX_BMC_CAN01_6126d1bc_Rx
            UI2Sens01_CALID_01_XIX_BMC_CAN01_6126d1bc_Rx_d28b6e52_Rx (PduRDestPdu): PduRDestPduRef=EcucPduCollection/UI2Sens01_CALID_01_XIX_BMC_CAN01_f3c92280_Rx
            PduRSrcPdu_d28b6e52 (PduRSrcPdu): PduRSrcPduRef=EcucPduCollection/UI2Sens01_CALID_01_XIX_BMC_CAN01_6126d1bc_Rx
          UI2Sens01_CALID_02_XIX_BMC_CAN01_0ca022e6_Rx
            UI2Sens01_CALID_02_XIX_BMC_CAN01_0ca022e6_Rx_31992630_Rx (PduRDestPdu): PduRDestPduRef=EcucPduCollection/UI2Sens01_CALID_02_XIX_BMC_CAN01_e2b448f9_Rx
            PduRSrcPdu_31992630 (PduRSrcPdu): PduRSrcPduRef=EcucPduCollection/UI2Sens01_CALID_02_XIX_BMC_CAN01_0ca022e6_Rx
          UI2Sens01_CVN_XIX_BMC_CAN01_7910df29_Rx
            UI2Sens01_CVN_XIX_BMC_CAN01_7910df29_Rx_987f4326_Rx (PduRDestPdu): PduRDestPduRef=EcucPduCollection/UI2Sens01_CVN_XIX_BMC_CAN01_fe6b52fc_Rx
            PduRSrcPdu_987f4326 (PduRSrcPdu): PduRSrcPduRef=EcucPduCollection/UI2Sens01_CVN_XIX_BMC_CAN01_7910df29_Rx
          UI2Sens02_CALID_01_XIX_BMC_CAN01_a812cab1_Rx
            UI2Sens02_CALID_01_XIX_BMC_CAN01_a812cab1_Rx_0e1135ae_Rx (PduRDestPdu): PduRDestPduRef=EcucPduCollection/UI2Sens02_CALID_01_XIX_BMC_CAN01_abd78ba8_Rx
            PduRSrcPdu_0e1135ae (PduRSrcPdu): PduRSrcPduRef=EcucPduCollection/UI2Sens02_CALID_01_XIX_BMC_CAN01_a812cab1_Rx
          UI2Sens02_CALID_02_XIX_BMC_CAN01_c59439eb_Rx
            UI2Sens02_CALID_02_XIX_BMC_CAN01_c59439eb_Rx_c5309ef2_Rx (PduRDestPdu): PduRDestPduRef=EcucPduCollection/UI2Sens02_CALID_02_XIX_BMC_CAN01_baaae1d1_Rx
            PduRSrcPdu_c5309ef2 (PduRSrcPdu): PduRSrcPduRef=EcucPduCollection/UI2Sens02_CALID_02_XIX_BMC_CAN01_c59439eb_Rx
          UI2Sens02_CVN_XIX_BMC_CAN01_34f8df4e_Rx
            UI2Sens02_CVN_XIX_BMC_CAN01_34f8df4e_Rx_053df0d7_Rx (PduRDestPdu): PduRDestPduRef=EcucPduCollection/UI2Sens02_CVN_XIX_BMC_CAN01_5d3dd455_Rx
            PduRSrcPdu_053df0d7 (PduRSrcPdu): PduRSrcPduRef=EcucPduCollection/UI2Sens02_CVN_XIX_BMC_CAN01_34f8df4e_Rx
          UI2_01_XIX_BMC_CAN01_E2E_04321bb6_Rx
            UI2_01_XIX_BMC_CAN01_E2E_04321bb6_Rx_24a65b83_Rx (PduRDestPdu): PduRDestPduRef=EcucPduCollection/UI2_01_XIX_BMC_CAN01_E2E_f7b0279f_Rx
            PduRSrcPdu_24a65b83 (PduRSrcPdu): PduRSrcPduRef=EcucPduCollection/UI2_01_XIX_BMC_CAN01_E2E_04321bb6_Rx
          UI2_02_XIX_BMC_CAN01_E2E_49da1bd1_Rx
            UI2_02_XIX_BMC_CAN01_E2E_49da1bd1_Rx_ada48f41_Rx (PduRDestPdu): PduRDestPduRef=EcucPduCollection/UI2_02_XIX_BMC_CAN01_E2E_54e6a136_Rx
            PduRSrcPdu_ada48f41 (PduRSrcPdu): PduRSrcPduRef=EcucPduCollection/UI2_02_XIX_BMC_CAN01_E2E_49da1bd1_Rx
          UI2_03_XIX_BMC_CAN01_E2E_c452e633_Rx
            UI2_03_XIX_BMC_CAN01_E2E_c452e633_Rx_d907d982_Rx (PduRDestPdu): PduRDestPduRef=EcucPduCollection/UI2_03_XIX_BMC_CAN01_E2E_8304216e_Rx
            PduRSrcPdu_d907d982 (PduRSrcPdu): PduRSrcPduRef=EcucPduCollection/UI2_03_XIX_BMC_CAN01_E2E_c452e633_Rx
          UI2_04_XIX_BMC_CAN01_af5334f2_Rx
            UI2_04_XIX_BMC_CAN01_af5334f2_Rx_77fe0f74_Rx (PduRDestPdu): PduRDestPduRef=EcucPduCollection/UI2_04_XIX_BMC_CAN01_33f018a3_Rx
            PduRSrcPdu_77fe0f74 (PduRSrcPdu): PduRSrcPduRef=EcucPduCollection/UI2_04_XIX_BMC_CAN01_af5334f2_Rx
          UI2_Komponentenfehler_01_XIX_BMC_CAN01_6d09fe13_Rx
            UI2_Komponentenfehler_01_XIX_BMC_CAN01_6d09fe13_Rx_b8d5b81b_Rx (PduRDestPdu): PduRDestPduRef=EcucPduCollection/UI2_Komponentenfehler_01_XIX_BMC_CAN01_6c666489_Rx
            PduRSrcPdu_b8d5b81b (PduRSrcPdu): PduRSrcPduRef=EcucPduCollection/UI2_Komponentenfehler_01_XIX_BMC_CAN01_6d09fe13_Rx
          UI2_Komponentenfehler_02_XIX_BMC_CAN01_008f0d49_Rx
            UI2_Komponentenfehler_02_XIX_BMC_CAN01_008f0d49_Rx_48d15ae7_Rx (PduRDestPdu): PduRDestPduRef=EcucPduCollection/UI2_Komponentenfehler_02_XIX_BMC_CAN01_7d1b0ef0_Rx
            PduRSrcPdu_48d15ae7 (PduRSrcPdu): PduRSrcPduRef=EcucPduCollection/UI2_Komponentenfehler_02_XIX_BMC_CAN01_008f0d49_Rx
          VDSO_05_XIX_HCP5_CANFD01_f45d20ad_Rx
            VDSO_05_XIX_HCP5_CANFD01_f45d20ad_Rx_fbfe2c62_Rx (PduRDestPdu): PduRDestPduRef=EcucPduCollection/VDSO_05_XIX_HCP5_CANFD01_48366f26_Rx
            PduRSrcPdu_fbfe2c62 (PduRSrcPdu): PduRSrcPduRef=EcucPduCollection/VDSO_05_XIX_HCP5_CANFD01_f45d20ad_Rx
          WFS_02_XIX_HCP5_CANFD01_a0e8c21d_Rx
            WFS_02_XIX_HCP5_CANFD01_a0e8c21d_Rx_6db56476_Rx (PduRDestPdu): PduRDestPduRef=EcucPduCollection/WFS_02_XIX_HCP5_CANFD01_61136cb6_Rx
            PduRSrcPdu_6db56476 (PduRSrcPdu): PduRSrcPduRef=EcucPduCollection/WFS_02_XIX_HCP5_CANFD01_a0e8c21d_Rx
          ZeitMaster_01_XIX_HCP5_CANFD01_16302e51_Rx
            ZeitMaster_01_XIX_HCP5_CANFD01_16302e51_Rx_2f7b3461_Rx (PduRDestPdu): PduRDestPduRef=EcucPduCollection/ZeitMaster_01_XIX_HCP5_CANFD01_dad73d21_Rx
            PduRSrcPdu_2f7b3461 (PduRSrcPdu): PduRSrcPduRef=EcucPduCollection/ZeitMaster_01_XIX_HCP5_CANFD01_16302e51_Rx
          Zeitmaster_05_XIX_HCP5_CANFD01_1d48ef0a_Rx
            Zeitmaster_05_XIX_HCP5_CANFD01_1d48ef0a_Rx_07825d96_Rx (PduRDestPdu): PduRDestPduRef=EcucPduCollection/Zeitmaster_05_XIX_HCP5_CANFD01_5eaa5a96_Rx
            PduRSrcPdu_07825d96 (PduRSrcPdu): PduRSrcPduRef=EcucPduCollection/Zeitmaster_05_XIX_HCP5_CANFD01_1d48ef0a_Rx
  module config SecOC
    3 x SecOCRxPduProcessing, all with SecOCAuthDataFreshnessLen=0, SecOCAuthDataFreshnessStartPosition=0, SecOCAuthenticationBuildAttempts=1, SecOCFreshnessValueLength=64, SecOCFreshnessValueTxLength=0:
      HVK_03_E2E_SOK_XIX_HCP5_CANFD01_32c3c9b9_Rx: SecOCAuthInfoTxLength=32, SecOCAuthenticationVerifyAttempts=4, SecOCDataId=715, SecOCFreshnessValueId=1, SecOCUseAuthDataFreshness=true
        HVK_03_XIX_HCP5_CANFD01_E2E_8a76edcb_Rx (SecOCRxAuthenticPduLayer): SecOCRxAuthenticLayerPduRef=EcucPduCollection/HVK_03_XIX_HCP5_CANFD01_E2E_8a76edcb_Rx
        SecOCRxSecuredPduLayer
          HVK_03_E2E_SOK_XIX_HCP5_CANFD01_32c3c9b9_Rx (SecOCRxSecuredPdu): SecOCSecuredRxPduVerification=true, SecOCRxSecuredLayerPduRef=EcucPduCollection/HVK_03_E2E_SOK_XIX_HCP5_CANFD01_32c3c9b9_Rx
      OBD_HCP1_SOK_XIX_HCP5_CANFD01_499f5f1b_Rx: SecOCAuthInfoTxLength=32, SecOCAuthenticationVerifyAttempts=4, SecOCDataId=864, SecOCFreshnessValueId=2, SecOCUseAuthDataFreshness=false
        OBD_HCP1_XIX_HCP5_CANFD01_1b389b6c_Rx (SecOCRxAuthenticPduLayer): SecOCRxAuthenticLayerPduRef=EcucPduCollection/OBD_HCP1_XIX_HCP5_CANFD01_1b389b6c_Rx
        SecOCRxSecuredPduLayer
          OBD_HCP1_SOK_XIX_HCP5_CANFD01_499f5f1b_Rx (SecOCRxSecuredPdu): SecOCSecuredRxPduVerification=false, SecOCRxSecuredLayerPduRef=EcucPduCollection/OBD_HCP1_SOK_XIX_HCP5_CANFD01_499f5f1b_Rx
      SOK_Zeit_Hybrid_01_Resp_01_SOK_XIX_HCP5_CANFD01_92adacdc_Rx: SecOCAuthInfoTxLength=64, SecOCAuthenticationVerifyAttempts=1, SecOCDataId=402, SecOCFreshnessValueId=0, SecOCUseAuthDataFreshness=true
        SOK_Zeit_Hybrid_01_Resp_01_XIX_HCP5_CANFD01_c7a98a10_Rx (SecOCRxAuthenticPduLayer): SecOCRxAuthenticLayerPduRef=EcucPduCollection/SOK_Zeit_Hybrid_01_Resp_01_XIX_HCP5_CANFD01_c7a98a10_Rx
        SecOCRxSecuredPduLayer
          SOK_Zeit_Hybrid_01_Resp_01_SOK_XIX_HCP5_CANFD01_92adacdc_Rx (SecOCRxSecuredPdu): SecOCSecuredRxPduVerification=true, SecOCRxSecuredLayerPduRef=EcucPduCollection/SOK_Zeit_Hybrid_01_Resp_01_SOK_XIX_HCP5_CANFD01_92adacdc_Rx
    8 x SecOCTxPduProcessing, all with SecOCAuthInfoTxLength=32, SecOCAuthenticationBuildAttempts=1, SecOCFreshnessValueLength=64, SecOCFreshnessValueTxLength=0:
      BMC_HV_01_E2E_SOK_XIX_HCP5_CANFD01_ad756307_Tx: SecOCDataId=533, SecOCFreshnessValueId=0
        BMC_HV_01_XIX_HCP5_CANFD01_E2E_fcbbcae3_Tx (SecOCTxAuthenticPduLayer): SecOCTxAuthenticLayerPduRef=EcucPduCollection/BMC_HV_01_XIX_HCP5_CANFD01_E2E_fcbbcae3_Tx
        SecOCTxSecuredPduLayer
          BMC_HV_01_E2E_SOK_XIX_HCP5_CANFD01_ad756307_Tx (SecOCTxSecuredPdu): SecOCTxSecuredLayerPduRef=EcucPduCollection/BMC_HV_01_E2E_SOK_XIX_HCP5_CANFD01_ad756307_Tx
      BMC_HV_02_E2E_SOK_XIX_HCP5_CANFD01_5f228eff_Tx: SecOCDataId=534, SecOCFreshnessValueId=1
        BMC_HV_02_XIX_HCP5_CANFD01_E2E_c5c367a3_Tx (SecOCTxAuthenticPduLayer): SecOCTxAuthenticLayerPduRef=EcucPduCollection/BMC_HV_02_XIX_HCP5_CANFD01_E2E_c5c367a3_Tx
        SecOCTxSecuredPduLayer
          BMC_HV_02_E2E_SOK_XIX_HCP5_CANFD01_5f228eff_Tx (SecOCTxSecuredPdu): SecOCTxSecuredLayerPduRef=EcucPduCollection/BMC_HV_02_E2E_SOK_XIX_HCP5_CANFD01_5f228eff_Tx
      BMC_HV_06_SOK_XIX_HCP5_CANFD01_e20cafa8_Tx: SecOCDataId=535, SecOCFreshnessValueId=2
        BMC_HV_06_XIX_HCP5_CANFD01_e2eda0bb_Tx (SecOCTxAuthenticPduLayer): SecOCTxAuthenticLayerPduRef=EcucPduCollection/BMC_HV_06_XIX_HCP5_CANFD01_e2eda0bb_Tx
        SecOCTxSecuredPduLayer
          BMC_HV_06_SOK_XIX_HCP5_CANFD01_e20cafa8_Tx (SecOCTxSecuredPdu): SecOCTxSecuredLayerPduRef=EcucPduCollection/BMC_HV_06_SOK_XIX_HCP5_CANFD01_e20cafa8_Tx
      BMC_HV_07_SOK_XIX_HCP5_CANFD01_f524cb68_Tx: SecOCDataId=730, SecOCFreshnessValueId=3
        BMC_HV_07_XIX_HCP5_CANFD01_0dbf165a_Tx (SecOCTxAuthenticPduLayer): SecOCTxAuthenticLayerPduRef=EcucPduCollection/BMC_HV_07_XIX_HCP5_CANFD01_0dbf165a_Tx
        SecOCTxSecuredPduLayer
          BMC_HV_07_SOK_XIX_HCP5_CANFD01_f524cb68_Tx (SecOCTxSecuredPdu): SecOCTxSecuredLayerPduRef=EcucPduCollection/BMC_HV_07_SOK_XIX_HCP5_CANFD01_f524cb68_Tx
      BMC_HV_08_SOK_XIX_HCP5_CANFD01_29bed328_Tx: SecOCDataId=731, SecOCFreshnessValueId=4
        BMC_HV_08_XIX_HCP5_CANFD01_fbc0b232_Tx (SecOCTxAuthenticPduLayer): SecOCTxAuthenticLayerPduRef=EcucPduCollection/BMC_HV_08_XIX_HCP5_CANFD01_fbc0b232_Tx
        SecOCTxSecuredPduLayer
          BMC_HV_08_SOK_XIX_HCP5_CANFD01_29bed328_Tx (SecOCTxSecuredPdu): SecOCTxSecuredLayerPduRef=EcucPduCollection/BMC_HV_08_SOK_XIX_HCP5_CANFD01_29bed328_Tx
      BMC_HV_09_SOK_XIX_HCP5_CANFD01_3e96b7e8_Tx: SecOCDataId=810, SecOCFreshnessValueId=5
        BMC_HV_09_XIX_HCP5_CANFD01_149204d3_Tx (SecOCTxAuthenticPduLayer): SecOCTxAuthenticLayerPduRef=EcucPduCollection/BMC_HV_09_XIX_HCP5_CANFD01_149204d3_Tx
        SecOCTxSecuredPduLayer
          BMC_HV_09_SOK_XIX_HCP5_CANFD01_3e96b7e8_Tx (SecOCTxSecuredPdu): SecOCTxSecuredLayerPduRef=EcucPduCollection/BMC_HV_09_SOK_XIX_HCP5_CANFD01_3e96b7e8_Tx
      BMC_HV_14_SOK_XIX_HCP5_CANFD01_572f8cfc_Tx: SecOCDataId=846, SecOCFreshnessValueId=6
        BMC_HV_14_XIX_HCP5_CANFD01_30db4b60_Tx (SecOCTxAuthenticPduLayer): SecOCTxAuthenticLayerPduRef=EcucPduCollection/BMC_HV_14_XIX_HCP5_CANFD01_30db4b60_Tx
        SecOCTxSecuredPduLayer
          BMC_HV_14_SOK_XIX_HCP5_CANFD01_572f8cfc_Tx (SecOCTxSecuredPdu): SecOCTxSecuredLayerPduRef=EcucPduCollection/BMC_HV_14_SOK_XIX_HCP5_CANFD01_572f8cfc_Tx
      OBD_Hybrid_01_SOK_XIX_HCP5_CANFD01_86ce2f2e_Tx: SecOCDataId=865, SecOCFreshnessValueId=7
        OBD_Hybrid_01_XIX_HCP5_CANFD01_40f9dae5_Tx (SecOCTxAuthenticPduLayer): SecOCTxAuthenticLayerPduRef=EcucPduCollection/OBD_Hybrid_01_XIX_HCP5_CANFD01_40f9dae5_Tx
        SecOCTxSecuredPduLayer
          OBD_Hybrid_01_SOK_XIX_HCP5_CANFD01_86ce2f2e_Tx (SecOCTxSecuredPdu): SecOCTxSecuredLayerPduRef=EcucPduCollection/OBD_Hybrid_01_SOK_XIX_HCP5_CANFD01_86ce2f2e_Tx
  module config Xcp
    XcpConfig
      XCP_Hybrid_01_CRO_01_FD_XIX_HCP5_CANFD01_f21b8ba9_Rx (XcpPdu)
        XCP_Hybrid_01_CRO_01_FD_XIX_HCP5_CANFD01_f21b8ba9_Rx (XcpRxPdu): XcpRxPduRef=EcucPduCollection/XCP_Hybrid_01_CRO_01_FD_XIX_HCP5_CANFD01_f21b8ba9_Rx
      XCP_Hybrid_01_DTO_01_FD_XIX_HCP5_CANFD01_ee6930a2_Tx (XcpPdu)
        XCP_Hybrid_01_DTO_01_FD_XIX_HCP5_CANFD01_ee6930a2_Tx (XcpTxPdu): XcpTxPduRef=EcucPduCollection/XCP_Hybrid_01_DTO_01_FD_XIX_HCP5_CANFD01_ee6930a2_Tx
    XcpGeneral
