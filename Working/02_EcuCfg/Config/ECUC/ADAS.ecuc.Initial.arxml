[part 6 of 8: package /InitialEcuC]
AUTOSAR XML (schema 4-3-0)
package /InitialEcuC  (continued)
  module config Dcm  (continued)
    DcmConfigSet  (continued)
      DcmDsp: DcmDspMaxDidToRead=8  (continued)
        344 x DcmDspDid:
          DID_DiagnServi_TABROW_NeuCalibData_Read: DcmDspDidIdentifier=65277, DcmDspDidInfoRef=DidInfo_DiagnServi_TABROW_NeuCalibData_Read  # Diagnostics Data Import
            DcmDspDidSignal: DcmDspDidDataPos=0, DcmDspDidDataRef=Data_DiagnServi_TABROW_NeuCalibData_Read  # Diagnostics Data Import
          DID_DiagnServi_TABROW_ECUNA_Read: DcmDspDidIdentifier=63498, DcmDspDidInfoRef=DidInfo_DiagnServi_TABROW_ECUNA_Read  # Diagnostics Data Import
            DcmDspDidSignal: DcmDspDidDataPos=0, DcmDspDidDataRef=Data_DiagnServi_TABROW_ECUNA_Read  # Diagnostics Data Import
          DID_DiagnServi_TABROW_CalibIdent_Read: DcmDspDidIdentifier=63492, DcmDspDidInfoRef=DidInfo_DiagnServi_TABROW_CalibIdent_Read  # Diagnostics Data Import
            DcmDspDidSignal: DcmDspDidDataPos=0, DcmDspDidDataRef=Data_DiagnServi_TABROW_CalibIdent_Read  # Diagnostics Data Import
          DID_DiagnServi_TABROW_SuppoINFOT0120_Read: DcmDspDidIdentifier=63488, DcmDspDidInfoRef=DidInfo_DiagnServi_TABROW_SuppoINFOT0120_Read  # Diagnostics Data Import
          DID_DiagnServi_TABROW_AccelPedalPositD_Read: DcmDspDidIdentifier=62537, DcmDspDidInfoRef=DidInfo_DiagnServi_TABROW_AccelPedalPositD_Read  # Diagnostics Data Import
            DcmDspDidSignal: DcmDspDidDataPos=0, DcmDspDidDataRef=Data_DiagnServi_TABROW_AccelPedalPositD_Read  # Diagnostics Data Import
          DID_DiagnServi_TABROW_ContrModulVolta_Read: DcmDspDidIdentifier=62530, DcmDspDidInfoRef=DidInfo_DiagnServi_TABROW_ContrModulVolta_Read  # Diagnostics Data Import
            DcmDspDidSignal: DcmDspDidDataPos=0, DcmDspDidDataRef=Data_DiagnServi_TABROW_ContrModulVolta_Read  # Diagnostics Data Import
          DID_DiagnServi_TABROW_MonitStatuThisDriviCycle_Read: DcmDspDidIdentifier=62529, DcmDspDidInfoRef=DidInfo_DiagnServi_TABROW_MonitStatuThisDriviCycle_Read  # Diagnostics Data Import
            DcmDspDidSignal: DcmDspDidDataPos=0, DcmDspDidDataRef=Data_DiagnServi_TABROW_MonitStatuThisDriviCycle_Read  # Diagnostics Data Import
          DID_DiagnServi_TABROW_SuppoPIDs4160_Read: DcmDspDidIdentifier=62528, DcmDspDidInfoRef=DidInfo_DiagnServi_TABROW_SuppoPIDs4160_Read  # Diagnostics Data Import
          DID_DiagnServi_TABROW_SuppoPIDs2140_Read: DcmDspDidIdentifier=62496, DcmDspDidInfoRef=DidInfo_DiagnServi_TABROW_SuppoPIDs2140_Read  # Diagnostics Data Import
          DID_DiagnServi_TABROW_TimeSinceEnginStart_Read: DcmDspDidIdentifier=62495, DcmDspDidInfoRef=DidInfo_DiagnServi_TABROW_TimeSinceEnginStart_Read  # Diagnostics Data Import
            DcmDspDidSignal: DcmDspDidDataPos=0, DcmDspDidDataRef=Data_DiagnServi_TABROW_TimeSinceEnginStart_Read  # Diagnostics Data Import
          DID_DiagnServi_TABROW_VehicSpeedSenso_Read: DcmDspDidIdentifier=62477, DcmDspDidInfoRef=DidInfo_DiagnServi_TABROW_VehicSpeedSenso_Read  # Diagnostics Data Import
            DcmDspDidSignal: DcmDspDidDataPos=0, DcmDspDidDataRef=Data_DiagnServi_TABROW_VehicSpeedSenso_Read  # Diagnostics Data Import
          DID_DiagnServi_TABROW_EnginRPM_Read: DcmDspDidIdentifier=62476, DcmDspDidInfoRef=DidInfo_DiagnServi_TABROW_EnginRPM_Read  # Diagnostics Data Import
            DcmDspDidSignal: DcmDspDidDataPos=0, DcmDspDidDataRef=Data_DiagnServi_TABROW_EnginRPM_Read  # Diagnostics Data Import
          DID_DiagnServi_TABROW_EnginCoolaTempe_Read: DcmDspDidIdentifier=62469, DcmDspDidInfoRef=DidInfo_DiagnServi_TABROW_EnginCoolaTempe_Read  # Diagnostics Data Import
            DcmDspDidSignal: DcmDspDidDataPos=0, DcmDspDidDataRef=Data_DiagnServi_TABROW_EnginCoolaTempe_Read  # Diagnostics Data Import
          DID_DiagnServi_TABROW_CalcuLOADValue_Read: DcmDspDidIdentifier=62468, DcmDspDidInfoRef=DidInfo_DiagnServi_TABROW_CalcuLOADValue_Read  # Diagnostics Data Import
            DcmDspDidSignal: DcmDspDidDataPos=0, DcmDspDidDataRef=Data_DiagnServi_TABROW_CalcuLOADValue_Read  # Diagnostics Data Import
          DID_DiagnServi_TABROW_MonitStatuSinceDTCsClear_Read: DcmDspDidIdentifier=62465, DcmDspDidInfoRef=DidInfo_DiagnServi_TABROW_MonitStatuSinceDTCsClear_Read  # Diagnostics Data Import
            DcmDspDidSignal: DcmDspDidDataPos=0, DcmDspDidDataRef=Data_DiagnServi_TABROW_MonitStatuSinceDTCsClear_Read  # Diagnostics Data Import
          DID_DiagnServi_TABROW_SuppoPIDs0120_Read: DcmDspDidIdentifier=62464, DcmDspDidInfoRef=DidInfo_DiagnServi_TABROW_SuppoPIDs0120_Read  # Diagnostics Data Import
          DID_TABROW_VishnDID_Read: DcmDspDidIdentifier=61939, DcmDspDidInfoRef=DidInfo_TABROW_VishnDID_Read  # Diagnostics Data Import
            DcmDspDidSignal: DcmDspDidDataPos=0, DcmDspDidDataRef=Data_TABROW_VishnDID_Read  # Diagnostics Data Import
          DID_DiagnServi_TABROW_NeuMeasu_Read_14: DcmDspDidIdentifier=61938, DcmDspDidInfoRef=DidInfo_DiagnServi_TABROW_NeuMeasu_Read_14  # Diagnostics Data Import
            DcmDspDidSignal: DcmDspDidDataPos=0, DcmDspDidDataRef=Data_DiagnServi_TABROW_NeuMeasu_Read_14  # Diagnostics Data Import
          DID_TABROW_CanTPData_Read: DcmDspDidIdentifier=61922, DcmDspDidInfoRef=DidInfo_TABROW_CanTPData_Read  # Diagnostics Data Import
            DcmDspDidSignal: DcmDspDidDataPos=0, DcmDspDidDataRef=Data_TABROW_CanTPData_Read  # Diagnostics Data Import
          DID_TABROW_PIMDID_Read: DcmDspDidIdentifier=61921, DcmDspDidInfoRef=DidInfo_TABROW_PIMDID_Read  # Diagnostics Data Import
            DcmDspDidSignal: DcmDspDidDataPos=0, DcmDspDidDataRef=Data_TABROW_PIMDID_Read  # Diagnostics Data Import
          DID_TABROW_DCMCALLODID_Read: DcmDspDidIdentifier=61920, DcmDspDidInfoRef=DidInfo_TABROW_DCMCALLODID_Read  # Diagnostics Data Import
            DcmDspDidSignal: DcmDspDidDataPos=0, DcmDspDidDataRef=Data_TABROW_DCMCALLODID_Read  # Diagnostics Data Import
          DID_DiagnServi_TABROW_TABROECUPr_Read: DcmDspDidIdentifier=61919, DcmDspDidInfoRef=DidInfo_DiagnServi_TABROW_TABROECUPr_Read  # Diagnostics Data Import
            DcmDspDidSignal: DcmDspDidDataPos=0, DcmDspDidDataRef=Data_DiagnServi_TABROW_TABROECUPr_Read  # Diagnostics Data Import
          DID_DiagnServi_TABROW_TABROFDSPr_Read: DcmDspDidIdentifier=61909, DcmDspDidInfoRef=DidInfo_DiagnServi_TABROW_TABROFDSPr_Read  # Diagnostics Data Import
            DcmDspDidSignal: DcmDspDidDataPos=0, DcmDspDidDataRef=Data_DiagnServi_TABROW_TABROFDSPr_Read  # Diagnostics Data Import
          DID_TABROW_SysteIdent_Read: DcmDspDidIdentifier=61878, DcmDspDidInfoRef=DidInfo_TABROW_SysteIdent_Read  # Diagnostics Data Import
            DcmDspDidSignal: DcmDspDidDataPos=0, DcmDspDidDataRef=Data_TABROW_SysteIdent_Read  # Diagnostics Data Import
          DID_DiagnServi_TABROW_TechnSpeciVersi_Read: DcmDspDidIdentifier=61876, DcmDspDidInfoRef=DidInfo_DiagnServi_TABROW_TechnSpeciVersi_Read  # Diagnostics Data Import
            DcmDspDidSignal: DcmDspDidDataPos=0, DcmDspDidDataRef=Data_DiagnServi_TABROW_TechnSpeciVersi_Read  # Diagnostics Data Import
          DID_DiagnServi_TABROW_VWDataSetName_Read: DcmDspDidIdentifier=61875, DcmDspDidInfoRef=DidInfo_DiagnServi_TABROW_VWDataSetName_Read  # Diagnostics Data Import
            DcmDspDidSignal: DcmDspDidDataPos=0, DcmDspDidDataRef=Data_DiagnServi_TABROW_VWDataSetName_Read  # Diagnostics Data Import
          DID_DiagnServi_TABROW_VWAppliDataSetIdent_Read: DcmDspDidIdentifier=61873, DcmDspDidInfoRef=DidInfo_DiagnServi_TABROW_VWAppliDataSetIdent_Read  # Diagnostics Data Import
            DcmDspDidSignal: DcmDspDidDataPos=0, DcmDspDidDataRef=Data_DiagnServi_TABROW_VWAppliDataSetIdent_Read  # Diagnostics Data Import
          DID_DiagnServi_TABROW_AUTOSStandAppliSoftwIdent_Read: DcmDspDidIdentifier=61871, DcmDspDidInfoRef=DidInfo_DiagnServi_TABROW_AUTOSStandAppliSoftwIdent_Read  # Diagnostics Data Import
            DcmDspDidSignal: DcmDspDidDataPos=0, DcmDspDidDataRef=Data_DiagnServi_TABROW_AUTOSStandAppliSoftwIdent_Read  # Diagnostics Data Import
          DID_DiagnServi_ReadDataByIdentVWLogicSoftwBlockVersi: DcmDspDidIdentifier=61867, DcmDspDidInfoRef=DidInfo_DiagnServi_ReadDataByIdentVWLogicSoftwBlockVersi  # Diagnostics Data Import
            DcmDspDidSignal: DcmDspDidDataPos=0, DcmDspDidDataRef=Data_DiagnServi_ReadDataByIdentVWLogicSoftwBlockVersi  # Diagnostics Data Import
          DID_TABROW_VWWorksSysteName_Read: DcmDspDidIdentifier=61866, DcmDspDidInfoRef=DidInfo_TABROW_VWWorksSysteName_Read  # Diagnostics Data Import
            DcmDspDidSignal: DcmDspDidDataPos=0, DcmDspDidDataRef=Data_TABROW_VWWorksSysteName_Read  # Diagnostics Data Import
          DID_TABROW_VWECUHardwVersiNumbe_Read: DcmDspDidIdentifier=61859, DcmDspDidInfoRef=DidInfo_TABROW_VWECUHardwVersiNumbe_Read  # Diagnostics Data Import
            DcmDspDidSignal: DcmDspDidDataPos=0, DcmDspDidDataRef=Data_TABROW_VWECUHardwVersiNumbe_Read  # Diagnostics Data Import
          DID_DiagnServi_ReadDataByIdentASAMODXFileVersi: DcmDspDidIdentifier=61858, DcmDspDidInfoRef=DidInfo_DiagnServi_ReadDataByIdentASAMODXFileVersi  # Diagnostics Data Import
            DcmDspDidSignal: DcmDspDidDataPos=0, DcmDspDidDataRef=Data_DiagnServi_ReadDataByIdentASAMODXFileVersi  # Diagnostics Data Import
          DID_TABROW_TABROVWDat_Read_1: DcmDspDidIdentifier=61857, DcmDspDidInfoRef=DidInfo_TABROW_TABROVWDat_Read_1  # Diagnostics Data Import
            DcmDspDidSignal: DcmDspDidDataPos=0, DcmDspDidDataRef=Data_TABROW_TABROVWDat_Read_1  # Diagnostics Data Import
          DID_DiagnServi_TABROW_VWDataSetNumbeOrECUDataContaNumbe_Read: DcmDspDidIdentifier=61856, DcmDspDidInfoRef=DidInfo_DiagnServi_TABROW_VWDataSetNumbeOrECUDataContaNumbe_Read  # Diagnostics Data Import
            DcmDspDidSignal: DcmDspDidDataPos=0, DcmDspDidDataRef=Data_DiagnServi_TABROW_VWDataSetNumbeOrECUDataContaNumbe_Read  # Diagnostics Data Import
          DID_DiagnServi_ReadDataByIdentASAMODXFileIdent: DcmDspDidIdentifier=61854, DcmDspDidInfoRef=DidInfo_DiagnServi_ReadDataByIdentASAMODXFileIdent  # Diagnostics Data Import
            DcmDspDidSignal: DcmDspDidDataPos=0, DcmDspDidDataRef=Data_DiagnServi_ReadDataByIdentASAMODXFileIdent  # Diagnostics Data Import
          DID_TABROW_VWSysteNameOrEnginType_Read: DcmDspDidIdentifier=61847, DcmDspDidInfoRef=DidInfo_TABROW_VWSysteNameOrEnginType_Read  # Diagnostics Data Import
            DcmDspDidSignal: DcmDspDidDataPos=0, DcmDspDidDataRef=Data_TABROW_VWSysteNameOrEnginType_Read  # Diagnostics Data Import
          DID_TABROW_TABROSyste_Read_4: DcmDspDidIdentifier=61845, DcmDspDidInfoRef=DidInfo_TABROW_TABROSyste_Read_4  # Diagnostics Data Import
            DcmDspDidSignal: DcmDspDidDataPos=0, DcmDspDidDataRef=Data_TABROW_TABROSyste_Read_4  # Diagnostics Data Import
          DID_TABROW_TABROSyste_Read_3: DcmDspDidIdentifier=61844, DcmDspDidInfoRef=DidInfo_TABROW_TABROSyste_Read_3  # Diagnostics Data Import
            DcmDspDidSignal: DcmDspDidDataPos=0, DcmDspDidDataRef=Data_TABROW_TABROSyste_Read_3  # Diagnostics Data Import
          DID_TABROW_TABROSyste_Read_2: DcmDspDidIdentifier=61843, DcmDspDidInfoRef=DidInfo_TABROW_TABROSyste_Read_2  # Diagnostics Data Import
            DcmDspDidSignal: DcmDspDidDataPos=0, DcmDspDidDataRef=Data_TABROW_TABROSyste_Read_2  # Diagnostics Data Import
          DID_TABROW_TABROSyste_Read_1: DcmDspDidIdentifier=61842, DcmDspDidInfoRef=DidInfo_TABROW_TABROSyste_Read_1  # Diagnostics Data Import
            DcmDspDidSignal: DcmDspDidDataPos=0, DcmDspDidDataRef=Data_TABROW_TABROSyste_Read_1  # Diagnostics Data Import
          DID_TABROW_VWECUHardwNumbe_Read: DcmDspDidIdentifier=61841, DcmDspDidInfoRef=DidInfo_TABROW_VWECUHardwNumbe_Read  # Diagnostics Data Import
            DcmDspDidSignal: DcmDspDidDataPos=0, DcmDspDidDataRef=Data_TABROW_VWECUHardwNumbe_Read  # Diagnostics Data Import
          DID_TABROW_VehicIdentNumbe_Read: DcmDspDidIdentifier=61840, DcmDspDidInfoRef=DidInfo_TABROW_VehicIdentNumbe_Read  # Diagnostics Data Import
            DcmDspDidSignal: DcmDspDidDataPos=0, DcmDspDidDataRef=Data_TABROW_VehicIdentNumbe_Read  # Diagnostics Data Import
          DID_TABROW_RegulXSoftwIdentNumbe_Read: DcmDspDidIdentifier=61839, DcmDspDidInfoRef=DidInfo_TABROW_RegulXSoftwIdentNumbe_Read  # Diagnostics Data Import
            DcmDspDidSignal: DcmDspDidDataPos=0, DcmDspDidDataRef=Data_TABROW_RegulXSoftwIdentNumbe_Read  # Diagnostics Data Import
          DID_DiagnServi_TABROW_ECUSeriaNumbe_Read: DcmDspDidIdentifier=61836, DcmDspDidInfoRef=DidInfo_DiagnServi_TABROW_ECUSeriaNumbe_Read  # Diagnostics Data Import
            DcmDspDidSignal: DcmDspDidDataPos=0, DcmDspDidDataRef=Data_DiagnServi_TABROW_ECUSeriaNumbe_Read  # Diagnostics Data Import
          DID_DiagnServi_TABROW_SysteSupplIdent_Read: DcmDspDidIdentifier=61834, DcmDspDidInfoRef=DidInfo_DiagnServi_TABROW_SysteSupplIdent_Read  # Diagnostics Data Import
            DcmDspDidSignal: DcmDspDidDataPos=0, DcmDspDidDataRef=Data_DiagnServi_TABROW_SysteSupplIdent_Read  # Diagnostics Data Import
          DID_DiagnServi_TABROW_VWAppliSoftwVersiNumbe_Read: DcmDspDidIdentifier=61833, DcmDspDidInfoRef=DidInfo_DiagnServi_TABROW_VWAppliSoftwVersiNumbe_Read  # Diagnostics Data Import
            DcmDspDidSignal: DcmDspDidDataPos=0, DcmDspDidDataRef=Data_DiagnServi_TABROW_VWAppliSoftwVersiNumbe_Read  # Diagnostics Data Import
          DID_DiagnServi_TABROW_VWSparePartNumbe_Read: DcmDspDidIdentifier=61831, DcmDspDidInfoRef=DidInfo_DiagnServi_TABROW_VWSparePartNumbe_Read  # Diagnostics Data Import
            DcmDspDidSignal: DcmDspDidDataPos=0, DcmDspDidDataRef=Data_DiagnServi_TABROW_VWSparePartNumbe_Read  # Diagnostics Data Import
          DID_DiagnServi_TABROW_ActivDiagnSessi_Read: DcmDspDidIdentifier=61830, DcmDspDidInfoRef=DidInfo_DiagnServi_TABROW_ActivDiagnSessi_Read  # Diagnostics Data Import
            DcmDspDidSignal: DcmDspDidDataPos=0, DcmDspDidDataRef=Data_DiagnServi_TABROW_ActivDiagnSessi_Read  # Diagnostics Data Import
          DID_DiagnServi_TABROW_VWFAZITIdentStrin_Read: DcmDspDidIdentifier=61820, DcmDspDidInfoRef=DidInfo_DiagnServi_TABROW_VWFAZITIdentStrin_Read  # Diagnostics Data Import
            DcmDspDidSignal: DcmDspDidDataPos=0, DcmDspDidDataRef=Data_DiagnServi_TABROW_VWFAZITIdentStrin_Read  # Diagnostics Data Import
          DID_TABROW_FingeAndProgrDateOfLogicSoftwBlock_Read: DcmDspDidIdentifier=61787, DcmDspDidInfoRef=DidInfo_TABROW_FingeAndProgrDateOfLogicSoftwBlock_Read  # Diagnostics Data Import
            DcmDspDidSignal: DcmDspDidDataPos=0, DcmDspDidDataRef=Data_TABROW_FingeAndProgrDateOfLogicSoftwBlock_Read  # Diagnostics Data Import
          DID_DiagnServi_TABROW_Finge_Read: DcmDspDidIdentifier=61786, DcmDspDidInfoRef=DidInfo_DiagnServi_TABROW_Finge_Read  # Diagnostics Data Import
            DcmDspDidSignal: DcmDspDidDataPos=0, DcmDspDidDataRef=Data_DiagnServi_TABROW_Finge_Read  # Diagnostics Data Import
          DID_DiagnServi_TABROW_NeuMeasu_Read_57_2_1: DcmDspDidIdentifier=60931, DcmDspDidInfoRef=DidInfo_DiagnServi_TABROW_NeuMeasu_Read_57_2_1  # Diagnostics Data Import
            DcmDspDidSignal: DcmDspDidDataPos=0, DcmDspDidDataRef=Data_DiagnServi_TABROW_NeuMeasu_Read_57_2_1  # Diagnostics Data Import
          DID_DiagnServi_TABROW_NeuMeasu_Read_57_13: DcmDspDidIdentifier=60930, DcmDspDidInfoRef=DidInfo_DiagnServi_TABROW_NeuMeasu_Read_57_13  # Diagnostics Data Import
            DcmDspDidSignal: DcmDspDidDataPos=0, DcmDspDidDataRef=Data_DiagnServi_TABROW_NeuMeasu_Read_57_13  # Diagnostics Data Import
          DID_TABROW_TABROSyste_Read_1_1_1_1_1_1_1_1_1_1_1_1_1_1_1: DcmDspDidIdentifier=57405, DcmDspDidInfoRef=DidInfo_TABROW_TABROSyste_Read_1_1_1_1_1_1_1_1_1_1_1_1_1_1_1  # Diagnostics Data Import
            DcmDspDidSignal: DcmDspDidDataPos=0, DcmDspDidDataRef=Data_TABROW_TABROSyste_Read_1_1_1_1_1_1_1_1_1_1_1_1_1_1_1  # Diagnostics Data Import
          DID_TABROW_TABROSyste_Read_1_1_1_1_1_1_1_1_1_1_1_1_1: DcmDspDidIdentifier=57403, DcmDspDidInfoRef=DidInfo_TABROW_TABROSyste_Read_1_1_1_1_1_1_1_1_1_1_1_1_1  # Diagnostics Data Import
            DcmDspDidSignal: DcmDspDidDataPos=0, DcmDspDidDataRef=Data_TABROW_TABROSyste_Read_1_1_1_1_1_1_1_1_1_1_1_1_1  # Diagnostics Data Import
          DID_TABROW_TABROSyste_Read_1_1_1_1_1_1_1_1_1_1_1_1: DcmDspDidIdentifier=57402, DcmDspDidInfoRef=DidInfo_TABROW_TABROSyste_Read_1_1_1_1_1_1_1_1_1_1_1_1  # Diagnostics Data Import
            DcmDspDidSignal: DcmDspDidDataPos=0, DcmDspDidDataRef=Data_TABROW_TABROSyste_Read_1_1_1_1_1_1_1_1_1_1_1_1  # Diagnostics Data Import
          DID_TABROW_TABROSyste_Read_1_1_1_1_1_1_1_1_1_1_1: DcmDspDidIdentifier=57401, DcmDspDidInfoRef=DidInfo_TABROW_TABROSyste_Read_1_1_1_1_1_1_1_1_1_1_1  # Diagnostics Data Import
            DcmDspDidSignal: DcmDspDidDataPos=0, DcmDspDidDataRef=Data_TABROW_TABROSyste_Read_1_1_1_1_1_1_1_1_1_1_1  # Diagnostics Data Import
          DID_TABROW_TABROSyste_Read_1_1_1_1_1_1_1_1_1_1: DcmDspDidIdentifier=57400, DcmDspDidInfoRef=DidInfo_TABROW_TABROSyste_Read_1_1_1_1_1_1_1_1_1_1  # Diagnostics Data Import
            DcmDspDidSignal: DcmDspDidDataPos=0, DcmDspDidDataRef=Data_TABROW_TABROSyste_Read_1_1_1_1_1_1_1_1_1_1  # Diagnostics Data Import
          DID_TABROW_TABROSyste_Read_1_1_1_1_1_1_1_1_1: DcmDspDidIdentifier=57399, DcmDspDidInfoRef=DidInfo_TABROW_TABROSyste_Read_1_1_1_1_1_1_1_1_1  # Diagnostics Data Import
            DcmDspDidSignal: DcmDspDidDataPos=0, DcmDspDidDataRef=Data_TABROW_TABROSyste_Read_1_1_1_1_1_1_1_1_1  # Diagnostics Data Import
          DID_TABROW_TABROSyste_Read_1_1_1_1_1_1_1_1: DcmDspDidIdentifier=57398, DcmDspDidInfoRef=DidInfo_TABROW_TABROSyste_Read_1_1_1_1_1_1_1_1  # Diagnostics Data Import
            DcmDspDidSignal: DcmDspDidDataPos=0, DcmDspDidDataRef=Data_TABROW_TABROSyste_Read_1_1_1_1_1_1_1_1  # Diagnostics Data Import
          DID_TABROW_TABROSyste_Read_1_1_1_1_1_1_1: DcmDspDidIdentifier=57397, DcmDspDidInfoRef=DidInfo_TABROW_TABROSyste_Read_1_1_1_1_1_1_1  # Diagnostics Data Import
            DcmDspDidSignal: DcmDspDidDataPos=0, DcmDspDidDataRef=Data_TABROW_TABROSyste_Read_1_1_1_1_1_1_1  # Diagnostics Data Import
          DID_TABROW_TABROSyste_Read_1_1_1_1_1_1: DcmDspDidIdentifier=57396, DcmDspDidInfoRef=DidInfo_TABROW_TABROSyste_Read_1_1_1_1_1_1  # Diagnostics Data Import
            DcmDspDidSignal: DcmDspDidDataPos=0, DcmDspDidDataRef=Data_TABROW_TABROSyste_Read_1_1_1_1_1_1  # Diagnostics Data Import
          DID_TABROW_TABROSyste_Read_1_1_1_1_1: DcmDspDidIdentifier=57395, DcmDspDidInfoRef=DidInfo_TABROW_TABROSyste_Read_1_1_1_1_1  # Diagnostics Data Import
            DcmDspDidSignal: DcmDspDidDataPos=0, DcmDspDidDataRef=Data_TABROW_TABROSyste_Read_1_1_1_1_1  # Diagnostics Data Import
          DID_TABROW_TABROSyste_Read_1_1_1_1: DcmDspDidIdentifier=57394, DcmDspDidInfoRef=DidInfo_TABROW_TABROSyste_Read_1_1_1_1  # Diagnostics Data Import
            DcmDspDidSignal: DcmDspDidDataPos=0, DcmDspDidDataRef=Data_TABROW_TABROSyste_Read_1_1_1_1  # Diagnostics Data Import
          DID_TABROW_TABROSyste_Read_1_1_1: DcmDspDidIdentifier=57393, DcmDspDidInfoRef=DidInfo_TABROW_TABROSyste_Read_1_1_1  # Diagnostics Data Import
            DcmDspDidSignal: DcmDspDidDataPos=0, DcmDspDidDataRef=Data_TABROW_TABROSyste_Read_1_1_1  # Diagnostics Data Import
          DID_TABROW_TABROSyste_Read_1_1: DcmDspDidIdentifier=57392, DcmDspDidInfoRef=DidInfo_TABROW_TABROSyste_Read_1_1  # Diagnostics Data Import
            DcmDspDidSignal: DcmDspDidDataPos=0, DcmDspDidDataRef=Data_TABROW_TABROSyste_Read_1_1  # Diagnostics Data Import
          DID_DiagnServi_TABROW_NeuMeasu_Read_29_1_1_1_1_1_1_1: DcmDspDidIdentifier=57378, DcmDspDidInfoRef=DidInfo_DiagnServi_TABROW_NeuMeasu_Read_29_1_1_1_1_1_1_1  # Diagnostics Data Import
            DcmDspDidSignal: DcmDspDidDataPos=0, DcmDspDidDataRef=Data_DiagnServi_TABROW_NeuMeasu_Read_29_1_1_1_1_1_1_1  # Diagnostics Data Import
          DID_DiagnServi_TABROW_NeuMeasu_Read_29_1_1_1_1_1_1: DcmDspDidIdentifier=57377, DcmDspDidInfoRef=DidInfo_DiagnServi_TABROW_NeuMeasu_Read_29_1_1_1_1_1_1  # Diagnostics Data Import
            DcmDspDidSignal: DcmDspDidDataPos=0, DcmDspDidDataRef=Data_DiagnServi_TABROW_NeuMeasu_Read_29_1_1_1_1_1_1  # Diagnostics Data Import
          DID_DiagnServi_TABROW_NeuMeasu_Read_29_1_1_1_1_1: DcmDspDidIdentifier=57376, DcmDspDidInfoRef=DidInfo_DiagnServi_TABROW_NeuMeasu_Read_29_1_1_1_1_1  # Diagnostics Data Import
            DcmDspDidSignal: DcmDspDidDataPos=0, DcmDspDidDataRef=Data_DiagnServi_TABROW_NeuMeasu_Read_29_1_1_1_1_1  # Diagnostics Data Import
          DID_DiagnServi_TABROW_NeuMeasu_Read_29_1_1_1_1: DcmDspDidIdentifier=57375, DcmDspDidInfoRef=DidInfo_DiagnServi_TABROW_NeuMeasu_Read_29_1_1_1_1  # Diagnostics Data Import
            DcmDspDidSignal: DcmDspDidDataPos=0, DcmDspDidDataRef=Data_DiagnServi_TABROW_NeuMeasu_Read_29_1_1_1_1  # Diagnostics Data Import
          DID_DiagnServi_TABROW_NeuMeasu_Read_29_1_1_1: DcmDspDidIdentifier=57374, DcmDspDidInfoRef=DidInfo_DiagnServi_TABROW_NeuMeasu_Read_29_1_1_1  # Diagnostics Data Import
            DcmDspDidSignal: DcmDspDidDataPos=0, DcmDspDidDataRef=Data_DiagnServi_TABROW_NeuMeasu_Read_29_1_1_1  # Diagnostics Data Import
          DID_DiagnServi_TABROW_NeuMeasu_Read_29_1_1: DcmDspDidIdentifier=57373, DcmDspDidInfoRef=DidInfo_DiagnServi_TABROW_NeuMeasu_Read_29_1_1  # Diagnostics Data Import
            DcmDspDidSignal: DcmDspDidDataPos=0, DcmDspDidDataRef=Data_DiagnServi_TABROW_NeuMeasu_Read_29_1_1  # Diagnostics Data Import
          DID_DiagnServi_TABROW_NeuMeasu_Read_29_1_2: DcmDspDidIdentifier=57372, DcmDspDidInfoRef=DidInfo_DiagnServi_TABROW_NeuMeasu_Read_29_1_2  # Diagnostics Data Import
            DcmDspDidSignal: DcmDspDidDataPos=0, DcmDspDidDataRef=Data_DiagnServi_TABROW_NeuMeasu_Read_29_1_2  # Diagnostics Data Import
          DID_DiagnServi_TABROW_NeuMeasu_Read_29_5: DcmDspDidIdentifier=57371, DcmDspDidInfoRef=DidInfo_DiagnServi_TABROW_NeuMeasu_Read_29_5  # Diagnostics Data Import
            DcmDspDidSignal: DcmDspDidDataPos=0, DcmDspDidDataRef=Data_DiagnServi_TABROW_NeuMeasu_Read_29_5  # Diagnostics Data Import
          DID_DiagnServi_TABROW_NeuMeasu_Read_28_4: DcmDspDidIdentifier=57370, DcmDspDidInfoRef=DidInfo_DiagnServi_TABROW_NeuMeasu_Read_28_4  # Diagnostics Data Import
            DcmDspDidSignal: DcmDspDidDataPos=0, DcmDspDidDataRef=Data_DiagnServi_TABROW_NeuMeasu_Read_28_4  # Diagnostics Data Import
          DID_DiagnServi_TABROW_NeuMeasu_Read_28_5: DcmDspDidIdentifier=57369, DcmDspDidInfoRef=DidInfo_DiagnServi_TABROW_NeuMeasu_Read_28_5  # Diagnostics Data Import
            DcmDspDidSignal: DcmDspDidDataPos=0, DcmDspDidDataRef=Data_DiagnServi_TABROW_NeuMeasu_Read_28_5  # Diagnostics Data Import
          DID_DiagnServi_TABROW_NeuMeasu_Read_27_1_1_1_1_1: DcmDspDidIdentifier=57368, DcmDspDidInfoRef=DidInfo_DiagnServi_TABROW_NeuMeasu_Read_27_1_1_1_1_1  # Diagnostics Data Import
            DcmDspDidSignal: DcmDspDidDataPos=0, DcmDspDidDataRef=Data_DiagnServi_TABROW_NeuMeasu_Read_27_1_1_1_1_1  # Diagnostics Data Import
          DID_DiagnServi_TABROW_NeuMeasu_Read_27_1_1_1_1: DcmDspDidIdentifier=57366, DcmDspDidInfoRef=DidInfo_DiagnServi_TABROW_NeuMeasu_Read_27_1_1_1_1  # Diagnostics Data Import
            DcmDspDidSignal: DcmDspDidDataPos=0, DcmDspDidDataRef=Data_DiagnServi_TABROW_NeuMeasu_Read_27_1_1_1_1  # Diagnostics Data Import
          DID_DiagnServi_TABROW_NeuMeasu_Read_27_1_1_1_2: DcmDspDidIdentifier=57365, DcmDspDidInfoRef=DidInfo_DiagnServi_TABROW_NeuMeasu_Read_27_1_1_1_2  # Diagnostics Data Import
            DcmDspDidSignal: DcmDspDidDataPos=0, DcmDspDidDataRef=Data_DiagnServi_TABROW_NeuMeasu_Read_27_1_1_1_2  # Diagnostics Data Import
          DID_DiagnServi_TABROW_NeuMeasu_Read_27_1_1_2: DcmDspDidIdentifier=57364, DcmDspDidInfoRef=DidInfo_DiagnServi_TABROW_NeuMeasu_Read_27_1_1_2  # Diagnostics Data Import
            DcmDspDidSignal: DcmDspDidDataPos=0, DcmDspDidDataRef=Data_DiagnServi_TABROW_NeuMeasu_Read_27_1_1_2  # Diagnostics Data Import
          DID_DiagnServi_TABROW_NeuMeasu_Read_27_1_2: DcmDspDidIdentifier=57363, DcmDspDidInfoRef=DidInfo_DiagnServi_TABROW_NeuMeasu_Read_27_1_2  # Diagnostics Data Import
            DcmDspDidSignal: DcmDspDidDataPos=0, DcmDspDidDataRef=Data_DiagnServi_TABROW_NeuMeasu_Read_27_1_2  # Diagnostics Data Import
          DID_DiagnServi_TABROW_NeuMeasu_Read_27_8: DcmDspDidIdentifier=57362, DcmDspDidInfoRef=DidInfo_DiagnServi_TABROW_NeuMeasu_Read_27_8  # Diagnostics Data Import
            DcmDspDidSignal: DcmDspDidDataPos=0, DcmDspDidDataRef=Data_DiagnServi_TABROW_NeuMeasu_Read_27_8  # Diagnostics Data Import
          DID_DiagnServi_TABROW_NeuMeasu_Read_63_1_1_1: DcmDspDidIdentifier=57361, DcmDspDidInfoRef=DidInfo_DiagnServi_TABROW_NeuMeasu_Read_63_1_1_1  # Diagnostics Data Import
            DcmDspDidSignal: DcmDspDidDataPos=0, DcmDspDidDataRef=Data_DiagnServi_TABROW_NeuMeasu_Read_63_1_1_1  # Diagnostics Data Import
          DID_DiagnServi_TABROW_NeuMeasu_Read_63_1_1: DcmDspDidIdentifier=57360, DcmDspDidInfoRef=DidInfo_DiagnServi_TABROW_NeuMeasu_Read_63_1_1  # Diagnostics Data Import
            DcmDspDidSignal: DcmDspDidDataPos=0, DcmDspDidDataRef=Data_DiagnServi_TABROW_NeuMeasu_Read_63_1_1  # Diagnostics Data Import
          DID_DiagnServi_TABROW_NeuMeasu_Read_63_1: DcmDspDidIdentifier=57358, DcmDspDidInfoRef=DidInfo_DiagnServi_TABROW_NeuMeasu_Read_63_1  # Diagnostics Data Import
            DcmDspDidSignal: DcmDspDidDataPos=0, DcmDspDidDataRef=Data_DiagnServi_TABROW_NeuMeasu_Read_63_1  # Diagnostics Data Import
          DID_DiagnServi_TABROW_NeuMeasu_Read_63: DcmDspDidIdentifier=57357, DcmDspDidInfoRef=DidInfo_DiagnServi_TABROW_NeuMeasu_Read_63  # Diagnostics Data Import
            DcmDspDidSignal: DcmDspDidDataPos=0, DcmDspDidDataRef=Data_DiagnServi_TABROW_NeuMeasu_Read_63  # Diagnostics Data Import
          DID_DiagnServi_TABROW_NeuMeasu_Read_30_3: DcmDspDidIdentifier=57356, DcmDspDidInfoRef=DidInfo_DiagnServi_TABROW_NeuMeasu_Read_30_3  # Diagnostics Data Import
            DcmDspDidSignal: DcmDspDidDataPos=0, DcmDspDidDataRef=Data_DiagnServi_TABROW_NeuMeasu_Read_30_3  # Diagnostics Data Import
          DID_DiagnServi_TABROW_NeuMeasu_Read_29_4: DcmDspDidIdentifier=57355, DcmDspDidInfoRef=DidInfo_DiagnServi_TABROW_NeuMeasu_Read_29_4  # Diagnostics Data Import
            DcmDspDidSignal: DcmDspDidDataPos=0, DcmDspDidDataRef=Data_DiagnServi_TABROW_NeuMeasu_Read_29_4  # Diagnostics Data Import
          DID_DiagnServi_TABROW_NeuMeasu_Read_28_3: DcmDspDidIdentifier=57354, DcmDspDidInfoRef=DidInfo_DiagnServi_TABROW_NeuMeasu_Read_28_3  # Diagnostics Data Import
            DcmDspDidSignal: DcmDspDidDataPos=0, DcmDspDidDataRef=Data_DiagnServi_TABROW_NeuMeasu_Read_28_3  # Diagnostics Data Import
          DID_DiagnServi_TABROW_NeuMeasu_Read_27_7: DcmDspDidIdentifier=57353, DcmDspDidInfoRef=DidInfo_DiagnServi_TABROW_NeuMeasu_Read_27_7  # Diagnostics Data Import
            DcmDspDidSignal: DcmDspDidDataPos=0, DcmDspDidDataRef=Data_DiagnServi_TABROW_NeuMeasu_Read_27_7  # Diagnostics Data Import
          DID_DiagnServi_TABROW_NeuMeasu_Read_28_6: DcmDspDidIdentifier=57345, DcmDspDidInfoRef=DidInfo_DiagnServi_TABROW_NeuMeasu_Read_28_6  # Diagnostics Data Import
            DcmDspDidSignal: DcmDspDidDataPos=0, DcmDspDidDataRef=Data_DiagnServi_TABROW_NeuMeasu_Read_28_6  # Diagnostics Data Import
          DID_TABROW_ECUStandMode2_Read: DcmDspDidIdentifier=49425, DcmDspDidInfoRef=DidInfo_TABROW_ECUStandMode2_Read  # Diagnostics Data Import
            DcmDspDidSignal: DcmDspDidDataPos=0, DcmDspDidDataRef=Data_TABROW_ECUStandMode2_Read  # Diagnostics Data Import
          DID_TABROW_ECUStandMode1_Read: DcmDspDidIdentifier=49424, DcmDspDidInfoRef=DidInfo_TABROW_ECUStandMode1_Read  # Diagnostics Data Import
            DcmDspDidSignal: DcmDspDidDataPos=0, DcmDspDidDataRef=Data_TABROW_ECUStandMode1_Read  # Diagnostics Data Import
          DID_TABROW_SFDDevelModeActiv_Read: DcmDspDidIdentifier=49419, DcmDspDidInfoRef=DidInfo_TABROW_SFDDevelModeActiv_Read  # Diagnostics Data Import
            DcmDspDidSignal: DcmDspDidDataPos=0, DcmDspDidDataRef=Data_TABROW_SFDDevelModeActiv_Read  # Diagnostics Data Import
          DID_DiagnServi_TABROW_NeuECUIdent_Read: DcmDspDidIdentifier=49415, DcmDspDidInfoRef=DidInfo_DiagnServi_TABROW_NeuECUIdent_Read  # Diagnostics Data Import
            DcmDspDidSignal: DcmDspDidDataPos=0, DcmDspDidDataRef=Data_DiagnServi_TABROW_NeuECUIdent_Read  # Diagnostics Data Import
          DID_TABROW_StatuECUStandMode_Read: DcmDspDidIdentifier=49409, DcmDspDidInfoRef=DidInfo_TABROW_StatuECUStandMode_Read  # Diagnostics Data Import
            DcmDspDidSignal: DcmDspDidDataPos=0, DcmDspDidDataRef=Data_TABROW_StatuECUStandMode_Read  # Diagnostics Data Import
          DID_Maximum_Charge_Voltage_Read_Data_By_Identifier: DcmDspDidIdentifier=20849, DcmDspDidInfoRef=DidInfo_Maximum_Charge_Voltage_Read_Data_By_Identifier  # Diagnostics Data Import
            DcmDspDidSignal: DcmDspDidDataPos=0, DcmDspDidDataRef=Data_Maximum_Charge_Voltage_Read_Data_By_Identifier  # Diagnostics Data Import
          DID_Minimum_Discharge_Voltage_Read_Data_By_Identifier: DcmDspDidIdentifier=20848, DcmDspDidInfoRef=DidInfo_Minimum_Discharge_Voltage_Read_Data_By_Identifier  # Diagnostics Data Import
            DcmDspDidSignal: DcmDspDidDataPos=0, DcmDspDidDataRef=Data_Minimum_Discharge_Voltage_Read_Data_By_Identifier  # Diagnostics Data Import
          DID_TABROW_ServiDiscoState_Read_Data_By_Identifier: DcmDspDidIdentifier=20836, DcmDspDidInfoRef=DidInfo_TABROW_ServiDiscoState_Read_Data_By_Identifier  # Diagnostics Data Import
            DcmDspDidSignal: DcmDspDidDataPos=0, DcmDspDidDataRef=Data_TABROW_ServiDiscoState_Read_Data_By_Identifier  # Diagnostics Data Import
          DID_DiagnServi_TABROW_NeuMeasu_Read_28_2: DcmDspDidIdentifier=20686, DcmDspDidInfoRef=DidInfo_DiagnServi_TABROW_NeuMeasu_Read_28_2  # Diagnostics Data Import
            DcmDspDidSignal: DcmDspDidDataPos=0, DcmDspDidDataRef=Data_DiagnServi_TABROW_NeuMeasu_Read_28_2  # Diagnostics Data Import
          DID_DiagnServi_TABROW_AdaptOfChineSeriaNumbe_Read: DcmDspDidIdentifier=18510, DcmDspDidInfoRef=DidInfo_DiagnServi_TABROW_AdaptOfChineSeriaNumbe_Read  # Diagnostics Data Import
            DcmDspDidSignal: DcmDspDidDataPos=0, DcmDspDidDataRef=Data_DiagnServi_TABROW_AdaptOfChineSeriaNumbe_Read  # Diagnostics Data Import
          DID_Zero_Potential_Status_Read_Data_By_Identifier: DcmDspDidIdentifier=16921, DcmDspDidInfoRef=DidInfo_Zero_Potential_Status_Read_Data_By_Identifier  # Diagnostics Data Import
            DcmDspDidSignal: DcmDspDidDataPos=0, DcmDspDidDataRef=Data_Zero_Potential_Status_Read_Data_By_Identifier  # Diagnostics Data Import
          DID_TABROW_ModeOfProteOfVehicDiagn_ReadDataByIdentifier: DcmDspDidIdentifier=15374, DcmDspDidInfoRef=DidInfo_TABROW_ModeOfProteOfVehicDiagn_ReadDataByIdentifier  # Diagnostics Data Import
            DcmDspDidSignal: DcmDspDidDataPos=0, DcmDspDidDataRef=Data_TABROW_ModeOfProteOfVehicDiagn_ReadDataByIdentifier  # Diagnostics Data Import
          DID_TABROW_VkmsKeyList_Read_Data_By_Identifier: DcmDspDidIdentifier=11360, DcmDspDidInfoRef=DidInfo_TABROW_VkmsKeyList_Read_Data_By_Identifier  # Diagnostics Data Import
            DcmDspDidSignal: DcmDspDidDataPos=0, DcmDspDidDataRef=Data_TABROW_VkmsKeyList_Read_Data_By_Identifier  # Diagnostics Data Import
          DID_TABROW_VkmsMissiKeyHisto_Read_Data_By_Identifier: DcmDspDidIdentifier=11351, DcmDspDidInfoRef=DidInfo_TABROW_VkmsMissiKeyHisto_Read_Data_By_Identifier  # Diagnostics Data Import
            DcmDspDidSignal: DcmDspDidDataPos=0, DcmDspDidDataRef=Data_TABROW_VkmsMissiKeyHisto_Read_Data_By_Identifier  # Diagnostics Data Import
          DID_TABROW_VkmsTrainCount_Read_Data_By_Identifier: DcmDspDidIdentifier=11350, DcmDspDidInfoRef=DidInfo_TABROW_VkmsTrainCount_Read_Data_By_Identifier  # Diagnostics Data Import
            DcmDspDidSignal: DcmDspDidDataPos=0, DcmDspDidDataRef=Data_TABROW_VkmsTrainCount_Read_Data_By_Identifier  # Diagnostics Data Import
          DID_TABROW_VkmsVkmsv_Read_Data_By_Identifier: DcmDspDidIdentifier=11349, DcmDspDidInfoRef=DidInfo_TABROW_VkmsVkmsv_Read_Data_By_Identifier  # Diagnostics Data Import
            DcmDspDidSignal: DcmDspDidDataPos=0, DcmDspDidDataRef=Data_TABROW_VkmsVkmsv_Read_Data_By_Identifier  # Diagnostics Data Import
          DID_Battery_technical_state_of_charge_Read_Data_By_Identifier: DcmDspDidIdentifier=10013, DcmDspDidInfoRef=DidInfo_Battery_technical_state_of_charge_Read_Data_By_Identifier  # Diagnostics Data Import
            DcmDspDidSignal: DcmDspDidDataPos=0, DcmDspDidDataRef=Data_Battery_technical_state_of_charge_Read_Data_By_Identifier  # Diagnostics Data Import
          DID_Battery_energy_content_maximum_Read_Data_By_Identifier: DcmDspDidIdentifier=10011, DcmDspDidInfoRef=DidInfo_Battery_energy_content_maximum_Read_Data_By_Identifier  # Diagnostics Data Import
            DcmDspDidSignal: DcmDspDidDataPos=0, DcmDspDidDataRef=Data_Battery_energy_content_maximum_Read_Data_By_Identifier  # Diagnostics Data Import
          DID_Battery_energy_content_actual_Read_Data_By_Identifier: DcmDspDidIdentifier=10010, DcmDspDidInfoRef=DidInfo_Battery_energy_content_actual_Read_Data_By_Identifier  # Diagnostics Data Import
            DcmDspDidSignal: DcmDspDidDataPos=0, DcmDspDidDataRef=Data_Battery_energy_content_actual_Read_Data_By_Identifier  # Diagnostics Data Import
          DID_Battery_contactors_actual_states_Read_Data_By_Identifier: DcmDspDidIdentifier=10006, DcmDspDidInfoRef=DidInfo_Battery_contactors_actual_states_Read_Data_By_Identifier  # Diagnostics Data Import
            DcmDspDidSignal: DcmDspDidDataPos=0, DcmDspDidDataRef=Data_Battery_contactors_actual_states_Read_Data_By_Identifier  # Diagnostics Data Import
          DID_TABROW_BMCHVKEoHVLState_Read_Data_By_Identifier: DcmDspDidIdentifier=10002, DcmDspDidInfoRef=DidInfo_TABROW_BMCHVKEoHVLState_Read_Data_By_Identifier  # Diagnostics Data Import
            DcmDspDidSignal: DcmDspDidDataPos=0, DcmDspDidDataRef=Data_TABROW_BMCHVKEoHVLState_Read_Data_By_Identifier  # Diagnostics Data Import
          DID_DiagnServi_HV_battery_modules_actual_voltage_Read: DcmDspDidIdentifier=10001, DcmDspDidInfoRef=DidInfo_DiagnServi_HV_battery_modules_actual_voltage_Read  # Diagnostics Data Import
            DcmDspDidSignal: DcmDspDidDataPos=0, DcmDspDidDataRef=Data_DiagnServi_HV_battery_modules_actual_voltage_Read  # Diagnostics Data Import
          DID_Battery_banks_actual_voltage_Read_Data_By_Identifier: DcmDspDidIdentifier=10000, DcmDspDidInfoRef=DidInfo_Battery_banks_actual_voltage_Read_Data_By_Identifier  # Diagnostics Data Import
            DcmDspDidSignal: DcmDspDidDataPos=0, DcmDspDidDataRef=Data_Battery_banks_actual_voltage_Read_Data_By_Identifier  # Diagnostics Data Import
          DID_HV_coordinator_requestet_voltage_hv_battery_Read_Data_By_Identifier: DcmDspDidIdentifier=9999, DcmDspDidInfoRef=DidInfo_HV_coordinator_requestet_voltage_hv_battery_Read_Data_By_Identifier  # Diagnostics Data Import
            DcmDspDidSignal: DcmDspDidDataPos=0, DcmDspDidDataRef=Data_HV_coordinator_requestet_voltage_hv_battery_Read_Data_By_Identifier  # Diagnostics Data Import
          DID_HV_battery_maximum_discharge_current_Read_Data_By_Identifier: DcmDspDidIdentifier=9997, DcmDspDidInfoRef=DidInfo_HV_battery_maximum_discharge_current_Read_Data_By_Identifier  # Diagnostics Data Import
            DcmDspDidSignal: DcmDspDidDataPos=0, DcmDspDidDataRef=Data_HV_battery_maximum_discharge_current_Read_Data_By_Identifier  # Diagnostics Data Import
          DID_HV_battery_maximum_charging_current_Read_Data_By_Identifier: DcmDspDidIdentifier=9996, DcmDspDidInfoRef=DidInfo_HV_battery_maximum_charging_current_Read_Data_By_Identifier  # Diagnostics Data Import
            DcmDspDidSignal: DcmDspDidDataPos=0, DcmDspDidDataRef=Data_HV_battery_maximum_charging_current_Read_Data_By_Identifier  # Diagnostics Data Import
          DID_HV_battery_maximum_discharge_power_Read_Data_By_Identifier: DcmDspDidIdentifier=9995, DcmDspDidInfoRef=DidInfo_HV_battery_maximum_discharge_power_Read_Data_By_Identifier  # Diagnostics Data Import
            DcmDspDidSignal: DcmDspDidDataPos=0, DcmDspDidDataRef=Data_HV_battery_maximum_discharge_power_Read_Data_By_Identifier  # Diagnostics Data Import
          DID_HV_battery_maximum_charging_power_Read_Data_By_Identifier: DcmDspDidIdentifier=9994, DcmDspDidInfoRef=DidInfo_HV_battery_maximum_charging_power_Read_Data_By_Identifier  # Diagnostics Data Import
            DcmDspDidSignal: DcmDspDidDataPos=0, DcmDspDidDataRef=Data_HV_battery_maximum_charging_power_Read_Data_By_Identifier  # Diagnostics Data Import
          DID_BMC_IWU_Status_Read_Data_By_Identifier: DcmDspDidIdentifier=9992, DcmDspDidInfoRef=DidInfo_BMC_IWU_Status_Read_Data_By_Identifier  # Diagnostics Data Import
            DcmDspDidSignal: DcmDspDidDataPos=0, DcmDspDidDataRef=Data_BMC_IWU_Status_Read_Data_By_Identifier  # Diagnostics Data Import
          DID_Battery_flow_temperature_Read_Data_By_Identifier: DcmDspDidIdentifier=9991, DcmDspDidInfoRef=DidInfo_Battery_flow_temperature_Read_Data_By_Identifier  # Diagnostics Data Import
            DcmDspDidSignal: DcmDspDidDataPos=0, DcmDspDidDataRef=Data_Battery_flow_temperature_Read_Data_By_Identifier  # Diagnostics Data Import
          DID_Battery_banks_allowed_modes_Read_Data_By_Identifier: DcmDspDidIdentifier=9990, DcmDspDidInfoRef=DidInfo_Battery_banks_allowed_modes_Read_Data_By_Identifier  # Diagnostics Data Import
            DcmDspDidSignal: DcmDspDidDataPos=0, DcmDspDidDataRef=Data_Battery_banks_allowed_modes_Read_Data_By_Identifier  # Diagnostics Data Import
          DID_Battery_banks_actual_mode_Read_Data_By_Identifier: DcmDspDidIdentifier=9988, DcmDspDidInfoRef=DidInfo_Battery_banks_actual_mode_Read_Data_By_Identifier  # Diagnostics Data Import
            DcmDspDidSignal: DcmDspDidDataPos=0, DcmDspDidDataRef=Data_Battery_banks_actual_mode_Read_Data_By_Identifier  # Diagnostics Data Import
          DID_TABROW_BMCHVKFehleSD_Read_Data_By_Identifier: DcmDspDidIdentifier=9987, DcmDspDidInfoRef=DidInfo_TABROW_BMCHVKFehleSD_Read_Data_By_Identifier  # Diagnostics Data Import
            DcmDspDidSignal: DcmDspDidDataPos=0, DcmDspDidDataRef=Data_TABROW_BMCHVKFehleSD_Read_Data_By_Identifier  # Diagnostics Data Import
          DID_Charisma_requestet_driving_program_hv_battery_Read_Data_By_Identifier: DcmDspDidIdentifier=9986, DcmDspDidInfoRef=DidInfo_Charisma_requestet_driving_program_hv_battery_Read_Data_By_Identifier  # Diagnostics Data Import
            DcmDspDidSignal: DcmDspDidDataPos=0, DcmDspDidDataRef=Data_Charisma_requestet_driving_program_hv_battery_Read_Data_By_Identifier  # Diagnostics Data Import
          DID_Battery_displayed_state_of_charge_Read_Data_By_Identifier: DcmDspDidIdentifier=9985, DcmDspDidInfoRef=DidInfo_Battery_displayed_state_of_charge_Read_Data_By_Identifier  # Diagnostics Data Import
            DcmDspDidSignal: DcmDspDidDataPos=0, DcmDspDidDataRef=Data_Battery_displayed_state_of_charge_Read_Data_By_Identifier  # Diagnostics Data Import
          DID_DC_charging_station_actual_voltage_Read_Data_By_Identifier: DcmDspDidIdentifier=9984, DcmDspDidInfoRef=DidInfo_DC_charging_station_actual_voltage_Read_Data_By_Identifier  # Diagnostics Data Import
            DcmDspDidSignal: DcmDspDidDataPos=0, DcmDspDidDataRef=Data_DC_charging_station_actual_voltage_Read_Data_By_Identifier  # Diagnostics Data Import
          DID_DiagnServi_TABROW_NeuMeasu_Read_1: DcmDspDidIdentifier=8727, DcmDspDidInfoRef=DidInfo_DiagnServi_TABROW_NeuMeasu_Read_1  # Diagnostics Data Import
            DcmDspDidSignal: DcmDspDidDataPos=0, DcmDspDidDataRef=Data_DiagnServi_TABROW_NeuMeasu_Read_1  # Diagnostics Data Import
          DID_DiagnServi_TABROW_NeuMeasu_Read: DcmDspDidIdentifier=8726, DcmDspDidInfoRef=DidInfo_DiagnServi_TABROW_NeuMeasu_Read  # Diagnostics Data Import
            DcmDspDidSignal: DcmDspDidDataPos=0, DcmDspDidDataRef=Data_DiagnServi_TABROW_NeuMeasu_Read  # Diagnostics Data Import
          DID_DiagnServi_TABROW_Milea_Read: DcmDspDidIdentifier=8707, DcmDspDidInfoRef=DidInfo_DiagnServi_TABROW_Milea_Read  # Diagnostics Data Import
            DcmDspDidSignal: DcmDspDidDataPos=0, DcmDspDidDataRef=Data_DiagnServi_TABROW_Milea_Read  # Diagnostics Data Import
          DID_TABROW_CellVoltaSum_ReadDataByIdent: DcmDspDidIdentifier=7739, DcmDspDidInfoRef=DidInfo_TABROW_CellVoltaSum_ReadDataByIdent  # Diagnostics Data Import
            DcmDspDidSignal: DcmDspDidDataPos=0, DcmDspDidDataRef=Data_TABROW_CellVoltaSum_ReadDataByIdent  # Diagnostics Data Import
          DID_TABROW_CellVoltaMinim_ReadDataByIdent: DcmDspDidIdentifier=7732, DcmDspDidInfoRef=DidInfo_TABROW_CellVoltaMinim_ReadDataByIdent  # Diagnostics Data Import
            DcmDspDidSignal: DcmDspDidDataPos=0, DcmDspDidDataRef=Data_TABROW_CellVoltaMinim_ReadDataByIdent  # Diagnostics Data Import
          DID_TABROW_CellVoltaMaxim_ReadDataByIdent: DcmDspDidIdentifier=7731, DcmDspDidInfoRef=DidInfo_TABROW_CellVoltaMaxim_ReadDataByIdent  # Diagnostics Data Import
            DcmDspDidSignal: DcmDspDidDataPos=0, DcmDspDidDataRef=Data_TABROW_CellVoltaMaxim_ReadDataByIdent  # Diagnostics Data Import
          DID_TABROW_CellStateOfChargMinim_ReadDataByIdent: DcmDspDidIdentifier=7725, DcmDspDidInfoRef=DidInfo_TABROW_CellStateOfChargMinim_ReadDataByIdent  # Diagnostics Data Import
            DcmDspDidSignal: DcmDspDidDataPos=0, DcmDspDidDataRef=Data_TABROW_CellStateOfChargMinim_ReadDataByIdent  # Diagnostics Data Import
          DID_TABROW_CellStateOfChargMaxim_ReadDataByIdent: DcmDspDidIdentifier=7724, DcmDspDidInfoRef=DidInfo_TABROW_CellStateOfChargMaxim_ReadDataByIdent  # Diagnostics Data Import
            DcmDspDidSignal: DcmDspDidDataPos=0, DcmDspDidDataRef=Data_TABROW_CellStateOfChargMaxim_ReadDataByIdent  # Diagnostics Data Import
          DID_TABROW_IsolaResisSysteMinus_ReadDataByIdent: DcmDspDidIdentifier=7705, DcmDspDidInfoRef=DidInfo_TABROW_IsolaResisSysteMinus_ReadDataByIdent  # Diagnostics Data Import
            DcmDspDidSignal: DcmDspDidDataPos=0, DcmDspDidDataRef=Data_TABROW_IsolaResisSysteMinus_ReadDataByIdent  # Diagnostics Data Import
          DID_TABROW_IsolaResisSystePlus_ReadDataByIdent: DcmDspDidIdentifier=7703, DcmDspDidInfoRef=DidInfo_TABROW_IsolaResisSystePlus_ReadDataByIdent  # Diagnostics Data Import
            DcmDspDidSignal: DcmDspDidDataPos=0, DcmDspDidDataRef=Data_TABROW_IsolaResisSystePlus_ReadDataByIdent  # Diagnostics Data Import
          DID_TABROW_BatteTempeAvera_ReadDataByIdent: DcmDspDidIdentifier=7696, DcmDspDidInfoRef=DidInfo_TABROW_BatteTempeAvera_ReadDataByIdent  # Diagnostics Data Import
            DcmDspDidSignal: DcmDspDidDataPos=0, DcmDspDidDataRef=Data_TABROW_BatteTempeAvera_ReadDataByIdent  # Diagnostics Data Import
          DID_TABROW_BatteTempeMinim_ReadDataByIdent: DcmDspDidIdentifier=7695, DcmDspDidInfoRef=DidInfo_TABROW_BatteTempeMinim_ReadDataByIdent  # Diagnostics Data Import
            DcmDspDidSignal: DcmDspDidDataPos=0, DcmDspDidDataRef=Data_TABROW_BatteTempeMinim_ReadDataByIdent  # Diagnostics Data Import
          DID_TABROW_BatteTempeMaxim_ReadDataByIdent: DcmDspDidIdentifier=7694, DcmDspDidInfoRef=DidInfo_TABROW_BatteTempeMaxim_ReadDataByIdent  # Diagnostics Data Import
            DcmDspDidSignal: DcmDspDidDataPos=0, DcmDspDidDataRef=Data_TABROW_BatteTempeMaxim_ReadDataByIdent  # Diagnostics Data Import
          DID_TABROW_StateOfBatteMIL_ReadDataByIdent: DcmDspDidIdentifier=7693, DcmDspDidInfoRef=DidInfo_TABROW_StateOfBatteMIL_ReadDataByIdent  # Diagnostics Data Import
            DcmDspDidSignal: DcmDspDidDataPos=0, DcmDspDidDataRef=Data_TABROW_StateOfBatteMIL_ReadDataByIdent  # Diagnostics Data Import
          DID_TABROW_StateOfBattePowerReduc_ReadDataByIdent: DcmDspDidIdentifier=7690, DcmDspDidInfoRef=DidInfo_TABROW_StateOfBattePowerReduc_ReadDataByIdent  # Diagnostics Data Import
            DcmDspDidSignal: DcmDspDidDataPos=0, DcmDspDidDataRef=Data_TABROW_StateOfBattePowerReduc_ReadDataByIdent  # Diagnostics Data Import
          DID_TABROW_StateOfBatteShutoCrash_ReadDataByIdent: DcmDspDidIdentifier=7686, DcmDspDidInfoRef=DidInfo_TABROW_StateOfBatteShutoCrash_ReadDataByIdent  # Diagnostics Data Import
            DcmDspDidSignal: DcmDspDidDataPos=0, DcmDspDidDataRef=Data_TABROW_StateOfBatteShutoCrash_ReadDataByIdent  # Diagnostics Data Import
          DID_Prozessorauslastung_Read_Data_By_Identifier: DcmDspDidIdentifier=4112, DcmDspDidInfoRef=DidInfo_Prozessorauslastung_Read_Data_By_Identifier  # Diagnostics Data Import
            DcmDspDidSignal: DcmDspDidDataPos=0, DcmDspDidDataRef=Data_Prozessorauslastung_Read_Data_By_Identifier  # Diagnostics Data Import
          DID_HV_Spannung_Nebenverbraucher_Read_Data_By_Identifier: DcmDspDidIdentifier=4099, DcmDspDidInfoRef=DidInfo_HV_Spannung_Nebenverbraucher_Read_Data_By_Identifier  # Diagnostics Data Import
            DcmDspDidSignal: DcmDspDidDataPos=0, DcmDspDidDataRef=Data_HV_Spannung_Nebenverbraucher_Read_Data_By_Identifier  # Diagnostics Data Import
          DID_BMC_Hybrid_Kundendienstfehler_Read_Data_By_Identifier: DcmDspDidIdentifier=4097, DcmDspDidInfoRef=DidInfo_BMC_Hybrid_Kundendienstfehler_Read_Data_By_Identifier  # Diagnostics Data Import
            DcmDspDidSignal: DcmDspDidDataPos=0, DcmDspDidDataRef=Data_BMC_Hybrid_Kundendienstfehler_Read_Data_By_Identifier  # Diagnostics Data Import
          DID_TABROW_KnockTestMode_Read: DcmDspDidIdentifier=2547, DcmDspDidInfoRef=DidInfo_TABROW_KnockTestMode_Read  # Diagnostics Data Import
            DcmDspDidSignal: DcmDspDidDataPos=0, DcmDspDidDataRef=Data_TABROW_KnockTestMode_Read  # Diagnostics Data Import
          DID_DiagnServi_TABROW_ActivOfDevelMessa_Read: DcmDspDidIdentifier=2306, DcmDspDidInfoRef=DidInfo_DiagnServi_TABROW_ActivOfDevelMessa_Read  # Diagnostics Data Import
            DcmDspDidSignal: DcmDspDidDataPos=0, DcmDspDidDataRef=Data_DiagnServi_TABROW_ActivOfDevelMessa_Read  # Diagnostics Data Import
          DID_DiagnServi_BMC_clamp_30c_Read: DcmDspDidIdentifier=2054, DcmDspDidInfoRef=DidInfo_DiagnServi_BMC_clamp_30c_Read  # Diagnostics Data Import
            DcmDspDidSignal: DcmDspDidDataPos=0, DcmDspDidDataRef=Data_DiagnServi_BMC_clamp_30c_Read  # Diagnostics Data Import
          DID_DiagnServi_TABROW_NeuMeasu_Read_58_1: DcmDspDidIdentifier=1751, DcmDspDidInfoRef=DidInfo_DiagnServi_TABROW_NeuMeasu_Read_58_1  # Diagnostics Data Import
            DcmDspDidSignal: DcmDspDidDataPos=0, DcmDspDidDataRef=Data_DiagnServi_TABROW_NeuMeasu_Read_58_1  # Diagnostics Data Import
          DID_DiagnServi_TABROW_NeuMeasu_Read_59_2: DcmDspDidIdentifier=1750, DcmDspDidInfoRef=DidInfo_DiagnServi_TABROW_NeuMeasu_Read_59_2  # Diagnostics Data Import
            DcmDspDidSignal: DcmDspDidDataPos=0, DcmDspDidDataRef=Data_DiagnServi_TABROW_NeuMeasu_Read_59_2  # Diagnostics Data Import
          DID_DiagnServi_TABROW_NeuMeasu_Read_57_14: DcmDspDidIdentifier=1749, DcmDspDidInfoRef=DidInfo_DiagnServi_TABROW_NeuMeasu_Read_57_14  # Diagnostics Data Import
            DcmDspDidSignal: DcmDspDidDataPos=0, DcmDspDidDataRef=Data_DiagnServi_TABROW_NeuMeasu_Read_57_14  # Diagnostics Data Import
          DID_DiagnServi_TABROW_NeuMeasu_Read_60_3: DcmDspDidIdentifier=1748, DcmDspDidInfoRef=DidInfo_DiagnServi_TABROW_NeuMeasu_Read_60_3  # Diagnostics Data Import
            DcmDspDidSignal: DcmDspDidDataPos=0, DcmDspDidDataRef=Data_DiagnServi_TABROW_NeuMeasu_Read_60_3  # Diagnostics Data Import
          DID_DiagnServi_TABROW_NeuMeasu_Read_27_6: DcmDspDidIdentifier=1747, DcmDspDidInfoRef=DidInfo_DiagnServi_TABROW_NeuMeasu_Read_27_6  # Diagnostics Data Import
            DcmDspDidSignal: DcmDspDidDataPos=0, DcmDspDidDataRef=Data_DiagnServi_TABROW_NeuMeasu_Read_27_6  # Diagnostics Data Import
          DID_DiagnServi_TABROW_NeuMeasu_Read_29_3: DcmDspDidIdentifier=1746, DcmDspDidInfoRef=DidInfo_DiagnServi_TABROW_NeuMeasu_Read_29_3  # Diagnostics Data Import
            DcmDspDidSignal: DcmDspDidDataPos=0, DcmDspDidDataRef=Data_DiagnServi_TABROW_NeuMeasu_Read_29_3  # Diagnostics Data Import
          DID_DiagnServi_TABROW_NeuMeasu_Read_30_2: DcmDspDidIdentifier=1745, DcmDspDidInfoRef=DidInfo_DiagnServi_TABROW_NeuMeasu_Read_30_2  # Diagnostics Data Import
            DcmDspDidSignal: DcmDspDidDataPos=0, DcmDspDidDataRef=Data_DiagnServi_TABROW_NeuMeasu_Read_30_2  # Diagnostics Data Import
          DID_DiagnServi_TABROW_NeuMeasu_Read_36_3: DcmDspDidIdentifier=1744, DcmDspDidInfoRef=DidInfo_DiagnServi_TABROW_NeuMeasu_Read_36_3  # Diagnostics Data Import
            DcmDspDidSignal: DcmDspDidDataPos=0, DcmDspDidDataRef=Data_DiagnServi_TABROW_NeuMeasu_Read_36_3  # Diagnostics Data Import
          DID_DiagnServi_TABROW_NeuMeasu_Read_27_5: DcmDspDidIdentifier=1740, DcmDspDidInfoRef=DidInfo_DiagnServi_TABROW_NeuMeasu_Read_27_5  # Diagnostics Data Import
            DcmDspDidSignal: DcmDspDidDataPos=0, DcmDspDidDataRef=Data_DiagnServi_TABROW_NeuMeasu_Read_27_5  # Diagnostics Data Import
          DID_DiagnServi_TABROW_NeuMeasu_Read_28_1: DcmDspDidIdentifier=1739, DcmDspDidInfoRef=DidInfo_DiagnServi_TABROW_NeuMeasu_Read_28_1  # Diagnostics Data Import
            DcmDspDidSignal: DcmDspDidDataPos=0, DcmDspDidDataRef=Data_DiagnServi_TABROW_NeuMeasu_Read_28_1  # Diagnostics Data Import
          DID_DiagnServi_TABROW_NeuMeasu_Read_61: DcmDspDidIdentifier=1738, DcmDspDidInfoRef=DidInfo_DiagnServi_TABROW_NeuMeasu_Read_61  # Diagnostics Data Import
            DcmDspDidSignal: DcmDspDidDataPos=0, DcmDspDidDataRef=Data_DiagnServi_TABROW_NeuMeasu_Read_61  # Diagnostics Data Import
          DID_DiagnServi_TABROW_NeuMeasu_Read_29_2: DcmDspDidIdentifier=1737, DcmDspDidInfoRef=DidInfo_DiagnServi_TABROW_NeuMeasu_Read_29_2  # Diagnostics Data Import
            DcmDspDidSignal: DcmDspDidDataPos=0, DcmDspDidDataRef=Data_DiagnServi_TABROW_NeuMeasu_Read_29_2  # Diagnostics Data Import
          DID_DiagnServi_TABROW_NeuMeasu_Read_30_1: DcmDspDidIdentifier=1736, DcmDspDidInfoRef=DidInfo_DiagnServi_TABROW_NeuMeasu_Read_30_1  # Diagnostics Data Import
            DcmDspDidSignal: DcmDspDidDataPos=0, DcmDspDidDataRef=Data_DiagnServi_TABROW_NeuMeasu_Read_30_1  # Diagnostics Data Import
          DID_DiagnServi_TABROW_NeuMeasu_Read_36: DcmDspDidIdentifier=1735, DcmDspDidInfoRef=DidInfo_DiagnServi_TABROW_NeuMeasu_Read_36  # Diagnostics Data Import
            DcmDspDidSignal: DcmDspDidDataPos=0, DcmDspDidDataRef=Data_DiagnServi_TABROW_NeuMeasu_Read_36  # Diagnostics Data Import
          DID_DiagnServi_TABROW_NeuMeasu_Read_36_1: DcmDspDidIdentifier=1734, DcmDspDidInfoRef=DidInfo_DiagnServi_TABROW_NeuMeasu_Read_36_1  # Diagnostics Data Import
            DcmDspDidSignal: DcmDspDidDataPos=0, DcmDspDidDataRef=Data_DiagnServi_TABROW_NeuMeasu_Read_36_1  # Diagnostics Data Import
          DID_DiagnServi_TABROW_NeuMeasu_Read_60: DcmDspDidIdentifier=1733, DcmDspDidInfoRef=DidInfo_DiagnServi_TABROW_NeuMeasu_Read_60  # Diagnostics Data Import
            DcmDspDidSignal: DcmDspDidDataPos=0, DcmDspDidDataRef=Data_DiagnServi_TABROW_NeuMeasu_Read_60  # Diagnostics Data Import
          DID_DiagnServi_TABROW_NeuMeasu_Read_60_1: DcmDspDidIdentifier=1732, DcmDspDidInfoRef=DidInfo_DiagnServi_TABROW_NeuMeasu_Read_60_1  # Diagnostics Data Import
            DcmDspDidSignal: DcmDspDidDataPos=0, DcmDspDidDataRef=Data_DiagnServi_TABROW_NeuMeasu_Read_60_1  # Diagnostics Data Import
          DID_DiagnServi_TABROW_NeuMeasu_Read_7: DcmDspDidIdentifier=1731, DcmDspDidInfoRef=DidInfo_DiagnServi_TABROW_NeuMeasu_Read_7  # Diagnostics Data Import
            DcmDspDidSignal: DcmDspDidDataPos=0, DcmDspDidDataRef=Data_DiagnServi_TABROW_NeuMeasu_Read_7  # Diagnostics Data Import
          DID_DiagnServi_TABROW_NeuMeasu_Read_7_2: DcmDspDidIdentifier=1730, DcmDspDidInfoRef=DidInfo_DiagnServi_TABROW_NeuMeasu_Read_7_2  # Diagnostics Data Import
            DcmDspDidSignal: DcmDspDidDataPos=0, DcmDspDidDataRef=Data_DiagnServi_TABROW_NeuMeasu_Read_7_2  # Diagnostics Data Import
          DID_DiagnServi_TABROW_NeuMeasu_Read_8_2: DcmDspDidIdentifier=1729, DcmDspDidInfoRef=DidInfo_DiagnServi_TABROW_NeuMeasu_Read_8_2  # Diagnostics Data Import
            DcmDspDidSignal: DcmDspDidDataPos=0, DcmDspDidDataRef=Data_DiagnServi_TABROW_NeuMeasu_Read_8_2  # Diagnostics Data Import
          DID_DiagnServi_TABROW_NeuMeasu_Read_8: DcmDspDidIdentifier=1728, DcmDspDidInfoRef=DidInfo_DiagnServi_TABROW_NeuMeasu_Read_8  # Diagnostics Data Import
            DcmDspDidSignal: DcmDspDidDataPos=0, DcmDspDidDataRef=Data_DiagnServi_TABROW_NeuMeasu_Read_8  # Diagnostics Data Import
          DID_DiagnServi_TABROW_NeuMeasu_Read_9_2_1_1_1: DcmDspDidIdentifier=1727, DcmDspDidInfoRef=DidInfo_DiagnServi_TABROW_NeuMeasu_Read_9_2_1_1_1  # Diagnostics Data Import
            DcmDspDidSignal: DcmDspDidDataPos=0, DcmDspDidDataRef=Data_DiagnServi_TABROW_NeuMeasu_Read_9_2_1_1_1  # Diagnostics Data Import
          DID_DiagnServi_TABROW_NeuMeasu_Read_9_2_1_1: DcmDspDidIdentifier=1726, DcmDspDidInfoRef=DidInfo_DiagnServi_TABROW_NeuMeasu_Read_9_2_1_1  # Diagnostics Data Import
            DcmDspDidSignal: DcmDspDidDataPos=0, DcmDspDidDataRef=Data_DiagnServi_TABROW_NeuMeasu_Read_9_2_1_1  # Diagnostics Data Import
          DID_DiagnServi_TABROW_NeuMeasu_Read_9_2_1: DcmDspDidIdentifier=1725, DcmDspDidInfoRef=DidInfo_DiagnServi_TABROW_NeuMeasu_Read_9_2_1  # Diagnostics Data Import
            DcmDspDidSignal: DcmDspDidDataPos=0, DcmDspDidDataRef=Data_DiagnServi_TABROW_NeuMeasu_Read_9_2_1  # Diagnostics Data Import
          DID_DiagnServi_TABROW_NeuMeasu_Read_70_1: DcmDspDidIdentifier=1724, DcmDspDidInfoRef=DidInfo_DiagnServi_TABROW_NeuMeasu_Read_70_1  # Diagnostics Data Import
            DcmDspDidSignal: DcmDspDidDataPos=0, DcmDspDidDataRef=Data_DiagnServi_TABROW_NeuMeasu_Read_70_1  # Diagnostics Data Import
          DID_DiagnServi_TABROW_NeuMeasu_Read_71: DcmDspDidIdentifier=1723, DcmDspDidInfoRef=DidInfo_DiagnServi_TABROW_NeuMeasu_Read_71  # Diagnostics Data Import
            DcmDspDidSignal: DcmDspDidDataPos=0, DcmDspDidDataRef=Data_DiagnServi_TABROW_NeuMeasu_Read_71  # Diagnostics Data Import
          DID_DiagnServi_TABROW_NeuMeasu_Read_72: DcmDspDidIdentifier=1722, DcmDspDidInfoRef=DidInfo_DiagnServi_TABROW_NeuMeasu_Read_72  # Diagnostics Data Import
            DcmDspDidSignal: DcmDspDidDataPos=0, DcmDspDidDataRef=Data_DiagnServi_TABROW_NeuMeasu_Read_72  # Diagnostics Data Import
          DID_DiagnServi_TABROW_NeuMeasu_Read_73: DcmDspDidIdentifier=1721, DcmDspDidInfoRef=DidInfo_DiagnServi_TABROW_NeuMeasu_Read_73  # Diagnostics Data Import
            DcmDspDidSignal: DcmDspDidDataPos=0, DcmDspDidDataRef=Data_DiagnServi_TABROW_NeuMeasu_Read_73  # Diagnostics Data Import
          DID_DiagnServi_TABROW_NeuMeasu_Read_74: DcmDspDidIdentifier=1720, DcmDspDidInfoRef=DidInfo_DiagnServi_TABROW_NeuMeasu_Read_74  # Diagnostics Data Import
            DcmDspDidSignal: DcmDspDidDataPos=0, DcmDspDidDataRef=Data_DiagnServi_TABROW_NeuMeasu_Read_74  # Diagnostics Data Import
          DID_DiagnServi_TABROW_NeuMeasu_Read_82: DcmDspDidIdentifier=1719, DcmDspDidInfoRef=DidInfo_DiagnServi_TABROW_NeuMeasu_Read_82  # Diagnostics Data Import
            DcmDspDidSignal: DcmDspDidDataPos=0, DcmDspDidDataRef=Data_DiagnServi_TABROW_NeuMeasu_Read_82  # Diagnostics Data Import
          DID_DiagnServi_TABROW_NeuMeasu_Read_83: DcmDspDidIdentifier=1718, DcmDspDidInfoRef=DidInfo_DiagnServi_TABROW_NeuMeasu_Read_83  # Diagnostics Data Import
            DcmDspDidSignal: DcmDspDidDataPos=0, DcmDspDidDataRef=Data_DiagnServi_TABROW_NeuMeasu_Read_83  # Diagnostics Data Import
          DID_DiagnServi_TABROW_NeuMeasu_Read_84: DcmDspDidIdentifier=1717, DcmDspDidInfoRef=DidInfo_DiagnServi_TABROW_NeuMeasu_Read_84  # Diagnostics Data Import
            DcmDspDidSignal: DcmDspDidDataPos=0, DcmDspDidDataRef=Data_DiagnServi_TABROW_NeuMeasu_Read_84  # Diagnostics Data Import
          DID_DiagnServi_TABROW_NeuMeasu_Read_9_2_1_1_2: DcmDspDidIdentifier=1715, DcmDspDidInfoRef=DidInfo_DiagnServi_TABROW_NeuMeasu_Read_9_2_1_1_2  # Diagnostics Data Import
            DcmDspDidSignal: DcmDspDidDataPos=0, DcmDspDidDataRef=Data_DiagnServi_TABROW_NeuMeasu_Read_9_2_1_1_2  # Diagnostics Data Import
          DID_DiagnServi_TABROW_NeuMeasu_Read_9: DcmDspDidIdentifier=1714, DcmDspDidInfoRef=DidInfo_DiagnServi_TABROW_NeuMeasu_Read_9  # Diagnostics Data Import
            DcmDspDidSignal: DcmDspDidDataPos=0, DcmDspDidDataRef=Data_DiagnServi_TABROW_NeuMeasu_Read_9  # Diagnostics Data Import
          DID_DiagnServi_TABROW_NeuMeasu_Read_9_2: DcmDspDidIdentifier=1713, DcmDspDidInfoRef=DidInfo_DiagnServi_TABROW_NeuMeasu_Read_9_2  # Diagnostics Data Import
            DcmDspDidSignal: DcmDspDidDataPos=0, DcmDspDidDataRef=Data_DiagnServi_TABROW_NeuMeasu_Read_9_2  # Diagnostics Data Import
          DID_DiagnServi_TABROW_NeuMeasu_Read_21_2: DcmDspDidIdentifier=1711, DcmDspDidInfoRef=DidInfo_DiagnServi_TABROW_NeuMeasu_Read_21_2  # Diagnostics Data Import
            DcmDspDidSignal: DcmDspDidDataPos=0, DcmDspDidDataRef=Data_DiagnServi_TABROW_NeuMeasu_Read_21_2  # Diagnostics Data Import
          DID_DiagnServi_TABROW_NeuMeasu_Read_70: DcmDspDidIdentifier=1681, DcmDspDidInfoRef=DidInfo_DiagnServi_TABROW_NeuMeasu_Read_70  # Diagnostics Data Import
            DcmDspDidSignal: DcmDspDidDataPos=0, DcmDspDidDataRef=Data_DiagnServi_TABROW_NeuMeasu_Read_70  # Diagnostics Data Import
          DID_DiagnServi_TABROW_NeuMeasu1_Read: DcmDspDidIdentifier=1675, DcmDspDidInfoRef=DidInfo_DiagnServi_TABROW_NeuMeasu1_Read  # Diagnostics Data Import
            DcmDspDidSignal: DcmDspDidDataPos=0, DcmDspDidDataRef=Data_DiagnServi_TABROW_NeuMeasu1_Read  # Diagnostics Data Import
          DID_DiagnServi_TABROW_NeuMeasu2_Read: DcmDspDidIdentifier=1674, DcmDspDidInfoRef=DidInfo_DiagnServi_TABROW_NeuMeasu2_Read  # Diagnostics Data Import
            DcmDspDidSignal: DcmDspDidDataPos=0, DcmDspDidDataRef=Data_DiagnServi_TABROW_NeuMeasu2_Read  # Diagnostics Data Import
          DID_DiagnServi_TABROW_NeuMeasu_Read_23: DcmDspDidIdentifier=1673, DcmDspDidInfoRef=DidInfo_DiagnServi_TABROW_NeuMeasu_Read_23  # Diagnostics Data Import
            DcmDspDidSignal: DcmDspDidDataPos=0, DcmDspDidDataRef=Data_DiagnServi_TABROW_NeuMeasu_Read_23  # Diagnostics Data Import
          DID_DiagnServi_TABROW_NeuMeasu_Read_24: DcmDspDidIdentifier=1672, DcmDspDidInfoRef=DidInfo_DiagnServi_TABROW_NeuMeasu_Read_24  # Diagnostics Data Import
            DcmDspDidSignal: DcmDspDidDataPos=0, DcmDspDidDataRef=Data_DiagnServi_TABROW_NeuMeasu_Read_24  # Diagnostics Data Import
          DID_DiagnServi_TABROW_NeuMeasu_Read_26: DcmDspDidIdentifier=1671, DcmDspDidInfoRef=DidInfo_DiagnServi_TABROW_NeuMeasu_Read_26  # Diagnostics Data Import
            DcmDspDidSignal: DcmDspDidDataPos=0, DcmDspDidDataRef=Data_DiagnServi_TABROW_NeuMeasu_Read_26  # Diagnostics Data Import
          DID_DiagnServi_TABROW_NeuMeasu_Read_25: DcmDspDidIdentifier=1670, DcmDspDidInfoRef=DidInfo_DiagnServi_TABROW_NeuMeasu_Read_25  # Diagnostics Data Import
            DcmDspDidSignal: DcmDspDidDataPos=0, DcmDspDidDataRef=Data_DiagnServi_TABROW_NeuMeasu_Read_25  # Diagnostics Data Import
          DID_DiagnServi_TABROW_NeuMeasu_Read_7_1: DcmDspDidIdentifier=1669, DcmDspDidInfoRef=DidInfo_DiagnServi_TABROW_NeuMeasu_Read_7_1  # Diagnostics Data Import
            DcmDspDidSignal: DcmDspDidDataPos=0, DcmDspDidDataRef=Data_DiagnServi_TABROW_NeuMeasu_Read_7_1  # Diagnostics Data Import
          DID_DiagnServi_TABROW_NeuMeasu_Read_22_1: DcmDspDidIdentifier=1668, DcmDspDidInfoRef=DidInfo_DiagnServi_TABROW_NeuMeasu_Read_22_1  # Diagnostics Data Import
            DcmDspDidSignal: DcmDspDidDataPos=0, DcmDspDidDataRef=Data_DiagnServi_TABROW_NeuMeasu_Read_22_1  # Diagnostics Data Import
          DID_DiagnServi_TABROW_NeuMeasu_Read_8_1: DcmDspDidIdentifier=1667, DcmDspDidInfoRef=DidInfo_DiagnServi_TABROW_NeuMeasu_Read_8_1  # Diagnostics Data Import
            DcmDspDidSignal: DcmDspDidDataPos=0, DcmDspDidDataRef=Data_DiagnServi_TABROW_NeuMeasu_Read_8_1  # Diagnostics Data Import
          DID_DiagnServi_TABROW_NeuMeasu_Read_21_1: DcmDspDidIdentifier=1666, DcmDspDidInfoRef=DidInfo_DiagnServi_TABROW_NeuMeasu_Read_21_1  # Diagnostics Data Import
            DcmDspDidSignal: DcmDspDidDataPos=0, DcmDspDidDataRef=Data_DiagnServi_TABROW_NeuMeasu_Read_21_1  # Diagnostics Data Import
          DID_Battery_isolation_measurement_actual_and_requested_state_Read_Data_By_Identifier: DcmDspDidIdentifier=1665, DcmDspDidInfoRef=DidInfo_Battery_isolation_measurement_actual_and_requested_state_Read_Data_By_Identifier  # Diagnostics Data Import
            DcmDspDidSignal: DcmDspDidDataPos=0, DcmDspDidDataRef=Data_Battery_isolation_measurement_actual_and_requested_state_Read_Data_By_Identifier  # Diagnostics Data Import
          DID_DiagnServi_TABROW_NeuMeasu_Read_28: DcmDspDidIdentifier=1664, DcmDspDidInfoRef=DidInfo_DiagnServi_TABROW_NeuMeasu_Read_28  # Diagnostics Data Import
            DcmDspDidSignal: DcmDspDidDataPos=0, DcmDspDidDataRef=Data_DiagnServi_TABROW_NeuMeasu_Read_28  # Diagnostics Data Import
          DID_DiagnServi_TABROW_NeuMeasu_Read_27: DcmDspDidIdentifier=1663, DcmDspDidInfoRef=DidInfo_DiagnServi_TABROW_NeuMeasu_Read_27  # Diagnostics Data Import
            DcmDspDidSignal: DcmDspDidDataPos=0, DcmDspDidDataRef=Data_DiagnServi_TABROW_NeuMeasu_Read_27  # Diagnostics Data Import
          DID_DiagnServi_TABROW_NeuMeasu_Read_27_1: DcmDspDidIdentifier=1662, DcmDspDidInfoRef=DidInfo_DiagnServi_TABROW_NeuMeasu_Read_27_1  # Diagnostics Data Import
            DcmDspDidSignal: DcmDspDidDataPos=0, DcmDspDidDataRef=Data_DiagnServi_TABROW_NeuMeasu_Read_27_1  # Diagnostics Data Import
          DID_DiagnServi_TABROW_NeuMeasu_Read_27_2: DcmDspDidIdentifier=1661, DcmDspDidInfoRef=DidInfo_DiagnServi_TABROW_NeuMeasu_Read_27_2  # Diagnostics Data Import
            DcmDspDidSignal: DcmDspDidDataPos=0, DcmDspDidDataRef=Data_DiagnServi_TABROW_NeuMeasu_Read_27_2  # Diagnostics Data Import
          DID_DiagnServi_TABROW_NeuMeasu_Read_27_3: DcmDspDidIdentifier=1660, DcmDspDidInfoRef=DidInfo_DiagnServi_TABROW_NeuMeasu_Read_27_3  # Diagnostics Data Import
            DcmDspDidSignal: DcmDspDidDataPos=0, DcmDspDidDataRef=Data_DiagnServi_TABROW_NeuMeasu_Read_27_3  # Diagnostics Data Import
          DID_DiagnServi_TABROW_NeuMeasu_Read_27_1_1: DcmDspDidIdentifier=1659, DcmDspDidInfoRef=DidInfo_DiagnServi_TABROW_NeuMeasu_Read_27_1_1  # Diagnostics Data Import
            DcmDspDidSignal: DcmDspDidDataPos=0, DcmDspDidDataRef=Data_DiagnServi_TABROW_NeuMeasu_Read_27_1_1  # Diagnostics Data Import
          DID_DiagnServi_TABROW_NeuMeasu_Read_27_2_1: DcmDspDidIdentifier=1658, DcmDspDidInfoRef=DidInfo_DiagnServi_TABROW_NeuMeasu_Read_27_2_1  # Diagnostics Data Import
            DcmDspDidSignal: DcmDspDidDataPos=0, DcmDspDidDataRef=Data_DiagnServi_TABROW_NeuMeasu_Read_27_2_1  # Diagnostics Data Import
          DID_DiagnServi_TABROW_NeuMeasu_Read_27_3_1: DcmDspDidIdentifier=1657, DcmDspDidInfoRef=DidInfo_DiagnServi_TABROW_NeuMeasu_Read_27_3_1  # Diagnostics Data Import
            DcmDspDidSignal: DcmDspDidDataPos=0, DcmDspDidDataRef=Data_DiagnServi_TABROW_NeuMeasu_Read_27_3_1  # Diagnostics Data Import
          DID_DiagnServi_TABROW_NeuMeasu_Read_27_4: DcmDspDidIdentifier=1656, DcmDspDidInfoRef=DidInfo_DiagnServi_TABROW_NeuMeasu_Read_27_4  # Diagnostics Data Import
            DcmDspDidSignal: DcmDspDidDataPos=0, DcmDspDidDataRef=Data_DiagnServi_TABROW_NeuMeasu_Read_27_4  # Diagnostics Data Import
          DID_DiagnServi_TABROW_NeuMeasu_Read_27_1_1_1: DcmDspDidIdentifier=1655, DcmDspDidInfoRef=DidInfo_DiagnServi_TABROW_NeuMeasu_Read_27_1_1_1  # Diagnostics Data Import
            DcmDspDidSignal: DcmDspDidDataPos=0, DcmDspDidDataRef=Data_DiagnServi_TABROW_NeuMeasu_Read_27_1_1_1  # Diagnostics Data Import
          DID_DiagnServi_TABROW_NeuMeasu_Read_27_2_1_1: DcmDspDidIdentifier=1654, DcmDspDidInfoRef=DidInfo_DiagnServi_TABROW_NeuMeasu_Read_27_2_1_1  # Diagnostics Data Import
            DcmDspDidSignal: DcmDspDidDataPos=0, DcmDspDidDataRef=Data_DiagnServi_TABROW_NeuMeasu_Read_27_2_1_1  # Diagnostics Data Import
          DID_DiagnServi_TABROW_NeuMeasu_Read_27_3_1_1: DcmDspDidIdentifier=1653, DcmDspDidInfoRef=DidInfo_DiagnServi_TABROW_NeuMeasu_Read_27_3_1_1  # Diagnostics Data Import
            DcmDspDidSignal: DcmDspDidDataPos=0, DcmDspDidDataRef=Data_DiagnServi_TABROW_NeuMeasu_Read_27_3_1_1  # Diagnostics Data Import
          DID_DiagnServi_TABROW_NeuMeasu_Read_30: DcmDspDidIdentifier=1652, DcmDspDidInfoRef=DidInfo_DiagnServi_TABROW_NeuMeasu_Read_30  # Diagnostics Data Import
            DcmDspDidSignal: DcmDspDidDataPos=0, DcmDspDidDataRef=Data_DiagnServi_TABROW_NeuMeasu_Read_30  # Diagnostics Data Import
          DID_DiagnServi_TABROW_NeuMeasu_Read_29_1: DcmDspDidIdentifier=1651, DcmDspDidInfoRef=DidInfo_DiagnServi_TABROW_NeuMeasu_Read_29_1  # Diagnostics Data Import
            DcmDspDidSignal: DcmDspDidDataPos=0, DcmDspDidDataRef=Data_DiagnServi_TABROW_NeuMeasu_Read_29_1  # Diagnostics Data Import
          DID_DiagnServi_TABROW_NeuMeasu_Read_31: DcmDspDidIdentifier=1650, DcmDspDidInfoRef=DidInfo_DiagnServi_TABROW_NeuMeasu_Read_31  # Diagnostics Data Import
            DcmDspDidSignal: DcmDspDidDataPos=0, DcmDspDidDataRef=Data_DiagnServi_TABROW_NeuMeasu_Read_31  # Diagnostics Data Import
          DID_DiagnServi_TABROW_NeuMeasu_Read_32: DcmDspDidIdentifier=1649, DcmDspDidInfoRef=DidInfo_DiagnServi_TABROW_NeuMeasu_Read_32  # Diagnostics Data Import
            DcmDspDidSignal: DcmDspDidDataPos=0, DcmDspDidDataRef=Data_DiagnServi_TABROW_NeuMeasu_Read_32  # Diagnostics Data Import
          DID_DiagnServi_TABROW_NeuMeasu_Read_9_1: DcmDspDidIdentifier=1648, DcmDspDidInfoRef=DidInfo_DiagnServi_TABROW_NeuMeasu_Read_9_1  # Diagnostics Data Import
            DcmDspDidSignal: DcmDspDidDataPos=0, DcmDspDidDataRef=Data_DiagnServi_TABROW_NeuMeasu_Read_9_1  # Diagnostics Data Import
          DID_DiagnServi_TABROW_NeuMeasu_Read_29: DcmDspDidIdentifier=1647, DcmDspDidInfoRef=DidInfo_DiagnServi_TABROW_NeuMeasu_Read_29  # Diagnostics Data Import
            DcmDspDidSignal: DcmDspDidDataPos=0, DcmDspDidDataRef=Data_DiagnServi_TABROW_NeuMeasu_Read_29  # Diagnostics Data Import
          DID_DiagnServi_TABROW_NeuMeasu_Read_27_4_1: DcmDspDidIdentifier=1646, DcmDspDidInfoRef=DidInfo_DiagnServi_TABROW_NeuMeasu_Read_27_4_1  # Diagnostics Data Import
            DcmDspDidSignal: DcmDspDidDataPos=0, DcmDspDidDataRef=Data_DiagnServi_TABROW_NeuMeasu_Read_27_4_1  # Diagnostics Data Import
          DID_DiagnServi_TABROW_NeuMeasu_Read_33: DcmDspDidIdentifier=1645, DcmDspDidInfoRef=DidInfo_DiagnServi_TABROW_NeuMeasu_Read_33  # Diagnostics Data Import
            DcmDspDidSignal: DcmDspDidDataPos=0, DcmDspDidDataRef=Data_DiagnServi_TABROW_NeuMeasu_Read_33  # Diagnostics Data Import
          DID_DiagnServi_TABROW_NeuMeasu_Read_15: DcmDspDidIdentifier=1632, DcmDspDidInfoRef=DidInfo_DiagnServi_TABROW_NeuMeasu_Read_15  # Diagnostics Data Import
            DcmDspDidSignal: DcmDspDidDataPos=0, DcmDspDidDataRef=Data_DiagnServi_TABROW_NeuMeasu_Read_15  # Diagnostics Data Import
          DID_DiagnServi_TABROW_NeuMeasu_Read_57_1: DcmDspDidIdentifier=1615, DcmDspDidInfoRef=DidInfo_DiagnServi_TABROW_NeuMeasu_Read_57_1  # Diagnostics Data Import
            DcmDspDidSignal: DcmDspDidDataPos=0, DcmDspDidDataRef=Data_DiagnServi_TABROW_NeuMeasu_Read_57_1  # Diagnostics Data Import
          DID_DiagnServi_TABROW_NeuMeasu_Read_57_11: DcmDspDidIdentifier=1612, DcmDspDidInfoRef=DidInfo_DiagnServi_TABROW_NeuMeasu_Read_57_11  # Diagnostics Data Import
            DcmDspDidSignal: DcmDspDidDataPos=0, DcmDspDidDataRef=Data_DiagnServi_TABROW_NeuMeasu_Read_57_11  # Diagnostics Data Import
          DID_DiagnServi_TABROW_VWCodinValue_Read: DcmDspDidIdentifier=1536, DcmDspDidInfoRef=DidInfo_DiagnServi_TABROW_VWCodinValue_Read  # Diagnostics Data Import
            DcmDspDidSignal: DcmDspDidDataPos=0, DcmDspDidDataRef=Data_DiagnServi_TABROW_VWCodinValue_Read  # Diagnostics Data Import
          DID_DiagnServi_TABROW_NeuMeasu_Read_56: DcmDspDidIdentifier=1507, DcmDspDidInfoRef=DidInfo_DiagnServi_TABROW_NeuMeasu_Read_56  # Diagnostics Data Import
            DcmDspDidSignal: DcmDspDidDataPos=0, DcmDspDidDataRef=Data_DiagnServi_TABROW_NeuMeasu_Read_56  # Diagnostics Data Import
          DID_DiagnServi_TABROW_NeuMeasu_Read_55: DcmDspDidIdentifier=1479, DcmDspDidInfoRef=DidInfo_DiagnServi_TABROW_NeuMeasu_Read_55  # Diagnostics Data Import
            DcmDspDidSignal: DcmDspDidDataPos=0, DcmDspDidDataRef=Data_DiagnServi_TABROW_NeuMeasu_Read_55  # Diagnostics Data Import
          DID_DiagnServi_TABROW_NeuMeasu_Read_52: DcmDspDidIdentifier=1478, DcmDspDidInfoRef=DidInfo_DiagnServi_TABROW_NeuMeasu_Read_52  # Diagnostics Data Import
            DcmDspDidSignal: DcmDspDidDataPos=0, DcmDspDidDataRef=Data_DiagnServi_TABROW_NeuMeasu_Read_52  # Diagnostics Data Import
          DID_DiagnServi_TABROW_NeuMeasu_Read_53: DcmDspDidIdentifier=1472, DcmDspDidInfoRef=DidInfo_DiagnServi_TABROW_NeuMeasu_Read_53  # Diagnostics Data Import
            DcmDspDidSignal: DcmDspDidDataPos=0, DcmDspDidDataRef=Data_DiagnServi_TABROW_NeuMeasu_Read_53  # Diagnostics Data Import
          DID_DiagnServi_TABROW_NeuMeasu_Read_45: DcmDspDidIdentifier=1469, DcmDspDidInfoRef=DidInfo_DiagnServi_TABROW_NeuMeasu_Read_45  # Diagnostics Data Import
            DcmDspDidSignal: DcmDspDidDataPos=0, DcmDspDidDataRef=Data_DiagnServi_TABROW_NeuMeasu_Read_45  # Diagnostics Data Import
          DID_DiagnServi_TABROW_NeuMeasu_Read_46_1_1_1_1_1_1_2_3: DcmDspDidIdentifier=1468, DcmDspDidInfoRef=DidInfo_DiagnServi_TABROW_NeuMeasu_Read_46_1_1_1_1_1_1_2_3  # Diagnostics Data Import
            DcmDspDidSignal: DcmDspDidDataPos=0, DcmDspDidDataRef=Data_DiagnServi_TABROW_NeuMeasu_Read_46_1_1_1_1_1_1_2_3  # Diagnostics Data Import
          DID_DiagnServi_TABROW_NeuMeasu_Read_46_1_1_1_1_1_1_2_2: DcmDspDidIdentifier=1467, DcmDspDidInfoRef=DidInfo_DiagnServi_TABROW_NeuMeasu_Read_46_1_1_1_1_1_1_2_2  # Diagnostics Data Import
            DcmDspDidSignal: DcmDspDidDataPos=0, DcmDspDidDataRef=Data_DiagnServi_TABROW_NeuMeasu_Read_46_1_1_1_1_1_1_2_2  # Diagnostics Data Import
          DID_DiagnServi_TABROW_NeuMeasu_Read_46_1_1_1_1_1_1_2_1: DcmDspDidIdentifier=1466, DcmDspDidInfoRef=DidInfo_DiagnServi_TABROW_NeuMeasu_Read_46_1_1_1_1_1_1_2_1  # Diagnostics Data Import
            DcmDspDidSignal: DcmDspDidDataPos=0, DcmDspDidDataRef=Data_DiagnServi_TABROW_NeuMeasu_Read_46_1_1_1_1_1_1_2_1  # Diagnostics Data Import
          DID_DiagnServi_TABROW_NeuMeasu_Read_46_1_1_1_1_1_1_2: DcmDspDidIdentifier=1465, DcmDspDidInfoRef=DidInfo_DiagnServi_TABROW_NeuMeasu_Read_46_1_1_1_1_1_1_2  # Diagnostics Data Import
            DcmDspDidSignal: DcmDspDidDataPos=0, DcmDspDidDataRef=Data_DiagnServi_TABROW_NeuMeasu_Read_46_1_1_1_1_1_1_2  # Diagnostics Data Import
          DID_DiagnServi_TABROW_NeuMeasu_Read_46_1_1_1_1_1_1_1: DcmDspDidIdentifier=1464, DcmDspDidInfoRef=DidInfo_DiagnServi_TABROW_NeuMeasu_Read_46_1_1_1_1_1_1_1  # Diagnostics Data Import
            DcmDspDidSignal: DcmDspDidDataPos=0, DcmDspDidDataRef=Data_DiagnServi_TABROW_NeuMeasu_Read_46_1_1_1_1_1_1_1  # Diagnostics Data Import
          DID_DiagnServi_TABROW_NeuMeasu_Read_46_1_1_1_1_1_1: DcmDspDidIdentifier=1463, DcmDspDidInfoRef=DidInfo_DiagnServi_TABROW_NeuMeasu_Read_46_1_1_1_1_1_1  # Diagnostics Data Import
            DcmDspDidSignal: DcmDspDidDataPos=0, DcmDspDidDataRef=Data_DiagnServi_TABROW_NeuMeasu_Read_46_1_1_1_1_1_1  # Diagnostics Data Import
          DID_DiagnServi_TABROW_NeuMeasu_Read_46_1_1_1_1_1: DcmDspDidIdentifier=1462, DcmDspDidInfoRef=DidInfo_DiagnServi_TABROW_NeuMeasu_Read_46_1_1_1_1_1  # Diagnostics Data Import
            DcmDspDidSignal: DcmDspDidDataPos=0, DcmDspDidDataRef=Data_DiagnServi_TABROW_NeuMeasu_Read_46_1_1_1_1_1  # Diagnostics Data Import
          DID_DiagnServi_TABROW_NeuMeasu_Read_46_1_1_1_1: DcmDspDidIdentifier=1461, DcmDspDidInfoRef=DidInfo_DiagnServi_TABROW_NeuMeasu_Read_46_1_1_1_1  # Diagnostics Data Import
            DcmDspDidSignal: DcmDspDidDataPos=0, DcmDspDidDataRef=Data_DiagnServi_TABROW_NeuMeasu_Read_46_1_1_1_1  # Diagnostics Data Import
          DID_DiagnServi_TABROW_NeuMeasu_Read_46_1_1_1: DcmDspDidIdentifier=1460, DcmDspDidInfoRef=DidInfo_DiagnServi_TABROW_NeuMeasu_Read_46_1_1_1  # Diagnostics Data Import
            DcmDspDidSignal: DcmDspDidDataPos=0, DcmDspDidDataRef=Data_DiagnServi_TABROW_NeuMeasu_Read_46_1_1_1  # Diagnostics Data Import
          DID_DiagnServi_TABROW_NeuMeasu_Read_46_1_1: DcmDspDidIdentifier=1459, DcmDspDidInfoRef=DidInfo_DiagnServi_TABROW_NeuMeasu_Read_46_1_1  # Diagnostics Data Import
            DcmDspDidSignal: DcmDspDidDataPos=0, DcmDspDidDataRef=Data_DiagnServi_TABROW_NeuMeasu_Read_46_1_1  # Diagnostics Data Import
          DID_DiagnServi_TABROW_NeuMeasu_Read_46_1: DcmDspDidIdentifier=1458, DcmDspDidInfoRef=DidInfo_DiagnServi_TABROW_NeuMeasu_Read_46_1  # Diagnostics Data Import
            DcmDspDidSignal: DcmDspDidDataPos=0, DcmDspDidDataRef=Data_DiagnServi_TABROW_NeuMeasu_Read_46_1  # Diagnostics Data Import
          DID_DiagnServi_TABROW_NeuMeasu_Read_46: DcmDspDidIdentifier=1457, DcmDspDidInfoRef=DidInfo_DiagnServi_TABROW_NeuMeasu_Read_46  # Diagnostics Data Import
            DcmDspDidSignal: DcmDspDidDataPos=0, DcmDspDidDataRef=Data_DiagnServi_TABROW_NeuMeasu_Read_46  # Diagnostics Data Import
          DID_High_voltage_battery_total_voltage_Read_Data_By_Identifier: DcmDspDidIdentifier=1435, DcmDspDidInfoRef=DidInfo_High_voltage_battery_total_voltage_Read_Data_By_Identifier  # Diagnostics Data Import
            DcmDspDidSignal: DcmDspDidDataPos=0, DcmDspDidDataRef=Data_High_voltage_battery_total_voltage_Read_Data_By_Identifier  # Diagnostics Data Import
          DID_DiagnServi_TABROW_NeuMeasu_Read_17: DcmDspDidIdentifier=1434, DcmDspDidInfoRef=DidInfo_DiagnServi_TABROW_NeuMeasu_Read_17  # Diagnostics Data Import
            DcmDspDidSignal: DcmDspDidDataPos=0, DcmDspDidDataRef=Data_DiagnServi_TABROW_NeuMeasu_Read_17  # Diagnostics Data Import
          DID_DiagnServi_TABROW_NeuMeasu_Read_18: DcmDspDidIdentifier=1431, DcmDspDidInfoRef=DidInfo_DiagnServi_TABROW_NeuMeasu_Read_18  # Diagnostics Data Import
            DcmDspDidSignal: DcmDspDidDataPos=0, DcmDspDidDataRef=Data_DiagnServi_TABROW_NeuMeasu_Read_18  # Diagnostics Data Import
          DID_DiagnServi_TABROW_NeuMeasu_Read_6: DcmDspDidIdentifier=1430, DcmDspDidInfoRef=DidInfo_DiagnServi_TABROW_NeuMeasu_Read_6  # Diagnostics Data Import
            DcmDspDidSignal: DcmDspDidDataPos=0, DcmDspDidDataRef=Data_DiagnServi_TABROW_NeuMeasu_Read_6  # Diagnostics Data Import
          DID_DiagnServi_TABROW_DID0xEFD_Read_3: DcmDspDidIdentifier=1429, DcmDspDidInfoRef=DidInfo_DiagnServi_TABROW_DID0xEFD_Read_3  # Diagnostics Data Import
            DcmDspDidSignal: DcmDspDidDataPos=0, DcmDspDidDataRef=Data_DiagnServi_TABROW_DID0xEFD_Read_3  # Diagnostics Data Import
          DID_DiagnServi_TABROW_NeuMeasu_Read_10: DcmDspDidIdentifier=1424, DcmDspDidInfoRef=DidInfo_DiagnServi_TABROW_NeuMeasu_Read_10  # Diagnostics Data Import
            DcmDspDidSignal: DcmDspDidDataPos=0, DcmDspDidDataRef=Data_DiagnServi_TABROW_NeuMeasu_Read_10  # Diagnostics Data Import
          DID_DiagnServi_TABROW_NeuMeasu_Read_4: DcmDspDidIdentifier=1423, DcmDspDidInfoRef=DidInfo_DiagnServi_TABROW_NeuMeasu_Read_4  # Diagnostics Data Import
            DcmDspDidSignal: DcmDspDidDataPos=0, DcmDspDidDataRef=Data_DiagnServi_TABROW_NeuMeasu_Read_4  # Diagnostics Data Import
          DID_DiagnServi_TABROW_NeuMeasu_Read_11: DcmDspDidIdentifier=1421, DcmDspDidInfoRef=DidInfo_DiagnServi_TABROW_NeuMeasu_Read_11  # Diagnostics Data Import
            DcmDspDidSignal: DcmDspDidDataPos=0, DcmDspDidDataRef=Data_DiagnServi_TABROW_NeuMeasu_Read_11  # Diagnostics Data Import
          DID_DiagnServi_TABROW_DID0xEFD_Read: DcmDspDidIdentifier=1420, DcmDspDidInfoRef=DidInfo_DiagnServi_TABROW_DID0xEFD_Read  # Diagnostics Data Import
            DcmDspDidSignal: DcmDspDidDataPos=0, DcmDspDidDataRef=Data_DiagnServi_TABROW_DID0xEFD_Read  # Diagnostics Data Import
          DID_DiagnServi_TABROW_NeuMeasu_Read_12: DcmDspDidIdentifier=1419, DcmDspDidInfoRef=DidInfo_DiagnServi_TABROW_NeuMeasu_Read_12  # Diagnostics Data Import
            DcmDspDidSignal: DcmDspDidDataPos=0, DcmDspDidDataRef=Data_DiagnServi_TABROW_NeuMeasu_Read_12  # Diagnostics Data Import
          DID_DiagnServi_TABROW_DID0xEFD_Read_1: DcmDspDidIdentifier=1418, DcmDspDidInfoRef=DidInfo_DiagnServi_TABROW_DID0xEFD_Read_1  # Diagnostics Data Import
            DcmDspDidSignal: DcmDspDidDataPos=0, DcmDspDidDataRef=Data_DiagnServi_TABROW_DID0xEFD_Read_1  # Diagnostics Data Import
          DID_DiagnServi_TABROW_DID0xEFD_Read_1_1: DcmDspDidIdentifier=1417, DcmDspDidInfoRef=DidInfo_DiagnServi_TABROW_DID0xEFD_Read_1_1  # Diagnostics Data Import
            DcmDspDidSignal: DcmDspDidDataPos=0, DcmDspDidDataRef=Data_DiagnServi_TABROW_DID0xEFD_Read_1_1  # Diagnostics Data Import
          DID_DiagnServi_TABROW_DID0xEFD_Read_2: DcmDspDidIdentifier=1416, DcmDspDidInfoRef=DidInfo_DiagnServi_TABROW_DID0xEFD_Read_2  # Diagnostics Data Import
            DcmDspDidSignal: DcmDspDidDataPos=0, DcmDspDidDataRef=Data_DiagnServi_TABROW_DID0xEFD_Read_2  # Diagnostics Data Import
          DID_DiagnServi_TABROW_DID0xEFD_Read_1_2: DcmDspDidIdentifier=1415, DcmDspDidInfoRef=DidInfo_DiagnServi_TABROW_DID0xEFD_Read_1_2  # Diagnostics Data Import
            DcmDspDidSignal: DcmDspDidDataPos=0, DcmDspDidDataRef=Data_DiagnServi_TABROW_DID0xEFD_Read_1_2  # Diagnostics Data Import
          DID_DiagnServi_TABROW_DID0xEFD_Read_1_1_1: DcmDspDidIdentifier=1414, DcmDspDidInfoRef=DidInfo_DiagnServi_TABROW_DID0xEFD_Read_1_1_1  # Diagnostics Data Import
            DcmDspDidSignal: DcmDspDidDataPos=0, DcmDspDidDataRef=Data_DiagnServi_TABROW_DID0xEFD_Read_1_1_1  # Diagnostics Data Import
          DID_DiagnServi_TABROW_NeuMeasu_Read_37: DcmDspDidIdentifier=1413, DcmDspDidInfoRef=DidInfo_DiagnServi_TABROW_NeuMeasu_Read_37  # Diagnostics Data Import
            DcmDspDidSignal: DcmDspDidDataPos=0, DcmDspDidDataRef=Data_DiagnServi_TABROW_NeuMeasu_Read_37  # Diagnostics Data Import
          DID_DiagnServi_TABROW_NeuMeasu_Read_42: DcmDspDidIdentifier=1412, DcmDspDidInfoRef=DidInfo_DiagnServi_TABROW_NeuMeasu_Read_42  # Diagnostics Data Import
            DcmDspDidSignal: DcmDspDidDataPos=0, DcmDspDidDataRef=Data_DiagnServi_TABROW_NeuMeasu_Read_42  # Diagnostics Data Import
          DID_DiagnServi_TABROW_NeuMeasu_Read_16: DcmDspDidIdentifier=1411, DcmDspDidInfoRef=DidInfo_DiagnServi_TABROW_NeuMeasu_Read_16  # Diagnostics Data Import
            DcmDspDidSignal: DcmDspDidDataPos=0, DcmDspDidDataRef=Data_DiagnServi_TABROW_NeuMeasu_Read_16  # Diagnostics Data Import
          DID_DiagnServi_TABROW_NeuMeasu_Read_35: DcmDspDidIdentifier=1410, DcmDspDidInfoRef=DidInfo_DiagnServi_TABROW_NeuMeasu_Read_35  # Diagnostics Data Import
            DcmDspDidSignal: DcmDspDidDataPos=0, DcmDspDidDataRef=Data_DiagnServi_TABROW_NeuMeasu_Read_35  # Diagnostics Data Import
          DID_DiagnServi_TABROW_NeuMeasu_Read_19: DcmDspDidIdentifier=1409, DcmDspDidInfoRef=DidInfo_DiagnServi_TABROW_NeuMeasu_Read_19  # Diagnostics Data Import
            DcmDspDidSignal: DcmDspDidDataPos=0, DcmDspDidDataRef=Data_DiagnServi_TABROW_NeuMeasu_Read_19  # Diagnostics Data Import
          DID_DiagnServi_TABROW_NeuMeasu_Read_38: DcmDspDidIdentifier=1406, DcmDspDidInfoRef=DidInfo_DiagnServi_TABROW_NeuMeasu_Read_38  # Diagnostics Data Import
            DcmDspDidSignal: DcmDspDidDataPos=0, DcmDspDidDataRef=Data_DiagnServi_TABROW_NeuMeasu_Read_38  # Diagnostics Data Import
          DID_DiagnServi_TABROW_NeuMeasu_Read_13: DcmDspDidIdentifier=1405, DcmDspDidInfoRef=DidInfo_DiagnServi_TABROW_NeuMeasu_Read_13  # Diagnostics Data Import
            DcmDspDidSignal: DcmDspDidDataPos=0, DcmDspDidDataRef=Data_DiagnServi_TABROW_NeuMeasu_Read_13  # Diagnostics Data Import
          DID_DiagnServi_TABROW_NeuMeasu_Read_39: DcmDspDidIdentifier=1404, DcmDspDidInfoRef=DidInfo_DiagnServi_TABROW_NeuMeasu_Read_39  # Diagnostics Data Import
            DcmDspDidSignal: DcmDspDidDataPos=0, DcmDspDidDataRef=Data_DiagnServi_TABROW_NeuMeasu_Read_39  # Diagnostics Data Import
          DID_DiagnServi_TABROW_NeuMeasu_Read_40: DcmDspDidIdentifier=1403, DcmDspDidInfoRef=DidInfo_DiagnServi_TABROW_NeuMeasu_Read_40  # Diagnostics Data Import
            DcmDspDidSignal: DcmDspDidDataPos=0, DcmDspDidDataRef=Data_DiagnServi_TABROW_NeuMeasu_Read_40  # Diagnostics Data Import
          DID_DiagnServi_TABROW_NeuMeasu_Read_41: DcmDspDidIdentifier=1402, DcmDspDidInfoRef=DidInfo_DiagnServi_TABROW_NeuMeasu_Read_41  # Diagnostics Data Import
            DcmDspDidSignal: DcmDspDidDataPos=0, DcmDspDidDataRef=Data_DiagnServi_TABROW_NeuMeasu_Read_41  # Diagnostics Data Import
          DID_DiagnServi_TABROW_NeuMeasu_Read_20: DcmDspDidIdentifier=1397, DcmDspDidInfoRef=DidInfo_DiagnServi_TABROW_NeuMeasu_Read_20  # Diagnostics Data Import
            DcmDspDidSignal: DcmDspDidDataPos=0, DcmDspDidDataRef=Data_DiagnServi_TABROW_NeuMeasu_Read_20  # Diagnostics Data Import
          DID_DiagnServi_TABROW_NeuMeasu_Read_49: DcmDspDidIdentifier=1396, DcmDspDidInfoRef=DidInfo_DiagnServi_TABROW_NeuMeasu_Read_49  # Diagnostics Data Import
            DcmDspDidSignal: DcmDspDidDataPos=0, DcmDspDidDataRef=Data_DiagnServi_TABROW_NeuMeasu_Read_49  # Diagnostics Data Import
          DID_DiagnServi_TABROW_NeuMeasu_Read_47: DcmDspDidIdentifier=1395, DcmDspDidInfoRef=DidInfo_DiagnServi_TABROW_NeuMeasu_Read_47  # Diagnostics Data Import
            DcmDspDidSignal: DcmDspDidDataPos=0, DcmDspDidDataRef=Data_DiagnServi_TABROW_NeuMeasu_Read_47  # Diagnostics Data Import
          DID_DiagnServi_TABROW_NeuMeasu_Read_49_1: DcmDspDidIdentifier=1394, DcmDspDidInfoRef=DidInfo_DiagnServi_TABROW_NeuMeasu_Read_49_1  # Diagnostics Data Import
            DcmDspDidSignal: DcmDspDidDataPos=0, DcmDspDidDataRef=Data_DiagnServi_TABROW_NeuMeasu_Read_49_1  # Diagnostics Data Import
          DID_DiagnServi_TABROW_NeuMeasu_Read_43: DcmDspDidIdentifier=1393, DcmDspDidInfoRef=DidInfo_DiagnServi_TABROW_NeuMeasu_Read_43  # Diagnostics Data Import
            DcmDspDidSignal: DcmDspDidDataPos=0, DcmDspDidDataRef=Data_DiagnServi_TABROW_NeuMeasu_Read_43  # Diagnostics Data Import
          DID_DiagnServi_TABROW_NeuMeasu_Read_43_1: DcmDspDidIdentifier=1392, DcmDspDidInfoRef=DidInfo_DiagnServi_TABROW_NeuMeasu_Read_43_1  # Diagnostics Data Import
            DcmDspDidSignal: DcmDspDidDataPos=0, DcmDspDidDataRef=Data_DiagnServi_TABROW_NeuMeasu_Read_43_1  # Diagnostics Data Import
          DID_DiagnServi_TABROW_NeuMeasu_Read_43_1_1: DcmDspDidIdentifier=1391, DcmDspDidInfoRef=DidInfo_DiagnServi_TABROW_NeuMeasu_Read_43_1_1  # Diagnostics Data Import
            DcmDspDidSignal: DcmDspDidDataPos=0, DcmDspDidDataRef=Data_DiagnServi_TABROW_NeuMeasu_Read_43_1_1  # Diagnostics Data Import
          DID_DiagnServi_TABROW_NeuMeasu_Read_43_1_1_1: DcmDspDidIdentifier=1390, DcmDspDidInfoRef=DidInfo_DiagnServi_TABROW_NeuMeasu_Read_43_1_1_1  # Diagnostics Data Import
            DcmDspDidSignal: DcmDspDidDataPos=0, DcmDspDidDataRef=Data_DiagnServi_TABROW_NeuMeasu_Read_43_1_1_1  # Diagnostics Data Import
          DID_DiagnServi_TABROW_NeuMeasu_Read_43_1_1_1_1: DcmDspDidIdentifier=1389, DcmDspDidInfoRef=DidInfo_DiagnServi_TABROW_NeuMeasu_Read_43_1_1_1_1  # Diagnostics Data Import
            DcmDspDidSignal: DcmDspDidDataPos=0, DcmDspDidDataRef=Data_DiagnServi_TABROW_NeuMeasu_Read_43_1_1_1_1  # Diagnostics Data Import
          DID_DiagnServi_TABROW_NeuMeasu_Read_43_1_1_1_1_1: DcmDspDidIdentifier=1388, DcmDspDidInfoRef=DidInfo_DiagnServi_TABROW_NeuMeasu_Read_43_1_1_1_1_1  # Diagnostics Data Import
            DcmDspDidSignal: DcmDspDidDataPos=0, DcmDspDidDataRef=Data_DiagnServi_TABROW_NeuMeasu_Read_43_1_1_1_1_1  # Diagnostics Data Import
          DID_DiagnServi_TABROW_NeuMeasu_Read_43_1_1_1_1_1_1: DcmDspDidIdentifier=1387, DcmDspDidInfoRef=DidInfo_DiagnServi_TABROW_NeuMeasu_Read_43_1_1_1_1_1_1  # Diagnostics Data Import
            DcmDspDidSignal: DcmDspDidDataPos=0, DcmDspDidDataRef=Data_DiagnServi_TABROW_NeuMeasu_Read_43_1_1_1_1_1_1  # Diagnostics Data Import
          DID_DiagnServi_TABROW_NeuMeasu_Read_43_1_1_1_1_1_1_1: DcmDspDidIdentifier=1386, DcmDspDidInfoRef=DidInfo_DiagnServi_TABROW_NeuMeasu_Read_43_1_1_1_1_1_1_1  # Diagnostics Data Import
            DcmDspDidSignal: DcmDspDidDataPos=0, DcmDspDidDataRef=Data_DiagnServi_TABROW_NeuMeasu_Read_43_1_1_1_1_1_1_1  # Diagnostics Data Import
          DID_DiagnServi_TABROW_NeuMeasu_Read_43_1_1_1_1_1_1_1_1_1_1: DcmDspDidIdentifier=1385, DcmDspDidInfoRef=DidInfo_DiagnServi_TABROW_NeuMeasu_Read_43_1_1_1_1_1_1_1_1_1_1  # Diagnostics Data Import
            DcmDspDidSignal: DcmDspDidDataPos=0, DcmDspDidDataRef=Data_DiagnServi_TABROW_NeuMeasu_Read_43_1_1_1_1_1_1_1_1_1_1  # Diagnostics Data Import
          DID_DiagnServi_TABROW_NeuMeasu_Read_43_1_1_1_1_1_1_1_1: DcmDspDidIdentifier=1384, DcmDspDidInfoRef=DidInfo_DiagnServi_TABROW_NeuMeasu_Read_43_1_1_1_1_1_1_1_1  # Diagnostics Data Import
            DcmDspDidSignal: DcmDspDidDataPos=0, DcmDspDidDataRef=Data_DiagnServi_TABROW_NeuMeasu_Read_43_1_1_1_1_1_1_1_1  # Diagnostics Data Import
          DID_DiagnServi_TABROW_NeuMeasu_Read_43_1_1_1_1_1_1_1_1_1: DcmDspDidIdentifier=1383, DcmDspDidInfoRef=DidInfo_DiagnServi_TABROW_NeuMeasu_Read_43_1_1_1_1_1_1_1_1_1  # Diagnostics Data Import
            DcmDspDidSignal: DcmDspDidDataPos=0, DcmDspDidDataRef=Data_DiagnServi_TABROW_NeuMeasu_Read_43_1_1_1_1_1_1_1_1_1  # Diagnostics Data Import
          DID_DiagnServi_TABROW_NeuMeasu_Read_43_1_1_1_1_1_1_1_1_1_1_1: DcmDspDidIdentifier=1382, DcmDspDidInfoRef=DidInfo_DiagnServi_TABROW_NeuMeasu_Read_43_1_1_1_1_1_1_1_1_1_1_1  # Diagnostics Data Import
            DcmDspDidSignal: DcmDspDidDataPos=0, DcmDspDidDataRef=Data_DiagnServi_TABROW_NeuMeasu_Read_43_1_1_1_1_1_1_1_1_1_1_1  # Diagnostics Data Import
          DID_DiagnServi_TABROW_NeuMeasu_Read_50: DcmDspDidIdentifier=1381, DcmDspDidInfoRef=DidInfo_DiagnServi_TABROW_NeuMeasu_Read_50  # Diagnostics Data Import
            DcmDspDidSignal: DcmDspDidDataPos=0, DcmDspDidDataRef=Data_DiagnServi_TABROW_NeuMeasu_Read_50  # Diagnostics Data Import
          DID_DiagnServi_TABROW_NeuMeasu_Read_48: DcmDspDidIdentifier=1380, DcmDspDidInfoRef=DidInfo_DiagnServi_TABROW_NeuMeasu_Read_48  # Diagnostics Data Import
            DcmDspDidSignal: DcmDspDidDataPos=0, DcmDspDidDataRef=Data_DiagnServi_TABROW_NeuMeasu_Read_48  # Diagnostics Data Import
          DID_DiagnServi_TABROW_DID0x0EF_Read: DcmDspDidIdentifier=1379, DcmDspDidInfoRef=DidInfo_DiagnServi_TABROW_DID0x0EF_Read  # Diagnostics Data Import
            DcmDspDidSignal: DcmDspDidDataPos=0, DcmDspDidDataRef=Data_DiagnServi_TABROW_DID0x0EF_Read  # Diagnostics Data Import
          DID_DiagnServi_TABROW_NeuMeasu_Read_33_1_1_1_1_1_1_1_1_1_1_1_1_1_1_1_1_1_1_1_1_1_1_1_2_1: DcmDspDidIdentifier=1355, DcmDspDidInfoRef=DidInfo_DiagnServi_TABROW_NeuMeasu_Read_33_1_1_1_1_1_1_1_1_1_1_1_1_1_1_1_1_1_1_1_1_1_1_1_2_1  # Diagnostics Data Import
            DcmDspDidSignal: DcmDspDidDataPos=0, DcmDspDidDataRef=Data_DiagnServi_TABROW_NeuMeasu_Read_33_1_1_1_1_1_1_1_1_1_1_1_1_1_1_1_1_1_1_1_1_1_1_1_2_1  # Diagnostics Data Import
          DID_DiagnServi_TABROW_NeuMeasu_Read_33_1_1_1_1_1_1_1_1_1_1_1_1_1_1_1_1_1_1_1_1_1_1_1_2_1_1_1: DcmDspDidIdentifier=1354, DcmDspDidInfoRef=DidInfo_DiagnServi_TABROW_NeuMeasu_Read_33_1_1_1_1_1_1_1_1_1_1_1_1_1_1_1_1_1_1_1_1_1_1_1_2_1_1_1  # Diagnostics Data Import
            DcmDspDidSignal: DcmDspDidDataPos=0, DcmDspDidDataRef=Data_DiagnServi_TABROW_NeuMeasu_Read_33_1_1_1_1_1_1_1_1_1_1_1_1_1_1_1_1_1_1_1_1_1_1_1_2_1_1_1  # Diagnostics Data Import
          DID_DiagnServi_TABROW_NeuMeasu_Read_3: DcmDspDidIdentifier=1302, DcmDspDidInfoRef=DidInfo_DiagnServi_TABROW_NeuMeasu_Read_3  # Diagnostics Data Import
            DcmDspDidSignal: DcmDspDidDataPos=0, DcmDspDidDataRef=Data_DiagnServi_TABROW_NeuMeasu_Read_3  # Diagnostics Data Import
          DID_DiagnServi_TABROW_NeuMeasu_Read_2: DcmDspDidIdentifier=1301, DcmDspDidInfoRef=DidInfo_DiagnServi_TABROW_NeuMeasu_Read_2  # Diagnostics Data Import
            DcmDspDidSignal: DcmDspDidDataPos=0, DcmDspDidDataRef=Data_DiagnServi_TABROW_NeuMeasu_Read_2  # Diagnostics Data Import
          DID_DiagnServi_TABROW_NeuMeasu_Read_5: DcmDspDidIdentifier=1300, DcmDspDidInfoRef=DidInfo_DiagnServi_TABROW_NeuMeasu_Read_5  # Diagnostics Data Import
            DcmDspDidSignal: DcmDspDidDataPos=0, DcmDspDidDataRef=Data_DiagnServi_TABROW_NeuMeasu_Read_5  # Diagnostics Data Import
          DID_DiagnServi_TABROW_NeuMeasu_Read_34: DcmDspDidIdentifier=1297, DcmDspDidInfoRef=DidInfo_DiagnServi_TABROW_NeuMeasu_Read_34  # Diagnostics Data Import
            DcmDspDidSignal: DcmDspDidDataPos=0, DcmDspDidDataRef=Data_DiagnServi_TABROW_NeuMeasu_Read_34  # Diagnostics Data Import
          DID_BMC_Vorlade_Zielspannung_Read_Data_By_Identifier: DcmDspDidIdentifier=1295, DcmDspDidInfoRef=DidInfo_BMC_Vorlade_Zielspannung_Read_Data_By_Identifier  # Diagnostics Data Import
            DcmDspDidSignal: DcmDspDidDataPos=0, DcmDspDidDataRef=Data_BMC_Vorlade_Zielspannung_Read_Data_By_Identifier  # Diagnostics Data Import
          DID_BMC_Mode_Read_Data_By_Identifier: DcmDspDidIdentifier=1294, DcmDspDidInfoRef=DidInfo_BMC_Mode_Read_Data_By_Identifier  # Diagnostics Data Import
            DcmDspDidSignal: DcmDspDidDataPos=0, DcmDspDidDataRef=Data_BMC_Mode_Read_Data_By_Identifier  # Diagnostics Data Import
          DID_BMC_Strom_Read_Data_By_Identifier: DcmDspDidIdentifier=1292, DcmDspDidInfoRef=DidInfo_BMC_Strom_Read_Data_By_Identifier  # Diagnostics Data Import
            DcmDspDidSignal: DcmDspDidDataPos=0, DcmDspDidDataRef=Data_BMC_Strom_Read_Data_By_Identifier  # Diagnostics Data Import
          DID_DiagnServi_TABROW_Produ_Read: DcmDspDidIdentifier=1278, DcmDspDidInfoRef=DidInfo_DiagnServi_TABROW_Produ_Read  # Diagnostics Data Import
            DcmDspDidSignal: DcmDspDidDataPos=0, DcmDspDidDataRef=Data_DiagnServi_TABROW_Produ_Read  # Diagnostics Data Import
          DID_DiagnServi_TABROW_ProduDeact_Read: DcmDspDidIdentifier=1276, DcmDspDidInfoRef=DidInfo_DiagnServi_TABROW_ProduDeact_Read  # Diagnostics Data Import
            DcmDspDidSignal: DcmDspDidDataPos=0, DcmDspDidDataRef=Data_DiagnServi_TABROW_ProduDeact_Read  # Diagnostics Data Import
          DID_TABROW_ProgrPreco_Read: DcmDspDidIdentifier=1096, DcmDspDidInfoRef=DidInfo_TABROW_ProgrPreco_Read  # Diagnostics Data Import
            DcmDspDidSignal: DcmDspDidDataPos=0, DcmDspDidDataRef=Data_TABROW_ProgrPreco_Read  # Diagnostics Data Import
          DID_DiagnServi_TABROW_BootlTPBlock_Read: DcmDspDidIdentifier=1040, DcmDspDidInfoRef=DidInfo_DiagnServi_TABROW_BootlTPBlock_Read  # Diagnostics Data Import
            DcmDspDidSignal: DcmDspDidDataPos=0, DcmDspDidDataRef=Data_DiagnServi_TABROW_BootlTPBlock_Read  # Diagnostics Data Import
          DID_TABROW_VWLogicSoftwBlockLockValue_Read: DcmDspDidIdentifier=1039, DcmDspDidInfoRef=DidInfo_TABROW_VWLogicSoftwBlockLockValue_Read  # Diagnostics Data Import
            DcmDspDidSignal: DcmDspDidDataPos=0, DcmDspDidDataRef=Data_TABROW_VWLogicSoftwBlockLockValue_Read  # Diagnostics Data Import
          DID_TABROW_VWLogicSoftwBlockCountOfProgrAttem_Read: DcmDspDidIdentifier=1031, DcmDspDidInfoRef=DidInfo_TABROW_VWLogicSoftwBlockCountOfProgrAttem_Read  # Diagnostics Data Import
            DcmDspDidSignal: DcmDspDidDataPos=0, DcmDspDidDataRef=Data_TABROW_VWLogicSoftwBlockCountOfProgrAttem_Read  # Diagnostics Data Import
          DID_DiagnServi_Assembly_part_number_Read: DcmDspDidIdentifier=810, DcmDspDidInfoRef=DidInfo_DiagnServi_Assembly_part_number_Read  # Diagnostics Data Import
            DcmDspDidSignal: DcmDspDidDataPos=0, DcmDspDidDataRef=Data_DiagnServi_Assembly_part_number_Read  # Diagnostics Data Import
          DID_DiagnServi_BCUe_part_number_Read: DcmDspDidIdentifier=809, DcmDspDidInfoRef=DidInfo_DiagnServi_BCUe_part_number_Read  # Diagnostics Data Import
            DcmDspDidSignal: DcmDspDidDataPos=0, DcmDspDidDataRef=Data_DiagnServi_BCUe_part_number_Read  # Diagnostics Data Import
          DID_BMC_Status_DCLS_Read_Data_By_Identifier: DcmDspDidIdentifier=808, DcmDspDidInfoRef=DidInfo_BMC_Status_DCLS_Read_Data_By_Identifier  # Diagnostics Data Import
            DcmDspDidSignal: DcmDspDidDataPos=0, DcmDspDidDataRef=Data_BMC_Status_DCLS_Read_Data_By_Identifier  # Diagnostics Data Import
          DID_DiagnServi_BMCE_part_number_Read: DcmDspDidIdentifier=807, DcmDspDidInfoRef=DidInfo_DiagnServi_BMCE_part_number_Read  # Diagnostics Data Import
            DcmDspDidSignal: DcmDspDidDataPos=0, DcmDspDidDataRef=Data_DiagnServi_BMCE_part_number_Read  # Diagnostics Data Import
          DID_DiagnServi_Cell_part_number_Read: DcmDspDidIdentifier=806, DcmDspDidInfoRef=DidInfo_DiagnServi_Cell_part_number_Read  # Diagnostics Data Import
            DcmDspDidSignal: DcmDspDidDataPos=0, DcmDspDidDataRef=Data_DiagnServi_Cell_part_number_Read  # Diagnostics Data Import
          DID_DiagnServi_BMC_serial_number_Read: DcmDspDidIdentifier=805, DcmDspDidInfoRef=DidInfo_DiagnServi_BMC_serial_number_Read  # Diagnostics Data Import
            DcmDspDidSignal: DcmDspDidDataPos=0, DcmDspDidDataRef=Data_DiagnServi_BMC_serial_number_Read  # Diagnostics Data Import
          DID_DiagnServi_Module_part_number_Read: DcmDspDidIdentifier=804, DcmDspDidInfoRef=DidInfo_DiagnServi_Module_part_number_Read  # Diagnostics Data Import
            DcmDspDidSignal: DcmDspDidDataPos=0, DcmDspDidDataRef=Data_DiagnServi_Module_part_number_Read  # Diagnostics Data Import
          DID_DiagnServi_SOH_Read: DcmDspDidIdentifier=803, DcmDspDidInfoRef=DidInfo_DiagnServi_SOH_Read  # Diagnostics Data Import
            DcmDspDidSignal: DcmDspDidDataPos=0, DcmDspDidDataRef=Data_DiagnServi_SOH_Read  # Diagnostics Data Import
          DID_TABROW_StatePCM_ReadDataByIdent: DcmDspDidIdentifier=802, DcmDspDidInfoRef=DidInfo_TABROW_StatePCM_ReadDataByIdent  # Diagnostics Data Import
            DcmDspDidSignal: DcmDspDidDataPos=0, DcmDspDidDataRef=Data_TABROW_StatePCM_ReadDataByIdent  # Diagnostics Data Import
          DID_DiagnServi_Type_number_assembly_Read: DcmDspDidIdentifier=801, DcmDspDidInfoRef=DidInfo_DiagnServi_Type_number_assembly_Read  # Diagnostics Data Import
            DcmDspDidSignal: DcmDspDidDataPos=0, DcmDspDidDataRef=Data_DiagnServi_Type_number_assembly_Read  # Diagnostics Data Import
          DID_DiagnServi_Type_number_BCUe_Read: DcmDspDidIdentifier=800, DcmDspDidInfoRef=DidInfo_DiagnServi_Type_number_BCUe_Read  # Diagnostics Data Import
            DcmDspDidSignal: DcmDspDidDataPos=0, DcmDspDidDataRef=Data_DiagnServi_Type_number_BCUe_Read  # Diagnostics Data Import
          DID_DiagnServi_Type_number_BMCE_Read: DcmDspDidIdentifier=799, DcmDspDidInfoRef=DidInfo_DiagnServi_Type_number_BMCE_Read  # Diagnostics Data Import
            DcmDspDidSignal: DcmDspDidDataPos=0, DcmDspDidDataRef=Data_DiagnServi_Type_number_BMCE_Read  # Diagnostics Data Import
          DID_Battery_amount_of_modules_Read_Data_By_Identifier: DcmDspDidIdentifier=796, DcmDspDidInfoRef=DidInfo_Battery_amount_of_modules_Read_Data_By_Identifier  # Diagnostics Data Import
            DcmDspDidSignal: DcmDspDidDataPos=0, DcmDspDidDataRef=Data_Battery_amount_of_modules_Read_Data_By_Identifier  # Diagnostics Data Import
          DID_DiagnServi_Assembly_production_data_Read: DcmDspDidIdentifier=795, DcmDspDidInfoRef=DidInfo_DiagnServi_Assembly_production_data_Read  # Diagnostics Data Import
            DcmDspDidSignal: DcmDspDidDataPos=0, DcmDspDidDataRef=Data_DiagnServi_Assembly_production_data_Read  # Diagnostics Data Import
          DID_State_Of_Charge_Battery_customer_Read_Data_By_Identifier: DcmDspDidIdentifier=793, DcmDspDidInfoRef=DidInfo_State_Of_Charge_Battery_customer_Read_Data_By_Identifier  # Diagnostics Data Import
            DcmDspDidSignal: DcmDspDidDataPos=0, DcmDspDidDataRef=Data_State_Of_Charge_Battery_customer_Read_Data_By_Identifier  # Diagnostics Data Import
          DID_Battery_return_flow_temperature_Read_Data_By_Identifier: DcmDspDidIdentifier=792, DcmDspDidInfoRef=DidInfo_Battery_return_flow_temperature_Read_Data_By_Identifier  # Diagnostics Data Import
            DcmDspDidSignal: DcmDspDidDataPos=0, DcmDspDidDataRef=Data_Battery_return_flow_temperature_Read_Data_By_Identifier  # Diagnostics Data Import
          DID_TABROW_BMCHVKFehleInter_Read_Data_By_Identifier: DcmDspDidIdentifier=790, DcmDspDidInfoRef=DidInfo_TABROW_BMCHVKFehleInter_Read_Data_By_Identifier  # Diagnostics Data Import
            DcmDspDidSignal: DcmDspDidDataPos=0, DcmDspDidDataRef=Data_TABROW_BMCHVKFehleInter_Read_Data_By_Identifier  # Diagnostics Data Import
          DID_HV_battery_performance_indicator_discharging_Read_Data_By_Identifier: DcmDspDidIdentifier=789, DcmDspDidInfoRef=DidInfo_HV_battery_performance_indicator_discharging_Read_Data_By_Identifier  # Diagnostics Data Import
            DcmDspDidSignal: DcmDspDidDataPos=0, DcmDspDidDataRef=Data_HV_battery_performance_indicator_discharging_Read_Data_By_Identifier  # Diagnostics Data Import
          DID_HV_battery_performance_indicator_charging_Read_Data_By_Identifier: DcmDspDidIdentifier=788, DcmDspDidInfoRef=DidInfo_HV_battery_performance_indicator_charging_Read_Data_By_Identifier  # Diagnostics Data Import
            DcmDspDidSignal: DcmDspDidDataPos=0, DcmDspDidDataRef=Data_HV_battery_performance_indicator_charging_Read_Data_By_Identifier  # Diagnostics Data Import
          DID_HV_battery_continuous_discharge_power_Read_Data_By_Identifier: DcmDspDidIdentifier=783, DcmDspDidInfoRef=DidInfo_HV_battery_continuous_discharge_power_Read_Data_By_Identifier  # Diagnostics Data Import
            DcmDspDidSignal: DcmDspDidDataPos=0, DcmDspDidDataRef=Data_HV_battery_continuous_discharge_power_Read_Data_By_Identifier  # Diagnostics Data Import
          DID_HV_Battery_thermal_load_Read_Data_By_Identifier: DcmDspDidIdentifier=782, DcmDspDidInfoRef=DidInfo_HV_Battery_thermal_load_Read_Data_By_Identifier  # Diagnostics Data Import
            DcmDspDidSignal: DcmDspDidDataPos=0, DcmDspDidDataRef=Data_HV_Battery_thermal_load_Read_Data_By_Identifier  # Diagnostics Data Import
          DID_TABROW_BMCHVKFehleHVIL_Read_Data_By_Identifier: DcmDspDidIdentifier=781, DcmDspDidInfoRef=DidInfo_TABROW_BMCHVKFehleHVIL_Read_Data_By_Identifier  # Diagnostics Data Import
            DcmDspDidSignal: DcmDspDidDataPos=0, DcmDspDidDataRef=Data_TABROW_BMCHVKFehleHVIL_Read_Data_By_Identifier  # Diagnostics Data Import
          DID_HV_battery_continuous_charging_power_Read_Data_By_Identifier: DcmDspDidIdentifier=780, DcmDspDidInfoRef=DidInfo_HV_battery_continuous_charging_power_Read_Data_By_Identifier  # Diagnostics Data Import
            DcmDspDidSignal: DcmDspDidDataPos=0, DcmDspDidDataRef=Data_HV_battery_continuous_charging_power_Read_Data_By_Identifier  # Diagnostics Data Import
          DID_Strommesung_Read_Data_By_Identifier: DcmDspDidIdentifier=779, DcmDspDidInfoRef=DidInfo_Strommesung_Read_Data_By_Identifier  # Diagnostics Data Import
            DcmDspDidSignal: DcmDspDidDataPos=0, DcmDspDidDataRef=Data_Strommesung_Read_Data_By_Identifier  # Diagnostics Data Import
          DID_TABROW_HVBatteBackFlowTempeWrite_Read: DcmDspDidIdentifier=768, DcmDspDidInfoRef=DidInfo_TABROW_HVBatteBackFlowTempeWrite_Read  # Diagnostics Data Import
            DcmDspDidSignal: DcmDspDidDataPos=0, DcmDspDidDataRef=Data_TABROW_HVBatteBackFlowTempeWrite_Read  # Diagnostics Data Import
          DID_TABROW_OBDClassDescr_Read_Data_By_Identifier: DcmDspDidIdentifier=719, DcmDspDidInfoRef=DidInfo_TABROW_OBDClassDescr_Read_Data_By_Identifier  # Diagnostics Data Import
            DcmDspDidSignal: DcmDspDidDataPos=0, DcmDspDidDataRef=Data_TABROW_OBDClassDescr_Read_Data_By_Identifier  # Diagnostics Data Import
          DID_TABROW_OBDType_Read: DcmDspDidIdentifier=718, DcmDspDidInfoRef=DidInfo_TABROW_OBDType_Read  # Diagnostics Data Import
            DcmDspDidSignal: DcmDspDidDataPos=0, DcmDspDidDataRef=Data_TABROW_OBDType_Read  # Diagnostics Data Import
          DID_TABROW_KnockTimer_Read: DcmDspDidIdentifier=715, DcmDspDidInfoRef=DidInfo_TABROW_KnockTimer_Read  # Diagnostics Data Import
            DcmDspDidSignal: DcmDspDidDataPos=0, DcmDspDidDataRef=Data_TABROW_KnockTimer_Read  # Diagnostics Data Import
          DID_TABROW_KnockCount_Read: DcmDspDidIdentifier=714, DcmDspDidInfoRef=DidInfo_TABROW_KnockCount_Read  # Diagnostics Data Import
            DcmDspDidSignal: DcmDspDidDataPos=0, DcmDspDidDataRef=Data_TABROW_KnockCount_Read  # Diagnostics Data Import
          DID_TABROW_StandAmbieCondi_ReadDataByIdent: DcmDspDidIdentifier=701, DcmDspDidInfoRef=DidInfo_TABROW_StandAmbieCondi_ReadDataByIdent  # Diagnostics Data Import
            DcmDspDidSignal: DcmDspDidDataPos=0, DcmDspDidDataRef=Data_TABROW_StandAmbieCondi_ReadDataByIdent  # Diagnostics Data Import
          DID_DiagnServi_TABROW_TABRORespo_Read_Data_By_Identifier: DcmDspDidIdentifier=691, DcmDspDidInfoRef=DidInfo_DiagnServi_TABROW_TABRORespo_Read_Data_By_Identifier  # Diagnostics Data Import
            DcmDspDidSignal: DcmDspDidDataPos=0, DcmDspDidDataRef=Data_DiagnServi_TABROW_TABRORespo_Read_Data_By_Identifier  # Diagnostics Data Import
          DID_DiagnServi_TABROW_NeuMeasu_Read_51: DcmDspDidIdentifier=646, DcmDspDidInfoRef=DidInfo_DiagnServi_TABROW_NeuMeasu_Read_51  # Diagnostics Data Import
            DcmDspDidSignal: DcmDspDidDataPos=0, DcmDspDidDataRef=Data_DiagnServi_TABROW_NeuMeasu_Read_51  # Diagnostics Data Import
          DID_DiagnServi_TABROW_TABROOBDDr_Read_Data_By_Identifier: DcmDspDidIdentifier=609, DcmDspDidInfoRef=DidInfo_DiagnServi_TABROW_TABROOBDDr_Read_Data_By_Identifier  # Diagnostics Data Import
            DcmDspDidSignal: DcmDspDidDataPos=0, DcmDspDidDataRef=Data_DiagnServi_TABROW_TABROOBDDr_Read_Data_By_Identifier  # Diagnostics Data Import
          DID_DiagnServi_TABROW_IntegValidDataConfiList_Read: DcmDspDidIdentifier=592, DcmDspDidInfoRef=DidInfo_DiagnServi_TABROW_IntegValidDataConfiList_Read  # Diagnostics Data Import
            DcmDspDidSignal: DcmDspDidDataPos=0, DcmDspDidDataRef=Data_DiagnServi_TABROW_IntegValidDataConfiList_Read  # Diagnostics Data Import
          DID_TABROW_ProgrHash_Read: DcmDspDidIdentifier=585, DcmDspDidInfoRef=DidInfo_TABROW_ProgrHash_Read  # Diagnostics Data Import
            DcmDspDidSignal: DcmDspDidDataPos=0, DcmDspDidDataRef=Data_TABROW_ProgrHash_Read  # Diagnostics Data Import
          DID_TABROW_ConfiHash_Read: DcmDspDidIdentifier=581, DcmDspDidInfoRef=DidInfo_TABROW_ConfiHash_Read  # Diagnostics Data Import
            DcmDspDidSignal: DcmDspDidDataPos=0, DcmDspDidDataRef=Data_TABROW_ConfiHash_Read  # Diagnostics Data Import
          DID_TABROW_StatuProdu_Read_Data_By_Identifier: DcmDspDidIdentifier=412, DcmDspDidInfoRef=DidInfo_TABROW_StatuProdu_Read_Data_By_Identifier  # Diagnostics Data Import
            DcmDspDidSignal: DcmDspDidDataPos=0, DcmDspDidDataRef=Data_TABROW_StatuProdu_Read_Data_By_Identifier  # Diagnostics Data Import
          DID_TABROW_SOKMissiKeyList_Read_Data_By_Identifier: DcmDspDidIdentifier=404, DcmDspDidInfoRef=DidInfo_TABROW_SOKMissiKeyList_Read_Data_By_Identifier  # Diagnostics Data Import
            DcmDspDidSignal: DcmDspDidDataPos=0, DcmDspDidDataRef=Data_TABROW_SOKMissiKeyList_Read_Data_By_Identifier  # Diagnostics Data Import
          DID_TABROW_SOKFreshInfor_Read_Data_By_Identifier: DcmDspDidIdentifier=402, DcmDspDidInfoRef=DidInfo_TABROW_SOKFreshInfor_Read_Data_By_Identifier  # Diagnostics Data Import
            DcmDspDidSignal: DcmDspDidDataPos=0, DcmDspDidDataRef=Data_TABROW_SOKFreshInfor_Read_Data_By_Identifier  # Diagnostics Data Import
          DID_TABROW_SOKTimeInfor_Read_Data_By_Identifier: DcmDspDidIdentifier=401, DcmDspDidInfoRef=DidInfo_TABROW_SOKTimeInfor_Read_Data_By_Identifier  # Diagnostics Data Import
            DcmDspDidSignal: DcmDspDidDataPos=0, DcmDspDidDataRef=Data_TABROW_SOKTimeInfor_Read_Data_By_Identifier  # Diagnostics Data Import
          DID_TABROW_SOKGenerInfor_Read_Data_By_Identifier: DcmDspDidIdentifier=400, DcmDspDidInfoRef=DidInfo_TABROW_SOKGenerInfor_Read_Data_By_Identifier  # Diagnostics Data Import
            DcmDspDidSignal: DcmDspDidDataPos=0, DcmDspDidDataRef=Data_TABROW_SOKGenerInfor_Read_Data_By_Identifier  # Diagnostics Data Import
          DID_TABROW_SOKSignaFaileList_Read_Data_By_Identifier: DcmDspDidIdentifier=399, DcmDspDidInfoRef=DidInfo_TABROW_SOKSignaFaileList_Read_Data_By_Identifier  # Diagnostics Data Import
            DcmDspDidSignal: DcmDspDidDataPos=0, DcmDspDidDataRef=Data_TABROW_SOKSignaFaileList_Read_Data_By_Identifier  # Diagnostics Data Import
          DID_TABROW_SOKVerifFaileList_Read_Data_By_Identifier: DcmDspDidIdentifier=395, DcmDspDidInfoRef=DidInfo_TABROW_SOKVerifFaileList_Read_Data_By_Identifier  # Diagnostics Data Import
            DcmDspDidSignal: DcmDspDidDataPos=0, DcmDspDidDataRef=Data_TABROW_SOKVerifFaileList_Read_Data_By_Identifier  # Diagnostics Data Import
          DID_TABROW_InUseMonitPerfoRatio_Read_Data_By_Identifier: DcmDspDidIdentifier=394, DcmDspDidInfoRef=DidInfo_TABROW_InUseMonitPerfoRatio_Read_Data_By_Identifier  # Diagnostics Data Import
            DcmDspDidSignal: DcmDspDidDataPos=0, DcmDspDidDataRef=Data_TABROW_InUseMonitPerfoRatio_Read_Data_By_Identifier  # Diagnostics Data Import
          DID_DiagnServi_ReadDataByIdentVWLogicBlockDowngProteVersi: DcmDspDidIdentifier=393, DcmDspDidInfoRef=DidInfo_DiagnServi_ReadDataByIdentVWLogicBlockDowngProteVersi  # Diagnostics Data Import
            DcmDspDidSignal: DcmDspDidDataPos=0, DcmDspDidDataRef=Data_DiagnServi_ReadDataByIdentVWLogicBlockDowngProteVersi  # Diagnostics Data Import
          DID_DiagnServi_TABROW_UnlocStatuOfECUOfProteOfVehicDiagn_Read: DcmDspDidIdentifier=372, DcmDspDidInfoRef=DidInfo_DiagnServi_TABROW_UnlocStatuOfECUOfProteOfVehicDiagn_Read  # Diagnostics Data Import
            DcmDspDidSignal: DcmDspDidDataPos=0, DcmDspDidDataRef=Data_DiagnServi_TABROW_UnlocStatuOfECUOfProteOfVehicDiagn_Read  # Diagnostics Data Import
          DID_DiagnServi_ReadDataByIdentBasicSettiStatu: DcmDspDidIdentifier=258, DcmDspDidInfoRef=DidInfo_DiagnServi_ReadDataByIdentBasicSettiStatu  # Diagnostics Data Import
            DcmDspDidSignal: DcmDspDidDataPos=0, DcmDspDidDataRef=Data_DiagnServi_ReadDataByIdentBasicSettiStatu  # Diagnostics Data Import
        DataInfo_DiagnServi_TABROW_NeuCalibData_Read (DcmDspDataInfo): DcmDspDataFixedLength=true  # Diagnostics Data Import
        Data_DiagnServi_TABROW_NeuCalibData_Read (DcmDspData): DcmDspDataSize=8, DcmDspDataType=UINT8_N, DcmDspDataInfoRef=DataInfo_DiagnServi_TABROW_NeuCalibData_Read  # Diagnostics Data Import
        DataInfo_DiagnServi_TABROW_ECUNA_Read (DcmDspDataInfo): DcmDspDataFixedLength=true  # Diagnostics Data Import
        Data_DiagnServi_TABROW_ECUNA_Read (DcmDspData): DcmDspDataSize=160, DcmDspDataType=UINT8_N, DcmDspDataInfoRef=DataInfo_DiagnServi_TABROW_ECUNA_Read  # Diagnostics Data Import
        DataInfo_DiagnServi_TABROW_CalibIdent_Read (DcmDspDataInfo)  # Diagnostics Data Import
        Data_DiagnServi_TABROW_CalibIdent_Read (DcmDspData): DcmDspDataType=UINT8_N, DcmDspDataInfoRef=DataInfo_DiagnServi_TABROW_CalibIdent_Read  # Diagnostics Data Import
        DataInfo_DiagnServi_TABROW_AccelPedalPositD_Read (DcmDspDataInfo): DcmDspDataFixedLength=true  # Diagnostics Data Import
        Data_DiagnServi_TABROW_AccelPedalPositD_Read (DcmDspData): DcmDspDataSize=8, DcmDspDataType=UINT8_N, DcmDspDataInfoRef=DataInfo_DiagnServi_TABROW_AccelPedalPositD_Read  # Diagnostics Data Import
        DataInfo_DiagnServi_TABROW_ContrModulVolta_Read (DcmDspDataInfo): DcmDspDataFixedLength=true  # Diagnostics Data Import
        Data_DiagnServi_TABROW_ContrModulVolta_Read (DcmDspData): DcmDspDataSize=16, DcmDspDataType=UINT8_N, DcmDspDataInfoRef=DataInfo_DiagnServi_TABROW_ContrModulVolta_Read  # Diagnostics Data Import
        DataInfo_DiagnServi_TABROW_MonitStatuThisDriviCycle_Read (DcmDspDataInfo): DcmDspDataFixedLength=true  # Diagnostics Data Import
        Data_DiagnServi_TABROW_MonitStatuThisDriviCycle_Read (DcmDspData): DcmDspDataSize=32, DcmDspDataType=UINT8_N, DcmDspDataInfoRef=DataInfo_DiagnServi_TABROW_MonitStatuThisDriviCycle_Read  # Diagnostics Data Import
        DataInfo_DiagnServi_TABROW_TimeSinceEnginStart_Read (DcmDspDataInfo): DcmDspDataFixedLength=true  # Diagnostics Data Import
        Data_DiagnServi_TABROW_TimeSinceEnginStart_Read (DcmDspData): DcmDspDataSize=16, DcmDspDataType=UINT8_N, DcmDspDataInfoRef=DataInfo_DiagnServi_TABROW_TimeSinceEnginStart_Read  # Diagnostics Data Import
        DataInfo_DiagnServi_TABROW_VehicSpeedSenso_Read (DcmDspDataInfo): DcmDspDataFixedLength=true  # Diagnostics Data Import
        Data_DiagnServi_TABROW_VehicSpeedSenso_Read (DcmDspData): DcmDspDataSize=8, DcmDspDataType=UINT8_N, DcmDspDataInfoRef=DataInfo_DiagnServi_TABROW_VehicSpeedSenso_Read  # Diagnostics Data Import
        DataInfo_DiagnServi_TABROW_EnginRPM_Read (DcmDspDataInfo): DcmDspDataFixedLength=true  # Diagnostics Data Import
        Data_DiagnServi_TABROW_EnginRPM_Read (DcmDspData): DcmDspDataSize=16, DcmDspDataType=UINT8_N, DcmDspDataInfoRef=DataInfo_DiagnServi_TABROW_EnginRPM_Read  # Diagnostics Data Import
        DataInfo_DiagnServi_TABROW_EnginCoolaTempe_Read (DcmDspDataInfo): DcmDspDataFixedLength=true  # Diagnostics Data Import
        Data_DiagnServi_TABROW_EnginCoolaTempe_Read (DcmDspData): DcmDspDataSize=8, DcmDspDataType=UINT8_N, DcmDspDataInfoRef=DataInfo_DiagnServi_TABROW_EnginCoolaTempe_Read  # Diagnostics Data Import
        DataInfo_DiagnServi_TABROW_CalcuLOADValue_Read (DcmDspDataInfo): DcmDspDataFixedLength=true  # Diagnostics Data Import
        Data_DiagnServi_TABROW_CalcuLOADValue_Read (DcmDspData): DcmDspDataSize=8, DcmDspDataType=UINT8_N, DcmDspDataInfoRef=DataInfo_DiagnServi_TABROW_CalcuLOADValue_Read  # Diagnostics Data Import
        DataInfo_DiagnServi_TABROW_MonitStatuSinceDTCsClear_Read (DcmDspDataInfo): DcmDspDataFixedLength=true  # Diagnostics Data Import
        Data_DiagnServi_TABROW_MonitStatuSinceDTCsClear_Read (DcmDspData): DcmDspDataSize=32, DcmDspDataType=UINT8_N, DcmDspDataInfoRef=DataInfo_DiagnServi_TABROW_MonitStatuSinceDTCsClear_Read  # Diagnostics Data Import
        DataInfo_TABROW_VishnDID_Read (DcmDspDataInfo): DcmDspDataFixedLength=true  # Diagnostics Data Import
        Data_TABROW_VishnDID_Read (DcmDspData): DcmDspDataSize=800, DcmDspDataType=UINT8_N, DcmDspDataInfoRef=DataInfo_TABROW_VishnDID_Read  # Diagnostics Data Import
        DataInfo_DiagnServi_TABROW_NeuMeasu_Read_14 (DcmDspDataInfo): DcmDspDataFixedLength=true  # Diagnostics Data Import
        Data_DiagnServi_TABROW_NeuMeasu_Read_14 (DcmDspData): DcmDspDataSize=8, DcmDspDataType=UINT8_N, DcmDspDataInfoRef=DataInfo_DiagnServi_TABROW_NeuMeasu_Read_14  # Diagnostics Data Import
        DataInfo_TABROW_CanTPData_Read (DcmDspDataInfo): DcmDspDataFixedLength=true  # Diagnostics Data Import
        Data_TABROW_CanTPData_Read (DcmDspData): DcmDspDataSize=1200, DcmDspDataType=UINT8_N, DcmDspDataInfoRef=DataInfo_TABROW_CanTPData_Read  # Diagnostics Data Import
        DataInfo_TABROW_PIMDID_Read (DcmDspDataInfo): DcmDspDataFixedLength=true  # Diagnostics Data Import
        Data_TABROW_PIMDID_Read (DcmDspData): DcmDspDataSize=80, DcmDspDataType=UINT8_N, DcmDspDataInfoRef=DataInfo_TABROW_PIMDID_Read  # Diagnostics Data Import
        DataInfo_TABROW_DCMCALLODID_Read (DcmDspDataInfo): DcmDspDataFixedLength=true  # Diagnostics Data Import
        Data_TABROW_DCMCALLODID_Read (DcmDspData): DcmDspDataSize=40, DcmDspDataType=UINT8_N, DcmDspDataInfoRef=DataInfo_TABROW_DCMCALLODID_Read  # Diagnostics Data Import
        DataInfo_DiagnServi_TABROW_TABROECUPr_Read (DcmDspDataInfo): DcmDspDataFixedLength=true  # Diagnostics Data Import
        Data_DiagnServi_TABROW_TABROECUPr_Read (DcmDspData): DcmDspDataSize=8, DcmDspDataType=UINT8_N, DcmDspDataInfoRef=DataInfo_DiagnServi_TABROW_TABROECUPr_Read  # Diagnostics Data Import
        DataInfo_DiagnServi_TABROW_TABROFDSPr_Read (DcmDspDataInfo): DcmDspDataFixedLength=false  # Diagnostics Data Import
        Data_DiagnServi_TABROW_TABROFDSPr_Read (DcmDspData): DcmDspDataSize=4136, DcmDspDataType=UINT8_N, DcmDspDataInfoRef=DataInfo_DiagnServi_TABROW_TABROFDSPr_Read  # Diagnostics Data Import
        DataInfo_TABROW_SysteIdent_Read (DcmDspDataInfo): DcmDspDataFixedLength=true  # Diagnostics Data Import
        Data_TABROW_SysteIdent_Read (DcmDspData): DcmDspDataSize=32, DcmDspDataType=UINT8_N, DcmDspDataInfoRef=DataInfo_TABROW_SysteIdent_Read  # Diagnostics Data Import
        DataInfo_DiagnServi_TABROW_TechnSpeciVersi_Read (DcmDspDataInfo): DcmDspDataFixedLength=true  # Diagnostics Data Import
        Data_DiagnServi_TABROW_TechnSpeciVersi_Read (DcmDspData): DcmDspDataSize=208, DcmDspDataType=UINT8_N, DcmDspDataInfoRef=DataInfo_DiagnServi_TABROW_TechnSpeciVersi_Read  # Diagnostics Data Import
        DataInfo_DiagnServi_TABROW_VWDataSetName_Read (DcmDspDataInfo)  # Diagnostics Data Import
        Data_DiagnServi_TABROW_VWDataSetName_Read (DcmDspData): DcmDspDataType=UINT8_N, DcmDspDataInfoRef=DataInfo_DiagnServi_TABROW_VWDataSetName_Read  # Diagnostics Data Import
        DataInfo_DiagnServi_TABROW_VWAppliDataSetIdent_Read (DcmDspDataInfo)  # Diagnostics Data Import
        Data_DiagnServi_TABROW_VWAppliDataSetIdent_Read (DcmDspData): DcmDspDataType=UINT8_N, DcmDspDataInfoRef=DataInfo_DiagnServi_TABROW_VWAppliDataSetIdent_Read  # Diagnostics Data Import
        DataInfo_DiagnServi_TABROW_AUTOSStandAppliSoftwIdent_Read (DcmDspDataInfo)  # Diagnostics Data Import
        Data_DiagnServi_TABROW_AUTOSStandAppliSoftwIdent_Read (DcmDspData): DcmDspDataType=UINT8_N, DcmDspDataInfoRef=DataInfo_DiagnServi_TABROW_AUTOSStandAppliSoftwIdent_Read  # Diagnostics Data Import
        DataInfo_DiagnServi_ReadDataByIdentVWLogicSoftwBlockVersi (DcmDspDataInfo): DcmDspDataFixedLength=true  # Diagnostics Data Import
        Data_DiagnServi_ReadDataByIdentVWLogicSoftwBlockVersi (DcmDspData): DcmDspDataSize=192, DcmDspDataType=UINT8_N, DcmDspDataInfoRef=DataInfo_DiagnServi_ReadDataByIdentVWLogicSoftwBlockVersi  # Diagnostics Data Import
        DataInfo_TABROW_VWWorksSysteName_Read (DcmDspDataInfo): DcmDspDataFixedLength=true  # Diagnostics Data Import
        Data_TABROW_VWWorksSysteName_Read (DcmDspData): DcmDspDataSize=40, DcmDspDataType=UINT8_N, DcmDspDataInfoRef=DataInfo_TABROW_VWWorksSysteName_Read  # Diagnostics Data Import
        DataInfo_TABROW_VWECUHardwVersiNumbe_Read (DcmDspDataInfo): DcmDspDataFixedLength=true  # Diagnostics Data Import
        Data_TABROW_VWECUHardwVersiNumbe_Read (DcmDspData): DcmDspDataSize=24, DcmDspDataType=UINT8_N, DcmDspDataInfoRef=DataInfo_TABROW_VWECUHardwVersiNumbe_Read  # Diagnostics Data Import
        DataInfo_DiagnServi_ReadDataByIdentASAMODXFileVersi (DcmDspDataInfo): DcmDspDataFixedLength=true  # Diagnostics Data Import
        Data_DiagnServi_ReadDataByIdentASAMODXFileVersi (DcmDspData): DcmDspDataSize=48, DcmDspDataType=UINT8_N, DcmDspDataInfoRef=DataInfo_DiagnServi_ReadDataByIdentASAMODXFileVersi  # Diagnostics Data Import
        DataInfo_TABROW_TABROVWDat_Read_1 (DcmDspDataInfo): DcmDspDataFixedLength=true  # Diagnostics Data Import
        Data_TABROW_TABROVWDat_Read_1 (DcmDspData): DcmDspDataSize=32, DcmDspDataType=UINT8_N, DcmDspDataInfoRef=DataInfo_TABROW_TABROVWDat_Read_1  # Diagnostics Data Import
        DataInfo_DiagnServi_TABROW_VWDataSetNumbeOrECUDataContaNumbe_Read (DcmDspDataInfo): DcmDspDataFixedLength=true  # Diagnostics Data Import
        Data_DiagnServi_TABROW_VWDataSetNumbeOrECUDataContaNumbe_Read (DcmDspData): DcmDspDataSize=88, DcmDspDataType=UINT8_N, DcmDspDataInfoRef=DataInfo_DiagnServi_TABROW_VWDataSetNumbeOrECUDataContaNumbe_Read  # Diagnostics Data Import
        DataInfo_DiagnServi_ReadDataByIdentASAMODXFileIdent (DcmDspDataInfo): DcmDspDataFixedLength=false  # Diagnostics Data Import
        Data_DiagnServi_ReadDataByIdentASAMODXFileIdent (DcmDspData): DcmDspDataSize=200, DcmDspDataType=UINT8_N, DcmDspDataInfoRef=DataInfo_DiagnServi_ReadDataByIdentASAMODXFileIdent  # Diagnostics Data Import
        DataInfo_TABROW_VWSysteNameOrEnginType_Read (DcmDspDataInfo): DcmDspDataFixedLength=true  # Diagnostics Data Import
        Data_TABROW_VWSysteNameOrEnginType_Read (DcmDspData): DcmDspDataSize=104, DcmDspDataType=UINT8_N, DcmDspDataInfoRef=DataInfo_TABROW_VWSysteNameOrEnginType_Read  # Diagnostics Data Import
        DataInfo_TABROW_TABROSyste_Read_4 (DcmDspDataInfo): DcmDspDataFixedLength=true  # Diagnostics Data Import
        Data_TABROW_TABROSyste_Read_4 (DcmDspData): DcmDspDataSize=88, DcmDspDataType=UINT8_N, DcmDspDataInfoRef=DataInfo_TABROW_TABROSyste_Read_4  # Diagnostics Data Import
        DataInfo_TABROW_TABROSyste_Read_3 (DcmDspDataInfo): DcmDspDataFixedLength=true  # Diagnostics Data Import
        Data_TABROW_TABROSyste_Read_3 (DcmDspData): DcmDspDataSize=88, DcmDspDataType=UINT8_N, DcmDspDataInfoRef=DataInfo_TABROW_TABROSyste_Read_3  # Diagnostics Data Import
        DataInfo_TABROW_TABROSyste_Read_2 (DcmDspDataInfo): DcmDspDataFixedLength=true  # Diagnostics Data Import
        Data_TABROW_TABROSyste_Read_2 (DcmDspData): DcmDspDataSize=88, DcmDspDataType=UINT8_N, DcmDspDataInfoRef=DataInfo_TABROW_TABROSyste_Read_2  # Diagnostics Data Import
        DataInfo_TABROW_TABROSyste_Read_1 (DcmDspDataInfo): DcmDspDataFixedLength=true  # Diagnostics Data Import
        Data_TABROW_TABROSyste_Read_1 (DcmDspData): DcmDspDataSize=88, DcmDspDataType=UINT8_N, DcmDspDataInfoRef=DataInfo_TABROW_TABROSyste_Read_1  # Diagnostics Data Import
        DataInfo_TABROW_VWECUHardwNumbe_Read (DcmDspDataInfo): DcmDspDataFixedLength=true  # Diagnostics Data Import
        Data_TABROW_VWECUHardwNumbe_Read (DcmDspData): DcmDspDataSize=88, DcmDspDataType=UINT8_N, DcmDspDataInfoRef=DataInfo_TABROW_VWECUHardwNumbe_Read  # Diagnostics Data Import
        DataInfo_TABROW_VehicIdentNumbe_Read (DcmDspDataInfo): DcmDspDataFixedLength=true  # Diagnostics Data Import
        Data_TABROW_VehicIdentNumbe_Read (DcmDspData): DcmDspDataSize=136, DcmDspDataType=UINT8_N, DcmDspDataInfoRef=DataInfo_TABROW_VehicIdentNumbe_Read  # Diagnostics Data Import
        DataInfo_TABROW_RegulXSoftwIdentNumbe_Read (DcmDspDataInfo): DcmDspDataFixedLength=true  # Diagnostics Data Import
        Data_TABROW_RegulXSoftwIdentNumbe_Read (DcmDspData): DcmDspDataSize=400, DcmDspDataType=UINT8_N, DcmDspDataInfoRef=DataInfo_TABROW_RegulXSoftwIdentNumbe_Read  # Diagnostics Data Import
        DataInfo_DiagnServi_TABROW_ECUSeriaNumbe_Read (DcmDspDataInfo): DcmDspDataFixedLength=true  # Diagnostics Data Import
        Data_DiagnServi_TABROW_ECUSeriaNumbe_Read (DcmDspData): DcmDspDataSize=160, DcmDspDataType=UINT8_N, DcmDspDataInfoRef=DataInfo_DiagnServi_TABROW_ECUSeriaNumbe_Read  # Diagnostics Data Import
        DataInfo_DiagnServi_TABROW_SysteSupplIdent_Read (DcmDspDataInfo): DcmDspDataFixedLength=false  # Diagnostics Data Import
        Data_DiagnServi_TABROW_SysteSupplIdent_Read (DcmDspData): DcmDspDataSize=524280, DcmDspDataType=UINT8_N, DcmDspDataInfoRef=DataInfo_DiagnServi_TABROW_SysteSupplIdent_Read  # Diagnostics Data Import
        DataInfo_DiagnServi_TABROW_VWAppliSoftwVersiNumbe_Read (DcmDspDataInfo): DcmDspDataFixedLength=true  # Diagnostics Data Import
        Data_DiagnServi_TABROW_VWAppliSoftwVersiNumbe_Read (DcmDspData): DcmDspDataSize=32, DcmDspDataType=UINT8_N, DcmDspDataInfoRef=DataInfo_DiagnServi_TABROW_VWAppliSoftwVersiNumbe_Read  # Diagnostics Data Import
        DataInfo_DiagnServi_TABROW_VWSparePartNumbe_Read (DcmDspDataInfo): DcmDspDataFixedLength=true  # Diagnostics Data Import
        Data_DiagnServi_TABROW_VWSparePartNumbe_Read (DcmDspData): DcmDspDataSize=88, DcmDspDataType=UINT8_N, DcmDspDataInfoRef=DataInfo_DiagnServi_TABROW_VWSparePartNumbe_Read  # Diagnostics Data Import
        DataInfo_DiagnServi_TABROW_ActivDiagnSessi_Read (DcmDspDataInfo): DcmDspDataFixedLength=true  # Diagnostics Data Import
        Data_DiagnServi_TABROW_ActivDiagnSessi_Read (DcmDspData): DcmDspDataSize=8, DcmDspDataType=UINT8_N, DcmDspDataInfoRef=DataInfo_DiagnServi_TABROW_ActivDiagnSessi_Read  # Diagnostics Data Import
        DataInfo_DiagnServi_TABROW_VWFAZITIdentStrin_Read (DcmDspDataInfo): DcmDspDataFixedLength=true  # Diagnostics Data Import
        Data_DiagnServi_TABROW_VWFAZITIdentStrin_Read (DcmDspData): DcmDspDataSize=184, DcmDspDataType=UINT8_N, DcmDspDataInfoRef=DataInfo_DiagnServi_TABROW_VWFAZITIdentStrin_Read  # Diagnostics Data Import
        DataInfo_TABROW_FingeAndProgrDateOfLogicSoftwBlock_Read (DcmDspDataInfo)  # Diagnostics Data Import
        Data_TABROW_FingeAndProgrDateOfLogicSoftwBlock_Read (DcmDspData): DcmDspDataType=UINT8_N, DcmDspDataInfoRef=DataInfo_TABROW_FingeAndProgrDateOfLogicSoftwBlock_Read  # Diagnostics Data Import
        DataInfo_DiagnServi_TABROW_Finge_Read (DcmDspDataInfo): DcmDspDataFixedLength=true  # Diagnostics Data Import
        Data_DiagnServi_TABROW_Finge_Read (DcmDspData): DcmDspDataSize=72, DcmDspDataType=UINT8_N, DcmDspDataInfoRef=DataInfo_DiagnServi_TABROW_Finge_Read  # Diagnostics Data Import
        DataInfo_DiagnServi_TABROW_NeuMeasu_Read_57_2_1 (DcmDspDataInfo): DcmDspDataFixedLength=true  # Diagnostics Data Import
        Data_DiagnServi_TABROW_NeuMeasu_Read_57_2_1 (DcmDspData): DcmDspDataSize=24, DcmDspDataType=UINT8_N, DcmDspDataInfoRef=DataInfo_DiagnServi_TABROW_NeuMeasu_Read_57_2_1  # Diagnostics Data Import
        DataInfo_DiagnServi_TABROW_NeuMeasu_Read_57_13 (DcmDspDataInfo): DcmDspDataFixedLength=true  # Diagnostics Data Import
        Data_DiagnServi_TABROW_NeuMeasu_Read_57_13 (DcmDspData): DcmDspDataSize=24, DcmDspDataType=UINT8_N, DcmDspDataInfoRef=DataInfo_DiagnServi_TABROW_NeuMeasu_Read_57_13  # Diagnostics Data Import
        DataInfo_TABROW_TABROSyste_Read_1_1_1_1_1_1_1_1_1_1_1_1_1_1_1 (DcmDspDataInfo): DcmDspDataFixedLength=true  # Diagnostics Data Import
        Data_TABROW_TABROSyste_Read_1_1_1_1_1_1_1_1_1_1_1_1_1_1_1 (DcmDspData): DcmDspDataSize=192, DcmDspDataType=UINT8_N, DcmDspDataInfoRef=DataInfo_TABROW_TABROSyste_Read_1_1_1_1_1_1_1_1_1_1_1_1_1_1_1  # Diagnostics Data Import
        DataInfo_TABROW_TABROSyste_Read_1_1_1_1_1_1_1_1_1_1_1_1_1 (DcmDspDataInfo): DcmDspDataFixedLength=true  # Diagnostics Data Import
        Data_TABROW_TABROSyste_Read_1_1_1_1_1_1_1_1_1_1_1_1_1 (DcmDspData): DcmDspDataSize=112, DcmDspDataType=UINT8_N, DcmDspDataInfoRef=DataInfo_TABROW_TABROSyste_Read_1_1_1_1_1_1_1_1_1_1_1_1_1  # Diagnostics Data Import
        DataInfo_TABROW_TABROSyste_Read_1_1_1_1_1_1_1_1_1_1_1_1 (DcmDspDataInfo): DcmDspDataFixedLength=true  # Diagnostics Data Import
        Data_TABROW_TABROSyste_Read_1_1_1_1_1_1_1_1_1_1_1_1 (DcmDspData): DcmDspDataSize=112, DcmDspDataType=UINT8_N, DcmDspDataInfoRef=DataInfo_TABROW_TABROSyste_Read_1_1_1_1_1_1_1_1_1_1_1_1  # Diagnostics Data Import
        DataInfo_TABROW_TABROSyste_Read_1_1_1_1_1_1_1_1_1_1_1 (DcmDspDataInfo): DcmDspDataFixedLength=true  # Diagnostics Data Import
        Data_TABROW_TABROSyste_Read_1_1_1_1_1_1_1_1_1_1_1 (DcmDspData): DcmDspDataSize=112, DcmDspDataType=UINT8_N, DcmDspDataInfoRef=DataInfo_TABROW_TABROSyste_Read_1_1_1_1_1_1_1_1_1_1_1  # Diagnostics Data Import
        DataInfo_TABROW_TABROSyste_Read_1_1_1_1_1_1_1_1_1_1 (DcmDspDataInfo): DcmDspDataFixedLength=true  # Diagnostics Data Import
        Data_TABROW_TABROSyste_Read_1_1_1_1_1_1_1_1_1_1 (DcmDspData): DcmDspDataSize=112, DcmDspDataType=UINT8_N, DcmDspDataInfoRef=DataInfo_TABROW_TABROSyste_Read_1_1_1_1_1_1_1_1_1_1  # Diagnostics Data Import
        DataInfo_TABROW_TABROSyste_Read_1_1_1_1_1_1_1_1_1 (DcmDspDataInfo): DcmDspDataFixedLength=true  # Diagnostics Data Import
        Data_TABROW_TABROSyste_Read_1_1_1_1_1_1_1_1_1 (DcmDspData): DcmDspDataSize=72, DcmDspDataType=UINT8_N, DcmDspDataInfoRef=DataInfo_TABROW_TABROSyste_Read_1_1_1_1_1_1_1_1_1  # Diagnostics Data Import
        DataInfo_TABROW_TABROSyste_Read_1_1_1_1_1_1_1_1 (DcmDspDataInfo): DcmDspDataFixedLength=true  # Diagnostics Data Import
        Data_TABROW_TABROSyste_Read_1_1_1_1_1_1_1_1 (DcmDspData): DcmDspDataSize=72, DcmDspDataType=UINT8_N, DcmDspDataInfoRef=DataInfo_TABROW_TABROSyste_Read_1_1_1_1_1_1_1_1  # Diagnostics Data Import
        DataInfo_TABROW_TABROSyste_Read_1_1_1_1_1_1_1 (DcmDspDataInfo): DcmDspDataFixedLength=true  # Diagnostics Data Import
        Data_TABROW_TABROSyste_Read_1_1_1_1_1_1_1 (DcmDspData): DcmDspDataSize=72, DcmDspDataType=UINT8_N, DcmDspDataInfoRef=DataInfo_TABROW_TABROSyste_Read_1_1_1_1_1_1_1  # Diagnostics Data Import
        DataInfo_TABROW_TABROSyste_Read_1_1_1_1_1_1 (DcmDspDataInfo): DcmDspDataFixedLength=true  # Diagnostics Data Import
        Data_TABROW_TABROSyste_Read_1_1_1_1_1_1 (DcmDspData): DcmDspDataSize=72, DcmDspDataType=UINT8_N, DcmDspDataInfoRef=DataInfo_TABROW_TABROSyste_Read_1_1_1_1_1_1  # Diagnostics Data Import
        DataInfo_TABROW_TABROSyste_Read_1_1_1_1_1 (DcmDspDataInfo): DcmDspDataFixedLength=true  # Diagnostics Data Import
        Data_TABROW_TABROSyste_Read_1_1_1_1_1 (DcmDspData): DcmDspDataSize=112, DcmDspDataType=UINT8_N, DcmDspDataInfoRef=DataInfo_TABROW_TABROSyste_Read_1_1_1_1_1  # Diagnostics Data Import
        DataInfo_TABROW_TABROSyste_Read_1_1_1_1 (DcmDspDataInfo): DcmDspDataFixedLength=true  # Diagnostics Data Import
        Data_TABROW_TABROSyste_Read_1_1_1_1 (DcmDspData): DcmDspDataSize=112, DcmDspDataType=UINT8_N, DcmDspDataInfoRef=DataInfo_TABROW_TABROSyste_Read_1_1_1_1  # Diagnostics Data Import
        DataInfo_TABROW_TABROSyste_Read_1_1_1 (DcmDspDataInfo): DcmDspDataFixedLength=true  # Diagnostics Data Import
        Data_TABROW_TABROSyste_Read_1_1_1 (DcmDspData): DcmDspDataSize=72, DcmDspDataType=UINT8_N, DcmDspDataInfoRef=DataInfo_TABROW_TABROSyste_Read_1_1_1  # Diagnostics Data Import
        DataInfo_TABROW_TABROSyste_Read_1_1 (DcmDspDataInfo): DcmDspDataFixedLength=true  # Diagnostics Data Import
        Data_TABROW_TABROSyste_Read_1_1 (DcmDspData): DcmDspDataSize=72, DcmDspDataType=UINT8_N, DcmDspDataInfoRef=DataInfo_TABROW_TABROSyste_Read_1_1  # Diagnostics Data Import
        DataInfo_DiagnServi_TABROW_NeuMeasu_Read_29_1_1_1_1_1_1_1 (DcmDspDataInfo): DcmDspDataFixedLength=true  # Diagnostics Data Import
        Data_DiagnServi_TABROW_NeuMeasu_Read_29_1_1_1_1_1_1_1 (DcmDspData): DcmDspDataSize=32, DcmDspDataType=UINT8_N, DcmDspDataInfoRef=DataInfo_DiagnServi_TABROW_NeuMeasu_Read_29_1_1_1_1_1_1_1  # Diagnostics Data Import
        DataInfo_DiagnServi_TABROW_NeuMeasu_Read_29_1_1_1_1_1_1 (DcmDspDataInfo): DcmDspDataFixedLength=true  # Diagnostics Data Import
        Data_DiagnServi_TABROW_NeuMeasu_Read_29_1_1_1_1_1_1 (DcmDspData): DcmDspDataSize=32, DcmDspDataType=UINT8_N, DcmDspDataInfoRef=DataInfo_DiagnServi_TABROW_NeuMeasu_Read_29_1_1_1_1_1_1  # Diagnostics Data Import
        DataInfo_DiagnServi_TABROW_NeuMeasu_Read_29_1_1_1_1_1 (DcmDspDataInfo): DcmDspDataFixedLength=true  # Diagnostics Data Import
        Data_DiagnServi_TABROW_NeuMeasu_Read_29_1_1_1_1_1 (DcmDspData): DcmDspDataSize=32, DcmDspDataType=UINT8_N, DcmDspDataInfoRef=DataInfo_DiagnServi_TABROW_NeuMeasu_Read_29_1_1_1_1_1  # Diagnostics Data Import
        DataInfo_DiagnServi_TABROW_NeuMeasu_Read_29_1_1_1_1 (DcmDspDataInfo): DcmDspDataFixedLength=true  # Diagnostics Data Import
        Data_DiagnServi_TABROW_NeuMeasu_Read_29_1_1_1_1 (DcmDspData): DcmDspDataSize=32, DcmDspDataType=UINT8_N, DcmDspDataInfoRef=DataInfo_DiagnServi_TABROW_NeuMeasu_Read_29_1_1_1_1  # Diagnostics Data Import
        DataInfo_DiagnServi_TABROW_NeuMeasu_Read_29_1_1_1 (DcmDspDataInfo): DcmDspDataFixedLength=true  # Diagnostics Data Import
        Data_DiagnServi_TABROW_NeuMeasu_Read_29_1_1_1 (DcmDspData): DcmDspDataSize=32, DcmDspDataType=UINT8_N, DcmDspDataInfoRef=DataInfo_DiagnServi_TABROW_NeuMeasu_Read_29_1_1_1  # Diagnostics Data Import
        DataInfo_DiagnServi_TABROW_NeuMeasu_Read_29_1_1 (DcmDspDataInfo): DcmDspDataFixedLength=true  # Diagnostics Data Import
        Data_DiagnServi_TABROW_NeuMeasu_Read_29_1_1 (DcmDspData): DcmDspDataSize=32, DcmDspDataType=UINT8_N, DcmDspDataInfoRef=DataInfo_DiagnServi_TABROW_NeuMeasu_Read_29_1_1  # Diagnostics Data Import
        DataInfo_DiagnServi_TABROW_NeuMeasu_Read_29_1_2 (DcmDspDataInfo): DcmDspDataFixedLength=true  # Diagnostics Data Import
        Data_DiagnServi_TABROW_NeuMeasu_Read_29_1_2 (DcmDspData): DcmDspDataSize=32, DcmDspDataType=UINT8_N, DcmDspDataInfoRef=DataInfo_DiagnServi_TABROW_NeuMeasu_Read_29_1_2  # Diagnostics Data Import
        DataInfo_DiagnServi_TABROW_NeuMeasu_Read_29_5 (DcmDspDataInfo): DcmDspDataFixedLength=true  # Diagnostics Data Import
        Data_DiagnServi_TABROW_NeuMeasu_Read_29_5 (DcmDspData): DcmDspDataSize=32, DcmDspDataType=UINT8_N, DcmDspDataInfoRef=DataInfo_DiagnServi_TABROW_NeuMeasu_Read_29_5  # Diagnostics Data Import
        DataInfo_DiagnServi_TABROW_NeuMeasu_Read_28_4 (DcmDspDataInfo): DcmDspDataFixedLength=true  # Diagnostics Data Import
        Data_DiagnServi_TABROW_NeuMeasu_Read_28_4 (DcmDspData): DcmDspDataSize=32, DcmDspDataType=UINT8_N, DcmDspDataInfoRef=DataInfo_DiagnServi_TABROW_NeuMeasu_Read_28_4  # Diagnostics Data Import
        DataInfo_DiagnServi_TABROW_NeuMeasu_Read_28_5 (DcmDspDataInfo): DcmDspDataFixedLength=true  # Diagnostics Data Import
        Data_DiagnServi_TABROW_NeuMeasu_Read_28_5 (DcmDspData): DcmDspDataSize=32, DcmDspDataType=UINT8_N, DcmDspDataInfoRef=DataInfo_DiagnServi_TABROW_NeuMeasu_Read_28_5  # Diagnostics Data Import
        DataInfo_DiagnServi_TABROW_NeuMeasu_Read_27_1_1_1_1_1 (DcmDspDataInfo): DcmDspDataFixedLength=true  # Diagnostics Data Import
        Data_DiagnServi_TABROW_NeuMeasu_Read_27_1_1_1_1_1 (DcmDspData): DcmDspDataSize=8, DcmDspDataType=UINT8_N, DcmDspDataInfoRef=DataInfo_DiagnServi_TABROW_NeuMeasu_Read_27_1_1_1_1_1  # Diagnostics Data Import
        DataInfo_DiagnServi_TABROW_NeuMeasu_Read_27_1_1_1_1 (DcmDspDataInfo): DcmDspDataFixedLength=true  # Diagnostics Data Import
        Data_DiagnServi_TABROW_NeuMeasu_Read_27_1_1_1_1 (DcmDspData): DcmDspDataSize=8, DcmDspDataType=UINT8_N, DcmDspDataInfoRef=DataInfo_DiagnServi_TABROW_NeuMeasu_Read_27_1_1_1_1  # Diagnostics Data Import
        DataInfo_DiagnServi_TABROW_NeuMeasu_Read_27_1_1_1_2 (DcmDspDataInfo): DcmDspDataFixedLength=true  # Diagnostics Data Import
        Data_DiagnServi_TABROW_NeuMeasu_Read_27_1_1_1_2 (DcmDspData): DcmDspDataSize=8, DcmDspDataType=UINT8_N, DcmDspDataInfoRef=DataInfo_DiagnServi_TABROW_NeuMeasu_Read_27_1_1_1_2  # Diagnostics Data Import
        DataInfo_DiagnServi_TABROW_NeuMeasu_Read_27_1_1_2 (DcmDspDataInfo): DcmDspDataFixedLength=true  # Diagnostics Data Import
        Data_DiagnServi_TABROW_NeuMeasu_Read_27_1_1_2 (DcmDspData): DcmDspDataSize=8, DcmDspDataType=UINT8_N, DcmDspDataInfoRef=DataInfo_DiagnServi_TABROW_NeuMeasu_Read_27_1_1_2  # Diagnostics Data Import
        DataInfo_DiagnServi_TABROW_NeuMeasu_Read_27_1_2 (DcmDspDataInfo): DcmDspDataFixedLength=true  # Diagnostics Data Import
        Data_DiagnServi_TABROW_NeuMeasu_Read_27_1_2 (DcmDspData): DcmDspDataSize=8, DcmDspDataType=UINT8_N, DcmDspDataInfoRef=DataInfo_DiagnServi_TABROW_NeuMeasu_Read_27_1_2  # Diagnostics Data Import
        DataInfo_DiagnServi_TABROW_NeuMeasu_Read_27_8 (DcmDspDataInfo): DcmDspDataFixedLength=true  # Diagnostics Data Import
        Data_DiagnServi_TABROW_NeuMeasu_Read_27_8 (DcmDspData): DcmDspDataSize=8, DcmDspDataType=UINT8_N, DcmDspDataInfoRef=DataInfo_DiagnServi_TABROW_NeuMeasu_Read_27_8  # Diagnostics Data Import
        DataInfo_DiagnServi_TABROW_NeuMeasu_Read_63_1_1_1 (DcmDspDataInfo): DcmDspDataFixedLength=true  # Diagnostics Data Import
        Data_DiagnServi_TABROW_NeuMeasu_Read_63_1_1_1 (DcmDspData): DcmDspDataSize=128, DcmDspDataType=UINT8_N, DcmDspDataInfoRef=DataInfo_DiagnServi_TABROW_NeuMeasu_Read_63_1_1_1  # Diagnostics Data Import
        DataInfo_DiagnServi_TABROW_NeuMeasu_Read_63_1_1 (DcmDspDataInfo): DcmDspDataFixedLength=true  # Diagnostics Data Import
        Data_DiagnServi_TABROW_NeuMeasu_Read_63_1_1 (DcmDspData): DcmDspDataSize=128, DcmDspDataType=UINT8_N, DcmDspDataInfoRef=DataInfo_DiagnServi_TABROW_NeuMeasu_Read_63_1_1  # Diagnostics Data Import
        DataInfo_DiagnServi_TABROW_NeuMeasu_Read_63_1 (DcmDspDataInfo): DcmDspDataFixedLength=true  # Diagnostics Data Import
        Data_DiagnServi_TABROW_NeuMeasu_Read_63_1 (DcmDspData): DcmDspDataSize=256, DcmDspDataType=UINT8_N, DcmDspDataInfoRef=DataInfo_DiagnServi_TABROW_NeuMeasu_Read_63_1  # Diagnostics Data Import
        DataInfo_DiagnServi_TABROW_NeuMeasu_Read_63 (DcmDspDataInfo): DcmDspDataFixedLength=true  # Diagnostics Data Import
        Data_DiagnServi_TABROW_NeuMeasu_Read_63 (DcmDspData): DcmDspDataSize=256, DcmDspDataType=UINT8_N, DcmDspDataInfoRef=DataInfo_DiagnServi_TABROW_NeuMeasu_Read_63  # Diagnostics Data Import
        DataInfo_DiagnServi_TABROW_NeuMeasu_Read_30_3 (DcmDspDataInfo): DcmDspDataFixedLength=true  # Diagnostics Data Import
        Data_DiagnServi_TABROW_NeuMeasu_Read_30_3 (DcmDspData): DcmDspDataSize=16, DcmDspDataType=UINT8_N, DcmDspDataInfoRef=DataInfo_DiagnServi_TABROW_NeuMeasu_Read_30_3  # Diagnostics Data Import
        DataInfo_DiagnServi_TABROW_NeuMeasu_Read_29_4 (DcmDspDataInfo): DcmDspDataFixedLength=true  # Diagnostics Data Import
        Data_DiagnServi_TABROW_NeuMeasu_Read_29_4 (DcmDspData): DcmDspDataSize=16, DcmDspDataType=UINT8_N, DcmDspDataInfoRef=DataInfo_DiagnServi_TABROW_NeuMeasu_Read_29_4  # Diagnostics Data Import
        DataInfo_DiagnServi_TABROW_NeuMeasu_Read_28_3 (DcmDspDataInfo): DcmDspDataFixedLength=true  # Diagnostics Data Import
        Data_DiagnServi_TABROW_NeuMeasu_Read_28_3 (DcmDspData): DcmDspDataSize=32, DcmDspDataType=UINT8_N, DcmDspDataInfoRef=DataInfo_DiagnServi_TABROW_NeuMeasu_Read_28_3  # Diagnostics Data Import
        DataInfo_DiagnServi_TABROW_NeuMeasu_Read_27_7 (DcmDspDataInfo): DcmDspDataFixedLength=true  # Diagnostics Data Import
        Data_DiagnServi_TABROW_NeuMeasu_Read_27_7 (DcmDspData): DcmDspDataSize=32, DcmDspDataType=UINT8_N, DcmDspDataInfoRef=DataInfo_DiagnServi_TABROW_NeuMeasu_Read_27_7  # Diagnostics Data Import
        DataInfo_DiagnServi_TABROW_NeuMeasu_Read_28_6 (DcmDspDataInfo): DcmDspDataFixedLength=true  # Diagnostics Data Import
        Data_DiagnServi_TABROW_NeuMeasu_Read_28_6 (DcmDspData): DcmDspDataSize=16, DcmDspDataType=UINT8_N, DcmDspDataInfoRef=DataInfo_DiagnServi_TABROW_NeuMeasu_Read_28_6  # Diagnostics Data Import
        DataInfo_TABROW_ECUStandMode2_Read (DcmDspDataInfo): DcmDspDataFixedLength=true  # Diagnostics Data Import
        Data_TABROW_ECUStandMode2_Read (DcmDspData): DcmDspDataSize=32, DcmDspDataType=UINT8_N, DcmDspDataInfoRef=DataInfo_TABROW_ECUStandMode2_Read  # Diagnostics Data Import
        DataInfo_TABROW_ECUStandMode1_Read (DcmDspDataInfo): DcmDspDataFixedLength=true  # Diagnostics Data Import
        Data_TABROW_ECUStandMode1_Read (DcmDspData): DcmDspDataSize=32, DcmDspDataType=UINT8_N, DcmDspDataInfoRef=DataInfo_TABROW_ECUStandMode1_Read  # Diagnostics Data Import
        DataInfo_TABROW_SFDDevelModeActiv_Read (DcmDspDataInfo): DcmDspDataFixedLength=true  # Diagnostics Data Import
        Data_TABROW_SFDDevelModeActiv_Read (DcmDspData): DcmDspDataSize=8, DcmDspDataType=UINT8_N, DcmDspDataInfoRef=DataInfo_TABROW_SFDDevelModeActiv_Read  # Diagnostics Data Import
        DataInfo_DiagnServi_TABROW_NeuECUIdent_Read (DcmDspDataInfo): DcmDspDataFixedLength=true  # Diagnostics Data Import
        Data_DiagnServi_TABROW_NeuECUIdent_Read (DcmDspData): DcmDspDataSize=88, DcmDspDataType=UINT8_N, DcmDspDataInfoRef=DataInfo_DiagnServi_TABROW_NeuECUIdent_Read  # Diagnostics Data Import
        DataInfo_TABROW_StatuECUStandMode_Read (DcmDspDataInfo): DcmDspDataFixedLength=true  # Diagnostics Data Import
        Data_TABROW_StatuECUStandMode_Read (DcmDspData): DcmDspDataSize=8, DcmDspDataType=UINT8_N, DcmDspDataInfoRef=DataInfo_TABROW_StatuECUStandMode_Read  # Diagnostics Data Import
        DataInfo_Maximum_Charge_Voltage_Read_Data_By_Identifier (DcmDspDataInfo): DcmDspDataFixedLength=true  # Diagnostics Data Import
        Data_Maximum_Charge_Voltage_Read_Data_By_Identifier (DcmDspData): DcmDspDataSize=16, DcmDspDataType=UINT8_N, DcmDspDataInfoRef=DataInfo_Maximum_Charge_Voltage_Read_Data_By_Identifier  # Diagnostics Data Import
        DataInfo_Minimum_Discharge_Voltage_Read_Data_By_Identifier (DcmDspDataInfo): DcmDspDataFixedLength=true  # Diagnostics Data Import
        Data_Minimum_Discharge_Voltage_Read_Data_By_Identifier (DcmDspData): DcmDspDataSize=16, DcmDspDataType=UINT8_N, DcmDspDataInfoRef=DataInfo_Minimum_Discharge_Voltage_Read_Data_By_Identifier  # Diagnostics Data Import
        DataInfo_TABROW_ServiDiscoState_Read_Data_By_Identifier (DcmDspDataInfo): DcmDspDataFixedLength=true  # Diagnostics Data Import
        Data_TABROW_ServiDiscoState_Read_Data_By_Identifier (DcmDspData): DcmDspDataSize=8, DcmDspDataType=UINT8_N, DcmDspDataInfoRef=DataInfo_TABROW_ServiDiscoState_Read_Data_By_Identifier  # Diagnostics Data Import
        DataInfo_DiagnServi_TABROW_NeuMeasu_Read_28_2 (DcmDspDataInfo): DcmDspDataFixedLength=true  # Diagnostics Data Import
        Data_DiagnServi_TABROW_NeuMeasu_Read_28_2 (DcmDspData): DcmDspDataSize=16, DcmDspDataType=UINT8_N, DcmDspDataInfoRef=DataInfo_DiagnServi_TABROW_NeuMeasu_Read_28_2  # Diagnostics Data Import
        DataInfo_DiagnServi_TABROW_AdaptOfChineSeriaNumbe_Read (DcmDspDataInfo): DcmDspDataFixedLength=true  # Diagnostics Data Import
        Data_DiagnServi_TABROW_AdaptOfChineSeriaNumbe_Read (DcmDspData): DcmDspDataSize=208, DcmDspDataType=UINT8_N, DcmDspDataInfoRef=DataInfo_DiagnServi_TABROW_AdaptOfChineSeriaNumbe_Read  # Diagnostics Data Import
        DataInfo_Zero_Potential_Status_Read_Data_By_Identifier (DcmDspDataInfo): DcmDspDataFixedLength=true  # Diagnostics Data Import
        Data_Zero_Potential_Status_Read_Data_By_Identifier (DcmDspData): DcmDspDataSize=8, DcmDspDataType=UINT8_N, DcmDspDataInfoRef=DataInfo_Zero_Potential_Status_Read_Data_By_Identifier  # Diagnostics Data Import
        DataInfo_TABROW_ModeOfProteOfVehicDiagn_ReadDataByIdentifier (DcmDspDataInfo): DcmDspDataFixedLength=true  # Diagnostics Data Import
        Data_TABROW_ModeOfProteOfVehicDiagn_ReadDataByIdentifier (DcmDspData): DcmDspDataSize=8, DcmDspDataType=UINT8_N, DcmDspDataInfoRef=DataInfo_TABROW_ModeOfProteOfVehicDiagn_ReadDataByIdentifier  # Diagnostics Data Import
        DataInfo_TABROW_VkmsKeyList_Read_Data_By_Identifier (DcmDspDataInfo): DcmDspDataFixedLength=false  # Diagnostics Data Import
        Data_TABROW_VkmsKeyList_Read_Data_By_Identifier (DcmDspData): DcmDspDataSize=8176, DcmDspDataType=UINT8_N, DcmDspDataInfoRef=DataInfo_TABROW_VkmsKeyList_Read_Data_By_Identifier  # Diagnostics Data Import
        DataInfo_TABROW_VkmsMissiKeyHisto_Read_Data_By_Identifier (DcmDspDataInfo): DcmDspDataFixedLength=false  # Diagnostics Data Import
        Data_TABROW_VkmsMissiKeyHisto_Read_Data_By_Identifier (DcmDspData): DcmDspDataSize=4096, DcmDspDataType=UINT8_N, DcmDspDataInfoRef=DataInfo_TABROW_VkmsMissiKeyHisto_Read_Data_By_Identifier  # Diagnostics Data Import
        DataInfo_TABROW_VkmsTrainCount_Read_Data_By_Identifier (DcmDspDataInfo): DcmDspDataFixedLength=true  # Diagnostics Data Import
        Data_TABROW_VkmsTrainCount_Read_Data_By_Identifier (DcmDspData): DcmDspDataSize=24, DcmDspDataType=UINT8_N, DcmDspDataInfoRef=DataInfo_TABROW_VkmsTrainCount_Read_Data_By_Identifier  # Diagnostics Data Import
        DataInfo_TABROW_VkmsVkmsv_Read_Data_By_Identifier (DcmDspDataInfo): DcmDspDataFixedLength=true  # Diagnostics Data Import
        Data_TABROW_VkmsVkmsv_Read_Data_By_Identifier (DcmDspData): DcmDspDataSize=144, DcmDspDataType=UINT8_N, DcmDspDataInfoRef=DataInfo_TABROW_VkmsVkmsv_Read_Data_By_Identifier  # Diagnostics Data Import
        DataInfo_Battery_technical_state_of_charge_Read_Data_By_Identifier (DcmDspDataInfo): DcmDspDataFixedLength=true  # Diagnostics Data Import
        Data_Battery_technical_state_of_charge_Read_Data_By_Identifier (DcmDspData): DcmDspDataSize=16, DcmDspDataType=UINT8_N, DcmDspDataInfoRef=DataInfo_Battery_technical_state_of_charge_Read_Data_By_Identifier  # Diagnostics Data Import
        DataInfo_Battery_energy_content_maximum_Read_Data_By_Identifier (DcmDspDataInfo): DcmDspDataFixedLength=true  # Diagnostics Data Import
        Data_Battery_energy_content_maximum_Read_Data_By_Identifier (DcmDspData): DcmDspDataSize=16, DcmDspDataType=UINT8_N, DcmDspDataInfoRef=DataInfo_Battery_energy_content_maximum_Read_Data_By_Identifier  # Diagnostics Data Import
        DataInfo_Battery_energy_content_actual_Read_Data_By_Identifier (DcmDspDataInfo): DcmDspDataFixedLength=true  # Diagnostics Data Import
        Data_Battery_energy_content_actual_Read_Data_By_Identifier (DcmDspData): DcmDspDataSize=32, DcmDspDataType=UINT8_N, DcmDspDataInfoRef=DataInfo_Battery_energy_content_actual_Read_Data_By_Identifier  # Diagnostics Data Import
        DataInfo_Battery_contactors_actual_states_Read_Data_By_Identifier (DcmDspDataInfo): DcmDspDataFixedLength=true  # Diagnostics Data Import
        Data_Battery_contactors_actual_states_Read_Data_By_Identifier (DcmDspData): DcmDspDataSize=16, DcmDspDataType=UINT8_N, DcmDspDataInfoRef=DataInfo_Battery_contactors_actual_states_Read_Data_By_Identifier  # Diagnostics Data Import
        DataInfo_TABROW_BMCHVKEoHVLState_Read_Data_By_Identifier (DcmDspDataInfo): DcmDspDataFixedLength=true  # Diagnostics Data Import
        Data_TABROW_BMCHVKEoHVLState_Read_Data_By_Identifier (DcmDspData): DcmDspDataSize=8, DcmDspDataType=UINT8_N, DcmDspDataInfoRef=DataInfo_TABROW_BMCHVKEoHVLState_Read_Data_By_Identifier  # Diagnostics Data Import
        DataInfo_DiagnServi_HV_battery_modules_actual_voltage_Read (DcmDspDataInfo): DcmDspDataFixedLength=true  # Diagnostics Data Import
        Data_DiagnServi_HV_battery_modules_actual_voltage_Read (DcmDspData): DcmDspDataSize=192, DcmDspDataType=UINT8_N, DcmDspDataInfoRef=DataInfo_DiagnServi_HV_battery_modules_actual_voltage_Read  # Diagnostics Data Import
        DataInfo_Battery_banks_actual_voltage_Read_Data_By_Identifier (DcmDspDataInfo): DcmDspDataFixedLength=true  # Diagnostics Data Import
        Data_Battery_banks_actual_voltage_Read_Data_By_Identifier (DcmDspData): DcmDspDataSize=64, DcmDspDataType=UINT8_N, DcmDspDataInfoRef=DataInfo_Battery_banks_actual_voltage_Read_Data_By_Identifier  # Diagnostics Data Import
        DataInfo_HV_coordinator_requestet_voltage_hv_battery_Read_Data_By_Identifier (DcmDspDataInfo): DcmDspDataFixedLength=true  # Diagnostics Data Import
        Data_HV_coordinator_requestet_voltage_hv_battery_Read_Data_By_Identifier (DcmDspData): DcmDspDataSize=8, DcmDspDataType=UINT8_N, DcmDspDataInfoRef=DataInfo_HV_coordinator_requestet_voltage_hv_battery_Read_Data_By_Identifier  # Diagnostics Data Import
        DataInfo_HV_battery_maximum_discharge_current_Read_Data_By_Identifier (DcmDspDataInfo): DcmDspDataFixedLength=true  # Diagnostics Data Import
        Data_HV_battery_maximum_discharge_current_Read_Data_By_Identifier (DcmDspData): DcmDspDataSize=16, DcmDspDataType=UINT8_N, DcmDspDataInfoRef=DataInfo_HV_battery_maximum_discharge_current_Read_Data_By_Identifier  # Diagnostics Data Import
        DataInfo_HV_battery_maximum_charging_current_Read_Data_By_Identifier (DcmDspDataInfo): DcmDspDataFixedLength=true  # Diagnostics Data Import
        Data_HV_battery_maximum_charging_current_Read_Data_By_Identifier (DcmDspData): DcmDspDataSize=16, DcmDspDataType=UINT8_N, DcmDspDataInfoRef=DataInfo_HV_battery_maximum_charging_current_Read_Data_By_Identifier  # Diagnostics Data Import
        DataInfo_HV_battery_maximum_discharge_power_Read_Data_By_Identifier (DcmDspDataInfo): DcmDspDataFixedLength=true  # Diagnostics Data Import
        Data_HV_battery_maximum_discharge_power_Read_Data_By_Identifier (DcmDspData): DcmDspDataSize=16, DcmDspDataType=UINT8_N, DcmDspDataInfoRef=DataInfo_HV_battery_maximum_discharge_power_Read_Data_By_Identifier  # Diagnostics Data Import
        DataInfo_HV_battery_maximum_charging_power_Read_Data_By_Identifier (DcmDspDataInfo): DcmDspDataFixedLength=true  # Diagnostics Data Import
        Data_HV_battery_maximum_charging_power_Read_Data_By_Identifier (DcmDspData): DcmDspDataSize=16, DcmDspDataType=UINT8_N, DcmDspDataInfoRef=DataInfo_HV_battery_maximum_charging_power_Read_Data_By_Identifier  # Diagnostics Data Import
        DataInfo_BMC_IWU_Status_Read_Data_By_Identifier (DcmDspDataInfo): DcmDspDataFixedLength=true  # Diagnostics Data Import
        Data_BMC_IWU_Status_Read_Data_By_Identifier (DcmDspData): DcmDspDataSize=8, DcmDspDataType=UINT8_N, DcmDspDataInfoRef=DataInfo_BMC_IWU_Status_Read_Data_By_Identifier  # Diagnostics Data Import
        DataInfo_Battery_flow_temperature_Read_Data_By_Identifier (DcmDspDataInfo): DcmDspDataFixedLength=true  # Diagnostics Data Import
        Data_Battery_flow_temperature_Read_Data_By_Identifier (DcmDspData): DcmDspDataSize=16, DcmDspDataType=UINT8_N, DcmDspDataInfoRef=DataInfo_Battery_flow_temperature_Read_Data_By_Identifier  # Diagnostics Data Import
        DataInfo_Battery_banks_allowed_modes_Read_Data_By_Identifier (DcmDspDataInfo): DcmDspDataFixedLength=true  # Diagnostics Data Import
        Data_Battery_banks_allowed_modes_Read_Data_By_Identifier (DcmDspData): DcmDspDataSize=8, DcmDspDataType=UINT8_N, DcmDspDataInfoRef=DataInfo_Battery_banks_allowed_modes_Read_Data_By_Identifier  # Diagnostics Data Import
        DataInfo_Battery_banks_actual_mode_Read_Data_By_Identifier (DcmDspDataInfo): DcmDspDataFixedLength=true  # Diagnostics Data Import
        Data_Battery_banks_actual_mode_Read_Data_By_Identifier (DcmDspData): DcmDspDataSize=8, DcmDspDataType=UINT8_N, DcmDspDataInfoRef=DataInfo_Battery_banks_actual_mode_Read_Data_By_Identifier  # Diagnostics Data Import
        DataInfo_TABROW_BMCHVKFehleSD_Read_Data_By_Identifier (DcmDspDataInfo): DcmDspDataFixedLength=true  # Diagnostics Data Import
        Data_TABROW_BMCHVKFehleSD_Read_Data_By_Identifier (DcmDspData): DcmDspDataSize=8, DcmDspDataType=UINT8_N, DcmDspDataInfoRef=DataInfo_TABROW_BMCHVKFehleSD_Read_Data_By_Identifier  # Diagnostics Data Import
        DataInfo_Charisma_requestet_driving_program_hv_battery_Read_Data_By_Identifier (DcmDspDataInfo): DcmDspDataFixedLength=true  # Diagnostics Data Import
        Data_Charisma_requestet_driving_program_hv_battery_Read_Data_By_Identifier (DcmDspData): DcmDspDataSize=8, DcmDspDataType=UINT8_N, DcmDspDataInfoRef=DataInfo_Charisma_requestet_driving_program_hv_battery_Read_Data_By_Identifier  # Diagnostics Data Import
        DataInfo_Battery_displayed_state_of_charge_Read_Data_By_Identifier (DcmDspDataInfo): DcmDspDataFixedLength=true  # Diagnostics Data Import
        Data_Battery_displayed_state_of_charge_Read_Data_By_Identifier (DcmDspData): DcmDspDataSize=16, DcmDspDataType=UINT8_N, DcmDspDataInfoRef=DataInfo_Battery_displayed_state_of_charge_Read_Data_By_Identifier  # Diagnostics Data Import
        DataInfo_DC_charging_station_actual_voltage_Read_Data_By_Identifier (DcmDspDataInfo): DcmDspDataFixedLength=true  # Diagnostics Data Import
        Data_DC_charging_station_actual_voltage_Read_Data_By_Identifier (DcmDspData): DcmDspDataSize=16, DcmDspDataType=UINT8_N, DcmDspDataInfoRef=DataInfo_DC_charging_station_actual_voltage_Read_Data_By_Identifier  # Diagnostics Data Import
        DataInfo_DiagnServi_TABROW_NeuMeasu_Read_1 (DcmDspDataInfo): DcmDspDataFixedLength=true  # Diagnostics Data Import
        Data_DiagnServi_TABROW_NeuMeasu_Read_1 (DcmDspData): DcmDspDataSize=32, DcmDspDataType=UINT8_N, DcmDspDataInfoRef=DataInfo_DiagnServi_TABROW_NeuMeasu_Read_1  # Diagnostics Data Import
        DataInfo_DiagnServi_TABROW_NeuMeasu_Read (DcmDspDataInfo): DcmDspDataFixedLength=true  # Diagnostics Data Import
        Data_DiagnServi_TABROW_NeuMeasu_Read (DcmDspData): DcmDspDataSize=24, DcmDspDataType=UINT8_N, DcmDspDataInfoRef=DataInfo_DiagnServi_TABROW_NeuMeasu_Read  # Diagnostics Data Import
        DataInfo_DiagnServi_TABROW_Milea_Read (DcmDspDataInfo): DcmDspDataFixedLength=true  # Diagnostics Data Import
        Data_DiagnServi_TABROW_Milea_Read (DcmDspData): DcmDspDataSize=24, DcmDspDataType=UINT8_N, DcmDspDataInfoRef=DataInfo_DiagnServi_TABROW_Milea_Read  # Diagnostics Data Import
        DataInfo_TABROW_CellVoltaSum_ReadDataByIdent (DcmDspDataInfo): DcmDspDataFixedLength=true  # Diagnostics Data Import
        Data_TABROW_CellVoltaSum_ReadDataByIdent (DcmDspData): DcmDspDataSize=16, DcmDspDataType=UINT8_N, DcmDspDataInfoRef=DataInfo_TABROW_CellVoltaSum_ReadDataByIdent  # Diagnostics Data Import
        DataInfo_TABROW_CellVoltaMinim_ReadDataByIdent (DcmDspDataInfo): DcmDspDataFixedLength=true  # Diagnostics Data Import
        Data_TABROW_CellVoltaMinim_ReadDataByIdent (DcmDspData): DcmDspDataSize=56, DcmDspDataType=UINT8_N, DcmDspDataInfoRef=DataInfo_TABROW_CellVoltaMinim_ReadDataByIdent  # Diagnostics Data Import
        DataInfo_TABROW_CellVoltaMaxim_ReadDataByIdent (DcmDspDataInfo): DcmDspDataFixedLength=true  # Diagnostics Data Import
        Data_TABROW_CellVoltaMaxim_ReadDataByIdent (DcmDspData): DcmDspDataSize=56, DcmDspDataType=UINT8_N, DcmDspDataInfoRef=DataInfo_TABROW_CellVoltaMaxim_ReadDataByIdent  # Diagnostics Data Import
        DataInfo_TABROW_CellStateOfChargMinim_ReadDataByIdent (DcmDspDataInfo): DcmDspDataFixedLength=true  # Diagnostics Data Import
        Data_TABROW_CellStateOfChargMinim_ReadDataByIdent (DcmDspData): DcmDspDataSize=32, DcmDspDataType=UINT8_N, DcmDspDataInfoRef=DataInfo_TABROW_CellStateOfChargMinim_ReadDataByIdent  # Diagnostics Data Import
        DataInfo_TABROW_CellStateOfChargMaxim_ReadDataByIdent (DcmDspDataInfo): DcmDspDataFixedLength=true  # Diagnostics Data Import
        Data_TABROW_CellStateOfChargMaxim_ReadDataByIdent (DcmDspData): DcmDspDataSize=32, DcmDspDataType=UINT8_N, DcmDspDataInfoRef=DataInfo_TABROW_CellStateOfChargMaxim_ReadDataByIdent  # Diagnostics Data Import
        DataInfo_TABROW_IsolaResisSysteMinus_ReadDataByIdent (DcmDspDataInfo): DcmDspDataFixedLength=true  # Diagnostics Data Import
        Data_TABROW_IsolaResisSysteMinus_ReadDataByIdent (DcmDspData): DcmDspDataSize=16, DcmDspDataType=UINT8_N, DcmDspDataInfoRef=DataInfo_TABROW_IsolaResisSysteMinus_ReadDataByIdent  # Diagnostics Data Import
        DataInfo_TABROW_IsolaResisSystePlus_ReadDataByIdent (DcmDspDataInfo): DcmDspDataFixedLength=true  # Diagnostics Data Import
        Data_TABROW_IsolaResisSystePlus_ReadDataByIdent (DcmDspData): DcmDspDataSize=16, DcmDspDataType=UINT8_N, DcmDspDataInfoRef=DataInfo_TABROW_IsolaResisSystePlus_ReadDataByIdent  # Diagnostics Data Import
        DataInfo_TABROW_BatteTempeAvera_ReadDataByIdent (DcmDspDataInfo): DcmDspDataFixedLength=true  # Diagnostics Data Import
        Data_TABROW_BatteTempeAvera_ReadDataByIdent (DcmDspData): DcmDspDataSize=16, DcmDspDataType=UINT8_N, DcmDspDataInfoRef=DataInfo_TABROW_BatteTempeAvera_ReadDataByIdent  # Diagnostics Data Import
        DataInfo_TABROW_BatteTempeMinim_ReadDataByIdent (DcmDspDataInfo): DcmDspDataFixedLength=true  # Diagnostics Data Import
        Data_TABROW_BatteTempeMinim_ReadDataByIdent (DcmDspData): DcmDspDataSize=32, DcmDspDataType=UINT8_N, DcmDspDataInfoRef=DataInfo_TABROW_BatteTempeMinim_ReadDataByIdent  # Diagnostics Data Import
        DataInfo_TABROW_BatteTempeMaxim_ReadDataByIdent (DcmDspDataInfo): DcmDspDataFixedLength=true  # Diagnostics Data Import
        Data_TABROW_BatteTempeMaxim_ReadDataByIdent (DcmDspData): DcmDspDataSize=32, DcmDspDataType=UINT8_N, DcmDspDataInfoRef=DataInfo_TABROW_BatteTempeMaxim_ReadDataByIdent  # Diagnostics Data Import
        DataInfo_TABROW_StateOfBatteMIL_ReadDataByIdent (DcmDspDataInfo): DcmDspDataFixedLength=true  # Diagnostics Data Import
        Data_TABROW_StateOfBatteMIL_ReadDataByIdent (DcmDspData): DcmDspDataSize=8, DcmDspDataType=UINT8_N, DcmDspDataInfoRef=DataInfo_TABROW_StateOfBatteMIL_ReadDataByIdent  # Diagnostics Data Import
        DataInfo_TABROW_StateOfBattePowerReduc_ReadDataByIdent (DcmDspDataInfo): DcmDspDataFixedLength=true  # Diagnostics Data Import
        Data_TABROW_StateOfBattePowerReduc_ReadDataByIdent (DcmDspData): DcmDspDataSize=8, DcmDspDataType=UINT8_N, DcmDspDataInfoRef=DataInfo_TABROW_StateOfBattePowerReduc_ReadDataByIdent  # Diagnostics Data Import
        DataInfo_TABROW_StateOfBatteShutoCrash_ReadDataByIdent (DcmDspDataInfo): DcmDspDataFixedLength=true  # Diagnostics Data Import
        Data_TABROW_StateOfBatteShutoCrash_ReadDataByIdent (DcmDspData): DcmDspDataSize=8, DcmDspDataType=UINT8_N, DcmDspDataInfoRef=DataInfo_TABROW_StateOfBatteShutoCrash_ReadDataByIdent  # Diagnostics Data Import
        DataInfo_Prozessorauslastung_Read_Data_By_Identifier (DcmDspDataInfo): DcmDspDataFixedLength=true  # Diagnostics Data Import
        Data_Prozessorauslastung_Read_Data_By_Identifier (DcmDspData): DcmDspDataSize=32, DcmDspDataType=UINT8_N, DcmDspDataInfoRef=DataInfo_Prozessorauslastung_Read_Data_By_Identifier  # Diagnostics Data Import
        DataInfo_HV_Spannung_Nebenverbraucher_Read_Data_By_Identifier (DcmDspDataInfo): DcmDspDataFixedLength=true  # Diagnostics Data Import
        Data_HV_Spannung_Nebenverbraucher_Read_Data_By_Identifier (DcmDspData): DcmDspDataSize=16, DcmDspDataType=UINT8_N, DcmDspDataInfoRef=DataInfo_HV_Spannung_Nebenverbraucher_Read_Data_By_Identifier  # Diagnostics Data Import
        DataInfo_BMC_Hybrid_Kundendienstfehler_Read_Data_By_Identifier (DcmDspDataInfo): DcmDspDataFixedLength=true  # Diagnostics Data Import
        Data_BMC_Hybrid_Kundendienstfehler_Read_Data_By_Identifier (DcmDspData): DcmDspDataSize=8, DcmDspDataType=UINT8_N, DcmDspDataInfoRef=DataInfo_BMC_Hybrid_Kundendienstfehler_Read_Data_By_Identifier  # Diagnostics Data Import
        DataInfo_TABROW_KnockTestMode_Read (DcmDspDataInfo): DcmDspDataFixedLength=true  # Diagnostics Data Import
        Data_TABROW_KnockTestMode_Read (DcmDspData): DcmDspDataSize=8, DcmDspDataType=UINT8_N, DcmDspDataInfoRef=DataInfo_TABROW_KnockTestMode_Read  # Diagnostics Data Import
        DataInfo_DiagnServi_TABROW_ActivOfDevelMessa_Read (DcmDspDataInfo): DcmDspDataFixedLength=true  # Diagnostics Data Import
        Data_DiagnServi_TABROW_ActivOfDevelMessa_Read (DcmDspData): DcmDspDataSize=8, DcmDspDataType=UINT8_N, DcmDspDataInfoRef=DataInfo_DiagnServi_TABROW_ActivOfDevelMessa_Read  # Diagnostics Data Import
        DataInfo_DiagnServi_BMC_clamp_30c_Read (DcmDspDataInfo): DcmDspDataFixedLength=true  # Diagnostics Data Import
        Data_DiagnServi_BMC_clamp_30c_Read (DcmDspData): DcmDspDataSize=8, DcmDspDataType=UINT8_N, DcmDspDataInfoRef=DataInfo_DiagnServi_BMC_clamp_30c_Read  # Diagnostics Data Import
        DataInfo_DiagnServi_TABROW_NeuMeasu_Read_58_1 (DcmDspDataInfo): DcmDspDataFixedLength=true  # Diagnostics Data Import
        Data_DiagnServi_TABROW_NeuMeasu_Read_58_1 (DcmDspData): DcmDspDataSize=16, DcmDspDataType=UINT8_N, DcmDspDataInfoRef=DataInfo_DiagnServi_TABROW_NeuMeasu_Read_58_1  # Diagnostics Data Import
        DataInfo_DiagnServi_TABROW_NeuMeasu_Read_59_2 (DcmDspDataInfo): DcmDspDataFixedLength=true  # Diagnostics Data Import
        Data_DiagnServi_TABROW_NeuMeasu_Read_59_2 (DcmDspData): DcmDspDataSize=16, DcmDspDataType=UINT8_N, DcmDspDataInfoRef=DataInfo_DiagnServi_TABROW_NeuMeasu_Read_59_2  # Diagnostics Data Import
        DataInfo_DiagnServi_TABROW_NeuMeasu_Read_57_14 (DcmDspDataInfo): DcmDspDataFixedLength=true  # Diagnostics Data Import
        Data_DiagnServi_TABROW_NeuMeasu_Read_57_14 (DcmDspData): DcmDspDataSize=24, DcmDspDataType=UINT8_N, DcmDspDataInfoRef=DataInfo_DiagnServi_TABROW_NeuMeasu_Read_57_14  # Diagnostics Data Import
        DataInfo_DiagnServi_TABROW_NeuMeasu_Read_60_3 (DcmDspDataInfo): DcmDspDataFixedLength=true  # Diagnostics Data Import
        Data_DiagnServi_TABROW_NeuMeasu_Read_60_3 (DcmDspData): DcmDspDataSize=16, DcmDspDataType=UINT8_N, DcmDspDataInfoRef=DataInfo_DiagnServi_TABROW_NeuMeasu_Read_60_3  # Diagnostics Data Import
        DataInfo_DiagnServi_TABROW_NeuMeasu_Read_27_6 (DcmDspDataInfo): DcmDspDataFixedLength=true  # Diagnostics Data Import
        Data_DiagnServi_TABROW_NeuMeasu_Read_27_6 (DcmDspData): DcmDspDataSize=16, DcmDspDataType=UINT8_N, DcmDspDataInfoRef=DataInfo_DiagnServi_TABROW_NeuMeasu_Read_27_6  # Diagnostics Data Import
        DataInfo_DiagnServi_TABROW_NeuMeasu_Read_29_3 (DcmDspDataInfo): DcmDspDataFixedLength=true  # Diagnostics Data Import
        Data_DiagnServi_TABROW_NeuMeasu_Read_29_3 (DcmDspData): DcmDspDataSize=16, DcmDspDataType=UINT8_N, DcmDspDataInfoRef=DataInfo_DiagnServi_TABROW_NeuMeasu_Read_29_3  # Diagnostics Data Import
        DataInfo_DiagnServi_TABROW_NeuMeasu_Read_30_2 (DcmDspDataInfo): DcmDspDataFixedLength=true  # Diagnostics Data Import
        Data_DiagnServi_TABROW_NeuMeasu_Read_30_2 (DcmDspData): DcmDspDataSize=16, DcmDspDataType=UINT8_N, DcmDspDataInfoRef=DataInfo_DiagnServi_TABROW_NeuMeasu_Read_30_2  # Diagnostics Data Import
        DataInfo_DiagnServi_TABROW_NeuMeasu_Read_36_3 (DcmDspDataInfo): DcmDspDataFixedLength=true  # Diagnostics Data Import
        Data_DiagnServi_TABROW_NeuMeasu_Read_36_3 (DcmDspData): DcmDspDataSize=16, DcmDspDataType=UINT8_N, DcmDspDataInfoRef=DataInfo_DiagnServi_TABROW_NeuMeasu_Read_36_3  # Diagnostics Data Import
        DataInfo_DiagnServi_TABROW_NeuMeasu_Read_27_5 (DcmDspDataInfo): DcmDspDataFixedLength=true  # Diagnostics Data Import
        Data_DiagnServi_TABROW_NeuMeasu_Read_27_5 (DcmDspData): DcmDspDataSize=32, DcmDspDataType=UINT8_N, DcmDspDataInfoRef=DataInfo_DiagnServi_TABROW_NeuMeasu_Read_27_5  # Diagnostics Data Import
        DataInfo_DiagnServi_TABROW_NeuMeasu_Read_28_1 (DcmDspDataInfo): DcmDspDataFixedLength=true  # Diagnostics Data Import
        Data_DiagnServi_TABROW_NeuMeasu_Read_28_1 (DcmDspData): DcmDspDataSize=8, DcmDspDataType=UINT8_N, DcmDspDataInfoRef=DataInfo_DiagnServi_TABROW_NeuMeasu_Read_28_1  # Diagnostics Data Import
        DataInfo_DiagnServi_TABROW_NeuMeasu_Read_61 (DcmDspDataInfo): DcmDspDataFixedLength=true  # Diagnostics Data Import
        Data_DiagnServi_TABROW_NeuMeasu_Read_61 (DcmDspData): DcmDspDataSize=24, DcmDspDataType=UINT8_N, DcmDspDataInfoRef=DataInfo_DiagnServi_TABROW_NeuMeasu_Read_61  # Diagnostics Data Import
        DataInfo_DiagnServi_TABROW_NeuMeasu_Read_29_2 (DcmDspDataInfo): DcmDspDataFixedLength=true  # Diagnostics Data Import
        Data_DiagnServi_TABROW_NeuMeasu_Read_29_2 (DcmDspData): DcmDspDataSize=16, DcmDspDataType=UINT8_N, DcmDspDataInfoRef=DataInfo_DiagnServi_TABROW_NeuMeasu_Read_29_2  # Diagnostics Data Import
        DataInfo_DiagnServi_TABROW_NeuMeasu_Read_30_1 (DcmDspDataInfo): DcmDspDataFixedLength=true  # Diagnostics Data Import
        Data_DiagnServi_TABROW_NeuMeasu_Read_30_1 (DcmDspData): DcmDspDataSize=16, DcmDspDataType=UINT8_N, DcmDspDataInfoRef=DataInfo_DiagnServi_TABROW_NeuMeasu_Read_30_1  # Diagnostics Data Import
        DataInfo_DiagnServi_TABROW_NeuMeasu_Read_36 (DcmDspDataInfo): DcmDspDataFixedLength=true  # Diagnostics Data Import
        Data_DiagnServi_TABROW_NeuMeasu_Read_36 (DcmDspData): DcmDspDataSize=16, DcmDspDataType=UINT8_N, DcmDspDataInfoRef=DataInfo_DiagnServi_TABROW_NeuMeasu_Read_36  # Diagnostics Data Import
        DataInfo_DiagnServi_TABROW_NeuMeasu_Read_36_1 (DcmDspDataInfo): DcmDspDataFixedLength=true  # Diagnostics Data Import
        Data_DiagnServi_TABROW_NeuMeasu_Read_36_1 (DcmDspData): DcmDspDataSize=16, DcmDspDataType=UINT8_N, DcmDspDataInfoRef=DataInfo_DiagnServi_TABROW_NeuMeasu_Read_36_1  # Diagnostics Data Import
        DataInfo_DiagnServi_TABROW_NeuMeasu_Read_60 (DcmDspDataInfo): DcmDspDataFixedLength=true  # Diagnostics Data Import
        Data_DiagnServi_TABROW_NeuMeasu_Read_60 (DcmDspData): DcmDspDataSize=16, DcmDspDataType=UINT8_N, DcmDspDataInfoRef=DataInfo_DiagnServi_TABROW_NeuMeasu_Read_60  # Diagnostics Data Import
        DataInfo_DiagnServi_TABROW_NeuMeasu_Read_60_1 (DcmDspDataInfo): DcmDspDataFixedLength=true  # Diagnostics Data Import
        Data_DiagnServi_TABROW_NeuMeasu_Read_60_1 (DcmDspData): DcmDspDataSize=16, DcmDspDataType=UINT8_N, DcmDspDataInfoRef=DataInfo_DiagnServi_TABROW_NeuMeasu_Read_60_1  # Diagnostics Data Import
        DataInfo_DiagnServi_TABROW_NeuMeasu_Read_7 (DcmDspDataInfo): DcmDspDataFixedLength=true  # Diagnostics Data Import
        Data_DiagnServi_TABROW_NeuMeasu_Read_7 (DcmDspData): DcmDspDataSize=8, DcmDspDataType=UINT8_N, DcmDspDataInfoRef=DataInfo_DiagnServi_TABROW_NeuMeasu_Read_7  # Diagnostics Data Import
        DataInfo_DiagnServi_TABROW_NeuMeasu_Read_7_2 (DcmDspDataInfo): DcmDspDataFixedLength=true  # Diagnostics Data Import
        Data_DiagnServi_TABROW_NeuMeasu_Read_7_2 (DcmDspData): DcmDspDataSize=8, DcmDspDataType=UINT8_N, DcmDspDataInfoRef=DataInfo_DiagnServi_TABROW_NeuMeasu_Read_7_2  # Diagnostics Data Import
        DataInfo_DiagnServi_TABROW_NeuMeasu_Read_8_2 (DcmDspDataInfo): DcmDspDataFixedLength=true  # Diagnostics Data Import
        Data_DiagnServi_TABROW_NeuMeasu_Read_8_2 (DcmDspData): DcmDspDataSize=24, DcmDspDataType=UINT8_N, DcmDspDataInfoRef=DataInfo_DiagnServi_TABROW_NeuMeasu_Read_8_2  # Diagnostics Data Import
        DataInfo_DiagnServi_TABROW_NeuMeasu_Read_8 (DcmDspDataInfo): DcmDspDataFixedLength=true  # Diagnostics Data Import
        Data_DiagnServi_TABROW_NeuMeasu_Read_8 (DcmDspData): DcmDspDataSize=24, DcmDspDataType=UINT8_N, DcmDspDataInfoRef=DataInfo_DiagnServi_TABROW_NeuMeasu_Read_8  # Diagnostics Data Import
        DataInfo_DiagnServi_TABROW_NeuMeasu_Read_9_2_1_1_1 (DcmDspDataInfo): DcmDspDataFixedLength=true  # Diagnostics Data Import
        Data_DiagnServi_TABROW_NeuMeasu_Read_9_2_1_1_1 (DcmDspData): DcmDspDataSize=16, DcmDspDataType=UINT8_N, DcmDspDataInfoRef=DataInfo_DiagnServi_TABROW_NeuMeasu_Read_9_2_1_1_1  # Diagnostics Data Import
        DataInfo_DiagnServi_TABROW_NeuMeasu_Read_9_2_1_1 (DcmDspDataInfo): DcmDspDataFixedLength=true  # Diagnostics Data Import
        Data_DiagnServi_TABROW_NeuMeasu_Read_9_2_1_1 (DcmDspData): DcmDspDataSize=16, DcmDspDataType=UINT8_N, DcmDspDataInfoRef=DataInfo_DiagnServi_TABROW_NeuMeasu_Read_9_2_1_1  # Diagnostics Data Import
        DataInfo_DiagnServi_TABROW_NeuMeasu_Read_9_2_1 (DcmDspDataInfo): DcmDspDataFixedLength=true  # Diagnostics Data Import
        Data_DiagnServi_TABROW_NeuMeasu_Read_9_2_1 (DcmDspData): DcmDspDataSize=16, DcmDspDataType=UINT8_N, DcmDspDataInfoRef=DataInfo_DiagnServi_TABROW_NeuMeasu_Read_9_2_1  # Diagnostics Data Import
        DataInfo_DiagnServi_TABROW_NeuMeasu_Read_70_1 (DcmDspDataInfo): DcmDspDataFixedLength=true  # Diagnostics Data Import
        Data_DiagnServi_TABROW_NeuMeasu_Read_70_1 (DcmDspData): DcmDspDataSize=8, DcmDspDataType=UINT8_N, DcmDspDataInfoRef=DataInfo_DiagnServi_TABROW_NeuMeasu_Read_70_1  # Diagnostics Data Import
        DataInfo_DiagnServi_TABROW_NeuMeasu_Read_71 (DcmDspDataInfo): DcmDspDataFixedLength=true  # Diagnostics Data Import
        Data_DiagnServi_TABROW_NeuMeasu_Read_71 (DcmDspData): DcmDspDataSize=32, DcmDspDataType=UINT8_N, DcmDspDataInfoRef=DataInfo_DiagnServi_TABROW_NeuMeasu_Read_71  # Diagnostics Data Import
        DataInfo_DiagnServi_TABROW_NeuMeasu_Read_72 (DcmDspDataInfo): DcmDspDataFixedLength=true  # Diagnostics Data Import
        Data_DiagnServi_TABROW_NeuMeasu_Read_72 (DcmDspData): DcmDspDataSize=16, DcmDspDataType=UINT8_N, DcmDspDataInfoRef=DataInfo_DiagnServi_TABROW_NeuMeasu_Read_72  # Diagnostics Data Import
        DataInfo_DiagnServi_TABROW_NeuMeasu_Read_73 (DcmDspDataInfo): DcmDspDataFixedLength=true  # Diagnostics Data Import
        Data_DiagnServi_TABROW_NeuMeasu_Read_73 (DcmDspData): DcmDspDataSize=32, DcmDspDataType=UINT8_N, DcmDspDataInfoRef=DataInfo_DiagnServi_TABROW_NeuMeasu_Read_73  # Diagnostics Data Import
        DataInfo_DiagnServi_TABROW_NeuMeasu_Read_74 (DcmDspDataInfo): DcmDspDataFixedLength=true  # Diagnostics Data Import
        Data_DiagnServi_TABROW_NeuMeasu_Read_74 (DcmDspData): DcmDspDataSize=16, DcmDspDataType=UINT8_N, DcmDspDataInfoRef=DataInfo_DiagnServi_TABROW_NeuMeasu_Read_74  # Diagnostics Data Import
        DataInfo_DiagnServi_TABROW_NeuMeasu_Read_82 (DcmDspDataInfo): DcmDspDataFixedLength=true  # Diagnostics Data Import
