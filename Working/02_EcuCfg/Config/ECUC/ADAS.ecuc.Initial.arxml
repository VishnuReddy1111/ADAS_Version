[part 1 of 8: package /InitialEcuC]
AUTOSAR XML (schema 4-3-0)
package /InitialEcuC
  ecuc value collection InitialEcuC: ecuc-values=[Can, CanIf, CanNm, CanSM, CanTp, Com, ComM, Dcm, Dem, EcuC, EcuM, Nm, PduR, SecOC, Xcp]
  module config Can
    CanConfigSet
      CT_BMC_CAN01_34f1c2c6 (CanController):
        CanControllerActivation = true
        CanControllerDefaultBaudrate = CT_BMC_CAN01_34f1c2c6/CanControllerBaudrateConfig
        CanControllerSystemRef = CT_BMC_CAN01
        CanWakeupSourceRef = EcuMCommonConfiguration/CN_BMC_CAN01_78a85e89
        CanControllerBaudrateConfig: CanControllerBaudRate=500
      CT_HCP5_CANFD01_e05ce4e2 (CanController):
        CanControllerActivation = true
        CanControllerDefaultBaudrate = CT_HCP5_CANFD01_e05ce4e2/CanControllerBaudrateConfig
        CanControllerSystemRef = CT_HCP5_CANFD01
        CanWakeupSourceRef = EcuMCommonConfiguration/CN_HCP5_CANFD01_54d90215
        CanControllerBaudrateConfig: CanControllerBaudRate=500
          CanControllerFdBaudrateConfig: CanControllerFdBaudRate=2000
      6 x CanHardwareObject, all with CanHandleType=BASIC, CanIdValue=0:
        CN_BMC_CAN01_78a85e89_Tx: CanObjectType=TRANSMIT, CanControllerRef=CanConfigSet/CT_BMC_CAN01_34f1c2c6
        CN_BMC_CAN01_d4211d16_Rx: CanIdType=EXTENDED, CanObjectType=RECEIVE, CanControllerRef=CanConfigSet/CT_BMC_CAN01_34f1c2c6
        CN_BMC_CAN01_e16b4bee_Rx: CanIdType=STANDARD, CanObjectType=RECEIVE, CanControllerRef=CanConfigSet/CT_BMC_CAN01_34f1c2c6
        CN_HCP5_CANFD01_54d90215_Tx: CanObjectType=TRANSMIT, CanControllerRef=CanConfigSet/CT_HCP5_CANFD01_e05ce4e2
        CN_HCP5_CANFD01_c0785467_Rx: CanIdType=EXTENDED, CanObjectType=RECEIVE, CanControllerRef=CanConfigSet/CT_HCP5_CANFD01_e05ce4e2
        CN_HCP5_CANFD01_f532029f_Rx: CanIdType=STANDARD, CanObjectType=RECEIVE, CanControllerRef=CanConfigSet/CT_HCP5_CANFD01_e05ce4e2
    CanGeneral: CanIndex=0
  module config CanIf
    CanIfCtrlDrvCfg_7d254554 (CanIfCtrlDrvCfg): CanIfCtrlDrvInitHohConfigRef=CanIfInitHohCfg, CanIfCtrlDrvNameRef=CanGeneral
      CT_BMC_CAN01_34f1c2c6 (CanIfCtrlCfg): CanIfCtrlCanCtrlRef=CanConfigSet/CT_BMC_CAN01_34f1c2c6
      CT_HCP5_CANFD01_e05ce4e2 (CanIfCtrlCfg): CanIfCtrlCanCtrlRef=CanConfigSet/CT_HCP5_CANFD01_e05ce4e2
    CanIfInitCfg
      CHNL_b74a53a7 (CanIfBufferCfg): CanIfBufferSize=0, CanIfBufferHthRef=CanIfInitHohCfg/CN_HCP5_CANFD01_54d90215_Tx
      CHNL_eb535f7d (CanIfBufferCfg): CanIfBufferSize=0, CanIfBufferHthRef=CanIfInitHohCfg/CN_BMC_CAN01_78a85e89_Tx
      CanIfInitHohCfg: CanIfInitRefCfgSet=CanConfigSet
        4 x CanIfHrhCfg:
          CN_BMC_CAN01_d4211d16_Rx: CanIfHrhCanCtrlIdRef=CanIfCtrlDrvCfg_7d254554/CT_BMC_CAN01_34f1c2c6, CanIfHrhIdSymRef=CanConfigSet/CN_BMC_CAN01_d4211d16_Rx
          CN_BMC_CAN01_e16b4bee_Rx: CanIfHrhCanCtrlIdRef=CanIfCtrlDrvCfg_7d254554/CT_BMC_CAN01_34f1c2c6, CanIfHrhIdSymRef=CanConfigSet/CN_BMC_CAN01_e16b4bee_Rx
          CN_HCP5_CANFD01_c0785467_Rx: CanIfHrhCanCtrlIdRef=CanIfCtrlDrvCfg_7d254554/CT_HCP5_CANFD01_e05ce4e2, CanIfHrhIdSymRef=CanConfigSet/CN_HCP5_CANFD01_c0785467_Rx
          CN_HCP5_CANFD01_f532029f_Rx: CanIfHrhCanCtrlIdRef=CanIfCtrlDrvCfg_7d254554/CT_HCP5_CANFD01_e05ce4e2, CanIfHrhIdSymRef=CanConfigSet/CN_HCP5_CANFD01_f532029f_Rx
        CN_BMC_CAN01_78a85e89_Tx (CanIfHthCfg): CanIfHthCanCtrlIdRef=CanIfCtrlDrvCfg_7d254554/CT_BMC_CAN01_34f1c2c6, CanIfHthIdSymRef=CanConfigSet/CN_BMC_CAN01_78a85e89_Tx
        CN_HCP5_CANFD01_54d90215_Tx (CanIfHthCfg): CanIfHthCanCtrlIdRef=CanIfCtrlDrvCfg_7d254554/CT_HCP5_CANFD01_e05ce4e2, CanIfHthIdSymRef=CanConfigSet/CN_HCP5_CANFD01_54d90215_Tx
      102 x CanIfRxPduCfg:
        Airbag_10_XIX_HCP5_CANFD01_4586204d_Rx: CanIfRxPduCanId=287, CanIfRxPduCanIdType=STANDARD_FD_CAN, CanIfRxPduDlc=20, CanIfRxPduUserRxIndicationName=PduR_CanIfRxIndication, CanIfRxPduUserRxIndicationUL=PDUR, CanIfRxPduHrhIdRef=CanIfInitHohCfg/CN_HCP5_CANFD01_f532029f_Rx, CanIfRxPduRef=EcucPduCollection/Airbag_10_XIX_HCP5_CANFD01_6624abf2_Rx
        BJB_08_XIX_BMC_CAN01_65b3a981_Rx: CanIfRxPduCanId=316495214, CanIfRxPduCanIdType=EXTENDED_NO_FD_CAN, CanIfRxPduDlc=8, CanIfRxPduUserRxIndicationName=PduR_CanIfRxIndication, CanIfRxPduUserRxIndicationUL=PDUR, CanIfRxPduHrhIdRef=CanIfInitHohCfg/CN_BMC_CAN01_d4211d16_Rx, CanIfRxPduRef=EcucPduCollection/BJB_08_XIX_BMC_CAN01_7b6df5c6_Rx
        BJB_10_XIX_BMC_CAN01_E2E_c82e0916_Rx: CanIfRxPduCanId=441800484, CanIfRxPduCanIdType=EXTENDED_NO_FD_CAN, CanIfRxPduDlc=8, CanIfRxPduUserRxIndicationName=PduR_CanIfRxIndication, CanIfRxPduUserRxIndicationUL=PDUR, CanIfRxPduHrhIdRef=CanIfInitHohCfg/CN_BMC_CAN01_d4211d16_Rx, CanIfRxPduRef=EcucPduCollection/BJB_10_XIX_BMC_CAN01_E2E_04bd7411_Rx
        BJB_11_XIX_BMC_CAN01_E2E_c1f189c1_Rx: CanIfRxPduCanId=441800493, CanIfRxPduCanIdType=EXTENDED_NO_FD_CAN, CanIfRxPduDlc=8, CanIfRxPduUserRxIndicationName=PduR_CanIfRxIndication, CanIfRxPduUserRxIndicationUL=PDUR, CanIfRxPduHrhIdRef=CanIfInitHohCfg/CN_BMC_CAN01_d4211d16_Rx, CanIfRxPduRef=EcucPduCollection/BJB_11_XIX_BMC_CAN01_E2E_893589f3_Rx
        BJB_12_XIX_BMC_CAN01_E2E_db9108b8_Rx: CanIfRxPduCanId=441800485, CanIfRxPduCanIdType=EXTENDED_NO_FD_CAN, CanIfRxPduDlc=8, CanIfRxPduUserRxIndicationName=PduR_CanIfRxIndication, CanIfRxPduUserRxIndicationUL=PDUR, CanIfRxPduHrhIdRef=CanIfInitHohCfg/CN_BMC_CAN01_d4211d16_Rx, CanIfRxPduRef=EcucPduCollection/BJB_12_XIX_BMC_CAN01_E2E_c4dd8994_Rx
        BJB_13_XIX_BMC_CAN01_E2E_d24e886f_Rx: CanIfRxPduCanId=441800486, CanIfRxPduCanIdType=EXTENDED_NO_FD_CAN, CanIfRxPduDlc=8, CanIfRxPduUserRxIndicationName=PduR_CanIfRxIndication, CanIfRxPduUserRxIndicationUL=PDUR, CanIfRxPduHrhIdRef=CanIfInitHohCfg/CN_BMC_CAN01_d4211d16_Rx, CanIfRxPduRef=EcucPduCollection/BJB_13_XIX_BMC_CAN01_E2E_49557476_Rx
        BJB_CALID_01_XIX_BMC_CAN01_5400c4fa_Rx: CanIfRxPduCanId=441799937, CanIfRxPduCanIdType=EXTENDED_NO_FD_CAN, CanIfRxPduDlc=8, CanIfRxPduUserRxIndicationName=PduR_CanIfRxIndication, CanIfRxPduUserRxIndicationUL=PDUR, CanIfRxPduHrhIdRef=CanIfInitHohCfg/CN_BMC_CAN01_d4211d16_Rx, CanIfRxPduRef=EcucPduCollection/BJB_CALID_01_XIX_BMC_CAN01_89dc60ad_Rx
        BJB_CALID_02_XIX_BMC_CAN01_ab0d4070_Rx: CanIfRxPduCanId=441799938, CanIfRxPduCanIdType=EXTENDED_NO_FD_CAN, CanIfRxPduDlc=8, CanIfRxPduUserRxIndicationName=PduR_CanIfRxIndication, CanIfRxPduUserRxIndicationUL=PDUR, CanIfRxPduHrhIdRef=CanIfInitHohCfg/CN_BMC_CAN01_d4211d16_Rx, CanIfRxPduRef=EcucPduCollection/BJB_CALID_02_XIX_BMC_CAN01_e45a93f7_Rx
        BJB_CVN_01_XIX_BMC_CAN01_1fa2680a_Rx: CanIfRxPduCanId=441799939, CanIfRxPduCanIdType=EXTENDED_NO_FD_CAN, CanIfRxPduDlc=8, CanIfRxPduUserRxIndicationName=PduR_CanIfRxIndication, CanIfRxPduUserRxIndicationUL=PDUR, CanIfRxPduHrhIdRef=CanIfInitHohCfg/CN_BMC_CAN01_d4211d16_Rx, CanIfRxPduRef=EcucPduCollection/BJB_CVN_01_XIX_BMC_CAN01_4f7fa9e3_Rx
        CDD_DEV_BJB_Req_01_XIX_HCP5_CANFD01_dc450494_Rx: CanIfRxPduCanId=419352576, CanIfRxPduCanIdType=EXTENDED_FD_CAN, CanIfRxPduDlc=8, CanIfRxPduUserRxIndicationUL=CDD, CanIfRxPduHrhIdRef=CanIfInitHohCfg/CN_HCP5_CANFD01_c0785467_Rx, CanIfRxPduRef=CDD_DEV_BJB_Req_01_XIX_HCP5_CANFD01_c982c041_Rx
        CDD_DEV_BJB_Resp_FF_XIX_BMC_CAN01_575624cc_Rx: CanIfRxPduCanId=419352831, CanIfRxPduCanIdType=EXTENDED_NO_FD_CAN, CanIfRxPduDlc=8, CanIfRxPduUserRxIndicationUL=CDD, CanIfRxPduHrhIdRef=CanIfInitHohCfg/CN_BMC_CAN01_d4211d16_Rx, CanIfRxPduRef=CDD_DEV_BJB_Resp_FF_XIX_BMC_CAN01_19d429a9_Rx
        CDD_DEV_BMS_Resp_00_XIX_BMC_CAN01_6fe1c639_Rx: CanIfRxPduCanId=469752320, CanIfRxPduCanIdType=EXTENDED_NO_FD_CAN, CanIfRxPduDlc=8, CanIfRxPduUserRxIndicationUL=CDD, CanIfRxPduHrhIdRef=CanIfInitHohCfg/CN_BMC_CAN01_d4211d16_Rx, CanIfRxPduRef=CDD_DEV_BMS_Resp_00_XIX_BMC_CAN01_7e9f0997_Rx
        CDD_DEV_BMS_Resp_01_XIX_BMC_CAN01_5221f93c_Rx: CanIfRxPduCanId=469752321, CanIfRxPduCanIdType=EXTENDED_NO_FD_CAN, CanIfRxPduDlc=8, CanIfRxPduUserRxIndicationUL=CDD, CanIfRxPduHrhIdRef=CanIfInitHohCfg/CN_BMC_CAN01_d4211d16_Rx, CanIfRxPduRef=CDD_DEV_BMS_Resp_01_XIX_BMC_CAN01_5a1d58a1_Rx
        CDD_DEV_BMS_Resp_176_XIX_BMC_CAN01_24a6d07a_Rx: CanIfRxPduCanId=469752496, CanIfRxPduCanIdType=EXTENDED_NO_FD_CAN, CanIfRxPduDlc=8, CanIfRxPduUserRxIndicationUL=CDD, CanIfRxPduHrhIdRef=CanIfInitHohCfg/CN_BMC_CAN01_d4211d16_Rx, CanIfRxPduRef=CDD_DEV_BMS_Resp_176_XIX_BMC_CAN01_b99d2149_Rx
        CDD_DEV_BMS_Resp_177_XIX_BMC_CAN01_3aede51d_Rx: CanIfRxPduCanId=469752497, CanIfRxPduCanIdType=EXTENDED_NO_FD_CAN, CanIfRxPduDlc=8, CanIfRxPduUserRxIndicationUL=CDD, CanIfRxPduHrhIdRef=CanIfInitHohCfg/CN_BMC_CAN01_d4211d16_Rx, CanIfRxPduRef=CDD_DEV_BMS_Resp_177_XIX_BMC_CAN01_9d1f707f_Rx
        CDD_DEV_BMS_Resp_178_XIX_BMC_CAN01_9345c410_Rx: CanIfRxPduCanId=469752498, CanIfRxPduCanIdType=EXTENDED_NO_FD_CAN, CanIfRxPduDlc=8, CanIfRxPduUserRxIndicationUL=CDD, CanIfRxPduHrhIdRef=CanIfInitHohCfg/CN_BMC_CAN01_d4211d16_Rx, CanIfRxPduRef=CDD_DEV_BMS_Resp_178_XIX_BMC_CAN01_9df3480c_Rx
        CDD_DEV_BMS_Resp_192_XIX_BMC_CAN01_f05a6eb4_Rx: CanIfRxPduCanId=469752512, CanIfRxPduCanIdType=EXTENDED_NO_FD_CAN, CanIfRxPduDlc=8, CanIfRxPduUserRxIndicationUL=CDD, CanIfRxPduHrhIdRef=CanIfInitHohCfg/CN_BMC_CAN01_d4211d16_Rx, CanIfRxPduRef=CDD_DEV_BMS_Resp_192_XIX_BMC_CAN01_2d06bee7_Rx
        CDD_DEV_BMS_Resp_193_XIX_BMC_CAN01_ee115bd3_Rx: CanIfRxPduCanId=469752513, CanIfRxPduCanIdType=EXTENDED_NO_FD_CAN, CanIfRxPduDlc=8, CanIfRxPduUserRxIndicationUL=CDD, CanIfRxPduHrhIdRef=CanIfInitHohCfg/CN_BMC_CAN01_d4211d16_Rx, CanIfRxPduRef=CDD_DEV_BMS_Resp_193_XIX_BMC_CAN01_0984efd1_Rx
        CDD_DEV_BMS_Resp_194_XIX_BMC_CAN01_b5e0d1e6_Rx: CanIfRxPduCanId=469752514, CanIfRxPduCanIdType=EXTENDED_NO_FD_CAN, CanIfRxPduDlc=8, CanIfRxPduUserRxIndicationUL=CDD, CanIfRxPduHrhIdRef=CanIfInitHohCfg/CN_BMC_CAN01_d4211d16_Rx, CanIfRxPduRef=CDD_DEV_BMS_Resp_194_XIX_BMC_CAN01_f60b5853_Rx
        CDD_XCP_BJB_CRO_01_XIX_HCP5_CANFD01_3d029e5f_Rx: CanIfRxPduCanId=419221504, CanIfRxPduCanIdType=EXTENDED_FD_CAN, CanIfRxPduDlc=8, CanIfRxPduUserRxIndicationUL=CDD, CanIfRxPduHrhIdRef=CanIfInitHohCfg/CN_HCP5_CANFD01_c0785467_Rx, CanIfRxPduRef=CDD_XCP_BJB_CRO_01_XIX_HCP5_CANFD01_a8ba0d4f_Rx
        CDD_XCP_BJB_DTO_01_XIX_BMC_CAN01_2b6433b5_Rx: CanIfRxPduCanId=419221505, CanIfRxPduCanIdType=EXTENDED_NO_FD_CAN, CanIfRxPduDlc=8, CanIfRxPduUserRxIndicationUL=CDD, CanIfRxPduHrhIdRef=CanIfInitHohCfg/CN_BMC_CAN01_d4211d16_Rx, CanIfRxPduRef=CDD_XCP_BJB_DTO_01_XIX_BMC_CAN01_382ede28_Rx
        Charisma_20_XIX_HCP5_CANFD01_11748999_Rx: CanIfRxPduCanId=441800045, CanIfRxPduCanIdType=EXTENDED_FD_CAN, CanIfRxPduDlc=20, CanIfRxPduUserRxIndicationName=PduR_CanIfRxIndication, CanIfRxPduUserRxIndicationUL=PDUR, CanIfRxPduHrhIdRef=CanIfInitHohCfg/CN_HCP5_CANFD01_c0785467_Rx, CanIfRxPduRef=EcucPduCollection/Charisma_20_XIX_HCP5_CANFD01_be5e5e8a_Rx
        ClampControl_01_XIX_HCP5_CANFD01_7d795a05_Rx: CanIfRxPduCanId=316495102, CanIfRxPduCanIdType=EXTENDED_FD_CAN, CanIfRxPduDlc=8, CanIfRxPduUserRxIndicationName=PduR_CanIfRxIndication, CanIfRxPduUserRxIndicationUL=PDUR, CanIfRxPduHrhIdRef=CanIfInitHohCfg/CN_HCP5_CANFD01_c0785467_Rx, CanIfRxPduRef=ClampControl_01_XIX_HCP5_CANFD01_5af08b97_Rx
        DAAP_Funkt_Req_MC_FD_XIX_HCP5_CANFD01_0f64870b_Rx: CanIfRxPduCanId=474038237, CanIfRxPduCanIdType=EXTENDED_FD_CAN, CanIfRxPduDlc=8, CanIfRxPduUserRxIndicationName=CanTp_RxIndication, CanIfRxPduUserRxIndicationType=PDUID_PDUINFOPTR, CanIfRxPduUserRxIndicationUL=CAN_TP, CanIfRxPduHrhIdRef=CanIfInitHohCfg/CN_HCP5_CANFD01_c0785467_Rx, CanIfRxPduRef=DAAP_Funkt_Req_MC_FD_XIX_HCP5_CANFD01_dbe988f8_Rx
        DAAP_Hybrid_01_Req_FD_XIX_HCP5_CANFD01_7f38c4bd_Rx: CanIfRxPduCanId=473972603, CanIfRxPduCanIdType=EXTENDED_FD_CAN, CanIfRxPduDlc=64, CanIfRxPduUserRxIndicationName=CanTp_RxIndication, CanIfRxPduUserRxIndicationType=PDUID_PDUINFOPTR, CanIfRxPduUserRxIndicationUL=CAN_TP, CanIfRxPduHrhIdRef=CanIfInitHohCfg/CN_HCP5_CANFD01_c0785467_Rx, CanIfRxPduRef=DAAP_Hybrid_01_Req_FD_XIX_HCP5_CANFD01_25e2ca12_Rx
        DCDC_04_XIX_HCP5_CANFD01_b5498b76_Rx: CanIfRxPduCanId=247, CanIfRxPduCanIdType=STANDARD_FD_CAN, CanIfRxPduDlc=8, CanIfRxPduUserRxIndicationName=PduR_CanIfRxIndication, CanIfRxPduUserRxIndicationUL=PDUR, CanIfRxPduHrhIdRef=CanIfInitHohCfg/CN_HCP5_CANFD01_f532029f_Rx, CanIfRxPduRef=EcucPduCollection/DCDC_04_XIX_HCP5_CANFD01_622db5e5_Rx
        DCDC_NV_CALID_XIX_HCP5_CANFD01_3daa14f3_Rx: CanIfRxPduCanId=441800372, CanIfRxPduCanIdType=EXTENDED_FD_CAN, CanIfRxPduDlc=16, CanIfRxPduUserRxIndicationName=PduR_CanIfRxIndication, CanIfRxPduUserRxIndicationUL=PDUR, CanIfRxPduHrhIdRef=CanIfInitHohCfg/CN_HCP5_CANFD01_c0785467_Rx, CanIfRxPduRef=EcucPduCollection/DCDC_NV_CALID_XIX_HCP5_CANFD01_004a20bd_Rx
        DCDC_NV_CVN_XIX_HCP5_CANFD01_b19aee2b_Rx: CanIfRxPduCanId=441800373, CanIfRxPduCanIdType=EXTENDED_FD_CAN, CanIfRxPduDlc=8, CanIfRxPduUserRxIndicationName=PduR_CanIfRxIndication, CanIfRxPduUserRxIndicationUL=PDUR, CanIfRxPduHrhIdRef=CanIfInitHohCfg/CN_HCP5_CANFD01_c0785467_Rx, CanIfRxPduRef=EcucPduCollection/DCDC_NV_CVN_XIX_HCP5_CANFD01_01267e2b_Rx
        DCDC_NV_Komponentenfehler_01_XIX_HCP5_CANFD01_1d8ec98b_Rx: CanIfRxPduCanId=441800368, CanIfRxPduCanIdType=EXTENDED_FD_CAN, CanIfRxPduDlc=8, CanIfRxPduUserRxIndicationName=PduR_CanIfRxIndication, CanIfRxPduUserRxIndicationUL=PDUR, CanIfRxPduHrhIdRef=CanIfInitHohCfg/CN_HCP5_CANFD01_c0785467_Rx, CanIfRxPduRef=EcucPduCollection/DCDC_NV_Komponentenfehler_01_XIX_HCP5_CANFD01_2b1a3644_Rx
        DCDC_NV_Komponentenfehler_02_XIX_HCP5_CANFD01_1dc77f5e_Rx: CanIfRxPduCanId=441800369, CanIfRxPduCanIdType=EXTENDED_FD_CAN, CanIfRxPduDlc=8, CanIfRxPduUserRxIndicationName=PduR_CanIfRxIndication, CanIfRxPduUserRxIndicationUL=PDUR, CanIfRxPduHrhIdRef=CanIfInitHohCfg/CN_HCP5_CANFD01_c0785467_Rx, CanIfRxPduRef=EcucPduCollection/DCDC_NV_Komponentenfehler_02_XIX_HCP5_CANFD01_01a686cc_Rx
        DCDC_NV_Komponentenfehler_03_XIX_HCP5_CANFD01_ab2f10d2_Rx: CanIfRxPduCanId=441800370, CanIfRxPduCanIdType=EXTENDED_FD_CAN, CanIfRxPduDlc=8, CanIfRxPduUserRxIndicationName=PduR_CanIfRxIndication, CanIfRxPduUserRxIndicationUL=PDUR, CanIfRxPduHrhIdRef=CanIfInitHohCfg/CN_HCP5_CANFD01_c0785467_Rx, CanIfRxPduRef=EcucPduCollection/DCDC_NV_Komponentenfehler_03_XIX_HCP5_CANFD01_aee2148b_Rx
        DCDC_NV_Komponentenfehler_04_XIX_HCP5_CANFD01_1d5412f4_Rx: CanIfRxPduCanId=441800371, CanIfRxPduCanIdType=EXTENDED_FD_CAN, CanIfRxPduDlc=8, CanIfRxPduUserRxIndicationName=PduR_CanIfRxIndication, CanIfRxPduUserRxIndicationUL=PDUR, CanIfRxPduHrhIdRef=CanIfInitHohCfg/CN_HCP5_CANFD01_c0785467_Rx, CanIfRxPduRef=EcucPduCollection/DCDC_NV_Komponentenfehler_04_XIX_HCP5_CANFD01_54dfe7dc_Rx
        DEV_Hybrid_01_Req_00_XIX_HCP5_CANFD01_eff55ffe_Rx: CanIfRxPduCanId=469525248, CanIfRxPduCanIdType=EXTENDED_FD_CAN, CanIfRxPduDlc=64, CanIfRxPduUserRxIndicationName=PduR_CanIfRxIndication, CanIfRxPduUserRxIndicationUL=PDUR, CanIfRxPduHrhIdRef=CanIfInitHohCfg/CN_HCP5_CANFD01_c0785467_Rx, CanIfRxPduRef=EcucPduCollection/DEV_Hybrid_01_Req_00_XIX_HCP5_CANFD01_91241766_Rx
        DIA_BJB_Req_XIX_HCP5_CANFD01_a02c6805_Rx: CanIfRxPduCanId=402396880, CanIfRxPduCanIdType=EXTENDED_FD_CAN, CanIfRxPduDlc=8, CanIfRxPduUserRxIndicationName=CanTp_RxIndication, CanIfRxPduUserRxIndicationType=PDUID_PDUINFOPTR, CanIfRxPduUserRxIndicationUL=CAN_TP, CanIfRxPduHrhIdRef=CanIfInitHohCfg/CN_HCP5_CANFD01_c0785467_Rx, CanIfRxPduRef=DIA_BJB_Req_XIX_HCP5_CANFD01_f2b9e65d_Rx
        DIA_BJB_Resp_XIX_BMC_CAN01_0b8fd74e_Rx: CanIfRxPduCanId=402527952, CanIfRxPduCanIdType=EXTENDED_NO_FD_CAN, CanIfRxPduDlc=8, CanIfRxPduUserRxIndicationName=CanTp_RxIndication, CanIfRxPduUserRxIndicationType=PDUID_PDUINFOPTR, CanIfRxPduUserRxIndicationUL=CAN_TP, CanIfRxPduHrhIdRef=CanIfInitHohCfg/CN_BMC_CAN01_d4211d16_Rx, CanIfRxPduRef=DIA_BJB_Resp_XIX_BMC_CAN01_c04d7636_Rx
        DIA_UI2Sens01_Req_XIX_HCP5_CANFD01_6e8e422a_Rx: CanIfRxPduCanId=402397105, CanIfRxPduCanIdType=EXTENDED_FD_CAN, CanIfRxPduDlc=8, CanIfRxPduUserRxIndicationName=CanTp_RxIndication, CanIfRxPduUserRxIndicationType=PDUID_PDUINFOPTR, CanIfRxPduUserRxIndicationUL=CAN_TP, CanIfRxPduHrhIdRef=CanIfInitHohCfg/CN_HCP5_CANFD01_c0785467_Rx, CanIfRxPduRef=DIA_UI2Sens01_Req_XIX_HCP5_CANFD01_d86619ec_Rx
        DIA_UI2Sens01_Resp_XIX_BMC_CAN01_62d361ac_Rx: CanIfRxPduCanId=402528177, CanIfRxPduCanIdType=EXTENDED_NO_FD_CAN, CanIfRxPduDlc=8, CanIfRxPduUserRxIndicationName=CanTp_RxIndication, CanIfRxPduUserRxIndicationType=PDUID_PDUINFOPTR, CanIfRxPduUserRxIndicationUL=CAN_TP, CanIfRxPduHrhIdRef=CanIfInitHohCfg/CN_BMC_CAN01_d4211d16_Rx, CanIfRxPduRef=DIA_UI2Sens01_Resp_XIX_BMC_CAN01_2ddec3aa_Rx
        DIA_UI2Sens02_Req_XIX_HCP5_CANFD01_c2847047_Rx: CanIfRxPduCanId=402397106, CanIfRxPduCanIdType=EXTENDED_FD_CAN, CanIfRxPduDlc=8, CanIfRxPduUserRxIndicationName=CanTp_RxIndication, CanIfRxPduUserRxIndicationType=PDUID_PDUINFOPTR, CanIfRxPduUserRxIndicationUL=CAN_TP, CanIfRxPduHrhIdRef=CanIfInitHohCfg/CN_HCP5_CANFD01_c0785467_Rx, CanIfRxPduRef=DIA_UI2Sens02_Req_XIX_HCP5_CANFD01_a61e514a_Rx
        DIA_UI2Sens02_Resp_XIX_BMC_CAN01_3e7de423_Rx: CanIfRxPduCanId=402528178, CanIfRxPduCanIdType=EXTENDED_NO_FD_CAN, CanIfRxPduDlc=8, CanIfRxPduUserRxIndicationName=CanTp_RxIndication, CanIfRxPduUserRxIndicationType=PDUID_PDUINFOPTR, CanIfRxPduUserRxIndicationUL=CAN_TP, CanIfRxPduHrhIdRef=CanIfInitHohCfg/CN_BMC_CAN01_d4211d16_Rx, CanIfRxPduRef=DIA_UI2Sens02_Resp_XIX_BMC_CAN01_fe45df51_Rx
        Diagnose_01_XIX_HCP5_CANFD01_5c244c6c_Rx: CanIfRxPduCanId=1714, CanIfRxPduCanIdType=STANDARD_FD_CAN, CanIfRxPduDlc=8, CanIfRxPduUserRxIndicationName=PduR_CanIfRxIndication, CanIfRxPduUserRxIndicationUL=PDUR, CanIfRxPduHrhIdRef=CanIfInitHohCfg/CN_HCP5_CANFD01_f532029f_Rx, CanIfRxPduRef=EcucPduCollection/Diagnose_01_XIX_HCP5_CANFD01_95a294dc_Rx
        ELF_06_XIX_HCP5_CANFD01_e1ab79c8_Rx: CanIfRxPduCanId=380196274, CanIfRxPduCanIdType=EXTENDED_FD_CAN, CanIfRxPduDlc=8, CanIfRxPduUserRxIndicationName=PduR_CanIfRxIndication, CanIfRxPduUserRxIndicationUL=PDUR, CanIfRxPduHrhIdRef=CanIfInitHohCfg/CN_HCP5_CANFD01_c0785467_Rx, CanIfRxPduRef=EcucPduCollection/ELF_06_XIX_HCP5_CANFD01_21ac90a0_Rx
        HCP1_17_XIX_HCP5_CANFD01_26918939_Rx: CanIfRxPduCanId=380196250, CanIfRxPduCanIdType=EXTENDED_FD_CAN, CanIfRxPduDlc=8, CanIfRxPduUserRxIndicationName=PduR_CanIfRxIndication, CanIfRxPduUserRxIndicationUL=PDUR, CanIfRxPduHrhIdRef=CanIfInitHohCfg/CN_HCP5_CANFD01_c0785467_Rx, CanIfRxPduRef=EcucPduCollection/HCP1_17_XIX_HCP5_CANFD01_c544c746_Rx
        HVEM_07_XIX_HCP5_CANFD01_3c9ed0ba_Rx: CanIfRxPduCanId=184112327, CanIfRxPduCanIdType=EXTENDED_FD_CAN, CanIfRxPduDlc=32, CanIfRxPduUserRxIndicationName=PduR_CanIfRxIndication, CanIfRxPduUserRxIndicationUL=PDUR, CanIfRxPduHrhIdRef=CanIfInitHohCfg/CN_HCP5_CANFD01_c0785467_Rx, CanIfRxPduRef=EcucPduCollection/HVEM_07_XIX_HCP5_CANFD01_6bc428a9_Rx
        HVK_03_E2E_SOK_XIX_HCP5_CANFD01_d591f6b8_Rx: CanIfRxPduCanId=184112329, CanIfRxPduCanIdType=EXTENDED_FD_CAN, CanIfRxPduDlc=12, CanIfRxPduUserRxIndicationName=PduR_CanIfRxIndication, CanIfRxPduUserRxIndicationUL=PDUR, CanIfRxPduHrhIdRef=CanIfInitHohCfg/CN_HCP5_CANFD01_c0785467_Rx, CanIfRxPduRef=EcucPduCollection/HVK_03_E2E_SOK_XIX_HCP5_CANFD01_17f9ff97_Rx
        HVLM_13_XIX_HCP5_CANFD01_6bfc3f19_Rx: CanIfRxPduCanId=625, CanIfRxPduCanIdType=STANDARD_FD_CAN, CanIfRxPduDlc=32, CanIfRxPduUserRxIndicationName=PduR_CanIfRxIndication, CanIfRxPduUserRxIndicationUL=PDUR, CanIfRxPduHrhIdRef=CanIfInitHohCfg/CN_HCP5_CANFD01_f532029f_Rx, CanIfRxPduRef=EcucPduCollection/HVLM_13_XIX_HCP5_CANFD01_f34a06e4_Rx
        HVLM_14_XIX_HCP5_CANFD01_E2E_41f6788c_Rx: CanIfRxPduCanId=626, CanIfRxPduCanIdType=STANDARD_FD_CAN, CanIfRxPduDlc=8, CanIfRxPduUserRxIndicationName=PduR_CanIfRxIndication, CanIfRxPduUserRxIndicationUL=PDUR, CanIfRxPduHrhIdRef=CanIfInitHohCfg/CN_HCP5_CANFD01_f532029f_Rx, CanIfRxPduRef=EcucPduCollection/HVLM_14_XIX_HCP5_CANFD01_E2E_2623685a_Rx
        ISO_Funktionaler_Req_All_XIX_HCP5_CANFD01_073618f9_Rx: CanIfRxPduCanId=1792, CanIfRxPduCanIdType=STANDARD_FD_CAN, CanIfRxPduDlc=8, CanIfRxPduUserRxIndicationName=CanTp_RxIndication, CanIfRxPduUserRxIndicationType=PDUID_PDUINFOPTR, CanIfRxPduUserRxIndicationUL=CAN_TP, CanIfRxPduHrhIdRef=CanIfInitHohCfg/CN_HCP5_CANFD01_f532029f_Rx, CanIfRxPduRef=ISO_Funktionaler_Req_All_XIX_HCP5_CANFD01_e497e7f8_Rx
        ISOx_Funkt_Req_All_FD_XIX_HCP5_CANFD01_013aa570_Rx: CanIfRxPduCanId=474021888, CanIfRxPduCanIdType=EXTENDED_FD_CAN, CanIfRxPduDlc=64, CanIfRxPduUserRxIndicationName=CanTp_RxIndication, CanIfRxPduUserRxIndicationType=PDUID_PDUINFOPTR, CanIfRxPduUserRxIndicationUL=CAN_TP, CanIfRxPduHrhIdRef=CanIfInitHohCfg/CN_HCP5_CANFD01_c0785467_Rx, CanIfRxPduRef=ISOx_Funkt_Req_All_FD_XIX_HCP5_CANFD01_1dbb1bad_Rx
        ISOx_Hybrid_01_Req_FD_XIX_HCP5_CANFD01_40e70463_Rx: CanIfRxPduCanId=473956475, CanIfRxPduCanIdType=EXTENDED_FD_CAN, CanIfRxPduDlc=64, CanIfRxPduUserRxIndicationName=CanTp_RxIndication, CanIfRxPduUserRxIndicationType=PDUID_PDUINFOPTR, CanIfRxPduUserRxIndicationUL=CAN_TP, CanIfRxPduHrhIdRef=CanIfInitHohCfg/CN_HCP5_CANFD01_c0785467_Rx, CanIfRxPduRef=ISOx_Hybrid_01_Req_FD_XIX_HCP5_CANFD01_5affd0fb_Rx
        ISOx_Hybrid_01_Req_XIX_HCP5_CANFD01_815e7b57_Rx: CanIfRxPduCanId=402391163, CanIfRxPduCanIdType=EXTENDED_FD_CAN, CanIfRxPduDlc=8, CanIfRxPduUserRxIndicationName=CanTp_RxIndication, CanIfRxPduUserRxIndicationType=PDUID_PDUINFOPTR, CanIfRxPduUserRxIndicationUL=CAN_TP, CanIfRxPduHrhIdRef=CanIfInitHohCfg/CN_HCP5_CANFD01_c0785467_Rx, CanIfRxPduRef=ISOx_Hybrid_01_Req_XIX_HCP5_CANFD01_bd99bbef_Rx
        KS_Hybrid_01_Challenge_M_XIX_HCP5_CANFD01_61694a7e_Rx: CanIfRxPduCanId=441800151, CanIfRxPduCanIdType=EXTENDED_FD_CAN, CanIfRxPduDlc=12, CanIfRxPduUserRxIndicationName=PduR_CanIfRxIndication, CanIfRxPduUserRxIndicationUL=PDUR, CanIfRxPduHrhIdRef=CanIfInitHohCfg/CN_HCP5_CANFD01_c0785467_Rx, CanIfRxPduRef=EcucPduCollection/KS_Hybrid_01_Challenge_M_XIX_HCP5_CANFD01_a71be84d_Rx
        KS_Hybrid_01_Response_M_XIX_HCP5_CANFD01_af175552_Rx: CanIfRxPduCanId=441800154, CanIfRxPduCanIdType=EXTENDED_FD_CAN, CanIfRxPduDlc=12, CanIfRxPduUserRxIndicationName=PduR_CanIfRxIndication, CanIfRxPduUserRxIndicationUL=PDUR, CanIfRxPduHrhIdRef=CanIfInitHohCfg/CN_HCP5_CANFD01_c0785467_Rx, CanIfRxPduRef=EcucPduCollection/KS_Hybrid_01_Response_M_XIX_HCP5_CANFD01_1b34419b_Rx
        NVEM_12_XIX_HCP5_CANFD01_47eee303_Rx: CanIfRxPduCanId=567, CanIfRxPduCanIdType=STANDARD_FD_CAN, CanIfRxPduDlc=12, CanIfRxPduUserRxIndicationName=PduR_CanIfRxIndication, CanIfRxPduUserRxIndicationUL=PDUR, CanIfRxPduHrhIdRef=CanIfInitHohCfg/CN_HCP5_CANFD01_f532029f_Rx, CanIfRxPduRef=EcucPduCollection/NVEM_12_XIX_HCP5_CANFD01_27d236bb_Rx
        NmNode_BMC_HV_XIX_BMC_CAN01_a81f589c_Rx: CanIfRxPduCanIdType=EXTENDED_NO_FD_CAN, CanIfRxPduDlc=8, CanIfRxPduUserRxIndicationName=CanNm_RxIndication, CanIfRxPduUserRxIndicationUL=CAN_NM, CanIfRxPduHrhIdRef=CanIfInitHohCfg/CN_BMC_CAN01_d4211d16_Rx, CanIfRxPduRef=NmNode_BMC_HV_XIX_BMC_CAN01_a39ed100_Rx
          CHNL_4b38bcce (CanIfRxPduCanIdRange): CanIfRxPduCanIdRangeLowerCanId=452984832, CanIfRxPduCanIdRangeUpperCanId=452985855
        NmNode_BMC_HV_XIX_HCP5_CANFD01_044b03b2_Rx: CanIfRxPduCanIdType=EXTENDED_FD_CAN, CanIfRxPduDlc=24, CanIfRxPduUserRxIndicationName=CanNm_RxIndication, CanIfRxPduUserRxIndicationUL=CAN_NM, CanIfRxPduHrhIdRef=CanIfInitHohCfg/CN_HCP5_CANFD01_c0785467_Rx, CanIfRxPduRef=NmNode_BMC_HV_XIX_HCP5_CANFD01_c8c687b4_Rx
          CHNL_74dce3ec (CanIfRxPduCanIdRange): CanIfRxPduCanIdRangeLowerCanId=452984832, CanIfRxPduCanIdRangeUpperCanId=452985855
        OBDC_Funktionaler_Req_All_FD_XIX_HCP5_CANFD01_88d59169_Rx: CanIfRxPduCanId=474022400, CanIfRxPduCanIdType=EXTENDED_FD_CAN, CanIfRxPduDlc=64, CanIfRxPduUserRxIndicationName=CanTp_RxIndication, CanIfRxPduUserRxIndicationType=PDUID_PDUINFOPTR, CanIfRxPduUserRxIndicationUL=CAN_TP, CanIfRxPduHrhIdRef=CanIfInitHohCfg/CN_HCP5_CANFD01_c0785467_Rx, CanIfRxPduRef=OBDC_Funktionaler_Req_All_FD_XIX_HCP5_CANFD01_d0af7a5a_Rx
        OBDC_Hybrid_01_Req_FD_XIX_HCP5_CANFD01_72b989a9_Rx: CanIfRxPduCanId=473956987, CanIfRxPduCanIdType=EXTENDED_FD_CAN, CanIfRxPduDlc=64, CanIfRxPduUserRxIndicationName=CanTp_RxIndication, CanIfRxPduUserRxIndicationType=PDUID_PDUINFOPTR, CanIfRxPduUserRxIndicationUL=CAN_TP, CanIfRxPduHrhIdRef=CanIfInitHohCfg/CN_HCP5_CANFD01_c0785467_Rx, CanIfRxPduRef=OBDC_Hybrid_01_Req_FD_XIX_HCP5_CANFD01_38935bdf_Rx
        OBDC_SSN_BJB_Req_XIX_HCP5_CANFD01_537affe6_Rx: CanIfRxPduCanId=402419920, CanIfRxPduCanIdType=EXTENDED_FD_CAN, CanIfRxPduDlc=8, CanIfRxPduUserRxIndicationName=CanTp_RxIndication, CanIfRxPduUserRxIndicationType=PDUID_PDUINFOPTR, CanIfRxPduUserRxIndicationUL=CAN_TP, CanIfRxPduHrhIdRef=CanIfInitHohCfg/CN_HCP5_CANFD01_c0785467_Rx, CanIfRxPduRef=OBDC_SSN_BJB_Req_XIX_HCP5_CANFD01_87b9d88e_Rx
        OBDC_SSN_BJB_Resp_XIX_BMC_CAN01_49e1db6f_Rx: CanIfRxPduCanId=402550992, CanIfRxPduCanIdType=EXTENDED_NO_FD_CAN, CanIfRxPduDlc=8, CanIfRxPduUserRxIndicationName=CanTp_RxIndication, CanIfRxPduUserRxIndicationType=PDUID_PDUINFOPTR, CanIfRxPduUserRxIndicationUL=CAN_TP, CanIfRxPduHrhIdRef=CanIfInitHohCfg/CN_BMC_CAN01_d4211d16_Rx, CanIfRxPduRef=OBDC_SSN_BJB_Resp_XIX_BMC_CAN01_d5ca69f5_Rx
        OBDC_SSN_UI2Sens01_Req_XIX_HCP5_CANFD01_adaf415b_Rx: CanIfRxPduCanId=402420145, CanIfRxPduCanIdType=EXTENDED_FD_CAN, CanIfRxPduDlc=8, CanIfRxPduUserRxIndicationName=CanTp_RxIndication, CanIfRxPduUserRxIndicationType=PDUID_PDUINFOPTR, CanIfRxPduUserRxIndicationUL=CAN_TP, CanIfRxPduHrhIdRef=CanIfInitHohCfg/CN_HCP5_CANFD01_c0785467_Rx, CanIfRxPduRef=OBDC_SSN_UI2Sens01_Req_XIX_HCP5_CANFD01_00e7db31_Rx
        OBDC_SSN_UI2Sens01_Resp_XIX_BMC_CAN01_33d311c0_Rx: CanIfRxPduCanId=402551217, CanIfRxPduCanIdType=EXTENDED_NO_FD_CAN, CanIfRxPduDlc=8, CanIfRxPduUserRxIndicationName=CanTp_RxIndication, CanIfRxPduUserRxIndicationType=PDUID_PDUINFOPTR, CanIfRxPduUserRxIndicationUL=CAN_TP, CanIfRxPduHrhIdRef=CanIfInitHohCfg/CN_BMC_CAN01_d4211d16_Rx, CanIfRxPduRef=OBDC_SSN_UI2Sens01_Resp_XIX_BMC_CAN01_327140fa_Rx
        OBDC_SSN_UI2Sens02_Req_XIX_HCP5_CANFD01_359d756d_Rx: CanIfRxPduCanId=402420146, CanIfRxPduCanIdType=EXTENDED_FD_CAN, CanIfRxPduDlc=8, CanIfRxPduUserRxIndicationName=CanTp_RxIndication, CanIfRxPduUserRxIndicationType=PDUID_PDUINFOPTR, CanIfRxPduUserRxIndicationUL=CAN_TP, CanIfRxPduHrhIdRef=CanIfInitHohCfg/CN_HCP5_CANFD01_c0785467_Rx, CanIfRxPduRef=OBDC_SSN_UI2Sens02_Req_XIX_HCP5_CANFD01_7e9f9397_Rx
        OBDC_SSN_UI2Sens02_Resp_XIX_BMC_CAN01_007c0617_Rx: CanIfRxPduCanId=402551218, CanIfRxPduCanIdType=EXTENDED_NO_FD_CAN, CanIfRxPduDlc=8, CanIfRxPduUserRxIndicationName=CanTp_RxIndication, CanIfRxPduUserRxIndicationType=PDUID_PDUINFOPTR, CanIfRxPduUserRxIndicationUL=CAN_TP, CanIfRxPduHrhIdRef=CanIfInitHohCfg/CN_BMC_CAN01_d4211d16_Rx, CanIfRxPduRef=OBDC_SSN_UI2Sens02_Resp_XIX_BMC_CAN01_e1ea5c01_Rx
        OBD_03_XIX_HCP5_CANFD01_e444f1b2_Rx: CanIfRxPduCanId=380196140, CanIfRxPduCanIdType=EXTENDED_FD_CAN, CanIfRxPduDlc=8, CanIfRxPduUserRxIndicationName=PduR_CanIfRxIndication, CanIfRxPduUserRxIndicationUL=PDUR, CanIfRxPduHrhIdRef=CanIfInitHohCfg/CN_HCP5_CANFD01_c0785467_Rx, CanIfRxPduRef=OBD_03_XIX_HCP5_CANFD01_2635ffad_Rx
        OBD_04_XIX_HCP5_CANFD01_942a7d61_Rx: CanIfRxPduCanId=380196171, CanIfRxPduCanIdType=EXTENDED_FD_CAN, CanIfRxPduDlc=8, CanIfRxPduUserRxIndicationName=PduR_CanIfRxIndication, CanIfRxPduUserRxIndicationUL=PDUR, CanIfRxPduHrhIdRef=CanIfInitHohCfg/CN_HCP5_CANFD01_c0785467_Rx, CanIfRxPduRef=OBD_04_XIX_HCP5_CANFD01_dc080cfa_Rx
        OBD_HCP1_SOK_XIX_HCP5_CANFD01_7e7ec6e6_Rx: CanIfRxPduCanId=400818191, CanIfRxPduCanIdType=EXTENDED_FD_CAN, CanIfRxPduDlc=6, CanIfRxPduUserRxIndicationName=PduR_CanIfRxIndication, CanIfRxPduUserRxIndicationUL=PDUR, CanIfRxPduHrhIdRef=CanIfInitHohCfg/CN_HCP5_CANFD01_c0785467_Rx, CanIfRxPduRef=EcucPduCollection/OBD_HCP1_SOK_XIX_HCP5_CANFD01_a5806350_Rx
        OBDx_Hybrid_01_Req_XIX_HCP5_CANFD01_5e9dd14f_Rx: CanIfRxPduCanId=416941553, CanIfRxPduCanIdType=EXTENDED_FD_CAN, CanIfRxPduDlc=8, CanIfRxPduUserRxIndicationName=CanTp_RxIndication, CanIfRxPduUserRxIndicationType=PDUID_PDUINFOPTR, CanIfRxPduUserRxIndicationUL=CAN_TP, CanIfRxPduHrhIdRef=CanIfInitHohCfg/CN_HCP5_CANFD01_c0785467_Rx, CanIfRxPduRef=OBDx_Hybrid_01_Req_XIX_HCP5_CANFD01_5cba35a0_Rx
        OBDx_allOBD_Req_XIX_HCP5_CANFD01_d9c59ad6_Rx: CanIfRxPduCanId=417018865, CanIfRxPduCanIdType=EXTENDED_FD_CAN, CanIfRxPduDlc=8, CanIfRxPduUserRxIndicationName=CanTp_RxIndication, CanIfRxPduUserRxIndicationType=PDUID_PDUINFOPTR, CanIfRxPduUserRxIndicationUL=CAN_TP, CanIfRxPduHrhIdRef=CanIfInitHohCfg/CN_HCP5_CANFD01_c0785467_Rx, CanIfRxPduRef=OBDx_allOBD_Req_XIX_HCP5_CANFD01_a7e21e7c_Rx
        OBG_01_XIX_HCP5_CANFD01_83b149e5_Rx: CanIfRxPduCanId=316495128, CanIfRxPduCanIdType=EXTENDED_FD_CAN, CanIfRxPduDlc=64, CanIfRxPduUserRxIndicationName=PduR_CanIfRxIndication, CanIfRxPduUserRxIndicationUL=PDUR, CanIfRxPduHrhIdRef=CanIfInitHohCfg/CN_HCP5_CANFD01_c0785467_Rx, CanIfRxPduRef=EcucPduCollection/OBG_01_XIX_HCP5_CANFD01_6af9c66f_Rx
        ORU_01_XIX_HCP5_CANFD01_d9ecf2b6_Rx: CanIfRxPduCanId=441800008, CanIfRxPduCanIdType=EXTENDED_FD_CAN, CanIfRxPduDlc=8, CanIfRxPduUserRxIndicationName=PduR_CanIfRxIndication, CanIfRxPduUserRxIndicationUL=PDUR, CanIfRxPduHrhIdRef=CanIfInitHohCfg/CN_HCP5_CANFD01_c0785467_Rx, CanIfRxPduRef=ORU_01_XIX_HCP5_CANFD01_81d7dd4c_Rx
        ORU_Control_A_01_XIX_HCP5_CANFD01_E2E_3ce3caba_Rx: CanIfRxPduCanId=441799804, CanIfRxPduCanIdType=EXTENDED_FD_CAN, CanIfRxPduDlc=8, CanIfRxPduUserRxIndicationName=PduR_CanIfRxIndication, CanIfRxPduUserRxIndicationUL=PDUR, CanIfRxPduHrhIdRef=CanIfInitHohCfg/CN_HCP5_CANFD01_c0785467_Rx, CanIfRxPduRef=ORU_Control_A_01_XIX_HCP5_CANFD01_E2E_893c1989_Rx
        ORU_Control_D_01_XIX_HCP5_CANFD01_E2E_70882d8f_Rx: CanIfRxPduCanId=380196245, CanIfRxPduCanIdType=EXTENDED_FD_CAN, CanIfRxPduDlc=8, CanIfRxPduUserRxIndicationName=PduR_CanIfRxIndication, CanIfRxPduUserRxIndicationUL=PDUR, CanIfRxPduHrhIdRef=CanIfInitHohCfg/CN_HCP5_CANFD01_c0785467_Rx, CanIfRxPduRef=ORU_Control_D_01_XIX_HCP5_CANFD01_E2E_9ed03939_Rx
        OTAMC_D_01_XIX_HCP5_CANFD01_E2E_762c73ec_Rx: CanIfRxPduCanId=380196246, CanIfRxPduCanIdType=EXTENDED_FD_CAN, CanIfRxPduDlc=4, CanIfRxPduUserRxIndicationName=PduR_CanIfRxIndication, CanIfRxPduUserRxIndicationUL=PDUR, CanIfRxPduHrhIdRef=CanIfInitHohCfg/CN_HCP5_CANFD01_c0785467_Rx, CanIfRxPduRef=OTAMC_D_01_XIX_HCP5_CANFD01_E2E_8283a85d_Rx
        OTP_01_XIX_HCP5_CANFD01_7701dadd_Rx: CanIfRxPduCanId=380196106, CanIfRxPduCanIdType=EXTENDED_FD_CAN, CanIfRxPduDlc=8, CanIfRxPduUserRxIndicationName=PduR_CanIfRxIndication, CanIfRxPduUserRxIndicationUL=PDUR, CanIfRxPduHrhIdRef=CanIfInitHohCfg/CN_HCP5_CANFD01_c0785467_Rx, CanIfRxPduRef=EcucPduCollection/OTP_01_XIX_HCP5_CANFD01_fd0a6756_Rx
        SOK_NoAuthenticTime_01_XIX_HCP5_CANFD01_258b3943_Rx: CanIfRxPduCanId=441800108, CanIfRxPduCanIdType=EXTENDED_FD_CAN, CanIfRxPduDlc=8, CanIfRxPduUserRxIndicationName=PduR_CanIfRxIndication, CanIfRxPduUserRxIndicationUL=PDUR, CanIfRxPduHrhIdRef=CanIfInitHohCfg/CN_HCP5_CANFD01_c0785467_Rx, CanIfRxPduRef=EcucPduCollection/SOK_NoAuthenticTime_01_XIX_HCP5_CANFD01_8db7a3c2_Rx
        SOK_Zeit_Hybrid_01_Resp_01_SOK_XIX_HCP5_CANFD01_dd7a6d66_Rx: CanIfRxPduCanId=316801147, CanIfRxPduCanIdType=EXTENDED_FD_CAN, CanIfRxPduDlc=16, CanIfRxPduUserRxIndicationName=PduR_CanIfRxIndication, CanIfRxPduUserRxIndicationUL=PDUR, CanIfRxPduHrhIdRef=CanIfInitHohCfg/CN_HCP5_CANFD01_c0785467_Rx, CanIfRxPduRef=EcucPduCollection/SOK_Zeit_Hybrid_01_Resp_01_SOK_XIX_HCP5_CANFD01_7ac24361_Rx
        Systeminfo_01_XIX_HCP5_CANFD01_46cbe0b5_Rx: CanIfRxPduCanId=1413, CanIfRxPduCanIdType=STANDARD_FD_CAN, CanIfRxPduDlc=8, CanIfRxPduUserRxIndicationName=PduR_CanIfRxIndication, CanIfRxPduUserRxIndicationUL=PDUR, CanIfRxPduHrhIdRef=CanIfInitHohCfg/CN_HCP5_CANFD01_f532029f_Rx, CanIfRxPduRef=Systeminfo_01_XIX_HCP5_CANFD01_1ca8fa11_Rx
        Thermomanagement_01_XIX_HCP5_CANFD01_6e8ab5ae_Rx: CanIfRxPduCanId=316495126, CanIfRxPduCanIdType=EXTENDED_FD_CAN, CanIfRxPduDlc=64, CanIfRxPduUserRxIndicationName=PduR_CanIfRxIndication, CanIfRxPduUserRxIndicationUL=PDUR, CanIfRxPduHrhIdRef=CanIfInitHohCfg/CN_HCP5_CANFD01_c0785467_Rx, CanIfRxPduRef=EcucPduCollection/Thermomanagement_01_XIX_HCP5_CANFD01_bb71c5fe_Rx
        UI1_01_XIX_BMC_CAN01_E2E_a06471fb_Rx: CanIfRxPduCanId=752, CanIfRxPduCanIdType=STANDARD_NO_FD_CAN, CanIfRxPduDlc=8, CanIfRxPduUserRxIndicationName=PduR_CanIfRxIndication, CanIfRxPduUserRxIndicationUL=PDUR, CanIfRxPduHrhIdRef=CanIfInitHohCfg/CN_BMC_CAN01_e16b4bee_Rx, CanIfRxPduRef=EcucPduCollection/UI1_01_XIX_BMC_CAN01_E2E_e77bac14_Rx
        UI1_02_XIX_BMC_CAN01_E2E_ba04f082_Rx: CanIfRxPduCanId=753, CanIfRxPduCanIdType=STANDARD_NO_FD_CAN, CanIfRxPduDlc=8, CanIfRxPduUserRxIndicationName=PduR_CanIfRxIndication, CanIfRxPduUserRxIndicationUL=PDUR, CanIfRxPduHrhIdRef=CanIfInitHohCfg/CN_BMC_CAN01_e16b4bee_Rx, CanIfRxPduRef=EcucPduCollection/UI1_02_XIX_BMC_CAN01_E2E_aa93ac73_Rx
        UI1_03_XIX_BMC_CAN01_c99c20bf_Rx: CanIfRxPduCanId=754, CanIfRxPduCanIdType=STANDARD_NO_FD_CAN, CanIfRxPduDlc=8, CanIfRxPduUserRxIndicationName=PduR_CanIfRxIndication, CanIfRxPduUserRxIndicationUL=PDUR, CanIfRxPduHrhIdRef=CanIfInitHohCfg/CN_BMC_CAN01_e16b4bee_Rx, CanIfRxPduRef=EcucPduCollection/UI1_03_XIX_BMC_CAN01_0abdbc10_Rx
        UI1_04_XIX_BMC_CAN01_4d9274e7_Rx: CanIfRxPduCanId=316494940, CanIfRxPduCanIdType=EXTENDED_NO_FD_CAN, CanIfRxPduDlc=8, CanIfRxPduUserRxIndicationName=PduR_CanIfRxIndication, CanIfRxPduUserRxIndicationUL=PDUR, CanIfRxPduHrhIdRef=CanIfInitHohCfg/CN_BMC_CAN01_d4211d16_Rx, CanIfRxPduRef=EcucPduCollection/UI1_04_XIX_BMC_CAN01_f5320b92_Rx
        UI1_05_XIX_BMC_CAN01_b5cd6b62_Rx: CanIfRxPduCanId=316494941, CanIfRxPduCanIdType=EXTENDED_NO_FD_CAN, CanIfRxPduDlc=8, CanIfRxPduUserRxIndicationName=PduR_CanIfRxIndication, CanIfRxPduUserRxIndicationUL=PDUR, CanIfRxPduHrhIdRef=CanIfInitHohCfg/CN_BMC_CAN01_d4211d16_Rx, CanIfRxPduRef=EcucPduCollection/UI1_05_XIX_BMC_CAN01_d1b05aa4_Rx
        UI1_Komponentenfehler_01_XIX_BMC_CAN01_f42bd274_Rx: CanIfRxPduCanId=316495134, CanIfRxPduCanIdType=EXTENDED_NO_FD_CAN, CanIfRxPduDlc=8, CanIfRxPduUserRxIndicationName=PduR_CanIfRxIndication, CanIfRxPduUserRxIndicationUL=PDUR, CanIfRxPduHrhIdRef=CanIfInitHohCfg/CN_BMC_CAN01_d4211d16_Rx, CanIfRxPduRef=EcucPduCollection/UI1_Komponentenfehler_01_XIX_BMC_CAN01_0b0d2b23_Rx
        UI1_Komponentenfehler_02_XIX_BMC_CAN01_2191a967_Rx: CanIfRxPduCanId=316495135, CanIfRxPduCanIdType=EXTENDED_NO_FD_CAN, CanIfRxPduDlc=8, CanIfRxPduUserRxIndicationName=PduR_CanIfRxIndication, CanIfRxPduUserRxIndicationUL=PDUR, CanIfRxPduHrhIdRef=CanIfInitHohCfg/CN_BMC_CAN01_d4211d16_Rx, CanIfRxPduRef=EcucPduCollection/UI1_Komponentenfehler_02_XIX_BMC_CAN01_668bd879_Rx
        UI2Sens01_CALID_01_XIX_BMC_CAN01_9dffcac2_Rx: CanIfRxPduCanId=441799878, CanIfRxPduCanIdType=EXTENDED_NO_FD_CAN, CanIfRxPduDlc=8, CanIfRxPduUserRxIndicationName=PduR_CanIfRxIndication, CanIfRxPduUserRxIndicationUL=PDUR, CanIfRxPduHrhIdRef=CanIfInitHohCfg/CN_BMC_CAN01_d4211d16_Rx, CanIfRxPduRef=EcucPduCollection/UI2Sens01_CALID_01_XIX_BMC_CAN01_6126d1bc_Rx
        UI2Sens01_CALID_02_XIX_BMC_CAN01_82a14c39_Rx: CanIfRxPduCanId=441799879, CanIfRxPduCanIdType=EXTENDED_NO_FD_CAN, CanIfRxPduDlc=8, CanIfRxPduUserRxIndicationName=PduR_CanIfRxIndication, CanIfRxPduUserRxIndicationUL=PDUR, CanIfRxPduHrhIdRef=CanIfInitHohCfg/CN_BMC_CAN01_d4211d16_Rx, CanIfRxPduRef=EcucPduCollection/UI2Sens01_CALID_02_XIX_BMC_CAN01_0ca022e6_Rx
        UI2Sens01_CVN_XIX_BMC_CAN01_740a4da5_Rx: CanIfRxPduCanId=441799882, CanIfRxPduCanIdType=EXTENDED_NO_FD_CAN, CanIfRxPduDlc=8, CanIfRxPduUserRxIndicationName=PduR_CanIfRxIndication, CanIfRxPduUserRxIndicationUL=PDUR, CanIfRxPduHrhIdRef=CanIfInitHohCfg/CN_BMC_CAN01_d4211d16_Rx, CanIfRxPduRef=EcucPduCollection/UI2Sens01_CVN_XIX_BMC_CAN01_7910df29_Rx
        UI2Sens02_CALID_01_XIX_BMC_CAN01_9d62397c_Rx: CanIfRxPduCanId=441799880, CanIfRxPduCanIdType=EXTENDED_NO_FD_CAN, CanIfRxPduDlc=8, CanIfRxPduUserRxIndicationName=PduR_CanIfRxIndication, CanIfRxPduUserRxIndicationUL=PDUR, CanIfRxPduHrhIdRef=CanIfInitHohCfg/CN_BMC_CAN01_d4211d16_Rx, CanIfRxPduRef=EcucPduCollection/UI2Sens02_CALID_01_XIX_BMC_CAN01_a812cab1_Rx
        UI2Sens02_CALID_02_XIX_BMC_CAN01_823cbf87_Rx: CanIfRxPduCanId=441799881, CanIfRxPduCanIdType=EXTENDED_NO_FD_CAN, CanIfRxPduDlc=8, CanIfRxPduUserRxIndicationName=PduR_CanIfRxIndication, CanIfRxPduUserRxIndicationUL=PDUR, CanIfRxPduHrhIdRef=CanIfInitHohCfg/CN_BMC_CAN01_d4211d16_Rx, CanIfRxPduRef=EcucPduCollection/UI2Sens02_CALID_02_XIX_BMC_CAN01_c59439eb_Rx
        UI2Sens02_CVN_XIX_BMC_CAN01_b7afa2a5_Rx: CanIfRxPduCanId=441799883, CanIfRxPduCanIdType=EXTENDED_NO_FD_CAN, CanIfRxPduDlc=8, CanIfRxPduUserRxIndicationName=PduR_CanIfRxIndication, CanIfRxPduUserRxIndicationUL=PDUR, CanIfRxPduHrhIdRef=CanIfInitHohCfg/CN_BMC_CAN01_d4211d16_Rx, CanIfRxPduRef=EcucPduCollection/UI2Sens02_CVN_XIX_BMC_CAN01_34f8df4e_Rx
        UI2_01_XIX_BMC_CAN01_E2E_946eea6c_Rx: CanIfRxPduCanId=755, CanIfRxPduCanIdType=STANDARD_NO_FD_CAN, CanIfRxPduDlc=8, CanIfRxPduUserRxIndicationName=PduR_CanIfRxIndication, CanIfRxPduUserRxIndicationUL=PDUR, CanIfRxPduHrhIdRef=CanIfInitHohCfg/CN_BMC_CAN01_e16b4bee_Rx, CanIfRxPduRef=EcucPduCollection/UI2_01_XIX_BMC_CAN01_E2E_04321bb6_Rx
        UI2_02_XIX_BMC_CAN01_E2E_8e0e6b15_Rx: CanIfRxPduCanId=756, CanIfRxPduCanIdType=STANDARD_NO_FD_CAN, CanIfRxPduDlc=8, CanIfRxPduUserRxIndicationName=PduR_CanIfRxIndication, CanIfRxPduUserRxIndicationUL=PDUR, CanIfRxPduHrhIdRef=CanIfInitHohCfg/CN_BMC_CAN01_e16b4bee_Rx, CanIfRxPduRef=EcucPduCollection/UI2_02_XIX_BMC_CAN01_E2E_49da1bd1_Rx
        UI2_03_XIX_BMC_CAN01_E2E_87d1ebc2_Rx: CanIfRxPduCanId=757, CanIfRxPduCanIdType=STANDARD_NO_FD_CAN, CanIfRxPduDlc=8, CanIfRxPduUserRxIndicationName=PduR_CanIfRxIndication, CanIfRxPduUserRxIndicationUL=PDUR, CanIfRxPduHrhIdRef=CanIfInitHohCfg/CN_BMC_CAN01_e16b4bee_Rx, CanIfRxPduRef=EcucPduCollection/UI2_03_XIX_BMC_CAN01_E2E_c452e633_Rx
        UI2_04_XIX_BMC_CAN01_e572df1e_Rx: CanIfRxPduCanId=316494942, CanIfRxPduCanIdType=EXTENDED_NO_FD_CAN, CanIfRxPduDlc=8, CanIfRxPduUserRxIndicationName=PduR_CanIfRxIndication, CanIfRxPduUserRxIndicationUL=PDUR, CanIfRxPduHrhIdRef=CanIfInitHohCfg/CN_BMC_CAN01_d4211d16_Rx, CanIfRxPduRef=EcucPduCollection/UI2_04_XIX_BMC_CAN01_af5334f2_Rx
        UI2_Komponentenfehler_01_XIX_BMC_CAN01_351ca71f_Rx: CanIfRxPduCanId=316495136, CanIfRxPduCanIdType=EXTENDED_NO_FD_CAN, CanIfRxPduDlc=8, CanIfRxPduUserRxIndicationName=PduR_CanIfRxIndication, CanIfRxPduUserRxIndicationUL=PDUR, CanIfRxPduHrhIdRef=CanIfInitHohCfg/CN_BMC_CAN01_d4211d16_Rx, CanIfRxPduRef=EcucPduCollection/UI2_Komponentenfehler_01_XIX_BMC_CAN01_6d09fe13_Rx
        UI2_Komponentenfehler_02_XIX_BMC_CAN01_e0a6dc0c_Rx: CanIfRxPduCanId=316495137, CanIfRxPduCanIdType=EXTENDED_NO_FD_CAN, CanIfRxPduDlc=8, CanIfRxPduUserRxIndicationName=PduR_CanIfRxIndication, CanIfRxPduUserRxIndicationUL=PDUR, CanIfRxPduHrhIdRef=CanIfInitHohCfg/CN_BMC_CAN01_d4211d16_Rx, CanIfRxPduRef=EcucPduCollection/UI2_Komponentenfehler_02_XIX_BMC_CAN01_008f0d49_Rx
        VDSO_05_XIX_HCP5_CANFD01_8df4a50a_Rx: CanIfRxPduCanId=92, CanIfRxPduCanIdType=STANDARD_FD_CAN, CanIfRxPduDlc=8, CanIfRxPduUserRxIndicationName=PduR_CanIfRxIndication, CanIfRxPduUserRxIndicationUL=PDUR, CanIfRxPduHrhIdRef=CanIfInitHohCfg/CN_HCP5_CANFD01_f532029f_Rx, CanIfRxPduRef=EcucPduCollection/VDSO_05_XIX_HCP5_CANFD01_f45d20ad_Rx
        WFS_02_XIX_HCP5_CANFD01_bbb255a9_Rx: CanIfRxPduCanId=441799750, CanIfRxPduCanIdType=EXTENDED_FD_CAN, CanIfRxPduDlc=32, CanIfRxPduUserRxIndicationName=PduR_CanIfRxIndication, CanIfRxPduUserRxIndicationUL=PDUR, CanIfRxPduHrhIdRef=CanIfInitHohCfg/CN_HCP5_CANFD01_c0785467_Rx, CanIfRxPduRef=EcucPduCollection/WFS_02_XIX_HCP5_CANFD01_a0e8c21d_Rx
        XCP_Hybrid_01_CRO_01_FD_XIX_HCP5_CANFD01_906d0391_Rx: CanIfRxPduCanId=469526272, CanIfRxPduCanIdType=EXTENDED_FD_CAN, CanIfRxPduDlc=64, CanIfRxPduUserRxIndicationName=Xcp_CanIfRxIndication, CanIfRxPduUserRxIndicationUL=XCP, CanIfRxPduHrhIdRef=CanIfInitHohCfg/CN_HCP5_CANFD01_c0785467_Rx, CanIfRxPduRef=EcucPduCollection/XCP_Hybrid_01_CRO_01_FD_XIX_HCP5_CANFD01_f21b8ba9_Rx
        ZeitMaster_01_XIX_HCP5_CANFD01_505b3779_Rx: CanIfRxPduCanId=441800119, CanIfRxPduCanIdType=EXTENDED_FD_CAN, CanIfRxPduDlc=8, CanIfRxPduUserRxIndicationName=PduR_CanIfRxIndication, CanIfRxPduUserRxIndicationUL=PDUR, CanIfRxPduHrhIdRef=CanIfInitHohCfg/CN_HCP5_CANFD01_c0785467_Rx, CanIfRxPduRef=EcucPduCollection/ZeitMaster_01_XIX_HCP5_CANFD01_16302e51_Rx
        Zeitmaster_05_XIX_HCP5_CANFD01_9723d66f_Rx: CanIfRxPduCanId=441800106, CanIfRxPduCanIdType=EXTENDED_FD_CAN, CanIfRxPduDlc=8, CanIfRxPduUserRxIndicationName=PduR_CanIfRxIndication, CanIfRxPduUserRxIndicationUL=PDUR, CanIfRxPduHrhIdRef=CanIfInitHohCfg/CN_HCP5_CANFD01_c0785467_Rx, CanIfRxPduRef=EcucPduCollection/Zeitmaster_05_XIX_HCP5_CANFD01_1d48ef0a_Rx
      65 x CanIfTxPduCfg:
        BMC_CMC_Temperatur_01_XIX_HCP5_CANFD01_5b37e798_Tx: CanIfTxPduCanId=441800234, CanIfTxPduCanIdType=EXTENDED_FD_CAN, CanIfTxPduDlc=64, CanIfTxPduUserTxConfirmationName=PduR_CanIfTxConfirmation, CanIfTxPduUserTxConfirmationUL=PDUR, CanIfTxPduBufferRef=CanIfInitCfg/CHNL_b74a53a7, CanIfTxPduRef=EcucPduCollection/BMC_CMC_Temperatur_01_XIX_HCP5_CANFD01_0fcecf3e_Tx
        BMC_CMC_Temperatur_02_XIX_HCP5_CANFD01_2994fe9f_Tx: CanIfTxPduCanId=441800235, CanIfTxPduCanIdType=EXTENDED_FD_CAN, CanIfTxPduDlc=24, CanIfTxPduUserTxConfirmationName=PduR_CanIfTxConfirmation, CanIfTxPduUserTxConfirmationUL=PDUR, CanIfTxPduBufferRef=CanIfInitCfg/CHNL_b74a53a7, CanIfTxPduRef=EcucPduCollection/BMC_CMC_Temperatur_02_XIX_HCP5_CANFD01_25727fb6_Tx
        BMC_CMC_Temperatur_03_XIX_HCP5_CANFD01_07f5f662_Tx: CanIfTxPduCanId=441800300, CanIfTxPduCanIdType=EXTENDED_FD_CAN, CanIfTxPduDlc=64, CanIfTxPduUserTxConfirmationName=PduR_CanIfTxConfirmation, CanIfTxPduUserTxConfirmationUL=PDUR, CanIfTxPduBufferRef=CanIfInitCfg/CHNL_b74a53a7, CanIfTxPduRef=EcucPduCollection/BMC_CMC_Temperatur_03_XIX_HCP5_CANFD01_8a36edf1_Tx
        BMC_CMC_Zellspannung_01_XIX_HCP5_CANFD01_649be5e8_Tx: CanIfTxPduCanId=441800236, CanIfTxPduCanIdType=EXTENDED_FD_CAN, CanIfTxPduDlc=64, CanIfTxPduUserTxConfirmationName=PduR_CanIfTxConfirmation, CanIfTxPduUserTxConfirmationUL=PDUR, CanIfTxPduBufferRef=CanIfInitCfg/CHNL_b74a53a7, CanIfTxPduRef=EcucPduCollection/BMC_CMC_Zellspannung_01_XIX_HCP5_CANFD01_e1187d1c_Tx
        BMC_CMC_Zellspannung_02_XIX_HCP5_CANFD01_d4fe46af_Tx: CanIfTxPduCanId=441800237, CanIfTxPduCanIdType=EXTENDED_FD_CAN, CanIfTxPduDlc=64, CanIfTxPduUserTxConfirmationName=PduR_CanIfTxConfirmation, CanIfTxPduUserTxConfirmationUL=PDUR, CanIfTxPduBufferRef=CanIfInitCfg/CHNL_b74a53a7, CanIfTxPduRef=EcucPduCollection/BMC_CMC_Zellspannung_02_XIX_HCP5_CANFD01_cba4cd94_Tx
        BMC_CMC_Zellspannung_03_XIX_HCP5_CANFD01_0df225ad_Tx: CanIfTxPduCanId=441800238, CanIfTxPduCanIdType=EXTENDED_FD_CAN, CanIfTxPduDlc=64, CanIfTxPduUserTxConfirmationName=PduR_CanIfTxConfirmation, CanIfTxPduUserTxConfirmationUL=PDUR, CanIfTxPduBufferRef=CanIfInitCfg/CHNL_b74a53a7, CanIfTxPduRef=EcucPduCollection/BMC_CMC_Zellspannung_03_XIX_HCP5_CANFD01_64e05fd3_Tx
        BMC_CMC_Zellspannung_04_XIX_HCP5_CANFD01_6f440660_Tx: CanIfTxPduCanId=441800239, CanIfTxPduCanIdType=EXTENDED_FD_CAN, CanIfTxPduDlc=64, CanIfTxPduUserTxConfirmationName=PduR_CanIfTxConfirmation, CanIfTxPduUserTxConfirmationUL=PDUR, CanIfTxPduBufferRef=CanIfInitCfg/CHNL_b74a53a7, CanIfTxPduRef=EcucPduCollection/BMC_CMC_Zellspannung_04_XIX_HCP5_CANFD01_9eddac84_Tx
        BMC_CMC_Zellspannung_05_XIX_HCP5_CANFD01_b6486562_Tx: CanIfTxPduCanId=441800240, CanIfTxPduCanIdType=EXTENDED_FD_CAN, CanIfTxPduDlc=64, CanIfTxPduUserTxConfirmationName=PduR_CanIfTxConfirmation, CanIfTxPduUserTxConfirmationUL=PDUR, CanIfTxPduBufferRef=CanIfInitCfg/CHNL_b74a53a7, CanIfTxPduRef=EcucPduCollection/BMC_CMC_Zellspannung_05_XIX_HCP5_CANFD01_31993ec3_Tx
        BMC_HV_01_E2E_SOK_XIX_HCP5_CANFD01_e2d584a8_Tx: CanIfTxPduCanId=275, CanIfTxPduCanIdType=STANDARD_FD_CAN, CanIfTxPduDlc=20, CanIfTxPduUserTxConfirmationName=PduR_CanIfTxConfirmation, CanIfTxPduUserTxConfirmationUL=PDUR, CanIfTxPduBufferRef=CanIfInitCfg/CHNL_b74a53a7, CanIfTxPduRef=EcucPduCollection/BMC_HV_01_E2E_SOK_XIX_HCP5_CANFD01_09a7f969_Tx
        BMC_HV_02_E2E_SOK_XIX_HCP5_CANFD01_4edfb6c5_Tx: CanIfTxPduCanId=316495124, CanIfTxPduCanIdType=EXTENDED_FD_CAN, CanIfTxPduDlc=48, CanIfTxPduUserTxConfirmationName=PduR_CanIfTxConfirmation, CanIfTxPduUserTxConfirmationUL=PDUR, CanIfTxPduBufferRef=CanIfInitCfg/CHNL_b74a53a7, CanIfTxPduRef=EcucPduCollection/BMC_HV_02_E2E_SOK_XIX_HCP5_CANFD01_4f75cc0d_Tx
        BMC_HV_03_XIX_HCP5_CANFD01_605a1c21_Tx: CanIfTxPduCanId=441800021, CanIfTxPduCanIdType=EXTENDED_FD_CAN, CanIfTxPduDlc=24, CanIfTxPduUserTxConfirmationName=PduR_CanIfTxConfirmation, CanIfTxPduUserTxConfirmationUL=PDUR, CanIfTxPduBufferRef=CanIfInitCfg/CHNL_b74a53a7, CanIfTxPduRef=EcucPduCollection/BMC_HV_03_XIX_HCP5_CANFD01_58321150_Tx
        BMC_HV_04_XIX_BMC_CAN01_E2E_501aae6e_Tx: CanIfTxPduCanId=380196111, CanIfTxPduCanIdType=EXTENDED_CAN, CanIfTxPduDlc=8, CanIfTxPduUserTxConfirmationName=PduR_CanIfTxConfirmation, CanIfTxPduUserTxConfirmationUL=PDUR, CanIfTxPduBufferRef=CanIfInitCfg/CHNL_eb535f7d, CanIfTxPduRef=EcucPduCollection/BMC_HV_04_XIX_BMC_CAN01_E2E_24b17933_Tx
        BMC_HV_05_XIX_HCP5_CANFD01_ecda9e3f_Tx: CanIfTxPduCanId=603, CanIfTxPduCanIdType=STANDARD_FD_CAN, CanIfTxPduDlc=8, CanIfTxPduUserTxConfirmationName=PduR_CanIfTxConfirmation, CanIfTxPduUserTxConfirmationUL=PDUR, CanIfTxPduBufferRef=CanIfInitCfg/CHNL_b74a53a7, CanIfTxPduRef=EcucPduCollection/BMC_HV_05_XIX_HCP5_CANFD01_0d4b7040_Tx
        BMC_HV_06_SOK_XIX_HCP5_CANFD01_393d3e1d_Tx: CanIfTxPduCanId=380196118, CanIfTxPduCanIdType=EXTENDED_FD_CAN, CanIfTxPduDlc=12, CanIfTxPduUserTxConfirmationName=PduR_CanIfTxConfirmation, CanIfTxPduUserTxConfirmationUL=PDUR, CanIfTxPduBufferRef=CanIfInitCfg/CHNL_b74a53a7, CanIfTxPduRef=EcucPduCollection/BMC_HV_06_SOK_XIX_HCP5_CANFD01_daff2390_Tx
        BMC_HV_07_SOK_XIX_HCP5_CANFD01_4db4bab2_Tx: CanIfTxPduCanId=380196146, CanIfTxPduCanIdType=EXTENDED_FD_CAN, CanIfTxPduDlc=12, CanIfTxPduUserTxConfirmationName=PduR_CanIfTxConfirmation, CanIfTxPduUserTxConfirmationUL=PDUR, CanIfTxPduBufferRef=CanIfInitCfg/CHNL_b74a53a7, CanIfTxPduRef=EcucPduCollection/BMC_HV_07_SOK_XIX_HCP5_CANFD01_f0d71bf2_Tx
        BMC_HV_08_SOK_XIX_HCP5_CANFD01_cbd70a44_Tx: CanIfTxPduCanId=441800241, CanIfTxPduCanIdType=EXTENDED_FD_CAN, CanIfTxPduDlc=48, CanIfTxPduUserTxConfirmationName=PduR_CanIfTxConfirmation, CanIfTxPduUserTxConfirmationUL=PDUR, CanIfTxPduBufferRef=CanIfInitCfg/CHNL_b74a53a7, CanIfTxPduRef=EcucPduCollection/BMC_HV_08_SOK_XIX_HCP5_CANFD01_ac3f778d_Tx
        BMC_HV_09_SOK_XIX_HCP5_CANFD01_bf5e8eeb_Tx: CanIfTxPduCanId=316495251, CanIfTxPduCanIdType=EXTENDED_FD_CAN, CanIfTxPduDlc=20, CanIfTxPduUserTxConfirmationName=PduR_CanIfTxConfirmation, CanIfTxPduUserTxConfirmationUL=PDUR, CanIfTxPduBufferRef=CanIfInitCfg/CHNL_b74a53a7, CanIfTxPduRef=EcucPduCollection/BMC_HV_09_SOK_XIX_HCP5_CANFD01_86174fef_Tx
        BMC_HV_10_XIX_BMC_CAN01_E2E_2092c60e_Tx: CanIfTxPduCanId=441800483, CanIfTxPduCanIdType=EXTENDED_CAN, CanIfTxPduDlc=8, CanIfTxPduUserTxConfirmationName=PduR_CanIfTxConfirmation, CanIfTxPduUserTxConfirmationUL=PDUR, CanIfTxPduBufferRef=CanIfInitCfg/CHNL_eb535f7d, CanIfTxPduRef=EcucPduCollection/BMC_HV_10_XIX_BMC_CAN01_E2E_31888fd1_Tx
        BMC_HV_11_XIX_BMC_CAN01_E2E_4a00e54f_Tx: CanIfTxPduCanId=441800494, CanIfTxPduCanIdType=EXTENDED_CAN, CanIfTxPduDlc=8, CanIfTxPduUserTxConfirmationName=PduR_CanIfTxConfirmation, CanIfTxPduUserTxConfirmationUL=PDUR, CanIfTxPduBufferRef=CanIfInitCfg/CHNL_eb535f7d, CanIfTxPduRef=EcucPduCollection/BMC_HV_11_XIX_BMC_CAN01_E2E_bc007233_Tx
        BMC_HV_12_XIX_BMC_CAN01_E2E_f5b6808c_Tx: CanIfTxPduCanId=441800487, CanIfTxPduCanIdType=EXTENDED_CAN, CanIfTxPduDlc=8, CanIfTxPduUserTxConfirmationName=PduR_CanIfTxConfirmation, CanIfTxPduUserTxConfirmationUL=PDUR, CanIfTxPduBufferRef=CanIfInitCfg/CHNL_eb535f7d, CanIfTxPduRef=EcucPduCollection/BMC_HV_12_XIX_BMC_CAN01_E2E_f1e87254_Tx
        BMC_HV_13_XIX_BMC_CAN01_E2E_9f24a3cd_Tx: CanIfTxPduCanId=441800488, CanIfTxPduCanIdType=EXTENDED_CAN, CanIfTxPduDlc=8, CanIfTxPduUserTxConfirmationName=PduR_CanIfTxConfirmation, CanIfTxPduUserTxConfirmationUL=PDUR, CanIfTxPduBufferRef=CanIfInitCfg/CHNL_eb535f7d, CanIfTxPduRef=EcucPduCollection/BMC_HV_13_XIX_BMC_CAN01_E2E_7c608fb6_Tx
        BMC_HV_14_SOK_XIX_HCP5_CANFD01_963300be_Tx: CanIfTxPduCanId=316495300, CanIfTxPduCanIdType=STANDARD_FD_CAN, CanIfTxPduDlc=16, CanIfTxPduUserTxConfirmationName=PduR_CanIfTxConfirmation, CanIfTxPduUserTxConfirmationUL=PDUR, CanIfTxPduBufferRef=CanIfInitCfg/CHNL_b74a53a7, CanIfTxPduRef=EcucPduCollection/BMC_HV_14_SOK_XIX_HCP5_CANFD01_2d397b18_Tx
        CDD_DEV_BJB_Req_01_XIX_BMC_CAN01_3aafbc32_Tx: CanIfTxPduCanId=419352576, CanIfTxPduCanIdType=EXTENDED_CAN, CanIfTxPduDlc=8, CanIfTxPduUserTxConfirmationUL=CDD, CanIfTxPduBufferRef=CanIfInitCfg/CHNL_eb535f7d, CanIfTxPduRef=CDD_DEV_BJB_Req_01_XIX_BMC_CAN01_3719e18f_Tx
        CDD_DEV_BJB_Resp_FF_XIX_HCP5_CANFD01_398cd71c_Tx: CanIfTxPduCanId=419352831, CanIfTxPduCanIdType=EXTENDED_FD_CAN, CanIfTxPduDlc=8, CanIfTxPduUserTxConfirmationUL=CDD, CanIfTxPduBufferRef=CanIfInitCfg/CHNL_b74a53a7, CanIfTxPduRef=CDD_DEV_BJB_Resp_FF_XIX_HCP5_CANFD01_77e6d841_Tx
        CDD_XCP_BJB_CRO_01_XIX_BMC_CAN01_da5ef3bc_Tx: CanIfTxPduCanId=419221504, CanIfTxPduCanIdType=EXTENDED_CAN, CanIfTxPduDlc=8, CanIfTxPduUserTxConfirmationUL=CDD, CanIfTxPduBufferRef=CanIfInitCfg/CHNL_eb535f7d, CanIfTxPduRef=CDD_XCP_BJB_CRO_01_XIX_BMC_CAN01_9130eaf8_Tx
        CDD_XCP_BJB_DTO_01_XIX_HCP5_CANFD01_d6e0c0ba_Tx: CanIfTxPduCanId=419221505, CanIfTxPduCanIdType=EXTENDED_FD_CAN, CanIfTxPduDlc=8, CanIfTxPduUserTxConfirmationUL=CDD, CanIfTxPduBufferRef=CanIfInitCfg/CHNL_b74a53a7, CanIfTxPduRef=CDD_XCP_BJB_DTO_01_XIX_HCP5_CANFD01_884a4965_Tx
        ClampControl_01_XIX_BMC_CAN01_cd1b5cf5_Tx: CanIfTxPduCanId=316495102, CanIfTxPduCanIdType=EXTENDED_CAN, CanIfTxPduDlc=8, CanIfTxPduUserTxConfirmationName=PduR_CanIfTxConfirmation, CanIfTxPduUserTxConfirmationUL=PDUR, CanIfTxPduBufferRef=CanIfInitCfg/CHNL_eb535f7d, CanIfTxPduRef=ClampControl_01_XIX_BMC_CAN01_6c74ee25_Tx
        DAAP_Hybrid_01_Resp_FD_XIX_HCP5_CANFD01_c0d93a5e_Tx: CanIfTxPduCanId=474103675, CanIfTxPduCanIdType=EXTENDED_FD_CAN, CanIfTxPduDlc=64, CanIfTxPduUserTxConfirmationName=CanTp_TxConfirmation, CanIfTxPduUserTxConfirmationUL=CAN_TP, CanIfTxPduBufferRef=CanIfInitCfg/CHNL_b74a53a7, CanIfTxPduRef=DAAP_Hybrid_01_Resp_FD_XIX_HCP5_CANFD01_a869e288_Tx
        DEV_Hybrid_01_Resp_FF_XIX_HCP5_CANFD01_7c961ae1_Tx: CanIfTxPduCanId=469525503, CanIfTxPduCanIdType=EXTENDED_FD_CAN, CanIfTxPduDlc=64, CanIfTxPduUserTxConfirmationName=PduR_CanIfTxConfirmation, CanIfTxPduUserTxConfirmationUL=PDUR, CanIfTxPduBufferRef=CanIfInitCfg/CHNL_b74a53a7, CanIfTxPduRef=EcucPduCollection/DEV_Hybrid_01_Resp_FF_XIX_HCP5_CANFD01_3aa35b5c_Tx
        DIA_BJB_Req_XIX_BMC_CAN01_4f76a5c7_Tx: CanIfTxPduCanId=402396880, CanIfTxPduCanIdType=EXTENDED_CAN, CanIfTxPduDlc=8, CanIfTxPduUserTxConfirmationName=CanTp_TxConfirmation, CanIfTxPduUserTxConfirmationUL=CAN_TP, CanIfTxPduBufferRef=CanIfInitCfg/CHNL_eb535f7d, CanIfTxPduRef=DIA_BJB_Req_XIX_BMC_CAN01_6c84b0d8_Tx
        DIA_BJB_Resp_XIX_HCP5_CANFD01_007e70da_Tx: CanIfTxPduCanId=402527952, CanIfTxPduCanIdType=EXTENDED_FD_CAN, CanIfTxPduDlc=8, CanIfTxPduUserTxConfirmationName=CanTp_TxConfirmation, CanIfTxPduUserTxConfirmationUL=CAN_TP, CanIfTxPduBufferRef=CanIfInitCfg/CHNL_b74a53a7, CanIfTxPduRef=DIA_BJB_Resp_XIX_HCP5_CANFD01_6385845c_Tx
        DIA_UI2Sens01_Req_XIX_BMC_CAN01_34978bb8_Tx: CanIfTxPduCanId=402397105, CanIfTxPduCanIdType=EXTENDED_CAN, CanIfTxPduDlc=8, CanIfTxPduUserTxConfirmationName=CanTp_TxConfirmation, CanIfTxPduUserTxConfirmationUL=CAN_TP, CanIfTxPduBufferRef=CanIfInitCfg/CHNL_eb535f7d, CanIfTxPduRef=DIA_UI2Sens01_Req_XIX_BMC_CAN01_47b20c58_Tx
        DIA_UI2Sens01_Resp_XIX_HCP5_CANFD01_27bbe557_Tx: CanIfTxPduCanId=402528177, CanIfTxPduCanIdType=EXTENDED_FD_CAN, CanIfTxPduDlc=8, CanIfTxPduUserTxConfirmationName=CanTp_TxConfirmation, CanIfTxPduUserTxConfirmationUL=CAN_TP, CanIfTxPduBufferRef=CanIfInitCfg/CHNL_b74a53a7, CanIfTxPduRef=DIA_UI2Sens01_Resp_XIX_HCP5_CANFD01_dfc9d8b9_Tx
        DIA_UI2Sens02_Req_XIX_BMC_CAN01_39198196_Tx: CanIfTxPduCanId=402397106, CanIfTxPduCanIdType=EXTENDED_CAN, CanIfTxPduDlc=8, CanIfTxPduUserTxConfirmationName=CanTp_TxConfirmation, CanIfTxPduUserTxConfirmationUL=CAN_TP, CanIfTxPduBufferRef=CanIfInitCfg/CHNL_eb535f7d, CanIfTxPduRef=DIA_UI2Sens02_Req_XIX_BMC_CAN01_0a5a0c3f_Tx
        DIA_UI2Sens02_Resp_XIX_HCP5_CANFD01_88436504_Tx: CanIfTxPduCanId=402528178, CanIfTxPduCanIdType=EXTENDED_FD_CAN, CanIfTxPduDlc=8, CanIfTxPduUserTxConfirmationName=CanTp_TxConfirmation, CanIfTxPduUserTxConfirmationUL=CAN_TP, CanIfTxPduBufferRef=CanIfInitCfg/CHNL_b74a53a7, CanIfTxPduRef=DIA_UI2Sens02_Resp_XIX_HCP5_CANFD01_e002a62c_Tx
        DS_Hybrid_01_XIX_HCP5_CANFD01_fed380d4_Tx: CanIfTxPduCanId=401342587, CanIfTxPduCanIdType=EXTENDED_FD_CAN, CanIfTxPduDlc=8, CanIfTxPduUserTxConfirmationName=PduR_CanIfTxConfirmation, CanIfTxPduUserTxConfirmationUL=PDUR, CanIfTxPduBufferRef=CanIfInitCfg/CHNL_b74a53a7, CanIfTxPduRef=EcucPduCollection/DS_Hybrid_01_XIX_HCP5_CANFD01_ed9ff9e4_Tx
        ISO_Funktionaler_Req_All_XIX_BMC_CAN01_b97cd406_Tx: CanIfTxPduCanId=1792, CanIfTxPduCanIdType=STANDARD_CAN, CanIfTxPduDlc=8, CanIfTxPduUserTxConfirmationName=CanTp_TxConfirmation, CanIfTxPduUserTxConfirmationUL=CAN_TP, CanIfTxPduBufferRef=CanIfInitCfg/CHNL_eb535f7d, CanIfTxPduRef=ISO_Funktionaler_Req_All_XIX_BMC_CAN01_aaf5996b_Tx
        ISOx_Hybrid_01_Resp_FD_XIX_HCP5_CANFD01_67e8ccae_Tx: CanIfTxPduCanId=474087547, CanIfTxPduCanIdType=EXTENDED_FD_CAN, CanIfTxPduDlc=64, CanIfTxPduUserTxConfirmationName=CanTp_TxConfirmation, CanIfTxPduUserTxConfirmationUL=CAN_TP, CanIfTxPduBufferRef=CanIfInitCfg/CHNL_b74a53a7, CanIfTxPduRef=ISOx_Hybrid_01_Resp_FD_XIX_HCP5_CANFD01_71c0a54e_Tx
        ISOx_Hybrid_01_Resp_XIX_HCP5_CANFD01_6ceb2cbe_Tx: CanIfTxPduCanId=402522235, CanIfTxPduCanIdType=EXTENDED_FD_CAN, CanIfTxPduDlc=8, CanIfTxPduUserTxConfirmationName=CanTp_TxConfirmation, CanIfTxPduUserTxConfirmationUL=CAN_TP, CanIfTxPduBufferRef=CanIfInitCfg/CHNL_b74a53a7, CanIfTxPduRef=ISOx_Hybrid_01_Resp_XIX_HCP5_CANFD01_46a576a1_Tx
        KN_Hybrid_01_XIX_HCP5_CANFD01_c84a3ea5_Tx: CanIfTxPduCanId=401604731, CanIfTxPduCanIdType=EXTENDED_FD_CAN, CanIfTxPduDlc=16, CanIfTxPduUserTxConfirmationName=PduR_CanIfTxConfirmation, CanIfTxPduUserTxConfirmationUL=PDUR, CanIfTxPduBufferRef=CanIfInitCfg/CHNL_b74a53a7, CanIfTxPduRef=EcucPduCollection/KN_Hybrid_01_XIX_HCP5_CANFD01_3c12b6a6_Tx
        KS_Hybrid_01_Challenge_K_XIX_HCP5_CANFD01_d5302dac_Tx: CanIfTxPduCanId=441800150, CanIfTxPduCanIdType=EXTENDED_FD_CAN, CanIfTxPduDlc=12, CanIfTxPduUserTxConfirmationName=PduR_CanIfTxConfirmation, CanIfTxPduUserTxConfirmationUL=PDUR, CanIfTxPduBufferRef=CanIfInitCfg/CHNL_b74a53a7, CanIfTxPduRef=EcucPduCollection/KS_Hybrid_01_Challenge_K_XIX_HCP5_CANFD01_f262895d_Tx
        KS_Hybrid_01_ReqFrame_XIX_HCP5_CANFD01_2f090e23_Tx: CanIfTxPduCanId=441800152, CanIfTxPduCanIdType=EXTENDED_FD_CAN, CanIfTxPduDlc=8, CanIfTxPduUserTxConfirmationName=PduR_CanIfTxConfirmation, CanIfTxPduUserTxConfirmationUL=PDUR, CanIfTxPduBufferRef=CanIfInitCfg/CHNL_b74a53a7, CanIfTxPduRef=EcucPduCollection/KS_Hybrid_01_ReqFrame_XIX_HCP5_CANFD01_d7f937e5_Tx
        KS_Hybrid_01_Response_K_XIX_HCP5_CANFD01_14ad159d_Tx: CanIfTxPduCanId=441800153, CanIfTxPduCanIdType=EXTENDED_FD_CAN, CanIfTxPduDlc=12, CanIfTxPduUserTxConfirmationName=PduR_CanIfTxConfirmation, CanIfTxPduUserTxConfirmationUL=PDUR, CanIfTxPduBufferRef=CanIfInitCfg/CHNL_b74a53a7, CanIfTxPduRef=EcucPduCollection/KS_Hybrid_01_Response_K_XIX_HCP5_CANFD01_4e4d208b_Tx
        NMH_Hybrid_01_XIX_BMC_CAN01_92052a44_Tx: CanIfTxPduCanId=452984955, CanIfTxPduCanIdType=EXTENDED_CAN, CanIfTxPduDlc=8, CanIfTxPduUserTxConfirmationName=CanNm_TxConfirmation, CanIfTxPduUserTxConfirmationUL=CAN_NM, CanIfTxPduBufferRef=CanIfInitCfg/CHNL_eb535f7d, CanIfTxPduRef=EcucPduCollection/NMH_Hybrid_01_XIX_BMC_CAN01_30f8f2db_Tx
        NM_Hybrid_01_XIX_HCP5_CANFD01_07855dca_Tx: CanIfTxPduCanId=452984955, CanIfTxPduCanIdType=EXTENDED_FD_CAN, CanIfTxPduDlc=24, CanIfTxPduUserTxConfirmationName=CanNm_TxConfirmation, CanIfTxPduUserTxConfirmationUL=CAN_NM, CanIfTxPduBufferRef=CanIfInitCfg/CHNL_b74a53a7, CanIfTxPduRef=EcucPduCollection/NM_Hybrid_01_XIX_HCP5_CANFD01_3f17aba9_Tx
        OBDC_Funktionaler_Req_All_XIX_BMC_CAN01_d0beae2e_Tx: CanIfTxPduCanId=402457088, CanIfTxPduCanIdType=EXTENDED_CAN, CanIfTxPduDlc=8, CanIfTxPduUserTxConfirmationName=CanTp_TxConfirmation, CanIfTxPduUserTxConfirmationUL=CAN_TP, CanIfTxPduBufferRef=CanIfInitCfg/CHNL_eb535f7d, CanIfTxPduRef=OBDC_Funktionaler_Req_All_XIX_BMC_CAN01_c40642be_Tx
        OBDC_Hybrid_01_Resp_FD_XIX_HCP5_CANFD01_0bc90f29_Tx: CanIfTxPduCanId=474088059, CanIfTxPduCanIdType=EXTENDED_FD_CAN, CanIfTxPduDlc=64, CanIfTxPduUserTxConfirmationName=CanTp_TxConfirmation, CanIfTxPduUserTxConfirmationUL=CAN_TP, CanIfTxPduBufferRef=CanIfInitCfg/CHNL_b74a53a7, CanIfTxPduRef=OBDC_Hybrid_01_Resp_FD_XIX_HCP5_CANFD01_4da12d14_Tx
        OBDC_SSN_BJB_Req_XIX_BMC_CAN01_6c60ffed_Tx: CanIfTxPduCanId=402419920, CanIfTxPduCanIdType=EXTENDED_CAN, CanIfTxPduDlc=8, CanIfTxPduUserTxConfirmationName=CanTp_TxConfirmation, CanIfTxPduUserTxConfirmationUL=CAN_TP, CanIfTxPduBufferRef=CanIfInitCfg/CHNL_eb535f7d, CanIfTxPduRef=OBDC_SSN_BJB_Req_XIX_BMC_CAN01_31b63a85_Tx
        OBDC_SSN_BJB_Resp_XIX_HCP5_CANFD01_03965832_Tx: CanIfTxPduCanId=402550992, CanIfTxPduCanIdType=EXTENDED_FD_CAN, CanIfTxPduDlc=8, CanIfTxPduUserTxConfirmationName=CanTp_TxConfirmation, CanIfTxPduUserTxConfirmationUL=CAN_TP, CanIfTxPduBufferRef=CanIfInitCfg/CHNL_b74a53a7, CanIfTxPduRef=OBDC_SSN_BJB_Resp_XIX_HCP5_CANFD01_7c2a070c_Tx
        OBDC_SSN_UI2Sens01_Req_XIX_BMC_CAN01_168a293f_Tx: CanIfTxPduCanId=402420145, CanIfTxPduCanIdType=EXTENDED_CAN, CanIfTxPduDlc=8, CanIfTxPduUserTxConfirmationName=CanTp_TxConfirmation, CanIfTxPduUserTxConfirmationUL=CAN_TP, CanIfTxPduBufferRef=CanIfInitCfg/CHNL_eb535f7d, CanIfTxPduRef=OBDC_SSN_UI2Sens01_Req_XIX_BMC_CAN01_32b2328b_Tx
        OBDC_SSN_UI2Sens01_Resp_XIX_HCP5_CANFD01_60cebe88_Tx: CanIfTxPduCanId=402551217, CanIfTxPduCanIdType=EXTENDED_FD_CAN, CanIfTxPduDlc=8, CanIfTxPduUserTxConfirmationName=CanTp_TxConfirmation, CanIfTxPduUserTxConfirmationUL=CAN_TP, CanIfTxPduBufferRef=CanIfInitCfg/CHNL_b74a53a7, CanIfTxPduRef=OBDC_SSN_UI2Sens01_Resp_XIX_HCP5_CANFD01_2773f712_Tx
        OBDC_SSN_UI2Sens02_Req_XIX_BMC_CAN01_f554d12a_Tx: CanIfTxPduCanId=402420146, CanIfTxPduCanIdType=EXTENDED_CAN, CanIfTxPduDlc=8, CanIfTxPduUserTxConfirmationName=CanTp_TxConfirmation, CanIfTxPduUserTxConfirmationUL=CAN_TP, CanIfTxPduBufferRef=CanIfInitCfg/CHNL_eb535f7d, CanIfTxPduRef=OBDC_SSN_UI2Sens02_Req_XIX_BMC_CAN01_7f5a32ec_Tx
        OBDC_SSN_UI2Sens02_Resp_XIX_HCP5_CANFD01_7f1a2b49_Tx: CanIfTxPduCanId=402551218, CanIfTxPduCanIdType=EXTENDED_FD_CAN, CanIfTxPduDlc=8, CanIfTxPduUserTxConfirmationName=CanTp_TxConfirmation, CanIfTxPduUserTxConfirmationUL=CAN_TP, CanIfTxPduBufferRef=CanIfInitCfg/CHNL_b74a53a7, CanIfTxPduRef=OBDC_SSN_UI2Sens02_Resp_XIX_HCP5_CANFD01_18b88987_Tx
        OBD_03_XIX_BMC_CAN01_5578af9b_Tx: CanIfTxPduCanId=380196140, CanIfTxPduCanIdType=EXTENDED_CAN, CanIfTxPduDlc=8, CanIfTxPduUserTxConfirmationName=PduR_CanIfTxConfirmation, CanIfTxPduUserTxConfirmationUL=PDUR, CanIfTxPduBufferRef=CanIfInitCfg/CHNL_eb535f7d, CanIfTxPduRef=OBD_03_XIX_BMC_CAN01_5c2c79fc_Tx
        OBD_04_XIX_BMC_CAN01_d176fbc3_Tx: CanIfTxPduCanId=380196171, CanIfTxPduCanIdType=EXTENDED_CAN, CanIfTxPduDlc=8, CanIfTxPduUserTxConfirmationName=PduR_CanIfTxConfirmation, CanIfTxPduUserTxConfirmationUL=PDUR, CanIfTxPduBufferRef=CanIfInitCfg/CHNL_eb535f7d, CanIfTxPduRef=OBD_04_XIX_BMC_CAN01_a3a3ce7e_Tx
        OBD_Hybrid_01_SOK_XIX_HCP5_CANFD01_6bce45f5_Tx: CanIfTxPduCanId=400818181, CanIfTxPduCanIdType=EXTENDED_FD_CAN, CanIfTxPduDlc=6, CanIfTxPduUserTxConfirmationName=PduR_CanIfTxConfirmation, CanIfTxPduUserTxConfirmationUL=PDUR, CanIfTxPduBufferRef=CanIfInitCfg/CHNL_b74a53a7, CanIfTxPduRef=EcucPduCollection/OBD_Hybrid_01_SOK_XIX_HCP5_CANFD01_c373a414_Tx
        OBDx_Hybrid_01_Resp_XIX_HCP5_CANFD01_8c0081cb_Tx: CanIfTxPduCanId=417001733, CanIfTxPduCanIdType=EXTENDED_FD_CAN, CanIfTxPduDlc=8, CanIfTxPduUserTxConfirmationName=CanTp_TxConfirmation, CanIfTxPduUserTxConfirmationUL=CAN_TP, CanIfTxPduBufferRef=CanIfInitCfg/CHNL_b74a53a7, CanIfTxPduRef=OBDx_Hybrid_01_Resp_XIX_HCP5_CANFD01_a027092e_Tx
        OBDx_allOBD_Req_XIX_BMC_CAN01_ea904dca_Tx: CanIfTxPduCanId=417018865, CanIfTxPduCanIdType=EXTENDED_CAN, CanIfTxPduDlc=8, CanIfTxPduUserTxConfirmationUL=CDD, CanIfTxPduBufferRef=CanIfInitCfg/CHNL_eb535f7d, CanIfTxPduRef=OBDx_allOBD_Req_XIX_BMC_CAN01_9cfd1e51_Tx
        ORU_01_XIX_BMC_CAN01_350b0f24_Tx: CanIfTxPduCanId=441800008, CanIfTxPduCanIdType=EXTENDED_CAN, CanIfTxPduDlc=8, CanIfTxPduUserTxConfirmationName=PduR_CanIfTxConfirmation, CanIfTxPduUserTxConfirmationUL=PDUR, CanIfTxPduBufferRef=CanIfInitCfg/CHNL_eb535f7d, CanIfTxPduRef=ORU_01_XIX_BMC_CAN01_4256635f_Tx
        ORU_Control_A_01_XIX_BMC_CAN01_3567ca2c_Tx: CanIfTxPduCanId=441799804, CanIfTxPduCanIdType=EXTENDED_CAN, CanIfTxPduDlc=8, CanIfTxPduUserTxConfirmationName=PduR_CanIfTxConfirmation, CanIfTxPduUserTxConfirmationUL=PDUR, CanIfTxPduBufferRef=CanIfInitCfg/CHNL_eb535f7d, CanIfTxPduRef=ORU_Control_A_01_XIX_BMC_CAN01_e1a4f99a_Tx
        ORU_Control_D_01_XIX_BMC_CAN01_015e516d_Tx: CanIfTxPduCanId=380196245, CanIfTxPduCanIdType=EXTENDED_CAN, CanIfTxPduDlc=8, CanIfTxPduUserTxConfirmationName=PduR_CanIfTxConfirmation, CanIfTxPduUserTxConfirmationUL=PDUR, CanIfTxPduBufferRef=CanIfInitCfg/CHNL_eb535f7d, CanIfTxPduRef=ORU_Control_D_01_XIX_BMC_CAN01_0f07b83a_Tx
        OTAMC_D_01_XIX_BMC_CAN01_61822804_Tx: CanIfTxPduCanId=380196246, CanIfTxPduCanIdType=EXTENDED_CAN, CanIfTxPduDlc=4, CanIfTxPduUserTxConfirmationName=PduR_CanIfTxConfirmation, CanIfTxPduUserTxConfirmationUL=PDUR, CanIfTxPduBufferRef=CanIfInitCfg/CHNL_eb535f7d, CanIfTxPduRef=OTAMC_D_01_XIX_BMC_CAN01_5e0c6077_Tx
        SOK_Zeit_Hybrid_01_Chal_01_XIX_HCP5_CANFD01_da12ec29_Tx: CanIfTxPduCanId=316670075, CanIfTxPduCanIdType=EXTENDED_FD_CAN, CanIfTxPduDlc=8, CanIfTxPduUserTxConfirmationName=PduR_CanIfTxConfirmation, CanIfTxPduUserTxConfirmationUL=PDUR, CanIfTxPduBufferRef=CanIfInitCfg/CHNL_b74a53a7, CanIfTxPduRef=EcucPduCollection/SOK_Zeit_Hybrid_01_Chal_01_XIX_HCP5_CANFD01_441f0aae_Tx
        Systeminfo_01_XIX_BMC_CAN01_ced9742b_Tx: CanIfTxPduCanId=1413, CanIfTxPduCanIdType=STANDARD_CAN, CanIfTxPduDlc=8, CanIfTxPduUserTxConfirmationName=PduR_CanIfTxConfirmation, CanIfTxPduUserTxConfirmationUL=PDUR, CanIfTxPduBufferRef=CanIfInitCfg/CHNL_eb535f7d, CanIfTxPduRef=Systeminfo_01_XIX_BMC_CAN01_e1870ca9_Tx
        XCP_Hybrid_01_DTO_01_FD_XIX_HCP5_CANFD01_05f39a13_Tx: CanIfTxPduCanId=469526273, CanIfTxPduCanIdType=EXTENDED_FD_CAN, CanIfTxPduDlc=64, CanIfTxPduUserTxConfirmationName=Xcp_CanIfTxConfirmation, CanIfTxPduUserTxConfirmationUL=XCP, CanIfTxPduBufferRef=CanIfInitCfg/CHNL_b74a53a7, CanIfTxPduRef=EcucPduCollection/XCP_Hybrid_01_DTO_01_FD_XIX_HCP5_CANFD01_ee6930a2_Tx
    CanIfPrivateCfg: CanIfPrivateSoftwareFilterType=LINEAR
    CanIfPublicCfg: CanIfPublicPnSupport=true
  module config CanNm
    CanNmGlobalConfig:
      CanNmBusLoadReductionEnabled = false
      CanNmBusSynchronizationEnabled = false
      CanNmComControlEnabled = false
      CanNmComUserDataSupport = true
      CanNmImmediateRestartEnabled = false
      CanNmNodeIdEnabled = false
      CanNmPassiveModeEnabled = false
      CanNmPduRxIndicationEnabled = true
      CanNmPnEiraCalcEnabled = true
      CanNmPnResetTime = 0.5
      CanNmRemoteSleepIndEnabled = false
      CanNmRepeatMsgIndEnabled = false
      CanNmStateChangeIndEnabled = true
      CanNmUserDataEnabled = true
      CanNmPnEiraRxNSduRef = PduPnc_EIRA_CAN_Rx
      NmCluster_BMC_CAN01_44a705e0 (CanNmChannelConfig):
        CanNmBusLoadReductionActive = false
        CanNmComControlEnabled = false
        CanNmImmediateNmCycleTime = 0.02
        CanNmImmediateNmTransmissions = 10
        CanNmImmediateRestartEnabled = false
        CanNmMsgCycleOffset = 0
        CanNmMsgCycleTime = 0.2
        CanNmMsgTimeoutTime = 0.1
        CanNmNodeIdEnabled = false
        CanNmPduCbvPosition = CANNM_PDU_BYTE_1
        CanNmPnEnabled = true
        CanNmPnEraCalcEnabled = false
        CanNmRemoteSleepIndTime = 0.5
        CanNmRepeatMessageTime = 4
        CanNmRepeatMsgIndEnabled = false
        CanNmTimeoutTime = 1
        CanNmUserDataLength = 6
        CanNmWaitBusSleepTime = 0.75
        CanNmComMNetworkHandleRef = ComMConfigSet/CN_BMC_CAN01_78a85e89
        NmCluster_BMC_CAN01_44a705e0_Rx (CanNmRxPdu): CanNmRxPduRef=NmNode_BMC_HV_XIX_BMC_CAN01_a39ed100_Rx
        NMH_Hybrid_01_XIX_BMC_CAN01_30f8f2db_Tx (CanNmTxPdu): CanNmTxPduRef=EcucPduCollection/NMH_Hybrid_01_XIX_BMC_CAN01_30f8f2db_Tx
        NMH_Hybrid_01_XIX_BMC_CAN01_272f3048 (CanNmUserDataTxPdu): CanNmTxUserDataPduRef=EcucPduCollection/NMH_Hybrid_01_XIX_BMC_CAN01_b22e17f1_Tx
      NmCluster_HCP5_CANFD01_da2f6b88 (CanNmChannelConfig):
        CanNmBusLoadReductionActive = false
        CanNmComControlEnabled = false
        CanNmImmediateNmCycleTime = 0.02
        CanNmImmediateNmTransmissions = 10
        CanNmImmediateRestartEnabled = false
        CanNmMsgCycleOffset = 0
        CanNmMsgCycleTime = 0.2
        CanNmMsgTimeoutTime = 0.1
        CanNmNodeIdEnabled = false
        CanNmPduCbvPosition = CANNM_PDU_BYTE_0
        CanNmPduNidPosition = CANNM_PDU_OFF
        CanNmPnEnabled = true
        CanNmPnEraCalcEnabled = false
        CanNmRemoteSleepIndTime = 0.5
        CanNmRepeatMessageTime = 4
        CanNmRepeatMsgIndEnabled = false
        CanNmTimeoutTime = 1
        CanNmUserDataLength = 23
        CanNmWaitBusSleepTime = 0.75
        CanNmComMNetworkHandleRef = ComMConfigSet/CN_HCP5_CANFD01_54d90215
        NmCluster_HCP5_CANFD01_da2f6b88_Rx (CanNmRxPdu): CanNmRxPduRef=NmNode_BMC_HV_XIX_HCP5_CANFD01_c8c687b4_Rx
        NM_Hybrid_01_XIX_HCP5_CANFD01_3f17aba9_Tx (CanNmTxPdu): CanNmTxPduRef=EcucPduCollection/NM_Hybrid_01_XIX_HCP5_CANFD01_3f17aba9_Tx
        NM_Hybrid_01_XIX_HCP5_CANFD01_f044f549 (CanNmUserDataTxPdu): CanNmTxUserDataPduRef=EcucPduCollection/NM_Hybrid_01_XIX_HCP5_CANFD01_c84ff8a5_Tx
      CanNmPnInfo: CanNmPnInfoLength=7, CanNmPnInfoOffset=1
        7 x CanNmPnFilterMaskByte:
          CanNmPnFilterMaskByte_0: CanNmPnFilterMaskByteIndex=0, CanNmPnFilterMaskByteValue=255
          CanNmPnFilterMaskByte_1: CanNmPnFilterMaskByteIndex=1, CanNmPnFilterMaskByteValue=254
          CanNmPnFilterMaskByte_2: CanNmPnFilterMaskByteIndex=2, CanNmPnFilterMaskByteValue=255
          CanNmPnFilterMaskByte_3: CanNmPnFilterMaskByteIndex=3, CanNmPnFilterMaskByteValue=255
          CanNmPnFilterMaskByte_4: CanNmPnFilterMaskByteIndex=4, CanNmPnFilterMaskByteValue=159
          CanNmPnFilterMaskByte_5: CanNmPnFilterMaskByteIndex=5, CanNmPnFilterMaskByteValue=255
          CanNmPnFilterMaskByte_6: CanNmPnFilterMaskByteIndex=6, CanNmPnFilterMaskByteValue=208
  module config CanSM
    CanSMConfiguration
      CHNL_b74a53a7 (CanSMManagerNetwork): CanSMBorCounterL1ToL2=1, CanSMBorTimeL1=0.05, CanSMBorTimeL2=0.2, CanSMComMNetworkHandleRef=ComMConfigSet/CN_HCP5_CANFD01_54d90215
        CT_HCP5_CANFD01_2159a909 (CanSMController): CanSMControllerId=CanIfCtrlDrvCfg_7d254554/CT_HCP5_CANFD01_e05ce4e2
      CHNL_eb535f7d (CanSMManagerNetwork): CanSMBorCounterL1ToL2=1, CanSMBorTimeL1=0.05, CanSMBorTimeL2=0.2, CanSMComMNetworkHandleRef=ComMConfigSet/CN_BMC_CAN01_78a85e89
        CT_BMC_CAN01_c53677ab (CanSMController): CanSMControllerId=CanIfCtrlDrvCfg_7d254554/CT_BMC_CAN01_34f1c2c6
  module config CanTp
    CanTpConfig
      24 x CanTpChannel, all with CanTpChannelMode=CANTP_MODE_HALF_DUPLEX:
        TPC_BMC_CAN01_XIX_TPCHType_CANHS_Flash_DIA_XIX_0x17FC16D0_XIX_0x17FE16D0_XIX_Physical_f1f4b50d
          CanTpRxNSdu_609f5227 (CanTpRxNSdu):
            CanTpBs = 15
            CanTpNar = 1
            CanTpNbr = 0.1
            CanTpNcr = 1
            CanTpRxAddressingFormat = CANTP_STANDARD
            CanTpRxDl = 8
            CanTpRxPaddingActivation = CANTP_ON
            CanTpRxTaType = CANTP_PHYSICAL
            CanTpRxWftMax = 15
            CanTpSTmin = 0.005
            CanTpRxNSduRef = EcucPduCollection/DCM_BMC_CAN01_XIX_TPCHType_CANHS_Flash_DIA_XIX_0x17FE16D0_XIX_0x17FC16D0_XIX_Physical_8400c53b_Rx
            CanTpRxNPdu_ad91627d (CanTpRxNPdu): CanTpRxNPduRef=DIA_BJB_Resp_XIX_BMC_CAN01_c04d7636_Rx
            CanTpTxFcNPdu_ad91627d (CanTpTxFcNPdu): CanTpTxFcNPduRef=DIA_BJB_Req_XIX_BMC_CAN01_6c84b0d8_Tx
          CanTpTxNSdu_609f5227 (CanTpTxNSdu):
            CanTpNas = 1
            CanTpNbs = 1
            CanTpNcs = 0.2
            CanTpTxAddressingFormat = CANTP_STANDARD
            CanTpTxDl = 8
            CanTpTxPaddingActivation = CANTP_ON
            CanTpTxTaType = CANTP_PHYSICAL
            CanTpTxNSduRef = EcucPduCollection/DCM_BMC_CAN01_XIX_TPCHType_CANHS_Flash_DIA_XIX_0x17FC16D0_XIX_0x17FE16D0_XIX_Physical_9f19b594_Tx
            CanTpRxFcNPdu_8f6bb68f (CanTpRxFcNPdu): CanTpRxFcNPduRef=DIA_BJB_Resp_XIX_BMC_CAN01_c04d7636_Rx
            CanTpTxNPdu_8f6bb68f (CanTpTxNPdu): CanTpTxNPduRef=DIA_BJB_Req_XIX_BMC_CAN01_6c84b0d8_Tx
        TPC_BMC_CAN01_XIX_TPCHType_CANHS_Flash_DIA_XIX_0x17FC17B1_XIX_0x17FE17B1_XIX_Physical_c48583a0
          CanTpRxNSdu_ce7621c7 (CanTpRxNSdu):
            CanTpBs = 15
            CanTpNar = 1
            CanTpNbr = 0.1
            CanTpNcr = 1
            CanTpRxAddressingFormat = CANTP_STANDARD
            CanTpRxDl = 8
            CanTpRxPaddingActivation = CANTP_ON
            CanTpRxTaType = CANTP_PHYSICAL
            CanTpRxWftMax = 15
            CanTpSTmin = 0.005
            CanTpRxNSduRef = EcucPduCollection/DCM_BMC_CAN01_XIX_TPCHType_CANHS_Flash_DIA_XIX_0x17FE17B1_XIX_0x17FC17B1_XIX_Physical_8ad3bf71_Rx
            CanTpRxNPdu_0bbd6d70 (CanTpRxNPdu): CanTpRxNPduRef=DIA_UI2Sens01_Resp_XIX_BMC_CAN01_2ddec3aa_Rx
            CanTpTxFcNPdu_0bbd6d70 (CanTpTxFcNPdu): CanTpTxFcNPduRef=DIA_UI2Sens01_Req_XIX_BMC_CAN01_47b20c58_Tx
          CanTpTxNSdu_ce7621c7 (CanTpTxNSdu):
            CanTpNas = 1
            CanTpNbs = 1
            CanTpNcs = 0.2
            CanTpTxAddressingFormat = CANTP_STANDARD
            CanTpTxDl = 8
            CanTpTxPaddingActivation = CANTP_ON
            CanTpTxTaType = CANTP_PHYSICAL
            CanTpTxNSduRef = EcucPduCollection/DCM_BMC_CAN01_XIX_TPCHType_CANHS_Flash_DIA_XIX_0x17FC17B1_XIX_0x17FE17B1_XIX_Physical_91cacfde_Tx
            CanTpRxFcNPdu_2947b982 (CanTpRxFcNPdu): CanTpRxFcNPduRef=DIA_UI2Sens01_Resp_XIX_BMC_CAN01_2ddec3aa_Rx
            CanTpTxNPdu_2947b982 (CanTpTxNPdu): CanTpTxNPduRef=DIA_UI2Sens01_Req_XIX_BMC_CAN01_47b20c58_Tx
        TPC_BMC_CAN01_XIX_TPCHType_CANHS_Flash_DIA_XIX_0x17FC17B2_XIX_0x17FE17B2_XIX_Physical_cf8925ab
          CanTpRxNSdu_6a94a10c (CanTpRxNSdu):
            CanTpBs = 15
            CanTpNar = 1
            CanTpNbr = 0.1
            CanTpNcr = 1
            CanTpRxAddressingFormat = CANTP_STANDARD
            CanTpRxDl = 8
            CanTpRxPaddingActivation = CANTP_ON
            CanTpRxTaType = CANTP_PHYSICAL
            CanTpRxWftMax = 15
            CanTpSTmin = 0.005
            CanTpRxNSduRef = EcucPduCollection/DCM_BMC_CAN01_XIX_TPCHType_CANHS_Flash_DIA_XIX_0x17FE17B2_XIX_0x17FC17B2_XIX_Physical_97163b00_Rx
            CanTpRxNPdu_08356b26 (CanTpRxNPdu): CanTpRxNPduRef=DIA_UI2Sens02_Resp_XIX_BMC_CAN01_fe45df51_Rx
            CanTpTxFcNPdu_08356b26 (CanTpTxFcNPdu): CanTpTxFcNPduRef=DIA_UI2Sens02_Req_XIX_BMC_CAN01_0a5a0c3f_Tx
          CanTpTxNSdu_6a94a10c (CanTpTxNSdu):
            CanTpNas = 1
            CanTpNbs = 1
            CanTpNcs = 0.2
            CanTpTxAddressingFormat = CANTP_STANDARD
            CanTpTxDl = 8
            CanTpTxPaddingActivation = CANTP_ON
            CanTpTxTaType = CANTP_PHYSICAL
            CanTpTxNSduRef = EcucPduCollection/DCM_BMC_CAN01_XIX_TPCHType_CANHS_Flash_DIA_XIX_0x17FC17B2_XIX_0x17FE17B2_XIX_Physical_8c0f4baf_Tx
            CanTpRxFcNPdu_2acfbfd4 (CanTpRxFcNPdu): CanTpRxFcNPduRef=DIA_UI2Sens02_Resp_XIX_BMC_CAN01_fe45df51_Rx
            CanTpTxNPdu_2acfbfd4 (CanTpTxNPdu): CanTpTxNPduRef=DIA_UI2Sens02_Req_XIX_BMC_CAN01_0a5a0c3f_Tx
        TPC_BMC_CAN01_XIX_TPCHType_CANHS_ISO_Diagnose_XIX_0x700_XIX_Functional_db439e36
          CanTpTxNSdu_2bf4df70 (CanTpTxNSdu):
            CanTpNas = 1
            CanTpNcs = 0.2
            CanTpTxAddressingFormat = CANTP_STANDARD
            CanTpTxDl = 8
            CanTpTxPaddingActivation = CANTP_ON
            CanTpTxTaType = CANTP_FUNCTIONAL
            CanTpTxNSduRef = DCM_BMC_CAN01_XIX_TPCHType_CANHS_ISO_Diagnose_XIX_0x700_XIX_Functional_770cc244_Tx
            CanTpTxNPdu_761474f5 (CanTpTxNPdu): CanTpTxNPduRef=ISO_Funktionaler_Req_All_XIX_BMC_CAN01_aaf5996b_Tx
        TPC_BMC_CAN01_XIX_TPCHType_CANHS_OBDC_Diagnose_XIX_0x17FD0200_XIX_Functional_4adb040a
          CanTpTxNSdu_44dfe4f4 (CanTpTxNSdu):
            CanTpNas = 1
            CanTpNcs = 0.2
            CanTpTxAddressingFormat = CANTP_STANDARD
            CanTpTxDl = 8
            CanTpTxPaddingActivation = CANTP_ON
            CanTpTxTaType = CANTP_FUNCTIONAL
            CanTpTxNSduRef = DCM_BMC_CAN01_XIX_TPCHType_CANHS_OBDC_Diagnose_XIX_0x17FD0200_XIX_Functional_e9b636f2_Tx
            CanTpTxNPdu_f9e9d1a6 (CanTpTxNPdu): CanTpTxNPduRef=OBDC_Funktionaler_Req_All_XIX_BMC_CAN01_c40642be_Tx
        TPC_BMC_CAN01_XIX_TPCHType_CANHS_OBDC_SSN_Diagnose_XIX_0x17FC70D0_XIX_0x17FE70D0_XIX_Physical_16ea9e9d
          CanTpRxNSdu_4a179228 (CanTpRxNSdu):
            CanTpBs = 15
            CanTpNar = 1
            CanTpNbr = 0.1
            CanTpNcr = 1
            CanTpRxAddressingFormat = CANTP_STANDARD
            CanTpRxDl = 8
            CanTpRxPaddingActivation = CANTP_ON
            CanTpRxTaType = CANTP_PHYSICAL
            CanTpRxWftMax = 15
            CanTpSTmin = 0.005
            CanTpRxNSduRef = EcucPduCollection/DCM_BMC_CAN01_XIX_TPCHType_CANHS_OBDC_SSN_Diagnose_XIX_0x17FE70D0_XIX_0x17FC70D0_XIX_Physical_f79c6d96_Rx
            CanTpRxNPdu_97309642 (CanTpRxNPdu): CanTpRxNPduRef=OBDC_SSN_BJB_Resp_XIX_BMC_CAN01_d5ca69f5_Rx
            CanTpTxFcNPdu_97309642 (CanTpTxFcNPdu): CanTpTxFcNPduRef=OBDC_SSN_BJB_Req_XIX_BMC_CAN01_31b63a85_Tx
          CanTpTxNSdu_4a179228 (CanTpTxNSdu):
            CanTpNas = 1
            CanTpNbs = 1
            CanTpNcs = 0.2
            CanTpTxAddressingFormat = CANTP_STANDARD
            CanTpTxDl = 8
            CanTpTxPaddingActivation = CANTP_ON
            CanTpTxTaType = CANTP_PHYSICAL
            CanTpTxNSduRef = EcucPduCollection/DCM_BMC_CAN01_XIX_TPCHType_CANHS_OBDC_SSN_Diagnose_XIX_0x17FC70D0_XIX_0x17FE70D0_XIX_Physical_ec851d39_Tx
            CanTpRxFcNPdu_b5ca42b0 (CanTpRxFcNPdu): CanTpRxFcNPduRef=OBDC_SSN_BJB_Resp_XIX_BMC_CAN01_d5ca69f5_Rx
            CanTpTxNPdu_b5ca42b0 (CanTpTxNPdu): CanTpTxNPduRef=OBDC_SSN_BJB_Req_XIX_BMC_CAN01_31b63a85_Tx
        TPC_BMC_CAN01_XIX_TPCHType_CANHS_OBDC_SSN_Diagnose_XIX_0x17FC71B1_XIX_0x17FE71B1_XIX_Physical_4f4480b2
          CanTpRxNSdu_cfc16dea (CanTpRxNSdu):
            CanTpBs = 15
            CanTpNar = 1
            CanTpNbr = 0.1
            CanTpNcr = 1
            CanTpRxAddressingFormat = CANTP_STANDARD
            CanTpRxDl = 8
            CanTpRxPaddingActivation = CANTP_ON
            CanTpRxTaType = CANTP_PHYSICAL
            CanTpRxWftMax = 15
            CanTpSTmin = 0.005
            CanTpRxNSduRef = EcucPduCollection/DCM_BMC_CAN01_XIX_TPCHType_CANHS_OBDC_SSN_Diagnose_XIX_0x17FE71B1_XIX_0x17FC71B1_XIX_Physical_f94f17dc_Rx
            CanTpRxNPdu_fd4157c5 (CanTpRxNPdu): CanTpRxNPduRef=OBDC_SSN_UI2Sens01_Resp_XIX_BMC_CAN01_327140fa_Rx
            CanTpTxFcNPdu_fd4157c5 (CanTpTxFcNPdu): CanTpTxFcNPduRef=OBDC_SSN_UI2Sens01_Req_XIX_BMC_CAN01_32b2328b_Tx
          CanTpTxNSdu_cfc16dea (CanTpTxNSdu):
            CanTpNas = 1
            CanTpNbs = 1
            CanTpNcs = 0.2
            CanTpTxAddressingFormat = CANTP_STANDARD
            CanTpTxDl = 8
            CanTpTxPaddingActivation = CANTP_ON
            CanTpTxTaType = CANTP_PHYSICAL
            CanTpTxNSduRef = EcucPduCollection/DCM_BMC_CAN01_XIX_TPCHType_CANHS_OBDC_SSN_Diagnose_XIX_0x17FC71B1_XIX_0x17FE71B1_XIX_Physical_e2566773_Tx
            CanTpRxFcNPdu_dfbb8337 (CanTpRxFcNPdu): CanTpRxFcNPduRef=OBDC_SSN_UI2Sens01_Resp_XIX_BMC_CAN01_327140fa_Rx
            CanTpTxNPdu_dfbb8337 (CanTpTxNPdu): CanTpTxNPduRef=OBDC_SSN_UI2Sens01_Req_XIX_BMC_CAN01_32b2328b_Tx
        TPC_BMC_CAN01_XIX_TPCHType_CANHS_OBDC_SSN_Diagnose_XIX_0x17FC71B2_XIX_0x17FE71B2_XIX_Physical_f38ca01a
          CanTpRxNSdu_ba22fb4a (CanTpRxNSdu):
            CanTpBs = 15
            CanTpNar = 1
            CanTpNbr = 0.1
            CanTpNcr = 1
            CanTpRxAddressingFormat = CANTP_STANDARD
            CanTpRxDl = 8
            CanTpRxPaddingActivation = CANTP_ON
            CanTpRxTaType = CANTP_PHYSICAL
            CanTpRxWftMax = 15
            CanTpSTmin = 0.005
            CanTpRxNSduRef = EcucPduCollection/DCM_BMC_CAN01_XIX_TPCHType_CANHS_OBDC_SSN_Diagnose_XIX_0x17FE71B2_XIX_0x17FC71B2_XIX_Physical_e48a93ad_Rx
            CanTpRxNPdu_cd28289f (CanTpRxNPdu): CanTpRxNPduRef=OBDC_SSN_UI2Sens02_Resp_XIX_BMC_CAN01_e1ea5c01_Rx
            CanTpTxFcNPdu_cd28289f (CanTpTxFcNPdu): CanTpTxFcNPduRef=OBDC_SSN_UI2Sens02_Req_XIX_BMC_CAN01_7f5a32ec_Tx
          CanTpTxNSdu_ba22fb4a (CanTpTxNSdu):
            CanTpNas = 1
            CanTpNbs = 1
            CanTpNcs = 0.2
            CanTpTxAddressingFormat = CANTP_STANDARD
            CanTpTxDl = 8
            CanTpTxPaddingActivation = CANTP_ON
            CanTpTxTaType = CANTP_PHYSICAL
            CanTpTxNSduRef = EcucPduCollection/DCM_BMC_CAN01_XIX_TPCHType_CANHS_OBDC_SSN_Diagnose_XIX_0x17FC71B2_XIX_0x17FE71B2_XIX_Physical_ff93e302_Tx
            CanTpRxFcNPdu_efd2fc6d (CanTpRxFcNPdu): CanTpRxFcNPduRef=OBDC_SSN_UI2Sens02_Resp_XIX_BMC_CAN01_e1ea5c01_Rx
            CanTpTxNPdu_efd2fc6d (CanTpTxNPdu): CanTpTxNPduRef=OBDC_SSN_UI2Sens02_Req_XIX_BMC_CAN01_7f5a32ec_Tx
        TPC_HCP5_CANFD01_XIX_TPCHType_CANFD_DAAP_XIX_0x1C403F7B_XIX_0x1C423F7B_XIX_Physical_749702d9
          CanTpRxNSdu_6f740f5b (CanTpRxNSdu):
            CanTpBs = 15
            CanTpNar = 1
            CanTpNbr = 0.1
            CanTpNcr = 1
            CanTpRxAddressingFormat = CANTP_STANDARD
            CanTpRxDl = 64
            CanTpRxPaddingActivation = CANTP_ON
            CanTpRxTaType = CANTP_CANFD_PHYSICAL
            CanTpRxWftMax = 15
            CanTpSTmin = 0.005
            CanTpRxNSduRef = EcucPduCollection/CDD_HCP5_CANFD01_XIX_TPCHType_CANFD_DAAP_XIX_0x1C403F7B_XIX_0x1C423F7B_XIX_Physical_1330e22e_Rx
            CanTpRxNPdu_4cda0177 (CanTpRxNPdu): CanTpRxNPduRef=DAAP_Hybrid_01_Req_FD_XIX_HCP5_CANFD01_25e2ca12_Rx
            CanTpTxFcNPdu_4cda0177 (CanTpTxFcNPdu): CanTpTxFcNPduRef=DAAP_Hybrid_01_Resp_FD_XIX_HCP5_CANFD01_a869e288_Tx
          CanTpTxNSdu_6f740f5b (CanTpTxNSdu):
            CanTpNas = 1
            CanTpNbs = 1
            CanTpNcs = 0.2
            CanTpTxAddressingFormat = CANTP_STANDARD
            CanTpTxDl = 8
            CanTpTxPaddingActivation = CANTP_ON
            CanTpTxTaType = CANTP_CANFD_PHYSICAL
            CanTpTxNSduRef = EcucPduCollection/CDD_HCP5_CANFD01_XIX_TPCHType_CANFD_DAAP_XIX_0x1C423F7B_XIX_0x1C403F7B_XIX_Physical_d2cfa6c1_Tx
            CanTpRxFcNPdu_6e20d585 (CanTpRxFcNPdu): CanTpRxFcNPduRef=DAAP_Hybrid_01_Req_FD_XIX_HCP5_CANFD01_25e2ca12_Rx
            CanTpTxNPdu_6e20d585 (CanTpTxNPdu): CanTpTxNPduRef=DAAP_Hybrid_01_Resp_FD_XIX_HCP5_CANFD01_a869e288_Tx
        TPC_HCP5_CANFD01_XIX_TPCHType_CANFD_DAAP_XIX_0x1C413FDD_XIX_Functional_9b011d0c
          CanTpRxNSdu_3e55cafd (CanTpRxNSdu):
            CanTpNbr = 0.1
            CanTpRxAddressingFormat = CANTP_STANDARD
            CanTpRxDl = 8
            CanTpRxPaddingActivation = CANTP_ON
            CanTpRxTaType = CANTP_FUNCTIONAL
            CanTpRxNSduRef = EcucPduCollection/CDD_HCP5_CANFD01_XIX_TPCHType_CANFD_DAAP_XIX_0x1C413FDD_XIX_Functional_880c97f7_Rx
            CanTpRxNPdu_4da76113 (CanTpRxNPdu): CanTpRxNPduRef=DAAP_Funkt_Req_MC_FD_XIX_HCP5_CANFD01_dbe988f8_Rx
        TPC_HCP5_CANFD01_XIX_TPCHType_CANFD_ISO_Diagnose_XIX_0x1C40007B_XIX_0x1C42007B_XIX_Physical_0f1ef670
          CanTpRxNSdu_a8e8a4a6 (CanTpRxNSdu):
            CanTpBs = 15
            CanTpNar = 1
            CanTpNbr = 0.1
            CanTpNcr = 1
            CanTpRxAddressingFormat = CANTP_STANDARD
            CanTpRxDl = 64
            CanTpRxPaddingActivation = CANTP_ON
            CanTpRxTaType = CANTP_CANFD_PHYSICAL
            CanTpRxWftMax = 15
            CanTpSTmin = 0.005
            CanTpRxNSduRef = EcucPduCollection/DCM_HCP5_CANFD01_XIX_TPCHType_CANFD_ISO_Diagnose_XIX_0x1C40007B_XIX_0x1C42007B_XIX_Physical_e79447d3_Rx
            CanTpRxNPdu_27bf3fc9 (CanTpRxNPdu): CanTpRxNPduRef=ISOx_Hybrid_01_Req_FD_XIX_HCP5_CANFD01_5affd0fb_Rx
            CanTpTxFcNPdu_27bf3fc9 (CanTpTxFcNPdu): CanTpTxFcNPduRef=ISOx_Hybrid_01_Resp_FD_XIX_HCP5_CANFD01_71c0a54e_Tx
          CanTpTxNSdu_a8e8a4a6 (CanTpTxNSdu):
            CanTpNas = 1
            CanTpNbs = 1
            CanTpNcs = 0.2
            CanTpTxAddressingFormat = CANTP_STANDARD
            CanTpTxDl = 8
            CanTpTxPaddingActivation = CANTP_ON
            CanTpTxTaType = CANTP_CANFD_PHYSICAL
            CanTpTxNSduRef = EcucPduCollection/DCM_HCP5_CANFD01_XIX_TPCHType_CANFD_ISO_Diagnose_XIX_0x1C42007B_XIX_0x1C40007B_XIX_Physical_266b033c_Tx
            CanTpRxFcNPdu_0545eb3b (CanTpRxFcNPdu): CanTpRxFcNPduRef=ISOx_Hybrid_01_Req_FD_XIX_HCP5_CANFD01_5affd0fb_Rx
            CanTpTxNPdu_0545eb3b (CanTpTxNPdu): CanTpTxNPduRef=ISOx_Hybrid_01_Resp_FD_XIX_HCP5_CANFD01_71c0a54e_Tx
        TPC_HCP5_CANFD01_XIX_TPCHType_CANFD_ISO_Diagnose_XIX_0x1C410000_XIX_Functional_677d3265
          CanTpRxNSdu_bf1fe3fd (CanTpRxNSdu):
            CanTpNbr = 0.1
            CanTpRxAddressingFormat = CANTP_STANDARD
            CanTpRxDl = 64
            CanTpRxPaddingActivation = CANTP_ON
            CanTpRxTaType = CANTP_CANFD_FUNCTIONAL
            CanTpRxNSduRef = DCM_HCP5_CANFD01_XIX_TPCHType_CANFD_ISO_Diagnose_XIX_0x1C410000_XIX_Functional_905f44f1_Rx
            CanTpRxNPdu_d8d6c01a (CanTpRxNPdu): CanTpRxNPduRef=ISOx_Funkt_Req_All_FD_XIX_HCP5_CANFD01_1dbb1bad_Rx
        TPC_HCP5_CANFD01_XIX_TPCHType_CANFD_OBDC_Diagnose_XIX_0x1C40027B_XIX_0x1C42027B_XIX_Physical_cb702e23
          CanTpRxNSdu_0279f0ba (CanTpRxNSdu):
            CanTpBs = 15
            CanTpNar = 1
            CanTpNbr = 0.1
            CanTpNcr = 1
            CanTpRxAddressingFormat = CANTP_STANDARD
            CanTpRxDl = 64
            CanTpRxPaddingActivation = CANTP_ON
            CanTpRxTaType = CANTP_CANFD_PHYSICAL
            CanTpRxWftMax = 15
            CanTpSTmin = 0.005
            CanTpRxNSduRef = EcucPduCollection/DCM_HCP5_CANFD01_XIX_TPCHType_CANFD_OBDC_Diagnose_XIX_0x1C40027B_XIX_0x1C42027B_XIX_Physical_8b2e4924_Rx
            CanTpRxNPdu_7abc1315 (CanTpRxNPdu): CanTpRxNPduRef=OBDC_Hybrid_01_Req_FD_XIX_HCP5_CANFD01_38935bdf_Rx
            CanTpTxFcNPdu_7abc1315 (CanTpTxFcNPdu): CanTpTxFcNPduRef=OBDC_Hybrid_01_Resp_FD_XIX_HCP5_CANFD01_4da12d14_Tx
          CanTpTxNSdu_0279f0ba (CanTpTxNSdu):
            CanTpNas = 1
            CanTpNbs = 1
            CanTpNcs = 0.2
            CanTpTxAddressingFormat = CANTP_STANDARD
            CanTpTxDl = 8
            CanTpTxPaddingActivation = CANTP_ON
            CanTpTxTaType = CANTP_CANFD_PHYSICAL
            CanTpTxNSduRef = EcucPduCollection/DCM_HCP5_CANFD01_XIX_TPCHType_CANFD_OBDC_Diagnose_XIX_0x1C42027B_XIX_0x1C40027B_XIX_Physical_4ad10dcb_Tx
            CanTpRxFcNPdu_5846c7e7 (CanTpRxFcNPdu): CanTpRxFcNPduRef=OBDC_Hybrid_01_Req_FD_XIX_HCP5_CANFD01_38935bdf_Rx
            CanTpTxNPdu_5846c7e7 (CanTpTxNPdu): CanTpTxNPduRef=OBDC_Hybrid_01_Resp_FD_XIX_HCP5_CANFD01_4da12d14_Tx
        TPC_HCP5_CANFD01_XIX_TPCHType_CANFD_OBDC_Diagnose_XIX_0x1C410200_XIX_Functional_91dfb76e
          CanTpRxNSdu_b2b9f46c (CanTpRxNSdu):
            CanTpNbr = 0.1
            CanTpRxAddressingFormat = CANTP_STANDARD
            CanTpRxDl = 64
            CanTpRxPaddingActivation = CANTP_ON
            CanTpRxTaType = CANTP_CANFD_FUNCTIONAL
            CanTpRxNSduRef = DCM_HCP5_CANFD01_XIX_TPCHType_CANFD_OBDC_Diagnose_XIX_0x1C410200_XIX_Functional_c81dd985_Rx
            CanTpRxNPdu_39dd35ba (CanTpRxNPdu): CanTpRxNPduRef=OBDC_Funktionaler_Req_All_FD_XIX_HCP5_CANFD01_d0af7a5a_Rx
        TPC_HCP5_CANFD01_XIX_TPCHType_CANHS_Flash_DIA_XIX_0x17FC16D0_XIX_0x17FE16D0_XIX_Physical_6de530be
          CanTpRxNSdu_26ffedb5 (CanTpRxNSdu):
            CanTpBs = 15
            CanTpNar = 1
            CanTpNbr = 0.1
            CanTpNcr = 1
            CanTpRxAddressingFormat = CANTP_STANDARD
            CanTpRxDl = 8
            CanTpRxPaddingActivation = CANTP_ON
            CanTpRxTaType = CANTP_PHYSICAL
            CanTpRxWftMax = 15
            CanTpSTmin = 0.005
            CanTpRxNSduRef = EcucPduCollection/DCM_HCP5_CANFD01_XIX_TPCHType_CANHS_Flash_DIA_XIX_0x17FC16D0_XIX_0x17FE16D0_XIX_Physical_33952be0_Rx
            CanTpRxNPdu_efe0918f (CanTpRxNPdu): CanTpRxNPduRef=DIA_BJB_Req_XIX_HCP5_CANFD01_f2b9e65d_Rx
            CanTpTxFcNPdu_efe0918f (CanTpTxFcNPdu): CanTpTxFcNPduRef=DIA_BJB_Resp_XIX_HCP5_CANFD01_6385845c_Tx
          CanTpTxNSdu_26ffedb5 (CanTpTxNSdu):
            CanTpNas = 1
            CanTpNbs = 1
            CanTpNcs = 0.2
            CanTpTxAddressingFormat = CANTP_STANDARD
            CanTpTxDl = 8
            CanTpTxPaddingActivation = CANTP_ON
            CanTpTxTaType = CANTP_PHYSICAL
            CanTpTxNSduRef = EcucPduCollection/DCM_HCP5_CANFD01_XIX_TPCHType_CANHS_Flash_DIA_XIX_0x17FE16D0_XIX_0x17FC16D0_XIX_Physical_aae5e090_Tx
            CanTpRxFcNPdu_cd1a457d (CanTpRxFcNPdu): CanTpRxFcNPduRef=DIA_BJB_Req_XIX_HCP5_CANFD01_f2b9e65d_Rx
            CanTpTxNPdu_cd1a457d (CanTpTxNPdu): CanTpTxNPduRef=DIA_BJB_Resp_XIX_HCP5_CANFD01_6385845c_Tx
        TPC_HCP5_CANFD01_XIX_TPCHType_CANHS_Flash_DIA_XIX_0x17FC17B1_XIX_0x17FE17B1_XIX_Physical_118e93c5
          CanTpRxNSdu_1a11b04e (CanTpRxNSdu):
            CanTpBs = 15
            CanTpNar = 1
            CanTpNbr = 0.1
            CanTpNcr = 1
            CanTpRxAddressingFormat = CANTP_STANDARD
            CanTpRxDl = 8
            CanTpRxPaddingActivation = CANTP_ON
            CanTpRxTaType = CANTP_PHYSICAL
            CanTpRxWftMax = 15
            CanTpSTmin = 0.005
            CanTpRxNSduRef = EcucPduCollection/DCM_HCP5_CANFD01_XIX_TPCHType_CANHS_Flash_DIA_XIX_0x17FC17B1_XIX_0x17FE17B1_XIX_Physical_849231ea_Rx
            CanTpRxNPdu_404cd787 (CanTpRxNPdu): CanTpRxNPduRef=DIA_UI2Sens01_Req_XIX_HCP5_CANFD01_d86619ec_Rx
            CanTpTxFcNPdu_404cd787 (CanTpTxFcNPdu): CanTpTxFcNPduRef=DIA_UI2Sens01_Resp_XIX_HCP5_CANFD01_dfc9d8b9_Tx
          CanTpTxNSdu_1a11b04e (CanTpTxNSdu):
            CanTpNas = 1
            CanTpNbs = 1
            CanTpNcs = 0.2
            CanTpTxAddressingFormat = CANTP_STANDARD
            CanTpTxDl = 8
            CanTpTxPaddingActivation = CANTP_ON
            CanTpTxTaType = CANTP_PHYSICAL
            CanTpTxNSduRef = EcucPduCollection/DCM_HCP5_CANFD01_XIX_TPCHType_CANHS_Flash_DIA_XIX_0x17FE17B1_XIX_0x17FC17B1_XIX_Physical_1de2fa9a_Tx
            CanTpRxFcNPdu_62b60375 (CanTpRxFcNPdu): CanTpRxFcNPduRef=DIA_UI2Sens01_Req_XIX_HCP5_CANFD01_d86619ec_Rx
            CanTpTxNPdu_62b60375 (CanTpTxNPdu): CanTpTxNPduRef=DIA_UI2Sens01_Resp_XIX_HCP5_CANFD01_dfc9d8b9_Tx
        TPC_HCP5_CANFD01_XIX_TPCHType_CANHS_Flash_DIA_XIX_0x17FC17B2_XIX_0x17FE17B2_XIX_Physical_26ffd7ad
          CanTpRxNSdu_0b24df6d (CanTpRxNSdu):
            CanTpBs = 15
            CanTpNar = 1
            CanTpNbr = 0.1
            CanTpNcr = 1
            CanTpRxAddressingFormat = CANTP_STANDARD
            CanTpRxDl = 8
            CanTpRxPaddingActivation = CANTP_ON
            CanTpRxTaType = CANTP_PHYSICAL
            CanTpRxWftMax = 15
            CanTpSTmin = 0.005
            CanTpRxNSduRef = EcucPduCollection/DCM_HCP5_CANFD01_XIX_TPCHType_CANHS_Flash_DIA_XIX_0x17FC17B2_XIX_0x17FE17B2_XIX_Physical_654058e0_Rx
            CanTpRxNPdu_8ee162ca (CanTpRxNPdu): CanTpRxNPduRef=DIA_UI2Sens02_Req_XIX_HCP5_CANFD01_a61e514a_Rx
            CanTpTxFcNPdu_8ee162ca (CanTpTxFcNPdu): CanTpTxFcNPduRef=DIA_UI2Sens02_Resp_XIX_HCP5_CANFD01_e002a62c_Tx
          CanTpTxNSdu_0b24df6d (CanTpTxNSdu):
            CanTpNas = 1
            CanTpNbs = 1
            CanTpNcs = 0.2
            CanTpTxAddressingFormat = CANTP_STANDARD
            CanTpTxDl = 8
            CanTpTxPaddingActivation = CANTP_ON
            CanTpTxTaType = CANTP_PHYSICAL
            CanTpTxNSduRef = EcucPduCollection/DCM_HCP5_CANFD01_XIX_TPCHType_CANHS_Flash_DIA_XIX_0x17FE17B2_XIX_0x17FC17B2_XIX_Physical_fc309390_Tx
            CanTpRxFcNPdu_ac1bb638 (CanTpRxFcNPdu): CanTpRxFcNPduRef=DIA_UI2Sens02_Req_XIX_HCP5_CANFD01_a61e514a_Rx
            CanTpTxNPdu_ac1bb638 (CanTpTxNPdu): CanTpTxNPduRef=DIA_UI2Sens02_Resp_XIX_HCP5_CANFD01_e002a62c_Tx
        TPC_HCP5_CANFD01_XIX_TPCHType_CANHS_ISO_Diagnose_XIX_0x17FC007B_XIX_0x17FE007B_XIX_Physical_f6febf9e
          CanTpRxNSdu_03261030 (CanTpRxNSdu):
            CanTpBs = 15
            CanTpNar = 1
            CanTpNbr = 0.1
            CanTpNcr = 1
            CanTpRxAddressingFormat = CANTP_STANDARD
            CanTpRxDl = 8
            CanTpRxPaddingActivation = CANTP_ON
            CanTpRxTaType = CANTP_PHYSICAL
            CanTpRxWftMax = 15
            CanTpSTmin = 0.005
            CanTpRxNSduRef = EcucPduCollection/DCM_HCP5_CANFD01_XIX_TPCHType_CANHS_ISO_Diagnose_XIX_0x17FC007B_XIX_0x17FE007B_XIX_Physical_fb6bd0a7_Rx
            CanTpRxNPdu_a2b7f63b (CanTpRxNPdu): CanTpRxNPduRef=ISOx_Hybrid_01_Req_XIX_HCP5_CANFD01_bd99bbef_Rx
            CanTpTxFcNPdu_a2b7f63b (CanTpTxFcNPdu): CanTpTxFcNPduRef=ISOx_Hybrid_01_Resp_XIX_HCP5_CANFD01_46a576a1_Tx
          CanTpTxNSdu_03261030 (CanTpTxNSdu):
            CanTpNas = 1
            CanTpNbs = 1
            CanTpNcs = 0.2
            CanTpTxAddressingFormat = CANTP_STANDARD
            CanTpTxDl = 8
            CanTpTxPaddingActivation = CANTP_ON
            CanTpTxTaType = CANTP_PHYSICAL
            CanTpTxNSduRef = EcucPduCollection/DCM_HCP5_CANFD01_XIX_TPCHType_CANHS_ISO_Diagnose_XIX_0x17FE007B_XIX_0x17FC007B_XIX_Physical_621b1bd7_Tx
            CanTpRxFcNPdu_804d22c9 (CanTpRxFcNPdu): CanTpRxFcNPduRef=ISOx_Hybrid_01_Req_XIX_HCP5_CANFD01_bd99bbef_Rx
            CanTpTxNPdu_804d22c9 (CanTpTxNPdu): CanTpTxNPduRef=ISOx_Hybrid_01_Resp_XIX_HCP5_CANFD01_46a576a1_Tx
        TPC_HCP5_CANFD01_XIX_TPCHType_CANHS_ISO_Diagnose_XIX_0x700_XIX_Functional_84dcea00
          CanTpRxNSdu_5fba93df (CanTpRxNSdu):
            CanTpNbr = 0.1
            CanTpRxAddressingFormat = CANTP_STANDARD
            CanTpRxDl = 8
            CanTpRxPaddingActivation = CANTP_ON
            CanTpRxTaType = CANTP_FUNCTIONAL
            CanTpRxNSduRef = EcucPduCollection/DCM_HCP5_CANFD01_XIX_TPCHType_CANHS_ISO_Diagnose_XIX_0x700_XIX_Functional_e754bff6_Rx
            CanTpRxNPdu_959d5d8a (CanTpRxNPdu): CanTpRxNPduRef=ISO_Funktionaler_Req_All_XIX_HCP5_CANFD01_e497e7f8_Rx
        TPC_HCP5_CANFD01_XIX_TPCHType_CANHS_OBDC_SSN_Diagnose_XIX_0x17FC70D0_XIX_0x17FE70D0_XIX_Physical_5e366870
          CanTpRxNSdu_8e7a3afd (CanTpRxNSdu):
            CanTpBs = 15
            CanTpNar = 1
            CanTpNbr = 0.1
            CanTpNcr = 1
            CanTpRxAddressingFormat = CANTP_STANDARD
            CanTpRxDl = 8
            CanTpRxPaddingActivation = CANTP_ON
            CanTpRxTaType = CANTP_PHYSICAL
            CanTpRxWftMax = 15
            CanTpSTmin = 0.005
            CanTpRxNSduRef = EcucPduCollection/DCM_HCP5_CANFD01_XIX_TPCHType_CANHS_OBDC_SSN_Diagnose_XIX_0x17FC70D0_XIX_0x17FE70D0_XIX_Physical_cd403ce5_Rx
            CanTpRxNPdu_473d4380 (CanTpRxNPdu): CanTpRxNPduRef=OBDC_SSN_BJB_Req_XIX_HCP5_CANFD01_87b9d88e_Rx
            CanTpTxFcNPdu_473d4380 (CanTpTxFcNPdu): CanTpTxFcNPduRef=OBDC_SSN_BJB_Resp_XIX_HCP5_CANFD01_7c2a070c_Tx
          CanTpTxNSdu_8e7a3afd (CanTpTxNSdu):
            CanTpNas = 1
            CanTpNbs = 1
            CanTpNcs = 0.2
            CanTpTxAddressingFormat = CANTP_STANDARD
            CanTpTxDl = 8
            CanTpTxPaddingActivation = CANTP_ON
            CanTpTxTaType = CANTP_PHYSICAL
            CanTpTxNSduRef = EcucPduCollection/DCM_HCP5_CANFD01_XIX_TPCHType_CANHS_OBDC_SSN_Diagnose_XIX_0x17FE70D0_XIX_0x17FC70D0_XIX_Physical_5430f795_Tx
            CanTpRxFcNPdu_65c79772 (CanTpRxFcNPdu): CanTpRxFcNPduRef=OBDC_SSN_BJB_Req_XIX_HCP5_CANFD01_87b9d88e_Rx
            CanTpTxNPdu_65c79772 (CanTpTxNPdu): CanTpTxNPduRef=OBDC_SSN_BJB_Resp_XIX_HCP5_CANFD01_7c2a070c_Tx
        TPC_HCP5_CANFD01_XIX_TPCHType_CANHS_OBDC_SSN_Diagnose_XIX_0x17FC71B1_XIX_0x17FE71B1_XIX_Physical_275feab5
          CanTpRxNSdu_038277d9 (CanTpRxNSdu):
            CanTpBs = 15
            CanTpNar = 1
            CanTpNbr = 0.1
            CanTpNcr = 1
            CanTpRxAddressingFormat = CANTP_STANDARD
            CanTpRxDl = 8
            CanTpRxPaddingActivation = CANTP_ON
            CanTpRxTaType = CANTP_PHYSICAL
            CanTpRxWftMax = 15
            CanTpSTmin = 0.005
            CanTpRxNSduRef = EcucPduCollection/DCM_HCP5_CANFD01_XIX_TPCHType_CANHS_OBDC_SSN_Diagnose_XIX_0x17FC71B1_XIX_0x17FE71B1_XIX_Physical_7a4726ef_Rx
            CanTpRxNPdu_2aa1c3b9 (CanTpRxNPdu): CanTpRxNPduRef=OBDC_SSN_UI2Sens01_Req_XIX_HCP5_CANFD01_00e7db31_Rx
            CanTpTxFcNPdu_2aa1c3b9 (CanTpTxFcNPdu): CanTpTxFcNPduRef=OBDC_SSN_UI2Sens01_Resp_XIX_HCP5_CANFD01_2773f712_Tx
          CanTpTxNSdu_038277d9 (CanTpTxNSdu):
            CanTpNas = 1
            CanTpNbs = 1
            CanTpNcs = 0.2
            CanTpTxAddressingFormat = CANTP_STANDARD
            CanTpTxDl = 8
            CanTpTxPaddingActivation = CANTP_ON
            CanTpTxTaType = CANTP_PHYSICAL
            CanTpTxNSduRef = EcucPduCollection/DCM_HCP5_CANFD01_XIX_TPCHType_CANHS_OBDC_SSN_Diagnose_XIX_0x17FE71B1_XIX_0x17FC71B1_XIX_Physical_e337ed9f_Tx
            CanTpRxFcNPdu_085b174b (CanTpRxFcNPdu): CanTpRxFcNPduRef=OBDC_SSN_UI2Sens01_Req_XIX_HCP5_CANFD01_00e7db31_Rx
            CanTpTxNPdu_085b174b (CanTpTxNPdu): CanTpTxNPduRef=OBDC_SSN_UI2Sens01_Resp_XIX_HCP5_CANFD01_2773f712_Tx
        TPC_HCP5_CANFD01_XIX_TPCHType_CANHS_OBDC_SSN_Diagnose_XIX_0x17FC71B2_XIX_0x17FE71B2_XIX_Physical_55597f36
          CanTpRxNSdu_4174e2aa (CanTpRxNSdu):
            CanTpBs = 15
            CanTpNar = 1
            CanTpNbr = 0.1
            CanTpNcr = 1
            CanTpRxAddressingFormat = CANTP_STANDARD
            CanTpRxDl = 8
            CanTpRxPaddingActivation = CANTP_ON
            CanTpRxTaType = CANTP_PHYSICAL
            CanTpRxWftMax = 15
            CanTpSTmin = 0.005
            CanTpRxNSduRef = EcucPduCollection/DCM_HCP5_CANFD01_XIX_TPCHType_CANHS_OBDC_SSN_Diagnose_XIX_0x17FC71B2_XIX_0x17FE71B2_XIX_Physical_9b954fe5_Rx
            CanTpRxNPdu_0b5e19f8 (CanTpRxNPdu): CanTpRxNPduRef=OBDC_SSN_UI2Sens02_Req_XIX_HCP5_CANFD01_7e9f9397_Rx
            CanTpTxFcNPdu_0b5e19f8 (CanTpTxFcNPdu): CanTpTxFcNPduRef=OBDC_SSN_UI2Sens02_Resp_XIX_HCP5_CANFD01_18b88987_Tx
          CanTpTxNSdu_4174e2aa (CanTpTxNSdu):
            CanTpNas = 1
            CanTpNbs = 1
            CanTpNcs = 0.2
            CanTpTxAddressingFormat = CANTP_STANDARD
            CanTpTxDl = 8
            CanTpTxPaddingActivation = CANTP_ON
            CanTpTxTaType = CANTP_PHYSICAL
            CanTpTxNSduRef = EcucPduCollection/DCM_HCP5_CANFD01_XIX_TPCHType_CANHS_OBDC_SSN_Diagnose_XIX_0x17FE71B2_XIX_0x17FC71B2_XIX_Physical_02e58495_Tx
            CanTpRxFcNPdu_29a4cd0a (CanTpRxFcNPdu): CanTpRxFcNPduRef=OBDC_SSN_UI2Sens02_Req_XIX_HCP5_CANFD01_7e9f9397_Rx
            CanTpTxNPdu_29a4cd0a (CanTpTxNPdu): CanTpTxNPduRef=OBDC_SSN_UI2Sens02_Resp_XIX_HCP5_CANFD01_18b88987_Tx
        TPC_HCP5_CANFD01_XIX_TPCHType_CANHS_OBDx_XIX_0x18DA05F1_XIX_0x18DAF105_XIX_Physical_5f70b7ea
          CanTpRxNSdu_dd731bf6 (CanTpRxNSdu):
            CanTpBs = 15
            CanTpNar = 0.025
            CanTpNbr = 0.001
            CanTpNcr = 0.15
            CanTpRxAddressingFormat = CANTP_STANDARD
            CanTpRxDl = 8
            CanTpRxPaddingActivation = CANTP_ON
            CanTpRxTaType = CANTP_PHYSICAL
            CanTpRxWftMax = 0
            CanTpSTmin = 0.005
            CanTpRxNSduRef = EcucPduCollection/DCM_HCP5_CANFD01_XIX_TPCHType_CANHS_OBDx_XIX_0x18DA05F1_XIX_0x18DAF105_XIX_Physical_31397855_Rx
            CanTpRxNPdu_0da6f803 (CanTpRxNPdu): CanTpRxNPduRef=OBDx_Hybrid_01_Req_XIX_HCP5_CANFD01_5cba35a0_Rx
            CanTpTxFcNPdu_0da6f803 (CanTpTxFcNPdu): CanTpTxFcNPduRef=OBDx_Hybrid_01_Resp_XIX_HCP5_CANFD01_a027092e_Tx
          CanTpTxNSdu_dd731bf6 (CanTpTxNSdu):
            CanTpNas = 0.025
            CanTpNbs = 0.075
            CanTpNcs = 0.025
            CanTpTxAddressingFormat = CANTP_STANDARD
            CanTpTxDl = 8
            CanTpTxPaddingActivation = CANTP_ON
            CanTpTxTaType = CANTP_PHYSICAL
            CanTpTxNSduRef = EcucPduCollection/DCM_HCP5_CANFD01_XIX_TPCHType_CANHS_OBDx_XIX_0x18DAF105_XIX_0x18DA05F1_XIX_Physical_71746075_Tx
            CanTpRxFcNPdu_2f5c2cf1 (CanTpRxFcNPdu): CanTpRxFcNPduRef=OBDx_Hybrid_01_Req_XIX_HCP5_CANFD01_5cba35a0_Rx
            CanTpTxNPdu_2f5c2cf1 (CanTpTxNPdu): CanTpTxNPduRef=OBDx_Hybrid_01_Resp_XIX_HCP5_CANFD01_a027092e_Tx
        TPC_HCP5_CANFD01_XIX_TPCHType_CANHS_OBDx_XIX_0x18DB33F1_XIX_Functional_f416b438
          CanTpRxNSdu_527ac2b8 (CanTpRxNSdu):
            CanTpNbr = 0.001
            CanTpRxAddressingFormat = CANTP_STANDARD
            CanTpRxDl = 8
            CanTpRxPaddingActivation = CANTP_ON
            CanTpRxTaType = CANTP_FUNCTIONAL
            CanTpRxNSduRef = EcucPduCollection/DCM_HCP5_CANFD01_XIX_TPCHType_CANHS_OBDx_XIX_0x18DB33F1_XIX_Functional_06e701c6_Rx
            CanTpRxNPdu_ff9a7279 (CanTpRxNPdu): CanTpRxNPduRef=OBDx_allOBD_Req_XIX_HCP5_CANFD01_a7e21e7c_Rx
