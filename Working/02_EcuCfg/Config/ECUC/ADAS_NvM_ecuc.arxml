AUTOSAR XML (schema 4-3-0)
package /ActiveEcuC
  module config NvM: implementation-config-variant=VARIANT-PRE-COMPILE, module-description=NvM_Impl
    StartApplication_NvMBlock2 (NvMBlockDescriptor):
      NvMBlockCrcType = NVM_CRC16
      NvMBlockManagementType = NVM_BLOCK_NATIVE
      NvMInitBlockCallback = NULL_PTR
      NvMResistantToChangedSw = true
      NvMUseInitCallback = false
      NvMUseJobendCallback = true
      NvMSingleBlockCallback = NULL_PTR
      NvMBswMBlockStatusInformation = false
      NvMBlockUseCrc = true
      NvMCalcRamBlockCrc = false
      NvMBlockJobPriority = 127
      NvMBlockWriteProt = false
      NvMNvBlockLength = 1
      NvMNvBlockNum = 1
      NvMNvramBlockIdentifier = 4
      NvMWriteBlockOnce = false
      NvMUseServicePorts = true
      NvMBlockUseCRCCompMechanism = false
      NvMWriteRamBlockToNvCallback = NULL_PTR
      NvMReadRamBlockFromNvCallback = NULL_PTR
      NvMBlockLengthCheckType = false
      NvMBlockLengthCheck = false
      NvMAutomaticBlockLength = false
      NvMInvokeCallbacksForReadAll = true
      NvMInvokeCallbacksForWriteAll = true
      NvMBlockUseSetRamBlockStatus = false
      NvMRamBlockDataAddress = 
      NvMCheckLossOfRedundancy = false
      NvMBlockUseSyncMechanism = false
      NvMTargetBlockReference
        NvMFeeRef: NvMNameOfFeeBlock=FeeBlockConfiguration_NvM2_StartAppl
    NvMConfigBlock (NvMBlockDescriptor):
      NvMBlockCrcType = NVM_CRC16
      NvMBlockManagementType = NVM_BLOCK_REDUNDANT
      NvMInitBlockCallback = NULL_PTR
      NvMResistantToChangedSw = true
      NvMSelectBlockForReadAll = true
      NvMSelectBlockForWriteAll = true
      NvMUseInitCallback = false
      NvMUseJobendCallback = false
      NvMSingleBlockCallback = NULL_PTR
      NvMBswMBlockStatusInformation = false
      NvMBlockUseCrc = true
      NvMBlockUseSyncMechanism = false
      NvMCalcRamBlockCrc = false
      NvMUseServicePorts = false
      NvMNvramBlockIdentifier = 1
      NvMNvBlockNum = 2
      NvMNvBlockLength = 2
      NvMRomBlockDataAddress = NULL_PTR
      NvMBlockJobPriority = 127
      NvMBlockWriteProt = false
      NvMWriteBlockOnce = false
      NvMBlockUseCRCCompMechanism = false
      NvMBlockPostReadTransformCallback = NULL_PTR
      NvMBlockPreWriteTransformCallback = NULL_PTR
      NvMBlockUseSetRamBlockStatus = true
      NvMInvokeCallbacksForReadAll = true
      NvMInvokeCallbacksForWriteAll = true
      NvMRamBlockDataAddress = vFotaH_NvMInfoBlock
      NvMCheckLossOfRedundancy = false
      NvMTargetBlockReference
        NvMFeeRef: NvMNameOfFeeBlock=FeeConfigBlock
    NvMCommon:
      NvMDevErrorDetect = true
      NvMVersionInfoApi = true
      NvMApiConfigClass = NVM_API_CONFIG_CLASS_3
      NvMBswMMultiBlockJobStatusInformation = true
      NvMCompiledConfigId = 1
      NvMCrcNumOfBytes = 64
      NvMDatasetSelectionBits = 4
      NvMDrvModeSwitch = true
      NvMDynamicConfiguration = false
      NvMJobPrioritization = false
      NvMPollingMode = true
      NvMSetRamBlockStatusApi = true
      NvMSizeStandardJobQueue = 8
      NvMMaxNoOfWriteRetries = 1
      NvMMainFunctionPeriod = 0.01
      NvMUseBlockIdCheck = false
      NvMRepairRedundantBlocksApi = false
      NvMSafeBswChecks = false
      NvMDetectedLossOfRedundancyCallback = NULL_PTR
    NvMCommonVendorParams:
      NvMKillWriteAllApi = true
      NvMCfgCbkIncludeList = Dem_Cbk.h
      NvMCfgCbkIncludeList = vFotaH_Stubs.h
      NvMCfgCbkIncludeList = vSwUpdM_Appl.h
      NvMCfgCbkIncludeList = vFotaH.h
      NvMCfgCbkIncludeList = Crypto_30_LibCv.h
      NvMDataIntegrityIntBuffer = true
      NvMPreReadAllApi = false
      NvMJobForwardingToMemoryCore = false
      NvMCfgCbkIncludeList = ivd_c4nva.h
      NvMCfgCbkIncludeList = CddNpmGen2.h
      NvMCfgCbkIncludeList = RT_Vishnu.h
    NvmDemEventParameterRefs:
      NVM_E_WRONG_BLOCK_ID = AutoCreatedDemEvent_NVM_E_WRONG_BLOCK_ID
      NVM_E_WRITE_PROTECTED = AutoCreatedDemEvent_NVM_E_WRITE_PROTECTED
      NVM_E_VERIFY_FAILED = AutoCreatedDemEvent_NVM_E_VERIFY_FAILED
      NVM_E_REQ_FAILED = AutoCreatedDemEvent_NVM_E_REQ_FAILED
      NVM_E_QUEUE_OVERFLOW = AutoCreatedDemEvent_NVM_E_QUEUE_OVERFLOW
      NVM_E_LOSS_OF_REDUNDANCY = AutoCreatedDemEvent_NVM_E_LOSS_OF_REDUNDANCY
      NVM_E_INTEGRITY_FAILED = AutoCreatedDemEvent_NVM_E_INTEGRITY_FAILED
    24 x NvMBlockDescriptor, all with NvMBlockManagementType=NVM_BLOCK_NATIVE, NvMBlockJobPriority=127, NvMBlockWriteProt=false, NvMNvBlockNum=1, NvMWriteBlockOnce=false, NvMBlockUseCRCCompMechanism=false, NvMInvokeCallbacksForReadAll=true, NvMInvokeCallbacksForWriteAll=true, NvMCheckLossOfRedundancy=false:
      DemAdminDataBlock: NvMBlockCrcType=NVM_CRC16, NvMInitBlockCallback=Dem_NvM_InitAdminData, NvMResistantToChangedSw=true, NvMSelectBlockForReadAll=true, NvMSelectBlockForWriteAll=true, NvMUseInitCallback=true, NvMUseJobendCallback=true, NvMSingleBlockCallback=Dem_NvM_JobFinished, NvMBswMBlockStatusInformation=false, NvMBlockUseCrc=true, NvMBlockUseSyncMechanism=false, NvMCalcRamBlockCrc=false, NvMNvBlockLength=16, NvMNvramBlockIdentifier=2, NvMUseServicePorts=false, NvMRamBlockDataAddress=Dem_Cfg_AdminData, NvMRomBlockDataAddress=NULL_PTR, NvMBlockUseSetRamBlockStatus=false
        NvMTargetBlockReference
          NvMFeeRef: NvMNameOfFeeBlock=FeeDemAdminDataBlock
      DemPrimaryDataBlock0: NvMBlockCrcType=NVM_CRC16, NvMInitBlockCallback=NULL_PTR, NvMResistantToChangedSw=true, NvMSelectBlockForReadAll=true, NvMSelectBlockForWriteAll=true, NvMUseInitCallback=false, NvMUseJobendCallback=true, NvMSingleBlockCallback=Dem_NvM_JobFinished, NvMBswMBlockStatusInformation=false, NvMBlockUseCrc=true, NvMBlockUseSyncMechanism=false, NvMCalcRamBlockCrc=false, NvMNvBlockLength=12, NvMNvramBlockIdentifier=6, NvMUseServicePorts=false, NvMRamBlockDataAddress=Dem_Cfg_PrimaryEntry_0, NvMRomBlockDataAddress=Dem_Cfg_MemoryEntryInit, NvMBlockUseSetRamBlockStatus=false
        NvMTargetBlockReference
          NvMFeeRef: NvMNameOfFeeBlock=FeeDemPrimaryDataBlock0
      DemPrimaryDataBlock1: NvMBlockCrcType=NVM_CRC16, NvMInitBlockCallback=NULL_PTR, NvMResistantToChangedSw=true, NvMSelectBlockForReadAll=true, NvMSelectBlockForWriteAll=true, NvMUseInitCallback=false, NvMUseJobendCallback=true, NvMSingleBlockCallback=Dem_NvM_JobFinished, NvMBswMBlockStatusInformation=false, NvMBlockUseCrc=true, NvMBlockUseSyncMechanism=false, NvMCalcRamBlockCrc=false, NvMNvBlockLength=12, NvMNvramBlockIdentifier=7, NvMUseServicePorts=false, NvMRamBlockDataAddress=Dem_Cfg_PrimaryEntry_1, NvMRomBlockDataAddress=Dem_Cfg_MemoryEntryInit, NvMBlockUseSetRamBlockStatus=false
        NvMTargetBlockReference
          NvMFeeRef: NvMNameOfFeeBlock=FeeDemPrimaryDataBlock1
      DemPrimaryDataBlock2: NvMBlockCrcType=NVM_CRC16, NvMInitBlockCallback=NULL_PTR, NvMResistantToChangedSw=true, NvMSelectBlockForReadAll=true, NvMSelectBlockForWriteAll=true, NvMUseInitCallback=false, NvMUseJobendCallback=true, NvMSingleBlockCallback=Dem_NvM_JobFinished, NvMBswMBlockStatusInformation=false, NvMBlockUseCrc=true, NvMBlockUseSyncMechanism=false, NvMCalcRamBlockCrc=false, NvMNvBlockLength=12, NvMNvramBlockIdentifier=8, NvMUseServicePorts=false, NvMRamBlockDataAddress=Dem_Cfg_PrimaryEntry_2, NvMRomBlockDataAddress=Dem_Cfg_MemoryEntryInit, NvMBlockUseSetRamBlockStatus=false
        NvMTargetBlockReference
          NvMFeeRef: NvMNameOfFeeBlock=FeeDemPrimaryDataBlock2
      DemPrimaryDataBlock3: NvMBlockCrcType=NVM_CRC16, NvMInitBlockCallback=NULL_PTR, NvMResistantToChangedSw=true, NvMSelectBlockForReadAll=true, NvMSelectBlockForWriteAll=true, NvMUseInitCallback=false, NvMUseJobendCallback=true, NvMSingleBlockCallback=Dem_NvM_JobFinished, NvMBswMBlockStatusInformation=false, NvMBlockUseCrc=true, NvMBlockUseSyncMechanism=false, NvMCalcRamBlockCrc=false, NvMNvBlockLength=12, NvMNvramBlockIdentifier=9, NvMUseServicePorts=false, NvMRamBlockDataAddress=Dem_Cfg_PrimaryEntry_3, NvMRomBlockDataAddress=Dem_Cfg_MemoryEntryInit, NvMBlockUseSetRamBlockStatus=false
        NvMTargetBlockReference
          NvMFeeRef: NvMNameOfFeeBlock=FeeDemPrimaryDataBlock3
      DemPrimaryDataBlock4: NvMBlockCrcType=NVM_CRC16, NvMInitBlockCallback=NULL_PTR, NvMResistantToChangedSw=true, NvMSelectBlockForReadAll=true, NvMSelectBlockForWriteAll=true, NvMUseInitCallback=false, NvMUseJobendCallback=true, NvMSingleBlockCallback=Dem_NvM_JobFinished, NvMBswMBlockStatusInformation=false, NvMBlockUseCrc=true, NvMBlockUseSyncMechanism=false, NvMCalcRamBlockCrc=false, NvMNvBlockLength=12, NvMNvramBlockIdentifier=10, NvMUseServicePorts=false, NvMRamBlockDataAddress=Dem_Cfg_PrimaryEntry_4, NvMRomBlockDataAddress=Dem_Cfg_MemoryEntryInit, NvMBlockUseSetRamBlockStatus=false
        NvMTargetBlockReference
          NvMFeeRef: NvMNameOfFeeBlock=FeeDemPrimaryDataBlock4
      DemPrimaryDataBlock5: NvMBlockCrcType=NVM_CRC16, NvMInitBlockCallback=NULL_PTR, NvMResistantToChangedSw=true, NvMSelectBlockForReadAll=true, NvMSelectBlockForWriteAll=true, NvMUseInitCallback=false, NvMUseJobendCallback=true, NvMSingleBlockCallback=Dem_NvM_JobFinished, NvMBswMBlockStatusInformation=false, NvMBlockUseCrc=true, NvMBlockUseSyncMechanism=false, NvMCalcRamBlockCrc=false, NvMNvBlockLength=12, NvMNvramBlockIdentifier=11, NvMUseServicePorts=false, NvMRamBlockDataAddress=Dem_Cfg_PrimaryEntry_5, NvMRomBlockDataAddress=Dem_Cfg_MemoryEntryInit, NvMBlockUseSetRamBlockStatus=false
        NvMTargetBlockReference
          NvMFeeRef: NvMNameOfFeeBlock=FeeDemPrimaryDataBlock5
      DemPrimaryDataBlock6: NvMBlockCrcType=NVM_CRC16, NvMInitBlockCallback=NULL_PTR, NvMResistantToChangedSw=true, NvMSelectBlockForReadAll=true, NvMSelectBlockForWriteAll=true, NvMUseInitCallback=false, NvMUseJobendCallback=true, NvMSingleBlockCallback=Dem_NvM_JobFinished, NvMBswMBlockStatusInformation=false, NvMBlockUseCrc=true, NvMBlockUseSyncMechanism=false, NvMCalcRamBlockCrc=false, NvMNvBlockLength=12, NvMNvramBlockIdentifier=12, NvMUseServicePorts=false, NvMRamBlockDataAddress=Dem_Cfg_PrimaryEntry_6, NvMRomBlockDataAddress=Dem_Cfg_MemoryEntryInit, NvMBlockUseSetRamBlockStatus=false
        NvMTargetBlockReference
          NvMFeeRef: NvMNameOfFeeBlock=FeeDemPrimaryDataBlock6
      DemPrimaryDataBlock7: NvMBlockCrcType=NVM_CRC16, NvMInitBlockCallback=NULL_PTR, NvMResistantToChangedSw=true, NvMSelectBlockForReadAll=true, NvMSelectBlockForWriteAll=true, NvMUseInitCallback=false, NvMUseJobendCallback=true, NvMSingleBlockCallback=Dem_NvM_JobFinished, NvMBswMBlockStatusInformation=false, NvMBlockUseCrc=true, NvMBlockUseSyncMechanism=false, NvMCalcRamBlockCrc=false, NvMNvBlockLength=12, NvMNvramBlockIdentifier=13, NvMUseServicePorts=false, NvMRamBlockDataAddress=Dem_Cfg_PrimaryEntry_7, NvMRomBlockDataAddress=Dem_Cfg_MemoryEntryInit, NvMBlockUseSetRamBlockStatus=false
        NvMTargetBlockReference
          NvMFeeRef: NvMNameOfFeeBlock=FeeDemPrimaryDataBlock7
      StartApplication_NvMBlock1: NvMInitBlockCallback=NULL_PTR, NvMResistantToChangedSw=true, NvMUseInitCallback=false, NvMUseJobendCallback=true, NvMSingleBlockCallback=NULL_PTR, NvMBswMBlockStatusInformation=false, NvMBlockUseCrc=true, NvMBlockUseSyncMechanism=false, NvMCalcRamBlockCrc=false, NvMNvBlockLength=1, NvMNvramBlockIdentifier=5, NvMUseServicePorts=true, NvMWriteRamBlockToNvCallback=NULL_PTR, NvMReadRamBlockFromNvCallback=NULL_PTR, NvMBlockLengthCheckType=false, NvMBlockLengthCheck=false, NvMAutomaticBlockLength=false, NvMBlockUseSetRamBlockStatus=false, NvMRamBlockDataAddress=vFotaH_NvMInfoBlock, NvMBlockCrcType=NVM_CRC16
        NvMTargetBlockReference
          NvMFeeRef: NvMNameOfFeeBlock=FeeBlockConfiguration
      vFotaH_NvMModuleInfo: NvMBlockCrcType=NVM_CRC32, NvMInitBlockCallback=NULL_PTR, NvMResistantToChangedSw=true, NvMSelectBlockForReadAll=true, NvMSelectBlockForWriteAll=true, NvMUseInitCallback=false, NvMUseJobendCallback=false, NvMSingleBlockCallback=NULL_PTR, NvMBswMBlockStatusInformation=false, NvMBlockUseCrc=true, NvMBlockUseSyncMechanism=false, NvMCalcRamBlockCrc=false, NvMNvBlockLength=32, NvMNvramBlockIdentifier=14, NvMUseServicePorts=false, NvMBlockUseSetRamBlockStatus=true, NvMBlockLengthCheck=true, NvMBlockLengthCheckType=true, NvMRamBlockDataAddress=vFotaH_NvMInfoBlock, NvMAutomaticBlockLength=true, NvMRomBlockDataAddress=NULL_PTR
        NvMTargetBlockReference
          NvMFeeRef: NvMNameOfFeeBlock=vFotaH_FeeModuleInfo
      vSwUpdM_Appl_NvModuleInfo: NvMBlockCrcType=NVM_CRC16, NvMInitBlockCallback=NULL_PTR, NvMResistantToChangedSw=true, NvMSelectBlockForReadAll=true, NvMSelectBlockForWriteAll=false, NvMUseInitCallback=false, NvMUseJobendCallback=false, NvMSingleBlockCallback=NULL_PTR, NvMBswMBlockStatusInformation=false, NvMBlockUseCrc=false, NvMBlockUseSyncMechanism=false, NvMCalcRamBlockCrc=false, NvMNvBlockLength=48, NvMNvramBlockIdentifier=15, NvMUseServicePorts=false, NvMBlockUseSetRamBlockStatus=false, NvMAutomaticBlockLength=true, NvMBlockLengthCheck=true, NvMBlockLengthCheckType=true, NvMRamBlockDataAddress=vSwUpdM_Appl_ModuleInfo, NvMReadRamBlockFromNvCallback=NULL_PTR, NvMRomBlockDataAddress=NULL_PTR
        NvMTargetBlockReference
          NvMFeeRef: NvMNameOfFeeBlock=vSwUpdM_Appl_FeeModuleInfo
      vSwUpdM_Appl_NvPartitionInfo: NvMBlockCrcType=NVM_CRC16, NvMInitBlockCallback=NULL_PTR, NvMResistantToChangedSw=true, NvMSelectBlockForReadAll=true, NvMSelectBlockForWriteAll=false, NvMUseInitCallback=false, NvMUseJobendCallback=false, NvMSingleBlockCallback=NULL_PTR, NvMBswMBlockStatusInformation=false, NvMBlockUseCrc=false, NvMBlockUseSyncMechanism=false, NvMCalcRamBlockCrc=false, NvMNvBlockLength=32, NvMNvramBlockIdentifier=16, NvMUseServicePorts=false, NvMBlockUseSetRamBlockStatus=false, NvMAutomaticBlockLength=true, NvMBlockLengthCheck=true, NvMBlockLengthCheckType=true, NvMRomBlockDataAddress=NULL_PTR, NvMWriteRamBlockToNvCallback=NULL_PTR, NvMReadRamBlockFromNvCallback=NULL_PTR, NvMRamBlockDataAddress=vSwUpdM_Appl_PartitionInfo
        NvMTargetBlockReference
          NvMFeeRef: NvMNameOfFeeBlock=vSwUpdM_Appl_FeePartitionInfo
      vSwUpdM_Appl_NvRegionInfo: NvMBlockCrcType=NVM_CRC16, NvMInitBlockCallback=NULL_PTR, NvMResistantToChangedSw=true, NvMSelectBlockForReadAll=true, NvMSelectBlockForWriteAll=false, NvMUseInitCallback=false, NvMUseJobendCallback=false, NvMSingleBlockCallback=NULL_PTR, NvMBswMBlockStatusInformation=false, NvMBlockUseCrc=false, NvMBlockUseSyncMechanism=false, NvMCalcRamBlockCrc=false, NvMNvBlockLength=32, NvMNvramBlockIdentifier=17, NvMUseServicePorts=false, NvMBlockUseSetRamBlockStatus=false, NvMRamBlockDataAddress=vSwUpdM_Appl_RegionInfo, NvMAutomaticBlockLength=true, NvMReadRamBlockFromNvCallback=NULL_PTR, NvMRomBlockDataAddress=NULL_PTR, NvMBlockLengthCheck=true, NvMBlockLengthCheckType=true
        NvMTargetBlockReference
          NvMFeeRef: NvMNameOfFeeBlock=vSwUpdM_Appl_FeeRegionInfo
      vSwUpdM_Appl_NvResumeInfo: NvMBlockCrcType=NVM_CRC16, NvMInitBlockCallback=NULL_PTR, NvMResistantToChangedSw=true, NvMSelectBlockForReadAll=true, NvMSelectBlockForWriteAll=false, NvMUseInitCallback=false, NvMUseJobendCallback=false, NvMSingleBlockCallback=NULL_PTR, NvMBswMBlockStatusInformation=false, NvMBlockUseCrc=false, NvMBlockUseSyncMechanism=false, NvMCalcRamBlockCrc=false, NvMNvBlockLength=16, NvMNvramBlockIdentifier=18, NvMUseServicePorts=false, NvMBlockUseSetRamBlockStatus=false, NvMBlockLengthCheck=true, NvMRamBlockDataAddress=vSwUpdM_Appl_ResumeInfo, NvMReadRamBlockFromNvCallback=NULL_PTR, NvMAutomaticBlockLength=true, NvMBlockLengthCheckType=true, NvMRomBlockDataAddress=NULL_PTR
        NvMTargetBlockReference
          NvMFeeRef: NvMNameOfFeeBlock=vSwUpdM_Appl_FeeResumeInfo
      vSwUpdM_Appl_NvSegmentAttributes: NvMBlockCrcType=NVM_CRC16, NvMInitBlockCallback=NULL_PTR, NvMResistantToChangedSw=true, NvMSelectBlockForReadAll=true, NvMSelectBlockForWriteAll=false, NvMUseInitCallback=false, NvMUseJobendCallback=false, NvMSingleBlockCallback=NULL_PTR, NvMBswMBlockStatusInformation=false, NvMBlockUseCrc=false, NvMBlockUseSyncMechanism=false, NvMCalcRamBlockCrc=false, NvMNvBlockLength=1120, NvMNvramBlockIdentifier=19, NvMUseServicePorts=false, NvMRamBlockDataAddress=vSwUpdM_Appl_SegmentAttributes, NvMAutomaticBlockLength=true, NvMBlockLengthCheckType=true, NvMBlockLengthCheck=true, NvMBlockUseSetRamBlockStatus=false, NvMReadRamBlockFromNvCallback=NULL_PTR, NvMRomBlockDataAddress=NULL_PTR
        NvMTargetBlockReference
          NvMFeeRef: NvMNameOfFeeBlock=vSwUpdM_Appl_FeeSegmentAttributes
      vSwUpdM_Appl_NvSegmentCount: NvMBlockCrcType=NVM_CRC16, NvMInitBlockCallback=NULL_PTR, NvMResistantToChangedSw=true, NvMSelectBlockForReadAll=true, NvMSelectBlockForWriteAll=false, NvMUseInitCallback=false, NvMUseJobendCallback=false, NvMSingleBlockCallback=NULL_PTR, NvMBswMBlockStatusInformation=false, NvMBlockUseCrc=false, NvMBlockUseSyncMechanism=false, NvMCalcRamBlockCrc=false, NvMNvBlockLength=16, NvMNvramBlockIdentifier=20, NvMUseServicePorts=false, NvMBlockUseSetRamBlockStatus=false, NvMRamBlockDataAddress=vSwUpdM_Appl_SegmentCount, NvMBlockLengthCheck=true, NvMBlockLengthCheckType=true, NvMAutomaticBlockLength=true, NvMReadRamBlockFromNvCallback=NULL_PTR, NvMRomBlockDataAddress=NULL_PTR
        NvMTargetBlockReference
          NvMFeeRef: NvMNameOfFeeBlock=vSwUpdM_Appl_FeeSegmentCount
      vSwUpdM_Appl_NvSegmentWriteAddress: NvMBlockCrcType=NVM_CRC16, NvMInitBlockCallback=NULL_PTR, NvMResistantToChangedSw=true, NvMSelectBlockForReadAll=true, NvMSelectBlockForWriteAll=false, NvMUseInitCallback=false, NvMUseJobendCallback=false, NvMSingleBlockCallback=NULL_PTR, NvMBswMBlockStatusInformation=false, NvMBlockUseCrc=false, NvMBlockUseSyncMechanism=false, NvMCalcRamBlockCrc=false, NvMNvBlockLength=560, NvMNvramBlockIdentifier=21, NvMUseServicePorts=false, NvMBlockUseSetRamBlockStatus=false, NvMAutomaticBlockLength=true, NvMRamBlockDataAddress=vSwUpdM_Appl_SegmentWriteAddress, NvMBlockLengthCheck=true, NvMBlockLengthCheckType=true, NvMReadRamBlockFromNvCallback=NULL_PTR, NvMRomBlockDataAddress=NULL_PTR
        NvMTargetBlockReference
          NvMFeeRef: NvMNameOfFeeBlock=vSwUpdM_Appl_FeeSegmentWriteAddress
      vSwUpdM_Appl_NvUpdateState: NvMBlockCrcType=NVM_CRC16, NvMInitBlockCallback=NULL_PTR, NvMResistantToChangedSw=true, NvMSelectBlockForReadAll=true, NvMSelectBlockForWriteAll=false, NvMUseInitCallback=false, NvMUseJobendCallback=false, NvMSingleBlockCallback=NULL_PTR, NvMBswMBlockStatusInformation=false, NvMBlockUseCrc=false, NvMBlockUseSyncMechanism=false, NvMCalcRamBlockCrc=false, NvMNvBlockLength=1, NvMNvramBlockIdentifier=22, NvMUseServicePorts=false, NvMBlockUseSetRamBlockStatus=false, NvMRamBlockDataAddress=vSwUpdM_Appl_UpdateState, NvMAutomaticBlockLength=true, NvMBlockLengthCheck=true, NvMBlockLengthCheckType=true, NvMReadRamBlockFromNvCallback=NULL_PTR, NvMRomBlockDataAddress=NULL_PTR
        NvMTargetBlockReference
          NvMFeeRef: NvMNameOfFeeBlock=vSwUpdM_Appl_FeeUpdateState
      CryptoKeyStorage: NvMBlockCrcType=NVM_CRC16, NvMInitBlockCallback=Crypto_30_LibCv_NvBlock_Init_CryptoNvBlock, NvMResistantToChangedSw=false, NvMSelectBlockForReadAll=true, NvMSelectBlockForWriteAll=true, NvMWriteRamBlockToNvCallback=Crypto_30_LibCv_NvBlock_WriteTo_CryptoNvBlock, NvMUseInitCallback=true, NvMUseJobendCallback=true, NvMSingleBlockCallback=Crypto_30_LibCv_NvBlock_Callback_CryptoNvBlock, NvMBswMBlockStatusInformation=false, NvMBlockUseCrc=true, NvMBlockUseSyncMechanism=true, NvMCalcRamBlockCrc=false, NvMNvBlockLength=474, NvMNvramBlockIdentifier=3, NvMUseServicePorts=false, NvMBlockLengthCheck=false, NvMBlockLengthCheckType=false, NvMInitBlockCallbackExtended=NULL_PTR, NvMRamBlockDataAddress=NULL_PTR, NvMReadRamBlockFromNvCallback=Crypto_30_LibCv_NvBlock_ReadFrom_CryptoNvBlock, NvMRomBlockDataAddress=NULL_PTR, NvMAutomaticBlockLength=false, NvMBlockUseSetRamBlockStatus=true
        NvMTargetBlockReference
          NvMFeeRef: NvMNameOfFeeBlock=FeeCryptoKeyStorage
      DemStatusDataBlock: NvMBlockCrcType=NVM_CRC16, NvMSelectBlockForWriteAll=false, NvMBlockUseCrc=true, NvMBlockUseSyncMechanism=false, NvMBswMBlockStatusInformation=false, NvMNvBlockLength=128, NvMNvramBlockIdentifier=23, NvMResistantToChangedSw=true, NvMUseServicePorts=false, NvMUseJobendCallback=false, NvMUseInitCallback=false, NvMBlockUseSetRamBlockStatus=false
        NvMTargetBlockReference
          NvMFeeRef: NvMNameOfFeeBlock=FeeDemStatusDataBlock
      NvMBlock_0x0250: NvMBlockCrcType=NVM_CRC16, NvMSelectBlockForWriteAll=false, NvMBlockUseCrc=true, NvMBlockUseSyncMechanism=false, NvMBswMBlockStatusInformation=false, NvMNvBlockLength=1, NvMNvramBlockIdentifier=24, NvMResistantToChangedSw=true, NvMUseServicePorts=true, NvMUseJobendCallback=false, NvMUseInitCallback=false, NvMBlockUseSetRamBlockStatus=false, NvMAutomaticBlockLength=true, NvMRomBlockDataAddress=, NvMSelectBlockForReadAll=false, NvMBlockLengthCheck=false, NvMBlockLengthCheckType=false
        NvMTargetBlockReference
          NvMFeeRef: NvMNameOfFeeBlock=FeeBlockConfiguration_NVBlock_0x0250
      CddNpmGen2_MeasurementsType: NvMBlockCrcType=NVM_CRC16, NvMSelectBlockForWriteAll=true, NvMBlockUseCrc=true, NvMBlockUseSyncMechanism=false, NvMBswMBlockStatusInformation=true, NvMNvBlockLength=10, NvMNvramBlockIdentifier=25, NvMResistantToChangedSw=true, NvMUseServicePorts=true, NvMUseJobendCallback=false, NvMUseInitCallback=false, NvMBlockUseSetRamBlockStatus=true, NvMSelectBlockForReadAll=true, NvMRamBlockDataAddress=RT_PIM, NvMStaticBlockIDCheck=true
        NvMTargetBlockReference
          NvMFeeRef: NvMNameOfFeeBlock=CddNpmGen2_MeasurementsType
      RT_Vishnu_NvMBlock: NvMBlockCrcType=NVM_CRC16, NvMSelectBlockForWriteAll=false, NvMBlockUseCrc=true, NvMBlockUseSyncMechanism=false, NvMBswMBlockStatusInformation=false, NvMNvBlockLength=64, NvMNvramBlockIdentifier=26, NvMResistantToChangedSw=true, NvMUseServicePorts=false, NvMUseJobendCallback=false, NvMUseInitCallback=false, NvMBlockUseSetRamBlockStatus=false, NvMInitBlockCallback=NULL_PTR
        NvMTargetBlockReference
          NvMFeeRef: NvMNameOfFeeBlock=RT_Fee_Block
