AUTOSAR XML (schema 4-3-0)
package /ActiveEcuC
  module config Fee: implementation-config-variant=VARIANT-POST-BUILD, module-description=Fee_Impl
    17 x FeeBlockConfiguration, all with FeeImmediateData=false, FeeNumberOfWriteCycles=10000, FeeQsBlockInstances=0, FeeQsBlockAddress=0, FeeQuasiStaticManager=false, FeeDeviceIndex=FlsGeneral:
      FeeDemPrimaryDataBlock0: FeeBlockNumber=48, FeeBlockSize=14
      FeeDemPrimaryDataBlock1: FeeBlockNumber=80, FeeBlockSize=14
      FeeDemPrimaryDataBlock2: FeeBlockNumber=112, FeeBlockSize=14
      FeeDemPrimaryDataBlock3: FeeBlockNumber=144, FeeBlockSize=14
      FeeDemPrimaryDataBlock4: FeeBlockNumber=176, FeeBlockSize=14
      FeeDemPrimaryDataBlock5: FeeBlockNumber=208, FeeBlockSize=14
      FeeDemPrimaryDataBlock6: FeeBlockNumber=240, FeeBlockSize=14
      FeeDemPrimaryDataBlock7: FeeBlockNumber=272, FeeBlockSize=14
      vFotaH_FeeModuleInfo: FeeBlockNumber=288, FeeBlockSize=36
      vSwUpdM_Appl_FeeModuleInfo: FeeBlockNumber=256, FeeBlockSize=48
      vSwUpdM_Appl_FeePartitionInfo: FeeBlockNumber=224, FeeBlockSize=32
      vSwUpdM_Appl_FeeRegionInfo: FeeBlockNumber=192, FeeBlockSize=32
      vSwUpdM_Appl_FeeResumeInfo: FeeBlockNumber=160, FeeBlockSize=16
      vSwUpdM_Appl_FeeSegmentAttributes: FeeBlockNumber=128, FeeBlockSize=1120
      vSwUpdM_Appl_FeeSegmentCount: FeeBlockNumber=352, FeeBlockSize=16
      vSwUpdM_Appl_FeeSegmentWriteAddress: FeeBlockNumber=96, FeeBlockSize=560
      vSwUpdM_Appl_FeeUpdateState: FeeBlockNumber=320, FeeBlockSize=1
    FeeIfxSpecificConfig:
      FeeThresholdValue = 200
      FeeMaxBlockCount = 30
      FeeRunTimeErrorDetect = true
      FeeBlocksScannedPerCycle = 0
      FeeUseEraseSuspend = false
      FeeStateVarStructure = Fee_StateVar
      FeeUnConfigBlock = FEE_UNCONFIG_BLOCK_KEEP
      FeeUnConfigBlkOverflowHandle = FEE_CONTINUE
      FeeGcRestart = FEE_GC_RESTART_WRITE
      FeeGetCycleCountApi = false
      FeeEccErrorInfoApi = false
      FeeEraseAllEnable = true
      FeeGetPrevDataApi = false
      FeeCancelAllApi = false
      FeeMaxBytesPerCycle = FEE_MAX_BYTES_512
      FeeNvmIllegalStateNotification = NULL_PTR
      FeeQsIllegalStateNotification = NULL_PTR
      FeeQsHardenErrorNotification = NULL_PTR
      FeeVirginFlashIllegalState = false
      FeeOngoingWriteCancelSupport = false
    CommonPublishedInformation:
      ArMajorVersion = 4
      ArMinorVersion = 4
      ArPatchVersion = 0
      SwMajorVersion = 20
      SwMinorVersion = 20
      SwPatchVersion = 0
      ModuleId = 21
      VendorId = 17
      Release = _TRICORE_TC397_ADAS
    FeePublishedInformation: FeeBlockOverhead=17, FeePageOverhead=1
    FeeGeneral:
      FeeDevErrorDetect = true
      FeeSafetyEnable = false
      FeeInitCheckApi = false
      FeeMainFunctionPeriod = 0.01
      FeePollingMode = false
      FeeSetModeSupported = true
      FeeVersionInfoApi = false
      FeeVirtualPageSize = 8
      FeeBlockTypeConfigured = FEE_DOUBLE_SECTOR_DATA_ONLY
    6 x FeeBlockConfiguration, all with FeeQsBlockInstances=0, FeeQsBlockAddress=0, FeeQuasiStaticManager=false, FeeImmediateData=false, FeeNumberOfWriteCycles=0, FeeDeviceIndex=FlsGeneral:
      FeeBlockConfiguration: FeeBlockNumber=368, FeeBlockSize=3
      FeeDemStatusDataBlock: FeeBlockNumber=304, FeeBlockSize=130
      FeeConfigBlock: FeeBlockSize=4, FeeBlockNumber=16
      FeeConfigBlock_cons0: FeeBlockNumber=17, FeeBlockSize=4
      FeeCryptoKeyStorage: FeeBlockSize=476, FeeBlockNumber=336
      FeeDemAdminDataBlock: FeeBlockNumber=32, FeeBlockSize=18
    FeeDemEventParameterRefs:
      FEE_E_WRITE_CYCLES_EXHAUSTED = AutoCreatedDemEvent_FeeDemEventParameterRefs_FEE_E_WRITE_CYCLES_EXHAUSTED
      FEE_E_WRITE = AutoCreatedDemEvent_FeeDemEventParameterRefs_FEE_E_WRITE
      FEE_E_UNCONFIG_BLK_EXCEEDED = AutoCreatedDemEvent_FeeDemEventParameterRefs_FEE_E_UNCONFIG_BLK_EXCEEDED
      FEE_E_READ = AutoCreatedDemEvent_FeeDemEventParameterRefs_FEE_E_READ
      FEE_E_INVALIDATE = AutoCreatedDemEvent_FeeDemEventParameterRefs_FEE_E_INVALIDATE
      FEE_E_GC_WRITE = AutoCreatedDemEvent_FeeDemEventParameterRefs_FEE_E_GC_WRITE
      FEE_E_GC_TRIG = AutoCreatedDemEvent_FeeDemEventParameterRefs_FEE_E_GC_TRIG
      FEE_E_GC_READ = AutoCreatedDemEvent_FeeDemEventParameterRefs_FEE_E_GC_READ
      FEE_E_GC_INIT = AutoCreatedDemEvent_FeeDemEventParameterRefs_FEE_E_GC_INIT
      FEE_E_GC_ERASE = AutoCreatedDemEvent_FeeDemEventParameterRefs_FEE_E_GC_ERASE
    4 x FeeBlockConfiguration, all with FeeQsBlockInstances=0, FeeQsBlockAddress=0, FeeQuasiStaticManager=false, FeeImmediateData=false, FeeDeviceIndex=FlsGeneral:
      FeeBlockConfiguration_NvM2_StartAppl: FeeBlockNumber=64, FeeBlockSize=3, FeeNumberOfWriteCycles=1000
      FeeBlockConfiguration_NVBlock_0x0250: FeeBlockNumber=400, FeeBlockSize=3, FeeNumberOfWriteCycles=0
      CddNpmGen2_MeasurementsType: FeeBlockNumber=384, FeeBlockSize=12, FeeNumberOfWriteCycles=10000
      RT_Fee_Block: FeeBlockNumber=416, FeeBlockSize=66, FeeNumberOfWriteCycles=10000
