[part 2 of 2: package /ActiveEcuC]
AUTOSAR XML (schema 4-3-0)
package /ActiveEcuC  (continued)
  module config Dcm: implementation-config-variant=VARIANT-PRE-COMPILE, module-description=Dcm_Impl  (continued)
    DcmConfigSet  (continued)
      DcmDsp: DcmDspMaxDidToRead=8, DcmDspReadDIDReportsNODIByte=false  (continued)
        DidInfo_DiagnServi_TABROW_VWAppliSoftwVersiNumbe_Read (DcmDspDidInfo)
          DcmDspDidAccess
            DcmDspDidRead
        DidInfo_Battery_isolation_measurement_actual_and_requested_state_Read_Data_By_Identifier (DcmDspDidInfo)
          DcmDspDidAccess
            DcmDspDidRead: DcmDspDidReadSessionRef=ST_Defau, DcmDspDidReadSessionRef=ST_Exten
        DID_DiagnServi_SOH_Read (DcmDspDid): DcmDspDidIdentifier=803, DcmDspDidUsed=true, DcmDspDidUsePort=USE_DATA_ELEMENT_SPECIFIC_INTERFACES, DcmDspDidInfoRef=DidInfo_DiagnServi_SOH_Read
          DcmDspDidSignal: DcmDspDidDataPos=0, DcmDspDidDataRef=Data_DiagnServi_SOH_Read
        Data_DiagnServi_TABROW_NeuMeasu_Read_63_1 (DcmDspData):
          DcmDspDataSize = 256
          DcmDspDataType = UINT8_N
          DcmDspDataUsePort = USE_DATA_ASYNCH_CLIENT_SERVER
          DcmDspDataInfoRef = DataInfo_DiagnServi_TABROW_NeuMeasu_Read_63_1
        DataInfo_TABROW_TABROSyste_Read_1_1_1_1_1_1_1_1_1_1 (DcmDspDataInfo): DcmDspDataFixedLength=true
        Data_TABROW_StateOfBatteMIL_ReadDataByIdent (DcmDspData):
          DcmDspDataSize = 8
          DcmDspDataType = UINT8_N
          DcmDspDataUsePort = USE_DATA_ASYNCH_CLIENT_SERVER
          DcmDspDataInfoRef = DataInfo_TABROW_StateOfBatteMIL_ReadDataByIdent
        Routine_DiagnServi_TABROW_RequeConfiOfProteOfVehicDiagn_Start_Routine (DcmDspRoutine):
          DcmDspRequestResultsRoutineSupported = false
          DcmDspStopRoutineSupported = false
          DcmDspRoutineIdentifier = 1705
          DcmDspRoutineFixedLength = false
          DcmDspRoutineUsePort = true
          DcmDspRoutineUsed = true
          DcmDspRoutineInfoRef = RoutineInfo_DiagnServi_TABROW_RequeConfiOfProteOfVehicDiagn_Start_Routine
        RoutineInfo_DiagnServi_TABROW_AdaptOfCellBalan_Start_Routine (DcmDspRoutineInfo)
          DcmDspRoutineRequestResOut
            ResData (DcmDspRoutineRequestResOutSignal): DcmDspRoutineSignalLength=16, DcmDspRoutineSignalType=UINT8_N, DcmDspRoutineSignalEndianness=opaque, DcmDspRoutineSignalPos=0
          DcmDspStartRoutineIn
            ReqData (DcmDspStartRoutineInSignal): DcmDspRoutineSignalLength=120, DcmDspRoutineSignalType=UINT8_N, DcmDspRoutineSignalEndianness=opaque, DcmDspRoutineSignalPos=0
          DcmDspRoutineAuthorization: DcmDspRoutineSessionRef=ST_Exten
          DcmDspRoutineStopOut
            ResData (DcmDspRoutineStopOutSignal): DcmDspRoutineSignalLength=8, DcmDspRoutineSignalType=UINT8_N, DcmDspRoutineSignalEndianness=opaque, DcmDspRoutineSignalPos=0
          DcmDspStartRoutineOut
            ResData (DcmDspStartRoutineOutSignal): DcmDspRoutineSignalLength=8, DcmDspRoutineSignalType=UINT8_N, DcmDspRoutineSignalEndianness=opaque, DcmDspRoutineSignalPos=0
        DataInfo_DiagnServi_BMCE_part_number_Read (DcmDspDataInfo): DcmDspDataFixedLength=true
        Data_HV_battery_performance_indicator_charging_Read_Data_By_Identifier (DcmDspData):
          DcmDspDataSize = 16
          DcmDspDataType = UINT8_N
          DcmDspDataUsePort = USE_DATA_ASYNCH_CLIENT_SERVER
          DcmDspDataInfoRef = DataInfo_HV_battery_performance_indicator_charging_Read_Data_By_Identifier
        DataInfo_DiagnServi_TABROW_NeuMeasu_Read_46_1 (DcmDspDataInfo): DcmDspDataFixedLength=true
        4 x DcmDspDid, all with DcmDspDidUsed=true, DcmDspDidUsePort=USE_DATA_ELEMENT_SPECIFIC_INTERFACES:
          DID_DiagnServi_TABROW_DID0xEFD_Read_1_1_1: DcmDspDidIdentifier=1414, DcmDspDidInfoRef=DidInfo_DiagnServi_TABROW_DID0xEFD_Read_1_1_1
            DcmDspDidSignal: DcmDspDidDataPos=0, DcmDspDidDataRef=Data_DiagnServi_TABROW_DID0xEFD_Read_1_1_1
          DID_DiagnServi_TABROW_NeuMeasu_Read_8_1: DcmDspDidIdentifier=1667, DcmDspDidInfoRef=DidInfo_DiagnServi_TABROW_NeuMeasu_Read_8_1
            DcmDspDidSignal: DcmDspDidDataPos=0, DcmDspDidDataRef=Data_DiagnServi_TABROW_NeuMeasu_Read_8_1
          DID_DiagnServi_TABROW_NeuMeasu_Read_8_2: DcmDspDidIdentifier=1729, DcmDspDidInfoRef=DidInfo_DiagnServi_TABROW_NeuMeasu_Read_8_2
            DcmDspDidSignal: DcmDspDidDataPos=0, DcmDspDidDataRef=Data_DiagnServi_TABROW_NeuMeasu_Read_8_2
          DID_DiagnServi_TABROW_ProduDeact_Read: DcmDspDidIdentifier=1276, DcmDspDidInfoRef=DidInfo_DiagnServi_TABROW_ProduDeact_Read
            DcmDspDidSignal: DcmDspDidDataPos=0, DcmDspDidDataRef=Data_DiagnServi_TABROW_ProduDeact_Read
        Data_DiagnServi_TABROW_TechnSpeciVersi_Read (DcmDspData):
          DcmDspDataSize = 208
          DcmDspDataType = UINT8_N
          DcmDspDataUsePort = USE_DATA_ASYNCH_CLIENT_SERVER
          DcmDspDataInfoRef = DataInfo_DiagnServi_TABROW_TechnSpeciVersi_Read
        DataInfo_DiagnServi_TABROW_DID0x0EF_Read (DcmDspDataInfo): DcmDspDataFixedLength=true
        Data_HV_battery_continuous_discharge_power_Read_Data_By_Identifier (DcmDspData):
          DcmDspDataSize = 16
          DcmDspDataType = UINT8_N
          DcmDspDataUsePort = USE_DATA_ASYNCH_CLIENT_SERVER
          DcmDspDataInfoRef = DataInfo_HV_battery_continuous_discharge_power_Read_Data_By_Identifier
        DidInfo_DiagnServi_TABROW_NeuECUIdent_Read (DcmDspDidInfo)
          DcmDspDidAccess
            DcmDspDidRead: DcmDspDidReadSessionRef=ST_Defau, DcmDspDidReadSessionRef=ST_Exten
        DID_DiagnServi_TABROW_NeuMeasu_Read_57_11 (DcmDspDid):
          DcmDspDidIdentifier = 1612
          DcmDspDidUsed = true
          DcmDspDidUsePort = USE_DATA_ELEMENT_SPECIFIC_INTERFACES
          DcmDspDidInfoRef = DidInfo_DiagnServi_TABROW_NeuMeasu_Read_57_11
          DcmDspDidSignal: DcmDspDidDataPos=0, DcmDspDidDataRef=Data_DiagnServi_TABROW_NeuMeasu_Read_57_11
        DID_DiagnServi_TABROW_NeuMeasu_Read_57_13 (DcmDspDid):
          DcmDspDidIdentifier = 60930
          DcmDspDidUsed = true
          DcmDspDidUsePort = USE_DATA_ELEMENT_SPECIFIC_INTERFACES
          DcmDspDidInfoRef = DidInfo_DiagnServi_TABROW_NeuMeasu_Read_57_13
          DcmDspDidSignal: DcmDspDidDataPos=0, DcmDspDidDataRef=Data_DiagnServi_TABROW_NeuMeasu_Read_57_13
        Data_DiagnServi_TABROW_AccelPedalPositD_Read (DcmDspData):
          DcmDspDataSize = 8
          DcmDspDataType = UINT8_N
          DcmDspDataUsePort = USE_DATA_ASYNCH_CLIENT_SERVER
          DcmDspDataInfoRef = DataInfo_DiagnServi_TABROW_AccelPedalPositD_Read
        DidInfo_High_voltage_battery_total_voltage_Read_Data_By_Identifier (DcmDspDidInfo)
          DcmDspDidAccess
            DcmDspDidRead: DcmDspDidReadSessionRef=ST_Defau, DcmDspDidReadSessionRef=ST_Exten
        Data_DiagnServi_TABROW_NeuMeasu_Read_3 (DcmDspData):
          DcmDspDataSize = 8
          DcmDspDataType = UINT8_N
          DcmDspDataUsePort = USE_DATA_ASYNCH_CLIENT_SERVER
          DcmDspDataInfoRef = DataInfo_DiagnServi_TABROW_NeuMeasu_Read_3
        DID_DiagnServi_TABROW_NeuMeasu_Read_57_14 (DcmDspDid):
          DcmDspDidIdentifier = 1749
          DcmDspDidUsed = true
          DcmDspDidUsePort = USE_DATA_ELEMENT_SPECIFIC_INTERFACES
          DcmDspDidInfoRef = DidInfo_DiagnServi_TABROW_NeuMeasu_Read_57_14
          DcmDspDidSignal: DcmDspDidDataPos=0, DcmDspDidDataRef=Data_DiagnServi_TABROW_NeuMeasu_Read_57_14
        Data_DiagnServi_TABROW_NeuMeasu_Read_2 (DcmDspData):
          DcmDspDataSize = 8
          DcmDspDataType = UINT8_N
          DcmDspDataUsePort = USE_DATA_ASYNCH_CLIENT_SERVER
          DcmDspDataInfoRef = DataInfo_DiagnServi_TABROW_NeuMeasu_Read_2
        Routine_DiagnServi_TABROW_VkmsCheckVerifHash_Start_Routine (DcmDspRoutine):
          DcmDspRequestResultsRoutineSupported = true
          DcmDspStopRoutineSupported = false
          DcmDspRoutineIdentifier = 49163
          DcmDspRoutineFixedLength = false
          DcmDspRoutineUsePort = true
          DcmDspRoutineUsed = true
          DcmDspRoutineInfoRef = RoutineInfo_DiagnServi_TABROW_VkmsCheckVerifHash_Start_Routine
        8 x DcmDspData, all with DcmDspDataType=UINT8_N, DcmDspDataUsePort=USE_DATA_ASYNCH_CLIENT_SERVER:
          Data_DiagnServi_TABROW_NeuMeasu_Read_5: DcmDspDataSize=8, DcmDspDataInfoRef=DataInfo_DiagnServi_TABROW_NeuMeasu_Read_5
          Data_Battery_return_flow_temperature_Read_Data_By_Identifier: DcmDspDataSize=40, DcmDspDataInfoRef=DataInfo_Battery_return_flow_temperature_Read_Data_By_Identifier
          Data_DC_charging_station_actual_voltage_Read_Data_By_Identifier: DcmDspDataSize=16, DcmDspDataInfoRef=DataInfo_DC_charging_station_actual_voltage_Read_Data_By_Identifier
          Data_DiagnServi_TABROW_NeuMeasu_Read_4: DcmDspDataSize=8, DcmDspDataInfoRef=DataInfo_DiagnServi_TABROW_NeuMeasu_Read_4
          Data_DiagnServi_TABROW_NeuMeasu_Read_7: DcmDspDataSize=8, DcmDspDataInfoRef=DataInfo_DiagnServi_TABROW_NeuMeasu_Read_7
          Data_DiagnServi_TABROW_NeuMeasu_Read_6: DcmDspDataSize=16, DcmDspDataInfoRef=DataInfo_DiagnServi_TABROW_NeuMeasu_Read_6
          Data_DiagnServi_TABROW_NeuMeasu_Read_33_1_1_1_1_1_1_1_1_1_1_1_1_1_1_1_1_1_1_1_1_1_1_1_2_1: DcmDspDataSize=72, DcmDspDataInfoRef=DataInfo_DiagnServi_TABROW_NeuMeasu_Read_33_1_1_1_1_1_1_1_1_1_1_1_1_1_1_1_1_1_1_1_1_1_1_1_2_1
          Data_DiagnServi_TABROW_NeuMeasu_Read_9: DcmDspDataSize=8, DcmDspDataInfoRef=DataInfo_DiagnServi_TABROW_NeuMeasu_Read_9
        DID_DiagnServi_TABROW_AccelPedalPositD_Read (DcmDspDid):
          DcmDspDidIdentifier = 62537
          DcmDspDidUsed = true
          DcmDspDidUsePort = USE_DATA_ELEMENT_SPECIFIC_INTERFACES
          DcmDspDidInfoRef = DidInfo_DiagnServi_TABROW_AccelPedalPositD_Read
          DcmDspDidSignal: DcmDspDidDataPos=0, DcmDspDidDataRef=Data_DiagnServi_TABROW_AccelPedalPositD_Read
        DID_DiagnServi_TABROW_Finge_Read (DcmDspDid):
          DcmDspDidIdentifier = 61786
          DcmDspDidUsed = true
          DcmDspDidUsePort = USE_DATA_ELEMENT_SPECIFIC_INTERFACES
          DcmDspDidInfoRef = DidInfo_DiagnServi_TABROW_Finge_Read
          DcmDspDidSignal: DcmDspDidDataPos=0, DcmDspDidDataRef=Data_DiagnServi_TABROW_Finge_Read
        Data_DiagnServi_TABROW_NeuMeasu_Read_8 (DcmDspData):
          DcmDspDataSize = 24
          DcmDspDataType = UINT8_N
          DcmDspDataUsePort = USE_DATA_ASYNCH_CLIENT_SERVER
          DcmDspDataInfoRef = DataInfo_DiagnServi_TABROW_NeuMeasu_Read_8
        DidInfo_DiagnServi_TABROW_NeuMeasu2_Read (DcmDspDidInfo)
          DcmDspDidAccess
            DcmDspDidRead: DcmDspDidReadSessionRef=ST_Defau, DcmDspDidReadSessionRef=ST_Exten
        3 x DcmDspData, all with DcmDspDataType=UINT8_N, DcmDspDataUsePort=USE_DATA_ASYNCH_CLIENT_SERVER:
          Data_DiagnServi_TABROW_ActivDiagnSessi_Read: DcmDspDataSize=8, DcmDspDataInfoRef=DataInfo_DiagnServi_TABROW_ActivDiagnSessi_Read
          Data_DiagnServi_TABROW_NeuMeasu_Read_1: DcmDspDataSize=32, DcmDspDataInfoRef=DataInfo_DiagnServi_TABROW_NeuMeasu_Read_1
          Data_DiagnServi_TABROW_BootlTPBlock_Read: DcmDspDataSize=8, DcmDspDataInfoRef=DataInfo_DiagnServi_TABROW_BootlTPBlock_Read
        DID_TABROW_TABROSyste_Read_1_1 (DcmDspDid):
          DcmDspDidIdentifier = 57392
          DcmDspDidUsed = true
          DcmDspDidUsePort = USE_DATA_ELEMENT_SPECIFIC_INTERFACES
          DcmDspDidInfoRef = DidInfo_TABROW_TABROSyste_Read_1_1
          DcmDspDidSignal: DcmDspDidDataPos=0, DcmDspDidDataRef=Data_TABROW_TABROSyste_Read_1_1
        Data_DiagnServi_TABROW_NeuMeasu_Read_29_1_1_1_1_1_1 (DcmDspData):
          DcmDspDataSize = 32
          DcmDspDataType = UINT8_N
          DcmDspDataUsePort = USE_DATA_ASYNCH_CLIENT_SERVER
          DcmDspDataInfoRef = DataInfo_DiagnServi_TABROW_NeuMeasu_Read_29_1_1_1_1_1_1
        DID_TABROW_ECUStandMode2_Read (DcmDspDid):
          DcmDspDidIdentifier = 49425
          DcmDspDidUsed = true
          DcmDspDidUsePort = USE_DATA_ELEMENT_SPECIFIC_INTERFACES
          DcmDspDidInfoRef = DidInfo_TABROW_ECUStandMode2_Read
          DcmDspDidSignal: DcmDspDidDataPos=0, DcmDspDidDataRef=Data_TABROW_ECUStandMode2_Read
        DidInfo_DiagnServi_TABROW_NeuMeasu_Read_22_1 (DcmDspDidInfo)
          DcmDspDidAccess
            DcmDspDidRead: DcmDspDidReadSessionRef=ST_Defau, DcmDspDidReadSessionRef=ST_Exten
        Data_DiagnServi_TABROW_DID0x0EF_Read (DcmDspData):
          DcmDspDataSize = 192
          DcmDspDataType = UINT8_N
          DcmDspDataUsePort = USE_DATA_ASYNCH_CLIENT_SERVER
          DcmDspDataInfoRef = DataInfo_DiagnServi_TABROW_DID0x0EF_Read
        DidInfo_DiagnServi_TABROW_TimeSinceEnginStart_Read (DcmDspDidInfo)
          DcmDspDidAccess
            DcmDspDidRead
        DataInfo_TABROW_VkmsKeyList_Read_Data_By_Identifier (DcmDspDataInfo): DcmDspDataFixedLength=false
        Data_TABROW_KnockTimer_Read (DcmDspData):
          DcmDspDataSize = 16
          DcmDspDataType = UINT8_N
          DcmDspDataUsePort = USE_DATA_ASYNCH_FNC
          DcmDspDataConditionCheckReadFncUsed = true
          DcmDspDataConditionCheckReadFnc = CddNpmGen2_Check_Read_Ident_ECUKnockoutTimer
          DcmDspDataReadFnc = CddNpmGen2_Read_Ident_ECUKnockoutTimer
          DcmDspDataWriteFnc = CddNpmGen2_Write_Ident_ECUKnockoutTimer
          DcmDspDataInfoRef = DataInfo_TABROW_KnockTimer_Read
        Data_DiagnServi_TABROW_CalibIdent_Read (DcmDspData):
          DcmDspDataType = UINT8_N
          DcmDspDataSize = 65535
          DcmDspDataUsePort = USE_DATA_ASYNCH_CLIENT_SERVER
          DcmDspDataInfoRef = DataInfo_DiagnServi_TABROW_CalibIdent_Read
        DidInfo_DiagnServi_TABROW_NeuMeasu_Read_43_1_1_1_1_1_1_1_1 (DcmDspDidInfo)
          DcmDspDidAccess
            DcmDspDidRead: DcmDspDidReadSessionRef=ST_Defau, DcmDspDidReadSessionRef=ST_Exten
        Data_Zero_Potential_Status_Read_Data_By_Identifier (DcmDspData):
          DcmDspDataSize = 8
          DcmDspDataType = UINT8_N
          DcmDspDataUsePort = USE_DATA_ASYNCH_CLIENT_SERVER
          DcmDspDataInfoRef = DataInfo_Zero_Potential_Status_Read_Data_By_Identifier
        DID_DiagnServi_TABROW_NeuMeasu2_Read (DcmDspDid):
          DcmDspDidIdentifier = 1674
          DcmDspDidUsed = true
          DcmDspDidUsePort = USE_DATA_ELEMENT_SPECIFIC_INTERFACES
          DcmDspDidInfoRef = DidInfo_DiagnServi_TABROW_NeuMeasu2_Read
          DcmDspDidSignal: DcmDspDidDataPos=0, DcmDspDidDataRef=Data_DiagnServi_TABROW_NeuMeasu2_Read
        DidInfo_DiagnServi_ReadDataByIdentBasicSettiStatu (DcmDspDidInfo)
          DcmDspDidAccess
            DcmDspDidRead: DcmDspDidReadSessionRef=ST_Defau, DcmDspDidReadSessionRef=ST_Exten
        DID_DiagnServi_TABROW_NeuCalibData_Read (DcmDspDid):
          DcmDspDidIdentifier = 65277
          DcmDspDidUsed = true
          DcmDspDidUsePort = USE_DATA_ELEMENT_SPECIFIC_INTERFACES
          DcmDspDidInfoRef = DidInfo_DiagnServi_TABROW_NeuCalibData_Read
          DcmDspDidSignal: DcmDspDidDataPos=0, DcmDspDidDataRef=Data_DiagnServi_TABROW_NeuCalibData_Read
        Data_DiagnServi_TABROW_NeuMeasu_Read_43_1 (DcmDspData):
          DcmDspDataSize = 512
          DcmDspDataType = UINT8_N
          DcmDspDataUsePort = USE_DATA_ASYNCH_CLIENT_SERVER
          DcmDspDataInfoRef = DataInfo_DiagnServi_TABROW_NeuMeasu_Read_43_1
        DidInfo_TABROW_BatteTempeMaxim_ReadDataByIdent (DcmDspDidInfo)
          DcmDspDidAccess
            DcmDspDidRead: DcmDspDidReadSessionRef=ST_Defau, DcmDspDidReadSessionRef=ST_Exten
        RoutineInfo_DiagnServi_TABROW_CalcuIntegValidData_Start_Routine (DcmDspRoutineInfo)
          DcmDspStartRoutineIn  # ReqData
            Type_of_calculation (DcmDspStartRoutineInSignal): DcmDspRoutineSignalLength=8, DcmDspRoutineSignalPos=0, DcmDspRoutineSignalType=UINT8
            Type_of_hash_value (DcmDspStartRoutineInSignal): DcmDspRoutineSignalLength=8, DcmDspRoutineSignalPos=8, DcmDspRoutineSignalType=UINT8
          DcmDspRoutineAuthorization: DcmDspRoutineSessionRef=ST_Defau, DcmDspRoutineSessionRef=ST_Exten
          DcmDspStartRoutineOut
            ResData (DcmDspStartRoutineOutSignal): DcmDspRoutineSignalLength=272, DcmDspRoutineSignalType=VARIABLE_LENGTH, DcmDspRoutineSignalEndianness=opaque, DcmDspRoutineSignalPos=0
        3 x DcmDspDataInfo:
          DataInfo_DiagnServi_TABROW_NeuMeasu_Read_59_2: DcmDspDataFixedLength=true
          DataInfo_DiagnServi_TABROW_VWAppliDataSetIdent_Read: DcmDspDataFixedLength=false
          DataInfo_DiagnServi_TABROW_DID0xEFD_Read_2: DcmDspDataFixedLength=true
        DID_DiagnServi_TABROW_NeuMeasu_Read_46_1_1_1_1_1_1 (DcmDspDid):
          DcmDspDidIdentifier = 1463
          DcmDspDidUsed = true
          DcmDspDidUsePort = USE_DATA_ELEMENT_SPECIFIC_INTERFACES
          DcmDspDidInfoRef = DidInfo_DiagnServi_TABROW_NeuMeasu_Read_46_1_1_1_1_1_1
          DcmDspDidSignal: DcmDspDidDataPos=0, DcmDspDidDataRef=Data_DiagnServi_TABROW_NeuMeasu_Read_46_1_1_1_1_1_1
        DataInfo_DiagnServi_TABROW_DID0xEFD_Read_1 (DcmDspDataInfo): DcmDspDataFixedLength=true
        DID_DiagnServi_TABROW_TABROOBDDr_Read_Data_By_Identifier (DcmDspDid):
          DcmDspDidIdentifier = 609
          DcmDspDidUsed = true
          DcmDspDidUsePort = USE_DATA_ELEMENT_SPECIFIC_INTERFACES
          DcmDspDidInfoRef = DidInfo_DiagnServi_TABROW_TABROOBDDr_Read_Data_By_Identifier
          DcmDspDidSignal: DcmDspDidDataPos=0, DcmDspDidDataRef=Data_DiagnServi_TABROW_TABROOBDDr_Read_Data_By_Identifier
        DataInfo_DiagnServi_TABROW_DID0xEFD_Read_3 (DcmDspDataInfo): DcmDspDataFixedLength=true
        DataInfo_DiagnServi_TABROW_VWAppliSoftwVersiNumbe_Read (DcmDspDataInfo): DcmDspDataFixedLength=true
        DID_DiagnServi_TABROW_NeuMeasu_Read_36_3 (DcmDspDid):
          DcmDspDidIdentifier = 1744
          DcmDspDidUsed = true
          DcmDspDidUsePort = USE_DATA_ELEMENT_SPECIFIC_INTERFACES
          DcmDspDidInfoRef = DidInfo_DiagnServi_TABROW_NeuMeasu_Read_36_3
          DcmDspDidSignal: DcmDspDidDataPos=0, DcmDspDidDataRef=Data_DiagnServi_TABROW_NeuMeasu_Read_36_3
        DataInfo_DiagnServi_TABROW_ActivDiagnSessi_Read (DcmDspDataInfo): DcmDspDataFixedLength=true
        DID_DiagnServi_TABROW_NeuMeasu_Read_36_1 (DcmDspDid):
          DcmDspDidIdentifier = 1734
          DcmDspDidUsed = true
          DcmDspDidUsePort = USE_DATA_ELEMENT_SPECIFIC_INTERFACES
          DcmDspDidInfoRef = DidInfo_DiagnServi_TABROW_NeuMeasu_Read_36_1
          DcmDspDidSignal: DcmDspDidDataPos=0, DcmDspDidDataRef=Data_DiagnServi_TABROW_NeuMeasu_Read_36_1
        DID_DiagnServi_TABROW_NeuMeasu_Read_43_1_1_1_1_1_1_1_1_1_1 (DcmDspDid):
          DcmDspDidIdentifier = 1385
          DcmDspDidUsed = true
          DcmDspDidUsePort = USE_DATA_ELEMENT_SPECIFIC_INTERFACES
          DcmDspDidInfoRef = DidInfo_DiagnServi_TABROW_NeuMeasu_Read_43_1_1_1_1_1_1_1_1_1_1
          DcmDspDidSignal: DcmDspDidDataPos=0, DcmDspDidDataRef=Data_DiagnServi_TABROW_NeuMeasu_Read_43_1_1_1_1_1_1_1_1_1_1
        DidInfo_DiagnServi_Cell_part_number_Read (DcmDspDidInfo)
          DcmDspDidAccess
            DcmDspDidWrite: DcmDspDidWriteSessionRef=ST_Exten
            DcmDspDidRead: DcmDspDidReadSessionRef=ST_Defau, DcmDspDidReadSessionRef=ST_Exten
        DataInfo_TABROW_InUseMonitPerfoRatio_Read_Data_By_Identifier (DcmDspDataInfo): DcmDspDataFixedLength=false
        Data_DiagnServi_TABROW_NeuMeasu_Read_43_1_1 (DcmDspData):
          DcmDspDataSize = 512
          DcmDspDataType = UINT8_N
          DcmDspDataUsePort = USE_DATA_ASYNCH_CLIENT_SERVER
          DcmDspDataInfoRef = DataInfo_DiagnServi_TABROW_NeuMeasu_Read_43_1_1
        DID_DiagnServi_TABROW_NeuMeasu_Read_43_1_1_1_1_1_1 (DcmDspDid):
          DcmDspDidIdentifier = 1387
          DcmDspDidUsed = true
          DcmDspDidUsePort = USE_DATA_ELEMENT_SPECIFIC_INTERFACES
          DcmDspDidInfoRef = DidInfo_DiagnServi_TABROW_NeuMeasu_Read_43_1_1_1_1_1_1
          DcmDspDidSignal: DcmDspDidDataPos=0, DcmDspDidDataRef=Data_DiagnServi_TABROW_NeuMeasu_Read_43_1_1_1_1_1_1
        DataInfo_DiagnServi_ReadDataByIdentASAMODXFileVersi (DcmDspDataInfo): DcmDspDataFixedLength=true
        DID_TABROW_InUseMonitPerfoRatio_Read_Data_By_Identifier (DcmDspDid):
          DcmDspDidIdentifier = 394
          DcmDspDidUsed = true
          DcmDspDidUsePort = USE_DATA_ELEMENT_SPECIFIC_INTERFACES
          DcmDspDidInfoRef = DidInfo_TABROW_InUseMonitPerfoRatio_Read_Data_By_Identifier
          DcmDspDidSignal: DcmDspDidDataPos=0, DcmDspDidDataRef=Data_TABROW_InUseMonitPerfoRatio_Read_Data_By_Identifier
        DID_DiagnServi_TABROW_NeuMeasu_Read_27_1_1_1_1 (DcmDspDid):
          DcmDspDidIdentifier = 57366
          DcmDspDidUsed = true
          DcmDspDidUsePort = USE_DATA_ELEMENT_SPECIFIC_INTERFACES
          DcmDspDidInfoRef = DidInfo_DiagnServi_TABROW_NeuMeasu_Read_27_1_1_1_1
          DcmDspDidSignal: DcmDspDidDataPos=0, DcmDspDidDataRef=Data_DiagnServi_TABROW_NeuMeasu_Read_27_1_1_1_1
        Data_DiagnServi_TABROW_NeuMeasu_Read_9_1 (DcmDspData):
          DcmDspDataSize = 8
          DcmDspDataType = UINT8_N
          DcmDspDataUsePort = USE_DATA_ASYNCH_CLIENT_SERVER
          DcmDspDataInfoRef = DataInfo_DiagnServi_TABROW_NeuMeasu_Read_9_1
        DID_TABROW_BMCHVKEoHVLState_Read_Data_By_Identifier (DcmDspDid):
          DcmDspDidIdentifier = 10002
          DcmDspDidUsed = true
          DcmDspDidUsePort = USE_DATA_ELEMENT_SPECIFIC_INTERFACES
          DcmDspDidInfoRef = DidInfo_TABROW_BMCHVKEoHVLState_Read_Data_By_Identifier
          DcmDspDidSignal: DcmDspDidDataPos=0, DcmDspDidDataRef=Data_TABROW_BMCHVKEoHVLState_Read_Data_By_Identifier
        DID_DiagnServi_TABROW_NeuMeasu_Read_27_1_1_1_2 (DcmDspDid):
          DcmDspDidIdentifier = 57365
          DcmDspDidUsed = true
          DcmDspDidUsePort = USE_DATA_ELEMENT_SPECIFIC_INTERFACES
          DcmDspDidInfoRef = DidInfo_DiagnServi_TABROW_NeuMeasu_Read_27_1_1_1_2
          DcmDspDidSignal: DcmDspDidDataPos=0, DcmDspDidDataRef=Data_DiagnServi_TABROW_NeuMeasu_Read_27_1_1_1_2
        Data_DiagnServi_TABROW_NeuMeasu_Read_9_2 (DcmDspData):
          DcmDspDataSize = 8
          DcmDspDataType = UINT8_N
          DcmDspDataUsePort = USE_DATA_ASYNCH_CLIENT_SERVER
          DcmDspDataInfoRef = DataInfo_DiagnServi_TABROW_NeuMeasu_Read_9_2
        DID_DiagnServi_BMCE_part_number_Read (DcmDspDid):
          DcmDspDidIdentifier = 807
          DcmDspDidUsed = true
          DcmDspDidUsePort = USE_DATA_ELEMENT_SPECIFIC_INTERFACES
          DcmDspDidInfoRef = DidInfo_DiagnServi_BMCE_part_number_Read
          DcmDspDidSignal: DcmDspDidDataPos=0, DcmDspDidDataRef=Data_DiagnServi_BMCE_part_number_Read
        Data_TABROW_FingeAndProgrDateOfLogicSoftwBlock_Read (DcmDspData):
          DcmDspDataType = UINT8_N
          DcmDspDataSize = 65535
          DcmDspDataUsePort = USE_DATA_ASYNCH_CLIENT_SERVER
          DcmDspDataInfoRef = DataInfo_TABROW_FingeAndProgrDateOfLogicSoftwBlock_Read
        DidInfo_TABROW_VkmsTrainCount_Read_Data_By_Identifier (DcmDspDidInfo)
          DcmDspDidAccess
            DcmDspDidRead: DcmDspDidReadSessionRef=ST_Defau, DcmDspDidReadSessionRef=ST_Exten
        Data_DiagnServi_Assembly_production_data_Read (DcmDspData):
          DcmDspDataSize = 176
          DcmDspDataType = UINT8_N
          DcmDspDataUsePort = USE_DATA_ASYNCH_CLIENT_SERVER
          DcmDspDataInfoRef = DataInfo_DiagnServi_Assembly_production_data_Read
        3 x DcmDspDid, all with DcmDspDidUsed=true, DcmDspDidUsePort=USE_DATA_ELEMENT_SPECIFIC_INTERFACES:
          DID_DiagnServi_TABROW_NeuMeasu_Read_8: DcmDspDidIdentifier=1728, DcmDspDidInfoRef=DidInfo_DiagnServi_TABROW_NeuMeasu_Read_8
            DcmDspDidSignal: DcmDspDidDataPos=0, DcmDspDidDataRef=Data_DiagnServi_TABROW_NeuMeasu_Read_8
          DID_DiagnServi_TABROW_NeuMeasu_Read_9: DcmDspDidIdentifier=1714, DcmDspDidInfoRef=DidInfo_DiagnServi_TABROW_NeuMeasu_Read_9
            DcmDspDidSignal: DcmDspDidDataPos=0, DcmDspDidDataRef=Data_DiagnServi_TABROW_NeuMeasu_Read_9
          DID_TABROW_BMCHVKFehleInter_Read_Data_By_Identifier: DcmDspDidIdentifier=790, DcmDspDidInfoRef=DidInfo_TABROW_BMCHVKFehleInter_Read_Data_By_Identifier
            DcmDspDidSignal: DcmDspDidDataPos=0, DcmDspDidDataRef=Data_TABROW_BMCHVKFehleInter_Read_Data_By_Identifier
        DataInfo_DiagnServi_TABROW_Produ_Read (DcmDspDataInfo): DcmDspDataFixedLength=true
        Routine_DiagnServi_TABROW_AdaptOfBatteBankMode_Start_Routine (DcmDspRoutine):
          DcmDspRequestResultsRoutineSupported = true
          DcmDspStopRoutineSupported = true
          DcmDspRoutineIdentifier = 912
          DcmDspRoutineFixedLength = false
          DcmDspRoutineUsePort = true
          DcmDspRoutineUsed = true
          DcmDspRoutineInfoRef = RoutineInfo_DiagnServi_TABROW_AdaptOfBatteBankMode_Start_Routine
        DID_DiagnServi_TABROW_NeuMeasu_Read_2 (DcmDspDid):
          DcmDspDidIdentifier = 1301
          DcmDspDidUsed = true
          DcmDspDidUsePort = USE_DATA_ELEMENT_SPECIFIC_INTERFACES
          DcmDspDidInfoRef = DidInfo_DiagnServi_TABROW_NeuMeasu_Read_2
          DcmDspDidSignal: DcmDspDidDataPos=0, DcmDspDidDataRef=Data_DiagnServi_TABROW_NeuMeasu_Read_2
        DidInfo_DiagnServi_TABROW_NeuMeasu_Read_46_1 (DcmDspDidInfo)
          DcmDspDidAccess
            DcmDspDidRead: DcmDspDidReadSessionRef=ST_Defau, DcmDspDidReadSessionRef=ST_Exten
        DID_DiagnServi_TABROW_NeuMeasu_Read_3 (DcmDspDid):
          DcmDspDidIdentifier = 1302
          DcmDspDidUsed = true
          DcmDspDidUsePort = USE_DATA_ELEMENT_SPECIFIC_INTERFACES
          DcmDspDidInfoRef = DidInfo_DiagnServi_TABROW_NeuMeasu_Read_3
          DcmDspDidSignal: DcmDspDidDataPos=0, DcmDspDidDataRef=Data_DiagnServi_TABROW_NeuMeasu_Read_3
        Data_DiagnServi_TABROW_NeuMeasu_Read_57_11 (DcmDspData):
          DcmDspDataSize = 1920
          DcmDspDataType = UINT8_N
          DcmDspDataUsePort = USE_DATA_ASYNCH_CLIENT_SERVER
          DcmDspDataInfoRef = DataInfo_DiagnServi_TABROW_NeuMeasu_Read_57_11
        DidInfo_DiagnServi_TABROW_NeuMeasu_Read_33_1_1_1_1_1_1_1_1_1_1_1_1_1_1_1_1_1_1_1_1_1_1_1_2_1 (DcmDspDidInfo)
          DcmDspDidAccess
            DcmDspDidRead: DcmDspDidReadSessionRef=ST_Defau, DcmDspDidReadSessionRef=ST_Exten
        DID_TABROW_VkmsVkmsv_Read_Data_By_Identifier (DcmDspDid):
          DcmDspDidIdentifier = 11349
          DcmDspDidUsed = true
          DcmDspDidUsePort = USE_DATA_ELEMENT_SPECIFIC_INTERFACES
          DcmDspDidInfoRef = DidInfo_TABROW_VkmsVkmsv_Read_Data_By_Identifier
          DcmDspDidSignal: DcmDspDidDataPos=0, DcmDspDidDataRef=Data_TABROW_VkmsVkmsv_Read_Data_By_Identifier
        DID_DiagnServi_TABROW_NeuMeasu_Read_1 (DcmDspDid):
          DcmDspDidIdentifier = 8727
          DcmDspDidUsed = true
          DcmDspDidUsePort = USE_DATA_ELEMENT_SPECIFIC_INTERFACES
          DcmDspDidInfoRef = DidInfo_DiagnServi_TABROW_NeuMeasu_Read_1
          DcmDspDidSignal: DcmDspDidDataPos=0, DcmDspDidDataRef=Data_DiagnServi_TABROW_NeuMeasu_Read_1
        Data_DiagnServi_TABROW_NeuMeasu_Read_9_2_1_1 (DcmDspData):
          DcmDspDataSize = 16
          DcmDspDataType = UINT8_N
          DcmDspDataUsePort = USE_DATA_ASYNCH_CLIENT_SERVER
          DcmDspDataInfoRef = DataInfo_DiagnServi_TABROW_NeuMeasu_Read_9_2_1_1
        DidInfo_DiagnServi_TABROW_DID0xEFD_Read (DcmDspDidInfo)
          DcmDspDidAccess
            DcmDspDidRead: DcmDspDidReadSessionRef=ST_Defau, DcmDspDidReadSessionRef=ST_Exten
        DID_DiagnServi_TABROW_NeuMeasu_Read_6 (DcmDspDid):
          DcmDspDidIdentifier = 1430
          DcmDspDidUsed = true
          DcmDspDidUsePort = USE_DATA_ELEMENT_SPECIFIC_INTERFACES
          DcmDspDidInfoRef = DidInfo_DiagnServi_TABROW_NeuMeasu_Read_6
          DcmDspDidSignal: DcmDspDidDataPos=0, DcmDspDidDataRef=Data_DiagnServi_TABROW_NeuMeasu_Read_6
        DID_TABROW_StatuProdu_Read_Data_By_Identifier (DcmDspDid):
          DcmDspDidIdentifier = 412
          DcmDspDidUsed = true
          DcmDspDidUsePort = USE_DATA_ELEMENT_SPECIFIC_INTERFACES
          DcmDspDidInfoRef = DidInfo_TABROW_StatuProdu_Read_Data_By_Identifier
          DcmDspDidSignal: DcmDspDidDataPos=0, DcmDspDidDataRef=Data_TABROW_StatuProdu_Read_Data_By_Identifier
        Data_DiagnServi_TABROW_NeuMeasu_Read_57_14 (DcmDspData):
          DcmDspDataSize = 24
          DcmDspDataType = UINT8_N
          DcmDspDataUsePort = USE_DATA_ASYNCH_CLIENT_SERVER
          DcmDspDataInfoRef = DataInfo_DiagnServi_TABROW_NeuMeasu_Read_57_14
        DID_DiagnServi_TABROW_NeuMeasu_Read_7 (DcmDspDid):
          DcmDspDidIdentifier = 1731
          DcmDspDidUsed = true
          DcmDspDidUsePort = USE_DATA_ELEMENT_SPECIFIC_INTERFACES
          DcmDspDidInfoRef = DidInfo_DiagnServi_TABROW_NeuMeasu_Read_7
          DcmDspDidSignal: DcmDspDidDataPos=0, DcmDspDidDataRef=Data_DiagnServi_TABROW_NeuMeasu_Read_7
        DataInfo_TABROW_TABROSyste_Read_1_1_1_1_1_1_1 (DcmDspDataInfo): DcmDspDataFixedLength=true
        DID_DiagnServi_TABROW_NeuMeasu_Read_4 (DcmDspDid):
          DcmDspDidIdentifier = 1423
          DcmDspDidUsed = true
          DcmDspDidUsePort = USE_DATA_ELEMENT_SPECIFIC_INTERFACES
          DcmDspDidInfoRef = DidInfo_DiagnServi_TABROW_NeuMeasu_Read_4
          DcmDspDidSignal: DcmDspDidDataPos=0, DcmDspDidDataRef=Data_DiagnServi_TABROW_NeuMeasu_Read_4
        DID_DiagnServi_TABROW_NeuMeasu_Read_5 (DcmDspDid):
          DcmDspDidIdentifier = 1300
          DcmDspDidUsed = true
          DcmDspDidUsePort = USE_DATA_ELEMENT_SPECIFIC_INTERFACES
          DcmDspDidInfoRef = DidInfo_DiagnServi_TABROW_NeuMeasu_Read_5
          DcmDspDidSignal: DcmDspDidDataPos=0, DcmDspDidDataRef=Data_DiagnServi_TABROW_NeuMeasu_Read_5
        Data_DiagnServi_TABROW_NeuMeasu_Read_57_13 (DcmDspData):
          DcmDspDataSize = 24
          DcmDspDataType = UINT8_N
          DcmDspDataUsePort = USE_DATA_ASYNCH_CLIENT_SERVER
          DcmDspDataInfoRef = DataInfo_DiagnServi_TABROW_NeuMeasu_Read_57_13
        7 x DcmDspDataInfo:
          DataInfo_DiagnServi_TABROW_NeuMeasu_Read_57_11: DcmDspDataFixedLength=false
          DataInfo_DiagnServi_TABROW_NeuMeasu_Read_43_1_1_1_1_1_1_1_1_1_1: DcmDspDataFixedLength=true
          DataInfo_DiagnServi_TABROW_NeuMeasu_Read_46_1_1_1_1_1_1_2_3: DcmDspDataFixedLength=true
          DataInfo_DiagnServi_TABROW_NeuMeasu_Read_57_14: DcmDspDataFixedLength=true
          DataInfo_DiagnServi_TABROW_NeuMeasu_Read_46_1_1_1_1_1_1_2_2: DcmDspDataFixedLength=true
          DataInfo_DiagnServi_TABROW_NeuMeasu_Read_57_13: DcmDspDataFixedLength=true
          DataInfo_DiagnServi_TABROW_NeuMeasu_Read_46_1_1_1_1_1_1_2_1: DcmDspDataFixedLength=true
        DID_TABROW_SysteIdent_Read (DcmDspDid):
          DcmDspDidIdentifier = 61878
          DcmDspDidUsed = true
          DcmDspDidUsePort = USE_DATA_ELEMENT_SPECIFIC_INTERFACES
          DcmDspDidInfoRef = DidInfo_TABROW_SysteIdent_Read
          DcmDspDidSignal: DcmDspDidDataPos=0, DcmDspDidDataRef=Data_TABROW_SysteIdent_Read
        RoutineInfo_DiagnServi_TABROW_IsolaMeasuDeactMode_Start_Routine (DcmDspRoutineInfo)
          DcmDspRoutineRequestResOut
            ResData (DcmDspRoutineRequestResOutSignal): DcmDspRoutineSignalLength=8, DcmDspRoutineSignalType=UINT8_N, DcmDspRoutineSignalEndianness=opaque, DcmDspRoutineSignalPos=0
          DcmDspStartRoutineIn
            ReqData (DcmDspStartRoutineInSignal): DcmDspRoutineSignalLength=8, DcmDspRoutineSignalType=UINT8_N, DcmDspRoutineSignalEndianness=opaque, DcmDspRoutineSignalPos=0
          DcmDspRoutineAuthorization: DcmDspRoutineSessionRef=ST_Exten
          DcmDspRoutineStopOut
            ResData (DcmDspRoutineStopOutSignal): DcmDspRoutineSignalLength=8, DcmDspRoutineSignalType=UINT8_N, DcmDspRoutineSignalEndianness=opaque, DcmDspRoutineSignalPos=0
          DcmDspStartRoutineOut
            ResData (DcmDspStartRoutineOutSignal): DcmDspRoutineSignalLength=8, DcmDspRoutineSignalType=UINT8_N, DcmDspRoutineSignalEndianness=opaque, DcmDspRoutineSignalPos=0
        DidInfo_TABROW_TABROSyste_Read_1_1_1_1_1_1_1 (DcmDspDidInfo)
          DcmDspDidAccess
            DcmDspDidRead
        DID_DiagnServi_TABROW_MonitStatuSinceDTCsClear_Read (DcmDspDid):
          DcmDspDidIdentifier = 62465
          DcmDspDidUsed = true
          DcmDspDidUsePort = USE_DATA_ELEMENT_SPECIFIC_INTERFACES
          DcmDspDidInfoRef = DidInfo_DiagnServi_TABROW_MonitStatuSinceDTCsClear_Read
          DcmDspDidSignal: DcmDspDidDataPos=0, DcmDspDidDataRef=Data_DiagnServi_TABROW_MonitStatuSinceDTCsClear_Read
        3 x DcmDspDidInfo:
          DidInfo_DiagnServi_TABROW_NeuMeasu_Read_57_1
            DcmDspDidAccess
              DcmDspDidRead: DcmDspDidReadSessionRef=ST_Defau, DcmDspDidReadSessionRef=ST_Exten
          DidInfo_HV_coordinator_requestet_voltage_hv_battery_Read_Data_By_Identifier
            DcmDspDidAccess
              DcmDspDidRead: DcmDspDidReadSessionRef=ST_Defau, DcmDspDidReadSessionRef=ST_Exten
          DidInfo_DiagnServi_TABROW_DID0xEFD_Read_3
            DcmDspDidAccess
              DcmDspDidRead: DcmDspDidReadSessionRef=ST_Defau, DcmDspDidReadSessionRef=ST_Exten
        DID_TABROW_TABROSyste_Read_1_1_1_1_1_1_1_1_1_1_1_1_1_1_1 (DcmDspDid):
          DcmDspDidIdentifier = 57405
          DcmDspDidUsed = true
          DcmDspDidUsePort = USE_DATA_ELEMENT_SPECIFIC_INTERFACES
          DcmDspDidInfoRef = DidInfo_TABROW_TABROSyste_Read_1_1_1_1_1_1_1_1_1_1_1_1_1_1_1
          DcmDspDidSignal: DcmDspDidDataPos=0, DcmDspDidDataRef=Data_TABROW_TABROSyste_Read_1_1_1_1_1_1_1_1_1_1_1_1_1_1_1
        DID_DiagnServi_TABROW_NeuMeasu_Read_29_1_1_1_1_1_1 (DcmDspDid):
          DcmDspDidIdentifier = 57377
          DcmDspDidUsed = true
          DcmDspDidUsePort = USE_DATA_ELEMENT_SPECIFIC_INTERFACES
          DcmDspDidInfoRef = DidInfo_DiagnServi_TABROW_NeuMeasu_Read_29_1_1_1_1_1_1
          DcmDspDidSignal: DcmDspDidDataPos=0, DcmDspDidDataRef=Data_DiagnServi_TABROW_NeuMeasu_Read_29_1_1_1_1_1_1
        DidInfo_TABROW_TABROSyste_Read_1_1_1_1_1_1_1_1_1_1_1_1_1_1_1 (DcmDspDidInfo)
          DcmDspDidAccess
            DcmDspDidRead
        DidInfo_DiagnServi_TABROW_DID0xEFD_Read_2 (DcmDspDidInfo)
          DcmDspDidAccess
            DcmDspDidRead: DcmDspDidReadSessionRef=ST_Defau, DcmDspDidReadSessionRef=ST_Exten
        DataInfo_TABROW_ServiDiscoState_Read_Data_By_Identifier (DcmDspDataInfo): DcmDspDataFixedLength=true
        DidInfo_DiagnServi_TABROW_DID0xEFD_Read_1 (DcmDspDidInfo)
          DcmDspDidAccess
            DcmDspDidRead: DcmDspDidReadSessionRef=ST_Defau, DcmDspDidReadSessionRef=ST_Exten
        Data_HV_battery_maximum_discharge_current_Read_Data_By_Identifier (DcmDspData):
          DcmDspDataSize = 16
          DcmDspDataType = UINT8_N
          DcmDspDataUsePort = USE_DATA_ASYNCH_CLIENT_SERVER
          DcmDspDataInfoRef = DataInfo_HV_battery_maximum_discharge_current_Read_Data_By_Identifier
        Data_DiagnServi_TABROW_NeuMeasu_Read_27_2_1_1 (DcmDspData):
          DcmDspDataSize = 216
          DcmDspDataType = UINT8_N
          DcmDspDataUsePort = USE_DATA_ASYNCH_CLIENT_SERVER
          DcmDspDataInfoRef = DataInfo_DiagnServi_TABROW_NeuMeasu_Read_27_2_1_1
        DidInfo_DiagnServi_Assembly_part_number_Read (DcmDspDidInfo)
          DcmDspDidAccess
            DcmDspDidWrite: DcmDspDidWriteSessionRef=ST_Exten
            DcmDspDidRead: DcmDspDidReadSessionRef=ST_Defau, DcmDspDidReadSessionRef=ST_Exten
        DataInfo_TABROW_BMCHVKFehleHVIL_Read_Data_By_Identifier (DcmDspDataInfo): DcmDspDataFixedLength=true
        DidInfo_TABROW_BMCHVKFehleHVIL_Read_Data_By_Identifier (DcmDspDidInfo)
          DcmDspDidAccess
            DcmDspDidRead: DcmDspDidReadSessionRef=ST_Defau, DcmDspDidReadSessionRef=ST_Exten
        Data_TABROW_StatuECUStandMode_Read (DcmDspData):
          DcmDspDataSize = 8
          DcmDspDataType = UINT8_N
          DcmDspDataUsePort = USE_DATA_ASYNCH_CLIENT_SERVER
          DcmDspDataInfoRef = DataInfo_TABROW_StatuECUStandMode_Read
        DataInfo_DiagnServi_TABROW_NeuMeasu_Read_43_1_1_1_1 (DcmDspDataInfo): DcmDspDataFixedLength=true
        DidInfo_TABROW_VWWorksSysteName_Read (DcmDspDidInfo)
          DcmDspDidAccess
            DcmDspDidRead: DcmDspDidReadSessionRef=ST_Defau, DcmDspDidReadSessionRef=ST_Exten
        DidInfo_DiagnServi_TABROW_TechnSpeciVersi_Read (DcmDspDidInfo)
          DcmDspDidAccess
            DcmDspDidRead: DcmDspDidReadSessionRef=ST_Defau, DcmDspDidReadSessionRef=ST_Exten
        Data_DiagnServi_TABROW_NeuMeasu_Read_46_1_1_1_1_1_1_1 (DcmDspData):
          DcmDspDataSize = 1216
          DcmDspDataType = UINT8_N
          DcmDspDataUsePort = USE_DATA_ASYNCH_CLIENT_SERVER
          DcmDspDataInfoRef = DataInfo_DiagnServi_TABROW_NeuMeasu_Read_46_1_1_1_1_1_1_1
        Data_DiagnServi_TABROW_NeuMeasu_Read_46_1_1_1_1_1_1_2 (DcmDspData):
          DcmDspDataSize = 1216
          DcmDspDataType = UINT8_N
          DcmDspDataUsePort = USE_DATA_ASYNCH_CLIENT_SERVER
          DcmDspDataInfoRef = DataInfo_DiagnServi_TABROW_NeuMeasu_Read_46_1_1_1_1_1_1_2
        DataInfo_TABROW_KnockTestMode_Read (DcmDspDataInfo): DcmDspDataFixedLength=true
        Data_DiagnServi_TABROW_TABRORespo_Read_Data_By_Identifier (DcmDspData):
          DcmDspDataSize = 8
          DcmDspDataType = UINT8_N
          DcmDspDataUsePort = USE_DATA_ASYNCH_CLIENT_SERVER
          DcmDspDataInfoRef = DataInfo_DiagnServi_TABROW_TABRORespo_Read_Data_By_Identifier
        DidInfo_TABROW_ECUStandMode2_Read (DcmDspDidInfo)
          DcmDspDidAccess
            DcmDspDidWrite: DcmDspDidWriteSessionRef=ST_Exten
            DcmDspDidRead: DcmDspDidReadSessionRef=ST_Defau, DcmDspDidReadSessionRef=ST_Exten
        DidInfo_BMC_IWU_Status_Read_Data_By_Identifier (DcmDspDidInfo)
          DcmDspDidAccess
            DcmDspDidRead: DcmDspDidReadSessionRef=ST_Defau, DcmDspDidReadSessionRef=ST_Exten
        DataInfo_TABROW_BatteTempeMinim_ReadDataByIdent (DcmDspDataInfo): DcmDspDataFixedLength=true
        DataInfo_TABROW_TABROSyste_Read_1_1_1_1 (DcmDspDataInfo): DcmDspDataFixedLength=true
        DID_DiagnServi_TABROW_DID0xEFD_Read (DcmDspDid):
          DcmDspDidIdentifier = 1420
          DcmDspDidUsed = true
          DcmDspDidUsePort = USE_DATA_ELEMENT_SPECIFIC_INTERFACES
          DcmDspDidInfoRef = DidInfo_DiagnServi_TABROW_DID0xEFD_Read
          DcmDspDidSignal: DcmDspDidDataPos=0, DcmDspDidDataRef=Data_DiagnServi_TABROW_DID0xEFD_Read
        Data_TABROW_VkmsVkmsv_Read_Data_By_Identifier (DcmDspData):
          DcmDspDataSize = 144
          DcmDspDataType = UINT8_N
          DcmDspDataUsePort = USE_DATA_ASYNCH_CLIENT_SERVER
          DcmDspDataInfoRef = DataInfo_TABROW_VkmsVkmsv_Read_Data_By_Identifier
        RoutineInfo_DiagnServi_TABROW_VkmsCheckVerifHash_Start_Routine (DcmDspRoutineInfo)
          DcmDspRoutineRequestResOut
            ResData (DcmDspRoutineRequestResOutSignal): DcmDspRoutineSignalLength=16, DcmDspRoutineSignalType=UINT8_N, DcmDspRoutineSignalEndianness=opaque, DcmDspRoutineSignalPos=0
          DcmDspStartRoutineIn
            ReqData (DcmDspStartRoutineInSignal): DcmDspRoutineSignalLength=136, DcmDspRoutineSignalType=UINT8_N, DcmDspRoutineSignalEndianness=opaque, DcmDspRoutineSignalPos=0
          DcmDspRoutineAuthorization: DcmDspRoutineSessionRef=ST_Exten
        DidInfo_TABROW_TABROSyste_Read_1_1_1 (DcmDspDidInfo)
          DcmDspDidAccess
            DcmDspDidRead
        DID_DiagnServi_ReadDataByIdentASAMODXFileVersi (DcmDspDid):
          DcmDspDidIdentifier = 61858
          DcmDspDidUsed = true
          DcmDspDidUsePort = USE_DATA_ELEMENT_SPECIFIC_INTERFACES
          DcmDspDidInfoRef = DidInfo_DiagnServi_ReadDataByIdentASAMODXFileVersi
          DcmDspDidSignal: DcmDspDidDataPos=0, DcmDspDidDataRef=Data_DiagnServi_ReadDataByIdentASAMODXFileVersi
        Data_DiagnServi_TABROW_NeuMeasu_Read_7_1 (DcmDspData):
          DcmDspDataSize = 8
          DcmDspDataType = UINT8_N
          DcmDspDataUsePort = USE_DATA_ASYNCH_CLIENT_SERVER
          DcmDspDataInfoRef = DataInfo_DiagnServi_TABROW_NeuMeasu_Read_7_1
        DataInfo_HV_battery_continuous_charging_power_Read_Data_By_Identifier (DcmDspDataInfo): DcmDspDataFixedLength=true
        DID_DiagnServi_TABROW_AdaptOfChineSeriaNumbe_Read (DcmDspDid):
          DcmDspDidIdentifier = 18510
          DcmDspDidUsed = true
          DcmDspDidUsePort = USE_DATA_ELEMENT_SPECIFIC_INTERFACES
          DcmDspDidInfoRef = DidInfo_DiagnServi_TABROW_AdaptOfChineSeriaNumbe_Read
          DcmDspDidSignal: DcmDspDidDataPos=0, DcmDspDidDataRef=Data_DiagnServi_TABROW_AdaptOfChineSeriaNumbe_Read
        DID_BMC_Status_DCLS_Read_Data_By_Identifier (DcmDspDid):
          DcmDspDidIdentifier = 808
          DcmDspDidUsed = true
          DcmDspDidUsePort = USE_DATA_ELEMENT_SPECIFIC_INTERFACES
          DcmDspDidInfoRef = DidInfo_BMC_Status_DCLS_Read_Data_By_Identifier
          DcmDspDidSignal: DcmDspDidDataPos=0, DcmDspDidDataRef=Data_BMC_Status_DCLS_Read_Data_By_Identifier
        Routine_DiagnServi_RoutiContrCheckProgrDepen (DcmDspRoutine):
          DcmDspRequestResultsRoutineSupported = false
          DcmDspStopRoutineSupported = false
          DcmDspRoutineIdentifier = 65281
          DcmDspRoutineFixedLength = false
          DcmDspRoutineUsePort = true
          DcmDspRoutineUsed = true
          DcmDspRoutineInfoRef = RoutineInfo_DiagnServi_RoutiContrCheckProgrDepen
        DID_TABROW_VkmsKeyList_Read_Data_By_Identifier (DcmDspDid):
          DcmDspDidIdentifier = 11360
          DcmDspDidUsed = true
          DcmDspDidUsePort = USE_DATA_ELEMENT_SPECIFIC_INTERFACES
          DcmDspDidInfoRef = DidInfo_TABROW_VkmsKeyList_Read_Data_By_Identifier
          DcmDspDidSignal: DcmDspDidDataPos=0, DcmDspDidDataRef=Data_TABROW_VkmsKeyList_Read_Data_By_Identifier
        DidInfo_DiagnServi_TABROW_SuppoPIDs4160_Read (DcmDspDidInfo)
          DcmDspDidAccess
            DcmDspDidRead: DcmDspDidReadSessionRef=ST_Defau, DcmDspDidReadSessionRef=ST_Exten
        DidInfo_DiagnServi_TABROW_VWSparePartNumbe_Read (DcmDspDidInfo)
          DcmDspDidAccess
            DcmDspDidRead
        DataInfo_TABROW_TABROSyste_Read_1_1_1 (DcmDspDataInfo): DcmDspDataFixedLength=true
        DID_DiagnServi_TABROW_Milea_Read (DcmDspDid):
          DcmDspDidIdentifier = 8707
          DcmDspDidUsed = true
          DcmDspDidUsePort = USE_DATA_ELEMENT_SPECIFIC_INTERFACES
          DcmDspDidInfoRef = DidInfo_DiagnServi_TABROW_Milea_Read
          DcmDspDidSignal: DcmDspDidDataPos=0, DcmDspDidDataRef=Data_DiagnServi_TABROW_Milea_Read
        DataInfo_DiagnServi_TABROW_NeuMeasu_Read_9_2_1_1_2 (DcmDspDataInfo): DcmDspDataFixedLength=true
        Data_DiagnServi_TABROW_NeuMeasu_Read_43_1_1_1_1_1_1 (DcmDspData):
          DcmDspDataSize = 512
          DcmDspDataType = UINT8_N
          DcmDspDataUsePort = USE_DATA_ASYNCH_CLIENT_SERVER
          DcmDspDataInfoRef = DataInfo_DiagnServi_TABROW_NeuMeasu_Read_43_1_1_1_1_1_1
        DataInfo_DiagnServi_TABROW_NeuMeasu_Read_9_2_1_1_1 (DcmDspDataInfo): DcmDspDataFixedLength=true
        Routine_DiagnServi_RoutiContrCheckProgrPreco (DcmDspRoutine):
          DcmDspRequestResultsRoutineSupported = false
          DcmDspStopRoutineSupported = false
          DcmDspRoutineIdentifier = 515
          DcmDspRoutineFixedLength = false
          DcmDspRoutineUsePort = true
          DcmDspRoutineUsed = true
          DcmDspRoutineInfoRef = RoutineInfo_DiagnServi_RoutiContrCheckProgrPreco
        DataInfo_High_voltage_battery_total_voltage_Read_Data_By_Identifier (DcmDspDataInfo): DcmDspDataFixedLength=true
        DID_DiagnServi_TABROW_VehicSpeedSenso_Read (DcmDspDid):
          DcmDspDidIdentifier = 62477
          DcmDspDidUsed = true
          DcmDspDidUsePort = USE_DATA_ELEMENT_SPECIFIC_INTERFACES
          DcmDspDidInfoRef = DidInfo_DiagnServi_TABROW_VehicSpeedSenso_Read
          DcmDspDidSignal: DcmDspDidDataPos=0, DcmDspDidDataRef=Data_DiagnServi_TABROW_VehicSpeedSenso_Read
        Data_DiagnServi_TABROW_NeuMeasu_Read_7_2 (DcmDspData):
          DcmDspDataSize = 8
          DcmDspDataType = UINT8_N
          DcmDspDataUsePort = USE_DATA_ASYNCH_CLIENT_SERVER
          DcmDspDataInfoRef = DataInfo_DiagnServi_TABROW_NeuMeasu_Read_7_2
        Routine_DiagnServi_TABROW_ResetOfAllAdapt_Start_Routine_COP (DcmDspRoutine):
          DcmDspRequestResultsRoutineSupported = true
          DcmDspStopRoutineSupported = true
          DcmDspRoutineIdentifier = 870
          DcmDspRoutineFixedLength = false
          DcmDspRoutineUsePort = true
          DcmDspRoutineUsed = true
          DcmDspRoutineInfoRef = RoutineInfo_DiagnServi_TABROW_ResetOfAllAdapt_Start_Routine_COP
        DID_DiagnServi_TABROW_NeuMeasu_Read_29_1_1_1_1_1_1_1 (DcmDspDid):
          DcmDspDidIdentifier = 57378
          DcmDspDidUsed = true
          DcmDspDidUsePort = USE_DATA_ELEMENT_SPECIFIC_INTERFACES
          DcmDspDidInfoRef = DidInfo_DiagnServi_TABROW_NeuMeasu_Read_29_1_1_1_1_1_1_1
          DcmDspDidSignal: DcmDspDidDataPos=0, DcmDspDidDataRef=Data_DiagnServi_TABROW_NeuMeasu_Read_29_1_1_1_1_1_1_1
        Data_TABROW_IsolaResisSysteMinus_ReadDataByIdent (DcmDspData):
          DcmDspDataSize = 16
          DcmDspDataType = UINT8_N
          DcmDspDataUsePort = USE_DATA_ASYNCH_CLIENT_SERVER
          DcmDspDataInfoRef = DataInfo_TABROW_IsolaResisSysteMinus_ReadDataByIdent
        DataInfo_DiagnServi_TABROW_TABROFDSPr_Read (DcmDspDataInfo): DcmDspDataFixedLength=false
        DidInfo_TABROW_SOKTimeInfor_Read_Data_By_Identifier (DcmDspDidInfo)
          DcmDspDidAccess
            DcmDspDidRead: DcmDspDidReadSessionRef=ST_Defau, DcmDspDidReadSessionRef=ST_Exten
        DataInfo_TABROW_SysteIdent_Read (DcmDspDataInfo): DcmDspDataFixedLength=true
        DID_DiagnServi_BCUe_part_number_Read (DcmDspDid):
          DcmDspDidIdentifier = 809
          DcmDspDidUsed = true
          DcmDspDidUsePort = USE_DATA_ELEMENT_SPECIFIC_INTERFACES
          DcmDspDidInfoRef = DidInfo_DiagnServi_BCUe_part_number_Read
          DcmDspDidSignal: DcmDspDidDataPos=0, DcmDspDidDataRef=Data_DiagnServi_BCUe_part_number_Read
        DID_DiagnServi_TABROW_IntegValidDataConfiList_Read (DcmDspDid):
          DcmDspDidIdentifier = 592
          DcmDspDidUsed = true
          DcmDspDidUsePort = USE_DATA_ELEMENT_SPECIFIC_INTERFACES
          DcmDspDidInfoRef = DidInfo_DiagnServi_TABROW_IntegValidDataConfiList_Read
          DcmDspDidSignal: DcmDspDidDataPos=0, DcmDspDidDataRef=Data_DiagnServi_TABROW_IntegValidDataConfiList_Read
        Data_TABROW_StateOfBatteShutoCrash_ReadDataByIdent (DcmDspData):
          DcmDspDataSize = 8
          DcmDspDataType = UINT8_N
          DcmDspDataUsePort = USE_DATA_ASYNCH_CLIENT_SERVER
          DcmDspDataInfoRef = DataInfo_TABROW_StateOfBatteShutoCrash_ReadDataByIdent
        DidInfo_Battery_banks_actual_voltage_Read_Data_By_Identifier (DcmDspDidInfo)
          DcmDspDidAccess
            DcmDspDidRead: DcmDspDidReadSessionRef=ST_Defau, DcmDspDidReadSessionRef=ST_Exten
        DataInfo_DiagnServi_Module_part_number_Read (DcmDspDataInfo): DcmDspDataFixedLength=true
        Data_TABROW_CellVoltaMinim_ReadDataByIdent (DcmDspData):
          DcmDspDataSize = 56
          DcmDspDataType = UINT8_N
          DcmDspDataUsePort = USE_DATA_ASYNCH_CLIENT_SERVER
          DcmDspDataInfoRef = DataInfo_TABROW_CellVoltaMinim_ReadDataByIdent
        DidInfo_DiagnServi_TABROW_DID0xEFD_Read_1_1_1 (DcmDspDidInfo)
          DcmDspDidAccess
            DcmDspDidRead: DcmDspDidReadSessionRef=ST_Defau, DcmDspDidReadSessionRef=ST_Exten
        5 x DcmDspDataInfo, all with DcmDspDataFixedLength=true:
          DataInfo_TABROW_VWWorksSysteName_Read
          DataInfo_DiagnServi_TABROW_NeuMeasu_Read_57_2_1
          DataInfo_DiagnServi_TABROW_NeuMeasu1_Read
          DataInfo_DiagnServi_TABROW_NeuMeasu_Read_46_1_1_1_1
          DataInfo_Charisma_requestet_driving_program_hv_battery_Read_Data_By_Identifier
        DID_TABROW_SOKFreshInfor_Read_Data_By_Identifier (DcmDspDid):
          DcmDspDidIdentifier = 402
          DcmDspDidUsed = true
          DcmDspDidUsePort = USE_DATA_ELEMENT_SPECIFIC_INTERFACES
          DcmDspDidInfoRef = DidInfo_TABROW_SOKFreshInfor_Read_Data_By_Identifier
          DcmDspDidSignal: DcmDspDidDataPos=0, DcmDspDidDataRef=Data_TABROW_SOKFreshInfor_Read_Data_By_Identifier
        4 x DcmDspData, all with DcmDspDataType=UINT8_N, DcmDspDataUsePort=USE_DATA_ASYNCH_CLIENT_SERVER:
          Data_DiagnServi_TABROW_NeuMeasu_Read_21_1: DcmDspDataSize=8, DcmDspDataInfoRef=DataInfo_DiagnServi_TABROW_NeuMeasu_Read_21_1
          Data_TABROW_TABROSyste_Read_1_1_1_1_1_1_1_1_1_1_1_1_1: DcmDspDataSize=112, DcmDspDataInfoRef=DataInfo_TABROW_TABROSyste_Read_1_1_1_1_1_1_1_1_1_1_1_1_1
          Data_DiagnServi_TABROW_NeuMeasu_Read_21_2: DcmDspDataSize=880, DcmDspDataInfoRef=DataInfo_DiagnServi_TABROW_NeuMeasu_Read_21_2
          Data_DiagnServi_TABROW_NeuMeasu_Read_27_1_2: DcmDspDataSize=8, DcmDspDataInfoRef=DataInfo_DiagnServi_TABROW_NeuMeasu_Read_27_1_2
        DataInfo_Battery_amount_of_modules_Read_Data_By_Identifier (DcmDspDataInfo): DcmDspDataFixedLength=true
        DidInfo_DiagnServi_TABROW_NeuMeasu_Read_43_1_1_1 (DcmDspDidInfo)
          DcmDspDidAccess
            DcmDspDidRead: DcmDspDidReadSessionRef=ST_Defau, DcmDspDidReadSessionRef=ST_Exten
        DidInfo_TABROW_StateOfBattePowerReduc_ReadDataByIdent (DcmDspDidInfo)
          DcmDspDidAccess
            DcmDspDidRead: DcmDspDidReadSessionRef=ST_Defau, DcmDspDidReadSessionRef=ST_Exten
        DID_DiagnServi_TABROW_NeuMeasu_Read_58_1 (DcmDspDid):
          DcmDspDidIdentifier = 1751
          DcmDspDidUsed = true
          DcmDspDidUsePort = USE_DATA_ELEMENT_SPECIFIC_INTERFACES
          DcmDspDidInfoRef = DidInfo_DiagnServi_TABROW_NeuMeasu_Read_58_1
          DcmDspDidSignal: DcmDspDidDataPos=0, DcmDspDidDataRef=Data_DiagnServi_TABROW_NeuMeasu_Read_58_1
        Data_DiagnServi_TABROW_NeuMeasu_Read_27_1_1 (DcmDspData):
          DcmDspDataSize = 216
          DcmDspDataType = UINT8_N
          DcmDspDataUsePort = USE_DATA_ASYNCH_CLIENT_SERVER
          DcmDspDataInfoRef = DataInfo_DiagnServi_TABROW_NeuMeasu_Read_27_1_1
        Data_DiagnServi_TABROW_IntegValidDataConfiList_Read (DcmDspData):
          DcmDspDataSize = 4016
          DcmDspDataType = UINT8_N
          DcmDspDataUsePort = USE_DATA_ASYNCH_CLIENT_SERVER
          DcmDspDataInfoRef = DataInfo_DiagnServi_TABROW_IntegValidDataConfiList_Read
        DidInfo_DiagnServi_TABROW_VWFAZITIdentStrin_Read (DcmDspDidInfo)
          DcmDspDidAccess
            DcmDspDidRead
        Data_DiagnServi_TABROW_NeuMeasu_Read_46_1_1_1_1_1 (DcmDspData):
          DcmDspDataSize = 1216
          DcmDspDataType = UINT8_N
          DcmDspDataUsePort = USE_DATA_ASYNCH_CLIENT_SERVER
          DcmDspDataInfoRef = DataInfo_DiagnServi_TABROW_NeuMeasu_Read_46_1_1_1_1_1
        DID_DiagnServi_TABROW_NeuMeasu_Read_43_1_1_1_1_1_1_1_1_1 (DcmDspDid):
          DcmDspDidIdentifier = 1383
          DcmDspDidUsed = true
          DcmDspDidUsePort = USE_DATA_ELEMENT_SPECIFIC_INTERFACES
          DcmDspDidInfoRef = DidInfo_DiagnServi_TABROW_NeuMeasu_Read_43_1_1_1_1_1_1_1_1_1
          DcmDspDidSignal: DcmDspDidDataPos=0, DcmDspDidDataRef=Data_DiagnServi_TABROW_NeuMeasu_Read_43_1_1_1_1_1_1_1_1_1
        Data_DiagnServi_TABROW_VehicSpeedSenso_Read (DcmDspData):
          DcmDspDataSize = 8
          DcmDspDataType = UINT8_N
          DcmDspDataUsePort = USE_DATA_ASYNCH_CLIENT_SERVER
          DcmDspDataInfoRef = DataInfo_DiagnServi_TABROW_VehicSpeedSenso_Read
        DID_Battery_return_flow_temperature_Read_Data_By_Identifier (DcmDspDid):
          DcmDspDidIdentifier = 792
          DcmDspDidUsed = true
          DcmDspDidUsePort = USE_DATA_ELEMENT_SPECIFIC_INTERFACES
          DcmDspDidInfoRef = DidInfo_Battery_return_flow_temperature_Read_Data_By_Identifier
          DcmDspDidSignal: DcmDspDidDataPos=0, DcmDspDidDataRef=Data_Battery_return_flow_temperature_Read_Data_By_Identifier
        Data_DiagnServi_TABROW_NeuMeasu_Read_27_3_1_1 (DcmDspData):
          DcmDspDataSize = 216
          DcmDspDataType = UINT8_N
          DcmDspDataUsePort = USE_DATA_ASYNCH_CLIENT_SERVER
          DcmDspDataInfoRef = DataInfo_DiagnServi_TABROW_NeuMeasu_Read_27_3_1_1
        Routine_DiagnServi_TABROW_ResetToFactoSetti_Start_Routine_COP (DcmDspRoutine):
          DcmDspRequestResultsRoutineSupported = true
          DcmDspStopRoutineSupported = true
          DcmDspRoutineIdentifier = 999
          DcmDspRoutineFixedLength = false
          DcmDspRoutineUsePort = true
          DcmDspRoutineUsed = true
          DcmDspRoutineInfoRef = RoutineInfo_DiagnServi_TABROW_ResetToFactoSetti_Start_Routine_COP
        DataInfo_DiagnServi_Type_number_BCUe_Read (DcmDspDataInfo): DcmDspDataFixedLength=true
        Routine_DiagnServi_TABROW_AdaptOfCellBalan_Start_Routine (DcmDspRoutine):
          DcmDspRequestResultsRoutineSupported = true
          DcmDspStopRoutineSupported = true
          DcmDspRoutineIdentifier = 966
          DcmDspRoutineFixedLength = false
          DcmDspRoutineUsePort = true
          DcmDspRoutineUsed = true
          DcmDspRoutineInfoRef = RoutineInfo_DiagnServi_TABROW_AdaptOfCellBalan_Start_Routine
        3 x DcmDspDid, all with DcmDspDidUsed=true, DcmDspDidUsePort=USE_DATA_ELEMENT_SPECIFIC_INTERFACES:
          DID_DiagnServi_TABROW_NeuMeasu1_Read: DcmDspDidIdentifier=1675, DcmDspDidInfoRef=DidInfo_DiagnServi_TABROW_NeuMeasu1_Read
            DcmDspDidSignal: DcmDspDidDataPos=0, DcmDspDidDataRef=Data_DiagnServi_TABROW_NeuMeasu1_Read
          DID_DiagnServi_TABROW_NeuMeasu_Read_43_1: DcmDspDidIdentifier=1392, DcmDspDidInfoRef=DidInfo_DiagnServi_TABROW_NeuMeasu_Read_43_1
            DcmDspDidSignal: DcmDspDidDataPos=0, DcmDspDidDataRef=Data_DiagnServi_TABROW_NeuMeasu_Read_43_1
          DID_TABROW_VWECUHardwNumbe_Read: DcmDspDidIdentifier=61841, DcmDspDidInfoRef=DidInfo_TABROW_VWECUHardwNumbe_Read
            DcmDspDidSignal: DcmDspDidDataPos=0, DcmDspDidDataRef=Data_TABROW_VWECUHardwNumbe_Read
        DataInfo_DiagnServi_TABROW_NeuMeasu_Read_70_1 (DcmDspDataInfo): DcmDspDataFixedLength=true
        DataInfo_DiagnServi_TABROW_NeuMeasu_Read_43_1_1_1 (DcmDspDataInfo): DcmDspDataFixedLength=true
        Data_TABROW_TABROSyste_Read_1_1_1_1_1_1_1_1_1_1 (DcmDspData):
          DcmDspDataSize = 112
          DcmDspDataType = UINT8_N
          DcmDspDataUsePort = USE_DATA_ASYNCH_CLIENT_SERVER
          DcmDspDataInfoRef = DataInfo_TABROW_TABROSyste_Read_1_1_1_1_1_1_1_1_1_1
        DidInfo_TABROW_CellVoltaMaxim_ReadDataByIdent (DcmDspDidInfo)
          DcmDspDidAccess
            DcmDspDidRead: DcmDspDidReadSessionRef=ST_Defau, DcmDspDidReadSessionRef=ST_Exten
        DataInfo_DiagnServi_TABROW_NeuMeasu_Read_9_2_1 (DcmDspDataInfo): DcmDspDataFixedLength=true
        DidInfo_TABROW_IsolaResisSystePlus_ReadDataByIdent (DcmDspDidInfo)
          DcmDspDidAccess
            DcmDspDidRead: DcmDspDidReadSessionRef=ST_Defau, DcmDspDidReadSessionRef=ST_Exten
        Data_DiagnServi_TABROW_NeuMeasu_Read_36_3 (DcmDspData):
          DcmDspDataSize = 16
          DcmDspDataType = UINT8_N
          DcmDspDataUsePort = USE_DATA_ASYNCH_CLIENT_SERVER
          DcmDspDataInfoRef = DataInfo_DiagnServi_TABROW_NeuMeasu_Read_36_3
        DID_DiagnServi_TABROW_NeuMeasu_Read_9_2_1 (DcmDspDid):
          DcmDspDidIdentifier = 1725
          DcmDspDidUsed = true
          DcmDspDidUsePort = USE_DATA_ELEMENT_SPECIFIC_INTERFACES
          DcmDspDidInfoRef = DidInfo_DiagnServi_TABROW_NeuMeasu_Read_9_2_1
          DcmDspDidSignal: DcmDspDidDataPos=0, DcmDspDidDataRef=Data_DiagnServi_TABROW_NeuMeasu_Read_9_2_1
        DidInfo_DiagnServi_ReadDataByIdentVWLogicSoftwBlockVersi (DcmDspDidInfo)
          DcmDspDidAccess
            DcmDspDidRead
        RoutineInfo_DiagnServi_TABROW_AdaptOfBatteBankMode_Start_Routine (DcmDspRoutineInfo)
          DcmDspRoutineRequestResOut
            ResData (DcmDspRoutineRequestResOutSignal): DcmDspRoutineSignalLength=32, DcmDspRoutineSignalType=UINT8_N, DcmDspRoutineSignalEndianness=opaque, DcmDspRoutineSignalPos=0
          DcmDspStartRoutineIn
            ReqData (DcmDspStartRoutineInSignal): DcmDspRoutineSignalLength=8, DcmDspRoutineSignalType=UINT8_N, DcmDspRoutineSignalEndianness=opaque, DcmDspRoutineSignalPos=0
          DcmDspRoutineAuthorization: DcmDspRoutineSessionRef=ST_Exten
          DcmDspRoutineStopOut
            ResData (DcmDspRoutineStopOutSignal): DcmDspRoutineSignalLength=8, DcmDspRoutineSignalType=UINT8_N, DcmDspRoutineSignalEndianness=opaque, DcmDspRoutineSignalPos=0
          DcmDspStartRoutineOut
            ResData (DcmDspStartRoutineOutSignal): DcmDspRoutineSignalLength=8, DcmDspRoutineSignalType=UINT8_N, DcmDspRoutineSignalEndianness=opaque, DcmDspRoutineSignalPos=0
        DID_Battery_banks_actual_mode_Read_Data_By_Identifier (DcmDspDid):
          DcmDspDidIdentifier = 9988
          DcmDspDidUsed = true
          DcmDspDidUsePort = USE_DATA_ELEMENT_SPECIFIC_INTERFACES
          DcmDspDidInfoRef = DidInfo_Battery_banks_actual_mode_Read_Data_By_Identifier
          DcmDspDidSignal: DcmDspDidDataPos=0, DcmDspDidDataRef=Data_Battery_banks_actual_mode_Read_Data_By_Identifier
        RoutineInfo_DiagnServi_TABROW_VkmsGetIdentHash_Start_Routine (DcmDspRoutineInfo)
          DcmDspRoutineRequestResOut
            ResData (DcmDspRoutineRequestResOutSignal): DcmDspRoutineSignalLength=144, DcmDspRoutineSignalType=UINT8_N, DcmDspRoutineSignalEndianness=opaque, DcmDspRoutineSignalPos=0
          DcmDspStartRoutineIn
            ReqData (DcmDspStartRoutineInSignal): DcmDspRoutineSignalLength=136, DcmDspRoutineSignalType=UINT8_N, DcmDspRoutineSignalEndianness=opaque, DcmDspRoutineSignalPos=0
          DcmDspRoutineAuthorization: DcmDspRoutineSessionRef=ST_Exten
        DataInfo_DiagnServi_Assembly_part_number_Read (DcmDspDataInfo): DcmDspDataFixedLength=true
        DidInfo_TABROW_BatteTempeAvera_ReadDataByIdent (DcmDspDidInfo)
          DcmDspDidAccess
            DcmDspDidRead: DcmDspDidReadSessionRef=ST_Defau, DcmDspDidReadSessionRef=ST_Exten
        DataInfo_DiagnServi_TABROW_NeuMeasu_Read_1 (DcmDspDataInfo): DcmDspDataFixedLength=true
        DID_DiagnServi_ReadDataByIdentASAMODXFileIdent (DcmDspDid):
          DcmDspDidIdentifier = 61854
          DcmDspDidUsed = true
          DcmDspDidUsePort = USE_DATA_ELEMENT_SPECIFIC_INTERFACES
          DcmDspDidInfoRef = DidInfo_DiagnServi_ReadDataByIdentASAMODXFileIdent
          DcmDspDidSignal: DcmDspDidDataPos=0, DcmDspDidDataRef=Data_DiagnServi_ReadDataByIdentASAMODXFileIdent
        7 x DcmDspDataInfo, all with DcmDspDataFixedLength=true:
          DataInfo_DiagnServi_TABROW_NeuMeasu_Read_28_3
          DataInfo_DiagnServi_TABROW_NeuMeasu_Read_4
          DataInfo_DiagnServi_TABROW_NeuMeasu_Read_28_4
          DataInfo_DiagnServi_TABROW_NeuMeasu_Read_5
          DataInfo_DiagnServi_TABROW_NeuMeasu_Read_28_5
          DataInfo_TABROW_StatuECUStandMode_Read
          DataInfo_DiagnServi_TABROW_NeuMeasu_Read_2
        Data_TABROW_TABROSyste_Read_1_1_1_1_1_1 (DcmDspData):
          DcmDspDataSize = 72
          DcmDspDataType = UINT8_N
          DcmDspDataUsePort = USE_DATA_ASYNCH_CLIENT_SERVER
          DcmDspDataInfoRef = DataInfo_TABROW_TABROSyste_Read_1_1_1_1_1_1
        DataInfo_DiagnServi_TABROW_NeuMeasu_Read_28_6 (DcmDspDataInfo): DcmDspDataFixedLength=true
        DataInfo_DiagnServi_TABROW_NeuMeasu_Read_3 (DcmDspDataInfo): DcmDspDataFixedLength=true
        Data_DiagnServi_Type_number_BCUe_Read (DcmDspData):
          DcmDspDataSize = 88
          DcmDspDataType = UINT8_N
          DcmDspDataUsePort = USE_DATA_ASYNCH_CLIENT_SERVER
          DcmDspDataInfoRef = DataInfo_DiagnServi_Type_number_BCUe_Read
        DataInfo_DiagnServi_TABROW_NeuMeasu_Read_8 (DcmDspDataInfo): DcmDspDataFixedLength=true
        DataInfo_DiagnServi_TABROW_NeuMeasu_Read_9 (DcmDspDataInfo): DcmDspDataFixedLength=true
        DidInfo_TABROW_VWLogicSoftwBlockLockValue_Read (DcmDspDidInfo)
          DcmDspDidAccess
            DcmDspDidRead
        DataInfo_DiagnServi_TABROW_NeuMeasu_Read_28_1 (DcmDspDataInfo): DcmDspDataFixedLength=true
        Data_DiagnServi_TABROW_NeuMeasu_Read_36_1 (DcmDspData):
          DcmDspDataSize = 16
          DcmDspDataType = UINT8_N
          DcmDspDataUsePort = USE_DATA_ASYNCH_CLIENT_SERVER
          DcmDspDataInfoRef = DataInfo_DiagnServi_TABROW_NeuMeasu_Read_36_1
        3 x DcmDspDataInfo, all with DcmDspDataFixedLength=true:
          DataInfo_DiagnServi_TABROW_NeuMeasu_Read_6
          DataInfo_DiagnServi_TABROW_NeuMeasu_Read_28_2
          DataInfo_DiagnServi_TABROW_NeuMeasu_Read_7
        Data_BMC_Mode_Read_Data_By_Identifier (DcmDspData):
          DcmDspDataSize = 8
          DcmDspDataType = UINT8_N
          DcmDspDataUsePort = USE_DATA_ASYNCH_CLIENT_SERVER
          DcmDspDataInfoRef = DataInfo_BMC_Mode_Read_Data_By_Identifier
        DID_DiagnServi_TABROW_NeuMeasu_Read_21_1 (DcmDspDid):
          DcmDspDidIdentifier = 1666
          DcmDspDidUsed = true
          DcmDspDidUsePort = USE_DATA_ELEMENT_SPECIFIC_INTERFACES
          DcmDspDidInfoRef = DidInfo_DiagnServi_TABROW_NeuMeasu_Read_21_1
          DcmDspDidSignal: DcmDspDidDataPos=0, DcmDspDidDataRef=Data_DiagnServi_TABROW_NeuMeasu_Read_21_1
        DidInfo_DiagnServi_TABROW_AUTOSStandAppliSoftwIdent_Read (DcmDspDidInfo)
          DcmDspDidAccess
            DcmDspDidRead: DcmDspDidReadSessionRef=ST_Defau, DcmDspDidReadSessionRef=ST_Exten
        DID_DiagnServi_TABROW_NeuMeasu_Read_21_2 (DcmDspDid):
          DcmDspDidIdentifier = 1711
          DcmDspDidUsed = true
          DcmDspDidUsePort = USE_DATA_ELEMENT_SPECIFIC_INTERFACES
          DcmDspDidInfoRef = DidInfo_DiagnServi_TABROW_NeuMeasu_Read_21_2
          DcmDspDidSignal: DcmDspDidDataPos=0, DcmDspDidDataRef=Data_DiagnServi_TABROW_NeuMeasu_Read_21_2
        DID_DiagnServi_TABROW_NeuMeasu_Read_33_1_1_1_1_1_1_1_1_1_1_1_1_1_1_1_1_1_1_1_1_1_1_1_2_1_1_1 (DcmDspDid):
          DcmDspDidIdentifier = 1354
          DcmDspDidUsed = true
          DcmDspDidUsePort = USE_DATA_ELEMENT_SPECIFIC_INTERFACES
          DcmDspDidInfoRef = DidInfo_DiagnServi_TABROW_NeuMeasu_Read_33_1_1_1_1_1_1_1_1_1_1_1_1_1_1_1_1_1_1_1_1_1_1_1_2_1_1_1
          DcmDspDidSignal: DcmDspDidDataPos=0, DcmDspDidDataRef=Data_DiagnServi_TABROW_NeuMeasu_Read_33_1_1_1_1_1_1_1_1_1_1_1_1_1_1_1_1_1_1_1_1_1_1_1_2_1_1_1
        Data_DiagnServi_TABROW_NeuMeasu_Read_43_1_1_1_1_1_1_1_1 (DcmDspData):
          DcmDspDataSize = 512
          DcmDspDataType = UINT8_N
          DcmDspDataUsePort = USE_DATA_ASYNCH_CLIENT_SERVER
          DcmDspDataInfoRef = DataInfo_DiagnServi_TABROW_NeuMeasu_Read_43_1_1_1_1_1_1_1_1
        DataInfo_DiagnServi_TABROW_NeuMeasu_Read_27_3_1 (DcmDspDataInfo): DcmDspDataFixedLength=true
        3 x DcmDspDidInfo:
          DidInfo_TABROW_ProgrPreco_Read
            DcmDspDidAccess
              DcmDspDidRead
          DidInfo_DiagnServi_TABROW_NeuMeasu_Read_9_2_1_1_1
            DcmDspDidAccess
              DcmDspDidRead: DcmDspDidReadSessionRef=ST_Defau, DcmDspDidReadSessionRef=ST_Exten
          DidInfo_DiagnServi_TABROW_NeuMeasu_Read_9_2_1_1_2
            DcmDspDidAccess
              DcmDspDidRead: DcmDspDidReadSessionRef=ST_Defau, DcmDspDidReadSessionRef=ST_Exten
        Routine_DiagnServi_TABROW_VkmsGetState_Start_Routine (DcmDspRoutine):
          DcmDspRequestResultsRoutineSupported = true
          DcmDspStopRoutineSupported = false
          DcmDspRoutineIdentifier = 49167
          DcmDspRoutineFixedLength = false
          DcmDspRoutineUsePort = true
          DcmDspRoutineUsed = true
          DcmDspRoutineInfoRef = RoutineInfo_DiagnServi_TABROW_VkmsGetState_Start_Routine
        DidInfo_DiagnServi_TABROW_TABROFDSPr_Read (DcmDspDidInfo)
          DcmDspDidAccess
            DcmDspDidRead
        DidInfo_TABROW_KnockCount_Read (DcmDspDidInfo)
          DcmDspDidAccess
            DcmDspDidWrite: DcmDspDidWriteSessionRef=ST_Exten
            DcmDspDidRead: DcmDspDidReadSessionRef=ST_Defau, DcmDspDidReadSessionRef=ST_Exten
        Data_DiagnServi_TABROW_NeuMeasu_Read_27_3_1 (DcmDspData):
          DcmDspDataSize = 216
          DcmDspDataType = UINT8_N
          DcmDspDataUsePort = USE_DATA_ASYNCH_CLIENT_SERVER
          DcmDspDataInfoRef = DataInfo_DiagnServi_TABROW_NeuMeasu_Read_27_3_1
        Data_BMC_Vorlade_Zielspannung_Read_Data_By_Identifier (DcmDspData):
          DcmDspDataSize = 16
          DcmDspDataType = UINT8_N
          DcmDspDataUsePort = USE_DATA_ASYNCH_CLIENT_SERVER
          DcmDspDataInfoRef = DataInfo_BMC_Vorlade_Zielspannung_Read_Data_By_Identifier
        DataInfo_TABROW_IsolaResisSystePlus_ReadDataByIdent (DcmDspDataInfo): DcmDspDataFixedLength=true
        DidInfo_DiagnServi_TABROW_NeuMeasu_Read_63_1_1_1 (DcmDspDidInfo)
          DcmDspDidAccess
            DcmDspDidRead: DcmDspDidReadSessionRef=ST_Defau, DcmDspDidReadSessionRef=ST_Exten
        DID_TABROW_CellVoltaMinim_ReadDataByIdent (DcmDspDid):
          DcmDspDidIdentifier = 7732
          DcmDspDidUsed = true
          DcmDspDidUsePort = USE_DATA_ELEMENT_SPECIFIC_INTERFACES
          DcmDspDidInfoRef = DidInfo_TABROW_CellVoltaMinim_ReadDataByIdent
          DcmDspDidSignal: DcmDspDidDataPos=0, DcmDspDidDataRef=Data_TABROW_CellVoltaMinim_ReadDataByIdent
        DidInfo_DiagnServi_TABROW_NeuMeasu_Read_27_4_1 (DcmDspDidInfo)
          DcmDspDidAccess
            DcmDspDidRead: DcmDspDidReadSessionRef=ST_Defau, DcmDspDidReadSessionRef=ST_Exten
        Data_TABROW_CellVoltaSum_ReadDataByIdent (DcmDspData):
          DcmDspDataSize = 16
          DcmDspDataType = UINT8_N
          DcmDspDataUsePort = USE_DATA_ASYNCH_CLIENT_SERVER
          DcmDspDataInfoRef = DataInfo_TABROW_CellVoltaSum_ReadDataByIdent
        DataInfo_HV_battery_maximum_charging_current_Read_Data_By_Identifier (DcmDspDataInfo): DcmDspDataFixedLength=true
        DataInfo_DiagnServi_TABROW_VWSparePartNumbe_Read (DcmDspDataInfo): DcmDspDataFixedLength=true
        DID_DiagnServi_ReadDataByIdentBasicSettiStatu (DcmDspDid):
          DcmDspDidIdentifier = 258
          DcmDspDidUsed = true
          DcmDspDidUsePort = USE_DATA_ELEMENT_SPECIFIC_INTERFACES
          DcmDspDidInfoRef = DidInfo_DiagnServi_ReadDataByIdentBasicSettiStatu
          DcmDspDidSignal: DcmDspDidDataPos=0, DcmDspDidDataRef=Data_DiagnServi_ReadDataByIdentBasicSettiStatu
        DidInfo_DiagnServi_TABROW_ContrModulVolta_Read (DcmDspDidInfo)
          DcmDspDidAccess
            DcmDspDidRead: DcmDspDidReadSessionRef=ST_Defau, DcmDspDidReadSessionRef=ST_Exten
        DataInfo_DiagnServi_TABROW_NeuMeasu_Read (DcmDspDataInfo): DcmDspDataFixedLength=true
        3 x DcmDspData, all with DcmDspDataType=UINT8_N, DcmDspDataUsePort=USE_DATA_ASYNCH_CLIENT_SERVER:
          Data_DiagnServi_TABROW_DID0xEFD_Read_1: DcmDspDataSize=32, DcmDspDataInfoRef=DataInfo_DiagnServi_TABROW_DID0xEFD_Read_1
          Data_DiagnServi_TABROW_DID0xEFD_Read_2: DcmDspDataSize=32, DcmDspDataInfoRef=DataInfo_DiagnServi_TABROW_DID0xEFD_Read_2
          Data_DiagnServi_TABROW_DID0xEFD_Read_3: DcmDspDataSize=16, DcmDspDataInfoRef=DataInfo_DiagnServi_TABROW_DID0xEFD_Read_3
        DID_DiagnServi_TABROW_NeuMeasu_Read_43_1_1_1_1 (DcmDspDid):
          DcmDspDidIdentifier = 1389
          DcmDspDidUsed = true
          DcmDspDidUsePort = USE_DATA_ELEMENT_SPECIFIC_INTERFACES
          DcmDspDidInfoRef = DidInfo_DiagnServi_TABROW_NeuMeasu_Read_43_1_1_1_1
          DcmDspDidSignal: DcmDspDidDataPos=0, DcmDspDidDataRef=Data_DiagnServi_TABROW_NeuMeasu_Read_43_1_1_1_1
        Data_DiagnServi_TABROW_NeuMeasu_Read_58_1 (DcmDspData):
          DcmDspDataSize = 16
          DcmDspDataType = UINT8_N
          DcmDspDataUsePort = USE_DATA_ASYNCH_CLIENT_SERVER
          DcmDspDataInfoRef = DataInfo_DiagnServi_TABROW_NeuMeasu_Read_58_1
        Data_DiagnServi_TABROW_NeuMeasu_Read_49_1 (DcmDspData):
          DcmDspDataSize = 16
          DcmDspDataType = UINT8_N
          DcmDspDataUsePort = USE_DATA_ASYNCH_CLIENT_SERVER
          DcmDspDataInfoRef = DataInfo_DiagnServi_TABROW_NeuMeasu_Read_49_1
        Routine_DiagnServi_TABROW_BeginOfWritiOfSecurDataOfProteOfVehicDiagn_Start_Routine (DcmDspRoutine):
          DcmDspRequestResultsRoutineSupported = false
          DcmDspStopRoutineSupported = false
          DcmDspRoutineIdentifier = 49169
          DcmDspRoutineFixedLength = false
          DcmDspRoutineUsePort = true
          DcmDspRoutineUsed = true
          DcmDspRoutineInfoRef = RoutineInfo_DiagnServi_TABROW_BeginOfWritiOfSecurDataOfProteOfVehicDiagn_Start_Routine
        Data_DiagnServi_TABROW_NeuMeasu_Read_46_1_1_1_1_1_1 (DcmDspData):
          DcmDspDataSize = 1216
          DcmDspDataType = UINT8_N
          DcmDspDataUsePort = USE_DATA_ASYNCH_CLIENT_SERVER
          DcmDspDataInfoRef = DataInfo_DiagnServi_TABROW_NeuMeasu_Read_46_1_1_1_1_1_1
        DidInfo_DiagnServi_TABROW_EnginCoolaTempe_Read (DcmDspDidInfo)
          DcmDspDidAccess
            DcmDspDidRead: DcmDspDidReadSessionRef=ST_Defau, DcmDspDidReadSessionRef=ST_Exten
        DataInfo_DiagnServi_TABROW_VWFAZITIdentStrin_Read (DcmDspDataInfo): DcmDspDataFixedLength=true
        DidInfo_DiagnServi_TABROW_NeuMeasu_Read_27_2_1 (DcmDspDidInfo)
          DcmDspDidAccess
            DcmDspDidRead: DcmDspDidReadSessionRef=ST_Defau, DcmDspDidReadSessionRef=ST_Exten
        Data_TABROW_TABROSyste_Read_1_1_1_1_1_1_1_1_1 (DcmDspData):
          DcmDspDataSize = 72
          DcmDspDataType = UINT8_N
          DcmDspDataUsePort = USE_DATA_ASYNCH_CLIENT_SERVER
          DcmDspDataInfoRef = DataInfo_TABROW_TABROSyste_Read_1_1_1_1_1_1_1_1_1
        Data_TABROW_SOKTimeInfor_Read_Data_By_Identifier (DcmDspData):
          DcmDspDataSize = 88
          DcmDspDataType = UINT8_N
          DcmDspDataUsePort = USE_DATA_ASYNCH_CLIENT_SERVER
          DcmDspDataInfoRef = DataInfo_TABROW_SOKTimeInfor_Read_Data_By_Identifier
        DataInfo_TABROW_CellStateOfChargMinim_ReadDataByIdent (DcmDspDataInfo): DcmDspDataFixedLength=true
        Data_DiagnServi_TABROW_NeuMeasu_Read_29_1_1_1_1_1 (DcmDspData):
          DcmDspDataSize = 32
          DcmDspDataType = UINT8_N
          DcmDspDataUsePort = USE_DATA_ASYNCH_CLIENT_SERVER
          DcmDspDataInfoRef = DataInfo_DiagnServi_TABROW_NeuMeasu_Read_29_1_1_1_1_1
        Routine_DiagnServi_TABROW_CalcuModulHashValue_Start_Routine_COP (DcmDspRoutine):
          DcmDspRequestResultsRoutineSupported = true
          DcmDspStopRoutineSupported = true
          DcmDspRoutineIdentifier = 666
          DcmDspRoutineFixedLength = false
          DcmDspRoutineUsePort = true
          DcmDspRoutineUsed = true
          DcmDspRoutineInfoRef = RoutineInfo_DiagnServi_TABROW_CalcuModulHashValue_Start_Routine_COP
        DID_TABROW_FingeAndProgrDateOfLogicSoftwBlock_Read (DcmDspDid):
          DcmDspDidIdentifier = 61787
          DcmDspDidUsed = true
          DcmDspDidUsePort = USE_DATA_ELEMENT_SPECIFIC_INTERFACES
          DcmDspDidInfoRef = DidInfo_TABROW_FingeAndProgrDateOfLogicSoftwBlock_Read
          DcmDspDidSignal: DcmDspDidDataPos=0, DcmDspDidDataRef=Data_TABROW_FingeAndProgrDateOfLogicSoftwBlock_Read
        DataInfo_DiagnServi_TABROW_NeuMeasu_Read_9_1 (DcmDspDataInfo): DcmDspDataFixedLength=true
        Data_DiagnServi_SOH_Read (DcmDspData): DcmDspDataSize=8, DcmDspDataType=UINT8_N, DcmDspDataUsePort=USE_DATA_ASYNCH_CLIENT_SERVER, DcmDspDataInfoRef=DataInfo_DiagnServi_SOH_Read
        RoutineInfo_TABROW_LockProteOfVehicDiagn_Start_Routine (DcmDspRoutineInfo)
          DcmDspRoutineAuthorization: DcmDspRoutineSessionRef=ST_Exten
          DcmDspStartRoutineOut
            ResData (DcmDspStartRoutineOutSignal): DcmDspRoutineSignalLength=16, DcmDspRoutineSignalType=UINT8_N, DcmDspRoutineSignalEndianness=opaque, DcmDspRoutineSignalPos=0
        DID_DiagnServi_TABROW_NeuMeasu_Read_30_2 (DcmDspDid):
          DcmDspDidIdentifier = 1745
          DcmDspDidUsed = true
          DcmDspDidUsePort = USE_DATA_ELEMENT_SPECIFIC_INTERFACES
          DcmDspDidInfoRef = DidInfo_DiagnServi_TABROW_NeuMeasu_Read_30_2
          DcmDspDidSignal: DcmDspDidDataPos=0, DcmDspDidDataRef=Data_DiagnServi_TABROW_NeuMeasu_Read_30_2
        DID_DiagnServi_TABROW_NeuMeasu_Read_30_3 (DcmDspDid):
          DcmDspDidIdentifier = 57356
          DcmDspDidUsed = true
          DcmDspDidUsePort = USE_DATA_ELEMENT_SPECIFIC_INTERFACES
          DcmDspDidInfoRef = DidInfo_DiagnServi_TABROW_NeuMeasu_Read_30_3
          DcmDspDidSignal: DcmDspDidDataPos=0, DcmDspDidDataRef=Data_DiagnServi_TABROW_NeuMeasu_Read_30_3
        DataInfo_DiagnServi_TABROW_NeuMeasu_Read_9_2 (DcmDspDataInfo): DcmDspDataFixedLength=true
        Data_DiagnServi_TABROW_NeuMeasu_Read_57_2_1 (DcmDspData):
          DcmDspDataSize = 24
          DcmDspDataType = UINT8_N
          DcmDspDataUsePort = USE_DATA_ASYNCH_CLIENT_SERVER
          DcmDspDataInfoRef = DataInfo_DiagnServi_TABROW_NeuMeasu_Read_57_2_1
        Data_DiagnServi_Cell_part_number_Read (DcmDspData):
          DcmDspDataSize = 88
          DcmDspDataType = UINT8_N
          DcmDspDataUsePort = USE_DATA_ASYNCH_CLIENT_SERVER
          DcmDspDataInfoRef = DataInfo_DiagnServi_Cell_part_number_Read
        DID_DiagnServi_TABROW_ActivDiagnSessi_Read (DcmDspDid):
          DcmDspDidIdentifier = 61830
          DcmDspDidUsed = true
          DcmDspDidUsePort = USE_DATA_ELEMENT_SPECIFIC_INTERFACES
          DcmDspDidInfoRef = DidInfo_DiagnServi_TABROW_ActivDiagnSessi_Read
          DcmDspDidSignal: DcmDspDidDataPos=0, DcmDspDidDataRef=Data_DiagnServi_TABROW_ActivDiagnSessi_Read
        DidInfo_DiagnServi_TABROW_SuppoINFOT0120_Read (DcmDspDidInfo)
          DcmDspDidAccess
            DcmDspDidRead: DcmDspDidReadSessionRef=ST_Defau, DcmDspDidReadSessionRef=ST_Exten
        6 x DcmDspRoutine, all with DcmDspRequestResultsRoutineSupported=true, DcmDspStopRoutineSupported=true, DcmDspRoutineFixedLength=false, DcmDspRoutineUsePort=true, DcmDspRoutineUsed=true:
          Routine_DiagnServi_TABROW_NeuRoutiBasicSetti_Start_Routine_5: DcmDspRoutineIdentifier=789, DcmDspRoutineInfoRef=RoutineInfo_DiagnServi_TABROW_NeuRoutiBasicSetti_Start_Routine_5
          Routine_DiagnServi_TABROW_NeuRoutiBasicSetti_Start_Routine_4: DcmDspRoutineIdentifier=783, DcmDspRoutineInfoRef=RoutineInfo_DiagnServi_TABROW_NeuRoutiBasicSetti_Start_Routine_4
          Routine_DiagnServi_TABROW_NeuRoutiBasicSetti_Start_Routine_1: DcmDspRoutineIdentifier=775, DcmDspRoutineInfoRef=RoutineInfo_DiagnServi_TABROW_NeuRoutiBasicSetti_Start_Routine_1
          Routine_DiagnServi_TABROW_IsolaMeasuDeactMode_Start_Routine_1: DcmDspRoutineIdentifier=793, DcmDspRoutineInfoRef=RoutineInfo_DiagnServi_TABROW_IsolaMeasuDeactMode_Start_Routine_1
          Routine_DiagnServi_TABROW_NeuRoutiBasicSetti_Start_Routine_3: DcmDspRoutineIdentifier=777, DcmDspRoutineInfoRef=RoutineInfo_DiagnServi_TABROW_NeuRoutiBasicSetti_Start_Routine_3
          Routine_DiagnServi_TABROW_NeuRoutiBasicSetti_Start_Routine_2: DcmDspRoutineIdentifier=778, DcmDspRoutineInfoRef=RoutineInfo_DiagnServi_TABROW_NeuRoutiBasicSetti_Start_Routine_2
        DidInfo_DiagnServi_TABROW_EnginRPM_Read (DcmDspDidInfo)
          DcmDspDidAccess
            DcmDspDidRead: DcmDspDidReadSessionRef=ST_Defau, DcmDspDidReadSessionRef=ST_Exten
        DataInfo_TABROW_StateOfBattePowerReduc_ReadDataByIdent (DcmDspDataInfo): DcmDspDataFixedLength=true
        DID_TABROW_VWSysteNameOrEnginType_Read (DcmDspDid):
          DcmDspDidIdentifier = 61847
          DcmDspDidUsed = true
          DcmDspDidUsePort = USE_DATA_ELEMENT_SPECIFIC_INTERFACES
          DcmDspDidInfoRef = DidInfo_TABROW_VWSysteNameOrEnginType_Read
          DcmDspDidSignal: DcmDspDidDataPos=0, DcmDspDidDataRef=Data_TABROW_VWSysteNameOrEnginType_Read
        Data_DiagnServi_TABROW_NeuMeasu_Read_29_1_2 (DcmDspData):
          DcmDspDataSize = 32
          DcmDspDataType = UINT8_N
          DcmDspDataUsePort = USE_DATA_ASYNCH_CLIENT_SERVER
          DcmDspDataInfoRef = DataInfo_DiagnServi_TABROW_NeuMeasu_Read_29_1_2
        DataInfo_DiagnServi_TABROW_NeuMeasu_Read_29_1_1_1_1 (DcmDspDataInfo): DcmDspDataFixedLength=true
        Data_DiagnServi_TABROW_NeuMeasu_Read_29_1_1 (DcmDspData):
          DcmDspDataSize = 32
          DcmDspDataType = UINT8_N
          DcmDspDataUsePort = USE_DATA_ASYNCH_CLIENT_SERVER
          DcmDspDataInfoRef = DataInfo_DiagnServi_TABROW_NeuMeasu_Read_29_1_1
        DID_DiagnServi_TABROW_NeuMeasu_Read_27_1_1_1_1_1 (DcmDspDid):
          DcmDspDidIdentifier = 57368
          DcmDspDidUsed = true
          DcmDspDidUsePort = USE_DATA_ELEMENT_SPECIFIC_INTERFACES
          DcmDspDidInfoRef = DidInfo_DiagnServi_TABROW_NeuMeasu_Read_27_1_1_1_1_1
          DcmDspDidSignal: DcmDspDidDataPos=0, DcmDspDidDataRef=Data_DiagnServi_TABROW_NeuMeasu_Read_27_1_1_1_1_1
        DataInfo_DiagnServi_TABROW_NeuMeasu_Read_27_1_2 (DcmDspDataInfo): DcmDspDataFixedLength=true
        Data_DiagnServi_TABROW_TimeSinceEnginStart_Read (DcmDspData):
          DcmDspDataSize = 16
          DcmDspDataType = UINT8_N
          DcmDspDataUsePort = USE_DATA_ASYNCH_CLIENT_SERVER
          DcmDspDataInfoRef = DataInfo_DiagnServi_TABROW_TimeSinceEnginStart_Read
        DID_DiagnServi_TABROW_NeuMeasu_Read_43_1_1_1 (DcmDspDid):
          DcmDspDidIdentifier = 1390
          DcmDspDidUsed = true
          DcmDspDidUsePort = USE_DATA_ELEMENT_SPECIFIC_INTERFACES
          DcmDspDidInfoRef = DidInfo_DiagnServi_TABROW_NeuMeasu_Read_43_1_1_1
          DcmDspDidSignal: DcmDspDidDataPos=0, DcmDspDidDataRef=Data_DiagnServi_TABROW_NeuMeasu_Read_43_1_1_1
        DataInfo_DiagnServi_TABROW_NeuMeasu_Read_27_1_1 (DcmDspDataInfo): DcmDspDataFixedLength=true
        3 x DcmDspDidInfo:
          DidInfo_DiagnServi_TABROW_NeuMeasu_Read_9
            DcmDspDidAccess
              DcmDspDidRead: DcmDspDidReadSessionRef=ST_Defau, DcmDspDidReadSessionRef=ST_Exten
          DidInfo_DiagnServi_TABROW_NeuMeasu_Read_8
            DcmDspDidAccess
              DcmDspDidRead: DcmDspDidReadSessionRef=ST_Defau, DcmDspDidReadSessionRef=ST_Exten
          DidInfo_DiagnServi_TABROW_NeuMeasu_Read_29_1_1_1_1
            DcmDspDidAccess
              DcmDspDidRead: DcmDspDidReadSessionRef=ST_Defau, DcmDspDidReadSessionRef=ST_Exten
        Data_TABROW_VWECUHardwVersiNumbe_Read (DcmDspData):
          DcmDspDataSize = 24
          DcmDspDataType = UINT8_N
          DcmDspDataUsePort = USE_DATA_ASYNCH_CLIENT_SERVER
          DcmDspDataInfoRef = DataInfo_TABROW_VWECUHardwVersiNumbe_Read
        DidInfo_DiagnServi_TABROW_NeuMeasu_Read_5 (DcmDspDidInfo)
          DcmDspDidAccess
            DcmDspDidRead: DcmDspDidReadSessionRef=ST_Defau, DcmDspDidReadSessionRef=ST_Exten
        Data_Battery_isolation_measurement_actual_and_requested_state_Read_Data_By_Identifier (DcmDspData):
          DcmDspDataSize = 16
          DcmDspDataType = UINT8_N
          DcmDspDataUsePort = USE_DATA_ASYNCH_CLIENT_SERVER
          DcmDspDataInfoRef = DataInfo_Battery_isolation_measurement_actual_and_requested_state_Read_Data_By_Identifier
        DidInfo_DiagnServi_TABROW_NeuMeasu_Read_4 (DcmDspDidInfo)
          DcmDspDidAccess
            DcmDspDidRead: DcmDspDidReadSessionRef=ST_Defau, DcmDspDidReadSessionRef=ST_Exten
        DataInfo_DiagnServi_TABROW_AUTOSStandAppliSoftwIdent_Read (DcmDspDataInfo): DcmDspDataFixedLength=false
        Data_DiagnServi_TABROW_DID0xEFD_Read (DcmDspData):
          DcmDspDataSize = 32
          DcmDspDataType = UINT8_N
          DcmDspDataUsePort = USE_DATA_ASYNCH_CLIENT_SERVER
          DcmDspDataInfoRef = DataInfo_DiagnServi_TABROW_DID0xEFD_Read
        DidInfo_DiagnServi_TABROW_NeuMeasu_Read_7 (DcmDspDidInfo)
          DcmDspDidAccess
            DcmDspDidRead: DcmDspDidReadSessionRef=ST_Defau, DcmDspDidReadSessionRef=ST_Exten
        DidInfo_DiagnServi_TABROW_NeuMeasu_Read_6 (DcmDspDidInfo)
          DcmDspDidAccess
            DcmDspDidRead: DcmDspDidReadSessionRef=ST_Defau, DcmDspDidReadSessionRef=ST_Exten
        Data_TABROW_VkmsMissiKeyHisto_Read_Data_By_Identifier (DcmDspData):
          DcmDspDataSize = 4096
          DcmDspDataType = UINT8_N
          DcmDspDataUsePort = USE_DATA_ASYNCH_CLIENT_SERVER
          DcmDspDataInfoRef = DataInfo_TABROW_VkmsMissiKeyHisto_Read_Data_By_Identifier
        DID_HV_battery_maximum_discharge_power_Read_Data_By_Identifier (DcmDspDid):
          DcmDspDidIdentifier = 9995
          DcmDspDidUsed = true
          DcmDspDidUsePort = USE_DATA_ELEMENT_SPECIFIC_INTERFACES
          DcmDspDidInfoRef = DidInfo_HV_battery_maximum_discharge_power_Read_Data_By_Identifier
          DcmDspDidSignal: DcmDspDidDataPos=0, DcmDspDidDataRef=Data_HV_battery_maximum_discharge_power_Read_Data_By_Identifier
        DidInfo_TABROW_OBDType_Read (DcmDspDidInfo)
          DcmDspDidAccess
            DcmDspDidRead: DcmDspDidReadSessionRef=ST_Defau, DcmDspDidReadSessionRef=ST_Exten
        DID_DiagnServi_TABROW_NeuMeasu_Read_30_1 (DcmDspDid):
          DcmDspDidIdentifier = 1736
          DcmDspDidUsed = true
          DcmDspDidUsePort = USE_DATA_ELEMENT_SPECIFIC_INTERFACES
          DcmDspDidInfoRef = DidInfo_DiagnServi_TABROW_NeuMeasu_Read_30_1
          DcmDspDidSignal: DcmDspDidDataPos=0, DcmDspDidDataRef=Data_DiagnServi_TABROW_NeuMeasu_Read_30_1
        Data_DiagnServi_TABROW_NeuMeasu_Read_43_1_1_1_1_1 (DcmDspData):
          DcmDspDataSize = 512
          DcmDspDataType = UINT8_N
          DcmDspDataUsePort = USE_DATA_ASYNCH_CLIENT_SERVER
          DcmDspDataInfoRef = DataInfo_DiagnServi_TABROW_NeuMeasu_Read_43_1_1_1_1_1
        Data_DiagnServi_TABROW_NeuMeasu_Read_29_1_1_1_1_1_1_1 (DcmDspData):
          DcmDspDataSize = 32
          DcmDspDataType = UINT8_N
          DcmDspDataUsePort = USE_DATA_ASYNCH_CLIENT_SERVER
          DcmDspDataInfoRef = DataInfo_DiagnServi_TABROW_NeuMeasu_Read_29_1_1_1_1_1_1_1
        DataInfo_HV_battery_maximum_discharge_current_Read_Data_By_Identifier (DcmDspDataInfo): DcmDspDataFixedLength=true
        5 x DcmDspDidInfo:
          DidInfo_DiagnServi_TABROW_CalcuLOADValue_Read
            DcmDspDidAccess
              DcmDspDidRead: DcmDspDidReadSessionRef=ST_Defau, DcmDspDidReadSessionRef=ST_Exten
          DidInfo_DiagnServi_TABROW_MonitStatuThisDriviCycle_Read
            DcmDspDidAccess
              DcmDspDidRead: DcmDspDidReadSessionRef=ST_Defau, DcmDspDidReadSessionRef=ST_Exten
          DidInfo_DiagnServi_TABROW_NeuMeasu_Read_1
            DcmDspDidAccess
              DcmDspDidRead: DcmDspDidReadSessionRef=ST_Defau, DcmDspDidReadSessionRef=ST_Exten
          DidInfo_TABROW_IsolaResisSysteMinus_ReadDataByIdent
            DcmDspDidAccess
              DcmDspDidRead: DcmDspDidReadSessionRef=ST_Defau, DcmDspDidReadSessionRef=ST_Exten
          DidInfo_DiagnServi_TABROW_NeuMeasu_Read_59_2
            DcmDspDidAccess
              DcmDspDidRead: DcmDspDidReadSessionRef=ST_Defau, DcmDspDidReadSessionRef=ST_Exten
        Data_DiagnServi_TABROW_EnginRPM_Read (DcmDspData):
          DcmDspDataSize = 16
          DcmDspDataType = UINT8_N
          DcmDspDataUsePort = USE_DATA_ASYNCH_CLIENT_SERVER
          DcmDspDataInfoRef = DataInfo_DiagnServi_TABROW_EnginRPM_Read
        DidInfo_DiagnServi_TABROW_NeuMeasu_Read_3 (DcmDspDidInfo)
          DcmDspDidAccess
            DcmDspDidRead: DcmDspDidReadSessionRef=ST_Defau, DcmDspDidReadSessionRef=ST_Exten
        DidInfo_DiagnServi_TABROW_NeuMeasu_Read_2 (DcmDspDidInfo)
          DcmDspDidAccess
            DcmDspDidRead: DcmDspDidReadSessionRef=ST_Defau, DcmDspDidReadSessionRef=ST_Exten
        DID_TABROW_StateOfBatteMIL_ReadDataByIdent (DcmDspDid):
          DcmDspDidIdentifier = 7693
          DcmDspDidUsed = true
          DcmDspDidUsePort = USE_DATA_ELEMENT_SPECIFIC_INTERFACES
          DcmDspDidInfoRef = DidInfo_TABROW_StateOfBatteMIL_ReadDataByIdent
          DcmDspDidSignal: DcmDspDidDataPos=0, DcmDspDidDataRef=Data_TABROW_StateOfBatteMIL_ReadDataByIdent
        DidInfo_DiagnServi_TABROW_NeuMeasu_Read_43_1_1_1_1_1_1_1_1_1 (DcmDspDidInfo)
          DcmDspDidAccess
            DcmDspDidRead: DcmDspDidReadSessionRef=ST_Defau, DcmDspDidReadSessionRef=ST_Exten
        DID_TABROW_BatteTempeMinim_ReadDataByIdent (DcmDspDid):
          DcmDspDidIdentifier = 7695
          DcmDspDidUsed = true
          DcmDspDidUsePort = USE_DATA_ELEMENT_SPECIFIC_INTERFACES
          DcmDspDidInfoRef = DidInfo_TABROW_BatteTempeMinim_ReadDataByIdent
          DcmDspDidSignal: DcmDspDidDataPos=0, DcmDspDidDataRef=Data_TABROW_BatteTempeMinim_ReadDataByIdent
        DidInfo_DiagnServi_Type_number_BMCE_Read (DcmDspDidInfo)
          DcmDspDidAccess
            DcmDspDidWrite: DcmDspDidWriteSessionRef=ST_Exten
            DcmDspDidRead: DcmDspDidReadSessionRef=ST_Defau, DcmDspDidReadSessionRef=ST_Exten
        DataInfo_Battery_banks_actual_voltage_Read_Data_By_Identifier (DcmDspDataInfo): DcmDspDataFixedLength=true
        Data_DiagnServi_TABROW_VWDataSetName_Read (DcmDspData):
          DcmDspDataType = UINT8_N
          DcmDspDataSize = 65535
          DcmDspDataUsePort = USE_DATA_ASYNCH_CLIENT_SERVER
          DcmDspDataInfoRef = DataInfo_DiagnServi_TABROW_VWDataSetName_Read
        DidInfo_HV_battery_maximum_discharge_current_Read_Data_By_Identifier (DcmDspDidInfo)
          DcmDspDidAccess
            DcmDspDidRead: DcmDspDidReadSessionRef=ST_Defau, DcmDspDidReadSessionRef=ST_Exten
        DID_TABROW_StateOfBattePowerReduc_ReadDataByIdent (DcmDspDid):
          DcmDspDidIdentifier = 7690
          DcmDspDidUsed = true
          DcmDspDidUsePort = USE_DATA_ELEMENT_SPECIFIC_INTERFACES
          DcmDspDidInfoRef = DidInfo_TABROW_StateOfBattePowerReduc_ReadDataByIdent
          DcmDspDidSignal: DcmDspDidDataPos=0, DcmDspDidDataRef=Data_TABROW_StateOfBattePowerReduc_ReadDataByIdent
        Data_Battery_flow_temperature_Read_Data_By_Identifier (DcmDspData):
          DcmDspDataSize = 16
          DcmDspDataType = UINT8_N
          DcmDspDataUsePort = USE_DATA_ASYNCH_CLIENT_SERVER
          DcmDspDataInfoRef = DataInfo_Battery_flow_temperature_Read_Data_By_Identifier
        DidInfo_DiagnServi_TABROW_NeuMeasu_Read_60_3 (DcmDspDidInfo)
          DcmDspDidAccess
            DcmDspDidRead: DcmDspDidReadSessionRef=ST_Defau, DcmDspDidReadSessionRef=ST_Exten
        DidInfo_DiagnServi_TABROW_NeuMeasu_Read_60_1 (DcmDspDidInfo)
          DcmDspDidAccess
            DcmDspDidRead: DcmDspDidReadSessionRef=ST_Defau, DcmDspDidReadSessionRef=ST_Exten
        Data_HV_battery_maximum_charging_current_Read_Data_By_Identifier (DcmDspData):
          DcmDspDataSize = 16
          DcmDspDataType = UINT8_N
          DcmDspDataUsePort = USE_DATA_ASYNCH_CLIENT_SERVER
          DcmDspDataInfoRef = DataInfo_HV_battery_maximum_charging_current_Read_Data_By_Identifier
        Data_TABROW_SysteIdent_Read (DcmDspData): DcmDspDataSize=32, DcmDspDataType=UINT8_N, DcmDspDataUsePort=USE_DATA_ASYNCH_CLIENT_SERVER, DcmDspDataInfoRef=DataInfo_TABROW_SysteIdent_Read
        Routine_DiagnServi_TABROW_AdaptOfVoltaMeasuChann_Start_Routine (DcmDspRoutine):
          DcmDspRequestResultsRoutineSupported = true
          DcmDspStopRoutineSupported = true
          DcmDspRoutineIdentifier = 772
          DcmDspRoutineFixedLength = false
          DcmDspRoutineUsePort = true
          DcmDspRoutineUsed = true
          DcmDspRoutineInfoRef = RoutineInfo_DiagnServi_TABROW_AdaptOfVoltaMeasuChann_Start_Routine
        DID_DiagnServi_TABROW_NeuMeasu_Read_27_3_1 (DcmDspDid):
          DcmDspDidIdentifier = 1657
          DcmDspDidUsed = true
          DcmDspDidUsePort = USE_DATA_ELEMENT_SPECIFIC_INTERFACES
          DcmDspDidInfoRef = DidInfo_DiagnServi_TABROW_NeuMeasu_Read_27_3_1
          DcmDspDidSignal: DcmDspDidDataPos=0, DcmDspDidDataRef=Data_DiagnServi_TABROW_NeuMeasu_Read_27_3_1
        DataInfo_DiagnServi_Assembly_production_data_Read (DcmDspDataInfo): DcmDspDataFixedLength=true
        DataInfo_Battery_isolation_measurement_actual_and_requested_state_Read_Data_By_Identifier (DcmDspDataInfo): DcmDspDataFixedLength=true
        DID_DiagnServi_HV_battery_modules_actual_voltage_Read (DcmDspDid):
          DcmDspDidIdentifier = 10001
          DcmDspDidUsed = true
          DcmDspDidUsePort = USE_DATA_ELEMENT_SPECIFIC_INTERFACES
          DcmDspDidInfoRef = DidInfo_DiagnServi_HV_battery_modules_actual_voltage_Read
          DcmDspDidSignal: DcmDspDidDataPos=0, DcmDspDidDataRef=Data_DiagnServi_HV_battery_modules_actual_voltage_Read
        DidInfo_DiagnServi_TABROW_Finge_Read (DcmDspDidInfo)
          DcmDspDidAccess
            DcmDspDidWrite: DcmDspDidWriteSessionRef=ST_Progr
            DcmDspDidRead: DcmDspDidReadSessionRef=ST_Progr
        DID_TABROW_IsolaResisSystePlus_ReadDataByIdent (DcmDspDid):
          DcmDspDidIdentifier = 7703
          DcmDspDidUsed = true
          DcmDspDidUsePort = USE_DATA_ELEMENT_SPECIFIC_INTERFACES
          DcmDspDidInfoRef = DidInfo_TABROW_IsolaResisSystePlus_ReadDataByIdent
          DcmDspDidSignal: DcmDspDidDataPos=0, DcmDspDidDataRef=Data_TABROW_IsolaResisSystePlus_ReadDataByIdent
        DataInfo_DiagnServi_TABROW_NeuMeasu_Read_29_1_1_1_1_1_1_1 (DcmDspDataInfo): DcmDspDataFixedLength=true
        DidInfo_DiagnServi_Module_part_number_Read (DcmDspDidInfo)
          DcmDspDidAccess
            DcmDspDidWrite: DcmDspDidWriteSessionRef=ST_Exten
            DcmDspDidRead: DcmDspDidReadSessionRef=ST_Defau, DcmDspDidReadSessionRef=ST_Exten
        DataInfo_DiagnServi_TABROW_MonitStatuSinceDTCsClear_Read (DcmDspDataInfo): DcmDspDataFixedLength=true
        Data_DiagnServi_TABROW_AdaptOfChineSeriaNumbe_Read (DcmDspData):
          DcmDspDataSize = 208
          DcmDspDataType = UINT8_N
          DcmDspDataUsePort = USE_DATA_ASYNCH_CLIENT_SERVER
          DcmDspDataInfoRef = DataInfo_DiagnServi_TABROW_AdaptOfChineSeriaNumbe_Read
        Data_BMC_Hybrid_Kundendienstfehler_Read_Data_By_Identifier (DcmDspData):
          DcmDspDataSize = 8
          DcmDspDataType = UINT8_N
          DcmDspDataUsePort = USE_DATA_ASYNCH_CLIENT_SERVER
          DcmDspDataInfoRef = DataInfo_BMC_Hybrid_Kundendienstfehler_Read_Data_By_Identifier
        4 x DcmDspDid, all with DcmDspDidUsed=true, DcmDspDidUsePort=USE_DATA_ELEMENT_SPECIFIC_INTERFACES:
          DID_DiagnServi_TABROW_VWDataSetNumbeOrECUDataContaNumbe_Read: DcmDspDidIdentifier=61856, DcmDspDidInfoRef=DidInfo_DiagnServi_TABROW_VWDataSetNumbeOrECUDataContaNumbe_Read
            DcmDspDidSignal: DcmDspDidDataPos=0, DcmDspDidDataRef=Data_DiagnServi_TABROW_VWDataSetNumbeOrECUDataContaNumbe_Read
          DID_DiagnServi_TABROW_NeuMeasu_Read_29_1_1_1: DcmDspDidIdentifier=57374, DcmDspDidInfoRef=DidInfo_DiagnServi_TABROW_NeuMeasu_Read_29_1_1_1
            DcmDspDidSignal: DcmDspDidDataPos=0, DcmDspDidDataRef=Data_DiagnServi_TABROW_NeuMeasu_Read_29_1_1_1
          DID_DiagnServi_TABROW_NeuMeasu_Read_7_1: DcmDspDidIdentifier=1669, DcmDspDidInfoRef=DidInfo_DiagnServi_TABROW_NeuMeasu_Read_7_1
            DcmDspDidSignal: DcmDspDidDataPos=0, DcmDspDidDataRef=Data_DiagnServi_TABROW_NeuMeasu_Read_7_1
          DID_DiagnServi_TABROW_NeuMeasu_Read_7_2: DcmDspDidIdentifier=1730, DcmDspDidInfoRef=DidInfo_DiagnServi_TABROW_NeuMeasu_Read_7_2
            DcmDspDidSignal: DcmDspDidDataPos=0, DcmDspDidDataRef=Data_DiagnServi_TABROW_NeuMeasu_Read_7_2
        DataInfo_DiagnServi_TABROW_NeuMeasu_Read_29_1_1 (DcmDspDataInfo): DcmDspDataFixedLength=true
        DataInfo_DiagnServi_TABROW_NeuMeasu_Read_29_1_2 (DcmDspDataInfo): DcmDspDataFixedLength=true
        DidInfo_DiagnServi_TABROW_NeuMeasu1_Read (DcmDspDidInfo)
          DcmDspDidAccess
            DcmDspDidRead: DcmDspDidReadSessionRef=ST_Defau, DcmDspDidReadSessionRef=ST_Exten
        DataInfo_DiagnServi_TABROW_NeuMeasu_Read_27_2_1_1 (DcmDspDataInfo): DcmDspDataFixedLength=true
        DidInfo_DiagnServi_TABROW_NeuMeasu_Read_46_1_1 (DcmDspDidInfo)
          DcmDspDidAccess
            DcmDspDidRead: DcmDspDidReadSessionRef=ST_Defau, DcmDspDidReadSessionRef=ST_Exten
        DidInfo_DiagnServi_TABROW_NeuMeasu_Read_43_1_1_1_1 (DcmDspDidInfo)
          DcmDspDidAccess
            DcmDspDidRead: DcmDspDidReadSessionRef=ST_Defau, DcmDspDidReadSessionRef=ST_Exten
        DataInfo_DiagnServi_TABROW_NeuMeasu_Read_43_1_1_1_1_1_1_1_1_1 (DcmDspDataInfo): DcmDspDataFixedLength=true
        Data_DiagnServi_TABROW_NeuMeasu_Read_9_2_1_1_2 (DcmDspData):
          DcmDspDataSize = 16
          DcmDspDataType = UINT8_N
          DcmDspDataUsePort = USE_DATA_ASYNCH_CLIENT_SERVER
          DcmDspDataInfoRef = DataInfo_DiagnServi_TABROW_NeuMeasu_Read_9_2_1_1_2
        DidInfo_TABROW_OBDClassDescr_Read_Data_By_Identifier (DcmDspDidInfo)
          DcmDspDidAccess
            DcmDspDidRead: DcmDspDidReadSessionRef=ST_Defau, DcmDspDidReadSessionRef=ST_Exten
        Data_DiagnServi_TABROW_NeuMeasu_Read_9_2_1_1_1 (DcmDspData):
          DcmDspDataSize = 16
          DcmDspDataType = UINT8_N
          DcmDspDataUsePort = USE_DATA_ASYNCH_CLIENT_SERVER
          DcmDspDataInfoRef = DataInfo_DiagnServi_TABROW_NeuMeasu_Read_9_2_1_1_1
        DID_TABROW_BMCHVKFehleSD_Read_Data_By_Identifier (DcmDspDid):
          DcmDspDidIdentifier = 9987
          DcmDspDidUsed = true
          DcmDspDidUsePort = USE_DATA_ELEMENT_SPECIFIC_INTERFACES
          DcmDspDidInfoRef = DidInfo_TABROW_BMCHVKFehleSD_Read_Data_By_Identifier
          DcmDspDidSignal: DcmDspDidDataPos=0, DcmDspDidDataRef=Data_TABROW_BMCHVKFehleSD_Read_Data_By_Identifier
        Data_DiagnServi_HV_battery_modules_actual_voltage_Read (DcmDspData):
          DcmDspDataSize = 192
          DcmDspDataType = UINT8_N
          DcmDspDataUsePort = USE_DATA_ASYNCH_CLIENT_SERVER
          DcmDspDataInfoRef = DataInfo_DiagnServi_HV_battery_modules_actual_voltage_Read
        DataInfo_DiagnServi_TABROW_NeuMeasu2_Read (DcmDspDataInfo): DcmDspDataFixedLength=true
        DataInfo_Battery_return_flow_temperature_Read_Data_By_Identifier (DcmDspDataInfo): DcmDspDataFixedLength=true
        DID_TABROW_CellVoltaMaxim_ReadDataByIdent (DcmDspDid):
          DcmDspDidIdentifier = 7731
          DcmDspDidUsed = true
          DcmDspDidUsePort = USE_DATA_ELEMENT_SPECIFIC_INTERFACES
          DcmDspDidInfoRef = DidInfo_TABROW_CellVoltaMaxim_ReadDataByIdent
          DcmDspDidSignal: DcmDspDidDataPos=0, DcmDspDidDataRef=Data_TABROW_CellVoltaMaxim_ReadDataByIdent
        Routine_DiagnServi_TABROW_CalcuConfiStateFingeOfProteOfVehicDiagn_Start_Routine (DcmDspRoutine):
          DcmDspRequestResultsRoutineSupported = false
          DcmDspStopRoutineSupported = false
          DcmDspRoutineIdentifier = 3842
          DcmDspRoutineFixedLength = false
          DcmDspRoutineUsePort = true
          DcmDspRoutineUsed = true
          DcmDspRoutineInfoRef = RoutineInfo_DiagnServi_TABROW_CalcuConfiStateFingeOfProteOfVehicDiagn_Start_Routine
        DidInfo_DiagnServi_TABROW_NeuMeasu_Read_27_2_1_1 (DcmDspDidInfo)
          DcmDspDidAccess
            DcmDspDidRead: DcmDspDidReadSessionRef=ST_Defau, DcmDspDidReadSessionRef=ST_Exten
        DataInfo_TABROW_VWSysteNameOrEnginType_Read (DcmDspDataInfo): DcmDspDataFixedLength=true
        Data_DiagnServi_TABROW_NeuMeasu_Read_27_1 (DcmDspData):
          DcmDspDataSize = 216
          DcmDspDataType = UINT8_N
          DcmDspDataUsePort = USE_DATA_ASYNCH_CLIENT_SERVER
          DcmDspDataInfoRef = DataInfo_DiagnServi_TABROW_NeuMeasu_Read_27_1
        RoutineInfo_DiagnServi_TABROW_IsolaMeasuDeactMode_Start_Routine_1 (DcmDspRoutineInfo)
          DcmDspRoutineRequestResOut
            ResData (DcmDspRoutineRequestResOutSignal): DcmDspRoutineSignalLength=24, DcmDspRoutineSignalType=UINT8_N, DcmDspRoutineSignalEndianness=opaque, DcmDspRoutineSignalPos=0
          DcmDspStartRoutineIn
            ReqData (DcmDspStartRoutineInSignal): DcmDspRoutineSignalLength=8, DcmDspRoutineSignalType=UINT8_N, DcmDspRoutineSignalEndianness=opaque, DcmDspRoutineSignalPos=0
          DcmDspRoutineAuthorization: DcmDspRoutineSessionRef=ST_Exten
          DcmDspRoutineStopOut
            ResData (DcmDspRoutineStopOutSignal): DcmDspRoutineSignalLength=8, DcmDspRoutineSignalType=UINT8_N, DcmDspRoutineSignalEndianness=opaque, DcmDspRoutineSignalPos=0
          DcmDspStartRoutineOut
            ResData (DcmDspStartRoutineOutSignal): DcmDspRoutineSignalLength=8, DcmDspRoutineSignalType=UINT8_N, DcmDspRoutineSignalEndianness=opaque, DcmDspRoutineSignalPos=0
        DataInfo_DiagnServi_BMC_clamp_30c_Read (DcmDspDataInfo): DcmDspDataFixedLength=true
        Data_DiagnServi_TABROW_NeuMeasu_Read_27_3 (DcmDspData):
          DcmDspDataSize = 216
          DcmDspDataType = UINT8_N
          DcmDspDataUsePort = USE_DATA_ASYNCH_CLIENT_SERVER
          DcmDspDataInfoRef = DataInfo_DiagnServi_TABROW_NeuMeasu_Read_27_3
        DataInfo_DiagnServi_TABROW_VWDataSetNumbeOrECUDataContaNumbe_Read (DcmDspDataInfo): DcmDspDataFixedLength=true
        3 x DcmDspData, all with DcmDspDataType=UINT8_N, DcmDspDataUsePort=USE_DATA_ASYNCH_CLIENT_SERVER:
          Data_DiagnServi_TABROW_NeuMeasu_Read_27_2: DcmDspDataSize=216, DcmDspDataInfoRef=DataInfo_DiagnServi_TABROW_NeuMeasu_Read_27_2
          Data_DiagnServi_TABROW_NeuMeasu_Read_27_5: DcmDspDataSize=32, DcmDspDataInfoRef=DataInfo_DiagnServi_TABROW_NeuMeasu_Read_27_5
          Data_DiagnServi_TABROW_NeuMeasu_Read_27_4: DcmDspDataSize=216, DcmDspDataInfoRef=DataInfo_DiagnServi_TABROW_NeuMeasu_Read_27_4
        DataInfo_DiagnServi_ReadDataByIdentVWLogicBlockDowngProteVersi (DcmDspDataInfo): DcmDspDataFixedLength=false
        Data_DiagnServi_TABROW_NeuMeasu_Read_27_7 (DcmDspData):
          DcmDspDataSize = 32
          DcmDspDataType = UINT8_N
          DcmDspDataUsePort = USE_DATA_ASYNCH_CLIENT_SERVER
          DcmDspDataInfoRef = DataInfo_DiagnServi_TABROW_NeuMeasu_Read_27_7
        DidInfo_Strommesung_Read_Data_By_Identifier (DcmDspDidInfo)
          DcmDspDidAccess
            DcmDspDidRead: DcmDspDidReadSessionRef=ST_Defau, DcmDspDidReadSessionRef=ST_Exten
        Data_DiagnServi_TABROW_NeuMeasu_Read_27_6 (DcmDspData):
          DcmDspDataSize = 16
          DcmDspDataType = UINT8_N
          DcmDspDataUsePort = USE_DATA_ASYNCH_CLIENT_SERVER
          DcmDspDataInfoRef = DataInfo_DiagnServi_TABROW_NeuMeasu_Read_27_6
        Data_DiagnServi_TABROW_NeuMeasu_Read_27_8 (DcmDspData):
          DcmDspDataSize = 8
          DcmDspDataType = UINT8_N
          DcmDspDataUsePort = USE_DATA_ASYNCH_CLIENT_SERVER
          DcmDspDataInfoRef = DataInfo_DiagnServi_TABROW_NeuMeasu_Read_27_8
        4 x DcmDspDid, all with DcmDspDidUsed=true, DcmDspDidUsePort=USE_DATA_ELEMENT_SPECIFIC_INTERFACES:
          DID_DiagnServi_TABROW_CalibIdent_Read: DcmDspDidIdentifier=63492, DcmDspDidInfoRef=DidInfo_DiagnServi_TABROW_CalibIdent_Read
            DcmDspDidSignal: DcmDspDidDataPos=0, DcmDspDidDataRef=Data_DiagnServi_TABROW_CalibIdent_Read
          DID_DiagnServi_TABROW_DID0xEFD_Read_1_2: DcmDspDidIdentifier=1415, DcmDspDidInfoRef=DidInfo_DiagnServi_TABROW_DID0xEFD_Read_1_2
            DcmDspDidSignal: DcmDspDidDataPos=0, DcmDspDidDataRef=Data_DiagnServi_TABROW_DID0xEFD_Read_1_2
          DID_DiagnServi_TABROW_DID0xEFD_Read_1_1: DcmDspDidIdentifier=1417, DcmDspDidInfoRef=DidInfo_DiagnServi_TABROW_DID0xEFD_Read_1_1
            DcmDspDidSignal: DcmDspDidDataPos=0, DcmDspDidDataRef=Data_DiagnServi_TABROW_DID0xEFD_Read_1_1
          DID_TABROW_KnockTimer_Read: DcmDspDidIdentifier=715, DcmDspDidInfoRef=DidInfo_TABROW_KnockTimer_Read
            DcmDspDidSignal: DcmDspDidDataPos=0, DcmDspDidDataRef=Data_TABROW_KnockTimer_Read
        RoutineInfo_DiagnServi_TABROW_CalcuModulHashValue_Start_Routine_COP (DcmDspRoutineInfo)
          DcmDspRoutineRequestResOut
            ResData (DcmDspRoutineRequestResOutSignal): DcmDspRoutineSignalLength=296, DcmDspRoutineSignalType=VARIABLE_LENGTH, DcmDspRoutineSignalEndianness=opaque, DcmDspRoutineSignalPos=0
          DcmDspStartRoutineIn
            ReqData (DcmDspStartRoutineInSignal): DcmDspRoutineSignalLength=16, DcmDspRoutineSignalType=UINT8_N, DcmDspRoutineSignalEndianness=opaque, DcmDspRoutineSignalPos=0
          DcmDspRoutineAuthorization: DcmDspRoutineSessionRef=ST_Defau, DcmDspRoutineSessionRef=ST_Exten
          DcmDspRoutineStopOut
            ResData (DcmDspRoutineStopOutSignal): DcmDspRoutineSignalLength=8, DcmDspRoutineSignalType=UINT8_N, DcmDspRoutineSignalEndianness=opaque, DcmDspRoutineSignalPos=0
          DcmDspStartRoutineOut
            ResData (DcmDspStartRoutineOutSignal): DcmDspRoutineSignalLength=8, DcmDspRoutineSignalType=UINT8_N, DcmDspRoutineSignalEndianness=opaque, DcmDspRoutineSignalPos=0
        DID_DiagnServi_TABROW_VWDataSetName_Read (DcmDspDid):
          DcmDspDidIdentifier = 61875
          DcmDspDidUsed = true
          DcmDspDidUsePort = USE_DATA_ELEMENT_SPECIFIC_INTERFACES
          DcmDspDidInfoRef = DidInfo_DiagnServi_TABROW_VWDataSetName_Read
          DcmDspDidSignal: DcmDspDidDataPos=0, DcmDspDidDataRef=Data_DiagnServi_TABROW_VWDataSetName_Read
        DidInfo_DiagnServi_TABROW_VWCodinValue_Read (DcmDspDidInfo)
          DcmDspDidAccess
            DcmDspDidWrite: DcmDspDidWriteSessionRef=ST_Exten
            DcmDspDidRead: DcmDspDidReadSessionRef=ST_Defau, DcmDspDidReadSessionRef=ST_Exten
        DID_DC_charging_station_actual_voltage_Read_Data_By_Identifier (DcmDspDid):
          DcmDspDidIdentifier = 9984
          DcmDspDidUsed = true
          DcmDspDidUsePort = USE_DATA_ELEMENT_SPECIFIC_INTERFACES
          DcmDspDidInfoRef = DidInfo_DC_charging_station_actual_voltage_Read_Data_By_Identifier
          DcmDspDidSignal: DcmDspDidDataPos=0, DcmDspDidDataRef=Data_DC_charging_station_actual_voltage_Read_Data_By_Identifier
        DataInfo_DiagnServi_TABROW_Finge_Read (DcmDspDataInfo): DcmDspDataFixedLength=true
        DID_TABROW_CellStateOfChargMinim_ReadDataByIdent (DcmDspDid):
          DcmDspDidIdentifier = 7725
          DcmDspDidUsed = true
          DcmDspDidUsePort = USE_DATA_ELEMENT_SPECIFIC_INTERFACES
          DcmDspDidInfoRef = DidInfo_TABROW_CellStateOfChargMinim_ReadDataByIdent
          DcmDspDidSignal: DcmDspDidDataPos=0, DcmDspDidDataRef=Data_TABROW_CellStateOfChargMinim_ReadDataByIdent
        DID_TABROW_TABROSyste_Read_1_1_1_1_1_1_1_1_1_1_1 (DcmDspDid):
          DcmDspDidIdentifier = 57401
          DcmDspDidUsed = true
          DcmDspDidUsePort = USE_DATA_ELEMENT_SPECIFIC_INTERFACES
          DcmDspDidInfoRef = DidInfo_TABROW_TABROSyste_Read_1_1_1_1_1_1_1_1_1_1_1
          DcmDspDidSignal: DcmDspDidDataPos=0, DcmDspDidDataRef=Data_TABROW_TABROSyste_Read_1_1_1_1_1_1_1_1_1_1_1
        DidInfo_HV_battery_maximum_charging_power_Read_Data_By_Identifier (DcmDspDidInfo)
          DcmDspDidAccess
            DcmDspDidRead: DcmDspDidReadSessionRef=ST_Defau, DcmDspDidReadSessionRef=ST_Exten
        Routine_DiagnServi_TABROW_ResetOfModulParam_Start_Routine (DcmDspRoutine):
          DcmDspRequestResultsRoutineSupported = true
          DcmDspStopRoutineSupported = true
          DcmDspRoutineIdentifier = 779
          DcmDspRoutineFixedLength = false
          DcmDspRoutineUsePort = true
          DcmDspRoutineUsed = true
          DcmDspRoutineInfoRef = RoutineInfo_DiagnServi_TABROW_ResetOfModulParam_Start_Routine
        Data_TABROW_TABROSyste_Read_1_1_1_1_1_1_1_1_1_1_1_1_1_1_1 (DcmDspData):
          DcmDspDataSize = 192
          DcmDspDataType = UINT8_N
          DcmDspDataUsePort = USE_DATA_ASYNCH_CLIENT_SERVER
          DcmDspDataInfoRef = DataInfo_TABROW_TABROSyste_Read_1_1_1_1_1_1_1_1_1_1_1_1_1_1_1
        DataInfo_DiagnServi_TABROW_NeuMeasu_Read_8_2 (DcmDspDataInfo): DcmDspDataFixedLength=true
        DataInfo_DiagnServi_TABROW_NeuMeasu_Read_8_1 (DcmDspDataInfo): DcmDspDataFixedLength=true
        DID_DiagnServi_TABROW_NeuMeasu_Read (DcmDspDid):
          DcmDspDidIdentifier = 8726
          DcmDspDidUsed = true
          DcmDspDidUsePort = USE_DATA_ELEMENT_SPECIFIC_INTERFACES
          DcmDspDidInfoRef = DidInfo_DiagnServi_TABROW_NeuMeasu_Read
          DcmDspDidSignal: DcmDspDidDataPos=0, DcmDspDidDataRef=Data_DiagnServi_TABROW_NeuMeasu_Read
        DID_TABROW_TABROSyste_Read_1 (DcmDspDid):
          DcmDspDidIdentifier = 61842
          DcmDspDidUsed = true
          DcmDspDidUsePort = USE_DATA_ELEMENT_SPECIFIC_INTERFACES
          DcmDspDidInfoRef = DidInfo_TABROW_TABROSyste_Read_1
          DcmDspDidSignal: DcmDspDidDataPos=0, DcmDspDidDataRef=Data_TABROW_TABROSyste_Read_1
        Routine_DiagnServi_TABROW_UnlocProteOfVehicDiagn_Start_Routine (DcmDspRoutine):
          DcmDspRequestResultsRoutineSupported = false
          DcmDspStopRoutineSupported = false
          DcmDspRoutineIdentifier = 49156
          DcmDspRoutineFixedLength = false
          DcmDspRoutineUsePort = true
          DcmDspRoutineUsed = true
          DcmDspRoutineInfoRef = RoutineInfo_DiagnServi_TABROW_UnlocProteOfVehicDiagn_Start_Routine
        DataInfo_DiagnServi_TABROW_NeuMeasu_Read_63_1 (DcmDspDataInfo): DcmDspDataFixedLength=true
        4 x DcmDspDid, all with DcmDspDidUsed=true, DcmDspDidUsePort=USE_DATA_ELEMENT_SPECIFIC_INTERFACES:
          DID_Maximum_Charge_Voltage_Read_Data_By_Identifier: DcmDspDidIdentifier=20849, DcmDspDidInfoRef=DidInfo_Maximum_Charge_Voltage_Read_Data_By_Identifier
            DcmDspDidSignal: DcmDspDidDataPos=0, DcmDspDidDataRef=Data_Maximum_Charge_Voltage_Read_Data_By_Identifier
          DID_DiagnServi_TABROW_ECUSeriaNumbe_Read: DcmDspDidIdentifier=61836, DcmDspDidInfoRef=DidInfo_DiagnServi_TABROW_ECUSeriaNumbe_Read
            DcmDspDidSignal: DcmDspDidDataPos=0, DcmDspDidDataRef=Data_DiagnServi_TABROW_ECUSeriaNumbe_Read
          DID_TABROW_SOKVerifFaileList_Read_Data_By_Identifier: DcmDspDidIdentifier=395, DcmDspDidInfoRef=DidInfo_TABROW_SOKVerifFaileList_Read_Data_By_Identifier
            DcmDspDidSignal: DcmDspDidDataPos=0, DcmDspDidDataRef=Data_TABROW_SOKVerifFaileList_Read_Data_By_Identifier
          DID_DiagnServi_TABROW_VWCodinValue_Read: DcmDspDidIdentifier=1536, DcmDspDidInfoRef=DidInfo_DiagnServi_TABROW_VWCodinValue_Read
            DcmDspDidSignal: DcmDspDidDataPos=0, DcmDspDidDataRef=Data_DiagnServi_TABROW_VWCodinValue_Read
        Data_DiagnServi_TABROW_CalcuLOADValue_Read (DcmDspData):
          DcmDspDataSize = 8
          DcmDspDataType = UINT8_N
          DcmDspDataUsePort = USE_DATA_ASYNCH_CLIENT_SERVER
          DcmDspDataInfoRef = DataInfo_DiagnServi_TABROW_CalcuLOADValue_Read
        RoutineInfo_DiagnServi_TABROW_ResetOfContaError_Start_Routine (DcmDspRoutineInfo)
          DcmDspRoutineRequestResOut
            ResData (DcmDspRoutineRequestResOutSignal): DcmDspRoutineSignalLength=8, DcmDspRoutineSignalType=UINT8_N, DcmDspRoutineSignalEndianness=opaque, DcmDspRoutineSignalPos=0
          DcmDspRoutineAuthorization: DcmDspRoutineSessionRef=ST_Exten
          DcmDspRoutineStopOut
            ResData (DcmDspRoutineStopOutSignal): DcmDspRoutineSignalLength=8, DcmDspRoutineSignalType=UINT8_N, DcmDspRoutineSignalEndianness=opaque, DcmDspRoutineSignalPos=0
          DcmDspStartRoutineOut
            ResData (DcmDspStartRoutineOutSignal): DcmDspRoutineSignalLength=8, DcmDspRoutineSignalType=UINT8_N, DcmDspRoutineSignalEndianness=opaque, DcmDspRoutineSignalPos=0
        DidInfo_TABROW_TABROSyste_Read_1_1_1_1_1_1_1_1 (DcmDspDidInfo)
          DcmDspDidAccess
            DcmDspDidRead
        DataInfo_DiagnServi_TABROW_CalcuLOADValue_Read (DcmDspDataInfo): DcmDspDataFixedLength=true
        4 x DcmDspDid, all with DcmDspDidUsed=true, DcmDspDidUsePort=USE_DATA_ELEMENT_SPECIFIC_INTERFACES:
          DID_TABROW_TABROSyste_Read_4: DcmDspDidIdentifier=61845, DcmDspDidInfoRef=DidInfo_TABROW_TABROSyste_Read_4
            DcmDspDidSignal: DcmDspDidDataPos=0, DcmDspDidDataRef=Data_TABROW_TABROSyste_Read_4
          DID_TABROW_TABROSyste_Read_2: DcmDspDidIdentifier=61843, DcmDspDidInfoRef=DidInfo_TABROW_TABROSyste_Read_2
            DcmDspDidSignal: DcmDspDidDataPos=0, DcmDspDidDataRef=Data_TABROW_TABROSyste_Read_2
          DID_TABROW_TABROSyste_Read_3: DcmDspDidIdentifier=61844, DcmDspDidInfoRef=DidInfo_TABROW_TABROSyste_Read_3
            DcmDspDidSignal: DcmDspDidDataPos=0, DcmDspDidDataRef=Data_TABROW_TABROSyste_Read_3
          DID_DiagnServi_TABROW_NeuMeasu_Read_63_1: DcmDspDidIdentifier=57358, DcmDspDidInfoRef=DidInfo_DiagnServi_TABROW_NeuMeasu_Read_63_1
            DcmDspDidSignal: DcmDspDidDataPos=0, DcmDspDidDataRef=Data_DiagnServi_TABROW_NeuMeasu_Read_63_1
        DidInfo_DiagnServi_TABROW_NeuMeasu_Read_9_2_1_1 (DcmDspDidInfo)
          DcmDspDidAccess
            DcmDspDidRead: DcmDspDidReadSessionRef=ST_Defau, DcmDspDidReadSessionRef=ST_Exten
        DID_Charisma_requestet_driving_program_hv_battery_Read_Data_By_Identifier (DcmDspDid):
          DcmDspDidIdentifier = 9986
          DcmDspDidUsed = true
          DcmDspDidUsePort = USE_DATA_ELEMENT_SPECIFIC_INTERFACES
          DcmDspDidInfoRef = DidInfo_Charisma_requestet_driving_program_hv_battery_Read_Data_By_Identifier
          DcmDspDidSignal: DcmDspDidDataPos=0, DcmDspDidDataRef=Data_Charisma_requestet_driving_program_hv_battery_Read_Data_By_Identifier
        DataInfo_BMC_Mode_Read_Data_By_Identifier (DcmDspDataInfo): DcmDspDataFixedLength=true
        DID_DiagnServi_TABROW_NeuMeasu_Read_27_1_1 (DcmDspDid):
          DcmDspDidIdentifier = 1659
          DcmDspDidUsed = true
          DcmDspDidUsePort = USE_DATA_ELEMENT_SPECIFIC_INTERFACES
          DcmDspDidInfoRef = DidInfo_DiagnServi_TABROW_NeuMeasu_Read_27_1_1
          DcmDspDidSignal: DcmDspDidDataPos=0, DcmDspDidDataRef=Data_DiagnServi_TABROW_NeuMeasu_Read_27_1_1
        DataInfo_DiagnServi_TABROW_NeuMeasu_Read_30_1 (DcmDspDataInfo): DcmDspDataFixedLength=true
        DataInfo_DiagnServi_TABROW_NeuMeasu_Read_30_3 (DcmDspDataInfo): DcmDspDataFixedLength=true
        DID_DiagnServi_TABROW_NeuMeasu_Read_27_1_2 (DcmDspDid):
          DcmDspDidIdentifier = 57363
          DcmDspDidUsed = true
          DcmDspDidUsePort = USE_DATA_ELEMENT_SPECIFIC_INTERFACES
          DcmDspDidInfoRef = DidInfo_DiagnServi_TABROW_NeuMeasu_Read_27_1_2
          DcmDspDidSignal: DcmDspDidDataPos=0, DcmDspDidDataRef=Data_DiagnServi_TABROW_NeuMeasu_Read_27_1_2
        DataInfo_DiagnServi_TABROW_NeuMeasu_Read_30_2 (DcmDspDataInfo): DcmDspDataFixedLength=true
        DidInfo_TABROW_ECUStandMode1_Read (DcmDspDidInfo)
          DcmDspDidAccess
            DcmDspDidWrite: DcmDspDidWriteSessionRef=ST_Exten
            DcmDspDidRead: DcmDspDidReadSessionRef=ST_Defau, DcmDspDidReadSessionRef=ST_Exten
        5 x DcmDspDataInfo, all with DcmDspDataFixedLength=true:
          DataInfo_DiagnServi_TABROW_TimeSinceEnginStart_Read
          DataInfo_DiagnServi_TABROW_NeuMeasu_Read_27_1_1_1
          DataInfo_BMC_Hybrid_Kundendienstfehler_Read_Data_By_Identifier
          DataInfo_DiagnServi_TABROW_NeuMeasu_Read_27_1_1_2
          DataInfo_TABROW_VWECUHardwVersiNumbe_Read
        Data_DiagnServi_ReadDataByIdentVWLogicBlockDowngProteVersi (DcmDspData):
          DcmDspDataType = UINT8_N
          DcmDspDataSize = 65535
          DcmDspDataUsePort = USE_DATA_ASYNCH_CLIENT_SERVER
          DcmDspDataInfoRef = DataInfo_DiagnServi_ReadDataByIdentVWLogicBlockDowngProteVersi
        DidInfo_DiagnServi_TABROW_NeuMeasu_Read_46_1_1_1 (DcmDspDidInfo)
          DcmDspDidAccess
            DcmDspDidRead: DcmDspDidReadSessionRef=ST_Defau, DcmDspDidReadSessionRef=ST_Exten
        DidInfo_HV_battery_performance_indicator_charging_Read_Data_By_Identifier (DcmDspDidInfo)
          DcmDspDidAccess
            DcmDspDidRead: DcmDspDidReadSessionRef=ST_Defau, DcmDspDidReadSessionRef=ST_Exten
        DataInfo_DiagnServi_TABROW_NeuMeasu_Read_29_1_1_1_1_1 (DcmDspDataInfo): DcmDspDataFixedLength=true
        Data_DiagnServi_TABROW_NeuMeasu_Read_60_1 (DcmDspData):
          DcmDspDataSize = 16
          DcmDspDataType = UINT8_N
          DcmDspDataUsePort = USE_DATA_ASYNCH_CLIENT_SERVER
          DcmDspDataInfoRef = DataInfo_DiagnServi_TABROW_NeuMeasu_Read_60_1
        Routine_DiagnServi_TABROW_RequeLoggiDataOfProteOfVehicDiagn_Start_Routine (DcmDspRoutine):
          DcmDspRequestResultsRoutineSupported = false
          DcmDspStopRoutineSupported = false
          DcmDspRoutineIdentifier = 49161
          DcmDspRoutineFixedLength = false
          DcmDspRoutineUsePort = true
          DcmDspRoutineUsed = true
          DcmDspRoutineInfoRef = RoutineInfo_DiagnServi_TABROW_RequeLoggiDataOfProteOfVehicDiagn_Start_Routine
        Data_DiagnServi_TABROW_NeuMeasu_Read_60_3 (DcmDspData):
          DcmDspDataSize = 16
          DcmDspDataType = UINT8_N
          DcmDspDataUsePort = USE_DATA_ASYNCH_CLIENT_SERVER
          DcmDspDataInfoRef = DataInfo_DiagnServi_TABROW_NeuMeasu_Read_60_3
        DidInfo_DiagnServi_TABROW_Milea_Read (DcmDspDidInfo)
          DcmDspDidAccess
            DcmDspDidRead: DcmDspDidReadSessionRef=ST_Defau, DcmDspDidReadSessionRef=ST_Exten
        Data_Battery_technical_state_of_charge_Read_Data_By_Identifier (DcmDspData):
          DcmDspDataSize = 16
          DcmDspDataType = UINT8_N
          DcmDspDataUsePort = USE_DATA_ASYNCH_CLIENT_SERVER
          DcmDspDataInfoRef = DataInfo_Battery_technical_state_of_charge_Read_Data_By_Identifier
        Routine_DiagnServi_TABROW_CalcuIndivHashValue_Start_Routine (DcmDspRoutine):
          DcmDspRequestResultsRoutineSupported = false
          DcmDspStopRoutineSupported = false
          DcmDspRoutineIdentifier = 596
          DcmDspRoutineFixedLength = false
          DcmDspRoutineUsePort = true
          DcmDspRoutineUsed = true
          DcmDspRoutineInfoRef = RoutineInfo_DiagnServi_TABROW_CalcuIndivHashValue_Start_Routine
        DID_DiagnServi_TABROW_NeuMeasu_Read_43_1_1 (DcmDspDid):
          DcmDspDidIdentifier = 1391
          DcmDspDidUsed = true
          DcmDspDidUsePort = USE_DATA_ELEMENT_SPECIFIC_INTERFACES
          DcmDspDidInfoRef = DidInfo_DiagnServi_TABROW_NeuMeasu_Read_43_1_1
          DcmDspDidSignal: DcmDspDidDataPos=0, DcmDspDidDataRef=Data_DiagnServi_TABROW_NeuMeasu_Read_43_1_1
        DidInfo_DC_charging_station_actual_voltage_Read_Data_By_Identifier (DcmDspDidInfo)
          DcmDspDidAccess
            DcmDspDidRead: DcmDspDidReadSessionRef=ST_Defau, DcmDspDidReadSessionRef=ST_Exten
        Data_TABROW_TABROSyste_Read_1_1_1 (DcmDspData):
          DcmDspDataSize = 72
          DcmDspDataType = UINT8_N
          DcmDspDataUsePort = USE_DATA_ASYNCH_CLIENT_SERVER
          DcmDspDataInfoRef = DataInfo_TABROW_TABROSyste_Read_1_1_1
        DidInfo_DiagnServi_TABROW_ECUSeriaNumbe_Read (DcmDspDidInfo)
          DcmDspDidAccess
            DcmDspDidRead
        DidInfo_DiagnServi_TABROW_SysteSupplIdent_Read (DcmDspDidInfo)
          DcmDspDidAccess
            DcmDspDidRead: DcmDspDidReadSessionRef=ST_Defau, DcmDspDidReadSessionRef=ST_Exten
        DataInfo_DiagnServi_TABROW_NeuMeasu_Read_46_1_1 (DcmDspDataInfo): DcmDspDataFixedLength=true
        DataInfo_DiagnServi_ReadDataByIdentASAMODXFileIdent (DcmDspDataInfo): DcmDspDataFixedLength=false
        Routine_Get_Energy_from_SOC_Start_Routine (DcmDspRoutine):
          DcmDspRequestResultsRoutineSupported = true
          DcmDspStopRoutineSupported = true
          DcmDspRoutineIdentifier = 65278
          DcmDspRoutineFixedLength = false
          DcmDspRoutineUsePort = true
          DcmDspRoutineUsed = true
          DcmDspRoutineInfoRef = RoutineInfo_Get_Energy_from_SOC_Start_Routine
        DidInfo_TABROW_VWLogicSoftwBlockCountOfProgrAttem_Read (DcmDspDidInfo)
          DcmDspDidAccess
            DcmDspDidRead
        DID_DiagnServi_Type_number_assembly_Read (DcmDspDid):
          DcmDspDidIdentifier = 801
          DcmDspDidUsed = true
          DcmDspDidUsePort = USE_DATA_ELEMENT_SPECIFIC_INTERFACES
          DcmDspDidInfoRef = DidInfo_DiagnServi_Type_number_assembly_Read
          DcmDspDidSignal: DcmDspDidDataPos=0, DcmDspDidDataRef=Data_DiagnServi_Type_number_assembly_Read
        DataInfo_TABROW_CellVoltaMinim_ReadDataByIdent (DcmDspDataInfo): DcmDspDataFixedLength=true
        RoutineInfo_DiagnServi_TABROW_RequeDataOfProteOfVehicDiagn_Start_Routine (DcmDspRoutineInfo)
          DcmDspStartRoutineIn
            ReqData (DcmDspStartRoutineInSignal): DcmDspRoutineSignalLength=8, DcmDspRoutineSignalType=UINT8_N, DcmDspRoutineSignalEndianness=opaque, DcmDspRoutineSignalPos=0
          DcmDspRoutineAuthorization: DcmDspRoutineSessionRef=ST_Defau, DcmDspRoutineSessionRef=ST_Exten
          DcmDspStartRoutineOut
            ResData (DcmDspStartRoutineOutSignal): DcmDspRoutineSignalLength=3544, DcmDspRoutineSignalType=VARIABLE_LENGTH, DcmDspRoutineSignalEndianness=opaque, DcmDspRoutineSignalPos=0
        Routine_DiagnServi_TABROW_ResetOfContaError_Start_Routine (DcmDspRoutine):
          DcmDspRequestResultsRoutineSupported = true
          DcmDspStopRoutineSupported = true
          DcmDspRoutineIdentifier = 771
          DcmDspRoutineFixedLength = false
          DcmDspRoutineUsePort = true
          DcmDspRoutineUsed = true
          DcmDspRoutineInfoRef = RoutineInfo_DiagnServi_TABROW_ResetOfContaError_Start_Routine
        DidInfo_DiagnServi_TABROW_NeuMeasu_Read_7_1 (DcmDspDidInfo)
          DcmDspDidAccess
            DcmDspDidRead: DcmDspDidReadSessionRef=ST_Defau, DcmDspDidReadSessionRef=ST_Exten
        DID_TABROW_OBDType_Read (DcmDspDid): DcmDspDidIdentifier=718, DcmDspDidUsed=true, DcmDspDidUsePort=USE_DATA_ELEMENT_SPECIFIC_INTERFACES, DcmDspDidInfoRef=DidInfo_TABROW_OBDType_Read
          DcmDspDidSignal: DcmDspDidDataPos=0, DcmDspDidDataRef=Data_TABROW_OBDType_Read
        5 x DcmDspDidInfo:
          DidInfo_DiagnServi_TABROW_NeuMeasu_Read_29_1_1
            DcmDspDidAccess
              DcmDspDidRead: DcmDspDidReadSessionRef=ST_Defau, DcmDspDidReadSessionRef=ST_Exten
          DidInfo_DiagnServi_TABROW_NeuMeasu_Read_7_2
            DcmDspDidAccess
              DcmDspDidRead: DcmDspDidReadSessionRef=ST_Defau, DcmDspDidReadSessionRef=ST_Exten
          DidInfo_Battery_technical_state_of_charge_Read_Data_By_Identifier
            DcmDspDidAccess
              DcmDspDidRead: DcmDspDidReadSessionRef=ST_Defau, DcmDspDidReadSessionRef=ST_Exten
          DidInfo_TABROW_CellStateOfChargMaxim_ReadDataByIdent
            DcmDspDidAccess
              DcmDspDidRead: DcmDspDidReadSessionRef=ST_Defau, DcmDspDidReadSessionRef=ST_Exten
          DidInfo_Battery_banks_allowed_modes_Read_Data_By_Identifier
            DcmDspDidAccess
              DcmDspDidRead: DcmDspDidReadSessionRef=ST_Defau, DcmDspDidReadSessionRef=ST_Exten
        4 x DcmDspData, all with DcmDspDataType=UINT8_N, DcmDspDataUsePort=USE_DATA_ASYNCH_CLIENT_SERVER:
          Data_DiagnServi_TABROW_NeuMeasu_Read_29_1: DcmDspDataSize=96, DcmDspDataInfoRef=DataInfo_DiagnServi_TABROW_NeuMeasu_Read_29_1
          Data_DiagnServi_TABROW_NeuMeasu_Read_29_3: DcmDspDataSize=16, DcmDspDataInfoRef=DataInfo_DiagnServi_TABROW_NeuMeasu_Read_29_3
          Data_DiagnServi_TABROW_NeuMeasu_Read_29_2: DcmDspDataSize=16, DcmDspDataInfoRef=DataInfo_DiagnServi_TABROW_NeuMeasu_Read_29_2
          Data_Battery_amount_of_modules_Read_Data_By_Identifier: DcmDspDataSize=8, DcmDspDataInfoRef=DataInfo_Battery_amount_of_modules_Read_Data_By_Identifier
        RoutineInfo_TABROW_EndOfWritiSecurDataOfProteOfVehicDiagn_Start_Routine (DcmDspRoutineInfo)
          DcmDspStartRoutineIn
            ReqData (DcmDspStartRoutineInSignal): DcmDspRoutineSignalLength=8, DcmDspRoutineSignalType=UINT8_N, DcmDspRoutineSignalEndianness=opaque, DcmDspRoutineSignalPos=0
          DcmDspRoutineAuthorization: DcmDspRoutineSessionRef=ST_Exten
          DcmDspStartRoutineOut
            ResData (DcmDspStartRoutineOutSignal): DcmDspRoutineSignalLength=16, DcmDspRoutineSignalType=UINT8_N, DcmDspRoutineSignalEndianness=opaque, DcmDspRoutineSignalPos=0
        Data_DiagnServi_TABROW_NeuMeasu_Read_29_5 (DcmDspData):
          DcmDspDataSize = 32
          DcmDspDataType = UINT8_N
          DcmDspDataUsePort = USE_DATA_ASYNCH_CLIENT_SERVER
          DcmDspDataInfoRef = DataInfo_DiagnServi_TABROW_NeuMeasu_Read_29_5
        Data_DiagnServi_TABROW_NeuMeasu_Read_29_4 (DcmDspData):
          DcmDspDataSize = 16
          DcmDspDataType = UINT8_N
          DcmDspDataUsePort = USE_DATA_ASYNCH_CLIENT_SERVER
          DcmDspDataInfoRef = DataInfo_DiagnServi_TABROW_NeuMeasu_Read_29_4
        RoutineInfo_Get_Energy_from_SOC_Start_Routine (DcmDspRoutineInfo)
          DcmDspRoutineRequestResOut
            ResData (DcmDspRoutineRequestResOutSignal): DcmDspRoutineSignalLength=72, DcmDspRoutineSignalType=VARIABLE_LENGTH, DcmDspRoutineSignalEndianness=opaque, DcmDspRoutineSignalPos=0
          DcmDspStartRoutineIn
            ReqData (DcmDspStartRoutineInSignal): DcmDspRoutineSignalLength=144, DcmDspRoutineSignalType=VARIABLE_LENGTH, DcmDspRoutineSignalEndianness=opaque, DcmDspRoutineSignalPos=0
          DcmDspRoutineAuthorization: DcmDspRoutineSessionRef=ST_Defau, DcmDspRoutineSessionRef=ST_Exten
          DcmDspRoutineStopOut
            ResData (DcmDspRoutineStopOutSignal): DcmDspRoutineSignalLength=8, DcmDspRoutineSignalType=UINT8_N, DcmDspRoutineSignalEndianness=opaque, DcmDspRoutineSignalPos=0
          DcmDspStartRoutineOut
            ResData (DcmDspStartRoutineOutSignal): DcmDspRoutineSignalLength=8, DcmDspRoutineSignalType=UINT8_N, DcmDspRoutineSignalEndianness=opaque, DcmDspRoutineSignalPos=0
        RoutineInfo_DiagnServi_TABROW_ResetOfModulParam_Start_Routine (DcmDspRoutineInfo)
          DcmDspRoutineRequestResOut
            ResData (DcmDspRoutineRequestResOutSignal): DcmDspRoutineSignalLength=8, DcmDspRoutineSignalType=UINT8_N, DcmDspRoutineSignalEndianness=opaque, DcmDspRoutineSignalPos=0
          DcmDspStartRoutineIn
            ReqData (DcmDspStartRoutineInSignal): DcmDspRoutineSignalLength=8, DcmDspRoutineSignalType=UINT8_N, DcmDspRoutineSignalEndianness=opaque, DcmDspRoutineSignalPos=0
          DcmDspRoutineAuthorization: DcmDspRoutineSessionRef=ST_Exten
          DcmDspRoutineStopOut
            ResData (DcmDspRoutineStopOutSignal): DcmDspRoutineSignalLength=8, DcmDspRoutineSignalType=UINT8_N, DcmDspRoutineSignalEndianness=opaque, DcmDspRoutineSignalPos=0
          DcmDspStartRoutineOut
            ResData (DcmDspStartRoutineOutSignal): DcmDspRoutineSignalLength=8, DcmDspRoutineSignalType=UINT8_N, DcmDspRoutineSignalEndianness=opaque, DcmDspRoutineSignalPos=0
        Data_DiagnServi_TABROW_VWFAZITIdentStrin_Read (DcmDspData):
          DcmDspDataSize = 184
          DcmDspDataType = UINT8_N
          DcmDspDataUsePort = USE_DATA_ASYNCH_CLIENT_SERVER
          DcmDspDataInfoRef = DataInfo_DiagnServi_TABROW_VWFAZITIdentStrin_Read
        DidInfo_DiagnServi_TABROW_NeuMeasu_Read_29_1 (DcmDspDidInfo)
          DcmDspDidAccess
            DcmDspDidRead: DcmDspDidReadSessionRef=ST_Defau, DcmDspDidReadSessionRef=ST_Exten
        DidInfo_DiagnServi_TABROW_NeuMeasu_Read_29_3 (DcmDspDidInfo)
          DcmDspDidAccess
            DcmDspDidRead: DcmDspDidReadSessionRef=ST_Defau, DcmDspDidReadSessionRef=ST_Exten
        DID_TABROW_SOKMissiKeyList_Read_Data_By_Identifier (DcmDspDid):
          DcmDspDidIdentifier = 404
          DcmDspDidUsed = true
          DcmDspDidUsePort = USE_DATA_ELEMENT_SPECIFIC_INTERFACES
          DcmDspDidInfoRef = DidInfo_TABROW_SOKMissiKeyList_Read_Data_By_Identifier
          DcmDspDidSignal: DcmDspDidDataPos=0, DcmDspDidDataRef=Data_TABROW_SOKMissiKeyList_Read_Data_By_Identifier
        5 x DcmDspDidInfo:
          DidInfo_DiagnServi_TABROW_NeuMeasu_Read_29_2
            DcmDspDidAccess
              DcmDspDidRead: DcmDspDidReadSessionRef=ST_Defau, DcmDspDidReadSessionRef=ST_Exten
          DidInfo_DiagnServi_TABROW_NeuMeasu_Read_27_3_1_1
            DcmDspDidAccess
              DcmDspDidRead: DcmDspDidReadSessionRef=ST_Defau, DcmDspDidReadSessionRef=ST_Exten
          DidInfo_DiagnServi_TABROW_NeuMeasu_Read_29_5
            DcmDspDidAccess
              DcmDspDidRead: DcmDspDidReadSessionRef=ST_Defau, DcmDspDidReadSessionRef=ST_Exten
          DidInfo_DiagnServi_TABROW_NeuMeasu_Read_29_4
            DcmDspDidAccess
              DcmDspDidRead: DcmDspDidReadSessionRef=ST_Defau, DcmDspDidReadSessionRef=ST_Exten
          DidInfo_DiagnServi_TABROW_NeuMeasu_Read_27_1_1_1_1_1
            DcmDspDidAccess
              DcmDspDidRead: DcmDspDidReadSessionRef=ST_Defau, DcmDspDidReadSessionRef=ST_Exten
        DID_DiagnServi_TABROW_TABROFDSPr_Read (DcmDspDid):
          DcmDspDidIdentifier = 61909
          DcmDspDidUsed = true
          DcmDspDidUsePort = USE_DATA_ELEMENT_SPECIFIC_INTERFACES
          DcmDspDidInfoRef = DidInfo_DiagnServi_TABROW_TABROFDSPr_Read
          DcmDspDidSignal: DcmDspDidDataPos=0, DcmDspDidDataRef=Data_DiagnServi_TABROW_TABROFDSPr_Read
        DataInfo_DiagnServi_TABROW_CalibIdent_Read (DcmDspDataInfo): DcmDspDataFixedLength=false
        Routine_TABROW_EndOfWritiSecurDataOfProteOfVehicDiagn_Start_Routine (DcmDspRoutine):
          DcmDspRequestResultsRoutineSupported = false
          DcmDspStopRoutineSupported = false
          DcmDspRoutineIdentifier = 49170
          DcmDspRoutineFixedLength = false
          DcmDspRoutineUsePort = true
          DcmDspRoutineUsed = true
          DcmDspRoutineInfoRef = RoutineInfo_TABROW_EndOfWritiSecurDataOfProteOfVehicDiagn_Start_Routine
        DataInfo_HV_Spannung_Nebenverbraucher_Read_Data_By_Identifier (DcmDspDataInfo): DcmDspDataFixedLength=true
        Data_TABROW_SOKSignaFaileList_Read_Data_By_Identifier (DcmDspData):
          DcmDspDataSize = 4096
          DcmDspDataType = UINT8_N
          DcmDspDataUsePort = USE_DATA_ASYNCH_CLIENT_SERVER
          DcmDspDataInfoRef = DataInfo_TABROW_SOKSignaFaileList_Read_Data_By_Identifier
        DID_Battery_amount_of_modules_Read_Data_By_Identifier (DcmDspDid):
          DcmDspDidIdentifier = 796
          DcmDspDidUsed = true
          DcmDspDidUsePort = USE_DATA_ELEMENT_SPECIFIC_INTERFACES
          DcmDspDidInfoRef = DidInfo_Battery_amount_of_modules_Read_Data_By_Identifier
          DcmDspDidSignal: DcmDspDidDataPos=0, DcmDspDidDataRef=Data_Battery_amount_of_modules_Read_Data_By_Identifier
        DataInfo_DiagnServi_TABROW_AdaptOfChineSeriaNumbe_Read (DcmDspDataInfo): DcmDspDataFixedLength=true
        DidInfo_DiagnServi_TABROW_NeuMeasu_Read_9_2_1 (DcmDspDidInfo)
          DcmDspDidAccess
            DcmDspDidRead: DcmDspDidReadSessionRef=ST_Defau, DcmDspDidReadSessionRef=ST_Exten
        DID_DiagnServi_TABROW_EnginRPM_Read (DcmDspDid):
          DcmDspDidIdentifier = 62476
          DcmDspDidUsed = true
          DcmDspDidUsePort = USE_DATA_ELEMENT_SPECIFIC_INTERFACES
          DcmDspDidInfoRef = DidInfo_DiagnServi_TABROW_EnginRPM_Read
          DcmDspDidSignal: DcmDspDidDataPos=0, DcmDspDidDataRef=Data_DiagnServi_TABROW_EnginRPM_Read
        3 x DcmDspDidInfo:
          DidInfo_TABROW_CellStateOfChargMinim_ReadDataByIdent
            DcmDspDidAccess
              DcmDspDidRead: DcmDspDidReadSessionRef=ST_Defau, DcmDspDidReadSessionRef=ST_Exten
          DidInfo_TABROW_SOKVerifFaileList_Read_Data_By_Identifier
            DcmDspDidAccess
              DcmDspDidRead: DcmDspDidReadSessionRef=ST_Defau, DcmDspDidReadSessionRef=ST_Exten
          DidInfo_DiagnServi_ReadDataByIdentASAMODXFileVersi
            DcmDspDidAccess
              DcmDspDidRead
        DataInfo_TABROW_BMCHVKFehleInter_Read_Data_By_Identifier (DcmDspDataInfo): DcmDspDataFixedLength=true
        3 x DcmDspDid, all with DcmDspDidUsed=true, DcmDspDidUsePort=USE_DATA_ELEMENT_SPECIFIC_INTERFACES:
          DID_DiagnServi_TABROW_Produ_Read: DcmDspDidIdentifier=1278, DcmDspDidInfoRef=DidInfo_DiagnServi_TABROW_Produ_Read
            DcmDspDidSignal: DcmDspDidDataPos=0, DcmDspDidDataRef=Data_DiagnServi_TABROW_Produ_Read
          DID_Battery_contactors_actual_states_Read_Data_By_Identifier: DcmDspDidIdentifier=10006, DcmDspDidInfoRef=DidInfo_Battery_contactors_actual_states_Read_Data_By_Identifier
            DcmDspDidSignal: DcmDspDidDataPos=0, DcmDspDidDataRef=Data_Battery_contactors_actual_states_Read_Data_By_Identifier
          DID_DiagnServi_TABROW_NeuMeasu_Read_27_1_1_1: DcmDspDidIdentifier=1655, DcmDspDidInfoRef=DidInfo_DiagnServi_TABROW_NeuMeasu_Read_27_1_1_1
            DcmDspDidSignal: DcmDspDidDataPos=0, DcmDspDidDataRef=Data_DiagnServi_TABROW_NeuMeasu_Read_27_1_1_1
        DataInfo_DiagnServi_TABROW_TABROOBDDr_Read_Data_By_Identifier (DcmDspDataInfo): DcmDspDataFixedLength=true
        DID_DiagnServi_TABROW_NeuMeasu_Read_27_1_1_2 (DcmDspDid):
          DcmDspDidIdentifier = 57364
          DcmDspDidUsed = true
          DcmDspDidUsePort = USE_DATA_ELEMENT_SPECIFIC_INTERFACES
          DcmDspDidInfoRef = DidInfo_DiagnServi_TABROW_NeuMeasu_Read_27_1_1_2
          DcmDspDidSignal: DcmDspDidDataPos=0, DcmDspDidDataRef=Data_DiagnServi_TABROW_NeuMeasu_Read_27_1_1_2
        Data_DiagnServi_TABROW_ECUSeriaNumbe_Read (DcmDspData):
          DcmDspDataSize = 160
          DcmDspDataType = UINT8_N
          DcmDspDataUsePort = USE_DATA_ASYNCH_CLIENT_SERVER
          DcmDspDataInfoRef = DataInfo_DiagnServi_TABROW_ECUSeriaNumbe_Read
        DidInfo_TABROW_CellVoltaSum_ReadDataByIdent (DcmDspDidInfo)
          DcmDspDidAccess
            DcmDspDidRead: DcmDspDidReadSessionRef=ST_Defau, DcmDspDidReadSessionRef=ST_Exten
        DidInfo_Charisma_requestet_driving_program_hv_battery_Read_Data_By_Identifier (DcmDspDidInfo)
          DcmDspDidAccess
            DcmDspDidRead: DcmDspDidReadSessionRef=ST_Defau, DcmDspDidReadSessionRef=ST_Exten
        DID_TABROW_OBDClassDescr_Read_Data_By_Identifier (DcmDspDid):
          DcmDspDidIdentifier = 719
          DcmDspDidUsed = true
          DcmDspDidUsePort = USE_DATA_ELEMENT_SPECIFIC_INTERFACES
          DcmDspDidInfoRef = DidInfo_TABROW_OBDClassDescr_Read_Data_By_Identifier
          DcmDspDidSignal: DcmDspDidDataPos=0, DcmDspDidDataRef=Data_TABROW_OBDClassDescr_Read_Data_By_Identifier
        RoutineInfo_DiagnServi_TABROW_CalcuConfiStateFingeOfProteOfVehicDiagn_Start_Routine (DcmDspRoutineInfo)
          DcmDspStartRoutineIn
            ReqData (DcmDspStartRoutineInSignal): DcmDspRoutineSignalLength=4120, DcmDspRoutineSignalType=VARIABLE_LENGTH, DcmDspRoutineSignalEndianness=opaque, DcmDspRoutineSignalPos=0
          DcmDspRoutineAuthorization: DcmDspRoutineSessionRef=ST_Defau, DcmDspRoutineSessionRef=ST_Exten
          DcmDspStartRoutineOut
            ResData (DcmDspStartRoutineOutSignal): DcmDspRoutineSignalLength=272, DcmDspRoutineSignalType=VARIABLE_LENGTH, DcmDspRoutineSignalEndianness=opaque, DcmDspRoutineSignalPos=0
        Data_HV_coordinator_requestet_voltage_hv_battery_Read_Data_By_Identifier (DcmDspData):
          DcmDspDataSize = 8
          DcmDspDataType = UINT8_N
          DcmDspDataUsePort = USE_DATA_ASYNCH_CLIENT_SERVER
          DcmDspDataInfoRef = DataInfo_HV_coordinator_requestet_voltage_hv_battery_Read_Data_By_Identifier
        Data_DiagnServi_TABROW_NeuMeasu_Read_33_1_1_1_1_1_1_1_1_1_1_1_1_1_1_1_1_1_1_1_1_1_1_1_2_1_1_1 (DcmDspData):
          DcmDspDataSize = 384
          DcmDspDataType = UINT8_N
          DcmDspDataUsePort = USE_DATA_ASYNCH_CLIENT_SERVER
          DcmDspDataInfoRef = DataInfo_DiagnServi_TABROW_NeuMeasu_Read_33_1_1_1_1_1_1_1_1_1_1_1_1_1_1_1_1_1_1_1_1_1_1_1_2_1_1_1
        DID_DiagnServi_TABROW_TimeSinceEnginStart_Read (DcmDspDid):
          DcmDspDidIdentifier = 62495
          DcmDspDidUsed = true
          DcmDspDidUsePort = USE_DATA_ELEMENT_SPECIFIC_INTERFACES
          DcmDspDidInfoRef = DidInfo_DiagnServi_TABROW_TimeSinceEnginStart_Read
          DcmDspDidSignal: DcmDspDidDataPos=0, DcmDspDidDataRef=Data_DiagnServi_TABROW_TimeSinceEnginStart_Read
        DID_TABROW_TABROSyste_Read_1_1_1_1 (DcmDspDid):
          DcmDspDidIdentifier = 57394
          DcmDspDidUsed = true
          DcmDspDidUsePort = USE_DATA_ELEMENT_SPECIFIC_INTERFACES
          DcmDspDidInfoRef = DidInfo_TABROW_TABROSyste_Read_1_1_1_1
          DcmDspDidSignal: DcmDspDidDataPos=0, DcmDspDidDataRef=Data_TABROW_TABROSyste_Read_1_1_1_1
        DataInfo_TABROW_TABROSyste_Read_4 (DcmDspDataInfo): DcmDspDataFixedLength=true
        3 x DcmDspDidInfo:
          DidInfo_DiagnServi_TABROW_NeuMeasu_Read_57_13
            DcmDspDidAccess
              DcmDspDidRead: DcmDspDidReadSessionRef=ST_Defau, DcmDspDidReadSessionRef=ST_Exten
          DidInfo_DiagnServi_TABROW_NeuMeasu_Read_57_11
            DcmDspDidAccess
              DcmDspDidRead: DcmDspDidReadSessionRef=ST_Defau, DcmDspDidReadSessionRef=ST_Exten
          DidInfo_DiagnServi_TABROW_NeuMeasu_Read_33_1_1_1_1_1_1_1_1_1_1_1_1_1_1_1_1_1_1_1_1_1_1_1_2_1_1_1
            DcmDspDidAccess
              DcmDspDidRead: DcmDspDidReadSessionRef=ST_Defau, DcmDspDidReadSessionRef=ST_Exten
        DID_DiagnServi_TABROW_NeuMeasu_Read_32 (DcmDspDid):
          DcmDspDidIdentifier = 1649
          DcmDspDidUsed = true
          DcmDspDidUsePort = USE_DATA_ELEMENT_SPECIFIC_INTERFACES
          DcmDspDidInfoRef = DidInfo_DiagnServi_TABROW_NeuMeasu_Read_32
          DcmDspDidSignal: DcmDspDidDataPos=0, DcmDspDidDataRef=Data_DiagnServi_TABROW_NeuMeasu_Read_32
        DID_DiagnServi_TABROW_NeuMeasu_Read_31 (DcmDspDid):
          DcmDspDidIdentifier = 1650
          DcmDspDidUsed = true
          DcmDspDidUsePort = USE_DATA_ELEMENT_SPECIFIC_INTERFACES
          DcmDspDidInfoRef = DidInfo_DiagnServi_TABROW_NeuMeasu_Read_31
          DcmDspDidSignal: DcmDspDidDataPos=0, DcmDspDidDataRef=Data_DiagnServi_TABROW_NeuMeasu_Read_31
        DataInfo_TABROW_TABROSyste_Read_1 (DcmDspDataInfo): DcmDspDataFixedLength=true
        DidInfo_DiagnServi_TABROW_NeuMeasu_Read_57_14 (DcmDspDidInfo)
          DcmDspDidAccess
            DcmDspDidRead: DcmDspDidReadSessionRef=ST_Defau, DcmDspDidReadSessionRef=ST_Exten
        DID_DiagnServi_TABROW_NeuMeasu_Read_30 (DcmDspDid):
          DcmDspDidIdentifier = 1652
          DcmDspDidUsed = true
          DcmDspDidUsePort = USE_DATA_ELEMENT_SPECIFIC_INTERFACES
          DcmDspDidInfoRef = DidInfo_DiagnServi_TABROW_NeuMeasu_Read_30
          DcmDspDidSignal: DcmDspDidDataPos=0, DcmDspDidDataRef=Data_DiagnServi_TABROW_NeuMeasu_Read_30
        DataInfo_TABROW_TABROSyste_Read_2 (DcmDspDataInfo): DcmDspDataFixedLength=true
        DataInfo_TABROW_StateOfBatteShutoCrash_ReadDataByIdent (DcmDspDataInfo): DcmDspDataFixedLength=true
        DidInfo_TABROW_BatteTempeMinim_ReadDataByIdent (DcmDspDidInfo)
          DcmDspDidAccess
            DcmDspDidRead: DcmDspDidReadSessionRef=ST_Defau, DcmDspDidReadSessionRef=ST_Exten
        DataInfo_TABROW_TABROSyste_Read_3 (DcmDspDataInfo): DcmDspDataFixedLength=true
        8 x DcmDspDid, all with DcmDspDidUsed=true, DcmDspDidUsePort=USE_DATA_ELEMENT_SPECIFIC_INTERFACES:
          DID_DiagnServi_TABROW_NeuMeasu_Read_28_2: DcmDspDidIdentifier=20686, DcmDspDidInfoRef=DidInfo_DiagnServi_TABROW_NeuMeasu_Read_28_2
            DcmDspDidSignal: DcmDspDidDataPos=0, DcmDspDidDataRef=Data_DiagnServi_TABROW_NeuMeasu_Read_28_2
          DID_DiagnServi_TABROW_NeuMeasu_Read_28_1: DcmDspDidIdentifier=1739, DcmDspDidInfoRef=DidInfo_DiagnServi_TABROW_NeuMeasu_Read_28_1
            DcmDspDidSignal: DcmDspDidDataPos=0, DcmDspDidDataRef=Data_DiagnServi_TABROW_NeuMeasu_Read_28_1
          DID_DiagnServi_TABROW_NeuMeasu_Read_28_4: DcmDspDidIdentifier=57370, DcmDspDidInfoRef=DidInfo_DiagnServi_TABROW_NeuMeasu_Read_28_4
            DcmDspDidSignal: DcmDspDidDataPos=0, DcmDspDidDataRef=Data_DiagnServi_TABROW_NeuMeasu_Read_28_4
          DID_TABROW_StatuECUStandMode_Read: DcmDspDidIdentifier=49409, DcmDspDidInfoRef=DidInfo_TABROW_StatuECUStandMode_Read
            DcmDspDidSignal: DcmDspDidDataPos=0, DcmDspDidDataRef=Data_TABROW_StatuECUStandMode_Read
          DID_DiagnServi_TABROW_NeuMeasu_Read_28_3: DcmDspDidIdentifier=57354, DcmDspDidInfoRef=DidInfo_DiagnServi_TABROW_NeuMeasu_Read_28_3
            DcmDspDidSignal: DcmDspDidDataPos=0, DcmDspDidDataRef=Data_DiagnServi_TABROW_NeuMeasu_Read_28_3
          DID_DiagnServi_TABROW_NeuMeasu_Read_28_6: DcmDspDidIdentifier=57345, DcmDspDidInfoRef=DidInfo_DiagnServi_TABROW_NeuMeasu_Read_28_6
            DcmDspDidSignal: DcmDspDidDataPos=0, DcmDspDidDataRef=Data_DiagnServi_TABROW_NeuMeasu_Read_28_6
          DID_DiagnServi_TABROW_NeuMeasu_Read_28_5: DcmDspDidIdentifier=57369, DcmDspDidInfoRef=DidInfo_DiagnServi_TABROW_NeuMeasu_Read_28_5
            DcmDspDidSignal: DcmDspDidDataPos=0, DcmDspDidDataRef=Data_DiagnServi_TABROW_NeuMeasu_Read_28_5
          DID_DiagnServi_TABROW_NeuMeasu_Read_33_1_1_1_1_1_1_1_1_1_1_1_1_1_1_1_1_1_1_1_1_1_1_1_2_1: DcmDspDidIdentifier=1355, DcmDspDidInfoRef=DidInfo_DiagnServi_TABROW_NeuMeasu_Read_33_1_1_1_1_1_1_1_1_1_1_1_1_1_1_1_1_1_1_1_1_1_1_1_2_1
            DcmDspDidSignal: DcmDspDidDataPos=0, DcmDspDidDataRef=Data_DiagnServi_TABROW_NeuMeasu_Read_33_1_1_1_1_1_1_1_1_1_1_1_1_1_1_1_1_1_1_1_1_1_1_1_2_1
        DidInfo_TABROW_VWSysteNameOrEnginType_Read (DcmDspDidInfo)
          DcmDspDidAccess
            DcmDspDidRead: DcmDspDidReadSessionRef=ST_Defau, DcmDspDidReadSessionRef=ST_Exten
        DataInfo_DiagnServi_TABROW_SysteSupplIdent_Read (DcmDspDataInfo): DcmDspDataFixedLength=false
        DidInfo_DiagnServi_TABROW_DID0x0EF_Read (DcmDspDidInfo)
          DcmDspDidAccess
            DcmDspDidRead: DcmDspDidReadSessionRef=ST_Defau, DcmDspDidReadSessionRef=ST_Exten
        DidInfo_DiagnServi_BMCE_part_number_Read (DcmDspDidInfo)
          DcmDspDidAccess
            DcmDspDidWrite: DcmDspDidWriteSessionRef=ST_Exten
            DcmDspDidRead: DcmDspDidReadSessionRef=ST_Defau, DcmDspDidReadSessionRef=ST_Exten
        4 x DcmDspDid, all with DcmDspDidUsed=true, DcmDspDidUsePort=USE_DATA_ELEMENT_SPECIFIC_INTERFACES:
          DID_TABROW_TABROVWDat_Read_1: DcmDspDidIdentifier=61857, DcmDspDidInfoRef=DidInfo_TABROW_TABROVWDat_Read_1
            DcmDspDidSignal: DcmDspDidDataPos=0, DcmDspDidDataRef=Data_TABROW_TABROVWDat_Read_1
          DID_DiagnServi_TABROW_NeuMeasu_Read_36: DcmDspDidIdentifier=1735, DcmDspDidInfoRef=DidInfo_DiagnServi_TABROW_NeuMeasu_Read_36
            DcmDspDidSignal: DcmDspDidDataPos=0, DcmDspDidDataRef=Data_DiagnServi_TABROW_NeuMeasu_Read_36
          DID_DiagnServi_TABROW_NeuMeasu_Read_35: DcmDspDidIdentifier=1410, DcmDspDidInfoRef=DidInfo_DiagnServi_TABROW_NeuMeasu_Read_35
            DcmDspDidSignal: DcmDspDidDataPos=0, DcmDspDidDataRef=Data_DiagnServi_TABROW_NeuMeasu_Read_35
          DID_DiagnServi_TABROW_NeuMeasu_Read_34: DcmDspDidIdentifier=1297, DcmDspDidInfoRef=DidInfo_DiagnServi_TABROW_NeuMeasu_Read_34
            DcmDspDidSignal: DcmDspDidDataPos=0, DcmDspDidDataRef=Data_DiagnServi_TABROW_NeuMeasu_Read_34
        DataInfo_TABROW_SOKGenerInfor_Read_Data_By_Identifier (DcmDspDataInfo): DcmDspDataFixedLength=true
        9 x DcmDspDid, all with DcmDspDidUsed=true, DcmDspDidUsePort=USE_DATA_ELEMENT_SPECIFIC_INTERFACES:
          DID_DiagnServi_TABROW_NeuMeasu_Read_33: DcmDspDidIdentifier=1645, DcmDspDidInfoRef=DidInfo_DiagnServi_TABROW_NeuMeasu_Read_33
            DcmDspDidSignal: DcmDspDidDataPos=0, DcmDspDidDataRef=Data_DiagnServi_TABROW_NeuMeasu_Read_33
          DID_DiagnServi_TABROW_NeuMeasu_Read_39: DcmDspDidIdentifier=1404, DcmDspDidInfoRef=DidInfo_DiagnServi_TABROW_NeuMeasu_Read_39
            DcmDspDidSignal: DcmDspDidDataPos=0, DcmDspDidDataRef=Data_DiagnServi_TABROW_NeuMeasu_Read_39
          DID_DiagnServi_TABROW_NeuMeasu_Read_38: DcmDspDidIdentifier=1406, DcmDspDidInfoRef=DidInfo_DiagnServi_TABROW_NeuMeasu_Read_38
            DcmDspDidSignal: DcmDspDidDataPos=0, DcmDspDidDataRef=Data_DiagnServi_TABROW_NeuMeasu_Read_38
          DID_DiagnServi_TABROW_NeuMeasu_Read_37: DcmDspDidIdentifier=1413, DcmDspDidInfoRef=DidInfo_DiagnServi_TABROW_NeuMeasu_Read_37
            DcmDspDidSignal: DcmDspDidDataPos=0, DcmDspDidDataRef=Data_DiagnServi_TABROW_NeuMeasu_Read_37
          DID_DiagnServi_TABROW_NeuMeasu_Read_46_1_1_1_1_1_1_2: DcmDspDidIdentifier=1465, DcmDspDidInfoRef=DidInfo_DiagnServi_TABROW_NeuMeasu_Read_46_1_1_1_1_1_1_2
            DcmDspDidSignal: DcmDspDidDataPos=0, DcmDspDidDataRef=Data_DiagnServi_TABROW_NeuMeasu_Read_46_1_1_1_1_1_1_2
          DID_DiagnServi_TABROW_NeuMeasu_Read_46_1_1_1_1_1_1_1: DcmDspDidIdentifier=1464, DcmDspDidInfoRef=DidInfo_DiagnServi_TABROW_NeuMeasu_Read_46_1_1_1_1_1_1_1
            DcmDspDidSignal: DcmDspDidDataPos=0, DcmDspDidDataRef=Data_DiagnServi_TABROW_NeuMeasu_Read_46_1_1_1_1_1_1_1
          DID_DiagnServi_TABROW_NeuMeasu_Read_43: DcmDspDidIdentifier=1393, DcmDspDidInfoRef=DidInfo_DiagnServi_TABROW_NeuMeasu_Read_43
            DcmDspDidSignal: DcmDspDidDataPos=0, DcmDspDidDataRef=Data_DiagnServi_TABROW_NeuMeasu_Read_43
          DID_DiagnServi_TABROW_NeuMeasu_Read_42: DcmDspDidIdentifier=1412, DcmDspDidInfoRef=DidInfo_DiagnServi_TABROW_NeuMeasu_Read_42
            DcmDspDidSignal: DcmDspDidDataPos=0, DcmDspDidDataRef=Data_DiagnServi_TABROW_NeuMeasu_Read_42
          DID_DiagnServi_TABROW_NeuMeasu_Read_41: DcmDspDidIdentifier=1402, DcmDspDidInfoRef=DidInfo_DiagnServi_TABROW_NeuMeasu_Read_41
            DcmDspDidSignal: DcmDspDidDataPos=0, DcmDspDidDataRef=Data_DiagnServi_TABROW_NeuMeasu_Read_41
        DataInfo_DiagnServi_TABROW_NeuMeasu_Read_43_1 (DcmDspDataInfo): DcmDspDataFixedLength=true
        DID_DiagnServi_TABROW_NeuMeasu_Read_40 (DcmDspDid):
          DcmDspDidIdentifier = 1403
          DcmDspDidUsed = true
          DcmDspDidUsePort = USE_DATA_ELEMENT_SPECIFIC_INTERFACES
          DcmDspDidInfoRef = DidInfo_DiagnServi_TABROW_NeuMeasu_Read_40
          DcmDspDidSignal: DcmDspDidDataPos=0, DcmDspDidDataRef=Data_DiagnServi_TABROW_NeuMeasu_Read_40
        Data_Minimum_Discharge_Voltage_Read_Data_By_Identifier (DcmDspData):
          DcmDspDataSize = 16
          DcmDspDataType = UINT8_N
          DcmDspDataUsePort = USE_DATA_ASYNCH_CLIENT_SERVER
          DcmDspDataInfoRef = DataInfo_Minimum_Discharge_Voltage_Read_Data_By_Identifier
        DID_DiagnServi_Assembly_part_number_Read (DcmDspDid):
          DcmDspDidIdentifier = 810
          DcmDspDidUsed = true
          DcmDspDidUsePort = USE_DATA_ELEMENT_SPECIFIC_INTERFACES
          DcmDspDidInfoRef = DidInfo_DiagnServi_Assembly_part_number_Read
          DcmDspDidSignal: DcmDspDidDataPos=0, DcmDspDidDataRef=Data_DiagnServi_Assembly_part_number_Read
        DataInfo_TABROW_StateOfBatteMIL_ReadDataByIdent (DcmDspDataInfo): DcmDspDataFixedLength=true
        3 x DcmDspDid, all with DcmDspDidUsed=true, DcmDspDidUsePort=USE_DATA_ELEMENT_SPECIFIC_INTERFACES:
          DID_DiagnServi_TABROW_NeuMeasu_Read_47: DcmDspDidIdentifier=1395, DcmDspDidInfoRef=DidInfo_DiagnServi_TABROW_NeuMeasu_Read_47
            DcmDspDidSignal: DcmDspDidDataPos=0, DcmDspDidDataRef=Data_DiagnServi_TABROW_NeuMeasu_Read_47
          DID_DiagnServi_TABROW_NeuMeasu_Read_46: DcmDspDidIdentifier=1457, DcmDspDidInfoRef=DidInfo_DiagnServi_TABROW_NeuMeasu_Read_46
            DcmDspDidSignal: DcmDspDidDataPos=0, DcmDspDidDataRef=Data_DiagnServi_TABROW_NeuMeasu_Read_46
          DID_DiagnServi_TABROW_NeuMeasu_Read_45: DcmDspDidIdentifier=1469, DcmDspDidInfoRef=DidInfo_DiagnServi_TABROW_NeuMeasu_Read_45
            DcmDspDidSignal: DcmDspDidDataPos=0, DcmDspDidDataRef=Data_DiagnServi_TABROW_NeuMeasu_Read_45
        DidInfo_DiagnServi_TABROW_ProduDeact_Read (DcmDspDidInfo)
          DcmDspDidAccess
            DcmDspDidWrite: DcmDspDidWriteSessionRef=ST_Exten
            DcmDspDidRead: DcmDspDidReadSessionRef=ST_Defau, DcmDspDidReadSessionRef=ST_Exten
        DidInfo_DiagnServi_TABROW_VehicSpeedSenso_Read (DcmDspDidInfo)
          DcmDspDidAccess
            DcmDspDidRead: DcmDspDidReadSessionRef=ST_Defau, DcmDspDidReadSessionRef=ST_Exten
        4 x DcmDspDid, all with DcmDspDidUsed=true, DcmDspDidUsePort=USE_DATA_ELEMENT_SPECIFIC_INTERFACES:
          DID_DiagnServi_TABROW_NeuMeasu_Read_49: DcmDspDidIdentifier=1396, DcmDspDidInfoRef=DidInfo_DiagnServi_TABROW_NeuMeasu_Read_49
            DcmDspDidSignal: DcmDspDidDataPos=0, DcmDspDidDataRef=Data_DiagnServi_TABROW_NeuMeasu_Read_49
          DID_DiagnServi_TABROW_NeuMeasu_Read_48: DcmDspDidIdentifier=1380, DcmDspDidInfoRef=DidInfo_DiagnServi_TABROW_NeuMeasu_Read_48
            DcmDspDidSignal: DcmDspDidDataPos=0, DcmDspDidDataRef=Data_DiagnServi_TABROW_NeuMeasu_Read_48
          DID_DiagnServi_TABROW_TABROECUPr_Read: DcmDspDidIdentifier=61919, DcmDspDidInfoRef=DidInfo_DiagnServi_TABROW_TABROECUPr_Read
            DcmDspDidSignal: DcmDspDidDataPos=0, DcmDspDidDataRef=Data_DiagnServi_TABROW_TABROECUPr_Read
          DID_TABROW_TABROSyste_Read_1_1_1_1_1_1_1_1_1_1_1_1: DcmDspDidIdentifier=57402, DcmDspDidInfoRef=DidInfo_TABROW_TABROSyste_Read_1_1_1_1_1_1_1_1_1_1_1_1
            DcmDspDidSignal: DcmDspDidDataPos=0, DcmDspDidDataRef=Data_TABROW_TABROSyste_Read_1_1_1_1_1_1_1_1_1_1_1_1
        DataInfo_DiagnServi_TABROW_NeuMeasu_Read_43_1_1 (DcmDspDataInfo): DcmDspDataFixedLength=true
        DID_DiagnServi_TABROW_NeuMeasu_Read_10 (DcmDspDid):
          DcmDspDidIdentifier = 1424
          DcmDspDidUsed = true
          DcmDspDidUsePort = USE_DATA_ELEMENT_SPECIFIC_INTERFACES
          DcmDspDidInfoRef = DidInfo_DiagnServi_TABROW_NeuMeasu_Read_10
          DcmDspDidSignal: DcmDspDidDataPos=0, DcmDspDidDataRef=Data_DiagnServi_TABROW_NeuMeasu_Read_10
        DID_DiagnServi_TABROW_NeuMeasu_Read_43_1_1_1_1_1_1_1_1_1_1_1 (DcmDspDid):
          DcmDspDidIdentifier = 1382
          DcmDspDidUsed = true
          DcmDspDidUsePort = USE_DATA_ELEMENT_SPECIFIC_INTERFACES
          DcmDspDidInfoRef = DidInfo_DiagnServi_TABROW_NeuMeasu_Read_43_1_1_1_1_1_1_1_1_1_1_1
          DcmDspDidSignal: DcmDspDidDataPos=0, DcmDspDidDataRef=Data_DiagnServi_TABROW_NeuMeasu_Read_43_1_1_1_1_1_1_1_1_1_1_1
        DataInfo_HV_battery_performance_indicator_discharging_Read_Data_By_Identifier (DcmDspDataInfo): DcmDspDataFixedLength=true
        DataInfo_DiagnServi_TABROW_ECUNA_Read (DcmDspDataInfo): DcmDspDataFixedLength=true
        DID_Minimum_Discharge_Voltage_Read_Data_By_Identifier (DcmDspDid):
          DcmDspDidIdentifier = 20848
          DcmDspDidUsed = true
          DcmDspDidUsePort = USE_DATA_ELEMENT_SPECIFIC_INTERFACES
          DcmDspDidInfoRef = DidInfo_Minimum_Discharge_Voltage_Read_Data_By_Identifier
          DcmDspDidSignal: DcmDspDidDataPos=0, DcmDspDidDataRef=Data_Minimum_Discharge_Voltage_Read_Data_By_Identifier
        DID_DiagnServi_TABROW_NeuMeasu_Read_19 (DcmDspDid):
          DcmDspDidIdentifier = 1409
          DcmDspDidUsed = true
          DcmDspDidUsePort = USE_DATA_ELEMENT_SPECIFIC_INTERFACES
          DcmDspDidInfoRef = DidInfo_DiagnServi_TABROW_NeuMeasu_Read_19
          DcmDspDidSignal: DcmDspDidDataPos=0, DcmDspDidDataRef=Data_DiagnServi_TABROW_NeuMeasu_Read_19
        Data_TABROW_KnockTestMode_Read (DcmDspData):
          DcmDspDataSize = 8
          DcmDspDataType = UINT8_N
          DcmDspDataUsePort = USE_DATA_SYNCH_FNC
          DcmDspDataConditionCheckReadFncUsed = true
          DcmDspDataConditionCheckReadFnc = CddNpmGen2_Check_Read_Ident_KnockoutTestMode
          DcmDspDataReadFnc = CddNpmGen2_Read_Ident_KnockoutTestMode
          DcmDspDataWriteFnc = CddNpmGen2_Write_Ident_KnockoutTestMode
          DcmDspDataInfoRef = DataInfo_TABROW_KnockTestMode_Read
        Routine_DiagnServi_TABROW_NeuRoutiBasicSetti_Start_Routine_4_2 (DcmDspRoutine):
          DcmDspRequestResultsRoutineSupported = true
          DcmDspStopRoutineSupported = true
          DcmDspRoutineIdentifier = 790
          DcmDspRoutineFixedLength = false
          DcmDspRoutineUsePort = true
          DcmDspRoutineUsed = true
          DcmDspRoutineInfoRef = RoutineInfo_DiagnServi_TABROW_NeuRoutiBasicSetti_Start_Routine_4_2
        DID_DiagnServi_TABROW_NeuMeasu_Read_14 (DcmDspDid):
          DcmDspDidIdentifier = 61938
          DcmDspDidUsed = true
          DcmDspDidUsePort = USE_DATA_ELEMENT_SPECIFIC_INTERFACES
          DcmDspDidInfoRef = DidInfo_DiagnServi_TABROW_NeuMeasu_Read_14
          DcmDspDidSignal: DcmDspDidDataPos=0, DcmDspDidDataRef=Data_DiagnServi_TABROW_NeuMeasu_Read_14
        DID_DiagnServi_TABROW_NeuMeasu_Read_70_1 (DcmDspDid):
          DcmDspDidIdentifier = 1724
          DcmDspDidUsed = true
          DcmDspDidUsePort = USE_DATA_ELEMENT_SPECIFIC_INTERFACES
          DcmDspDidInfoRef = DidInfo_DiagnServi_TABROW_NeuMeasu_Read_70_1
          DcmDspDidSignal: DcmDspDidDataPos=0, DcmDspDidDataRef=Data_DiagnServi_TABROW_NeuMeasu_Read_70_1
        DidInfo_TABROW_InUseMonitPerfoRatio_Read_Data_By_Identifier (DcmDspDidInfo)
          DcmDspDidAccess
            DcmDspDidRead: DcmDspDidReadSessionRef=ST_Defau, DcmDspDidReadSessionRef=ST_Exten
        7 x DcmDspDid, all with DcmDspDidUsed=true, DcmDspDidUsePort=USE_DATA_ELEMENT_SPECIFIC_INTERFACES:
          DID_DiagnServi_TABROW_NeuMeasu_Read_13: DcmDspDidIdentifier=1405, DcmDspDidInfoRef=DidInfo_DiagnServi_TABROW_NeuMeasu_Read_13
            DcmDspDidSignal: DcmDspDidDataPos=0, DcmDspDidDataRef=Data_DiagnServi_TABROW_NeuMeasu_Read_13
          DID_DiagnServi_TABROW_NeuMeasu_Read_12: DcmDspDidIdentifier=1419, DcmDspDidInfoRef=DidInfo_DiagnServi_TABROW_NeuMeasu_Read_12
            DcmDspDidSignal: DcmDspDidDataPos=0, DcmDspDidDataRef=Data_DiagnServi_TABROW_NeuMeasu_Read_12
          DID_DiagnServi_TABROW_NeuMeasu_Read_11: DcmDspDidIdentifier=1421, DcmDspDidInfoRef=DidInfo_DiagnServi_TABROW_NeuMeasu_Read_11
            DcmDspDidSignal: DcmDspDidDataPos=0, DcmDspDidDataRef=Data_DiagnServi_TABROW_NeuMeasu_Read_11
          DID_DiagnServi_TABROW_NeuMeasu_Read_18: DcmDspDidIdentifier=1431, DcmDspDidInfoRef=DidInfo_DiagnServi_TABROW_NeuMeasu_Read_18
            DcmDspDidSignal: DcmDspDidDataPos=0, DcmDspDidDataRef=Data_DiagnServi_TABROW_NeuMeasu_Read_18
          DID_DiagnServi_TABROW_NeuMeasu_Read_17: DcmDspDidIdentifier=1434, DcmDspDidInfoRef=DidInfo_DiagnServi_TABROW_NeuMeasu_Read_17
            DcmDspDidSignal: DcmDspDidDataPos=0, DcmDspDidDataRef=Data_DiagnServi_TABROW_NeuMeasu_Read_17
          DID_DiagnServi_TABROW_NeuMeasu_Read_16: DcmDspDidIdentifier=1411, DcmDspDidInfoRef=DidInfo_DiagnServi_TABROW_NeuMeasu_Read_16
            DcmDspDidSignal: DcmDspDidDataPos=0, DcmDspDidDataRef=Data_DiagnServi_TABROW_NeuMeasu_Read_16
          DID_DiagnServi_TABROW_NeuMeasu_Read_15: DcmDspDidIdentifier=1632, DcmDspDidInfoRef=DidInfo_DiagnServi_TABROW_NeuMeasu_Read_15
            DcmDspDidSignal: DcmDspDidDataPos=0, DcmDspDidDataRef=Data_DiagnServi_TABROW_NeuMeasu_Read_15
        DataInfo_DiagnServi_TABROW_NeuMeasu_Read_21_2 (DcmDspDataInfo): DcmDspDataFixedLength=true
        DataInfo_HV_battery_performance_indicator_charging_Read_Data_By_Identifier (DcmDspDataInfo): DcmDspDataFixedLength=true
        DID_DiagnServi_TABROW_NeuMeasu_Read_27_2_1_1 (DcmDspDid):
          DcmDspDidIdentifier = 1654
          DcmDspDidUsed = true
          DcmDspDidUsePort = USE_DATA_ELEMENT_SPECIFIC_INTERFACES
          DcmDspDidInfoRef = DidInfo_DiagnServi_TABROW_NeuMeasu_Read_27_2_1_1
          DcmDspDidSignal: DcmDspDidDataPos=0, DcmDspDidDataRef=Data_DiagnServi_TABROW_NeuMeasu_Read_27_2_1_1
        DataInfo_TABROW_VkmsMissiKeyHisto_Read_Data_By_Identifier (DcmDspDataInfo): DcmDspDataFixedLength=false
        Data_TABROW_VWLogicSoftwBlockCountOfProgrAttem_Read (DcmDspData):
          DcmDspDataType = UINT8_N
          DcmDspDataSize = 65535
          DcmDspDataUsePort = USE_DATA_ASYNCH_CLIENT_SERVER
          DcmDspDataInfoRef = DataInfo_TABROW_VWLogicSoftwBlockCountOfProgrAttem_Read
        DID_DiagnServi_TABROW_NeuMeasu_Read_20 (DcmDspDid):
          DcmDspDidIdentifier = 1397
          DcmDspDidUsed = true
          DcmDspDidUsePort = USE_DATA_ELEMENT_SPECIFIC_INTERFACES
          DcmDspDidInfoRef = DidInfo_DiagnServi_TABROW_NeuMeasu_Read_20
          DcmDspDidSignal: DcmDspDidDataPos=0, DcmDspDidDataRef=Data_DiagnServi_TABROW_NeuMeasu_Read_20
        DataInfo_DiagnServi_TABROW_NeuMeasu_Read_21_1 (DcmDspDataInfo): DcmDspDataFixedLength=true
        DID_DiagnServi_Assembly_production_data_Read (DcmDspDid):
          DcmDspDidIdentifier = 795
          DcmDspDidUsed = true
          DcmDspDidUsePort = USE_DATA_ELEMENT_SPECIFIC_INTERFACES
          DcmDspDidInfoRef = DidInfo_DiagnServi_Assembly_production_data_Read
          DcmDspDidSignal: DcmDspDidDataPos=0, DcmDspDidDataRef=Data_DiagnServi_Assembly_production_data_Read
        3 x DcmDspData, all with DcmDspDataType=UINT8_N, DcmDspDataUsePort=USE_DATA_ASYNCH_CLIENT_SERVER:
          Data_DiagnServi_TABROW_VWAppliSoftwVersiNumbe_Read: DcmDspDataSize=32, DcmDspDataInfoRef=DataInfo_DiagnServi_TABROW_VWAppliSoftwVersiNumbe_Read
          Data_DiagnServi_Module_part_number_Read: DcmDspDataSize=88, DcmDspDataInfoRef=DataInfo_DiagnServi_Module_part_number_Read
          Data_BMC_Strom_Read_Data_By_Identifier: DcmDspDataSize=16, DcmDspDataInfoRef=DataInfo_BMC_Strom_Read_Data_By_Identifier
        DID_TABROW_VkmsTrainCount_Read_Data_By_Identifier (DcmDspDid):
          DcmDspDidIdentifier = 11350
          DcmDspDidUsed = true
          DcmDspDidUsePort = USE_DATA_ELEMENT_SPECIFIC_INTERFACES
          DcmDspDidInfoRef = DidInfo_TABROW_VkmsTrainCount_Read_Data_By_Identifier
          DcmDspDidSignal: DcmDspDidDataPos=0, DcmDspDidDataRef=Data_TABROW_VkmsTrainCount_Read_Data_By_Identifier
        DID_DiagnServi_Cell_part_number_Read (DcmDspDid):
          DcmDspDidIdentifier = 806
          DcmDspDidUsed = true
          DcmDspDidUsePort = USE_DATA_ELEMENT_SPECIFIC_INTERFACES
          DcmDspDidInfoRef = DidInfo_DiagnServi_Cell_part_number_Read
          DcmDspDidSignal: DcmDspDidDataPos=0, DcmDspDidDataRef=Data_DiagnServi_Cell_part_number_Read
        Routine_DiagnServi_TABROW_ClearDowngProteData_Start_Routine_COP (DcmDspRoutine):
          DcmDspRequestResultsRoutineSupported = true
          DcmDspStopRoutineSupported = true
          DcmDspRoutineIdentifier = 1630
          DcmDspRoutineFixedLength = false
          DcmDspRoutineUsePort = true
          DcmDspRoutineUsed = true
          DcmDspRoutineInfoRef = RoutineInfo_DiagnServi_TABROW_ClearDowngProteData_Start_Routine_COP
        DidInfo_HV_battery_maximum_discharge_power_Read_Data_By_Identifier (DcmDspDidInfo)
          DcmDspDidAccess
            DcmDspDidRead: DcmDspDidReadSessionRef=ST_Defau, DcmDspDidReadSessionRef=ST_Exten
        DID_TABROW_CellStateOfChargMaxim_ReadDataByIdent (DcmDspDid):
          DcmDspDidIdentifier = 7724
          DcmDspDidUsed = true
          DcmDspDidUsePort = USE_DATA_ELEMENT_SPECIFIC_INTERFACES
          DcmDspDidInfoRef = DidInfo_TABROW_CellStateOfChargMaxim_ReadDataByIdent
          DcmDspDidSignal: DcmDspDidDataPos=0, DcmDspDidDataRef=Data_TABROW_CellStateOfChargMaxim_ReadDataByIdent
        Data_DiagnServi_TABROW_TABROFDSPr_Read (DcmDspData):
          DcmDspDataSize = 4136
          DcmDspDataType = UINT8_N
          DcmDspDataUsePort = USE_DATA_ASYNCH_CLIENT_SERVER
          DcmDspDataInfoRef = DataInfo_DiagnServi_TABROW_TABROFDSPr_Read
        3 x DcmDspDidInfo:
          DidInfo_DiagnServi_TABROW_DID0xEFD_Read_1_1
            DcmDspDidAccess
              DcmDspDidRead: DcmDspDidReadSessionRef=ST_Defau, DcmDspDidReadSessionRef=ST_Exten
          DidInfo_DiagnServi_TABROW_DID0xEFD_Read_1_2
            DcmDspDidAccess
              DcmDspDidRead: DcmDspDidReadSessionRef=ST_Defau, DcmDspDidReadSessionRef=ST_Exten
          DidInfo_DiagnServi_BCUe_part_number_Read
            DcmDspDidAccess
              DcmDspDidWrite: DcmDspDidWriteSessionRef=ST_Exten
              DcmDspDidRead: DcmDspDidReadSessionRef=ST_Defau, DcmDspDidReadSessionRef=ST_Exten
        DID_DiagnServi_TABROW_NeuMeasu_Read_25 (DcmDspDid):
          DcmDspDidIdentifier = 1670
          DcmDspDidUsed = true
          DcmDspDidUsePort = USE_DATA_ELEMENT_SPECIFIC_INTERFACES
          DcmDspDidInfoRef = DidInfo_DiagnServi_TABROW_NeuMeasu_Read_25
          DcmDspDidSignal: DcmDspDidDataPos=0, DcmDspDidDataRef=Data_DiagnServi_TABROW_NeuMeasu_Read_25
        Data_TABROW_VWLogicSoftwBlockLockValue_Read (DcmDspData):
          DcmDspDataType = UINT8_N
          DcmDspDataSize = 65535
          DcmDspDataUsePort = USE_DATA_ASYNCH_CLIENT_SERVER
          DcmDspDataInfoRef = DataInfo_TABROW_VWLogicSoftwBlockLockValue_Read
        4 x DcmDspDid, all with DcmDspDidUsed=true, DcmDspDidUsePort=USE_DATA_ELEMENT_SPECIFIC_INTERFACES:
          DID_DiagnServi_TABROW_NeuMeasu_Read_24: DcmDspDidIdentifier=1672, DcmDspDidInfoRef=DidInfo_DiagnServi_TABROW_NeuMeasu_Read_24
            DcmDspDidSignal: DcmDspDidDataPos=0, DcmDspDidDataRef=Data_DiagnServi_TABROW_NeuMeasu_Read_24
          DID_DiagnServi_TABROW_NeuMeasu_Read_23: DcmDspDidIdentifier=1673, DcmDspDidInfoRef=DidInfo_DiagnServi_TABROW_NeuMeasu_Read_23
            DcmDspDidSignal: DcmDspDidDataPos=0, DcmDspDidDataRef=Data_DiagnServi_TABROW_NeuMeasu_Read_23
          DID_TABROW_ProgrPreco_Read: DcmDspDidIdentifier=1096, DcmDspDidInfoRef=DidInfo_TABROW_ProgrPreco_Read
            DcmDspDidSignal: DcmDspDidDataPos=0, DcmDspDidDataRef=Data_TABROW_ProgrPreco_Read
          DID_DiagnServi_TABROW_NeuMeasu_Read_29: DcmDspDidIdentifier=1647, DcmDspDidInfoRef=DidInfo_DiagnServi_TABROW_NeuMeasu_Read_29
            DcmDspDidSignal: DcmDspDidDataPos=0, DcmDspDidDataRef=Data_DiagnServi_TABROW_NeuMeasu_Read_29
        DataInfo_BMC_Status_DCLS_Read_Data_By_Identifier (DcmDspDataInfo): DcmDspDataFixedLength=true
        6 x DcmDspDid, all with DcmDspDidUsed=true, DcmDspDidUsePort=USE_DATA_ELEMENT_SPECIFIC_INTERFACES:
          DID_DiagnServi_TABROW_NeuMeasu_Read_28: DcmDspDidIdentifier=1664, DcmDspDidInfoRef=DidInfo_DiagnServi_TABROW_NeuMeasu_Read_28
            DcmDspDidSignal: DcmDspDidDataPos=0, DcmDspDidDataRef=Data_DiagnServi_TABROW_NeuMeasu_Read_28
          DID_DiagnServi_TABROW_NeuMeasu_Read_27: DcmDspDidIdentifier=1663, DcmDspDidInfoRef=DidInfo_DiagnServi_TABROW_NeuMeasu_Read_27
            DcmDspDidSignal: DcmDspDidDataPos=0, DcmDspDidDataRef=Data_DiagnServi_TABROW_NeuMeasu_Read_27
          DID_DiagnServi_TABROW_NeuMeasu_Read_26: DcmDspDidIdentifier=1671, DcmDspDidInfoRef=DidInfo_DiagnServi_TABROW_NeuMeasu_Read_26
            DcmDspDidSignal: DcmDspDidDataPos=0, DcmDspDidDataRef=Data_DiagnServi_TABROW_NeuMeasu_Read_26
          DID_DiagnServi_TABROW_NeuMeasu_Read_72: DcmDspDidIdentifier=1722, DcmDspDidInfoRef=DidInfo_DiagnServi_TABROW_NeuMeasu_Read_72
            DcmDspDidSignal: DcmDspDidDataPos=0, DcmDspDidDataRef=Data_DiagnServi_TABROW_NeuMeasu_Read_72
          DID_DiagnServi_TABROW_NeuMeasu_Read_71: DcmDspDidIdentifier=1723, DcmDspDidInfoRef=DidInfo_DiagnServi_TABROW_NeuMeasu_Read_71
            DcmDspDidSignal: DcmDspDidDataPos=0, DcmDspDidDataRef=Data_DiagnServi_TABROW_NeuMeasu_Read_71
          DID_DiagnServi_TABROW_NeuMeasu_Read_70: DcmDspDidIdentifier=1681, DcmDspDidInfoRef=DidInfo_DiagnServi_TABROW_NeuMeasu_Read_70
            DcmDspDidSignal: DcmDspDidDataPos=0, DcmDspDidDataRef=Data_DiagnServi_TABROW_NeuMeasu_Read_70
        Data_Charisma_requestet_driving_program_hv_battery_Read_Data_By_Identifier (DcmDspData):
          DcmDspDataSize = 8
          DcmDspDataType = UINT8_N
          DcmDspDataUsePort = USE_DATA_ASYNCH_CLIENT_SERVER
          DcmDspDataInfoRef = DataInfo_Charisma_requestet_driving_program_hv_battery_Read_Data_By_Identifier
        DataInfo_DiagnServi_ReadDataByIdentVWLogicSoftwBlockVersi (DcmDspDataInfo): DcmDspDataFixedLength=true
        Routine_DiagnServi_TABROW_VkmsGetIdentHash_Start_Routine (DcmDspRoutine):
          DcmDspRequestResultsRoutineSupported = true
          DcmDspStopRoutineSupported = false
          DcmDspRoutineIdentifier = 49164
          DcmDspRoutineFixedLength = false
          DcmDspRoutineUsePort = true
          DcmDspRoutineUsed = true
          DcmDspRoutineInfoRef = RoutineInfo_DiagnServi_TABROW_VkmsGetIdentHash_Start_Routine
        DID_DiagnServi_TABROW_NeuMeasu_Read_74 (DcmDspDid):
          DcmDspDidIdentifier = 1720
          DcmDspDidUsed = true
          DcmDspDidUsePort = USE_DATA_ELEMENT_SPECIFIC_INTERFACES
          DcmDspDidInfoRef = DidInfo_DiagnServi_TABROW_NeuMeasu_Read_74
          DcmDspDidSignal: DcmDspDidDataPos=0, DcmDspDidDataRef=Data_DiagnServi_TABROW_NeuMeasu_Read_74
        Data_Strommesung_Read_Data_By_Identifier (DcmDspData):
          DcmDspDataSize = 32
          DcmDspDataType = UINT8_N
          DcmDspDataUsePort = USE_DATA_ASYNCH_CLIENT_SERVER
          DcmDspDataInfoRef = DataInfo_Strommesung_Read_Data_By_Identifier
        DID_DiagnServi_TABROW_NeuMeasu_Read_73 (DcmDspDid):
          DcmDspDidIdentifier = 1721
          DcmDspDidUsed = true
          DcmDspDidUsePort = USE_DATA_ELEMENT_SPECIFIC_INTERFACES
          DcmDspDidInfoRef = DidInfo_DiagnServi_TABROW_NeuMeasu_Read_73
          DcmDspDidSignal: DcmDspDidDataPos=0, DcmDspDidDataRef=Data_DiagnServi_TABROW_NeuMeasu_Read_73
        5 x DcmDspDidInfo:
          DidInfo_DiagnServi_BMC_serial_number_Read
            DcmDspDidAccess
              DcmDspDidWrite: DcmDspDidWriteSessionRef=ST_Exten
              DcmDspDidRead: DcmDspDidReadSessionRef=ST_Defau, DcmDspDidReadSessionRef=ST_Exten
          DidInfo_Battery_return_flow_temperature_Read_Data_By_Identifier
            DcmDspDidAccess
              DcmDspDidRead: DcmDspDidReadSessionRef=ST_Defau, DcmDspDidReadSessionRef=ST_Exten
              DcmDspDidWrite: DcmDspDidWriteSessionRef=ST_Exten
          DidInfo_TABROW_TABROSyste_Read_1_1_1_1
            DcmDspDidAccess
              DcmDspDidRead
          DidInfo_DiagnServi_TABROW_UnlocStatuOfECUOfProteOfVehicDiagn_Read
            DcmDspDidAccess
              DcmDspDidRead: DcmDspDidReadSessionRef=ST_Defau, DcmDspDidReadSessionRef=ST_Exten
          DidInfo_DiagnServi_TABROW_SuppoPIDs2140_Read
            DcmDspDidAccess
              DcmDspDidRead: DcmDspDidReadSessionRef=ST_Defau, DcmDspDidReadSessionRef=ST_Exten
        DID_TABROW_VWWorksSysteName_Read (DcmDspDid):
          DcmDspDidIdentifier = 61866
          DcmDspDidUsed = true
          DcmDspDidUsePort = USE_DATA_ELEMENT_SPECIFIC_INTERFACES
          DcmDspDidInfoRef = DidInfo_TABROW_VWWorksSysteName_Read
          DcmDspDidSignal: DcmDspDidDataPos=0, DcmDspDidDataRef=Data_TABROW_VWWorksSysteName_Read
        Data_DiagnServi_TABROW_NeuMeasu_Read_43_1_1_1_1_1_1_1_1_1 (DcmDspData):
          DcmDspDataSize = 512
          DcmDspDataType = UINT8_N
          DcmDspDataUsePort = USE_DATA_ASYNCH_CLIENT_SERVER
          DcmDspDataInfoRef = DataInfo_DiagnServi_TABROW_NeuMeasu_Read_43_1_1_1_1_1_1_1_1_1
        DidInfo_TABROW_TABROSyste_Read_1_1 (DcmDspDidInfo)
          DcmDspDidAccess
            DcmDspDidRead
        DidInfo_DiagnServi_TABROW_NeuMeasu_Read_29_1_1_1 (DcmDspDidInfo)
          DcmDspDidAccess
            DcmDspDidRead: DcmDspDidReadSessionRef=ST_Defau, DcmDspDidReadSessionRef=ST_Exten
        4 x DcmDspDid, all with DcmDspDidUsed=true, DcmDspDidUsePort=USE_DATA_ELEMENT_SPECIFIC_INTERFACES:
          DID_DiagnServi_TABROW_NeuMeasu_Read_83: DcmDspDidIdentifier=1718, DcmDspDidInfoRef=DidInfo_DiagnServi_TABROW_NeuMeasu_Read_83
            DcmDspDidSignal: DcmDspDidDataPos=0, DcmDspDidDataRef=Data_DiagnServi_TABROW_NeuMeasu_Read_83
          DID_DiagnServi_TABROW_NeuMeasu_Read_9_2: DcmDspDidIdentifier=1713, DcmDspDidInfoRef=DidInfo_DiagnServi_TABROW_NeuMeasu_Read_9_2
            DcmDspDidSignal: DcmDspDidDataPos=0, DcmDspDidDataRef=Data_DiagnServi_TABROW_NeuMeasu_Read_9_2
          DID_DiagnServi_TABROW_NeuMeasu_Read_82: DcmDspDidIdentifier=1719, DcmDspDidInfoRef=DidInfo_DiagnServi_TABROW_NeuMeasu_Read_82
            DcmDspDidSignal: DcmDspDidDataPos=0, DcmDspDidDataRef=Data_DiagnServi_TABROW_NeuMeasu_Read_82
          DID_DiagnServi_TABROW_NeuMeasu_Read_29_1_1: DcmDspDidIdentifier=57373, DcmDspDidInfoRef=DidInfo_DiagnServi_TABROW_NeuMeasu_Read_29_1_1
            DcmDspDidSignal: DcmDspDidDataPos=0, DcmDspDidDataRef=Data_DiagnServi_TABROW_NeuMeasu_Read_29_1_1
        DataInfo_DiagnServi_TABROW_NeuMeasu_Read_27_3_1_1 (DcmDspDataInfo): DcmDspDataFixedLength=true
        DID_DiagnServi_TABROW_NeuMeasu_Read_29_1_2 (DcmDspDid):
          DcmDspDidIdentifier = 57372
          DcmDspDidUsed = true
          DcmDspDidUsePort = USE_DATA_ELEMENT_SPECIFIC_INTERFACES
          DcmDspDidInfoRef = DidInfo_DiagnServi_TABROW_NeuMeasu_Read_29_1_2
          DcmDspDidSignal: DcmDspDidDataPos=0, DcmDspDidDataRef=Data_DiagnServi_TABROW_NeuMeasu_Read_29_1_2
        DataInfo_TABROW_TABROSyste_Read_1_1_1_1_1_1_1_1_1_1_1_1_1_1_1 (DcmDspDataInfo): DcmDspDataFixedLength=true
        DID_DiagnServi_TABROW_NeuMeasu_Read_84 (DcmDspDid):
          DcmDspDidIdentifier = 1717
          DcmDspDidUsed = true
          DcmDspDidUsePort = USE_DATA_ELEMENT_SPECIFIC_INTERFACES
          DcmDspDidInfoRef = DidInfo_DiagnServi_TABROW_NeuMeasu_Read_84
          DcmDspDidSignal: DcmDspDidDataPos=0, DcmDspDidDataRef=Data_DiagnServi_TABROW_NeuMeasu_Read_84
        DID_DiagnServi_TABROW_NeuMeasu_Read_9_1 (DcmDspDid):
          DcmDspDidIdentifier = 1648
          DcmDspDidUsed = true
          DcmDspDidUsePort = USE_DATA_ELEMENT_SPECIFIC_INTERFACES
          DcmDspDidInfoRef = DidInfo_DiagnServi_TABROW_NeuMeasu_Read_9_1
          DcmDspDidSignal: DcmDspDidDataPos=0, DcmDspDidDataRef=Data_DiagnServi_TABROW_NeuMeasu_Read_9_1
        DataInfo_DiagnServi_TABROW_DID0xEFD_Read_1_1_1 (DcmDspDataInfo): DcmDspDataFixedLength=true
        DID_TABROW_BatteTempeMaxim_ReadDataByIdent (DcmDspDid):
          DcmDspDidIdentifier = 7694
          DcmDspDidUsed = true
          DcmDspDidUsePort = USE_DATA_ELEMENT_SPECIFIC_INTERFACES
          DcmDspDidInfoRef = DidInfo_TABROW_BatteTempeMaxim_ReadDataByIdent
          DcmDspDidSignal: DcmDspDidDataPos=0, DcmDspDidDataRef=Data_TABROW_BatteTempeMaxim_ReadDataByIdent
        Data_DiagnServi_TABROW_UnlocStatuOfECUOfProteOfVehicDiagn_Read (DcmDspData):
          DcmDspDataSize = 32
          DcmDspDataType = UINT8_N
          DcmDspDataUsePort = USE_DATA_ASYNCH_CLIENT_SERVER
          DcmDspDataInfoRef = DataInfo_DiagnServi_TABROW_UnlocStatuOfECUOfProteOfVehicDiagn_Read
        Data_DiagnServi_TABROW_NeuMeasu_Read_43_1_1_1_1_1_1_1 (DcmDspData):
          DcmDspDataSize = 512
          DcmDspDataType = UINT8_N
          DcmDspDataUsePort = USE_DATA_ASYNCH_CLIENT_SERVER
          DcmDspDataInfoRef = DataInfo_DiagnServi_TABROW_NeuMeasu_Read_43_1_1_1_1_1_1_1
        DataInfo_DiagnServi_TABROW_NeuMeasu_Read_43_1_1_1_1_1_1_1_1_1_1_1 (DcmDspDataInfo): DcmDspDataFixedLength=true
        DidInfo_DiagnServi_Assembly_production_data_Read (DcmDspDidInfo)
          DcmDspDidAccess
            DcmDspDidWrite: DcmDspDidWriteSessionRef=ST_Exten
            DcmDspDidRead: DcmDspDidReadSessionRef=ST_Defau, DcmDspDidReadSessionRef=ST_Exten
        DidInfo_DiagnServi_Type_number_BCUe_Read (DcmDspDidInfo)
          DcmDspDidAccess
            DcmDspDidWrite: DcmDspDidWriteSessionRef=ST_Exten
            DcmDspDidRead: DcmDspDidReadSessionRef=ST_Defau, DcmDspDidReadSessionRef=ST_Exten
        DID_DiagnServi_TABROW_NeuMeasu_Read_50 (DcmDspDid):
          DcmDspDidIdentifier = 1381
          DcmDspDidUsed = true
          DcmDspDidUsePort = USE_DATA_ELEMENT_SPECIFIC_INTERFACES
          DcmDspDidInfoRef = DidInfo_DiagnServi_TABROW_NeuMeasu_Read_50
          DcmDspDidSignal: DcmDspDidDataPos=0, DcmDspDidDataRef=Data_DiagnServi_TABROW_NeuMeasu_Read_50
        DataInfo_DiagnServi_TABROW_NeuMeasu_Read_58_1 (DcmDspDataInfo): DcmDspDataFixedLength=true
        Data_DiagnServi_TABROW_ECUNA_Read (DcmDspData):
          DcmDspDataSize = 160
          DcmDspDataType = UINT8_N
          DcmDspDataUsePort = USE_DATA_ASYNCH_CLIENT_SERVER
          DcmDspDataInfoRef = DataInfo_DiagnServi_TABROW_ECUNA_Read
        4 x DcmDspDid, all with DcmDspDidUsed=true, DcmDspDidUsePort=USE_DATA_ELEMENT_SPECIFIC_INTERFACES:
          DID_DiagnServi_Type_number_BCUe_Read: DcmDspDidIdentifier=800, DcmDspDidInfoRef=DidInfo_DiagnServi_Type_number_BCUe_Read
            DcmDspDidSignal: DcmDspDidDataPos=0, DcmDspDidDataRef=Data_DiagnServi_Type_number_BCUe_Read
          DID_DiagnServi_TABROW_NeuMeasu_Read_53: DcmDspDidIdentifier=1472, DcmDspDidInfoRef=DidInfo_DiagnServi_TABROW_NeuMeasu_Read_53
            DcmDspDidSignal: DcmDspDidDataPos=0, DcmDspDidDataRef=Data_DiagnServi_TABROW_NeuMeasu_Read_53
          DID_DiagnServi_TABROW_NeuMeasu_Read_52: DcmDspDidIdentifier=1478, DcmDspDidInfoRef=DidInfo_DiagnServi_TABROW_NeuMeasu_Read_52
            DcmDspDidSignal: DcmDspDidDataPos=0, DcmDspDidDataRef=Data_DiagnServi_TABROW_NeuMeasu_Read_52
          DID_DiagnServi_TABROW_NeuMeasu_Read_51: DcmDspDidIdentifier=646, DcmDspDidInfoRef=DidInfo_DiagnServi_TABROW_NeuMeasu_Read_51
            DcmDspDidSignal: DcmDspDidDataPos=0, DcmDspDidDataRef=Data_DiagnServi_TABROW_NeuMeasu_Read_51
        DataInfo_DiagnServi_TABROW_TABROECUPr_Read (DcmDspDataInfo): DcmDspDataFixedLength=true
        Data_DiagnServi_TABROW_ActivOfDevelMessa_Read (DcmDspData):
          DcmDspDataSize = 8
          DcmDspDataType = UINT8_N
          DcmDspDataUsePort = USE_DATA_ASYNCH_CLIENT_SERVER
          DcmDspDataInfoRef = DataInfo_DiagnServi_TABROW_ActivOfDevelMessa_Read
        3 x DcmDspDidInfo:
          DidInfo_DiagnServi_TABROW_NeuMeasu_Read_27_1_1_1
            DcmDspDidAccess
              DcmDspDidRead: DcmDspDidReadSessionRef=ST_Defau, DcmDspDidReadSessionRef=ST_Exten
          DidInfo_DiagnServi_TABROW_NeuMeasu_Read_27_1_1_2
            DcmDspDidAccess
              DcmDspDidRead: DcmDspDidReadSessionRef=ST_Defau, DcmDspDidReadSessionRef=ST_Exten
          DidInfo_TABROW_TABROSyste_Read_1_1_1_1_1_1_1_1_1_1_1
            DcmDspDidAccess
              DcmDspDidRead
        DataInfo_TABROW_ModeOfProteOfVehicDiagn_ReadDataByIdentifier (DcmDspDataInfo): DcmDspDataFixedLength=true
        DID_DiagnServi_TABROW_NeuMeasu_Read_56 (DcmDspDid):
          DcmDspDidIdentifier = 1507
          DcmDspDidUsed = true
          DcmDspDidUsePort = USE_DATA_ELEMENT_SPECIFIC_INTERFACES
          DcmDspDidInfoRef = DidInfo_DiagnServi_TABROW_NeuMeasu_Read_56
          DcmDspDidSignal: DcmDspDidDataPos=0, DcmDspDidDataRef=Data_DiagnServi_TABROW_NeuMeasu_Read_56
        DataInfo_DiagnServi_TABROW_VehicSpeedSenso_Read (DcmDspDataInfo): DcmDspDataFixedLength=true
        DID_DiagnServi_TABROW_NeuMeasu_Read_55 (DcmDspDid):
          DcmDspDidIdentifier = 1479
          DcmDspDidUsed = true
          DcmDspDidUsePort = USE_DATA_ELEMENT_SPECIFIC_INTERFACES
          DcmDspDidInfoRef = DidInfo_DiagnServi_TABROW_NeuMeasu_Read_55
          DcmDspDidSignal: DcmDspDidDataPos=0, DcmDspDidDataRef=Data_DiagnServi_TABROW_NeuMeasu_Read_55
        DataInfo_Battery_contactors_actual_states_Read_Data_By_Identifier (DcmDspDataInfo): DcmDspDataFixedLength=true
        RoutineInfo_DiagnServi_TABROW_ClearDowngProteData_Start_Routine_COP (DcmDspRoutineInfo)
          DcmDspRoutineRequestResOut
            ResData (DcmDspRoutineRequestResOutSignal): DcmDspRoutineSignalLength=8, DcmDspRoutineSignalType=UINT8_N, DcmDspRoutineSignalEndianness=opaque, DcmDspRoutineSignalPos=0
          DcmDspRoutineAuthorization: DcmDspRoutineSessionRef=ST_Defau, DcmDspRoutineSessionRef=ST_Exten
          DcmDspRoutineStopOut
            ResData (DcmDspRoutineStopOutSignal): DcmDspRoutineSignalLength=8, DcmDspRoutineSignalType=UINT8_N, DcmDspRoutineSignalEndianness=opaque, DcmDspRoutineSignalPos=0
          DcmDspStartRoutineOut
            ResData (DcmDspStartRoutineOutSignal): DcmDspRoutineSignalLength=8, DcmDspRoutineSignalType=UINT8_N, DcmDspRoutineSignalEndianness=opaque, DcmDspRoutineSignalPos=0
        DID_DiagnServi_TABROW_NeuMeasu_Read_61 (DcmDspDid):
          DcmDspDidIdentifier = 1738
          DcmDspDidUsed = true
          DcmDspDidUsePort = USE_DATA_ELEMENT_SPECIFIC_INTERFACES
          DcmDspDidInfoRef = DidInfo_DiagnServi_TABROW_NeuMeasu_Read_61
          DcmDspDidSignal: DcmDspDidDataPos=0, DcmDspDidDataRef=Data_DiagnServi_TABROW_NeuMeasu_Read_61
        DidInfo_TABROW_SOKFreshInfor_Read_Data_By_Identifier (DcmDspDidInfo)
          DcmDspDidAccess
            DcmDspDidRead: DcmDspDidReadSessionRef=ST_Defau, DcmDspDidReadSessionRef=ST_Exten
        DID_DiagnServi_TABROW_NeuMeasu_Read_60 (DcmDspDid):
          DcmDspDidIdentifier = 1733
          DcmDspDidUsed = true
          DcmDspDidUsePort = USE_DATA_ELEMENT_SPECIFIC_INTERFACES
          DcmDspDidInfoRef = DidInfo_DiagnServi_TABROW_NeuMeasu_Read_60
          DcmDspDidSignal: DcmDspDidDataPos=0, DcmDspDidDataRef=Data_DiagnServi_TABROW_NeuMeasu_Read_60
        DidInfo_TABROW_BMCHVKFehleSD_Read_Data_By_Identifier (DcmDspDidInfo)
          DcmDspDidAccess
            DcmDspDidRead: DcmDspDidReadSessionRef=ST_Defau, DcmDspDidReadSessionRef=ST_Exten
        DidInfo_TABROW_BMCHVKFehleInter_Read_Data_By_Identifier (DcmDspDidInfo)
          DcmDspDidAccess
            DcmDspDidRead: DcmDspDidReadSessionRef=ST_Defau, DcmDspDidReadSessionRef=ST_Exten
        Data_TABROW_SOKGenerInfor_Read_Data_By_Identifier (DcmDspData):
          DcmDspDataSize = 24
          DcmDspDataType = UINT8_N
          DcmDspDataUsePort = USE_DATA_ASYNCH_CLIENT_SERVER
          DcmDspDataInfoRef = DataInfo_TABROW_SOKGenerInfor_Read_Data_By_Identifier
        DID_DiagnServi_TABROW_NeuMeasu_Read_63 (DcmDspDid):
          DcmDspDidIdentifier = 57357
          DcmDspDidUsed = true
          DcmDspDidUsePort = USE_DATA_ELEMENT_SPECIFIC_INTERFACES
          DcmDspDidInfoRef = DidInfo_DiagnServi_TABROW_NeuMeasu_Read_63
          DcmDspDidSignal: DcmDspDidDataPos=0, DcmDspDidDataRef=Data_DiagnServi_TABROW_NeuMeasu_Read_63
        DataInfo_DiagnServi_TABROW_BootlTPBlock_Read (DcmDspDataInfo): DcmDspDataFixedLength=true
        4 x DcmDspDid, all with DcmDspDidUsed=true, DcmDspDidUsePort=USE_DATA_ELEMENT_SPECIFIC_INTERFACES:
          DID_DiagnServi_BMC_clamp_30c_Read: DcmDspDidIdentifier=2054, DcmDspDidInfoRef=DidInfo_DiagnServi_BMC_clamp_30c_Read
            DcmDspDidSignal: DcmDspDidDataPos=0, DcmDspDidDataRef=Data_DiagnServi_BMC_clamp_30c_Read
          DID_TABROW_CellVoltaSum_ReadDataByIdent: DcmDspDidIdentifier=7739, DcmDspDidInfoRef=DidInfo_TABROW_CellVoltaSum_ReadDataByIdent
            DcmDspDidSignal: DcmDspDidDataPos=0, DcmDspDidDataRef=Data_TABROW_CellVoltaSum_ReadDataByIdent
          DID_DiagnServi_TABROW_NeuMeasu_Read_27_3_1_1: DcmDspDidIdentifier=1653, DcmDspDidInfoRef=DidInfo_DiagnServi_TABROW_NeuMeasu_Read_27_3_1_1
            DcmDspDidSignal: DcmDspDidDataPos=0, DcmDspDidDataRef=Data_DiagnServi_TABROW_NeuMeasu_Read_27_3_1_1
          DID_Battery_isolation_measurement_actual_and_requested_state_Read_Data_By_Identifier: DcmDspDidIdentifier=1665, DcmDspDidInfoRef=DidInfo_Battery_isolation_measurement_actual_and_requested_state_Read_Data_By_Identifier
            DcmDspDidSignal: DcmDspDidDataPos=0, DcmDspDidDataRef=Data_Battery_isolation_measurement_actual_and_requested_state_Read_Data_By_Identifier
        Data_HV_Spannung_Nebenverbraucher_Read_Data_By_Identifier (DcmDspData):
          DcmDspDataSize = 16
          DcmDspDataType = UINT8_N
          DcmDspDataUsePort = USE_DATA_ASYNCH_CLIENT_SERVER
          DcmDspDataInfoRef = DataInfo_HV_Spannung_Nebenverbraucher_Read_Data_By_Identifier
        DID_TABROW_ServiDiscoState_Read_Data_By_Identifier (DcmDspDid):
          DcmDspDidIdentifier = 20836
          DcmDspDidUsed = true
          DcmDspDidUsePort = USE_DATA_ELEMENT_SPECIFIC_INTERFACES
          DcmDspDidInfoRef = DidInfo_TABROW_ServiDiscoState_Read_Data_By_Identifier
          DcmDspDidSignal: DcmDspDidDataPos=0, DcmDspDidDataRef=Data_TABROW_ServiDiscoState_Read_Data_By_Identifier
        DataInfo_DiagnServi_TABROW_NeuCalibData_Read (DcmDspDataInfo): DcmDspDataFixedLength=true
        RoutineInfo_TABROW_VkmsDebug_Start_Routine_001 (DcmDspRoutineInfo)
          DcmDspRoutineRequestResOut
            ResData (DcmDspRoutineRequestResOutSignal): DcmDspRoutineSignalLength=408, DcmDspRoutineSignalType=VARIABLE_LENGTH, DcmDspRoutineSignalPos=0
          DcmDspStartRoutineIn
            ReqData (DcmDspStartRoutineInSignal): DcmDspRoutineSignalLength=4104, DcmDspRoutineSignalType=VARIABLE_LENGTH, DcmDspRoutineSignalPos=0
          DcmDspRoutineAuthorization: DcmDspRoutineSessionRef=ST_Exten
        DataInfo_TABROW_VehicIdentNumbe_Read (DcmDspDataInfo): DcmDspDataFixedLength=true
        Data_TABROW_ProgrHash_Read (DcmDspData): DcmDspDataSize=256, DcmDspDataType=UINT8_N, DcmDspDataUsePort=USE_DATA_ASYNCH_CLIENT_SERVER, DcmDspDataInfoRef=DataInfo_TABROW_ProgrHash_Read
        DID_TABROW_RegulXSoftwIdentNumbe_Read (DcmDspDid):
          DcmDspDidIdentifier = 61839
          DcmDspDidUsed = true
          DcmDspDidUsePort = USE_DATA_ELEMENT_SPECIFIC_INTERFACES
          DcmDspDidInfoRef = DidInfo_TABROW_RegulXSoftwIdentNumbe_Read
          DcmDspDidSignal: DcmDspDidDataPos=0, DcmDspDidDataRef=Data_TABROW_RegulXSoftwIdentNumbe_Read
        DidInfo_TABROW_RegulXSoftwIdentNumbe_Read (DcmDspDidInfo)
          DcmDspDidAccess
            DcmDspDidWrite: DcmDspDidWriteSessionRef=ST_Defau, DcmDspDidWriteSessionRef=ST_Exten
            DcmDspDidRead: DcmDspDidReadSessionRef=ST_Defau, DcmDspDidReadSessionRef=ST_Exten
        DataInfo_TABROW_ProgrHash_Read (DcmDspDataInfo): DcmDspDataFixedLength=true
        DataInfo_TABROW_RegulXSoftwIdentNumbe_Read (DcmDspDataInfo): DcmDspDataFixedLength=true
        DID_TABROW_ConfiHash_Read (DcmDspDid): DcmDspDidIdentifier=581, DcmDspDidUsed=true, DcmDspDidUsePort=USE_DATA_ELEMENT_SPECIFIC_INTERFACES, DcmDspDidInfoRef=DidInfo_TABROW_ConfiHash_Read
          DcmDspDidSignal: DcmDspDidDataPos=0, DcmDspDidDataRef=Data_TABROW_ConfiHash_Read
        Data_TABROW_RegulXSoftwIdentNumbe_Read (DcmDspData):
          DcmDspDataSize = 400
          DcmDspDataType = UINT8_N
          DcmDspDataUsePort = USE_DATA_ASYNCH_CLIENT_SERVER
          DcmDspDataInfoRef = DataInfo_TABROW_RegulXSoftwIdentNumbe_Read
        DID_TABROW_VehicIdentNumbe_Read (DcmDspDid):
          DcmDspDidIdentifier = 61840
          DcmDspDidUsed = true
          DcmDspDidUsePort = USE_DATA_ELEMENT_SPECIFIC_INTERFACES
          DcmDspDidInfoRef = DidInfo_TABROW_VehicIdentNumbe_Read
          DcmDspDidSignal: DcmDspDidDataPos=0, DcmDspDidDataRef=Data_TABROW_VehicIdentNumbe_Read
        DidInfo_TABROW_ProgrHash_Read (DcmDspDidInfo)
          DcmDspDidAccess
            DcmDspDidRead: DcmDspDidReadSessionRef=ST_Defau, DcmDspDidReadSessionRef=ST_Exten
        Data_TABROW_VehicIdentNumbe_Read (DcmDspData):
          DcmDspDataSize = 136
          DcmDspDataType = UINT8_N
          DcmDspDataUsePort = USE_DATA_ASYNCH_CLIENT_SERVER
          DcmDspDataInfoRef = DataInfo_TABROW_VehicIdentNumbe_Read
        DID_TABROW_ProgrHash_Read (DcmDspDid): DcmDspDidIdentifier=585, DcmDspDidUsed=true, DcmDspDidUsePort=USE_DATA_ELEMENT_SPECIFIC_INTERFACES, DcmDspDidInfoRef=DidInfo_TABROW_ProgrHash_Read
          DcmDspDidSignal: DcmDspDidDataPos=0, DcmDspDidDataRef=Data_TABROW_ProgrHash_Read
        DataInfo_TABROW_ConfiHash_Read (DcmDspDataInfo): DcmDspDataFixedLength=true
        DidInfo_TABROW_VehicIdentNumbe_Read (DcmDspDidInfo)
          DcmDspDidAccess
            DcmDspDidRead
        DidInfo_TABROW_ConfiHash_Read (DcmDspDidInfo)
          DcmDspDidAccess
            DcmDspDidRead: DcmDspDidReadSessionRef=ST_Defau, DcmDspDidReadSessionRef=ST_Exten
        Data_TABROW_ConfiHash_Read (DcmDspData): DcmDspDataSize=256, DcmDspDataType=UINT8_N, DcmDspDataUsePort=USE_DATA_ASYNCH_CLIENT_SERVER, DcmDspDataInfoRef=DataInfo_TABROW_ConfiHash_Read
        DidInfo_TABROW_SFDDevelModeActiv_Read (DcmDspDidInfo)
          DcmDspDidAccess
            DcmDspDidWrite: DcmDspDidWriteSessionRef=ST_Exten
            DcmDspDidRead: DcmDspDidReadSessionRef=ST_Exten
        DID_TABROW_SFDDevelModeActiv_Read (DcmDspDid):
          DcmDspDidIdentifier = 49419
          DcmDspDidUsed = true
          DcmDspDidUsePort = USE_DATA_ELEMENT_SPECIFIC_INTERFACES
          DcmDspDidInfoRef = DidInfo_TABROW_SFDDevelModeActiv_Read
          DcmDspDidSignal: DcmDspDidDataPos=0, DcmDspDidDataRef=Data_TABROW_SFDDevelModeActiv_Read
        DataInfo_TABROW_SFDDevelModeActiv_Read (DcmDspDataInfo): DcmDspDataFixedLength=true
        Data_TABROW_SFDDevelModeActiv_Read (DcmDspData):
          DcmDspDataSize = 8
          DcmDspDataType = UINT8_N
          DcmDspDataUsePort = USE_DATA_ASYNCH_CLIENT_SERVER
          DcmDspDataInfoRef = DataInfo_TABROW_SFDDevelModeActiv_Read
        DcmDspAuthentication: DcmDspAuthenticationRoleSize=1, DcmDspAuthenticationSetDeauthenticatedRoleApi=false, DcmDspAuthenticationDeauthenticatedRoleRef=ST_Unsec
          ST_Unsec (DcmDspAuthenticationRow): DcmDspAuthenticationRoleBitPosition=0
          ST_EndToEnd (DcmDspAuthenticationRow): DcmDspAuthenticationRoleBitPosition=1
        DID_TABROW_VishnDID_Read (DcmDspDid):
          DcmDspDidIdentifier = 61939
          DcmDspDidUsed = true
          DcmDspDidUsePort = USE_DATA_ELEMENT_SPECIFIC_INTERFACES
          DcmDspDidInfoRef = DidInfo_TABROW_VishnDID_Read
          DcmDspDidSignal: DcmDspDidDataPos=0, DcmDspDidDataRef=Data_TABROW_VishnDID_Read
        Data_TABROW_VishnDID_Read (DcmDspData): DcmDspDataSize=800, DcmDspDataType=UINT8_N, DcmDspDataUsePort=USE_DATA_ASYNCH_CLIENT_SERVER, DcmDspDataInfoRef=DataInfo_TABROW_VishnDID_Read
        DidInfo_TABROW_VishnDID_Read (DcmDspDidInfo)
          DcmDspDidAccess
            DcmDspDidRead: DcmDspDidReadSessionRef=ST_Defau, DcmDspDidReadSessionRef=ST_Exten
        DataInfo_TABROW_VishnDID_Read (DcmDspDataInfo): DcmDspDataFixedLength=true
        DID_Vishnu_DID (DcmDspDid): DcmDspDidIdentifier=4386, DcmDspDidUsed=true, DcmDspDidUsePort=USE_DATA_ELEMENT_SPECIFIC_INTERFACES, DcmDspDidInfoRef=DidInfo_Vishnu_DID
          DcmDspDidSignal: DcmDspDidDataPos=0, DcmDspDidDataRef=Data_Vishnu_DID
        DidInfo_Vishnu_DID (DcmDspDidInfo)
          DcmDspDidAccess
            DcmDspDidWrite: DcmDspDidWriteSessionRef=ST_Exten
            DcmDspDidRead: DcmDspDidReadSessionRef=ST_Exten
        Data_Vishnu_DID (DcmDspData):
          DcmDspDataSize = 64
          DcmDspDataUsePort = USE_DATA_ASYNCH_CLIENT_SERVER
          DcmDspDataType = UINT8
          DcmDspDataEndianness = LITTLE_ENDIAN
          DcmDspDataReadFnc = 
          DcmDspDataReadDataLengthFnc = 
          DcmDspDataWriteFnc = 
          DcmDspDataInfoRef = DataInfo_Vishnu_DID
        DataInfo_Vishnu_DID (DcmDspDataInfo): DcmDspDataFixedLength=true
        DidInfo_TABROW_DCMCALLODID_Read (DcmDspDidInfo)
          DcmDspDidAccess
            DcmDspDidWrite: DcmDspDidWriteSessionRef=ST_Exten
            DcmDspDidRead: DcmDspDidReadSessionRef=ST_Defau, DcmDspDidReadSessionRef=ST_Exten
        DidInfo_TABROW_CanTPData_Read (DcmDspDidInfo)
          DcmDspDidAccess
            DcmDspDidWrite: DcmDspDidWriteSessionRef=ST_Exten, DcmDspDidWriteSessionRef=ST_Defau
            DcmDspDidRead: DcmDspDidReadSessionRef=ST_Defau, DcmDspDidReadSessionRef=ST_Exten
        DID_TABROW_DCMCALLODID_Read (DcmDspDid):
          DcmDspDidIdentifier = 61920
          DcmDspDidUsed = true
          DcmDspDidUsePort = USE_DATA_ELEMENT_SPECIFIC_INTERFACES
          DcmDspDidInfoRef = DidInfo_TABROW_DCMCALLODID_Read
          DcmDspDidSignal: DcmDspDidDataPos=0, DcmDspDidDataRef=Data_TABROW_DCMCALLODID_Read
        DataInfo_TABROW_CanTPData_Read (DcmDspDataInfo): DcmDspDataFixedLength=true
        Data_TABROW_CanTPData_Read (DcmDspData): DcmDspDataSize=1200, DcmDspDataType=UINT8_N, DcmDspDataUsePort=USE_DATA_ASYNCH_CLIENT_SERVER, DcmDspDataInfoRef=DataInfo_TABROW_CanTPData_Read
        DataInfo_TABROW_DCMCALLODID_Read (DcmDspDataInfo): DcmDspDataFixedLength=true
        DID_TABROW_CanTPData_Read (DcmDspDid):
          DcmDspDidIdentifier = 61922
          DcmDspDidUsed = true
          DcmDspDidUsePort = USE_DATA_ELEMENT_SPECIFIC_INTERFACES
          DcmDspDidInfoRef = DidInfo_TABROW_CanTPData_Read
          DcmDspDidSignal: DcmDspDidDataPos=0, DcmDspDidDataRef=Data_TABROW_CanTPData_Read
        DID_TABROW_PIMDID_Read (DcmDspDid): DcmDspDidIdentifier=61921, DcmDspDidUsed=true, DcmDspDidUsePort=USE_DATA_ELEMENT_SPECIFIC_INTERFACES, DcmDspDidInfoRef=DidInfo_TABROW_PIMDID_Read
          DcmDspDidSignal: DcmDspDidDataPos=0, DcmDspDidDataRef=Data_TABROW_PIMDID_Read
        DataInfo_TABROW_PIMDID_Read (DcmDspDataInfo): DcmDspDataFixedLength=true
        Data_TABROW_PIMDID_Read (DcmDspData): DcmDspDataSize=80, DcmDspDataType=UINT8_N, DcmDspDataUsePort=USE_DATA_ASYNCH_CLIENT_SERVER, DcmDspDataInfoRef=DataInfo_TABROW_PIMDID_Read
        Data_TABROW_DCMCALLODID_Read (DcmDspData):
          DcmDspDataSize = 40
          DcmDspDataType = UINT8_N
          DcmDspDataUsePort = USE_DATA_SYNCH_FNC
          DcmDspDataConditionCheckReadFnc = DcmDspDataConditionCheckReadFnc_Data_TABROW_DCMCALLODID_Read
          DcmDspDataReadFnc = DcmDspDataReadFnc_Data_TABROW_DCMCALLODID_Read
          DcmDspDataWriteFnc = DcmDspDataWriteFnc_Data_TABROW_DCMCALLODID_Read
          DcmDspDataInfoRef = DataInfo_TABROW_DCMCALLODID_Read
        DidInfo_TABROW_PIMDID_Read (DcmDspDidInfo)
          DcmDspDidAccess
            DcmDspDidWrite: DcmDspDidWriteSessionRef=ST_Exten
            DcmDspDidRead: DcmDspDidReadSessionRef=ST_Defau, DcmDspDidReadSessionRef=ST_Exten
        Routine_DiagnServi_TABROW_NewRoutiBasicSetti_Start_Routine (DcmDspRoutine):
          DcmDspRequestResultsRoutineSupported = true
          DcmDspStopRoutineSupported = true
          DcmDspRoutineIdentifier = 921
          DcmDspRoutineFixedLength = false
          DcmDspRoutineUsePort = true
          DcmDspRoutineUsed = true
          DcmDspRoutineInfoRef = RoutineInfo_DiagnServi_TABROW_NewRoutiBasicSetti_Start_Routine
        RoutineInfo_DiagnServi_TABROW_NewRoutiBasicSetti_Start_Routine (DcmDspRoutineInfo)
          DcmDspRoutineRequestResOut
            ResData (DcmDspRoutineRequestResOutSignal): DcmDspRoutineSignalLength=8, DcmDspRoutineSignalType=UINT8_N, DcmDspRoutineSignalEndianness=opaque, DcmDspRoutineSignalPos=0
          DcmDspRoutineAuthorization: DcmDspRoutineSessionRef=ST_Exten
          DcmDspRoutineStopOut
            ResData (DcmDspRoutineStopOutSignal): DcmDspRoutineSignalLength=8, DcmDspRoutineSignalType=UINT8_N, DcmDspRoutineSignalEndianness=opaque, DcmDspRoutineSignalPos=0
          DcmDspStartRoutineOut
            ResData (DcmDspStartRoutineOutSignal): DcmDspRoutineSignalLength=8, DcmDspRoutineSignalType=UINT8_N, DcmDspRoutineSignalEndianness=opaque, DcmDspRoutineSignalPos=0
        DidInfo_TABROW_HVBatteBackFlowTempeWrite_Read (DcmDspDidInfo)
          DcmDspDidAccess
            DcmDspDidRead: DcmDspDidReadSessionRef=ST_Defau, DcmDspDidReadSessionRef=ST_Exten
        DID_TABROW_HVBatteBackFlowTempeWrite_Read (DcmDspDid):
          DcmDspDidIdentifier = 768
          DcmDspDidUsed = true
          DcmDspDidUsePort = USE_DATA_ELEMENT_SPECIFIC_INTERFACES
          DcmDspDidInfoRef = DidInfo_TABROW_HVBatteBackFlowTempeWrite_Read
          DcmDspDidSignal: DcmDspDidDataPos=0, DcmDspDidDataRef=Data_TABROW_HVBatteBackFlowTempeWrite_Read
        Data_TABROW_HVBatteBackFlowTempeWrite_Read (DcmDspData):
          DcmDspDataSize = 64
          DcmDspDataType = UINT8_N
          DcmDspDataUsePort = USE_DATA_ASYNCH_CLIENT_SERVER
          DcmDspDataInfoRef = DataInfo_TABROW_HVBatteBackFlowTempeWrite_Read
        DataInfo_TABROW_HVBatteBackFlowTempeWrite_Read (DcmDspDataInfo): DcmDspDataFixedLength=true
      DcmPageBufferCfg: DcmPagedBufferEnabled=true
      DcmProcessingConditions
        7 x DcmModeRule, all with DcmModeRuleNrcValue=51:
          ExtendedSFDRole: DcmLogicalOperator=DCM_OR, DcmArgumentRef=DcmModeCondition_ExtendedSFDRole
          EptiSFDRole: DcmLogicalOperator=DCM_OR, DcmArgumentRef=DcmModeCondition_EptiSFDRole
          E2eSFDMode: DcmLogicalOperator=DCM_OR, DcmArgumentRef=DcmModeCondition_E2eSFDMode
          OtaSFDRole: DcmLogicalOperator=DCM_OR, DcmArgumentRef=DcmModeCondition_OtaSFDRole
          SuperUserSFDRole: DcmLogicalOperator=DCM_AND, DcmArgumentRef=DcmModeCondition_SuperUserSFDRole
          BasicSFDRole: DcmLogicalOperator=DCM_OR, DcmArgumentRef=DcmModeCondition_BasicSFDRole
          ProductionSFDRole: DcmLogicalOperator=DCM_OR, DcmArgumentRef=DcmModeCondition_ProductionSFDRole, DcmArgumentRef=BasicSFDRole
        7 x DcmModeCondition, all with DcmConditionType=DCM_EQUALS:
          DcmModeCondition_BasicSFDRole: DcmBswModeRef=BasicSFDRole.ALLOW
          DcmModeCondition_E2eSFDMode: DcmBswModeRef=E2eSFDRole.ALLOW
          DcmModeCondition_EptiSFDRole: DcmBswModeRef=EptiSFDRole.ALLOW
          DcmModeCondition_ExtendedSFDRole: DcmBswModeRef=ExtendedSFDRole.ALLOW
          DcmModeCondition_OtaSFDRole: DcmBswModeRef=OtaSFDRole.ALLOW
          DcmModeCondition_ProductionSFDRole: DcmBswModeRef=ProductionSFDRole.ALLOW
          DcmModeCondition_SuperUserSFDRole: DcmBswModeRef=SuperUserSFDRole.ALLOW
