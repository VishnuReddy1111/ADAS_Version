[part 1 of 2: package /ActiveEcuC]
AUTOSAR XML (schema 4-3-0)
package /ActiveEcuC
  module config Dcm: implementation-config-variant=VARIANT-PRE-COMPILE, module-description=Dcm_Impl
    DcmConfigSet
      DcmDsl
        DcmDslProtocol
          DcmDslProtocolRow_29812fbf (DcmDslProtocolRow):
            DcmDslProtocolEndiannessConvEnabled = false
            DcmDslProtocolID = DCM_UDS_ON_CAN
            DcmDslProtocolPreemptTimeout = 0
            DcmDslProtocolPriority = 0
            DcmSendRespPendOnTransToBoot = true
            DcmTimStrP2ServerAdjust = 0
            DcmTimStrP2StarServerAdjust = 0
            DcmSendRespPendOnRestart = true
            DcmDslProtocolMaximumResponseSize = 4095
            DcmDslProtocolRxBufferID = DcmDslBuffer
            DcmDslProtocolSIDTable = DcmDsdServiceTable
            DcmDslProtocolTxBufferID = DcmDslBuffer
            DcmDemClientRef = DemClient_DCM
            5 x DcmDslConnection:
              DC_BMC_HV_XIX_TPCHType_CANFD_OBDC_Diagnose_5cd3446c
                DC_BMC_HV_XIX_TPCHType_CANFD_OBDC_Diagnose_5cd3446c (DcmDslMainConnection): DcmDslProtocolRxTesterSourceAddr=635, DcmDslProtocolRxConnectionId=1
                  DCM_HCP5_CANFD01_XIX_TPCHType_CANFD_OBDC_Diagnose_XIX_0x1C40027B_XIX_0x1C42027B_XIX_Physical_a0b6e66f_Rx_3f2403cf (DcmDslProtocolRx):
                    DcmDslProtocolRxAddrType = DCM_PHYSICAL_TYPE
                    DcmDslProtocolRxPduId = 4
                    DcmDslProtocolRxChannelId = 0
                    DcmDslProtocolRxComMChannelRef = CN_HCP5_CANFD01_54d90215
                    DcmDslProtocolRxPduRef = DCM_HCP5_CANFD01_XIX_TPCHType_CANFD_OBDC_Diagnose_XIX_0x1C40027B_XIX_0x1C42027B_XIX_Physical_a0b6e66f_Rx
                  DCM_HCP5_CANFD01_XIX_TPCHType_CANFD_OBDC_Diagnose_XIX_0x1C42027B_XIX_0x1C40027B_XIX_Physical_c887ac0a_Tx_5714768d (DcmDslProtocolTx):
                    DcmDslTxConfirmationPduId = 2
                    DcmDslProtocolTxPduRef = DCM_HCP5_CANFD01_XIX_TPCHType_CANFD_OBDC_Diagnose_XIX_0x1C42027B_XIX_0x1C40027B_XIX_Physical_c887ac0a_Tx
                  DCM_HCP5_CANFD01_XIX_TPCHType_CANFD_OBDC_Diagnose_XIX_0x1C410200_XIX_Functional_967cb818_Rx_064eb1bf (DcmDslProtocolRx):
                    DcmDslProtocolRxAddrType = DCM_FUNCTIONAL_TYPE
                    DcmDslProtocolRxPduId = 5
                    DcmDslProtocolRxChannelId = 0
                    DcmDslProtocolRxComMChannelRef = CN_HCP5_CANFD01_54d90215
                    DcmDslProtocolRxPduRef = DCM_HCP5_CANFD01_XIX_TPCHType_CANFD_OBDC_Diagnose_XIX_0x1C410200_XIX_Functional_967cb818_Rx
              DC_BMC_HV_XIX_TPCHType_CANHS_OBDx_e24363dc
                DC_BMC_HV_XIX_TPCHType_CANHS_OBDx_e24363dc (DcmDslMainConnection): DcmDslProtocolRxTesterSourceAddr=1521, DcmDslProtocolRxConnectionId=2
                  DCM_HCP5_CANFD01_XIX_TPCHType_CANHS_OBDx_XIX_0x18DAF105_XIX_0x18DA05F1_XIX_Physical_9db247ca_Tx_acb0bc5a (DcmDslProtocolTx):
                    DcmDslTxConfirmationPduId = 4
                    DcmDslProtocolTxPduRef = DCM_HCP5_CANFD01_XIX_TPCHType_CANHS_OBDx_XIX_0x18DAF105_XIX_0x18DA05F1_XIX_Physical_9db247ca_Tx
                  DCM_HCP5_CANFD01_XIX_TPCHType_CANHS_OBDx_XIX_0x18DA05F1_XIX_0x18DAF105_XIX_Physical_c08ed539_Rx_739699a5 (DcmDslProtocolRx):
                    DcmDslProtocolRxAddrType = DCM_PHYSICAL_TYPE
                    DcmDslProtocolRxPduId = 7
                    DcmDslProtocolRxChannelId = 0
                    DcmDslProtocolRxComMChannelRef = CN_HCP5_CANFD01_54d90215
                    DcmDslProtocolRxPduRef = DCM_HCP5_CANFD01_XIX_TPCHType_CANHS_OBDx_XIX_0x18DA05F1_XIX_0x18DAF105_XIX_Physical_c08ed539_Rx
              DC_BMC_HV_XIX_TPCHType_CANHS_ISO_Diagnose_31d8ad05
                DC_BMC_HV_XIX_TPCHType_CANHS_ISO_Diagnose_31d8ad05 (DcmDslMainConnection): DcmDslProtocolRxTesterSourceAddr=123, DcmDslProtocolRxConnectionId=3
                  DCM_HCP5_CANFD01_XIX_TPCHType_CANHS_ISO_Diagnose_XIX_0x17FC007B_XIX_0x17FE007B_XIX_Physical_f4a1250c_Rx_ab17daed (DcmDslProtocolRx):
                    DcmDslProtocolRxAddrType = DCM_PHYSICAL_TYPE
                    DcmDslProtocolRxPduId = 6
                    DcmDslProtocolRxChannelId = 0
                    DcmDslProtocolRxComMChannelRef = CN_HCP5_CANFD01_54d90215
                    DcmDslProtocolRxPduRef = DCM_HCP5_CANFD01_XIX_TPCHType_CANHS_ISO_Diagnose_XIX_0x17FC007B_XIX_0x17FE007B_XIX_Physical_f4a1250c_Rx
                  DCM_HCP5_CANFD01_XIX_TPCHType_CANHS_ISO_Diagnose_XIX_0x17FE007B_XIX_0x17FC007B_XIX_Physical_4cf2fba3_Tx_920245bd (DcmDslProtocolTx):
                    DcmDslTxConfirmationPduId = 3
                    DcmDslProtocolTxPduRef = DCM_HCP5_CANFD01_XIX_TPCHType_CANHS_ISO_Diagnose_XIX_0x17FE007B_XIX_0x17FC007B_XIX_Physical_4cf2fba3_Tx
              DC_BMC_HV_XIX_TPCHType_CANFD_ISO_Diagnose_dfd423dc
                DC_BMC_HV_XIX_TPCHType_CANFD_ISO_Diagnose_dfd423dc (DcmDslMainConnection): DcmDslProtocolRxTesterSourceAddr=123, DcmDslProtocolRxConnectionId=4
                  DCM_HCP5_CANFD01_XIX_TPCHType_CANFD_ISO_Diagnose_XIX_0x1C410000_XIX_Functional_012ca6ee_Rx_de537ab2 (DcmDslProtocolRx):
                    DcmDslProtocolRxAddrType = DCM_FUNCTIONAL_TYPE
                    DcmDslProtocolRxPduId = 3
                    DcmDslProtocolRxChannelId = 0
                    DcmDslProtocolRxComMChannelRef = CN_HCP5_CANFD01_54d90215
                    DcmDslProtocolRxPduRef = DCM_HCP5_CANFD01_XIX_TPCHType_CANFD_ISO_Diagnose_XIX_0x1C410000_XIX_Functional_012ca6ee_Rx
                  DCM_HCP5_CANFD01_XIX_TPCHType_CANFD_ISO_Diagnose_XIX_0x1C42007B_XIX_0x1C40007B_XIX_Physical_4bbc7f71_Tx_29646996 (DcmDslProtocolTx):
                    DcmDslTxConfirmationPduId = 1
                    DcmDslProtocolTxPduRef = DCM_HCP5_CANFD01_XIX_TPCHType_CANFD_ISO_Diagnose_XIX_0x1C42007B_XIX_0x1C40007B_XIX_Physical_4bbc7f71_Tx
                  DCM_HCP5_CANFD01_XIX_TPCHType_CANFD_ISO_Diagnose_XIX_0x1C40007B_XIX_0x1C42007B_XIX_Physical_238d3514_Rx_0eb3e0c5 (DcmDslProtocolRx):
                    DcmDslProtocolRxAddrType = DCM_PHYSICAL_TYPE
                    DcmDslProtocolRxPduId = 2
                    DcmDslProtocolRxChannelId = 0
                    DcmDslProtocolRxComMChannelRef = CN_HCP5_CANFD01_54d90215
                    DcmDslProtocolRxPduRef = DCM_HCP5_CANFD01_XIX_TPCHType_CANFD_ISO_Diagnose_XIX_0x1C40007B_XIX_0x1C42007B_XIX_Physical_238d3514_Rx
              CDD_HCP5_CANFD01_XIX_TPCHType_CANFD_DAAP_01
                DcmDslMainConnection: DcmDslProtocolRxTesterSourceAddr=65535, DcmDslProtocolRxConnectionId=0
                  DcmDslProtocolRx:
                    DcmDslProtocolRxAddrType = DCM_PHYSICAL_TYPE
                    DcmDslProtocolRxChannelId = 0
                    DcmDslProtocolRxPduId = 0
                    DcmDslProtocolRxPduRef = CDD_HCP5_CANFD01_XIX_TPCHType_CANFD_DAAP_XIX_0x1C403F7B_XIX_0x1C423F7B_XIX_Physical_3bee6131_Rx
                    DcmDslProtocolRxComMChannelRef = CN_HCP5_CANFD01_54d90215
                  DcmDslProtocolRx_001 (DcmDslProtocolRx):
                    DcmDslProtocolRxAddrType = DCM_FUNCTIONAL_TYPE
                    DcmDslProtocolRxChannelId = 0
                    DcmDslProtocolRxPduId = 1
                    DcmDslProtocolRxPduRef = CDD_HCP5_CANFD01_XIX_TPCHType_CANFD_DAAP_XIX_0x1C413FDD_XIX_Functional_6530545d_Rx
                    DcmDslProtocolRxComMChannelRef = CN_HCP5_CANFD01_54d90215
                  DcmDslProtocolTx:
                    DcmDslTxConfirmationPduId = 0
                    DcmDslProtocolTxPduRef = CDD_HCP5_CANFD01_XIX_TPCHType_CANFD_DAAP_XIX_0x1C423F7B_XIX_0x1C403F7B_XIX_Physical_53df2b54_Tx
        DcmDslDiagResp: DcmDslDiagRespMaxNumRespPend=0, DcmDslDiagRespOnSecondDeclinedRequest=false, DcmDslDiagRespMaxNumOfDeclinedRequests=3
        DcmDslBuffer: DcmDslBufferSize=8195
        DcmDslBuffer_002 (DcmDslBuffer): DcmDslBufferSize=8195
        DcmDslServiceRequestManufacturerNotification:
          DcmDslServiceRequestManufacturerNotificationUsePort = false
          DcmDslServiceRequestManufacturerNotificationConfirmationFnc = vFotaH_DcmConfirmationCallout
          DcmDslServiceRequestManufacturerNotificationIndicationFnc = vFotaH_DcmIndicationCallout
      DcmGeneral:
        DcmResetToFblAfterSessionFinalResponseEnabled = false
        DcmDevErrorDetect = true
        DcmRequestManufacturerNotificationEnabled = false
        DcmRequestSupplierNotificationEnabled = false
        DcmRespondAllRequest = true
        DcmTaskTime = 0.01
        DcmVersionInfoApi = true
        DcmDspDataDefaultEndianness = LITTLE_ENDIAN
        DcmSafeBswChecks = false
        DcmSupportedIDCalculationSuppressionEnabled = false
        DcmDtrDataProvisionViaDemEnabled = true
        DcmForeignDiagnosticRequestDetectionEnabled = false
        DcmSuppressResponseOnCanTpFuncMixedAddrRequests = false
        DcmSenderReceiverPRPortsEnabled = false
        DcmAutosarVersion = AUTOSAR_4_02_02
      DcmDsd
        DcmDsdServiceTable
          12 x DcmDsdService:
            ClearDiagInfo: DcmDsdSidTabServiceId=20, DcmDsdSidTabSubfuncAvail=false
            EcuReset: DcmDsdSidTabServiceId=17, DcmDsdSidTabSubfuncAvail=true
              Hard (DcmDsdSubService): DcmDsdSubServiceId=1, DcmDsdSubServiceSessionLevelRef=ST_Exten
              KeyOffOn (DcmDsdSubService): DcmDsdSubServiceId=2, DcmDsdSubServiceSessionLevelRef=ST_Defau, DcmDsdSubServiceSessionLevelRef=ST_Exten
            ControlDtcSetting: DcmDsdSidTabServiceId=133, DcmDsdSidTabSubfuncAvail=true, DcmDsdSidTabSessionLevelRef=ST_Exten, DcmDsdSidTabSessionLevelRef=ST_Progr
              Disable (DcmDsdSubService): DcmDsdSubServiceId=2, DcmDsdSubServiceSessionLevelRef=ST_Exten, DcmDsdSubServiceSessionLevelRef=ST_Progr
              Enable (DcmDsdSubService): DcmDsdSubServiceId=1, DcmDsdSubServiceSessionLevelRef=ST_Exten, DcmDsdSubServiceSessionLevelRef=ST_Progr
            WriteDataById: DcmDsdSidTabServiceId=46, DcmDsdSidTabSubfuncAvail=false
            ReadDataById: DcmDsdSidTabServiceId=34, DcmDsdSidTabSubfuncAvail=false
            ReadDtcInfo: DcmDsdSidTabServiceId=25, DcmDsdSidTabSubfuncAvail=true
              11 x DcmDsdSubService:
                RDTCSSI: DcmDsdSubServiceId=3, DcmDsdSubServiceSessionLevelRef=ST_Defau, DcmDsdSubServiceSessionLevelRef=ST_Exten
                RDTCBSM: DcmDsdSubServiceId=2, DcmDsdSubServiceSessionLevelRef=ST_Defau, DcmDsdSubServiceSessionLevelRef=ST_Exten
                RNODTCBSM: DcmDsdSubServiceId=1, DcmDsdSubServiceSessionLevelRef=ST_Defau, DcmDsdSubServiceSessionLevelRef=ST_Exten
                RDTCSSBDTC: DcmDsdSubServiceId=4, DcmDsdSubServiceSessionLevelRef=ST_Defau, DcmDsdSubServiceSessionLevelRef=ST_Exten
                RMRCDTC: DcmDsdSubServiceId=14, DcmDsdSubServiceSessionLevelRef=ST_Defau, DcmDsdSubServiceSessionLevelRef=ST_Exten
                RDTCEDRBDN: DcmDsdSubServiceId=6, DcmDsdSubServiceSessionLevelRef=ST_Defau, DcmDsdSubServiceSessionLevelRef=ST_Exten
                RDTCBRGI: DcmDsdSubServiceId=86
                RWWHOBDDTCWPS: DcmDsdSubServiceId=85
                RDTCEDI: DcmDsdSubServiceId=26
                RWWHOBDDTCBMR: DcmDsdSubServiceId=66
                RDTCFDC: DcmDsdSubServiceId=20
            TesterPresent: DcmDsdSidTabServiceId=62, DcmDsdSidTabSubfuncAvail=true
              TesterPresent (DcmDsdSubService): DcmDsdSubServiceId=0
            CommunicationControl: DcmDsdSidTabServiceId=40, DcmDsdSidTabSubfuncAvail=true, DcmDsdSidTabSessionLevelRef=ST_Exten, DcmDsdSidTabSessionLevelRef=ST_Progr
              EnableRxAndDisableTx (DcmDsdSubService): DcmDsdSubServiceId=1, DcmDsdSubServiceSessionLevelRef=ST_Exten, DcmDsdSubServiceSessionLevelRef=ST_Progr
              EnableRxAndTx (DcmDsdSubService): DcmDsdSubServiceId=0, DcmDsdSubServiceSessionLevelRef=ST_Exten, DcmDsdSubServiceSessionLevelRef=ST_Progr
            RoutineControl: DcmDsdSidTabServiceId=49, DcmDsdSidTabSubfuncAvail=true
            DiagSessionControl: DcmDsdSidTabServiceId=16, DcmDsdSidTabSubfuncAvail=true
              3 x DcmDsdSubService:
                Programming: DcmDsdSubServiceId=2, DcmDsdSubServiceSessionLevelRef=ST_Exten, DcmDsdSubServiceSessionLevelRef=ST_Progr
                Default: DcmDsdSubServiceId=1
                Extended: DcmDsdSubServiceId=3
            ResponseOnEvent: DcmDsdSidTabServiceId=134, DcmDsdSidTabSubfuncAvail=true, DcmDsdSidTabSessionLevelRef=ST_Defau, DcmDsdSidTabSessionLevelRef=ST_Exten
              4 x DcmDsdSubService, all with DcmDsdSubServiceSessionLevelRef=ST_Defau, DcmDsdSubServiceSessionLevelRef=ST_Exten:
                Clear: DcmDsdSubServiceId=6
                OnDtcStatChg: DcmDsdSubServiceId=1
                Start: DcmDsdSubServiceId=5
                Stop: DcmDsdSubServiceId=0
            SecurityAccess: DcmDsdSidTabServiceId=39, DcmDsdSidTabSubfuncAvail=true, DcmDsdSidTabSessionLevelRef=ST_Exten, DcmDsdSidTabSessionLevelRef=ST_Progr
              4 x DcmDsdSubService:
                KeyLevel_1: DcmDsdSubServiceId=2, DcmDsdSubServiceSessionLevelRef=ST_Progr, DcmDsdSubServiceSessionLevelRef=ST_Exten, DcmDsdSubServiceSessionLevelRef=ST_Defau
                SeedLevel_1: DcmDsdSubServiceId=1, DcmDsdSubServiceSessionLevelRef=ST_Progr, DcmDsdSubServiceSessionLevelRef=ST_Exten, DcmDsdSubServiceSessionLevelRef=ST_Defau
                Keylevel_2: DcmDsdSubServiceId=3
                SeedLevel_2: DcmDsdSubServiceId=4
      DcmDsp: DcmDspMaxDidToRead=8, DcmDspReadDIDReportsNODIByte=false
        DcmDspSecurity: DcmDspSecurityResetAttemptCounterOnTimeout=false
          Unlock_L1 (DcmDspSecurityRow):
            DcmDspSecurityAttemptCounterEnabled = false
            DcmDspSecurityDelayTime = 10
            DcmDspSecurityDelayTimeOnBoot = 0
            DcmDspSecurityKeySize = 4
            DcmDspSecurityLevel = 1
            DcmDspSecurityNumAttDelay = 3
            DcmDspSecuritySeedSize = 4
            DcmDspSecurityUsePort = USE_ASYNCH_CLIENT_SERVER
          UnLock_L2 (DcmDspSecurityRow):
            DcmDspSecurityAttemptCounterEnabled = false
            DcmDspSecurityDelayTime = 10
            DcmDspSecurityDelayTimeOnBoot = 0
            DcmDspSecurityKeySize = 4
            DcmDspSecurityLevel = 2
            DcmDspSecurityNumAttDelay = 5
            DcmDspSecuritySeedSize = 4
            DcmDspSecurityUsePort = USE_ASYNCH_CLIENT_SERVER
        DcmDspControlDTCSetting: DcmSupportDTCSettingControlOptionRecord=true
        ComControl (DcmDspComControl)
          DspComContolAllChannel (DcmDspComControlAllChannel): DcmDspAllComMChannelRef=CN_BMC_CAN01_78a85e89
        DcmDspSession
          3 x DcmDspSessionRow, all with DcmDspSessionP2ServerMax=0.05, DcmDspSessionP2StarServerMax=5, DcmDspSessionForBoot=DCM_NO_BOOT:
            ST_Exten: DcmDspSessionLevel=3
            ST_Defau: DcmDspSessionLevel=1
            ST_Progr: DcmDspSessionLevel=2
        DidInfo_DID_StartApplication (DcmDspDidInfo)
          DcmDspDidAccess
            DcmDspDidRead
            DcmDspDidWrite
        DataInfo_DID_StartApplication (DcmDspDataInfo): DcmDspDataFixedLength=true
        Data_DID_StartApplication (DcmDspData): DcmDspDataSize=16, DcmDspDataUsePort=USE_DATA_SYNCH_CLIENT_SERVER, DcmDspDataType=UINT16, DcmDspDataInfoRef=DataInfo_DID_StartApplication
        DID_StartApplication (DcmDspDid): DcmDspDidIdentifier=85, DcmDspDidUsed=true, DcmDspDidUsePort=USE_DATA_ELEMENT_SPECIFIC_INTERFACES, DcmDspDidInfoRef=DidInfo_DID_StartApplication
          DcmDspDidSignal_Data_DID_StartApplication (DcmDspDidSignal): DcmDspDidDataPos=0, DcmDspDidDataRef=Data_DID_StartApplication
        DcmDspMemory: DcmDspUseMemoryId=false
          DcmDspMemoryIdInfo
            DcmDspReadMemoryRangeInfo: DcmDspReadMemoryRangeHigh=2684420095, DcmDspReadMemoryRangeLow=2684354560
            DcmDspWriteMemoryRangeInfo: DcmDspWriteMemoryRangeHigh=2684420095, DcmDspWriteMemoryRangeLow=2684354560
        Data_DiagnServi_TABROW_NeuMeasu_Read_56 (DcmDspData):
          DcmDspDataSize = 8
          DcmDspDataType = UINT8_N
          DcmDspDataUsePort = USE_DATA_ASYNCH_CLIENT_SERVER
          DcmDspDataInfoRef = DataInfo_DiagnServi_TABROW_NeuMeasu_Read_56
        DID_HV_battery_continuous_charging_power_Read_Data_By_Identifier (DcmDspDid):
          DcmDspDidIdentifier = 780
          DcmDspDidUsed = true
          DcmDspDidUsePort = USE_DATA_ELEMENT_SPECIFIC_INTERFACES
          DcmDspDidInfoRef = DidInfo_HV_battery_continuous_charging_power_Read_Data_By_Identifier
          DcmDspDidSignal: DcmDspDidDataPos=0, DcmDspDidDataRef=Data_HV_battery_continuous_charging_power_Read_Data_By_Identifier
        Data_Prozessorauslastung_Read_Data_By_Identifier (DcmDspData):
          DcmDspDataSize = 32
          DcmDspDataType = UINT8_N
          DcmDspDataUsePort = USE_DATA_ASYNCH_CLIENT_SERVER
          DcmDspDataInfoRef = DataInfo_Prozessorauslastung_Read_Data_By_Identifier
        Data_DiagnServi_TABROW_NeuMeasu_Read_55 (DcmDspData):
          DcmDspDataSize = 880
          DcmDspDataType = UINT8_N
          DcmDspDataUsePort = USE_DATA_ASYNCH_CLIENT_SERVER
          DcmDspDataInfoRef = DataInfo_DiagnServi_TABROW_NeuMeasu_Read_55
        DidInfo_HV_battery_continuous_discharge_power_Read_Data_By_Identifier (DcmDspDidInfo)
          DcmDspDidAccess
            DcmDspDidRead: DcmDspDidReadSessionRef=ST_Defau, DcmDspDidReadSessionRef=ST_Exten
        DataInfo_DiagnServi_TABROW_NeuMeasu_Read_36_1 (DcmDspDataInfo): DcmDspDataFixedLength=true
        Data_DiagnServi_TABROW_NeuMeasu_Read_53 (DcmDspData):
          DcmDspDataSize = 96
          DcmDspDataType = UINT8_N
          DcmDspDataUsePort = USE_DATA_ASYNCH_CLIENT_SERVER
          DcmDspDataInfoRef = DataInfo_DiagnServi_TABROW_NeuMeasu_Read_53
        DataInfo_DiagnServi_BMC_serial_number_Read (DcmDspDataInfo): DcmDspDataFixedLength=true
        DataInfo_TABROW_SOKTimeInfor_Read_Data_By_Identifier (DcmDspDataInfo): DcmDspDataFixedLength=true
        DidInfo_DiagnServi_TABROW_VWDataSetNumbeOrECUDataContaNumbe_Read (DcmDspDidInfo)
          DcmDspDidAccess
            DcmDspDidWrite: DcmDspDidWriteSessionRef=ST_Exten
            DcmDspDidRead: DcmDspDidReadSessionRef=ST_Defau, DcmDspDidReadSessionRef=ST_Exten
        DidInfo_TABROW_CellVoltaMinim_ReadDataByIdent (DcmDspDidInfo)
          DcmDspDidAccess
            DcmDspDidRead: DcmDspDidReadSessionRef=ST_Defau, DcmDspDidReadSessionRef=ST_Exten
        Routine_DiagnServi_TABROW_ResetHVBatteAfterSepar_Start_Routine (DcmDspRoutine):
          DcmDspRequestResultsRoutineSupported = true
          DcmDspStopRoutineSupported = true
          DcmDspRoutineIdentifier = 792
          DcmDspRoutineFixedLength = false
          DcmDspRoutineUsePort = true
          DcmDspRoutineUsed = true
          DcmDspRoutineInfoRef = RoutineInfo_DiagnServi_TABROW_ResetHVBatteAfterSepar_Start_Routine
        RoutineInfo_DiagnServi_RoutiContrCheckProgrDepen (DcmDspRoutineInfo)
          DcmDspRoutineAuthorization: DcmDspRoutineSessionRef=ST_Progr
          DcmDspStartRoutineOut
            ResData (DcmDspStartRoutineOutSignal): DcmDspRoutineSignalLength=8, DcmDspRoutineSignalType=UINT8_N, DcmDspRoutineSignalEndianness=opaque, DcmDspRoutineSignalPos=0
        DataInfo_Battery_technical_state_of_charge_Read_Data_By_Identifier (DcmDspDataInfo): DcmDspDataFixedLength=true
        3 x DcmDspData, all with DcmDspDataType=UINT8_N, DcmDspDataUsePort=USE_DATA_ASYNCH_CLIENT_SERVER:
          Data_DiagnServi_TABROW_NeuMeasu_Read_52: DcmDspDataSize=384, DcmDspDataInfoRef=DataInfo_DiagnServi_TABROW_NeuMeasu_Read_52
          Data_DiagnServi_TABROW_NeuMeasu_Read_51: DcmDspDataSize=8, DcmDspDataInfoRef=DataInfo_DiagnServi_TABROW_NeuMeasu_Read_51
          Data_DiagnServi_TABROW_NeuMeasu_Read_50: DcmDspDataSize=16, DcmDspDataInfoRef=DataInfo_DiagnServi_TABROW_NeuMeasu_Read_50
        DID_HV_battery_performance_indicator_discharging_Read_Data_By_Identifier (DcmDspDid):
          DcmDspDidIdentifier = 789
          DcmDspDidUsed = true
          DcmDspDidUsePort = USE_DATA_ELEMENT_SPECIFIC_INTERFACES
          DcmDspDidInfoRef = DidInfo_HV_battery_performance_indicator_discharging_Read_Data_By_Identifier
          DcmDspDidSignal: DcmDspDidDataPos=0, DcmDspDidDataRef=Data_HV_battery_performance_indicator_discharging_Read_Data_By_Identifier
        DidInfo_TABROW_KnockTimer_Read (DcmDspDidInfo)
          DcmDspDidAccess
            DcmDspDidWrite: DcmDspDidWriteSessionRef=ST_Exten
            DcmDspDidRead: DcmDspDidReadSessionRef=ST_Defau, DcmDspDidReadSessionRef=ST_Exten
        Data_DiagnServi_TABROW_DID0xEFD_Read_1_1_1 (DcmDspData):
          DcmDspDataSize = 32
          DcmDspDataType = UINT8_N
          DcmDspDataUsePort = USE_DATA_ASYNCH_CLIENT_SERVER
          DcmDspDataInfoRef = DataInfo_DiagnServi_TABROW_DID0xEFD_Read_1_1_1
        DID_BMC_Mode_Read_Data_By_Identifier (DcmDspDid):
          DcmDspDidIdentifier = 1294
          DcmDspDidUsed = true
          DcmDspDidUsePort = USE_DATA_ELEMENT_SPECIFIC_INTERFACES
          DcmDspDidInfoRef = DidInfo_BMC_Mode_Read_Data_By_Identifier
          DcmDspDidSignal: DcmDspDidDataPos=0, DcmDspDidDataRef=Data_BMC_Mode_Read_Data_By_Identifier
        DataInfo_HV_battery_maximum_charging_power_Read_Data_By_Identifier (DcmDspDataInfo): DcmDspDataFixedLength=true
        Data_DiagnServi_Assembly_part_number_Read (DcmDspData):
          DcmDspDataSize = 88
          DcmDspDataType = UINT8_N
          DcmDspDataUsePort = USE_DATA_ASYNCH_CLIENT_SERVER
          DcmDspDataInfoRef = DataInfo_DiagnServi_Assembly_part_number_Read
          DcmDspDataBlockIdRef = CddNpmGen2_MeasurementsType
        Data_TABROW_SOKVerifFaileList_Read_Data_By_Identifier (DcmDspData):
          DcmDspDataSize = 4096
          DcmDspDataType = UINT8_N
          DcmDspDataUsePort = USE_DATA_ASYNCH_CLIENT_SERVER
          DcmDspDataInfoRef = DataInfo_TABROW_SOKVerifFaileList_Read_Data_By_Identifier
        DataInfo_DiagnServi_TABROW_NeuMeasu_Read_36_3 (DcmDspDataInfo): DcmDspDataFixedLength=true
        DataInfo_TABROW_FingeAndProgrDateOfLogicSoftwBlock_Read (DcmDspDataInfo): DcmDspDataFixedLength=false
        Data_TABROW_BatteTempeMaxim_ReadDataByIdent (DcmDspData):
          DcmDspDataSize = 32
          DcmDspDataType = UINT8_N
          DcmDspDataUsePort = USE_DATA_ASYNCH_CLIENT_SERVER
          DcmDspDataInfoRef = DataInfo_TABROW_BatteTempeMaxim_ReadDataByIdent
        Data_Battery_contactors_actual_states_Read_Data_By_Identifier (DcmDspData):
          DcmDspDataSize = 16
          DcmDspDataType = UINT8_N
          DcmDspDataUsePort = USE_DATA_ASYNCH_CLIENT_SERVER
          DcmDspDataInfoRef = DataInfo_Battery_contactors_actual_states_Read_Data_By_Identifier
        DID_DiagnServi_TABROW_NeuMeasu_Read_59_2 (DcmDspDid):
          DcmDspDidIdentifier = 1750
          DcmDspDidUsed = true
          DcmDspDidUsePort = USE_DATA_ELEMENT_SPECIFIC_INTERFACES
          DcmDspDidInfoRef = DidInfo_DiagnServi_TABROW_NeuMeasu_Read_59_2
          DcmDspDidSignal: DcmDspDidDataPos=0, DcmDspDidDataRef=Data_DiagnServi_TABROW_NeuMeasu_Read_59_2
        DID_TABROW_TABROSyste_Read_1_1_1_1_1_1_1 (DcmDspDid):
          DcmDspDidIdentifier = 57397
          DcmDspDidUsed = true
          DcmDspDidUsePort = USE_DATA_ELEMENT_SPECIFIC_INTERFACES
          DcmDspDidInfoRef = DidInfo_TABROW_TABROSyste_Read_1_1_1_1_1_1_1
          DcmDspDidSignal: DcmDspDidDataPos=0, DcmDspDidDataRef=Data_TABROW_TABROSyste_Read_1_1_1_1_1_1_1
        DidInfo_HV_Spannung_Nebenverbraucher_Read_Data_By_Identifier (DcmDspDidInfo)
          DcmDspDidAccess
            DcmDspDidRead: DcmDspDidReadSessionRef=ST_Defau, DcmDspDidReadSessionRef=ST_Exten
        DataInfo_DiagnServi_TABROW_EnginCoolaTempe_Read (DcmDspDataInfo): DcmDspDataFixedLength=true
        Data_DiagnServi_TABROW_Finge_Read (DcmDspData):
          DcmDspDataSize = 72
          DcmDspDataType = UINT8_N
          DcmDspDataUsePort = USE_DATA_ASYNCH_CLIENT_SERVER
          DcmDspDataInfoRef = DataInfo_DiagnServi_TABROW_Finge_Read
        Data_DiagnServi_TABROW_NeuMeasu_Read_63 (DcmDspData):
          DcmDspDataSize = 256
          DcmDspDataType = UINT8_N
          DcmDspDataUsePort = USE_DATA_ASYNCH_CLIENT_SERVER
          DcmDspDataInfoRef = DataInfo_DiagnServi_TABROW_NeuMeasu_Read_63
        DataInfo_TABROW_IsolaResisSysteMinus_ReadDataByIdent (DcmDspDataInfo): DcmDspDataFixedLength=true
        Data_DiagnServi_TABROW_NeuMeasu_Read_61 (DcmDspData):
          DcmDspDataSize = 24
          DcmDspDataType = UINT8_N
          DcmDspDataUsePort = USE_DATA_ASYNCH_CLIENT_SERVER
          DcmDspDataInfoRef = DataInfo_DiagnServi_TABROW_NeuMeasu_Read_61
        Data_DiagnServi_TABROW_NeuMeasu_Read_60 (DcmDspData):
          DcmDspDataSize = 16
          DcmDspDataType = UINT8_N
          DcmDspDataUsePort = USE_DATA_ASYNCH_CLIENT_SERVER
          DcmDspDataInfoRef = DataInfo_DiagnServi_TABROW_NeuMeasu_Read_60
        DataInfo_DiagnServi_TABROW_TechnSpeciVersi_Read (DcmDspDataInfo): DcmDspDataFixedLength=true
        DataInfo_Battery_displayed_state_of_charge_Read_Data_By_Identifier (DcmDspDataInfo): DcmDspDataFixedLength=true
        DID_TABROW_SOKSignaFaileList_Read_Data_By_Identifier (DcmDspDid):
          DcmDspDidIdentifier = 399
          DcmDspDidUsed = true
          DcmDspDidUsePort = USE_DATA_ELEMENT_SPECIFIC_INTERFACES
          DcmDspDidInfoRef = DidInfo_TABROW_SOKSignaFaileList_Read_Data_By_Identifier
          DcmDspDidSignal: DcmDspDidDataPos=0, DcmDspDidDataRef=Data_TABROW_SOKSignaFaileList_Read_Data_By_Identifier
        Routine_DiagnServi_TABROW_VkmsGetPssHash_Start_Routine (DcmDspRoutine):
          DcmDspRequestResultsRoutineSupported = true
          DcmDspStopRoutineSupported = false
          DcmDspRoutineIdentifier = 49165
          DcmDspRoutineFixedLength = false
          DcmDspRoutineUsePort = true
          DcmDspRoutineUsed = true
          DcmDspRoutineInfoRef = RoutineInfo_DiagnServi_TABROW_VkmsGetPssHash_Start_Routine
        DataInfo_BMC_IWU_Status_Read_Data_By_Identifier (DcmDspDataInfo): DcmDspDataFixedLength=true
        5 x DcmDspData, all with DcmDspDataType=UINT8_N, DcmDspDataUsePort=USE_DATA_ASYNCH_CLIENT_SERVER:
          Data_DiagnServi_TABROW_NeuMeasu_Read_34: DcmDspDataSize=8, DcmDspDataInfoRef=DataInfo_DiagnServi_TABROW_NeuMeasu_Read_34
          Data_DiagnServi_TABROW_NeuMeasu_Read_33: DcmDspDataSize=24, DcmDspDataInfoRef=DataInfo_DiagnServi_TABROW_NeuMeasu_Read_33
          Data_DiagnServi_TABROW_NeuMeasu_Read_32: DcmDspDataSize=8, DcmDspDataInfoRef=DataInfo_DiagnServi_TABROW_NeuMeasu_Read_32
          Data_DiagnServi_TABROW_NeuMeasu_Read_31: DcmDspDataSize=8, DcmDspDataInfoRef=DataInfo_DiagnServi_TABROW_NeuMeasu_Read_31
          Data_DiagnServi_TABROW_NeuMeasu_Read_38: DcmDspDataSize=8, DcmDspDataInfoRef=DataInfo_DiagnServi_TABROW_NeuMeasu_Read_38
        DataInfo_Battery_banks_actual_mode_Read_Data_By_Identifier (DcmDspDataInfo): DcmDspDataFixedLength=true
        Data_DiagnServi_TABROW_NeuMeasu_Read_37 (DcmDspData):
          DcmDspDataSize = 16
          DcmDspDataType = UINT8_N
          DcmDspDataUsePort = USE_DATA_ASYNCH_CLIENT_SERVER
          DcmDspDataInfoRef = DataInfo_DiagnServi_TABROW_NeuMeasu_Read_37
        DidInfo_DiagnServi_TABROW_NeuMeasu_Read_46_1_1_1_1_1_1_2_2 (DcmDspDidInfo)
          DcmDspDidAccess
            DcmDspDidRead: DcmDspDidReadSessionRef=ST_Defau, DcmDspDidReadSessionRef=ST_Exten
        Data_DiagnServi_TABROW_AUTOSStandAppliSoftwIdent_Read (DcmDspData):
          DcmDspDataType = UINT8_N
          DcmDspDataSize = 65535
          DcmDspDataUsePort = USE_DATA_ASYNCH_CLIENT_SERVER
          DcmDspDataInfoRef = DataInfo_DiagnServi_TABROW_AUTOSStandAppliSoftwIdent_Read
        Data_DiagnServi_TABROW_NeuMeasu_Read_36 (DcmDspData):
          DcmDspDataSize = 16
          DcmDspDataType = UINT8_N
          DcmDspDataUsePort = USE_DATA_ASYNCH_CLIENT_SERVER
          DcmDspDataInfoRef = DataInfo_DiagnServi_TABROW_NeuMeasu_Read_36
        DidInfo_DiagnServi_TABROW_NeuMeasu_Read_46_1_1_1_1_1_1_2_3 (DcmDspDidInfo)
          DcmDspDidAccess
            DcmDspDidRead: DcmDspDidReadSessionRef=ST_Defau, DcmDspDidReadSessionRef=ST_Exten
        Data_DiagnServi_TABROW_NeuMeasu_Read_35 (DcmDspData):
          DcmDspDataSize = 40
          DcmDspDataType = UINT8_N
          DcmDspDataUsePort = USE_DATA_ASYNCH_CLIENT_SERVER
          DcmDspDataInfoRef = DataInfo_DiagnServi_TABROW_NeuMeasu_Read_35
        DidInfo_DiagnServi_TABROW_NeuMeasu_Read_46_1_1_1_1_1_1_2_1 (DcmDspDidInfo)
          DcmDspDidAccess
            DcmDspDidRead: DcmDspDidReadSessionRef=ST_Defau, DcmDspDidReadSessionRef=ST_Exten
        DID_DiagnServi_TABROW_NeuMeasu_Read_46_1_1_1_1_1 (DcmDspDid):
          DcmDspDidIdentifier = 1462
          DcmDspDidUsed = true
          DcmDspDidUsePort = USE_DATA_ELEMENT_SPECIFIC_INTERFACES
          DcmDspDidInfoRef = DidInfo_DiagnServi_TABROW_NeuMeasu_Read_46_1_1_1_1_1
          DcmDspDidSignal: DcmDspDidDataPos=0, DcmDspDidDataRef=Data_DiagnServi_TABROW_NeuMeasu_Read_46_1_1_1_1_1
        DataInfo_TABROW_TABROSyste_Read_1_1_1_1_1_1_1_1_1_1_1_1_1 (DcmDspDataInfo): DcmDspDataFixedLength=true
        DataInfo_Battery_energy_content_actual_Read_Data_By_Identifier (DcmDspDataInfo): DcmDspDataFixedLength=true
        Data_DiagnServi_TABROW_NeuMeasu_Read_30 (DcmDspData):
          DcmDspDataSize = 16
          DcmDspDataType = UINT8_N
          DcmDspDataUsePort = USE_DATA_ASYNCH_CLIENT_SERVER
          DcmDspDataInfoRef = DataInfo_DiagnServi_TABROW_NeuMeasu_Read_30
        DID_TABROW_VWECUHardwVersiNumbe_Read (DcmDspDid):
          DcmDspDidIdentifier = 61859
          DcmDspDidUsed = true
          DcmDspDidUsePort = USE_DATA_ELEMENT_SPECIFIC_INTERFACES
          DcmDspDidInfoRef = DidInfo_TABROW_VWECUHardwVersiNumbe_Read
          DcmDspDidSignal: DcmDspDidDataPos=0, DcmDspDidDataRef=Data_TABROW_VWECUHardwVersiNumbe_Read
        DID_DiagnServi_TABROW_NeuMeasu_Read_63_1_1_1 (DcmDspDid):
          DcmDspDidIdentifier = 57361
          DcmDspDidUsed = true
          DcmDspDidUsePort = USE_DATA_ELEMENT_SPECIFIC_INTERFACES
          DcmDspDidInfoRef = DidInfo_DiagnServi_TABROW_NeuMeasu_Read_63_1_1_1
          DcmDspDidSignal: DcmDspDidDataPos=0, DcmDspDidDataRef=Data_DiagnServi_TABROW_NeuMeasu_Read_63_1_1_1
        DidInfo_DiagnServi_TABROW_NeuMeasu_Read_46_1_1_1_1_1 (DcmDspDidInfo)
          DcmDspDidAccess
            DcmDspDidRead: DcmDspDidReadSessionRef=ST_Defau, DcmDspDidReadSessionRef=ST_Exten
        DID_TABROW_TABROSyste_Read_1_1_1_1_1_1 (DcmDspDid):
          DcmDspDidIdentifier = 57396
          DcmDspDidUsed = true
          DcmDspDidUsePort = USE_DATA_ELEMENT_SPECIFIC_INTERFACES
          DcmDspDidInfoRef = DidInfo_TABROW_TABROSyste_Read_1_1_1_1_1_1
          DcmDspDidSignal: DcmDspDidDataPos=0, DcmDspDidDataRef=Data_TABROW_TABROSyste_Read_1_1_1_1_1_1
        Data_DiagnServi_ReadDataByIdentASAMODXFileIdent (DcmDspData):
          DcmDspDataSize = 200
          DcmDspDataType = UINT8_N
          DcmDspDataUsePort = USE_DATA_ASYNCH_CLIENT_SERVER
          DcmDspDataInfoRef = DataInfo_DiagnServi_ReadDataByIdentASAMODXFileIdent
        DidInfo_Battery_flow_temperature_Read_Data_By_Identifier (DcmDspDidInfo)
          DcmDspDidAccess
            DcmDspDidRead: DcmDspDidReadSessionRef=ST_Defau, DcmDspDidReadSessionRef=ST_Exten
        DataInfo_TABROW_VWLogicSoftwBlockLockValue_Read (DcmDspDataInfo): DcmDspDataFixedLength=false
        RoutineInfo_DiagnServi_TABROW_ResetHealiInhib_Start_Routine (DcmDspRoutineInfo)
          DcmDspStartRoutineIn
            ReqData (DcmDspStartRoutineInSignal): DcmDspRoutineSignalLength=8, DcmDspRoutineSignalType=UINT8_N, DcmDspRoutineSignalEndianness=opaque, DcmDspRoutineSignalPos=0
          DcmDspRoutineAuthorization: DcmDspRoutineSessionRef=ST_Exten
          DcmDspStartRoutineOut
            ResData (DcmDspStartRoutineOutSignal): DcmDspRoutineSignalLength=8, DcmDspRoutineSignalType=UINT8_N, DcmDspRoutineSignalEndianness=opaque, DcmDspRoutineSignalPos=0
        DidInfo_TABROW_StateOfBatteMIL_ReadDataByIdent (DcmDspDidInfo)
          DcmDspDidAccess
            DcmDspDidRead: DcmDspDidReadSessionRef=ST_Defau, DcmDspDidReadSessionRef=ST_Exten
        RoutineInfo_DiagnServi_TABROW_ResetProteOfVehicDiagn_Start_Routine (DcmDspRoutineInfo)
          DcmDspStartRoutineIn
            ReqData (DcmDspStartRoutineInSignal): DcmDspRoutineSignalLength=3736, DcmDspRoutineSignalType=VARIABLE_LENGTH, DcmDspRoutineSignalEndianness=opaque, DcmDspRoutineSignalPos=0
          DcmDspRoutineAuthorization: DcmDspRoutineSessionRef=ST_Exten
          DcmDspStartRoutineOut
            ResData (DcmDspStartRoutineOutSignal): DcmDspRoutineSignalLength=16, DcmDspRoutineSignalType=UINT8_N, DcmDspRoutineSignalEndianness=opaque, DcmDspRoutineSignalPos=0
        Data_DiagnServi_TABROW_NeuMeasu_Read_29 (DcmDspData):
          DcmDspDataSize = 96
          DcmDspDataType = UINT8_N
          DcmDspDataUsePort = USE_DATA_ASYNCH_CLIENT_SERVER
          DcmDspDataInfoRef = DataInfo_DiagnServi_TABROW_NeuMeasu_Read_29
        Data_DiagnServi_TABROW_NeuMeasu_Read_28 (DcmDspData):
          DcmDspDataSize = 64
          DcmDspDataType = UINT8_N
          DcmDspDataUsePort = USE_DATA_ASYNCH_CLIENT_SERVER
          DcmDspDataInfoRef = DataInfo_DiagnServi_TABROW_NeuMeasu_Read_28
        DidInfo_HV_battery_performance_indicator_discharging_Read_Data_By_Identifier (DcmDspDidInfo)
          DcmDspDidAccess
            DcmDspDidRead: DcmDspDidReadSessionRef=ST_Defau, DcmDspDidReadSessionRef=ST_Exten
        Data_DiagnServi_TABROW_NeuMeasu_Read_45 (DcmDspData):
          DcmDspDataSize = 48
          DcmDspDataType = UINT8_N
          DcmDspDataUsePort = USE_DATA_ASYNCH_CLIENT_SERVER
          DcmDspDataInfoRef = DataInfo_DiagnServi_TABROW_NeuMeasu_Read_45
        DidInfo_Prozessorauslastung_Read_Data_By_Identifier (DcmDspDidInfo)
          DcmDspDidAccess
            DcmDspDidRead: DcmDspDidReadSessionRef=ST_Defau, DcmDspDidReadSessionRef=ST_Exten
        5 x DcmDspData, all with DcmDspDataType=UINT8_N, DcmDspDataUsePort=USE_DATA_ASYNCH_CLIENT_SERVER:
          Data_DiagnServi_TABROW_NeuMeasu_Read_43: DcmDspDataSize=512, DcmDspDataInfoRef=DataInfo_DiagnServi_TABROW_NeuMeasu_Read_43
          Data_DiagnServi_TABROW_NeuMeasu_Read_42: DcmDspDataSize=8, DcmDspDataInfoRef=DataInfo_DiagnServi_TABROW_NeuMeasu_Read_42
          Data_DiagnServi_TABROW_NeuMeasu_Read_49: DcmDspDataSize=16, DcmDspDataInfoRef=DataInfo_DiagnServi_TABROW_NeuMeasu_Read_49
          Data_DiagnServi_TABROW_NeuMeasu_Read_48: DcmDspDataSize=192, DcmDspDataInfoRef=DataInfo_DiagnServi_TABROW_NeuMeasu_Read_48
          Data_DiagnServi_TABROW_NeuMeasu_Read_47: DcmDspDataSize=16, DcmDspDataInfoRef=DataInfo_DiagnServi_TABROW_NeuMeasu_Read_47
        DataInfo_TABROW_CellStateOfChargMaxim_ReadDataByIdent (DcmDspDataInfo): DcmDspDataFixedLength=true
        Data_DiagnServi_TABROW_NeuMeasu_Read_46 (DcmDspData):
          DcmDspDataSize = 1216
          DcmDspDataType = UINT8_N
          DcmDspDataUsePort = USE_DATA_ASYNCH_CLIENT_SERVER
          DcmDspDataInfoRef = DataInfo_DiagnServi_TABROW_NeuMeasu_Read_46
        DidInfo_DiagnServi_TABROW_NeuMeasu_Read_43_1_1 (DcmDspDidInfo)
          DcmDspDidAccess
            DcmDspDidRead: DcmDspDidReadSessionRef=ST_Defau, DcmDspDidReadSessionRef=ST_Exten
        DataInfo_Battery_flow_temperature_Read_Data_By_Identifier (DcmDspDataInfo): DcmDspDataFixedLength=true
        DataInfo_TABROW_ECUStandMode2_Read (DcmDspDataInfo): DcmDspDataFixedLength=true
        3 x DcmDspData, all with DcmDspDataType=UINT8_N, DcmDspDataUsePort=USE_DATA_ASYNCH_CLIENT_SERVER:
          Data_High_voltage_battery_total_voltage_Read_Data_By_Identifier: DcmDspDataSize=32, DcmDspDataInfoRef=DataInfo_High_voltage_battery_total_voltage_Read_Data_By_Identifier
          Data_DiagnServi_TABROW_NeuMeasu_Read_41: DcmDspDataSize=112, DcmDspDataInfoRef=DataInfo_DiagnServi_TABROW_NeuMeasu_Read_41
          Data_DiagnServi_TABROW_NeuMeasu_Read_40: DcmDspDataSize=32, DcmDspDataInfoRef=DataInfo_DiagnServi_TABROW_NeuMeasu_Read_40
        DID_DiagnServi_TABROW_SuppoPIDs4160_Read (DcmDspDid):
          DcmDspDidIdentifier = 62528
          DcmDspDidUsed = true
          DcmDspDidUsePort = USE_DATA_ELEMENT_SPECIFIC_INTERFACES
          DcmDspDidInfoRef = DidInfo_DiagnServi_TABROW_SuppoPIDs4160_Read
        Data_DiagnServi_TABROW_NeuMeasu_Read (DcmDspData):
          DcmDspDataSize = 24
          DcmDspDataType = UINT8_N
          DcmDspDataUsePort = USE_DATA_ASYNCH_CLIENT_SERVER
          DcmDspDataInfoRef = DataInfo_DiagnServi_TABROW_NeuMeasu_Read
        5 x DcmDspDidInfo:
          DidInfo_DiagnServi_TABROW_NeuMeasu_Read_14
            DcmDspDidAccess
              DcmDspDidRead: DcmDspDidReadSessionRef=ST_Defau, DcmDspDidReadSessionRef=ST_Exten
          DidInfo_DiagnServi_TABROW_NeuMeasu_Read_13
            DcmDspDidAccess
              DcmDspDidRead: DcmDspDidReadSessionRef=ST_Defau, DcmDspDidReadSessionRef=ST_Exten
          DidInfo_DiagnServi_TABROW_NeuMeasu_Read_12
            DcmDspDidAccess
              DcmDspDidRead: DcmDspDidReadSessionRef=ST_Defau, DcmDspDidReadSessionRef=ST_Exten
          DidInfo_DiagnServi_TABROW_NeuMeasu_Read_11
            DcmDspDidAccess
              DcmDspDidRead: DcmDspDidReadSessionRef=ST_Defau, DcmDspDidReadSessionRef=ST_Exten
          DidInfo_DiagnServi_TABROW_NeuMeasu_Read_10
            DcmDspDidAccess
              DcmDspDidRead: DcmDspDidReadSessionRef=ST_Defau, DcmDspDidReadSessionRef=ST_Exten
        Data_DiagnServi_TABROW_NeuMeasu_Read_8_2 (DcmDspData):
          DcmDspDataSize = 24
          DcmDspDataType = UINT8_N
          DcmDspDataUsePort = USE_DATA_ASYNCH_CLIENT_SERVER
          DcmDspDataInfoRef = DataInfo_DiagnServi_TABROW_NeuMeasu_Read_8_2
        Data_DiagnServi_TABROW_NeuMeasu_Read_8_1 (DcmDspData):
          DcmDspDataSize = 16
          DcmDspDataType = UINT8_N
          DcmDspDataUsePort = USE_DATA_ASYNCH_CLIENT_SERVER
          DcmDspDataInfoRef = DataInfo_DiagnServi_TABROW_NeuMeasu_Read_8_1
        DidInfo_DiagnServi_TABROW_NeuMeasu_Read_19 (DcmDspDidInfo)
          DcmDspDidAccess
            DcmDspDidRead: DcmDspDidReadSessionRef=ST_Defau, DcmDspDidReadSessionRef=ST_Exten
        Data_DiagnServi_TABROW_NeuMeasu_Read_39 (DcmDspData):
          DcmDspDataSize = 8
          DcmDspDataType = UINT8_N
          DcmDspDataUsePort = USE_DATA_ASYNCH_CLIENT_SERVER
          DcmDspDataInfoRef = DataInfo_DiagnServi_TABROW_NeuMeasu_Read_39
        5 x DcmDspDidInfo:
          DidInfo_DiagnServi_TABROW_NeuMeasu_Read_18
            DcmDspDidAccess
              DcmDspDidRead: DcmDspDidReadSessionRef=ST_Defau, DcmDspDidReadSessionRef=ST_Exten
          DidInfo_DiagnServi_SOH_Read
            DcmDspDidAccess
              DcmDspDidRead: DcmDspDidReadSessionRef=ST_Defau, DcmDspDidReadSessionRef=ST_Exten
          DidInfo_DiagnServi_TABROW_NeuMeasu_Read_17
            DcmDspDidAccess
              DcmDspDidRead: DcmDspDidReadSessionRef=ST_Defau, DcmDspDidReadSessionRef=ST_Exten
          DidInfo_DiagnServi_TABROW_NeuMeasu_Read_16
            DcmDspDidAccess
              DcmDspDidRead: DcmDspDidReadSessionRef=ST_Defau, DcmDspDidReadSessionRef=ST_Exten
          DidInfo_DiagnServi_TABROW_NeuMeasu_Read_15
            DcmDspDidAccess
              DcmDspDidRead: DcmDspDidReadSessionRef=ST_Defau, DcmDspDidReadSessionRef=ST_Exten
        DID_DiagnServi_TABROW_NeuECUIdent_Read (DcmDspDid):
          DcmDspDidIdentifier = 49415
          DcmDspDidUsed = true
          DcmDspDidUsePort = USE_DATA_ELEMENT_SPECIFIC_INTERFACES
          DcmDspDidInfoRef = DidInfo_DiagnServi_TABROW_NeuECUIdent_Read
          DcmDspDidSignal: DcmDspDidDataPos=0, DcmDspDidDataRef=Data_DiagnServi_TABROW_NeuECUIdent_Read
        DID_DiagnServi_TABROW_NeuMeasu_Read_22_1 (DcmDspDid):
          DcmDspDidIdentifier = 1668
          DcmDspDidUsed = true
          DcmDspDidUsePort = USE_DATA_ELEMENT_SPECIFIC_INTERFACES
          DcmDspDidInfoRef = DidInfo_DiagnServi_TABROW_NeuMeasu_Read_22_1
          DcmDspDidSignal: DcmDspDidDataPos=0, DcmDspDidDataRef=Data_DiagnServi_TABROW_NeuMeasu_Read_22_1
        3 x DcmDspDidInfo:
          DidInfo_TABROW_TABROSyste_Read_1_1_1_1_1_1_1_1_1
            DcmDspDidAccess
              DcmDspDidRead
          DidInfo_DiagnServi_TABROW_NeuMeasu_Read_43_1
            DcmDspDidAccess
              DcmDspDidRead: DcmDspDidReadSessionRef=ST_Defau, DcmDspDidReadSessionRef=ST_Exten
          DidInfo_DiagnServi_TABROW_ECUNA_Read
            DcmDspDidAccess
              DcmDspDidRead: DcmDspDidReadSessionRef=ST_Defau, DcmDspDidReadSessionRef=ST_Exten
        DID_TABROW_VWLogicSoftwBlockLockValue_Read (DcmDspDid):
          DcmDspDidIdentifier = 1039
          DcmDspDidUsed = true
          DcmDspDidUsePort = USE_DATA_ELEMENT_SPECIFIC_INTERFACES
          DcmDspDidInfoRef = DidInfo_TABROW_VWLogicSoftwBlockLockValue_Read
          DcmDspDidSignal: DcmDspDidDataPos=0, DcmDspDidDataRef=Data_TABROW_VWLogicSoftwBlockLockValue_Read
        Data_DiagnServi_TABROW_EnginCoolaTempe_Read (DcmDspData):
          DcmDspDataSize = 8
          DcmDspDataType = UINT8_N
          DcmDspDataUsePort = USE_DATA_ASYNCH_CLIENT_SERVER
          DcmDspDataInfoRef = DataInfo_DiagnServi_TABROW_EnginCoolaTempe_Read
        4 x DcmDspDidInfo:
          DidInfo_DiagnServi_TABROW_NeuMeasu_Read_25
            DcmDspDidAccess
              DcmDspDidRead: DcmDspDidReadSessionRef=ST_Defau, DcmDspDidReadSessionRef=ST_Exten
          DidInfo_DiagnServi_TABROW_NeuMeasu_Read_24
            DcmDspDidAccess
              DcmDspDidRead: DcmDspDidReadSessionRef=ST_Defau, DcmDspDidReadSessionRef=ST_Exten
          DidInfo_DiagnServi_TABROW_NeuMeasu_Read_23
            DcmDspDidAccess
              DcmDspDidRead: DcmDspDidReadSessionRef=ST_Defau, DcmDspDidReadSessionRef=ST_Exten
          DidInfo_DiagnServi_TABROW_NeuMeasu_Read_20
            DcmDspDidAccess
              DcmDspDidRead: DcmDspDidReadSessionRef=ST_Defau, DcmDspDidReadSessionRef=ST_Exten
        DataInfo_DiagnServi_TABROW_NeuMeasu_Read_46_1_1_1_1_1_1 (DcmDspDataInfo): DcmDspDataFixedLength=true
        DID_TABROW_KnockCount_Read (DcmDspDid):
          DcmDspDidIdentifier = 714
          DcmDspDidUsed = true
          DcmDspDidUsePort = USE_DATA_ELEMENT_SPECIFIC_INTERFACES
          DcmDspDidInfoRef = DidInfo_TABROW_KnockCount_Read
          DcmDspDidSignal: DcmDspDidDataPos=0, DcmDspDidDataRef=Data_TABROW_KnockCount_Read
        DataInfo_DiagnServi_HV_battery_modules_actual_voltage_Read (DcmDspDataInfo): DcmDspDataFixedLength=true
        DidInfo_DiagnServi_TABROW_NeuMeasu_Read_29 (DcmDspDidInfo)
          DcmDspDidAccess
            DcmDspDidRead: DcmDspDidReadSessionRef=ST_Defau, DcmDspDidReadSessionRef=ST_Exten
        DidInfo_DiagnServi_TABROW_NeuMeasu_Read_28 (DcmDspDidInfo)
          DcmDspDidAccess
            DcmDspDidRead: DcmDspDidReadSessionRef=ST_Defau, DcmDspDidReadSessionRef=ST_Exten
        Data_DiagnServi_TABROW_NeuMeasu_Read_22_1 (DcmDspData):
          DcmDspDataSize = 16
          DcmDspDataType = UINT8_N
          DcmDspDataUsePort = USE_DATA_ASYNCH_CLIENT_SERVER
          DcmDspDataInfoRef = DataInfo_DiagnServi_TABROW_NeuMeasu_Read_22_1
        3 x DcmDspDidInfo:
          DidInfo_DiagnServi_TABROW_NeuMeasu_Read_27
            DcmDspDidAccess
              DcmDspDidRead: DcmDspDidReadSessionRef=ST_Defau, DcmDspDidReadSessionRef=ST_Exten
          DidInfo_DiagnServi_TABROW_NeuMeasu_Read_26
            DcmDspDidAccess
              DcmDspDidRead: DcmDspDidReadSessionRef=ST_Defau, DcmDspDidReadSessionRef=ST_Exten
          DidInfo_Battery_energy_content_actual_Read_Data_By_Identifier
            DcmDspDidAccess
              DcmDspDidRead: DcmDspDidReadSessionRef=ST_Defau, DcmDspDidReadSessionRef=ST_Exten
        Data_DiagnServi_TABROW_NeuMeasu_Read_27_2_1 (DcmDspData):
          DcmDspDataSize = 216
          DcmDspDataType = UINT8_N
          DcmDspDataUsePort = USE_DATA_ASYNCH_CLIENT_SERVER
          DcmDspDataInfoRef = DataInfo_DiagnServi_TABROW_NeuMeasu_Read_27_2_1
        DID_DiagnServi_TABROW_NeuMeasu_Read_57_1 (DcmDspDid):
          DcmDspDidIdentifier = 1615
          DcmDspDidUsed = true
          DcmDspDidUsePort = USE_DATA_ELEMENT_SPECIFIC_INTERFACES
          DcmDspDidInfoRef = DidInfo_DiagnServi_TABROW_NeuMeasu_Read_57_1
          DcmDspDidSignal: DcmDspDidDataPos=0, DcmDspDidDataRef=Data_DiagnServi_TABROW_NeuMeasu_Read_57_1
        Data_BMC_Status_DCLS_Read_Data_By_Identifier (DcmDspData):
          DcmDspDataSize = 8
          DcmDspDataType = UINT8_N
          DcmDspDataUsePort = USE_DATA_ASYNCH_CLIENT_SERVER
          DcmDspDataInfoRef = DataInfo_BMC_Status_DCLS_Read_Data_By_Identifier
        DataInfo_DiagnServi_TABROW_NeuMeasu_Read_33_1_1_1_1_1_1_1_1_1_1_1_1_1_1_1_1_1_1_1_1_1_1_1_2_1_1_1 (DcmDspDataInfo): DcmDspDataFixedLength=true
        DID_TABROW_StatePCM_ReadDataByIdent (DcmDspDid):
          DcmDspDidIdentifier = 802
          DcmDspDidUsed = true
          DcmDspDidUsePort = USE_DATA_ELEMENT_SPECIFIC_INTERFACES
          DcmDspDidInfoRef = DidInfo_TABROW_StatePCM_ReadDataByIdent
          DcmDspDidSignal: DcmDspDidDataPos=0, DcmDspDidDataRef=Data_TABROW_StatePCM_ReadDataByIdent
        DidInfo_DiagnServi_TABROW_NeuMeasu_Read_36 (DcmDspDidInfo)
          DcmDspDidAccess
            DcmDspDidRead: DcmDspDidReadSessionRef=ST_Defau, DcmDspDidReadSessionRef=ST_Exten
        DataInfo_TABROW_KnockCount_Read (DcmDspDataInfo): DcmDspDataFixedLength=true
        DidInfo_DiagnServi_TABROW_NeuMeasu_Read_35 (DcmDspDidInfo)
          DcmDspDidAccess
            DcmDspDidRead: DcmDspDidReadSessionRef=ST_Defau, DcmDspDidReadSessionRef=ST_Exten
        DidInfo_DiagnServi_TABROW_NeuMeasu_Read_34 (DcmDspDidInfo)
          DcmDspDidAccess
            DcmDspDidRead: DcmDspDidReadSessionRef=ST_Defau, DcmDspDidReadSessionRef=ST_Exten
        DID_DiagnServi_TABROW_SysteSupplIdent_Read (DcmDspDid):
          DcmDspDidIdentifier = 61834
          DcmDspDidUsed = true
          DcmDspDidUsePort = USE_DATA_ELEMENT_SPECIFIC_INTERFACES
          DcmDspDidInfoRef = DidInfo_DiagnServi_TABROW_SysteSupplIdent_Read
          DcmDspDidSignal: DcmDspDidDataPos=0, DcmDspDidDataRef=Data_DiagnServi_TABROW_SysteSupplIdent_Read
        DID_High_voltage_battery_total_voltage_Read_Data_By_Identifier (DcmDspDid):
          DcmDspDidIdentifier = 1435
          DcmDspDidUsed = true
          DcmDspDidUsePort = USE_DATA_ELEMENT_SPECIFIC_INTERFACES
          DcmDspDidInfoRef = DidInfo_High_voltage_battery_total_voltage_Read_Data_By_Identifier
          DcmDspDidSignal: DcmDspDidDataPos=0, DcmDspDidDataRef=Data_High_voltage_battery_total_voltage_Read_Data_By_Identifier
        RoutineInfo_DiagnServi_TABROW_ResetHVBatteAfterSepar_Start_Routine (DcmDspRoutineInfo)
          DcmDspRoutineRequestResOut
            ResData (DcmDspRoutineRequestResOutSignal): DcmDspRoutineSignalLength=40, DcmDspRoutineSignalType=UINT8_N, DcmDspRoutineSignalEndianness=opaque, DcmDspRoutineSignalPos=0
          DcmDspRoutineAuthorization: DcmDspRoutineSessionRef=ST_Exten
          DcmDspRoutineStopOut
            ResData (DcmDspRoutineStopOutSignal): DcmDspRoutineSignalLength=8, DcmDspRoutineSignalType=UINT8_N, DcmDspRoutineSignalEndianness=opaque, DcmDspRoutineSignalPos=0
          DcmDspStartRoutineOut
            ResData (DcmDspStartRoutineOutSignal): DcmDspRoutineSignalLength=8, DcmDspRoutineSignalType=UINT8_N, DcmDspRoutineSignalEndianness=opaque, DcmDspRoutineSignalPos=0
        4 x DcmDspDidInfo:
          DidInfo_DiagnServi_TABROW_NeuMeasu_Read_33
            DcmDspDidAccess
              DcmDspDidRead: DcmDspDidReadSessionRef=ST_Defau, DcmDspDidReadSessionRef=ST_Exten
          DidInfo_DiagnServi_TABROW_NeuMeasu_Read_32
            DcmDspDidAccess
              DcmDspDidRead: DcmDspDidReadSessionRef=ST_Defau, DcmDspDidReadSessionRef=ST_Exten
          DidInfo_DiagnServi_TABROW_NeuMeasu_Read_31
            DcmDspDidAccess
              DcmDspDidRead: DcmDspDidReadSessionRef=ST_Defau, DcmDspDidReadSessionRef=ST_Exten
          DidInfo_DiagnServi_TABROW_NeuMeasu_Read_30
            DcmDspDidAccess
              DcmDspDidRead: DcmDspDidReadSessionRef=ST_Defau, DcmDspDidReadSessionRef=ST_Exten
        DID_Battery_technical_state_of_charge_Read_Data_By_Identifier (DcmDspDid):
          DcmDspDidIdentifier = 10013
          DcmDspDidUsed = true
          DcmDspDidUsePort = USE_DATA_ELEMENT_SPECIFIC_INTERFACES
          DcmDspDidInfoRef = DidInfo_Battery_technical_state_of_charge_Read_Data_By_Identifier
          DcmDspDidSignal: DcmDspDidDataPos=0, DcmDspDidDataRef=Data_Battery_technical_state_of_charge_Read_Data_By_Identifier
        Data_DiagnServi_TABROW_NeuMeasu_Read_57_1 (DcmDspData):
          DcmDspDataSize = 16
          DcmDspDataType = UINT8_N
          DcmDspDataUsePort = USE_DATA_ASYNCH_CLIENT_SERVER
          DcmDspDataInfoRef = DataInfo_DiagnServi_TABROW_NeuMeasu_Read_57_1
        DataInfo_DiagnServi_TABROW_NeuMeasu_Read_49_1 (DcmDspDataInfo): DcmDspDataFixedLength=true
        DidInfo_DiagnServi_TABROW_ActivDiagnSessi_Read (DcmDspDidInfo)
          DcmDspDidAccess
            DcmDspDidRead
        DidInfo_DiagnServi_TABROW_NeuMeasu_Read_39 (DcmDspDidInfo)
          DcmDspDidAccess
            DcmDspDidRead: DcmDspDidReadSessionRef=ST_Defau, DcmDspDidReadSessionRef=ST_Exten
        Data_DiagnServi_TABROW_NeuMeasu_Read_46_1_1_1 (DcmDspData):
          DcmDspDataSize = 1216
          DcmDspDataType = UINT8_N
          DcmDspDataUsePort = USE_DATA_ASYNCH_CLIENT_SERVER
          DcmDspDataInfoRef = DataInfo_DiagnServi_TABROW_NeuMeasu_Read_46_1_1_1
        DidInfo_DiagnServi_TABROW_NeuMeasu_Read_38 (DcmDspDidInfo)
          DcmDspDidAccess
            DcmDspDidRead: DcmDspDidReadSessionRef=ST_Defau, DcmDspDidReadSessionRef=ST_Exten
        Data_DiagnServi_TABROW_NeuMeasu_Read_43_1_1_1_1_1_1_1_1_1_1_1 (DcmDspData):
          DcmDspDataSize = 512
          DcmDspDataType = UINT8_N
          DcmDspDataUsePort = USE_DATA_ASYNCH_CLIENT_SERVER
          DcmDspDataInfoRef = DataInfo_DiagnServi_TABROW_NeuMeasu_Read_43_1_1_1_1_1_1_1_1_1_1_1
        DidInfo_DiagnServi_TABROW_NeuMeasu_Read_37 (DcmDspDidInfo)
          DcmDspDidAccess
            DcmDspDidRead: DcmDspDidReadSessionRef=ST_Defau, DcmDspDidReadSessionRef=ST_Exten
        Data_DiagnServi_ReadDataByIdentBasicSettiStatu (DcmDspData):
          DcmDspDataSize = 8
          DcmDspDataType = UINT8_N
          DcmDspDataUsePort = USE_DATA_ASYNCH_CLIENT_SERVER
          DcmDspDataInfoRef = DataInfo_DiagnServi_ReadDataByIdentBasicSettiStatu
        Data_DiagnServi_TABROW_DID0xEFD_Read_1_1 (DcmDspData):
          DcmDspDataSize = 32
          DcmDspDataType = UINT8_N
          DcmDspDataUsePort = USE_DATA_ASYNCH_CLIENT_SERVER
          DcmDspDataInfoRef = DataInfo_DiagnServi_TABROW_DID0xEFD_Read_1_1
        DidInfo_DiagnServi_TABROW_MonitStatuSinceDTCsClear_Read (DcmDspDidInfo)
          DcmDspDidAccess
            DcmDspDidRead: DcmDspDidReadSessionRef=ST_Defau, DcmDspDidReadSessionRef=ST_Exten
        Data_DiagnServi_TABROW_DID0xEFD_Read_1_2 (DcmDspData):
          DcmDspDataSize = 32
          DcmDspDataType = UINT8_N
          DcmDspDataUsePort = USE_DATA_ASYNCH_CLIENT_SERVER
          DcmDspDataInfoRef = DataInfo_DiagnServi_TABROW_DID0xEFD_Read_1_2
        DidInfo_DiagnServi_TABROW_NeuMeasu_Read_21_1 (DcmDspDidInfo)
          DcmDspDidAccess
            DcmDspDidRead: DcmDspDidReadSessionRef=ST_Defau, DcmDspDidReadSessionRef=ST_Exten
        DidInfo_DiagnServi_TABROW_NeuMeasu_Read_21_2 (DcmDspDidInfo)
          DcmDspDidAccess
            DcmDspDidRead: DcmDspDidReadSessionRef=ST_Defau, DcmDspDidReadSessionRef=ST_Exten
        DID_DiagnServi_TABROW_NeuMeasu_Read_46_1 (DcmDspDid):
          DcmDspDidIdentifier = 1458
          DcmDspDidUsed = true
          DcmDspDidUsePort = USE_DATA_ELEMENT_SPECIFIC_INTERFACES
          DcmDspDidInfoRef = DidInfo_DiagnServi_TABROW_NeuMeasu_Read_46_1
          DcmDspDidSignal: DcmDspDidDataPos=0, DcmDspDidDataRef=Data_DiagnServi_TABROW_NeuMeasu_Read_46_1
        DID_DiagnServi_TABROW_SuppoINFOT0120_Read (DcmDspDid):
          DcmDspDidIdentifier = 63488
          DcmDspDidUsed = true
          DcmDspDidUsePort = USE_DATA_ELEMENT_SPECIFIC_INTERFACES
          DcmDspDidInfoRef = DidInfo_DiagnServi_TABROW_SuppoINFOT0120_Read
        DataInfo_DiagnServi_TABROW_EnginRPM_Read (DcmDspDataInfo): DcmDspDataFixedLength=true
        5 x DcmDspData, all with DcmDspDataType=UINT8_N, DcmDspDataUsePort=USE_DATA_ASYNCH_CLIENT_SERVER:
          Data_DiagnServi_TABROW_NeuMeasu_Read_70: DcmDspDataSize=3088, DcmDspDataInfoRef=DataInfo_DiagnServi_TABROW_NeuMeasu_Read_70
          Data_DiagnServi_TABROW_NeuMeasu_Read_74: DcmDspDataSize=16, DcmDspDataInfoRef=DataInfo_DiagnServi_TABROW_NeuMeasu_Read_74
          Data_DiagnServi_TABROW_NeuMeasu_Read_73: DcmDspDataSize=32, DcmDspDataInfoRef=DataInfo_DiagnServi_TABROW_NeuMeasu_Read_73
          Data_DiagnServi_TABROW_NeuMeasu_Read_72: DcmDspDataSize=16, DcmDspDataInfoRef=DataInfo_DiagnServi_TABROW_NeuMeasu_Read_72
          Data_DiagnServi_TABROW_NeuMeasu_Read_71: DcmDspDataSize=32, DcmDspDataInfoRef=DataInfo_DiagnServi_TABROW_NeuMeasu_Read_71
        DidInfo_DiagnServi_TABROW_NeuMeasu_Read_47 (DcmDspDidInfo)
          DcmDspDidAccess
            DcmDspDidRead: DcmDspDidReadSessionRef=ST_Defau, DcmDspDidReadSessionRef=ST_Exten
        DataInfo_Zero_Potential_Status_Read_Data_By_Identifier (DcmDspDataInfo): DcmDspDataFixedLength=true
        DidInfo_DiagnServi_TABROW_NeuMeasu_Read_46 (DcmDspDidInfo)
          DcmDspDidAccess
            DcmDspDidRead: DcmDspDidReadSessionRef=ST_Defau, DcmDspDidReadSessionRef=ST_Exten
        Data_HV_Battery_thermal_load_Read_Data_By_Identifier (DcmDspData):
          DcmDspDataSize = 800
          DcmDspDataType = UINT8_N
          DcmDspDataUsePort = USE_DATA_ASYNCH_CLIENT_SERVER
          DcmDspDataInfoRef = DataInfo_HV_Battery_thermal_load_Read_Data_By_Identifier
        6 x DcmDspDidInfo:
          DidInfo_DiagnServi_TABROW_NeuMeasu_Read_45
            DcmDspDidAccess
              DcmDspDidRead: DcmDspDidReadSessionRef=ST_Defau, DcmDspDidReadSessionRef=ST_Exten
          DidInfo_DiagnServi_TABROW_NeuMeasu_Read_43
            DcmDspDidAccess
              DcmDspDidRead: DcmDspDidReadSessionRef=ST_Defau, DcmDspDidReadSessionRef=ST_Exten
          DidInfo_DiagnServi_TABROW_NeuMeasu_Read_42
            DcmDspDidAccess
              DcmDspDidRead: DcmDspDidReadSessionRef=ST_Defau, DcmDspDidReadSessionRef=ST_Exten
          DidInfo_DiagnServi_TABROW_NeuMeasu_Read_41
            DcmDspDidAccess
              DcmDspDidRead: DcmDspDidReadSessionRef=ST_Defau, DcmDspDidReadSessionRef=ST_Exten
          DidInfo_DiagnServi_TABROW_NeuMeasu_Read_57_2_1
            DcmDspDidAccess
              DcmDspDidRead: DcmDspDidReadSessionRef=ST_Defau, DcmDspDidReadSessionRef=ST_Exten
          DidInfo_DiagnServi_TABROW_NeuMeasu_Read_40
            DcmDspDidAccess
              DcmDspDidRead: DcmDspDidReadSessionRef=ST_Defau, DcmDspDidReadSessionRef=ST_Exten
        DataInfo_TABROW_TABROSyste_Read_1_1_1_1_1_1_1_1_1 (DcmDspDataInfo): DcmDspDataFixedLength=true
        DataInfo_BMC_Vorlade_Zielspannung_Read_Data_By_Identifier (DcmDspDataInfo): DcmDspDataFixedLength=true
        DidInfo_DiagnServi_TABROW_AccelPedalPositD_Read (DcmDspDidInfo)
          DcmDspDidAccess
            DcmDspDidRead: DcmDspDidReadSessionRef=ST_Defau, DcmDspDidReadSessionRef=ST_Exten
        DataInfo_DiagnServi_TABROW_UnlocStatuOfECUOfProteOfVehicDiagn_Read (DcmDspDataInfo): DcmDspDataFixedLength=true
        Data_TABROW_VWSysteNameOrEnginType_Read (DcmDspData):
          DcmDspDataSize = 104
          DcmDspDataType = UINT8_N
          DcmDspDataUsePort = USE_DATA_ASYNCH_CLIENT_SERVER
          DcmDspDataInfoRef = DataInfo_TABROW_VWSysteNameOrEnginType_Read
        DidInfo_DiagnServi_TABROW_NeuMeasu_Read_49 (DcmDspDidInfo)
          DcmDspDidAccess
            DcmDspDidRead: DcmDspDidReadSessionRef=ST_Defau, DcmDspDidReadSessionRef=ST_Exten
        Data_TABROW_BMCHVKFehleHVIL_Read_Data_By_Identifier (DcmDspData):
          DcmDspDataSize = 8
          DcmDspDataType = UINT8_N
          DcmDspDataUsePort = USE_DATA_ASYNCH_CLIENT_SERVER
          DcmDspDataInfoRef = DataInfo_TABROW_BMCHVKFehleHVIL_Read_Data_By_Identifier
        DidInfo_DiagnServi_TABROW_NeuMeasu_Read_48 (DcmDspDidInfo)
          DcmDspDidAccess
            DcmDspDidRead: DcmDspDidReadSessionRef=ST_Defau, DcmDspDidReadSessionRef=ST_Exten
        DataInfo_TABROW_ECUStandMode1_Read (DcmDspDataInfo): DcmDspDataFixedLength=true
        DID_TABROW_BMCHVKFehleHVIL_Read_Data_By_Identifier (DcmDspDid):
          DcmDspDidIdentifier = 781
          DcmDspDidUsed = true
          DcmDspDidUsePort = USE_DATA_ELEMENT_SPECIFIC_INTERFACES
          DcmDspDidInfoRef = DidInfo_TABROW_BMCHVKFehleHVIL_Read_Data_By_Identifier
          DcmDspDidSignal: DcmDspDidDataPos=0, DcmDspDidDataRef=Data_TABROW_BMCHVKFehleHVIL_Read_Data_By_Identifier
        RoutineInfo_DiagnServi_TABROW_NeuRoutiBasicSetti_Start_Routine (DcmDspRoutineInfo)
          DcmDspRoutineRequestResOut
            ResData (DcmDspRoutineRequestResOutSignal): DcmDspRoutineSignalLength=8, DcmDspRoutineSignalType=UINT8_N, DcmDspRoutineSignalEndianness=opaque, DcmDspRoutineSignalPos=0
          DcmDspStartRoutineIn
            ReqData (DcmDspStartRoutineInSignal): DcmDspRoutineSignalLength=8, DcmDspRoutineSignalType=UINT8_N, DcmDspRoutineSignalEndianness=opaque, DcmDspRoutineSignalPos=0
          DcmDspRoutineAuthorization: DcmDspRoutineSessionRef=ST_Exten
          DcmDspRoutineStopOut
            ResData (DcmDspRoutineStopOutSignal): DcmDspRoutineSignalLength=8, DcmDspRoutineSignalType=UINT8_N, DcmDspRoutineSignalEndianness=opaque, DcmDspRoutineSignalPos=0
          DcmDspStartRoutineOut
            ResData (DcmDspStartRoutineOutSignal): DcmDspRoutineSignalLength=8, DcmDspRoutineSignalType=UINT8_N, DcmDspRoutineSignalEndianness=opaque, DcmDspRoutineSignalPos=0
        DidInfo_HV_battery_maximum_charging_current_Read_Data_By_Identifier (DcmDspDidInfo)
          DcmDspDidAccess
            DcmDspDidRead: DcmDspDidReadSessionRef=ST_Defau, DcmDspDidReadSessionRef=ST_Exten
        DataInfo_DiagnServi_TABROW_NeuMeasu_Read_29_1_1_1_1_1_1 (DcmDspDataInfo): DcmDspDataFixedLength=true
        DidInfo_DiagnServi_TABROW_NeuMeasu_Read_50 (DcmDspDidInfo)
          DcmDspDidAccess
            DcmDspDidRead: DcmDspDidReadSessionRef=ST_Defau, DcmDspDidReadSessionRef=ST_Exten
        Data_TABROW_TABROSyste_Read_1_1_1_1_1_1_1 (DcmDspData):
          DcmDspDataSize = 72
          DcmDspDataType = UINT8_N
          DcmDspDataUsePort = USE_DATA_ASYNCH_CLIENT_SERVER
          DcmDspDataInfoRef = DataInfo_TABROW_TABROSyste_Read_1_1_1_1_1_1_1
        DID_DiagnServi_TABROW_VWAppliSoftwVersiNumbe_Read (DcmDspDid):
          DcmDspDidIdentifier = 61833
          DcmDspDidUsed = true
          DcmDspDidUsePort = USE_DATA_ELEMENT_SPECIFIC_INTERFACES
          DcmDspDidInfoRef = DidInfo_DiagnServi_TABROW_VWAppliSoftwVersiNumbe_Read
          DcmDspDidSignal: DcmDspDidDataPos=0, DcmDspDidDataRef=Data_DiagnServi_TABROW_VWAppliSoftwVersiNumbe_Read
        5 x DcmDspData, all with DcmDspDataType=UINT8_N, DcmDspDataUsePort=USE_DATA_ASYNCH_CLIENT_SERVER:
          Data_DiagnServi_TABROW_Milea_Read: DcmDspDataSize=24, DcmDspDataInfoRef=DataInfo_DiagnServi_TABROW_Milea_Read
          Data_DiagnServi_TABROW_NeuMeasu_Read_84: DcmDspDataSize=32, DcmDspDataInfoRef=DataInfo_DiagnServi_TABROW_NeuMeasu_Read_84
          Data_DiagnServi_TABROW_NeuMeasu_Read_83: DcmDspDataSize=32, DcmDspDataInfoRef=DataInfo_DiagnServi_TABROW_NeuMeasu_Read_83
          Data_DiagnServi_TABROW_VWDataSetNumbeOrECUDataContaNumbe_Read: DcmDspDataSize=88, DcmDspDataInfoRef=DataInfo_DiagnServi_TABROW_VWDataSetNumbeOrECUDataContaNumbe_Read
          Data_DiagnServi_TABROW_NeuMeasu_Read_82: DcmDspDataSize=8, DcmDspDataInfoRef=DataInfo_DiagnServi_TABROW_NeuMeasu_Read_82
        DID_HV_Spannung_Nebenverbraucher_Read_Data_By_Identifier (DcmDspDid):
          DcmDspDidIdentifier = 4099
          DcmDspDidUsed = true
          DcmDspDidUsePort = USE_DATA_ELEMENT_SPECIFIC_INTERFACES
          DcmDspDidInfoRef = DidInfo_HV_Spannung_Nebenverbraucher_Read_Data_By_Identifier
          DcmDspDidSignal: DcmDspDidDataPos=0, DcmDspDidDataRef=Data_HV_Spannung_Nebenverbraucher_Read_Data_By_Identifier
        DataInfo_DiagnServi_TABROW_NeuMeasu_Read_29_1_1_1 (DcmDspDataInfo): DcmDspDataFixedLength=true
        DataInfo_DiagnServi_TABROW_NeuMeasu_Read_33_1_1_1_1_1_1_1_1_1_1_1_1_1_1_1_1_1_1_1_1_1_1_1_2_1 (DcmDspDataInfo): DcmDspDataFixedLength=true
        DidInfo_DiagnServi_TABROW_NeuMeasu_Read_56 (DcmDspDidInfo)
          DcmDspDidAccess
            DcmDspDidRead: DcmDspDidReadSessionRef=ST_Defau, DcmDspDidReadSessionRef=ST_Exten
        DidInfo_DiagnServi_TABROW_NeuMeasu_Read_55 (DcmDspDidInfo)
          DcmDspDidAccess
            DcmDspDidRead: DcmDspDidReadSessionRef=ST_Defau, DcmDspDidReadSessionRef=ST_Exten
        DataInfo_DiagnServi_TABROW_NeuMeasu_Read_27_8 (DcmDspDataInfo): DcmDspDataFixedLength=true
        4 x DcmDspDidInfo:
          DidInfo_DiagnServi_ReadDataByIdentASAMODXFileIdent
            DcmDspDidAccess
              DcmDspDidRead
          DidInfo_DiagnServi_TABROW_NeuMeasu_Read_53
            DcmDspDidAccess
              DcmDspDidRead: DcmDspDidReadSessionRef=ST_Defau, DcmDspDidReadSessionRef=ST_Exten
          DidInfo_DiagnServi_TABROW_NeuMeasu_Read_52
            DcmDspDidAccess
              DcmDspDidRead: DcmDspDidReadSessionRef=ST_Defau, DcmDspDidReadSessionRef=ST_Exten
          DidInfo_DiagnServi_TABROW_NeuMeasu_Read_51
            DcmDspDidAccess
              DcmDspDidRead: DcmDspDidReadSessionRef=ST_Defau, DcmDspDidReadSessionRef=ST_Exten
        Data_TABROW_ECUStandMode1_Read (DcmDspData): DcmDspDataSize=32, DcmDspDataType=UINT8_N, DcmDspDataUsePort=USE_DATA_ASYNCH_CLIENT_SERVER, DcmDspDataInfoRef=DataInfo_TABROW_ECUStandMode1_Read
        DataInfo_DiagnServi_TABROW_NeuMeasu_Read_27_4 (DcmDspDataInfo): DcmDspDataFixedLength=true
        RoutineInfo_DiagnServi_TABROW_ResetOfAllAdapt_Start_Routine_COP (DcmDspRoutineInfo)
          DcmDspRoutineRequestResOut
            ResData (DcmDspRoutineRequestResOutSignal): DcmDspRoutineSignalLength=8, DcmDspRoutineSignalType=UINT8_N, DcmDspRoutineSignalEndianness=opaque, DcmDspRoutineSignalPos=0
          DcmDspStartRoutineIn
            ReqData (DcmDspStartRoutineInSignal): DcmDspRoutineSignalLength=24, DcmDspRoutineSignalType=UINT8_N, DcmDspRoutineSignalEndianness=opaque, DcmDspRoutineSignalPos=0
          DcmDspRoutineAuthorization: DcmDspRoutineSessionRef=ST_Exten
          DcmDspRoutineStopOut
            ResData (DcmDspRoutineStopOutSignal): DcmDspRoutineSignalLength=8, DcmDspRoutineSignalType=UINT8_N, DcmDspRoutineSignalEndianness=opaque, DcmDspRoutineSignalPos=0
          DcmDspStartRoutineOut
            ResData (DcmDspStartRoutineOutSignal): DcmDspRoutineSignalLength=8, DcmDspRoutineSignalType=UINT8_N, DcmDspRoutineSignalEndianness=opaque, DcmDspRoutineSignalPos=0
        RoutineInfo_DiagnServi_TABROW_NeuRoutiImmedResul_Start_Routine (DcmDspRoutineInfo)
          DcmDspStartRoutineIn
            ReqData (DcmDspStartRoutineInSignal): DcmDspRoutineSignalLength=8, DcmDspRoutineSignalType=UINT8_N, DcmDspRoutineSignalEndianness=opaque, DcmDspRoutineSignalPos=0
          DcmDspRoutineAuthorization: DcmDspRoutineSessionRef=ST_Exten
          DcmDspStartRoutineOut
            ResData (DcmDspStartRoutineOutSignal): DcmDspRoutineSignalLength=800, DcmDspRoutineSignalType=UINT8_N, DcmDspRoutineSignalEndianness=opaque, DcmDspRoutineSignalPos=0
        DidInfo_Maximum_Charge_Voltage_Read_Data_By_Identifier (DcmDspDidInfo)
          DcmDspDidAccess
            DcmDspDidRead: DcmDspDidReadSessionRef=ST_Defau, DcmDspDidReadSessionRef=ST_Exten
        3 x DcmDspDataInfo, all with DcmDspDataFixedLength=true:
          DataInfo_DiagnServi_TABROW_NeuMeasu_Read_27_{5..7}
        DID_TABROW_TABROSyste_Read_1_1_1_1_1_1_1_1 (DcmDspDid):
          DcmDspDidIdentifier = 57398
          DcmDspDidUsed = true
          DcmDspDidUsePort = USE_DATA_ELEMENT_SPECIFIC_INTERFACES
          DcmDspDidInfoRef = DidInfo_TABROW_TABROSyste_Read_1_1_1_1_1_1_1_1
          DcmDspDidSignal: DcmDspDidDataPos=0, DcmDspDidDataRef=Data_TABROW_TABROSyste_Read_1_1_1_1_1_1_1_1
        DataInfo_DiagnServi_TABROW_NeuMeasu_Read_27_1 (DcmDspDataInfo): DcmDspDataFixedLength=true
        DidInfo_DiagnServi_TABROW_SuppoPIDs0120_Read (DcmDspDidInfo)
          DcmDspDidAccess
            DcmDspDidRead: DcmDspDidReadSessionRef=ST_Defau, DcmDspDidReadSessionRef=ST_Exten
        DidInfo_DiagnServi_TABROW_NeuMeasu_Read_43_1_1_1_1_1_1_1 (DcmDspDidInfo)
          DcmDspDidAccess
            DcmDspDidRead: DcmDspDidReadSessionRef=ST_Defau, DcmDspDidReadSessionRef=ST_Exten
        DID_DiagnServi_TABROW_EnginCoolaTempe_Read (DcmDspDid):
          DcmDspDidIdentifier = 62469
          DcmDspDidUsed = true
          DcmDspDidUsePort = USE_DATA_ELEMENT_SPECIFIC_INTERFACES
          DcmDspDidInfoRef = DidInfo_DiagnServi_TABROW_EnginCoolaTempe_Read
          DcmDspDidSignal: DcmDspDidDataPos=0, DcmDspDidDataRef=Data_DiagnServi_TABROW_EnginCoolaTempe_Read
        DataInfo_DiagnServi_TABROW_NeuMeasu_Read_27_2 (DcmDspDataInfo): DcmDspDataFixedLength=true
        DataInfo_DiagnServi_TABROW_NeuMeasu_Read_27_3 (DcmDspDataInfo): DcmDspDataFixedLength=true
        RoutineInfo_DiagnServi_TABROW_NeuRoutiBasicSetti_Start_Routine_4 (DcmDspRoutineInfo)
          DcmDspRoutineRequestResOut
            ResData (DcmDspRoutineRequestResOutSignal): DcmDspRoutineSignalLength=8, DcmDspRoutineSignalType=UINT8_N, DcmDspRoutineSignalEndianness=opaque, DcmDspRoutineSignalPos=0
          DcmDspRoutineAuthorization: DcmDspRoutineSessionRef=ST_Exten
          DcmDspRoutineStopOut
            ResData (DcmDspRoutineStopOutSignal): DcmDspRoutineSignalLength=8, DcmDspRoutineSignalType=UINT8_N, DcmDspRoutineSignalEndianness=opaque, DcmDspRoutineSignalPos=0
          DcmDspStartRoutineOut
            ResData (DcmDspStartRoutineOutSignal): DcmDspRoutineSignalLength=8, DcmDspRoutineSignalType=UINT8_N, DcmDspRoutineSignalEndianness=opaque, DcmDspRoutineSignalPos=0
        DataInfo_TABROW_VWLogicSoftwBlockCountOfProgrAttem_Read (DcmDspDataInfo): DcmDspDataFixedLength=false
        RoutineInfo_DiagnServi_TABROW_NeuRoutiBasicSetti_Start_Routine_5 (DcmDspRoutineInfo)
          DcmDspRoutineRequestResOut
            ResData (DcmDspRoutineRequestResOutSignal): DcmDspRoutineSignalLength=8, DcmDspRoutineSignalType=UINT8_N, DcmDspRoutineSignalEndianness=opaque, DcmDspRoutineSignalPos=0
          DcmDspRoutineAuthorization: DcmDspRoutineSessionRef=ST_Exten
          DcmDspRoutineStopOut
            ResData (DcmDspRoutineStopOutSignal): DcmDspRoutineSignalLength=8, DcmDspRoutineSignalType=UINT8_N, DcmDspRoutineSignalEndianness=opaque, DcmDspRoutineSignalPos=0
          DcmDspStartRoutineOut
            ResData (DcmDspStartRoutineOutSignal): DcmDspRoutineSignalLength=8, DcmDspRoutineSignalType=UINT8_N, DcmDspRoutineSignalEndianness=opaque, DcmDspRoutineSignalPos=0
        DidInfo_DiagnServi_TABROW_IntegValidDataConfiList_Read (DcmDspDidInfo)
          DcmDspDidAccess
            DcmDspDidWrite: DcmDspDidWriteSessionRef=ST_Exten, DcmDspDidWriteRoleRef=ST_EndToEnd
            DcmDspDidRead: DcmDspDidReadSessionRef=ST_Defau, DcmDspDidReadSessionRef=ST_Exten
        DID_TABROW_SOKTimeInfor_Read_Data_By_Identifier (DcmDspDid):
          DcmDspDidIdentifier = 401
          DcmDspDidUsed = true
          DcmDspDidUsePort = USE_DATA_ELEMENT_SPECIFIC_INTERFACES
          DcmDspDidInfoRef = DidInfo_TABROW_SOKTimeInfor_Read_Data_By_Identifier
          DcmDspDidSignal: DcmDspDidDataPos=0, DcmDspDidDataRef=Data_TABROW_SOKTimeInfor_Read_Data_By_Identifier
        3 x DcmDspData, all with DcmDspDataSize=1216, DcmDspDataType=UINT8_N, DcmDspDataUsePort=USE_DATA_ASYNCH_CLIENT_SERVER:
          Data_DiagnServi_TABROW_NeuMeasu_Read_46_1_1_1_1_1_1_2_2: DcmDspDataInfoRef=DataInfo_DiagnServi_TABROW_NeuMeasu_Read_46_1_1_1_1_1_1_2_2
          Data_DiagnServi_TABROW_NeuMeasu_Read_46_1_1_1_1_1_1_2_3: DcmDspDataInfoRef=DataInfo_DiagnServi_TABROW_NeuMeasu_Read_46_1_1_1_1_1_1_2_3
          Data_DiagnServi_TABROW_NeuMeasu_Read_46_1_1_1_1_1_1_2_1: DcmDspDataInfoRef=DataInfo_DiagnServi_TABROW_NeuMeasu_Read_46_1_1_1_1_1_1_2_1
        DidInfo_DiagnServi_TABROW_NeuMeasu_Read_61 (DcmDspDidInfo)
          DcmDspDidAccess
            DcmDspDidRead: DcmDspDidReadSessionRef=ST_Defau, DcmDspDidReadSessionRef=ST_Exten
        DataInfo_DiagnServi_TABROW_NeuMeasu_Read_27_2_1 (DcmDspDataInfo): DcmDspDataFixedLength=true
        3 x DcmDspDidInfo:
          DidInfo_DiagnServi_TABROW_NeuMeasu_Read_60
            DcmDspDidAccess
              DcmDspDidRead: DcmDspDidReadSessionRef=ST_Defau, DcmDspDidReadSessionRef=ST_Exten
          DidInfo_DiagnServi_TABROW_NeuMeasu_Read_49_1
            DcmDspDidAccess
              DcmDspDidRead: DcmDspDidReadSessionRef=ST_Defau, DcmDspDidReadSessionRef=ST_Exten
          DidInfo_HV_Battery_thermal_load_Read_Data_By_Identifier
            DcmDspDidAccess
              DcmDspDidRead: DcmDspDidReadSessionRef=ST_Defau, DcmDspDidReadSessionRef=ST_Exten
        DID_Battery_banks_allowed_modes_Read_Data_By_Identifier (DcmDspDid):
          DcmDspDidIdentifier = 9990
          DcmDspDidUsed = true
          DcmDspDidUsePort = USE_DATA_ELEMENT_SPECIFIC_INTERFACES
          DcmDspDidInfoRef = DidInfo_Battery_banks_allowed_modes_Read_Data_By_Identifier
          DcmDspDidSignal: DcmDspDidDataPos=0, DcmDspDidDataRef=Data_Battery_banks_allowed_modes_Read_Data_By_Identifier
        3 x DcmDspRoutineInfo:
          RoutineInfo_DiagnServi_TABROW_NeuRoutiBasicSetti_Start_Routine_2
            DcmDspRoutineRequestResOut
              ResData (DcmDspRoutineRequestResOutSignal): DcmDspRoutineSignalLength=24, DcmDspRoutineSignalType=UINT8_N, DcmDspRoutineSignalEndianness=opaque, DcmDspRoutineSignalPos=0
            DcmDspRoutineAuthorization: DcmDspRoutineSessionRef=ST_Exten
            DcmDspRoutineStopOut
              ResData (DcmDspRoutineStopOutSignal): DcmDspRoutineSignalLength=8, DcmDspRoutineSignalType=UINT8_N, DcmDspRoutineSignalEndianness=opaque, DcmDspRoutineSignalPos=0
            DcmDspStartRoutineOut
              ResData (DcmDspStartRoutineOutSignal): DcmDspRoutineSignalLength=8, DcmDspRoutineSignalType=UINT8_N, DcmDspRoutineSignalEndianness=opaque, DcmDspRoutineSignalPos=0
          RoutineInfo_DiagnServi_TABROW_NeuRoutiBasicSetti_Start_Routine_3
            DcmDspRoutineRequestResOut
              ResData (DcmDspRoutineRequestResOutSignal): DcmDspRoutineSignalLength=8, DcmDspRoutineSignalType=UINT8_N, DcmDspRoutineSignalEndianness=opaque, DcmDspRoutineSignalPos=0
            DcmDspRoutineAuthorization: DcmDspRoutineSessionRef=ST_Exten
            DcmDspRoutineStopOut
              ResData (DcmDspRoutineStopOutSignal): DcmDspRoutineSignalLength=8, DcmDspRoutineSignalType=UINT8_N, DcmDspRoutineSignalEndianness=opaque, DcmDspRoutineSignalPos=0
            DcmDspStartRoutineOut
              ResData (DcmDspStartRoutineOutSignal): DcmDspRoutineSignalLength=8, DcmDspRoutineSignalType=UINT8_N, DcmDspRoutineSignalEndianness=opaque, DcmDspRoutineSignalPos=0
          RoutineInfo_DiagnServi_TABROW_NeuRoutiBasicSetti_Start_Routine_1
            DcmDspRoutineRequestResOut
              ResData (DcmDspRoutineRequestResOutSignal): DcmDspRoutineSignalLength=8, DcmDspRoutineSignalType=UINT8_N, DcmDspRoutineSignalEndianness=opaque, DcmDspRoutineSignalPos=0
            DcmDspRoutineAuthorization: DcmDspRoutineSessionRef=ST_Exten
            DcmDspRoutineStopOut
              ResData (DcmDspRoutineStopOutSignal): DcmDspRoutineSignalLength=8, DcmDspRoutineSignalType=UINT8_N, DcmDspRoutineSignalEndianness=opaque, DcmDspRoutineSignalPos=0
            DcmDspStartRoutineOut
              ResData (DcmDspStartRoutineOutSignal): DcmDspRoutineSignalLength=8, DcmDspRoutineSignalType=UINT8_N, DcmDspRoutineSignalEndianness=opaque, DcmDspRoutineSignalPos=0
        3 x DcmDspDidInfo:
          DidInfo_TABROW_StateOfBatteShutoCrash_ReadDataByIdent
            DcmDspDidAccess
              DcmDspDidRead: DcmDspDidReadSessionRef=ST_Defau, DcmDspDidReadSessionRef=ST_Exten
          DidInfo_DiagnServi_TABROW_NeuMeasu_Read_63
            DcmDspDidAccess
              DcmDspDidRead: DcmDspDidReadSessionRef=ST_Defau, DcmDspDidReadSessionRef=ST_Exten
          DidInfo_BMC_Strom_Read_Data_By_Identifier
            DcmDspDidAccess
              DcmDspDidRead: DcmDspDidReadSessionRef=ST_Defau, DcmDspDidReadSessionRef=ST_Exten
        DataInfo_HV_battery_maximum_discharge_power_Read_Data_By_Identifier (DcmDspDataInfo): DcmDspDataFixedLength=true
        DataInfo_TABROW_TABROSyste_Read_1_1_1_1_1_1_1_1 (DcmDspDataInfo): DcmDspDataFixedLength=true
        Data_DiagnServi_TABROW_TABROECUPr_Read (DcmDspData):
          DcmDspDataSize = 8
          DcmDspDataType = UINT8_N
          DcmDspDataUsePort = USE_DATA_ASYNCH_CLIENT_SERVER
          DcmDspDataInfoRef = DataInfo_DiagnServi_TABROW_TABROECUPr_Read
        DID_Battery_flow_temperature_Read_Data_By_Identifier (DcmDspDid):
          DcmDspDidIdentifier = 9991
          DcmDspDidUsed = true
          DcmDspDidUsePort = USE_DATA_ELEMENT_SPECIFIC_INTERFACES
          DcmDspDidInfoRef = DidInfo_Battery_flow_temperature_Read_Data_By_Identifier
          DcmDspDidSignal: DcmDspDidDataPos=0, DcmDspDidDataRef=Data_Battery_flow_temperature_Read_Data_By_Identifier
        Routine_DiagnServi_TABROW_NeuRoutiImmedResul_Start_Routine (DcmDspRoutine):
          DcmDspRequestResultsRoutineSupported = false
          DcmDspStopRoutineSupported = false
          DcmDspRoutineIdentifier = 785
          DcmDspRoutineFixedLength = false
          DcmDspRoutineUsePort = true
          DcmDspRoutineUsed = true
          DcmDspRoutineInfoRef = RoutineInfo_DiagnServi_TABROW_NeuRoutiImmedResul_Start_Routine
        DID_DiagnServi_TABROW_NeuMeasu_Read_9_2_1_1 (DcmDspDid):
          DcmDspDidIdentifier = 1726
          DcmDspDidUsed = true
          DcmDspDidUsePort = USE_DATA_ELEMENT_SPECIFIC_INTERFACES
          DcmDspDidInfoRef = DidInfo_DiagnServi_TABROW_NeuMeasu_Read_9_2_1_1
          DcmDspDidSignal: DcmDspDidDataPos=0, DcmDspDidDataRef=Data_DiagnServi_TABROW_NeuMeasu_Read_9_2_1_1
        Data_TABROW_TABROVWDat_Read_1 (DcmDspData): DcmDspDataSize=32, DcmDspDataType=UINT8_N, DcmDspDataUsePort=USE_DATA_ASYNCH_CLIENT_SERVER, DcmDspDataInfoRef=DataInfo_TABROW_TABROVWDat_Read_1
        DataInfo_DiagnServi_TABROW_NeuMeasu_Read_63_1_1 (DcmDspDataInfo): DcmDspDataFixedLength=true
        DataInfo_TABROW_TABROSyste_Read_1_1_1_1_1_1 (DcmDspDataInfo): DcmDspDataFixedLength=true
        3 x DcmDspData, all with DcmDspDataType=UINT8_N, DcmDspDataUsePort=USE_DATA_ASYNCH_CLIENT_SERVER:
          Data_DiagnServi_BMCE_part_number_Read: DcmDspDataSize=88, DcmDspDataInfoRef=DataInfo_DiagnServi_BMCE_part_number_Read
          Data_DiagnServi_TABROW_NeuMeasu_Read_59_2: DcmDspDataSize=16, DcmDspDataInfoRef=DataInfo_DiagnServi_TABROW_NeuMeasu_Read_59_2
          Data_DiagnServi_TABROW_NeuMeasu_Read_27_4_1: DcmDspDataSize=216, DcmDspDataInfoRef=DataInfo_DiagnServi_TABROW_NeuMeasu_Read_27_4_1
        DidInfo_DiagnServi_TABROW_NeuMeasu_Read_43_1_1_1_1_1_1 (DcmDspDidInfo)
          DcmDspDidAccess
            DcmDspDidRead: DcmDspDidReadSessionRef=ST_Defau, DcmDspDidReadSessionRef=ST_Exten
        DataInfo_TABROW_ProgrPreco_Read (DcmDspDataInfo): DcmDspDataFixedLength=false
        Routine_DiagnServi_TABROW_IsolaMeasuDeactMode_Start_Routine (DcmDspRoutine):
          DcmDspRequestResultsRoutineSupported = true
          DcmDspStopRoutineSupported = true
          DcmDspRoutineIdentifier = 768
          DcmDspRoutineFixedLength = false
          DcmDspRoutineUsePort = true
          DcmDspRoutineUsed = true
          DcmDspRoutineInfoRef = RoutineInfo_DiagnServi_TABROW_IsolaMeasuDeactMode_Start_Routine
        DidInfo_DiagnServi_TABROW_NeuMeasu_Read_72 (DcmDspDidInfo)
          DcmDspDidAccess
            DcmDspDidRead: DcmDspDidReadSessionRef=ST_Defau, DcmDspDidReadSessionRef=ST_Exten
        Data_DiagnServi_TABROW_VWCodinValue_Read (DcmDspData):
          DcmDspDataSize = 8
          DcmDspDataType = UINT8_N
          DcmDspDataUsePort = USE_DATA_ASYNCH_CLIENT_SERVER
          DcmDspDataInfoRef = DataInfo_DiagnServi_TABROW_VWCodinValue_Read
        3 x DcmDspDidInfo:
          DidInfo_DiagnServi_TABROW_NeuMeasu_Read_71
            DcmDspDidAccess
              DcmDspDidRead: DcmDspDidReadSessionRef=ST_Defau, DcmDspDidReadSessionRef=ST_Exten
          DidInfo_BMC_Vorlade_Zielspannung_Read_Data_By_Identifier
            DcmDspDidAccess
              DcmDspDidRead: DcmDspDidReadSessionRef=ST_Defau, DcmDspDidReadSessionRef=ST_Exten
          DidInfo_DiagnServi_TABROW_NeuMeasu_Read_70
            DcmDspDidAccess
              DcmDspDidRead: DcmDspDidReadSessionRef=ST_Defau, DcmDspDidReadSessionRef=ST_Exten
        3 x DcmDspDid, all with DcmDspDidUsed=true, DcmDspDidUsePort=USE_DATA_ELEMENT_SPECIFIC_INTERFACES:
          DID_DiagnServi_TABROW_NeuMeasu_Read_46_1_1: DcmDspDidIdentifier=1459, DcmDspDidInfoRef=DidInfo_DiagnServi_TABROW_NeuMeasu_Read_46_1_1
            DcmDspDidSignal: DcmDspDidDataPos=0, DcmDspDidDataRef=Data_DiagnServi_TABROW_NeuMeasu_Read_46_1_1
          DID_TABROW_KnockTestMode_Read: DcmDspDidIdentifier=2547, DcmDspDidInfoRef=DidInfo_TABROW_KnockTestMode_Read
            DcmDspDidSignal: DcmDspDidDataPos=0, DcmDspDidDataRef=Data_TABROW_KnockTestMode_Read
          DID_DiagnServi_TABROW_NeuMeasu_Read_46_1_1_1: DcmDspDidIdentifier=1460, DcmDspDidInfoRef=DidInfo_DiagnServi_TABROW_NeuMeasu_Read_46_1_1_1
            DcmDspDidSignal: DcmDspDidDataPos=0, DcmDspDidDataRef=Data_DiagnServi_TABROW_NeuMeasu_Read_46_1_1_1
        3 x DcmDspDidInfo:
          DidInfo_DiagnServi_TABROW_NeuMeasu_Read_74
            DcmDspDidAccess
              DcmDspDidRead: DcmDspDidReadSessionRef=ST_Defau, DcmDspDidReadSessionRef=ST_Exten
          DidInfo_DiagnServi_TABROW_NeuMeasu_Read_9_1
            DcmDspDidAccess
              DcmDspDidRead: DcmDspDidReadSessionRef=ST_Defau, DcmDspDidReadSessionRef=ST_Exten
          DidInfo_DiagnServi_TABROW_NeuMeasu_Read_43_1_1_1_1_1_1_1_1_1_1_1
            DcmDspDidAccess
              DcmDspDidRead: DcmDspDidReadSessionRef=ST_Defau, DcmDspDidReadSessionRef=ST_Exten
        DID_Strommesung_Read_Data_By_Identifier (DcmDspDid):
          DcmDspDidIdentifier = 779
          DcmDspDidUsed = true
          DcmDspDidUsePort = USE_DATA_ELEMENT_SPECIFIC_INTERFACES
          DcmDspDidInfoRef = DidInfo_Strommesung_Read_Data_By_Identifier
          DcmDspDidSignal: DcmDspDidDataPos=0, DcmDspDidDataRef=Data_Strommesung_Read_Data_By_Identifier
        DidInfo_DiagnServi_TABROW_NeuMeasu_Read_73 (DcmDspDidInfo)
          DcmDspDidAccess
            DcmDspDidRead: DcmDspDidReadSessionRef=ST_Defau, DcmDspDidReadSessionRef=ST_Exten
        DidInfo_DiagnServi_TABROW_NeuMeasu_Read_9_2 (DcmDspDidInfo)
          DcmDspDidAccess
            DcmDspDidRead: DcmDspDidReadSessionRef=ST_Defau, DcmDspDidReadSessionRef=ST_Exten
        Data_Battery_banks_actual_mode_Read_Data_By_Identifier (DcmDspData):
          DcmDspDataSize = 8
          DcmDspDataType = UINT8_N
          DcmDspDataUsePort = USE_DATA_ASYNCH_CLIENT_SERVER
          DcmDspDataInfoRef = DataInfo_Battery_banks_actual_mode_Read_Data_By_Identifier
        DidInfo_DiagnServi_TABROW_NeuMeasu_Read (DcmDspDidInfo)
          DcmDspDidAccess
            DcmDspDidRead: DcmDspDidReadSessionRef=ST_Defau, DcmDspDidReadSessionRef=ST_Exten
        Routine_TABROW_SOKFunctDeact_Start_Routine_COP (DcmDspRoutine):
          DcmDspRequestResultsRoutineSupported = true
          DcmDspStopRoutineSupported = true
          DcmDspRoutineIdentifier = 49410
          DcmDspRoutineFixedLength = false
          DcmDspRoutineUsePort = true
          DcmDspRoutineUsed = true
          DcmDspRoutineInfoRef = RoutineInfo_TABROW_SOKFunctDeact_Start_Routine_COP
        DID_BMC_Hybrid_Kundendienstfehler_Read_Data_By_Identifier (DcmDspDid):
          DcmDspDidIdentifier = 4097
          DcmDspDidUsed = true
          DcmDspDidUsePort = USE_DATA_ELEMENT_SPECIFIC_INTERFACES
          DcmDspDidInfoRef = DidInfo_BMC_Hybrid_Kundendienstfehler_Read_Data_By_Identifier
          DcmDspDidSignal: DcmDspDidDataPos=0, DcmDspDidDataRef=Data_BMC_Hybrid_Kundendienstfehler_Read_Data_By_Identifier
        DataInfo_DiagnServi_Type_number_BMCE_Read (DcmDspDataInfo): DcmDspDataFixedLength=true
        DidInfo_DiagnServi_TABROW_NeuMeasu_Read_83 (DcmDspDidInfo)
          DcmDspDidAccess
            DcmDspDidRead: DcmDspDidReadSessionRef=ST_Defau, DcmDspDidReadSessionRef=ST_Exten
        DataInfo_TABROW_SOKSignaFaileList_Read_Data_By_Identifier (DcmDspDataInfo): DcmDspDataFixedLength=false
        DidInfo_DiagnServi_TABROW_NeuMeasu_Read_82 (DcmDspDidInfo)
          DcmDspDidAccess
            DcmDspDidRead: DcmDspDidReadSessionRef=ST_Defau, DcmDspDidReadSessionRef=ST_Exten
        Data_DiagnServi_BCUe_part_number_Read (DcmDspData):
          DcmDspDataSize = 88
          DcmDspDataType = UINT8_N
          DcmDspDataUsePort = USE_DATA_ASYNCH_CLIENT_SERVER
          DcmDspDataInfoRef = DataInfo_DiagnServi_BCUe_part_number_Read
        DidInfo_DiagnServi_TABROW_NeuMeasu_Read_29_1_2 (DcmDspDidInfo)
          DcmDspDidAccess
            DcmDspDidRead: DcmDspDidReadSessionRef=ST_Defau, DcmDspDidReadSessionRef=ST_Exten
        DidInfo_DiagnServi_TABROW_NeuMeasu_Read_27_1 (DcmDspDidInfo)
          DcmDspDidAccess
            DcmDspDidRead: DcmDspDidReadSessionRef=ST_Defau, DcmDspDidReadSessionRef=ST_Exten
        3 x DcmDspDataInfo:
          DataInfo_DiagnServi_TABROW_IntegValidDataConfiList_Read: DcmDspDataFixedLength=false
          DataInfo_DiagnServi_TABROW_ContrModulVolta_Read: DcmDspDataFixedLength=true
          DataInfo_HV_coordinator_requestet_voltage_hv_battery_Read_Data_By_Identifier: DcmDspDataFixedLength=true
        4 x DcmDspDidInfo:
          DidInfo_DiagnServi_TABROW_VWDataSetName_Read
            DcmDspDidAccess
              DcmDspDidRead: DcmDspDidReadSessionRef=ST_Defau, DcmDspDidReadSessionRef=ST_Exten
          DidInfo_DiagnServi_TABROW_NeuMeasu_Read_27_3
            DcmDspDidAccess
              DcmDspDidRead: DcmDspDidReadSessionRef=ST_Defau, DcmDspDidReadSessionRef=ST_Exten
          DidInfo_DiagnServi_TABROW_NeuMeasu_Read_27_2
            DcmDspDidAccess
              DcmDspDidRead: DcmDspDidReadSessionRef=ST_Defau, DcmDspDidReadSessionRef=ST_Exten
          DidInfo_DiagnServi_TABROW_NeuMeasu_Read_27_5
            DcmDspDidAccess
              DcmDspDidRead: DcmDspDidReadSessionRef=ST_Defau, DcmDspDidReadSessionRef=ST_Exten
        Routine_TABROW_VkmsHandlDownl_Start_Routine (DcmDspRoutine):
          DcmDspRequestResultsRoutineSupported = true
          DcmDspStopRoutineSupported = false
          DcmDspRoutineIdentifier = 49162
          DcmDspRoutineFixedLength = false
          DcmDspRoutineUsePort = true
          DcmDspRoutineUsed = true
          DcmDspRoutineInfoRef = RoutineInfo_TABROW_VkmsHandlDownl_Start_Routine
        DidInfo_DiagnServi_TABROW_NeuMeasu_Read_27_4 (DcmDspDidInfo)
          DcmDspDidAccess
            DcmDspDidRead: DcmDspDidReadSessionRef=ST_Defau, DcmDspDidReadSessionRef=ST_Exten
        RoutineInfo_DiagnServi_RoutiContrCheckProgrPreco (DcmDspRoutineInfo)
          DcmDspRoutineAuthorization: DcmDspRoutineSessionRef=ST_Defau, DcmDspRoutineSessionRef=ST_Exten
          DcmDspStartRoutineOut
            ResData (DcmDspStartRoutineOutSignal): DcmDspRoutineSignalLength=2040, DcmDspRoutineSignalType=VARIABLE_LENGTH, DcmDspRoutineSignalEndianness=opaque, DcmDspRoutineSignalPos=0
        5 x DcmDspDidInfo:
          DidInfo_DiagnServi_TABROW_NeuMeasu_Read_27_7
            DcmDspDidAccess
              DcmDspDidRead: DcmDspDidReadSessionRef=ST_Defau, DcmDspDidReadSessionRef=ST_Exten
          DidInfo_TABROW_BMCHVKEoHVLState_Read_Data_By_Identifier
            DcmDspDidAccess
              DcmDspDidRead: DcmDspDidReadSessionRef=ST_Defau, DcmDspDidReadSessionRef=ST_Exten
          DidInfo_DiagnServi_TABROW_NeuMeasu_Read_27_6
            DcmDspDidAccess
              DcmDspDidRead: DcmDspDidReadSessionRef=ST_Defau, DcmDspDidReadSessionRef=ST_Exten
          DidInfo_DiagnServi_TABROW_NeuMeasu_Read_27_3_1
            DcmDspDidAccess
              DcmDspDidRead: DcmDspDidReadSessionRef=ST_Defau, DcmDspDidReadSessionRef=ST_Exten
          DidInfo_DiagnServi_TABROW_NeuMeasu_Read_27_8
            DcmDspDidAccess
              DcmDspDidRead: DcmDspDidReadSessionRef=ST_Defau, DcmDspDidReadSessionRef=ST_Exten
        DID_TABROW_IsolaResisSysteMinus_ReadDataByIdent (DcmDspDid):
          DcmDspDidIdentifier = 7705
          DcmDspDidUsed = true
          DcmDspDidUsePort = USE_DATA_ELEMENT_SPECIFIC_INTERFACES
          DcmDspDidInfoRef = DidInfo_TABROW_IsolaResisSysteMinus_ReadDataByIdent
          DcmDspDidSignal: DcmDspDidDataPos=0, DcmDspDidDataRef=Data_TABROW_IsolaResisSysteMinus_ReadDataByIdent
        Data_TABROW_VkmsKeyList_Read_Data_By_Identifier (DcmDspData):
          DcmDspDataSize = 8176
          DcmDspDataType = UINT8_N
          DcmDspDataUsePort = USE_DATA_ASYNCH_CLIENT_SERVER
          DcmDspDataInfoRef = DataInfo_TABROW_VkmsKeyList_Read_Data_By_Identifier
        DataInfo_TABROW_TABROSyste_Read_1_1_1_1_1 (DcmDspDataInfo): DcmDspDataFixedLength=true
        DidInfo_DiagnServi_TABROW_NeuMeasu_Read_84 (DcmDspDidInfo)
          DcmDspDidAccess
            DcmDspDidRead: DcmDspDidReadSessionRef=ST_Defau, DcmDspDidReadSessionRef=ST_Exten
        Data_DiagnServi_TABROW_NeuMeasu_Read_46_1 (DcmDspData):
          DcmDspDataSize = 1216
          DcmDspDataType = UINT8_N
          DcmDspDataUsePort = USE_DATA_ASYNCH_CLIENT_SERVER
          DcmDspDataInfoRef = DataInfo_DiagnServi_TABROW_NeuMeasu_Read_46_1
        DID_DiagnServi_TABROW_NeuMeasu_Read_43_1_1_1_1_1 (DcmDspDid):
          DcmDspDidIdentifier = 1388
          DcmDspDidUsed = true
          DcmDspDidUsePort = USE_DATA_ELEMENT_SPECIFIC_INTERFACES
          DcmDspDidInfoRef = DidInfo_DiagnServi_TABROW_NeuMeasu_Read_43_1_1_1_1_1
          DcmDspDidSignal: DcmDspDidDataPos=0, DcmDspDidDataRef=Data_DiagnServi_TABROW_NeuMeasu_Read_43_1_1_1_1_1
        DidInfo_DiagnServi_TABROW_NeuMeasu_Read_43_1_1_1_1_1 (DcmDspDidInfo)
          DcmDspDidAccess
            DcmDspDidRead: DcmDspDidReadSessionRef=ST_Defau, DcmDspDidReadSessionRef=ST_Exten
        DataInfo_TABROW_BatteTempeMaxim_ReadDataByIdent (DcmDspDataInfo): DcmDspDataFixedLength=true
        Data_DiagnServi_TABROW_NeuMeasu_Read_27_1_1_1_1_1 (DcmDspData):
          DcmDspDataSize = 8
          DcmDspDataType = UINT8_N
          DcmDspDataUsePort = USE_DATA_ASYNCH_CLIENT_SERVER
          DcmDspDataInfoRef = DataInfo_DiagnServi_TABROW_NeuMeasu_Read_27_1_1_1_1_1
        DidInfo_TABROW_StatePCM_ReadDataByIdent (DcmDspDidInfo)
          DcmDspDidAccess
            DcmDspDidRead: DcmDspDidReadSessionRef=ST_Defau, DcmDspDidReadSessionRef=ST_Exten
        DID_BMC_IWU_Status_Read_Data_By_Identifier (DcmDspDid):
          DcmDspDidIdentifier = 9992
          DcmDspDidUsed = true
          DcmDspDidUsePort = USE_DATA_ELEMENT_SPECIFIC_INTERFACES
          DcmDspDidInfoRef = DidInfo_BMC_IWU_Status_Read_Data_By_Identifier
          DcmDspDidSignal: DcmDspDidDataPos=0, DcmDspDidDataRef=Data_BMC_IWU_Status_Read_Data_By_Identifier
        Data_TABROW_BatteTempeAvera_ReadDataByIdent (DcmDspData):
          DcmDspDataSize = 16
          DcmDspDataType = UINT8_N
          DcmDspDataUsePort = USE_DATA_ASYNCH_CLIENT_SERVER
          DcmDspDataInfoRef = DataInfo_TABROW_BatteTempeAvera_ReadDataByIdent
        DidInfo_TABROW_TABROVWDat_Read_1 (DcmDspDidInfo)
          DcmDspDidAccess
            DcmDspDidWrite: DcmDspDidWriteSessionRef=ST_Exten
            DcmDspDidRead: DcmDspDidReadSessionRef=ST_Defau, DcmDspDidReadSessionRef=ST_Exten
        DataInfo_DiagnServi_SOH_Read (DcmDspDataInfo): DcmDspDataFixedLength=true
        DidInfo_TABROW_VWECUHardwNumbe_Read (DcmDspDidInfo)
          DcmDspDidAccess
            DcmDspDidRead: DcmDspDidReadSessionRef=ST_Progr
        DataInfo_TABROW_VkmsVkmsv_Read_Data_By_Identifier (DcmDspDataInfo): DcmDspDataFixedLength=true
        DidInfo_TABROW_ModeOfProteOfVehicDiagn_ReadDataByIdentifier (DcmDspDidInfo)
          DcmDspDidAccess
            DcmDspDidRead: DcmDspDidReadSessionRef=ST_Defau, DcmDspDidReadSessionRef=ST_Exten
        Routine_TABROW_CheckCalibPreCondi_Start_Routine (DcmDspRoutine):
          DcmDspRequestResultsRoutineSupported = false
          DcmDspStopRoutineSupported = false
          DcmDspRoutineIdentifier = 49171
          DcmDspRoutineFixedLength = false
          DcmDspRoutineUsePort = true
          DcmDspRoutineUsed = true
          DcmDspRoutineInfoRef = RoutineInfo_TABROW_CheckCalibPreCondi_Start_Routine
        Routine_DiagnServi_TABROW_ResetProteOfVehicDiagn_Start_Routine (DcmDspRoutine):
          DcmDspRequestResultsRoutineSupported = false
          DcmDspStopRoutineSupported = false
          DcmDspRoutineIdentifier = 49159
          DcmDspRoutineFixedLength = false
          DcmDspRoutineUsePort = true
          DcmDspRoutineUsed = true
          DcmDspRoutineInfoRef = RoutineInfo_DiagnServi_TABROW_ResetProteOfVehicDiagn_Start_Routine
        DataInfo_DiagnServi_TABROW_NeuMeasu_Read_29_2 (DcmDspDataInfo): DcmDspDataFixedLength=true
        DidInfo_TABROW_KnockTestMode_Read (DcmDspDidInfo)
          DcmDspDidAccess
            DcmDspDidWrite: DcmDspDidWriteSessionRef=ST_Exten
            DcmDspDidRead: DcmDspDidReadSessionRef=ST_Defau, DcmDspDidReadSessionRef=ST_Exten
        DataInfo_DiagnServi_TABROW_NeuMeasu_Read_29_3 (DcmDspDataInfo): DcmDspDataFixedLength=true
        DidInfo_TABROW_VkmsMissiKeyHisto_Read_Data_By_Identifier (DcmDspDidInfo)
          DcmDspDidAccess
            DcmDspDidRead: DcmDspDidReadSessionRef=ST_Defau, DcmDspDidReadSessionRef=ST_Exten
        3 x DcmDspDataInfo, all with DcmDspDataFixedLength=true:
          DataInfo_DiagnServi_TABROW_NeuMeasu_Read_29_4
          DataInfo_DiagnServi_TABROW_TABRORespo_Read_Data_By_Identifier
          DataInfo_DiagnServi_TABROW_NeuMeasu_Read_29_5
        Data_TABROW_StateOfBattePowerReduc_ReadDataByIdent (DcmDspData):
          DcmDspDataSize = 8
          DcmDspDataType = UINT8_N
          DcmDspDataUsePort = USE_DATA_ASYNCH_CLIENT_SERVER
          DcmDspDataInfoRef = DataInfo_TABROW_StateOfBattePowerReduc_ReadDataByIdent
        Data_DiagnServi_BMC_serial_number_Read (DcmDspData):
          DcmDspDataSize = 80
          DcmDspDataType = UINT8_N
          DcmDspDataUsePort = USE_DATA_ASYNCH_CLIENT_SERVER
          DcmDspDataInfoRef = DataInfo_DiagnServi_BMC_serial_number_Read
        DataInfo_DiagnServi_TABROW_NeuMeasu_Read_29_1 (DcmDspDataInfo): DcmDspDataFixedLength=true
        DID_DiagnServi_Type_number_BMCE_Read (DcmDspDid):
          DcmDspDidIdentifier = 799
          DcmDspDidUsed = true
          DcmDspDidUsePort = USE_DATA_ELEMENT_SPECIFIC_INTERFACES
          DcmDspDidInfoRef = DidInfo_DiagnServi_Type_number_BMCE_Read
          DcmDspDidSignal: DcmDspDidDataPos=0, DcmDspDidDataRef=Data_DiagnServi_Type_number_BMCE_Read
        Data_DiagnServi_TABROW_TABROOBDDr_Read_Data_By_Identifier (DcmDspData):
          DcmDspDataSize = 8
          DcmDspDataType = UINT8_N
          DcmDspDataUsePort = USE_DATA_ASYNCH_CLIENT_SERVER
          DcmDspDataInfoRef = DataInfo_DiagnServi_TABROW_TABROOBDDr_Read_Data_By_Identifier
        Data_DiagnServi_TABROW_NeuMeasu_Read_27_1_1_1_2 (DcmDspData):
          DcmDspDataSize = 8
          DcmDspDataType = UINT8_N
          DcmDspDataUsePort = USE_DATA_ASYNCH_CLIENT_SERVER
          DcmDspDataInfoRef = DataInfo_DiagnServi_TABROW_NeuMeasu_Read_27_1_1_1_2
        3 x DcmDspDataInfo, all with DcmDspDataFixedLength=true:
          DataInfo_DiagnServi_TABROW_NeuMeasu_Read_46_1_1_1_1_1_1_2
          DataInfo_DiagnServi_TABROW_NeuMeasu_Read_46_1_1_1_1_1_1_1
          DataInfo_State_Of_Charge_Battery_customer_Read_Data_By_Identifier
        Data_DiagnServi_TABROW_NeuMeasu_Read_27_1_1_1_1 (DcmDspData):
          DcmDspDataSize = 8
          DcmDspDataType = UINT8_N
          DcmDspDataUsePort = USE_DATA_ASYNCH_CLIENT_SERVER
          DcmDspDataInfoRef = DataInfo_DiagnServi_TABROW_NeuMeasu_Read_27_1_1_1_1
        DidInfo_Battery_contactors_actual_states_Read_Data_By_Identifier (DcmDspDidInfo)
          DcmDspDidAccess
            DcmDspDidRead: DcmDspDidReadSessionRef=ST_Defau, DcmDspDidReadSessionRef=ST_Exten
        DataInfo_DiagnServi_TABROW_NeuMeasu_Read_43_1_1_1_1_1_1 (DcmDspDataInfo): DcmDspDataFixedLength=true
        Data_DiagnServi_TABROW_ProduDeact_Read (DcmDspData):
          DcmDspDataSize = 24
          DcmDspDataType = UINT8_N
          DcmDspDataUsePort = USE_DATA_ASYNCH_CLIENT_SERVER
          DcmDspDataInfoRef = DataInfo_DiagnServi_TABROW_ProduDeact_Read
        DID_HV_battery_continuous_discharge_power_Read_Data_By_Identifier (DcmDspDid):
          DcmDspDidIdentifier = 783
          DcmDspDidUsed = true
          DcmDspDidUsePort = USE_DATA_ELEMENT_SPECIFIC_INTERFACES
          DcmDspDidInfoRef = DidInfo_HV_battery_continuous_discharge_power_Read_Data_By_Identifier
          DcmDspDidSignal: DcmDspDidDataPos=0, DcmDspDidDataRef=Data_HV_battery_continuous_discharge_power_Read_Data_By_Identifier
        Data_DiagnServi_ReadDataByIdentVWLogicSoftwBlockVersi (DcmDspData):
          DcmDspDataSize = 192
          DcmDspDataType = UINT8_N
          DcmDspDataUsePort = USE_DATA_ASYNCH_CLIENT_SERVER
          DcmDspDataInfoRef = DataInfo_DiagnServi_ReadDataByIdentVWLogicSoftwBlockVersi
        DataInfo_DiagnServi_TABROW_NeuMeasu_Read_43_1_1_1_1_1_1_1_1 (DcmDspDataInfo): DcmDspDataFixedLength=true
        DidInfo_TABROW_FingeAndProgrDateOfLogicSoftwBlock_Read (DcmDspDidInfo)
          DcmDspDidAccess
            DcmDspDidRead
        DidInfo_DiagnServi_TABROW_NeuMeasu_Read_29_1_1_1_1_1 (DcmDspDidInfo)
          DcmDspDidAccess
            DcmDspDidRead: DcmDspDidReadSessionRef=ST_Defau, DcmDspDidReadSessionRef=ST_Exten
        DID_DiagnServi_TABROW_BootlTPBlock_Read (DcmDspDid):
          DcmDspDidIdentifier = 1040
          DcmDspDidUsed = true
          DcmDspDidUsePort = USE_DATA_ELEMENT_SPECIFIC_INTERFACES
          DcmDspDidInfoRef = DidInfo_DiagnServi_TABROW_BootlTPBlock_Read
          DcmDspDidSignal: DcmDspDidDataPos=0, DcmDspDidDataRef=Data_DiagnServi_TABROW_BootlTPBlock_Read
        Data_Battery_displayed_state_of_charge_Read_Data_By_Identifier (DcmDspData):
          DcmDspDataSize = 16
          DcmDspDataType = UINT8_N
          DcmDspDataUsePort = USE_DATA_ASYNCH_CLIENT_SERVER
          DcmDspDataInfoRef = DataInfo_Battery_displayed_state_of_charge_Read_Data_By_Identifier
        Data_DiagnServi_TABROW_NeuMeasu_Read_46_1_1_1_1 (DcmDspData):
          DcmDspDataSize = 1216
          DcmDspDataType = UINT8_N
          DcmDspDataUsePort = USE_DATA_ASYNCH_CLIENT_SERVER
          DcmDspDataInfoRef = DataInfo_DiagnServi_TABROW_NeuMeasu_Read_46_1_1_1_1
        DID_DiagnServi_ReadDataByIdentVWLogicBlockDowngProteVersi (DcmDspDid):
          DcmDspDidIdentifier = 393
          DcmDspDidUsed = true
          DcmDspDidUsePort = USE_DATA_ELEMENT_SPECIFIC_INTERFACES
          DcmDspDidInfoRef = DidInfo_DiagnServi_ReadDataByIdentVWLogicBlockDowngProteVersi
          DcmDspDidSignal: DcmDspDidDataPos=0, DcmDspDidDataRef=Data_DiagnServi_ReadDataByIdentVWLogicBlockDowngProteVersi
        DidInfo_Battery_displayed_state_of_charge_Read_Data_By_Identifier (DcmDspDidInfo)
          DcmDspDidAccess
            DcmDspDidRead: DcmDspDidReadSessionRef=ST_Defau, DcmDspDidReadSessionRef=ST_Exten
        DataInfo_BMC_Strom_Read_Data_By_Identifier (DcmDspDataInfo): DcmDspDataFixedLength=true
        RoutineInfo_DiagnServi_TABROW_ResetToFactoSetti_Start_Routine_COP (DcmDspRoutineInfo)
          DcmDspRoutineRequestResOut
            ResData (DcmDspRoutineRequestResOutSignal): DcmDspRoutineSignalLength=8, DcmDspRoutineSignalType=UINT8_N, DcmDspRoutineSignalEndianness=opaque, DcmDspRoutineSignalPos=0
          DcmDspStartRoutineIn
            ReqData (DcmDspStartRoutineInSignal): DcmDspRoutineSignalLength=24, DcmDspRoutineSignalType=UINT8_N, DcmDspRoutineSignalEndianness=opaque, DcmDspRoutineSignalPos=0
          DcmDspRoutineAuthorization: DcmDspRoutineSessionRef=ST_Exten
          DcmDspRoutineStopOut
            ResData (DcmDspRoutineStopOutSignal): DcmDspRoutineSignalLength=8, DcmDspRoutineSignalType=UINT8_N, DcmDspRoutineSignalEndianness=opaque, DcmDspRoutineSignalPos=0
          DcmDspStartRoutineOut
            ResData (DcmDspStartRoutineOutSignal): DcmDspRoutineSignalLength=8, DcmDspRoutineSignalType=UINT8_N, DcmDspRoutineSignalEndianness=opaque, DcmDspRoutineSignalPos=0
        Data_DiagnServi_TABROW_ContrModulVolta_Read (DcmDspData):
          DcmDspDataSize = 16
          DcmDspDataType = UINT8_N
          DcmDspDataUsePort = USE_DATA_ASYNCH_CLIENT_SERVER
          DcmDspDataInfoRef = DataInfo_DiagnServi_TABROW_ContrModulVolta_Read
        Data_TABROW_ProgrPreco_Read (DcmDspData): DcmDspDataSize=2048, DcmDspDataType=UINT8_N, DcmDspDataUsePort=USE_DATA_ASYNCH_CLIENT_SERVER, DcmDspDataInfoRef=DataInfo_TABROW_ProgrPreco_Read
        DidInfo_DiagnServi_TABROW_NeuMeasu_Read_43_1_1_1_1_1_1_1_1_1_1 (DcmDspDidInfo)
          DcmDspDidAccess
            DcmDspDidRead: DcmDspDidReadSessionRef=ST_Defau, DcmDspDidReadSessionRef=ST_Exten
        DataInfo_DiagnServi_TABROW_NeuMeasu_Read_60_3 (DcmDspDataInfo): DcmDspDataFixedLength=true
        DataInfo_DiagnServi_TABROW_NeuMeasu_Read_60_1 (DcmDspDataInfo): DcmDspDataFixedLength=true
        DidInfo_DiagnServi_TABROW_NeuMeasu_Read_58_1 (DcmDspDidInfo)
          DcmDspDidAccess
            DcmDspDidRead: DcmDspDidReadSessionRef=ST_Defau, DcmDspDidReadSessionRef=ST_Exten
        DID_DiagnServi_TABROW_NeuMeasu_Read_29_1_1_1_1 (DcmDspDid):
          DcmDspDidIdentifier = 57375
          DcmDspDidUsed = true
          DcmDspDidUsePort = USE_DATA_ELEMENT_SPECIFIC_INTERFACES
          DcmDspDidInfoRef = DidInfo_DiagnServi_TABROW_NeuMeasu_Read_29_1_1_1_1
          DcmDspDidSignal: DcmDspDidDataPos=0, DcmDspDidDataRef=Data_DiagnServi_TABROW_NeuMeasu_Read_29_1_1_1_1
        DataInfo_DiagnServi_Type_number_assembly_Read (DcmDspDataInfo): DcmDspDataFixedLength=true
        Data_DiagnServi_TABROW_NeuMeasu_Read_63_1_1_1 (DcmDspData):
          DcmDspDataSize = 128
          DcmDspDataType = UINT8_N
          DcmDspDataUsePort = USE_DATA_ASYNCH_CLIENT_SERVER
          DcmDspDataInfoRef = DataInfo_DiagnServi_TABROW_NeuMeasu_Read_63_1_1_1
        DID_TABROW_ModeOfProteOfVehicDiagn_ReadDataByIdentifier (DcmDspDid):
          DcmDspDidIdentifier = 15374
          DcmDspDidUsed = true
          DcmDspDidUsePort = USE_DATA_ELEMENT_SPECIFIC_INTERFACES
          DcmDspDidInfoRef = DidInfo_TABROW_ModeOfProteOfVehicDiagn_ReadDataByIdentifier
          DcmDspDidSignal: DcmDspDidDataPos=0, DcmDspDidDataRef=Data_TABROW_ModeOfProteOfVehicDiagn_ReadDataByIdentifier
        DID_TABROW_TABROSyste_Read_1_1_1_1_1_1_1_1_1_1_1_1_1 (DcmDspDid):
          DcmDspDidIdentifier = 57403
          DcmDspDidUsed = true
          DcmDspDidUsePort = USE_DATA_ELEMENT_SPECIFIC_INTERFACES
          DcmDspDidInfoRef = DidInfo_TABROW_TABROSyste_Read_1_1_1_1_1_1_1_1_1_1_1_1_1
          DcmDspDidSignal: DcmDspDidDataPos=0, DcmDspDidDataRef=Data_TABROW_TABROSyste_Read_1_1_1_1_1_1_1_1_1_1_1_1_1
        DataInfo_HV_battery_continuous_discharge_power_Read_Data_By_Identifier (DcmDspDataInfo): DcmDspDataFixedLength=true
        DID_Battery_energy_content_maximum_Read_Data_By_Identifier (DcmDspDid):
          DcmDspDidIdentifier = 10011
          DcmDspDidUsed = true
          DcmDspDidUsePort = USE_DATA_ELEMENT_SPECIFIC_INTERFACES
          DcmDspDidInfoRef = DidInfo_Battery_energy_content_maximum_Read_Data_By_Identifier
          DcmDspDidSignal: DcmDspDidDataPos=0, DcmDspDidDataRef=Data_Battery_energy_content_maximum_Read_Data_By_Identifier
        Data_DiagnServi_TABROW_MonitStatuThisDriviCycle_Read (DcmDspData):
          DcmDspDataSize = 32
          DcmDspDataType = UINT8_N
          DcmDspDataUsePort = USE_DATA_ASYNCH_CLIENT_SERVER
          DcmDspDataInfoRef = DataInfo_DiagnServi_TABROW_MonitStatuThisDriviCycle_Read
        Data_TABROW_StatuProdu_Read_Data_By_Identifier (DcmDspData):
          DcmDspDataSize = 8
          DcmDspDataType = UINT8_N
          DcmDspDataUsePort = USE_DATA_ASYNCH_CLIENT_SERVER
          DcmDspDataInfoRef = DataInfo_TABROW_StatuProdu_Read_Data_By_Identifier
        DataInfo_TABROW_StatuProdu_Read_Data_By_Identifier (DcmDspDataInfo): DcmDspDataFixedLength=true
        DataInfo_TABROW_TABROSyste_Read_1_1_1_1_1_1_1_1_1_1_1_1 (DcmDspDataInfo): DcmDspDataFixedLength=true
        3 x DcmDspDidInfo:
          DidInfo_TABROW_SOKSignaFaileList_Read_Data_By_Identifier
            DcmDspDidAccess
              DcmDspDidRead: DcmDspDidReadSessionRef=ST_Defau, DcmDspDidReadSessionRef=ST_Exten
          DidInfo_DiagnServi_TABROW_NeuMeasu_Read_27_1_2
            DcmDspDidAccess
              DcmDspDidRead: DcmDspDidReadSessionRef=ST_Defau, DcmDspDidReadSessionRef=ST_Exten
          DidInfo_DiagnServi_TABROW_NeuMeasu_Read_27_1_1
            DcmDspDidAccess
              DcmDspDidRead: DcmDspDidReadSessionRef=ST_Defau, DcmDspDidReadSessionRef=ST_Exten
        Routine_TABROW_LockProteOfVehicDiagn_Start_Routine (DcmDspRoutine):
          DcmDspRequestResultsRoutineSupported = false
          DcmDspStopRoutineSupported = false
          DcmDspRoutineIdentifier = 49157
          DcmDspRoutineFixedLength = false
          DcmDspRoutineUsePort = true
          DcmDspRoutineUsed = true
          DcmDspRoutineInfoRef = RoutineInfo_TABROW_LockProteOfVehicDiagn_Start_Routine
        Data_TABROW_StatePCM_ReadDataByIdent (DcmDspData):
          DcmDspDataSize = 8
          DcmDspDataType = UINT8_N
          DcmDspDataUsePort = USE_DATA_ASYNCH_CLIENT_SERVER
          DcmDspDataInfoRef = DataInfo_TABROW_StatePCM_ReadDataByIdent
        Data_TABROW_StandAmbieCondi_ReadDataByIdent (DcmDspData):
          DcmDspDataSize = 72
          DcmDspDataType = UINT8_N
          DcmDspDataUsePort = USE_DATA_ASYNCH_CLIENT_SERVER
          DcmDspDataInfoRef = DataInfo_TABROW_StandAmbieCondi_ReadDataByIdent
        DataInfo_DiagnServi_TABROW_NeuMeasu_Read_43_1_1_1_1_1_1_1 (DcmDspDataInfo): DcmDspDataFixedLength=true
        DID_DiagnServi_TABROW_TechnSpeciVersi_Read (DcmDspDid):
          DcmDspDidIdentifier = 61876
          DcmDspDidUsed = true
          DcmDspDidUsePort = USE_DATA_ELEMENT_SPECIFIC_INTERFACES
          DcmDspDidInfoRef = DidInfo_DiagnServi_TABROW_TechnSpeciVersi_Read
          DcmDspDidSignal: DcmDspDidDataPos=0, DcmDspDidDataRef=Data_DiagnServi_TABROW_TechnSpeciVersi_Read
        DID_BMC_Strom_Read_Data_By_Identifier (DcmDspDid):
          DcmDspDidIdentifier = 1292
          DcmDspDidUsed = true
          DcmDspDidUsePort = USE_DATA_ELEMENT_SPECIFIC_INTERFACES
          DcmDspDidInfoRef = DidInfo_BMC_Strom_Read_Data_By_Identifier
          DcmDspDidSignal: DcmDspDidDataPos=0, DcmDspDidDataRef=Data_BMC_Strom_Read_Data_By_Identifier
        Data_DiagnServi_TABROW_NeuMeasu2_Read (DcmDspData):
          DcmDspDataSize = 8
          DcmDspDataType = UINT8_N
          DcmDspDataUsePort = USE_DATA_ASYNCH_CLIENT_SERVER
          DcmDspDataInfoRef = DataInfo_DiagnServi_TABROW_NeuMeasu2_Read
        DidInfo_DiagnServi_TABROW_NeuMeasu_Read_46_1_1_1_1_1_1 (DcmDspDidInfo)
          DcmDspDidAccess
            DcmDspDidRead: DcmDspDidReadSessionRef=ST_Defau, DcmDspDidReadSessionRef=ST_Exten
        DataInfo_DiagnServi_TABROW_NeuMeasu_Read_27_1_1_1_1_1 (DcmDspDataInfo): DcmDspDataFixedLength=true
        DataInfo_DiagnServi_TABROW_NeuMeasu_Read_46_1_1_1 (DcmDspDataInfo): DcmDspDataFixedLength=true
        DidInfo_DiagnServi_TABROW_NeuMeasu_Read_36_1 (DcmDspDidInfo)
          DcmDspDidAccess
            DcmDspDidRead: DcmDspDidReadSessionRef=ST_Defau, DcmDspDidReadSessionRef=ST_Exten
        DidInfo_DiagnServi_TABROW_NeuMeasu_Read_36_3 (DcmDspDidInfo)
          DcmDspDidAccess
            DcmDspDidRead: DcmDspDidReadSessionRef=ST_Defau, DcmDspDidReadSessionRef=ST_Exten
        DID_DiagnServi_TABROW_UnlocStatuOfECUOfProteOfVehicDiagn_Read (DcmDspDid):
          DcmDspDidIdentifier = 372
          DcmDspDidUsed = true
          DcmDspDidUsePort = USE_DATA_ELEMENT_SPECIFIC_INTERFACES
          DcmDspDidInfoRef = DidInfo_DiagnServi_TABROW_UnlocStatuOfECUOfProteOfVehicDiagn_Read
          DcmDspDidSignal: DcmDspDidDataPos=0, DcmDspDidDataRef=Data_DiagnServi_TABROW_UnlocStatuOfECUOfProteOfVehicDiagn_Read
        Data_DiagnServi_TABROW_VWAppliDataSetIdent_Read (DcmDspData):
          DcmDspDataType = UINT8_N
          DcmDspDataSize = 65535
          DcmDspDataUsePort = USE_DATA_ASYNCH_CLIENT_SERVER
          DcmDspDataInfoRef = DataInfo_DiagnServi_TABROW_VWAppliDataSetIdent_Read
        DataInfo_TABROW_VWECUHardwNumbe_Read (DcmDspDataInfo): DcmDspDataFixedLength=true
        DidInfo_DiagnServi_TABROW_NeuMeasu_Read_29_1_1_1_1_1_1 (DcmDspDidInfo)
          DcmDspDidAccess
            DcmDspDidRead: DcmDspDidReadSessionRef=ST_Defau, DcmDspDidReadSessionRef=ST_Exten
        Data_HV_battery_maximum_charging_power_Read_Data_By_Identifier (DcmDspData):
          DcmDspDataSize = 16
          DcmDspDataType = UINT8_N
          DcmDspDataUsePort = USE_DATA_ASYNCH_CLIENT_SERVER
          DcmDspDataInfoRef = DataInfo_HV_battery_maximum_charging_power_Read_Data_By_Identifier
        Routine_DiagnServi_Verify_partial_software_checksum_Start_Routine (DcmDspRoutine):
          DcmDspRequestResultsRoutineSupported = false
          DcmDspStopRoutineSupported = false
          DcmDspRoutineIdentifier = 1348
          DcmDspRoutineFixedLength = false
          DcmDspRoutineUsePort = true
          DcmDspRoutineUsed = true
          DcmDspRoutineInfoRef = RoutineInfo_DiagnServi_Verify_partial_software_checksum_Start_Routine
        Data_Battery_banks_allowed_modes_Read_Data_By_Identifier (DcmDspData):
          DcmDspDataSize = 8
          DcmDspDataType = UINT8_N
          DcmDspDataUsePort = USE_DATA_ASYNCH_CLIENT_SERVER
          DcmDspDataInfoRef = DataInfo_Battery_banks_allowed_modes_Read_Data_By_Identifier
        Routine_TABROW_VkmsDebug_Start_Routine (DcmDspRoutine):
          DcmDspRequestResultsRoutineSupported = true
          DcmDspStopRoutineSupported = false
          DcmDspRoutineIdentifier = 1608
          DcmDspRoutineFixedLength = false
          DcmDspRoutineUsePort = true
          DcmDspRoutineUsed = true
          DcmDspRoutineInfoRef = RoutineInfo_TABROW_VkmsDebug_Start_Routine_001
        Routine_DiagnServi_Get_Charge_Power_Start_Routine (DcmDspRoutine):
          DcmDspRequestResultsRoutineSupported = true
          DcmDspStopRoutineSupported = true
          DcmDspRoutineIdentifier = 65279
          DcmDspRoutineFixedLength = false
          DcmDspRoutineUsePort = true
          DcmDspRoutineUsed = true
          DcmDspRoutineInfoRef = RoutineInfo_DiagnServi_Get_Charge_Power_Start_Routine
        Data_DiagnServi_TABROW_NeuMeasu_Read_63_1_1 (DcmDspData):
          DcmDspDataSize = 128
          DcmDspDataType = UINT8_N
          DcmDspDataUsePort = USE_DATA_ASYNCH_CLIENT_SERVER
          DcmDspDataInfoRef = DataInfo_DiagnServi_TABROW_NeuMeasu_Read_63_1_1
        DataInfo_Maximum_Charge_Voltage_Read_Data_By_Identifier (DcmDspDataInfo): DcmDspDataFixedLength=true
        DataInfo_HV_Battery_thermal_load_Read_Data_By_Identifier (DcmDspDataInfo): DcmDspDataFixedLength=true
        DidInfo_Zero_Potential_Status_Read_Data_By_Identifier (DcmDspDidInfo)
          DcmDspDidAccess
            DcmDspDidRead: DcmDspDidReadSessionRef=ST_Defau, DcmDspDidReadSessionRef=ST_Exten
        DataInfo_DiagnServi_TABROW_NeuMeasu_Read_48 (DcmDspDataInfo): DcmDspDataFixedLength=true
        DataInfo_DiagnServi_TABROW_NeuMeasu_Read_49 (DcmDspDataInfo): DcmDspDataFixedLength=true
        DID_DiagnServi_TABROW_DID0x0EF_Read (DcmDspDid):
          DcmDspDidIdentifier = 1379
          DcmDspDidUsed = true
          DcmDspDidUsePort = USE_DATA_ELEMENT_SPECIFIC_INTERFACES
          DcmDspDidInfoRef = DidInfo_DiagnServi_TABROW_DID0x0EF_Read
          DcmDspDidSignal: DcmDspDidDataPos=0, DcmDspDidDataRef=Data_DiagnServi_TABROW_DID0x0EF_Read
        Data_DiagnServi_TABROW_NeuMeasu_Read_28_2 (DcmDspData):
          DcmDspDataSize = 16
          DcmDspDataType = UINT8_N
          DcmDspDataUsePort = USE_DATA_ASYNCH_CLIENT_SERVER
          DcmDspDataInfoRef = DataInfo_DiagnServi_TABROW_NeuMeasu_Read_28_2
        DataInfo_DiagnServi_TABROW_NeuMeasu_Read_46 (DcmDspDataInfo): DcmDspDataFixedLength=true
        Data_DiagnServi_TABROW_NeuMeasu_Read_28_1 (DcmDspData):
          DcmDspDataSize = 8
          DcmDspDataType = UINT8_N
          DcmDspDataUsePort = USE_DATA_ASYNCH_CLIENT_SERVER
          DcmDspDataInfoRef = DataInfo_DiagnServi_TABROW_NeuMeasu_Read_28_1
        DataInfo_DiagnServi_TABROW_NeuMeasu_Read_47 (DcmDspDataInfo): DcmDspDataFixedLength=true
        Data_DiagnServi_TABROW_NeuMeasu_Read_28_4 (DcmDspData):
          DcmDspDataSize = 32
          DcmDspDataType = UINT8_N
          DcmDspDataUsePort = USE_DATA_ASYNCH_CLIENT_SERVER
          DcmDspDataInfoRef = DataInfo_DiagnServi_TABROW_NeuMeasu_Read_28_4
        Data_DiagnServi_TABROW_NeuMeasu_Read_28_3 (DcmDspData):
          DcmDspDataSize = 32
          DcmDspDataType = UINT8_N
          DcmDspDataUsePort = USE_DATA_ASYNCH_CLIENT_SERVER
          DcmDspDataInfoRef = DataInfo_DiagnServi_TABROW_NeuMeasu_Read_28_3
        DataInfo_DiagnServi_TABROW_NeuMeasu_Read_45 (DcmDspDataInfo): DcmDspDataFixedLength=true
        Data_DiagnServi_TABROW_NeuMeasu_Read_28_6 (DcmDspData):
          DcmDspDataSize = 16
          DcmDspDataType = UINT8_N
          DcmDspDataUsePort = USE_DATA_ASYNCH_CLIENT_SERVER
          DcmDspDataInfoRef = DataInfo_DiagnServi_TABROW_NeuMeasu_Read_28_6
        DataInfo_DiagnServi_TABROW_NeuMeasu_Read_42 (DcmDspDataInfo): DcmDspDataFixedLength=true
        Data_DiagnServi_TABROW_NeuMeasu_Read_28_5 (DcmDspData):
          DcmDspDataSize = 32
          DcmDspDataType = UINT8_N
          DcmDspDataUsePort = USE_DATA_ASYNCH_CLIENT_SERVER
          DcmDspDataInfoRef = DataInfo_DiagnServi_TABROW_NeuMeasu_Read_28_5
        4 x DcmDspDataInfo, all with DcmDspDataFixedLength=true:
          DataInfo_DiagnServi_TABROW_NeuMeasu_Read_43
          DataInfo_DiagnServi_TABROW_NeuMeasu_Read_40
          DataInfo_DiagnServi_TABROW_NeuMeasu_Read_41
          DataInfo_DiagnServi_BCUe_part_number_Read
        RoutineInfo_DiagnServi_TABROW_ResetHardCrashFlag_Start_Routine (DcmDspRoutineInfo)
          DcmDspRoutineRequestResOut
            ResData (DcmDspRoutineRequestResOutSignal): DcmDspRoutineSignalLength=8, DcmDspRoutineSignalType=UINT8_N, DcmDspRoutineSignalEndianness=opaque, DcmDspRoutineSignalPos=0
          DcmDspRoutineAuthorization: DcmDspRoutineSessionRef=ST_Exten
          DcmDspRoutineStopOut
            ResData (DcmDspRoutineStopOutSignal): DcmDspRoutineSignalLength=8, DcmDspRoutineSignalType=UINT8_N, DcmDspRoutineSignalEndianness=opaque, DcmDspRoutineSignalPos=0
          DcmDspStartRoutineOut
            ResData (DcmDspStartRoutineOutSignal): DcmDspRoutineSignalLength=8, DcmDspRoutineSignalType=UINT8_N, DcmDspRoutineSignalEndianness=opaque, DcmDspRoutineSignalPos=0
        3 x DcmDspDid, all with DcmDspDidUsed=true, DcmDspDidUsePort=USE_DATA_ELEMENT_SPECIFIC_INTERFACES:
          DID_DiagnServi_TABROW_ContrModulVolta_Read: DcmDspDidIdentifier=62530, DcmDspDidInfoRef=DidInfo_DiagnServi_TABROW_ContrModulVolta_Read
            DcmDspDidSignal: DcmDspDidDataPos=0, DcmDspDidDataRef=Data_DiagnServi_TABROW_ContrModulVolta_Read
          DID_TABROW_VkmsMissiKeyHisto_Read_Data_By_Identifier: DcmDspDidIdentifier=11351, DcmDspDidInfoRef=DidInfo_TABROW_VkmsMissiKeyHisto_Read_Data_By_Identifier
            DcmDspDidSignal: DcmDspDidDataPos=0, DcmDspDidDataRef=Data_TABROW_VkmsMissiKeyHisto_Read_Data_By_Identifier
          DID_DiagnServi_TABROW_AUTOSStandAppliSoftwIdent_Read: DcmDspDidIdentifier=61871, DcmDspDidInfoRef=DidInfo_DiagnServi_TABROW_AUTOSStandAppliSoftwIdent_Read
            DcmDspDidSignal: DcmDspDidDataPos=0, DcmDspDidDataRef=Data_DiagnServi_TABROW_AUTOSStandAppliSoftwIdent_Read
        Data_DiagnServi_TABROW_NeuMeasu1_Read (DcmDspData):
          DcmDspDataSize = 16
          DcmDspDataType = UINT8_N
          DcmDspDataUsePort = USE_DATA_ASYNCH_CLIENT_SERVER
          DcmDspDataInfoRef = DataInfo_DiagnServi_TABROW_NeuMeasu1_Read
        DID_DiagnServi_TABROW_TABRORespo_Read_Data_By_Identifier (DcmDspDid):
          DcmDspDidIdentifier = 691
          DcmDspDidUsed = true
          DcmDspDidUsePort = USE_DATA_ELEMENT_SPECIFIC_INTERFACES
          DcmDspDidInfoRef = DidInfo_DiagnServi_TABROW_TABRORespo_Read_Data_By_Identifier
          DcmDspDidSignal: DcmDspDidDataPos=0, DcmDspDidDataRef=Data_DiagnServi_TABROW_TABRORespo_Read_Data_By_Identifier
        DidInfo_DiagnServi_TABROW_NeuMeasu_Read_46_1_1_1_1_1_1_2 (DcmDspDidInfo)
          DcmDspDidAccess
            DcmDspDidRead: DcmDspDidReadSessionRef=ST_Defau, DcmDspDidReadSessionRef=ST_Exten
        DidInfo_DiagnServi_TABROW_NeuMeasu_Read_46_1_1_1_1_1_1_1 (DcmDspDidInfo)
          DcmDspDidAccess
            DcmDspDidRead: DcmDspDidReadSessionRef=ST_Defau, DcmDspDidReadSessionRef=ST_Exten
        DID_Battery_energy_content_actual_Read_Data_By_Identifier (DcmDspDid):
          DcmDspDidIdentifier = 10010
          DcmDspDidUsed = true
          DcmDspDidUsePort = USE_DATA_ELEMENT_SPECIFIC_INTERFACES
          DcmDspDidInfoRef = DidInfo_Battery_energy_content_actual_Read_Data_By_Identifier
          DcmDspDidSignal: DcmDspDidDataPos=0, DcmDspDidDataRef=Data_Battery_energy_content_actual_Read_Data_By_Identifier
        Data_TABROW_TABROSyste_Read_1_1_1_1_1 (DcmDspData):
          DcmDspDataSize = 112
          DcmDspDataType = UINT8_N
          DcmDspDataUsePort = USE_DATA_ASYNCH_CLIENT_SERVER
          DcmDspDataInfoRef = DataInfo_TABROW_TABROSyste_Read_1_1_1_1_1
        DidInfo_TABROW_SOKGenerInfor_Read_Data_By_Identifier (DcmDspDidInfo)
          DcmDspDidAccess
            DcmDspDidRead: DcmDspDidReadSessionRef=ST_Defau, DcmDspDidReadSessionRef=ST_Exten
        DID_TABROW_SOKGenerInfor_Read_Data_By_Identifier (DcmDspDid):
          DcmDspDidIdentifier = 400
          DcmDspDidUsed = true
          DcmDspDidUsePort = USE_DATA_ELEMENT_SPECIFIC_INTERFACES
          DcmDspDidInfoRef = DidInfo_TABROW_SOKGenerInfor_Read_Data_By_Identifier
          DcmDspDidSignal: DcmDspDidDataPos=0, DcmDspDidDataRef=Data_TABROW_SOKGenerInfor_Read_Data_By_Identifier
        DidInfo_TABROW_SysteIdent_Read (DcmDspDidInfo)
          DcmDspDidAccess
            DcmDspDidRead
        DidInfo_TABROW_StandAmbieCondi_ReadDataByIdent (DcmDspDidInfo)
          DcmDspDidAccess
            DcmDspDidRead: DcmDspDidReadSessionRef=ST_Defau, DcmDspDidReadSessionRef=ST_Exten
        6 x DcmDspDataInfo, all with DcmDspDataFixedLength=true:
          DataInfo_DiagnServi_TABROW_NeuMeasu_Read_39
          DataInfo_DiagnServi_TABROW_NeuMeasu_Read_37
          DataInfo_DiagnServi_TABROW_NeuMeasu_Read_7_2
          DataInfo_DiagnServi_TABROW_NeuMeasu_Read_38
          DataInfo_DiagnServi_TABROW_NeuMeasu_Read_35
          DataInfo_DiagnServi_TABROW_NeuMeasu_Read_36
        DID_DiagnServi_ReadDataByIdentVWLogicSoftwBlockVersi (DcmDspDid):
          DcmDspDidIdentifier = 61867
          DcmDspDidUsed = true
          DcmDspDidUsePort = USE_DATA_ELEMENT_SPECIFIC_INTERFACES
          DcmDspDidInfoRef = DidInfo_DiagnServi_ReadDataByIdentVWLogicSoftwBlockVersi
          DcmDspDidSignal: DcmDspDidDataPos=0, DcmDspDidDataRef=Data_DiagnServi_ReadDataByIdentVWLogicSoftwBlockVersi
        DataInfo_DiagnServi_TABROW_NeuMeasu_Read_33 (DcmDspDataInfo): DcmDspDataFixedLength=true
        RoutineInfo_TABROW_SOKFunctDeact_Start_Routine_COP (DcmDspRoutineInfo)
          DcmDspRoutineRequestResOut
            ResData (DcmDspRoutineRequestResOutSignal): DcmDspRoutineSignalLength=24, DcmDspRoutineSignalType=UINT8_N, DcmDspRoutineSignalEndianness=opaque, DcmDspRoutineSignalPos=0
          DcmDspStartRoutineIn
            ReqData (DcmDspStartRoutineInSignal): DcmDspRoutineSignalLength=8, DcmDspRoutineSignalType=UINT8_N, DcmDspRoutineSignalEndianness=opaque, DcmDspRoutineSignalPos=0
          DcmDspRoutineAuthorization: DcmDspRoutineSessionRef=ST_Exten
          DcmDspRoutineStopOut
            ResData (DcmDspRoutineStopOutSignal): DcmDspRoutineSignalLength=8, DcmDspRoutineSignalType=UINT8_N, DcmDspRoutineSignalEndianness=opaque, DcmDspRoutineSignalPos=0
          DcmDspStartRoutineOut
            ResData (DcmDspStartRoutineOutSignal): DcmDspRoutineSignalLength=8, DcmDspRoutineSignalType=UINT8_N, DcmDspRoutineSignalEndianness=opaque, DcmDspRoutineSignalPos=0
        DidInfo_TABROW_TABROSyste_Read_1_1_1_1_1 (DcmDspDidInfo)
          DcmDspDidAccess
            DcmDspDidRead
        4 x DcmDspDataInfo, all with DcmDspDataFixedLength=true:
          DataInfo_DiagnServi_TABROW_NeuMeasu_Read_34
          DataInfo_DiagnServi_TABROW_NeuMeasu_Read_31
          DataInfo_DiagnServi_TABROW_NeuMeasu_Read_32
          DataInfo_DiagnServi_TABROW_NeuMeasu_Read_30
        DID_HV_battery_maximum_charging_current_Read_Data_By_Identifier (DcmDspDid):
          DcmDspDidIdentifier = 9996
          DcmDspDidUsed = true
          DcmDspDidUsePort = USE_DATA_ELEMENT_SPECIFIC_INTERFACES
          DcmDspDidInfoRef = DidInfo_HV_battery_maximum_charging_current_Read_Data_By_Identifier
          DcmDspDidSignal: DcmDspDidDataPos=0, DcmDspDidDataRef=Data_HV_battery_maximum_charging_current_Read_Data_By_Identifier
        DID_DiagnServi_TABROW_VWFAZITIdentStrin_Read (DcmDspDid):
          DcmDspDidIdentifier = 61820
          DcmDspDidUsed = true
          DcmDspDidUsePort = USE_DATA_ELEMENT_SPECIFIC_INTERFACES
          DcmDspDidInfoRef = DidInfo_DiagnServi_TABROW_VWFAZITIdentStrin_Read
          DcmDspDidSignal: DcmDspDidDataPos=0, DcmDspDidDataRef=Data_DiagnServi_TABROW_VWFAZITIdentStrin_Read
        DataInfo_DiagnServi_TABROW_AccelPedalPositD_Read (DcmDspDataInfo): DcmDspDataFixedLength=true
        DataInfo_TABROW_VkmsTrainCount_Read_Data_By_Identifier (DcmDspDataInfo): DcmDspDataFixedLength=true
        Data_HV_battery_performance_indicator_discharging_Read_Data_By_Identifier (DcmDspData):
          DcmDspDataSize = 16
          DcmDspDataType = UINT8_N
          DcmDspDataUsePort = USE_DATA_ASYNCH_CLIENT_SERVER
          DcmDspDataInfoRef = DataInfo_HV_battery_performance_indicator_discharging_Read_Data_By_Identifier
        RoutineInfo_DiagnServi_Verify_partial_software_checksum_Start_Routine (DcmDspRoutineInfo)
          DcmDspStartRoutineIn
            ReqData (DcmDspStartRoutineInSignal): DcmDspRoutineSignalLength=32904, DcmDspRoutineSignalType=VARIABLE_LENGTH, DcmDspRoutineSignalEndianness=opaque, DcmDspRoutineSignalPos=0
          DcmDspRoutineAuthorization
          DcmDspStartRoutineOut
            ResData (DcmDspStartRoutineOutSignal): DcmDspRoutineSignalLength=8, DcmDspRoutineSignalType=UINT8_N, DcmDspRoutineSignalEndianness=opaque, DcmDspRoutineSignalPos=0
        Data_DiagnServi_TABROW_NeuMeasu_Read_70_1 (DcmDspData):
          DcmDspDataSize = 8
          DcmDspDataType = UINT8_N
          DcmDspDataUsePort = USE_DATA_ASYNCH_CLIENT_SERVER
          DcmDspDataInfoRef = DataInfo_DiagnServi_TABROW_NeuMeasu_Read_70_1
        DataInfo_TABROW_StatePCM_ReadDataByIdent (DcmDspDataInfo): DcmDspDataFixedLength=true
        Data_TABROW_BMCHVKFehleSD_Read_Data_By_Identifier (DcmDspData):
          DcmDspDataSize = 8
          DcmDspDataType = UINT8_N
          DcmDspDataUsePort = USE_DATA_ASYNCH_CLIENT_SERVER
          DcmDspDataInfoRef = DataInfo_TABROW_BMCHVKFehleSD_Read_Data_By_Identifier
        7 x DcmDspDataInfo, all with DcmDspDataFixedLength=true:
          DataInfo_TABROW_BMCHVKEoHVLState_Read_Data_By_Identifier
          DataInfo_DiagnServi_TABROW_NeuMeasu_Read_7_1
          DataInfo_DiagnServi_TABROW_NeuMeasu_Read_28
          DataInfo_DiagnServi_TABROW_NeuMeasu_Read_29
          DataInfo_DiagnServi_TABROW_NeuMeasu_Read_26
          DataInfo_DiagnServi_TABROW_NeuMeasu_Read_27
          DataInfo_DiagnServi_TABROW_NeuMeasu_Read_24
        Data_TABROW_OBDClassDescr_Read_Data_By_Identifier (DcmDspData):
          DcmDspDataSize = 16
          DcmDspDataType = UINT8_N
          DcmDspDataUsePort = USE_DATA_ASYNCH_CLIENT_SERVER
          DcmDspDataInfoRef = DataInfo_TABROW_OBDClassDescr_Read_Data_By_Identifier
        Data_TABROW_ECUStandMode2_Read (DcmDspData): DcmDspDataSize=32, DcmDspDataType=UINT8_N, DcmDspDataUsePort=USE_DATA_ASYNCH_CLIENT_SERVER, DcmDspDataInfoRef=DataInfo_TABROW_ECUStandMode2_Read
        DataInfo_DiagnServi_TABROW_NeuMeasu_Read_25 (DcmDspDataInfo): DcmDspDataFixedLength=true
        Data_TABROW_VWWorksSysteName_Read (DcmDspData):
          DcmDspDataSize = 40
          DcmDspDataType = UINT8_N
          DcmDspDataUsePort = USE_DATA_ASYNCH_CLIENT_SERVER
          DcmDspDataInfoRef = DataInfo_TABROW_VWWorksSysteName_Read
        DataInfo_DiagnServi_TABROW_NeuMeasu_Read_23 (DcmDspDataInfo): DcmDspDataFixedLength=true
        DataInfo_DiagnServi_TABROW_NeuMeasu_Read_20 (DcmDspDataInfo): DcmDspDataFixedLength=true
        DID_DiagnServi_TABROW_NeuMeasu_Read_27_2_1 (DcmDspDid):
          DcmDspDidIdentifier = 1658
          DcmDspDidUsed = true
          DcmDspDidUsePort = USE_DATA_ELEMENT_SPECIFIC_INTERFACES
          DcmDspDidInfoRef = DidInfo_DiagnServi_TABROW_NeuMeasu_Read_27_2_1
          DcmDspDidSignal: DcmDspDidDataPos=0, DcmDspDidDataRef=Data_DiagnServi_TABROW_NeuMeasu_Read_27_2_1
        DataInfo_DiagnServi_TABROW_ECUSeriaNumbe_Read (DcmDspDataInfo): DcmDspDataFixedLength=true
        DID_TABROW_StateOfBatteShutoCrash_ReadDataByIdent (DcmDspDid):
          DcmDspDidIdentifier = 7686
          DcmDspDidUsed = true
          DcmDspDidUsePort = USE_DATA_ELEMENT_SPECIFIC_INTERFACES
          DcmDspDidInfoRef = DidInfo_TABROW_StateOfBatteShutoCrash_ReadDataByIdent
          DcmDspDidSignal: DcmDspDidDataPos=0, DcmDspDidDataRef=Data_TABROW_StateOfBatteShutoCrash_ReadDataByIdent
        RoutineInfo_DiagnServi_TABROW_VkmsGetPssHash_Start_Routine (DcmDspRoutineInfo)
          DcmDspRoutineRequestResOut
            ResData (DcmDspRoutineRequestResOutSignal): DcmDspRoutineSignalLength=144, DcmDspRoutineSignalType=UINT8_N, DcmDspRoutineSignalEndianness=opaque, DcmDspRoutineSignalPos=0
          DcmDspStartRoutineIn
            ReqData (DcmDspStartRoutineInSignal): DcmDspRoutineSignalLength=8, DcmDspRoutineSignalType=UINT8_N, DcmDspRoutineSignalEndianness=opaque, DcmDspRoutineSignalPos=0
          DcmDspRoutineAuthorization: DcmDspRoutineSessionRef=ST_Exten
        DID_BMC_Vorlade_Zielspannung_Read_Data_By_Identifier (DcmDspDid):
          DcmDspDidIdentifier = 1295
          DcmDspDidUsed = true
          DcmDspDidUsePort = USE_DATA_ELEMENT_SPECIFIC_INTERFACES
          DcmDspDidInfoRef = DidInfo_BMC_Vorlade_Zielspannung_Read_Data_By_Identifier
          DcmDspDidSignal: DcmDspDidDataPos=0, DcmDspDidDataRef=Data_BMC_Vorlade_Zielspannung_Read_Data_By_Identifier
        Data_TABROW_CellVoltaMaxim_ReadDataByIdent (DcmDspData):
          DcmDspDataSize = 56
          DcmDspDataType = UINT8_N
          DcmDspDataUsePort = USE_DATA_ASYNCH_CLIENT_SERVER
          DcmDspDataInfoRef = DataInfo_TABROW_CellVoltaMaxim_ReadDataByIdent
        DataInfo_DiagnServi_TABROW_Milea_Read (DcmDspDataInfo): DcmDspDataFixedLength=true
        RoutineInfo_TABROW_VkmsHandlDownl_Start_Routine (DcmDspRoutineInfo)
          DcmDspRoutineRequestResOut
            ResData (DcmDspRoutineRequestResOutSignal): DcmDspRoutineSignalLength=16, DcmDspRoutineSignalType=UINT8_N, DcmDspRoutineSignalEndianness=opaque, DcmDspRoutineSignalPos=0
          DcmDspStartRoutineIn
            ReqData (DcmDspStartRoutineInSignal): DcmDspRoutineSignalLength=4104, DcmDspRoutineSignalType=VARIABLE_LENGTH, DcmDspRoutineSignalEndianness=opaque, DcmDspRoutineSignalPos=0
          DcmDspRoutineAuthorization: DcmDspRoutineSessionRef=ST_Exten
        DidInfo_DiagnServi_TABROW_VWAppliDataSetIdent_Read (DcmDspDidInfo)
          DcmDspDidAccess
            DcmDspDidRead: DcmDspDidReadSessionRef=ST_Defau, DcmDspDidReadSessionRef=ST_Exten
        DID_TABROW_TABROSyste_Read_1_1_1_1_1_1_1_1_1_1 (DcmDspDid):
          DcmDspDidIdentifier = 57400
          DcmDspDidUsed = true
          DcmDspDidUsePort = USE_DATA_ELEMENT_SPECIFIC_INTERFACES
          DcmDspDidInfoRef = DidInfo_TABROW_TABROSyste_Read_1_1_1_1_1_1_1_1_1_1
          DcmDspDidSignal: DcmDspDidDataPos=0, DcmDspDidDataRef=Data_TABROW_TABROSyste_Read_1_1_1_1_1_1_1_1_1_1
        DataInfo_TABROW_CellVoltaMaxim_ReadDataByIdent (DcmDspDataInfo): DcmDspDataFixedLength=true
        RoutineInfo_DiagnServi_TABROW_UnlocProteOfVehicDiagn_Start_Routine (DcmDspRoutineInfo)
          DcmDspStartRoutineIn
            ReqData (DcmDspStartRoutineInSignal): DcmDspRoutineSignalLength=3760, DcmDspRoutineSignalType=VARIABLE_LENGTH, DcmDspRoutineSignalEndianness=opaque, DcmDspRoutineSignalPos=0
          DcmDspRoutineAuthorization: DcmDspRoutineSessionRef=ST_Exten
          DcmDspStartRoutineOut
            ResData (DcmDspStartRoutineOutSignal): DcmDspRoutineSignalLength=16, DcmDspRoutineSignalType=UINT8_N, DcmDspRoutineSignalEndianness=opaque, DcmDspRoutineSignalPos=0
        Data_HV_battery_continuous_charging_power_Read_Data_By_Identifier (DcmDspData):
          DcmDspDataSize = 16
          DcmDspDataType = UINT8_N
          DcmDspDataUsePort = USE_DATA_ASYNCH_CLIENT_SERVER
          DcmDspDataInfoRef = DataInfo_HV_battery_continuous_charging_power_Read_Data_By_Identifier
        12 x DcmDspDataInfo:
          DataInfo_DiagnServi_TABROW_NeuMeasu_Read_19: DcmDspDataFixedLength=true
          DataInfo_DiagnServi_TABROW_NeuMeasu_Read_43_1_1_1_1_1: DcmDspDataFixedLength=true
          DataInfo_DiagnServi_TABROW_VWDataSetName_Read: DcmDspDataFixedLength=false
          DataInfo_TABROW_BatteTempeAvera_ReadDataByIdent: DcmDspDataFixedLength=true
          DataInfo_DiagnServi_TABROW_NeuMeasu_Read_17: DcmDspDataFixedLength=true
          DataInfo_DiagnServi_TABROW_NeuMeasu_Read_18: DcmDspDataFixedLength=true
          DataInfo_DiagnServi_TABROW_NeuMeasu_Read_15: DcmDspDataFixedLength=true
          DataInfo_DiagnServi_TABROW_NeuMeasu_Read_16: DcmDspDataFixedLength=true
          DataInfo_DiagnServi_TABROW_NeuMeasu_Read_13: DcmDspDataFixedLength=true
          DataInfo_DiagnServi_TABROW_NeuMeasu_Read_14: DcmDspDataFixedLength=true
          DataInfo_DiagnServi_TABROW_NeuMeasu_Read_11: DcmDspDataFixedLength=true
          DataInfo_DiagnServi_TABROW_NeuMeasu_Read_12: DcmDspDataFixedLength=true
        DidInfo_DiagnServi_HV_battery_modules_actual_voltage_Read (DcmDspDidInfo)
          DcmDspDidAccess
            DcmDspDidRead: DcmDspDidReadSessionRef=ST_Defau, DcmDspDidReadSessionRef=ST_Exten
        DataInfo_DiagnServi_TABROW_NeuMeasu_Read_10 (DcmDspDataInfo): DcmDspDataFixedLength=true
        DID_DiagnServi_TABROW_SuppoPIDs2140_Read (DcmDspDid):
          DcmDspDidIdentifier = 62496
          DcmDspDidUsed = true
          DcmDspDidUsePort = USE_DATA_ELEMENT_SPECIFIC_INTERFACES
          DcmDspDidInfoRef = DidInfo_DiagnServi_TABROW_SuppoPIDs2140_Read
        Data_DiagnServi_BMC_clamp_30c_Read (DcmDspData):
          DcmDspDataSize = 8
          DcmDspDataType = UINT8_N
          DcmDspDataUsePort = USE_DATA_ASYNCH_CLIENT_SERVER
          DcmDspDataInfoRef = DataInfo_DiagnServi_BMC_clamp_30c_Read
        DidInfo_DiagnServi_TABROW_CalibIdent_Read (DcmDspDidInfo)
          DcmDspDidAccess
            DcmDspDidRead: DcmDspDidReadSessionRef=ST_Defau, DcmDspDidReadSessionRef=ST_Exten
        RoutineInfo_DiagnServi_TABROW_RequeLoggiDataOfProteOfVehicDiagn_Start_Routine (DcmDspRoutineInfo)
          DcmDspStartRoutineIn
            ReqData (DcmDspStartRoutineInSignal): DcmDspRoutineSignalLength=8, DcmDspRoutineSignalType=UINT8_N, DcmDspRoutineSignalEndianness=opaque, DcmDspRoutineSignalPos=0
          DcmDspRoutineAuthorization: DcmDspRoutineSessionRef=ST_Exten
          DcmDspStartRoutineOut
            ResData (DcmDspStartRoutineOutSignal): DcmDspRoutineSignalLength=784, DcmDspRoutineSignalType=VARIABLE_LENGTH, DcmDspRoutineSignalEndianness=opaque, DcmDspRoutineSignalPos=0
        DID_DiagnServi_TABROW_NeuMeasu_Read_43_1_1_1_1_1_1_1 (DcmDspDid):
          DcmDspDidIdentifier = 1386
          DcmDspDidUsed = true
          DcmDspDidUsePort = USE_DATA_ELEMENT_SPECIFIC_INTERFACES
          DcmDspDidInfoRef = DidInfo_DiagnServi_TABROW_NeuMeasu_Read_43_1_1_1_1_1_1_1
          DcmDspDidSignal: DcmDspDidDataPos=0, DcmDspDidDataRef=Data_DiagnServi_TABROW_NeuMeasu_Read_43_1_1_1_1_1_1_1
        RoutineInfo_DiagnServi_TABROW_VkmsGetState_Start_Routine (DcmDspRoutineInfo)
          DcmDspRoutineRequestResOut
            ResData (DcmDspRoutineRequestResOutSignal): DcmDspRoutineSignalLength=96, DcmDspRoutineSignalType=UINT8_N, DcmDspRoutineSignalEndianness=opaque, DcmDspRoutineSignalPos=0
          DcmDspStartRoutineIn
            ReqData (DcmDspStartRoutineInSignal): DcmDspRoutineSignalLength=8, DcmDspRoutineSignalType=UINT8_N, DcmDspRoutineSignalEndianness=opaque, DcmDspRoutineSignalPos=0
          DcmDspRoutineAuthorization: DcmDspRoutineSessionRef=ST_Exten
        DidInfo_TABROW_StatuECUStandMode_Read (DcmDspDidInfo)
          DcmDspDidAccess
            DcmDspDidRead: DcmDspDidReadSessionRef=ST_Defau, DcmDspDidReadSessionRef=ST_Exten
        DidInfo_Battery_amount_of_modules_Read_Data_By_Identifier (DcmDspDidInfo)
          DcmDspDidAccess
            DcmDspDidRead: DcmDspDidReadSessionRef=ST_Defau, DcmDspDidReadSessionRef=ST_Exten
        Data_DiagnServi_TABROW_SysteSupplIdent_Read (DcmDspData):
          DcmDspDataSize = 256
          DcmDspDataType = UINT8_N
          DcmDspDataUsePort = USE_DATA_ASYNCH_CLIENT_SERVER
          DcmDspDataInfoRef = DataInfo_DiagnServi_TABROW_SysteSupplIdent_Read
        DID_HV_Battery_thermal_load_Read_Data_By_Identifier (DcmDspDid):
          DcmDspDidIdentifier = 782
          DcmDspDidUsed = true
          DcmDspDidUsePort = USE_DATA_ELEMENT_SPECIFIC_INTERFACES
          DcmDspDidInfoRef = DidInfo_HV_Battery_thermal_load_Read_Data_By_Identifier
          DcmDspDidSignal: DcmDspDidDataPos=0, DcmDspDidDataRef=Data_HV_Battery_thermal_load_Read_Data_By_Identifier
        DataInfo_TABROW_CellVoltaSum_ReadDataByIdent (DcmDspDataInfo): DcmDspDataFixedLength=true
        DidInfo_TABROW_TABROSyste_Read_1_1_1_1_1_1 (DcmDspDidInfo)
          DcmDspDidAccess
            DcmDspDidRead
        DID_DiagnServi_TABROW_NeuMeasu_Read_29_1_1_1_1_1 (DcmDspDid):
          DcmDspDidIdentifier = 57376
          DcmDspDidUsed = true
          DcmDspDidUsePort = USE_DATA_ELEMENT_SPECIFIC_INTERFACES
          DcmDspDidInfoRef = DidInfo_DiagnServi_TABROW_NeuMeasu_Read_29_1_1_1_1_1
          DcmDspDidSignal: DcmDspDidDataPos=0, DcmDspDidDataRef=Data_DiagnServi_TABROW_NeuMeasu_Read_29_1_1_1_1_1
        DidInfo_TABROW_TABROSyste_Read_1_1_1_1_1_1_1_1_1_1_1_1 (DcmDspDidInfo)
          DcmDspDidAccess
            DcmDspDidRead
        DataInfo_DiagnServi_TABROW_NeuMeasu_Read_84 (DcmDspDataInfo): DcmDspDataFixedLength=true
        RoutineInfo_DiagnServi_TABROW_NeuRoutiBasicSetti_Start_Routine_4_2 (DcmDspRoutineInfo)
          DcmDspRoutineRequestResOut
            ResData (DcmDspRoutineRequestResOutSignal): DcmDspRoutineSignalLength=8, DcmDspRoutineSignalType=UINT8_N, DcmDspRoutineSignalEndianness=opaque, DcmDspRoutineSignalPos=0
          DcmDspRoutineAuthorization: DcmDspRoutineSessionRef=ST_Exten
          DcmDspRoutineStopOut
            ResData (DcmDspRoutineStopOutSignal): DcmDspRoutineSignalLength=8, DcmDspRoutineSignalType=UINT8_N, DcmDspRoutineSignalEndianness=opaque, DcmDspRoutineSignalPos=0
          DcmDspStartRoutineOut
            ResData (DcmDspStartRoutineOutSignal): DcmDspRoutineSignalLength=8, DcmDspRoutineSignalType=UINT8_N, DcmDspRoutineSignalEndianness=opaque, DcmDspRoutineSignalPos=0
        3 x DcmDspDataInfo, all with DcmDspDataFixedLength=true:
          DataInfo_DiagnServi_TABROW_NeuMeasu_Read_82
          DataInfo_DiagnServi_TABROW_NeuMeasu_Read_27_4_1
          DataInfo_DiagnServi_TABROW_NeuMeasu_Read_83
        6 x DcmDspDidInfo:
          DidInfo_DiagnServi_TABROW_NeuMeasu_Read_28_2
            DcmDspDidAccess
              DcmDspDidRead: DcmDspDidReadSessionRef=ST_Defau, DcmDspDidReadSessionRef=ST_Exten
          DidInfo_DiagnServi_TABROW_NeuMeasu_Read_28_1
            DcmDspDidAccess
              DcmDspDidRead: DcmDspDidReadSessionRef=ST_Defau, DcmDspDidReadSessionRef=ST_Exten
          DidInfo_DiagnServi_TABROW_NeuMeasu_Read_28_4
            DcmDspDidAccess
              DcmDspDidRead: DcmDspDidReadSessionRef=ST_Defau, DcmDspDidReadSessionRef=ST_Exten
          DidInfo_TABROW_VkmsKeyList_Read_Data_By_Identifier
            DcmDspDidAccess
              DcmDspDidRead: DcmDspDidReadSessionRef=ST_Defau, DcmDspDidReadSessionRef=ST_Exten
          DidInfo_DiagnServi_TABROW_NeuMeasu_Read_28_3
            DcmDspDidAccess
              DcmDspDidRead: DcmDspDidReadSessionRef=ST_Defau, DcmDspDidReadSessionRef=ST_Exten
          DidInfo_DiagnServi_TABROW_NeuMeasu_Read_28_6
            DcmDspDidAccess
              DcmDspDidRead: DcmDspDidReadSessionRef=ST_Defau, DcmDspDidReadSessionRef=ST_Exten
        Data_DiagnServi_TABROW_NeuMeasu_Read_9_2_1 (DcmDspData):
          DcmDspDataSize = 16
          DcmDspDataType = UINT8_N
          DcmDspDataUsePort = USE_DATA_ASYNCH_CLIENT_SERVER
          DcmDspDataInfoRef = DataInfo_DiagnServi_TABROW_NeuMeasu_Read_9_2_1
        DidInfo_DiagnServi_TABROW_NeuMeasu_Read_28_5 (DcmDspDidInfo)
          DcmDspDidAccess
            DcmDspDidRead: DcmDspDidReadSessionRef=ST_Defau, DcmDspDidReadSessionRef=ST_Exten
        DataInfo_TABROW_TABROVWDat_Read_1 (DcmDspDataInfo): DcmDspDataFixedLength=true
        Data_TABROW_CellStateOfChargMinim_ReadDataByIdent (DcmDspData):
          DcmDspDataSize = 32
          DcmDspDataType = UINT8_N
          DcmDspDataUsePort = USE_DATA_ASYNCH_CLIENT_SERVER
          DcmDspDataInfoRef = DataInfo_TABROW_CellStateOfChargMinim_ReadDataByIdent
        DID_Prozessorauslastung_Read_Data_By_Identifier (DcmDspDid):
          DcmDspDidIdentifier = 4112
          DcmDspDidUsed = true
          DcmDspDidUsePort = USE_DATA_ELEMENT_SPECIFIC_INTERFACES
          DcmDspDidInfoRef = DidInfo_Prozessorauslastung_Read_Data_By_Identifier
          DcmDspDidSignal: DcmDspDidDataPos=0, DcmDspDidDataRef=Data_Prozessorauslastung_Read_Data_By_Identifier
        DataInfo_TABROW_SOKFreshInfor_Read_Data_By_Identifier (DcmDspDataInfo): DcmDspDataFixedLength=false
        DataInfo_DC_charging_station_actual_voltage_Read_Data_By_Identifier (DcmDspDataInfo): DcmDspDataFixedLength=true
        Data_State_Of_Charge_Battery_customer_Read_Data_By_Identifier (DcmDspData):
          DcmDspDataSize = 16
          DcmDspDataType = UINT8_N
          DcmDspDataUsePort = USE_DATA_ASYNCH_CLIENT_SERVER
          DcmDspDataInfoRef = DataInfo_State_Of_Charge_Battery_customer_Read_Data_By_Identifier
        Data_TABROW_SOKMissiKeyList_Read_Data_By_Identifier (DcmDspData):
          DcmDspDataSize = 4096
          DcmDspDataType = UINT8_N
          DcmDspDataUsePort = USE_DATA_ASYNCH_CLIENT_SERVER
          DcmDspDataInfoRef = DataInfo_TABROW_SOKMissiKeyList_Read_Data_By_Identifier
        Routine_DiagnServi_TABROW_CalcuIntegValidData_Start_Routine (DcmDspRoutine):
          DcmDspRequestResultsRoutineSupported = false
          DcmDspStopRoutineSupported = false
          DcmDspRoutineIdentifier = 595
          DcmDspRoutineFixedLength = false
          DcmDspRoutineUsePort = true
          DcmDspRoutineUsed = true
          DcmDspRoutineInfoRef = RoutineInfo_DiagnServi_TABROW_CalcuIntegValidData_Start_Routine
        Data_TABROW_ModeOfProteOfVehicDiagn_ReadDataByIdentifier (DcmDspData):
          DcmDspDataSize = 8
          DcmDspDataType = UINT8_N
          DcmDspDataUsePort = USE_DATA_ASYNCH_CLIENT_SERVER
          DcmDspDataInfoRef = DataInfo_TABROW_ModeOfProteOfVehicDiagn_ReadDataByIdentifier
        DID_State_Of_Charge_Battery_customer_Read_Data_By_Identifier (DcmDspDid):
          DcmDspDidIdentifier = 793
          DcmDspDidUsed = true
          DcmDspDidUsePort = USE_DATA_ELEMENT_SPECIFIC_INTERFACES
          DcmDspDidInfoRef = DidInfo_State_Of_Charge_Battery_customer_Read_Data_By_Identifier
          DcmDspDidSignal: DcmDspDidDataPos=0, DcmDspDidDataRef=Data_State_Of_Charge_Battery_customer_Read_Data_By_Identifier
        DidInfo_DiagnServi_TABROW_TABRORespo_Read_Data_By_Identifier (DcmDspDidInfo)
          DcmDspDidAccess
            DcmDspDidRead: DcmDspDidReadSessionRef=ST_Defau, DcmDspDidReadSessionRef=ST_Exten
        3 x DcmDspDataInfo, all with DcmDspDataFixedLength=true:
          DataInfo_DiagnServi_TABROW_NeuMeasu_Read_73
          DataInfo_DiagnServi_TABROW_NeuMeasu_Read_74
          DataInfo_DiagnServi_TABROW_NeuMeasu_Read_71
        DID_DiagnServi_TABROW_ActivOfDevelMessa_Read (DcmDspDid):
          DcmDspDidIdentifier = 2306
          DcmDspDidUsed = true
          DcmDspDidUsePort = USE_DATA_ELEMENT_SPECIFIC_INTERFACES
          DcmDspDidInfoRef = DidInfo_DiagnServi_TABROW_ActivOfDevelMessa_Read
          DcmDspDidSignal: DcmDspDidDataPos=0, DcmDspDidDataRef=Data_DiagnServi_TABROW_ActivOfDevelMessa_Read
        DataInfo_DiagnServi_TABROW_NeuMeasu_Read_72 (DcmDspDataInfo): DcmDspDataFixedLength=true
        DataInfo_DiagnServi_TABROW_NeuMeasu_Read_70 (DcmDspDataInfo): DcmDspDataFixedLength=true
        Data_TABROW_VWECUHardwNumbe_Read (DcmDspData):
          DcmDspDataSize = 88
          DcmDspDataType = UINT8_N
          DcmDspDataUsePort = USE_DATA_ASYNCH_CLIENT_SERVER
          DcmDspDataInfoRef = DataInfo_TABROW_VWECUHardwNumbe_Read
          DcmDspDataBlockIdRef = DemPrimaryDataBlock7
        DidInfo_TABROW_VkmsVkmsv_Read_Data_By_Identifier (DcmDspDidInfo)
          DcmDspDidAccess
            DcmDspDidRead: DcmDspDidReadSessionRef=ST_Defau, DcmDspDidReadSessionRef=ST_Exten
        Data_DiagnServi_TABROW_Produ_Read (DcmDspData):
          DcmDspDataSize = 24
          DcmDspDataType = UINT8_N
          DcmDspDataUsePort = USE_DATA_ASYNCH_CLIENT_SERVER
          DcmDspDataInfoRef = DataInfo_DiagnServi_TABROW_Produ_Read
        Data_DiagnServi_TABROW_NeuMeasu_Read_43_1_1_1 (DcmDspData):
          DcmDspDataSize = 512
          DcmDspDataType = UINT8_N
          DcmDspDataUsePort = USE_DATA_ASYNCH_CLIENT_SERVER
          DcmDspDataInfoRef = DataInfo_DiagnServi_TABROW_NeuMeasu_Read_43_1_1_1
        3 x DcmDspDidInfo:
          DidInfo_DiagnServi_TABROW_NeuMeasu_Read_29_1_1_1_1_1_1_1
            DcmDspDidAccess
              DcmDspDidRead: DcmDspDidReadSessionRef=ST_Defau, DcmDspDidReadSessionRef=ST_Exten
          DidInfo_TABROW_StatuProdu_Read_Data_By_Identifier
            DcmDspDidAccess
              DcmDspDidRead: DcmDspDidReadSessionRef=ST_Defau, DcmDspDidReadSessionRef=ST_Exten
          DidInfo_DiagnServi_TABROW_NeuMeasu_Read_63_1_1
            DcmDspDidAccess
              DcmDspDidRead: DcmDspDidReadSessionRef=ST_Defau, DcmDspDidReadSessionRef=ST_Exten
        Data_TABROW_OBDType_Read (DcmDspData): DcmDspDataSize=8, DcmDspDataType=UINT8_N, DcmDspDataUsePort=USE_DATA_ASYNCH_CLIENT_SERVER, DcmDspDataInfoRef=DataInfo_TABROW_OBDType_Read
        DID_DiagnServi_TABROW_NeuMeasu_Read_60_3 (DcmDspDid):
          DcmDspDidIdentifier = 1748
          DcmDspDidUsed = true
          DcmDspDidUsePort = USE_DATA_ELEMENT_SPECIFIC_INTERFACES
          DcmDspDidInfoRef = DidInfo_DiagnServi_TABROW_NeuMeasu_Read_60_3
          DcmDspDidSignal: DcmDspDidDataPos=0, DcmDspDidDataRef=Data_DiagnServi_TABROW_NeuMeasu_Read_60_3
        DataInfo_TABROW_StandAmbieCondi_ReadDataByIdent (DcmDspDataInfo): DcmDspDataFixedLength=true
        DID_DiagnServi_TABROW_NeuMeasu_Read_60_1 (DcmDspDid):
          DcmDspDidIdentifier = 1732
          DcmDspDidUsed = true
          DcmDspDidUsePort = USE_DATA_ELEMENT_SPECIFIC_INTERFACES
          DcmDspDidInfoRef = DidInfo_DiagnServi_TABROW_NeuMeasu_Read_60_1
          DcmDspDidSignal: DcmDspDidDataPos=0, DcmDspDidDataRef=Data_DiagnServi_TABROW_NeuMeasu_Read_60_1
        DataInfo_DiagnServi_TABROW_DID0xEFD_Read (DcmDspDataInfo): DcmDspDataFixedLength=true
        DataInfo_TABROW_OBDClassDescr_Read_Data_By_Identifier (DcmDspDataInfo): DcmDspDataFixedLength=true
        Data_Battery_banks_actual_voltage_Read_Data_By_Identifier (DcmDspData):
          DcmDspDataSize = 64
          DcmDspDataType = UINT8_N
          DcmDspDataUsePort = USE_DATA_ASYNCH_CLIENT_SERVER
          DcmDspDataInfoRef = DataInfo_Battery_banks_actual_voltage_Read_Data_By_Identifier
        DidInfo_Minimum_Discharge_Voltage_Read_Data_By_Identifier (DcmDspDidInfo)
          DcmDspDidAccess
            DcmDspDidRead: DcmDspDidReadSessionRef=ST_Defau, DcmDspDidReadSessionRef=ST_Exten
        Data_Battery_energy_content_maximum_Read_Data_By_Identifier (DcmDspData):
          DcmDspDataSize = 16
          DcmDspDataType = UINT8_N
          DcmDspDataUsePort = USE_DATA_ASYNCH_CLIENT_SERVER
          DcmDspDataInfoRef = DataInfo_Battery_energy_content_maximum_Read_Data_By_Identifier
        RoutineInfo_DiagnServi_TABROW_AdaptOfVoltaMeasuChann_Start_Routine (DcmDspRoutineInfo)
          DcmDspRoutineRequestResOut
            ResData (DcmDspRoutineRequestResOutSignal): DcmDspRoutineSignalLength=48, DcmDspRoutineSignalType=UINT8_N, DcmDspRoutineSignalEndianness=opaque, DcmDspRoutineSignalPos=0
          DcmDspStartRoutineIn
            ReqData (DcmDspStartRoutineInSignal): DcmDspRoutineSignalLength=8, DcmDspRoutineSignalType=UINT8_N, DcmDspRoutineSignalEndianness=opaque, DcmDspRoutineSignalPos=0
          DcmDspRoutineAuthorization: DcmDspRoutineSessionRef=ST_Exten
          DcmDspRoutineStopOut
            ResData (DcmDspRoutineStopOutSignal): DcmDspRoutineSignalLength=8, DcmDspRoutineSignalType=UINT8_N, DcmDspRoutineSignalEndianness=opaque, DcmDspRoutineSignalPos=0
          DcmDspStartRoutineOut
            ResData (DcmDspStartRoutineOutSignal): DcmDspRoutineSignalLength=8, DcmDspRoutineSignalType=UINT8_N, DcmDspRoutineSignalEndianness=opaque, DcmDspRoutineSignalPos=0
        3 x DcmDspDataInfo, all with DcmDspDataFixedLength=true:
          DataInfo_DiagnServi_TABROW_NeuMeasu_Read_63
          DataInfo_DiagnServi_TABROW_NeuMeasu_Read_60
          DataInfo_DiagnServi_TABROW_NeuMeasu_Read_61
        Data_TABROW_TABROSyste_Read_1_1_1_1_1_1_1_1 (DcmDspData):
          DcmDspDataSize = 72
          DcmDspDataType = UINT8_N
          DcmDspDataUsePort = USE_DATA_ASYNCH_CLIENT_SERVER
          DcmDspDataInfoRef = DataInfo_TABROW_TABROSyste_Read_1_1_1_1_1_1_1_1
        DID_DiagnServi_TABROW_CalcuLOADValue_Read (DcmDspDid):
          DcmDspDidIdentifier = 62468
          DcmDspDidUsed = true
          DcmDspDidUsePort = USE_DATA_ELEMENT_SPECIFIC_INTERFACES
          DcmDspDidInfoRef = DidInfo_DiagnServi_TABROW_CalcuLOADValue_Read
          DcmDspDidSignal: DcmDspDidDataPos=0, DcmDspDidDataRef=Data_DiagnServi_TABROW_CalcuLOADValue_Read
        DID_HV_battery_performance_indicator_charging_Read_Data_By_Identifier (DcmDspDid):
          DcmDspDidIdentifier = 788
          DcmDspDidUsed = true
          DcmDspDidUsePort = USE_DATA_ELEMENT_SPECIFIC_INTERFACES
          DcmDspDidInfoRef = DidInfo_HV_battery_performance_indicator_charging_Read_Data_By_Identifier
          DcmDspDidSignal: DcmDspDidDataPos=0, DcmDspDidDataRef=Data_HV_battery_performance_indicator_charging_Read_Data_By_Identifier
        Data_TABROW_BMCHVKEoHVLState_Read_Data_By_Identifier (DcmDspData):
          DcmDspDataSize = 8
          DcmDspDataType = UINT8_N
          DcmDspDataUsePort = USE_DATA_ASYNCH_CLIENT_SERVER
          DcmDspDataInfoRef = DataInfo_TABROW_BMCHVKEoHVLState_Read_Data_By_Identifier
        DidInfo_DiagnServi_BMC_clamp_30c_Read (DcmDspDidInfo)
          DcmDspDidAccess
            DcmDspDidRead: DcmDspDidReadSessionRef=ST_Defau, DcmDspDidReadSessionRef=ST_Exten
        DidInfo_DiagnServi_TABROW_NeuMeasu_Read_70_1 (DcmDspDidInfo)
          DcmDspDidAccess
            DcmDspDidRead: DcmDspDidReadSessionRef=ST_Defau, DcmDspDidReadSessionRef=ST_Exten
        DataInfo_DiagnServi_TABROW_VWCodinValue_Read (DcmDspDataInfo): DcmDspDataFixedLength=true
        DataInfo_DiagnServi_TABROW_NeuMeasu_Read_55 (DcmDspDataInfo): DcmDspDataFixedLength=true
        Data_TABROW_CellStateOfChargMaxim_ReadDataByIdent (DcmDspData):
          DcmDspDataSize = 32
          DcmDspDataType = UINT8_N
          DcmDspDataUsePort = USE_DATA_ASYNCH_CLIENT_SERVER
          DcmDspDataInfoRef = DataInfo_TABROW_CellStateOfChargMaxim_ReadDataByIdent
        4 x DcmDspDataInfo, all with DcmDspDataFixedLength=true:
          DataInfo_DiagnServi_TABROW_NeuMeasu_Read_56
          DataInfo_DiagnServi_TABROW_NeuMeasu_Read_53
          DataInfo_DiagnServi_TABROW_NeuMeasu_Read_51
          DataInfo_DiagnServi_TABROW_NeuMeasu_Read_52
        DidInfo_HV_battery_continuous_charging_power_Read_Data_By_Identifier (DcmDspDidInfo)
          DcmDspDidAccess
            DcmDspDidRead: DcmDspDidReadSessionRef=ST_Defau, DcmDspDidReadSessionRef=ST_Exten
        DID_Zero_Potential_Status_Read_Data_By_Identifier (DcmDspDid):
          DcmDspDidIdentifier = 16921
          DcmDspDidUsed = true
          DcmDspDidUsePort = USE_DATA_ELEMENT_SPECIFIC_INTERFACES
          DcmDspDidInfoRef = DidInfo_Zero_Potential_Status_Read_Data_By_Identifier
          DcmDspDidSignal: DcmDspDidDataPos=0, DcmDspDidDataRef=Data_Zero_Potential_Status_Read_Data_By_Identifier
        DidInfo_Battery_banks_actual_mode_Read_Data_By_Identifier (DcmDspDidInfo)
          DcmDspDidAccess
            DcmDspDidRead: DcmDspDidReadSessionRef=ST_Defau, DcmDspDidReadSessionRef=ST_Exten
        DidInfo_DiagnServi_TABROW_NeuMeasu_Read_46_1_1_1_1 (DcmDspDidInfo)
          DcmDspDidAccess
            DcmDspDidRead: DcmDspDidReadSessionRef=ST_Defau, DcmDspDidReadSessionRef=ST_Exten
        DataInfo_DiagnServi_TABROW_NeuMeasu_Read_50 (DcmDspDataInfo): DcmDspDataFixedLength=true
        Data_DiagnServi_TABROW_MonitStatuSinceDTCsClear_Read (DcmDspData):
          DcmDspDataSize = 32
          DcmDspDataType = UINT8_N
          DcmDspDataUsePort = USE_DATA_ASYNCH_CLIENT_SERVER
          DcmDspDataInfoRef = DataInfo_DiagnServi_TABROW_MonitStatuSinceDTCsClear_Read
        DspRoe (DcmDspRoe): DcmDspRoeInitOnDSC=false, DcmDspRoeInterMessageTime=0, DcmDspRoeMaxNumberOfRetry=0, DcmDspRoeQueueEnabled=false, DcmDspRoeSchedulerRate=0.01
          DcmDspRoeEventWindowTime: DcmDspRoeEventWindowTime=DCM_ROE_EVENT_WINDOW_CURRENT_CYCLE
        DataInfo_TABROW_OBDType_Read (DcmDspDataInfo): DcmDspDataFixedLength=true
        DidInfo_DiagnServi_TABROW_NeuMeasu_Read_8_2 (DcmDspDidInfo)
          DcmDspDidAccess
            DcmDspDidRead: DcmDspDidReadSessionRef=ST_Defau, DcmDspDidReadSessionRef=ST_Exten
        DidInfo_DiagnServi_TABROW_NeuMeasu_Read_8_1 (DcmDspDidInfo)
          DcmDspDidAccess
            DcmDspDidRead: DcmDspDidReadSessionRef=ST_Defau, DcmDspDidReadSessionRef=ST_Exten
        DataInfo_DiagnServi_TABROW_MonitStatuThisDriviCycle_Read (DcmDspDataInfo): DcmDspDataFixedLength=true
        Data_TABROW_VkmsTrainCount_Read_Data_By_Identifier (DcmDspData):
          DcmDspDataSize = 24
          DcmDspDataType = UINT8_N
          DcmDspDataUsePort = USE_DATA_ASYNCH_CLIENT_SERVER
          DcmDspDataInfoRef = DataInfo_TABROW_VkmsTrainCount_Read_Data_By_Identifier
        DataInfo_DiagnServi_ReadDataByIdentBasicSettiStatu (DcmDspDataInfo): DcmDspDataFixedLength=true
        DidInfo_DiagnServi_ReadDataByIdentVWLogicBlockDowngProteVersi (DcmDspDidInfo)
          DcmDspDidAccess
            DcmDspDidRead
        DataInfo_DiagnServi_TABROW_DID0xEFD_Read_1_1 (DcmDspDataInfo): DcmDspDataFixedLength=true
        DataInfo_DiagnServi_TABROW_DID0xEFD_Read_1_2 (DcmDspDataInfo): DcmDspDataFixedLength=true
        DidInfo_TABROW_SOKMissiKeyList_Read_Data_By_Identifier (DcmDspDidInfo)
          DcmDspDidAccess
            DcmDspDidRead: DcmDspDidReadSessionRef=ST_Defau, DcmDspDidReadSessionRef=ST_Exten
        DataInfo_Battery_banks_allowed_modes_Read_Data_By_Identifier (DcmDspDataInfo): DcmDspDataFixedLength=true
        DataInfo_DiagnServi_TABROW_NeuMeasu_Read_63_1_1_1 (DcmDspDataInfo): DcmDspDataFixedLength=true
        Data_DiagnServi_TABROW_NeuMeasu_Read_43_1_1_1_1_1_1_1_1_1_1 (DcmDspData):
          DcmDspDataSize = 512
          DcmDspDataType = UINT8_N
          DcmDspDataUsePort = USE_DATA_ASYNCH_CLIENT_SERVER
          DcmDspDataInfoRef = DataInfo_DiagnServi_TABROW_NeuMeasu_Read_43_1_1_1_1_1_1_1_1_1_1
        DID_DiagnServi_TABROW_NeuMeasu_Read_57_2_1 (DcmDspDid):
          DcmDspDidIdentifier = 60931
          DcmDspDidUsed = true
          DcmDspDidUsePort = USE_DATA_ELEMENT_SPECIFIC_INTERFACES
          DcmDspDidInfoRef = DidInfo_DiagnServi_TABROW_NeuMeasu_Read_57_2_1
          DcmDspDidSignal: DcmDspDidDataPos=0, DcmDspDidDataRef=Data_DiagnServi_TABROW_NeuMeasu_Read_57_2_1
        RoutineInfo_DiagnServi_TABROW_BeginOfWritiOfSecurDataOfProteOfVehicDiagn_Start_Routine (DcmDspRoutineInfo)
          DcmDspStartRoutineIn
            ReqData (DcmDspStartRoutineInSignal): DcmDspRoutineSignalLength=8192, DcmDspRoutineSignalType=VARIABLE_LENGTH, DcmDspRoutineSignalEndianness=opaque, DcmDspRoutineSignalPos=0
          DcmDspRoutineAuthorization: DcmDspRoutineSessionRef=ST_Exten
          DcmDspStartRoutineOut
            ResData (DcmDspStartRoutineOutSignal): DcmDspRoutineSignalLength=16, DcmDspRoutineSignalType=UINT8_N, DcmDspRoutineSignalEndianness=opaque, DcmDspRoutineSignalPos=0
        DidInfo_DiagnServi_Type_number_assembly_Read (DcmDspDidInfo)
          DcmDspDidAccess
            DcmDspDidWrite: DcmDspDidWriteSessionRef=ST_Exten
            DcmDspDidRead: DcmDspDidReadSessionRef=ST_Defau, DcmDspDidReadSessionRef=ST_Exten
        DID_DiagnServi_BMC_serial_number_Read (DcmDspDid):
          DcmDspDidIdentifier = 805
          DcmDspDidUsed = true
          DcmDspDidUsePort = USE_DATA_ELEMENT_SPECIFIC_INTERFACES
          DcmDspDidInfoRef = DidInfo_DiagnServi_BMC_serial_number_Read
          DcmDspDidSignal: DcmDspDidDataPos=0, DcmDspDidDataRef=Data_DiagnServi_BMC_serial_number_Read
        DataInfo_DiagnServi_TABROW_ActivOfDevelMessa_Read (DcmDspDataInfo): DcmDspDataFixedLength=true
        RoutineInfo_DiagnServi_Get_Charge_Power_Start_Routine (DcmDspRoutineInfo)
          DcmDspRoutineRequestResOut
            ResData (DcmDspRoutineRequestResOutSignal): DcmDspRoutineSignalLength=2320, DcmDspRoutineSignalType=VARIABLE_LENGTH, DcmDspRoutineSignalEndianness=opaque, DcmDspRoutineSignalPos=0
          DcmDspStartRoutineIn
            ReqData (DcmDspStartRoutineInSignal): DcmDspRoutineSignalLength=1936, DcmDspRoutineSignalType=VARIABLE_LENGTH, DcmDspRoutineSignalEndianness=opaque, DcmDspRoutineSignalPos=0
          DcmDspRoutineAuthorization: DcmDspRoutineSessionRef=ST_Defau, DcmDspRoutineSessionRef=ST_Exten
          DcmDspRoutineStopOut
            ResData (DcmDspRoutineStopOutSignal): DcmDspRoutineSignalLength=8, DcmDspRoutineSignalType=UINT8_N, DcmDspRoutineSignalEndianness=opaque, DcmDspRoutineSignalPos=0
          DcmDspStartRoutineOut
            ResData (DcmDspStartRoutineOutSignal): DcmDspRoutineSignalLength=8, DcmDspRoutineSignalType=UINT8_N, DcmDspRoutineSignalEndianness=opaque, DcmDspRoutineSignalPos=0
        DataInfo_TABROW_SOKVerifFaileList_Read_Data_By_Identifier (DcmDspDataInfo): DcmDspDataFixedLength=false
        Data_Battery_energy_content_actual_Read_Data_By_Identifier (DcmDspData):
          DcmDspDataSize = 32
          DcmDspDataType = UINT8_N
          DcmDspDataUsePort = USE_DATA_ASYNCH_CLIENT_SERVER
          DcmDspDataInfoRef = DataInfo_Battery_energy_content_actual_Read_Data_By_Identifier
        DID_HV_coordinator_requestet_voltage_hv_battery_Read_Data_By_Identifier (DcmDspDid):
          DcmDspDidIdentifier = 9999
          DcmDspDidUsed = true
          DcmDspDidUsePort = USE_DATA_ELEMENT_SPECIFIC_INTERFACES
          DcmDspDidInfoRef = DidInfo_HV_coordinator_requestet_voltage_hv_battery_Read_Data_By_Identifier
          DcmDspDidSignal: DcmDspDidDataPos=0, DcmDspDidDataRef=Data_HV_coordinator_requestet_voltage_hv_battery_Read_Data_By_Identifier
        Data_DiagnServi_TABROW_NeuMeasu_Read_29_1_1_1_1 (DcmDspData):
          DcmDspDataSize = 32
          DcmDspDataType = UINT8_N
          DcmDspDataUsePort = USE_DATA_ASYNCH_CLIENT_SERVER
          DcmDspDataInfoRef = DataInfo_DiagnServi_TABROW_NeuMeasu_Read_29_1_1_1_1
        Routine_DiagnServi_TABROW_ResetHardCrashFlag_Start_Routine (DcmDspRoutine):
          DcmDspRequestResultsRoutineSupported = true
          DcmDspStopRoutineSupported = true
          DcmDspRoutineIdentifier = 1141
          DcmDspRoutineFixedLength = false
          DcmDspRoutineUsePort = true
          DcmDspRoutineUsed = true
          DcmDspRoutineInfoRef = RoutineInfo_DiagnServi_TABROW_ResetHardCrashFlag_Start_Routine
        RoutineInfo_DiagnServi_TABROW_CalcuIndivHashValue_Start_Routine (DcmDspRoutineInfo)
          DcmDspStartRoutineIn  # ReqData
            3 x DcmDspStartRoutineInSignal, all with DcmDspRoutineSignalType=UINT8:
              Type_of_hash_value: DcmDspRoutineSignalLength=8, DcmDspRoutineSignalPos=0
              Type_of_hash: DcmDspRoutineSignalLength=8, DcmDspRoutineSignalPos=8
              Individual_hash_value_id: DcmDspRoutineSignalLength=16, DcmDspRoutineSignalPos=16
          DcmDspRoutineAuthorization: DcmDspRoutineSessionRef=ST_Defau, DcmDspRoutineSessionRef=ST_Exten
          DcmDspStartRoutineOut
            ResData (DcmDspStartRoutineOutSignal): DcmDspRoutineSignalLength=2600, DcmDspRoutineSignalType=VARIABLE_LENGTH, DcmDspRoutineSignalEndianness=opaque, DcmDspRoutineSignalPos=0
        DID_DiagnServi_TABROW_DID0xEFD_Read_1 (DcmDspDid):
          DcmDspDidIdentifier = 1418
          DcmDspDidUsed = true
          DcmDspDidUsePort = USE_DATA_ELEMENT_SPECIFIC_INTERFACES
          DcmDspDidInfoRef = DidInfo_DiagnServi_TABROW_DID0xEFD_Read_1
          DcmDspDidSignal: DcmDspDidDataPos=0, DcmDspDidDataRef=Data_DiagnServi_TABROW_DID0xEFD_Read_1
        DID_DiagnServi_TABROW_DID0xEFD_Read_2 (DcmDspDid):
          DcmDspDidIdentifier = 1416
          DcmDspDidUsed = true
          DcmDspDidUsePort = USE_DATA_ELEMENT_SPECIFIC_INTERFACES
          DcmDspDidInfoRef = DidInfo_DiagnServi_TABROW_DID0xEFD_Read_2
          DcmDspDidSignal: DcmDspDidDataPos=0, DcmDspDidDataRef=Data_DiagnServi_TABROW_DID0xEFD_Read_2
        DidInfo_BMC_Hybrid_Kundendienstfehler_Read_Data_By_Identifier (DcmDspDidInfo)
          DcmDspDidAccess
            DcmDspDidRead: DcmDspDidReadSessionRef=ST_Defau, DcmDspDidReadSessionRef=ST_Exten
        3 x DcmDspDid, all with DcmDspDidUsed=true, DcmDspDidUsePort=USE_DATA_ELEMENT_SPECIFIC_INTERFACES:
          DID_DiagnServi_TABROW_DID0xEFD_Read_3: DcmDspDidIdentifier=1429, DcmDspDidInfoRef=DidInfo_DiagnServi_TABROW_DID0xEFD_Read_3
            DcmDspDidSignal: DcmDspDidDataPos=0, DcmDspDidDataRef=Data_DiagnServi_TABROW_DID0xEFD_Read_3
          DID_DiagnServi_TABROW_NeuMeasu_Read_46_1_1_1_1: DcmDspDidIdentifier=1461, DcmDspDidInfoRef=DidInfo_DiagnServi_TABROW_NeuMeasu_Read_46_1_1_1_1
            DcmDspDidSignal: DcmDspDidDataPos=0, DcmDspDidDataRef=Data_DiagnServi_TABROW_NeuMeasu_Read_46_1_1_1_1
          DID_TABROW_ECUStandMode1_Read: DcmDspDidIdentifier=49424, DcmDspDidInfoRef=DidInfo_TABROW_ECUStandMode1_Read
            DcmDspDidSignal: DcmDspDidDataPos=0, DcmDspDidDataRef=Data_TABROW_ECUStandMode1_Read
        Data_HV_battery_maximum_discharge_power_Read_Data_By_Identifier (DcmDspData):
          DcmDspDataSize = 16
          DcmDspDataType = UINT8_N
          DcmDspDataUsePort = USE_DATA_ASYNCH_CLIENT_SERVER
          DcmDspDataInfoRef = DataInfo_HV_battery_maximum_discharge_power_Read_Data_By_Identifier
        DID_TABROW_TABROSyste_Read_1_1_1_1_1 (DcmDspDid):
          DcmDspDidIdentifier = 57395
          DcmDspDidUsed = true
          DcmDspDidUsePort = USE_DATA_ELEMENT_SPECIFIC_INTERFACES
          DcmDspDidInfoRef = DidInfo_TABROW_TABROSyste_Read_1_1_1_1_1
          DcmDspDidSignal: DcmDspDidDataPos=0, DcmDspDidDataRef=Data_TABROW_TABROSyste_Read_1_1_1_1_1
        Data_TABROW_TABROSyste_Read_1_1_1_1 (DcmDspData):
          DcmDspDataSize = 112
          DcmDspDataType = UINT8_N
          DcmDspDataUsePort = USE_DATA_ASYNCH_CLIENT_SERVER
          DcmDspDataInfoRef = DataInfo_TABROW_TABROSyste_Read_1_1_1_1
        DataInfo_Strommesung_Read_Data_By_Identifier (DcmDspDataInfo): DcmDspDataFixedLength=true
        Data_TABROW_BatteTempeMinim_ReadDataByIdent (DcmDspData):
          DcmDspDataSize = 32
          DcmDspDataType = UINT8_N
          DcmDspDataUsePort = USE_DATA_ASYNCH_CLIENT_SERVER
          DcmDspDataInfoRef = DataInfo_TABROW_BatteTempeMinim_ReadDataByIdent
        DidInfo_TABROW_TABROSyste_Read_1_1_1_1_1_1_1_1_1_1_1_1_1 (DcmDspDidInfo)
          DcmDspDidAccess
            DcmDspDidRead
        Data_TABROW_KnockCount_Read (DcmDspData):
          DcmDspDataSize = 16
          DcmDspDataType = UINT8_N
          DcmDspDataUsePort = USE_DATA_ASYNCH_FNC
          DcmDspDataConditionCheckReadFncUsed = true
          DcmDspDataConditionCheckReadFnc = CddNpmGen2_Check_Read_Ident_ECUKnockoutCounter
          DcmDspDataWriteFnc = CddNpmGen2_Write_Ident_ECUKnockoutCounter
          DcmDspDataReadFnc = CddNpmGen2_Read_Ident_ECUKnockoutCounter
          DcmDspDataInfoRef = DataInfo_TABROW_KnockCount_Read
        DataInfo_TABROW_BMCHVKFehleSD_Read_Data_By_Identifier (DcmDspDataInfo): DcmDspDataFixedLength=true
        DataInfo_TABROW_TABROSyste_Read_1_1 (DcmDspDataInfo): DcmDspDataFixedLength=true
        DidInfo_DiagnServi_TABROW_AdaptOfChineSeriaNumbe_Read (DcmDspDidInfo)
          DcmDspDidAccess
            DcmDspDidWrite: DcmDspDidWriteSessionRef=ST_Exten
            DcmDspDidRead: DcmDspDidReadSessionRef=ST_Defau, DcmDspDidReadSessionRef=ST_Exten
        DidInfo_DiagnServi_TABROW_BootlTPBlock_Read (DcmDspDidInfo)
          DcmDspDidAccess
            DcmDspDidWrite: DcmDspDidWriteSessionRef=ST_Exten, DcmDspDidWriteSessionRef=ST_Progr
            DcmDspDidRead
        DataInfo_DiagnServi_TABROW_NeuMeasu_Read_27_1_1_1_1 (DcmDspDataInfo): DcmDspDataFixedLength=true
        DidInfo_DiagnServi_TABROW_NeuMeasu_Read_27_1_1_1_2 (DcmDspDidInfo)
          DcmDspDidAccess
            DcmDspDidRead: DcmDspDidReadSessionRef=ST_Defau, DcmDspDidReadSessionRef=ST_Exten
        DidInfo_DiagnServi_TABROW_NeuMeasu_Read_27_1_1_1_1 (DcmDspDidInfo)
          DcmDspDidAccess
            DcmDspDidRead: DcmDspDidReadSessionRef=ST_Defau, DcmDspDidReadSessionRef=ST_Exten
        DID_DiagnServi_TABROW_NeuMeasu_Read_29_1 (DcmDspDid):
          DcmDspDidIdentifier = 1651
          DcmDspDidUsed = true
          DcmDspDidUsePort = USE_DATA_ELEMENT_SPECIFIC_INTERFACES
          DcmDspDidInfoRef = DidInfo_DiagnServi_TABROW_NeuMeasu_Read_29_1
          DcmDspDidSignal: DcmDspDidDataPos=0, DcmDspDidDataRef=Data_DiagnServi_TABROW_NeuMeasu_Read_29_1
        Routine_DiagnServi_TABROW_ResetHealiInhib_Start_Routine (DcmDspRoutine):
          DcmDspRequestResultsRoutineSupported = false
          DcmDspStopRoutineSupported = false
          DcmDspRoutineIdentifier = 1704
          DcmDspRoutineFixedLength = false
          DcmDspRoutineUsePort = true
          DcmDspRoutineUsed = true
          DcmDspRoutineInfoRef = RoutineInfo_DiagnServi_TABROW_ResetHealiInhib_Start_Routine
        DidInfo_TABROW_ServiDiscoState_Read_Data_By_Identifier (DcmDspDidInfo)
          DcmDspDidAccess
            DcmDspDidRead: DcmDspDidReadSessionRef=ST_Defau, DcmDspDidReadSessionRef=ST_Exten
        7 x DcmDspDid, all with DcmDspDidUsed=true, DcmDspDidUsePort=USE_DATA_ELEMENT_SPECIFIC_INTERFACES:
          DID_DiagnServi_TABROW_NeuMeasu_Read_29_3: DcmDspDidIdentifier=1746, DcmDspDidInfoRef=DidInfo_DiagnServi_TABROW_NeuMeasu_Read_29_3
            DcmDspDidSignal: DcmDspDidDataPos=0, DcmDspDidDataRef=Data_DiagnServi_TABROW_NeuMeasu_Read_29_3
          DID_DiagnServi_TABROW_NeuMeasu_Read_46_1_1_1_1_1_1_2_1: DcmDspDidIdentifier=1466, DcmDspDidInfoRef=DidInfo_DiagnServi_TABROW_NeuMeasu_Read_46_1_1_1_1_1_1_2_1
            DcmDspDidSignal: DcmDspDidDataPos=0, DcmDspDidDataRef=Data_DiagnServi_TABROW_NeuMeasu_Read_46_1_1_1_1_1_1_2_1
          DID_DiagnServi_TABROW_NeuMeasu_Read_29_2: DcmDspDidIdentifier=1737, DcmDspDidInfoRef=DidInfo_DiagnServi_TABROW_NeuMeasu_Read_29_2
            DcmDspDidSignal: DcmDspDidDataPos=0, DcmDspDidDataRef=Data_DiagnServi_TABROW_NeuMeasu_Read_29_2
          DID_DiagnServi_TABROW_NeuMeasu_Read_29_5: DcmDspDidIdentifier=57371, DcmDspDidInfoRef=DidInfo_DiagnServi_TABROW_NeuMeasu_Read_29_5
            DcmDspDidSignal: DcmDspDidDataPos=0, DcmDspDidDataRef=Data_DiagnServi_TABROW_NeuMeasu_Read_29_5
          DID_DiagnServi_TABROW_NeuMeasu_Read_46_1_1_1_1_1_1_2_3: DcmDspDidIdentifier=1468, DcmDspDidInfoRef=DidInfo_DiagnServi_TABROW_NeuMeasu_Read_46_1_1_1_1_1_1_2_3
            DcmDspDidSignal: DcmDspDidDataPos=0, DcmDspDidDataRef=Data_DiagnServi_TABROW_NeuMeasu_Read_46_1_1_1_1_1_1_2_3
          DID_DiagnServi_TABROW_NeuMeasu_Read_29_4: DcmDspDidIdentifier=57355, DcmDspDidInfoRef=DidInfo_DiagnServi_TABROW_NeuMeasu_Read_29_4
            DcmDspDidSignal: DcmDspDidDataPos=0, DcmDspDidDataRef=Data_DiagnServi_TABROW_NeuMeasu_Read_29_4
          DID_DiagnServi_TABROW_NeuMeasu_Read_46_1_1_1_1_1_1_2_2: DcmDspDidIdentifier=1467, DcmDspDidInfoRef=DidInfo_DiagnServi_TABROW_NeuMeasu_Read_46_1_1_1_1_1_1_2_2
            DcmDspDidSignal: DcmDspDidDataPos=0, DcmDspDidDataRef=Data_DiagnServi_TABROW_NeuMeasu_Read_46_1_1_1_1_1_1_2_2
        DidInfo_DiagnServi_TABROW_ActivOfDevelMessa_Read (DcmDspDidInfo)
          DcmDspDidAccess
            DcmDspDidWrite: DcmDspDidWriteSessionRef=ST_Exten
            DcmDspDidRead: DcmDspDidReadSessionRef=ST_Defau, DcmDspDidReadSessionRef=ST_Exten
        DataInfo_DiagnServi_TABROW_NeuMeasu_Read_27_1_1_1_2 (DcmDspDataInfo): DcmDspDataFixedLength=true
        DID_DiagnServi_TABROW_MonitStatuThisDriviCycle_Read (DcmDspDid):
          DcmDspDidIdentifier = 62529
          DcmDspDidUsed = true
          DcmDspDidUsePort = USE_DATA_ELEMENT_SPECIFIC_INTERFACES
          DcmDspDidInfoRef = DidInfo_DiagnServi_TABROW_MonitStatuThisDriviCycle_Read
          DcmDspDidSignal: DcmDspDidDataPos=0, DcmDspDidDataRef=Data_DiagnServi_TABROW_MonitStatuThisDriviCycle_Read
        DID_TABROW_TABROSyste_Read_1_1_1_1_1_1_1_1_1 (DcmDspDid):
          DcmDspDidIdentifier = 57399
          DcmDspDidUsed = true
          DcmDspDidUsePort = USE_DATA_ELEMENT_SPECIFIC_INTERFACES
          DcmDspDidInfoRef = DidInfo_TABROW_TABROSyste_Read_1_1_1_1_1_1_1_1_1
          DcmDspDidSignal: DcmDspDidDataPos=0, DcmDspDidDataRef=Data_TABROW_TABROSyste_Read_1_1_1_1_1_1_1_1_1
        DataInfo_DiagnServi_TABROW_ProduDeact_Read (DcmDspDataInfo): DcmDspDataFixedLength=true
        DID_TABROW_TABROSyste_Read_1_1_1 (DcmDspDid):
          DcmDspDidIdentifier = 57393
          DcmDspDidUsed = true
          DcmDspDidUsePort = USE_DATA_ELEMENT_SPECIFIC_INTERFACES
          DcmDspDidInfoRef = DidInfo_TABROW_TABROSyste_Read_1_1_1
          DcmDspDidSignal: DcmDspDidDataPos=0, DcmDspDidDataRef=Data_TABROW_TABROSyste_Read_1_1_1
        DataInfo_TABROW_TABROSyste_Read_1_1_1_1_1_1_1_1_1_1_1 (DcmDspDataInfo): DcmDspDataFixedLength=true
        Data_TABROW_InUseMonitPerfoRatio_Read_Data_By_Identifier (DcmDspData):
          DcmDspDataType = UINT8_N
          DcmDspDataSize = 65535
          DcmDspDataUsePort = USE_DATA_ASYNCH_CLIENT_SERVER
          DcmDspDataInfoRef = DataInfo_TABROW_InUseMonitPerfoRatio_Read_Data_By_Identifier
        DID_DiagnServi_TABROW_VWAppliDataSetIdent_Read (DcmDspDid):
          DcmDspDidIdentifier = 61873
          DcmDspDidUsed = true
          DcmDspDidUsePort = USE_DATA_ELEMENT_SPECIFIC_INTERFACES
          DcmDspDidInfoRef = DidInfo_DiagnServi_TABROW_VWAppliDataSetIdent_Read
          DcmDspDidSignal: DcmDspDidDataPos=0, DcmDspDidDataRef=Data_DiagnServi_TABROW_VWAppliDataSetIdent_Read
        Data_Maximum_Charge_Voltage_Read_Data_By_Identifier (DcmDspData):
          DcmDspDataSize = 16
          DcmDspDataType = UINT8_N
          DcmDspDataUsePort = USE_DATA_ASYNCH_CLIENT_SERVER
          DcmDspDataInfoRef = DataInfo_Maximum_Charge_Voltage_Read_Data_By_Identifier
        Data_DiagnServi_ReadDataByIdentASAMODXFileVersi (DcmDspData):
          DcmDspDataSize = 48
          DcmDspDataType = UINT8_N
          DcmDspDataUsePort = USE_DATA_ASYNCH_CLIENT_SERVER
          DcmDspDataInfoRef = DataInfo_DiagnServi_ReadDataByIdentASAMODXFileVersi
        3 x DcmDspDidInfo:
          DidInfo_DiagnServi_TABROW_NeuMeasu_Read_30_1
            DcmDspDidAccess
              DcmDspDidRead: DcmDspDidReadSessionRef=ST_Defau, DcmDspDidReadSessionRef=ST_Exten
          DidInfo_DiagnServi_TABROW_NeuMeasu_Read_30_3
            DcmDspDidAccess
              DcmDspDidRead: DcmDspDidReadSessionRef=ST_Defau, DcmDspDidReadSessionRef=ST_Exten
          DidInfo_DiagnServi_TABROW_NeuMeasu_Read_30_2
            DcmDspDidAccess
              DcmDspDidRead: DcmDspDidReadSessionRef=ST_Defau, DcmDspDidReadSessionRef=ST_Exten
        DataInfo_DiagnServi_Cell_part_number_Read (DcmDspDataInfo): DcmDspDataFixedLength=true
        Data_TABROW_TABROSyste_Read_1_1_1_1_1_1_1_1_1_1_1_1 (DcmDspData):
          DcmDspDataSize = 112
          DcmDspDataType = UINT8_N
          DcmDspDataUsePort = USE_DATA_ASYNCH_CLIENT_SERVER
          DcmDspDataInfoRef = DataInfo_TABROW_TABROSyste_Read_1_1_1_1_1_1_1_1_1_1_1_1
        DataInfo_DiagnServi_TABROW_NeuMeasu_Read_46_1_1_1_1_1 (DcmDspDataInfo): DcmDspDataFixedLength=true
        Data_TABROW_TABROSyste_Read_1_1 (DcmDspData): DcmDspDataSize=72, DcmDspDataType=UINT8_N, DcmDspDataUsePort=USE_DATA_ASYNCH_CLIENT_SERVER, DcmDspDataInfoRef=DataInfo_TABROW_TABROSyste_Read_1_1
        DidInfo_DiagnServi_TABROW_TABROECUPr_Read (DcmDspDidInfo)
          DcmDspDidAccess
            DcmDspDidRead
        DidInfo_DiagnServi_TABROW_NeuCalibData_Read (DcmDspDidInfo)
          DcmDspDidAccess
            DcmDspDidWrite: DcmDspDidWriteSessionRef=ST_Exten
            DcmDspDidRead: DcmDspDidReadSessionRef=ST_Defau, DcmDspDidReadSessionRef=ST_Exten
        DID_DiagnServi_TABROW_NeuMeasu_Read_43_1_1_1_1_1_1_1_1 (DcmDspDid):
          DcmDspDidIdentifier = 1384
          DcmDspDidUsed = true
          DcmDspDidUsePort = USE_DATA_ELEMENT_SPECIFIC_INTERFACES
          DcmDspDidInfoRef = DidInfo_DiagnServi_TABROW_NeuMeasu_Read_43_1_1_1_1_1_1_1_1
          DcmDspDidSignal: DcmDspDidDataPos=0, DcmDspDidDataRef=Data_DiagnServi_TABROW_NeuMeasu_Read_43_1_1_1_1_1_1_1_1
        DID_TABROW_BatteTempeAvera_ReadDataByIdent (DcmDspDid):
          DcmDspDidIdentifier = 7696
          DcmDspDidUsed = true
          DcmDspDidUsePort = USE_DATA_ELEMENT_SPECIFIC_INTERFACES
          DcmDspDidInfoRef = DidInfo_TABROW_BatteTempeAvera_ReadDataByIdent
          DcmDspDidSignal: DcmDspDidDataPos=0, DcmDspDidDataRef=Data_TABROW_BatteTempeAvera_ReadDataByIdent
        DataInfo_DiagnServi_TABROW_NeuMeasu_Read_57_1 (DcmDspDataInfo): DcmDspDataFixedLength=true
        Data_DiagnServi_TABROW_NeuMeasu_Read_12 (DcmDspData):
          DcmDspDataSize = 24
          DcmDspDataType = UINT8_N
          DcmDspDataUsePort = USE_DATA_ASYNCH_CLIENT_SERVER
          DcmDspDataInfoRef = DataInfo_DiagnServi_TABROW_NeuMeasu_Read_12
        DataInfo_TABROW_KnockTimer_Read (DcmDspDataInfo): DcmDspDataFixedLength=true
        Data_DiagnServi_TABROW_NeuMeasu_Read_11 (DcmDspData):
          DcmDspDataSize = 24
          DcmDspDataType = UINT8_N
          DcmDspDataUsePort = USE_DATA_ASYNCH_CLIENT_SERVER
          DcmDspDataInfoRef = DataInfo_DiagnServi_TABROW_NeuMeasu_Read_11
        DID_HV_battery_maximum_discharge_current_Read_Data_By_Identifier (DcmDspDid):
          DcmDspDidIdentifier = 9997
          DcmDspDidUsed = true
          DcmDspDidUsePort = USE_DATA_ELEMENT_SPECIFIC_INTERFACES
          DcmDspDidInfoRef = DidInfo_HV_battery_maximum_discharge_current_Read_Data_By_Identifier
          DcmDspDidSignal: DcmDspDidDataPos=0, DcmDspDidDataRef=Data_HV_battery_maximum_discharge_current_Read_Data_By_Identifier
        4 x DcmDspData, all with DcmDspDataType=UINT8_N, DcmDspDataUsePort=USE_DATA_ASYNCH_CLIENT_SERVER:
          Data_DiagnServi_TABROW_NeuMeasu_Read_10: DcmDspDataSize=16, DcmDspDataInfoRef=DataInfo_DiagnServi_TABROW_NeuMeasu_Read_10
          Data_DiagnServi_TABROW_NeuCalibData_Read: DcmDspDataSize=8, DcmDspDataInfoRef=DataInfo_DiagnServi_TABROW_NeuCalibData_Read
          Data_BMC_IWU_Status_Read_Data_By_Identifier: DcmDspDataSize=8, DcmDspDataInfoRef=DataInfo_BMC_IWU_Status_Read_Data_By_Identifier
          Data_DiagnServi_TABROW_NeuMeasu_Read_16: DcmDspDataSize=8, DcmDspDataInfoRef=DataInfo_DiagnServi_TABROW_NeuMeasu_Read_16
        DID_DiagnServi_TABROW_NeuMeasu_Read_49_1 (DcmDspDid):
          DcmDspDidIdentifier = 1394
          DcmDspDidUsed = true
          DcmDspDidUsePort = USE_DATA_ELEMENT_SPECIFIC_INTERFACES
          DcmDspDidInfoRef = DidInfo_DiagnServi_TABROW_NeuMeasu_Read_49_1
          DcmDspDidSignal: DcmDspDidDataPos=0, DcmDspDidDataRef=Data_DiagnServi_TABROW_NeuMeasu_Read_49_1
        Data_DiagnServi_TABROW_NeuMeasu_Read_15 (DcmDspData):
          DcmDspDataSize = 8
          DcmDspDataType = UINT8_N
          DcmDspDataUsePort = USE_DATA_ASYNCH_CLIENT_SERVER
          DcmDspDataInfoRef = DataInfo_DiagnServi_TABROW_NeuMeasu_Read_15
        Data_DiagnServi_TABROW_NeuMeasu_Read_14 (DcmDspData):
          DcmDspDataSize = 8
          DcmDspDataType = UINT8_N
          DcmDspDataUsePort = USE_DATA_ASYNCH_CLIENT_SERVER
          DcmDspDataInfoRef = DataInfo_DiagnServi_TABROW_NeuMeasu_Read_14
        DataInfo_DiagnServi_TABROW_NeuMeasu_Read_9_2_1_1 (DcmDspDataInfo): DcmDspDataFixedLength=true
        Data_DiagnServi_TABROW_NeuMeasu_Read_13 (DcmDspData):
          DcmDspDataSize = 48
          DcmDspDataType = UINT8_N
          DcmDspDataUsePort = USE_DATA_ASYNCH_CLIENT_SERVER
          DcmDspDataInfoRef = DataInfo_DiagnServi_TABROW_NeuMeasu_Read_13
        Data_DiagnServi_Type_number_BMCE_Read (DcmDspData):
          DcmDspDataSize = 88
          DcmDspDataType = UINT8_N
          DcmDspDataUsePort = USE_DATA_ASYNCH_CLIENT_SERVER
          DcmDspDataInfoRef = DataInfo_DiagnServi_Type_number_BMCE_Read
        DidInfo_TABROW_TABROSyste_Read_1 (DcmDspDidInfo)
          DcmDspDidAccess
            DcmDspDidRead
            DcmDspDidWrite: DcmDspDidWriteSessionRef=ST_Exten
        DidInfo_DiagnServi_TABROW_Produ_Read (DcmDspDidInfo)
          DcmDspDidAccess
            DcmDspDidWrite: DcmDspDidWriteSessionRef=ST_Exten
            DcmDspDidRead: DcmDspDidReadSessionRef=ST_Defau, DcmDspDidReadSessionRef=ST_Exten
        Data_DiagnServi_TABROW_NeuMeasu_Read_29_1_1_1 (DcmDspData):
          DcmDspDataSize = 32
          DcmDspDataType = UINT8_N
          DcmDspDataUsePort = USE_DATA_ASYNCH_CLIENT_SERVER
          DcmDspDataInfoRef = DataInfo_DiagnServi_TABROW_NeuMeasu_Read_29_1_1_1
        3 x DcmDspDidInfo:
          DidInfo_TABROW_TABROSyste_Read_4
            DcmDspDidAccess
              DcmDspDidRead
          DidInfo_TABROW_TABROSyste_Read_3
            DcmDspDidAccess
              DcmDspDidRead
          DidInfo_TABROW_TABROSyste_Read_2
            DcmDspDidAccess
              DcmDspDidRead
        DID_TABROW_VWLogicSoftwBlockCountOfProgrAttem_Read (DcmDspDid):
          DcmDspDidIdentifier = 1031
          DcmDspDidUsed = true
          DcmDspDidUsePort = USE_DATA_ELEMENT_SPECIFIC_INTERFACES
          DcmDspDidInfoRef = DidInfo_TABROW_VWLogicSoftwBlockCountOfProgrAttem_Read
          DcmDspDidSignal: DcmDspDidDataPos=0, DcmDspDidDataRef=Data_TABROW_VWLogicSoftwBlockCountOfProgrAttem_Read
        DataInfo_Prozessorauslastung_Read_Data_By_Identifier (DcmDspDataInfo): DcmDspDataFixedLength=true
        DID_DiagnServi_TABROW_VWSparePartNumbe_Read (DcmDspDid):
          DcmDspDidIdentifier = 61831
          DcmDspDidUsed = true
          DcmDspDidUsePort = USE_DATA_ELEMENT_SPECIFIC_INTERFACES
          DcmDspDidInfoRef = DidInfo_DiagnServi_TABROW_VWSparePartNumbe_Read
          DcmDspDidSignal: DcmDspDidDataPos=0, DcmDspDidDataRef=Data_DiagnServi_TABROW_VWSparePartNumbe_Read
        Data_TABROW_SOKFreshInfor_Read_Data_By_Identifier (DcmDspData):
          DcmDspDataSize = 28576
          DcmDspDataType = UINT8_N
          DcmDspDataUsePort = USE_DATA_ASYNCH_CLIENT_SERVER
          DcmDspDataInfoRef = DataInfo_TABROW_SOKFreshInfor_Read_Data_By_Identifier
        DataInfo_Minimum_Discharge_Voltage_Read_Data_By_Identifier (DcmDspDataInfo): DcmDspDataFixedLength=true
        DidInfo_DiagnServi_TABROW_TABROOBDDr_Read_Data_By_Identifier (DcmDspDidInfo)
          DcmDspDidAccess
            DcmDspDidRead: DcmDspDidReadSessionRef=ST_Defau, DcmDspDidReadSessionRef=ST_Exten
        DID_Battery_banks_actual_voltage_Read_Data_By_Identifier (DcmDspDid):
          DcmDspDidIdentifier = 10000
          DcmDspDidUsed = true
          DcmDspDidUsePort = USE_DATA_ELEMENT_SPECIFIC_INTERFACES
          DcmDspDidInfoRef = DidInfo_Battery_banks_actual_voltage_Read_Data_By_Identifier
          DcmDspDidSignal: DcmDspDidDataPos=0, DcmDspDidDataRef=Data_Battery_banks_actual_voltage_Read_Data_By_Identifier
        Data_DiagnServi_Type_number_assembly_Read (DcmDspData):
          DcmDspDataSize = 88
          DcmDspDataType = UINT8_N
          DcmDspDataUsePort = USE_DATA_ASYNCH_CLIENT_SERVER
          DcmDspDataInfoRef = DataInfo_DiagnServi_Type_number_assembly_Read
        DID_DiagnServi_TABROW_ECUNA_Read (DcmDspDid):
          DcmDspDidIdentifier = 63498
          DcmDspDidUsed = true
          DcmDspDidUsePort = USE_DATA_ELEMENT_SPECIFIC_INTERFACES
          DcmDspDidInfoRef = DidInfo_DiagnServi_TABROW_ECUNA_Read
          DcmDspDidSignal: DcmDspDidDataPos=0, DcmDspDidDataRef=Data_DiagnServi_TABROW_ECUNA_Read
        DID_HV_battery_maximum_charging_power_Read_Data_By_Identifier (DcmDspDid):
          DcmDspDidIdentifier = 9994
          DcmDspDidUsed = true
          DcmDspDidUsePort = USE_DATA_ELEMENT_SPECIFIC_INTERFACES
          DcmDspDidInfoRef = DidInfo_HV_battery_maximum_charging_power_Read_Data_By_Identifier
          DcmDspDidSignal: DcmDspDidDataPos=0, DcmDspDidDataRef=Data_HV_battery_maximum_charging_power_Read_Data_By_Identifier
        Data_DiagnServi_TABROW_VWSparePartNumbe_Read (DcmDspData):
          DcmDspDataSize = 88
          DcmDspDataType = UINT8_N
          DcmDspDataUsePort = USE_DATA_ASYNCH_CLIENT_SERVER
          DcmDspDataInfoRef = DataInfo_DiagnServi_TABROW_VWSparePartNumbe_Read
        Data_DiagnServi_TABROW_NeuMeasu_Read_23 (DcmDspData):
          DcmDspDataSize = 48
          DcmDspDataType = UINT8_N
          DcmDspDataUsePort = USE_DATA_ASYNCH_CLIENT_SERVER
          DcmDspDataInfoRef = DataInfo_DiagnServi_TABROW_NeuMeasu_Read_23
        DataInfo_DiagnServi_TABROW_NeuMeasu_Read_22_1 (DcmDspDataInfo): DcmDspDataFixedLength=true
        RoutineInfo_DiagnServi_TABROW_RequeConfiOfProteOfVehicDiagn_Start_Routine (DcmDspRoutineInfo)
          DcmDspStartRoutineIn
            ReqData (DcmDspStartRoutineInSignal): DcmDspRoutineSignalLength=8, DcmDspRoutineSignalType=UINT8_N, DcmDspRoutineSignalEndianness=opaque, DcmDspRoutineSignalPos=0
          DcmDspRoutineAuthorization: DcmDspRoutineSessionRef=ST_Exten
          DcmDspStartRoutineOut
            ResData (DcmDspStartRoutineOutSignal): DcmDspRoutineSignalLength=7712, DcmDspRoutineSignalType=VARIABLE_LENGTH, DcmDspRoutineSignalEndianness=opaque, DcmDspRoutineSignalPos=0
        DID_DiagnServi_TABROW_NeuMeasu_Read_9_2_1_1_2 (DcmDspDid):
          DcmDspDidIdentifier = 1715
          DcmDspDidUsed = true
          DcmDspDidUsePort = USE_DATA_ELEMENT_SPECIFIC_INTERFACES
          DcmDspDidInfoRef = DidInfo_DiagnServi_TABROW_NeuMeasu_Read_9_2_1_1_2
          DcmDspDidSignal: DcmDspDidDataPos=0, DcmDspDidDataRef=Data_DiagnServi_TABROW_NeuMeasu_Read_9_2_1_1_2
        DidInfo_TABROW_VWECUHardwVersiNumbe_Read (DcmDspDidInfo)
          DcmDspDidAccess
            DcmDspDidRead
        DID_DiagnServi_TABROW_NeuMeasu_Read_9_2_1_1_1 (DcmDspDid):
          DcmDspDidIdentifier = 1727
          DcmDspDidUsed = true
          DcmDspDidUsePort = USE_DATA_ELEMENT_SPECIFIC_INTERFACES
          DcmDspDidInfoRef = DidInfo_DiagnServi_TABROW_NeuMeasu_Read_9_2_1_1_1
          DcmDspDidSignal: DcmDspDidDataPos=0, DcmDspDidDataRef=Data_DiagnServi_TABROW_NeuMeasu_Read_9_2_1_1_1
        3 x DcmDspData, all with DcmDspDataType=UINT8_N, DcmDspDataUsePort=USE_DATA_ASYNCH_CLIENT_SERVER:
          Data_DiagnServi_TABROW_NeuMeasu_Read_20: DcmDspDataSize=8, DcmDspDataInfoRef=DataInfo_DiagnServi_TABROW_NeuMeasu_Read_20
          Data_DiagnServi_TABROW_NeuMeasu_Read_27: DcmDspDataSize=216, DcmDspDataInfoRef=DataInfo_DiagnServi_TABROW_NeuMeasu_Read_27
          Data_DiagnServi_TABROW_NeuMeasu_Read_26: DcmDspDataSize=8, DcmDspDataInfoRef=DataInfo_DiagnServi_TABROW_NeuMeasu_Read_26
        DataInfo_DiagnServi_TABROW_NeuECUIdent_Read (DcmDspDataInfo): DcmDspDataFixedLength=true
        Data_DiagnServi_TABROW_NeuMeasu_Read_25 (DcmDspData):
          DcmDspDataSize = 16
          DcmDspDataType = UINT8_N
          DcmDspDataUsePort = USE_DATA_ASYNCH_CLIENT_SERVER
          DcmDspDataInfoRef = DataInfo_DiagnServi_TABROW_NeuMeasu_Read_25
        RoutineInfo_TABROW_CheckCalibPreCondi_Start_Routine (DcmDspRoutineInfo)
          DcmDspStartRoutineIn
            ReqData (DcmDspStartRoutineInSignal): DcmDspRoutineSignalLength=24, DcmDspRoutineSignalType=UINT8_N, DcmDspRoutineSignalEndianness=opaque, DcmDspRoutineSignalPos=0
          DcmDspRoutineAuthorization: DcmDspRoutineSessionRef=ST_Exten
          DcmDspStartRoutineOut
            ResData (DcmDspStartRoutineOutSignal): DcmDspRoutineSignalLength=2072, DcmDspRoutineSignalType=VARIABLE_LENGTH, DcmDspRoutineSignalEndianness=opaque, DcmDspRoutineSignalPos=0
        Data_DiagnServi_TABROW_NeuMeasu_Read_24 (DcmDspData):
          DcmDspDataSize = 8
          DcmDspDataType = UINT8_N
          DcmDspDataUsePort = USE_DATA_ASYNCH_CLIENT_SERVER
          DcmDspDataInfoRef = DataInfo_DiagnServi_TABROW_NeuMeasu_Read_24
        DID_DiagnServi_TABROW_NeuMeasu_Read_63_1_1 (DcmDspDid):
          DcmDspDidIdentifier = 57360
          DcmDspDidUsed = true
          DcmDspDidUsePort = USE_DATA_ELEMENT_SPECIFIC_INTERFACES
          DcmDspDidInfoRef = DidInfo_DiagnServi_TABROW_NeuMeasu_Read_63_1_1
          DcmDspDidSignal: DcmDspDidDataPos=0, DcmDspDidDataRef=Data_DiagnServi_TABROW_NeuMeasu_Read_63_1_1
        Data_TABROW_IsolaResisSystePlus_ReadDataByIdent (DcmDspData):
          DcmDspDataSize = 16
          DcmDspDataType = UINT8_N
          DcmDspDataUsePort = USE_DATA_ASYNCH_CLIENT_SERVER
          DcmDspDataInfoRef = DataInfo_TABROW_IsolaResisSystePlus_ReadDataByIdent
        Routine_DiagnServi_TABROW_NeuRoutiBasicSetti_Start_Routine (DcmDspRoutine):
          DcmDspRequestResultsRoutineSupported = true
          DcmDspStopRoutineSupported = true
          DcmDspRoutineIdentifier = 780
          DcmDspRoutineFixedLength = false
          DcmDspRoutineUsePort = true
          DcmDspRoutineUsed = true
          DcmDspRoutineInfoRef = RoutineInfo_DiagnServi_TABROW_NeuRoutiBasicSetti_Start_Routine
        Routine_DiagnServi_TABROW_RequeDataOfProteOfVehicDiagn_Start_Routine (DcmDspRoutine):
          DcmDspRequestResultsRoutineSupported = false
          DcmDspStopRoutineSupported = false
          DcmDspRoutineIdentifier = 49160
          DcmDspRoutineFixedLength = false
          DcmDspRoutineUsePort = true
          DcmDspRoutineUsed = true
          DcmDspRoutineInfoRef = RoutineInfo_DiagnServi_TABROW_RequeDataOfProteOfVehicDiagn_Start_Routine
        DataInfo_TABROW_SOKMissiKeyList_Read_Data_By_Identifier (DcmDspDataInfo): DcmDspDataFixedLength=false
        DID_DiagnServi_Module_part_number_Read (DcmDspDid):
          DcmDspDidIdentifier = 804
          DcmDspDidUsed = true
          DcmDspDidUsePort = USE_DATA_ELEMENT_SPECIFIC_INTERFACES
          DcmDspDidInfoRef = DidInfo_DiagnServi_Module_part_number_Read
          DcmDspDidSignal: DcmDspDidDataPos=0, DcmDspDidDataRef=Data_DiagnServi_Module_part_number_Read
        DidInfo_Battery_energy_content_maximum_Read_Data_By_Identifier (DcmDspDidInfo)
          DcmDspDidAccess
            DcmDspDidRead: DcmDspDidReadSessionRef=ST_Defau, DcmDspDidReadSessionRef=ST_Exten
        4 x DcmDspData, all with DcmDspDataType=UINT8_N, DcmDspDataUsePort=USE_DATA_ASYNCH_CLIENT_SERVER:
          Data_TABROW_TABROSyste_Read_3: DcmDspDataSize=88, DcmDspDataInfoRef=DataInfo_TABROW_TABROSyste_Read_3
          Data_DiagnServi_TABROW_NeuMeasu_Read_30_1: DcmDspDataSize=16, DcmDspDataInfoRef=DataInfo_DiagnServi_TABROW_NeuMeasu_Read_30_1
          Data_TABROW_TABROSyste_Read_2: DcmDspDataSize=88, DcmDspDataInfoRef=DataInfo_TABROW_TABROSyste_Read_2
          Data_DiagnServi_TABROW_NeuMeasu_Read_19: DcmDspDataSize=24, DcmDspDataInfoRef=DataInfo_DiagnServi_TABROW_NeuMeasu_Read_19
        DID_Battery_displayed_state_of_charge_Read_Data_By_Identifier (DcmDspDid):
          DcmDspDidIdentifier = 9985
          DcmDspDidUsed = true
          DcmDspDidUsePort = USE_DATA_ELEMENT_SPECIFIC_INTERFACES
          DcmDspDidInfoRef = DidInfo_Battery_displayed_state_of_charge_Read_Data_By_Identifier
          DcmDspDidSignal: DcmDspDidDataPos=0, DcmDspDidDataRef=Data_Battery_displayed_state_of_charge_Read_Data_By_Identifier
        3 x DcmDspData, all with DcmDspDataType=UINT8_N, DcmDspDataUsePort=USE_DATA_ASYNCH_CLIENT_SERVER:
          Data_TABROW_TABROSyste_Read_1: DcmDspDataSize=88, DcmDspDataInfoRef=DataInfo_TABROW_TABROSyste_Read_1
          Data_DiagnServi_TABROW_NeuMeasu_Read_30_3: DcmDspDataSize=16, DcmDspDataInfoRef=DataInfo_DiagnServi_TABROW_NeuMeasu_Read_30_3
          Data_DiagnServi_TABROW_NeuMeasu_Read_18: DcmDspDataSize=8, DcmDspDataInfoRef=DataInfo_DiagnServi_TABROW_NeuMeasu_Read_18
        DID_DiagnServi_TABROW_SuppoPIDs0120_Read (DcmDspDid):
          DcmDspDidIdentifier = 62464
          DcmDspDidUsed = true
          DcmDspDidUsePort = USE_DATA_ELEMENT_SPECIFIC_INTERFACES
          DcmDspDidInfoRef = DidInfo_DiagnServi_TABROW_SuppoPIDs0120_Read
        Data_DiagnServi_TABROW_NeuMeasu_Read_30_2 (DcmDspData):
          DcmDspDataSize = 16
          DcmDspDataType = UINT8_N
          DcmDspDataUsePort = USE_DATA_ASYNCH_CLIENT_SERVER
          DcmDspDataInfoRef = DataInfo_DiagnServi_TABROW_NeuMeasu_Read_30_2
        Data_DiagnServi_TABROW_NeuMeasu_Read_17 (DcmDspData):
          DcmDspDataSize = 8
          DcmDspDataType = UINT8_N
          DcmDspDataUsePort = USE_DATA_ASYNCH_CLIENT_SERVER
          DcmDspDataInfoRef = DataInfo_DiagnServi_TABROW_NeuMeasu_Read_17
        DidInfo_BMC_Mode_Read_Data_By_Identifier (DcmDspDidInfo)
          DcmDspDidAccess
            DcmDspDidRead: DcmDspDidReadSessionRef=ST_Defau, DcmDspDidReadSessionRef=ST_Exten
        DataInfo_Battery_energy_content_maximum_Read_Data_By_Identifier (DcmDspDataInfo): DcmDspDataFixedLength=true
        Data_TABROW_TABROSyste_Read_4 (DcmDspData): DcmDspDataSize=88, DcmDspDataType=UINT8_N, DcmDspDataUsePort=USE_DATA_ASYNCH_CLIENT_SERVER, DcmDspDataInfoRef=DataInfo_TABROW_TABROSyste_Read_4
        DidInfo_DiagnServi_TABROW_NeuMeasu_Read_63_1 (DcmDspDidInfo)
          DcmDspDidAccess
            DcmDspDidRead: DcmDspDidReadSessionRef=ST_Defau, DcmDspDidReadSessionRef=ST_Exten
        DID_DiagnServi_TABROW_NeuMeasu_Read_27_4_1 (DcmDspDid):
          DcmDspDidIdentifier = 1646
          DcmDspDidUsed = true
          DcmDspDidUsePort = USE_DATA_ELEMENT_SPECIFIC_INTERFACES
          DcmDspDidInfoRef = DidInfo_DiagnServi_TABROW_NeuMeasu_Read_27_4_1
          DcmDspDidSignal: DcmDspDidDataPos=0, DcmDspDidDataRef=Data_DiagnServi_TABROW_NeuMeasu_Read_27_4_1
        4 x DcmDspData, all with DcmDspDataType=UINT8_N, DcmDspDataUsePort=USE_DATA_ASYNCH_CLIENT_SERVER:
          Data_DiagnServi_TABROW_NeuMeasu_Read_46_1_1: DcmDspDataSize=1216, DcmDspDataInfoRef=DataInfo_DiagnServi_TABROW_NeuMeasu_Read_46_1_1
          Data_TABROW_TABROSyste_Read_1_1_1_1_1_1_1_1_1_1_1: DcmDspDataSize=112, DcmDspDataInfoRef=DataInfo_TABROW_TABROSyste_Read_1_1_1_1_1_1_1_1_1_1_1
          Data_DiagnServi_TABROW_NeuMeasu_Read_27_1_1_2: DcmDspDataSize=8, DcmDspDataInfoRef=DataInfo_DiagnServi_TABROW_NeuMeasu_Read_27_1_1_2
          Data_DiagnServi_TABROW_NeuECUIdent_Read: DcmDspDataSize=88, DcmDspDataInfoRef=DataInfo_DiagnServi_TABROW_NeuECUIdent_Read
        DID_DiagnServi_TABROW_NeuMeasu_Read_27_1 (DcmDspDid):
          DcmDspDidIdentifier = 1662
          DcmDspDidUsed = true
          DcmDspDidUsePort = USE_DATA_ELEMENT_SPECIFIC_INTERFACES
          DcmDspDidInfoRef = DidInfo_DiagnServi_TABROW_NeuMeasu_Read_27_1
          DcmDspDidSignal: DcmDspDidDataPos=0, DcmDspDidDataRef=Data_DiagnServi_TABROW_NeuMeasu_Read_27_1
        Data_DiagnServi_TABROW_NeuMeasu_Read_27_1_1_1 (DcmDspData):
          DcmDspDataSize = 216
          DcmDspDataType = UINT8_N
          DcmDspDataUsePort = USE_DATA_ASYNCH_CLIENT_SERVER
          DcmDspDataInfoRef = DataInfo_DiagnServi_TABROW_NeuMeasu_Read_27_1_1_1
        DidInfo_State_Of_Charge_Battery_customer_Read_Data_By_Identifier (DcmDspDidInfo)
          DcmDspDidAccess
            DcmDspDidRead: DcmDspDidReadSessionRef=ST_Defau, DcmDspDidReadSessionRef=ST_Exten
        DID_DiagnServi_TABROW_NeuMeasu_Read_27_3 (DcmDspDid):
          DcmDspDidIdentifier = 1660
          DcmDspDidUsed = true
          DcmDspDidUsePort = USE_DATA_ELEMENT_SPECIFIC_INTERFACES
          DcmDspDidInfoRef = DidInfo_DiagnServi_TABROW_NeuMeasu_Read_27_3
          DcmDspDidSignal: DcmDspDidDataPos=0, DcmDspDidDataRef=Data_DiagnServi_TABROW_NeuMeasu_Read_27_3
        Data_TABROW_BMCHVKFehleInter_Read_Data_By_Identifier (DcmDspData):
          DcmDspDataSize = 8
          DcmDspDataType = UINT8_N
          DcmDspDataUsePort = USE_DATA_ASYNCH_CLIENT_SERVER
          DcmDspDataInfoRef = DataInfo_TABROW_BMCHVKFehleInter_Read_Data_By_Identifier
        4 x DcmDspDid, all with DcmDspDidUsed=true, DcmDspDidUsePort=USE_DATA_ELEMENT_SPECIFIC_INTERFACES:
          DID_DiagnServi_TABROW_NeuMeasu_Read_27_2: DcmDspDidIdentifier=1661, DcmDspDidInfoRef=DidInfo_DiagnServi_TABROW_NeuMeasu_Read_27_2
            DcmDspDidSignal: DcmDspDidDataPos=0, DcmDspDidDataRef=Data_DiagnServi_TABROW_NeuMeasu_Read_27_2
          DID_DiagnServi_TABROW_NeuMeasu_Read_27_5: DcmDspDidIdentifier=1740, DcmDspDidInfoRef=DidInfo_DiagnServi_TABROW_NeuMeasu_Read_27_5
            DcmDspDidSignal: DcmDspDidDataPos=0, DcmDspDidDataRef=Data_DiagnServi_TABROW_NeuMeasu_Read_27_5
          DID_DiagnServi_TABROW_NeuMeasu_Read_27_4: DcmDspDidIdentifier=1656, DcmDspDidInfoRef=DidInfo_DiagnServi_TABROW_NeuMeasu_Read_27_4
            DcmDspDidSignal: DcmDspDidDataPos=0, DcmDspDidDataRef=Data_DiagnServi_TABROW_NeuMeasu_Read_27_4
          DID_DiagnServi_TABROW_NeuMeasu_Read_27_7: DcmDspDidIdentifier=57353, DcmDspDidInfoRef=DidInfo_DiagnServi_TABROW_NeuMeasu_Read_27_7
            DcmDspDidSignal: DcmDspDidDataPos=0, DcmDspDidDataRef=Data_DiagnServi_TABROW_NeuMeasu_Read_27_7
        Data_DiagnServi_TABROW_NeuMeasu_Read_43_1_1_1_1 (DcmDspData):
          DcmDspDataSize = 512
          DcmDspDataType = UINT8_N
          DcmDspDataUsePort = USE_DATA_ASYNCH_CLIENT_SERVER
          DcmDspDataInfoRef = DataInfo_DiagnServi_TABROW_NeuMeasu_Read_43_1_1_1_1
        DID_DiagnServi_TABROW_NeuMeasu_Read_27_6 (DcmDspDid):
          DcmDspDidIdentifier = 1747
          DcmDspDidUsed = true
          DcmDspDidUsePort = USE_DATA_ELEMENT_SPECIFIC_INTERFACES
          DcmDspDidInfoRef = DidInfo_DiagnServi_TABROW_NeuMeasu_Read_27_6
          DcmDspDidSignal: DcmDspDidDataPos=0, DcmDspDidDataRef=Data_DiagnServi_TABROW_NeuMeasu_Read_27_6
        DID_DiagnServi_TABROW_NeuMeasu_Read_27_8 (DcmDspDid):
          DcmDspDidIdentifier = 57362
          DcmDspDidUsed = true
          DcmDspDidUsePort = USE_DATA_ELEMENT_SPECIFIC_INTERFACES
          DcmDspDidInfoRef = DidInfo_DiagnServi_TABROW_NeuMeasu_Read_27_8
          DcmDspDidSignal: DcmDspDidDataPos=0, DcmDspDidDataRef=Data_DiagnServi_TABROW_NeuMeasu_Read_27_8
        Data_TABROW_ServiDiscoState_Read_Data_By_Identifier (DcmDspData):
          DcmDspDataSize = 8
          DcmDspDataType = UINT8_N
          DcmDspDataUsePort = USE_DATA_ASYNCH_CLIENT_SERVER
          DcmDspDataInfoRef = DataInfo_TABROW_ServiDiscoState_Read_Data_By_Identifier
        DidInfo_TABROW_TABROSyste_Read_1_1_1_1_1_1_1_1_1_1 (DcmDspDidInfo)
          DcmDspDidAccess
            DcmDspDidRead
            DcmDspDidWrite: DcmDspDidWriteSessionRef=ST_Exten
        DidInfo_BMC_Status_DCLS_Read_Data_By_Identifier (DcmDspDidInfo)
          DcmDspDidAccess
            DcmDspDidRead: DcmDspDidReadSessionRef=ST_Defau, DcmDspDidReadSessionRef=ST_Exten
        DID_TABROW_StandAmbieCondi_ReadDataByIdent (DcmDspDid):
          DcmDspDidIdentifier = 701
          DcmDspDidUsed = true
          DcmDspDidUsePort = USE_DATA_ELEMENT_SPECIFIC_INTERFACES
          DcmDspDidInfoRef = DidInfo_TABROW_StandAmbieCondi_ReadDataByIdent
          DcmDspDidSignal: DcmDspDidDataPos=0, DcmDspDidDataRef=Data_TABROW_StandAmbieCondi_ReadDataByIdent
