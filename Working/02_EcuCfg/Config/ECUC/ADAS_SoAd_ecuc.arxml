AUTOSAR XML (schema 00048)
package /ActiveEcuC
  module config SoAd: implementation-config-variant=VARIANT-PRE-COMPILE, module-description=SoAd_Impl
    SoAdConfig
      3 x SoAdRoutingGroup, all with SoAdRoutingGroupIsEnabledAtInit=false:
        Math_events_3e1d7af9: SoAdRoutingGroupId=1, SoAdRoutingGroupTxTriggerable=true
        Basics_events_d39e7277: SoAdRoutingGroupId=0, SoAdRoutingGroupTxTriggerable=false
        Math_methods_04e78f72: SoAdRoutingGroupId=2, SoAdRoutingGroupTxTriggerable=false
      Maths_Triangle_MyECU_4ce11453_Tx (SoAdPduRoute):
        SoAdTxUpperLayerType = IF
        SoAdTxPduId = 8
        SoAdTxPduCollectionSemantics = SOAD_COLLECT_QUEUED
        SoAdTxIfTriggerTransmit = false
        SoAdTxIfOptimized = false
        SoAdTxIfOptimisticTransmit = false
        SoAdTxPduRef = Maths_Triangle_MyECU_4ce11453_Tx
        SCB_Math_83c40fa4 (SoAdPduRouteDest): SoAdTxPduHeaderId=753665, SoAdTxRoutingGroupRef=Math_events_3e1d7af9, SoAdTxSocketConnOrSocketConnBundleRef=SoAdConfig/SCB_Math_83c40fa4
      SD_Uni_MyECU_dd1c2435 (SoAdSocketConnectionGroup):
        SoAdPduHeaderEnable = true
        SoAdSocketFramePriority = 0
        SoAdSocketLocalPort = 30490
        SoAdSocketAutomaticSoConSetup = false
        SoAdSocketIpAddrAssignmentChgNotification = true
        SoAdSocketMsgAcceptanceFilterEnabled = false
        SoAdSocketSoConModeChgNotification = false
        SoAdBestMatchWithSockRouteEnabled = false
        SoAdBestMatchWithPduHeaderEnabled = false
        SoAdSocketAutomaticSoConSetupKeepOnline = false
        SoAdResourceManagementEnable = false
        SoAdSocketLocalAddressRef = NEP_MyECU_b5eec5f0
        SD_Uni_MyECU_d52779b2 (SoAdSocketConnection): SoAdSocketId=10, SoAdSocketGetReceivedRemoteAddressEnabled=true, SoAdVerifyRxPduEnable=false
          SoAdSocketRemoteAddress: SoAdSocketRemotePort=30490, SoAdSocketRemoteIpAddress=, SoAdSocketRemoteIpAddressNotSet=false, SoAdSocketRemotePortNotSet=false
        SoAdSocketProtocol
          SoAdSocketUdp:
            SoAdSocketUdpListenOnly = false
            SoAdSocketUdpStrictHeaderLenCheckEnabled = false
            SoAdSocketUdpChecksumEnabled = true
            SoAdSocketUdpAddressResolutionRetryEnabled = true
            SoAdSocketUdpImmediateIfTxConfirmation = false
            SoAdSocketUdpAddressResolutionRetryQueueLimit = 1
            SoAdSocketUdpChecksumChangeEnabled = false
      SCB_DoIP_UDP_539479bb (SoAdSocketConnectionGroup):
        SoAdSocketFramePriority = 0
        SoAdSocketLocalPort = 13400
        SoAdPduHeaderEnable = false
        SoAdSocketAutomaticSoConSetup = false
        SoAdSocketIpAddrAssignmentChgNotification = true
        SoAdSocketMsgAcceptanceFilterEnabled = true
        SoAdSocketSoConModeChgNotification = true
        SoAdBestMatchWithSockRouteEnabled = false
        SoAdBestMatchWithPduHeaderEnabled = false
        SoAdSocketAutomaticSoConSetupKeepOnline = false
        SoAdResourceManagementEnable = false
        SoAdSocketLocalAddressRef = NEP_MyECU_b5eec5f0
        SCB_DoIP_UDP_c2bf8e34 (SoAdSocketConnection): SoAdSocketId=4, SoAdSocketGetReceivedRemoteAddressEnabled=false, SoAdVerifyRxPduEnable=false
          SoAdSocketRemoteAddress: SoAdSocketRemoteIpAddress=255.255.255.255, SoAdSocketRemotePort=13400, SoAdSocketRemoteIpAddressNotSet=false, SoAdSocketRemotePortNotSet=false
        SCB_DoIP_UDP_6c08ed5a (SoAdSocketConnection): SoAdSocketId=3, SoAdSocketGetReceivedRemoteAddressEnabled=false, SoAdVerifyRxPduEnable=false
          SoAdSocketRemoteAddress: SoAdSocketRemotePort=0, SoAdSocketRemoteIpAddress=, SoAdSocketRemoteIpAddressNotSet=false, SoAdSocketRemotePortNotSet=false
        SoAdSocketProtocol
          SoAdSocketUdp:
            SoAdSocketUdpListenOnly = false
            SoAdSocketUdpStrictHeaderLenCheckEnabled = false
            SoAdSocketUdpChecksumEnabled = true
            SoAdSocketUdpAddressResolutionRetryEnabled = true
            SoAdSocketUdpImmediateIfTxConfirmation = false
            SoAdSocketUdpAddressResolutionRetryQueueLimit = 1
            SoAdSocketUdpChecksumChangeEnabled = false
      SCB_Basics_362ccfdd_Rx (SoAdSocketRoute): SoAdRxPduHeaderId=688129, SoAdRxSocketConnOrSocketConnBundleRef=SCB_Basics_f1920dfe
        SCB_Basics_76f10691 (SoAdSocketRouteDest): SoAdRxUpperLayerType=IF, SoAdRxPduId=0, SoAdRxPduRef=Basics_Echo_Dashboard_6be9ec98_Rx, SoAdRxRoutingGroupRef=Basics_events_d39e7277
      5 x SoAdPduRoute, all with SoAdTxPduCollectionSemantics=SOAD_COLLECT_QUEUED:
        Maths_Multiply_return_MyECU_a014c44d_Tx: SoAdTxUpperLayerType=IF, SoAdTxPduId=6, SoAdTxIfTriggerTransmit=false, SoAdTxIfOptimized=false, SoAdTxIfOptimisticTransmit=false, SoAdTxPduRef=Maths_Multiply_return_MyECU_a014c44d_Tx
          SCB_Math_88dbc7c0 (SoAdPduRouteDest): SoAdTxPduHeaderId=720929, SoAdTxRoutingGroupRef=Math_methods_04e78f72, SoAdTxSocketConnOrSocketConnBundleRef=SCB_Math_83c40fa4/SCB_Math_88dbc7c0
        DoIP_TCP01_MyECU_Tx_Tester_Rx_c55a3b76_Tx: SoAdTxUpperLayerType=TP, SoAdTxPduId=0, SoAdTxTpOptimized=false, SoAdTxPduRef=DoIP_TCP01_MyECU_Tx_Tester_Rx_c55a3b76_Tx
          SCB_DoIP_TCP_14c6c034 (SoAdPduRouteDest): SoAdTxSocketConnOrSocketConnBundleRef=SCB_DoIP_TCP_1d17854b/SCB_DoIP_TCP_14c6c034
        DoIP_UDP_VehicleAnnouncement_59a8c6e3_Tx: SoAdTxUpperLayerType=IF, SoAdTxPduId=3, SoAdTxIfTriggerTransmit=false, SoAdTxIfOptimized=false, SoAdTxIfOptimisticTransmit=false, SoAdTxPduRef=DoIP_UDP_VehicleAnnouncement_59a8c6e3_Tx
          SCB_DoIP_UDP_c2bf8e34 (SoAdPduRouteDest): SoAdTxSocketConnOrSocketConnBundleRef=SCB_DoIP_UDP_539479bb/SCB_DoIP_UDP_c2bf8e34
        Maths_Divide_return_MyECU_98cdf8cf_Tx: SoAdTxUpperLayerType=IF, SoAdTxPduId=5, SoAdTxIfTriggerTransmit=false, SoAdTxIfOptimized=false, SoAdTxIfOptimisticTransmit=false, SoAdTxPduRef=Maths_Divide_return_MyECU_98cdf8cf_Tx
          SCB_Math_88dbc7c0 (SoAdPduRouteDest): SoAdTxPduHeaderId=720930, SoAdTxRoutingGroupRef=Math_methods_04e78f72, SoAdTxSocketConnOrSocketConnBundleRef=SCB_Math_83c40fa4/SCB_Math_88dbc7c0
        DoIP_TCP02_MyECU_Tx_Tester_Rx_92781724_Tx: SoAdTxUpperLayerType=TP, SoAdTxPduId=1, SoAdTxTpOptimized=false, SoAdTxPduRef=DoIP_TCP02_MyECU_Tx_Tester_Rx_92781724_Tx
          SCB_DoIP_TCP_b2b1cb80 (SoAdPduRouteDest): SoAdTxSocketConnOrSocketConnBundleRef=SCB_DoIP_TCP_1d17854b/SCB_DoIP_TCP_b2b1cb80
      SCB_DoIP_UDP_092771ae_Rx (SoAdSocketRoute): SoAdRxSocketConnOrSocketConnBundleRef=SCB_DoIP_UDP_539479bb/SCB_DoIP_UDP_6c08ed5a
        SCB_DoIP_UDP_7353c750 (SoAdSocketRouteDest): SoAdRxUpperLayerType=IF, SoAdRxPduId=3, SoAdRxPduRef=DoIP_UDP_Tester_Tx_MyECU_Rx_c8039ea2_Rx
      3 x SoAdPduRoute, all with SoAdTxUpperLayerType=IF, SoAdTxPduCollectionSemantics=SOAD_COLLECT_QUEUED, SoAdTxIfTriggerTransmit=false, SoAdTxIfOptimized=false, SoAdTxIfOptimisticTransmit=false:
        Maths_Substract_return_MyECU_d9b1fce3_Tx: SoAdTxPduId=7, SoAdTxPduRef=Maths_Substract_return_MyECU_d9b1fce3_Tx
          SCB_Math_88dbc7c0 (SoAdPduRouteDest): SoAdTxPduHeaderId=720928, SoAdTxRoutingGroupRef=Math_methods_04e78f72, SoAdTxSocketConnOrSocketConnBundleRef=SCB_Math_83c40fa4/SCB_Math_88dbc7c0
        PDU_UdpNmTx_MyECU_a23fc2ca_Tx: SoAdTxPduId=9, SoAdTxPduRef=PDU_UdpNmTx_MyECU_a23fc2ca_Tx
          SCB_NM_MyECU_11dde21a (SoAdPduRouteDest): SoAdTxSocketConnOrSocketConnBundleRef=SCB_NM_MyECU_20f2c79e/SCB_NM_MyECU_11dde21a
        XCP_Response_PDU_2d0521ff_Tx: SoAdTxPduId=14, SoAdTxPduRef=XCP_Response_PDU_2d0521ff_Tx
          SCB_Xcp_MyECU_0195b261 (SoAdPduRouteDest): SoAdTxSocketConnOrSocketConnBundleRef=SCB_Xcp_MyECU_d4fcbd34/SCB_Xcp_MyECU_0195b261
      SD_Multi_MyECU_89a27419_Rx (SoAdSocketRoute): SoAdRxPduHeaderId=4294934784, SoAdRxSocketConnOrSocketConnBundleRef=SD_Multi_MyECU_5d6e9596
        SD_Multi_MyECU_215e8bd1 (SoAdSocketRouteDest): SoAdRxUpperLayerType=IF, SoAdRxPduId=10, SoAdRxPduRef=SD_Ctrl_Rx_Multicast_abf0bc8f_Rx
      SCB_DoIP_TCP_f2ac81b7_Rx (SoAdSocketRoute): SoAdRxSocketConnOrSocketConnBundleRef=SCB_DoIP_TCP_1d17854b/SCB_DoIP_TCP_b2b1cb80
        SCB_DoIP_TCP_fd930c98 (SoAdSocketRouteDest): SoAdRxUpperLayerType=TP, SoAdRxPduId=2, SoAdRxPduRef=DoIP_TCP02_Tester_Tx_MyECU_Rx_9571c88e_Rx
      SCB_DoIP_TCP_1d17854b (SoAdSocketConnectionGroup):
        SoAdSocketFramePriority = 0
        SoAdSocketLocalPort = 13400
        SoAdPduHeaderEnable = false
        SoAdSocketAutomaticSoConSetup = false
        SoAdSocketIpAddrAssignmentChgNotification = true
        SoAdSocketMsgAcceptanceFilterEnabled = true
        SoAdSocketSoConModeChgNotification = true
        SoAdBestMatchWithSockRouteEnabled = false
        SoAdBestMatchWithPduHeaderEnabled = false
        SoAdSocketAutomaticSoConSetupKeepOnline = false
        SoAdResourceManagementEnable = false
        SoAdSocketTpRxBufferMin = 512
        SoAdSocketLocalAddressRef = NEP_MyECU_b5eec5f0
        SCB_DoIP_TCP_14c6c034 (SoAdSocketConnection): SoAdSocketId=1, SoAdSocketGetReceivedRemoteAddressEnabled=false, SoAdVerifyRxPduEnable=false, SoAdTcpTxQueueSize=2
          SoAdSocketRemoteAddress: SoAdSocketRemotePort=0, SoAdSocketRemoteIpAddress=, SoAdSocketRemoteIpAddressNotSet=false, SoAdSocketRemotePortNotSet=false
        SoAdSocketProtocol
          SoAdSocketTcp:
            SoAdSocketTcpInitiate = false
            SoAdSocketTcpImmediateTpTxConfirmation = false
            SoAdSocketTcpKeepAlive = false
            SoAdSocketTcpTxBufferMin = 512
            SoAdSocketTcpNoDelay = true
        SCB_DoIP_TCP_b2b1cb80 (SoAdSocketConnection): SoAdSocketId=2, SoAdSocketGetReceivedRemoteAddressEnabled=false, SoAdVerifyRxPduEnable=false, SoAdTcpTxQueueSize=2
          SoAdSocketRemoteAddress: SoAdSocketRemotePort=0, SoAdSocketRemoteIpAddress=, SoAdSocketRemoteIpAddressNotSet=false, SoAdSocketRemotePortNotSet=false
      SD_Multi_MyECU_63893f37 (SoAdSocketConnectionGroup):
        SoAdPduHeaderEnable = true
        SoAdSocketFramePriority = 0
        SoAdSocketLocalPort = 30490
        SoAdSocketAutomaticSoConSetup = false
        SoAdSocketIpAddrAssignmentChgNotification = false
        SoAdSocketMsgAcceptanceFilterEnabled = false
        SoAdSocketSoConModeChgNotification = false
        SoAdBestMatchWithSockRouteEnabled = false
        SoAdBestMatchWithPduHeaderEnabled = false
        SoAdSocketAutomaticSoConSetupKeepOnline = false
        SoAdResourceManagementEnable = false
        SoAdSocketLocalAddressRef = NEP_SD_Multicast_IP_1690fc8d
        SD_Multi_MyECU_5d6e9596 (SoAdSocketConnection): SoAdSocketId=9, SoAdSocketGetReceivedRemoteAddressEnabled=true, SoAdVerifyRxPduEnable=false
          SoAdSocketRemoteAddress: SoAdSocketRemotePort=30490, SoAdSocketRemoteIpAddress=, SoAdSocketRemoteIpAddressNotSet=false, SoAdSocketRemotePortNotSet=false
        SoAdSocketProtocol
          SoAdSocketUdp:
            SoAdSocketUdpListenOnly = false
            SoAdSocketUdpStrictHeaderLenCheckEnabled = false
            SoAdSocketUdpChecksumEnabled = true
            SoAdSocketUdpAddressResolutionRetryEnabled = true
            SoAdSocketUdpImmediateIfTxConfirmation = false
            SoAdSocketUdpAddressResolutionRetryQueueLimit = 1
            SoAdSocketUdpChecksumChangeEnabled = false
      SD_Uni_MyECU_b7f15b57_Rx (SoAdSocketRoute): SoAdRxPduHeaderId=4294934784, SoAdRxSocketConnOrSocketConnBundleRef=SD_Uni_MyECU_dd1c2435/SD_Uni_MyECU_d52779b2
        SD_Uni_MyECU_9c8e7701 (SoAdSocketRouteDest): SoAdRxUpperLayerType=IF, SoAdRxPduId=11, SoAdRxPduRef=SD_Ctrl_Rx_cf97c32f_Rx
      SCB_Xcp_MyECU_d4fcbd34 (SoAdSocketConnectionGroup):
        SoAdSocketFramePriority = 0
        SoAdSocketLocalPort = 5555
        SoAdPduHeaderEnable = false
        SoAdSocketAutomaticSoConSetup = false
        SoAdSocketIpAddrAssignmentChgNotification = false
        SoAdSocketMsgAcceptanceFilterEnabled = true
        SoAdSocketSoConModeChgNotification = true
        SoAdBestMatchWithSockRouteEnabled = false
        SoAdBestMatchWithPduHeaderEnabled = false
        SoAdSocketAutomaticSoConSetupKeepOnline = false
        SoAdResourceManagementEnable = false
        SoAdSocketLocalAddressRef = NEP_MyECU_b5eec5f0
        SoAdSocketProtocol
          SoAdSocketUdp:
            SoAdSocketUdpListenOnly = false
            SoAdSocketUdpStrictHeaderLenCheckEnabled = false
            SoAdSocketUdpChecksumEnabled = true
            SoAdSocketUdpAddressResolutionRetryEnabled = true
            SoAdSocketUdpImmediateIfTxConfirmation = false
            SoAdSocketUdpAddressResolutionRetryQueueLimit = 1
            SoAdSocketUdpChecksumChangeEnabled = false
        SCB_Xcp_MyECU_0195b261 (SoAdSocketConnection): SoAdSocketId=8, SoAdSocketGetReceivedRemoteAddressEnabled=false, SoAdVerifyRxPduEnable=false
          SoAdSocketRemoteAddress: SoAdSocketRemotePort=0, SoAdSocketRemoteIpAddress=, SoAdSocketRemoteIpAddressNotSet=false, SoAdSocketRemotePortNotSet=false
      SCB_DoIP_TCP_d0de1fd3_Rx (SoAdSocketRoute): SoAdRxSocketConnOrSocketConnBundleRef=SCB_DoIP_TCP_1d17854b/SCB_DoIP_TCP_14c6c034
        SCB_DoIP_TCP_523a4152 (SoAdSocketRouteDest): SoAdRxUpperLayerType=TP, SoAdRxPduId=1, SoAdRxPduRef=DoIP_TCP01_Tester_Tx_MyECU_Rx_c253e4dc_Rx
      DoIP_UDP_MyECU_Tx_Tester_Rx_cf0a4108_Tx (SoAdPduRoute):
        SoAdTxUpperLayerType = IF
        SoAdTxPduId = 2
        SoAdTxPduCollectionSemantics = SOAD_COLLECT_QUEUED
        SoAdTxIfTriggerTransmit = false
        SoAdTxIfOptimized = false
        SoAdTxIfOptimisticTransmit = false
        SoAdTxPduRef = DoIP_UDP_MyECU_Tx_Tester_Rx_cf0a4108_Tx
        SCB_DoIP_UDP_6c08ed5a (SoAdPduRouteDest): SoAdTxSocketConnOrSocketConnBundleRef=SCB_DoIP_UDP_539479bb/SCB_DoIP_UDP_6c08ed5a
      Maths_Add_return_MyECU_1d790293_Tx (SoAdPduRoute):
        SoAdTxUpperLayerType = IF
        SoAdTxPduId = 4
        SoAdTxPduCollectionSemantics = SOAD_COLLECT_QUEUED
        SoAdTxIfTriggerTransmit = false
        SoAdTxIfOptimized = false
        SoAdTxIfOptimisticTransmit = false
        SoAdTxPduRef = Maths_Add_return_MyECU_1d790293_Tx
        SCB_Math_88dbc7c0 (SoAdPduRouteDest): SoAdTxPduHeaderId=720927, SoAdTxRoutingGroupRef=Math_methods_04e78f72, SoAdTxSocketConnOrSocketConnBundleRef=SCB_Math_83c40fa4/SCB_Math_88dbc7c0
      SCB_Math_83c40fa4 (SoAdSocketConnectionGroup):
        SoAdPduHeaderEnable = true
        SoAdSocketFramePriority = 0
        SoAdSocketLocalPort = 30491
        SoAdSocketAutomaticSoConSetup = false
        SoAdSocketIpAddrAssignmentChgNotification = false
        SoAdSocketMsgAcceptanceFilterEnabled = true
        SoAdSocketSoConModeChgNotification = true
        SoAdBestMatchWithSockRouteEnabled = false
        SoAdBestMatchWithPduHeaderEnabled = false
        SoAdSocketAutomaticSoConSetupKeepOnline = false
        SoAdResourceManagementEnable = false
        SoAdSocketLocalAddressRef = NEP_MyECU_b5eec5f0
        SoAdSocketProtocol
          SoAdSocketUdp:
            SoAdSocketUdpListenOnly = false
            SoAdSocketUdpStrictHeaderLenCheckEnabled = false
            SoAdSocketUdpChecksumEnabled = true
            SoAdSocketUdpAddressResolutionRetryEnabled = true
            SoAdSocketUdpImmediateIfTxConfirmation = false
            SoAdSocketUdpAddressResolutionRetryQueueLimit = 1
            SoAdSocketUdpChecksumChangeEnabled = false
            SoAdSocketUdpAliveSupervisionTimeout = 1
        SCB_Math_88dbc7c0 (SoAdSocketConnection): SoAdSocketId=5, SoAdSocketGetReceivedRemoteAddressEnabled=false, SoAdVerifyRxPduEnable=false, SoAdAdditionalChgNotificationRef=Sd
          SoAdSocketRemoteAddress: SoAdSocketRemotePort=30491, SoAdSocketRemoteIpAddress=, SoAdSocketRemoteIpAddressNotSet=false, SoAdSocketRemotePortNotSet=false
      SD_Ctrl_Tx_86d8d410_Tx (SoAdPduRoute):
        SoAdTxUpperLayerType = IF
        SoAdTxPduId = 10
        SoAdTxPduCollectionSemantics = SOAD_COLLECT_QUEUED
        SoAdTxIfTriggerTransmit = false
        SoAdTxIfOptimized = false
        SoAdTxIfOptimisticTransmit = false
        SoAdTxPduRef = SD_Ctrl_Tx_86d8d410_Tx
        SD_Uni_MyECU_d52779b2 (SoAdPduRouteDest): SoAdTxPduHeaderId=4294934784, SoAdTxSocketConnOrSocketConnBundleRef=SD_Uni_MyECU_dd1c2435/SD_Uni_MyECU_d52779b2
      SCB_Basics_d6d2116a (SoAdSocketConnectionGroup):
        SoAdPduHeaderEnable = true
        SoAdSocketFramePriority = 0
        SoAdSocketLocalPort = 30501
        SoAdSocketAutomaticSoConSetup = false
        SoAdSocketIpAddrAssignmentChgNotification = false
        SoAdSocketMsgAcceptanceFilterEnabled = true
        SoAdSocketSoConModeChgNotification = true
        SoAdBestMatchWithSockRouteEnabled = false
        SoAdBestMatchWithPduHeaderEnabled = false
        SoAdSocketAutomaticSoConSetupKeepOnline = false
        SoAdResourceManagementEnable = false
        SoAdSocketLocalAddressRef = NEP_MyECU_b5eec5f0
        SCB_Basics_f1920dfe (SoAdSocketConnection): SoAdSocketId=0, SoAdSocketGetReceivedRemoteAddressEnabled=false, SoAdVerifyRxPduEnable=false, SoAdAdditionalChgNotificationRef=Sd
          SoAdSocketRemoteAddress: SoAdSocketRemotePort=30501, SoAdSocketRemoteIpAddress=, SoAdSocketRemoteIpAddressNotSet=false, SoAdSocketRemotePortNotSet=false
        SoAdSocketProtocol
          SoAdSocketUdp:
            SoAdSocketUdpListenOnly = false
            SoAdSocketUdpStrictHeaderLenCheckEnabled = false
            SoAdSocketUdpChecksumEnabled = true
            SoAdSocketUdpAddressResolutionRetryEnabled = true
            SoAdSocketUdpImmediateIfTxConfirmation = false
            SoAdSocketUdpAddressResolutionRetryQueueLimit = 1
            SoAdSocketUdpChecksumChangeEnabled = false
            SoAdSocketUdpAliveSupervisionTimeout = 1
      5 x SoAdSocketRoute:
        SCB_Xcp_MyECU_758ceaa2_Rx: SoAdRxSocketConnOrSocketConnBundleRef=SCB_Xcp_MyECU_d4fcbd34/SCB_Xcp_MyECU_0195b261
          SCB_Xcp_MyECU_f2d755c9 (SoAdSocketRouteDest): SoAdRxUpperLayerType=IF, SoAdRxPduId=9, SoAdRxPduRef=XCP_Request_PDU_c1459bdf_Rx
        SCB_Math_da735152_Rx: SoAdRxPduHeaderId=720927, SoAdRxSocketConnOrSocketConnBundleRef=SCB_Math_83c40fa4/SCB_Math_88dbc7c0
          SCB_Math_d017ce83 (SoAdSocketRouteDest): SoAdRxUpperLayerType=IF, SoAdRxPduId=7, SoAdRxPduRef=Maths_Add_call_Dashboard_8f2ed2a1_Rx, SoAdRxRoutingGroupRef=Math_methods_04e78f72
        SCB_Math_35bb6516_Rx: SoAdRxPduHeaderId=720928, SoAdRxSocketConnOrSocketConnBundleRef=SCB_Math_83c40fa4/SCB_Math_88dbc7c0
          SCB_Math_d1a73034 (SoAdSocketRouteDest): SoAdRxUpperLayerType=IF, SoAdRxPduId=5, SoAdRxPduRef=Maths_Substract_call_Dashboard_fa14b084_Rx, SoAdRxRoutingGroupRef=Math_methods_04e78f72
        SCB_Math_8fe1c01c_Rx: SoAdRxPduHeaderId=720930, SoAdRxSocketConnOrSocketConnBundleRef=SCB_Math_83c40fa4/SCB_Math_88dbc7c0
          SCB_Math_b3887993 (SoAdSocketRouteDest): SoAdRxUpperLayerType=IF, SoAdRxPduId=4, SoAdRxPduRef=Maths_Divide_call_Dashboard_c4485e4f_Rx, SoAdRxRoutingGroupRef=Math_methods_04e78f72
        SCB_Math_87aabb85_Rx: SoAdRxPduHeaderId=720929, SoAdRxSocketConnOrSocketConnBundleRef=SCB_Math_83c40fa4/SCB_Math_88dbc7c0
          SCB_Math_ec486013 (SoAdSocketRouteDest): SoAdRxUpperLayerType=IF, SoAdRxPduId=6, SoAdRxPduRef=Maths_Multiply_call_Dashboard_e292e0d8_Rx, SoAdRxRoutingGroupRef=Math_methods_04e78f72
      SCB_NM_MyECU_20f2c79e (SoAdSocketConnectionGroup):
        SoAdSocketFramePriority = 2
        SoAdSocketLocalPort = 1001
        SoAdPduHeaderEnable = false
        SoAdSocketAutomaticSoConSetup = true
        SoAdSocketIpAddrAssignmentChgNotification = false
        SoAdSocketMsgAcceptanceFilterEnabled = true
        SoAdSocketSoConModeChgNotification = false
        SoAdBestMatchWithSockRouteEnabled = false
        SoAdBestMatchWithPduHeaderEnabled = false
        SoAdSocketAutomaticSoConSetupKeepOnline = false
        SoAdResourceManagementEnable = false
        SoAdSocketLocalAddressRef = NEP_NM_IPv6_MyECU_LinkLocal_cc2dfcf9
        SoAdSocketProtocol
          SoAdSocketUdp:
            SoAdSocketUdpListenOnly = false
            SoAdSocketUdpStrictHeaderLenCheckEnabled = false
            SoAdSocketUdpChecksumEnabled = true
            SoAdSocketUdpAddressResolutionRetryEnabled = true
            SoAdSocketUdpImmediateIfTxConfirmation = false
            SoAdSocketUdpAddressResolutionRetryQueueLimit = 1
            SoAdSocketUdpChecksumChangeEnabled = false
        SCB_NM_MyECU_11dde21a (SoAdSocketConnection): SoAdSocketId=7, SoAdSocketGetReceivedRemoteAddressEnabled=false, SoAdVerifyRxPduEnable=false
          SoAdSocketRemoteAddress: SoAdSocketRemotePort=1001, SoAdSocketRemoteIpAddress=, SoAdSocketRemoteIpAddressNotSet=false, SoAdSocketRemotePortNotSet=false
      SCB_NM_Global_c5202594 (SoAdSocketConnectionGroup):
        SoAdSocketFramePriority = 2
        SoAdSocketLocalPort = 1001
        SoAdPduHeaderEnable = false
        SoAdSocketAutomaticSoConSetup = true
        SoAdSocketIpAddrAssignmentChgNotification = false
        SoAdSocketMsgAcceptanceFilterEnabled = true
        SoAdSocketSoConModeChgNotification = false
        SoAdBestMatchWithSockRouteEnabled = false
        SoAdBestMatchWithPduHeaderEnabled = false
        SoAdSocketAutomaticSoConSetupKeepOnline = false
        SoAdSocketLocalAddressRef = NEP_NM_IPv6_Multicast_0621f4c5
        SCB_NM_Global_afa15e29 (SoAdSocketConnection): SoAdSocketId=6, SoAdSocketGetReceivedRemoteAddressEnabled=false, SoAdVerifyRxPduEnable=false
          SoAdSocketRemoteAddress: SoAdSocketRemotePort=1001, SoAdSocketRemoteIpAddress=, SoAdSocketRemoteIpAddressNotSet=false, SoAdSocketRemotePortNotSet=false
        SoAdSocketProtocol
          SoAdSocketUdp:
            SoAdSocketUdpListenOnly = false
            SoAdSocketUdpStrictHeaderLenCheckEnabled = false
            SoAdSocketUdpChecksumEnabled = true
            SoAdSocketUdpAddressResolutionRetryEnabled = true
            SoAdSocketUdpImmediateIfTxConfirmation = false
            SoAdSocketUdpAddressResolutionRetryQueueLimit = 1
            SoAdSocketUdpChecksumChangeEnabled = false
      SCB_NM_Global_25b6bf5f_Rx (SoAdSocketRoute): SoAdRxSocketConnOrSocketConnBundleRef=SCB_NM_Global_afa15e29
        SCB_NM_Global_075b3c8d (SoAdSocketRouteDest): SoAdRxUpperLayerType=IF, SoAdRxPduId=8, SoAdRxPduRef=PDU_UdpNmRX_MyECU_fd977b7e_Rx
      SoAdInstance:
        SoAdSocketConnectionGroupRef = SCB_Basics_d6d2116a
        SoAdSocketConnectionGroupRef = SCB_DoIP_TCP_1d17854b
        SoAdSocketConnectionGroupRef = SCB_DoIP_UDP_539479bb
        SoAdSocketConnectionGroupRef = SoAdConfig/SCB_Math_83c40fa4
        SoAdSocketConnectionGroupRef = SCB_NM_Global_c5202594
        SoAdSocketConnectionGroupRef = SCB_NM_MyECU_20f2c79e
        SoAdSocketConnectionGroupRef = SCB_Xcp_MyECU_d4fcbd34
        SoAdSocketConnectionGroupRef = SD_Multi_MyECU_63893f37
        SoAdSocketConnectionGroupRef = SD_Uni_MyECU_dd1c2435
        SoAdSocketConnectionGroupRef = StartApplication_CC_SoAdSocketConnectionGroup_SoAdCdd_Udp
        SoAdSocketConnectionGroupRef = StartApplication_CCLD_SoAdSocketConnectionGroup_SoAdCdd_Udp
        SoAdSocketConnectionGroupRef = StartApplication_ETH_SoAdSocketConnectionGroup_SoAdCdd_Udp
        SoAdIfTriggerTransmitConfig
          SoAdIfTriggerTransmitBuffer: SoAdIfTriggerTransmitBufferSize=12
      StartApplication_CCLD_SoAdPduRoute_SoAdCdd_Udp_Tx (SoAdPduRoute):
        SoAdTxPduId = 11
        SoAdTxUpperLayerType = IF
        SoAdTxIfTriggerTransmit = false
        SoAdTxPduCollectionSemantics = SOAD_COLLECT_QUEUED
        SoAdTxIfOptimisticTransmit = false
        SoAdTxIfOptimized = false
        SoAdTxPduRef = StartApplication_CCLD_Pdu_SoAdCdd_Udp_Tx
        StartApplication_CCLD_SoAdPduRouteDest_SoAdCdd_Udp_Tx (SoAdPduRouteDest): SoAdTxSocketConnOrSocketConnBundleRef=StartApplication_CCLD_SoAdSocketConnectionGroup_SoAdCdd_Udp
      StartApplication_CCLD_SoAdSocketConnectionGroup_SoAdCdd_Udp (SoAdSocketConnectionGroup):
        SoAdPduHeaderEnable = false
        SoAdSocketAutomaticSoConSetup = true
        SoAdSocketIpAddrAssignmentChgNotification = false
        SoAdSocketLocalPort = 2425
        SoAdSocketMsgAcceptanceFilterEnabled = false
        SoAdSocketSoConModeChgNotification = false
        SoAdBestMatchWithSockRouteEnabled = false
        SoAdBestMatchWithPduHeaderEnabled = false
        SoAdSocketAutomaticSoConSetupKeepOnline = false
        SoAdSocketLocalAddressRef = NEP_MyECU_b5eec5f0
        StartApplication_CCLD_SoAdSocketConnection_SoAdCdd_Udp (SoAdSocketConnection): SoAdSocketId=11, SoAdSocketGetReceivedRemoteAddressEnabled=false, SoAdVerifyRxPduEnable=false
          StartApplication_CCLD_SoAdSocketRemoteAddress_SoAdCdd_Udp (SoAdSocketRemoteAddress): SoAdSocketRemotePort=4243, SoAdSocketRemoteIpAddressNotSet=false, SoAdSocketRemotePortNotSet=false, SoAdSocketRemoteIpAddress=192.168.1.10
        SoAdSocketProtocol
          StartApplication_CCLD_SoAdSocketUdp_SoAdCdd_Udp (SoAdSocketUdp):
            SoAdSocketUdpListenOnly = false
            SoAdSocketUdpImmediateIfTxConfirmation = false
            SoAdSocketUdpStrictHeaderLenCheckEnabled = false
            SoAdSocketUdpAddressResolutionRetryEnabled = true
            SoAdSocketUdpAddressResolutionRetryQueueLimit = 1
            SoAdSocketUdpChecksumChangeEnabled = false
            SoAdSocketUdpChecksumEnabled = true
      StartApplication_CCLD_SoAdSocketRoute_SoAdCdd_Udp_Rx (SoAdSocketRoute): SoAdRxSocketConnOrSocketConnBundleRef=StartApplication_CCLD_SoAdSocketConnectionGroup_SoAdCdd_Udp
        StartApplication_CCLD_SoAdSocketRouteDest_SoAdCdd_Udp_Rx (SoAdSocketRouteDest): SoAdRxUpperLayerType=IF, SoAdRxPduId=12, SoAdRxPduRef=StartApplication_CCLD_Pdu_SoAdCdd_Udp_Rx
      StartApplication_CC_SoAdPduRoute_SoAdCdd_Udp_Tx (SoAdPduRoute):
        SoAdTxPduId = 12
        SoAdTxUpperLayerType = IF
        SoAdTxIfTriggerTransmit = false
        SoAdTxPduCollectionSemantics = SOAD_COLLECT_QUEUED
        SoAdTxIfOptimisticTransmit = false
        SoAdTxIfOptimized = false
        SoAdTxPduRef = StartApplication_CC_Pdu_SoAdCdd_Udp_Tx
        StartApplication_CC_SoAdPduRouteDest_SoAdCdd_Udp_Tx (SoAdPduRouteDest): SoAdTxPduHeaderId=0, SoAdTxSocketConnOrSocketConnBundleRef=StartApplication_CC_SoAdSocketConnectionGroup_SoAdCdd_Udp
      StartApplication_CC_SoAdSocketConnectionGroup_SoAdCdd_Udp (SoAdSocketConnectionGroup):
        SoAdPduHeaderEnable = true
        SoAdSocketAutomaticSoConSetup = true
        SoAdSocketIpAddrAssignmentChgNotification = false
        SoAdSocketLocalPort = 2424
        SoAdSocketMsgAcceptanceFilterEnabled = false
        SoAdSocketSoConModeChgNotification = false
        SoAdBestMatchWithSockRouteEnabled = false
        SoAdBestMatchWithPduHeaderEnabled = false
        SoAdSocketAutomaticSoConSetupKeepOnline = false
        SoAdSocketLocalAddressRef = NEP_MyECU_b5eec5f0
        StartApplication_CC_SoAdSocketConnection_SoAdCdd_Udp (SoAdSocketConnection): SoAdSocketId=12, SoAdSocketGetReceivedRemoteAddressEnabled=false, SoAdVerifyRxPduEnable=false
          StartApplication_CC_SoAdSocketRemoteAddress_SoAdCdd_Udp (SoAdSocketRemoteAddress): SoAdSocketRemotePort=4242, SoAdSocketRemoteIpAddressNotSet=false, SoAdSocketRemotePortNotSet=false, SoAdSocketRemoteIpAddress=192.168.1.10
        SoAdSocketProtocol
          StartApplication_CC_SoAdSocketUdp_SoAdCdd_Udp (SoAdSocketUdp):
            SoAdSocketUdpListenOnly = false
            SoAdSocketUdpImmediateIfTxConfirmation = false
            SoAdSocketUdpStrictHeaderLenCheckEnabled = false
            SoAdSocketUdpAddressResolutionRetryEnabled = true
            SoAdSocketUdpAddressResolutionRetryQueueLimit = 1
            SoAdSocketUdpChecksumChangeEnabled = false
            SoAdSocketUdpChecksumEnabled = true
      StartApplication_CC_SoAdSocketRoute_SoAdCdd_Udp_Rx (SoAdSocketRoute): SoAdRxPduHeaderId=0, SoAdRxSocketConnOrSocketConnBundleRef=StartApplication_CC_SoAdSocketConnectionGroup_SoAdCdd_Udp
        StartApplication_CC_SoAdSocketRouteDest_SoAdCdd_Udp_Rx (SoAdSocketRouteDest): SoAdRxUpperLayerType=IF, SoAdRxPduId=13, SoAdRxPduRef=StartApplication_CC_Pdu_SoAdCdd_Udp_Rx
      StartApplication_ETH_SoAdPduRoute_SoAdCdd_Udp_Tx (SoAdPduRoute):
        SoAdTxPduId = 13
        SoAdTxUpperLayerType = IF
        SoAdTxIfTriggerTransmit = false
        SoAdTxPduCollectionSemantics = SOAD_COLLECT_QUEUED
        SoAdTxIfOptimized = false
        SoAdTxIfOptimisticTransmit = false
        SoAdTxPduRef = StartApplication_ETH_Pdu_SoAdCdd_Udp_Tx
        StartApplication_ETH_SoAdPduRouteDest_SoAdCdd_Udp_Tx (SoAdPduRouteDest): SoAdTxSocketConnOrSocketConnBundleRef=StartApplication_ETH_SoAdSocketConnectionGroup_SoAdCdd_Udp
      StartApplication_ETH_SoAdSocketConnectionGroup_SoAdCdd_Udp (SoAdSocketConnectionGroup):
        SoAdPduHeaderEnable = false
        SoAdSocketAutomaticSoConSetup = true
        SoAdSocketIpAddrAssignmentChgNotification = false
        SoAdSocketLocalPort = 3535
        SoAdSocketMsgAcceptanceFilterEnabled = false
        SoAdSocketSoConModeChgNotification = false
        SoAdBestMatchWithSockRouteEnabled = false
        SoAdBestMatchWithPduHeaderEnabled = false
        SoAdSocketAutomaticSoConSetupKeepOnline = false
        SoAdSocketLocalAddressRef = NEP_MyECU_b5eec5f0
        StartApplication_ETH_SoAdSocketConnection_SoAdCdd_Udp (SoAdSocketConnection): SoAdSocketId=13, SoAdSocketGetReceivedRemoteAddressEnabled=false, SoAdVerifyRxPduEnable=false
          StartApplication_ETH_SoAdSocketRemoteAddress_SoAdCdd_Udp (SoAdSocketRemoteAddress): SoAdSocketRemotePort=5353, SoAdSocketRemoteIpAddressNotSet=false, SoAdSocketRemotePortNotSet=false, SoAdSocketRemoteIpAddress=192.168.1.10
        SoAdSocketProtocol
          StartApplication_ETH_SoAdSocketUdp_SoAdCdd_Udp (SoAdSocketUdp):
            SoAdSocketUdpListenOnly = false
            SoAdSocketUdpImmediateIfTxConfirmation = false
            SoAdSocketUdpStrictHeaderLenCheckEnabled = false
            SoAdSocketUdpAddressResolutionRetryEnabled = true
            SoAdSocketUdpAddressResolutionRetryQueueLimit = 1
            SoAdSocketUdpChecksumChangeEnabled = false
            SoAdSocketUdpChecksumEnabled = true
      StartApplication_ETH_SoAdSocketRoute_SoAdCdd_Udp_Rx (SoAdSocketRoute): SoAdRxSocketConnOrSocketConnBundleRef=StartApplication_ETH_SoAdSocketConnectionGroup_SoAdCdd_Udp
        StartApplication_ETH_SoAdSocketRouteDest_SoAdCdd_Udp_Rx (SoAdSocketRouteDest): SoAdRxUpperLayerType=IF, SoAdRxPduId=14, SoAdRxPduRef=StartApplication_ETH_Pdu_SoAdCdd_Udp_Rx
    SoAdGeneral:
      SoAdDevErrorDetect = true
      SoAdIPv6AddressEnabled = true
      SoAdMainFunctionPeriod = 0.005
      SoAdRoutingGroupMax = 3
      SoAdSoConMax = 14
      SoAdVersionInfoApi = true
      SoAdShutdownFinishedWaitTime = 2
      SoAdTxDynamicLengthEnabled = false
      SoAdMainFunctionSplitEnabled = true
      SoAdSafeBswChecks = false
      SoAdGetAndResetMeasurementDataApi = false
      SoAdGetAndResetMeasurementDataSomeIpSd = false
      SoAdEnableSecurityEventReporting = false
      SoAdRxTcpBufferSegmentsMax = 2
      SoAdSocketApi: SoAdSocketApiPrefix=TcpIp, SoAdVBsdAdUsed=false
      SoAdGeneration:
        SoAdOutOfBoundsWriteProtectionStrategy = NONE
        SoAdOutOfBoundsWriteSanitizer = false
        SoAdOutOfBoundsReadSanitizer = false
        SoAdReduceConstantData2Define = false
        SoAdBoolDataInArrayOfStructStrategy = BOOLEAN
        SoAdDeduplicateIndirectedData = true
        SoAdDataDeduplicationStrategy = DEDUPLICATE_CONST_DATA_WITH_CAST
        SoAdReduceBoolDataByNegationThreshold = 2
        SoAdReduceBoolDataByNumericalComparisonThreshold = 2
        SoAdReduceBoolDataByNumericalRelationThreshold = 2
        SoAdReduceBoolDataByNumericalOperandStrategy = DEDUPLICATE_DATA_WITH_ANY_VALUE
        SoAdReduceNumericalDataByOffsetThreshold = 2
        SoAdReduceNumericalDataByArraySubtractionThreshold = 2
        SoAdReduceDataByStreaming = false
        SoAdShortSymbols = false
        SoAdInterfacesForDeactivatedData = false
        SoAdReferringKeysInComments = false
    6 x SoAdBswModules, all with SoAdIf=true:
      PduR: SoAdIfTriggerTransmit=true, SoAdIfTxConfirmation=false, SoAdLocalIpAddrAssigmentChg=false, SoAdSoConModeChg=false, SoAdTp=false, SoAdUseCallerInfix=true, SoAdUseTypeInfix=true, SoAdBswModuleRef=PduR
      Sd: SoAdIfTriggerTransmit=false, SoAdIfTxConfirmation=false, SoAdLocalIpAddrAssigmentChg=true, SoAdSoConModeChg=true, SoAdTp=false, SoAdUseCallerInfix=false, SoAdUseTypeInfix=false, SoAdBswModuleRef=Sd
      DoIP: SoAdIfTriggerTransmit=false, SoAdIfTxConfirmation=true, SoAdLocalIpAddrAssigmentChg=true, SoAdSoConModeChg=true, SoAdTp=true, SoAdUseCallerInfix=true, SoAdUseTypeInfix=true, SoAdBswModuleRef=DoIP
      UdpNm: SoAdIfTriggerTransmit=false, SoAdIfTxConfirmation=true, SoAdLocalIpAddrAssigmentChg=false, SoAdSoConModeChg=false, SoAdTp=false, SoAdUseCallerInfix=true, SoAdUseTypeInfix=true, SoAdBswModuleRef=UdpNm
      Xcp: SoAdIfTriggerTransmit=false, SoAdIfTxConfirmation=true, SoAdLocalIpAddrAssigmentChg=false, SoAdSoConModeChg=true, SoAdTp=false, SoAdUseCallerInfix=true, SoAdUseTypeInfix=false, SoAdBswModuleRef=Xcp
      StartApplicationEth: SoAdIfTriggerTransmit=false, SoAdIfTxConfirmation=false, SoAdLocalIpAddrAssigmentChg=false, SoAdSoConModeChg=false, SoAdTp=false, SoAdUseCallerInfix=true, SoAdUseTypeInfix=true, SoAdBswModuleRef=StartApplicationEth
