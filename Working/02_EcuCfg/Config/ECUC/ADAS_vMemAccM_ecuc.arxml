AUTOSAR XML (schema 4-3-0)
package /ActiveEcuC
  module config vMemAccM: implementation-config-variant=VARIANT-PRE-COMPILE, module-description=vMemAccM_Impl
    vMemAccMAddressArea_B (vMemAccMAddressAreaConfiguration): vMemAccMAddressAreaId=1, vMemAccMAddressAreaPriority=1, vMemAccMReadRequestLength=64
      3 x vMemAccMSubAddressAreaConfiguration, all with vMemAccMNumberOfSectors=64, vMemAccMvMemFuncPtrTableSymbol=vMem_30_Tc3xxInf01_FunctionPointerTable, vMemAccMUseEraseBurst=false, vMemAccMUseWriteBurst=false:
        PF1_PF3_PS0_S0_S63: vMemAccMVirtualStartAddress=2150629376, vMemAccMPhysicalStartAddress=2687500288, vMemAccMSectorRef=PF1_PF3_PS0_S0_S63
        PF1_PF3_PS1_S64_S127: vMemAccMVirtualStartAddress=2151677952, vMemAccMPhysicalStartAddress=2688548864, vMemAccMSectorRef=PF1_PF3_PS1_S64_S127
        PF1_PF3_PS2_S128_S191: vMemAccMVirtualStartAddress=2152726528, vMemAccMPhysicalStartAddress=2689597440, vMemAccMSectorRef=PF1_PF3_PS2_S128_S191
    Blocking (vMemAccMAddressAreaConfiguration): vMemAccMAddressAreaId=2, vMemAccMAddressAreaPriority=3, vMemAccMReadRequestLength=64
      3 x vMemAccMSubAddressAreaConfiguration, all with vMemAccMNumberOfSectors=64, vMemAccMvMemFuncPtrTableSymbol=vMem_30_Tc3xxInf01_FunctionPointerTable, vMemAccMUseEraseBurst=false, vMemAccMUseWriteBurst=false:
        PF2_PF0_PS0_S0_S63: vMemAccMVirtualStartAddress=2150629376, vMemAccMPhysicalStartAddress=2690646016, vMemAccMSectorRef=PF2_PF0_PS0_S0_S63
        PF2_PF0_PS1_S64_S127: vMemAccMVirtualStartAddress=2151677952, vMemAccMPhysicalStartAddress=2691694592, vMemAccMSectorRef=PF2_PF0_PS1_S64_S127
        PF2_PF0_PS2_S128_S191: vMemAccMVirtualStartAddress=2152726528, vMemAccMPhysicalStartAddress=2692743168, vMemAccMSectorRef=PF2_PF0_PS2_S128_S191
    vMemAccMGeneral:
      vMemAccMVersionInfoApi = false
      vMemAccMMainFunctionPeriod = 0.005
      vMemAccMMainFunctionTriggering = FixedCycleTime
      vMemAccMSafeBswChecks = false
      vMemAccMDevErrorDetect = true
      vMemAccMCompareApi = true
    vMemAccMAdressAreaBackup (vMemAccMAddressAreaConfiguration): vMemAccMAddressAreaId=3, vMemAccMAddressAreaPriority=0, vMemAccMReadRequestLength=64
      3 x vMemAccMSubAddressAreaConfiguration, all with vMemAccMNumberOfSectors=64, vMemAccMvMemFuncPtrTableSymbol=vMem_30_Tc3xxInf01_FunctionPointerTable, vMemAccMUseEraseBurst=false, vMemAccMUseWriteBurst=false:
        PF3_PF1_PS0_S0_S63: vMemAccMVirtualStartAddress=2150629376, vMemAccMPhysicalStartAddress=2693791744, vMemAccMSectorRef=PF3_PF1_PS0_S0_S63
        PF3_PF1_PS1_S64_S127: vMemAccMVirtualStartAddress=2151677952, vMemAccMPhysicalStartAddress=2694840320, vMemAccMSectorRef=PF3_PF1_PS1_S64_S127
        PF3_PF1_PS2_S128_S191: vMemAccMVirtualStartAddress=2152726528, vMemAccMPhysicalStartAddress=2695888896, vMemAccMSectorRef=PF3_PF1_PS2_S128_S191
    vMemAccMAddressArea_A (vMemAccMAddressAreaConfiguration): vMemAccMAddressAreaId=0, vMemAccMAddressAreaPriority=2, vMemAccMReadRequestLength=64
      vMemAccMSubAddressAreaConfiguration:
        vMemAccMNumberOfSectors = 1
        vMemAccMVirtualStartAddress = 0
        vMemAccMPhysicalStartAddress = 0
        vMemAccMvMemFuncPtrTableSymbol = vMem_30_Blocking_FunctionPointerTable
        vMemAccMUseEraseBurst = false
        vMemAccMUseWriteBurst = false
        vMemAccMSectorRef = vMemSector_BlockFee
