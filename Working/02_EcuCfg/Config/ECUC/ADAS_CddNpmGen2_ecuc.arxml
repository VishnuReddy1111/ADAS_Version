AUTOSAR XML (schema 4-3-0)
package /ActiveEcuC
  module config CddNpmGen2: implementation-config-variant=VARIANT-PRE-COMPILE, module-description=CddNpmGen2_Impl
    CddNpmGen2General: CddNpmGen2MainFunctionPeriod=0.1, CddNpmGen2DevErrorDetect=true, CddNpmGen2VersionInfoApi=false, CddNpmGen2InstanceId=0
    CddNpmGen2Configuration
      CddNpmGen2SignalConfiguration:
        CddNpmGen2ComSignalSupport = true
        CddNpmGen2ComSignalBusKnockOutStatus = KN_Hybrid_01_BusKnockOut_XIX_KN_Hybrid_01_XIX_HCP5_CANFD01_b162d19d_Tx
        CddNpmGen2ComSignalBusKnockOutTimer = KN_Hybrid_01_BusKnockOutTimer_XIX_KN_Hybrid_01_XIX_HCP5_CANFD01_e5089bb3_Tx
        CddNpmGen2ComSignalEcuKnockOutStatus = KN_Hybrid_01_ECUKnockOut_XIX_KN_Hybrid_01_XIX_HCP5_CANFD01_dd88c4a5_Tx
        CddNpmGen2ComSignalEcuKnockOutTimer = KN_Hybrid_01_ECUKnockOutTimer_XIX_KN_Hybrid_01_XIX_HCP5_CANFD01_7ea3be84_Tx
      CddNpmGen2DiagnosticSupportHandling: CddNpmGen2DiagnosticSupport=true, CddNpmGen2KnockOutTest=true, CddNpmGen2NvMMaxWriteDIDTimer=0.5
      CddNpmGen2BusKnockoutHandling: CddNpmGen2BusKnockOut=true, CddNpmGen2BusKnockOutVeto=true, CddNpmGen2NVEM=false, CddNpmGen2BusKnockOutTimer=15
      CddNpmGen2EcuKnockoutHandling: CddNpmGen2EcuKnockOut=true, CddNpmGen2EcuKnockOutVeto=true, CddNpmGen2EcuKnockOutTimer=1
      CddNpmGen2NvmHandling: CddNpmGen2NvmBlockDescriptor=CddNpmGen2_MeasurementsType
      CN_HCP5_CANFD01_54d90215 (CddNpmGen2Channel): CddNpmGen2KnockOutMonitoring=true, CddNpmGen2NetworkHandle=CN_HCP5_CANFD01_54d90215
      CN_BMC_CAN01_78a85e89 (CddNpmGen2Channel): CddNpmGen2KnockOutMonitoring=false, CddNpmGen2NetworkHandle=CN_BMC_CAN01_78a85e89
