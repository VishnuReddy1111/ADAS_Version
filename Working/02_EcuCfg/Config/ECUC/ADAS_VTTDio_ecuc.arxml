AUTOSAR XML (schema 00048)
package /ActiveEcuC
  module config VTTDio: implementation-config-variant=VARIANT-PRE-COMPILE, module-description=VTTDio_Impl
    DioGeneral: DioDevErrorDetect=true, DioFlipChannelApi=false, DioVersionInfoApi=true, DioSafeBswChecks=false
    DioConfig
      3 x DioPort:
        DioPort_LinDioEn: DioPortId=0
        DioPort_LinDioRx: DioPortId=1
        DioPort_LinDioTx: DioPortId=2
