AUTOSAR XML (schema 4-3-0)
package /ActiveEcuC
  module config Csm: implementation-config-variant=VARIANT-PRE-COMPILE, module-description=Csm_Impl
    4 x CsmPrimitives:
      StartApplication_CsmPrimitives_AES_Decrypt
        CsmDecrypt
          StartApplication_CsmPrimitives_AES_Decrypt (CsmDecryptConfig):
            CsmDecryptAlgorithmFamiliy = CRYPTO_ALGOFAM_AES
            CsmDecryptAlgorithmFamily = CRYPTO_ALGOFAM_AES
            CsmDecryptAlgorithmKeyLength = 16
            CsmDecryptAlgorithmMode = CRYPTO_ALGOMODE_ECB
            CsmDecryptAlgorithmSecondaryFamily = CRYPTO_ALGOFAM_NOT_SET
            CsmDecryptProcessing = CSM_SYNCHRONOUS
      StartApplication_CsmPrimitives_AES_Encrypt
        CsmEncrypt
          StartApplication_CsmPrimitives_AES_Encrypt (CsmEncryptConfig):
            CsmEncryptAlgorithmFamiliy = CRYPTO_ALGOFAM_AES
            CsmEncryptAlgorithmFamily = CRYPTO_ALGOFAM_AES
            CsmEncryptAlgorithmMode = CRYPTO_ALGOMODE_ECB
            CsmEncryptAlgorithmSecondaryFamily = CRYPTO_ALGOFAM_NOT_SET
            CsmEncryptProcessing = CSM_SYNCHRONOUS
            CsmEncryptAlgorithmKeyLength = 16
      StartApplication_CsmPrimitives_MAC_Generate
        CsmMacGenerate
          StartApplication_CsmPrimitives_MAC_Generate (CsmMacGenerateConfig):
            CsmMacGenerateAlgorithmFamiliy = CRYPTO_ALGOFAM_AES
            CsmMacGenerateAlgorithmFamily = CRYPTO_ALGOFAM_AES
            CsmMacGenerateAlgorithmKeyLength = 16
            CsmMacGenerateAlgorithmMode = CRYPTO_ALGOMODE_CMAC
            CsmMacGenerateAlgorithmSecondaryFamily = CRYPTO_ALGOFAM_NOT_SET
            CsmMacGenerateProcessing = CSM_SYNCHRONOUS
            CsmMacGenerateResultLength = 8
            CsmMacGenerateSwcInterfaceVersion = CSM_ASR_VERSION_4_03
      StartApplication_CsmPrimitives_MAC_Verify
        CsmMacVerify
          StartApplication_CsmPrimitives_MAC_Verify (CsmMacVerifyConfig):
            CsmMacVerifyAlgorithmFamiliy = CRYPTO_ALGOFAM_AES
            CsmMacVerifyAlgorithmFamily = CRYPTO_ALGOFAM_AES
            CsmMacVerifyAlgorithmSecondaryFamily = CRYPTO_ALGOFAM_NOT_SET
            CsmMacVerifyCompareLength = 8
            CsmMacVerifyProcessing = CSM_SYNCHRONOUS
            CsmMacVerifyAlgorithmMode = CRYPTO_ALGOMODE_CMAC
            CsmMacVerifyAlgorithmKeyLength = 16
            CsmMacVerifySwcInterfaceVersion = CSM_ASR_VERSION_4_03
    CsmGeneral:
      CsmAsymPublicKeyMaxLength = 1024
      CsmDevErrorDetect = true
      CsmMainFunctionPeriod = 0.002
      CsmSymKeyMaxLength = 16
      CsmUseDeprecated = false
      CsmVersionInfoApi = true
      CsmAsymPrivateKeyMaxLength = 32
      CsmCallbackStartNotification = false
      CsmCustomIncludeFiles = Crypto_30_LibCv_Custom.h
      CsmCancelationDuringProcessing = false
      CsmSafeBswChecks = false
      CsmJobTypeLayout:
        CsmJobTypeLayoutAsr430Compatibility = true
        CsmJobTypeLayoutVarMembers = false
        CsmJobTypeLayoutInput64 = false
        CsmJobTypeLayoutOutput64Ptr = false
        CsmJobTypeLayoutRedirectionInfoRef = true
    CsmJobs
      29 x CsmJob, all with CsmProcessingMode=CRYPTO_PROCESSING_SYNC:
        StartApplication_ECB_AES_Decrypt: CsmJobId=25, CsmJobPriority=0, CsmJobUsePort=true, CsmJobInterfaceUsePort=CRYPTO_USE_PORT, CsmJobKeyRef=StartApplication_CsmKey_Dec, CsmJobPrimitiveRef=Csm/StartApplication_CsmPrimitives_AES_Decrypt, CsmJobQueueRef=StartApplication_CsmQueue
        StartApplication_ECB_AES_Encrypt: CsmJobId=26, CsmJobPriority=0, CsmJobUsePort=true, CsmJobInterfaceUsePort=CRYPTO_USE_PORT, CsmJobKeyRef=StartApplication_CsmKey_Enc, CsmJobPrimitiveRef=Csm/StartApplication_CsmPrimitives_AES_Encrypt, CsmJobQueueRef=StartApplication_CsmQueue
        StartApplication_MAC_Generate: CsmJobId=27, CsmJobPriority=0, CsmJobUsePort=true, CsmJobInterfaceUsePort=CRYPTO_USE_PORT, CsmJobKeyRef=StartApplication_CsmKey_MAC, CsmJobPrimitiveRef=Csm/StartApplication_CsmPrimitives_MAC_Generate, CsmJobQueueRef=StartApplication_CsmQueue
        StartApplication_MAC_Verify: CsmJobId=28, CsmJobPriority=0, CsmJobUsePort=true, CsmJobInterfaceUsePort=CRYPTO_USE_PORT, CsmJobKeyRef=StartApplication_CsmKey_MAC, CsmJobPrimitiveRef=Csm/StartApplication_CsmPrimitives_MAC_Verify, CsmJobQueueRef=StartApplication_CsmQueue
        StartApplication_CsmJobVerify: CsmJobId=24, CsmJobPriority=1, CsmJobUsePort=false, CsmJobInterfaceUsePort=CRYPTO_USE_FNC, CsmJobKeyRef=StartApplication_CsmKey, CsmJobPrimitiveRef=Csm/StartApplication_CsmPrimitivesVerify, CsmJobQueueRef=StartApplication_CsmQueue
        StartApplication_CsmJobGenerate: CsmJobId=23, CsmJobPriority=1, CsmJobUsePort=false, CsmJobInterfaceUsePort=CRYPTO_USE_FNC, CsmJobKeyRef=StartApplication_CsmKey, CsmJobPrimitiveRef=Csm/StartApplication_CsmPrimitivesGenerate, CsmJobQueueRef=StartApplication_CsmQueue
        CsmJobSha256: CsmJobId=0, CsmJobPriority=0, CsmJobUsePort=false, CsmJobInterfaceUsePort=CRYPTO_USE_FNC, CsmJobKeyRef=CsmKey_CryIf_SccContractKeyPair, CsmJobPrimitiveRef=Csm/CsmPrimitiveHash, CsmJobQueueRef=CsmQueueXmlSecurity
        CsmJob_SccAES: CsmJobId=1, CsmJobPriority=0, CsmJobUsePort=false, CsmJobInterfaceUsePort=CRYPTO_USE_FNC, CsmJobKeyRef=CsmKey_SccAesKey, CsmJobPrimitiveRef=Csm/CsmPrimitiveDecrypt, CsmJobQueueRef=CsmQueue, CsmInOutRedirectionRef=CsmInOutRedirectionDecryptAES
        CsmJob_SccECDSAContractSign: CsmJobPriority=0, CsmJobId=3, CsmJobUsePort=false, CsmJobInterfaceUsePort=CRYPTO_USE_FNC, CsmJobPrimitiveRef=Csm/CsmPrimitiveEcdsaGen, CsmJobQueueRef=CsmQueueXmlSecurity, CsmJobKeyRef=CsmKey_Crypto_SccContractPrivKey
        CsmJob_SccECDSAProvSign: CsmJobPriority=0, CsmJobId=4, CsmJobUsePort=false, CsmJobInterfaceUsePort=CRYPTO_USE_FNC, CsmJobPrimitiveRef=Csm/CsmPrimitiveEcdsaGen, CsmJobQueueRef=CsmQueueXmlSecurity, CsmJobKeyRef=CsmKey_Crypto_SccProvisioningPrivKey
        CsmJob_SccECDSAVerify: CsmJobPriority=0, CsmJobId=5, CsmJobUsePort=false, CsmJobInterfaceUsePort=CRYPTO_USE_FNC, CsmJobPrimitiveRef=Csm/CsmPrimitiveEcdsaVer, CsmJobQueueRef=CsmQueueXmlSecurity, CsmJobKeyRef=CsmKey_CryIf_SccPublicKey
        CsmJob_SccKdfSHA256: CsmJobId=7, CsmJobPriority=0, CsmJobUsePort=false, CsmJobInterfaceUsePort=CRYPTO_USE_FNC, CsmJobKeyRef=CsmKey_SccKdfSHA256, CsmJobPrimitiveRef=Csm/CsmPrimitiveHash, CsmJobQueueRef=CsmQueue, CsmInOutRedirectionRef=CsmInOutRedirectionKdfSHA256
        CsmJob_Scc_ECDH_Exchange: CsmJobId=8, CsmJobPriority=0, CsmJobUsePort=false, CsmJobInterfaceUsePort=CRYPTO_USE_FNC, CsmJobKeyRef=CsmKey_SccEcdhExchange, CsmJobPrimitiveRef=Csm/CsmPrimitivesExchangeCalcSecret, CsmJobQueueRef=CsmQueue_Scc
        CsmJob_Tls_Conn0_Aes128Cbc_Decrypt: CsmJobId=9, CsmJobPriority=0, CsmJobUsePort=false, CsmJobInterfaceUsePort=CRYPTO_USE_FNC, CsmJobKeyRef=CsmKey_Tls_Conn0_Aes128Cbc_Decrypt, CsmJobPrimitiveRef=Csm/CsmPrimitives_Tls_Aes128Cbc_Decrypt, CsmJobQueueRef=CsmQueue_Tls_Conn0
        CsmJob_Tls_Conn0_Aes128Cbc_Encrypt: CsmJobId=10, CsmJobPriority=0, CsmJobUsePort=false, CsmJobInterfaceUsePort=CRYPTO_USE_FNC, CsmJobKeyRef=CsmKey_Tls_Conn0_Aes128Cbc_Encrypt, CsmJobPrimitiveRef=Csm/CsmPrimitives_Tls_Aes128Cbc_Encrypt, CsmJobQueueRef=CsmQueue_Tls_Conn0
        CsmJob_Tls_Conn0_CertVerify_EccNistP256R1Sha1: CsmJobId=11, CsmJobPriority=0, CsmJobUsePort=false, CsmJobInterfaceUsePort=CRYPTO_USE_FNC, CsmJobKeyRef=CsmKey_Tls_Conn0_CertVerify_PubKey, CsmJobPrimitiveRef=Csm/CsmPrimitives_Tls_CertVerify_EccNistP256R1Sha1, CsmJobQueueRef=CsmQueue_Tls_Conn0
        CsmJob_Tls_Conn0_CertVerify_EccNistP256R1Sha256: CsmJobId=12, CsmJobPriority=0, CsmJobUsePort=false, CsmJobInterfaceUsePort=CRYPTO_USE_FNC, CsmJobKeyRef=CsmKey_Tls_Conn0_CertVerify_PubKey, CsmJobPrimitiveRef=Csm/CsmPrimitives_Tls_CertVerify_EccNistP256R1Sha256, CsmJobQueueRef=CsmQueue_Tls_Conn0
        CsmJob_Tls_Conn0_HMacSha1_Generate: CsmJobId=13, CsmJobPriority=0, CsmJobUsePort=false, CsmJobInterfaceUsePort=CRYPTO_USE_FNC, CsmJobKeyRef=CsmKey_Tls_Conn0_HMacShaX_Generate, CsmJobPrimitiveRef=Csm/CsmPrimitives_Tls_HMac_Sha1_Generate, CsmJobQueueRef=CsmQueue_Tls_Conn0
        CsmJob_Tls_Conn0_HMacSha256_Generate: CsmJobId=15, CsmJobPriority=0, CsmJobUsePort=false, CsmJobInterfaceUsePort=CRYPTO_USE_FNC, CsmJobKeyRef=CsmKey_Tls_Conn0_HMacShaX_Generate, CsmJobPrimitiveRef=Csm/CsmPrimitives_Tls_HMac_Sha256_Generate, CsmJobQueueRef=CsmQueue_Tls_Conn0
        CsmJob_Tls_Conn0_HMacSha1_Verify: CsmJobId=14, CsmJobPriority=0, CsmJobUsePort=false, CsmJobInterfaceUsePort=CRYPTO_USE_FNC, CsmJobKeyRef=CsmKey_Tls_Conn0_HMacShaX_Verify, CsmJobPrimitiveRef=Csm/CsmPrimitives_Tls_HMac_Sha1_Verify, CsmJobQueueRef=CsmQueue_Tls_Conn0
        CsmJob_Tls_Conn0_HMacSha256_Verify: CsmJobId=16, CsmJobPriority=0, CsmJobUsePort=false, CsmJobInterfaceUsePort=CRYPTO_USE_FNC, CsmJobKeyRef=CsmKey_Tls_Conn0_HMacShaX_Verify, CsmJobPrimitiveRef=Csm/CsmPrimitives_Tls_HMac_Sha256_Verify, CsmJobQueueRef=CsmQueue_Tls_Conn0
        CsmJob_Tls_Conn0_Prf_HMacGenerate_Private: CsmJobId=20, CsmJobPriority=0, CsmJobUsePort=false, CsmJobInterfaceUsePort=CRYPTO_USE_FNC, CsmJobKeyRef=CsmKey_Tls_Conn0_Prf_Secret, CsmJobPrimitiveRef=Csm/CsmPrimitives_Tls_HMac_Sha256_Generate, CsmJobQueueRef=CsmQueue_Tls_Conn0, CsmInOutRedirectionRef=CsmInOutRedirection_PrfPrivate
        CsmJob_Tls_Conn0_Prf_HMacGenerate_Public: CsmJobId=21, CsmJobPriority=0, CsmJobUsePort=false, CsmJobInterfaceUsePort=CRYPTO_USE_FNC, CsmJobKeyRef=CsmKey_Tls_Conn0_Prf_Secret, CsmJobPrimitiveRef=Csm/CsmPrimitives_Tls_HMac_Sha256_Generate, CsmJobQueueRef=CsmQueue_Tls_Conn0, CsmInOutRedirectionRef=CsmInOutRedirection_PrfPublic
        CsmJob_Tls_Conn0_HS_RandomNumber: CsmJobId=17, CsmJobPriority=0, CsmJobUsePort=false, CsmJobInterfaceUsePort=CRYPTO_USE_FNC, CsmJobKeyRef=CsmKey_Tls_Conn0_HS_RandomNumber, CsmJobPrimitiveRef=Csm/CsmPrimitives_Tls_RandomNumber, CsmJobQueueRef=CsmQueue_Tls_Conn0
        CsmJob_Tls_Conn0_HashSha256_ToClientFinished: CsmJobId=18, CsmJobPriority=0, CsmJobUsePort=false, CsmJobInterfaceUsePort=CRYPTO_USE_FNC, CsmJobKeyRef=CsmKey_Tls_Conn0_HS_HashSha256_ToClientFinished, CsmJobPrimitiveRef=Csm/CsmPrimitives_Tls_HashSha256, CsmJobQueueRef=CsmQueue_Tls_Conn0_HS_HashSha256_ToClientFinished
        CsmJob_Tls_Conn0_HashSha256_ToServerFinished: CsmJobId=19, CsmJobPriority=0, CsmJobUsePort=false, CsmJobInterfaceUsePort=CRYPTO_USE_FNC, CsmJobKeyRef=CsmKey_Tls_Conn0_HS_HashSha256_ToServerFinished, CsmJobPrimitiveRef=Csm/CsmPrimitives_Tls_HashSha256, CsmJobQueueRef=CsmQueue_Tls_Conn0_HS_HashSha256_ToServerFinished
        CsmJob_Tls_Global_HashSha1: CsmJobId=22, CsmJobPriority=0, CsmJobUsePort=false, CsmJobInterfaceUsePort=CRYPTO_USE_FNC, CsmJobKeyRef=CsmKey_Tls_Global_HashSha1, CsmJobPrimitiveRef=Csm/CsmPrimitives_Tls_HashSha1, CsmJobQueueRef=CsmQueue_Tls_Global_HashSha1
        CsmJob_SccExchangeCalcSecret: CsmJobId=6, CsmJobPriority=0, CsmJobUsePort=false, CsmJobInterfaceUsePort=CRYPTO_USE_FNC, CsmJobKeyRef=CsmKey_SccEcdhExchange, CsmJobPrimitiveRef=Csm/CsmPrimitivesExchangeCalcSecret, CsmJobQueueRef=CsmQueue_Scc
        CsmJob_SccCertificateUpdateVer: CsmJobId=2, CsmJobPriority=0, CsmJobUsePort=false, CsmJobInterfaceUsePort=CRYPTO_USE_FNC, CsmJobKeyRef=CsmKey_Crypto_SccContractPrivKeyTemp, CsmJobPrimitiveRef=Csm/CsmPrimitiveEcdsaGen, CsmJobQueueRef=CsmQueue_Scc
    CsmKeys
      33 x CsmKey:
        StartApplication_CsmKey_Dec: CsmKeyId=30, CsmKeyUsePort=true, CsmKeySwcInterfaceVersion=CSM_ASR_VERSION_4_03, CsmKeyRef=StartApplication_CryIfKey_Dec
        StartApplication_CsmKey_Enc: CsmKeyId=31, CsmKeyUsePort=true, CsmKeySwcInterfaceVersion=CSM_ASR_VERSION_4_03, CsmKeyRef=StartApplication_CryIfKey_Enc
        StartApplication_CsmKey_MAC: CsmKeyId=32, CsmKeyUsePort=true, CsmKeySwcInterfaceVersion=CSM_ASR_VERSION_4_03, CsmKeyRef=StartApplication_CryIfKey_MAC
        StartApplication_CsmKey: CsmKeyId=29, CsmKeyUsePort=true, CsmKeySwcInterfaceVersion=CSM_ASR_VERSION_4_03, CsmKeyRef=StartApplication_CryIfKey
        CsmKey_CryIf_SccContractKeyPair: CsmKeyId=0, CsmKeyUsePort=false, CsmKeyRef=CryIf_SccContractKeyPair
        CsmKey_CryIf_SccProvisioningKeyPair: CsmKeyId=1, CsmKeyUsePort=false, CsmKeyRef=CryIf_SccProvisioningKeyPair
        CsmKey_CryIf_SccPublicKey: CsmKeyId=2, CsmKeyUsePort=false, CsmKeyRef=CryIf_SccPublicKey
        CsmKey_Crypto_SccContractPrivKey: CsmKeyId=3, CsmKeyUsePort=false, CsmKeyRef=CryIfKey_Crypto_SccContractPrivKey
        CsmKey_Crypto_SccProvisioningPrivKey: CsmKeyId=5, CsmKeyUsePort=false, CsmKeyRef=CryIfKey_Crypto_SccProvisioningPrivKey
        CsmKey_SccAesKey: CsmKeyId=6, CsmKeyUsePort=false, CsmKeySwcInterfaceVersion=CSM_ASR_VERSION_4_03, CsmKeyRef=CryIf_SccAesKey
        CsmKey_SccEcdhExchange: CsmKeyId=7, CsmKeyUsePort=false, CsmKeySwcInterfaceVersion=CSM_ASR_VERSION_4_03, CsmKeyRef=CryIf_SccEcdhExchange
        CsmKey_SccKdfSHA256: CsmKeyId=8, CsmKeyUsePort=false, CsmKeySwcInterfaceVersion=CSM_ASR_VERSION_4_03, CsmKeyRef=CryIf_SccKdfSHA256Key
        CsmKey_Tls_Conn0_Aes128Cbc_Encrypt: CsmKeyId=13, CsmKeyUsePort=false, CsmKeyRef=CryIfKey_Tls_Conn0_Aes128Cbc_Encrypt
        CsmKey_Tls_Conn0_Prf_ResultPrivate: CsmKeyId=24, CsmKeyUsePort=false, CsmKeyRef=CryIfKey_Tls_Conn0_Prf_ResultPrivate
        CsmKey_Tls_Global_HashSha1: CsmKeyId=28, CsmKeyUsePort=false, CsmKeyRef=CryIfKey_Tls_Global_HashSha1
        CsmKey_Tls_Conn0_HS_HashSha256_ToServerFinished: CsmKeyId=18, CsmKeyUsePort=false, CsmKeyRef=CryIfKey_Tls_Conn0_HS_HashSha256_ToServerFinished
        CsmKey_Tls_Conn0_PreMasterSecretInfo: CsmKeyId=21, CsmKeyUsePort=false, CsmKeyRef=CryIfKey_Tls_Conn0_PreMasterSecretInfo
        CsmKey_Tls_Conn0_HMacShaX_Generate: CsmKeyId=15, CsmKeyUsePort=false, CsmKeyRef=CryIfKey_Tls_Conn0_HMacShaX_Generate
        CsmKey_Tls_Conn0_Aes128Cbc_Decrypt: CsmKeyId=12, CsmKeyUsePort=false, CsmKeyRef=CryIfKey_Tls_Conn0_Aes128Cbc_Decrypt
        CsmKey_Tls_Conn0_HMacShaX_Verify: CsmKeyId=16, CsmKeyUsePort=false, CsmKeyRef=CryIfKey_Tls_Conn0_HMacShaX_Verify
        CsmKey_Tls_Conn0_Prf_ResultPublic: CsmKeyId=25, CsmKeyUsePort=false, CsmKeyRef=CryIfKey_Tls_Conn0_Prf_ResultPublic
        CsmKey_Tls_Conn0_MasterSecret: CsmKeyId=20, CsmKeyUsePort=false, CsmKeyRef=CryIfKey_Tls_Conn0_MasterSecret
        CsmKey_Tls_Conn0_HS_RandomNumber: CsmKeyId=19, CsmKeyUsePort=false, CsmKeyRef=CryIfKey_Tls_Conn0_HS_RandomNumber
        CsmKey_Tls_Conn0_Prf_Secret: CsmKeyId=26, CsmKeyUsePort=false, CsmKeyRef=CryIfKey_Tls_Conn0_Prf_Secret
        CsmKey_Tls_Conn0_PrfCalculationValuesPublic: CsmKeyId=23, CsmKeyUsePort=false, CsmKeyRef=CryIfKey_Tls_Conn0_PrfCalculationValuesPublic
        CsmKey_Tls_Conn0_TmpBuffer: CsmKeyId=27, CsmKeyUsePort=false, CsmKeyRef=CryIfKey_Tls_Conn0_TmpBuffer
        CsmKey_Tls_Conn0_PrfCalculationValuesPrivate: CsmKeyId=22, CsmKeyUsePort=false, CsmKeyRef=CryIfKey_Tls_Conn0_PrfCalculationValuesPrivate
        CsmKey_Tls_Conn0_CertVerify_PubKey: CsmKeyId=14, CsmKeyUsePort=false, CsmKeyRef=CryIfKey_Tls_Conn0_CertVerify_PubKey
        CsmKey_Tls_Conn0_HS_HashSha256_ToClientFinished: CsmKeyId=17, CsmKeyUsePort=false, CsmKeyRef=CryIfKey_Tls_Conn0_HS_HashSha256_ToClientFinished
        CsmKey_Crypto_SccContractPrivKeyTemp: CsmKeyId=4, CsmKeyUsePort=false, CsmKeyRef=CryIfKey_Crypto_SccContractPrivKeyTemp
        CsmKey_StartApplication_Dec: CsmKeyId=9, CsmKeyUsePort=false, CsmKeyRef=CryIfKey_StartApplication_Dec
        CsmKey_StartApplication_Enc: CsmKeyId=10, CsmKeyUsePort=false, CsmKeyRef=CryIfKey_StartApplication_Enc
        CsmKey_StartApplication_MAC: CsmKeyId=11, CsmKeyUsePort=false, CsmKeyRef=CryIfKey_StartApplication_MAC
    CsmQueues
      8 x CsmQueue, all with CsmQueueSize=1, CsmTriggerAsynchJobsInCallback=false, CsmJobSharing=true:
        StartApplication_CsmQueue: CsmChannelRef=StartApplication_CryIfChannel
        CsmQueue: CsmChannelRef=CryIfChannel
        CsmQueueXmlSecurity: CsmChannelRef=CryIfChannel
        CsmQueue_Scc: CsmChannelRef=CryIfChannel_Scc
        CsmQueue_Tls_Global_HashSha1: CsmChannelRef=CryIfChannel_Tls_Global_HashSha1
        CsmQueue_Tls_Conn0_HS_HashSha256_ToClientFinished: CsmChannelRef=CryIfChannel_Tls_Conn0_HS_HashSha256_ToClientFinished
        CsmQueue_Tls_Conn0_HS_HashSha256_ToServerFinished: CsmChannelRef=CryIfChannel_Tls_Conn0_HS_HashSha256_ToServerFinished
        CsmQueue_Tls_Conn0: CsmChannelRef=CryIfChannel_Tls_Conn0
    StartApplication_CsmPrimitivesVerify (CsmPrimitives)
      StartApplication_CsmMacVerify (CsmMacVerify)
        StartApplication_CsmPrimitivesVerify (CsmMacVerifyConfig):
          CsmMacVerifyAlgorithmFamiliy = CRYPTO_ALGOFAM_AES
          CsmMacVerifyAlgorithmFamily = CRYPTO_ALGOFAM_AES
          CsmMacVerifyAlgorithmSecondaryFamily = CRYPTO_ALGOFAM_NOT_SET
          CsmMacVerifyCompareLength = 16
          CsmMacVerifyProcessing = CSM_SYNCHRONOUS
          CsmMacVerifyAlgorithmMode = CRYPTO_ALGOMODE_CMAC
          CsmMacVerifyDataMaxLength = 48
          CsmMacVerifySwcInterfaceVersion = CSM_ASR_VERSION_4_03
          CsmMacVerifyAlgorithmKeyLength = 16
    StartApplication_CsmPrimitivesGenerate (CsmPrimitives)
      StartApplication_CsmMacGenerate (CsmMacGenerate)
        StartApplication_CsmPrimitivesGenerate (CsmMacGenerateConfig):
          CsmMacGenerateAlgorithmFamiliy = CRYPTO_ALGOFAM_AES
          CsmMacGenerateAlgorithmFamily = CRYPTO_ALGOFAM_AES
          CsmMacGenerateAlgorithmKeyLength = 16
          CsmMacGenerateAlgorithmMode = CRYPTO_ALGOMODE_CMAC
          CsmMacGenerateAlgorithmSecondaryFamily = CRYPTO_ALGOFAM_NOT_SET
          CsmMacGenerateProcessing = CSM_SYNCHRONOUS
          CsmMacGenerateResultLength = 16
          CsmMacGenerateSwcInterfaceVersion = CSM_ASR_VERSION_4_03
    CsmInOutRedirections
      4 x CsmInOutRedirection:
        CsmInOutRedirectionKdfSHA256: CsmInputKeyElementId=13, CsmOutputKeyElementId=13, CsmInputKeyRef=CsmKey_SccKdfSHA256, CsmOutputKeyRef=CsmKey_SccAesKey
        CsmInOutRedirectionDecryptAES: CsmOutputKeyElementId=7, CsmOutputKeyRef=CsmKey_SccAesKey
        CsmInOutRedirection_PrfPrivate: CsmInputKeyElementId=3080, CsmOutputKeyElementId=3081, CsmInputKeyRef=CsmKey_Tls_Conn0_PrfCalculationValuesPrivate, CsmOutputKeyRef=CsmKey_Tls_Conn0_PrfCalculationValuesPrivate
        CsmInOutRedirection_PrfPublic: CsmInputKeyElementId=3080, CsmOutputKeyElementId=3081, CsmInputKeyRef=CsmKey_Tls_Conn0_PrfCalculationValuesPublic, CsmOutputKeyRef=CsmKey_Tls_Conn0_PrfCalculationValuesPublic
    16 x CsmPrimitives:
      CsmPrimitiveDecrypt
        CsmDecrypt
          CsmPrimitiveDecrypt (CsmDecryptConfig):
            CsmDecryptAlgorithmFamiliy = CRYPTO_ALGOFAM_AES
            CsmDecryptAlgorithmFamily = CRYPTO_ALGOFAM_AES
            CsmDecryptAlgorithmKeyLength = 16
            CsmDecryptAlgorithmMode = CRYPTO_ALGOMODE_CBC
            CsmDecryptAlgorithmSecondaryFamily = CRYPTO_ALGOFAM_CUSTOM
            CsmDecryptProcessing = CSM_SYNCHRONOUS
            CsmDecryptAlgorithmSecondaryFamilyCustom = CRYPTO_ALGOFAM_PADDING_ONEWITHZEROS
            CsmDecryptSwcInterfaceVersion = CSM_ASR_VERSION_4_03
      CsmPrimitiveEcdsaGen
        CsmSignatureGenerate
          CsmPrimitiveEcdsaGen (CsmSignatureGenerateConfig):
            CsmSignatureGenerateAlgorithmFamiliy = CRYPTO_ALGOFAM_ECCNIST
            CsmSignatureGenerateAlgorithmFamily = CRYPTO_ALGOFAM_ECCNIST
            CsmSignatureGenerateAlgorithmMode = CRYPTO_ALGOMODE_CUSTOM
            CsmSignatureGenerateAlgorithmSecondaryFamily = CRYPTO_ALGOFAM_SHA2_256
            CsmSignatureGenerateKeyLength = 32
            CsmSignatureGenerateProcessing = CSM_SYNCHRONOUS
            CsmSignatureGenerateResultLength = 64
            CsmSignatureGenerateAlgorithmModeCustom = CRYPTO_ALGOMODE_CUSTOM_P256R1
            CsmSignatureGenerateSwcInterfaceVersion = CSM_ASR_VERSION_4_03
      CsmPrimitiveEcdsaVer
        CsmSignatureVerify
          CsmPrimitiveEcdsaVer (CsmSignatureVerifyConfig):
            CsmSignatureVerifyAlgorithmFamiliy = CRYPTO_ALGOFAM_ECCNIST
            CsmSignatureVerifyAlgorithmFamily = CRYPTO_ALGOFAM_ECCNIST
            CsmSignatureVerifyAlgorithmMode = CRYPTO_ALGOMODE_CUSTOM
            CsmSignatureVerifyAlgorithmSecondaryFamily = CRYPTO_ALGOFAM_SHA2_256
            CsmSignatureVerifyCompareLength = 64
            CsmSignatureVerifyProcessing = CSM_SYNCHRONOUS
            CsmSignatureVerifyAlgorithmModeCustom = CRYPTO_ALGOMODE_CUSTOM_P256R1
            CsmSignatureVerifySwcInterfaceVersion = CSM_ASR_VERSION_4_03
            CsmSignatureVerifyKeyLength = 32
      CsmPrimitiveHash
        CsmHash
          CsmPrimitiveHash (CsmHashConfig):
            CsmHashAlgorithmFamiliy = CRYPTO_ALGOFAM_SHA2_256
            CsmHashAlgorithmFamily = CRYPTO_ALGOFAM_SHA2_256
            CsmHashAlgorithmMode = CRYPTO_ALGOMODE_NOT_SET
            CsmHashAlgorithmSecondaryFamily = CRYPTO_ALGOFAM_NOT_SET
            CsmHashProcessing = CSM_SYNCHRONOUS
            CsmHashResultLength = 32
            CsmHashSwcInterfaceVersion = CSM_ASR_VERSION_4_03
      CsmPrimitivesExchangeCalcSecret
        CsmJobKeyExchangeCalcSecret
          CsmPrimitivesExchangeCalcSecret (CsmJobKeyExchangeCalcSecretConfig):
            CsmJobKeyExchangeCalcSecretAlgorithmFamiliy = CRYPTO_ALGOFAM_CUSTOM
            CsmJobKeyExchangeCalcSecretAlgorithmFamily = CRYPTO_ALGOFAM_CUSTOM
            CsmJobKeyExchangeCalcSecretAlgorithmMode = CRYPTO_ALGOMODE_CUSTOM
            CsmJobKeyExchangeCalcSecretAlgorithmSecondaryFamily = CRYPTO_ALGOFAM_NOT_SET
            CsmJobKeyExchangeCalcSecretAlgorithmFamilyCustom = CRYPTO_ALGOFAM_ECCNIST
            CsmJobKeyExchangeCalcSecretAlgorithmModeCustom = CRYPTO_ALGOMODE_CUSTOM_P256R1
      CsmPrimitives_Tls_CertVerify_EccNistP256R1Sha1
        CsmSignatureVerify
          CsmPrimitives_Tls_CertVerify_EccNistP256R1Sha1 (CsmSignatureVerifyConfig):
            CsmSignatureVerifyAlgorithmFamiliy = CRYPTO_ALGOFAM_ECCNIST
            CsmSignatureVerifyAlgorithmFamily = CRYPTO_ALGOFAM_ECCNIST
            CsmSignatureVerifyAlgorithmMode = CRYPTO_ALGOMODE_CUSTOM
            CsmSignatureVerifyAlgorithmSecondaryFamily = CRYPTO_ALGOFAM_SHA1
            CsmSignatureVerifyCompareLength = 64
            CsmSignatureVerifyProcessing = CSM_SYNCHRONOUS
            CsmSignatureVerifyKeyLength = 32
            CsmSignatureVerifyAlgorithmModeCustom = CRYPTO_ALGOMODE_CUSTOM_P256R1
      CsmPrimitives_Tls_RandomNumber
        CsmRandomGenerate
          CsmPrimitives_Tls_RandomNumber (CsmRandomGenerateConfig):
            CsmRandomGenerateAlgorithmFamiliy = CRYPTO_ALGOFAM_RNG
            CsmRandomGenerateAlgorithmFamily = CRYPTO_ALGOFAM_RNG
            CsmRandomGenerateAlgorithmMode = CRYPTO_ALGOMODE_NOT_SET
            CsmRandomGenerateAlgorithmSecondaryFamily = CRYPTO_ALGOFAM_NOT_SET
            CsmRandomGenerateProcessing = CSM_SYNCHRONOUS
            CsmRandomGenerateResultLength = 46
      CsmPrimitives_Tls_CertVerify_EccNistP256R1Sha256
        CsmSignatureVerify
          CsmPrimitives_Tls_CertVerify_EccNistP256R1Sha256 (CsmSignatureVerifyConfig):
            CsmSignatureVerifyAlgorithmFamiliy = CRYPTO_ALGOFAM_ECCNIST
            CsmSignatureVerifyAlgorithmFamily = CRYPTO_ALGOFAM_ECCNIST
            CsmSignatureVerifyAlgorithmMode = CRYPTO_ALGOMODE_CUSTOM
            CsmSignatureVerifyAlgorithmSecondaryFamily = CRYPTO_ALGOFAM_SHA2_256
            CsmSignatureVerifyCompareLength = 64
            CsmSignatureVerifyProcessing = CSM_SYNCHRONOUS
            CsmSignatureVerifyKeyLength = 32
            CsmSignatureVerifyAlgorithmModeCustom = CRYPTO_ALGOMODE_CUSTOM_P256R1
      CsmPrimitives_Tls_HashSha1
        CsmHash
          CsmPrimitives_Tls_HashSha1 (CsmHashConfig):
            CsmHashAlgorithmFamiliy = CRYPTO_ALGOFAM_SHA1
            CsmHashAlgorithmFamily = CRYPTO_ALGOFAM_SHA1
            CsmHashAlgorithmMode = CRYPTO_ALGOMODE_NOT_SET
            CsmHashAlgorithmSecondaryFamily = CRYPTO_ALGOFAM_NOT_SET
            CsmHashProcessing = CSM_SYNCHRONOUS
            CsmHashResultLength = 20
      CsmPrimitives_Tls_HashSha256
        CsmHash
          CsmPrimitives_Tls_HashSha256 (CsmHashConfig):
            CsmHashAlgorithmFamiliy = CRYPTO_ALGOFAM_SHA2_256
            CsmHashAlgorithmFamily = CRYPTO_ALGOFAM_SHA2_256
            CsmHashAlgorithmMode = CRYPTO_ALGOMODE_NOT_SET
            CsmHashAlgorithmSecondaryFamily = CRYPTO_ALGOFAM_NOT_SET
            CsmHashProcessing = CSM_SYNCHRONOUS
            CsmHashResultLength = 32
      CsmPrimitives_Tls_HMac_Sha1_Verify
        CsmMacVerify
          CsmPrimitives_Tls_HMac_Sha1_Verify (CsmMacVerifyConfig):
            CsmMacVerifyAlgorithmFamiliy = CRYPTO_ALGOFAM_SHA1
            CsmMacVerifyAlgorithmFamily = CRYPTO_ALGOFAM_SHA1
            CsmMacVerifyAlgorithmSecondaryFamily = CRYPTO_ALGOFAM_NOT_SET
            CsmMacVerifyCompareLength = 20
            CsmMacVerifyProcessing = CSM_SYNCHRONOUS
            CsmMacVerifyAlgorithmMode = CRYPTO_ALGOMODE_HMAC
            CsmMacVerifyAlgorithmKeyLength = 16
      CsmPrimitives_Tls_HMac_Sha256_Verify
        CsmMacVerify
          CsmPrimitives_Tls_HMac_Sha256_Verify (CsmMacVerifyConfig):
            CsmMacVerifyAlgorithmFamiliy = CRYPTO_ALGOFAM_SHA2_256
            CsmMacVerifyAlgorithmFamily = CRYPTO_ALGOFAM_SHA2_256
            CsmMacVerifyAlgorithmSecondaryFamily = CRYPTO_ALGOFAM_NOT_SET
            CsmMacVerifyCompareLength = 32
            CsmMacVerifyProcessing = CSM_SYNCHRONOUS
            CsmMacVerifyAlgorithmMode = CRYPTO_ALGOMODE_HMAC
            CsmMacVerifyAlgorithmKeyLength = 16
      CsmPrimitives_Tls_Aes128Cbc_Decrypt
        CsmDecrypt
          CsmPrimitives_Tls_Aes128Cbc_Decrypt (CsmDecryptConfig):
            CsmDecryptAlgorithmFamiliy = CRYPTO_ALGOFAM_AES
            CsmDecryptAlgorithmFamily = CRYPTO_ALGOFAM_AES
            CsmDecryptAlgorithmKeyLength = 16
            CsmDecryptAlgorithmMode = CRYPTO_ALGOMODE_CBC
            CsmDecryptAlgorithmSecondaryFamily = CRYPTO_ALGOFAM_NOT_SET
            CsmDecryptProcessing = CSM_SYNCHRONOUS
      CsmPrimitives_Tls_HMac_Sha1_Generate
        CsmMacGenerate
          CsmPrimitives_Tls_HMac_Sha1_Generate (CsmMacGenerateConfig):
            CsmMacGenerateAlgorithmFamiliy = CRYPTO_ALGOFAM_SHA1
            CsmMacGenerateAlgorithmFamily = CRYPTO_ALGOFAM_SHA1
            CsmMacGenerateAlgorithmKeyLength = 16
            CsmMacGenerateAlgorithmMode = CRYPTO_ALGOMODE_HMAC
            CsmMacGenerateAlgorithmSecondaryFamily = CRYPTO_ALGOFAM_NOT_SET
            CsmMacGenerateProcessing = CSM_SYNCHRONOUS
            CsmMacGenerateResultLength = 20
      CsmPrimitives_Tls_HMac_Sha256_Generate
        CsmMacGenerate
          CsmPrimitives_Tls_HMac_Sha256_Generate (CsmMacGenerateConfig):
            CsmMacGenerateAlgorithmFamiliy = CRYPTO_ALGOFAM_SHA2_256
            CsmMacGenerateAlgorithmFamily = CRYPTO_ALGOFAM_SHA2_256
            CsmMacGenerateAlgorithmKeyLength = 16
            CsmMacGenerateAlgorithmMode = CRYPTO_ALGOMODE_HMAC
            CsmMacGenerateAlgorithmSecondaryFamily = CRYPTO_ALGOFAM_NOT_SET
            CsmMacGenerateProcessing = CSM_SYNCHRONOUS
            CsmMacGenerateResultLength = 32
      CsmPrimitives_Tls_Aes128Cbc_Encrypt
        CsmEncrypt
          CsmPrimitives_Tls_Aes128Cbc_Encrypt (CsmEncryptConfig):
            CsmEncryptAlgorithmFamiliy = CRYPTO_ALGOFAM_AES
            CsmEncryptAlgorithmFamily = CRYPTO_ALGOFAM_AES
            CsmEncryptAlgorithmMode = CRYPTO_ALGOMODE_CBC
            CsmEncryptAlgorithmSecondaryFamily = CRYPTO_ALGOFAM_CUSTOM
            CsmEncryptProcessing = CSM_SYNCHRONOUS
            CsmEncryptAlgorithmKeyLength = 16
            CsmEncryptAlgorithmSecondaryFamilyCustom = CRYPTO_ALGOFAM_CUSTOM_PADDING_PKCS7
