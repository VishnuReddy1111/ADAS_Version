AUTOSAR XML (schema 4-3-0)
package /ActiveEcuC
  module config VTTCan: implementation-config-variant=VARIANT-PRE-COMPILE, module-description=VTTCan_Impl
    CanGeneral:
      CanUseOsInterruptControl = false
      CanChangeBaudrateApi = false
      CanDevErrorDetection = true
      CanHardwareCancellation = false
      CanIdenticalIdCancellation = false
      CanIndex = 0
      CanMainFunctionBusoffPeriod = 0.01
      CanMainFunctionModePeriod = 0.01
      CanMainFunctionWakeupPeriod = 0.01
      CanMultiplexedTransmission = false
      CanSetBaudrateApi = false
      CanTimeoutDuration = 0.01
      CanVersionInfoApi = true
      CanGenericPrecopy = false
      CanHardwareLoopCheck = false
      CanRxFullCANSupport = false
      CanTxFullCANSupport = false
      CanRxBasicCANSupport = true
      CanUseNestedCANInterrupts = false
      CanHardwareCancelByAppl = false
      CanIndividualProcessing = false
      CanGenericConfirmation = false
      CanRxQueue = false
      CanSupportMixedID = true
      CanRxQueueSize = 10
      CanMultipleBasicCANObjects = false
      CanMultipleBasicCANTxObjects = false
      CanHardwareHandleType = UINT8
      CanOptimizeOneController = true
      CanInterruptCategory = CATEGORY2
      CanGetStatus = true
      CanInterruptLock = DRIVER
      CanWakeupSupport = true
      CanRamCheck = None
      CanOverrunNotification = DET
      CanReinitStart = false
      CanGenericPreTransmit = false
      CanFdSupport = FULL
      CanRuntimeMeasurementSupport = true
      CanMaxRxDataLen = 64
      CanMaxTxDataLen = 64
      CanUsePeripheralAccessApi = false
      CanMirrorModeSupport = false
      CanSafeBswChecks = false
      CanSilentModeSupport = false
      CanCheckWakeupCanRetType = false
      CanFdHardwareBufferOptimization = false
      CanGenericConfirmationAPI2 = false
      CanHwTxFifoSupport = false
      CanEnableSecurityEventReporting = false
      CanUserConfigFile = 
      CanMainFunctionRWPeriods: CanMainFunctionReadPeriod=0.01
    CanConfigSet
      CT_CAN_d43e43a4 (CanController):
        CanBusoffProcessing = INTERRUPT
        CanControllerActivation = true
        CanControllerBaseAddress = 0
        CanControllerId = 0
        CanRxProcessing = INTERRUPT
        CanTxProcessing = INTERRUPT
        CanWakeupProcessing = INTERRUPT
        CanWakeupSupport = false
        CanWakeupSourceId = 0
        CanBusName = CT_CAN_d43e43a4
        CanControllerDefaultBaudrate = CT_CAN_d43e43a4/CanControllerBaudrateConfig
        CanFilterMask: CanFilterMaskValue=0, CanFilterCodeValue=0, IsLocked=false
        CanControllerBaudrateConfig:
          CanControllerBaudRate = 250
          CanControllerBaudRateConfigID = 0
          CanControllerPropSeg = 7
          CanControllerSeg1 = 4
          CanControllerSeg2 = 4
          CanControllerSyncJumpWidth = 1
          CanBaudrateClock = 80000
          CanBaudratePrescaler = 20
          CanSamplingMode = OneSample
          CanControllerFdBaudrateConfig:
            CanControllerFdBaudRate = 1000
            CanControllerPropSeg = 7
            CanControllerSeg1 = 4
            CanControllerSeg2 = 4
            CanControllerSyncJumpWidth = 1
            CanControllerTxBitRateSwitch = true
            CanBaudratePrescaler = 5
            CanSamplingMode = OneSample
      8 x CanHardwareObject, all with CanHandleType=BASIC, CanIdValue=0, CanHwProcessing=false, CanMaxDataLen=64, CanFdPaddingValue=0, CanObjectMultiplexedTransmission=false, CanObjectHwFifo=false:
        CN_CAN_fe6ecc87_Tx: CanIdType=STANDARD, CanObjectId=0, CanObjectType=TRANSMIT, CanObjectHwSize=1, CanObjectHwHandle=0, CanControllerRef=CT_CAN_d43e43a4
        CN_CAN_23287e84_Rx: CanIdType=STANDARD, CanObjectId=1, CanObjectType=RECEIVE, CanObjectHwSize=2, CanObjectHwHandle=1, CanControllerRef=CT_CAN_d43e43a4, CanFilterMaskRef=CT_CAN_d43e43a4/CanFilterMask
        CN_BMC_CAN01_e16b4bee_Rx: CanIdType=EXTENDED, CanObjectId=2, CanObjectType=RECEIVE, CanObjectHwSize=5, CanObjectHwHandle=6, CanControllerRef=CT_BMC_CAN01_34f1c2c6, CanFilterMaskRef=CT_BMC_CAN01_34f1c2c6/CanFilterMask_001
        CN_HCP5_CANFD01_c0785467_Rx: CanIdType=STANDARD, CanObjectId=4, CanObjectType=RECEIVE, CanObjectHwSize=5, CanObjectHwHandle=1, CanControllerRef=CT_HCP5_CANFD01_e05ce4e2, CanFilterMaskRef=CT_HCP5_CANFD01_e05ce4e2/CanFilterMask
        CN_BMC_CAN01_d4211d16_Rx: CanIdType=STANDARD, CanObjectId=1, CanObjectType=RECEIVE, CanObjectHwSize=5, CanObjectHwHandle=1, CanControllerRef=CT_BMC_CAN01_34f1c2c6, CanFilterMaskRef=CT_BMC_CAN01_34f1c2c6/CanFilterMask
        CN_HCP5_CANFD01_f532029f_Rx: CanIdType=EXTENDED, CanObjectId=5, CanObjectType=RECEIVE, CanObjectHwSize=5, CanObjectHwHandle=6, CanControllerRef=CT_HCP5_CANFD01_e05ce4e2, CanFilterMaskRef=CT_HCP5_CANFD01_e05ce4e2/CanFilterMask_001
        CN_HCP5_CANFD01_54d90215_Tx: CanIdType=MIXED, CanObjectId=3, CanObjectType=TRANSMIT, CanObjectHwSize=1, CanObjectHwHandle=0, CanControllerRef=CT_HCP5_CANFD01_e05ce4e2
        CN_BMC_CAN01_78a85e89_Tx: CanIdType=MIXED, CanObjectId=0, CanObjectType=TRANSMIT, CanObjectHwSize=1, CanObjectHwHandle=0, CanControllerRef=CT_BMC_CAN01_34f1c2c6
      CT_BMC_CAN01_34f1c2c6 (CanController):
        CanBusoffProcessing = INTERRUPT
        CanControllerActivation = true
        CanControllerBaseAddress = 0
        CanControllerId = 0
        CanRxProcessing = INTERRUPT
        CanTxProcessing = INTERRUPT
        CanWakeupProcessing = INTERRUPT
        CanWakeupSupport = false
        CanWakeupSourceId = 0
        CanBusName = CAN
        CanControllerDefaultBaudrate = CT_BMC_CAN01_34f1c2c6/CanControllerBaudrateConfig
        CanWakeupSourceRef = CN_BMC_CAN01_78a85e89
        CanControllerBaudrateConfig:
          CanControllerBaudRate = 500
          CanControllerBaudRateConfigID = 0
          CanControllerPropSeg = 7
          CanControllerSeg1 = 4
          CanControllerSeg2 = 4
          CanControllerSyncJumpWidth = 1
          CanBaudrateClock = 8000
          CanBaudratePrescaler = 1
          CanSamplingMode = OneSample
        CanFilterMask: CanFilterMaskValue=0, CanFilterCodeValue=0, IsLocked=false
        CanFilterMask_001 (CanFilterMask): CanFilterMaskValue=2147483648, CanFilterCodeValue=0, IsLocked=false
      CT_HCP5_CANFD01_e05ce4e2 (CanController):
        CanBusoffProcessing = INTERRUPT
        CanControllerActivation = true
        CanControllerBaseAddress = 1
        CanControllerId = 1
        CanRxProcessing = INTERRUPT
        CanTxProcessing = INTERRUPT
        CanWakeupProcessing = INTERRUPT
        CanWakeupSupport = false
        CanWakeupSourceId = 0
        CanBusName = CAN123
        CanControllerDefaultBaudrate = CT_HCP5_CANFD01_e05ce4e2/CanControllerBaudrateConfig
        CanWakeupSourceRef = CN_HCP5_CANFD01_54d90215
        CanControllerBaudrateConfig:
          CanControllerBaudRate = 500
          CanControllerBaudRateConfigID = 0
          CanControllerPropSeg = 1
          CanControllerSeg1 = 1
          CanControllerSeg2 = 1
          CanControllerSyncJumpWidth = 1
          CanBaudrateClock = 8000
          CanBaudratePrescaler = 4
          CanSamplingMode = OneSample
          CanControllerFdBaudrateConfig:
            CanControllerFdBaudRate = 2000
            CanControllerPropSeg = 7
            CanControllerSeg1 = 4
            CanControllerSeg2 = 4
            CanControllerSyncJumpWidth = 1
            CanControllerTxBitRateSwitch = true
            CanBaudratePrescaler = 2
            CanSamplingMode = OneSample
        CanFilterMask: CanFilterMaskValue=0, CanFilterCodeValue=0, IsLocked=false
        CanFilterMask_001 (CanFilterMask): CanFilterMaskValue=2147483648, CanFilterCodeValue=0, IsLocked=false
