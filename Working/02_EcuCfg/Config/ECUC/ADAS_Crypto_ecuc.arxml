AUTOSAR XML (schema 4-3-0)
package /ActiveEcuC
  module config Crypto: implementation-config-variant=VARIANT-PRE-COMPILE, module-description=Crypto_Impl
    CryptoDriverObjects
      6 x CryptoDriverObject, all with CryptoDriverObjectQueueSize=1:
        Crypto_30_LibCv: CryptoDriverObjectId=5, CryptoPrimitiveRef=AesCmacGenerate, CryptoPrimitiveRef=AesCmacVerify, CryptoPrimitiveRef=AesDecrypt, CryptoPrimitiveRef=SHA256, CryptoPrimitiveRef=EccNistP256R1GenerateSha256, CryptoPrimitiveRef=EccNistP256R1VerifySha256, CryptoPrimitiveRef=AesEncrypt
        CryptoDriverObject_Scc: CryptoDriverObjectId=0, CryptoPrimitiveRef=EccNistP256R1GenerateSha256, CryptoPrimitiveRef=EccNistP256R1VerifySha256, CryptoPrimitiveRef=SHA256, CryptoPrimitiveRef=EcDsaEd25519Generate, CryptoPrimitiveRef=EcDsaEd25519Verify, CryptoPrimitiveRef=AesDecrypt, CryptoPrimitiveRef=RngDrbgAes128Df, CryptoPrimitiveRef=KeyExchangeCalcSecretNistP256R1
        CryptoDriverObject_Tls_Global_HashSha1: CryptoDriverObjectId=1, CryptoPrimitiveRef=SHA1
        CryptoDriverObject_Tls_Conn0_HS_HashSha256_ToClientFinished: CryptoDriverObjectId=2, CryptoPrimitiveRef=SHA256
        CryptoDriverObject_Tls_Conn0_HS_HashSha256_ToServerFinished: CryptoDriverObjectId=3, CryptoPrimitiveRef=SHA256
        CryptoDriverObject_Tls_Conn0: CryptoDriverObjectId=4, CryptoPrimitiveRef=SHA1, CryptoPrimitiveRef=SHA256, CryptoPrimitiveRef=AesDecrypt, CryptoPrimitiveRef=AesEncrypt, CryptoPrimitiveRef=RngFips186, CryptoPrimitiveRef=EccNistP256R1VerifySha1, CryptoPrimitiveRef=EccNistP256R1VerifySha256, CryptoPrimitiveRef=HmacSha1Generate, CryptoPrimitiveRef=HmacSha1Verify, CryptoPrimitiveRef=HmacSha256Generate, CryptoPrimitiveRef=HmacSha256Verify
    CryptoGeneral:
      CryptoVersionInfoApi = true
      CryptoMainFunctionPeriod = 0.01
      CryptoDevErrorDetect = true
      CryptoSafeBswChecks = false
      CryptoUseVStdLib = true
      CryptoKeyElementDelete = false
      CryptoAlignKeyStorage = false
      CryptoNvMEnableSetRamBlockStatus = false
      CryptoRedirection = true
      CryptoDefaultRandomMaxRetries = 10
      CryptoNumberOfLongTermPrimitiveWorkspace = 0
      CryptoStrictLengthCheckForKeyElementGet = true
      CryptoKeyDerivePrimitives
      CryptoMacPrimitives: CryptoCmacAesRoundkeyReuse=false
      CryptoCipherPrimitives: CryptoEnableAES256=false, CryptoEnableAES192=false
      CryptoKeyExchangePrimitives: CryptoKeyExchangeAlgorithm=CRYPTO_KEY_EXCHANGE_ALGORITHM_SECP256R1
      CryptoKeyGeneratePrimitives: CryptoKeyGenerateMaxLength=32
      CryptoConfigurableCallouts
    CryptoKeyElements
      134 x CryptoKeyElement, all with CryptoKeyElementFormat=CRYPTO_KE_FORMAT_BIN_OCTET, CryptoKeyElementWriteOnce=false:
        StartApplication_CryptoKeyElement_Dec: CryptoKeyElementId=1, CryptoKeyElementSize=16, CryptoKeyElementReadAccess=RA_ALLOWED, CryptoKeyElementAllowPartialAccess=false, CryptoKeyElementPersist=false, CryptoKeyElementWriteAccess=WA_ALLOWED
        StartApplication_CryptoKeyElement_Enc: CryptoKeyElementId=1, CryptoKeyElementSize=16, CryptoKeyElementReadAccess=RA_ALLOWED, CryptoKeyElementAllowPartialAccess=false, CryptoKeyElementPersist=false, CryptoKeyElementWriteAccess=WA_ALLOWED
        StartApplication_CryptoKeyElement_MAC: CryptoKeyElementId=1, CryptoKeyElementSize=16, CryptoKeyElementReadAccess=RA_ALLOWED, CryptoKeyElementAllowPartialAccess=false, CryptoKeyElementPersist=false, CryptoKeyElementWriteAccess=WA_ALLOWED
        Crypto_30_LibCv_Signature_Rsa_ExponentDq: CryptoKeyElementId=3054, CryptoKeyElementSize=16, CryptoKeyElementReadAccess=RA_ALLOWED, CryptoKeyElementAllowPartialAccess=false, CryptoKeyElementPersist=false, CryptoKeyElementWriteAccess=WA_ALLOWED
        Crypto_30_LibCv_KeyGenerate_Seed: CryptoKeyElementId=16, CryptoKeyElementSize=16, CryptoKeyElementReadAccess=RA_ALLOWED, CryptoKeyElementAllowPartialAccess=false, CryptoKeyElementPersist=false, CryptoKeyElementWriteAccess=WA_ALLOWED
        Crypto_30_LibCv_Random_Seed_Nist_800_90A_DRBG_AES128: CryptoKeyElementId=3, CryptoKeyElementAllowPartialAccess=false, CryptoKeyElementReadAccess=RA_DENIED, CryptoKeyElementSize=32, CryptoKeyElementPersist=true, CryptoKeyElementWriteAccess=WA_ALLOWED
        Crypto_30_LibCv_KeyExchange_SharedValue: CryptoKeyElementId=1, CryptoKeyElementSize=64, CryptoKeyElementReadAccess=RA_INTERNAL_COPY, CryptoKeyElementAllowPartialAccess=false, CryptoKeyElementPersist=false, CryptoKeyElementWriteAccess=WA_ALLOWED
        Crypto_30_LibCv_KeyDerivation_Password: CryptoKeyElementId=1, CryptoKeyElementSize=16, CryptoKeyElementReadAccess=RA_ALLOWED, CryptoKeyElementAllowPartialAccess=false, CryptoKeyElementPersist=false, CryptoKeyElementWriteAccess=WA_ALLOWED
        Crypto_30_LibCv_Random_Reseed_Counter: CryptoKeyElementId=3018, CryptoKeyElementWriteAccess=WA_DENIED, CryptoKeyElementAllowPartialAccess=false, CryptoKeyElementSize=4, CryptoKeyElementInitValue=0 0 0 1, CryptoKeyElementPersist=true, CryptoKeyElementReadAccess=RA_ALLOWED
        Crypto_30_LibCv_Signature_Rsa_ExponentDp: CryptoKeyElementId=3053, CryptoKeyElementSize=16, CryptoKeyElementReadAccess=RA_ALLOWED, CryptoKeyElementAllowPartialAccess=false, CryptoKeyElementPersist=false, CryptoKeyElementWriteAccess=WA_ALLOWED
        Crypto_30_LibCv_Random_Seed: CryptoKeyElementId=3, CryptoKeyElementSize=20, CryptoKeyElementReadAccess=RA_ALLOWED, CryptoKeyElementAllowPartialAccess=false, CryptoKeyElementPersist=false, CryptoKeyElementWriteAccess=WA_ALLOWED
        Crypto_30_LibCv_KeyGenerate_Algorithm: CryptoKeyElementId=17, CryptoKeyElementInitValue=0x00, CryptoKeyElementSize=1, CryptoKeyElementReadAccess=RA_ALLOWED, CryptoKeyElementAllowPartialAccess=false, CryptoKeyElementPersist=false, CryptoKeyElementWriteAccess=WA_ALLOWED
        Crypto_30_LibCv_Signature_Key: CryptoKeyElementId=1, CryptoKeyElementSize=32, CryptoKeyElementReadAccess=RA_INTERNAL_COPY, CryptoKeyElementAllowPartialAccess=true, CryptoKeyElementPersist=true, CryptoKeyElementWriteAccess=WA_ALLOWED
        Crypto_30_LibCv_KeyDerivation_Algorithm_ASM_NISTFIPS1864: CryptoKeyElementId=15, CryptoKeyElementInitValue=0x02, CryptoKeyElementSize=1, CryptoKeyElementReadAccess=RA_ALLOWED, CryptoKeyElementAllowPartialAccess=false, CryptoKeyElementPersist=false, CryptoKeyElementWriteAccess=WA_ALLOWED
        Crypto_30_LibCv_Signature_Rsa_InverseQi: CryptoKeyElementId=3055, CryptoKeyElementSize=16, CryptoKeyElementReadAccess=RA_ALLOWED, CryptoKeyElementAllowPartialAccess=false, CryptoKeyElementPersist=false, CryptoKeyElementWriteAccess=WA_ALLOWED
        Crypto_30_LibCv_Mac_Proof: CryptoKeyElementId=2, CryptoKeyElementSize=48, CryptoKeyElementReadAccess=RA_ALLOWED, CryptoKeyElementAllowPartialAccess=false, CryptoKeyElementPersist=false, CryptoKeyElementWriteAccess=WA_ALLOWED
        Crypto_30_LibCv_KeyGenerate_Key: CryptoKeyElementId=1, CryptoKeyElementSize=16, CryptoKeyElementReadAccess=RA_ALLOWED, CryptoKeyElementAllowPartialAccess=false, CryptoKeyElementPersist=false, CryptoKeyElementWriteAccess=WA_ALLOWED
        Crypto_30_LibCv_KeyExchange_Algorithm_SECP256R1: CryptoKeyElementId=12, CryptoKeyElementInitValue=0x02, CryptoKeyElementSize=1, CryptoKeyElementReadAccess=RA_INTERNAL_COPY, CryptoKeyElementAllowPartialAccess=false, CryptoKeyElementPersist=false, CryptoKeyElementWriteAccess=WA_ALLOWED
        Crypto_30_LibCv_Signature_Rsa_PrimeQ: CryptoKeyElementId=3052, CryptoKeyElementSize=16, CryptoKeyElementReadAccess=RA_ALLOWED, CryptoKeyElementAllowPartialAccess=false, CryptoKeyElementPersist=false, CryptoKeyElementWriteAccess=WA_ALLOWED
        Crypto_30_LibCv_Signature_Rsa_PrimeP: CryptoKeyElementId=3051, CryptoKeyElementSize=16, CryptoKeyElementReadAccess=RA_ALLOWED, CryptoKeyElementAllowPartialAccess=false, CryptoKeyElementPersist=false, CryptoKeyElementWriteAccess=WA_ALLOWED
        Crypto_30_LibCv_Cipher_Key: CryptoKeyElementId=1, CryptoKeyElementSize=16, CryptoKeyElementReadAccess=RA_DENIED, CryptoKeyElementAllowPartialAccess=true, CryptoKeyElementPersist=false, CryptoKeyElementWriteAccess=WA_ALLOWED
        Crypto_30_LibCv_KeyExchange_Algorithm_ANSIP256R1: CryptoKeyElementId=12, CryptoKeyElementInitValue=0x01, CryptoKeyElementSize=1, CryptoKeyElementReadAccess=RA_ALLOWED, CryptoKeyElementAllowPartialAccess=false, CryptoKeyElementPersist=false, CryptoKeyElementWriteAccess=WA_ALLOWED
        Crypto_30_LibCv_KeyDerivation_Algorithm_NIST80056A: CryptoKeyElementId=15, CryptoKeyElementInitValue=0x03, CryptoKeyElementSize=1, CryptoKeyElementReadAccess=RA_ALLOWED, CryptoKeyElementAllowPartialAccess=false, CryptoKeyElementPersist=false, CryptoKeyElementWriteAccess=WA_ALLOWED
        Crypto_30_LibCv_KeyExchange_Algorithm_X25519: CryptoKeyElementId=12, CryptoKeyElementInitValue=0x00, CryptoKeyElementSize=1, CryptoKeyElementReadAccess=RA_ALLOWED, CryptoKeyElementAllowPartialAccess=false, CryptoKeyElementPersist=false, CryptoKeyElementWriteAccess=WA_ALLOWED
        Crypto_30_LibCv_KeyDerivation_AdditionalInfo: CryptoKeyElementId=131, CryptoKeyElementSize=5, CryptoKeyElementReadAccess=RA_ALLOWED, CryptoKeyElementAllowPartialAccess=false, CryptoKeyElementPersist=false, CryptoKeyElementWriteAccess=WA_ALLOWED
        Crypto_30_LibCv_SCC_Contract_PubKey: CryptoKeyElementId=3013, CryptoKeyElementSize=64, CryptoKeyElementReadAccess=RA_ALLOWED, CryptoKeyElementAllowPartialAccess=false, CryptoKeyElementPersist=false, CryptoKeyElementWriteAccess=WA_ALLOWED
        Crypto_30_LibCv_KeyExchange_OwnPubKey: CryptoKeyElementId=10, CryptoKeyElementSize=32, CryptoKeyElementReadAccess=RA_ALLOWED, CryptoKeyElementAllowPartialAccess=false, CryptoKeyElementPersist=false, CryptoKeyElementWriteAccess=WA_ALLOWED
        Crypto_30_LibCv_KeyDerivation_Algorithm_SYM_NIST800108: CryptoKeyElementId=15, CryptoKeyElementInitValue=0x01, CryptoKeyElementSize=1, CryptoKeyElementReadAccess=RA_ALLOWED, CryptoKeyElementAllowPartialAccess=false, CryptoKeyElementPersist=false, CryptoKeyElementWriteAccess=WA_ALLOWED
        Crypto_30_LibCv_Cipher_IV: CryptoKeyElementId=5, CryptoKeyElementSize=16, CryptoKeyElementReadAccess=RA_ALLOWED, CryptoKeyElementAllowPartialAccess=false, CryptoKeyElementPersist=false, CryptoKeyElementWriteAccess=WA_ALLOWED
        Crypto_30_LibCv_Random_Algorithm_Fips186_Sha1: CryptoKeyElementId=4, CryptoKeyElementInitValue=0x00, CryptoKeyElementSize=1, CryptoKeyElementReadAccess=RA_ALLOWED, CryptoKeyElementAllowPartialAccess=false, CryptoKeyElementPersist=false, CryptoKeyElementWriteAccess=WA_ALLOWED
        Crypto_30_LibCv_Random_Algorithm: CryptoKeyElementId=4, CryptoKeyElementSize=1, CryptoKeyElementReadAccess=RA_ALLOWED, CryptoKeyElementAllowPartialAccess=false, CryptoKeyElementPersist=false, CryptoKeyElementWriteAccess=WA_ALLOWED
        Crypto_30_LibCv_KeyDerivation_Label: CryptoKeyElementId=130, CryptoKeyElementSize=4, CryptoKeyElementReadAccess=RA_ALLOWED, CryptoKeyElementAllowPartialAccess=false, CryptoKeyElementPersist=false, CryptoKeyElementWriteAccess=WA_ALLOWED
        Crypto_30_LibCv_KeyExchange_Base: CryptoKeyElementId=8, CryptoKeyElementSize=16, CryptoKeyElementReadAccess=RA_ALLOWED, CryptoKeyElementAllowPartialAccess=false, CryptoKeyElementPersist=false, CryptoKeyElementWriteAccess=WA_ALLOWED
        Crypto_30_LibCv_Random_Nonce: CryptoKeyElementId=3017, CryptoKeyElementSize=16, CryptoKeyElementReadAccess=RA_ALLOWED, CryptoKeyElementAllowPartialAccess=false, CryptoKeyElementPersist=false, CryptoKeyElementWriteAccess=WA_ALLOWED
        Crypto_30_LibCv_Random_AdditinalInput: CryptoKeyElementId=3016, CryptoKeyElementSize=32, CryptoKeyElementReadAccess=RA_ALLOWED, CryptoKeyElementAllowPartialAccess=false, CryptoKeyElementPersist=false, CryptoKeyElementWriteAccess=WA_ALLOWED
        Crypto_30_LibCv_Random_PrivateString: CryptoKeyElementId=3015, CryptoKeyElementSize=16, CryptoKeyElementReadAccess=RA_ALLOWED, CryptoKeyElementAllowPartialAccess=false, CryptoKeyElementPersist=false, CryptoKeyElementWriteAccess=WA_ALLOWED
        Crypto_30_LibCv_Signature_Rsa_SaltLength: CryptoKeyElementId=164, CryptoKeyElementSize=2, CryptoKeyElementReadAccess=RA_ALLOWED, CryptoKeyElementAllowPartialAccess=false, CryptoKeyElementPersist=false, CryptoKeyElementWriteAccess=WA_ALLOWED
        Crypto_30_LibCv_KeyExchange_PrivKey: CryptoKeyElementId=9, CryptoKeyElementSize=32, CryptoKeyElementReadAccess=RA_INTERNAL_COPY, CryptoKeyElementAllowPartialAccess=false, CryptoKeyElementPersist=false, CryptoKeyElementWriteAccess=WA_ALLOWED
        Crypto_30_LibCv_SCC_IV_And_Encrypted_PrivKey: CryptoKeyElementId=3014, CryptoKeyElementSize=48, CryptoKeyElementReadAccess=RA_ALLOWED, CryptoKeyElementAllowPartialAccess=false, CryptoKeyElementPersist=false, CryptoKeyElementWriteAccess=WA_ALLOWED
        Crypto_30_LibCv_KeyDerive_Algorithm: CryptoKeyElementId=15, CryptoKeyElementInitValue=0x00, CryptoKeyElementSize=1, CryptoKeyElementReadAccess=RA_ALLOWED, CryptoKeyElementAllowPartialAccess=false, CryptoKeyElementPersist=false, CryptoKeyElementWriteAccess=WA_ALLOWED
        Crypto_30_LibCv_KeyExchange_PartnerPubKey: CryptoKeyElementId=3003, CryptoKeyElementSize=64, CryptoKeyElementReadAccess=RA_ALLOWED, CryptoKeyElementAllowPartialAccess=false, CryptoKeyElementPersist=false, CryptoKeyElementWriteAccess=WA_ALLOWED
        Crypto_30_LibCv_Random_Algorithm_Nist_800_90A_DRBG_AES128: CryptoKeyElementId=4, CryptoKeyElementSize=1, CryptoKeyElementInitValue=0x01, CryptoKeyElementReadAccess=RA_ALLOWED, CryptoKeyElementAllowPartialAccess=false, CryptoKeyElementPersist=false, CryptoKeyElementWriteAccess=WA_ALLOWED
        Crypto_30_LibCv_Signature_Rsa_Salt: CryptoKeyElementId=163, CryptoKeyElementSize=32, CryptoKeyElementReadAccess=RA_ALLOWED, CryptoKeyElementAllowPartialAccess=false, CryptoKeyElementPersist=false, CryptoKeyElementWriteAccess=WA_ALLOWED
        Crypto_30_LibCv_Mac_Key: CryptoKeyElementId=1, CryptoKeyElementSize=16, CryptoKeyElementReadAccess=RA_ALLOWED, CryptoKeyElementAllowPartialAccess=false, CryptoKeyElementPersist=false, CryptoKeyElementWriteAccess=WA_ALLOWED
        Crypto_30_LibCv_Signature_Rsa_Pub_Exponent: CryptoKeyElementId=161, CryptoKeyElementSize=3, CryptoKeyElementReadAccess=RA_ALLOWED, CryptoKeyElementAllowPartialAccess=false, CryptoKeyElementPersist=false, CryptoKeyElementWriteAccess=WA_ALLOWED
        Crypto_30_LibCv_Signature_Rsa_Modulus: CryptoKeyElementId=160, CryptoKeyElementSize=32, CryptoKeyElementReadAccess=RA_ALLOWED, CryptoKeyElementAllowPartialAccess=false, CryptoKeyElementPersist=false, CryptoKeyElementWriteAccess=WA_ALLOWED
        Crypto_30_LibCv_Signature_Rsa_Priv_Exponent: CryptoKeyElementId=162, CryptoKeyElementSize=32, CryptoKeyElementReadAccess=RA_ALLOWED, CryptoKeyElementAllowPartialAccess=false, CryptoKeyElementPersist=false, CryptoKeyElementWriteAccess=WA_ALLOWED
        Crypto_30_LibCv_Hash_Result: CryptoKeyElementId=1, CryptoKeyElementSize=20, CryptoKeyElementReadAccess=RA_ALLOWED, CryptoKeyElementAllowPartialAccess=false, CryptoKeyElementPersist=false, CryptoKeyElementWriteAccess=WA_ALLOWED
        Crypto_30_LibCv_KeyDerivation_Algorithm_ISO15118: CryptoKeyElementId=15, CryptoKeyElementInitValue=0x04, CryptoKeyElementSize=1, CryptoKeyElementReadAccess=RA_ALLOWED, CryptoKeyElementAllowPartialAccess=false, CryptoKeyElementPersist=false, CryptoKeyElementWriteAccess=WA_ALLOWED
        Crypto_30_LibCv_KeyDerivation_Salt: CryptoKeyElementId=13, CryptoKeyElementSize=39, CryptoKeyElementReadAccess=RA_INTERNAL_COPY, CryptoKeyElementAllowPartialAccess=true, CryptoKeyElementPersist=false, CryptoKeyElementWriteAccess=WA_ALLOWED
        Crypto_30_LibCv_Cipher_Proof: CryptoKeyElementId=6, CryptoKeyElementSize=48, CryptoKeyElementReadAccess=RA_ALLOWED, CryptoKeyElementAllowPartialAccess=false, CryptoKeyElementPersist=false, CryptoKeyElementWriteAccess=WA_ALLOWED
        Crypto_30_LibCv_Random_AdditionalInput: CryptoKeyElementId=3016, CryptoKeyElementAllowPartialAccess=false, CryptoKeyElementPersist=false, CryptoKeyElementReadAccess=RA_ALLOWED, CryptoKeyElementSize=16, CryptoKeyElementWriteAccess=WA_ALLOWED
        Crypto_30_LibCv_Mac_Key_She: CryptoKeyElementId=1, CryptoKeyElementWriteAccess=WA_ENCRYPTED, CryptoKeyElementSize=16, CryptoKeyElementAllowPartialAccess=false, CryptoKeyElementPersist=false, CryptoKeyElementReadAccess=RA_ENCRYPTED
        Crypto_30_LibCv_Cipher_Key_She: CryptoKeyElementId=1, CryptoKeyElementWriteAccess=WA_ENCRYPTED, CryptoKeyElementSize=16, CryptoKeyElementAllowPartialAccess=false, CryptoKeyElementPersist=false, CryptoKeyElementReadAccess=RA_ENCRYPTED
        Crypto_30_LibCv_She_UId: CryptoKeyElementSize=15, CryptoKeyElementId=3021, CryptoKeyElementAllowPartialAccess=false, CryptoKeyElementPersist=false, CryptoKeyElementReadAccess=RA_ALLOWED, CryptoKeyElementWriteAccess=WA_ALLOWED
        Crypto_30_LibCv_She_Counter: CryptoKeyElementId=3019, CryptoKeyElementSize=4, CryptoKeyElementWriteAccess=WA_DENIED, CryptoKeyElementAllowPartialAccess=false, CryptoKeyElementPersist=false, CryptoKeyElementReadAccess=RA_ALLOWED, CryptoKeyElementInitValue=0 0 0 0
        Crypto_30_LibCv_She_BootProtection: CryptoKeyElementId=3056, CryptoKeyElementSize=1, CryptoKeyElementAllowPartialAccess=false, CryptoKeyElementPersist=false, CryptoKeyElementReadAccess=RA_ALLOWED, CryptoKeyElementWriteAccess=WA_ALLOWED
        Crypto_30_LibCv_She_DebuggerProtection: CryptoKeyElementId=3057, CryptoKeyElementSize=1, CryptoKeyElementAllowPartialAccess=false, CryptoKeyElementPersist=false, CryptoKeyElementReadAccess=RA_ALLOWED, CryptoKeyElementWriteAccess=WA_ALLOWED
        Crypto_30_LibCv_Rsa_Modulus: CryptoKeyElementId=160, CryptoKeyElementAllowPartialAccess=false, CryptoKeyElementPersist=false, CryptoKeyElementReadAccess=RA_ALLOWED, CryptoKeyElementSize=16, CryptoKeyElementWriteAccess=WA_ALLOWED
        Crypto_30_LibCv_Rsa_Pub_Exponent: CryptoKeyElementId=161, CryptoKeyElementAllowPartialAccess=false, CryptoKeyElementPersist=false, CryptoKeyElementReadAccess=RA_ALLOWED, CryptoKeyElementSize=16, CryptoKeyElementWriteAccess=WA_ALLOWED
        Crypto_30_LibCv_Rsa_Priv_Exponent: CryptoKeyElementId=162, CryptoKeyElementAllowPartialAccess=false, CryptoKeyElementPersist=false, CryptoKeyElementReadAccess=RA_ALLOWED, CryptoKeyElementSize=16, CryptoKeyElementWriteAccess=WA_ALLOWED
        Crypto_30_LibCv_Rsa_Salt: CryptoKeyElementId=163, CryptoKeyElementAllowPartialAccess=false, CryptoKeyElementPersist=false, CryptoKeyElementReadAccess=RA_ALLOWED, CryptoKeyElementSize=16, CryptoKeyElementWriteAccess=WA_ALLOWED
        Crypto_30_LibCv_Rsa_SaltLength: CryptoKeyElementId=164, CryptoKeyElementSize=2, CryptoKeyElementAllowPartialAccess=false, CryptoKeyElementPersist=false, CryptoKeyElementReadAccess=RA_ALLOWED, CryptoKeyElementWriteAccess=WA_ALLOWED
        Crypto_30_LibCv_Rsa_PrimeP: CryptoKeyElementId=3051, CryptoKeyElementAllowPartialAccess=false, CryptoKeyElementPersist=false, CryptoKeyElementReadAccess=RA_ALLOWED, CryptoKeyElementSize=16, CryptoKeyElementWriteAccess=WA_ALLOWED
        Crypto_30_LibCv_Rsa_PrimeQ: CryptoKeyElementId=3052, CryptoKeyElementAllowPartialAccess=false, CryptoKeyElementPersist=false, CryptoKeyElementReadAccess=RA_ALLOWED, CryptoKeyElementSize=16, CryptoKeyElementWriteAccess=WA_ALLOWED
        Crypto_30_LibCv_Rsa_ExponentDp: CryptoKeyElementId=3053, CryptoKeyElementAllowPartialAccess=false, CryptoKeyElementPersist=false, CryptoKeyElementReadAccess=RA_ALLOWED, CryptoKeyElementSize=16, CryptoKeyElementWriteAccess=WA_ALLOWED
        Crypto_30_LibCv_Rsa_ExponentDq: CryptoKeyElementId=3054, CryptoKeyElementAllowPartialAccess=false, CryptoKeyElementPersist=false, CryptoKeyElementReadAccess=RA_ALLOWED, CryptoKeyElementSize=16, CryptoKeyElementWriteAccess=WA_ALLOWED
        Crypto_30_LibCv_Rsa_InverseQi: CryptoKeyElementId=3055, CryptoKeyElementAllowPartialAccess=false, CryptoKeyElementPersist=false, CryptoKeyElementReadAccess=RA_ALLOWED, CryptoKeyElementSize=16, CryptoKeyElementWriteAccess=WA_ALLOWED
        Crypto_30_LibCv_Label: CryptoKeyElementId=3058, CryptoKeyElementAllowPartialAccess=false, CryptoKeyElementPersist=false, CryptoKeyElementReadAccess=RA_ALLOWED, CryptoKeyElementSize=16, CryptoKeyElementWriteAccess=WA_ALLOWED
        Crypto_30_LibCv_KeyExchange_Algorithm_SECP384R1: CryptoKeyElementId=12, CryptoKeyElementInitValue=0x04, CryptoKeyElementSize=1, CryptoKeyElementAllowPartialAccess=false, CryptoKeyElementPersist=false, CryptoKeyElementReadAccess=RA_ALLOWED, CryptoKeyElementWriteAccess=WA_ALLOWED
        Crypto_30_LibCv_KeyDerivation_Algorithm_KDF_X963_SHA256: CryptoKeyElementId=15, CryptoKeyElementInitValue=0x06, CryptoKeyElementSize=1, CryptoKeyElementAllowPartialAccess=false, CryptoKeyElementPersist=false, CryptoKeyElementReadAccess=RA_ALLOWED, CryptoKeyElementWriteAccess=WA_ALLOWED
        Crypto_30_LibCv_Mac_Key_She_Ram: CryptoKeyElementId=1, CryptoKeyElementWriteAccess=WA_ALLOWED, CryptoKeyElementSize=16, CryptoKeyElementReadAccess=RA_ENCRYPTED, CryptoKeyElementAllowPartialAccess=false, CryptoKeyElementPersist=false
        Crypto_30_LibCv_Cipher_Key_She_Ram: CryptoKeyElementId=1, CryptoKeyElementWriteAccess=WA_ALLOWED, CryptoKeyElementSize=16, CryptoKeyElementReadAccess=RA_ENCRYPTED, CryptoKeyElementAllowPartialAccess=false, CryptoKeyElementPersist=false
        Crypto_30_LibCv_Cipher_2NDKey: CryptoKeyElementId=7, CryptoKeyElementAllowPartialAccess=false, CryptoKeyElementPersist=false, CryptoKeyElementReadAccess=RA_ALLOWED, CryptoKeyElementSize=16, CryptoKeyElementWriteAccess=WA_ALLOWED
        Crypto_30_LibCv_KeyGenerate_Algorithm_Symmetric_Generic: CryptoKeyElementId=17, CryptoKeyElementInitValue=0, CryptoKeyElementSize=1, CryptoKeyElementReadAccess=RA_ALLOWED, CryptoKeyElementAllowPartialAccess=false, CryptoKeyElementPersist=false, CryptoKeyElementWriteAccess=WA_ALLOWED
        Crypto_30_LibCv_KeyGenerate_Algorithm_Ansi_Nist_Sec_P256R1: CryptoKeyElementId=17, CryptoKeyElementInitValue=1, CryptoKeyElementSize=1, CryptoKeyElementReadAccess=RA_ALLOWED, CryptoKeyElementAllowPartialAccess=false, CryptoKeyElementPersist=false, CryptoKeyElementWriteAccess=WA_ALLOWED
        Crypto_30_LibCv_KeyGenerate_Algorithm_Nist_Sec_P384R1: CryptoKeyElementId=17, CryptoKeyElementInitValue=2, CryptoKeyElementSize=1, CryptoKeyElementReadAccess=RA_ALLOWED, CryptoKeyElementAllowPartialAccess=false, CryptoKeyElementPersist=false, CryptoKeyElementWriteAccess=WA_ALLOWED
        Crypto_30_LibCv_KeyDerivation_Iterations_PBKDF2: CryptoKeyElementId=14, CryptoKeyElementSize=4, CryptoKeyElementReadAccess=RA_ALLOWED, CryptoKeyElementAllowPartialAccess=false, CryptoKeyElementPersist=false, CryptoKeyElementWriteAccess=WA_ALLOWED
        Crypto_30_LibCv_KeyDerivation_Algorithm_PBKDF2_HMAC_SHA1: CryptoKeyElementId=15, CryptoKeyElementInitValue=0x09, CryptoKeyElementSize=1, CryptoKeyElementReadAccess=RA_ALLOWED, CryptoKeyElementAllowPartialAccess=false, CryptoKeyElementPersist=false, CryptoKeyElementWriteAccess=WA_ALLOWED
        Crypto_30_LibCv_KeyDerivation_Algorithm_PBKDF2_HMAC_SHA256: CryptoKeyElementId=15, CryptoKeyElementInitValue=0x0A, CryptoKeyElementSize=1, CryptoKeyElementReadAccess=RA_ALLOWED, CryptoKeyElementAllowPartialAccess=false, CryptoKeyElementPersist=false, CryptoKeyElementWriteAccess=WA_ALLOWED
        Crypto_30_LibCv_KeyDerivation_Algorithm_KDF_X963_SHA512: CryptoKeyElementId=15, CryptoKeyElementInitValue=0x07, CryptoKeyElementSize=1, CryptoKeyElementReadAccess=RA_ALLOWED, CryptoKeyElementAllowPartialAccess=false, CryptoKeyElementPersist=false, CryptoKeyElementWriteAccess=WA_ALLOWED
        Crypto_30_LibCv_Aead_ChaCha_Key: CryptoKeyElementId=1, CryptoKeyElementSize=32, CryptoKeyElementReadAccess=RA_ALLOWED, CryptoKeyElementAllowPartialAccess=false, CryptoKeyElementPersist=false, CryptoKeyElementWriteAccess=WA_ALLOWED
        Crypto_30_LibCv_Aead_ChaCha_Nonce: CryptoKeyElementId=5, CryptoKeyElementSize=12, CryptoKeyElementReadAccess=RA_ALLOWED, CryptoKeyElementAllowPartialAccess=false, CryptoKeyElementPersist=false, CryptoKeyElementWriteAccess=WA_ALLOWED
        Crypto_30_LibCv_Random_Algorithm_Nist_800_90A_DRBG_AES128_DF: CryptoKeyElementId=4, CryptoKeyElementSize=1, CryptoKeyElementInitValue=2, CryptoKeyElementReadAccess=RA_ALLOWED, CryptoKeyElementAllowPartialAccess=false, CryptoKeyElementPersist=false, CryptoKeyElementWriteAccess=WA_ALLOWED
        Crypto_30_LibCv_Random_Algorithm_Nist_800_90A_DRBG_HASH_SHA2_512: CryptoKeyElementId=4, CryptoKeyElementSize=1, CryptoKeyElementInitValue=3, CryptoKeyElementReadAccess=RA_ALLOWED, CryptoKeyElementAllowPartialAccess=false, CryptoKeyElementPersist=false, CryptoKeyElementWriteAccess=WA_ALLOWED
        Crypto_30_LibCv_Random_Seed_Nist_800_90A_DRBG_HASH_SHA2_512: CryptoKeyElementId=3, CryptoKeyElementAllowPartialAccess=false, CryptoKeyElementReadAccess=RA_DENIED, CryptoKeyElementSize=222, CryptoKeyElementPersist=false, CryptoKeyElementWriteAccess=WA_ALLOWED
        Crypto_30_LibCv_Random_Algorithm_Nist_800_90A_DRBG_AES256: CryptoKeyElementId=4, CryptoKeyElementSize=1, CryptoKeyElementInitValue=4, CryptoKeyElementAllowPartialAccess=false, CryptoKeyElementPersist=false, CryptoKeyElementReadAccess=RA_ALLOWED, CryptoKeyElementWriteAccess=WA_ALLOWED
        Crypto_30_LibCv_Random_Algorithm_Nist_800_90A_DRBG_AES256Df: CryptoKeyElementId=4, CryptoKeyElementSize=1, CryptoKeyElementInitValue=5, CryptoKeyElementAllowPartialAccess=false, CryptoKeyElementPersist=false, CryptoKeyElementReadAccess=RA_ALLOWED, CryptoKeyElementWriteAccess=WA_ALLOWED
        Crypto_30_LibCv_Random_Seed_Nist_800_90A_DRBG_AES256: CryptoKeyElementId=3, CryptoKeyElementAllowPartialAccess=false, CryptoKeyElementReadAccess=RA_DENIED, CryptoKeyElementSize=48, CryptoKeyElementPersist=false, CryptoKeyElementWriteAccess=WA_ALLOWED
        Crypto_30_LibCv_KeyDerivation_Algorithm_HKDF_HMAC_SHA256: CryptoKeyElementId=15, CryptoKeyElementInitValue=0x0B, CryptoKeyElementSize=1, CryptoKeyElementAllowPartialAccess=false, CryptoKeyElementPersist=false, CryptoKeyElementReadAccess=RA_ALLOWED, CryptoKeyElementWriteAccess=WA_ALLOWED
        Crypto_30_LibCv_KeyDerivation_Iterations_HKDF: CryptoKeyElementId=14, CryptoKeyElementSize=1, CryptoKeyElementAllowPartialAccess=false, CryptoKeyElementPersist=false, CryptoKeyElementReadAccess=RA_ALLOWED, CryptoKeyElementWriteAccess=WA_ALLOWED
        Crypto_30_LibCv_KeyDerivation_Algorithm_Spake2Plus_P256R1: CryptoKeyElementId=15, CryptoKeyElementInitValue=0x0C, CryptoKeyElementSize=1, CryptoKeyElementAllowPartialAccess=false, CryptoKeyElementPersist=false, CryptoKeyElementReadAccess=RA_ALLOWED, CryptoKeyElementWriteAccess=WA_ALLOWED
        Crypto_30_LibCv_KeyExchange_Algorithm_Spake2Plus_Suite8: CryptoKeyElementId=12, CryptoKeyElementSize=1, CryptoKeyElementInitValue=5, CryptoKeyElementAllowPartialAccess=false, CryptoKeyElementPersist=false, CryptoKeyElementReadAccess=RA_ALLOWED, CryptoKeyElementWriteAccess=WA_ALLOWED
        Crypto_30_LibCv_KeyExchange_Algorithm_Spake2Plus_Suite8_1: CryptoKeyElementId=12, CryptoKeyElementSize=1, CryptoKeyElementInitValue=6, CryptoKeyElementAllowPartialAccess=false, CryptoKeyElementPersist=false, CryptoKeyElementReadAccess=RA_ALLOWED, CryptoKeyElementWriteAccess=WA_ALLOWED
        Crypto_30_LibCv_W0: CryptoKeyElementId=3084, CryptoKeyElementAllowPartialAccess=false, CryptoKeyElementPersist=false, CryptoKeyElementReadAccess=RA_ALLOWED, CryptoKeyElementSize=16, CryptoKeyElementWriteAccess=WA_ALLOWED
        Crypto_30_LibCv_W1: CryptoKeyElementId=3085, CryptoKeyElementAllowPartialAccess=false, CryptoKeyElementPersist=false, CryptoKeyElementReadAccess=RA_ALLOWED, CryptoKeyElementSize=16, CryptoKeyElementWriteAccess=WA_ALLOWED
        Crypto_30_LibCv_L: CryptoKeyElementId=3086, CryptoKeyElementAllowPartialAccess=false, CryptoKeyElementPersist=false, CryptoKeyElementReadAccess=RA_ALLOWED, CryptoKeyElementSize=16, CryptoKeyElementWriteAccess=WA_ALLOWED
        Crypto_30_LibCv_Verification_Result: CryptoKeyElementId=3088, CryptoKeyElementSize=1, CryptoKeyElementAllowPartialAccess=false, CryptoKeyElementPersist=false, CryptoKeyElementReadAccess=RA_ALLOWED, CryptoKeyElementWriteAccess=WA_ALLOWED
        Crypto_30_LibCv_AdditionalInfo: CryptoKeyElementId=131, CryptoKeyElementAllowPartialAccess=false, CryptoKeyElementPersist=false, CryptoKeyElementReadAccess=RA_ALLOWED, CryptoKeyElementSize=16, CryptoKeyElementWriteAccess=WA_ALLOWED
        Crypto_30_LibCv_Verification: CryptoKeyElementId=3087, CryptoKeyElementAllowPartialAccess=false, CryptoKeyElementPersist=false, CryptoKeyElementReadAccess=RA_ALLOWED, CryptoKeyElementSize=16, CryptoKeyElementWriteAccess=WA_ALLOWED
        Crypto_30_LibCv_Scc_Certificate_Subject_PublicKey: CryptoKeyElementId=1, CryptoKeyElementSize=64, CryptoKeyElementReadAccess=RA_ALLOWED, CryptoKeyElementAllowPartialAccess=false, CryptoKeyElementPersist=false, CryptoKeyElementWriteAccess=WA_ALLOWED
        SccPrivateKeyDecrypted: CryptoKeyElementId=7, CryptoKeyElementSize=32, CryptoKeyElementReadAccess=RA_INTERNAL_COPY, CryptoKeyElementAllowPartialAccess=true, CryptoKeyElementPersist=false, CryptoKeyElementWriteAccess=WA_ALLOWED
        CryptoKeyElement_Tls_HashShaX: CryptoKeyElementId=1, CryptoKeyElementSize=32, CryptoKeyElementReadAccess=RA_ALLOWED, CryptoKeyElementAllowPartialAccess=true, CryptoKeyElementPersist=false, CryptoKeyElementWriteAccess=WA_ALLOWED
        CryptoKeyElement_Tls_HMacShaX: CryptoKeyElementId=1, CryptoKeyElementSize=48, CryptoKeyElementReadAccess=RA_INTERNAL_COPY, CryptoKeyElementAllowPartialAccess=true, CryptoKeyElementPersist=false, CryptoKeyElementWriteAccess=WA_ALLOWED
        CryptoKeyElement_Tls_KeyEx_Algorithm: CryptoKeyElementId=12, CryptoKeyElementSize=1, CryptoKeyElementReadAccess=RA_ALLOWED, CryptoKeyElementAllowPartialAccess=false, CryptoKeyElementPersist=false, CryptoKeyElementWriteAccess=WA_ALLOWED
        CryptoKeyElement_Tls_KeyEx_OwnPubKey: CryptoKeyElementId=10, CryptoKeyElementSize=64, CryptoKeyElementReadAccess=RA_ALLOWED, CryptoKeyElementAllowPartialAccess=false, CryptoKeyElementPersist=false, CryptoKeyElementWriteAccess=WA_ALLOWED
        CryptoKeyElement_Tls_KeyEx_PrivKey: CryptoKeyElementId=9, CryptoKeyElementSize=32, CryptoKeyElementReadAccess=RA_DENIED, CryptoKeyElementAllowPartialAccess=false, CryptoKeyElementPersist=false, CryptoKeyElementWriteAccess=WA_ALLOWED
        CryptoKeyElement_Tls_KeyEx_SharedSecret: CryptoKeyElementId=1, CryptoKeyElementSize=64, CryptoKeyElementReadAccess=RA_INTERNAL_COPY, CryptoKeyElementAllowPartialAccess=true, CryptoKeyElementPersist=false, CryptoKeyElementWriteAccess=WA_ALLOWED
        CryptoKeyElement_Tls_MasterSecret: CryptoKeyElementId=3080, CryptoKeyElementSize=48, CryptoKeyElementReadAccess=RA_INTERNAL_COPY, CryptoKeyElementAllowPartialAccess=true, CryptoKeyElementPersist=false, CryptoKeyElementWriteAccess=WA_ALLOWED
        CryptoKeyElement_Tls_PrfInputValue: CryptoKeyElementId=3080, CryptoKeyElementSize=110, CryptoKeyElementReadAccess=RA_INTERNAL_COPY, CryptoKeyElementAllowPartialAccess=true, CryptoKeyElementPersist=false, CryptoKeyElementWriteAccess=WA_ALLOWED
        CryptoKeyElement_Tls_PrfOutputValuePrivate: CryptoKeyElementId=3081, CryptoKeyElementSize=32, CryptoKeyElementReadAccess=RA_INTERNAL_COPY, CryptoKeyElementAllowPartialAccess=true, CryptoKeyElementPersist=false, CryptoKeyElementWriteAccess=WA_ALLOWED
        CryptoKeyElement_Tls_PrfOutputValuePublic: CryptoKeyElementId=3081, CryptoKeyElementSize=32, CryptoKeyElementReadAccess=RA_ALLOWED, CryptoKeyElementAllowPartialAccess=true, CryptoKeyElementPersist=false, CryptoKeyElementWriteAccess=WA_ALLOWED
        CryptoKeyElement_Tls_PrfResultPrivate: CryptoKeyElementId=3080, CryptoKeyElementSize=128, CryptoKeyElementReadAccess=RA_INTERNAL_COPY, CryptoKeyElementAllowPartialAccess=true, CryptoKeyElementPersist=false, CryptoKeyElementWriteAccess=WA_ALLOWED
        CryptoKeyElement_Tls_PrfResultPublic: CryptoKeyElementId=3080, CryptoKeyElementSize=128, CryptoKeyElementReadAccess=RA_ALLOWED, CryptoKeyElementAllowPartialAccess=true, CryptoKeyElementPersist=false, CryptoKeyElementWriteAccess=WA_ALLOWED
        CryptoKeyElement_Tls_PrfSecret: CryptoKeyElementId=1, CryptoKeyElementSize=48, CryptoKeyElementReadAccess=RA_INTERNAL_COPY, CryptoKeyElementAllowPartialAccess=true, CryptoKeyElementPersist=false, CryptoKeyElementWriteAccess=WA_ALLOWED
        CryptoKeyElement_Tls_PrfValueActivePrivate: CryptoKeyElementId=3082, CryptoKeyElementSize=32, CryptoKeyElementReadAccess=RA_INTERNAL_COPY, CryptoKeyElementAllowPartialAccess=true, CryptoKeyElementPersist=false, CryptoKeyElementWriteAccess=WA_ALLOWED
        CryptoKeyElement_Tls_PrfValueActivePublic: CryptoKeyElementId=3082, CryptoKeyElementSize=32, CryptoKeyElementReadAccess=RA_ALLOWED, CryptoKeyElementAllowPartialAccess=true, CryptoKeyElementPersist=false, CryptoKeyElementWriteAccess=WA_ALLOWED
        CryptoKeyElement_Tls_PrfValuePassivePrivate: CryptoKeyElementId=3083, CryptoKeyElementSize=32, CryptoKeyElementReadAccess=RA_INTERNAL_COPY, CryptoKeyElementAllowPartialAccess=true, CryptoKeyElementPersist=false, CryptoKeyElementWriteAccess=WA_ALLOWED
        CryptoKeyElement_Tls_PrfValuePassivePublic: CryptoKeyElementId=3083, CryptoKeyElementSize=32, CryptoKeyElementReadAccess=RA_ALLOWED, CryptoKeyElementAllowPartialAccess=true, CryptoKeyElementPersist=false, CryptoKeyElementWriteAccess=WA_ALLOWED
        CryptoKeyElement_Tls_PubKey: CryptoKeyElementId=1, CryptoKeyElementSize=65, CryptoKeyElementReadAccess=RA_ALLOWED, CryptoKeyElementAllowPartialAccess=true, CryptoKeyElementPersist=false, CryptoKeyElementWriteAccess=WA_ALLOWED
        CryptoKeyElement_Tls_RandomNumber_Algorithm: CryptoKeyElementId=4, CryptoKeyElementSize=1, CryptoKeyElementReadAccess=RA_ALLOWED, CryptoKeyElementAllowPartialAccess=false, CryptoKeyElementPersist=false, CryptoKeyElementWriteAccess=WA_ALLOWED
        CryptoKeyElement_Tls_RandomNumber_Seed: CryptoKeyElementId=3, CryptoKeyElementSize=20, CryptoKeyElementReadAccess=RA_ALLOWED, CryptoKeyElementAllowPartialAccess=false, CryptoKeyElementPersist=false, CryptoKeyElementWriteAccess=WA_ALLOWED
        CryptoKeyElement_Tls_TmpBuffer: CryptoKeyElementId=3080, CryptoKeyElementSize=80, CryptoKeyElementReadAccess=RA_INTERNAL_COPY, CryptoKeyElementAllowPartialAccess=true, CryptoKeyElementPersist=false, CryptoKeyElementWriteAccess=WA_ALLOWED
        CryptoKeyElement_Tls_Xcrypt_IV: CryptoKeyElementId=5, CryptoKeyElementSize=16, CryptoKeyElementReadAccess=RA_ALLOWED, CryptoKeyElementAllowPartialAccess=false, CryptoKeyElementPersist=false, CryptoKeyElementWriteAccess=WA_ALLOWED
        CryptoKeyElement_Tls_Xcrypt_Key: CryptoKeyElementId=1, CryptoKeyElementSize=16, CryptoKeyElementReadAccess=RA_INTERNAL_COPY, CryptoKeyElementAllowPartialAccess=true, CryptoKeyElementPersist=false, CryptoKeyElementWriteAccess=WA_ALLOWED
        Crypto_30_LibCv_KeyGenerate_Algorithm_Ed25519: CryptoKeyElementId=17, CryptoKeyElementSize=1, CryptoKeyElementInitValue=3, CryptoKeyElementReadAccess=RA_ALLOWED, CryptoKeyElementAllowPartialAccess=false, CryptoKeyElementPersist=false, CryptoKeyElementWriteAccess=WA_ALLOWED
        Crypto_30_LibCv_Scc_ContrCertTempPrivateKeyElemen: CryptoKeyElementId=1, CryptoKeyElementSize=32, CryptoKeyElementReadAccess=RA_INTERNAL_COPY, CryptoKeyElementAllowPartialAccess=false, CryptoKeyElementPersist=false, CryptoKeyElementWriteAccess=WA_ALLOWED
        Crypto_30_LibCv_KeyExchange_PartnerPubKey_2: CryptoKeyElementId=3004, CryptoKeyElementSize=16, CryptoKeyElementReadAccess=RA_ALLOWED, CryptoKeyElementAllowPartialAccess=false, CryptoKeyElementPersist=false, CryptoKeyElementWriteAccess=WA_ALLOWED
        Crypto_30_LibCv_KeyExchange_Algorithm_NISTP224R1_BD: CryptoKeyElementId=12, CryptoKeyElementInitValue=3, CryptoKeyElementSize=1, CryptoKeyElementReadAccess=RA_ALLOWED, CryptoKeyElementAllowPartialAccess=false, CryptoKeyElementPersist=false, CryptoKeyElementWriteAccess=WA_ALLOWED
        Crypto_30_LibCv_KeyExchange_EcuId: CryptoKeyElementId=3007, CryptoKeyElementSize=1, CryptoKeyElementReadAccess=RA_ALLOWED, CryptoKeyElementAllowPartialAccess=false, CryptoKeyElementPersist=false, CryptoKeyElementWriteAccess=WA_ALLOWED
        Crypto_30_LibCv_KeyExchange_NumEcu: CryptoKeyElementId=3006, CryptoKeyElementSize=1, CryptoKeyElementReadAccess=RA_ALLOWED, CryptoKeyElementAllowPartialAccess=false, CryptoKeyElementPersist=false, CryptoKeyElementWriteAccess=WA_ALLOWED
        Crypto_30_LibCv_KeyExchange_Intermediate: CryptoKeyElementId=3005, CryptoKeyElementSize=16, CryptoKeyElementReadAccess=RA_ALLOWED, CryptoKeyElementAllowPartialAccess=false, CryptoKeyElementPersist=false, CryptoKeyElementWriteAccess=WA_ALLOWED
        Crypto_30_LibCv_KeyDerivation_Algorithm_HKDF_Option1_SHA256: CryptoKeyElementId=15, CryptoKeyElementInitValue=0x0D, CryptoKeyElementSize=1, CryptoKeyElementReadAccess=RA_ALLOWED, CryptoKeyElementAllowPartialAccess=false, CryptoKeyElementPersist=false, CryptoKeyElementWriteAccess=WA_ALLOWED
        Crypto_30_LibCv_KeyExchange_Algorithm_SECP521R1: CryptoKeyElementId=12, CryptoKeyElementInitValue=0x07, CryptoKeyElementSize=1, CryptoKeyElementReadAccess=RA_ALLOWED, CryptoKeyElementAllowPartialAccess=false, CryptoKeyElementPersist=false, CryptoKeyElementWriteAccess=WA_ALLOWED
    CryptoPrimitives
      147 x CryptoPrimitive:
        RsaPssSha256Verify: CryptoPrimitiveAlgorithmFamily=CRYPTO_ALGOFAM_RSA, CryptoPrimitiveService=CRYPTO_SIGNATURE_VERIFY, CryptoPrimitiveAlgorithmMode=CRYPTO_ALGOMODE_RSASSA_PSS, CryptoPrimitiveAlgorithmSecondaryFamily=CRYPTO_ALGOFAM_SHA2_256
        HmacSha1Generate: CryptoPrimitiveAlgorithmFamily=CRYPTO_ALGOFAM_SHA1, CryptoPrimitiveAlgorithmMode=CRYPTO_ALGOMODE_HMAC, CryptoPrimitiveAlgorithmSecondaryFamily=CRYPTO_ALGOFAM_NOT_SET, CryptoPrimitiveService=CRYPTO_MAC_GENERATE
        RsaPkcs1CrtSha256Generate: CryptoPrimitiveAlgorithmFamily=CRYPTO_ALGOFAM_RSA, CryptoPrimitiveService=CRYPTO_SIGNATURE_GENERATE, CryptoPrimitiveAlgorithmMode=CRYPTO_ALGOMODE_CUSTOM_RSASSA_PKCS1_v1_5_CRT, CryptoPrimitiveAlgorithmSecondaryFamily=CRYPTO_ALGOFAM_SHA2_256, CryptoPrimitiveAlgorithmModeCustomRef=Crypto_30_LibCv_RSASSA_PKCS1_v1_5_CRT
        RngDrbgAes128Df: CryptoPrimitiveAlgorithmMode=CRYPTO_ALGOMODE_CUSTOM_USE_DF, CryptoPrimitiveService=CRYPTO_RANDOM, CryptoPrimitiveAlgorithmFamily=CRYPTO_ALGOFAM_CUSTOM_DRBG, CryptoPrimitiveAlgorithmSecondaryFamily=CRYPTO_ALGOFAM_AES, CryptoPrimitiveAlgorithmFamilyCustomRef=Crypto_30_LibCv_DRBG, CryptoPrimitiveAlgorithmModeCustomRef=Crypto_30_LibCv_UseDF
        EcDsaEd25519Verify: CryptoPrimitiveAlgorithmSecondaryFamily=CRYPTO_ALGOFAM_NOT_SET, CryptoPrimitiveAlgorithmMode=CRYPTO_ALGOMODE_NOT_SET, CryptoPrimitiveService=CRYPTO_SIGNATURE_VERIFY, CryptoPrimitiveAlgorithmFamily=CRYPTO_ALGOFAM_ED25519, CryptoPrimitiveAlgorithmSecondaryFamily=CRYPTO_ALGOFAM_SHA2_512
        EccNistP256R1GenerateSha1: CryptoPrimitiveAlgorithmFamily=CRYPTO_ALGOFAM_ECCNIST, CryptoPrimitiveAlgorithmMode=CRYPTO_ALGOMODE_CUSTOM_P256R1, CryptoPrimitiveService=CRYPTO_SIGNATURE_GENERATE, CryptoPrimitiveAlgorithmSecondaryFamily=CRYPTO_ALGOFAM_SHA1, CryptoPrimitiveAlgorithmModeCustomRef=Crypto_30_LibCv_P256r1
        RngFips186: CryptoPrimitiveAlgorithmMode=CRYPTO_ALGOMODE_NOT_SET, CryptoPrimitiveService=CRYPTO_RANDOM, CryptoPrimitiveAlgorithmFamily=CRYPTO_ALGOFAM_RNG, CryptoPrimitiveAlgorithmSecondaryFamily=CRYPTO_ALGOFAM_NOT_SET
        HmacSha1Verify: CryptoPrimitiveAlgorithmFamily=CRYPTO_ALGOFAM_SHA1, CryptoPrimitiveAlgorithmMode=CRYPTO_ALGOMODE_HMAC, CryptoPrimitiveAlgorithmSecondaryFamily=CRYPTO_ALGOFAM_NOT_SET, CryptoPrimitiveService=CRYPTO_MAC_VERIFY
        EccNistP256R1VerifySha1: CryptoPrimitiveAlgorithmFamily=CRYPTO_ALGOFAM_ECCNIST, CryptoPrimitiveAlgorithmMode=CRYPTO_ALGOMODE_CUSTOM_P256R1, CryptoPrimitiveService=CRYPTO_SIGNATURE_VERIFY, CryptoPrimitiveAlgorithmSecondaryFamily=CRYPTO_ALGOFAM_SHA1, CryptoPrimitiveAlgorithmModeCustomRef=Crypto_30_LibCv_P256r1
        EccSecP256R1GenerateSha1: CryptoPrimitiveAlgorithmFamily=CRYPTO_ALGOFAM_CUSTOM_ECCSEC, CryptoPrimitiveAlgorithmMode=CRYPTO_ALGOMODE_CUSTOM_P256R1, CryptoPrimitiveService=CRYPTO_SIGNATURE_GENERATE, CryptoPrimitiveAlgorithmSecondaryFamily=CRYPTO_ALGOFAM_SHA1, CryptoPrimitiveAlgorithmFamilyCustomRef=Crypto_30_LibCv_ECCSEC, CryptoPrimitiveAlgorithmModeCustomRef=Crypto_30_LibCv_P256r1
        EcDsaEd25519Generate: CryptoPrimitiveAlgorithmSecondaryFamily=CRYPTO_ALGOFAM_NOT_SET, CryptoPrimitiveAlgorithmMode=CRYPTO_ALGOMODE_NOT_SET, CryptoPrimitiveService=CRYPTO_SIGNATURE_GENERATE, CryptoPrimitiveAlgorithmFamily=CRYPTO_ALGOFAM_ED25519, CryptoPrimitiveAlgorithmSecondaryFamily=CRYPTO_ALGOFAM_SHA2_512
        SHA1: CryptoPrimitiveAlgorithmSecondaryFamily=CRYPTO_ALGOFAM_NOT_SET, CryptoPrimitiveAlgorithmMode=CRYPTO_ALGOMODE_NOT_SET, CryptoPrimitiveService=CRYPTO_HASH, CryptoPrimitiveAlgorithmFamily=CRYPTO_ALGOFAM_SHA1
        EccNistP256R1VerifySha256: CryptoPrimitiveAlgorithmFamily=CRYPTO_ALGOFAM_ECCNIST, CryptoPrimitiveAlgorithmMode=CRYPTO_ALGOMODE_CUSTOM_P256R1, CryptoPrimitiveService=CRYPTO_SIGNATURE_VERIFY, CryptoPrimitiveAlgorithmSecondaryFamily=CRYPTO_ALGOFAM_SHA2_256, CryptoPrimitiveAlgorithmModeCustomRef=Crypto_30_LibCv_P256r1
        RsaPkcs1Sha256Verify: CryptoPrimitiveAlgorithmFamily=CRYPTO_ALGOFAM_RSA, CryptoPrimitiveService=CRYPTO_SIGNATURE_VERIFY, CryptoPrimitiveAlgorithmMode=CRYPTO_ALGOMODE_RSASSA_PKCS1_v1_5, CryptoPrimitiveAlgorithmSecondaryFamily=CRYPTO_ALGOFAM_SHA2_256
        SipHashGenerate: CryptoPrimitiveService=CRYPTO_MAC_GENERATE, CryptoPrimitiveAlgorithmFamily=CRYPTO_ALGOFAM_SIPHASH, CryptoPrimitiveAlgorithmMode=CRYPTO_ALGOMODE_SIPHASH_2_4, CryptoPrimitiveAlgorithmSecondaryFamily=CRYPTO_ALGOFAM_NOT_SET
        AesGCMEncrypt: CryptoPrimitiveAlgorithmSecondaryFamily=CRYPTO_ALGOFAM_NOT_SET, CryptoPrimitiveAlgorithmMode=CRYPTO_ALGOMODE_GCM, CryptoPrimitiveService=CRYPTO_AEADENCRYPT, CryptoPrimitiveAlgorithmFamily=CRYPTO_ALGOFAM_AES
        RsaPkcs1Sha1Verify: CryptoPrimitiveAlgorithmFamily=CRYPTO_ALGOFAM_RSA, CryptoPrimitiveService=CRYPTO_SIGNATURE_VERIFY, CryptoPrimitiveAlgorithmMode=CRYPTO_ALGOMODE_RSASSA_PKCS1_v1_5, CryptoPrimitiveAlgorithmSecondaryFamily=CRYPTO_ALGOFAM_SHA1
        AesEncrypt: CryptoPrimitiveAlgorithmSecondaryFamily=CRYPTO_ALGOFAM_NOT_SET, CryptoPrimitiveAlgorithmMode=CRYPTO_ALGOMODE_ECB, CryptoPrimitiveService=CRYPTO_ENCRYPT, CryptoPrimitiveAlgorithmFamily=CRYPTO_ALGOFAM_AES, CryptoPrimitiveAlgorithmMode=CRYPTO_ALGOMODE_CBC, CryptoPrimitiveAlgorithmSecondaryFamily=CRYPTO_ALGOFAM_CUSTOM_PADDING_PKCS7, CryptoPrimitiveAlgorithmSecondaryFamily=CRYPTO_ALGOFAM_PADDING_ONEWITHZEROS, CryptoPrimitiveAlgorithmMode=CRYPTO_ALGOMODE_CTR, CryptoPrimitiveAlgorithmSecondaryFamilyCustomRef=Crypto_30_LibCv_PaddingPKCS7
        AesCmacGenerate: CryptoPrimitiveAlgorithmSecondaryFamily=CRYPTO_ALGOFAM_NOT_SET, CryptoPrimitiveAlgorithmMode=CRYPTO_ALGOMODE_CMAC, CryptoPrimitiveService=CRYPTO_MAC_GENERATE, CryptoPrimitiveAlgorithmFamily=CRYPTO_ALGOFAM_AES
        EccNistP256R1VerifyWithoutPreHashing: CryptoPrimitiveAlgorithmFamily=CRYPTO_ALGOFAM_ECCNIST, CryptoPrimitiveAlgorithmMode=CRYPTO_ALGOMODE_CUSTOM_P256R1, CryptoPrimitiveService=CRYPTO_SIGNATURE_VERIFY, CryptoPrimitiveAlgorithmSecondaryFamily=CRYPTO_ALGOFAM_NOT_SET, CryptoPrimitiveAlgorithmModeCustomRef=Crypto_30_LibCv_P256r1
        RsaPkcs1CrtSha1Generate: CryptoPrimitiveAlgorithmFamily=CRYPTO_ALGOFAM_RSA, CryptoPrimitiveService=CRYPTO_SIGNATURE_GENERATE, CryptoPrimitiveAlgorithmMode=CRYPTO_ALGOMODE_CUSTOM_RSASSA_PKCS1_v1_5_CRT, CryptoPrimitiveAlgorithmSecondaryFamily=CRYPTO_ALGOFAM_SHA1, CryptoPrimitiveAlgorithmModeCustomRef=Crypto_30_LibCv_RSASSA_PKCS1_v1_5_CRT
        EccAnsiP256R1GenerateSha256: CryptoPrimitiveAlgorithmFamily=CRYPTO_ALGOFAM_CUSTOM_ECCANSI, CryptoPrimitiveAlgorithmMode=CRYPTO_ALGOMODE_CUSTOM_P256R1, CryptoPrimitiveService=CRYPTO_SIGNATURE_GENERATE, CryptoPrimitiveAlgorithmSecondaryFamily=CRYPTO_ALGOFAM_SHA2_256, CryptoPrimitiveAlgorithmFamilyCustomRef=Crypto_30_LibCv_ECCANSI, CryptoPrimitiveAlgorithmModeCustomRef=Crypto_30_LibCv_P256r1
        RsaPssSha256Generate: CryptoPrimitiveAlgorithmFamily=CRYPTO_ALGOFAM_RSA, CryptoPrimitiveService=CRYPTO_SIGNATURE_GENERATE, CryptoPrimitiveAlgorithmMode=CRYPTO_ALGOMODE_RSASSA_PSS, CryptoPrimitiveAlgorithmSecondaryFamily=CRYPTO_ALGOFAM_SHA2_256
        EccSecP256R1VerifySha256: CryptoPrimitiveAlgorithmFamily=CRYPTO_ALGOFAM_CUSTOM_ECCSEC, CryptoPrimitiveAlgorithmMode=CRYPTO_ALGOMODE_CUSTOM_P256R1, CryptoPrimitiveService=CRYPTO_SIGNATURE_VERIFY, CryptoPrimitiveAlgorithmSecondaryFamily=CRYPTO_ALGOFAM_SHA2_256, CryptoPrimitiveAlgorithmFamilyCustomRef=Crypto_30_LibCv_ECCSEC, CryptoPrimitiveAlgorithmModeCustomRef=Crypto_30_LibCv_P256r1
        SHA256: CryptoPrimitiveAlgorithmSecondaryFamily=CRYPTO_ALGOFAM_NOT_SET, CryptoPrimitiveAlgorithmMode=CRYPTO_ALGOMODE_NOT_SET, CryptoPrimitiveService=CRYPTO_HASH, CryptoPrimitiveAlgorithmFamily=CRYPTO_ALGOFAM_SHA2_256
        AesDecrypt: CryptoPrimitiveAlgorithmSecondaryFamily=CRYPTO_ALGOFAM_NOT_SET, CryptoPrimitiveAlgorithmMode=CRYPTO_ALGOMODE_ECB, CryptoPrimitiveService=CRYPTO_DECRYPT, CryptoPrimitiveAlgorithmFamily=CRYPTO_ALGOFAM_AES, CryptoPrimitiveAlgorithmMode=CRYPTO_ALGOMODE_CBC, CryptoPrimitiveAlgorithmSecondaryFamily=CRYPTO_ALGOFAM_CUSTOM_PADDING_PKCS7, CryptoPrimitiveAlgorithmSecondaryFamily=CRYPTO_ALGOFAM_PADDING_ONEWITHZEROS, CryptoPrimitiveAlgorithmMode=CRYPTO_ALGOMODE_CTR, CryptoPrimitiveAlgorithmSecondaryFamilyCustomRef=Crypto_30_LibCv_PaddingPKCS7
        RngFips186Sha1: CryptoPrimitiveAlgorithmMode=CRYPTO_ALGOMODE_NOT_SET, CryptoPrimitiveService=CRYPTO_RANDOM, CryptoPrimitiveAlgorithmFamily=CRYPTO_ALGOFAM_CUSTOM_FIPS186, CryptoPrimitiveAlgorithmSecondaryFamily=CRYPTO_ALGOFAM_SHA1, CryptoPrimitiveAlgorithmFamilyCustomRef=Crypto_30_LibCv_FIPS186
        RsaPkcs1Sha1Generate: CryptoPrimitiveAlgorithmFamily=CRYPTO_ALGOFAM_RSA, CryptoPrimitiveService=CRYPTO_SIGNATURE_GENERATE, CryptoPrimitiveAlgorithmMode=CRYPTO_ALGOMODE_RSASSA_PKCS1_v1_5, CryptoPrimitiveAlgorithmSecondaryFamily=CRYPTO_ALGOFAM_SHA1
        EccNistP256R1GenerateWithoutPreHashing: CryptoPrimitiveAlgorithmFamily=CRYPTO_ALGOFAM_ECCNIST, CryptoPrimitiveAlgorithmMode=CRYPTO_ALGOMODE_CUSTOM_P256R1, CryptoPrimitiveService=CRYPTO_SIGNATURE_GENERATE, CryptoPrimitiveAlgorithmSecondaryFamily=CRYPTO_ALGOFAM_NOT_SET, CryptoPrimitiveAlgorithmModeCustomRef=Crypto_30_LibCv_P256r1
        EccNistP256R1GenerateSha256: CryptoPrimitiveAlgorithmFamily=CRYPTO_ALGOFAM_ECCNIST, CryptoPrimitiveAlgorithmMode=CRYPTO_ALGOMODE_CUSTOM_P256R1, CryptoPrimitiveService=CRYPTO_SIGNATURE_GENERATE, CryptoPrimitiveAlgorithmSecondaryFamily=CRYPTO_ALGOFAM_SHA2_256, CryptoPrimitiveAlgorithmModeCustomRef=Crypto_30_LibCv_P256r1
        RsaPkcs1Encrypt: CryptoPrimitiveAlgorithmFamily=CRYPTO_ALGOFAM_RSA, CryptoPrimitiveService=CRYPTO_ENCRYPT, CryptoPrimitiveAlgorithmMode=CRYPTO_ALGOMODE_RSAES_PKCS1_v1_5, CryptoPrimitiveAlgorithmSecondaryFamily=CRYPTO_ALGOFAM_NOT_SET
        HmacSha256Generate: CryptoPrimitiveAlgorithmFamily=CRYPTO_ALGOFAM_SHA2_256, CryptoPrimitiveAlgorithmMode=CRYPTO_ALGOMODE_HMAC, CryptoPrimitiveAlgorithmSecondaryFamily=CRYPTO_ALGOFAM_NOT_SET, CryptoPrimitiveService=CRYPTO_MAC_GENERATE
        EccSecP256R1VerifySha1: CryptoPrimitiveAlgorithmFamily=CRYPTO_ALGOFAM_CUSTOM_ECCSEC, CryptoPrimitiveAlgorithmMode=CRYPTO_ALGOMODE_CUSTOM_P256R1, CryptoPrimitiveService=CRYPTO_SIGNATURE_VERIFY, CryptoPrimitiveAlgorithmSecondaryFamily=CRYPTO_ALGOFAM_SHA1, CryptoPrimitiveAlgorithmFamilyCustomRef=Crypto_30_LibCv_ECCSEC, CryptoPrimitiveAlgorithmModeCustomRef=Crypto_30_LibCv_P256r1
        EccAnsiP256R1VerifyWithoutPreHashing: CryptoPrimitiveAlgorithmFamily=CRYPTO_ALGOFAM_CUSTOM_ECCANSI, CryptoPrimitiveAlgorithmMode=CRYPTO_ALGOMODE_CUSTOM_P256R1, CryptoPrimitiveService=CRYPTO_SIGNATURE_VERIFY, CryptoPrimitiveAlgorithmSecondaryFamily=CRYPTO_ALGOFAM_NOT_SET, CryptoPrimitiveAlgorithmFamilyCustomRef=Crypto_30_LibCv_ECCANSI, CryptoPrimitiveAlgorithmModeCustomRef=Crypto_30_LibCv_P256r1
        EccSecP256R1GenerateWithoutPreHashing: CryptoPrimitiveAlgorithmFamily=CRYPTO_ALGOFAM_CUSTOM_ECCSEC, CryptoPrimitiveAlgorithmMode=CRYPTO_ALGOMODE_CUSTOM_P256R1, CryptoPrimitiveService=CRYPTO_SIGNATURE_GENERATE, CryptoPrimitiveAlgorithmSecondaryFamily=CRYPTO_ALGOFAM_NOT_SET, CryptoPrimitiveAlgorithmFamilyCustomRef=Crypto_30_LibCv_ECCSEC, CryptoPrimitiveAlgorithmModeCustomRef=Crypto_30_LibCv_P256r1
        SipHashVerify: CryptoPrimitiveService=CRYPTO_MAC_VERIFY, CryptoPrimitiveAlgorithmFamily=CRYPTO_ALGOFAM_SIPHASH, CryptoPrimitiveAlgorithmMode=CRYPTO_ALGOMODE_SIPHASH_2_4, CryptoPrimitiveAlgorithmSecondaryFamily=CRYPTO_ALGOFAM_NOT_SET
        EccSecP256R1GenerateSha256: CryptoPrimitiveAlgorithmFamily=CRYPTO_ALGOFAM_CUSTOM_ECCSEC, CryptoPrimitiveAlgorithmMode=CRYPTO_ALGOMODE_CUSTOM_P256R1, CryptoPrimitiveService=CRYPTO_SIGNATURE_GENERATE, CryptoPrimitiveAlgorithmSecondaryFamily=CRYPTO_ALGOFAM_SHA2_256, CryptoPrimitiveAlgorithmFamilyCustomRef=Crypto_30_LibCv_ECCSEC, CryptoPrimitiveAlgorithmModeCustomRef=Crypto_30_LibCv_P256r1
        RsaPkcs1Decrypt: CryptoPrimitiveAlgorithmFamily=CRYPTO_ALGOFAM_RSA, CryptoPrimitiveService=CRYPTO_DECRYPT, CryptoPrimitiveAlgorithmMode=CRYPTO_ALGOMODE_RSAES_PKCS1_v1_5, CryptoPrimitiveAlgorithmSecondaryFamily=CRYPTO_ALGOFAM_NOT_SET
        EccAnsiP256R1VerifySha1: CryptoPrimitiveAlgorithmFamily=CRYPTO_ALGOFAM_CUSTOM_ECCANSI, CryptoPrimitiveAlgorithmMode=CRYPTO_ALGOMODE_CUSTOM_P256R1, CryptoPrimitiveService=CRYPTO_SIGNATURE_VERIFY, CryptoPrimitiveAlgorithmSecondaryFamily=CRYPTO_ALGOFAM_SHA1, CryptoPrimitiveAlgorithmFamilyCustomRef=Crypto_30_LibCv_ECCANSI, CryptoPrimitiveAlgorithmModeCustomRef=Crypto_30_LibCv_P256r1
        HmacSha256Verify: CryptoPrimitiveAlgorithmFamily=CRYPTO_ALGOFAM_SHA2_256, CryptoPrimitiveAlgorithmMode=CRYPTO_ALGOMODE_HMAC, CryptoPrimitiveAlgorithmSecondaryFamily=CRYPTO_ALGOFAM_NOT_SET, CryptoPrimitiveService=CRYPTO_MAC_VERIFY
        EccAnsiP256R1VerifySha256: CryptoPrimitiveAlgorithmFamily=CRYPTO_ALGOFAM_CUSTOM_ECCANSI, CryptoPrimitiveAlgorithmMode=CRYPTO_ALGOMODE_CUSTOM_P256R1, CryptoPrimitiveService=CRYPTO_SIGNATURE_VERIFY, CryptoPrimitiveAlgorithmSecondaryFamily=CRYPTO_ALGOFAM_SHA2_256, CryptoPrimitiveAlgorithmFamilyCustomRef=Crypto_30_LibCv_ECCANSI, CryptoPrimitiveAlgorithmModeCustomRef=Crypto_30_LibCv_P256r1
        RsaPkcs1Sha256Generate: CryptoPrimitiveAlgorithmFamily=CRYPTO_ALGOFAM_RSA, CryptoPrimitiveService=CRYPTO_SIGNATURE_GENERATE, CryptoPrimitiveAlgorithmMode=CRYPTO_ALGOMODE_RSASSA_PKCS1_v1_5, CryptoPrimitiveAlgorithmSecondaryFamily=CRYPTO_ALGOFAM_SHA2_256
        RsaPssSha1Verify: CryptoPrimitiveAlgorithmFamily=CRYPTO_ALGOFAM_RSA, CryptoPrimitiveService=CRYPTO_SIGNATURE_VERIFY, CryptoPrimitiveAlgorithmMode=CRYPTO_ALGOMODE_RSASSA_PSS, CryptoPrimitiveAlgorithmSecondaryFamily=CRYPTO_ALGOFAM_SHA1
        EccSecP256R1VerifyWithoutPreHashing: CryptoPrimitiveAlgorithmFamily=CRYPTO_ALGOFAM_CUSTOM_ECCSEC, CryptoPrimitiveAlgorithmMode=CRYPTO_ALGOMODE_CUSTOM_P256R1, CryptoPrimitiveService=CRYPTO_SIGNATURE_VERIFY, CryptoPrimitiveAlgorithmSecondaryFamily=CRYPTO_ALGOFAM_NOT_SET, CryptoPrimitiveAlgorithmFamilyCustomRef=Crypto_30_LibCv_ECCSEC, CryptoPrimitiveAlgorithmModeCustomRef=Crypto_30_LibCv_P256r1
        RngDrbgAes128: CryptoPrimitiveAlgorithmMode=CRYPTO_ALGOMODE_NOT_SET, CryptoPrimitiveService=CRYPTO_RANDOM, CryptoPrimitiveAlgorithmFamily=CRYPTO_ALGOFAM_CUSTOM_DRBG, CryptoPrimitiveAlgorithmSecondaryFamily=CRYPTO_ALGOFAM_AES, CryptoPrimitiveAlgorithmFamilyCustomRef=Crypto_30_LibCv_DRBG
        EccAnsiP256R1GenerateSha1: CryptoPrimitiveAlgorithmFamily=CRYPTO_ALGOFAM_CUSTOM_ECCANSI, CryptoPrimitiveAlgorithmMode=CRYPTO_ALGOMODE_CUSTOM_P256R1, CryptoPrimitiveService=CRYPTO_SIGNATURE_GENERATE, CryptoPrimitiveAlgorithmSecondaryFamily=CRYPTO_ALGOFAM_SHA1, CryptoPrimitiveAlgorithmFamilyCustomRef=Crypto_30_LibCv_ECCANSI, CryptoPrimitiveAlgorithmModeCustomRef=Crypto_30_LibCv_P256r1
        SHA512: CryptoPrimitiveAlgorithmSecondaryFamily=CRYPTO_ALGOFAM_NOT_SET, CryptoPrimitiveAlgorithmMode=CRYPTO_ALGOMODE_NOT_SET, CryptoPrimitiveService=CRYPTO_HASH, CryptoPrimitiveAlgorithmFamily=CRYPTO_ALGOFAM_SHA2_512
        AesGCMDecrypt: CryptoPrimitiveAlgorithmSecondaryFamily=CRYPTO_ALGOFAM_NOT_SET, CryptoPrimitiveAlgorithmMode=CRYPTO_ALGOMODE_GCM, CryptoPrimitiveService=CRYPTO_AEADDECRYPT, CryptoPrimitiveAlgorithmFamily=CRYPTO_ALGOFAM_AES
        RsaPssSha1Generate: CryptoPrimitiveAlgorithmFamily=CRYPTO_ALGOFAM_RSA, CryptoPrimitiveService=CRYPTO_SIGNATURE_GENERATE, CryptoPrimitiveAlgorithmMode=CRYPTO_ALGOMODE_RSASSA_PSS, CryptoPrimitiveAlgorithmSecondaryFamily=CRYPTO_ALGOFAM_SHA1
        EccAnsiP256R1GenerateWithoutPreHashing: CryptoPrimitiveAlgorithmFamily=CRYPTO_ALGOFAM_CUSTOM_ECCANSI, CryptoPrimitiveAlgorithmMode=CRYPTO_ALGOMODE_CUSTOM_P256R1, CryptoPrimitiveService=CRYPTO_SIGNATURE_GENERATE, CryptoPrimitiveAlgorithmSecondaryFamily=CRYPTO_ALGOFAM_NOT_SET, CryptoPrimitiveAlgorithmFamilyCustomRef=Crypto_30_LibCv_ECCANSI, CryptoPrimitiveAlgorithmModeCustomRef=Crypto_30_LibCv_P256r1
        AesCmacVerify: CryptoPrimitiveAlgorithmSecondaryFamily=CRYPTO_ALGOFAM_NOT_SET, CryptoPrimitiveAlgorithmMode=CRYPTO_ALGOMODE_CMAC, CryptoPrimitiveService=CRYPTO_MAC_VERIFY, CryptoPrimitiveAlgorithmFamily=CRYPTO_ALGOFAM_AES
        EccNistP384R1GenerateWithoutPreHashing: CryptoPrimitiveAlgorithmFamily=CRYPTO_ALGOFAM_ECCNIST, CryptoPrimitiveAlgorithmMode=CRYPTO_ALGOMODE_CUSTOM_P384R1, CryptoPrimitiveService=CRYPTO_SIGNATURE_GENERATE, CryptoPrimitiveAlgorithmSecondaryFamily=CRYPTO_ALGOFAM_NOT_SET, CryptoPrimitiveAlgorithmModeCustomRef=Crypto_30_LibCv_P384r1
        EccNistP384R1VerifyWithoutPreHashing: CryptoPrimitiveAlgorithmFamily=CRYPTO_ALGOFAM_ECCNIST, CryptoPrimitiveAlgorithmMode=CRYPTO_ALGOMODE_CUSTOM_P384R1, CryptoPrimitiveService=CRYPTO_SIGNATURE_VERIFY, CryptoPrimitiveAlgorithmSecondaryFamily=CRYPTO_ALGOFAM_NOT_SET, CryptoPrimitiveAlgorithmModeCustomRef=Crypto_30_LibCv_P384r1
        EccSecP384R1GenerateWithoutPreHashing: CryptoPrimitiveAlgorithmFamily=CRYPTO_ALGOFAM_CUSTOM_ECCSEC, CryptoPrimitiveAlgorithmMode=CRYPTO_ALGOMODE_CUSTOM_P384R1, CryptoPrimitiveService=CRYPTO_SIGNATURE_GENERATE, CryptoPrimitiveAlgorithmSecondaryFamily=CRYPTO_ALGOFAM_NOT_SET, CryptoPrimitiveAlgorithmModeCustomRef=Crypto_30_LibCv_P384r1, CryptoPrimitiveAlgorithmFamilyCustomRef=Crypto_30_LibCv_ECCSEC
        EccSecP384R1VerifyWithoutPreHashing: CryptoPrimitiveAlgorithmFamily=CRYPTO_ALGOFAM_CUSTOM_ECCSEC, CryptoPrimitiveAlgorithmMode=CRYPTO_ALGOMODE_CUSTOM_P384R1, CryptoPrimitiveService=CRYPTO_SIGNATURE_VERIFY, CryptoPrimitiveAlgorithmSecondaryFamily=CRYPTO_ALGOFAM_NOT_SET, CryptoPrimitiveAlgorithmModeCustomRef=Crypto_30_LibCv_P384r1, CryptoPrimitiveAlgorithmFamilyCustomRef=Crypto_30_LibCv_ECCSEC
        EccNistP384R1GenerateSha1: CryptoPrimitiveAlgorithmFamily=CRYPTO_ALGOFAM_ECCNIST, CryptoPrimitiveAlgorithmMode=CRYPTO_ALGOMODE_CUSTOM_P384R1, CryptoPrimitiveService=CRYPTO_SIGNATURE_GENERATE, CryptoPrimitiveAlgorithmSecondaryFamily=CRYPTO_ALGOFAM_SHA1, CryptoPrimitiveAlgorithmModeCustomRef=Crypto_30_LibCv_P384r1
        EccNistP384R1GenerateSha256: CryptoPrimitiveAlgorithmFamily=CRYPTO_ALGOFAM_ECCNIST, CryptoPrimitiveAlgorithmMode=CRYPTO_ALGOMODE_CUSTOM_P384R1, CryptoPrimitiveService=CRYPTO_SIGNATURE_GENERATE, CryptoPrimitiveAlgorithmSecondaryFamily=CRYPTO_ALGOFAM_SHA2_256, CryptoPrimitiveAlgorithmModeCustomRef=Crypto_30_LibCv_P384r1
        EccNistP384R1VerifySha1: CryptoPrimitiveAlgorithmFamily=CRYPTO_ALGOFAM_ECCNIST, CryptoPrimitiveAlgorithmMode=CRYPTO_ALGOMODE_CUSTOM_P384R1, CryptoPrimitiveService=CRYPTO_SIGNATURE_VERIFY, CryptoPrimitiveAlgorithmSecondaryFamily=CRYPTO_ALGOFAM_SHA1, CryptoPrimitiveAlgorithmModeCustomRef=Crypto_30_LibCv_P384r1
        EccNistP384R1VerifySha256: CryptoPrimitiveAlgorithmFamily=CRYPTO_ALGOFAM_ECCNIST, CryptoPrimitiveAlgorithmMode=CRYPTO_ALGOMODE_CUSTOM_P384R1, CryptoPrimitiveService=CRYPTO_SIGNATURE_VERIFY, CryptoPrimitiveAlgorithmSecondaryFamily=CRYPTO_ALGOFAM_SHA2_256, CryptoPrimitiveAlgorithmModeCustomRef=Crypto_30_LibCv_P384r1
        EccSecP384R1GenerateSha1: CryptoPrimitiveAlgorithmFamily=CRYPTO_ALGOFAM_CUSTOM_ECCSEC, CryptoPrimitiveAlgorithmMode=CRYPTO_ALGOMODE_CUSTOM_P384R1, CryptoPrimitiveService=CRYPTO_SIGNATURE_GENERATE, CryptoPrimitiveAlgorithmSecondaryFamily=CRYPTO_ALGOFAM_SHA1, CryptoPrimitiveAlgorithmFamilyCustomRef=Crypto_30_LibCv_ECCSEC, CryptoPrimitiveAlgorithmModeCustomRef=Crypto_30_LibCv_P384r1
        EccSecP384R1GenerateSha256: CryptoPrimitiveAlgorithmFamily=CRYPTO_ALGOFAM_CUSTOM_ECCSEC, CryptoPrimitiveAlgorithmMode=CRYPTO_ALGOMODE_CUSTOM_P384R1, CryptoPrimitiveService=CRYPTO_SIGNATURE_GENERATE, CryptoPrimitiveAlgorithmSecondaryFamily=CRYPTO_ALGOFAM_SHA2_256, CryptoPrimitiveAlgorithmFamilyCustomRef=Crypto_30_LibCv_ECCSEC, CryptoPrimitiveAlgorithmModeCustomRef=Crypto_30_LibCv_P384r1
        EccSecP384R1VerifySha1: CryptoPrimitiveAlgorithmFamily=CRYPTO_ALGOFAM_CUSTOM_ECCSEC, CryptoPrimitiveAlgorithmMode=CRYPTO_ALGOMODE_CUSTOM_P384R1, CryptoPrimitiveService=CRYPTO_SIGNATURE_VERIFY, CryptoPrimitiveAlgorithmSecondaryFamily=CRYPTO_ALGOFAM_SHA1, CryptoPrimitiveAlgorithmFamilyCustomRef=Crypto_30_LibCv_ECCSEC, CryptoPrimitiveAlgorithmModeCustomRef=Crypto_30_LibCv_P384r1
        EccSecP384R1VerifySha256: CryptoPrimitiveAlgorithmFamily=CRYPTO_ALGOFAM_CUSTOM_ECCSEC, CryptoPrimitiveAlgorithmMode=CRYPTO_ALGOMODE_CUSTOM_P384R1, CryptoPrimitiveService=CRYPTO_SIGNATURE_VERIFY, CryptoPrimitiveAlgorithmSecondaryFamily=CRYPTO_ALGOFAM_SHA2_256, CryptoPrimitiveAlgorithmFamilyCustomRef=Crypto_30_LibCv_ECCSEC, CryptoPrimitiveAlgorithmModeCustomRef=Crypto_30_LibCv_P384r1
        RsaOaepSha1Encrypt: CryptoPrimitiveAlgorithmFamily=CRYPTO_ALGOFAM_RSA, CryptoPrimitiveAlgorithmMode=CRYPTO_ALGOMODE_RSAES_OAEP, CryptoPrimitiveAlgorithmSecondaryFamily=CRYPTO_ALGOFAM_SHA1, CryptoPrimitiveService=CRYPTO_ENCRYPT
        RsaOaepSha1Decrypt: CryptoPrimitiveAlgorithmFamily=CRYPTO_ALGOFAM_RSA, CryptoPrimitiveAlgorithmMode=CRYPTO_ALGOMODE_RSAES_OAEP, CryptoPrimitiveAlgorithmSecondaryFamily=CRYPTO_ALGOFAM_SHA1, CryptoPrimitiveService=CRYPTO_DECRYPT
        RsaOaepSha256Encrypt: CryptoPrimitiveAlgorithmFamily=CRYPTO_ALGOFAM_RSA, CryptoPrimitiveAlgorithmMode=CRYPTO_ALGOMODE_RSAES_OAEP, CryptoPrimitiveAlgorithmSecondaryFamily=CRYPTO_ALGOFAM_SHA2_256, CryptoPrimitiveService=CRYPTO_ENCRYPT
        RsaOaepSha256Decrypt: CryptoPrimitiveAlgorithmFamily=CRYPTO_ALGOFAM_RSA, CryptoPrimitiveAlgorithmMode=CRYPTO_ALGOMODE_RSAES_OAEP, CryptoPrimitiveAlgorithmSecondaryFamily=CRYPTO_ALGOFAM_SHA2_256, CryptoPrimitiveService=CRYPTO_DECRYPT
        RsaOaepCrtSha1Decrypt: CryptoPrimitiveAlgorithmFamily=CRYPTO_ALGOFAM_RSA, CryptoPrimitiveAlgorithmMode=CRYPTO_ALGOMODE_CUSTOM_RSAES_OAEP_CRT, CryptoPrimitiveAlgorithmSecondaryFamily=CRYPTO_ALGOFAM_SHA1, CryptoPrimitiveService=CRYPTO_DECRYPT, CryptoPrimitiveAlgorithmModeCustomRef=Crypto_30_LibCv_RSAES_OAEP_CRT
        RsaOaepCrtSha256Decrypt: CryptoPrimitiveAlgorithmFamily=CRYPTO_ALGOFAM_RSA, CryptoPrimitiveAlgorithmMode=CRYPTO_ALGOMODE_CUSTOM_RSAES_OAEP_CRT, CryptoPrimitiveAlgorithmSecondaryFamily=CRYPTO_ALGOFAM_SHA2_256, CryptoPrimitiveService=CRYPTO_DECRYPT, CryptoPrimitiveAlgorithmModeCustomRef=Crypto_30_LibCv_RSAES_OAEP_CRT
        EccNistP256R1GenerateSha512: CryptoPrimitiveAlgorithmFamily=CRYPTO_ALGOFAM_ECCNIST, CryptoPrimitiveAlgorithmMode=CRYPTO_ALGOMODE_CUSTOM_P256R1, CryptoPrimitiveService=CRYPTO_SIGNATURE_GENERATE, CryptoPrimitiveAlgorithmSecondaryFamily=CRYPTO_ALGOFAM_SHA2_512, CryptoPrimitiveAlgorithmModeCustomRef=Crypto_30_LibCv_P256r1
        EccNistP256R1VerifySha512: CryptoPrimitiveAlgorithmFamily=CRYPTO_ALGOFAM_ECCNIST, CryptoPrimitiveAlgorithmMode=CRYPTO_ALGOMODE_CUSTOM_P256R1, CryptoPrimitiveService=CRYPTO_SIGNATURE_VERIFY, CryptoPrimitiveAlgorithmSecondaryFamily=CRYPTO_ALGOFAM_SHA2_512, CryptoPrimitiveAlgorithmModeCustomRef=Crypto_30_LibCv_P256r1
        EccAnsiP256R1GenerateSha512: CryptoPrimitiveAlgorithmFamily=CRYPTO_ALGOFAM_CUSTOM_ECCANSI, CryptoPrimitiveAlgorithmMode=CRYPTO_ALGOMODE_CUSTOM_P256R1, CryptoPrimitiveService=CRYPTO_SIGNATURE_GENERATE, CryptoPrimitiveAlgorithmSecondaryFamily=CRYPTO_ALGOFAM_SHA2_512, CryptoPrimitiveAlgorithmFamilyCustomRef=Crypto_30_LibCv_ECCANSI, CryptoPrimitiveAlgorithmModeCustomRef=Crypto_30_LibCv_P256r1
        EccAnsiP256R1VerifySha512: CryptoPrimitiveAlgorithmFamily=CRYPTO_ALGOFAM_CUSTOM_ECCANSI, CryptoPrimitiveAlgorithmMode=CRYPTO_ALGOMODE_CUSTOM_P256R1, CryptoPrimitiveService=CRYPTO_SIGNATURE_VERIFY, CryptoPrimitiveAlgorithmSecondaryFamily=CRYPTO_ALGOFAM_SHA2_512, CryptoPrimitiveAlgorithmFamilyCustomRef=Crypto_30_LibCv_ECCANSI, CryptoPrimitiveAlgorithmModeCustomRef=Crypto_30_LibCv_P256r1
        EccSecP256R1GenerateSha512: CryptoPrimitiveAlgorithmFamily=CRYPTO_ALGOFAM_CUSTOM_ECCSEC, CryptoPrimitiveAlgorithmMode=CRYPTO_ALGOMODE_CUSTOM_P256R1, CryptoPrimitiveService=CRYPTO_SIGNATURE_GENERATE, CryptoPrimitiveAlgorithmSecondaryFamily=CRYPTO_ALGOFAM_SHA2_512, CryptoPrimitiveAlgorithmFamilyCustomRef=Crypto_30_LibCv_ECCSEC, CryptoPrimitiveAlgorithmModeCustomRef=Crypto_30_LibCv_P256r1
        EccSecP256R1VerifySha512: CryptoPrimitiveAlgorithmFamily=CRYPTO_ALGOFAM_CUSTOM_ECCSEC, CryptoPrimitiveAlgorithmMode=CRYPTO_ALGOMODE_CUSTOM_P256R1, CryptoPrimitiveService=CRYPTO_SIGNATURE_VERIFY, CryptoPrimitiveAlgorithmSecondaryFamily=CRYPTO_ALGOFAM_SHA2_512, CryptoPrimitiveAlgorithmFamilyCustomRef=Crypto_30_LibCv_ECCSEC, CryptoPrimitiveAlgorithmModeCustomRef=Crypto_30_LibCv_P256r1
        EccNistP384R1GenerateSha512: CryptoPrimitiveAlgorithmFamily=CRYPTO_ALGOFAM_ECCNIST, CryptoPrimitiveAlgorithmMode=CRYPTO_ALGOMODE_CUSTOM_P384R1, CryptoPrimitiveService=CRYPTO_SIGNATURE_GENERATE, CryptoPrimitiveAlgorithmSecondaryFamily=CRYPTO_ALGOFAM_SHA2_512, CryptoPrimitiveAlgorithmModeCustomRef=Crypto_30_LibCv_P384r1
        EccNistP384R1VerifySha512: CryptoPrimitiveAlgorithmFamily=CRYPTO_ALGOFAM_ECCNIST, CryptoPrimitiveAlgorithmMode=CRYPTO_ALGOMODE_CUSTOM_P384R1, CryptoPrimitiveService=CRYPTO_SIGNATURE_VERIFY, CryptoPrimitiveAlgorithmSecondaryFamily=CRYPTO_ALGOFAM_SHA2_512, CryptoPrimitiveAlgorithmModeCustomRef=Crypto_30_LibCv_P384r1
        EccSecP384R1GenerateSha512: CryptoPrimitiveAlgorithmFamily=CRYPTO_ALGOFAM_CUSTOM_ECCSEC, CryptoPrimitiveAlgorithmMode=CRYPTO_ALGOMODE_CUSTOM_P384R1, CryptoPrimitiveService=CRYPTO_SIGNATURE_GENERATE, CryptoPrimitiveAlgorithmSecondaryFamily=CRYPTO_ALGOFAM_SHA2_512, CryptoPrimitiveAlgorithmFamilyCustomRef=Crypto_30_LibCv_ECCSEC, CryptoPrimitiveAlgorithmModeCustomRef=Crypto_30_LibCv_P384r1
        EccSecP384R1VerifySha512: CryptoPrimitiveAlgorithmFamily=CRYPTO_ALGOFAM_CUSTOM_ECCSEC, CryptoPrimitiveAlgorithmMode=CRYPTO_ALGOMODE_CUSTOM_P384R1, CryptoPrimitiveService=CRYPTO_SIGNATURE_VERIFY, CryptoPrimitiveAlgorithmSecondaryFamily=CRYPTO_ALGOFAM_SHA2_512, CryptoPrimitiveAlgorithmFamilyCustomRef=Crypto_30_LibCv_ECCSEC, CryptoPrimitiveAlgorithmModeCustomRef=Crypto_30_LibCv_P384r1
        SHA384: CryptoPrimitiveAlgorithmSecondaryFamily=CRYPTO_ALGOFAM_NOT_SET, CryptoPrimitiveAlgorithmMode=CRYPTO_ALGOMODE_NOT_SET, CryptoPrimitiveService=CRYPTO_HASH, CryptoPrimitiveAlgorithmFamily=CRYPTO_ALGOFAM_SHA2_384
        EccNistP256R1GenerateSha384: CryptoPrimitiveAlgorithmFamily=CRYPTO_ALGOFAM_ECCNIST, CryptoPrimitiveAlgorithmMode=CRYPTO_ALGOMODE_CUSTOM_P256R1, CryptoPrimitiveService=CRYPTO_SIGNATURE_GENERATE, CryptoPrimitiveAlgorithmSecondaryFamily=CRYPTO_ALGOFAM_SHA2_384, CryptoPrimitiveAlgorithmModeCustomRef=Crypto_30_LibCv_P256r1
        EccNistP256R1VerifySha384: CryptoPrimitiveAlgorithmFamily=CRYPTO_ALGOFAM_ECCNIST, CryptoPrimitiveAlgorithmMode=CRYPTO_ALGOMODE_CUSTOM_P256R1, CryptoPrimitiveService=CRYPTO_SIGNATURE_VERIFY, CryptoPrimitiveAlgorithmSecondaryFamily=CRYPTO_ALGOFAM_SHA2_384, CryptoPrimitiveAlgorithmModeCustomRef=Crypto_30_LibCv_P256r1
        EccAnsiP256R1GenerateSha384: CryptoPrimitiveAlgorithmFamily=CRYPTO_ALGOFAM_CUSTOM_ECCANSI, CryptoPrimitiveAlgorithmMode=CRYPTO_ALGOMODE_CUSTOM_P256R1, CryptoPrimitiveService=CRYPTO_SIGNATURE_GENERATE, CryptoPrimitiveAlgorithmSecondaryFamily=CRYPTO_ALGOFAM_SHA2_384, CryptoPrimitiveAlgorithmFamilyCustomRef=Crypto_30_LibCv_ECCANSI, CryptoPrimitiveAlgorithmModeCustomRef=Crypto_30_LibCv_P256r1
        EccAnsiP256R1VerifySha384: CryptoPrimitiveAlgorithmFamily=CRYPTO_ALGOFAM_CUSTOM_ECCANSI, CryptoPrimitiveAlgorithmMode=CRYPTO_ALGOMODE_CUSTOM_P256R1, CryptoPrimitiveService=CRYPTO_SIGNATURE_VERIFY, CryptoPrimitiveAlgorithmSecondaryFamily=CRYPTO_ALGOFAM_SHA2_384, CryptoPrimitiveAlgorithmFamilyCustomRef=Crypto_30_LibCv_ECCANSI, CryptoPrimitiveAlgorithmModeCustomRef=Crypto_30_LibCv_P256r1
        EccSecP256R1GenerateSha384: CryptoPrimitiveAlgorithmFamily=CRYPTO_ALGOFAM_CUSTOM_ECCSEC, CryptoPrimitiveAlgorithmMode=CRYPTO_ALGOMODE_CUSTOM_P256R1, CryptoPrimitiveService=CRYPTO_SIGNATURE_GENERATE, CryptoPrimitiveAlgorithmSecondaryFamily=CRYPTO_ALGOFAM_SHA2_384, CryptoPrimitiveAlgorithmFamilyCustomRef=Crypto_30_LibCv_ECCSEC, CryptoPrimitiveAlgorithmModeCustomRef=Crypto_30_LibCv_P256r1
        EccSecP256R1VerifySha384: CryptoPrimitiveAlgorithmFamily=CRYPTO_ALGOFAM_CUSTOM_ECCSEC, CryptoPrimitiveAlgorithmMode=CRYPTO_ALGOMODE_CUSTOM_P256R1, CryptoPrimitiveService=CRYPTO_SIGNATURE_VERIFY, CryptoPrimitiveAlgorithmSecondaryFamily=CRYPTO_ALGOFAM_SHA2_384, CryptoPrimitiveAlgorithmFamilyCustomRef=Crypto_30_LibCv_ECCSEC, CryptoPrimitiveAlgorithmModeCustomRef=Crypto_30_LibCv_P256r1
        EccNistP384R1GenerateSha384: CryptoPrimitiveAlgorithmFamily=CRYPTO_ALGOFAM_ECCNIST, CryptoPrimitiveAlgorithmMode=CRYPTO_ALGOMODE_CUSTOM_P384R1, CryptoPrimitiveService=CRYPTO_SIGNATURE_GENERATE, CryptoPrimitiveAlgorithmSecondaryFamily=CRYPTO_ALGOFAM_SHA2_384, CryptoPrimitiveAlgorithmModeCustomRef=Crypto_30_LibCv_P384r1
        EccNistP384R1VerifySha384: CryptoPrimitiveAlgorithmFamily=CRYPTO_ALGOFAM_ECCNIST, CryptoPrimitiveAlgorithmMode=CRYPTO_ALGOMODE_CUSTOM_P384R1, CryptoPrimitiveService=CRYPTO_SIGNATURE_VERIFY, CryptoPrimitiveAlgorithmSecondaryFamily=CRYPTO_ALGOFAM_SHA2_384, CryptoPrimitiveAlgorithmModeCustomRef=Crypto_30_LibCv_P384r1
        EccSecP384R1GenerateSha384: CryptoPrimitiveAlgorithmFamily=CRYPTO_ALGOFAM_CUSTOM_ECCSEC, CryptoPrimitiveAlgorithmMode=CRYPTO_ALGOMODE_CUSTOM_P384R1, CryptoPrimitiveService=CRYPTO_SIGNATURE_GENERATE, CryptoPrimitiveAlgorithmSecondaryFamily=CRYPTO_ALGOFAM_SHA2_384, CryptoPrimitiveAlgorithmFamilyCustomRef=Crypto_30_LibCv_ECCSEC, CryptoPrimitiveAlgorithmModeCustomRef=Crypto_30_LibCv_P384r1
        EccSecP384R1VerifySha384: CryptoPrimitiveAlgorithmFamily=CRYPTO_ALGOFAM_CUSTOM_ECCSEC, CryptoPrimitiveAlgorithmMode=CRYPTO_ALGOMODE_CUSTOM_P384R1, CryptoPrimitiveService=CRYPTO_SIGNATURE_VERIFY, CryptoPrimitiveAlgorithmSecondaryFamily=CRYPTO_ALGOFAM_SHA2_384, CryptoPrimitiveAlgorithmFamilyCustomRef=Crypto_30_LibCv_ECCSEC, CryptoPrimitiveAlgorithmModeCustomRef=Crypto_30_LibCv_P384r1
        GmacAesGenerate: CryptoPrimitiveAlgorithmSecondaryFamily=CRYPTO_ALGOFAM_NOT_SET, CryptoPrimitiveAlgorithmMode=CRYPTO_ALGOMODE_GMAC, CryptoPrimitiveService=CRYPTO_MAC_GENERATE, CryptoPrimitiveAlgorithmFamily=CRYPTO_ALGOFAM_AES
        GmacAesVerify: CryptoPrimitiveAlgorithmSecondaryFamily=CRYPTO_ALGOFAM_NOT_SET, CryptoPrimitiveAlgorithmMode=CRYPTO_ALGOMODE_GMAC, CryptoPrimitiveService=CRYPTO_MAC_VERIFY, CryptoPrimitiveAlgorithmFamily=CRYPTO_ALGOFAM_AES
        HmacSha384Generate: CryptoPrimitiveAlgorithmFamily=CRYPTO_ALGOFAM_SHA2_384, CryptoPrimitiveAlgorithmMode=CRYPTO_ALGOMODE_HMAC, CryptoPrimitiveAlgorithmSecondaryFamily=CRYPTO_ALGOFAM_NOT_SET, CryptoPrimitiveService=CRYPTO_MAC_GENERATE
        HmacSha384Verify: CryptoPrimitiveAlgorithmFamily=CRYPTO_ALGOFAM_SHA2_384, CryptoPrimitiveAlgorithmMode=CRYPTO_ALGOMODE_HMAC, CryptoPrimitiveAlgorithmSecondaryFamily=CRYPTO_ALGOFAM_NOT_SET, CryptoPrimitiveService=CRYPTO_MAC_VERIFY
        KeySetValid: CryptoPrimitiveService=CRYPTO_KEY_SET_VALID, CryptoPrimitiveAlgorithmFamily=CRYPTO_ALGOFAM_NOT_SET, CryptoPrimitiveAlgorithmMode=CRYPTO_ALGOMODE_NOT_SET, CryptoPrimitiveAlgorithmSecondaryFamily=CRYPTO_ALGOFAM_NOT_SET
        KeyDeriveX963SHA256: CryptoPrimitiveService=CRYPTO_KEY_DERIVE, CryptoPrimitiveAlgorithmFamily=CRYPTO_ALGOFAM_KDFX963, CryptoPrimitiveAlgorithmMode=CRYPTO_ALGOMODE_NOT_SET, CryptoPrimitiveAlgorithmSecondaryFamily=CRYPTO_ALGOFAM_SHA2_256
        KeyExchangeCalcPubValX25519: CryptoPrimitiveService=CRYPTO_KEY_EXCHANGE_CALC_PUBVAL, CryptoPrimitiveAlgorithmFamily=CRYPTO_ALGOFAM_CUSTOM_X25519, CryptoPrimitiveAlgorithmMode=CRYPTO_ALGOMODE_NOT_SET, CryptoPrimitiveAlgorithmSecondaryFamily=CRYPTO_ALGOFAM_NOT_SET, CryptoPrimitiveAlgorithmFamilyCustomRef=Crypto_30_LibCv_X25519
        KeyExchangeCalcSecretX25519: CryptoPrimitiveService=CRYPTO_KEY_EXCHANGE_CALC_SECRET, CryptoPrimitiveAlgorithmFamily=CRYPTO_ALGOFAM_CUSTOM_X25519, CryptoPrimitiveAlgorithmMode=CRYPTO_ALGOMODE_NOT_SET, CryptoPrimitiveAlgorithmSecondaryFamily=CRYPTO_ALGOFAM_NOT_SET, CryptoPrimitiveAlgorithmFamilyCustomRef=Crypto_30_LibCv_X25519
        KeyExchangeCalcPubValSecP256R1: CryptoPrimitiveService=CRYPTO_KEY_EXCHANGE_CALC_PUBVAL, CryptoPrimitiveAlgorithmFamily=CRYPTO_ALGOFAM_ECCSEC, CryptoPrimitiveAlgorithmMode=CRYPTO_ALGOMODE_CUSTOM_P256R1, CryptoPrimitiveAlgorithmSecondaryFamily=CRYPTO_ALGOFAM_NOT_SET, CryptoPrimitiveAlgorithmModeCustomRef=Crypto_30_LibCv_P256r1
        KeyExchangeCalcPubValSecP384R1: CryptoPrimitiveService=CRYPTO_KEY_EXCHANGE_CALC_PUBVAL, CryptoPrimitiveAlgorithmFamily=CRYPTO_ALGOFAM_ECCSEC, CryptoPrimitiveAlgorithmMode=CRYPTO_ALGOMODE_CUSTOM_P384R1, CryptoPrimitiveAlgorithmSecondaryFamily=CRYPTO_ALGOFAM_NOT_SET, CryptoPrimitiveAlgorithmModeCustomRef=Crypto_30_LibCv_P384r1
        KeyExchangeCalcSecretSecP256R1: CryptoPrimitiveService=CRYPTO_KEY_EXCHANGE_CALC_SECRET, CryptoPrimitiveAlgorithmFamily=CRYPTO_ALGOFAM_ECCSEC, CryptoPrimitiveAlgorithmMode=CRYPTO_ALGOMODE_CUSTOM_P256R1, CryptoPrimitiveAlgorithmSecondaryFamily=CRYPTO_ALGOFAM_NOT_SET, CryptoPrimitiveAlgorithmModeCustomRef=Crypto_30_LibCv_P256r1
        KeyExchangeCalcSecretSecP384R1: CryptoPrimitiveService=CRYPTO_KEY_EXCHANGE_CALC_SECRET, CryptoPrimitiveAlgorithmFamily=CRYPTO_ALGOFAM_ECCSEC, CryptoPrimitiveAlgorithmMode=CRYPTO_ALGOMODE_CUSTOM_P384R1, CryptoPrimitiveAlgorithmSecondaryFamily=CRYPTO_ALGOFAM_NOT_SET, CryptoPrimitiveAlgorithmModeCustomRef=Crypto_30_LibCv_P384r1
        KeyExchangeCalcPubValAnsiP256R1: CryptoPrimitiveService=CRYPTO_KEY_EXCHANGE_CALC_PUBVAL, CryptoPrimitiveAlgorithmFamily=CRYPTO_ALGOFAM_ECCANSI, CryptoPrimitiveAlgorithmMode=CRYPTO_ALGOMODE_CUSTOM_P256R1, CryptoPrimitiveAlgorithmSecondaryFamily=CRYPTO_ALGOFAM_NOT_SET, CryptoPrimitiveAlgorithmModeCustomRef=Crypto_30_LibCv_P256r1
        KeyExchangeCalcSecretAnsiP256R1: CryptoPrimitiveService=CRYPTO_KEY_EXCHANGE_CALC_SECRET, CryptoPrimitiveAlgorithmFamily=CRYPTO_ALGOFAM_ECCANSI, CryptoPrimitiveAlgorithmMode=CRYPTO_ALGOMODE_CUSTOM_P256R1, CryptoPrimitiveAlgorithmSecondaryFamily=CRYPTO_ALGOFAM_NOT_SET, CryptoPrimitiveAlgorithmModeCustomRef=Crypto_30_LibCv_P256r1
        KeyExchangeCalcPubValNistP256R1: CryptoPrimitiveService=CRYPTO_KEY_EXCHANGE_CALC_PUBVAL, CryptoPrimitiveAlgorithmFamily=CRYPTO_ALGOFAM_ECCNIST, CryptoPrimitiveAlgorithmMode=CRYPTO_ALGOMODE_CUSTOM_P256R1, CryptoPrimitiveAlgorithmSecondaryFamily=CRYPTO_ALGOFAM_NOT_SET, CryptoPrimitiveAlgorithmModeCustomRef=Crypto_30_LibCv_P256r1
        KeyExchangeCalcSecretNistP256R1: CryptoPrimitiveService=CRYPTO_KEY_EXCHANGE_CALC_SECRET, CryptoPrimitiveAlgorithmFamily=CRYPTO_ALGOFAM_ECCNIST, CryptoPrimitiveAlgorithmMode=CRYPTO_ALGOMODE_CUSTOM_P256R1, CryptoPrimitiveAlgorithmSecondaryFamily=CRYPTO_ALGOFAM_NOT_SET, CryptoPrimitiveAlgorithmModeCustomRef=Crypto_30_LibCv_P256r1
        KeyExchangeCalcPubValNistP384R1: CryptoPrimitiveService=CRYPTO_KEY_EXCHANGE_CALC_PUBVAL, CryptoPrimitiveAlgorithmFamily=CRYPTO_ALGOFAM_ECCNIST, CryptoPrimitiveAlgorithmMode=CRYPTO_ALGOMODE_CUSTOM_P384R1, CryptoPrimitiveAlgorithmSecondaryFamily=CRYPTO_ALGOFAM_NOT_SET, CryptoPrimitiveAlgorithmModeCustomRef=Crypto_30_LibCv_P384r1
        KeyExchangeCalcSecretNistP384R1: CryptoPrimitiveService=CRYPTO_KEY_EXCHANGE_CALC_SECRET, CryptoPrimitiveAlgorithmFamily=CRYPTO_ALGOFAM_ECCNIST, CryptoPrimitiveAlgorithmMode=CRYPTO_ALGOMODE_CUSTOM_P384R1, CryptoPrimitiveAlgorithmSecondaryFamily=CRYPTO_ALGOFAM_NOT_SET, CryptoPrimitiveAlgorithmModeCustomRef=Crypto_30_LibCv_P384r1
        RandomSeedRngFips186Sha1: CryptoPrimitiveAlgorithmMode=CRYPTO_ALGOMODE_NOT_SET, CryptoPrimitiveService=CRYPTO_RANDOM_SEED, CryptoPrimitiveAlgorithmFamily=CRYPTO_ALGOFAM_FIPS186, CryptoPrimitiveAlgorithmSecondaryFamily=CRYPTO_ALGOFAM_SHA1
        RandomSeedRngDrbgAes128: CryptoPrimitiveAlgorithmMode=CRYPTO_ALGOMODE_NOT_SET, CryptoPrimitiveService=CRYPTO_RANDOM_SEED, CryptoPrimitiveAlgorithmFamily=CRYPTO_ALGOFAM_DRBG, CryptoPrimitiveAlgorithmSecondaryFamily=CRYPTO_ALGOFAM_AES
        RandomSeedRngDrbgAes128Df: CryptoPrimitiveAlgorithmMode=CRYPTO_ALGOMODE_CUSTOM_USE_DF, CryptoPrimitiveService=CRYPTO_RANDOM_SEED, CryptoPrimitiveAlgorithmFamily=CRYPTO_ALGOFAM_DRBG, CryptoPrimitiveAlgorithmSecondaryFamily=CRYPTO_ALGOFAM_AES, CryptoPrimitiveAlgorithmModeCustomRef=Crypto_30_LibCv_UseDF
        KeyDeriveIso15118: CryptoPrimitiveService=CRYPTO_KEY_DERIVE, CryptoPrimitiveAlgorithmFamily=CRYPTO_ALGOFAM_CUSTOM_ISO15118, CryptoPrimitiveAlgorithmMode=CRYPTO_ALGOMODE_NOT_SET, CryptoPrimitiveAlgorithmSecondaryFamily=CRYPTO_ALGOFAM_NOT_SET, CryptoPrimitiveAlgorithmFamilyCustomRef=Crypto_30_LibCv_ISO15118
        KeyDeriveSymNist800108CntModeSha256: CryptoPrimitiveService=CRYPTO_KEY_DERIVE, CryptoPrimitiveAlgorithmFamily=CRYPTO_ALGOFAM_NOT_SET, CryptoPrimitiveAlgorithmMode=CRYPTO_ALGOMODE_CTR, CryptoPrimitiveAlgorithmSecondaryFamily=CRYPTO_ALGOFAM_SHA2_256
        KeyDeriveAsymNistFips1864Erb: CryptoPrimitiveService=CRYPTO_KEY_DERIVE, CryptoPrimitiveAlgorithmFamily=CRYPTO_ALGOFAM_FIPS186, CryptoPrimitiveAlgorithmMode=CRYPTO_ALGOMODE_NOT_SET, CryptoPrimitiveAlgorithmSecondaryFamily=CRYPTO_ALGOFAM_SHA2_256
        KeyDeriveNist80056AOnePassSha256: CryptoPrimitiveService=CRYPTO_KEY_DERIVE, CryptoPrimitiveAlgorithmFamily=CRYPTO_ALGOFAM_DH, CryptoPrimitiveAlgorithmMode=CRYPTO_ALGOMODE_CUSTOM_P256R1, CryptoPrimitiveAlgorithmSecondaryFamily=CRYPTO_ALGOFAM_SHA2_256, CryptoPrimitiveAlgorithmModeCustomRef=Crypto_30_LibCv_P256r1
        KeyGenerateSymmetricGeneric: CryptoPrimitiveService=CRYPTO_KEY_GENERATE, CryptoPrimitiveAlgorithmFamily=CRYPTO_ALGOFAM_NOT_SET, CryptoPrimitiveAlgorithmMode=CRYPTO_ALGOMODE_NOT_SET, CryptoPrimitiveAlgorithmSecondaryFamily=CRYPTO_ALGOFAM_NOT_SET
        KeyGenerateSecP256R1: CryptoPrimitiveService=CRYPTO_KEY_GENERATE, CryptoPrimitiveAlgorithmFamily=CRYPTO_ALGOFAM_ECCSEC, CryptoPrimitiveAlgorithmMode=CRYPTO_ALGOMODE_CUSTOM_P256R1, CryptoPrimitiveAlgorithmSecondaryFamily=CRYPTO_ALGOFAM_NOT_SET, CryptoPrimitiveAlgorithmModeCustomRef=Crypto_30_LibCv_P256r1
        KeyGenerateSecP384R1: CryptoPrimitiveService=CRYPTO_KEY_GENERATE, CryptoPrimitiveAlgorithmFamily=CRYPTO_ALGOFAM_ECCSEC, CryptoPrimitiveAlgorithmMode=CRYPTO_ALGOMODE_CUSTOM_P384R1, CryptoPrimitiveAlgorithmSecondaryFamily=CRYPTO_ALGOFAM_NOT_SET, CryptoPrimitiveAlgorithmModeCustomRef=Crypto_30_LibCv_P384r1
        KeyGenerateNistP256R1: CryptoPrimitiveService=CRYPTO_KEY_GENERATE, CryptoPrimitiveAlgorithmFamily=CRYPTO_ALGOFAM_ECCNIST, CryptoPrimitiveAlgorithmMode=CRYPTO_ALGOMODE_CUSTOM_P256R1, CryptoPrimitiveAlgorithmSecondaryFamily=CRYPTO_ALGOFAM_NOT_SET, CryptoPrimitiveAlgorithmModeCustomRef=Crypto_30_LibCv_P256r1
        KeyGenerateNistP384R1: CryptoPrimitiveService=CRYPTO_KEY_GENERATE, CryptoPrimitiveAlgorithmFamily=CRYPTO_ALGOFAM_ECCNIST, CryptoPrimitiveAlgorithmMode=CRYPTO_ALGOMODE_CUSTOM_P384R1, CryptoPrimitiveAlgorithmSecondaryFamily=CRYPTO_ALGOFAM_NOT_SET, CryptoPrimitiveAlgorithmModeCustomRef=Crypto_30_LibCv_P384r1
        KeyGenerateAnsiP256R1: CryptoPrimitiveService=CRYPTO_KEY_GENERATE, CryptoPrimitiveAlgorithmFamily=CRYPTO_ALGOFAM_ECCANSI, CryptoPrimitiveAlgorithmMode=CRYPTO_ALGOMODE_CUSTOM_P256R1, CryptoPrimitiveAlgorithmSecondaryFamily=CRYPTO_ALGOFAM_NOT_SET, CryptoPrimitiveAlgorithmModeCustomRef=Crypto_30_LibCv_P256r1
        HmacRipemd160Generate: CryptoPrimitiveService=CRYPTO_MAC_GENERATE, CryptoPrimitiveAlgorithmMode=CRYPTO_ALGOMODE_HMAC, CryptoPrimitiveAlgorithmFamily=CRYPTO_ALGOFAM_RIPEMD160, CryptoPrimitiveAlgorithmSecondaryFamily=CRYPTO_ALGOFAM_NOT_SET
        HmacRipemd160Verify: CryptoPrimitiveService=CRYPTO_MAC_VERIFY, CryptoPrimitiveAlgorithmMode=CRYPTO_ALGOMODE_HMAC, CryptoPrimitiveAlgorithmFamily=CRYPTO_ALGOFAM_RIPEMD160, CryptoPrimitiveAlgorithmSecondaryFamily=CRYPTO_ALGOFAM_NOT_SET
        EccSecP160R1GenerateWithoutPreHashing: CryptoPrimitiveService=CRYPTO_SIGNATURE_GENERATE, CryptoPrimitiveAlgorithmMode=CRYPTO_ALGOMODE_CUSTOM_P160R1, CryptoPrimitiveAlgorithmFamily=CRYPTO_ALGOFAM_ECCSEC, CryptoPrimitiveAlgorithmSecondaryFamily=CRYPTO_ALGOFAM_NOT_SET, CryptoPrimitiveAlgorithmModeCustomRef=Crypto_30_LibCv_P160r1
        EccSecP160R1VerifyWithoutPreHashing: CryptoPrimitiveService=CRYPTO_SIGNATURE_VERIFY, CryptoPrimitiveAlgorithmMode=CRYPTO_ALGOMODE_CUSTOM_P160R1, CryptoPrimitiveAlgorithmFamily=CRYPTO_ALGOFAM_ECCSEC, CryptoPrimitiveAlgorithmSecondaryFamily=CRYPTO_ALGOFAM_NOT_SET, CryptoPrimitiveAlgorithmModeCustomRef=Crypto_30_LibCv_P160r1
        HashRipemd160: CryptoPrimitiveService=CRYPTO_HASH, CryptoPrimitiveAlgorithmMode=CRYPTO_ALGOMODE_NOT_SET, CryptoPrimitiveAlgorithmFamily=CRYPTO_ALGOFAM_RIPEMD160, CryptoPrimitiveAlgorithmSecondaryFamily=CRYPTO_ALGOFAM_NOT_SET
        KeyDerivePbkdf2HmacSha1: CryptoPrimitiveService=CRYPTO_KEY_DERIVE, CryptoPrimitiveAlgorithmFamily=CRYPTO_ALGOFAM_PBKDF2, CryptoPrimitiveAlgorithmMode=CRYPTO_ALGOMODE_HMAC, CryptoPrimitiveAlgorithmSecondaryFamily=CRYPTO_ALGOFAM_SHA1
        KeyDerivePbkdf2HmacSha256: CryptoPrimitiveService=CRYPTO_KEY_DERIVE, CryptoPrimitiveAlgorithmFamily=CRYPTO_ALGOFAM_PBKDF2, CryptoPrimitiveAlgorithmMode=CRYPTO_ALGOMODE_HMAC, CryptoPrimitiveAlgorithmSecondaryFamily=CRYPTO_ALGOFAM_SHA2_256
        KeyDeriveX963SHA512: CryptoPrimitiveService=CRYPTO_KEY_DERIVE, CryptoPrimitiveAlgorithmMode=CRYPTO_ALGOMODE_NOT_SET, CryptoPrimitiveAlgorithmFamily=CRYPTO_ALGOFAM_KDFX963, CryptoPrimitiveAlgorithmSecondaryFamily=CRYPTO_ALGOFAM_SHA2_512
        AeadChaCha20Poly1305Encrypt: CryptoPrimitiveService=CRYPTO_AEADENCRYPT, CryptoPrimitiveAlgorithmMode=CRYPTO_ALGOMODE_20ROUNDS, CryptoPrimitiveAlgorithmFamily=CRYPTO_ALGOFAM_CHACHA, CryptoPrimitiveAlgorithmSecondaryFamily=CRYPTO_ALGOFAM_CUSTOM_POLY_1305, CryptoPrimitiveAlgorithmSecondaryFamilyCustomRef=Crypto_30_LibCv_POLY1305
        AeadChaCha20Poly1305Decrypt: CryptoPrimitiveService=CRYPTO_AEADDECRYPT, CryptoPrimitiveAlgorithmMode=CRYPTO_ALGOMODE_20ROUNDS, CryptoPrimitiveAlgorithmFamily=CRYPTO_ALGOFAM_CHACHA, CryptoPrimitiveAlgorithmSecondaryFamily=CRYPTO_ALGOFAM_CUSTOM_POLY_1305, CryptoPrimitiveAlgorithmSecondaryFamilyCustomRef=Crypto_30_LibCv_POLY1305
        RngHashDrbgSha512: CryptoPrimitiveService=CRYPTO_RANDOM, CryptoPrimitiveAlgorithmMode=CRYPTO_ALGOMODE_NOT_SET, CryptoPrimitiveAlgorithmFamily=CRYPTO_ALGOFAM_DRBG, CryptoPrimitiveAlgorithmSecondaryFamily=CRYPTO_ALGOFAM_SHA2_512
        RandomSeedRngHashDrbgSha512: CryptoPrimitiveService=CRYPTO_RANDOM_SEED, CryptoPrimitiveAlgorithmMode=CRYPTO_ALGOMODE_NOT_SET, CryptoPrimitiveAlgorithmFamily=CRYPTO_ALGOFAM_DRBG, CryptoPrimitiveAlgorithmSecondaryFamily=CRYPTO_ALGOFAM_SHA2_512
        SHA3_256: CryptoPrimitiveService=CRYPTO_HASH, CryptoPrimitiveAlgorithmMode=CRYPTO_ALGOMODE_NOT_SET, CryptoPrimitiveAlgorithmFamily=CRYPTO_ALGOFAM_SHA3_256, CryptoPrimitiveAlgorithmSecondaryFamily=CRYPTO_ALGOFAM_NOT_SET
        RngDrbgAes256: CryptoPrimitiveService=CRYPTO_RANDOM, CryptoPrimitiveAlgorithmMode=CRYPTO_ALGOMODE_NOT_SET, CryptoPrimitiveAlgorithmFamily=CRYPTO_ALGOFAM_DRBG, CryptoPrimitiveAlgorithmSecondaryFamily=CRYPTO_ALGOFAM_AES
        RngDrbgAes256Df: CryptoPrimitiveService=CRYPTO_RANDOM, CryptoPrimitiveAlgorithmMode=CRYPTO_ALGOMODE_CUSTOM_USE_DF, CryptoPrimitiveAlgorithmFamily=CRYPTO_ALGOFAM_DRBG, CryptoPrimitiveAlgorithmSecondaryFamily=CRYPTO_ALGOFAM_AES, CryptoPrimitiveAlgorithmModeCustomRef=Crypto_30_LibCv_UseDF
        RandomSeedRngDrbgAes256: CryptoPrimitiveService=CRYPTO_RANDOM_SEED, CryptoPrimitiveAlgorithmMode=CRYPTO_ALGOMODE_NOT_SET, CryptoPrimitiveAlgorithmFamily=CRYPTO_ALGOFAM_DRBG, CryptoPrimitiveAlgorithmSecondaryFamily=CRYPTO_ALGOFAM_AES
        RandomSeedRngDrbgAes256Df: CryptoPrimitiveService=CRYPTO_RANDOM_SEED, CryptoPrimitiveAlgorithmMode=CRYPTO_ALGOMODE_CUSTOM_USE_DF, CryptoPrimitiveAlgorithmFamily=CRYPTO_ALGOFAM_DRBG, CryptoPrimitiveAlgorithmSecondaryFamily=CRYPTO_ALGOFAM_AES, CryptoPrimitiveAlgorithmModeCustomRef=Crypto_30_LibCv_UseDF
        SheCmdGetId: CryptoPrimitiveService=CRYPTO_MAC_GENERATE, CryptoPrimitiveAlgorithmMode=CRYPTO_ALGOMODE_CMAC, CryptoPrimitiveAlgorithmFamily=CRYPTO_ALGOFAM_AES, CryptoPrimitiveAlgorithmSecondaryFamily=CRYPTO_ALGOFAM_CUSTOM_CMD_GET_ID, CryptoPrimitiveAlgorithmSecondaryFamilyCustomRef=Crypto_30_LibCv_CmdGetId
        AesCCMEncrypt: CryptoPrimitiveAlgorithmSecondaryFamily=CRYPTO_ALGOFAM_NOT_SET, CryptoPrimitiveAlgorithmMode=CRYPTO_ALGOMODE_CUSTOM_CCM, CryptoPrimitiveService=CRYPTO_AEADENCRYPT, CryptoPrimitiveAlgorithmFamily=CRYPTO_ALGOFAM_AES, CryptoPrimitiveAlgorithmModeCustomRef=Crypto_30_LibCv_CCM
        AesCCMDecrypt: CryptoPrimitiveAlgorithmSecondaryFamily=CRYPTO_ALGOFAM_NOT_SET, CryptoPrimitiveAlgorithmMode=CRYPTO_ALGOMODE_CUSTOM_CCM, CryptoPrimitiveService=CRYPTO_AEADDECRYPT, CryptoPrimitiveAlgorithmFamily=CRYPTO_ALGOFAM_AES, CryptoPrimitiveAlgorithmModeCustomRef=Crypto_30_LibCv_CCM
        KeyDeriveHkdfHmacSHA256: CryptoPrimitiveService=CRYPTO_KEY_DERIVE, CryptoPrimitiveAlgorithmFamily=CRYPTO_ALGOFAM_CUSTOM_HKDF, CryptoPrimitiveAlgorithmMode=CRYPTO_ALGOMODE_HMAC, CryptoPrimitiveAlgorithmSecondaryFamily=CRYPTO_ALGOFAM_SHA2_256, CryptoPrimitiveAlgorithmFamilyCustomRef=Crypto_30_LibCv_HKDF
        KeyExchangeCalcPubValSpake2PlusCipherSuite8: CryptoPrimitiveService=CRYPTO_KEY_EXCHANGE_CALC_PUBVAL, CryptoPrimitiveAlgorithmFamily=CRYPTO_ALGOFAM_CUSTOM_SPAKE2_PLUS, CryptoPrimitiveAlgorithmMode=CRYPTO_ALGOMODE_CUSTOM_MODE_1, CryptoPrimitiveAlgorithmSecondaryFamily=CRYPTO_ALGOFAM_CUSTOM_CIPHER_SUITE_8, CryptoPrimitiveAlgorithmMode=CRYPTO_ALGOMODE_NOT_SET, CryptoPrimitiveAlgorithmSecondaryFamilyCustomRef=Crypto_30_LibCv_CipherSuite8, CryptoPrimitiveAlgorithmFamilyCustomRef=Crypto_30_LibCv_SPAKE2PLUS, CryptoPrimitiveAlgorithmModeCustomRef=Crypto_30_LibCv_Mode1
        KeyExchangeCalcSecretSpake2PlusCipherSuite8: CryptoPrimitiveService=CRYPTO_KEY_EXCHANGE_CALC_SECRET, CryptoPrimitiveAlgorithmFamily=CRYPTO_ALGOFAM_CUSTOM_SPAKE2_PLUS, CryptoPrimitiveAlgorithmMode=CRYPTO_ALGOMODE_CUSTOM_MODE_1, CryptoPrimitiveAlgorithmSecondaryFamily=CRYPTO_ALGOFAM_CUSTOM_CIPHER_SUITE_8, CryptoPrimitiveAlgorithmMode=CRYPTO_ALGOMODE_NOT_SET, CryptoPrimitiveAlgorithmSecondaryFamilyCustomRef=Crypto_30_LibCv_CipherSuite8, CryptoPrimitiveAlgorithmFamilyCustomRef=Crypto_30_LibCv_SPAKE2PLUS, CryptoPrimitiveAlgorithmModeCustomRef=Crypto_30_LibCv_Mode1
        KeyDeriveSpake2PlusP256R1: CryptoPrimitiveService=CRYPTO_KEY_DERIVE, CryptoPrimitiveAlgorithmFamily=CRYPTO_ALGOFAM_CUSTOM_SPAKE2_PLUS, CryptoPrimitiveAlgorithmMode=CRYPTO_ALGOMODE_CUSTOM_P256R1, CryptoPrimitiveAlgorithmSecondaryFamily=CRYPTO_ALGOFAM_NOT_SET, CryptoPrimitiveAlgorithmFamilyCustomRef=Crypto_30_LibCv_SPAKE2PLUS, CryptoPrimitiveAlgorithmModeCustomRef=Crypto_30_LibCv_P256r1
        HashMD5: CryptoPrimitiveService=CRYPTO_HASH, CryptoPrimitiveAlgorithmMode=CRYPTO_ALGOMODE_NOT_SET, CryptoPrimitiveAlgorithmFamily=CRYPTO_ALGOFAM_CUSTOM_MD5, CryptoPrimitiveAlgorithmSecondaryFamily=CRYPTO_ALGOFAM_NOT_SET, CryptoPrimitiveAlgorithmFamilyCustomRef=Crypto_30_LibCv_MD5
        KeyGenerateEd25519: CryptoPrimitiveService=CRYPTO_KEY_GENERATE, CryptoPrimitiveAlgorithmMode=CRYPTO_ALGOMODE_NOT_SET, CryptoPrimitiveAlgorithmFamily=CRYPTO_ALGOFAM_ED25519, CryptoPrimitiveAlgorithmSecondaryFamily=CRYPTO_ALGOFAM_NOT_SET
      13 x CryptoPrimitiveAlgorithmFamilyCustom:
        Crypto_30_LibCv_PaddingPKCS7: CryptoPrimitiveAlgorithmFamilyCustomId=133
        Crypto_30_LibCv_FIPS186: CryptoPrimitiveAlgorithmFamilyCustomId=132
        Crypto_30_LibCv_ECCANSI: CryptoPrimitiveAlgorithmFamilyCustomId=129
        Crypto_30_LibCv_ECCSEC: CryptoPrimitiveAlgorithmFamilyCustomId=130
        Crypto_30_LibCv_DRBG: CryptoPrimitiveAlgorithmFamilyCustomId=131
        Crypto_30_LibCv_X25519: CryptoPrimitiveAlgorithmFamilyCustomId=135
        Crypto_30_LibCv_ISO15118: CryptoPrimitiveAlgorithmFamilyCustomId=136
        Crypto_30_LibCv_POLY1305: CryptoPrimitiveAlgorithmFamilyCustomId=137
        Crypto_30_LibCv_CmdGetId: CryptoPrimitiveAlgorithmFamilyCustomId=140
        Crypto_30_LibCv_HKDF: CryptoPrimitiveAlgorithmFamilyCustomId=139
        Crypto_30_LibCv_SPAKE2PLUS: CryptoPrimitiveAlgorithmFamilyCustomId=138
        Crypto_30_LibCv_CipherSuite8: CryptoPrimitiveAlgorithmFamilyCustomId=157
        Crypto_30_LibCv_MD5: CryptoPrimitiveAlgorithmFamilyCustomId=191
      8 x CryptoPrimitiveAlgorithmModeCustom:
        Crypto_30_LibCv_CCM: CryptoPrimitiveAlgorithmModeCustomId=147
        Crypto_30_LibCv_Mode1: CryptoPrimitiveAlgorithmModeCustomId=150
        Crypto_30_LibCv_P160r1: CryptoPrimitiveAlgorithmModeCustomId=146
        Crypto_30_LibCv_P256r1: CryptoPrimitiveAlgorithmModeCustomId=128
        Crypto_30_LibCv_P384r1: CryptoPrimitiveAlgorithmModeCustomId=131
        Crypto_30_LibCv_RSAES_OAEP_CRT: CryptoPrimitiveAlgorithmModeCustomId=132
        Crypto_30_LibCv_RSASSA_PKCS1_v1_5_CRT: CryptoPrimitiveAlgorithmModeCustomId=129
        Crypto_30_LibCv_UseDF: CryptoPrimitiveAlgorithmModeCustomId=130
      KeyExchangeCalcPubValNistP224R1_BD (CryptoPrimitive):
        CryptoPrimitiveService = CRYPTO_KEY_EXCHANGE_CALC_PUBVAL
        CryptoPrimitiveAlgorithmFamily = CRYPTO_ALGOFAM_ECCNIST
        CryptoPrimitiveAlgorithmMode = CRYPTO_ALGOMODE_CUSTOM_P224R1
        CryptoPrimitiveAlgorithmSecondaryFamily = CRYPTO_ALGOFAM_CUSTOM_BD
        CryptoPrimitiveAlgorithmModeCustomRef = Crypto_30_LibCv_P224r1
        CryptoPrimitiveAlgorithmSecondaryFamilyCustomRef = Crypto_30_LibCv_BD
      KeyExchangeCalcSecretNistP224R1_BD (CryptoPrimitive):
        CryptoPrimitiveService = CRYPTO_KEY_EXCHANGE_CALC_SECRET
        CryptoPrimitiveAlgorithmFamily = CRYPTO_ALGOFAM_ECCNIST
        CryptoPrimitiveAlgorithmMode = CRYPTO_ALGOMODE_CUSTOM_P224R1
        CryptoPrimitiveAlgorithmSecondaryFamily = CRYPTO_ALGOFAM_CUSTOM_BD
        CryptoPrimitiveAlgorithmModeCustomRef = Crypto_30_LibCv_P224r1
        CryptoPrimitiveAlgorithmSecondaryFamilyCustomRef = Crypto_30_LibCv_BD
      Crypto_30_LibCv_P224r1 (CryptoPrimitiveAlgorithmModeCustom): CryptoPrimitiveAlgorithmModeCustomId=148
      Crypto_30_LibCv_BD (CryptoPrimitiveAlgorithmFamilyCustom): CryptoPrimitiveAlgorithmFamilyCustomId=141
      KeyDeriveHkdfOption1SHA256 (CryptoPrimitive):
        CryptoPrimitiveService = CRYPTO_KEY_DERIVE
        CryptoPrimitiveAlgorithmFamily = CRYPTO_ALGOFAM_CUSTOM_HKDF
        CryptoPrimitiveAlgorithmMode = CRYPTO_ALGOMODE_NOT_SET
        CryptoPrimitiveAlgorithmSecondaryFamily = CRYPTO_ALGOFAM_SHA2_256
        CryptoPrimitiveAlgorithmFamilyCustomRef = Crypto_30_LibCv_HKDF
      EccSecP521R1GenerateSha512 (CryptoPrimitive):
        CryptoPrimitiveAlgorithmFamily = CRYPTO_ALGOFAM_ECCSEC
        CryptoPrimitiveAlgorithmMode = CRYPTO_ALGOMODE_CUSTOM_P521R1
        CryptoPrimitiveAlgorithmSecondaryFamily = CRYPTO_ALGOFAM_SHA2_512
        CryptoPrimitiveService = CRYPTO_SIGNATURE_GENERATE
        CryptoPrimitiveAlgorithmModeCustomRef = Crypto_30_LibCv_P521r1
      Crypto_30_LibCv_P521r1 (CryptoPrimitiveAlgorithmModeCustom): CryptoPrimitiveAlgorithmModeCustomId=134
      12 x CryptoPrimitive:
        EccSecP521R1VerifySha512: CryptoPrimitiveAlgorithmFamily=CRYPTO_ALGOFAM_ECCSEC, CryptoPrimitiveAlgorithmMode=CRYPTO_ALGOMODE_CUSTOM_P521R1, CryptoPrimitiveAlgorithmSecondaryFamily=CRYPTO_ALGOFAM_SHA2_512, CryptoPrimitiveService=CRYPTO_SIGNATURE_VERIFY, CryptoPrimitiveAlgorithmModeCustomRef=Crypto_30_LibCv_P521r1
        KeyExchangeCalcSecretSecP521R1: CryptoPrimitiveService=CRYPTO_KEY_EXCHANGE_CALC_SECRET, CryptoPrimitiveAlgorithmFamily=CRYPTO_ALGOFAM_ECCSEC, CryptoPrimitiveAlgorithmMode=CRYPTO_ALGOMODE_CUSTOM_P521R1, CryptoPrimitiveAlgorithmSecondaryFamily=CRYPTO_ALGOFAM_NOT_SET, CryptoPrimitiveAlgorithmModeCustomRef=Crypto_30_LibCv_P521r1
        KeyExchangeCalcPubValSecP521R1: CryptoPrimitiveService=CRYPTO_KEY_EXCHANGE_CALC_PUBVAL, CryptoPrimitiveAlgorithmFamily=CRYPTO_ALGOFAM_ECCSEC, CryptoPrimitiveAlgorithmMode=CRYPTO_ALGOMODE_CUSTOM_P521R1, CryptoPrimitiveAlgorithmSecondaryFamily=CRYPTO_ALGOFAM_NOT_SET, CryptoPrimitiveAlgorithmModeCustomRef=Crypto_30_LibCv_P521r1
        SHA3_224: CryptoPrimitiveService=CRYPTO_HASH, CryptoPrimitiveAlgorithmMode=CRYPTO_ALGOMODE_NOT_SET, CryptoPrimitiveAlgorithmFamily=CRYPTO_ALGOFAM_SHA3_224, CryptoPrimitiveAlgorithmSecondaryFamily=CRYPTO_ALGOFAM_NOT_SET
        SHA3_384: CryptoPrimitiveService=CRYPTO_HASH, CryptoPrimitiveAlgorithmMode=CRYPTO_ALGOMODE_NOT_SET, CryptoPrimitiveAlgorithmFamily=CRYPTO_ALGOFAM_SHA3_384, CryptoPrimitiveAlgorithmSecondaryFamily=CRYPTO_ALGOFAM_NOT_SET
        SHA3_512: CryptoPrimitiveService=CRYPTO_HASH, CryptoPrimitiveAlgorithmMode=CRYPTO_ALGOMODE_NOT_SET, CryptoPrimitiveAlgorithmFamily=CRYPTO_ALGOFAM_SHA3_512, CryptoPrimitiveAlgorithmSecondaryFamily=CRYPTO_ALGOFAM_NOT_SET
        SHAKE128: CryptoPrimitiveService=CRYPTO_HASH, CryptoPrimitiveAlgorithmMode=CRYPTO_ALGOMODE_NOT_SET, CryptoPrimitiveAlgorithmFamily=CRYPTO_ALGOFAM_SHAKE128, CryptoPrimitiveAlgorithmSecondaryFamily=CRYPTO_ALGOFAM_NOT_SET
        SHAKE256: CryptoPrimitiveService=CRYPTO_HASH, CryptoPrimitiveAlgorithmMode=CRYPTO_ALGOMODE_NOT_SET, CryptoPrimitiveAlgorithmFamily=CRYPTO_ALGOFAM_SHAKE256, CryptoPrimitiveAlgorithmSecondaryFamily=CRYPTO_ALGOFAM_NOT_SET
        EccNistP521R1GenerateSha512: CryptoPrimitiveAlgorithmFamily=CRYPTO_ALGOFAM_ECCNIST, CryptoPrimitiveAlgorithmMode=CRYPTO_ALGOMODE_CUSTOM_P521R1, CryptoPrimitiveAlgorithmSecondaryFamily=CRYPTO_ALGOFAM_SHA2_512, CryptoPrimitiveService=CRYPTO_SIGNATURE_GENERATE, CryptoPrimitiveAlgorithmModeCustomRef=Crypto_30_LibCv_P521r1
        EccNistP521R1VerifySha512: CryptoPrimitiveAlgorithmFamily=CRYPTO_ALGOFAM_ECCNIST, CryptoPrimitiveAlgorithmMode=CRYPTO_ALGOMODE_CUSTOM_P521R1, CryptoPrimitiveAlgorithmSecondaryFamily=CRYPTO_ALGOFAM_SHA2_512, CryptoPrimitiveService=CRYPTO_SIGNATURE_VERIFY, CryptoPrimitiveAlgorithmModeCustomRef=Crypto_30_LibCv_P521r1
        KeyExchangeCalcSecretNistP521R1: CryptoPrimitiveService=CRYPTO_KEY_EXCHANGE_CALC_SECRET, CryptoPrimitiveAlgorithmFamily=CRYPTO_ALGOFAM_ECCNIST, CryptoPrimitiveAlgorithmMode=CRYPTO_ALGOMODE_CUSTOM_P521R1, CryptoPrimitiveAlgorithmSecondaryFamily=CRYPTO_ALGOFAM_NOT_SET, CryptoPrimitiveAlgorithmModeCustomRef=Crypto_30_LibCv_P521r1
        KeyExchangeCalcPubValNistP521R1: CryptoPrimitiveService=CRYPTO_KEY_EXCHANGE_CALC_PUBVAL, CryptoPrimitiveAlgorithmFamily=CRYPTO_ALGOFAM_ECCNIST, CryptoPrimitiveAlgorithmMode=CRYPTO_ALGOMODE_CUSTOM_P521R1, CryptoPrimitiveAlgorithmSecondaryFamily=CRYPTO_ALGOFAM_NOT_SET, CryptoPrimitiveAlgorithmModeCustomRef=Crypto_30_LibCv_P521r1
    CryptoKeyTypes
      80 x CryptoKeyType:
        StartApplication_CryptoKeyType_Dec: CryptoKeyElementRef=StartApplication_CryptoKeyElement_Dec
        StartApplication_CryptoKeyType_Enc: CryptoKeyElementRef=StartApplication_CryptoKeyElement_Enc
        StartApplication_CryptoKeyType_MAC: CryptoKeyElementRef=StartApplication_CryptoKeyElement_MAC
        Signature_Rsa_Pss_Verify_AutoSalt: CryptoKeyElementRef=Crypto_30_LibCv_Rsa_Modulus, CryptoKeyElementRef=Crypto_30_LibCv_Rsa_Pub_Exponent
        Hash: CryptoKeyElementRef=Crypto_30_LibCv_Hash_Result
        Random_Nist_800_90A_DRBG_AES_NoDF: CryptoKeyElementRef=Crypto_30_LibCv_Random_Algorithm_Nist_800_90A_DRBG_AES128, CryptoKeyElementRef=Crypto_30_LibCv_Random_Seed_Nist_800_90A_DRBG_AES128, CryptoKeyElementRef=Crypto_30_LibCv_Random_PrivateString, CryptoKeyElementRef=Crypto_30_LibCv_Random_Reseed_Counter, CryptoKeyElementRef=Crypto_30_LibCv_Random_AdditionalInput
        Signature_Rsa_Pkcs1_Verify: CryptoKeyElementRef=Crypto_30_LibCv_Rsa_Modulus, CryptoKeyElementRef=Crypto_30_LibCv_Rsa_Pub_Exponent
        Mac: CryptoKeyElementRef=Crypto_30_LibCv_Mac_Key
        KeyGenerate: CryptoKeyElementRef=Crypto_30_LibCv_KeyGenerate_Algorithm, CryptoKeyElementRef=Crypto_30_LibCv_KeyGenerate_Seed, CryptoKeyElementRef=Crypto_30_LibCv_KeyGenerate_Key
        CipherShe: CryptoKeyElementRef=Crypto_30_LibCv_Cipher_IV, CryptoKeyElementRef=Crypto_30_LibCv_Cipher_Proof, CryptoKeyElementRef=Crypto_30_LibCv_Cipher_Key_She, CryptoKeyElementRef=Crypto_30_LibCv_She_Counter
        KeyExchange_X25519: CryptoKeyElementRef=Crypto_30_LibCv_KeyExchange_Algorithm_X25519, CryptoKeyElementRef=Crypto_30_LibCv_KeyExchange_OwnPubKey, CryptoKeyElementRef=Crypto_30_LibCv_KeyExchange_Base, CryptoKeyElementRef=Crypto_30_LibCv_KeyExchange_PrivKey, CryptoKeyElementRef=Crypto_30_LibCv_KeyExchange_SharedValue
        Signature_Rsa_Pss_Verify: CryptoKeyElementRef=Crypto_30_LibCv_Rsa_Modulus, CryptoKeyElementRef=Crypto_30_LibCv_Rsa_Pub_Exponent, CryptoKeyElementRef=Crypto_30_LibCv_Rsa_SaltLength
        Random_Nist_800_90A_DRBG_AES_DF: CryptoKeyElementRef=Crypto_30_LibCv_Random_Seed_Nist_800_90A_DRBG_AES128, CryptoKeyElementRef=Crypto_30_LibCv_Random_PrivateString, CryptoKeyElementRef=Crypto_30_LibCv_Random_Reseed_Counter, CryptoKeyElementRef=Crypto_30_LibCv_Random_Nonce, CryptoKeyElementRef=Crypto_30_LibCv_Random_AdditionalInput, CryptoKeyElementRef=Crypto_30_LibCv_Random_Algorithm_Nist_800_90A_DRBG_AES128_DF
        KeyExchange_SECP256R1: CryptoKeyElementRef=Crypto_30_LibCv_KeyExchange_OwnPubKey, CryptoKeyElementRef=Crypto_30_LibCv_KeyExchange_Base, CryptoKeyElementRef=Crypto_30_LibCv_KeyExchange_PrivKey, CryptoKeyElementRef=Crypto_30_LibCv_KeyExchange_SharedValue, CryptoKeyElementRef=Crypto_30_LibCv_KeyExchange_Algorithm_SECP256R1
        KeyExchange_ANSIP256R1: CryptoKeyElementRef=Crypto_30_LibCv_KeyExchange_Algorithm_ANSIP256R1, CryptoKeyElementRef=Crypto_30_LibCv_KeyExchange_OwnPubKey, CryptoKeyElementRef=Crypto_30_LibCv_KeyExchange_Base, CryptoKeyElementRef=Crypto_30_LibCv_KeyExchange_PrivKey, CryptoKeyElementRef=Crypto_30_LibCv_KeyExchange_SharedValue
        Signature: CryptoKeyElementRef=Crypto_30_LibCv_Signature_Key
        Signature_Rsa_Pkcs1_Generate: CryptoKeyElementRef=Crypto_30_LibCv_Rsa_Modulus, CryptoKeyElementRef=Crypto_30_LibCv_Rsa_Priv_Exponent
        Signature_Rsa_Pss_Generate: CryptoKeyElementRef=Crypto_30_LibCv_Rsa_Modulus, CryptoKeyElementRef=Crypto_30_LibCv_Rsa_Priv_Exponent, CryptoKeyElementRef=Crypto_30_LibCv_Rsa_Salt
        KeyDerive: CryptoKeyElementRef=Crypto_30_LibCv_KeyDerivation_Password, CryptoKeyElementRef=Crypto_30_LibCv_KeyDerive_Algorithm, CryptoKeyElementRef=Crypto_30_LibCv_KeyDerivation_Salt, CryptoKeyElementRef=Crypto_30_LibCv_KeyDerivation_Label, CryptoKeyElementRef=Crypto_30_LibCv_KeyDerivation_Iterations_PBKDF2
        Random_Fips186_Sha1: CryptoKeyElementRef=Crypto_30_LibCv_Random_Algorithm_Fips186_Sha1, CryptoKeyElementRef=Crypto_30_LibCv_Random_Seed
        KeyDerive_ASM_NISTFIPS1864: CryptoKeyElementRef=Crypto_30_LibCv_KeyDerivation_Password, CryptoKeyElementRef=Crypto_30_LibCv_KeyDerivation_Algorithm_ASM_NISTFIPS1864, CryptoKeyElementRef=Crypto_30_LibCv_KeyDerivation_Salt, CryptoKeyElementRef=Crypto_30_LibCv_KeyDerivation_Label
        Signature_RsaCrt_Pkcs1_Generate: CryptoKeyElementRef=Crypto_30_LibCv_Rsa_PrimeP, CryptoKeyElementRef=Crypto_30_LibCv_Rsa_PrimeQ, CryptoKeyElementRef=Crypto_30_LibCv_Rsa_ExponentDp, CryptoKeyElementRef=Crypto_30_LibCv_Rsa_ExponentDq, CryptoKeyElementRef=Crypto_30_LibCv_Rsa_InverseQi
        CipherWithoutIv: CryptoKeyElementRef=Crypto_30_LibCv_Cipher_Key
        KeyDerive_NIST80056A: CryptoKeyElementRef=Crypto_30_LibCv_KeyDerivation_Password, CryptoKeyElementRef=Crypto_30_LibCv_KeyDerivation_Algorithm_NIST80056A, CryptoKeyElementRef=Crypto_30_LibCv_KeyExchange_PartnerPubKey, CryptoKeyElementRef=Crypto_30_LibCv_KeyDerivation_AdditionalInfo
        KeyDerive_ISO15118_ProvCert: CryptoKeyElementRef=Crypto_30_LibCv_Signature_Key, CryptoKeyElementRef=Crypto_30_LibCv_KeyDerivation_Algorithm_ISO15118, CryptoKeyElementRef=Crypto_30_LibCv_KeyExchange_OwnPubKey, CryptoKeyElementRef=Crypto_30_LibCv_KeyExchange_PrivKey
        Cipher: CryptoKeyElementRef=Crypto_30_LibCv_Cipher_Key, CryptoKeyElementRef=Crypto_30_LibCv_Cipher_IV, CryptoKeyElementRef=SccPrivateKeyDecrypted, CryptoKeyElementRef=Crypto_30_LibCv_Cipher_Proof, CryptoKeyElementRef=Crypto_30_LibCv_KeyDerivation_Salt
        KeyDerive_SYM_NIST800108: CryptoKeyElementRef=Crypto_30_LibCv_KeyDerivation_Password, CryptoKeyElementRef=Crypto_30_LibCv_KeyDerivation_Algorithm_SYM_NIST800108, CryptoKeyElementRef=Crypto_30_LibCv_KeyDerivation_Salt, CryptoKeyElementRef=Crypto_30_LibCv_KeyDerivation_Label
        MacShe: CryptoKeyElementRef=Crypto_30_LibCv_Mac_Proof, CryptoKeyElementRef=Crypto_30_LibCv_Mac_Key_She, CryptoKeyElementRef=Crypto_30_LibCv_She_Counter
        KeyDerive_ISO15118_ContrCert: CryptoKeyElementRef=Crypto_30_LibCv_Signature_Key, CryptoKeyElementRef=Crypto_30_LibCv_KeyDerivation_Algorithm_ISO15118, CryptoKeyElementRef=Crypto_30_LibCv_KeyExchange_PartnerPubKey, CryptoKeyElementRef=Crypto_30_LibCv_SCC_Contract_PubKey, CryptoKeyElementRef=Crypto_30_LibCv_SCC_IV_And_Encrypted_PrivKey
        SheInfoKey: CryptoKeyElementRef=Crypto_30_LibCv_She_UId, CryptoKeyElementRef=Crypto_30_LibCv_She_BootProtection, CryptoKeyElementRef=Crypto_30_LibCv_She_DebuggerProtection
        Cipher_Rsa_Oaep_Encrypt: CryptoKeyElementRef=Crypto_30_LibCv_Rsa_Modulus, CryptoKeyElementRef=Crypto_30_LibCv_Rsa_Pub_Exponent
        Cipher_Rsa_Oaep_Decrypt: CryptoKeyElementRef=Crypto_30_LibCv_Rsa_Modulus, CryptoKeyElementRef=Crypto_30_LibCv_Rsa_Priv_Exponent
        Cipher_RsaCrt_Oaep_Decrypt: CryptoKeyElementRef=Crypto_30_LibCv_Rsa_PrimeP, CryptoKeyElementRef=Crypto_30_LibCv_Rsa_PrimeQ, CryptoKeyElementRef=Crypto_30_LibCv_Rsa_ExponentDp, CryptoKeyElementRef=Crypto_30_LibCv_Rsa_ExponentDq, CryptoKeyElementRef=Crypto_30_LibCv_Rsa_InverseQi
        Cipher_Rsa_Pkcs1_Encrypt: CryptoKeyElementRef=Crypto_30_LibCv_Rsa_Modulus, CryptoKeyElementRef=Crypto_30_LibCv_Rsa_Pub_Exponent
        Cipher_Rsa_Pkcs1_Decrypt: CryptoKeyElementRef=Crypto_30_LibCv_Rsa_Modulus, CryptoKeyElementRef=Crypto_30_LibCv_Rsa_Priv_Exponent
        Cipher_Rsa_Oaep_Encrypt_With_Label: CryptoKeyElementRef=Crypto_30_LibCv_Rsa_Modulus, CryptoKeyElementRef=Crypto_30_LibCv_Rsa_Pub_Exponent, CryptoKeyElementRef=Crypto_30_LibCv_Label
        Cipher_Rsa_Oaep_Decrypt_With_Label: CryptoKeyElementRef=Crypto_30_LibCv_Rsa_Modulus, CryptoKeyElementRef=Crypto_30_LibCv_Rsa_Priv_Exponent, CryptoKeyElementRef=Crypto_30_LibCv_Label
        Cipher_RsaCrt_Oaep_Decrypt_With_Label: CryptoKeyElementRef=Crypto_30_LibCv_Rsa_PrimeP, CryptoKeyElementRef=Crypto_30_LibCv_Rsa_PrimeQ, CryptoKeyElementRef=Crypto_30_LibCv_Rsa_ExponentDp, CryptoKeyElementRef=Crypto_30_LibCv_Rsa_ExponentDq, CryptoKeyElementRef=Crypto_30_LibCv_Rsa_InverseQi, CryptoKeyElementRef=Crypto_30_LibCv_Label
        KeyExchange_SECP384R1: CryptoKeyElementRef=Crypto_30_LibCv_KeyExchange_Algorithm_SECP384R1, CryptoKeyElementRef=Crypto_30_LibCv_KeyExchange_OwnPubKey, CryptoKeyElementRef=Crypto_30_LibCv_KeyExchange_PrivKey, CryptoKeyElementRef=Crypto_30_LibCv_KeyExchange_SharedValue
        Cipher_Rsa_Pkcs1_Decrypt_Pub: CryptoKeyElementRef=Crypto_30_LibCv_Rsa_Modulus, CryptoKeyElementRef=Crypto_30_LibCv_Rsa_Pub_Exponent
        KeyDerive_KDF_X963_SHA256: CryptoKeyElementRef=Crypto_30_LibCv_KeyDerivation_Password, CryptoKeyElementRef=Crypto_30_LibCv_KeyDerivation_Salt, CryptoKeyElementRef=Crypto_30_LibCv_KeyDerivation_Algorithm_KDF_X963_SHA256
        CipherSheRam: CryptoKeyElementRef=Crypto_30_LibCv_Cipher_Key_She_Ram, CryptoKeyElementRef=Crypto_30_LibCv_Cipher_IV, CryptoKeyElementRef=Crypto_30_LibCv_Cipher_Proof
        MacSheRam: CryptoKeyElementRef=Crypto_30_LibCv_Mac_Key_She_Ram, CryptoKeyElementRef=Crypto_30_LibCv_Mac_Proof
        MacGmac: CryptoKeyElementRef=Crypto_30_LibCv_Mac_Key, CryptoKeyElementRef=Crypto_30_LibCv_Cipher_IV
        KeyGenerate_Symmetric_Generic: CryptoKeyElementRef=Crypto_30_LibCv_KeyGenerate_Key, CryptoKeyElementRef=Crypto_30_LibCv_KeyGenerate_Algorithm_Symmetric_Generic
        KeyGenerate_Ansi_Nist_Sec_P256R1: CryptoKeyElementRef=Crypto_30_LibCv_KeyGenerate_Key, CryptoKeyElementRef=Crypto_30_LibCv_KeyExchange_OwnPubKey, CryptoKeyElementRef=Crypto_30_LibCv_KeyGenerate_Algorithm_Ansi_Nist_Sec_P256R1
        KeyGenerate_Nist_Sec_P384R1: CryptoKeyElementRef=Crypto_30_LibCv_KeyGenerate_Key, CryptoKeyElementRef=Crypto_30_LibCv_KeyExchange_OwnPubKey, CryptoKeyElementRef=Crypto_30_LibCv_KeyGenerate_Algorithm_Nist_Sec_P384R1
        KeyDerive_PBKDF2_HMAC_SHA1: CryptoKeyElementRef=Crypto_30_LibCv_KeyDerivation_Password, CryptoKeyElementRef=Crypto_30_LibCv_KeyDerivation_Salt, CryptoKeyElementRef=Crypto_30_LibCv_KeyDerivation_Iterations_PBKDF2, CryptoKeyElementRef=Crypto_30_LibCv_KeyDerivation_Algorithm_PBKDF2_HMAC_SHA1
        KeyDerive_PBKDF2_HMAC_SHA256: CryptoKeyElementRef=Crypto_30_LibCv_KeyDerivation_Password, CryptoKeyElementRef=Crypto_30_LibCv_KeyDerivation_Salt, CryptoKeyElementRef=Crypto_30_LibCv_KeyDerivation_Iterations_PBKDF2, CryptoKeyElementRef=Crypto_30_LibCv_KeyDerivation_Algorithm_PBKDF2_HMAC_SHA256
        KeyDerive_KDF_X963_SHA512: CryptoKeyElementRef=Crypto_30_LibCv_KeyDerivation_Password, CryptoKeyElementRef=Crypto_30_LibCv_KeyDerivation_Salt, CryptoKeyElementRef=Crypto_30_LibCv_KeyDerivation_Algorithm_KDF_X963_SHA512
        AEAD_ChaCha20_Poly1305: CryptoKeyElementRef=Crypto_30_LibCv_Aead_ChaCha_Key, CryptoKeyElementRef=Crypto_30_LibCv_Aead_ChaCha_Nonce
        Random_Nist_800_90A_DRBG_HASH_SHA2_512: CryptoKeyElementRef=Crypto_30_LibCv_Random_Algorithm_Nist_800_90A_DRBG_HASH_SHA2_512, CryptoKeyElementRef=Crypto_30_LibCv_Random_Seed_Nist_800_90A_DRBG_HASH_SHA2_512, CryptoKeyElementRef=Crypto_30_LibCv_Random_PrivateString, CryptoKeyElementRef=Crypto_30_LibCv_Random_AdditionalInput, CryptoKeyElementRef=Crypto_30_LibCv_Random_Reseed_Counter, CryptoKeyElementRef=Crypto_30_LibCv_Random_Nonce
        Random_Nist_800_90A_DRBG_AES256_NoDF: CryptoKeyElementRef=Crypto_30_LibCv_Random_Algorithm_Nist_800_90A_DRBG_AES256, CryptoKeyElementRef=Crypto_30_LibCv_Random_Seed_Nist_800_90A_DRBG_AES256, CryptoKeyElementRef=Crypto_30_LibCv_Random_PrivateString, CryptoKeyElementRef=Crypto_30_LibCv_Random_AdditionalInput, CryptoKeyElementRef=Crypto_30_LibCv_Random_Reseed_Counter
        Random_Nist_800_90A_DRBG_AES256_DF: CryptoKeyElementRef=Crypto_30_LibCv_Random_Algorithm_Nist_800_90A_DRBG_AES256Df, CryptoKeyElementRef=Crypto_30_LibCv_Random_Seed_Nist_800_90A_DRBG_AES256, CryptoKeyElementRef=Crypto_30_LibCv_Random_PrivateString, CryptoKeyElementRef=Crypto_30_LibCv_Random_AdditionalInput, CryptoKeyElementRef=Crypto_30_LibCv_Random_Reseed_Counter, CryptoKeyElementRef=Crypto_30_LibCv_Random_Nonce
        KeyDerive_HKDF_HMAC_SHA256: CryptoKeyElementRef=Crypto_30_LibCv_KeyDerivation_Password, CryptoKeyElementRef=Crypto_30_LibCv_KeyDerivation_Salt, CryptoKeyElementRef=Crypto_30_LibCv_KeyDerivation_Iterations_HKDF, CryptoKeyElementRef=Crypto_30_LibCv_KeyDerivation_Algorithm_HKDF_HMAC_SHA256, CryptoKeyElementRef=Crypto_30_LibCv_KeyDerivation_AdditionalInfo
        KeyDerive_Spake2Plus_P256R1: CryptoKeyElementRef=Crypto_30_LibCv_KeyDerivation_Password, CryptoKeyElementRef=Crypto_30_LibCv_KeyDerivation_Algorithm_Spake2Plus_P256R1
        KeyExchange_Spake2Plus_A_Suite8_1: CryptoKeyElementRef=Crypto_30_LibCv_KeyExchange_Algorithm_Spake2Plus_Suite8_1, CryptoKeyElementRef=Crypto_30_LibCv_W0, CryptoKeyElementRef=Crypto_30_LibCv_W1, CryptoKeyElementRef=Crypto_30_LibCv_AdditionalInfo, CryptoKeyElementRef=Crypto_30_LibCv_KeyExchange_SharedValue, CryptoKeyElementRef=Crypto_30_LibCv_Verification_Result, CryptoKeyElementRef=Crypto_30_LibCv_Verification
        KeyExchange_Spake2Plus_B_Suite8_1: CryptoKeyElementRef=Crypto_30_LibCv_KeyExchange_Algorithm_Spake2Plus_Suite8_1, CryptoKeyElementRef=Crypto_30_LibCv_W0, CryptoKeyElementRef=Crypto_30_LibCv_L, CryptoKeyElementRef=Crypto_30_LibCv_AdditionalInfo, CryptoKeyElementRef=Crypto_30_LibCv_KeyExchange_SharedValue, CryptoKeyElementRef=Crypto_30_LibCv_Verification_Result, CryptoKeyElementRef=Crypto_30_LibCv_Verification
        KeyExchange_Spake2Plus_A_Suite8: CryptoKeyElementRef=Crypto_30_LibCv_KeyExchange_Algorithm_Spake2Plus_Suite8, CryptoKeyElementRef=Crypto_30_LibCv_W0, CryptoKeyElementRef=Crypto_30_LibCv_W1, CryptoKeyElementRef=Crypto_30_LibCv_AdditionalInfo, CryptoKeyElementRef=Crypto_30_LibCv_KeyExchange_SharedValue, CryptoKeyElementRef=Crypto_30_LibCv_Verification_Result, CryptoKeyElementRef=Crypto_30_LibCv_Verification
        KeyExchange_Spake2Plus_B_Suite8: CryptoKeyElementRef=Crypto_30_LibCv_KeyExchange_Algorithm_Spake2Plus_Suite8, CryptoKeyElementRef=Crypto_30_LibCv_W0, CryptoKeyElementRef=Crypto_30_LibCv_L, CryptoKeyElementRef=Crypto_30_LibCv_AdditionalInfo, CryptoKeyElementRef=Crypto_30_LibCv_KeyExchange_SharedValue, CryptoKeyElementRef=Crypto_30_LibCv_Verification_Result, CryptoKeyElementRef=Crypto_30_LibCv_Verification
        KeyDerive_KdfSHA256_ISO15118: CryptoKeyElementRef=Crypto_30_LibCv_KeyDerivation_Salt
        SccPublicKey: CryptoKeyElementRef=Crypto_30_LibCv_Scc_Certificate_Subject_PublicKey
        CryptoKeyType_Tls_HashShaX: CryptoKeyElementRef=CryptoKeyElement_Tls_HashShaX
        CryptoKeyType_Tls_HMacShaX: CryptoKeyElementRef=CryptoKeyElement_Tls_HMacShaX
        CryptoKeyType_Tls_KeyEx_PreMasterSecretInfo: CryptoKeyElementRef=CryptoKeyElement_Tls_KeyEx_Algorithm, CryptoKeyElementRef=CryptoKeyElement_Tls_KeyEx_OwnPubKey, CryptoKeyElementRef=CryptoKeyElement_Tls_KeyEx_PrivKey, CryptoKeyElementRef=CryptoKeyElement_Tls_KeyEx_SharedSecret
        CryptoKeyType_Tls_MasterSecret: CryptoKeyElementRef=CryptoKeyElement_Tls_MasterSecret
        CryptoKeyType_Tls_PrfCalculationValuesPrivate: CryptoKeyElementRef=CryptoKeyElement_Tls_PrfInputValue, CryptoKeyElementRef=CryptoKeyElement_Tls_PrfOutputValuePrivate, CryptoKeyElementRef=CryptoKeyElement_Tls_PrfValueActivePrivate, CryptoKeyElementRef=CryptoKeyElement_Tls_PrfValuePassivePrivate
        CryptoKeyType_Tls_PrfResultPrivate: CryptoKeyElementRef=CryptoKeyElement_Tls_PrfResultPrivate
        CryptoKeyType_Tls_PrfResultPublic: CryptoKeyElementRef=CryptoKeyElement_Tls_PrfResultPublic
        CryptoKeyType_Tls_PrfSecret: CryptoKeyElementRef=CryptoKeyElement_Tls_PrfSecret
        CryptoKeyType_Tls_PubKey: CryptoKeyElementRef=CryptoKeyElement_Tls_PubKey
        CryptoKeyType_Tls_RandomNumber: CryptoKeyElementRef=CryptoKeyElement_Tls_RandomNumber_Algorithm, CryptoKeyElementRef=CryptoKeyElement_Tls_RandomNumber_Seed
        CryptoKeyType_Tls_TmpBuffer: CryptoKeyElementRef=CryptoKeyElement_Tls_TmpBuffer
        CryptoKeyType_Tls_Xcrypt: CryptoKeyElementRef=CryptoKeyElement_Tls_Xcrypt_Key, CryptoKeyElementRef=CryptoKeyElement_Tls_Xcrypt_IV
        CryptoKeyType_Tls_PrfCalculationValuesPublic: CryptoKeyElementRef=CryptoKeyElement_Tls_PrfInputValue, CryptoKeyElementRef=CryptoKeyElement_Tls_PrfOutputValuePublic, CryptoKeyElementRef=CryptoKeyElement_Tls_PrfValueActivePublic, CryptoKeyElementRef=CryptoKeyElement_Tls_PrfValuePassivePublic
        KeyGenerate_ED25519: CryptoKeyElementRef=Crypto_30_LibCv_KeyGenerate_Key, CryptoKeyElementRef=Crypto_30_LibCv_KeyExchange_OwnPubKey, CryptoKeyElementRef=Crypto_30_LibCv_KeyGenerate_Algorithm_Ed25519
        Scc_ContrCertTempPrivateKey: CryptoKeyElementRef=Crypto_30_LibCv_Scc_ContrCertTempPrivateKeyElemen
        KeyExchange_NISTP224R1_BD: CryptoKeyElementRef=Crypto_30_LibCv_KeyExchange_Algorithm_NISTP224R1_BD, CryptoKeyElementRef=Crypto_30_LibCv_KeyExchange_OwnPubKey, CryptoKeyElementRef=Crypto_30_LibCv_KeyExchange_PrivKey, CryptoKeyElementRef=Crypto_30_LibCv_KeyExchange_SharedValue, CryptoKeyElementRef=Crypto_30_LibCv_KeyExchange_NumEcu, CryptoKeyElementRef=Crypto_30_LibCv_KeyExchange_EcuId, CryptoKeyElementRef=Crypto_30_LibCv_KeyExchange_Intermediate, CryptoKeyElementRef=Crypto_30_LibCv_KeyExchange_PartnerPubKey, CryptoKeyElementRef=Crypto_30_LibCv_KeyExchange_PartnerPubKey_2
        KeyDerive_Hkdf_Option1_Sha256: CryptoKeyElementRef=Crypto_30_LibCv_KeyDerivation_Password, CryptoKeyElementRef=Crypto_30_LibCv_KeyDerivation_AdditionalInfo, CryptoKeyElementRef=Crypto_30_LibCv_KeyDerivation_Algorithm_HKDF_Option1_SHA256
        KeyExchange_SECP521R1: CryptoKeyElementRef=Crypto_30_LibCv_KeyExchange_Algorithm_SECP521R1, CryptoKeyElementRef=Crypto_30_LibCv_KeyExchange_OwnPubKey, CryptoKeyElementRef=Crypto_30_LibCv_KeyExchange_PrivKey, CryptoKeyElementRef=Crypto_30_LibCv_KeyExchange_SharedValue
    CryptoKeys
      30 x CryptoKey, all with CryptoKeyDeriveIterations=1:
        StartApplication_CryptoKey_Dec: CryptoKeyId=9, CryptoKeyNvId=70, CryptoKeyTypeRef=StartApplication_CryptoKeyType_Dec
        StartApplication_CryptoKey_Enc: CryptoKeyId=14, CryptoKeyNvId=71, CryptoKeyTypeRef=StartApplication_CryptoKeyType_Enc
        StartApplication_CryptoKey_MAC: CryptoKeyId=19, CryptoKeyNvId=72, CryptoKeyTypeRef=StartApplication_CryptoKeyType_MAC
        CryptoKey_CryIfKey: CryptoKeyId=0, CryptoKeyNvId=0, CryptoKeyTypeRef=Mac
        Crypto_SccAesKey: CryptoKeyId=10, CryptoKeyNvId=6, CryptoKeyTypeRef=Cipher
        Crypto_SccContractKeyPair: CryptoKeyId=1, CryptoKeyNvId=29, CryptoKeyTypeRef=KeyDerive_ISO15118_ContrCert
        Crypto_SccContractPrivKey: CryptoKeyId=7, CryptoKeyNvId=7, CryptoKeyTypeRef=Signature
        Crypto_SccEcdhExchange: CryptoKeyId=2, CryptoKeyNvId=8, CryptoKeyTypeRef=KeyExchange_SECP256R1
        Crypto_SccKdfSHA256Key: CryptoKeyId=4, CryptoKeyNvId=9, CryptoKeyTypeRef=KeyDerive_KdfSHA256_ISO15118
        Crypto_SccProvisioningKeyPair: CryptoKeyId=3, CryptoKeyNvId=28, CryptoKeyTypeRef=KeyDerive_ISO15118_ProvCert
        Crypto_SccProvisioningPrivKey: CryptoKeyId=8, CryptoKeyNvId=30, CryptoKeyTypeRef=Signature
        Crypto_SccPublicKey: CryptoKeyId=5, CryptoKeyNvId=27, CryptoKeyTypeRef=SccPublicKey
        CryptoKey_Tls_Conn0_Aes128Cbc_Decrypt: CryptoKeyId=11, CryptoKeyNvId=32, CryptoKeyTypeRef=CryptoKeyType_Tls_Xcrypt
        CryptoKey_Tls_Conn0_Aes128Cbc_Encrypt: CryptoKeyId=12, CryptoKeyNvId=31, CryptoKeyTypeRef=CryptoKeyType_Tls_Xcrypt
        CryptoKey_Tls_Conn0_CertVerify_PubKey: CryptoKeyId=13, CryptoKeyNvId=33, CryptoKeyTypeRef=CryptoKeyType_Tls_PubKey
        CryptoKey_Tls_Conn0_HMacShaX_Generate: CryptoKeyId=15, CryptoKeyNvId=34, CryptoKeyTypeRef=CryptoKeyType_Tls_HMacShaX
        CryptoKey_Tls_Conn0_HMacShaX_Verify: CryptoKeyId=16, CryptoKeyNvId=35, CryptoKeyTypeRef=CryptoKeyType_Tls_HMacShaX
        CryptoKey_Tls_Conn0_HS_RandomNumber: CryptoKeyId=17, CryptoKeyNvId=36, CryptoKeyTypeRef=CryptoKeyType_Tls_RandomNumber
        CryptoKey_Tls_Conn0_MasterSecret: CryptoKeyId=18, CryptoKeyNvId=37, CryptoKeyTypeRef=CryptoKeyType_Tls_MasterSecret
        CryptoKey_Tls_Conn0_PreMasterSecretInfo: CryptoKeyId=20, CryptoKeyNvId=38, CryptoKeyTypeRef=CryptoKeyType_Tls_KeyEx_PreMasterSecretInfo
        CryptoKey_Tls_Conn0_Prf_ResultPrivate: CryptoKeyId=21, CryptoKeyNvId=39, CryptoKeyTypeRef=CryptoKeyType_Tls_PrfResultPrivate
        CryptoKey_Tls_Conn0_Prf_ResultPublic: CryptoKeyId=22, CryptoKeyNvId=40, CryptoKeyTypeRef=CryptoKeyType_Tls_PrfResultPublic
        CryptoKey_Tls_Conn0_Prf_Secret: CryptoKeyId=23, CryptoKeyNvId=41, CryptoKeyTypeRef=CryptoKeyType_Tls_PrfSecret
        CryptoKey_Tls_Conn0_PrfCalculationValuesPrivate: CryptoKeyId=24, CryptoKeyNvId=42, CryptoKeyTypeRef=CryptoKeyType_Tls_PrfCalculationValuesPrivate
        CryptoKey_Tls_Conn0_PrfCalculationValuesPublic: CryptoKeyId=25, CryptoKeyNvId=43, CryptoKeyTypeRef=CryptoKeyType_Tls_PrfCalculationValuesPublic
        CryptoKey_Tls_Conn0_TmpBuffer: CryptoKeyId=26, CryptoKeyNvId=44, CryptoKeyTypeRef=CryptoKeyType_Tls_TmpBuffer
        CryptoKey_Tls_Conn0_HS_HashSha256_ToClientFinished: CryptoKeyId=27, CryptoKeyNvId=45, CryptoKeyTypeRef=CryptoKeyType_Tls_HashShaX
        CryptoKey_Tls_Conn0_HS_HashSha256_ToServerFinished: CryptoKeyId=28, CryptoKeyNvId=46, CryptoKeyTypeRef=CryptoKeyType_Tls_HashShaX
        CryptoKey_Tls_Global_HashSha1: CryptoKeyId=29, CryptoKeyNvId=47, CryptoKeyTypeRef=CryptoKeyType_Tls_HashShaX
        Crypto_SccContractPrivKeyTemp: CryptoKeyId=6, CryptoKeyNvId=48, CryptoKeyTypeRef=Scc_ContrCertTempPrivateKey
    CryptoNvStorage: CryptoNvManagementDataPerKey=4, CryptoNvWriteBlockFctName=NvM_WriteBlock
      CryptoNvBlock:
        CryptoNvBlockId = 0
        CryptoNvBlockLength = 474
        CryptoNvBlockFillLevel = 150
        CryptoNvBlockProcessing = NV_PROCESSING_DEFERRED
        CryptoNvBlockConsistencyLevel = NV_CONSISTENCY_LEVEL_DETECT
        CryptoNvBlockRevision = 0
        CryptoNvBlockCrcLayoutChecksum = 3628623260
        CryptoNvBlockDescriptor = CryptoKeyStorage
        CryptoNvBlockKeyRef = Crypto_SccProvisioningKeyPair
        CryptoNvBlockKeyRef = Crypto_SccContractKeyPair
        CryptoNvBlockKeyRef = Crypto_SccContractPrivKey
        CryptoNvBlockKeyRef = Crypto_SccProvisioningPrivKey
