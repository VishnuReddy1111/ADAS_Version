AUTOSAR XML (schema 4-3-0)
package /ActiveEcuC
  module config vMem_30_Blocking: definition=vMem, implementation-config-variant=VARIANT-PRE-COMPILE, module-description=vMem_Impl
    vMemBlocking_InstFee (vMemInstance): vMemInstanceId=0
      vMemSectorList
        vMemSector_BlockFee (vMemSector): vMemNumberOfSectors=1, vMemSectorSize=65536, vMemStartAddress=0, vMemPageSize=1
          vMemBurstSettings: vMemEraseBurstSize=65536, vMemPageBurstRamAlignment=1, vMemWriteBurstSize=1
    vMemGeneral: vMemDevErrorDetect=true, vMemVersionInfoApi=false, vMemSafeBswChecks=false
  module config vMem: implementation-config-variant=VARIANT-PRE-COMPILE, module-description=vMem_Impl
    vMemInstance: vMemInstanceId=0
      vMemSectorList
        14 x vMemSector, all with vMemNumberOfSectors=64, vMemPageSize=32, vMemSectorSize=16384:
          PF0_PF2_PS0_S0_S63: vMemStartAddress=2684354560, vMemProgramFlashId=0, vMemPhysicalSectorId=0, vMemAlternateMapSectorRef=PF2_PF0_PS0_S0_S63
            vMemBurstSettings: vMemEraseBurstSize=524288, vMemPageBurstRamAlignment=1, vMemWriteBurstSize=256
          PF0_PF2_PS1_S64_S127: vMemStartAddress=2685403136, vMemProgramFlashId=0, vMemPhysicalSectorId=1, vMemAlternateMapSectorRef=PF2_PF0_PS1_S64_S127
            vMemBurstSettings: vMemEraseBurstSize=524288, vMemPageBurstRamAlignment=1, vMemWriteBurstSize=256
          PF0_PF2_PS2_S128_S191: vMemStartAddress=2686451712, vMemProgramFlashId=0, vMemPhysicalSectorId=2, vMemAlternateMapSectorRef=PF2_PF0_PS2_S128_S191
            vMemBurstSettings: vMemEraseBurstSize=524288, vMemPageBurstRamAlignment=1, vMemWriteBurstSize=256
          PF1_PF3_PS0_S0_S63: vMemStartAddress=2687500288, vMemProgramFlashId=1, vMemPhysicalSectorId=0, vMemAlternateMapSectorRef=PF3_PF1_PS0_S0_S63
            vMemBurstSettings: vMemEraseBurstSize=524288, vMemPageBurstRamAlignment=1, vMemWriteBurstSize=256
          PF1_PF3_PS1_S64_S127: vMemStartAddress=2688548864, vMemProgramFlashId=1, vMemPhysicalSectorId=1, vMemAlternateMapSectorRef=PF3_PF1_PS1_S64_S127
            vMemBurstSettings: vMemEraseBurstSize=524288, vMemPageBurstRamAlignment=1, vMemWriteBurstSize=256
          PF1_PF3_PS2_S128_S191: vMemStartAddress=2689597440, vMemProgramFlashId=1, vMemPhysicalSectorId=2, vMemAlternateMapSectorRef=PF3_PF1_PS2_S128_S191
            vMemBurstSettings: vMemEraseBurstSize=524288, vMemPageBurstRamAlignment=1, vMemWriteBurstSize=256
          PF2_PF0_PS0_S0_S63: vMemStartAddress=2690646016, vMemProgramFlashId=2, vMemPhysicalSectorId=0, vMemAlternateMapSectorRef=PF0_PF2_PS0_S0_S63
            vMemBurstSettings: vMemEraseBurstSize=524288, vMemPageBurstRamAlignment=1, vMemWriteBurstSize=256
          PF2_PF0_PS1_S64_S127: vMemStartAddress=2691694592, vMemProgramFlashId=2, vMemPhysicalSectorId=1, vMemAlternateMapSectorRef=PF0_PF2_PS1_S64_S127
            vMemBurstSettings: vMemEraseBurstSize=524288, vMemPageBurstRamAlignment=1, vMemWriteBurstSize=256
          PF2_PF0_PS2_S128_S191: vMemStartAddress=2692743168, vMemProgramFlashId=2, vMemPhysicalSectorId=2, vMemAlternateMapSectorRef=PF0_PF2_PS2_S128_S191
            vMemBurstSettings: vMemEraseBurstSize=524288, vMemPageBurstRamAlignment=1, vMemWriteBurstSize=256
          PF3_PF1_PS0_S0_S63: vMemStartAddress=2693791744, vMemProgramFlashId=3, vMemPhysicalSectorId=0, vMemAlternateMapSectorRef=PF1_PF3_PS0_S0_S63
            vMemBurstSettings: vMemEraseBurstSize=524288, vMemPageBurstRamAlignment=1, vMemWriteBurstSize=256
          PF3_PF1_PS1_S64_S127: vMemStartAddress=2694840320, vMemProgramFlashId=3, vMemPhysicalSectorId=1, vMemAlternateMapSectorRef=PF1_PF3_PS1_S64_S127
            vMemBurstSettings: vMemEraseBurstSize=524288, vMemPageBurstRamAlignment=1, vMemWriteBurstSize=256
          PF3_PF1_PS2_S128_S191: vMemStartAddress=2695888896, vMemProgramFlashId=3, vMemPhysicalSectorId=2, vMemAlternateMapSectorRef=PF1_PF3_PS2_S128_S191
            vMemBurstSettings: vMemEraseBurstSize=524288, vMemPageBurstRamAlignment=1, vMemWriteBurstSize=256
          PF4_PF5_PS0_S0_S63: vMemStartAddress=2696937472, vMemProgramFlashId=4, vMemPhysicalSectorId=0, vMemAlternateMapSectorRef=PF5_PF4_PS0_S0_S63
            vMemBurstSettings: vMemEraseBurstSize=524288, vMemPageBurstRamAlignment=1, vMemWriteBurstSize=256
          PF5_PF4_PS0_S0_S63: vMemStartAddress=2700083200, vMemProgramFlashId=5, vMemPhysicalSectorId=0, vMemAlternateMapSectorRef=PF4_PF5_PS0_S0_S63
            vMemBurstSettings: vMemEraseBurstSize=524288, vMemPageBurstRamAlignment=1, vMemWriteBurstSize=256
    vMemGeneral: vMemReadOnlyMode=false, vMemVersionInfoApi=true, vMemDevErrorDetect=true, vMemSafeBswChecks=false, vMemUsePeripheralAccessApi=false
