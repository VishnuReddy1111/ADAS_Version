AUTOSAR XML (schema 4-3-0)
package /ActiveEcuC
  module config CanIf: implementation-config-variant=VARIANT-PRE-COMPILE, module-description=CanIf_Impl
    CanIfCtrlDrvCfg_7d254554 (CanIfCtrlDrvCfg): CanIfCtrlDrvTxCancellation=false, CanIfCtrlDrvInitHohConfigRef=CanIfInitHohCfg, CanIfCtrlDrvNameRef=CanGeneral
      CT_BMC_CAN01_34f1c2c6 (CanIfCtrlCfg): CanIfCtrlId=0, CanIfCtrlWakeupSupport=false, CanIfCtrlJ1939DynAddrSupport=DISABLED, CanIfCtrlCanCtrlRef=CT_BMC_CAN01_34f1c2c6
      CT_HCP5_CANFD01_e05ce4e2 (CanIfCtrlCfg): CanIfCtrlId=1, CanIfCtrlWakeupSupport=false, CanIfCtrlJ1939DynAddrSupport=DISABLED, CanIfCtrlCanCtrlRef=CT_HCP5_CANFD01_e05ce4e2
    CanIfDispatchCfg:
      CanIfDispatchUserCtrlBusOffName = CanSM_ControllerBusOff
      CanIfDispatchUserCtrlBusOffUL = CAN_SM
      CanIfDispatchUserCtrlModeIndicationName = CanSM_ControllerModeIndication
      CanIfDispatchUserCtrlModeIndicationUL = CAN_SM
    CanIfInitCfg
      CanIfInitHohCfg: CanIfInitRefCfgSet=CanConfigSet
        CN_HCP5_CANFD01_54d90215_Tx (CanIfHthCfg): CanIfHthCanCtrlIdRef=CT_HCP5_CANFD01_e05ce4e2, CanIfHthIdSymRef=CN_HCP5_CANFD01_54d90215_Tx
        CN_BMC_CAN01_78a85e89_Tx (CanIfHthCfg): CanIfHthCanCtrlIdRef=CT_BMC_CAN01_34f1c2c6, CanIfHthIdSymRef=CN_BMC_CAN01_78a85e89_Tx
        4 x CanIfHrhCfg, all with CanIfHrhSoftwareFilter=true:
          CN_HCP5_CANFD01_f532029f_Rx: CanIfHrhCanCtrlIdRef=CT_HCP5_CANFD01_e05ce4e2, CanIfHrhIdSymRef=CN_HCP5_CANFD01_f532029f_Rx
          CN_BMC_CAN01_d4211d16_Rx: CanIfHrhCanCtrlIdRef=CT_BMC_CAN01_34f1c2c6, CanIfHrhIdSymRef=CN_BMC_CAN01_d4211d16_Rx
          CN_BMC_CAN01_e16b4bee_Rx: CanIfHrhCanCtrlIdRef=CT_BMC_CAN01_34f1c2c6, CanIfHrhIdSymRef=CN_BMC_CAN01_e16b4bee_Rx
          CN_HCP5_CANFD01_c0785467_Rx: CanIfHrhCanCtrlIdRef=CT_HCP5_CANFD01_e05ce4e2, CanIfHrhIdSymRef=CN_HCP5_CANFD01_c0785467_Rx
      HCP1_17_XIX_HCP5_CANFD01_26918939_Rx (CanIfRxPduCfg):
        CanIfRxPduCanId = 380196250
        CanIfRxPduCanIdType = EXTENDED_FD_CAN
        CanIfRxPduDlc = 8
        CanIfRxPduUserRxIndicationName = PduR_CanIfRxIndication
        CanIfRxPduUserRxIndicationUL = PDUR
        CanIfRxPduId = 76
        CanIfRxPduReadData = false
        CanIfRxPduReadNotifyStatus = false
        CanIfRxPduDlcCheck = true
        CanIfRxPduHrhIdRef = CN_HCP5_CANFD01_f532029f_Rx
        CanIfRxPduRef = HCP1_17_XIX_HCP5_CANFD01_c544c746_Rx
      XCP_Hybrid_01_CRO_01_FD_XIX_HCP5_CANFD01_906d0391_Rx (CanIfRxPduCfg):
        CanIfRxPduCanId = 469526272
        CanIfRxPduCanIdType = EXTENDED_FD_CAN
        CanIfRxPduDlc = 64
        CanIfRxPduUserRxIndicationName = Xcp_CanIfRxIndication
        CanIfRxPduUserRxIndicationUL = XCP
        CanIfRxPduId = 44
        CanIfRxPduReadData = false
        CanIfRxPduReadNotifyStatus = false
        CanIfRxPduDlcCheck = true
        CanIfRxPduHrhIdRef = CN_HCP5_CANFD01_f532029f_Rx
        CanIfRxPduRef = XCP_Hybrid_01_CRO_01_FD_XIX_HCP5_CANFD01_f21b8ba9_Rx
      ORU_Control_A_01_XIX_BMC_CAN01_3567ca2c_Tx (CanIfTxPduCfg):
        CanIfTxPduCanId = 441799804
        CanIfTxPduCanIdType = EXTENDED_CAN
        CanIfTxPduDlc = 8
        CanIfTxPduUserTxConfirmationName = NULL_PTR
        CanIfTxPduUserTxConfirmationUL = NONE
        CanIfTxPduId = 7
        CanIfTxPduReadNotifyStatus = false
        CanIfTxPduType = STATIC
        CanIfTxPduTruncation = true
        CanIfTxPduBufferRef = CHNL_eb535f7d
        CanIfTxPduRef = ORU_Control_A_01_XIX_BMC_CAN01_e1a4f99a_Tx
      HVK_03_E2E_SOK_XIX_HCP5_CANFD01_d591f6b8_Rx (CanIfRxPduCfg):
        CanIfRxPduCanId = 184112329
        CanIfRxPduCanIdType = EXTENDED_FD_CAN
        CanIfRxPduDlc = 12
        CanIfRxPduUserRxIndicationName = PduR_CanIfRxIndication
        CanIfRxPduUserRxIndicationUL = PDUR
        CanIfRxPduId = 87
        CanIfRxPduReadData = false
        CanIfRxPduReadNotifyStatus = false
        CanIfRxPduDlcCheck = true
        CanIfRxPduHrhIdRef = CN_HCP5_CANFD01_f532029f_Rx
        CanIfRxPduRef = HVK_03_E2E_SOK_XIX_HCP5_CANFD01_17f9ff97_Rx
      NM_Hybrid_01_XIX_HCP5_CANFD01_07855dca_Tx (CanIfTxPduCfg):
        CanIfTxPduCanId = 452984955
        CanIfTxPduCanIdType = EXTENDED_FD_CAN
        CanIfTxPduDlc = 24
        CanIfTxPduUserTxConfirmationName = CanNm_TxConfirmation
        CanIfTxPduUserTxConfirmationUL = CAN_NM
        CanIfTxPduId = 30
        CanIfTxPduReadNotifyStatus = false
        CanIfTxPduType = STATIC
        CanIfTxPduTruncation = true
        CanIfTxPduBufferRef = CHNL_b74a53a7
        CanIfTxPduRef = NM_Hybrid_01_XIX_HCP5_CANFD01_3f17aba9_Tx
      OBDC_SSN_UI2Sens02_Resp_XIX_BMC_CAN01_007c0617_Rx (CanIfRxPduCfg):
        CanIfRxPduCanId = 402551218
        CanIfRxPduCanIdType = EXTENDED_NO_FD_CAN
        CanIfRxPduDlc = 8
        CanIfRxPduUserRxIndicationName = PduR_CanIfRxIndication
        CanIfRxPduUserRxIndicationType = PDUID_PDUINFOPTR
        CanIfRxPduUserRxIndicationUL = PDUR
        CanIfRxPduId = 16
        CanIfRxPduReadData = false
        CanIfRxPduReadNotifyStatus = false
        CanIfRxPduDlcCheck = true
        CanIfRxPduHrhIdRef = CN_BMC_CAN01_e16b4bee_Rx
        CanIfRxPduRef = OBDC_SSN_UI2Sens02_Resp_XIX_BMC_CAN01_e1ea5c01_Rx
      BMC_CMC_Zellspannung_03_XIX_HCP5_CANFD01_0df225ad_Tx (CanIfTxPduCfg):
        CanIfTxPduCanId = 441800238
        CanIfTxPduCanIdType = EXTENDED_FD_CAN
        CanIfTxPduDlc = 64
        CanIfTxPduUserTxConfirmationName = PduR_CanIfTxConfirmation
        CanIfTxPduUserTxConfirmationUL = PDUR
        CanIfTxPduId = 35
        CanIfTxPduReadNotifyStatus = false
        CanIfTxPduType = STATIC
        CanIfTxPduTruncation = true
        CanIfTxPduBufferRef = CHNL_b74a53a7
        CanIfTxPduRef = BMC_CMC_Zellspannung_03_XIX_HCP5_CANFD01_64e05fd3_Tx
      BJB_CALID_01_XIX_BMC_CAN01_5400c4fa_Rx (CanIfRxPduCfg):
        CanIfRxPduCanId = 441799937
        CanIfRxPduCanIdType = EXTENDED_NO_FD_CAN
        CanIfRxPduDlc = 8
        CanIfRxPduUserRxIndicationName = PduR_CanIfRxIndication
        CanIfRxPduUserRxIndicationUL = PDUR
        CanIfRxPduId = 7
        CanIfRxPduReadData = false
        CanIfRxPduReadNotifyStatus = false
        CanIfRxPduDlcCheck = true
        CanIfRxPduHrhIdRef = CN_BMC_CAN01_e16b4bee_Rx
        CanIfRxPduRef = BJB_CALID_01_XIX_BMC_CAN01_89dc60ad_Rx
      OTAMC_D_01_XIX_BMC_CAN01_61822804_Tx (CanIfTxPduCfg):
        CanIfTxPduCanId = 380196246
        CanIfTxPduCanIdType = EXTENDED_CAN
        CanIfTxPduDlc = 4
        CanIfTxPduUserTxConfirmationName = NULL_PTR
        CanIfTxPduUserTxConfirmationUL = NONE
        CanIfTxPduId = 18
        CanIfTxPduReadNotifyStatus = false
        CanIfTxPduType = STATIC
        CanIfTxPduTruncation = true
        CanIfTxPduBufferRef = CHNL_eb535f7d
        CanIfTxPduRef = OTAMC_D_01_XIX_BMC_CAN01_5e0c6077_Tx
      Airbag_10_XIX_HCP5_CANFD01_4586204d_Rx (CanIfRxPduCfg):
        CanIfRxPduCanId = 287
        CanIfRxPduCanIdType = STANDARD_FD_CAN
        CanIfRxPduDlc = 16
        CanIfRxPduUserRxIndicationName = PduR_CanIfRxIndication
        CanIfRxPduUserRxIndicationUL = PDUR
        CanIfRxPduId = 92
        CanIfRxPduReadData = false
        CanIfRxPduReadNotifyStatus = false
        CanIfRxPduDlcCheck = true
        CanIfRxPduHrhIdRef = CN_HCP5_CANFD01_c0785467_Rx
        CanIfRxPduRef = Airbag_10_XIX_HCP5_CANFD01_6624abf2_Rx
      DIA_BJB_Resp_XIX_HCP5_CANFD01_007e70da_Tx (CanIfTxPduCfg):
        CanIfTxPduCanId = 402527952
        CanIfTxPduCanIdType = EXTENDED_FD_CAN
        CanIfTxPduDlc = 8
        CanIfTxPduUserTxConfirmationName = NULL_PTR
        CanIfTxPduUserTxConfirmationUL = NONE
        CanIfTxPduId = 53
        CanIfTxPduReadNotifyStatus = false
        CanIfTxPduType = STATIC
        CanIfTxPduTruncation = true
        CanIfTxPduBufferRef = CHNL_b74a53a7
        CanIfTxPduRef = DIA_BJB_Resp_XIX_HCP5_CANFD01_6385845c_Tx
      KS_Hybrid_01_Challenge_K_XIX_HCP5_CANFD01_d5302dac_Tx (CanIfTxPduCfg):
        CanIfTxPduCanId = 441800150
        CanIfTxPduCanIdType = EXTENDED_FD_CAN
        CanIfTxPduDlc = 12
        CanIfTxPduUserTxConfirmationName = PduR_CanIfTxConfirmation
        CanIfTxPduUserTxConfirmationUL = PDUR
        CanIfTxPduId = 42
        CanIfTxPduReadNotifyStatus = false
        CanIfTxPduType = STATIC
        CanIfTxPduTruncation = true
        CanIfTxPduBufferRef = CHNL_b74a53a7
        CanIfTxPduRef = KS_Hybrid_01_Challenge_K_XIX_HCP5_CANFD01_f262895d_Tx
      3 x CanIfRxPduCfg, all with CanIfRxPduDlc=8, CanIfRxPduUserRxIndicationName=PduR_CanIfRxIndication, CanIfRxPduUserRxIndicationUL=PDUR, CanIfRxPduReadData=false, CanIfRxPduReadNotifyStatus=false, CanIfRxPduDlcCheck=true:
        OBDC_SSN_UI2Sens01_Req_XIX_HCP5_CANFD01_adaf415b_Rx: CanIfRxPduCanId=402420145, CanIfRxPduCanIdType=EXTENDED_FD_CAN, CanIfRxPduUserRxIndicationType=PDUID_PDUINFOPTR, CanIfRxPduId=68, CanIfRxPduHrhIdRef=CN_HCP5_CANFD01_f532029f_Rx, CanIfRxPduRef=OBDC_SSN_UI2Sens01_Req_XIX_HCP5_CANFD01_00e7db31_Rx
        UI2_01_XIX_BMC_CAN01_E2E_946eea6c_Rx: CanIfRxPduCanId=755, CanIfRxPduCanIdType=STANDARD_NO_FD_CAN, CanIfRxPduId=32, CanIfRxPduHrhIdRef=CN_BMC_CAN01_d4211d16_Rx, CanIfRxPduRef=UI2_01_XIX_BMC_CAN01_E2E_04321bb6_Rx
        DIA_UI2Sens01_Req_XIX_HCP5_CANFD01_6e8e422a_Rx: CanIfRxPduCanId=402397105, CanIfRxPduCanIdType=EXTENDED_FD_CAN, CanIfRxPduUserRxIndicationType=PDUID_PDUINFOPTR, CanIfRxPduId=71, CanIfRxPduHrhIdRef=CN_HCP5_CANFD01_f532029f_Rx, CanIfRxPduRef=DIA_UI2Sens01_Req_XIX_HCP5_CANFD01_d86619ec_Rx
      DIA_UI2Sens01_Resp_XIX_HCP5_CANFD01_27bbe557_Tx (CanIfTxPduCfg):
        CanIfTxPduCanId = 402528177
        CanIfTxPduCanIdType = EXTENDED_FD_CAN
        CanIfTxPduDlc = 8
        CanIfTxPduUserTxConfirmationName = NULL_PTR
        CanIfTxPduUserTxConfirmationUL = NONE
        CanIfTxPduId = 52
        CanIfTxPduReadNotifyStatus = false
        CanIfTxPduType = STATIC
        CanIfTxPduTruncation = true
        CanIfTxPduBufferRef = CHNL_b74a53a7
        CanIfTxPduRef = DIA_UI2Sens01_Resp_XIX_HCP5_CANFD01_dfc9d8b9_Tx
      OBDx_Hybrid_01_Req_XIX_HCP5_CANFD01_5e9dd14f_Rx (CanIfRxPduCfg):
        CanIfRxPduCanId = 416941553
        CanIfRxPduCanIdType = EXTENDED_FD_CAN
        CanIfRxPduDlc = 8
        CanIfRxPduUserRxIndicationName = CanTp_RxIndication
        CanIfRxPduUserRxIndicationType = PDUID_PDUINFOPTR
        CanIfRxPduUserRxIndicationUL = CAN_TP
        CanIfRxPduId = 66
        CanIfRxPduReadData = false
        CanIfRxPduReadNotifyStatus = false
        CanIfRxPduDlcCheck = true
        CanIfRxPduHrhIdRef = CN_HCP5_CANFD01_f532029f_Rx
        CanIfRxPduRef = OBDx_Hybrid_01_Req_XIX_HCP5_CANFD01_5cba35a0_Rx
      OBDC_SSN_UI2Sens02_Resp_XIX_HCP5_CANFD01_7f1a2b49_Tx (CanIfTxPduCfg):
        CanIfTxPduCanId = 402551218
        CanIfTxPduCanIdType = EXTENDED_FD_CAN
        CanIfTxPduDlc = 8
        CanIfTxPduUserTxConfirmationName = NULL_PTR
        CanIfTxPduUserTxConfirmationUL = NONE
        CanIfTxPduId = 48
        CanIfTxPduReadNotifyStatus = false
        CanIfTxPduType = STATIC
        CanIfTxPduTruncation = true
        CanIfTxPduBufferRef = CHNL_b74a53a7
        CanIfTxPduRef = OBDC_SSN_UI2Sens02_Resp_XIX_HCP5_CANFD01_18b88987_Tx
      3 x CanIfRxPduCfg, all with CanIfRxPduReadData=false, CanIfRxPduReadNotifyStatus=false, CanIfRxPduDlcCheck=true:
        Thermomanagement_01_XIX_HCP5_CANFD01_6e8ab5ae_Rx: CanIfRxPduCanId=316495126, CanIfRxPduCanIdType=EXTENDED_FD_CAN, CanIfRxPduDlc=64, CanIfRxPduUserRxIndicationName=PduR_CanIfRxIndication, CanIfRxPduUserRxIndicationUL=PDUR, CanIfRxPduId=85, CanIfRxPduHrhIdRef=CN_HCP5_CANFD01_f532029f_Rx, CanIfRxPduRef=Thermomanagement_01_XIX_HCP5_CANFD01_bb71c5fe_Rx
        UI2Sens02_CALID_02_XIX_BMC_CAN01_823cbf87_Rx: CanIfRxPduCanId=441799881, CanIfRxPduCanIdType=EXTENDED_NO_FD_CAN, CanIfRxPduDlc=8, CanIfRxPduUserRxIndicationName=PduR_CanIfRxIndication, CanIfRxPduUserRxIndicationUL=PDUR, CanIfRxPduId=10, CanIfRxPduHrhIdRef=CN_BMC_CAN01_e16b4bee_Rx, CanIfRxPduRef=UI2Sens02_CALID_02_XIX_BMC_CAN01_c59439eb_Rx
        DAAP_Hybrid_01_Req_FD_XIX_HCP5_CANFD01_7f38c4bd_Rx: CanIfRxPduCanId=473972603, CanIfRxPduCanIdType=EXTENDED_FD_CAN, CanIfRxPduDlc=64, CanIfRxPduUserRxIndicationName=CanTp_RxIndication, CanIfRxPduUserRxIndicationType=PDUID_PDUINFOPTR, CanIfRxPduUserRxIndicationUL=CAN_TP, CanIfRxPduId=40, CanIfRxPduHrhIdRef=CN_HCP5_CANFD01_f532029f_Rx, CanIfRxPduRef=DAAP_Hybrid_01_Req_FD_XIX_HCP5_CANFD01_25e2ca12_Rx
      BMC_HV_11_XIX_BMC_CAN01_E2E_4a00e54f_Tx (CanIfTxPduCfg):
        CanIfTxPduCanId = 441800494
        CanIfTxPduCanIdType = EXTENDED_CAN
        CanIfTxPduDlc = 8
        CanIfTxPduUserTxConfirmationName = PduR_CanIfTxConfirmation
        CanIfTxPduUserTxConfirmationUL = PDUR
        CanIfTxPduId = 2
        CanIfTxPduReadNotifyStatus = false
        CanIfTxPduType = STATIC
        CanIfTxPduTruncation = true
        CanIfTxPduBufferRef = CHNL_eb535f7d
        CanIfTxPduRef = BMC_HV_11_XIX_BMC_CAN01_E2E_bc007233_Tx
      DIA_UI2Sens01_Resp_XIX_BMC_CAN01_62d361ac_Rx (CanIfRxPduCfg):
        CanIfRxPduCanId = 402528177
        CanIfRxPduCanIdType = EXTENDED_NO_FD_CAN
        CanIfRxPduDlc = 8
        CanIfRxPduUserRxIndicationName = PduR_CanIfRxIndication
        CanIfRxPduUserRxIndicationType = PDUID_PDUINFOPTR
        CanIfRxPduUserRxIndicationUL = PDUR
        CanIfRxPduId = 20
        CanIfRxPduReadData = false
        CanIfRxPduReadNotifyStatus = false
        CanIfRxPduDlcCheck = true
        CanIfRxPduHrhIdRef = CN_BMC_CAN01_e16b4bee_Rx
        CanIfRxPduRef = DIA_UI2Sens01_Resp_XIX_BMC_CAN01_2ddec3aa_Rx
      OTAMC_D_01_XIX_HCP5_CANFD01_E2E_762c73ec_Rx (CanIfRxPduCfg):
        CanIfRxPduCanId = 380196246
        CanIfRxPduCanIdType = EXTENDED_FD_CAN
        CanIfRxPduDlc = 4
        CanIfRxPduUserRxIndicationName = PduR_CanIfRxIndication
        CanIfRxPduUserRxIndicationUL = PDUR
        CanIfRxPduId = 77
        CanIfRxPduReadData = false
        CanIfRxPduReadNotifyStatus = false
        CanIfRxPduDlcCheck = true
        CanIfRxPduHrhIdRef = CN_HCP5_CANFD01_f532029f_Rx
        CanIfRxPduRef = OTAMC_D_01_XIX_HCP5_CANFD01_E2E_8283a85d_Rx
      OBDC_Funktionaler_Req_All_XIX_BMC_CAN01_d0beae2e_Tx (CanIfTxPduCfg):
        CanIfTxPduCanId = 402457088
        CanIfTxPduCanIdType = EXTENDED_CAN
        CanIfTxPduDlc = 8
        CanIfTxPduUserTxConfirmationName = CanTp_TxConfirmation
        CanIfTxPduUserTxConfirmationUL = CAN_TP
        CanIfTxPduId = 11
        CanIfTxPduReadNotifyStatus = false
        CanIfTxPduType = STATIC
        CanIfTxPduTruncation = true
        CanIfTxPduBufferRef = CHNL_eb535f7d
        CanIfTxPduRef = OBDC_Funktionaler_Req_All_XIX_BMC_CAN01_c40642be_Tx
      ISOx_Hybrid_01_Req_XIX_HCP5_CANFD01_815e7b57_Rx (CanIfRxPduCfg):
        CanIfRxPduCanId = 402391163
        CanIfRxPduCanIdType = EXTENDED_FD_CAN
        CanIfRxPduDlc = 8
        CanIfRxPduUserRxIndicationName = CanTp_RxIndication
        CanIfRxPduUserRxIndicationType = PDUID_PDUINFOPTR
        CanIfRxPduUserRxIndicationUL = CAN_TP
        CanIfRxPduId = 73
        CanIfRxPduReadData = false
        CanIfRxPduReadNotifyStatus = false
        CanIfRxPduDlcCheck = true
        CanIfRxPduHrhIdRef = CN_HCP5_CANFD01_f532029f_Rx
        CanIfRxPduRef = ISOx_Hybrid_01_Req_XIX_HCP5_CANFD01_bd99bbef_Rx
      UI2_Komponentenfehler_02_XIX_BMC_CAN01_e0a6dc0c_Rx (CanIfRxPduCfg):
        CanIfRxPduCanId = 316495137
        CanIfRxPduCanIdType = EXTENDED_NO_FD_CAN
        CanIfRxPduDlc = 8
        CanIfRxPduUserRxIndicationName = PduR_CanIfRxIndication
        CanIfRxPduUserRxIndicationUL = PDUR
        CanIfRxPduId = 23
        CanIfRxPduReadData = false
        CanIfRxPduReadNotifyStatus = false
        CanIfRxPduDlcCheck = true
        CanIfRxPduHrhIdRef = CN_BMC_CAN01_e16b4bee_Rx
        CanIfRxPduRef = UI2_Komponentenfehler_02_XIX_BMC_CAN01_008f0d49_Rx
      OBDC_SSN_UI2Sens01_Resp_XIX_HCP5_CANFD01_60cebe88_Tx (CanIfTxPduCfg):
        CanIfTxPduCanId = 402551217
        CanIfTxPduCanIdType = EXTENDED_FD_CAN
        CanIfTxPduDlc = 8
        CanIfTxPduUserTxConfirmationName = NULL_PTR
        CanIfTxPduUserTxConfirmationUL = NONE
        CanIfTxPduId = 49
        CanIfTxPduReadNotifyStatus = false
        CanIfTxPduType = STATIC
        CanIfTxPduTruncation = true
        CanIfTxPduBufferRef = CHNL_b74a53a7
        CanIfTxPduRef = OBDC_SSN_UI2Sens01_Resp_XIX_HCP5_CANFD01_2773f712_Tx
      OBDx_allOBD_Req_XIX_BMC_CAN01_ea904dca_Tx (CanIfTxPduCfg):
        CanIfTxPduCanId = 417018865
        CanIfTxPduCanIdType = EXTENDED_CAN
        CanIfTxPduDlc = 8
        CanIfTxPduUserTxConfirmationUL = NONE
        CanIfTxPduId = 10
        CanIfTxPduReadNotifyStatus = false
        CanIfTxPduType = STATIC
        CanIfTxPduTruncation = true
        CanIfTxPduUserTxConfirmationName = NULL_PTR
        CanIfTxPduBufferRef = CHNL_eb535f7d
        CanIfTxPduRef = OBDx_allOBD_Req_XIX_BMC_CAN01_9cfd1e51_Tx
      4 x CanIfRxPduCfg, all with CanIfRxPduDlc=8, CanIfRxPduUserRxIndicationName=PduR_CanIfRxIndication, CanIfRxPduUserRxIndicationUL=PDUR, CanIfRxPduReadData=false, CanIfRxPduReadNotifyStatus=false, CanIfRxPduDlcCheck=true:
        DIA_BJB_Req_XIX_HCP5_CANFD01_a02c6805_Rx: CanIfRxPduCanId=402396880, CanIfRxPduCanIdType=EXTENDED_FD_CAN, CanIfRxPduUserRxIndicationType=PDUID_PDUINFOPTR, CanIfRxPduId=72, CanIfRxPduHrhIdRef=CN_HCP5_CANFD01_f532029f_Rx, CanIfRxPduRef=DIA_BJB_Req_XIX_HCP5_CANFD01_f2b9e65d_Rx
        UI2_02_XIX_BMC_CAN01_E2E_8e0e6b15_Rx: CanIfRxPduCanId=756, CanIfRxPduCanIdType=STANDARD_NO_FD_CAN, CanIfRxPduId=31, CanIfRxPduHrhIdRef=CN_BMC_CAN01_d4211d16_Rx, CanIfRxPduRef=UI2_02_XIX_BMC_CAN01_E2E_49da1bd1_Rx
        ClampControl_01_XIX_HCP5_CANFD01_7d795a05_Rx: CanIfRxPduCanId=316495102, CanIfRxPduCanIdType=EXTENDED_FD_CAN, CanIfRxPduId=86, CanIfRxPduHrhIdRef=CN_HCP5_CANFD01_f532029f_Rx, CanIfRxPduRef=ClampControl_01_XIX_HCP5_CANFD01_5af08b97_Rx
        UI2Sens01_CALID_01_XIX_BMC_CAN01_9dffcac2_Rx: CanIfRxPduCanId=441799878, CanIfRxPduCanIdType=EXTENDED_NO_FD_CAN, CanIfRxPduId=13, CanIfRxPduHrhIdRef=CN_BMC_CAN01_e16b4bee_Rx, CanIfRxPduRef=UI2Sens01_CALID_01_XIX_BMC_CAN01_6126d1bc_Rx
      XCP_Hybrid_01_DTO_01_FD_XIX_HCP5_CANFD01_05f39a13_Tx (CanIfTxPduCfg):
        CanIfTxPduCanId = 469526273
        CanIfTxPduCanIdType = EXTENDED_FD_CAN
        CanIfTxPduDlc = 64
        CanIfTxPduUserTxConfirmationName = Xcp_CanIfTxConfirmation
        CanIfTxPduUserTxConfirmationUL = XCP
        CanIfTxPduId = 28
        CanIfTxPduReadNotifyStatus = false
        CanIfTxPduType = STATIC
        CanIfTxPduTruncation = true
        CanIfTxPduBufferRef = CHNL_b74a53a7
        CanIfTxPduRef = XCP_Hybrid_01_DTO_01_FD_XIX_HCP5_CANFD01_ee6930a2_Tx
      ISOx_Hybrid_01_Req_FD_XIX_HCP5_CANFD01_40e70463_Rx (CanIfRxPduCfg):
        CanIfRxPduCanId = 473956475
        CanIfRxPduCanIdType = EXTENDED_FD_CAN
        CanIfRxPduDlc = 64
        CanIfRxPduUserRxIndicationName = CanTp_RxIndication
        CanIfRxPduUserRxIndicationType = PDUID_PDUINFOPTR
        CanIfRxPduUserRxIndicationUL = CAN_TP
        CanIfRxPduId = 42
        CanIfRxPduReadData = false
        CanIfRxPduReadNotifyStatus = false
        CanIfRxPduDlcCheck = true
        CanIfRxPduHrhIdRef = CN_HCP5_CANFD01_f532029f_Rx
        CanIfRxPduRef = ISOx_Hybrid_01_Req_FD_XIX_HCP5_CANFD01_5affd0fb_Rx
      BMC_HV_10_XIX_BMC_CAN01_E2E_2092c60e_Tx (CanIfTxPduCfg):
        CanIfTxPduCanId = 441800483
        CanIfTxPduCanIdType = EXTENDED_CAN
        CanIfTxPduDlc = 8
        CanIfTxPduUserTxConfirmationName = PduR_CanIfTxConfirmation
        CanIfTxPduUserTxConfirmationUL = PDUR
        CanIfTxPduId = 5
        CanIfTxPduReadNotifyStatus = false
        CanIfTxPduType = STATIC
        CanIfTxPduTruncation = true
        CanIfTxPduBufferRef = CHNL_eb535f7d
        CanIfTxPduRef = BMC_HV_10_XIX_BMC_CAN01_E2E_31888fd1_Tx
      BMC_HV_13_XIX_BMC_CAN01_E2E_9f24a3cd_Tx (CanIfTxPduCfg):
        CanIfTxPduCanId = 441800488
        CanIfTxPduCanIdType = EXTENDED_CAN
        CanIfTxPduDlc = 8
        CanIfTxPduUserTxConfirmationName = PduR_CanIfTxConfirmation
        CanIfTxPduUserTxConfirmationUL = PDUR
        CanIfTxPduId = 3
        CanIfTxPduReadNotifyStatus = false
        CanIfTxPduType = STATIC
        CanIfTxPduTruncation = true
        CanIfTxPduBufferRef = CHNL_eb535f7d
        CanIfTxPduRef = BMC_HV_13_XIX_BMC_CAN01_E2E_7c608fb6_Tx
      OBDx_allOBD_Req_XIX_HCP5_CANFD01_d9c59ad6_Rx (CanIfRxPduCfg):
        CanIfRxPduCanId = 417018865
        CanIfRxPduCanIdType = EXTENDED_FD_CAN
        CanIfRxPduDlc = 8
        CanIfRxPduUserRxIndicationName = PduR_CanIfRxIndication
        CanIfRxPduUserRxIndicationType = PDUID_PDUINFOPTR
        CanIfRxPduUserRxIndicationUL = PDUR
        CanIfRxPduId = 65
        CanIfRxPduReadData = false
        CanIfRxPduReadNotifyStatus = false
        CanIfRxPduDlcCheck = true
        CanIfRxPduHrhIdRef = CN_HCP5_CANFD01_f532029f_Rx
        CanIfRxPduRef = OBDx_allOBD_Req_XIX_HCP5_CANFD01_a7e21e7c_Rx
      BMC_HV_03_XIX_HCP5_CANFD01_605a1c21_Tx (CanIfTxPduCfg):
        CanIfTxPduCanId = 441800021
        CanIfTxPduCanIdType = EXTENDED_FD_CAN
        CanIfTxPduDlc = 24
        CanIfTxPduUserTxConfirmationName = PduR_CanIfTxConfirmation
        CanIfTxPduUserTxConfirmationUL = PDUR
        CanIfTxPduId = 43
        CanIfTxPduReadNotifyStatus = false
        CanIfTxPduType = STATIC
        CanIfTxPduTruncation = true
        CanIfTxPduBufferRef = CHNL_b74a53a7
        CanIfTxPduRef = BMC_HV_03_XIX_HCP5_CANFD01_58321150_Tx
      OBDx_Hybrid_01_Resp_XIX_HCP5_CANFD01_8c0081cb_Tx (CanIfTxPduCfg):
        CanIfTxPduCanId = 417001733
        CanIfTxPduCanIdType = EXTENDED_FD_CAN
        CanIfTxPduDlc = 8
        CanIfTxPduUserTxConfirmationName = CanTp_TxConfirmation
        CanIfTxPduUserTxConfirmationUL = CAN_TP
        CanIfTxPduId = 46
        CanIfTxPduReadNotifyStatus = false
        CanIfTxPduType = STATIC
        CanIfTxPduTruncation = true
        CanIfTxPduBufferRef = CHNL_b74a53a7
        CanIfTxPduRef = OBDx_Hybrid_01_Resp_XIX_HCP5_CANFD01_a027092e_Tx
      6 x CanIfRxPduCfg, all with CanIfRxPduReadData=false, CanIfRxPduReadNotifyStatus=false, CanIfRxPduDlcCheck=true:
        DCDC_04_XIX_HCP5_CANFD01_b5498b76_Rx: CanIfRxPduCanId=247, CanIfRxPduCanIdType=STANDARD_FD_CAN, CanIfRxPduDlc=8, CanIfRxPduUserRxIndicationName=PduR_CanIfRxIndication, CanIfRxPduUserRxIndicationUL=PDUR, CanIfRxPduId=93, CanIfRxPduHrhIdRef=CN_HCP5_CANFD01_c0785467_Rx, CanIfRxPduRef=DCDC_04_XIX_HCP5_CANFD01_622db5e5_Rx
        NmNode_BMC_HV_XIX_HCP5_CANFD01_044b03b2_Rx: CanIfRxPduCanIdType=EXTENDED_FD_CAN, CanIfRxPduDlc=24, CanIfRxPduUserRxIndicationName=CanNm_RxIndication, CanIfRxPduUserRxIndicationUL=CAN_NM, CanIfRxPduId=36, CanIfRxPduHrhIdRef=CN_HCP5_CANFD01_f532029f_Rx, CanIfRxPduRef=NmNode_BMC_HV_XIX_HCP5_CANFD01_c8c687b4_Rx
          CHNL_74dce3ec (CanIfRxPduCanIdRange): CanIfRxPduCanIdRangeLowerCanId=452984832, CanIfRxPduCanIdRangeUpperCanId=452985855
        OTP_01_XIX_HCP5_CANFD01_7701dadd_Rx: CanIfRxPduCanId=380196106, CanIfRxPduCanIdType=EXTENDED_FD_CAN, CanIfRxPduDlc=8, CanIfRxPduUserRxIndicationName=PduR_CanIfRxIndication, CanIfRxPduUserRxIndicationUL=PDUR, CanIfRxPduId=81, CanIfRxPduHrhIdRef=CN_HCP5_CANFD01_f532029f_Rx, CanIfRxPduRef=OTP_01_XIX_HCP5_CANFD01_fd0a6756_Rx
        BJB_10_XIX_BMC_CAN01_E2E_c82e0916_Rx: CanIfRxPduCanId=441800484, CanIfRxPduCanIdType=EXTENDED_NO_FD_CAN, CanIfRxPduDlc=8, CanIfRxPduUserRxIndicationName=PduR_CanIfRxIndication, CanIfRxPduUserRxIndicationUL=PDUR, CanIfRxPduId=4, CanIfRxPduHrhIdRef=CN_BMC_CAN01_e16b4bee_Rx, CanIfRxPduRef=BJB_10_XIX_BMC_CAN01_E2E_04bd7411_Rx
        OBDC_Funktionaler_Req_All_FD_XIX_HCP5_CANFD01_88d59169_Rx: CanIfRxPduCanId=474022400, CanIfRxPduCanIdType=EXTENDED_FD_CAN, CanIfRxPduDlc=64, CanIfRxPduUserRxIndicationName=CanTp_RxIndication, CanIfRxPduUserRxIndicationType=PDUID_PDUINFOPTR, CanIfRxPduUserRxIndicationUL=CAN_TP, CanIfRxPduId=38, CanIfRxPduHrhIdRef=CN_HCP5_CANFD01_f532029f_Rx, CanIfRxPduRef=OBDC_Funktionaler_Req_All_FD_XIX_HCP5_CANFD01_d0af7a5a_Rx
        OBDC_Hybrid_01_Req_FD_XIX_HCP5_CANFD01_72b989a9_Rx: CanIfRxPduCanId=473956987, CanIfRxPduCanIdType=EXTENDED_FD_CAN, CanIfRxPduDlc=64, CanIfRxPduUserRxIndicationName=CanTp_RxIndication, CanIfRxPduUserRxIndicationType=PDUID_PDUINFOPTR, CanIfRxPduUserRxIndicationUL=CAN_TP, CanIfRxPduId=41, CanIfRxPduHrhIdRef=CN_HCP5_CANFD01_f532029f_Rx, CanIfRxPduRef=OBDC_Hybrid_01_Req_FD_XIX_HCP5_CANFD01_38935bdf_Rx
      4 x CanIfTxPduCfg, all with CanIfTxPduReadNotifyStatus=false, CanIfTxPduType=STATIC, CanIfTxPduTruncation=true:
        ISOx_Hybrid_01_Resp_FD_XIX_HCP5_CANFD01_67e8ccae_Tx: CanIfTxPduCanId=474087547, CanIfTxPduCanIdType=EXTENDED_FD_CAN, CanIfTxPduDlc=64, CanIfTxPduUserTxConfirmationName=CanTp_TxConfirmation, CanIfTxPduUserTxConfirmationUL=CAN_TP, CanIfTxPduId=27, CanIfTxPduBufferRef=CHNL_b74a53a7, CanIfTxPduRef=ISOx_Hybrid_01_Resp_FD_XIX_HCP5_CANFD01_71c0a54e_Tx
        KS_Hybrid_01_ReqFrame_XIX_HCP5_CANFD01_2f090e23_Tx: CanIfTxPduCanId=441800152, CanIfTxPduCanIdType=EXTENDED_FD_CAN, CanIfTxPduDlc=8, CanIfTxPduUserTxConfirmationName=PduR_CanIfTxConfirmation, CanIfTxPduUserTxConfirmationUL=PDUR, CanIfTxPduId=41, CanIfTxPduBufferRef=CHNL_b74a53a7, CanIfTxPduRef=KS_Hybrid_01_ReqFrame_XIX_HCP5_CANFD01_d7f937e5_Tx
        NMH_Hybrid_01_XIX_BMC_CAN01_92052a44_Tx: CanIfTxPduCanId=452984955, CanIfTxPduCanIdType=EXTENDED_CAN, CanIfTxPduDlc=8, CanIfTxPduUserTxConfirmationName=CanNm_TxConfirmation, CanIfTxPduUserTxConfirmationUL=CAN_NM, CanIfTxPduId=1, CanIfTxPduBufferRef=CHNL_eb535f7d, CanIfTxPduRef=NMH_Hybrid_01_XIX_BMC_CAN01_30f8f2db_Tx
        ORU_Control_D_01_XIX_BMC_CAN01_015e516d_Tx: CanIfTxPduCanId=380196245, CanIfTxPduCanIdType=EXTENDED_CAN, CanIfTxPduDlc=8, CanIfTxPduUserTxConfirmationName=NULL_PTR, CanIfTxPduUserTxConfirmationUL=NONE, CanIfTxPduId=19, CanIfTxPduBufferRef=CHNL_eb535f7d, CanIfTxPduRef=ORU_Control_D_01_XIX_BMC_CAN01_0f07b83a_Tx
      ISOx_Funkt_Req_All_FD_XIX_HCP5_CANFD01_013aa570_Rx (CanIfRxPduCfg):
        CanIfRxPduCanId = 474021888
        CanIfRxPduCanIdType = EXTENDED_FD_CAN
        CanIfRxPduDlc = 64
        CanIfRxPduUserRxIndicationName = CanTp_RxIndication
        CanIfRxPduUserRxIndicationType = PDUID_PDUINFOPTR
        CanIfRxPduUserRxIndicationUL = CAN_TP
        CanIfRxPduId = 39
        CanIfRxPduReadData = false
        CanIfRxPduReadNotifyStatus = false
        CanIfRxPduDlcCheck = true
        CanIfRxPduHrhIdRef = CN_HCP5_CANFD01_f532029f_Rx
        CanIfRxPduRef = ISOx_Funkt_Req_All_FD_XIX_HCP5_CANFD01_1dbb1bad_Rx
      ISOx_Hybrid_01_Resp_XIX_HCP5_CANFD01_6ceb2cbe_Tx (CanIfTxPduCfg):
        CanIfTxPduCanId = 402522235
        CanIfTxPduCanIdType = EXTENDED_FD_CAN
        CanIfTxPduDlc = 8
        CanIfTxPduUserTxConfirmationName = CanTp_TxConfirmation
        CanIfTxPduUserTxConfirmationUL = CAN_TP
        CanIfTxPduId = 54
        CanIfTxPduReadNotifyStatus = false
        CanIfTxPduType = STATIC
        CanIfTxPduTruncation = true
        CanIfTxPduBufferRef = CHNL_b74a53a7
        CanIfTxPduRef = ISOx_Hybrid_01_Resp_XIX_HCP5_CANFD01_46a576a1_Tx
      CDD_DEV_BJB_Resp_FF_XIX_BMC_CAN01_575624cc_Rx (CanIfRxPduCfg):
        CanIfRxPduCanId = 419352831
        CanIfRxPduCanIdType = EXTENDED_NO_FD_CAN
        CanIfRxPduDlc = 8
        CanIfRxPduUserRxIndicationUL = PDUR
        CanIfRxPduId = 14
        CanIfRxPduReadData = false
        CanIfRxPduReadNotifyStatus = false
        CanIfRxPduUserRxIndicationName = PduR_CanIfRxIndication
        CanIfRxPduDlcCheck = true
        CanIfRxPduHrhIdRef = CN_BMC_CAN01_e16b4bee_Rx
        CanIfRxPduRef = CDD_DEV_BJB_Resp_FF_XIX_BMC_CAN01_19d429a9_Rx
      OBD_HCP1_SOK_XIX_HCP5_CANFD01_7e7ec6e6_Rx (CanIfRxPduCfg):
        CanIfRxPduCanId = 400818191
        CanIfRxPduCanIdType = EXTENDED_FD_CAN
        CanIfRxPduDlc = 6
        CanIfRxPduUserRxIndicationName = PduR_CanIfRxIndication
        CanIfRxPduUserRxIndicationUL = PDUR
        CanIfRxPduId = 74
        CanIfRxPduReadData = false
        CanIfRxPduReadNotifyStatus = false
        CanIfRxPduDlcCheck = true
        CanIfRxPduHrhIdRef = CN_HCP5_CANFD01_f532029f_Rx
        CanIfRxPduRef = OBD_HCP1_SOK_XIX_HCP5_CANFD01_a5806350_Rx
      BMC_HV_06_SOK_XIX_HCP5_CANFD01_393d3e1d_Tx (CanIfTxPduCfg):
        CanIfTxPduCanId = 380196118
        CanIfTxPduCanIdType = EXTENDED_FD_CAN
        CanIfTxPduDlc = 12
        CanIfTxPduUserTxConfirmationName = PduR_CanIfTxConfirmation
        CanIfTxPduUserTxConfirmationUL = PDUR
        CanIfTxPduId = 59
        CanIfTxPduReadNotifyStatus = false
        CanIfTxPduType = STATIC
        CanIfTxPduTruncation = true
        CanIfTxPduBufferRef = CHNL_b74a53a7
        CanIfTxPduRef = BMC_HV_06_SOK_XIX_HCP5_CANFD01_daff2390_Tx
      DIA_UI2Sens02_Req_XIX_HCP5_CANFD01_c2847047_Rx (CanIfRxPduCfg):
        CanIfRxPduCanId = 402397106
        CanIfRxPduCanIdType = EXTENDED_FD_CAN
        CanIfRxPduDlc = 8
        CanIfRxPduUserRxIndicationName = PduR_CanIfRxIndication
        CanIfRxPduUserRxIndicationType = PDUID_PDUINFOPTR
        CanIfRxPduUserRxIndicationUL = PDUR
        CanIfRxPduId = 70
        CanIfRxPduReadData = false
        CanIfRxPduReadNotifyStatus = false
        CanIfRxPduDlcCheck = true
        CanIfRxPduHrhIdRef = CN_HCP5_CANFD01_f532029f_Rx
        CanIfRxPduRef = DIA_UI2Sens02_Req_XIX_HCP5_CANFD01_a61e514a_Rx
      BMC_CMC_Temperatur_01_XIX_HCP5_CANFD01_5b37e798_Tx (CanIfTxPduCfg):
        CanIfTxPduCanId = 441800234
        CanIfTxPduCanIdType = EXTENDED_FD_CAN
        CanIfTxPduDlc = 64
        CanIfTxPduUserTxConfirmationName = PduR_CanIfTxConfirmation
        CanIfTxPduUserTxConfirmationUL = PDUR
        CanIfTxPduId = 39
        CanIfTxPduReadNotifyStatus = false
        CanIfTxPduType = STATIC
        CanIfTxPduTruncation = true
        CanIfTxPduBufferRef = CHNL_b74a53a7
        CanIfTxPduRef = BMC_CMC_Temperatur_01_XIX_HCP5_CANFD01_0fcecf3e_Tx
      DCDC_NV_CALID_XIX_HCP5_CANFD01_3daa14f3_Rx (CanIfRxPduCfg):
        CanIfRxPduCanId = 441800372
        CanIfRxPduCanIdType = EXTENDED_FD_CAN
        CanIfRxPduDlc = 16
        CanIfRxPduUserRxIndicationName = PduR_CanIfRxIndication
        CanIfRxPduUserRxIndicationUL = PDUR
        CanIfRxPduId = 48
        CanIfRxPduReadData = false
        CanIfRxPduReadNotifyStatus = false
        CanIfRxPduDlcCheck = true
        CanIfRxPduHrhIdRef = CN_HCP5_CANFD01_f532029f_Rx
        CanIfRxPduRef = DCDC_NV_CALID_XIX_HCP5_CANFD01_004a20bd_Rx
      OBDC_SSN_BJB_Resp_XIX_HCP5_CANFD01_03965832_Tx (CanIfTxPduCfg):
        CanIfTxPduCanId = 402550992
        CanIfTxPduCanIdType = EXTENDED_FD_CAN
        CanIfTxPduDlc = 8
        CanIfTxPduUserTxConfirmationName = NULL_PTR
        CanIfTxPduUserTxConfirmationUL = NONE
        CanIfTxPduId = 50
        CanIfTxPduReadNotifyStatus = false
        CanIfTxPduType = STATIC
        CanIfTxPduTruncation = true
        CanIfTxPduBufferRef = CHNL_b74a53a7
        CanIfTxPduRef = OBDC_SSN_BJB_Resp_XIX_HCP5_CANFD01_7c2a070c_Tx
      DCDC_NV_Komponentenfehler_03_XIX_HCP5_CANFD01_ab2f10d2_Rx (CanIfRxPduCfg):
        CanIfRxPduCanId = 441800370
        CanIfRxPduCanIdType = EXTENDED_FD_CAN
        CanIfRxPduDlc = 8
        CanIfRxPduUserRxIndicationName = PduR_CanIfRxIndication
        CanIfRxPduUserRxIndicationUL = PDUR
        CanIfRxPduId = 50
        CanIfRxPduReadData = false
        CanIfRxPduReadNotifyStatus = false
        CanIfRxPduDlcCheck = true
        CanIfRxPduHrhIdRef = CN_HCP5_CANFD01_f532029f_Rx
        CanIfRxPduRef = DCDC_NV_Komponentenfehler_03_XIX_HCP5_CANFD01_aee2148b_Rx
      BMC_HV_04_XIX_BMC_CAN01_E2E_501aae6e_Tx (CanIfTxPduCfg):
        CanIfTxPduCanId = 380196111
        CanIfTxPduCanIdType = EXTENDED_CAN
        CanIfTxPduDlc = 8
        CanIfTxPduUserTxConfirmationName = PduR_CanIfTxConfirmation
        CanIfTxPduUserTxConfirmationUL = PDUR
        CanIfTxPduId = 22
        CanIfTxPduReadNotifyStatus = false
        CanIfTxPduType = STATIC
        CanIfTxPduTruncation = true
        CanIfTxPduBufferRef = CHNL_eb535f7d
        CanIfTxPduRef = BMC_HV_04_XIX_BMC_CAN01_E2E_24b17933_Tx
      BMC_HV_12_XIX_BMC_CAN01_E2E_f5b6808c_Tx (CanIfTxPduCfg):
        CanIfTxPduCanId = 441800487
        CanIfTxPduCanIdType = EXTENDED_CAN
        CanIfTxPduDlc = 8
        CanIfTxPduUserTxConfirmationName = PduR_CanIfTxConfirmation
        CanIfTxPduUserTxConfirmationUL = PDUR
        CanIfTxPduId = 4
        CanIfTxPduReadNotifyStatus = false
        CanIfTxPduType = STATIC
        CanIfTxPduTruncation = true
        CanIfTxPduBufferRef = CHNL_eb535f7d
        CanIfTxPduRef = BMC_HV_12_XIX_BMC_CAN01_E2E_f1e87254_Tx
      UI2Sens01_CALID_02_XIX_BMC_CAN01_82a14c39_Rx (CanIfRxPduCfg):
        CanIfRxPduCanId = 441799879
        CanIfRxPduCanIdType = EXTENDED_NO_FD_CAN
        CanIfRxPduDlc = 8
        CanIfRxPduUserRxIndicationName = PduR_CanIfRxIndication
        CanIfRxPduUserRxIndicationUL = PDUR
        CanIfRxPduId = 12
        CanIfRxPduReadData = false
        CanIfRxPduReadNotifyStatus = false
        CanIfRxPduDlcCheck = true
        CanIfRxPduHrhIdRef = CN_BMC_CAN01_e16b4bee_Rx
        CanIfRxPduRef = UI2Sens01_CALID_02_XIX_BMC_CAN01_0ca022e6_Rx
      BMC_CMC_Zellspannung_02_XIX_HCP5_CANFD01_d4fe46af_Tx (CanIfTxPduCfg):
        CanIfTxPduCanId = 441800237
        CanIfTxPduCanIdType = EXTENDED_FD_CAN
        CanIfTxPduDlc = 64
        CanIfTxPduUserTxConfirmationName = PduR_CanIfTxConfirmation
        CanIfTxPduUserTxConfirmationUL = PDUR
        CanIfTxPduId = 36
        CanIfTxPduReadNotifyStatus = false
        CanIfTxPduType = STATIC
        CanIfTxPduTruncation = true
        CanIfTxPduBufferRef = CHNL_b74a53a7
        CanIfTxPduRef = BMC_CMC_Zellspannung_02_XIX_HCP5_CANFD01_cba4cd94_Tx
      6 x CanIfRxPduCfg, all with CanIfRxPduDlc=8, CanIfRxPduUserRxIndicationName=PduR_CanIfRxIndication, CanIfRxPduUserRxIndicationUL=PDUR, CanIfRxPduReadData=false, CanIfRxPduReadNotifyStatus=false, CanIfRxPduDlcCheck=true:
        ISO_Funktionaler_Req_All_XIX_HCP5_CANFD01_073618f9_Rx: CanIfRxPduCanId=1792, CanIfRxPduCanIdType=STANDARD_FD_CAN, CanIfRxPduUserRxIndicationType=PDUID_PDUINFOPTR, CanIfRxPduId=43, CanIfRxPduHrhIdRef=CN_HCP5_CANFD01_c0785467_Rx, CanIfRxPduRef=ISO_Funktionaler_Req_All_XIX_HCP5_CANFD01_e497e7f8_Rx
        UI1_04_XIX_BMC_CAN01_4d9274e7_Rx: CanIfRxPduCanId=316494940, CanIfRxPduCanIdType=EXTENDED_NO_FD_CAN, CanIfRxPduId=29, CanIfRxPduHrhIdRef=CN_BMC_CAN01_e16b4bee_Rx, CanIfRxPduRef=UI1_04_XIX_BMC_CAN01_f5320b92_Rx
        Zeitmaster_05_XIX_HCP5_CANFD01_9723d66f_Rx: CanIfRxPduCanId=441800106, CanIfRxPduCanIdType=EXTENDED_FD_CAN, CanIfRxPduId=57, CanIfRxPduHrhIdRef=CN_HCP5_CANFD01_f532029f_Rx, CanIfRxPduRef=Zeitmaster_05_XIX_HCP5_CANFD01_1d48ef0a_Rx
        BJB_08_XIX_BMC_CAN01_65b3a981_Rx: CanIfRxPduCanId=316495214, CanIfRxPduCanIdType=EXTENDED_NO_FD_CAN, CanIfRxPduId=22, CanIfRxPduHrhIdRef=CN_BMC_CAN01_e16b4bee_Rx, CanIfRxPduRef=BJB_08_XIX_BMC_CAN01_7b6df5c6_Rx
        OBDC_SSN_BJB_Resp_XIX_BMC_CAN01_49e1db6f_Rx: CanIfRxPduCanId=402550992, CanIfRxPduCanIdType=EXTENDED_NO_FD_CAN, CanIfRxPduUserRxIndicationType=PDUID_PDUINFOPTR, CanIfRxPduId=18, CanIfRxPduHrhIdRef=CN_BMC_CAN01_e16b4bee_Rx, CanIfRxPduRef=OBDC_SSN_BJB_Resp_XIX_BMC_CAN01_d5ca69f5_Rx
        OBD_03_XIX_HCP5_CANFD01_e444f1b2_Rx: CanIfRxPduCanId=380196140, CanIfRxPduCanIdType=EXTENDED_FD_CAN, CanIfRxPduId=80, CanIfRxPduHrhIdRef=CN_HCP5_CANFD01_f532029f_Rx, CanIfRxPduRef=OBD_03_XIX_HCP5_CANFD01_2635ffad_Rx
      OBD_04_XIX_BMC_CAN01_d176fbc3_Tx (CanIfTxPduCfg):
        CanIfTxPduCanId = 380196171
        CanIfTxPduCanIdType = EXTENDED_CAN
        CanIfTxPduDlc = 8
        CanIfTxPduUserTxConfirmationName = NULL_PTR
        CanIfTxPduUserTxConfirmationUL = NONE
        CanIfTxPduId = 20
        CanIfTxPduReadNotifyStatus = false
        CanIfTxPduType = STATIC
        CanIfTxPduTruncation = true
        CanIfTxPduBufferRef = CHNL_eb535f7d
        CanIfTxPduRef = OBD_04_XIX_BMC_CAN01_a3a3ce7e_Tx
      DCDC_NV_CVN_XIX_HCP5_CANFD01_b19aee2b_Rx (CanIfRxPduCfg):
        CanIfRxPduCanId = 441800373
        CanIfRxPduCanIdType = EXTENDED_FD_CAN
        CanIfRxPduDlc = 8
        CanIfRxPduUserRxIndicationName = PduR_CanIfRxIndication
        CanIfRxPduUserRxIndicationUL = PDUR
        CanIfRxPduId = 47
        CanIfRxPduReadData = false
        CanIfRxPduReadNotifyStatus = false
        CanIfRxPduDlcCheck = true
        CanIfRxPduHrhIdRef = CN_HCP5_CANFD01_f532029f_Rx
        CanIfRxPduRef = DCDC_NV_CVN_XIX_HCP5_CANFD01_01267e2b_Rx
      OBDC_SSN_UI2Sens01_Req_XIX_BMC_CAN01_168a293f_Tx (CanIfTxPduCfg):
        CanIfTxPduCanId = 402420145
        CanIfTxPduCanIdType = EXTENDED_CAN
        CanIfTxPduDlc = 8
        CanIfTxPduUserTxConfirmationName = NULL_PTR
        CanIfTxPduUserTxConfirmationUL = NONE
        CanIfTxPduId = 13
        CanIfTxPduReadNotifyStatus = false
        CanIfTxPduType = STATIC
        CanIfTxPduTruncation = true
        CanIfTxPduBufferRef = CHNL_eb535f7d
        CanIfTxPduRef = OBDC_SSN_UI2Sens01_Req_XIX_BMC_CAN01_32b2328b_Tx
      CDD_DEV_BJB_Req_01_XIX_HCP5_CANFD01_dc450494_Rx (CanIfRxPduCfg):
        CanIfRxPduCanId = 419352576
        CanIfRxPduCanIdType = EXTENDED_FD_CAN
        CanIfRxPduDlc = 8
        CanIfRxPduUserRxIndicationUL = PDUR
        CanIfRxPduId = 62
        CanIfRxPduReadData = false
        CanIfRxPduReadNotifyStatus = false
        CanIfRxPduUserRxIndicationName = PduR_CanIfRxIndication
        CanIfRxPduDlcCheck = true
        CanIfRxPduHrhIdRef = CN_HCP5_CANFD01_f532029f_Rx
        CanIfRxPduRef = CDD_DEV_BJB_Req_01_XIX_HCP5_CANFD01_c982c041_Rx
      OBDC_SSN_BJB_Req_XIX_HCP5_CANFD01_537affe6_Rx (CanIfRxPduCfg):
        CanIfRxPduCanId = 402419920
        CanIfRxPduCanIdType = EXTENDED_FD_CAN
        CanIfRxPduDlc = 8
        CanIfRxPduUserRxIndicationName = PduR_CanIfRxIndication
        CanIfRxPduUserRxIndicationType = PDUID_PDUINFOPTR
        CanIfRxPduUserRxIndicationUL = PDUR
        CanIfRxPduId = 69
        CanIfRxPduReadData = false
        CanIfRxPduReadNotifyStatus = false
        CanIfRxPduDlcCheck = true
        CanIfRxPduHrhIdRef = CN_HCP5_CANFD01_f532029f_Rx
        CanIfRxPduRef = OBDC_SSN_BJB_Req_XIX_HCP5_CANFD01_87b9d88e_Rx
      BMC_CMC_Zellspannung_04_XIX_HCP5_CANFD01_6f440660_Tx (CanIfTxPduCfg):
        CanIfTxPduCanId = 441800239
        CanIfTxPduCanIdType = EXTENDED_FD_CAN
        CanIfTxPduDlc = 64
        CanIfTxPduUserTxConfirmationName = PduR_CanIfTxConfirmation
        CanIfTxPduUserTxConfirmationUL = PDUR
        CanIfTxPduId = 34
        CanIfTxPduReadNotifyStatus = false
        CanIfTxPduType = STATIC
        CanIfTxPduTruncation = true
        CanIfTxPduBufferRef = CHNL_b74a53a7
        CanIfTxPduRef = BMC_CMC_Zellspannung_04_XIX_HCP5_CANFD01_9eddac84_Tx
      DCDC_NV_Komponentenfehler_04_XIX_HCP5_CANFD01_1d5412f4_Rx (CanIfRxPduCfg):
        CanIfRxPduCanId = 441800371
        CanIfRxPduCanIdType = EXTENDED_FD_CAN
        CanIfRxPduDlc = 8
        CanIfRxPduUserRxIndicationName = PduR_CanIfRxIndication
        CanIfRxPduUserRxIndicationUL = PDUR
        CanIfRxPduId = 49
        CanIfRxPduReadData = false
        CanIfRxPduReadNotifyStatus = false
        CanIfRxPduDlcCheck = true
        CanIfRxPduHrhIdRef = CN_HCP5_CANFD01_f532029f_Rx
        CanIfRxPduRef = DCDC_NV_Komponentenfehler_04_XIX_HCP5_CANFD01_54dfe7dc_Rx
      DCDC_NV_Komponentenfehler_02_XIX_HCP5_CANFD01_1dc77f5e_Rx (CanIfRxPduCfg):
        CanIfRxPduCanId = 441800369
        CanIfRxPduCanIdType = EXTENDED_FD_CAN
        CanIfRxPduDlc = 8
        CanIfRxPduUserRxIndicationName = PduR_CanIfRxIndication
        CanIfRxPduUserRxIndicationUL = PDUR
        CanIfRxPduId = 51
        CanIfRxPduReadData = false
        CanIfRxPduReadNotifyStatus = false
        CanIfRxPduDlcCheck = true
        CanIfRxPduHrhIdRef = CN_HCP5_CANFD01_f532029f_Rx
        CanIfRxPduRef = DCDC_NV_Komponentenfehler_02_XIX_HCP5_CANFD01_01a686cc_Rx
      ISO_Funktionaler_Req_All_XIX_BMC_CAN01_b97cd406_Tx (CanIfTxPduCfg):
        CanIfTxPduCanId = 1792
        CanIfTxPduCanIdType = STANDARD_CAN
        CanIfTxPduDlc = 8
        CanIfTxPduUserTxConfirmationName = NULL_PTR
        CanIfTxPduUserTxConfirmationUL = NONE
        CanIfTxPduId = 0
        CanIfTxPduReadNotifyStatus = false
        CanIfTxPduType = STATIC
        CanIfTxPduTruncation = true
        CanIfTxPduBufferRef = CHNL_eb535f7d
        CanIfTxPduRef = ISO_Funktionaler_Req_All_XIX_BMC_CAN01_aaf5996b_Tx
      DEV_Hybrid_01_Req_00_XIX_HCP5_CANFD01_eff55ffe_Rx (CanIfRxPduCfg):
        CanIfRxPduCanId = 469525248
        CanIfRxPduCanIdType = EXTENDED_FD_CAN
        CanIfRxPduDlc = 64
        CanIfRxPduUserRxIndicationName = PduR_CanIfRxIndication
        CanIfRxPduUserRxIndicationUL = PDUR
        CanIfRxPduId = 45
        CanIfRxPduReadData = false
        CanIfRxPduReadNotifyStatus = false
        CanIfRxPduDlcCheck = true
        CanIfRxPduHrhIdRef = CN_HCP5_CANFD01_f532029f_Rx
        CanIfRxPduRef = DEV_Hybrid_01_Req_00_XIX_HCP5_CANFD01_91241766_Rx
      UI1_01_XIX_BMC_CAN01_E2E_a06471fb_Rx (CanIfRxPduCfg):
        CanIfRxPduCanId = 752
        CanIfRxPduCanIdType = STANDARD_NO_FD_CAN
        CanIfRxPduDlc = 8
        CanIfRxPduUserRxIndicationName = PduR_CanIfRxIndication
        CanIfRxPduUserRxIndicationUL = PDUR
        CanIfRxPduId = 35
        CanIfRxPduReadData = false
        CanIfRxPduReadNotifyStatus = false
        CanIfRxPduDlcCheck = true
        CanIfRxPduHrhIdRef = CN_BMC_CAN01_d4211d16_Rx
        CanIfRxPduRef = UI1_01_XIX_BMC_CAN01_E2E_e77bac14_Rx
      DIA_BJB_Req_XIX_BMC_CAN01_4f76a5c7_Tx (CanIfTxPduCfg):
        CanIfTxPduCanId = 402396880
        CanIfTxPduCanIdType = EXTENDED_CAN
        CanIfTxPduDlc = 8
        CanIfTxPduUserTxConfirmationName = NULL_PTR
        CanIfTxPduUserTxConfirmationUL = NONE
        CanIfTxPduId = 17
        CanIfTxPduReadNotifyStatus = false
        CanIfTxPduType = STATIC
        CanIfTxPduTruncation = true
        CanIfTxPduBufferRef = CHNL_eb535f7d
        CanIfTxPduRef = DIA_BJB_Req_XIX_BMC_CAN01_6c84b0d8_Tx
      VDSO_05_XIX_HCP5_CANFD01_8df4a50a_Rx (CanIfRxPduCfg):
        CanIfRxPduCanId = 92
        CanIfRxPduCanIdType = STANDARD_FD_CAN
        CanIfRxPduDlc = 8
        CanIfRxPduUserRxIndicationName = PduR_CanIfRxIndication
        CanIfRxPduUserRxIndicationUL = PDUR
        CanIfRxPduId = 94
        CanIfRxPduReadData = false
        CanIfRxPduReadNotifyStatus = false
        CanIfRxPduDlcCheck = true
        CanIfRxPduHrhIdRef = CN_HCP5_CANFD01_c0785467_Rx
        CanIfRxPduRef = VDSO_05_XIX_HCP5_CANFD01_f45d20ad_Rx
      4 x CanIfTxPduCfg, all with CanIfTxPduCanIdType=EXTENDED_FD_CAN, CanIfTxPduUserTxConfirmationName=PduR_CanIfTxConfirmation, CanIfTxPduUserTxConfirmationUL=PDUR, CanIfTxPduReadNotifyStatus=false, CanIfTxPduType=STATIC, CanIfTxPduTruncation=true, CanIfTxPduBufferRef=CHNL_b74a53a7:
        DEV_Hybrid_01_Resp_FF_XIX_HCP5_CANFD01_7c961ae1_Tx: CanIfTxPduCanId=469525503, CanIfTxPduDlc=64, CanIfTxPduId=29, CanIfTxPduRef=DEV_Hybrid_01_Resp_FF_XIX_HCP5_CANFD01_3aa35b5c_Tx
        SOK_Zeit_Hybrid_01_Chal_01_XIX_HCP5_CANFD01_da12ec29_Tx: CanIfTxPduCanId=316670075, CanIfTxPduDlc=8, CanIfTxPduId=60, CanIfTxPduRef=SOK_Zeit_Hybrid_01_Chal_01_XIX_HCP5_CANFD01_441f0aae_Tx
        BMC_HV_07_SOK_XIX_HCP5_CANFD01_4db4bab2_Tx: CanIfTxPduCanId=380196146, CanIfTxPduDlc=12, CanIfTxPduId=58, CanIfTxPduRef=BMC_HV_07_SOK_XIX_HCP5_CANFD01_f0d71bf2_Tx
        BMC_HV_08_SOK_XIX_HCP5_CANFD01_cbd70a44_Tx: CanIfTxPduCanId=441800241, CanIfTxPduDlc=48, CanIfTxPduId=32, CanIfTxPduRef=BMC_HV_08_SOK_XIX_HCP5_CANFD01_ac3f778d_Tx
      BJB_CALID_02_XIX_BMC_CAN01_ab0d4070_Rx (CanIfRxPduCfg):
        CanIfRxPduCanId = 441799938
        CanIfRxPduCanIdType = EXTENDED_NO_FD_CAN
        CanIfRxPduDlc = 8
        CanIfRxPduUserRxIndicationName = PduR_CanIfRxIndication
        CanIfRxPduUserRxIndicationUL = PDUR
        CanIfRxPduId = 6
        CanIfRxPduReadData = false
        CanIfRxPduReadNotifyStatus = false
        CanIfRxPduDlcCheck = true
        CanIfRxPduHrhIdRef = CN_BMC_CAN01_e16b4bee_Rx
        CanIfRxPduRef = BJB_CALID_02_XIX_BMC_CAN01_e45a93f7_Rx
      BMC_HV_05_XIX_HCP5_CANFD01_ecda9e3f_Tx (CanIfTxPduCfg):
        CanIfTxPduCanId = 603
        CanIfTxPduCanIdType = STANDARD_FD_CAN
        CanIfTxPduDlc = 8
        CanIfTxPduUserTxConfirmationName = PduR_CanIfTxConfirmation
        CanIfTxPduUserTxConfirmationUL = PDUR
        CanIfTxPduId = 64
        CanIfTxPduReadNotifyStatus = false
        CanIfTxPduType = STATIC
        CanIfTxPduTruncation = true
        CanIfTxPduBufferRef = CHNL_b74a53a7
        CanIfTxPduRef = BMC_HV_05_XIX_HCP5_CANFD01_0d4b7040_Tx
      ZeitMaster_01_XIX_HCP5_CANFD01_505b3779_Rx (CanIfRxPduCfg):
        CanIfRxPduCanId = 441800119
        CanIfRxPduCanIdType = EXTENDED_FD_CAN
        CanIfRxPduDlc = 8
        CanIfRxPduUserRxIndicationName = PduR_CanIfRxIndication
        CanIfRxPduUserRxIndicationUL = PDUR
        CanIfRxPduId = 55
        CanIfRxPduReadData = false
        CanIfRxPduReadNotifyStatus = false
        CanIfRxPduDlcCheck = true
        CanIfRxPduHrhIdRef = CN_HCP5_CANFD01_f532029f_Rx
        CanIfRxPduRef = ZeitMaster_01_XIX_HCP5_CANFD01_16302e51_Rx
      OBDC_SSN_UI2Sens02_Req_XIX_BMC_CAN01_f554d12a_Tx (CanIfTxPduCfg):
        CanIfTxPduCanId = 402420146
        CanIfTxPduCanIdType = EXTENDED_CAN
        CanIfTxPduDlc = 8
        CanIfTxPduUserTxConfirmationName = NULL_PTR
        CanIfTxPduUserTxConfirmationUL = NONE
        CanIfTxPduId = 12
        CanIfTxPduReadNotifyStatus = false
        CanIfTxPduType = STATIC
        CanIfTxPduTruncation = true
        CanIfTxPduBufferRef = CHNL_eb535f7d
        CanIfTxPduRef = OBDC_SSN_UI2Sens02_Req_XIX_BMC_CAN01_7f5a32ec_Tx
      Systeminfo_01_XIX_BMC_CAN01_ced9742b_Tx (CanIfTxPduCfg):
        CanIfTxPduCanId = 1413
        CanIfTxPduCanIdType = STANDARD_CAN
        CanIfTxPduDlc = 8
        CanIfTxPduUserTxConfirmationName = NULL_PTR
        CanIfTxPduUserTxConfirmationUL = NONE
        CanIfTxPduId = 23
        CanIfTxPduReadNotifyStatus = false
        CanIfTxPduType = STATIC
        CanIfTxPduTruncation = true
        CanIfTxPduBufferRef = CHNL_eb535f7d
        CanIfTxPduRef = Systeminfo_01_XIX_BMC_CAN01_e1870ca9_Tx
      CDD_XCP_BJB_CRO_01_XIX_HCP5_CANFD01_3d029e5f_Rx (CanIfRxPduCfg):
        CanIfRxPduCanId = 419221504
        CanIfRxPduCanIdType = EXTENDED_FD_CAN
        CanIfRxPduDlc = 8
        CanIfRxPduUserRxIndicationUL = NONE
        CanIfRxPduId = 63
        CanIfRxPduReadData = false
        CanIfRxPduReadNotifyStatus = false
        CanIfRxPduUserRxIndicationName = NULL_PTR
        CanIfRxPduDlcCheck = true
        CanIfRxPduHrhIdRef = CN_HCP5_CANFD01_f532029f_Rx
        CanIfRxPduRef = CDD_XCP_BJB_CRO_01_XIX_HCP5_CANFD01_a8ba0d4f_Rx
      DCDC_NV_Komponentenfehler_01_XIX_HCP5_CANFD01_1d8ec98b_Rx (CanIfRxPduCfg):
        CanIfRxPduCanId = 441800368
        CanIfRxPduCanIdType = EXTENDED_FD_CAN
        CanIfRxPduDlc = 8
        CanIfRxPduUserRxIndicationName = PduR_CanIfRxIndication
        CanIfRxPduUserRxIndicationUL = PDUR
        CanIfRxPduId = 52
        CanIfRxPduReadData = false
        CanIfRxPduReadNotifyStatus = false
        CanIfRxPduDlcCheck = true
        CanIfRxPduHrhIdRef = CN_HCP5_CANFD01_f532029f_Rx
        CanIfRxPduRef = DCDC_NV_Komponentenfehler_01_XIX_HCP5_CANFD01_2b1a3644_Rx
      BMC_HV_02_E2E_SOK_XIX_HCP5_CANFD01_4edfb6c5_Tx (CanIfTxPduCfg):
        CanIfTxPduCanId = 316495124
        CanIfTxPduCanIdType = EXTENDED_FD_CAN
        CanIfTxPduDlc = 48
        CanIfTxPduUserTxConfirmationName = PduR_CanIfTxConfirmation
        CanIfTxPduUserTxConfirmationUL = PDUR
        CanIfTxPduId = 63
        CanIfTxPduReadNotifyStatus = false
        CanIfTxPduType = STATIC
        CanIfTxPduTruncation = true
        CanIfTxPduBufferRef = CHNL_b74a53a7
        CanIfTxPduRef = BMC_HV_02_E2E_SOK_XIX_HCP5_CANFD01_4f75cc0d_Tx
      Diagnose_01_XIX_HCP5_CANFD01_5c244c6c_Rx (CanIfRxPduCfg):
        CanIfRxPduCanId = 1714
        CanIfRxPduCanIdType = STANDARD_FD_CAN
        CanIfRxPduDlc = 8
        CanIfRxPduUserRxIndicationName = PduR_CanIfRxIndication
        CanIfRxPduUserRxIndicationUL = PDUR
        CanIfRxPduId = 46
        CanIfRxPduReadData = false
        CanIfRxPduReadNotifyStatus = false
        CanIfRxPduDlcCheck = true
        CanIfRxPduHrhIdRef = CN_HCP5_CANFD01_c0785467_Rx
        CanIfRxPduRef = Diagnose_01_XIX_HCP5_CANFD01_95a294dc_Rx
      HVLM_14_XIX_HCP5_CANFD01_E2E_41f6788c_Rx (CanIfRxPduCfg):
        CanIfRxPduCanId = 626
        CanIfRxPduCanIdType = STANDARD_FD_CAN
        CanIfRxPduDlc = 8
        CanIfRxPduUserRxIndicationName = PduR_CanIfRxIndication
        CanIfRxPduUserRxIndicationUL = PDUR
        CanIfRxPduId = 89
        CanIfRxPduReadData = false
        CanIfRxPduReadNotifyStatus = false
        CanIfRxPduDlcCheck = true
        CanIfRxPduHrhIdRef = CN_HCP5_CANFD01_c0785467_Rx
        CanIfRxPduRef = HVLM_14_XIX_HCP5_CANFD01_E2E_2623685a_Rx
      CDD_DEV_BJB_Req_01_XIX_BMC_CAN01_3aafbc32_Tx (CanIfTxPduCfg):
        CanIfTxPduCanId = 419352576
        CanIfTxPduCanIdType = EXTENDED_CAN
        CanIfTxPduDlc = 8
        CanIfTxPduUserTxConfirmationUL = NONE
        CanIfTxPduId = 8
        CanIfTxPduReadNotifyStatus = false
        CanIfTxPduType = STATIC
        CanIfTxPduTruncation = true
        CanIfTxPduUserTxConfirmationName = NULL_PTR
        CanIfTxPduBufferRef = CHNL_eb535f7d
        CanIfTxPduRef = CDD_DEV_BJB_Req_01_XIX_BMC_CAN01_3719e18f_Tx
      UI1_Komponentenfehler_02_XIX_BMC_CAN01_2191a967_Rx (CanIfRxPduCfg):
        CanIfRxPduCanId = 316495135
        CanIfRxPduCanIdType = EXTENDED_NO_FD_CAN
        CanIfRxPduDlc = 8
        CanIfRxPduUserRxIndicationName = PduR_CanIfRxIndication
        CanIfRxPduUserRxIndicationUL = PDUR
        CanIfRxPduId = 25
        CanIfRxPduReadData = false
        CanIfRxPduReadNotifyStatus = false
        CanIfRxPduDlcCheck = true
        CanIfRxPduHrhIdRef = CN_BMC_CAN01_e16b4bee_Rx
        CanIfRxPduRef = UI1_Komponentenfehler_02_XIX_BMC_CAN01_668bd879_Rx
      3 x CanIfTxPduCfg, all with CanIfTxPduReadNotifyStatus=false, CanIfTxPduType=STATIC, CanIfTxPduTruncation=true:
        CDD_XCP_BJB_DTO_01_XIX_HCP5_CANFD01_d6e0c0ba_Tx: CanIfTxPduCanId=419221505, CanIfTxPduCanIdType=EXTENDED_FD_CAN, CanIfTxPduDlc=8, CanIfTxPduUserTxConfirmationUL=NONE, CanIfTxPduId=45, CanIfTxPduUserTxConfirmationName=NULL_PTR, CanIfTxPduBufferRef=CHNL_b74a53a7, CanIfTxPduRef=CDD_XCP_BJB_DTO_01_XIX_HCP5_CANFD01_884a4965_Tx
        BMC_HV_09_SOK_XIX_HCP5_CANFD01_bf5e8eeb_Tx: CanIfTxPduCanId=316495251, CanIfTxPduCanIdType=EXTENDED_FD_CAN, CanIfTxPduDlc=20, CanIfTxPduUserTxConfirmationName=PduR_CanIfTxConfirmation, CanIfTxPduUserTxConfirmationUL=PDUR, CanIfTxPduId=62, CanIfTxPduBufferRef=CHNL_b74a53a7, CanIfTxPduRef=BMC_HV_09_SOK_XIX_HCP5_CANFD01_86174fef_Tx
        ClampControl_01_XIX_BMC_CAN01_cd1b5cf5_Tx: CanIfTxPduCanId=316495102, CanIfTxPduCanIdType=EXTENDED_CAN, CanIfTxPduDlc=8, CanIfTxPduUserTxConfirmationName=NULL_PTR, CanIfTxPduUserTxConfirmationUL=NONE, CanIfTxPduId=24, CanIfTxPduBufferRef=CHNL_eb535f7d, CanIfTxPduRef=ClampControl_01_XIX_BMC_CAN01_6c74ee25_Tx
      DIA_BJB_Resp_XIX_BMC_CAN01_0b8fd74e_Rx (CanIfRxPduCfg):
        CanIfRxPduCanId = 402527952
        CanIfRxPduCanIdType = EXTENDED_NO_FD_CAN
        CanIfRxPduDlc = 8
        CanIfRxPduUserRxIndicationName = PduR_CanIfRxIndication
        CanIfRxPduUserRxIndicationType = PDUID_PDUINFOPTR
        CanIfRxPduUserRxIndicationUL = PDUR
        CanIfRxPduId = 21
        CanIfRxPduReadData = false
        CanIfRxPduReadNotifyStatus = false
        CanIfRxPduDlcCheck = true
        CanIfRxPduHrhIdRef = CN_BMC_CAN01_e16b4bee_Rx
        CanIfRxPduRef = DIA_BJB_Resp_XIX_BMC_CAN01_c04d7636_Rx
      CDD_DEV_BJB_Resp_FF_XIX_HCP5_CANFD01_398cd71c_Tx (CanIfTxPduCfg):
        CanIfTxPduCanId = 419352831
        CanIfTxPduCanIdType = EXTENDED_FD_CAN
        CanIfTxPduDlc = 8
        CanIfTxPduUserTxConfirmationUL = NONE
        CanIfTxPduId = 44
        CanIfTxPduReadNotifyStatus = false
        CanIfTxPduType = STATIC
        CanIfTxPduTruncation = true
        CanIfTxPduUserTxConfirmationName = NULL_PTR
        CanIfTxPduBufferRef = CHNL_b74a53a7
        CanIfTxPduRef = CDD_DEV_BJB_Resp_FF_XIX_HCP5_CANFD01_77e6d841_Tx
      BMC_HV_14_SOK_XIX_HCP5_CANFD01_963300be_Tx (CanIfTxPduCfg):
        CanIfTxPduCanId = 316495300
        CanIfTxPduCanIdType = EXTENDED_FD_CAN
        CanIfTxPduDlc = 16
        CanIfTxPduUserTxConfirmationName = PduR_CanIfTxConfirmation
        CanIfTxPduUserTxConfirmationUL = PDUR
        CanIfTxPduId = 61
        CanIfTxPduReadNotifyStatus = false
        CanIfTxPduType = STATIC
        CanIfTxPduTruncation = true
        CanIfTxPduBufferRef = CHNL_b74a53a7
        CanIfTxPduRef = BMC_HV_14_SOK_XIX_HCP5_CANFD01_2d397b18_Tx
      7 x CanIfRxPduCfg, all with CanIfRxPduUserRxIndicationName=PduR_CanIfRxIndication, CanIfRxPduUserRxIndicationUL=PDUR, CanIfRxPduReadData=false, CanIfRxPduReadNotifyStatus=false, CanIfRxPduDlcCheck=true:
        SOK_Zeit_Hybrid_01_Resp_01_SOK_XIX_HCP5_CANFD01_dd7a6d66_Rx: CanIfRxPduCanId=316801147, CanIfRxPduCanIdType=EXTENDED_FD_CAN, CanIfRxPduDlc=16, CanIfRxPduId=83, CanIfRxPduHrhIdRef=CN_HCP5_CANFD01_f532029f_Rx, CanIfRxPduRef=SOK_Zeit_Hybrid_01_Resp_01_SOK_XIX_HCP5_CANFD01_7ac24361_Rx
        UI2_03_XIX_BMC_CAN01_E2E_87d1ebc2_Rx: CanIfRxPduCanId=757, CanIfRxPduCanIdType=STANDARD_NO_FD_CAN, CanIfRxPduDlc=8, CanIfRxPduId=30, CanIfRxPduHrhIdRef=CN_BMC_CAN01_d4211d16_Rx, CanIfRxPduRef=UI2_03_XIX_BMC_CAN01_E2E_c452e633_Rx
        OBG_01_XIX_HCP5_CANFD01_83b149e5_Rx: CanIfRxPduCanId=316495128, CanIfRxPduCanIdType=EXTENDED_FD_CAN, CanIfRxPduDlc=60, CanIfRxPduId=84, CanIfRxPduHrhIdRef=CN_HCP5_CANFD01_f532029f_Rx, CanIfRxPduRef=OBG_01_XIX_HCP5_CANFD01_6af9c66f_Rx
        Charisma_20_XIX_HCP5_CANFD01_11748999_Rx: CanIfRxPduCanId=441800045, CanIfRxPduCanIdType=EXTENDED_FD_CAN, CanIfRxPduDlc=20, CanIfRxPduId=58, CanIfRxPduHrhIdRef=CN_HCP5_CANFD01_f532029f_Rx, CanIfRxPduRef=Charisma_20_XIX_HCP5_CANFD01_be5e5e8a_Rx
        HVLM_13_XIX_HCP5_CANFD01_6bfc3f19_Rx: CanIfRxPduCanId=625, CanIfRxPduCanIdType=STANDARD_FD_CAN, CanIfRxPduDlc=32, CanIfRxPduId=90, CanIfRxPduHrhIdRef=CN_HCP5_CANFD01_c0785467_Rx, CanIfRxPduRef=HVLM_13_XIX_HCP5_CANFD01_f34a06e4_Rx
        SOK_NoAuthenticTime_01_XIX_HCP5_CANFD01_258b3943_Rx: CanIfRxPduCanId=441800108, CanIfRxPduCanIdType=EXTENDED_FD_CAN, CanIfRxPduDlc=8, CanIfRxPduId=56, CanIfRxPduHrhIdRef=CN_HCP5_CANFD01_f532029f_Rx, CanIfRxPduRef=SOK_NoAuthenticTime_01_XIX_HCP5_CANFD01_8db7a3c2_Rx
        ORU_Control_D_01_XIX_HCP5_CANFD01_E2E_70882d8f_Rx: CanIfRxPduCanId=380196245, CanIfRxPduCanIdType=EXTENDED_FD_CAN, CanIfRxPduDlc=8, CanIfRxPduId=78, CanIfRxPduHrhIdRef=CN_HCP5_CANFD01_f532029f_Rx, CanIfRxPduRef=ORU_Control_D_01_XIX_HCP5_CANFD01_E2E_9ed03939_Rx
      BMC_CMC_Temperatur_03_XIX_HCP5_CANFD01_07f5f662_Tx (CanIfTxPduCfg):
        CanIfTxPduCanId = 441800300
        CanIfTxPduCanIdType = EXTENDED_FD_CAN
        CanIfTxPduDlc = 64
        CanIfTxPduUserTxConfirmationName = PduR_CanIfTxConfirmation
        CanIfTxPduUserTxConfirmationUL = PDUR
        CanIfTxPduId = 31
        CanIfTxPduReadNotifyStatus = false
        CanIfTxPduType = STATIC
        CanIfTxPduTruncation = true
        CanIfTxPduBufferRef = CHNL_b74a53a7
        CanIfTxPduRef = BMC_CMC_Temperatur_03_XIX_HCP5_CANFD01_8a36edf1_Tx
      WFS_02_XIX_HCP5_CANFD01_bbb255a9_Rx (CanIfRxPduCfg):
        CanIfRxPduCanId = 441799750
        CanIfRxPduCanIdType = EXTENDED_FD_CAN
        CanIfRxPduDlc = 28
        CanIfRxPduUserRxIndicationName = PduR_CanIfRxIndication
        CanIfRxPduUserRxIndicationUL = PDUR
        CanIfRxPduId = 61
        CanIfRxPduReadData = false
        CanIfRxPduReadNotifyStatus = false
        CanIfRxPduDlcCheck = true
        CanIfRxPduHrhIdRef = CN_HCP5_CANFD01_f532029f_Rx
        CanIfRxPduRef = WFS_02_XIX_HCP5_CANFD01_a0e8c21d_Rx
      KS_Hybrid_01_Response_K_XIX_HCP5_CANFD01_14ad159d_Tx (CanIfTxPduCfg):
        CanIfTxPduCanId = 441800153
        CanIfTxPduCanIdType = EXTENDED_FD_CAN
        CanIfTxPduDlc = 12
        CanIfTxPduUserTxConfirmationName = PduR_CanIfTxConfirmation
        CanIfTxPduUserTxConfirmationUL = PDUR
        CanIfTxPduId = 40
        CanIfTxPduReadNotifyStatus = false
        CanIfTxPduType = STATIC
        CanIfTxPduTruncation = true
        CanIfTxPduBufferRef = CHNL_b74a53a7
        CanIfTxPduRef = KS_Hybrid_01_Response_K_XIX_HCP5_CANFD01_4e4d208b_Tx
      DAAP_Hybrid_01_Resp_FD_XIX_HCP5_CANFD01_c0d93a5e_Tx (CanIfTxPduCfg):
        CanIfTxPduCanId = 474103675
        CanIfTxPduCanIdType = EXTENDED_FD_CAN
        CanIfTxPduDlc = 64
        CanIfTxPduUserTxConfirmationName = CanTp_TxConfirmation
        CanIfTxPduUserTxConfirmationUL = CAN_TP
        CanIfTxPduId = 25
        CanIfTxPduReadNotifyStatus = false
        CanIfTxPduType = STATIC
        CanIfTxPduTruncation = true
        CanIfTxPduBufferRef = CHNL_b74a53a7
        CanIfTxPduRef = DAAP_Hybrid_01_Resp_FD_XIX_HCP5_CANFD01_a869e288_Tx
      UI2_04_XIX_BMC_CAN01_e572df1e_Rx (CanIfRxPduCfg):
        CanIfRxPduCanId = 316494942
        CanIfRxPduCanIdType = EXTENDED_NO_FD_CAN
        CanIfRxPduDlc = 8
        CanIfRxPduUserRxIndicationName = PduR_CanIfRxIndication
        CanIfRxPduUserRxIndicationUL = PDUR
        CanIfRxPduId = 27
        CanIfRxPduReadData = false
        CanIfRxPduReadNotifyStatus = false
        CanIfRxPduDlcCheck = true
        CanIfRxPduHrhIdRef = CN_BMC_CAN01_e16b4bee_Rx
        CanIfRxPduRef = UI2_04_XIX_BMC_CAN01_af5334f2_Rx
      ELF_06_XIX_HCP5_CANFD01_e1ab79c8_Rx (CanIfRxPduCfg):
        CanIfRxPduCanId = 380196274
        CanIfRxPduCanIdType = EXTENDED_FD_CAN
        CanIfRxPduDlc = 8
        CanIfRxPduUserRxIndicationName = PduR_CanIfRxIndication
        CanIfRxPduUserRxIndicationUL = PDUR
        CanIfRxPduId = 75
        CanIfRxPduReadData = false
        CanIfRxPduReadNotifyStatus = false
        CanIfRxPduDlcCheck = true
        CanIfRxPduHrhIdRef = CN_HCP5_CANFD01_f532029f_Rx
        CanIfRxPduRef = ELF_06_XIX_HCP5_CANFD01_21ac90a0_Rx
      3 x CanIfTxPduCfg, all with CanIfTxPduUserTxConfirmationName=PduR_CanIfTxConfirmation, CanIfTxPduUserTxConfirmationUL=PDUR, CanIfTxPduReadNotifyStatus=false, CanIfTxPduType=STATIC, CanIfTxPduTruncation=true, CanIfTxPduBufferRef=CHNL_b74a53a7:
        BMC_HV_01_E2E_SOK_XIX_HCP5_CANFD01_e2d584a8_Tx: CanIfTxPduCanId=275, CanIfTxPduCanIdType=STANDARD_FD_CAN, CanIfTxPduDlc=20, CanIfTxPduId=65, CanIfTxPduRef=BMC_HV_01_E2E_SOK_XIX_HCP5_CANFD01_09a7f969_Tx
        BMC_CMC_Temperatur_02_XIX_HCP5_CANFD01_2994fe9f_Tx: CanIfTxPduCanId=441800235, CanIfTxPduCanIdType=EXTENDED_FD_CAN, CanIfTxPduDlc=24, CanIfTxPduId=38, CanIfTxPduRef=BMC_CMC_Temperatur_02_XIX_HCP5_CANFD01_25727fb6_Tx
        BMC_CMC_Zellspannung_01_XIX_HCP5_CANFD01_649be5e8_Tx: CanIfTxPduCanId=441800236, CanIfTxPduCanIdType=EXTENDED_FD_CAN, CanIfTxPduDlc=64, CanIfTxPduId=37, CanIfTxPduRef=BMC_CMC_Zellspannung_01_XIX_HCP5_CANFD01_e1187d1c_Tx
      5 x CanIfRxPduCfg, all with CanIfRxPduUserRxIndicationName=PduR_CanIfRxIndication, CanIfRxPduUserRxIndicationUL=PDUR, CanIfRxPduReadData=false, CanIfRxPduReadNotifyStatus=false, CanIfRxPduDlcCheck=true:
        OBDC_SSN_UI2Sens02_Req_XIX_HCP5_CANFD01_359d756d_Rx: CanIfRxPduCanId=402420146, CanIfRxPduCanIdType=EXTENDED_FD_CAN, CanIfRxPduDlc=8, CanIfRxPduUserRxIndicationType=PDUID_PDUINFOPTR, CanIfRxPduId=67, CanIfRxPduHrhIdRef=CN_HCP5_CANFD01_f532029f_Rx, CanIfRxPduRef=OBDC_SSN_UI2Sens02_Req_XIX_HCP5_CANFD01_7e9f9397_Rx
        NVEM_12_XIX_HCP5_CANFD01_47eee303_Rx: CanIfRxPduCanId=567, CanIfRxPduCanIdType=STANDARD_FD_CAN, CanIfRxPduDlc=12, CanIfRxPduId=91, CanIfRxPduHrhIdRef=CN_HCP5_CANFD01_c0785467_Rx, CanIfRxPduRef=NVEM_12_XIX_HCP5_CANFD01_27d236bb_Rx
        UI2Sens02_CALID_01_XIX_BMC_CAN01_9d62397c_Rx: CanIfRxPduCanId=441799880, CanIfRxPduCanIdType=EXTENDED_NO_FD_CAN, CanIfRxPduDlc=8, CanIfRxPduId=11, CanIfRxPduHrhIdRef=CN_BMC_CAN01_e16b4bee_Rx, CanIfRxPduRef=UI2Sens02_CALID_01_XIX_BMC_CAN01_a812cab1_Rx
        UI1_Komponentenfehler_01_XIX_BMC_CAN01_f42bd274_Rx: CanIfRxPduCanId=316495134, CanIfRxPduCanIdType=EXTENDED_NO_FD_CAN, CanIfRxPduDlc=8, CanIfRxPduId=26, CanIfRxPduHrhIdRef=CN_BMC_CAN01_e16b4bee_Rx, CanIfRxPduRef=UI1_Komponentenfehler_01_XIX_BMC_CAN01_0b0d2b23_Rx
        BJB_11_XIX_BMC_CAN01_E2E_c1f189c1_Rx: CanIfRxPduCanId=441800493, CanIfRxPduCanIdType=EXTENDED_NO_FD_CAN, CanIfRxPduDlc=8, CanIfRxPduId=1, CanIfRxPduHrhIdRef=CN_BMC_CAN01_e16b4bee_Rx, CanIfRxPduRef=BJB_11_XIX_BMC_CAN01_E2E_893589f3_Rx
      ORU_01_XIX_BMC_CAN01_350b0f24_Tx (CanIfTxPduCfg):
        CanIfTxPduCanId = 441800008
        CanIfTxPduCanIdType = EXTENDED_CAN
        CanIfTxPduDlc = 8
        CanIfTxPduUserTxConfirmationName = NULL_PTR
        CanIfTxPduUserTxConfirmationUL = NONE
        CanIfTxPduId = 6
        CanIfTxPduReadNotifyStatus = false
        CanIfTxPduType = STATIC
        CanIfTxPduTruncation = true
        CanIfTxPduBufferRef = CHNL_eb535f7d
        CanIfTxPduRef = ORU_01_XIX_BMC_CAN01_4256635f_Tx
      ORU_Control_A_01_XIX_HCP5_CANFD01_E2E_3ce3caba_Rx (CanIfRxPduCfg):
        CanIfRxPduCanId = 441799804
        CanIfRxPduCanIdType = EXTENDED_FD_CAN
        CanIfRxPduDlc = 8
        CanIfRxPduUserRxIndicationName = PduR_CanIfRxIndication
        CanIfRxPduUserRxIndicationUL = PDUR
        CanIfRxPduId = 60
        CanIfRxPduReadData = false
        CanIfRxPduReadNotifyStatus = false
        CanIfRxPduDlcCheck = true
        CanIfRxPduHrhIdRef = CN_HCP5_CANFD01_f532029f_Rx
        CanIfRxPduRef = ORU_Control_A_01_XIX_HCP5_CANFD01_E2E_893c1989_Rx
      DIA_UI2Sens02_Req_XIX_BMC_CAN01_39198196_Tx (CanIfTxPduCfg):
        CanIfTxPduCanId = 402397106
        CanIfTxPduCanIdType = EXTENDED_CAN
        CanIfTxPduDlc = 8
        CanIfTxPduUserTxConfirmationName = NULL_PTR
        CanIfTxPduUserTxConfirmationUL = NONE
        CanIfTxPduId = 15
        CanIfTxPduReadNotifyStatus = false
        CanIfTxPduType = STATIC
        CanIfTxPduTruncation = true
        CanIfTxPduBufferRef = CHNL_eb535f7d
        CanIfTxPduRef = DIA_UI2Sens02_Req_XIX_BMC_CAN01_0a5a0c3f_Tx
      CDD_XCP_BJB_DTO_01_XIX_BMC_CAN01_2b6433b5_Rx (CanIfRxPduCfg):
        CanIfRxPduCanId = 419221505
        CanIfRxPduCanIdType = EXTENDED_NO_FD_CAN
        CanIfRxPduDlc = 8
        CanIfRxPduUserRxIndicationUL = NONE
        CanIfRxPduId = 15
        CanIfRxPduReadData = false
        CanIfRxPduReadNotifyStatus = false
        CanIfRxPduUserRxIndicationName = NULL_PTR
        CanIfRxPduDlcCheck = true
        CanIfRxPduHrhIdRef = CN_BMC_CAN01_e16b4bee_Rx
        CanIfRxPduRef = CDD_XCP_BJB_DTO_01_XIX_BMC_CAN01_382ede28_Rx
      CHNL_b74a53a7 (CanIfBufferCfg):
        CanIfBufferSize = 41
        CanIfTxBufferHandlingType = PRIO_BY_CANID
        CanIfTxBufferMappedTxPdus = 41
        CanIfTxBufferMaxPduLength = 64
        CanIfBufferHthRef = CN_HCP5_CANFD01_54d90215_Tx
      OBD_03_XIX_BMC_CAN01_5578af9b_Tx (CanIfTxPduCfg):
        CanIfTxPduCanId = 380196140
        CanIfTxPduCanIdType = EXTENDED_CAN
        CanIfTxPduDlc = 8
        CanIfTxPduUserTxConfirmationName = NULL_PTR
        CanIfTxPduUserTxConfirmationUL = NONE
        CanIfTxPduId = 21
        CanIfTxPduReadNotifyStatus = false
        CanIfTxPduType = STATIC
        CanIfTxPduTruncation = true
        CanIfTxPduBufferRef = CHNL_eb535f7d
        CanIfTxPduRef = OBD_03_XIX_BMC_CAN01_5c2c79fc_Tx
      8 x CanIfRxPduCfg, all with CanIfRxPduReadData=false, CanIfRxPduReadNotifyStatus=false, CanIfRxPduDlcCheck=true:
        DIA_UI2Sens02_Resp_XIX_BMC_CAN01_3e7de423_Rx: CanIfRxPduCanId=402528178, CanIfRxPduCanIdType=EXTENDED_NO_FD_CAN, CanIfRxPduDlc=8, CanIfRxPduUserRxIndicationName=PduR_CanIfRxIndication, CanIfRxPduUserRxIndicationType=PDUID_PDUINFOPTR, CanIfRxPduUserRxIndicationUL=PDUR, CanIfRxPduId=19, CanIfRxPduHrhIdRef=CN_BMC_CAN01_e16b4bee_Rx, CanIfRxPduRef=DIA_UI2Sens02_Resp_XIX_BMC_CAN01_fe45df51_Rx
        BJB_CVN_01_XIX_BMC_CAN01_1fa2680a_Rx: CanIfRxPduCanId=441799939, CanIfRxPduCanIdType=EXTENDED_NO_FD_CAN, CanIfRxPduDlc=8, CanIfRxPduUserRxIndicationName=PduR_CanIfRxIndication, CanIfRxPduUserRxIndicationUL=PDUR, CanIfRxPduId=5, CanIfRxPduHrhIdRef=CN_BMC_CAN01_e16b4bee_Rx, CanIfRxPduRef=BJB_CVN_01_XIX_BMC_CAN01_4f7fa9e3_Rx
        UI2Sens01_CVN_XIX_BMC_CAN01_740a4da5_Rx: CanIfRxPduCanId=441799882, CanIfRxPduCanIdType=EXTENDED_NO_FD_CAN, CanIfRxPduDlc=8, CanIfRxPduUserRxIndicationName=PduR_CanIfRxIndication, CanIfRxPduUserRxIndicationUL=PDUR, CanIfRxPduId=9, CanIfRxPduHrhIdRef=CN_BMC_CAN01_e16b4bee_Rx, CanIfRxPduRef=UI2Sens01_CVN_XIX_BMC_CAN01_7910df29_Rx
        DAAP_Funkt_Req_MC_FD_XIX_HCP5_CANFD01_0f64870b_Rx: CanIfRxPduCanId=474038237, CanIfRxPduCanIdType=EXTENDED_FD_CAN, CanIfRxPduDlc=8, CanIfRxPduUserRxIndicationName=CanTp_RxIndication, CanIfRxPduUserRxIndicationType=PDUID_PDUINFOPTR, CanIfRxPduUserRxIndicationUL=CAN_TP, CanIfRxPduId=37, CanIfRxPduHrhIdRef=CN_HCP5_CANFD01_f532029f_Rx, CanIfRxPduRef=DAAP_Funkt_Req_MC_FD_XIX_HCP5_CANFD01_dbe988f8_Rx
        HVEM_07_XIX_HCP5_CANFD01_3c9ed0ba_Rx: CanIfRxPduCanId=184112327, CanIfRxPduCanIdType=EXTENDED_FD_CAN, CanIfRxPduDlc=32, CanIfRxPduUserRxIndicationName=PduR_CanIfRxIndication, CanIfRxPduUserRxIndicationUL=PDUR, CanIfRxPduId=88, CanIfRxPduHrhIdRef=CN_HCP5_CANFD01_f532029f_Rx, CanIfRxPduRef=HVEM_07_XIX_HCP5_CANFD01_6bc428a9_Rx
        NmNode_BMC_HV_XIX_BMC_CAN01_a81f589c_Rx: CanIfRxPduCanIdType=EXTENDED_NO_FD_CAN, CanIfRxPduDlc=8, CanIfRxPduUserRxIndicationName=CanNm_RxIndication, CanIfRxPduUserRxIndicationUL=CAN_NM, CanIfRxPduId=0, CanIfRxPduHrhIdRef=CN_BMC_CAN01_e16b4bee_Rx, CanIfRxPduRef=NmNode_BMC_HV_XIX_BMC_CAN01_a39ed100_Rx
          CHNL_4b38bcce (CanIfRxPduCanIdRange): CanIfRxPduCanIdRangeLowerCanId=452984832, CanIfRxPduCanIdRangeUpperCanId=452985855
        OBDC_SSN_UI2Sens01_Resp_XIX_BMC_CAN01_33d311c0_Rx: CanIfRxPduCanId=402551217, CanIfRxPduCanIdType=EXTENDED_NO_FD_CAN, CanIfRxPduDlc=8, CanIfRxPduUserRxIndicationName=PduR_CanIfRxIndication, CanIfRxPduUserRxIndicationType=PDUID_PDUINFOPTR, CanIfRxPduUserRxIndicationUL=PDUR, CanIfRxPduId=17, CanIfRxPduHrhIdRef=CN_BMC_CAN01_e16b4bee_Rx, CanIfRxPduRef=OBDC_SSN_UI2Sens01_Resp_XIX_BMC_CAN01_327140fa_Rx
        UI1_05_XIX_BMC_CAN01_b5cd6b62_Rx: CanIfRxPduCanId=316494941, CanIfRxPduCanIdType=EXTENDED_NO_FD_CAN, CanIfRxPduDlc=8, CanIfRxPduUserRxIndicationName=PduR_CanIfRxIndication, CanIfRxPduUserRxIndicationUL=PDUR, CanIfRxPduId=28, CanIfRxPduHrhIdRef=CN_BMC_CAN01_e16b4bee_Rx, CanIfRxPduRef=UI1_05_XIX_BMC_CAN01_d1b05aa4_Rx
      DIA_UI2Sens02_Resp_XIX_HCP5_CANFD01_88436504_Tx (CanIfTxPduCfg):
        CanIfTxPduCanId = 402528178
        CanIfTxPduCanIdType = EXTENDED_FD_CAN
        CanIfTxPduDlc = 8
        CanIfTxPduUserTxConfirmationName = NULL_PTR
        CanIfTxPduUserTxConfirmationUL = NONE
        CanIfTxPduId = 51
        CanIfTxPduReadNotifyStatus = false
        CanIfTxPduType = STATIC
        CanIfTxPduTruncation = true
        CanIfTxPduBufferRef = CHNL_b74a53a7
        CanIfTxPduRef = DIA_UI2Sens02_Resp_XIX_HCP5_CANFD01_e002a62c_Tx
      CHNL_eb535f7d (CanIfBufferCfg):
        CanIfBufferSize = 25
        CanIfTxBufferHandlingType = PRIO_BY_CANID
        CanIfTxBufferMappedTxPdus = 25
        CanIfTxBufferMaxPduLength = 8
        CanIfBufferHthRef = CN_BMC_CAN01_78a85e89_Tx
      Systeminfo_01_XIX_HCP5_CANFD01_46cbe0b5_Rx (CanIfRxPduCfg):
        CanIfRxPduCanId = 1413
        CanIfRxPduCanIdType = STANDARD_FD_CAN
        CanIfRxPduDlc = 8
        CanIfRxPduUserRxIndicationName = PduR_CanIfRxIndication
        CanIfRxPduUserRxIndicationUL = PDUR
        CanIfRxPduId = 82
        CanIfRxPduReadData = false
        CanIfRxPduReadNotifyStatus = false
        CanIfRxPduDlcCheck = true
        CanIfRxPduHrhIdRef = CN_HCP5_CANFD01_c0785467_Rx
        CanIfRxPduRef = Systeminfo_01_XIX_HCP5_CANFD01_1ca8fa11_Rx
      DS_Hybrid_01_XIX_HCP5_CANFD01_fed380d4_Tx (CanIfTxPduCfg):
        CanIfTxPduCanId = 401342587
        CanIfTxPduCanIdType = EXTENDED_FD_CAN
        CanIfTxPduDlc = 8
        CanIfTxPduUserTxConfirmationName = PduR_CanIfTxConfirmation
        CanIfTxPduUserTxConfirmationUL = PDUR
        CanIfTxPduId = 56
        CanIfTxPduReadNotifyStatus = false
        CanIfTxPduType = STATIC
        CanIfTxPduTruncation = true
        CanIfTxPduBufferRef = CHNL_b74a53a7
        CanIfTxPduRef = DS_Hybrid_01_XIX_HCP5_CANFD01_ed9ff9e4_Tx
      UI2Sens02_CVN_XIX_BMC_CAN01_b7afa2a5_Rx (CanIfRxPduCfg):
        CanIfRxPduCanId = 441799883
        CanIfRxPduCanIdType = EXTENDED_NO_FD_CAN
        CanIfRxPduDlc = 8
        CanIfRxPduUserRxIndicationName = PduR_CanIfRxIndication
        CanIfRxPduUserRxIndicationUL = PDUR
        CanIfRxPduId = 8
        CanIfRxPduReadData = false
        CanIfRxPduReadNotifyStatus = false
        CanIfRxPduDlcCheck = true
        CanIfRxPduHrhIdRef = CN_BMC_CAN01_e16b4bee_Rx
        CanIfRxPduRef = UI2Sens02_CVN_XIX_BMC_CAN01_34f8df4e_Rx
      CDD_XCP_BJB_CRO_01_XIX_BMC_CAN01_da5ef3bc_Tx (CanIfTxPduCfg):
        CanIfTxPduCanId = 419221504
        CanIfTxPduCanIdType = EXTENDED_CAN
        CanIfTxPduDlc = 8
        CanIfTxPduUserTxConfirmationUL = NONE
        CanIfTxPduId = 9
        CanIfTxPduReadNotifyStatus = false
        CanIfTxPduType = STATIC
        CanIfTxPduTruncation = true
        CanIfTxPduUserTxConfirmationName = NULL_PTR
        CanIfTxPduBufferRef = CHNL_eb535f7d
        CanIfTxPduRef = CDD_XCP_BJB_CRO_01_XIX_BMC_CAN01_9130eaf8_Tx
      BJB_13_XIX_BMC_CAN01_E2E_d24e886f_Rx (CanIfRxPduCfg):
        CanIfRxPduCanId = 441800486
        CanIfRxPduCanIdType = EXTENDED_NO_FD_CAN
        CanIfRxPduDlc = 8
        CanIfRxPduUserRxIndicationName = PduR_CanIfRxIndication
        CanIfRxPduUserRxIndicationUL = PDUR
        CanIfRxPduId = 2
        CanIfRxPduReadData = false
        CanIfRxPduReadNotifyStatus = false
        CanIfRxPduDlcCheck = true
        CanIfRxPduHrhIdRef = CN_BMC_CAN01_e16b4bee_Rx
        CanIfRxPduRef = BJB_13_XIX_BMC_CAN01_E2E_49557476_Rx
      UI2_Komponentenfehler_01_XIX_BMC_CAN01_351ca71f_Rx (CanIfRxPduCfg):
        CanIfRxPduCanId = 316495136
        CanIfRxPduCanIdType = EXTENDED_NO_FD_CAN
        CanIfRxPduDlc = 8
        CanIfRxPduUserRxIndicationName = PduR_CanIfRxIndication
        CanIfRxPduUserRxIndicationUL = PDUR
        CanIfRxPduId = 24
        CanIfRxPduReadData = false
        CanIfRxPduReadNotifyStatus = false
        CanIfRxPduDlcCheck = true
        CanIfRxPduHrhIdRef = CN_BMC_CAN01_e16b4bee_Rx
        CanIfRxPduRef = UI2_Komponentenfehler_01_XIX_BMC_CAN01_6d09fe13_Rx
      DIA_UI2Sens01_Req_XIX_BMC_CAN01_34978bb8_Tx (CanIfTxPduCfg):
        CanIfTxPduCanId = 402397105
        CanIfTxPduCanIdType = EXTENDED_CAN
        CanIfTxPduDlc = 8
        CanIfTxPduUserTxConfirmationName = NULL_PTR
        CanIfTxPduUserTxConfirmationUL = NONE
        CanIfTxPduId = 16
        CanIfTxPduReadNotifyStatus = false
        CanIfTxPduType = STATIC
        CanIfTxPduTruncation = true
        CanIfTxPduBufferRef = CHNL_eb535f7d
        CanIfTxPduRef = DIA_UI2Sens01_Req_XIX_BMC_CAN01_47b20c58_Tx
      KS_Hybrid_01_Challenge_M_XIX_HCP5_CANFD01_61694a7e_Rx (CanIfRxPduCfg):
        CanIfRxPduCanId = 441800151
        CanIfRxPduCanIdType = EXTENDED_FD_CAN
        CanIfRxPduDlc = 12
        CanIfRxPduUserRxIndicationName = PduR_CanIfRxIndication
        CanIfRxPduUserRxIndicationUL = PDUR
        CanIfRxPduId = 54
        CanIfRxPduReadData = false
        CanIfRxPduReadNotifyStatus = false
        CanIfRxPduDlcCheck = true
        CanIfRxPduHrhIdRef = CN_HCP5_CANFD01_f532029f_Rx
        CanIfRxPduRef = KS_Hybrid_01_Challenge_M_XIX_HCP5_CANFD01_a71be84d_Rx
      OBD_Hybrid_01_SOK_XIX_HCP5_CANFD01_6bce45f5_Tx (CanIfTxPduCfg):
        CanIfTxPduCanId = 400818181
        CanIfTxPduCanIdType = EXTENDED_FD_CAN
        CanIfTxPduDlc = 6
        CanIfTxPduUserTxConfirmationName = PduR_CanIfTxConfirmation
        CanIfTxPduUserTxConfirmationUL = PDUR
        CanIfTxPduId = 57
        CanIfTxPduReadNotifyStatus = false
        CanIfTxPduType = STATIC
        CanIfTxPduTruncation = true
        CanIfTxPduBufferRef = CHNL_b74a53a7
        CanIfTxPduRef = OBD_Hybrid_01_SOK_XIX_HCP5_CANFD01_c373a414_Tx
      5 x CanIfRxPduCfg, all with CanIfRxPduUserRxIndicationName=PduR_CanIfRxIndication, CanIfRxPduUserRxIndicationUL=PDUR, CanIfRxPduReadData=false, CanIfRxPduReadNotifyStatus=false, CanIfRxPduDlcCheck=true:
        KS_Hybrid_01_Response_M_XIX_HCP5_CANFD01_af175552_Rx: CanIfRxPduCanId=441800154, CanIfRxPduCanIdType=EXTENDED_FD_CAN, CanIfRxPduDlc=12, CanIfRxPduId=53, CanIfRxPduHrhIdRef=CN_HCP5_CANFD01_f532029f_Rx, CanIfRxPduRef=KS_Hybrid_01_Response_M_XIX_HCP5_CANFD01_1b34419b_Rx
        UI1_03_XIX_BMC_CAN01_c99c20bf_Rx: CanIfRxPduCanId=754, CanIfRxPduCanIdType=STANDARD_NO_FD_CAN, CanIfRxPduDlc=8, CanIfRxPduId=33, CanIfRxPduHrhIdRef=CN_BMC_CAN01_d4211d16_Rx, CanIfRxPduRef=UI1_03_XIX_BMC_CAN01_0abdbc10_Rx
        ORU_01_XIX_HCP5_CANFD01_d9ecf2b6_Rx: CanIfRxPduCanId=441800008, CanIfRxPduCanIdType=EXTENDED_FD_CAN, CanIfRxPduDlc=8, CanIfRxPduId=59, CanIfRxPduHrhIdRef=CN_HCP5_CANFD01_f532029f_Rx, CanIfRxPduRef=ORU_01_XIX_HCP5_CANFD01_81d7dd4c_Rx
        BJB_12_XIX_BMC_CAN01_E2E_db9108b8_Rx: CanIfRxPduCanId=441800485, CanIfRxPduCanIdType=EXTENDED_NO_FD_CAN, CanIfRxPduDlc=8, CanIfRxPduId=3, CanIfRxPduHrhIdRef=CN_BMC_CAN01_e16b4bee_Rx, CanIfRxPduRef=BJB_12_XIX_BMC_CAN01_E2E_c4dd8994_Rx
        OBD_04_XIX_HCP5_CANFD01_942a7d61_Rx: CanIfRxPduCanId=380196171, CanIfRxPduCanIdType=EXTENDED_FD_CAN, CanIfRxPduDlc=8, CanIfRxPduId=79, CanIfRxPduHrhIdRef=CN_HCP5_CANFD01_f532029f_Rx, CanIfRxPduRef=OBD_04_XIX_HCP5_CANFD01_dc080cfa_Rx
      3 x CanIfTxPduCfg, all with CanIfTxPduReadNotifyStatus=false, CanIfTxPduType=STATIC, CanIfTxPduTruncation=true:
        KN_Hybrid_01_XIX_HCP5_CANFD01_c84a3ea5_Tx: CanIfTxPduCanId=401604731, CanIfTxPduCanIdType=EXTENDED_FD_CAN, CanIfTxPduDlc=16, CanIfTxPduUserTxConfirmationName=PduR_CanIfTxConfirmation, CanIfTxPduUserTxConfirmationUL=PDUR, CanIfTxPduId=55, CanIfTxPduBufferRef=CHNL_b74a53a7, CanIfTxPduRef=KN_Hybrid_01_XIX_HCP5_CANFD01_3c12b6a6_Tx
        BMC_CMC_Zellspannung_05_XIX_HCP5_CANFD01_b6486562_Tx: CanIfTxPduCanId=441800240, CanIfTxPduCanIdType=EXTENDED_FD_CAN, CanIfTxPduDlc=64, CanIfTxPduUserTxConfirmationName=PduR_CanIfTxConfirmation, CanIfTxPduUserTxConfirmationUL=PDUR, CanIfTxPduId=33, CanIfTxPduBufferRef=CHNL_b74a53a7, CanIfTxPduRef=BMC_CMC_Zellspannung_05_XIX_HCP5_CANFD01_31993ec3_Tx
        OBDC_SSN_BJB_Req_XIX_BMC_CAN01_6c60ffed_Tx: CanIfTxPduCanId=402419920, CanIfTxPduCanIdType=EXTENDED_CAN, CanIfTxPduDlc=8, CanIfTxPduUserTxConfirmationName=NULL_PTR, CanIfTxPduUserTxConfirmationUL=NONE, CanIfTxPduId=14, CanIfTxPduBufferRef=CHNL_eb535f7d, CanIfTxPduRef=OBDC_SSN_BJB_Req_XIX_BMC_CAN01_31b63a85_Tx
      UI1_02_XIX_BMC_CAN01_E2E_ba04f082_Rx (CanIfRxPduCfg):
        CanIfRxPduCanId = 753
        CanIfRxPduCanIdType = STANDARD_NO_FD_CAN
        CanIfRxPduDlc = 8
        CanIfRxPduUserRxIndicationName = PduR_CanIfRxIndication
        CanIfRxPduUserRxIndicationUL = PDUR
        CanIfRxPduId = 34
        CanIfRxPduReadData = false
        CanIfRxPduReadNotifyStatus = false
        CanIfRxPduDlcCheck = true
        CanIfRxPduHrhIdRef = CN_BMC_CAN01_d4211d16_Rx
        CanIfRxPduRef = UI1_02_XIX_BMC_CAN01_E2E_aa93ac73_Rx
      OBDC_Hybrid_01_Resp_FD_XIX_HCP5_CANFD01_0bc90f29_Tx (CanIfTxPduCfg):
        CanIfTxPduCanId = 474088059
        CanIfTxPduCanIdType = EXTENDED_FD_CAN
        CanIfTxPduDlc = 64
        CanIfTxPduUserTxConfirmationName = CanTp_TxConfirmation
        CanIfTxPduUserTxConfirmationUL = CAN_TP
        CanIfTxPduId = 26
        CanIfTxPduReadNotifyStatus = false
        CanIfTxPduType = STATIC
        CanIfTxPduTruncation = true
        CanIfTxPduBufferRef = CHNL_b74a53a7
        CanIfTxPduRef = OBDC_Hybrid_01_Resp_FD_XIX_HCP5_CANFD01_4da12d14_Tx
      CanIfRxPduCfg_PDUID_mBAP_Klima_01_0x638_Rx (CanIfRxPduCfg):
        CanIfRxPduCanIdType = STANDARD_FD_CAN
        CanIfRxPduDlc = 8
        CanIfRxPduId = 64
        CanIfRxPduReadData = false
        CanIfRxPduReadNotifyStatus = false
        CanIfRxPduUserRxIndicationName = PduR_CanIfRxIndication
        CanIfRxPduUserRxIndicationUL = PDUR
        CanIfRxPduDlcCheck = true
        CanIfRxPduCanId = 1592
        CanIfRxPduHrhIdRef = CN_HCP5_CANFD01_c0785467_Rx
        CanIfRxPduRef = Pdu_BAP_CanIf2PduR_Rx
      CanIfTxPduCfg_PDUID_mBAP_ASG_01_0x601_Tx (CanIfTxPduCfg):
        CanIfTxPduCanId = 1537
        CanIfTxPduCanIdType = STANDARD_FD_CAN
        CanIfTxPduDlc = 8
        CanIfTxPduId = 47
        CanIfTxPduReadNotifyStatus = false
        CanIfTxPduType = STATIC
        CanIfTxPduUserTxConfirmationUL = PDUR
        CanIfTxPduTruncation = true
        CanIfTxPduUserTxConfirmationName = PduR_CanIfTxConfirmation
        CanIfTxPduBufferRef = CHNL_b74a53a7
        CanIfTxPduRef = Pdu_BAP_PduR2CanIf_Tx
    CanIfPrivateCfg:
      CanIfPrivateSoftwareFilterType = LINEAR
      CanIfPrivateDlcCheck = false
      CanIfSupportTTCAN = false
      CanIfTransceiverMapping = false
      CanIfTransceiverHandling = false
      CanIfSupportExtendedIds = true
      CanIfSupportNmOsek = false
      CanIfTxBufferType = BYTE_QUEUE
      CanIfWakeupSupport = false
      CanIfStaticFdTxBufferSupport = true
      CanIfRxSearchConsiderMsgType = true
      CanIfTxBufferFifoSupport = false
      CanIfSetPduReceptionModeSupport = false
      CanIfCheckWakeupCanRetType = true
      CanIfDataChecksumRxSupport = false
      CanIfDataChecksumTxSupport = false
    CanIfPublicCfg:
      CanIfPublicPnSupport = true
      CanIfPublicCancelTransmitSupport = true
      CanIfPublicDevErrorDetect = true
      CanIfPublicHandleTypeEnum = UINT8
      CanIfPublicMultipleDrvSupport = false
      CanIfPublicNumberOfCanHwUnits = 1
      CanIfPublicReadRxPduDataApi = false
      CanIfPublicReadRxPduNotifyStatusApi = false
      CanIfPublicReadTxPduNotifyStatusApi = false
      CanIfPublicSetDynamicTxIdApi = false
      CanIfPublicTxBuffering = true
      CanIfPublicTxConfirmPollingSupport = true
      CanIfPublicVersionInfoApi = false
      CanIfPublicWakeupCheckValidSupport = false
      CanIfPnWakeupTxPduFilterSupport = false
      CanIfPnTrcvHandlingSupport = false
      CanIfJ1939DynAddrSupport = DISABLED
      CanIfSafeBswChecks = false
      CanIfBusMirroringSupport = false
      CanIfEnableSecurityEventReporting = false
      CanIfSupportCanDrvAsr440 = false
      CanIfSupportMultipartition = false
      CanIfSetBaudrateApi = false
