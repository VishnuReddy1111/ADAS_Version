AUTOSAR XML (schema 4-3-0)
package /ActiveEcuC
  module config StartApplicationEth: definition=Cdd, implementation-config-variant=VARIANT-PRE-COMPILE, module-description=Cdd_Impl
    CddComStackContribution
      CddSoAdUpperLayerContribution
        StartApplication_CC_Pdu_SoAdCdd_Udp_Rx (CddSoAdUpperLayerRxPdu): CddPduRApiType=IF, CddSoAdUpperLayerHandleId=1, CddSoAdUpperLayerPduRef=StartApplication_CC_Pdu_SoAdCdd_Udp_Rx
        StartApplication_CC_Pdu_SoAdCdd_Udp_Tx (CddSoAdUpperLayerTxPdu): CddPduRApiType=IF, CddSoAdUpperLayerHandleId=1, CddSoAdUpperLayerPduRef=StartApplication_CC_Pdu_SoAdCdd_Udp_Tx
        StartApplication_CCLD_Pdu_SoAdCdd_Udp_Rx (CddSoAdUpperLayerRxPdu): CddPduRApiType=IF, CddSoAdUpperLayerHandleId=0, CddSoAdUpperLayerPduRef=StartApplication_CCLD_Pdu_SoAdCdd_Udp_Rx
        StartApplication_CCLD_Pdu_SoAdCdd_Udp_Tx (CddSoAdUpperLayerTxPdu): CddPduRApiType=IF, CddSoAdUpperLayerHandleId=0, CddSoAdUpperLayerPduRef=StartApplication_CCLD_Pdu_SoAdCdd_Udp_Tx
        StartApplication_ETH_Pdu_SoAdCdd_Udp_Rx (CddSoAdUpperLayerRxPdu): CddPduRApiType=IF, CddSoAdUpperLayerHandleId=2, CddSoAdUpperLayerPduRef=StartApplication_ETH_Pdu_SoAdCdd_Udp_Rx
        StartApplication_ETH_Pdu_SoAdCdd_Udp_Tx (CddSoAdUpperLayerTxPdu): CddPduRApiType=IF, CddSoAdUpperLayerHandleId=2, CddSoAdUpperLayerPduRef=StartApplication_ETH_Pdu_SoAdCdd_Udp_Tx
  module config BAP: definition=Cdd, implementation-config-variant=VARIANT-PRE-COMPILE, module-description=BAP_Impl
    BAPGeneral: BAPVersionInfoApi=true, BAPUseRte=true
    CddComStackContribution
      CddPduRUpperLayerContribution
        PDUID_mBAP_ASG_01_0x601_Tx (CddPduRUpperLayerTxPdu): CddPduRUpperLayerHandleId=141, CddPduRUpperLayerPduRef=PDUID_mBAP_ASG_01_0x601_Tx
        PDUID_mBAP_Klima_01_0x638_Rx (CddPduRUpperLayerRxPdu): CddPduRUpperLayerHandleId=150, CddPduRUpperLayerPduRef=PDUID_mBAP_Klima_01_0x638_Rx
        PDUID_mBAP_Klima_01_0x638_Tx (CddPduRUpperLayerTxPdu): CddPduRUpperLayerHandleId=140, CddPduRUpperLayerPduRef=PDUID_mBAP_Klima_01_0x638_Tx
        PDUID_mBAP_ASG_01_0x601_Rx (CddPduRUpperLayerRxPdu): CddPduRUpperLayerHandleId=149, CddPduRUpperLayerPduRef=PDUID_mBAP_ASG_01_0x601_Rx
