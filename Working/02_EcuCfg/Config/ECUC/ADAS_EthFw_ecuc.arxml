AUTOSAR XML (schema 00048)
package /ActiveEcuC
  module config EthFw: implementation-config-variant=VARIANT-PRE-COMPILE, module-description=EthFw_Impl
    EthFwConfig: EthFwRxFrameDiscardedCbk=EthFw_CB_RxFrameDiscarded, EthFwTxFrameDiscardedCbk=EthFw_CB_TxFrameDiscarded
      5 x EthFwRule:
        EthFwRule_IPv4_NoVLAN: EthFwControllerRef=MyECU_EEI_U_ee15deea, EthFwFrameOwnerRef=TcpIp_IPv4
          EthFwMacAddr: EthFwLocalMacAddrAllowAll=true, EthFwRemoteMacAddrAllowAll=true
          EthFwMacProtocol
            EthFwIpRule
              EthFwIpProtocol
                EthFwTcpRule
                  EthFwTcpPort: EthFwLocalPortAllowAll=true, EthFwRemotePortAllowAll=true
                EthFwUdpRule
                  EthFwUdpPort: EthFwLocalPortAllowAll=false, EthFwRemotePortAllowAll=true, EthFwLocalPortStart=0, EthFwLocalPortEnd=65534
              9 x EthFwIpAddr, all with EthFwLocalIpAddrAllowAll=false:
                EthFwIpAddr_192_168_1_11_192_168_1_8: EthFwRemoteIpAddrAllowAll=false, EthFwLocalIpAddrStart=192.168.1.11, EthFwRemoteIpAddrStart=192.168.1.8, EthFwRemoteIpAddrEnd=192.168.1.10
                EthFwIpAddr_Multicast_Tx: EthFwRemoteIpAddrAllowAll=false, EthFwLocalIpAddrStart=192.168.1.11, EthFwRemoteIpAddrStart=224.0.0.0, EthFwRemoteIpAddrEnd=239.255.255.255
                EthFwIpAddr_Broadcast_Tx: EthFwRemoteIpAddrAllowAll=false, EthFwLocalIpAddrStart=192.168.1.11, EthFwRemoteIpAddrStart=255.255.255.255
                EthFwIpAddr_Multicast_Rx: EthFwRemoteIpAddrAllowAll=false, EthFwLocalIpAddrStart=224.0.0.0, EthFwRemoteIpAddrStart=192.168.1.1, EthFwRemoteIpAddrEnd=192.168.1.51, EthFwLocalIpAddrEnd=239.255.255.255
                EthFwIpAddr_192_168_1_11_192_168_1_10: EthFwRemoteIpAddrAllowAll=false, EthFwLocalIpAddrStart=192.168.1.11, EthFwRemoteIpAddrStart=192.168.1.20
                EthFwIpAddr_Broadcast_Rx: EthFwRemoteIpAddrAllowAll=true, EthFwLocalIpAddrStart=255.255.255.255
                EthFwIpAddr_192_168_1_11_192_168_1_12: EthFwRemoteIpAddrAllowAll=false, EthFwLocalIpAddrStart=192.168.1.11, EthFwRemoteIpAddrStart=192.168.1.12
                EthFwIpAddr_192_168_1_11_192_168_1_2: EthFwRemoteIpAddrAllowAll=false, EthFwLocalIpAddrStart=192.168.1.11, EthFwRemoteIpAddrStart=192.168.1.2
                EthFwIpAddr_Broadcast_Rx_Subnet: EthFwRemoteIpAddrAllowAll=true, EthFwLocalIpAddrStart=192.168.1.255
        EthFwRule_ARP: EthFwControllerRef=MyECU_EEI_U_ee15deea, EthFwFrameOwnerRef=TcpIp_ARP
          EthFwMacAddr:
            EthFwLocalMacAddrAllowAll = true
            EthFwRemoteMacAddrAllowAll = false
            EthFwRemoteMacAddrStart = 02:00:00:00:00:00
            EthFwRemoteMacAddrEnd = 02:FF:FF:FF:FF:FF
          EthFwMacProtocol
          EthFwMacAddr_001 (EthFwMacAddr):
            EthFwLocalMacAddrAllowAll = true
            EthFwRemoteMacAddrAllowAll = false
            EthFwRemoteMacAddrStart = AA:00:00:00:00:00
            EthFwRemoteMacAddrEnd = FF:FF:FF:FF:FF:FF
        EthFwRule_IPv6_NoVLAN: EthFwControllerRef=MyECU_EEI_U_ee15deea, EthFwFrameOwnerRef=TcpIp_IPv6
          EthFwMacAddr: EthFwLocalMacAddrAllowAll=true, EthFwRemoteMacAddrAllowAll=true
          EthFwMacProtocol
            EthFwIpRule
              EthFwIpProtocol
                EthFwTcpRule
                  EthFwTcpPort: EthFwLocalPortAllowAll=true, EthFwRemotePortAllowAll=true
                EthFwUdpRule
                  EthFwUdpPort: EthFwLocalPortAllowAll=true, EthFwRemotePortAllowAll=true
                EthFwRawProtocolRule: EthFwAllowAllProtocolTypes=false, EthFwProtocolType=58
              EthFwIpAddr: EthFwLocalIpAddrAllowAll=true, EthFwRemoteIpAddrAllowAll=true
        EthFwRule_EthTSyn: EthFwControllerRef=MyECU_EEI_U_ee15deea, EthFwFrameOwnerRef=EthTSyn_EthTSyn
          EthFwMacAddr: EthFwLocalMacAddrAllowAll=true, EthFwRemoteMacAddrAllowAll=true
          EthFwMacProtocol
        EthFwRule_IPv6_VLAN10: EthFwControllerRef=MyECU_EEI_V10_NM_53547422, EthFwFrameOwnerRef=TcpIp_IPv6
          EthFwMacAddr: EthFwLocalMacAddrAllowAll=true, EthFwRemoteMacAddrAllowAll=true
          EthFwMacProtocol
            EthFwIpRule
              EthFwIpProtocol
                EthFwUdpRule
                  EthFwUdpPort: EthFwLocalPortAllowAll=true, EthFwRemotePortAllowAll=true
              EthFwIpAddr: EthFwLocalIpAddrAllowAll=true, EthFwRemoteIpAddrAllowAll=true
          EthFwFramePriority: EthFwAllowAllFramePriorities=true
    EthFwGeneral: EthFwDevErrorDetect=true, EthFwVersionInfoApi=true, EthFwEnabled=true, EthFwSafeBswChecks=false
      EthFwGeneration:
        EthFwOutOfBoundsWriteProtectionStrategy = NONE
        EthFwOutOfBoundsWriteSanitizer = false
        EthFwOutOfBoundsReadSanitizer = false
        EthFwNumericalDataTypeMinimizationStrategy = NONE
        EthFwReduceConstantData2Define = false
        EthFwBoolDataInArrayOfStructStrategy = BITMASKING
        EthFwDeduplicateIndirectedData = false
        EthFwDataDeduplicationStrategy = NONE
        EthFwReduceBoolDataByNegationThreshold = 0
        EthFwReduceBoolDataByNumericalComparisonThreshold = 0
        EthFwReduceBoolDataByNumericalRelationThreshold = 0
        EthFwReduceBoolDataByNumericalOperandStrategy = NONE
        EthFwReduceNumericalDataByOffsetThreshold = 0
        EthFwReduceNumericalDataByArraySubtractionThreshold = 0
        EthFwReduceDataByStreaming = false
        EthFwShortSymbols = false
        EthFwInterfacesForDeactivatedData = false
        EthFwReferringKeysInComments = false
