AUTOSAR XML (schema 4-3-0)
package /ActiveEcuC
  module config EthTrcv: implementation-config-variant=VARIANT-PRE-COMPILE, module-description=EthTrcv_Impl
    EthTrcvGeneral:
      EthTrcvDevErrorDetect = true
      EthTrcvGetBaudRateApi = true
      EthTrcvGetDuplexModeApi = true
      EthTrcvGetLinkStateApi = true
      EthTrcvGetTransceiverModeApi = true
      EthTrcvMaxTrcvsSupported = 1
      EthTrcvSetTransceiverModeApi = true
      EthTrcvStartAutoNegotiationApi = true
      EthTrcvVersionInfoApi = true
      EthTrcvIndex = 0
      EthTrcvRuntimeMeasurementSupport = true
      EthTrcvWakeUpSupport = ETHTRCV_WAKEUP_NOT_SUPPORTED
      EthTrcvMainFunctionPeriod = 1
      EthTrcvSafeBswChecks = false
      EthTrcvHwAccessLoopCount = 0
      EthTrcvCableDiagLoopCount = 10000
      EthTrcvPreTrcvInitUserCallout = NULL_PTR
      EthTrcvPostTrcvInitUserCallout = NULL_PTR
    EthTrcvConfigSet
      EthTrcvConfig:
        EthTrcvIdx = 0
        EthTrcvAutoNegotiationEnabled = true
        EthTrcvSpeed = TRCV_SPEED_100
        EthTrcvEnableAccessCheck = false
        EthTrcvAccessCheckRegisterValue = 28
        EthTrcvConnNeg = ETHTRCV_CONN_NEG_AUTO
        EthTrcvPhySignalQualityMeanValueLength = 100
        EthTrcvSoftResetOnInit = false
        EthTrcvHwAccessMonitorEnabled = false
        EthTrcvMgmtInterface
          EthTrcvMiiInterface: EthTrcvMiiIdx=1, EthTrcvMiiSelection=ETHTRCV_MII_MODE, EthTrcvCtrlRef=BA_MyECU_0_EPC_d9b4790c
