AUTOSAR XML (schema 4-3-0)
package /ActiveEcuC
  module config Can: implementation-config-variant=VARIANT-PRE-COMPILE, module-description=Can_Impl
    CanGeneral:
      CanIndex = 0
      CanVersionInfoApi = true
      CanGetStatus = true
      CanChangeBaudrateApi = false
      CanDevErrorDetection = true
      CanHardwareCancellation = false
      CanIdenticalIdCancellation = false
      CanMainFunctionBusoffPeriod = 0.01
      CanMainFunctionModePeriod = 0.01
      CanMainFunctionWakeupPeriod = 0.01
      CanMultiplexedTransmission = false
      CanTimeoutDuration = 0.01
      CanGenericPrecopy = false
      CanHardwareCancelByAppl = false
      CanGenericConfirmationAPI2 = false
      CanRxQueue = false
      CanSupportMixedID = true
      CanSupportExtendedID = true
      CanRxQueueSize = 10
      CanHardwareHandleType = UINT8
      CanInterruptCategory = CATEGORY2
      CanInterruptLock = DRIVER
      CanOverrunNotification = DET
      CanReinitStart = false
      CanGenericPreTransmit = false
      CanRuntimeMeasurementSupport = true
      CanUsePeripheralAccessApi = false
      CanUseOsInterruptControl = true
      CanSafeBswChecks = false
      CanCheckWakeupCanRetType = false
      CanFdHardwareBufferOptimization = false
      CanGenericConfirmation = None
      CanMirrorModeSupport = false
      CanSilentModeSupport = false
      CanHardwareLoopCheck = true
      CanEnableSecurityEventReporting = false
      CanSetBaudrateApi = false
      CanSoftwareCancellation = true
      CanRamCheck = None
      CanSupportMultipartition = false
      CanUserConfigFile = C:\Vector\CBD2201090_D00\DaVinciConfigurator\Components\EcuM\Implementation\EcuM_Error.h
      CanCounterRef = SystemTimer_Core0
      CanMainFunctionRWPeriods: CanMainFunctionReadPeriod=0.01
    CanConfigSet
      CN_BMC_CAN01_e16b4bee_Rx (CanHardwareObject):
        CanHandleType = BASIC
        CanIdType = EXTENDED
        CanIdValue = 0
        CanObjectType = RECEIVE
        CanObjectId = 2
        CanHwProcessing = false
        CanObjectHwSize = 1
        CanObjectHwHandle = 1
        CanFdPaddingValue = 0
        CanObjectMultiplexedTransmission = false
        CanObjectHwFifo = false
        CanMaxDataLen = 8
        CanControllerRef = CT_BMC_CAN01_34f1c2c6
        CanFilterMaskRef = CT_BMC_CAN01_34f1c2c6/CanFilterMask_001
      CT_HCP5_CANFD01_e05ce4e2 (CanController):
        CanControllerActivation = true
        CanBusoffProcessing = INTERRUPT
        CanControllerBaseAddress = 4028664320
        CanControllerId = 1
        CanRxProcessing = INTERRUPT
        CanTxProcessing = INTERRUPT
        CanWakeupProcessing = INTERRUPT
        CanWakeupSupport = false
        CanWakeupSourceId = 0
        CanIndividualProcessing = false
        CanFdSupport = FULL
        CanMaxRxDataLen = 64
        CanMaxTxDataLen = 64
        CanRamCheck = None
        CanControllerDefaultBaudrate = CT_HCP5_CANFD01_e05ce4e2/CanControllerBaudrateConfig
        CanControllerSystemRef = CT_HCP5_CANFD01
        CanWakeupSourceRef = CN_HCP5_CANFD01_54d90215
        CanCpuClockRef = McuClockReferencePoint_Can
        CanvCanExtensionRef = vCanController
        CanOsCounterRef = SystemTimer_Core0
        CanControllerBaudrateConfig:
          CanControllerBaudRate = 500
          CanControllerBaudRateConfigID = 0
          CanControllerPropSeg = 1
          CanControllerSeg1 = 6
          CanControllerSeg2 = 2
          CanControllerSyncJumpWidth = 2
          CanBaudrateClock = 20000
          CanBaudratePrescaler = 4
          CanControllerFdBaudrateConfig:
            CanControllerFdBaudRate = 2000
            CanControllerPropSeg = 1
            CanControllerSeg1 = 6
            CanControllerSeg2 = 2
            CanControllerSyncJumpWidth = 2
            CanControllerTxBitRateSwitch = true
            CanBaudratePrescaler = 1
        CanFilterMask: CanFilterMaskValue=0, CanFilterCodeValue=0, IsLocked=false, CanFilterMaskId=0
        CanFilterMask_001 (CanFilterMask): CanFilterMaskValue=2147483648, CanFilterCodeValue=0, IsLocked=false, CanFilterMaskId=1
      CN_HCP5_CANFD01_f532029f_Rx (CanHardwareObject):
        CanHandleType = BASIC
        CanIdType = EXTENDED
        CanIdValue = 0
        CanObjectType = RECEIVE
        CanObjectId = 5
        CanHwProcessing = false
        CanObjectHwSize = 1
        CanObjectHwHandle = 1
        CanFdPaddingValue = 0
        CanObjectMultiplexedTransmission = false
        CanObjectHwFifo = false
        CanMaxDataLen = 64
        CanControllerRef = CT_HCP5_CANFD01_e05ce4e2
        CanFilterMaskRef = CT_HCP5_CANFD01_e05ce4e2/CanFilterMask_001
      CN_BMC_CAN01_d4211d16_Rx (CanHardwareObject):
        CanHandleType = BASIC
        CanIdType = STANDARD
        CanIdValue = 0
        CanObjectType = RECEIVE
        CanObjectId = 1
        CanHwProcessing = false
        CanObjectHwSize = 1
        CanObjectHwHandle = 0
        CanFdPaddingValue = 0
        CanObjectMultiplexedTransmission = false
        CanObjectHwFifo = false
        CanMaxDataLen = 8
        CanControllerRef = CT_BMC_CAN01_34f1c2c6
        CanFilterMaskRef = CT_BMC_CAN01_34f1c2c6/CanFilterMask
      CT_BMC_CAN01_34f1c2c6 (CanController):
        CanControllerActivation = true
        CanBusoffProcessing = INTERRUPT
        CanControllerBaseAddress = 4028794368
        CanControllerId = 0
        CanRxProcessing = INTERRUPT
        CanTxProcessing = INTERRUPT
        CanWakeupProcessing = INTERRUPT
        CanWakeupSupport = false
        CanWakeupSourceId = 0
        CanIndividualProcessing = false
        CanFdSupport = NONE
        CanMaxRxDataLen = 8
        CanMaxTxDataLen = 8
        CanRamCheck = None
        CanControllerDefaultBaudrate = CT_BMC_CAN01_34f1c2c6/CanControllerBaudrateConfig
        CanControllerSystemRef = CT_BMC_CAN01
        CanWakeupSourceRef = CN_BMC_CAN01_78a85e89
        CanCpuClockRef = McuClockReferencePoint_Can
        CanvCanExtensionRef = CT_BMC_CAN01
        CanOsCounterRef = SystemTimer_Core0
        CanControllerBaudrateConfig:
          CanControllerBaudRate = 500
          CanControllerBaudRateConfigID = 0
          CanControllerPropSeg = 1
          CanControllerSeg1 = 6
          CanControllerSeg2 = 2
          CanControllerSyncJumpWidth = 2
          CanBaudrateClock = 20000
          CanBaudratePrescaler = 4
        CanFilterMask: CanFilterMaskValue=0, CanFilterCodeValue=0, IsLocked=false, CanFilterMaskId=0
        CanFilterMask_001 (CanFilterMask): CanFilterMaskValue=2147483648, CanFilterCodeValue=0, IsLocked=false, CanFilterMaskId=1
      3 x CanHardwareObject, all with CanHandleType=BASIC, CanIdValue=0, CanHwProcessing=false, CanObjectHwSize=1, CanObjectHwHandle=0, CanFdPaddingValue=0, CanObjectMultiplexedTransmission=false, CanObjectHwFifo=false:
        CN_HCP5_CANFD01_54d90215_Tx: CanObjectType=TRANSMIT, CanIdType=MIXED, CanObjectId=3, CanMaxDataLen=64, CanControllerRef=CT_HCP5_CANFD01_e05ce4e2
        CN_BMC_CAN01_78a85e89_Tx: CanObjectType=TRANSMIT, CanIdType=MIXED, CanObjectId=0, CanMaxDataLen=8, CanControllerRef=CT_BMC_CAN01_34f1c2c6
        CN_HCP5_CANFD01_c0785467_Rx: CanIdType=STANDARD, CanObjectType=RECEIVE, CanObjectId=4, CanMaxDataLen=64, CanControllerRef=CT_HCP5_CANFD01_e05ce4e2, CanFilterMaskRef=CT_HCP5_CANFD01_e05ce4e2/CanFilterMask
