AUTOSAR XML (schema 4-3-0)
package /ActiveEcuC
  module config vLinkGen: implementation-config-variant=VARIANT-PRE-COMPILE, module-description=vLinkGen_Impl
    vLinkGenMemLayout
      vLinkGenLinkerSections
        brsStartupEntry (vLinkGenLinkerCodeSection): vLinkGenLinkerCodeSectionName=brsStartupEntry_C, vLinkGenLinkerCodeSectionAlignment=8, vLinkGenLinkerCodeSectionFast=false
        MSR_CODE (vLinkGenLinkerCodeSection): vLinkGenLinkerCodeSectionName=MSR_CODE, vLinkGenLinkerCodeSectionFast=false, vLinkGenLinkerCodeSectionAlignment=0
        MSR_CONST (vLinkGenLinkerConstSection): vLinkGenLinkerConstSectionName=MSR_CONST, vLinkGenLinkerConstSectionFast=false, vLinkGenLinkerConstSectionAlignment=0
        MSR_PBCFG_CONST (vLinkGenLinkerConstSection): vLinkGenLinkerConstSectionName=MSR_PBCFG_CONST, vLinkGenLinkerConstSectionFast=false, vLinkGenLinkerConstSectionAlignment=0
        4 x vLinkGenLinkerVarSection, all with vLinkGenLinkerVarSectionFast=false, vLinkGenLinkerVarSectionAlignment=0:
          MSR_PBCFG_VAR: vLinkGenLinkerVarSectionName=MSR_PBCFG_VAR
          MSR_VAR_CLEARED: vLinkGenLinkerVarSectionName=MSR_VAR_CLEARED
          MSR_VAR_INIT: vLinkGenLinkerVarSectionName=MSR_VAR_INIT
          MSR_VAR_NO_INIT: vLinkGenLinkerVarSectionName=MSR_VAR_NO_INIT
        MSR_CONST_FAST (vLinkGenLinkerConstSection): vLinkGenLinkerConstSectionFast=true, vLinkGenLinkerConstSectionName=MSR_CONST_FAST, vLinkGenLinkerConstSectionAlignment=0
        3 x vLinkGenLinkerVarSection, all with vLinkGenLinkerVarSectionFast=true, vLinkGenLinkerVarSectionAlignment=0:
          MSR_VAR_FAST_CLEARED: vLinkGenLinkerVarSectionName=MSR_VAR_FAST_CLEARED
          MSR_VAR_FAST_INIT: vLinkGenLinkerVarSectionName=MSR_VAR_FAST_INIT
          MSR_VAR_FAST_NO_INIT: vLinkGenLinkerVarSectionName=MSR_VAR_FAST_NO_INIT
        MSR_PBCFG_CONST_FAST (vLinkGenLinkerConstSection): vLinkGenLinkerConstSectionFast=true, vLinkGenLinkerConstSectionName=MSR_PBCFG_CONST_FAST, vLinkGenLinkerConstSectionAlignment=0
        9 x vLinkGenLinkerVarSection, all with vLinkGenLinkerVarSectionAlignment=0:
          MSR_PBCFG_VAR_FAST: vLinkGenLinkerVarSectionFast=true, vLinkGenLinkerVarSectionName=MSR_PBCFG_VAR_FAST
          MSR_PBCFG_VAR_FAST_NO_INIT: vLinkGenLinkerVarSectionFast=true, vLinkGenLinkerVarSectionName=MSR_PBCFG_VAR_FAST_NO_INIT
          MSR_PBCFG_VAR_NO_INIT: vLinkGenLinkerVarSectionName=MSR_PBCFG_VAR_NO_INIT, vLinkGenLinkerVarSectionFast=false
          MSR_VAR_SAVED_ZONE_INIT: vLinkGenLinkerVarSectionName=MSR_VAR_SAVED_ZONE_INIT, vLinkGenLinkerVarSectionFast=false
          MSR_VAR_SAVED_ZONE_NO_INIT: vLinkGenLinkerVarSectionName=MSR_VAR_SAVED_ZONE_NO_INIT, vLinkGenLinkerVarSectionFast=false
          MSR_VAR_SAVED_ZONE_FAST_INIT: vLinkGenLinkerVarSectionFast=true, vLinkGenLinkerVarSectionName=MSR_VAR_SAVED_ZONE_FAST_INIT
          MSR_VAR_SAVED_ZONE_FAST_NO_INIT: vLinkGenLinkerVarSectionFast=true, vLinkGenLinkerVarSectionName=MSR_VAR_SAVED_ZONE_FAST_NO_INIT
          MSR_PBCFG_VAR_CLEARED: vLinkGenLinkerVarSectionName=MSR_PBCFG_VAR_CLEARED, vLinkGenLinkerVarSectionFast=false
          MSR_PBCFG_VAR_FAST_CLEARED: vLinkGenLinkerVarSectionName=MSR_PBCFG_VAR_FAST_CLEARED, vLinkGenLinkerVarSectionFast=true
        brsStartup (vLinkGenLinkerCodeSection): vLinkGenLinkerCodeSectionName=brsStartup, vLinkGenLinkerCodeSectionAlignment=8, vLinkGenLinkerCodeSectionFast=false
        BMHD0 (vLinkGenLinkerConstSection): vLinkGenLinkerConstSectionName=BMHD0, vLinkGenLinkerConstSectionAlignment=32, vLinkGenLinkerConstSectionFast=false
        3 x vLinkGenLinkerCodeSection, all with vLinkGenLinkerCodeSectionFast=false, vLinkGenLinkerCodeSectionAlignment=0:
          brsExcVect: vLinkGenLinkerCodeSectionName=brsExcVect
          brsMainStartup: vLinkGenLinkerCodeSectionName=brsMainStartup
          brsSharedConst: vLinkGenLinkerCodeSectionName=brsSharedConst
        brsExcVectConst (vLinkGenLinkerConstSection): vLinkGenLinkerConstSectionName=brsExcVectConst, vLinkGenLinkerConstSectionFast=false, vLinkGenLinkerConstSectionAlignment=0
        brsSharedVar (vLinkGenLinkerVarSection): vLinkGenLinkerVarSectionName=brsSharedVar, vLinkGenLinkerVarSectionFast=false, vLinkGenLinkerVarSectionAlignment=0
        7 x vLinkGenLinkerSpecSection, all with vLinkGenLinkerSpecSectionPad=0, vLinkGenLinkerSpecSectionAlignment=0:
          text: vLinkGenLinkerSpecSectionValue=[.]text*
          rodata: vLinkGenLinkerSpecSectionValue=[.]rodata*
          zrodata: vLinkGenLinkerSpecSectionValue=[.]zrodata*
          data: vLinkGenLinkerSpecSectionValue=[.]data*
          zdata: vLinkGenLinkerSpecSectionValue=[.]zdata*
          bss: vLinkGenLinkerSpecSectionValue=[.]bss*
          zbss: vLinkGenLinkerSpecSectionValue=[.]zbss*
        22 x vLinkGenLinkerCodeSection, all with vLinkGenLinkerCodeSectionFast=false, vLinkGenLinkerCodeSectionModule=Os:
          OS_CODE: vLinkGenLinkerCodeSectionName=OS_CODE, vLinkGenLinkerCodeSectionAlignment=0
          OS_OS_COREINITHOOK_CODE: vLinkGenLinkerCodeSectionName=OS_OS_COREINITHOOK_CODE, vLinkGenLinkerCodeSectionAlignment=0
          OS_INTVEC_CODE: vLinkGenLinkerCodeSectionName=OS_INTVEC_CODE, vLinkGenLinkerCodeSectionAlignment=8192, vLinkGenLinkerCodeSectionFlag=vLinkGenConstSectionFlags/KEEP
          OS_EXCVEC_CORE0_CODE: vLinkGenLinkerCodeSectionName=OS_EXCVEC_CORE0_CODE, vLinkGenLinkerCodeSectionAlignment=256, vLinkGenLinkerCodeSectionFlag=vLinkGenConstSectionFlags/KEEP
          OS_INTVEC_CORE0_CODE: vLinkGenLinkerCodeSectionName=OS_INTVEC_CORE0_CODE, vLinkGenLinkerCodeSectionAlignment=8192, vLinkGenLinkerCodeSectionFlag=vLinkGenConstSectionFlags/KEEP
          OS_EXCVEC_CORE1_CODE: vLinkGenLinkerCodeSectionName=OS_EXCVEC_CORE1_CODE, vLinkGenLinkerCodeSectionAlignment=256, vLinkGenLinkerCodeSectionFlag=vLinkGenConstSectionFlags/KEEP
          OS_INTVEC_CORE1_CODE: vLinkGenLinkerCodeSectionName=OS_INTVEC_CORE1_CODE, vLinkGenLinkerCodeSectionAlignment=8192, vLinkGenLinkerCodeSectionFlag=vLinkGenConstSectionFlags/KEEP
          OS_ERRORHOOK_CODE: vLinkGenLinkerCodeSectionName=OS_ERRORHOOK_CODE, vLinkGenLinkerCodeSectionAlignment=0
          OS_Default_Init_Task_Core1_Trusted_CODE: vLinkGenLinkerCodeSectionName=OS_Default_Init_Task_Core1_Trusted_CODE, vLinkGenLinkerCodeSectionAlignment=0
          OS_Default_BSW_Async_Task_CODE: vLinkGenLinkerCodeSectionName=OS_Default_BSW_Async_Task_CODE, vLinkGenLinkerCodeSectionAlignment=0
          OS_StartApplication_Appl_Init_Task_CODE: vLinkGenLinkerCodeSectionName=OS_StartApplication_Appl_Init_Task_CODE, vLinkGenLinkerCodeSectionAlignment=0
          OS_Default_Init_Task_CODE: vLinkGenLinkerCodeSectionName=OS_Default_Init_Task_CODE, vLinkGenLinkerCodeSectionAlignment=0
          OS_StartApplication_Appl_Task_CODE: vLinkGenLinkerCodeSectionName=OS_StartApplication_Appl_Task_CODE, vLinkGenLinkerCodeSectionAlignment=0
          OS_Default_BSW_Sync_Task_CODE: vLinkGenLinkerCodeSectionName=OS_Default_BSW_Sync_Task_CODE, vLinkGenLinkerCodeSectionAlignment=0
          OS_StartApplication_NoSwc_Appl_Task_CODE: vLinkGenLinkerCodeSectionName=OS_StartApplication_NoSwc_Appl_Task_CODE, vLinkGenLinkerCodeSectionAlignment=0
          OS_Default_RTE_Mode_switch_Task_CODE: vLinkGenLinkerCodeSectionName=OS_Default_RTE_Mode_switch_Task_CODE, vLinkGenLinkerCodeSectionAlignment=0
          OS_StartApplication_NoSwc_Init_Task_CODE: vLinkGenLinkerCodeSectionName=OS_StartApplication_NoSwc_Init_Task_CODE, vLinkGenLinkerCodeSectionAlignment=0
          OS_Default_Init_Task_Core1_CODE: vLinkGenLinkerCodeSectionName=OS_Default_Init_Task_Core1_CODE, vLinkGenLinkerCodeSectionAlignment=0
          OS_BswBackgroundTask_CODE: vLinkGenLinkerCodeSectionName=OS_BswBackgroundTask_CODE, vLinkGenLinkerCodeSectionAlignment=0
          OS_Default_Init_Task_Trusted_CODE: vLinkGenLinkerCodeSectionName=OS_Default_Init_Task_Trusted_CODE, vLinkGenLinkerCodeSectionAlignment=0
          OS_Default_BSW_Task_Core1_CODE: vLinkGenLinkerCodeSectionName=OS_Default_BSW_Task_Core1_CODE, vLinkGenLinkerCodeSectionAlignment=0
          OS_Default_Appl_Init_Task_CODE: vLinkGenLinkerCodeSectionName=OS_Default_Appl_Init_Task_CODE, vLinkGenLinkerCodeSectionAlignment=0
        11 x vLinkGenLinkerConstSection, all with vLinkGenLinkerConstSectionFast=false, vLinkGenLinkerConstSectionModule=Os:
          OS_CONST: vLinkGenLinkerConstSectionName=OS_CONST, vLinkGenLinkerConstSectionAlignment=0
          OS_INTVEC_CONST: vLinkGenLinkerConstSectionName=OS_INTVEC_CONST, vLinkGenLinkerConstSectionAlignment=0, vLinkGenLinkerConstSectionFlag=vLinkGenConstSectionFlags/KEEP
          OS_GLOBALSHARED_CONST: vLinkGenLinkerConstSectionName=OS_GLOBALSHARED_CONST, vLinkGenLinkerConstSectionAlignment=0
          OS_CORE0_CONST: vLinkGenLinkerConstSectionName=OS_CORE0_CONST, vLinkGenLinkerConstSectionAlignment=0
          OS_EXCVEC_CORE0_CONST: vLinkGenLinkerConstSectionName=OS_EXCVEC_CORE0_CONST, vLinkGenLinkerConstSectionAlignment=256, vLinkGenLinkerConstSectionFlag=vLinkGenConstSectionFlags/KEEP
          OS_INTVEC_CORE0_CONST: vLinkGenLinkerConstSectionName=OS_INTVEC_CORE0_CONST, vLinkGenLinkerConstSectionAlignment=8192, vLinkGenLinkerConstSectionFlag=vLinkGenConstSectionFlags/KEEP
          OS_CORE1_CONST: vLinkGenLinkerConstSectionName=OS_CORE1_CONST, vLinkGenLinkerConstSectionAlignment=0
          OS_EXCVEC_CORE1_CONST: vLinkGenLinkerConstSectionName=OS_EXCVEC_CORE1_CONST, vLinkGenLinkerConstSectionAlignment=256, vLinkGenLinkerConstSectionFlag=vLinkGenConstSectionFlags/KEEP
          OS_INTVEC_CORE1_CONST: vLinkGenLinkerConstSectionName=OS_INTVEC_CORE1_CONST, vLinkGenLinkerConstSectionAlignment=8192, vLinkGenLinkerConstSectionFlag=vLinkGenConstSectionFlags/KEEP
          OS_OsApplication_SystemApplication_Core0_CONST: vLinkGenLinkerConstSectionName=OS_OsApplication_SystemApplication_Core0_CONST, vLinkGenLinkerConstSectionAlignment=0
          OS_OsApplication_SystemApplication_Core1_CONST: vLinkGenLinkerConstSectionName=OS_OsApplication_SystemApplication_Core1_CONST, vLinkGenLinkerConstSectionAlignment=0
        18 x vLinkGenLinkerStackSection, all with vLinkGenLinkerStackSectionAlignment=8, vLinkGenLinkerStackSectionModule=Os:
          OS_STACK_OSCORE0_ERROR_VAR_NOINIT: vLinkGenLinkerStackSectionName=OS_STACK_OSCORE0_ERROR_VAR_NOINIT
          OS_STACK_OSCORE0_INIT_VAR_NOINIT: vLinkGenLinkerStackSectionName=OS_STACK_OSCORE0_INIT_VAR_NOINIT
          OS_STACK_OSCORE0_KERNEL_VAR_NOINIT: vLinkGenLinkerStackSectionName=OS_STACK_OSCORE0_KERNEL_VAR_NOINIT
          OS_STACK_OSCORE0_ISR_CORE_VAR_NOINIT: vLinkGenLinkerStackSectionName=OS_STACK_OSCORE0_ISR_CORE_VAR_NOINIT
          OS_STACK_DEFAULT_BSW_ASYNC_TASK_VAR_NOINIT: vLinkGenLinkerStackSectionName=OS_STACK_DEFAULT_BSW_ASYNC_TASK_VAR_NOINIT
          OS_STACK_OSCORE0_TASK_PRIO10_VAR_NOINIT: vLinkGenLinkerStackSectionName=OS_STACK_OSCORE0_TASK_PRIO10_VAR_NOINIT
          OS_STACK_OSCORE0_TASK_PRIO4294967295_VAR_NOINIT: vLinkGenLinkerStackSectionName=OS_STACK_OSCORE0_TASK_PRIO4294967295_VAR_NOINIT
          OS_STACK_OSCORE0_TASK_PRIO45_VAR_NOINIT: vLinkGenLinkerStackSectionName=OS_STACK_OSCORE0_TASK_PRIO45_VAR_NOINIT
          OS_STACK_OSCORE0_TASK_PRIO5_VAR_NOINIT: vLinkGenLinkerStackSectionName=OS_STACK_OSCORE0_TASK_PRIO5_VAR_NOINIT
          OS_STACK_STARTAPPLICATION_NOSWC_APPL_TASK_VAR_NOINIT: vLinkGenLinkerStackSectionName=OS_STACK_STARTAPPLICATION_NOSWC_APPL_TASK_VAR_NOINIT
          OS_STACK_OSCORE0_TASK_PRIO0_VAR_NOINIT: vLinkGenLinkerStackSectionName=OS_STACK_OSCORE0_TASK_PRIO0_VAR_NOINIT
          OS_STACK_OSCORE0_TASK_PRIO49_VAR_NOINIT: vLinkGenLinkerStackSectionName=OS_STACK_OSCORE0_TASK_PRIO49_VAR_NOINIT
          OS_STACK_OSCORE1_TASK_PRIO4294967295_VAR_NOINIT: vLinkGenLinkerStackSectionName=OS_STACK_OSCORE1_TASK_PRIO4294967295_VAR_NOINIT
          OS_STACK_OSCORE1_KERNEL_VAR_NOINIT: vLinkGenLinkerStackSectionName=OS_STACK_OSCORE1_KERNEL_VAR_NOINIT
          OS_STACK_OSCORE1_INIT_VAR_NOINIT: vLinkGenLinkerStackSectionName=OS_STACK_OSCORE1_INIT_VAR_NOINIT
          OS_STACK_OSCORE1_ERROR_VAR_NOINIT: vLinkGenLinkerStackSectionName=OS_STACK_OSCORE1_ERROR_VAR_NOINIT
          OS_STACK_OSCORE1_ISR_CORE_VAR_NOINIT: vLinkGenLinkerStackSectionName=OS_STACK_OSCORE1_ISR_CORE_VAR_NOINIT
          OS_STACK_OSCORE1_TASK_PRIO49_VAR_NOINIT: vLinkGenLinkerStackSectionName=OS_STACK_OSCORE1_TASK_PRIO49_VAR_NOINIT
        46 x vLinkGenLinkerVarSection, all with vLinkGenLinkerVarSectionFast=false, vLinkGenLinkerVarSectionAlignment=0, vLinkGenLinkerVarSectionModule=Os:
          OS_VAR_NOCACHE: vLinkGenLinkerVarSectionName=OS_VAR_NOCACHE
          OS_VAR_NOCACHE_NOINIT: vLinkGenLinkerVarSectionName=OS_VAR_NOCACHE_NOINIT
          OS_GLOBALSHARED_VAR_NOINIT: vLinkGenLinkerVarSectionName=OS_GLOBALSHARED_VAR_NOINIT
          OS_GLOBALSHARED_VAR: vLinkGenLinkerVarSectionName=OS_GLOBALSHARED_VAR
          OS_GLOBALSHARED_VAR_ZERO_INIT: vLinkGenLinkerVarSectionName=OS_GLOBALSHARED_VAR_ZERO_INIT
          OS_GLOBALSHARED_VAR_NOCACHE_NOINIT: vLinkGenLinkerVarSectionName=OS_GLOBALSHARED_VAR_NOCACHE_NOINIT
          OS_GLOBALSHARED_VAR_NOCACHE: vLinkGenLinkerVarSectionName=OS_GLOBALSHARED_VAR_NOCACHE
          OS_GLOBALSHARED_VAR_NOCACHE_ZERO_INIT: vLinkGenLinkerVarSectionName=OS_GLOBALSHARED_VAR_NOCACHE_ZERO_INIT
          OS_GLOBALSHARED_VAR_ZERO_INIT_bss: vLinkGenLinkerVarSectionName=OS_GLOBALSHARED_VAR_ZERO_INIT_bss
          OS_GLOBALSHARED_VAR_NOCACHE_ZERO_INIT_bss: vLinkGenLinkerVarSectionName=OS_GLOBALSHARED_VAR_NOCACHE_ZERO_INIT_bss
          OS_GLOBALSHARED_VAR_SAVED_ZONE: vLinkGenLinkerVarSectionName=OS_GLOBALSHARED_VAR_SAVED_ZONE
          OS_GLOBALSHARED_VAR_SAVED_ZONE_NOINIT: vLinkGenLinkerVarSectionName=OS_GLOBALSHARED_VAR_SAVED_ZONE_NOINIT
          OS_CORESTATUS_CORE0_VAR_NOCACHE_NOINIT: vLinkGenLinkerVarSectionName=OS_CORESTATUS_CORE0_VAR_NOCACHE_NOINIT
          OS_CORE0_VAR: vLinkGenLinkerVarSectionName=OS_CORE0_VAR
          OS_CORE0_VAR_NOCACHE: vLinkGenLinkerVarSectionName=OS_CORE0_VAR_NOCACHE
          OS_CORE0_VAR_NOINIT: vLinkGenLinkerVarSectionName=OS_CORE0_VAR_NOINIT
          OS_CORE0_VAR_NOCACHE_NOINIT: vLinkGenLinkerVarSectionName=OS_CORE0_VAR_NOCACHE_NOINIT
          OS_PUBLIC_CORE0_VAR_NOINIT: vLinkGenLinkerVarSectionName=OS_PUBLIC_CORE0_VAR_NOINIT
          OS_BARRIER_CORE0_VAR_NOCACHE_NOINIT: vLinkGenLinkerVarSectionName=OS_BARRIER_CORE0_VAR_NOCACHE_NOINIT
          OS_CORESTATUS_CORE1_VAR_NOCACHE_NOINIT: vLinkGenLinkerVarSectionName=OS_CORESTATUS_CORE1_VAR_NOCACHE_NOINIT
          OS_CORE1_VAR: vLinkGenLinkerVarSectionName=OS_CORE1_VAR
          OS_CORE1_VAR_NOCACHE: vLinkGenLinkerVarSectionName=OS_CORE1_VAR_NOCACHE
          OS_CORE1_VAR_NOINIT: vLinkGenLinkerVarSectionName=OS_CORE1_VAR_NOINIT
          OS_CORE1_VAR_NOCACHE_NOINIT: vLinkGenLinkerVarSectionName=OS_CORE1_VAR_NOCACHE_NOINIT
          OS_PUBLIC_CORE1_VAR_NOINIT: vLinkGenLinkerVarSectionName=OS_PUBLIC_CORE1_VAR_NOINIT
          OS_BARRIER_CORE1_VAR_NOCACHE_NOINIT: vLinkGenLinkerVarSectionName=OS_BARRIER_CORE1_VAR_NOCACHE_NOINIT
          OS_OsApplication_SystemApplication_Core0_VAR_NOINIT: vLinkGenLinkerVarSectionName=OS_OsApplication_SystemApplication_Core0_VAR_NOINIT
          OS_OsApplication_SystemApplication_Core0_VAR: vLinkGenLinkerVarSectionName=OS_OsApplication_SystemApplication_Core0_VAR
          OS_OsApplication_SystemApplication_Core0_VAR_ZERO_INIT: vLinkGenLinkerVarSectionName=OS_OsApplication_SystemApplication_Core0_VAR_ZERO_INIT
          OS_OsApplication_SystemApplication_Core0_VAR_NOCACHE_NOINIT: vLinkGenLinkerVarSectionName=OS_OsApplication_SystemApplication_Core0_VAR_NOCACHE_NOINIT
          OS_OsApplication_SystemApplication_Core0_VAR_NOCACHE: vLinkGenLinkerVarSectionName=OS_OsApplication_SystemApplication_Core0_VAR_NOCACHE
          OS_OsApplication_SystemApplication_Core0_VAR_NOCACHE_ZERO_INIT: vLinkGenLinkerVarSectionName=OS_OsApplication_SystemApplication_Core0_VAR_NOCACHE_ZERO_INIT
          OS_OsApplication_SystemApplication_Core0_VAR_ZERO_INIT_bss: vLinkGenLinkerVarSectionName=OS_OsApplication_SystemApplication_Core0_VAR_ZERO_INIT_bss
          OS_OsApplication_SystemApplication_Core0_VAR_NOCACHE_ZERO_INIT_bss: vLinkGenLinkerVarSectionName=OS_OsApplication_SystemApplication_Core0_VAR_NOCACHE_ZERO_INIT_bss
          OS_OsApplication_SystemApplication_Core0_VAR_SAVED_ZONE: vLinkGenLinkerVarSectionName=OS_OsApplication_SystemApplication_Core0_VAR_SAVED_ZONE
          OS_OsApplication_SystemApplication_Core0_VAR_SAVED_ZONE_NOINIT: vLinkGenLinkerVarSectionName=OS_OsApplication_SystemApplication_Core0_VAR_SAVED_ZONE_NOINIT
          OS_OsApplication_SystemApplication_Core1_VAR_NOINIT: vLinkGenLinkerVarSectionName=OS_OsApplication_SystemApplication_Core1_VAR_NOINIT
          OS_OsApplication_SystemApplication_Core1_VAR: vLinkGenLinkerVarSectionName=OS_OsApplication_SystemApplication_Core1_VAR
          OS_OsApplication_SystemApplication_Core1_VAR_ZERO_INIT: vLinkGenLinkerVarSectionName=OS_OsApplication_SystemApplication_Core1_VAR_ZERO_INIT
          OS_OsApplication_SystemApplication_Core1_VAR_NOCACHE_NOINIT: vLinkGenLinkerVarSectionName=OS_OsApplication_SystemApplication_Core1_VAR_NOCACHE_NOINIT
          OS_OsApplication_SystemApplication_Core1_VAR_NOCACHE: vLinkGenLinkerVarSectionName=OS_OsApplication_SystemApplication_Core1_VAR_NOCACHE
          OS_OsApplication_SystemApplication_Core1_VAR_NOCACHE_ZERO_INIT: vLinkGenLinkerVarSectionName=OS_OsApplication_SystemApplication_Core1_VAR_NOCACHE_ZERO_INIT
          OS_OsApplication_SystemApplication_Core1_VAR_ZERO_INIT_bss: vLinkGenLinkerVarSectionName=OS_OsApplication_SystemApplication_Core1_VAR_ZERO_INIT_bss
          OS_OsApplication_SystemApplication_Core1_VAR_NOCACHE_ZERO_INIT_bss: vLinkGenLinkerVarSectionName=OS_OsApplication_SystemApplication_Core1_VAR_NOCACHE_ZERO_INIT_bss
          OS_OsApplication_SystemApplication_Core1_VAR_SAVED_ZONE: vLinkGenLinkerVarSectionName=OS_OsApplication_SystemApplication_Core1_VAR_SAVED_ZONE
          OS_OsApplication_SystemApplication_Core1_VAR_SAVED_ZONE_NOINIT: vLinkGenLinkerVarSectionName=OS_OsApplication_SystemApplication_Core1_VAR_SAVED_ZONE_NOINIT
        6 x vLinkGenLinkerConstSection, all with vLinkGenLinkerConstSectionFast=true, vLinkGenLinkerConstSectionAlignment=0, vLinkGenLinkerConstSectionModule=Os:
          OS_CONST_FAST: vLinkGenLinkerConstSectionName=OS_CONST_FAST
          OS_GLOBALSHARED_CONST_FAST: vLinkGenLinkerConstSectionName=OS_GLOBALSHARED_CONST_FAST
          OS_CORE0_CONST_FAST: vLinkGenLinkerConstSectionName=OS_CORE0_CONST_FAST
          OS_CORE1_CONST_FAST: vLinkGenLinkerConstSectionName=OS_CORE1_CONST_FAST
          OS_OsApplication_SystemApplication_Core0_CONST_FAST: vLinkGenLinkerConstSectionName=OS_OsApplication_SystemApplication_Core0_CONST_FAST
          OS_OsApplication_SystemApplication_Core1_CONST_FAST: vLinkGenLinkerConstSectionName=OS_OsApplication_SystemApplication_Core1_CONST_FAST
        46 x vLinkGenLinkerVarSection, all with vLinkGenLinkerVarSectionFast=true, vLinkGenLinkerVarSectionAlignment=0, vLinkGenLinkerVarSectionModule=Os:
          OS_VAR_FAST_NOCACHE: vLinkGenLinkerVarSectionName=OS_VAR_FAST_NOCACHE
          OS_VAR_FAST_NOCACHE_NOINIT: vLinkGenLinkerVarSectionName=OS_VAR_FAST_NOCACHE_NOINIT
          OS_GLOBALSHARED_VAR_FAST_NOINIT: vLinkGenLinkerVarSectionName=OS_GLOBALSHARED_VAR_FAST_NOINIT
          OS_GLOBALSHARED_VAR_FAST: vLinkGenLinkerVarSectionName=OS_GLOBALSHARED_VAR_FAST
          OS_GLOBALSHARED_VAR_FAST_ZERO_INIT: vLinkGenLinkerVarSectionName=OS_GLOBALSHARED_VAR_FAST_ZERO_INIT
          OS_GLOBALSHARED_VAR_FAST_NOCACHE_NOINIT: vLinkGenLinkerVarSectionName=OS_GLOBALSHARED_VAR_FAST_NOCACHE_NOINIT
          OS_GLOBALSHARED_VAR_FAST_NOCACHE: vLinkGenLinkerVarSectionName=OS_GLOBALSHARED_VAR_FAST_NOCACHE
          OS_GLOBALSHARED_VAR_FAST_NOCACHE_ZERO_INIT: vLinkGenLinkerVarSectionName=OS_GLOBALSHARED_VAR_FAST_NOCACHE_ZERO_INIT
          OS_GLOBALSHARED_VAR_FAST_ZERO_INIT_bss: vLinkGenLinkerVarSectionName=OS_GLOBALSHARED_VAR_FAST_ZERO_INIT_bss
          OS_GLOBALSHARED_VAR_FAST_NOCACHE_ZERO_INIT_bss: vLinkGenLinkerVarSectionName=OS_GLOBALSHARED_VAR_FAST_NOCACHE_ZERO_INIT_bss
          OS_GLOBALSHARED_VAR_FAST_SAVED_ZONE: vLinkGenLinkerVarSectionName=OS_GLOBALSHARED_VAR_FAST_SAVED_ZONE
          OS_GLOBALSHARED_VAR_FAST_SAVED_ZONE_NOINIT: vLinkGenLinkerVarSectionName=OS_GLOBALSHARED_VAR_FAST_SAVED_ZONE_NOINIT
          OS_CORESTATUS_CORE0_VAR_FAST_NOCACHE_NOINIT: vLinkGenLinkerVarSectionName=OS_CORESTATUS_CORE0_VAR_FAST_NOCACHE_NOINIT
          OS_CORE0_VAR_FAST: vLinkGenLinkerVarSectionName=OS_CORE0_VAR_FAST
          OS_CORE0_VAR_FAST_NOCACHE: vLinkGenLinkerVarSectionName=OS_CORE0_VAR_FAST_NOCACHE
          OS_CORE0_VAR_FAST_NOINIT: vLinkGenLinkerVarSectionName=OS_CORE0_VAR_FAST_NOINIT
          OS_CORE0_VAR_FAST_NOCACHE_NOINIT: vLinkGenLinkerVarSectionName=OS_CORE0_VAR_FAST_NOCACHE_NOINIT
          OS_PUBLIC_CORE0_VAR_FAST_NOINIT: vLinkGenLinkerVarSectionName=OS_PUBLIC_CORE0_VAR_FAST_NOINIT
          OS_BARRIER_CORE0_VAR_FAST_NOCACHE_NOINIT: vLinkGenLinkerVarSectionName=OS_BARRIER_CORE0_VAR_FAST_NOCACHE_NOINIT
          OS_CORESTATUS_CORE1_VAR_FAST_NOCACHE_NOINIT: vLinkGenLinkerVarSectionName=OS_CORESTATUS_CORE1_VAR_FAST_NOCACHE_NOINIT
          OS_CORE1_VAR_FAST: vLinkGenLinkerVarSectionName=OS_CORE1_VAR_FAST
          OS_CORE1_VAR_FAST_NOCACHE: vLinkGenLinkerVarSectionName=OS_CORE1_VAR_FAST_NOCACHE
          OS_CORE1_VAR_FAST_NOINIT: vLinkGenLinkerVarSectionName=OS_CORE1_VAR_FAST_NOINIT
          OS_CORE1_VAR_FAST_NOCACHE_NOINIT: vLinkGenLinkerVarSectionName=OS_CORE1_VAR_FAST_NOCACHE_NOINIT
          OS_PUBLIC_CORE1_VAR_FAST_NOINIT: vLinkGenLinkerVarSectionName=OS_PUBLIC_CORE1_VAR_FAST_NOINIT
          OS_BARRIER_CORE1_VAR_FAST_NOCACHE_NOINIT: vLinkGenLinkerVarSectionName=OS_BARRIER_CORE1_VAR_FAST_NOCACHE_NOINIT
          OS_OsApplication_SystemApplication_Core0_VAR_FAST_NOINIT: vLinkGenLinkerVarSectionName=OS_OsApplication_SystemApplication_Core0_VAR_FAST_NOINIT
          OS_OsApplication_SystemApplication_Core0_VAR_FAST: vLinkGenLinkerVarSectionName=OS_OsApplication_SystemApplication_Core0_VAR_FAST
          OS_OsApplication_SystemApplication_Core0_VAR_FAST_ZERO_INIT: vLinkGenLinkerVarSectionName=OS_OsApplication_SystemApplication_Core0_VAR_FAST_ZERO_INIT
          OS_OsApplication_SystemApplication_Core0_VAR_FAST_NOCACHE_NOINIT: vLinkGenLinkerVarSectionName=OS_OsApplication_SystemApplication_Core0_VAR_FAST_NOCACHE_NOINIT
          OS_OsApplication_SystemApplication_Core0_VAR_FAST_NOCACHE: vLinkGenLinkerVarSectionName=OS_OsApplication_SystemApplication_Core0_VAR_FAST_NOCACHE
          OS_OsApplication_SystemApplication_Core0_VAR_FAST_NOCACHE_ZERO_INIT: vLinkGenLinkerVarSectionName=OS_OsApplication_SystemApplication_Core0_VAR_FAST_NOCACHE_ZERO_INIT
          OS_OsApplication_SystemApplication_Core0_VAR_FAST_ZERO_INIT_bss: vLinkGenLinkerVarSectionName=OS_OsApplication_SystemApplication_Core0_VAR_FAST_ZERO_INIT_bss
          OS_OsApplication_SystemApplication_Core0_VAR_FAST_NOCACHE_ZERO_INIT_bss: vLinkGenLinkerVarSectionName=OS_OsApplication_SystemApplication_Core0_VAR_FAST_NOCACHE_ZERO_INIT_bss
          OS_OsApplication_SystemApplication_Core0_VAR_FAST_SAVED_ZONE: vLinkGenLinkerVarSectionName=OS_OsApplication_SystemApplication_Core0_VAR_FAST_SAVED_ZONE
          OS_OsApplication_SystemApplication_Core0_VAR_FAST_SAVED_ZONE_NOINIT: vLinkGenLinkerVarSectionName=OS_OsApplication_SystemApplication_Core0_VAR_FAST_SAVED_ZONE_NOINIT
          OS_OsApplication_SystemApplication_Core1_VAR_FAST_NOINIT: vLinkGenLinkerVarSectionName=OS_OsApplication_SystemApplication_Core1_VAR_FAST_NOINIT
          OS_OsApplication_SystemApplication_Core1_VAR_FAST: vLinkGenLinkerVarSectionName=OS_OsApplication_SystemApplication_Core1_VAR_FAST
          OS_OsApplication_SystemApplication_Core1_VAR_FAST_ZERO_INIT: vLinkGenLinkerVarSectionName=OS_OsApplication_SystemApplication_Core1_VAR_FAST_ZERO_INIT
          OS_OsApplication_SystemApplication_Core1_VAR_FAST_NOCACHE_NOINIT: vLinkGenLinkerVarSectionName=OS_OsApplication_SystemApplication_Core1_VAR_FAST_NOCACHE_NOINIT
          OS_OsApplication_SystemApplication_Core1_VAR_FAST_NOCACHE: vLinkGenLinkerVarSectionName=OS_OsApplication_SystemApplication_Core1_VAR_FAST_NOCACHE
          OS_OsApplication_SystemApplication_Core1_VAR_FAST_NOCACHE_ZERO_INIT: vLinkGenLinkerVarSectionName=OS_OsApplication_SystemApplication_Core1_VAR_FAST_NOCACHE_ZERO_INIT
          OS_OsApplication_SystemApplication_Core1_VAR_FAST_ZERO_INIT_bss: vLinkGenLinkerVarSectionName=OS_OsApplication_SystemApplication_Core1_VAR_FAST_ZERO_INIT_bss
          OS_OsApplication_SystemApplication_Core1_VAR_FAST_NOCACHE_ZERO_INIT_bss: vLinkGenLinkerVarSectionName=OS_OsApplication_SystemApplication_Core1_VAR_FAST_NOCACHE_ZERO_INIT_bss
          OS_OsApplication_SystemApplication_Core1_VAR_FAST_SAVED_ZONE: vLinkGenLinkerVarSectionName=OS_OsApplication_SystemApplication_Core1_VAR_FAST_SAVED_ZONE
          OS_OsApplication_SystemApplication_Core1_VAR_FAST_SAVED_ZONE_NOINIT: vLinkGenLinkerVarSectionName=OS_OsApplication_SystemApplication_Core1_VAR_FAST_SAVED_ZONE_NOINIT
        OS_Default_Appl_Task_CODE (vLinkGenLinkerCodeSection):
          vLinkGenLinkerCodeSectionName = OS_Default_Appl_Task_CODE
          vLinkGenLinkerCodeSectionFast = false
          vLinkGenLinkerCodeSectionAlignment = 0
          vLinkGenLinkerCodeSectionModule = Os
        OS_STACK_DEFAULT_APPL_TASK_VAR_NOINIT (vLinkGenLinkerStackSection): vLinkGenLinkerStackSectionName=OS_STACK_DEFAULT_APPL_TASK_VAR_NOINIT, vLinkGenLinkerStackSectionAlignment=8, vLinkGenLinkerStackSectionModule=Os
        OS_CORESHARED_0X00000003_VAR_NOCACHE_NOINIT (vLinkGenLinkerVarSection):
          vLinkGenLinkerVarSectionName = OS_CORESHARED_0X00000003_VAR_NOCACHE_NOINIT
          vLinkGenLinkerVarSectionFast = false
          vLinkGenLinkerVarSectionAlignment = 0
          vLinkGenLinkerVarSectionModule = Os
        OS_CORESHARED_0X00000003_VAR_FAST_NOCACHE_NOINIT (vLinkGenLinkerVarSection):
          vLinkGenLinkerVarSectionName = OS_CORESHARED_0X00000003_VAR_FAST_NOCACHE_NOINIT
          vLinkGenLinkerVarSectionFast = true
          vLinkGenLinkerVarSectionAlignment = 0
          vLinkGenLinkerVarSectionModule = Os
        3 x vLinkGenLinkerStackSection, all with vLinkGenLinkerStackSectionAlignment=8, vLinkGenLinkerStackSectionModule=Os:
          OS_STACK_DEFAULT_INIT_TASK_CORE1_VAR_NOINIT: vLinkGenLinkerStackSectionName=OS_STACK_DEFAULT_INIT_TASK_CORE1_VAR_NOINIT
          OS_STACK_DEFAULT_INIT_TASK_VAR_NOINIT: vLinkGenLinkerStackSectionName=OS_STACK_DEFAULT_INIT_TASK_VAR_NOINIT
          OS_STACK_DEFAULT_BSW_TASK_CORE1_VAR_NOINIT: vLinkGenLinkerStackSectionName=OS_STACK_DEFAULT_BSW_TASK_CORE1_VAR_NOINIT
        OS_vCan_30_Mcan_Isr_2_CODE (vLinkGenLinkerCodeSection):
          vLinkGenLinkerCodeSectionName = OS_vCan_30_Mcan_Isr_2_CODE
          vLinkGenLinkerCodeSectionFast = false
          vLinkGenLinkerCodeSectionAlignment = 0
          vLinkGenLinkerCodeSectionModule = Os
        OS_STACK_OSCORE0_TASK_PRIO40_VAR_NOINIT (vLinkGenLinkerStackSection):
          vLinkGenLinkerStackSectionName = OS_STACK_OSCORE0_TASK_PRIO40_VAR_NOINIT
          vLinkGenLinkerStackSectionAlignment = 8
          vLinkGenLinkerStackSectionModule = Os
        OS_vCan_30_Mcan_Isr_9_CODE (vLinkGenLinkerCodeSection):
          vLinkGenLinkerCodeSectionName = OS_vCan_30_Mcan_Isr_9_CODE
          vLinkGenLinkerCodeSectionFast = false
          vLinkGenLinkerCodeSectionAlignment = 0
          vLinkGenLinkerCodeSectionModule = Os
        OS_SHUTDOWNHOOK_CODE (vLinkGenLinkerCodeSection):
          vLinkGenLinkerCodeSectionName = OS_SHUTDOWNHOOK_CODE
          vLinkGenLinkerCodeSectionFast = false
          vLinkGenLinkerCodeSectionAlignment = 0
          vLinkGenLinkerCodeSectionModule = Os
        OS_STACK_OSCORE0_SHUTDOWN_VAR_NOINIT (vLinkGenLinkerStackSection): vLinkGenLinkerStackSectionName=OS_STACK_OSCORE0_SHUTDOWN_VAR_NOINIT, vLinkGenLinkerStackSectionAlignment=8, vLinkGenLinkerStackSectionModule=Os
        OS_STACK_OSCORE1_SHUTDOWN_VAR_NOINIT (vLinkGenLinkerStackSection): vLinkGenLinkerStackSectionName=OS_STACK_OSCORE1_SHUTDOWN_VAR_NOINIT, vLinkGenLinkerStackSectionAlignment=8, vLinkGenLinkerStackSectionModule=Os
      3 x vLinkGenLogicalConstGroup, all with vLinkGenConstGroupPosition=5, vLinkGenConstGroupRegion=PFlash0_Cached/PFlash0_Cached:
        MSR_CODE: vLinkGenConstGroupContentType=GLOBAL_CODE
          MSR_CODE (vLinkGenConstSectionGroup):
            vLinkGenConstSectionGroupPosition = 0
            vLinkGenConstSectionGroupInit = NONE
            vLinkGenConstSectionGroupInitStage = ONE
            vLinkGenConstSectionGroupFlag = vLinkGenConstGroupFlags/ORDERED
            vLinkGenConstSectionGroupFlag = vLinkGenConstGroupFlags/CONTIGUOUS
            vLinkGenConstSectionGroupFlag = vLinkGenConstGroupFlags/FILL
            vLinkGenConstSectionGroupFlag = vLinkGenConstGroupFlags/READ
            vLinkGenConstSectionGroupFlag = vLinkGenConstGroupFlags/EXECUTE
            vLinkGenConstSectionGroupRef = vLinkGenLinkerSections/MSR_CODE
        MSR_CONST: vLinkGenConstGroupContentType=GLOBAL_CONST
          MSR_CONST (vLinkGenConstSectionGroup):
            vLinkGenConstSectionGroupPosition = 0
            vLinkGenConstSectionGroupInit = NONE
            vLinkGenConstSectionGroupInitStage = ONE
            vLinkGenConstSectionGroupFlag = vLinkGenConstGroupFlags/ORDERED
            vLinkGenConstSectionGroupFlag = vLinkGenConstGroupFlags/CONTIGUOUS
            vLinkGenConstSectionGroupFlag = vLinkGenConstGroupFlags/FILL
            vLinkGenConstSectionGroupFlag = vLinkGenConstGroupFlags/READ
            vLinkGenConstSectionGroupFlag = vLinkGenConstGroupFlags/EXECUTE
            vLinkGenConstSectionGroupRef = vLinkGenLinkerSections/MSR_CONST
            vLinkGenConstSectionGroupRef = MSR_CONST_FAST
        MSR_PBCFG_CONST: vLinkGenConstGroupContentType=GLOBAL_CONST
          MSR_PBCFG_CONST (vLinkGenConstSectionGroup):
            vLinkGenConstSectionGroupPosition = 0
            vLinkGenConstSectionGroupInit = NONE
            vLinkGenConstSectionGroupInitStage = ONE
            vLinkGenConstSectionGroupFlag = vLinkGenConstGroupFlags/ORDERED
            vLinkGenConstSectionGroupFlag = vLinkGenConstGroupFlags/CONTIGUOUS
            vLinkGenConstSectionGroupFlag = vLinkGenConstGroupFlags/FILL
            vLinkGenConstSectionGroupFlag = vLinkGenConstGroupFlags/READ
            vLinkGenConstSectionGroupFlag = vLinkGenConstGroupFlags/EXECUTE
            vLinkGenConstSectionGroupRef = vLinkGenLinkerSections/MSR_PBCFG_CONST
            vLinkGenConstSectionGroupRef = MSR_PBCFG_CONST_FAST
      3 x vLinkGenLogicalVarGroup, all with vLinkGenVarGroupPosition=5, vLinkGenVarGroupInitCore=0, vLinkGenVarGroupRegion=DSPR_Core0/DSPR_Core0, vLinkGenVarGroupRomRegion=PFlash0_Cached/PFlash0_Cached:
        MSR_VAR: vLinkGenVarGroupContentType=GLOBAL_DATA
          3 x vLinkGenVarSectionGroup, all with vLinkGenVarSectionGroupPosition=0, vLinkGenVarSectionGroupInitStage=ONE, vLinkGenVarSectionGroupAlignment=16, vLinkGenVarSectionGroupFlag=vLinkGenVarGroupFlags/ORDERED, vLinkGenVarSectionGroupFlag=vLinkGenVarGroupFlags/CONTIGUOUS, vLinkGenVarSectionGroupFlag=vLinkGenVarGroupFlags/FILL, vLinkGenVarSectionGroupFlag=vLinkGenVarGroupFlags/READ, vLinkGenVarSectionGroupFlag=vLinkGenVarGroupFlags/WRITE:
            MSR_VAR_CLEARED: vLinkGenVarSectionGroupInit=ZERO_INIT, vLinkGenVarSectionGroupEndAlignment=4, vLinkGenVarSectionGroupRef=vLinkGenLinkerSections/MSR_VAR_CLEARED, vLinkGenVarSectionGroupRef=MSR_VAR_FAST_CLEARED
            MSR_VAR_INIT: vLinkGenVarSectionGroupInit=INIT, vLinkGenVarSectionGroupEndAlignment=4, vLinkGenVarSectionGroupRef=vLinkGenLinkerSections/MSR_VAR_INIT, vLinkGenVarSectionGroupRef=MSR_VAR_FAST_INIT
            MSR_VAR_NO_INIT: vLinkGenVarSectionGroupInit=NONE, vLinkGenVarSectionGroupRef=vLinkGenLinkerSections/MSR_VAR_NO_INIT, vLinkGenVarSectionGroupRef=MSR_VAR_FAST_NO_INIT
        MSR_PBCFG_VAR: vLinkGenVarGroupContentType=GLOBAL_DATA
          3 x vLinkGenVarSectionGroup, all with vLinkGenVarSectionGroupPosition=0, vLinkGenVarSectionGroupInitStage=ONE, vLinkGenVarSectionGroupAlignment=16, vLinkGenVarSectionGroupFlag=vLinkGenVarGroupFlags/ORDERED, vLinkGenVarSectionGroupFlag=vLinkGenVarGroupFlags/CONTIGUOUS, vLinkGenVarSectionGroupFlag=vLinkGenVarGroupFlags/FILL, vLinkGenVarSectionGroupFlag=vLinkGenVarGroupFlags/READ, vLinkGenVarSectionGroupFlag=vLinkGenVarGroupFlags/WRITE:
            MSR_PBCFG_VAR_INIT: vLinkGenVarSectionGroupInit=INIT, vLinkGenVarSectionGroupEndAlignment=4, vLinkGenVarSectionGroupRef=vLinkGenLinkerSections/MSR_PBCFG_VAR, vLinkGenVarSectionGroupRef=MSR_PBCFG_VAR_FAST
            MSR_PBCFG_VAR_NO_INIT: vLinkGenVarSectionGroupInit=NONE, vLinkGenVarSectionGroupRef=vLinkGenLinkerSections/MSR_PBCFG_VAR_NO_INIT, vLinkGenVarSectionGroupRef=MSR_PBCFG_VAR_FAST_NO_INIT
            MSR_PBCFG_VAR_CLEARED: vLinkGenVarSectionGroupInit=ZERO_INIT, vLinkGenVarSectionGroupEndAlignment=4, vLinkGenVarSectionGroupRef=vLinkGenLinkerSections/MSR_PBCFG_VAR_CLEARED, vLinkGenVarSectionGroupRef=MSR_PBCFG_VAR_FAST_CLEARED
        MSR_VAR_SAVED_ZONE: vLinkGenVarGroupContentType=RETENTION_DATA
          MSR_VAR_SAVED_ZONE_INIT (vLinkGenVarSectionGroup):
            vLinkGenVarSectionGroupInit = INIT
            vLinkGenVarSectionGroupPosition = 0
            vLinkGenVarSectionGroupInitStage = ONE
            vLinkGenVarSectionGroupAlignment = 16
            vLinkGenVarSectionGroupEndAlignment = 4
            vLinkGenVarSectionGroupFlag = vLinkGenVarGroupFlags/ORDERED
            vLinkGenVarSectionGroupFlag = vLinkGenVarGroupFlags/CONTIGUOUS
            vLinkGenVarSectionGroupFlag = vLinkGenVarGroupFlags/FILL
            vLinkGenVarSectionGroupFlag = vLinkGenVarGroupFlags/READ
            vLinkGenVarSectionGroupFlag = vLinkGenVarGroupFlags/WRITE
            vLinkGenVarSectionGroupRef = vLinkGenLinkerSections/MSR_VAR_SAVED_ZONE_INIT
            vLinkGenVarSectionGroupRef = MSR_VAR_SAVED_ZONE_FAST_INIT
          MSR_VAR_SAVED_ZONE_NO_INIT (vLinkGenVarSectionGroup):
            vLinkGenVarSectionGroupInit = NONE
            vLinkGenVarSectionGroupPosition = 0
            vLinkGenVarSectionGroupInitStage = ONE
            vLinkGenVarSectionGroupAlignment = 16
            vLinkGenVarSectionGroupFlag = vLinkGenVarGroupFlags/ORDERED
            vLinkGenVarSectionGroupFlag = vLinkGenVarGroupFlags/CONTIGUOUS
            vLinkGenVarSectionGroupFlag = vLinkGenVarGroupFlags/FILL
            vLinkGenVarSectionGroupFlag = vLinkGenVarGroupFlags/READ
            vLinkGenVarSectionGroupFlag = vLinkGenVarGroupFlags/WRITE
            vLinkGenVarSectionGroupRef = vLinkGenLinkerSections/MSR_VAR_SAVED_ZONE_NO_INIT
            vLinkGenVarSectionGroupRef = MSR_VAR_SAVED_ZONE_FAST_NO_INIT
      8 x vLinkGenMemoryRegion, all with vLinkGenMemoryRegionAddrOffset=0, vLinkGenMemoryRegionAvailable=true:
        DSPR_Core0: vLinkGenMemoryRegionSize=245760, vLinkGenMemoryRegionAddress=1879048192, vLinkGenMemoryRegionHwRegion=DSPR0
          3 x vLinkGenMemoryRegionBlock, all with vLinkGenMemoryRegionBlockInitStage=NONE:
            DSPR_Core0: vLinkGenMemoryRegionBlockCore=0, vLinkGenMemoryRegionBlockPosition=0, vLinkGenMemoryRegionBlockSize=208880, vLinkGenMemoryRegionBlockAddress=1879048192, vLinkGenMemoryRegionBlockBoundary=LOWER, vLinkGenMemoryRegionBlockContentType=GLOBAL_DATA, vLinkGenMemoryRegionBlockContentType=LOCAL_DATA, vLinkGenMemoryRegionBlockContentType=RAM_CODE_COPY, vLinkGenMemoryRegionBlockContentType=RAM_CONST_COPY, vLinkGenMemoryRegionBlockContentType=RETENTION_DATA, vLinkGenMemoryRegionBlockContentType=STACKS
            Variables_Shared: vLinkGenMemoryRegionBlockSize=16, vLinkGenMemoryRegionBlockBoundary=UPPER, vLinkGenMemoryRegionBlockPosition=0, vLinkGenMemoryRegionBlockAddress=1879257072, vLinkGenMemoryRegionBlockContentType=SHARED_DATA
            StartupStack_Shared: vLinkGenMemoryRegionBlockPosition=1, vLinkGenMemoryRegionBlockSize=36864, vLinkGenMemoryRegionBlockCore=0, vLinkGenMemoryRegionBlockBoundary=UPPER, vLinkGenMemoryRegionBlockAddress=1879257088, vLinkGenMemoryRegionBlockContentType=STARTUP_STACK
        DSPR_Core1: vLinkGenMemoryRegionSize=245760, vLinkGenMemoryRegionAddress=1610612736, vLinkGenMemoryRegionHwRegion=DSPR1
          DSPR_Core1 (vLinkGenMemoryRegionBlock):
            vLinkGenMemoryRegionBlockCore = 1
            vLinkGenMemoryRegionBlockPosition = 0
            vLinkGenMemoryRegionBlockSize = 245760
            vLinkGenMemoryRegionBlockAddress = 1610612736
            vLinkGenMemoryRegionBlockBoundary = LOWER
            vLinkGenMemoryRegionBlockInitStage = NONE
            vLinkGenMemoryRegionBlockContentType = LOCAL_DATA
            vLinkGenMemoryRegionBlockContentType = RAM_CODE_COPY
            vLinkGenMemoryRegionBlockContentType = RAM_CONST_COPY
            vLinkGenMemoryRegionBlockContentType = RETENTION_DATA
            vLinkGenMemoryRegionBlockContentType = STACKS
            vLinkGenMemoryRegionBlockContentType = STARTUP_STACK
        DSPR_Core2: vLinkGenMemoryRegionSize=98304, vLinkGenMemoryRegionAddress=1342177280, vLinkGenMemoryRegionHwRegion=DSPR2
          DSPR_Core2 (vLinkGenMemoryRegionBlock):
            vLinkGenMemoryRegionBlockCore = 2
            vLinkGenMemoryRegionBlockPosition = 0
            vLinkGenMemoryRegionBlockSize = 98304
            vLinkGenMemoryRegionBlockAddress = 1342177280
            vLinkGenMemoryRegionBlockBoundary = LOWER
            vLinkGenMemoryRegionBlockInitStage = NONE
            vLinkGenMemoryRegionBlockContentType = LOCAL_DATA
            vLinkGenMemoryRegionBlockContentType = RAM_CODE_COPY
            vLinkGenMemoryRegionBlockContentType = RAM_CONST_COPY
            vLinkGenMemoryRegionBlockContentType = RETENTION_DATA
            vLinkGenMemoryRegionBlockContentType = STACKS
            vLinkGenMemoryRegionBlockContentType = STARTUP_STACK
        DSPR_Core3: vLinkGenMemoryRegionSize=98304, vLinkGenMemoryRegionAddress=1073741824, vLinkGenMemoryRegionHwRegion=DSPR3
          DSPR_Core3 (vLinkGenMemoryRegionBlock):
            vLinkGenMemoryRegionBlockCore = 3
            vLinkGenMemoryRegionBlockPosition = 0
            vLinkGenMemoryRegionBlockSize = 98304
            vLinkGenMemoryRegionBlockAddress = 1073741824
            vLinkGenMemoryRegionBlockBoundary = LOWER
            vLinkGenMemoryRegionBlockInitStage = NONE
            vLinkGenMemoryRegionBlockContentType = LOCAL_DATA
            vLinkGenMemoryRegionBlockContentType = RAM_CODE_COPY
            vLinkGenMemoryRegionBlockContentType = RAM_CONST_COPY
            vLinkGenMemoryRegionBlockContentType = RETENTION_DATA
            vLinkGenMemoryRegionBlockContentType = STACKS
            vLinkGenMemoryRegionBlockContentType = STARTUP_STACK
        DSPR_Core4: vLinkGenMemoryRegionSize=98304, vLinkGenMemoryRegionAddress=805306368, vLinkGenMemoryRegionHwRegion=DSPR4
          DSPR_Core4 (vLinkGenMemoryRegionBlock):
            vLinkGenMemoryRegionBlockCore = 4
            vLinkGenMemoryRegionBlockPosition = 0
            vLinkGenMemoryRegionBlockSize = 98304
            vLinkGenMemoryRegionBlockAddress = 805306368
            vLinkGenMemoryRegionBlockBoundary = LOWER
            vLinkGenMemoryRegionBlockInitStage = NONE
            vLinkGenMemoryRegionBlockContentType = LOCAL_DATA
            vLinkGenMemoryRegionBlockContentType = RAM_CODE_COPY
            vLinkGenMemoryRegionBlockContentType = RAM_CONST_COPY
            vLinkGenMemoryRegionBlockContentType = RETENTION_DATA
            vLinkGenMemoryRegionBlockContentType = STACKS
            vLinkGenMemoryRegionBlockContentType = STARTUP_STACK
        DSPR_Core5: vLinkGenMemoryRegionSize=98304, vLinkGenMemoryRegionAddress=268435456, vLinkGenMemoryRegionHwRegion=DSPR5
          DSPR_Core5 (vLinkGenMemoryRegionBlock):
            vLinkGenMemoryRegionBlockCore = 5
            vLinkGenMemoryRegionBlockPosition = 0
            vLinkGenMemoryRegionBlockSize = 98304
            vLinkGenMemoryRegionBlockAddress = 268435456
            vLinkGenMemoryRegionBlockBoundary = LOWER
            vLinkGenMemoryRegionBlockInitStage = NONE
            vLinkGenMemoryRegionBlockContentType = LOCAL_DATA
            vLinkGenMemoryRegionBlockContentType = RAM_CODE_COPY
            vLinkGenMemoryRegionBlockContentType = RAM_CONST_COPY
            vLinkGenMemoryRegionBlockContentType = RETENTION_DATA
            vLinkGenMemoryRegionBlockContentType = STACKS
            vLinkGenMemoryRegionBlockContentType = STARTUP_STACK
        PFlash0_Cached: vLinkGenMemoryRegionSize=3145728, vLinkGenMemoryRegionAddress=2147483648, vLinkGenMemoryRegionHwRegion=PFlash0_Cached
          4 x vLinkGenMemoryRegionBlock, all with vLinkGenMemoryRegionBlockBoundary=LOWER, vLinkGenMemoryRegionBlockInitStage=NONE:
            StartupCode_FirstExecInst: vLinkGenMemoryRegionBlockSize=1280, vLinkGenMemoryRegionBlockPosition=0, vLinkGenMemoryRegionBlockAddress=2147483648, vLinkGenMemoryRegionBlockContentType=STARTUP_CODE
            CoreExceptions_FirstExecInst: vLinkGenMemoryRegionBlockPosition=2, vLinkGenMemoryRegionBlockSize=512, vLinkGenMemoryRegionBlockAddress=2147811328, vLinkGenMemoryRegionBlockContentType=GLOBAL_EXCVEC_CODE, vLinkGenMemoryRegionBlockContentType=GLOBAL_EXCVEC_CONST
            PFlash0_Cached: vLinkGenMemoryRegionBlockPosition=3, vLinkGenMemoryRegionBlockSize=2817536, vLinkGenMemoryRegionBlockAddress=2147811840, vLinkGenMemoryRegionBlockContentType=LOCAL_EXCVEC_CODE, vLinkGenMemoryRegionBlockContentType=LOCAL_EXCVEC_CONST, vLinkGenMemoryRegionBlockContentType=LOCAL_INTVEC_CODE, vLinkGenMemoryRegionBlockContentType=LOCAL_INTVEC_CONST, vLinkGenMemoryRegionBlockContentType=GLOBAL_INTVEC_CODE, vLinkGenMemoryRegionBlockContentType=GLOBAL_INTVEC_CONST, vLinkGenMemoryRegionBlockContentType=GLOBAL_CODE, vLinkGenMemoryRegionBlockContentType=GLOBAL_CONST, vLinkGenMemoryRegionBlockContentType=LOCAL_CODE, vLinkGenMemoryRegionBlockContentType=LOCAL_CONST, vLinkGenMemoryRegionBlockContentType=RAM_CODE, vLinkGenMemoryRegionBlockContentType=RAM_CONST
            PFlash0_vHSM_reserved: vLinkGenMemoryRegionBlockPosition=1, vLinkGenMemoryRegionBlockSize=326400, vLinkGenMemoryRegionBlockAddress=2147484928
        MemRegion_BMHD0: vLinkGenMemoryRegionSize=512, vLinkGenMemoryRegionAddress=2940207104, vLinkGenMemoryRegionHwRegion=BMHD0
          BMHD0 (vLinkGenMemoryRegionBlock):
            vLinkGenMemoryRegionBlockPosition = 0
            vLinkGenMemoryRegionBlockSize = 512
            vLinkGenMemoryRegionBlockAddress = 2940207104
            vLinkGenMemoryRegionBlockBoundary = LOWER
            vLinkGenMemoryRegionBlockInitStage = NONE
      BMHD0 (vLinkGenLogicalConstGroup): vLinkGenConstGroupPosition=5, vLinkGenConstGroupRegion=MemRegion_BMHD0/BMHD0
        BMHD0 (vLinkGenConstSectionGroup):
          vLinkGenConstSectionGroupPosition = 0
          vLinkGenConstSectionGroupInit = NONE
          vLinkGenConstSectionGroupInitStage = ONE
          vLinkGenConstSectionGroupFlag = vLinkGenConstGroupFlags/ORDERED
          vLinkGenConstSectionGroupFlag = vLinkGenConstGroupFlags/CONTIGUOUS
          vLinkGenConstSectionGroupFlag = vLinkGenConstGroupFlags/FILL
          vLinkGenConstSectionGroupFlag = vLinkGenConstGroupFlags/READ
          vLinkGenConstSectionGroupFlag = vLinkGenConstGroupFlags/EXECUTE
          vLinkGenConstSectionGroupRef = vLinkGenLinkerSections/BMHD0
      Brs_ExcVect (vLinkGenLogicalConstGroup): vLinkGenConstGroupPosition=1, vLinkGenConstGroupContentType=GLOBAL_EXCVEC_CONST, vLinkGenConstGroupRegion=CoreExceptions_FirstExecInst
        Brs_ExcVect (vLinkGenConstSectionGroup):
          vLinkGenConstSectionGroupAlignment = 256
          vLinkGenConstSectionGroupEndAlignment = 8
          vLinkGenConstSectionGroupGapSize = 16
          vLinkGenConstSectionGroupPosition = 0
          vLinkGenConstSectionGroupInit = NONE
          vLinkGenConstSectionGroupInitStage = ONE
          vLinkGenConstSectionGroupFlag = vLinkGenConstGroupFlags/ORDERED
          vLinkGenConstSectionGroupFlag = vLinkGenConstGroupFlags/CONTIGUOUS
          vLinkGenConstSectionGroupFlag = vLinkGenConstGroupFlags/FILL
          vLinkGenConstSectionGroupFlag = vLinkGenConstGroupFlags/READ
          vLinkGenConstSectionGroupFlag = vLinkGenConstGroupFlags/EXECUTE
          vLinkGenConstSectionGroupRef = brsExcVect
          vLinkGenConstSectionGroupRef = brsExcVectConst
      Startup_Labels (vLinkGenLogicalSymbolGroup): vLinkGenSymbolGroupPosition=5
        7 x vLinkGenLinkerSymbol, all with vLinkGenLinkerSymbolValue=brsStartupEntry, vLinkGenLinkerSymbolPosition=0:
          Startup_Labels1: vLinkGenLinkerSymbolName=StartupEntry
          Startup_Labels2: vLinkGenLinkerSymbolName=_start_tc0
          Startup_Labels3: vLinkGenLinkerSymbolName=_start_tc1
          Startup_Labels4: vLinkGenLinkerSymbolName=_start_tc2
          Startup_Labels5: vLinkGenLinkerSymbolName=_start_tc3
          Startup_Labels6: vLinkGenLinkerSymbolName=_start_tc4
          Startup_Labels7: vLinkGenLinkerSymbolName=_start_tc5
      HEAPWORKAROUNDLABEL (vLinkGenLogicalSymbolGroup): vLinkGenSymbolGroupPosition=5
        HeapWorkaroundLabel (vLinkGenLinkerSymbol): vLinkGenLinkerSymbolName=__HEAP, vLinkGenLinkerSymbolValue=8, vLinkGenLinkerSymbolPosition=0
        HeapWorkaroundLabelEnd (vLinkGenLinkerSymbol): vLinkGenLinkerSymbolName=__HEAP_END, vLinkGenLinkerSymbolValue=8, vLinkGenLinkerSymbolPosition=0
      Brs_Startup_Code (vLinkGenLogicalConstGroup): vLinkGenConstGroupPosition=1, vLinkGenConstGroupContentType=STARTUP_CODE, vLinkGenConstGroupRegion=StartupCode_FirstExecInst
        3 x vLinkGenConstSectionGroup, all with vLinkGenConstSectionGroupPosition=0, vLinkGenConstSectionGroupInit=NONE, vLinkGenConstSectionGroupInitStage=ONE, vLinkGenConstSectionGroupFlag=vLinkGenConstGroupFlags/ORDERED, vLinkGenConstSectionGroupFlag=vLinkGenConstGroupFlags/CONTIGUOUS, vLinkGenConstSectionGroupFlag=vLinkGenConstGroupFlags/FILL, vLinkGenConstSectionGroupFlag=vLinkGenConstGroupFlags/READ, vLinkGenConstSectionGroupFlag=vLinkGenConstGroupFlags/EXECUTE:
          Brs_Startup_Code: vLinkGenConstSectionGroupRef=brsStartup
          BrsMain_Startup_Code: vLinkGenConstSectionGroupRef=brsMainStartup
          Brs_Startup_Entry: vLinkGenConstSectionGroupRef=brsStartupEntry
      Brs_Shared_Const (vLinkGenLogicalConstGroup): vLinkGenConstGroupPosition=5, vLinkGenConstGroupContentType=GLOBAL_CONST, vLinkGenConstGroupRegion=PFlash0_Cached/PFlash0_Cached
        Brs_Shared_Const (vLinkGenConstSectionGroup):
          vLinkGenConstSectionGroupPosition = 0
          vLinkGenConstSectionGroupInit = NONE
          vLinkGenConstSectionGroupInitStage = ONE
          vLinkGenConstSectionGroupFlag = vLinkGenConstGroupFlags/ORDERED
          vLinkGenConstSectionGroupFlag = vLinkGenConstGroupFlags/CONTIGUOUS
          vLinkGenConstSectionGroupFlag = vLinkGenConstGroupFlags/FILL
          vLinkGenConstSectionGroupFlag = vLinkGenConstGroupFlags/READ
          vLinkGenConstSectionGroupFlag = vLinkGenConstGroupFlags/EXECUTE
          vLinkGenConstSectionGroupRef = brsSharedConst
      Brs_Shared_Var (vLinkGenLogicalVarGroup): vLinkGenVarGroupPosition=5, vLinkGenVarGroupContentType=SHARED_DATA, vLinkGenVarGroupRegion=Variables_Shared
        Brs_Shared_Var (vLinkGenVarSectionGroup):
          vLinkGenVarSectionGroupPosition = 0
          vLinkGenVarSectionGroupInit = NONE
          vLinkGenVarSectionGroupInitStage = ONE
          vLinkGenVarSectionGroupAlignment = 16
          vLinkGenVarSectionGroupFlag = vLinkGenVarGroupFlags/ORDERED
          vLinkGenVarSectionGroupFlag = vLinkGenVarGroupFlags/CONTIGUOUS
          vLinkGenVarSectionGroupFlag = vLinkGenVarGroupFlags/FILL
          vLinkGenVarSectionGroupFlag = vLinkGenVarGroupFlags/READ
          vLinkGenVarSectionGroupFlag = vLinkGenVarGroupFlags/WRITE
          vLinkGenVarSectionGroupRef = brsSharedVar
      Const_Default (vLinkGenLogicalConstGroup): vLinkGenConstGroupPosition=1000, vLinkGenConstGroupContentType=GLOBAL_CONST, vLinkGenConstGroupRegion=PFlash0_Cached/PFlash0_Cached
        3 x vLinkGenConstSectionGroup, all with vLinkGenConstSectionGroupPosition=0, vLinkGenConstSectionGroupInit=NONE, vLinkGenConstSectionGroupInitStage=ONE, vLinkGenConstSectionGroupFlag=vLinkGenConstGroupFlags/ORDERED, vLinkGenConstSectionGroupFlag=vLinkGenConstGroupFlags/CONTIGUOUS, vLinkGenConstSectionGroupFlag=vLinkGenConstGroupFlags/FILL, vLinkGenConstSectionGroupFlag=vLinkGenConstGroupFlags/READ, vLinkGenConstSectionGroupFlag=vLinkGenConstGroupFlags/EXECUTE:
          text: vLinkGenConstSectionGroupRef=vLinkGenLinkerSections/text
          rodata: vLinkGenConstSectionGroupRef=vLinkGenLinkerSections/rodata
          zrodata: vLinkGenConstSectionGroupRef=vLinkGenLinkerSections/zrodata
      Data_Default (vLinkGenLogicalVarGroup):
        vLinkGenVarGroupPosition = 1000
        vLinkGenVarGroupInitCore = 0
        vLinkGenVarGroupContentType = GLOBAL_DATA
        vLinkGenVarGroupRegion = DSPR_Core0/DSPR_Core0
        vLinkGenVarGroupRomRegion = PFlash0_Cached/PFlash0_Cached
        4 x vLinkGenVarSectionGroup, all with vLinkGenVarSectionGroupPosition=0, vLinkGenVarSectionGroupInitStage=ONE, vLinkGenVarSectionGroupAlignment=16, vLinkGenVarSectionGroupEndAlignment=4, vLinkGenVarSectionGroupFlag=vLinkGenVarGroupFlags/ORDERED, vLinkGenVarSectionGroupFlag=vLinkGenVarGroupFlags/CONTIGUOUS, vLinkGenVarSectionGroupFlag=vLinkGenVarGroupFlags/FILL, vLinkGenVarSectionGroupFlag=vLinkGenVarGroupFlags/READ, vLinkGenVarSectionGroupFlag=vLinkGenVarGroupFlags/WRITE:
          data: vLinkGenVarSectionGroupInit=INIT, vLinkGenVarSectionGroupRef=vLinkGenLinkerSections/data
          zdata: vLinkGenVarSectionGroupInit=INIT, vLinkGenVarSectionGroupRef=vLinkGenLinkerSections/zdata
          bss: vLinkGenVarSectionGroupInit=ZERO_INIT, vLinkGenVarSectionGroupRef=vLinkGenLinkerSections/bss
          zbss: vLinkGenVarSectionGroupInit=ZERO_INIT, vLinkGenVarSectionGroupRef=vLinkGenLinkerSections/zbss
      14 x vLinkGenLogicalConstGroup, all with vLinkGenConstGroupPosition=5, vLinkGenConstGroupRegion=PFlash0_Cached/PFlash0_Cached, vLinkGenConstGroupModule=Os:
        OS_CODE: vLinkGenConstGroupContentType=GLOBAL_CODE
          OS_CODE (vLinkGenConstSectionGroup):
            vLinkGenConstSectionGroupPosition = 0
            vLinkGenConstSectionGroupInit = NONE
            vLinkGenConstSectionGroupInitStage = ONE
            vLinkGenConstSectionGroupGapSize = 16
            vLinkGenConstSectionGroupFlag = vLinkGenConstGroupFlags/ORDERED
            vLinkGenConstSectionGroupFlag = vLinkGenConstGroupFlags/CONTIGUOUS
            vLinkGenConstSectionGroupFlag = vLinkGenConstGroupFlags/FILL
            vLinkGenConstSectionGroupFlag = vLinkGenConstGroupFlags/READ
            vLinkGenConstSectionGroupFlag = vLinkGenConstGroupFlags/EXECUTE
            vLinkGenConstSectionGroupRef = vLinkGenLinkerSections/OS_CODE
            vLinkGenConstSectionGroupRef = OS_OS_COREINITHOOK_CODE
        OS_USER_CODE: vLinkGenConstGroupContentType=GLOBAL_CODE
          OS_USER_CODE (vLinkGenConstSectionGroup):
            vLinkGenConstSectionGroupPosition = 0
            vLinkGenConstSectionGroupInit = NONE
            vLinkGenConstSectionGroupInitStage = ONE
            vLinkGenConstSectionGroupGapSize = 16
            vLinkGenConstSectionGroupFlag = vLinkGenConstGroupFlags/ORDERED
            vLinkGenConstSectionGroupFlag = vLinkGenConstGroupFlags/CONTIGUOUS
            vLinkGenConstSectionGroupFlag = vLinkGenConstGroupFlags/FILL
            vLinkGenConstSectionGroupFlag = vLinkGenConstGroupFlags/READ
            vLinkGenConstSectionGroupFlag = vLinkGenConstGroupFlags/EXECUTE
            vLinkGenConstSectionGroupRef = OS_ERRORHOOK_CODE
            vLinkGenConstSectionGroupRef = OS_Default_Init_Task_Core1_Trusted_CODE
            vLinkGenConstSectionGroupRef = OS_Default_BSW_Async_Task_CODE
            vLinkGenConstSectionGroupRef = OS_StartApplication_Appl_Init_Task_CODE
            vLinkGenConstSectionGroupRef = OS_Default_Init_Task_CODE
            vLinkGenConstSectionGroupRef = OS_StartApplication_Appl_Task_CODE
            vLinkGenConstSectionGroupRef = OS_Default_BSW_Sync_Task_CODE
            vLinkGenConstSectionGroupRef = OS_StartApplication_NoSwc_Appl_Task_CODE
            vLinkGenConstSectionGroupRef = OS_Default_RTE_Mode_switch_Task_CODE
            vLinkGenConstSectionGroupRef = OS_StartApplication_NoSwc_Init_Task_CODE
            vLinkGenConstSectionGroupRef = OS_Default_Init_Task_Core1_CODE
            vLinkGenConstSectionGroupRef = OS_BswBackgroundTask_CODE
            vLinkGenConstSectionGroupRef = OS_Default_Init_Task_Trusted_CODE
            vLinkGenConstSectionGroupRef = OS_Default_BSW_Task_Core1_CODE
            vLinkGenConstSectionGroupRef = OS_Default_Appl_Init_Task_CODE
            vLinkGenConstSectionGroupRef = OS_Default_Appl_Task_CODE
            vLinkGenConstSectionGroupRef = OS_vCan_30_Mcan_Isr_2_CODE
            vLinkGenConstSectionGroupRef = OS_vCan_30_Mcan_Isr_9_CODE
            vLinkGenConstSectionGroupRef = OS_SHUTDOWNHOOK_CODE
        OS_EXCVEC_CORE0_CODE: vLinkGenConstGroupCore=0, vLinkGenConstGroupContentType=LOCAL_EXCVEC_CODE
          OS_EXCVEC_CORE0_CODE (vLinkGenConstSectionGroup):
            vLinkGenConstSectionGroupPosition = 0
            vLinkGenConstSectionGroupInit = NONE
            vLinkGenConstSectionGroupInitStage = ONE
            vLinkGenConstSectionGroupGapSize = 16
            vLinkGenConstSectionGroupAlignment = 256
            vLinkGenConstSectionGroupEndAlignment = 8
            vLinkGenConstSectionGroupFlag = vLinkGenConstGroupFlags/ORDERED
            vLinkGenConstSectionGroupFlag = vLinkGenConstGroupFlags/CONTIGUOUS
            vLinkGenConstSectionGroupFlag = vLinkGenConstGroupFlags/FILL
            vLinkGenConstSectionGroupFlag = vLinkGenConstGroupFlags/READ
            vLinkGenConstSectionGroupFlag = vLinkGenConstGroupFlags/EXECUTE
            vLinkGenConstSectionGroupRef = vLinkGenLinkerSections/OS_EXCVEC_CORE0_CODE
        OS_EXCVEC_CORE1_CODE: vLinkGenConstGroupCore=1, vLinkGenConstGroupContentType=LOCAL_EXCVEC_CODE
          OS_EXCVEC_CORE1_CODE (vLinkGenConstSectionGroup):
            vLinkGenConstSectionGroupPosition = 0
            vLinkGenConstSectionGroupInit = NONE
            vLinkGenConstSectionGroupInitStage = ONE
            vLinkGenConstSectionGroupGapSize = 16
            vLinkGenConstSectionGroupAlignment = 256
            vLinkGenConstSectionGroupEndAlignment = 8
            vLinkGenConstSectionGroupFlag = vLinkGenConstGroupFlags/ORDERED
            vLinkGenConstSectionGroupFlag = vLinkGenConstGroupFlags/CONTIGUOUS
            vLinkGenConstSectionGroupFlag = vLinkGenConstGroupFlags/FILL
            vLinkGenConstSectionGroupFlag = vLinkGenConstGroupFlags/READ
            vLinkGenConstSectionGroupFlag = vLinkGenConstGroupFlags/EXECUTE
            vLinkGenConstSectionGroupRef = vLinkGenLinkerSections/OS_EXCVEC_CORE1_CODE
        OS_INTVEC_CORE0_CODE: vLinkGenConstGroupCore=0, vLinkGenConstGroupContentType=LOCAL_INTVEC_CODE
          OS_INTVEC_CORE0_CODE (vLinkGenConstSectionGroup):
            vLinkGenConstSectionGroupPosition = 0
            vLinkGenConstSectionGroupInit = NONE
            vLinkGenConstSectionGroupInitStage = ONE
            vLinkGenConstSectionGroupGapSize = 16
            vLinkGenConstSectionGroupAlignment = 8192
            vLinkGenConstSectionGroupEndAlignment = 8
            vLinkGenConstSectionGroupFlag = vLinkGenConstGroupFlags/ORDERED
            vLinkGenConstSectionGroupFlag = vLinkGenConstGroupFlags/CONTIGUOUS
            vLinkGenConstSectionGroupFlag = vLinkGenConstGroupFlags/FILL
            vLinkGenConstSectionGroupFlag = vLinkGenConstGroupFlags/READ
            vLinkGenConstSectionGroupFlag = vLinkGenConstGroupFlags/EXECUTE
            vLinkGenConstSectionGroupRef = vLinkGenLinkerSections/OS_INTVEC_CORE0_CODE
        OS_INTVEC_CORE1_CODE: vLinkGenConstGroupCore=1, vLinkGenConstGroupContentType=LOCAL_INTVEC_CODE
          OS_INTVEC_CORE1_CODE (vLinkGenConstSectionGroup):
            vLinkGenConstSectionGroupPosition = 0
            vLinkGenConstSectionGroupInit = NONE
            vLinkGenConstSectionGroupInitStage = ONE
            vLinkGenConstSectionGroupGapSize = 16
            vLinkGenConstSectionGroupAlignment = 8192
            vLinkGenConstSectionGroupEndAlignment = 8
            vLinkGenConstSectionGroupFlag = vLinkGenConstGroupFlags/ORDERED
            vLinkGenConstSectionGroupFlag = vLinkGenConstGroupFlags/CONTIGUOUS
            vLinkGenConstSectionGroupFlag = vLinkGenConstGroupFlags/FILL
            vLinkGenConstSectionGroupFlag = vLinkGenConstGroupFlags/READ
            vLinkGenConstSectionGroupFlag = vLinkGenConstGroupFlags/EXECUTE
            vLinkGenConstSectionGroupRef = vLinkGenLinkerSections/OS_INTVEC_CORE1_CODE
        OS_INTVEC_CODE: vLinkGenConstGroupContentType=GLOBAL_INTVEC_CODE
          OS_INTVEC_CODE (vLinkGenConstSectionGroup):
            vLinkGenConstSectionGroupPosition = 0
            vLinkGenConstSectionGroupInit = NONE
            vLinkGenConstSectionGroupInitStage = ONE
            vLinkGenConstSectionGroupGapSize = 16
            vLinkGenConstSectionGroupAlignment = 8192
            vLinkGenConstSectionGroupEndAlignment = 8
            vLinkGenConstSectionGroupFlag = vLinkGenConstGroupFlags/ORDERED
            vLinkGenConstSectionGroupFlag = vLinkGenConstGroupFlags/CONTIGUOUS
            vLinkGenConstSectionGroupFlag = vLinkGenConstGroupFlags/FILL
            vLinkGenConstSectionGroupFlag = vLinkGenConstGroupFlags/READ
            vLinkGenConstSectionGroupFlag = vLinkGenConstGroupFlags/EXECUTE
            vLinkGenConstSectionGroupRef = vLinkGenLinkerSections/OS_INTVEC_CODE
        OS_CONST: vLinkGenConstGroupContentType=GLOBAL_CONST
          OS_CONST (vLinkGenConstSectionGroup):
            vLinkGenConstSectionGroupPosition = 0
            vLinkGenConstSectionGroupInit = NONE
            vLinkGenConstSectionGroupInitStage = ONE
            vLinkGenConstSectionGroupGapSize = 16
            vLinkGenConstSectionGroupFlag = vLinkGenConstGroupFlags/ORDERED
            vLinkGenConstSectionGroupFlag = vLinkGenConstGroupFlags/CONTIGUOUS
            vLinkGenConstSectionGroupFlag = vLinkGenConstGroupFlags/FILL
            vLinkGenConstSectionGroupFlag = vLinkGenConstGroupFlags/READ
            vLinkGenConstSectionGroupFlag = vLinkGenConstGroupFlags/EXECUTE
            vLinkGenConstSectionGroupRef = vLinkGenLinkerSections/OS_CONST
            vLinkGenConstSectionGroupRef = OS_CORE0_CONST
            vLinkGenConstSectionGroupRef = OS_CORE1_CONST
            vLinkGenConstSectionGroupRef = OS_OsApplication_SystemApplication_Core0_CONST
            vLinkGenConstSectionGroupRef = OS_OsApplication_SystemApplication_Core1_CONST
            vLinkGenConstSectionGroupRef = OS_CONST_FAST
            vLinkGenConstSectionGroupRef = OS_CORE0_CONST_FAST
            vLinkGenConstSectionGroupRef = OS_CORE1_CONST_FAST
            vLinkGenConstSectionGroupRef = OS_OsApplication_SystemApplication_Core0_CONST_FAST
            vLinkGenConstSectionGroupRef = OS_OsApplication_SystemApplication_Core1_CONST_FAST
        OS_GLOBALSHARED_CONST: vLinkGenConstGroupContentType=GLOBAL_CONST
          OS_GLOBALSHARED_CONST (vLinkGenConstSectionGroup):
            vLinkGenConstSectionGroupPosition = 0
            vLinkGenConstSectionGroupInit = NONE
            vLinkGenConstSectionGroupInitStage = ONE
            vLinkGenConstSectionGroupGapSize = 16
            vLinkGenConstSectionGroupFlag = vLinkGenConstGroupFlags/ORDERED
            vLinkGenConstSectionGroupFlag = vLinkGenConstGroupFlags/CONTIGUOUS
            vLinkGenConstSectionGroupFlag = vLinkGenConstGroupFlags/FILL
            vLinkGenConstSectionGroupFlag = vLinkGenConstGroupFlags/READ
            vLinkGenConstSectionGroupFlag = vLinkGenConstGroupFlags/EXECUTE
            vLinkGenConstSectionGroupRef = vLinkGenLinkerSections/OS_GLOBALSHARED_CONST
            vLinkGenConstSectionGroupRef = OS_GLOBALSHARED_CONST_FAST
        OS_INTVEC_CONST: vLinkGenConstGroupContentType=GLOBAL_INTVEC_CONST
          OS_INTVEC_CONST (vLinkGenConstSectionGroup):
            vLinkGenConstSectionGroupPosition = 0
            vLinkGenConstSectionGroupInit = NONE
            vLinkGenConstSectionGroupInitStage = ONE
            vLinkGenConstSectionGroupGapSize = 16
            vLinkGenConstSectionGroupAlignment = 8192
            vLinkGenConstSectionGroupEndAlignment = 8
            vLinkGenConstSectionGroupFlag = vLinkGenConstGroupFlags/ORDERED
            vLinkGenConstSectionGroupFlag = vLinkGenConstGroupFlags/CONTIGUOUS
            vLinkGenConstSectionGroupFlag = vLinkGenConstGroupFlags/FILL
            vLinkGenConstSectionGroupFlag = vLinkGenConstGroupFlags/READ
            vLinkGenConstSectionGroupFlag = vLinkGenConstGroupFlags/EXECUTE
            vLinkGenConstSectionGroupRef = vLinkGenLinkerSections/OS_INTVEC_CONST
        OS_EXCVEC_CORE0_CONST: vLinkGenConstGroupCore=0, vLinkGenConstGroupContentType=LOCAL_EXCVEC_CONST
          OS_EXCVEC_CORE0_CONST (vLinkGenConstSectionGroup):
            vLinkGenConstSectionGroupPosition = 0
            vLinkGenConstSectionGroupInit = NONE
            vLinkGenConstSectionGroupInitStage = ONE
            vLinkGenConstSectionGroupGapSize = 16
            vLinkGenConstSectionGroupAlignment = 256
            vLinkGenConstSectionGroupEndAlignment = 8
            vLinkGenConstSectionGroupFlag = vLinkGenConstGroupFlags/ORDERED
            vLinkGenConstSectionGroupFlag = vLinkGenConstGroupFlags/CONTIGUOUS
            vLinkGenConstSectionGroupFlag = vLinkGenConstGroupFlags/FILL
            vLinkGenConstSectionGroupFlag = vLinkGenConstGroupFlags/READ
            vLinkGenConstSectionGroupFlag = vLinkGenConstGroupFlags/EXECUTE
            vLinkGenConstSectionGroupRef = vLinkGenLinkerSections/OS_EXCVEC_CORE0_CONST
        OS_EXCVEC_CORE1_CONST: vLinkGenConstGroupCore=1, vLinkGenConstGroupContentType=LOCAL_EXCVEC_CONST
          OS_EXCVEC_CORE1_CONST (vLinkGenConstSectionGroup):
            vLinkGenConstSectionGroupPosition = 0
            vLinkGenConstSectionGroupInit = NONE
            vLinkGenConstSectionGroupInitStage = ONE
            vLinkGenConstSectionGroupGapSize = 16
            vLinkGenConstSectionGroupAlignment = 256
            vLinkGenConstSectionGroupEndAlignment = 8
            vLinkGenConstSectionGroupFlag = vLinkGenConstGroupFlags/ORDERED
            vLinkGenConstSectionGroupFlag = vLinkGenConstGroupFlags/CONTIGUOUS
            vLinkGenConstSectionGroupFlag = vLinkGenConstGroupFlags/FILL
            vLinkGenConstSectionGroupFlag = vLinkGenConstGroupFlags/READ
            vLinkGenConstSectionGroupFlag = vLinkGenConstGroupFlags/EXECUTE
            vLinkGenConstSectionGroupRef = vLinkGenLinkerSections/OS_EXCVEC_CORE1_CONST
        OS_INTVEC_CORE0_CONST: vLinkGenConstGroupCore=0, vLinkGenConstGroupContentType=LOCAL_INTVEC_CONST
          OS_INTVEC_CORE0_CONST (vLinkGenConstSectionGroup):
            vLinkGenConstSectionGroupPosition = 0
            vLinkGenConstSectionGroupInit = NONE
            vLinkGenConstSectionGroupInitStage = ONE
            vLinkGenConstSectionGroupGapSize = 16
            vLinkGenConstSectionGroupAlignment = 8192
            vLinkGenConstSectionGroupEndAlignment = 8
            vLinkGenConstSectionGroupFlag = vLinkGenConstGroupFlags/ORDERED
            vLinkGenConstSectionGroupFlag = vLinkGenConstGroupFlags/CONTIGUOUS
            vLinkGenConstSectionGroupFlag = vLinkGenConstGroupFlags/FILL
            vLinkGenConstSectionGroupFlag = vLinkGenConstGroupFlags/READ
            vLinkGenConstSectionGroupFlag = vLinkGenConstGroupFlags/EXECUTE
            vLinkGenConstSectionGroupRef = vLinkGenLinkerSections/OS_INTVEC_CORE0_CONST
        OS_INTVEC_CORE1_CONST: vLinkGenConstGroupCore=1, vLinkGenConstGroupContentType=LOCAL_INTVEC_CONST
          OS_INTVEC_CORE1_CONST (vLinkGenConstSectionGroup):
            vLinkGenConstSectionGroupPosition = 0
            vLinkGenConstSectionGroupInit = NONE
            vLinkGenConstSectionGroupInitStage = ONE
            vLinkGenConstSectionGroupGapSize = 16
            vLinkGenConstSectionGroupAlignment = 8192
            vLinkGenConstSectionGroupEndAlignment = 8
            vLinkGenConstSectionGroupFlag = vLinkGenConstGroupFlags/ORDERED
            vLinkGenConstSectionGroupFlag = vLinkGenConstGroupFlags/CONTIGUOUS
            vLinkGenConstSectionGroupFlag = vLinkGenConstGroupFlags/FILL
            vLinkGenConstSectionGroupFlag = vLinkGenConstGroupFlags/READ
            vLinkGenConstSectionGroupFlag = vLinkGenConstGroupFlags/EXECUTE
            vLinkGenConstSectionGroupRef = vLinkGenLinkerSections/OS_INTVEC_CORE1_CONST
      9 x vLinkGenLogicalVarGroup:
        OS_STACKS_CORE0_VAR: vLinkGenVarGroupPosition=0, vLinkGenVarGroupCore=0, vLinkGenVarGroupRegion=DSPR_Core0/DSPR_Core0, vLinkGenVarGroupModule=Os, vLinkGenVarGroupContentType=STACKS
          OS_STACKS_CORE0_VAR_NOINIT (vLinkGenVarSectionGroup):
            vLinkGenVarSectionGroupPosition = 0
            vLinkGenVarSectionGroupInit = NONE
            vLinkGenVarSectionGroupInitStage = ONE
            vLinkGenVarSectionGroupGapSize = 16
            vLinkGenVarSectionGroupAlignment = 16
            vLinkGenVarSectionGroupFlag = vLinkGenVarGroupFlags/ORDERED
            vLinkGenVarSectionGroupFlag = vLinkGenVarGroupFlags/CONTIGUOUS
            vLinkGenVarSectionGroupFlag = vLinkGenVarGroupFlags/FILL
            vLinkGenVarSectionGroupFlag = vLinkGenVarGroupFlags/READ
            vLinkGenVarSectionGroupFlag = vLinkGenVarGroupFlags/WRITE
            vLinkGenVarSectionGroupRef = OS_STACK_OSCORE0_ERROR_VAR_NOINIT
            vLinkGenVarSectionGroupRef = OS_STACK_OSCORE0_INIT_VAR_NOINIT
            vLinkGenVarSectionGroupRef = OS_STACK_OSCORE0_KERNEL_VAR_NOINIT
            vLinkGenVarSectionGroupRef = OS_STACK_OSCORE0_ISR_CORE_VAR_NOINIT
            vLinkGenVarSectionGroupRef = OS_STACK_DEFAULT_BSW_ASYNC_TASK_VAR_NOINIT
            vLinkGenVarSectionGroupRef = OS_STACK_OSCORE0_TASK_PRIO10_VAR_NOINIT
            vLinkGenVarSectionGroupRef = OS_STACK_OSCORE0_TASK_PRIO4294967295_VAR_NOINIT
            vLinkGenVarSectionGroupRef = OS_STACK_OSCORE0_TASK_PRIO45_VAR_NOINIT
            vLinkGenVarSectionGroupRef = OS_STACK_OSCORE0_TASK_PRIO5_VAR_NOINIT
            vLinkGenVarSectionGroupRef = OS_STACK_STARTAPPLICATION_NOSWC_APPL_TASK_VAR_NOINIT
            vLinkGenVarSectionGroupRef = OS_STACK_OSCORE0_TASK_PRIO0_VAR_NOINIT
            vLinkGenVarSectionGroupRef = OS_STACK_OSCORE0_TASK_PRIO49_VAR_NOINIT
            vLinkGenVarSectionGroupRef = OS_STACK_DEFAULT_APPL_TASK_VAR_NOINIT
            vLinkGenVarSectionGroupRef = OS_STACK_DEFAULT_INIT_TASK_VAR_NOINIT
            vLinkGenVarSectionGroupRef = OS_STACK_OSCORE0_TASK_PRIO40_VAR_NOINIT
            vLinkGenVarSectionGroupRef = OS_STACK_OSCORE0_SHUTDOWN_VAR_NOINIT
        OS_STACKS_CORE1_VAR: vLinkGenVarGroupPosition=0, vLinkGenVarGroupCore=1, vLinkGenVarGroupRegion=DSPR_Core1/DSPR_Core1, vLinkGenVarGroupModule=Os, vLinkGenVarGroupContentType=STACKS
          OS_STACKS_CORE1_VAR_NOINIT (vLinkGenVarSectionGroup):
            vLinkGenVarSectionGroupPosition = 0
            vLinkGenVarSectionGroupInit = NONE
            vLinkGenVarSectionGroupInitStage = ONE
            vLinkGenVarSectionGroupGapSize = 16
            vLinkGenVarSectionGroupAlignment = 16
            vLinkGenVarSectionGroupFlag = vLinkGenVarGroupFlags/ORDERED
            vLinkGenVarSectionGroupFlag = vLinkGenVarGroupFlags/CONTIGUOUS
            vLinkGenVarSectionGroupFlag = vLinkGenVarGroupFlags/FILL
            vLinkGenVarSectionGroupFlag = vLinkGenVarGroupFlags/READ
            vLinkGenVarSectionGroupFlag = vLinkGenVarGroupFlags/WRITE
            vLinkGenVarSectionGroupRef = OS_STACK_OSCORE1_TASK_PRIO4294967295_VAR_NOINIT
            vLinkGenVarSectionGroupRef = OS_STACK_OSCORE1_KERNEL_VAR_NOINIT
            vLinkGenVarSectionGroupRef = OS_STACK_OSCORE1_INIT_VAR_NOINIT
            vLinkGenVarSectionGroupRef = OS_STACK_OSCORE1_ERROR_VAR_NOINIT
            vLinkGenVarSectionGroupRef = OS_STACK_OSCORE1_ISR_CORE_VAR_NOINIT
            vLinkGenVarSectionGroupRef = OS_STACK_OSCORE1_TASK_PRIO49_VAR_NOINIT
            vLinkGenVarSectionGroupRef = OS_STACK_DEFAULT_INIT_TASK_CORE1_VAR_NOINIT
            vLinkGenVarSectionGroupRef = OS_STACK_DEFAULT_BSW_TASK_CORE1_VAR_NOINIT
            vLinkGenVarSectionGroupRef = OS_STACK_OSCORE1_SHUTDOWN_VAR_NOINIT
        OS_GLOBALSHARED_VAR: vLinkGenVarGroupPosition=5, vLinkGenVarGroupInitCore=0, vLinkGenVarGroupRegion=DSPR_Core0/DSPR_Core0, vLinkGenVarGroupModule=Os, vLinkGenVarGroupContentType=GLOBAL_DATA, vLinkGenVarGroupRomRegion=PFlash0_Cached/PFlash0_Cached
          8 x vLinkGenVarSectionGroup, all with vLinkGenVarSectionGroupPosition=0, vLinkGenVarSectionGroupInitStage=ONE, vLinkGenVarSectionGroupGapSize=16, vLinkGenVarSectionGroupAlignment=16, vLinkGenVarSectionGroupFlag=vLinkGenVarGroupFlags/ORDERED, vLinkGenVarSectionGroupFlag=vLinkGenVarGroupFlags/CONTIGUOUS, vLinkGenVarSectionGroupFlag=vLinkGenVarGroupFlags/FILL, vLinkGenVarSectionGroupFlag=vLinkGenVarGroupFlags/READ, vLinkGenVarSectionGroupFlag=vLinkGenVarGroupFlags/WRITE:
            OS_GLOBALSHARED_VAR_NOINIT: vLinkGenVarSectionGroupInit=NONE, vLinkGenVarSectionGroupRef=vLinkGenLinkerSections/OS_GLOBALSHARED_VAR_NOINIT, vLinkGenVarSectionGroupRef=OS_GLOBALSHARED_VAR_NOCACHE_NOINIT
            OS_GLOBALSHARED_VAR_INIT: vLinkGenVarSectionGroupInit=INIT, vLinkGenVarSectionGroupEndAlignment=4, vLinkGenVarSectionGroupRef=vLinkGenLinkerSections/OS_GLOBALSHARED_VAR, vLinkGenVarSectionGroupRef=OS_GLOBALSHARED_VAR_NOCACHE
            OS_GLOBALSHARED_VAR_ZERO_INIT: vLinkGenVarSectionGroupInit=ZERO_INIT, vLinkGenVarSectionGroupEndAlignment=4, vLinkGenVarSectionGroupRef=vLinkGenLinkerSections/OS_GLOBALSHARED_VAR_ZERO_INIT, vLinkGenVarSectionGroupRef=OS_GLOBALSHARED_VAR_NOCACHE_ZERO_INIT
            OS_GLOBALSHARED_VAR_ZERO_INIT_bss: vLinkGenVarSectionGroupInit=ZERO_INIT, vLinkGenVarSectionGroupEndAlignment=4, vLinkGenVarSectionGroupRef=vLinkGenLinkerSections/OS_GLOBALSHARED_VAR_ZERO_INIT_bss, vLinkGenVarSectionGroupRef=OS_GLOBALSHARED_VAR_NOCACHE_ZERO_INIT_bss
            OS_GLOBALSHARED_VAR_FAST_NOINIT: vLinkGenVarSectionGroupInit=NONE, vLinkGenVarSectionGroupRef=vLinkGenLinkerSections/OS_GLOBALSHARED_VAR_FAST_NOINIT, vLinkGenVarSectionGroupRef=OS_GLOBALSHARED_VAR_FAST_NOCACHE_NOINIT
            OS_GLOBALSHARED_VAR_FAST_INIT: vLinkGenVarSectionGroupInit=INIT, vLinkGenVarSectionGroupEndAlignment=4, vLinkGenVarSectionGroupRef=OS_GLOBALSHARED_VAR_FAST, vLinkGenVarSectionGroupRef=OS_GLOBALSHARED_VAR_FAST_NOCACHE
            OS_GLOBALSHARED_VAR_FAST_ZERO_INIT: vLinkGenVarSectionGroupInit=ZERO_INIT, vLinkGenVarSectionGroupEndAlignment=4, vLinkGenVarSectionGroupRef=vLinkGenLinkerSections/OS_GLOBALSHARED_VAR_FAST_ZERO_INIT, vLinkGenVarSectionGroupRef=OS_GLOBALSHARED_VAR_FAST_NOCACHE_ZERO_INIT
            OS_GLOBALSHARED_VAR_FAST_ZERO_INIT_bss: vLinkGenVarSectionGroupInit=ZERO_INIT, vLinkGenVarSectionGroupEndAlignment=4, vLinkGenVarSectionGroupRef=vLinkGenLinkerSections/OS_GLOBALSHARED_VAR_FAST_ZERO_INIT_bss, vLinkGenVarSectionGroupRef=OS_GLOBALSHARED_VAR_FAST_NOCACHE_ZERO_INIT_bss
        OS_GLOBALSHARED_VAR_SAVED_ZONE: vLinkGenVarGroupPosition=5, vLinkGenVarGroupInitCore=0, vLinkGenVarGroupRegion=DSPR_Core0/DSPR_Core0, vLinkGenVarGroupModule=Os, vLinkGenVarGroupContentType=RETENTION_DATA, vLinkGenVarGroupRomRegion=PFlash0_Cached/PFlash0_Cached
          4 x vLinkGenVarSectionGroup, all with vLinkGenVarSectionGroupPosition=0, vLinkGenVarSectionGroupInitStage=ONE, vLinkGenVarSectionGroupGapSize=16, vLinkGenVarSectionGroupAlignment=16, vLinkGenVarSectionGroupFlag=vLinkGenVarGroupFlags/ORDERED, vLinkGenVarSectionGroupFlag=vLinkGenVarGroupFlags/CONTIGUOUS, vLinkGenVarSectionGroupFlag=vLinkGenVarGroupFlags/FILL, vLinkGenVarSectionGroupFlag=vLinkGenVarGroupFlags/READ, vLinkGenVarSectionGroupFlag=vLinkGenVarGroupFlags/WRITE:
            OS_GLOBALSHARED_VAR_SAVED_ZONE_NOINIT: vLinkGenVarSectionGroupInit=NONE, vLinkGenVarSectionGroupRef=vLinkGenLinkerSections/OS_GLOBALSHARED_VAR_SAVED_ZONE_NOINIT
            OS_GLOBALSHARED_VAR_SAVED_ZONE_INIT: vLinkGenVarSectionGroupInit=INIT, vLinkGenVarSectionGroupEndAlignment=4, vLinkGenVarSectionGroupRef=vLinkGenLinkerSections/OS_GLOBALSHARED_VAR_SAVED_ZONE
            OS_GLOBALSHARED_VAR_SAVED_ZONE_FAST_NOINIT: vLinkGenVarSectionGroupInit=NONE, vLinkGenVarSectionGroupRef=OS_GLOBALSHARED_VAR_FAST_SAVED_ZONE_NOINIT
            OS_GLOBALSHARED_VAR_SAVED_ZONE_FAST_INIT: vLinkGenVarSectionGroupInit=INIT, vLinkGenVarSectionGroupEndAlignment=4, vLinkGenVarSectionGroupRef=OS_GLOBALSHARED_VAR_FAST_SAVED_ZONE
        OS_DATA_CORE0_VAR: vLinkGenVarGroupPosition=5, vLinkGenVarGroupCore=0, vLinkGenVarGroupInitCore=0, vLinkGenVarGroupRegion=DSPR_Core0/DSPR_Core0, vLinkGenVarGroupModule=Os, vLinkGenVarGroupContentType=LOCAL_DATA, vLinkGenVarGroupRomRegion=PFlash0_Cached/PFlash0_Cached
          8 x vLinkGenVarSectionGroup, all with vLinkGenVarSectionGroupPosition=0, vLinkGenVarSectionGroupInitStage=ONE, vLinkGenVarSectionGroupGapSize=16, vLinkGenVarSectionGroupAlignment=16, vLinkGenVarSectionGroupFlag=vLinkGenVarGroupFlags/ORDERED, vLinkGenVarSectionGroupFlag=vLinkGenVarGroupFlags/CONTIGUOUS, vLinkGenVarSectionGroupFlag=vLinkGenVarGroupFlags/FILL, vLinkGenVarSectionGroupFlag=vLinkGenVarGroupFlags/READ, vLinkGenVarSectionGroupFlag=vLinkGenVarGroupFlags/WRITE:
            OS_DATA_CORE0_VAR_NOINIT: vLinkGenVarSectionGroupInit=NONE, vLinkGenVarSectionGroupEndAlignment=4, vLinkGenVarSectionGroupRef=OS_CORE0_VAR_NOINIT, vLinkGenVarSectionGroupRef=OS_CORE0_VAR_NOCACHE_NOINIT, vLinkGenVarSectionGroupRef=OS_OsApplication_SystemApplication_Core0_VAR_NOINIT, vLinkGenVarSectionGroupRef=OS_OsApplication_SystemApplication_Core0_VAR_NOCACHE_NOINIT, vLinkGenVarSectionGroupRef=OS_OsApplication_SystemApplication_Core0_VAR_SAVED_ZONE_NOINIT
            OS_DATA_CORE0_VAR_INIT: vLinkGenVarSectionGroupInit=INIT, vLinkGenVarSectionGroupEndAlignment=4, vLinkGenVarSectionGroupRef=OS_CORE0_VAR, vLinkGenVarSectionGroupRef=OS_CORE0_VAR_NOCACHE, vLinkGenVarSectionGroupRef=OS_OsApplication_SystemApplication_Core0_VAR, vLinkGenVarSectionGroupRef=OS_OsApplication_SystemApplication_Core0_VAR_NOCACHE, vLinkGenVarSectionGroupRef=OS_OsApplication_SystemApplication_Core0_VAR_SAVED_ZONE
            OS_DATA_CORE0_VAR_ZERO_INIT: vLinkGenVarSectionGroupInit=ZERO_INIT, vLinkGenVarSectionGroupEndAlignment=4, vLinkGenVarSectionGroupRef=OS_OsApplication_SystemApplication_Core0_VAR_ZERO_INIT, vLinkGenVarSectionGroupRef=OS_OsApplication_SystemApplication_Core0_VAR_NOCACHE_ZERO_INIT
            OS_DATA_CORE0_VAR_ZERO_INIT_bss: vLinkGenVarSectionGroupInit=ZERO_INIT, vLinkGenVarSectionGroupEndAlignment=4, vLinkGenVarSectionGroupRef=OS_OsApplication_SystemApplication_Core0_VAR_ZERO_INIT_bss, vLinkGenVarSectionGroupRef=OS_OsApplication_SystemApplication_Core0_VAR_NOCACHE_ZERO_INIT_bss
            OS_DATA_CORE0_VAR_FAST_NOINIT: vLinkGenVarSectionGroupInit=NONE, vLinkGenVarSectionGroupRef=OS_CORE0_VAR_FAST_NOINIT, vLinkGenVarSectionGroupRef=OS_CORE0_VAR_FAST_NOCACHE_NOINIT, vLinkGenVarSectionGroupRef=OS_OsApplication_SystemApplication_Core0_VAR_FAST_NOINIT, vLinkGenVarSectionGroupRef=OS_OsApplication_SystemApplication_Core0_VAR_FAST_NOCACHE_NOINIT, vLinkGenVarSectionGroupRef=OS_OsApplication_SystemApplication_Core0_VAR_FAST_SAVED_ZONE_NOINIT
            OS_DATA_CORE0_VAR_FAST_INIT: vLinkGenVarSectionGroupInit=INIT, vLinkGenVarSectionGroupEndAlignment=4, vLinkGenVarSectionGroupRef=OS_CORE0_VAR_FAST, vLinkGenVarSectionGroupRef=OS_CORE0_VAR_FAST_NOCACHE, vLinkGenVarSectionGroupRef=OS_OsApplication_SystemApplication_Core0_VAR_FAST, vLinkGenVarSectionGroupRef=OS_OsApplication_SystemApplication_Core0_VAR_FAST_NOCACHE, vLinkGenVarSectionGroupRef=OS_OsApplication_SystemApplication_Core0_VAR_FAST_SAVED_ZONE
            OS_DATA_CORE0_VAR_FAST_ZERO_INIT: vLinkGenVarSectionGroupInit=ZERO_INIT, vLinkGenVarSectionGroupEndAlignment=4, vLinkGenVarSectionGroupRef=OS_OsApplication_SystemApplication_Core0_VAR_FAST_ZERO_INIT, vLinkGenVarSectionGroupRef=OS_OsApplication_SystemApplication_Core0_VAR_FAST_NOCACHE_ZERO_INIT
            OS_DATA_CORE0_VAR_FAST_ZERO_INIT_bss: vLinkGenVarSectionGroupInit=ZERO_INIT, vLinkGenVarSectionGroupEndAlignment=4, vLinkGenVarSectionGroupRef=OS_OsApplication_SystemApplication_Core0_VAR_FAST_ZERO_INIT_bss, vLinkGenVarSectionGroupRef=OS_OsApplication_SystemApplication_Core0_VAR_FAST_NOCACHE_ZERO_INIT_bss
        OS_DATA_CORE1_VAR: vLinkGenVarGroupPosition=5, vLinkGenVarGroupCore=1, vLinkGenVarGroupInitCore=1, vLinkGenVarGroupRegion=DSPR_Core1/DSPR_Core1, vLinkGenVarGroupModule=Os, vLinkGenVarGroupContentType=LOCAL_DATA, vLinkGenVarGroupRomRegion=PFlash0_Cached/PFlash0_Cached
          8 x vLinkGenVarSectionGroup, all with vLinkGenVarSectionGroupPosition=0, vLinkGenVarSectionGroupInitStage=ONE, vLinkGenVarSectionGroupGapSize=16, vLinkGenVarSectionGroupAlignment=16, vLinkGenVarSectionGroupFlag=vLinkGenVarGroupFlags/ORDERED, vLinkGenVarSectionGroupFlag=vLinkGenVarGroupFlags/CONTIGUOUS, vLinkGenVarSectionGroupFlag=vLinkGenVarGroupFlags/FILL, vLinkGenVarSectionGroupFlag=vLinkGenVarGroupFlags/READ, vLinkGenVarSectionGroupFlag=vLinkGenVarGroupFlags/WRITE:
            OS_DATA_CORE1_VAR_NOINIT: vLinkGenVarSectionGroupInit=NONE, vLinkGenVarSectionGroupRef=OS_CORE1_VAR_NOINIT, vLinkGenVarSectionGroupRef=OS_CORE1_VAR_NOCACHE_NOINIT, vLinkGenVarSectionGroupRef=OS_OsApplication_SystemApplication_Core1_VAR_NOINIT, vLinkGenVarSectionGroupRef=OS_OsApplication_SystemApplication_Core1_VAR_NOCACHE_NOINIT, vLinkGenVarSectionGroupRef=OS_OsApplication_SystemApplication_Core1_VAR_SAVED_ZONE_NOINIT
            OS_DATA_CORE1_VAR_INIT: vLinkGenVarSectionGroupInit=INIT, vLinkGenVarSectionGroupEndAlignment=4, vLinkGenVarSectionGroupRef=OS_CORE1_VAR, vLinkGenVarSectionGroupRef=OS_CORE1_VAR_NOCACHE, vLinkGenVarSectionGroupRef=OS_OsApplication_SystemApplication_Core1_VAR, vLinkGenVarSectionGroupRef=OS_OsApplication_SystemApplication_Core1_VAR_NOCACHE, vLinkGenVarSectionGroupRef=OS_OsApplication_SystemApplication_Core1_VAR_SAVED_ZONE
            OS_DATA_CORE1_VAR_ZERO_INIT: vLinkGenVarSectionGroupInit=ZERO_INIT, vLinkGenVarSectionGroupEndAlignment=4, vLinkGenVarSectionGroupRef=OS_OsApplication_SystemApplication_Core1_VAR_ZERO_INIT, vLinkGenVarSectionGroupRef=OS_OsApplication_SystemApplication_Core1_VAR_NOCACHE_ZERO_INIT
            OS_DATA_CORE1_VAR_ZERO_INIT_bss: vLinkGenVarSectionGroupInit=ZERO_INIT, vLinkGenVarSectionGroupEndAlignment=4, vLinkGenVarSectionGroupRef=OS_OsApplication_SystemApplication_Core1_VAR_ZERO_INIT_bss, vLinkGenVarSectionGroupRef=OS_OsApplication_SystemApplication_Core1_VAR_NOCACHE_ZERO_INIT_bss
            OS_DATA_CORE1_VAR_FAST_NOINIT: vLinkGenVarSectionGroupInit=NONE, vLinkGenVarSectionGroupRef=OS_CORE1_VAR_FAST_NOINIT, vLinkGenVarSectionGroupRef=OS_CORE1_VAR_FAST_NOCACHE_NOINIT, vLinkGenVarSectionGroupRef=OS_OsApplication_SystemApplication_Core1_VAR_FAST_NOINIT, vLinkGenVarSectionGroupRef=OS_OsApplication_SystemApplication_Core1_VAR_FAST_NOCACHE_NOINIT, vLinkGenVarSectionGroupRef=OS_OsApplication_SystemApplication_Core1_VAR_FAST_SAVED_ZONE_NOINIT
            OS_DATA_CORE1_VAR_FAST_INIT: vLinkGenVarSectionGroupInit=INIT, vLinkGenVarSectionGroupEndAlignment=4, vLinkGenVarSectionGroupRef=OS_CORE1_VAR_FAST, vLinkGenVarSectionGroupRef=OS_CORE1_VAR_FAST_NOCACHE, vLinkGenVarSectionGroupRef=OS_OsApplication_SystemApplication_Core1_VAR_FAST, vLinkGenVarSectionGroupRef=OS_OsApplication_SystemApplication_Core1_VAR_FAST_NOCACHE, vLinkGenVarSectionGroupRef=OS_OsApplication_SystemApplication_Core1_VAR_FAST_SAVED_ZONE
            OS_DATA_CORE1_VAR_FAST_ZERO_INIT: vLinkGenVarSectionGroupInit=ZERO_INIT, vLinkGenVarSectionGroupEndAlignment=4, vLinkGenVarSectionGroupRef=OS_OsApplication_SystemApplication_Core1_VAR_FAST_ZERO_INIT, vLinkGenVarSectionGroupRef=OS_OsApplication_SystemApplication_Core1_VAR_FAST_NOCACHE_ZERO_INIT
            OS_DATA_CORE1_VAR_FAST_ZERO_INIT_bss: vLinkGenVarSectionGroupInit=ZERO_INIT, vLinkGenVarSectionGroupEndAlignment=4, vLinkGenVarSectionGroupRef=OS_OsApplication_SystemApplication_Core1_VAR_FAST_ZERO_INIT_bss, vLinkGenVarSectionGroupRef=OS_OsApplication_SystemApplication_Core1_VAR_FAST_NOCACHE_ZERO_INIT_bss
        OS_DATA_SHARED_VAR: vLinkGenVarGroupPosition=5, vLinkGenVarGroupInitCore=0, vLinkGenVarGroupRegion=DSPR_Core0/DSPR_Core0, vLinkGenVarGroupModule=Os, vLinkGenVarGroupContentType=GLOBAL_DATA, vLinkGenVarGroupRomRegion=PFlash0_Cached/PFlash0_Cached
          4 x vLinkGenVarSectionGroup, all with vLinkGenVarSectionGroupPosition=0, vLinkGenVarSectionGroupInitStage=ONE, vLinkGenVarSectionGroupGapSize=16, vLinkGenVarSectionGroupAlignment=16, vLinkGenVarSectionGroupFlag=vLinkGenVarGroupFlags/ORDERED, vLinkGenVarSectionGroupFlag=vLinkGenVarGroupFlags/CONTIGUOUS, vLinkGenVarSectionGroupFlag=vLinkGenVarGroupFlags/FILL, vLinkGenVarSectionGroupFlag=vLinkGenVarGroupFlags/READ, vLinkGenVarSectionGroupFlag=vLinkGenVarGroupFlags/WRITE:
            OS_DATA_SHARED_VAR_NOINIT: vLinkGenVarSectionGroupInit=NONE, vLinkGenVarSectionGroupRef=OS_VAR_NOCACHE_NOINIT, vLinkGenVarSectionGroupRef=OS_CORESTATUS_CORE0_VAR_NOCACHE_NOINIT, vLinkGenVarSectionGroupRef=OS_PUBLIC_CORE0_VAR_NOINIT, vLinkGenVarSectionGroupRef=OS_BARRIER_CORE0_VAR_NOCACHE_NOINIT, vLinkGenVarSectionGroupRef=OS_CORESTATUS_CORE1_VAR_NOCACHE_NOINIT, vLinkGenVarSectionGroupRef=OS_PUBLIC_CORE1_VAR_NOINIT, vLinkGenVarSectionGroupRef=OS_BARRIER_CORE1_VAR_NOCACHE_NOINIT, vLinkGenVarSectionGroupRef=OS_CORESHARED_0X00000003_VAR_NOCACHE_NOINIT
            OS_DATA_SHARED_VAR_INIT: vLinkGenVarSectionGroupInit=INIT, vLinkGenVarSectionGroupEndAlignment=4, vLinkGenVarSectionGroupRef=OS_VAR_NOCACHE
            OS_DATA_SHARED_VAR_FAST_NOINIT: vLinkGenVarSectionGroupInit=NONE, vLinkGenVarSectionGroupRef=OS_VAR_FAST_NOCACHE_NOINIT, vLinkGenVarSectionGroupRef=OS_CORESTATUS_CORE0_VAR_FAST_NOCACHE_NOINIT, vLinkGenVarSectionGroupRef=OS_PUBLIC_CORE0_VAR_FAST_NOINIT, vLinkGenVarSectionGroupRef=OS_BARRIER_CORE0_VAR_FAST_NOCACHE_NOINIT, vLinkGenVarSectionGroupRef=OS_CORESTATUS_CORE1_VAR_FAST_NOCACHE_NOINIT, vLinkGenVarSectionGroupRef=OS_PUBLIC_CORE1_VAR_FAST_NOINIT, vLinkGenVarSectionGroupRef=OS_BARRIER_CORE1_VAR_FAST_NOCACHE_NOINIT, vLinkGenVarSectionGroupRef=OS_CORESHARED_0X00000003_VAR_FAST_NOCACHE_NOINIT
            OS_DATA_SHARED_VAR_FAST_INIT: vLinkGenVarSectionGroupInit=INIT, vLinkGenVarSectionGroupEndAlignment=4, vLinkGenVarSectionGroupRef=OS_VAR_FAST_NOCACHE
        STACK_C0: vLinkGenVarGroupPosition=5, vLinkGenVarGroupCore=0, vLinkGenVarGroupRegion=StartupStack_Shared, vLinkGenVarGroupContentType=STARTUP_STACK, vLinkGenVarGroupModule=vBRS
          STACK_C0 (vLinkGenVarSectionGroup):
            vLinkGenVarSectionGroupPosition = 0
            vLinkGenVarSectionGroupInit = NONE
            vLinkGenVarSectionGroupInitStage = ONE
            vLinkGenVarSectionGroupAlignment = 64
            vLinkGenVarSectionGroupEndAlignment = 4
            vLinkGenVarSectionGroupSize = 36864
            vLinkGenVarSectionGroupFlag = vLinkGenVarGroupFlags/ORDERED
            vLinkGenVarSectionGroupFlag = vLinkGenVarGroupFlags/CONTIGUOUS
            vLinkGenVarSectionGroupFlag = vLinkGenVarGroupFlags/FILL
            vLinkGenVarSectionGroupFlag = vLinkGenVarGroupFlags/READ
            vLinkGenVarSectionGroupFlag = vLinkGenVarGroupFlags/WRITE
        STACK_C1: vLinkGenVarGroupPosition=5, vLinkGenVarGroupCore=1, vLinkGenVarGroupRegion=DSPR_Core1/DSPR_Core1, vLinkGenVarGroupContentType=STARTUP_STACK, vLinkGenVarGroupModule=vBRS
          STACK_C1 (vLinkGenVarSectionGroup):
            vLinkGenVarSectionGroupPosition = 0
            vLinkGenVarSectionGroupInit = NONE
            vLinkGenVarSectionGroupInitStage = ONE
            vLinkGenVarSectionGroupAlignment = 64
            vLinkGenVarSectionGroupEndAlignment = 4
            vLinkGenVarSectionGroupSize = 36864
            vLinkGenVarSectionGroupFlag = vLinkGenVarGroupFlags/ORDERED
            vLinkGenVarSectionGroupFlag = vLinkGenVarGroupFlags/CONTIGUOUS
            vLinkGenVarSectionGroupFlag = vLinkGenVarGroupFlags/FILL
            vLinkGenVarSectionGroupFlag = vLinkGenVarGroupFlags/READ
            vLinkGenVarSectionGroupFlag = vLinkGenVarGroupFlags/WRITE
    vLinkGenContentTypes
      RAM_CODE (vLinkGenConstContentType): vLinkGenConstContentTypeLocal=false, vLinkGenConstContentTypeCopyRef=RAM_CODE_COPY
      RAM_CONST (vLinkGenConstContentType): vLinkGenConstContentTypeLocal=false, vLinkGenConstContentTypeCopyRef=RAM_CONST_COPY
      3 x vLinkGenVarContentType:
        GLOBAL_DATA: vLinkGenVarContentTypeLocal=false, vLinkGenVarContentTypeCopyRef=GLOBAL_CONST
        LOCAL_DATA: vLinkGenVarContentTypeLocal=true, vLinkGenVarContentTypeCopyRef=LOCAL_CONST
        RETENTION_DATA: vLinkGenVarContentTypeLocal=false, vLinkGenVarContentTypeCopyRef=GLOBAL_CONST
      13 x vLinkGenConstContentType:
        GLOBAL_CODE: vLinkGenConstContentTypeLocal=false
        LOCAL_CODE: vLinkGenConstContentTypeLocal=true
        GLOBAL_CONST: vLinkGenConstContentTypeLocal=false
        LOCAL_CONST: vLinkGenConstContentTypeLocal=true
        GLOBAL_EXCVEC_CODE: vLinkGenConstContentTypeLocal=false
        LOCAL_EXCVEC_CODE: vLinkGenConstContentTypeLocal=true
        GLOBAL_EXCVEC_CONST: vLinkGenConstContentTypeLocal=true
        LOCAL_EXCVEC_CONST: vLinkGenConstContentTypeLocal=true
        GLOBAL_INTVEC_CODE: vLinkGenConstContentTypeLocal=false
        LOCAL_INTVEC_CODE: vLinkGenConstContentTypeLocal=true
        GLOBAL_INTVEC_CONST: vLinkGenConstContentTypeLocal=false
        LOCAL_INTVEC_CONST: vLinkGenConstContentTypeLocal=true
        STARTUP_CODE: vLinkGenConstContentTypeLocal=false
      5 x vLinkGenVarContentType:
        STARTUP_STACK: vLinkGenVarContentTypeLocal=true
        STACKS: vLinkGenVarContentTypeLocal=true
        RAM_CODE_COPY: vLinkGenVarContentTypeLocal=false
        RAM_CONST_COPY: vLinkGenVarContentTypeLocal=false
        SHARED_DATA: vLinkGenVarContentTypeLocal=false
    vLinkGenPublishedInformation: vLinkGenDefaultVarGroupAlignment=16, vLinkGenGeneration=2, vLinkGenDuplicatedLabels=false
      vLinkGenRegionBlockFlags
        RESERVED (vLinkGenRegionBlockFlag)
      vLinkGenConstGroupFlags
        7 x vLinkGenConstGroupFlag:
          ORDERED
          CONTIGUOUS
          FILL
          NOCOPY
          EXECUTE
          READ
          WRITE
      vLinkGenConstSectionFlags
        KEEP (vLinkGenConstSectionFlag)
      vLinkGenVarGroupFlags
        7 x vLinkGenVarGroupFlag:
          ORDERED
          CONTIGUOUS
          FILL
          NOCOPY
          EXECUTE
          READ
          WRITE
      vLinkGenVarSectionFlags
        KEEP (vLinkGenVarSectionFlag)
      vLinkGenLogicalConstGroupFlags
        FORCE_ZERO_OFFSET (vLinkGenLogicalConstGroupFlag)
      vLinkGenLogicalVarGroupFlags
        FORCE_ZERO_OFFSET (vLinkGenLogicalVarGroupFlag)
    vLinkGenGeneral: vLinkGenEntrySymbol=brsStartupEntry, vLinkGenFileGeneration=STANDARD
