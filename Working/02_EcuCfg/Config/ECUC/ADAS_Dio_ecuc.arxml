AUTOSAR XML (schema 4-3-0)
package /ActiveEcuC
  module config Dio: implementation-config-variant=VARIANT-LINK-TIME, module-description=Dio_Impl
    DioConfig
      DioPort_0 (DioPort): DioPortId=33
        5 x DioChannel:
          DioChannel_LED_1: DioChannelId=1, DioChannelEcucPartitionRef=EcucPartition_SystemApplication_Core0
          DioChannel_LED_{2..4}: DioChannelId={2..4}
          DioChannel_Buzzer: DioChannelId=0
    DioGeneral: DioDevErrorDetect=false, DioFlipChannelApi=false, DioMaskedWritePortApi=false, DioVersionInfoApi=false, DioSafetyEnable=false
    CommonPublishedInformation:
      ArMajorVersion = 4
      ArMinorVersion = 4
      ArPatchVersion = 0
      SwMajorVersion = 20
      SwMinorVersion = 0
      SwPatchVersion = 1
      ModuleId = 120
      VendorId = 17
      Release = _TRICORE_TC397_ADAS
