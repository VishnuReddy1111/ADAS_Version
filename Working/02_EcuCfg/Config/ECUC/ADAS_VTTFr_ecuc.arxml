AUTOSAR XML (schema 00048)
package /ActiveEcuC
  module config VTTFr: implementation-config-variant=VARIANT-PRE-COMPILE, module-description=VTTFr_Impl
    FrMultipleConfiguration
      MyECU_6c1a0d52 (FrController):
        FrCtrlIdx = 0
        FrPAllowHaltDueToClock = true
        FrPAllowPassiveToActive = 0
        FrPChannels = FR_CHANNEL_A
        FrPClusterDriftDamping = 2
        FrPDecodingCorrection = 72
        FrPDelayCompensationA = 1
        FrPDelayCompensationB = 1
        FrPExternalSync = false
        FrPFallBackInternal = false
        FrPKeySlotId = 2
        FrPKeySlotOnlyEnabled = false
        FrPKeySlotUsedForStartup = true
        FrPKeySlotUsedForSync = true
        FrPLatestTx = 250
        FrPMacroInitialOffsetA = 5
        FrPMacroInitialOffsetB = 5
        FrPMicroInitialOffsetA = 7
        FrPMicroInitialOffsetB = 7
        FrPMicroPerCycle = 200000
        FrPNmVectorEarlyUpdate = false
        FrPOffsetCorrectionOut = 150
        FrPOffsetCorrectionStart = 4956
        FrPPayloadLengthDynMax = 50
        FrPRateCorrectionOut = 601
        FrPSamplesPerMicrotick = N2SAMPLES
        FrPSecondKeySlotId = 0
        FrPTwoKeySlotMode = false
        FrPWakeupChannel = FR_CHANNEL_A
        FrPWakeupPattern = 63
        FrPdAcceptedStartupRange = 242
        FrPdListenTimeout = 401202
        FrPdMicrotick = T25NS
        FrStrobePointPosition = SAMPLE_5
        FrStatusIRQLine = LINE_0
        FrErrorIRQLine = LINE_1
        FrCANoeClusterName = FlexRay
        FrAbsoluteTimer: FrAbsTimerIdx=0
        FrControllerDemEventParameterRefs: FrDemCtrlTestResultRef=AutoCreatedDemEvent_MyECU_6c1a0d52_FrDemCtrlTestResultRef
        FIFO0 (FrFifo): FrChannels=FR_CHANNEL_A
          FrRange: FrRangeMax=91, FrRangeMin=90
    FrGeneral:
      FrAbsoluteTimerDisable = false
      FrRuntimeMeasurementSupport = true
      FrBufferReconfig = false
      FrCtrlTestCount = 1
      FrCycleStartInterrupt = true
      FrDevErrorDetect = true
      FrFIFOSupport = true
      FrHardwareCancellationEnable = false
      FrIndex = 0
      FrNumCtrlSupported = 1
      FrRxStringentCheck = false
      FrRxStringentLengthCheck = false
      FrSingleChannelAPI = false
      FrTimeoutDurationFactor = 0
      FrTimer0Interrupt = true
      FrTypeOfInterruptFunction = Category2
      FrUseAsmFunctionOptimization = false
      FrVersionInfoApi = true
      FrDirectBufferAccessEnable = false
      FrEnableMsgIdFiltering = false
      FrSafeBswChecks = false
      FrTxConflictStatus = false
