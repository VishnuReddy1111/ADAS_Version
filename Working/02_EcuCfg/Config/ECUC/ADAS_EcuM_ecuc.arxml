AUTOSAR XML (schema 4-3-0)
package /ActiveEcuC
  module config EcuM: implementation-config-variant=VARIANT-PRE-COMPILE, module-description=EcuM_Impl
    EcuMConfiguration
      EcuMFlexConfiguration:
        EcuMFlexModuleConfigurationRef = CanConfigSet
        EcuMNormalMcuModeRef = McuModeSettingConf_0
        EcuMPartitionRef = EcucPartition_SystemApplication_Core1
        EcuMPartitionRef = EcucPartition_SystemApplication_Core0
        ECUM_CAUSE_UNKNOWN (EcuMShutdownCause): EcuMShutdownCauseId=0
        ECUM_RESET_IO (EcuMResetMode): EcuMResetModeId=2
        ECUM_RESET_MCU (EcuMResetMode): EcuMResetModeId=0
        ECUM_CAUSE_DCM (EcuMShutdownCause): EcuMShutdownCauseId=3
        ECUM_RESET_WAKEUP (EcuMResetMode): EcuMResetModeId=3
        ECUM_CAUSE_ECU_STATE (EcuMShutdownCause): EcuMShutdownCauseId=1
        ECUM_RESET_WDG (EcuMResetMode): EcuMResetModeId=1
        ECUM_CAUSE_WDGM (EcuMShutdownCause): EcuMShutdownCauseId=2
      EcuMCommonConfiguration: EcuMConfigConsistencyHash=4653573584838904932, EcuMDefaultAppMode=OSDEFAULTAPPMODE, EcuMOSResource=OsResource
        4 x EcuMWakeupSource, all with EcuMValidationTimeout=0, EcuMCheckWakeupTimeout=0, EcuMWakeupSourcePolling=false:
          ECUM_WKSOURCE_POWER: EcuMWakeupSourceId=0
          ECUM_WKSOURCE_INTERNAL_WDG: EcuMWakeupSourceId=3
          ECUM_WKSOURCE_INTERNAL_RESET: EcuMWakeupSourceId=2
          ECUM_WKSOURCE_RESET: EcuMWakeupSourceId=1
        EcuMDefaultShutdownTarget: EcuMDefaultState=EcuMStateOff
        ECUM_WKSOURCE_EXTERNAL_WDG (EcuMWakeupSource): EcuMWakeupSourceId=4, EcuMValidationTimeout=0, EcuMCheckWakeupTimeout=0, EcuMWakeupSourcePolling=false
        EcuMDemEventParameterRefs:
          ECUM_E_RAM_CHECK_FAILED = AutoCreatedDemEvent_ECUM_E_RAM_CHECK_FAILED
          ECUM_E_IMPROPER_CALLER = AutoCreatedDemEvent_ECUM_E_IMPROPER_CALLER
          ECUM_E_CONFIGURATION_DATA_INCONSISTENT = AutoCreatedDemEvent_ECUM_E_CONFIGURATION_DATA_INCONSISTENT
          ECUM_E_ALL_RUN_REQUESTS_KILLED = AutoCreatedDemEvent_ECUM_E_ALL_RUN_REQUESTS_KILLED
        EcuMDriverInitListZero
          28 x EcuMDriverInitItem:
            BswM_InitMemory: index=0, EcuMModuleID=BswM, EcuMModuleService=BswM_InitMemory, EcuMModuleHeader=BswM.h
            CanIf_InitMemory: index=1, EcuMModuleID=CanIf, EcuMModuleService=CanIf_InitMemory, EcuMModuleHeader=CanIf.h
            CanNm_InitMemory: index=2, EcuMModuleID=CanNm, EcuMModuleService=CanNm_InitMemory, EcuMModuleHeader=CanNm.h
            CanSM_InitMemory: index=3, EcuMModuleID=CanSM, EcuMModuleService=CanSM_InitMemory, EcuMModuleHeader=CanSM_EcuM.h
            CanTp_InitMemory: index=4, EcuMModuleID=CanTp, EcuMModuleService=CanTp_InitMemory, EcuMModuleHeader=CanTp.h
            ComM_InitMemory: index=6, EcuMModuleID=ComM, EcuMModuleService=ComM_InitMemory, EcuMModuleHeader=ComM.h
            Com_InitMemory: index=7, EcuMModuleID=Com, EcuMModuleService=Com_InitMemory, EcuMModuleHeader=Com.h
            CryIf_InitMemory: index=8, EcuMModuleID=CryIf, EcuMModuleService=CryIf_InitMemory, EcuMModuleHeader=CryIf.h
            Crypto_30_LibCv_InitMemory: index=9, EcuMModuleID=Crypto, EcuMModuleService=Crypto_30_LibCv_InitMemory, EcuMModuleHeader=Crypto_30_LibCv.h
            Csm_InitMemory: index=10, EcuMModuleID=Csm, EcuMModuleService=Csm_InitMemory, EcuMModuleHeader=Csm.h
            Dcm_InitMemory: index=11, EcuMModuleID=Dcm, EcuMModuleService=Dcm_InitMemory, EcuMModuleHeader=Dcm.h
            Dem_InitMemory: index=12, EcuMModuleID=Dem, EcuMModuleService=Dem_InitMemory, EcuMModuleHeader=Dem.h
            Det_InitMemory: index=13, EcuMModuleID=Det, EcuMModuleService=Det_InitMemory, EcuMModuleHeader=Det.h
            E2EXf_InitMemory: index=14, EcuMModuleID=E2EXf, EcuMModuleService=E2EXf_InitMemory, EcuMModuleHeader=E2EXf.h
            Nm_InitMemory: index=25, EcuMModuleID=Nm, EcuMModuleService=Nm_InitMemory, EcuMModuleHeader=Nm.h
            PduR_InitMemory: index=26, EcuMModuleID=PduR, EcuMModuleService=PduR_InitMemory, EcuMModuleHeader=PduR.h
            Rte_InitMemory: index=27, EcuMModuleID=Rte, EcuMModuleService=Rte_InitMemory, EcuMModuleHeader=Rte_Main.h
            SecOC_InitMemory: index=28, EcuMModuleID=SecOC, EcuMModuleService=SecOC_InitMemory, EcuMModuleHeader=SecOC.h
            Xcp_InitMemory: index=29, EcuMModuleID=Xcp, EcuMModuleService=Xcp_InitMemory, EcuMModuleHeader=Xcp.h
            CanXcp_InitMemory: index=30, EcuMModuleID=Xcp, EcuMModuleService=CanXcp_InitMemory, EcuMModuleHeader=CanXcp.h
            Rtm_InitMemory: index=49, EcuMModuleID=Rtm, EcuMModuleService=Rtm_InitMemory, EcuMModuleHeader=Rtm.h
            vMemAccM_InitMemory: index=53, EcuMModuleID=vMemAccM, EcuMModuleService=vMemAccM_InitMemory, EcuMModuleHeader=vMemAccM.h
            vFotaH_InitMemory: index=54, EcuMModuleID=vFotaH, EcuMModuleService=vFotaH_InitMemory, EcuMModuleHeader=vFotaH.h
            vSwUpdM_InitMemory: index=55, EcuMModuleID=vSwUpdM, EcuMModuleService=vSwUpdM_InitMemory, EcuMModuleHeader=vSwUpdM.h
            vStreamProc_InitMemory: index=56, EcuMModuleID=vStreamProc, EcuMModuleService=vStreamProc_InitMemory, EcuMModuleHeader=vStreamProc.h
            Det_Init: index=48, EcuMModuleID=Det, EcuMModuleService=Det_Init, EcuMModuleHeader=Det.h
            Dem_PreInit: index=47, EcuMModuleID=Dem, EcuMModuleService=Dem_PreInit, EcuMModuleHeader=Dem.h
            vStreamProc_Init: index=57, EcuMModuleID=vStreamProc, EcuMModuleService=vStreamProc_Init, EcuMModuleHeader=vStreamProc.h
        EcuMDriverInitListOne
          11 x EcuMDriverInitItem:
            BswM_PreInit: index=0, EcuMModuleID=BswM, EcuMModuleService=BswM_PreInit, EcuMModuleHeader=BswM.h
            PduR_PreInit: index=1, EcuMModuleID=PduR, EcuMModuleService=PduR_PreInit, EcuMModuleHeader=PduR.h
            Nm_PreInit: index=3, EcuMModuleID=Nm, EcuMModuleService=Nm_PreInit, EcuMModuleHeader=Nm.h
            ComM_PreInit: index=4, EcuMModuleID=ComM, EcuMModuleService=ComM_PreInit, EcuMModuleHeader=ComM.h
            E2EXf_Init: index=6, EcuMModuleID=E2EXf, EcuMModuleService=E2EXf_Init, EcuMModuleHeader=E2EXf.h
            Mcu_Init: index=8, EcuMModuleID=Mcu, EcuMModuleService=Mcu_Init, EcuMModuleHeader=Mcu.h
            Mcu_Init_AdditionalCode: index=9, EcuMModuleID=Code, EcuMAdditionalInitCode=Mcu_InitClock(0);while (MCU_PLL_LOCKED != Mcu_GetPllStatus());Mcu_DistributePllClock();, EcuMModuleHeader=Mcu.h
            vCan_30_Mcan_Init: index=9, EcuMModuleID=vCan, EcuMModuleService=vCan_30_Mcan_Init, EcuMModuleHeader=vCan_30_Mcan.h
            Port_Init: index=10, EcuMModuleID=Port, EcuMModuleService=Port_Init, EcuMModuleHeader=Port.h
            Fls_17_Dmu_Init: index=11, EcuMModuleID=Fls, EcuMModuleService=Fls_17_Dmu_Init, EcuMModuleHeader=Fls_17_Dmu.h
            Fee_Init: EcuMModuleID=Fee, EcuMModuleHeader=Fee.h, EcuMModuleService=Fee_Init
        EcuMDriverRestartList
        CN_BMC_CAN01_78a85e89 (EcuMWakeupSource): EcuMWakeupSourceId=5, EcuMWakeupSourcePolling=false, EcuMComMChannelRef=CN_BMC_CAN01_78a85e89
        CN_HCP5_CANFD01_54d90215 (EcuMWakeupSource): EcuMWakeupSourceId=6, EcuMWakeupSourcePolling=false, EcuMComMChannelRef=CN_HCP5_CANFD01_54d90215
    EcuMGeneral:
      EcuMDevErrorDetect = true
      EcuMIncludeDem = true
      EcuMIncludeDet = true
      EcuMMainFunctionPeriod = 0.01
      EcuMVersionInfoApi = false
      EcuMDeferredBswMNotification = false
      EcuMSlaveCoreHandling = true
      EcuMEnableFixBehavior = false
      EcuMNonChannelWakeupInRun = false
      EcuMSchMStartInitialization = true
      EcuMSafeBswChecks = false
      EcuMGeneration: EcuMOutOfBoundsWriteSanitizer=false, EcuMOutOfBoundsReadSanitizer=false, EcuMInterfacesForDeactivatedData=false
    EcuMFlexGeneral: EcuMAlarmClockPresent=false, EcuMResetLoopDetection=false, EcuMEnableDefBehaviour=false, EcuMModeHandling=true
