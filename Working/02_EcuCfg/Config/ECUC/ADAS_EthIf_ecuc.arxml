AUTOSAR XML (schema 00048)
package /ActiveEcuC
  module config EthIf: implementation-config-variant=VARIANT-PRE-COMPILE, module-description=EthIf_Impl
    EthIfConfigSet
      TcpIp_ARP (EthIfFrameOwnerConfig): EthIfFrameType=2054, EthIfOwner=1, EthIfBswModuleRef=TcpIp
      TcpIp_ARP_RxIndication (EthIfRxIndicationConfig): EthIfRxIndicationFunction=IpV4_Arp_RxIndication, EthIfFrameOwnerConfigRef=TcpIp_ARP
      TcpIp_IPv4 (EthIfFrameOwnerConfig): EthIfFrameType=2048, EthIfOwner=0, EthIfBswModuleRef=TcpIp
      TcpIp_IPv4_RxIndication (EthIfRxIndicationConfig): EthIfRxIndicationFunction=IpV4_Ip_RxIndication, EthIfFrameOwnerConfigRef=TcpIp_IPv4
      TcpIp_IPv4_TxConfirmation (EthIfTxConfirmationConfig): EthIfTxConfirmationFunction=IpV4_Ip_TxConfirmation, EthIfFrameOwnerConfigRef=TcpIp_IPv4
      MyECU_EEI_V10_NM_53547422 (EthIfController):
        EthIfCtrlIdx = 1
        EthIfEnableVLAN = true
        EthIfVlanId = 10
        EthIfCtrlMtu = 1500
        EthIfEnableLaxLinkAggregation = false
        EthIfPhysControllerRef = BA_MyECU_0_EPC_d9b4790c
        EthIfTransceiverRef = EthTrcvConfig
      MyECU_EEI_U_ee15deea (EthIfController):
        EthIfCtrlIdx = 0
        EthIfEnableVLAN = false
        EthIfVlanId = 0
        EthIfCtrlMtu = 1500
        EthIfEnableLaxLinkAggregation = false
        EthIfPhysControllerRef = BA_MyECU_0_EPC_d9b4790c
        EthIfTransceiverRef = EthTrcvConfig
      EthTSyn_EthTSyn (EthIfFrameOwnerConfig): EthIfFrameType=35063, EthIfOwner=3, EthIfBswModuleRef=EthTSyn
      EthTSyn_RxIndication_EthTSyn (EthIfRxIndicationConfig): EthIfRxIndicationFunction=EthTSyn_RxIndication, EthIfFrameOwnerConfigRef=EthTSyn_EthTSyn
      EthTSyn_TrcvLinkStateChg_EthTSyn (EthIfTrcvLinkStateChgConfig): EthIfTrcvLinkStateChgFunction=EthTSyn_TrcvLinkStateChg, EthIfFrameOwnerConfigRef=EthTSyn_EthTSyn
      EthTSyn_TxConfirmation_EthTSyn (EthIfTxConfirmationConfig): EthIfTxConfirmationFunction=EthTSyn_TxConfirmation, EthIfFrameOwnerConfigRef=EthTSyn_EthTSyn
      TcpIp_IPv6 (EthIfFrameOwnerConfig): EthIfFrameType=34525, EthIfOwner=2, EthIfBswModuleRef=TcpIp
      TcpIp_IPv6_RxIndication (EthIfRxIndicationConfig): EthIfRxIndicationFunction=IpV6_RxIndication, EthIfFrameOwnerConfigRef=TcpIp_IPv6
      TcpIp_IPv6_TxConfirmation (EthIfTxConfirmationConfig): EthIfTxConfirmationFunction=IpV6_TxConfirmation, EthIfFrameOwnerConfigRef=TcpIp_IPv6
      EthSM_LinkStateChgCbk (EthIfTrcvLinkStateChgConfig): EthIfTrcvLinkStateChgFunction=EthSM_TrcvLinkStateChg
    EthIfGeneral:
      EthIfDevErrorDetect = true
      EthIfEnableRxInterrupt = true
      EthIfEnableTxInterrupt = true
      EthIfMaxTrcvsTotal = 1
      EthIfMaxTxBufsTotal = 20
      EthIfTrcvLinkStateChgMainReload = 5
      EthIfVersionInfoApi = true
      EthIfVersionInfoApiMacro = false
      EthIfEnableMainFunctionState = true
      EthIfMainFunctionPeriod = 0.005
      EthIfMainFunctionRxTimeout = 0.005
      EthIfRxIndicationIterations = 5
      EthIfUpdatePhysAddrFilter = true
      EthIfEnableZeroCopyExtensions = false
      EthIfMaxExtTxBufsTotal = 0
      EthIfGlobalTimeSupport = false
      EthIfEnableHeaderAccessApi = false
      EthIfWakeupSupport = false
      EthIfSwitchManagementSupport = false
      EthIfSafeBswChecks = false
      EthIfEnableSignalQualityApi = false
      EthIfGetAndResetMeasurementDataApi = false
      EthIfEnableSecurityEventReporting = false
      EthIfPortStartupActiveTime = 0.5
      EthIfEnableMacSecApi = false
      EthIfPublicCddHeaderFile = Eth_GeneralTypes.h
