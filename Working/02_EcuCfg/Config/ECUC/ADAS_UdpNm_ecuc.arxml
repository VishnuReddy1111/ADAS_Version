AUTOSAR XML (schema 00048)
package /ActiveEcuC
  module config UdpNm: implementation-config-variant=VARIANT-PRE-COMPILE, module-description=UdpNm_Impl
    UdpNmGlobalConfig:
      UdpNmComControlEnabled = true
      UdpNmComUserDataSupport = true
      UdpNmNodeIdEnabled = true
      UdpNmUserDataEnabled = true
      UdpNmBusSynchronizationEnabled = false
      UdpNmCoordinatorSyncSupport = false
      UdpNmDevErrorDetect = true
      UdpNmPassiveModeEnabled = false
      UdpNmPduRxIndicationEnabled = false
      UdpNmRemoteSleepIndEnabled = false
      UdpNmStateChangeIndEnabled = true
      UdpNmVersionInfoApi = true
      UdpNmRuntimeMeasurementSupport = true
      UdpNmSafeBswChecks = true
      UdpNmRuntimeErrorReport = true
      UdpNmPnSyncShutdownErrorReactionEnabled = false
      UdpNmCoordinatorEnabled = false
      UdpNmCoordinatorId = 0
      UdpNmImmediateRestartEnabled = false
      UdpNmNodeDetectionEnabled = false
      UdpNmNumberOfChannels = 1
      UdpNmRepeatMsgIndEnabled = false
      UdpNmPnEiraCalcEnabled = false
      UdpNmPnResetTime = 1
      UdpNmPnInfo: UdpNmPnInfoLength=0, UdpNmPnInfoOffset=1
      MyECU_EEI_V10_NM_53547422 (UdpNmChannelConfig):
        UdpNmMsgCycleTime = 0.1
        UdpNmMsgTimeoutTime = 0.06
        UdpNmPduLength = 8
        UdpNmPduNidPosition = UDPNM_PDU_BYTE_1
        UdpNmRemoteSleepIndTime = 0.5
        UdpNmRepeatMessageTime = 0.4
        UdpNmTimeoutTime = 1
        UdpNmUserDataLength = 6
        UdpNmWaitBusSleepTime = 0.75
        UdpNmMainFunctionPeriod = 0.01
        UdpNmMsgCycleOffset = 0
        UdpNmNodeId = 0
        UdpNmPduCbvPosition = UDPNM_PDU_BYTE_0
        UdpNmImmediateNmTransmissions = 0
        UdpNmCarWakeUpRxEnabled = false
        UdpNmActiveWakeupBitEnabled = false
        UdpNmNodeIdEnabled = true
        UdpNmNodeDetectionEnabled = false
        UdpNmComControlEnabled = true
        UdpNmImmediateRestartEnabled = false
        UdpNmRepeatMsgIndEnabled = false
        UdpNmCriBitAlwaysEnabled = false
        UdpNmPnEraCalcEnabled = false
        UdpNmPnHandleMultipleNetworkRequests = false
        UdpNmPnEnabled = false
        UdpNmComMNetworkHandleRef = MyECU_EEI_V10_NM_53547422
        PDU_UdpNmRX_MyECU_f6676c1a (UdpNmRxPdu): UdpNmRxPduId=0, UdpNmRxPduRef=PDU_UdpNmRX_MyECU_fd977b7e_Rx
        PDU_UdpNmTx_MyECU_ffb55c01 (UdpNmTxPdu): UdpNmTxConfirmationPduId=0, UdpNmTxPduRef=PDU_UdpNmTx_MyECU_a23fc2ca_Tx
        PDU_UdpNmTx_MyECU_af1d7c28 (UdpNmUserDataTxPdu): UdpNmTxUserDataPduId=0, UdpNmTxUserDataPduRef=PDU_UdpNmTx_MyECU_ffb55c01_Tx
      UdpNmGeneration: UdpNmOutOfBoundsWriteSanitizer=false, UdpNmOutOfBoundsReadSanitizer=false, UdpNmInterfacesForDeactivatedData=false
