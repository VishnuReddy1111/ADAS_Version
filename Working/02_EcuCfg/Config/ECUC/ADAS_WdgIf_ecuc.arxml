AUTOSAR XML (schema 4-3-0)
package /ActiveEcuC
  module config WdgIf: implementation-config-variant=VARIANT-PRE-COMPILE, module-description=WdgIf_Impl
    WdgIfDevice_Core0 (WdgIfDevice):
      WdgIfDeviceIndex = 0
      WdgIfDeviceIncludeFile = Wdg_17_Scu.h
      WdgIfDeviceSetMode = Wdg_17_Scu_SetMode
      WdgIfDeviceSetTriggerCondition = Wdg_17_Scu_SetTriggerCondition
      WdgIfDriverRef = WdgIfStateCombinerMaster
    WdgIfGeneral: WdgIfDevErrorDetect=true, WdgIfVersionInfoApi=true, WdgIfUseStateCombiner=true
    WdgIfDevice_Core1 (WdgIfDevice): WdgIfDeviceIndex=1, WdgIfDriverRef=WdgIfStateCombinerSlave
    WdgIfStateCombiner
      WdgIfStateCombinerGeneral: WdgIfStateCombinerUseOsSpinlock=true, WdgIfStateCombinerStartUpSyncCycles=10, WdgIfStateCombinerSpinlockID=1
      WdgIfStateCombinerMaster: WdgIfStateCombinerMasterWdgRef=WdgGeneral
      WdgIfStateCombinerSlave:
        WdgIfStateCombinerReferenceCycle = 1
        WdgIfStateCombinerSlaveIncrementsMin = 0
        WdgIfStateCombinerSlaveIncrementsMax = 0
        WdgIfGlobalMemoryAppTaskRef = OsApplication_SystemApplication_Core1
