AUTOSAR XML (schema 4-3-0)
package /ActiveEcuC
  module config vFeeAcc: implementation-config-variant=VARIANT-PRE-COMPILE, module-description=vFeeAcc_Impl
    vFeeAccGeneral: vFeeAccVersionInfoApi=false, vFeeAccDevErrorDetect=true, vFeeAccMainFunctionTriggering=FixedCycleTime, vFeeAccMainFunctionPeriod=0.005
    vFeeAccAccessManagerConf: vFeeAccVirtualAddressAreaRef=Blocking
    vFeeAccFeeSettings
      vFeeAccFeeRef: vFeeAccFeeGeneralContainerRef=FeeGeneral
