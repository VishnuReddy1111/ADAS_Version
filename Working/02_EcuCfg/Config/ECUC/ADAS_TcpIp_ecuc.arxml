AUTOSAR XML (schema 00048)
package /ActiveEcuC
  module config TcpIp: implementation-config-variant=VARIANT-PRE-COMPILE, module-description=TcpIp_Impl
    TcpIpConfig
      TcpIpSocketOwnerConfig
        SoAd (TcpIpSocketOwner):
          TcpIpSocketOwnerUpperLayerType = SOAD
          TcpIpSocketOwnerId = 0
          TcpIpSocketOwnerTcpIpEventName = SoAd_TcpIpEvent
          TcpIpSocketOwnerTcpListenSocketMax = 1
          TcpIpSocketOwnerCopyTxDataDynamicLengthEnabled = false
          TcpIpSocketOwnerTxConfirmationName = SoAd_TxConfirmation
          TcpIpSocketOwnerLocalIpAddrAssignmentChgName = SoAd_LocalIpAddrAssignmentChg
          TcpIpSocketOwnerCopyTxDataName = SoAd_CopyTxData
          TcpIpSocketOwnerRxIndicationName = SoAd_RxIndication
          TcpIpSocketOwnerTcpConnectedName = SoAd_TcpConnected
          TcpIpSocketOwnerTcpAcceptedName = SoAd_TcpAccepted
          TcpIpSocketOwnerHeaderFileName = SoAd_Cbk.h
      NEP_SD_Multicast_IP_1690fc8d (TcpIpLocalAddr):
        TcpIpAddressType = TCPIP_MULTICAST
        TcpIpDomainType = TCPIP_AF_INET
        TcpIpAddrId = 1
        TcpIpIpAddrReceiveAllNotConfiguredMulticasts = false
        TcpIpCtrlRef = MyECU_EEI_U_fec61230
        NEP_SD_Multicast_IP_69a46422 (TcpIpAddrAssignment): TcpIpAssignmentMethod=TCPIP_STATIC, TcpIpAssignmentPriority=1, TcpIpAssignmentTrigger=TCPIP_AUTOMATIC
        TcpIpStaticIpAddressConfig: TcpIpStaticIpAddress=239.192.255.251
      TcpIpUdpConfig: TcpIpUdpTtl=64, TcpIpUdpTxRetryQueueSize=1
      TcpIpIpConfig
        TcpIpIpV4Config
          TcpIpArpConfig:
            TcpIpArpNumGratuitousARPonStartup = 0
            TcpIpArpPacketQueueEnabled = true
            TcpIpArpTableEntryTimeout = 30
            TcpIpArpTableSizeMax = 10
            TcpIpArpRetryTime = 5
            TcpIpArpRetryInterval = 2
            TcpIpArpRequestTimeout = 1
          TcpIpIcmpConfig: TcpIpIcmpTtl=64, TcpIpIcmpEchoReplyMaxLen=32, TcpIpIcmpDestinationUnreachableEnabled=false
        TcpIpIpV6Config
          TcpIpIcmpV6Config:
            TcpIpIcmpV6EchoDataBufferSize = 64
            TcpIpIcmpV6EchoReplyEnabled = false
            TcpIpIcmpV6HopLimit = 64
            TcpIpIcmpV6MsgDestinationUnreachableEnabled = false
            TcpIpIcmpV6MsgParameterProblemEnabled = true
            TcpIpIcmpV6EchoRequestApiEnabled = false
            TcpIpIcmpV6ErrorMessagesEnabled = true
            TcpIpIcmpV6TxMessageBufferSize = 1280
          TcpIpNdpConfig: TcpIpNdpRfc6106DnsslOptEnabled=false, TcpIpNdpRfc6106RdnssOptEnabled=false
            TcpIpNdpArNudConfig:
              TcpIpNdpDefaultReachableTime = 30
              TcpIpNdpDefaultRetransTimer = 1
              TcpIpNdpDelayFirstProbeTime = 5
              TcpIpNdpMaxNeighborCacheSize = 5
              TcpIpNdpMaxRandomFactor = 15
              TcpIpNdpMinRandomFactor = 5
              TcpIpNdpNeighborUnreachabilityDetectionEnabled = true
              TcpIpNdpNumMulticastSolicitations = 3
              TcpIpNdpNumUnicastSolicitations = 3
              TcpIpNdpPacketQueueEnabled = true
              TcpIpNdpRandomReachableTimeEnabled = true
              TcpIpNdpInverseNaEnabled = false
              TcpIpNdpInverseNsEnabled = false
              TcpIpNdpNeighborCacheUpdateByInverseNaEnabled = true
            TcpIpNdpPrefixRouterDiscoveryConfig:
              TcpIpNdpDefaultRouterListSize = 2
              TcpIpNdpDestinationCacheSize = 5
              TcpIpNdpDynamicHopLimitEnabled = true
              TcpIpNdpDynamicMtuEnabled = false
              TcpIpNdpDynamicReachableTimeEnabled = true
              TcpIpNdpDynamicRetransTimeEnabled = true
              TcpIpNdpMaxRtrSolicitationDelay = 1
              TcpIpNdpMaxRtrSolicitations = 3
              TcpIpNdpPrefixListSize = 5
              TcpIpNdpRndRtrSolicitationDelayEnabled = true
              TcpIpNdpRtrSolicitationInterval = 4
            TcpIpNdpSlaacConfig:
              TcpIpNdpSlaacDadNumberOfTransmissions = 1
              TcpIpNdpSlaacDadRetransmissionDelay = 1
              TcpIpNdpSlaacDelayEnabled = true
              TcpIpNdpSlaacOptimisticDadEnabled = false
              TcpIpNdpSlaacMinLifetime = 7200
              TcpIpNdpSlaacMaxDelay = 1
      MyECU_EEI_V10_NM_44248c36 (TcpIpCtrl): TcpIpIpFramePrioDefault=2, TcpIpEthIfCtrlRef=MyECU_EEI_V10_NM_53547422
        TcpIpIpVXCtrl
          TcpIpIpV6Ctrl:
            TcpIpIpV6DefaultHopLimit = 0
            TcpIpIpV6DefaultTrafficClass = 0
            TcpIpIpV6DefaultFlowLabel = 0
            TcpIpIpV6CtrlIdx = 0
            TcpIpDiscardUnknownExtHdr = false
            TcpIpIpV6NdpConfigRef = TcpIpNdpConfig
            TcpIpIpV6MtuConfig: TcpIpIpV6DefaultMtuSize=1500, TcpIpIpV6PathMtuEnabled=false, TcpIpIpV6PathMtuTimeout=600
      NEP_MyECU_b5eec5f0 (TcpIpLocalAddr):
        TcpIpAddressType = TCPIP_UNICAST
        TcpIpDomainType = TCPIP_AF_INET
        TcpIpAddrId = 0
        TcpIpIpAddrReceiveAllNotConfiguredMulticasts = false
        TcpIpCtrlRef = MyECU_EEI_U_fec61230
        NEP_MyECU_22f7945c (TcpIpAddrAssignment): TcpIpAssignmentMethod=TCPIP_STATIC, TcpIpAssignmentPriority=1, TcpIpAssignmentTrigger=TCPIP_AUTOMATIC
        TcpIpStaticIpAddressConfig: TcpIpNetmask=24, TcpIpStaticIpAddress=192.168.1.11
      TcpIpTcpConfig:
        TcpIpTcpCongestionAvoidanceEnabled = false
        TcpIpTcpFastRecoveryEnabled = false
        TcpIpTcpFastRetransmitEnabled = false
        TcpIpTcpFinWait2Timeout = 30
        TcpIpTcpKeepAliveEnabled = false
        TcpIpTcpKeepAliveInterval = 0
        TcpIpTcpKeepAliveProbesMax = 0
        TcpIpTcpKeepAliveTime = 7200
        TcpIpTcpMsl = 0.5
        TcpIpTcpNagleEnabled = true
        TcpIpTcpReceiveWindowMax = 512
        TcpIpTcpSlowStartEnabled = false
        TcpIpTcpSynMaxRtx = 255
        TcpIpTcpSynReceivedTimeout = 0
        TcpIpTcpTtl = 64
        TcpIpTcpUserTimeoutDef = 20
        TcpIpTcpUserTimeoutOptionSupport = false
        TcpIpTcpTimeStampOptionSupport = false
        TcpIpTcpTxResetQueueSize = 8
        TcpIpTcpTxRetryQueueSize = 10
        TcpIpTcpOutOfOrderRxSupport = true
        TcpIpTcpNoRstInvSocket = false
        TcpIpTcpRetransmissionTimeout = 1
        TcpIpTcpNagleTimeout = 0
        TcpIpTcpAvgNumOooSegsPerSocket = 5
        TcpIpTcpMaxNumOooSegsPerSocket = 5
        TcpIpTcpSackOptionSupport = false
        TcpIpTcpRetransmissionTimeoutMax = 60
        TcpIpTcpSocketBuffer: TcpIpTcpSocketRxBufferSize=512, TcpIpTcpSocketTxBufferSize=512
        TcpIpTcpSocketBuffer_001 (TcpIpTcpSocketBuffer): TcpIpTcpSocketRxBufferSize=512, TcpIpTcpSocketTxBufferSize=512
      MyECU_EEI_U_fec61230 (TcpIpCtrl): TcpIpIpFramePrioDefault=0, TcpIpEthIfCtrlRef=MyECU_EEI_U_ee15deea
        TcpIpIpVXCtrl
          TcpIpIpV4Ctrl: TcpIpIpDefaultTtl=0, TcpIpIpTypeOfServiceDefault=0, TcpIpIpCtrlIdx=0, TcpIpArpConfigRef=TcpIpArpConfig
      3 x TcpIpLocalAddr, all with TcpIpIpAddrReceiveAllNotConfiguredMulticasts=false:
        NEP_NM_IPv6_Multicast_0621f4c5: TcpIpAddressType=TCPIP_MULTICAST, TcpIpDomainType=TCPIP_AF_INET6, TcpIpAddrId=4, TcpIpCtrlRef=MyECU_EEI_V10_NM_44248c36
          NEP_NM_IPv6_Multicast_03372d6d (TcpIpAddrAssignment): TcpIpAssignmentMethod=TCPIP_STATIC, TcpIpAssignmentPriority=1, TcpIpAssignmentTrigger=TCPIP_AUTOMATIC
          TcpIpStaticIpAddressConfig: TcpIpStaticIpAddress=FF02:0:0:0:0:0:0:1
        NEP_NM_IPv6_MyECU_LinkLocal_cc2dfcf9: TcpIpAddressType=TCPIP_UNICAST, TcpIpDomainType=TCPIP_AF_INET6, TcpIpAddrId=3, TcpIpCtrlRef=MyECU_EEI_V10_NM_44248c36
          NEP_NM_IPv6_MyECU_LinkLocal_ed5c3e35 (TcpIpAddrAssignment): TcpIpAssignmentLifetime=TCPIP_FORGET, TcpIpAssignmentMethod=TCPIP_LINKLOCAL, TcpIpAssignmentPriority=1, TcpIpAssignmentTrigger=TCPIP_AUTOMATIC
        TcpIpV4LocalAddr_MyECU_EEI_U_fec61230_Broadcast: TcpIpAddrId=2, TcpIpAddressType=TCPIP_IPV4_BROADCAST, TcpIpDomainType=TCPIP_AF_INET, TcpIpCtrlRef=MyECU_EEI_U_fec61230
          TcpIpAddrAssignment: TcpIpAssignmentMethod=TCPIP_STATIC, TcpIpAssignmentPriority=1, TcpIpAssignmentTrigger=TCPIP_AUTOMATIC
      MyECU_EEI_untagged_IpV6 (TcpIpCtrl): TcpIpIpFramePrioDefault=0, TcpIpEthIfCtrlRef=MyECU_EEI_U_ee15deea
        TcpIpIpVXCtrl
          TcpIpIpV6Ctrl_untagged (TcpIpIpV6Ctrl):
            TcpIpIpV6DefaultHopLimit = 0
            TcpIpIpV6DefaultTrafficClass = 0
            TcpIpIpV6DefaultFlowLabel = 0
            TcpIpIpV6CtrlIdx = 1
            TcpIpDiscardUnknownExtHdr = false
            TcpIpIpV6NdpConfigRef = TcpIpNdpConfig
            TcpIpIpV6MtuConfig: TcpIpIpV6DefaultMtuSize=1500, TcpIpIpV6PathMtuEnabled=false, TcpIpIpV6PathMtuTimeout=600
      TcpIpV6LocalAddr_MyECU_EEI_untagged_IpV6_AsAn (TcpIpLocalAddr):
        TcpIpAddrId = 6
        TcpIpAddressType = TCPIP_MULTICAST
        TcpIpDomainType = TCPIP_AF_INET6
        TcpIpIpAddrReceiveAllNotConfiguredMulticasts = false
        TcpIpCtrlRef = MyECU_EEI_untagged_IpV6
        TcpIpAddrAssignment: TcpIpAssignmentMethod=TCPIP_STATIC, TcpIpAssignmentPriority=1, TcpIpAssignmentTrigger=TCPIP_AUTOMATIC
        TcpIpStaticIpAddressConfig: TcpIpStaticIpAddress=ff02::1
      TcpIpV6LocalAddr_MyECU_EEI_untagged_IpV6_LinkLocal (TcpIpLocalAddr):
        TcpIpAddrId = 5
        TcpIpAddressType = TCPIP_UNICAST
        TcpIpDomainType = TCPIP_AF_INET6
        TcpIpIpAddrReceiveAllNotConfiguredMulticasts = false
        TcpIpCtrlRef = MyECU_EEI_untagged_IpV6
        TcpIpAddrAssignment: TcpIpAssignmentMethod=TCPIP_LINKLOCAL, TcpIpAssignmentPriority=1, TcpIpAssignmentTrigger=TCPIP_AUTOMATIC, TcpIpAssignmentLifetime=TCPIP_FORGET
    TcpIpGeneral:
      TcpIpTcpEnabled = true
      TcpIpUdpEnabled = true
      TcpIpBufferMemory = 2048
      TcpIpDevErrorDetect = true
      TcpIpDhcpServerEnabled = false
      TcpIpMainFunctionPeriod = 0.005
      TcpIpResetIpAssignmentApi = false
      TcpIpScalabilityClass = SC3
      TcpIpTcpSocketMax = 3
      TcpIpUdpSocketMax = 11
      TcpIpVersionInfoApi = true
      TcpIpRandNoFct = Demo_GetRandNo
      TcpIpRandNoFctIncludeFile = Demo.h
      TcpIpDiagExtensionsEnabled = false
      TcpIpLowerLayerName = EthIf
      TcpIpMainFunctionSplitEnabled = true
      TcpIpSafeBswChecks = false
      TcpIpGetDhcpStatusApi = false
      TcpIpIpSecEnabled = false
      TcpIpGetAndResetMeasurementDataApi = false
      TcpIpAsrTlsEnabled = false
      TcpIpMultiCoreSupportEnabled = false
      TcpIpCsmAccessIndirectionPrefix = Csm
      TcpIpEnableSecurityEventReporting = false
      TcpIpGeneration:
        TcpIpOutOfBoundsWriteProtectionStrategy = NONE
        TcpIpOutOfBoundsWriteSanitizer = false
        TcpIpOutOfBoundsReadSanitizer = false
        TcpIpReduceConstantData2Define = false
        TcpIpBoolDataInArrayOfStructStrategy = BOOLEAN
        TcpIpDeduplicateIndirectedData = true
        TcpIpDataDeduplicationStrategy = NONE
        TcpIpReduceBoolDataByNegationThreshold = 2
        TcpIpReduceBoolDataByNumericalComparisonThreshold = 2
        TcpIpReduceBoolDataByNumericalRelationThreshold = 2
        TcpIpReduceBoolDataByNumericalOperandStrategy = DEDUPLICATE_DATA_WITH_ANY_VALUE
        TcpIpReduceNumericalDataByOffsetThreshold = 0
        TcpIpReduceNumericalDataByArraySubtractionThreshold = 2
        TcpIpReduceDataByStreaming = false
        TcpIpShortSymbols = false
        TcpIpInterfacesForDeactivatedData = false
        TcpIpReferringKeysInComments = false
      TcpIpIpV6General:
        TcpIpIpV6Enabled = true
        TcpIpDhcpV6ClientEnabled = false
        TcpIpIpV6PathMtuDiscoveryEnabled = false
        TcpIpLocalAddrIpv6EntriesMax = 4
        TcpIpNdpAddressResolutionUnrechabilityDetectionEnabled = true
        TcpIpNdpPrefixAndRouterDiscoveryEnabled = true
        TcpIpIpV6EthIfUpdatePhysAddrFilterApiEnabled = true
        TcpIpIpV6SetTrafficClassAndFlowLabelApiEnabled = false
        TcpIpIpV6ExtendedDestAddrValidationEnabled = false
        TcpIpIpV6CacheLookupOptimizationEnabled = true
        TcpIpIpV6DefaultCtrl = TcpIpIpV6Ctrl_untagged
      TcpIpIpV4General:
        TcpIpIpV4Enabled = true
        TcpIpArpEnabled = true
        TcpIpAutoIpEnabled = false
        TcpIpDhcpClientEnabled = false
        TcpIpIcmpEnabled = true
        TcpIpLocalAddrIpv4EntriesMax = 3
        TcpIpPathMtuDiscoveryEnabled = false
        TcpIpIpV4EthIfUpdatePhysAddrFilterApiEnabled = true
        TcpIpArpDiscardedEntryHandling = false
