AUTOSAR XML (schema 00048)
package /ActiveEcuC
  module config Lin: implementation-config-variant=VARIANT-PRE-COMPILE, module-description=Lin_Impl
    LinGlobalConfig
      CN_LIN00_19b2d5e7 (LinChannel):
        LinChannelBaudRate = 19200
        LinChannelId = 0
        LinNodeType = MASTER
        LinChannelWakeupSupport = true
        LinUart = 2
        LinBreakFieldLength = 14
        LinBreakDelimiterLength = 2
        LinAlternateInputSelect = INPUT_3
        LinClockSource = F_ASCLINS
        LinAutobaudDetection = false
        LinChannelEcuMWakeupSource = CN_LIN00_19b2d5e7
        LinClockRef = McuClockReferencePoint_LIN
      LinDemEventParameterRefs: LIN_E_TIMEOUT=AutoCreatedDemEvent_LIN_E_TIMEOUT
    LinGeneral:
      LinDevErrorDetect = true
      LinIndex = 0
      LinTimeoutDuration = 100
      LinVersionInfoApi = true
      LinTypeOfInterruptFunction = CATEGORY2
      LinRuntimeMeasurementSupport = true
      LinSafeBswChecks = false
      LinNodeTypeAllowed = Master
      LinSupportPollingMode = false
    LinPlatformConfig:
      LinRegisterAddresses = 0xF0000600UL 0xF0000700UL 0xF0000800UL 0xF0000900UL 0xF0000A00UL 0xF0000B00UL 0xF0000C00UL 0xF0000D00UL 0xF0000E00UL 0xF0000F00UL 0xF02C0A00UL 0xF02C0B00UL 0xF02C0C00UL 0xF02C0D00UL 0xF02C0E00UL 0xF02C0F00UL 0xF02C1000UL 0xF02C1100UL 0xF02C1200UL 0xF02C1300UL 0xF02C1400UL 0xF02C1500UL 0xF02C1600UL 0xF02C1700UL
      LinClockRegister = F_OSC=0x04 F_ASCLINF=0x02 F_ASCLINS=0x04
      LinNewRegisterStructUsed = false
