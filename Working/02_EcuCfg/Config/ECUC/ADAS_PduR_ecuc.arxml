AUTOSAR XML (schema 4-3-0)
package /ActiveEcuC
  module config PduR: implementation-config-variant=VARIANT-PRE-COMPILE, module-description=PduR_Impl
    PduRGeneral:
      PduRDevErrorDetect = true
      PduRVersionInfoApi = true
      PduRMetaDataSupport = false
      PduRPduCallback = false
      PduRSwitching = false
      PduRSafeBswChecks = false
      PduREnableDeferredTransmission = false
      PduREnableDeferredReception = false
      PduRSupportMulticore = false
      PduRRoutingTypeGateway = true
      PduRSpinlockRetryCounter = 4294967295
      PduRExtendedErrorChecks = false
      PduRGeneration:
        PduROutOfBoundsWriteProtectionStrategy = NONE
        PduROutOfBoundsWriteSanitizer = false
        PduROutOfBoundsReadSanitizer = false
        PduRNumericalDataTypeMinimizationStrategy = WITH_CAST
        PduRReduceConstantData2Define = false
        PduRBoolDataInArrayOfStructStrategy = BITMASKING
        PduRDeduplicateIndirectedData = true
        PduRDataDeduplicationStrategy = WITH_CAST
        PduRReduceBoolDataByNegationThreshold = 2
        PduRReduceBoolDataByNumericalComparisonThreshold = 2
        PduRReduceBoolDataByNumericalRelationThreshold = 2
        PduRReduceBoolDataByNumericalOperandStrategy = WITH_ANY_VALUE
        PduRReduceNumericalDataByOffsetThreshold = 2
        PduRReduceNumericalDataByArraySubtractionThreshold = 2
        PduRReduceDataByStreaming = false
        PduRShortSymbols = false
        PduRInterfacesForDeactivatedData = false
        PduRReferringKeysInComments = false
    PduRRoutingTables: PduRConfigurationId=0
      PduRRoutingTable
        142 x PduRRoutingPath, all with PduRMulticoreRoutingPath=false, PduRLockRef=PduRLock_PduRExclusiveArea:
          BMC_CMC_Zellspannung_02_XIX_HCP5_CANFD01_1de9628b_Tx: PduRRoutingPathCommunicationType=COMMUNICATION_INTERFACE
            PduRSrcPdu_1b71b75a (PduRSrcPdu):
              PduRSourcePduHandleId = 4
              PduRSrcPduDirection = TRANSMIT
              PduRSrcPduRef = BMC_CMC_Zellspannung_02_XIX_HCP5_CANFD01_1de9628b_Tx
              PduRSrcPduPduRBswModulesRef = Com
            BMC_CMC_Zellspannung_02_XIX_HCP5_CANFD01_cba4cd94_Tx (PduRDestPdu):
              PduRDestPduHandleId = 4
              PduRDestPduDirection = TRANSMIT
              PduRDestPduRoutingType = API_FORWARDING
              PduRDestPduDataProcessing = IMMEDIATE
              PduRPduLengthHandlingStrategy = IGNORE
              PduRDestPduCrossPartitionDestination = false
              PduRTransmissionConfirmation = true
              PduRDestPduDataProvision = PDUR_DIRECT
              PduRDestPduRef = BMC_CMC_Zellspannung_02_XIX_HCP5_CANFD01_cba4cd94_Tx
              PduRDestPduPduRBswModulesRef = CanIf
          VDSO_05_XIX_HCP5_CANFD01_f45d20ad_Rx: PduRRoutingPathCommunicationType=COMMUNICATION_INTERFACE
            VDSO_05_XIX_HCP5_CANFD01_f45d20ad_Rx_fbfe2c62_Rx (PduRDestPdu):
              PduRDestPduHandleId = 66
              PduRDestPduDirection = RECEIVE
              PduRDestPduRoutingType = API_FORWARDING
              PduRDestPduDataProcessing = IMMEDIATE
              PduRPduLengthHandlingStrategy = IGNORE
              PduRDestPduCrossPartitionDestination = false
              PduRTransmissionConfirmation = false
              PduRDestPduRef = VDSO_05_XIX_HCP5_CANFD01_48366f26_Rx
              PduRDestPduPduRBswModulesRef = Com
            PduRSrcPdu_fbfe2c62 (PduRSrcPdu): PduRSourcePduHandleId=84, PduRSrcPduDirection=RECEIVE, PduRSrcPduRef=VDSO_05_XIX_HCP5_CANFD01_f45d20ad_Rx, PduRSrcPduPduRBswModulesRef=CanIf
          HVLM_13_XIX_HCP5_CANFD01_f34a06e4_Rx: PduRRoutingPathCommunicationType=COMMUNICATION_INTERFACE
            HVLM_13_XIX_HCP5_CANFD01_f34a06e4_Rx_a57e9da9_Rx (PduRDestPdu):
              PduRDestPduHandleId = 26
              PduRDestPduDirection = RECEIVE
              PduRDestPduRoutingType = API_FORWARDING
              PduRDestPduDataProcessing = IMMEDIATE
              PduRPduLengthHandlingStrategy = IGNORE
              PduRDestPduCrossPartitionDestination = false
              PduRTransmissionConfirmation = false
              PduRDestPduRef = HVLM_13_XIX_HCP5_CANFD01_f1be44f1_Rx
              PduRDestPduPduRBswModulesRef = Com
            PduRSrcPdu_a57e9da9 (PduRSrcPdu): PduRSourcePduHandleId=51, PduRSrcPduDirection=RECEIVE, PduRSrcPduRef=HVLM_13_XIX_HCP5_CANFD01_f34a06e4_Rx, PduRSrcPduPduRBswModulesRef=CanIf
          UI1_04_XIX_BMC_CAN01_f5320b92_Rx: PduRRoutingPathCommunicationType=COMMUNICATION_INTERFACE
            UI1_04_XIX_BMC_CAN01_f5320b92_Rx_a68bd2dd_Rx (PduRDestPdu):
              PduRDestPduHandleId = 50
              PduRDestPduDirection = RECEIVE
              PduRDestPduRoutingType = API_FORWARDING
              PduRDestPduDataProcessing = IMMEDIATE
              PduRPduLengthHandlingStrategy = IGNORE
              PduRDestPduCrossPartitionDestination = false
              PduRTransmissionConfirmation = false
              PduRDestPduRef = UI1_04_XIX_BMC_CAN01_d976c5c1_Rx
              PduRDestPduPduRBswModulesRef = Com
            PduRSrcPdu_a68bd2dd (PduRSrcPdu): PduRSourcePduHandleId=68, PduRSrcPduDirection=RECEIVE, PduRSrcPduRef=UI1_04_XIX_BMC_CAN01_f5320b92_Rx, PduRSrcPduPduRBswModulesRef=CanIf
          DEV_Hybrid_01_Req_00_XIX_HCP5_CANFD01_91241766_Rx: PduRRoutingPathCommunicationType=COMMUNICATION_INTERFACE
            DEV_Hybrid_01_Req_00_XIX_HCP5_CANFD01_91241766_Rx_69081bae_Rx (PduRDestPdu):
              PduRDestPduHandleId = 18
              PduRDestPduDirection = RECEIVE
              PduRDestPduRoutingType = API_FORWARDING
              PduRDestPduDataProcessing = IMMEDIATE
              PduRPduLengthHandlingStrategy = IGNORE
              PduRDestPduCrossPartitionDestination = false
              PduRTransmissionConfirmation = false
              PduRDestPduRef = DEV_Hybrid_01_Req_00_XIX_HCP5_CANFD01_5661b344_Rx
              PduRDestPduPduRBswModulesRef = Com
            PduRSrcPdu_69081bae (PduRSrcPdu):
              PduRSourcePduHandleId = 44
              PduRSrcPduDirection = RECEIVE
              PduRSrcPduRef = DEV_Hybrid_01_Req_00_XIX_HCP5_CANFD01_91241766_Rx
              PduRSrcPduPduRBswModulesRef = CanIf
          BMC_HV_b485d83b_Rx: PduRRoutingPathCommunicationType=COMMUNICATION_INTERFACE
            BMC_HV_b485d83b_Rx_1e673584_Rx (PduRDestPdu):
              PduRDestPduHandleId = 38
              PduRDestPduDirection = RECEIVE
              PduRDestPduRoutingType = API_FORWARDING
              PduRDestPduDataProcessing = IMMEDIATE
              PduRPduLengthHandlingStrategy = IGNORE
              PduRDestPduCrossPartitionDestination = false
              PduRTransmissionConfirmation = false
              PduRDestPduRef = ORU_Control_D_01_XIX_HCP5_CANFD01_E2E_6e31ae8f_Rx
              PduRDestPduPduRBswModulesRef = Com
            PduRSrcPdu_1e673584 (PduRSrcPdu):
              PduRSourcePduHandleId = 25
              PduRSrcPduDirection = RECEIVE
              PduRSrcPduRef = ORU_Control_D_01_XIX_HCP5_CANFD01_E2E_9ed03939_Rx
              PduRSrcPduPduRBswModulesRef = CanIf
            BMC_HV_c64edb55_Tx (PduRDestPdu):
              PduRDestPduHandleId = 62
              PduRDestPduDirection = TRANSMIT
              PduRDestPduRoutingType = GATEWAY_ROUTING
              PduRDestPduDataProcessing = IMMEDIATE
              PduRPduLengthHandlingStrategy = IGNORE
              PduRDestPduCrossPartitionDestination = false
              PduRTransmissionConfirmation = false
              PduRDestPduDataProvision = PDUR_DIRECT
              PduRDestPduRef = ORU_Control_D_01_XIX_BMC_CAN01_0f07b83a_Tx
              PduRDestPduPduRBswModulesRef = CanIf
          UI2Sens01_CALID_01_XIX_BMC_CAN01_6126d1bc_Rx: PduRRoutingPathCommunicationType=COMMUNICATION_INTERFACE
            PduRSrcPdu_d28b6e52 (PduRSrcPdu):
              PduRSourcePduHandleId = 72
              PduRSrcPduDirection = RECEIVE
              PduRSrcPduRef = UI2Sens01_CALID_01_XIX_BMC_CAN01_6126d1bc_Rx
              PduRSrcPduPduRBswModulesRef = CanIf
            UI2Sens01_CALID_01_XIX_BMC_CAN01_6126d1bc_Rx_d28b6e52_Rx (PduRDestPdu):
              PduRDestPduHandleId = 54
              PduRDestPduDirection = RECEIVE
              PduRDestPduRoutingType = API_FORWARDING
              PduRDestPduDataProcessing = IMMEDIATE
              PduRPduLengthHandlingStrategy = IGNORE
              PduRDestPduCrossPartitionDestination = false
              PduRTransmissionConfirmation = false
              PduRDestPduRef = UI2Sens01_CALID_01_XIX_BMC_CAN01_f3c92280_Rx
              PduRDestPduPduRBswModulesRef = Com
          HVEM_07_XIX_HCP5_CANFD01_6bc428a9_Rx: PduRRoutingPathCommunicationType=COMMUNICATION_INTERFACE
            HVEM_07_XIX_HCP5_CANFD01_6bc428a9_Rx_0e19c894_Rx (PduRDestPdu):
              PduRDestPduHandleId = 23
              PduRDestPduDirection = RECEIVE
              PduRDestPduRoutingType = API_FORWARDING
              PduRDestPduDataProcessing = IMMEDIATE
              PduRPduLengthHandlingStrategy = IGNORE
              PduRDestPduCrossPartitionDestination = false
              PduRTransmissionConfirmation = false
              PduRDestPduRef = HVEM_07_XIX_HCP5_CANFD01_839f516f_Rx
              PduRDestPduPduRBswModulesRef = Com
            PduRSrcPdu_0e19c894 (PduRSrcPdu): PduRSourcePduHandleId=48, PduRSrcPduDirection=RECEIVE, PduRSrcPduRef=HVEM_07_XIX_HCP5_CANFD01_6bc428a9_Rx, PduRSrcPduPduRBswModulesRef=CanIf
          DCDC_NV_Komponentenfehler_02_XIX_HCP5_CANFD01_01a686cc_Rx: PduRRoutingPathCommunicationType=COMMUNICATION_INTERFACE
            PduRSrcPdu_58b8b145 (PduRSrcPdu):
              PduRSourcePduHandleId = 41
              PduRSrcPduDirection = RECEIVE
              PduRSrcPduRef = DCDC_NV_Komponentenfehler_02_XIX_HCP5_CANFD01_01a686cc_Rx
              PduRSrcPduPduRBswModulesRef = CanIf
            DCDC_NV_Komponentenfehler_02_XIX_HCP5_CANFD01_01a686cc_Rx_58b8b145_Rx (PduRDestPdu):
              PduRDestPduHandleId = 15
              PduRDestPduDirection = RECEIVE
              PduRDestPduRoutingType = API_FORWARDING
              PduRDestPduDataProcessing = IMMEDIATE
              PduRPduLengthHandlingStrategy = IGNORE
              PduRDestPduCrossPartitionDestination = false
              PduRTransmissionConfirmation = false
              PduRDestPduRef = DCDC_NV_Komponentenfehler_02_XIX_HCP5_CANFD01_37eeaa04_Rx
              PduRDestPduPduRBswModulesRef = Com
          BJB_CALID_01_XIX_BMC_CAN01_89dc60ad_Rx: PduRRoutingPathCommunicationType=COMMUNICATION_INTERFACE
            PduRSrcPdu_41bc7e76 (PduRSrcPdu): PduRSourcePduHandleId=6, PduRSrcPduDirection=RECEIVE, PduRSrcPduRef=BJB_CALID_01_XIX_BMC_CAN01_89dc60ad_Rx, PduRSrcPduPduRBswModulesRef=CanIf
            BJB_CALID_01_XIX_BMC_CAN01_89dc60ad_Rx_41bc7e76_Rx (PduRDestPdu):
              PduRDestPduHandleId = 6
              PduRDestPduDirection = RECEIVE
              PduRDestPduRoutingType = API_FORWARDING
              PduRDestPduDataProcessing = IMMEDIATE
              PduRPduLengthHandlingStrategy = IGNORE
              PduRDestPduCrossPartitionDestination = false
              PduRTransmissionConfirmation = false
              PduRDestPduRef = BJB_CALID_01_XIX_BMC_CAN01_adee7d66_Rx
              PduRDestPduPduRBswModulesRef = Com
          NM_Hybrid_01_XIX_HCP5_CANFD01_c84ff8a5_Tx: PduRRoutingPathCommunicationType=COMMUNICATION_INTERFACE
            NM_Hybrid_01_XIX_HCP5_CANFD01_c84ff8a5_Tx_448d0b52_Tx (PduRDestPdu):
              PduRDestPduHandleId = 48
              PduRDestPduDirection = TRANSMIT
              PduRDestPduRoutingType = API_FORWARDING
              PduRDestPduDataProcessing = IMMEDIATE
              PduRPduLengthHandlingStrategy = IGNORE
              PduRDestPduCrossPartitionDestination = false
              PduRTransmissionConfirmation = true
              PduRDestPduDataProvision = PDUR_TRIGGERTRANSMIT
              PduRDestPduRef = NM_Hybrid_01_XIX_HCP5_CANFD01_c84ff8a5_Tx
              PduRDestPduPduRBswModulesRef = CanNm
            PduRSrcPdu_448d0b52 (PduRSrcPdu): PduRSourcePduHandleId=41, PduRSrcPduDirection=TRANSMIT, PduRSrcPduRef=NM_Hybrid_01_XIX_HCP5_CANFD01_c84ff8a5_Tx, PduRSrcPduPduRBswModulesRef=Com
          UI1_02_XIX_BMC_CAN01_E2E_aa93ac73_Rx: PduRRoutingPathCommunicationType=COMMUNICATION_INTERFACE
            PduRSrcPdu_ca25ded9 (PduRSrcPdu): PduRSourcePduHandleId=66, PduRSrcPduDirection=RECEIVE, PduRSrcPduRef=UI1_02_XIX_BMC_CAN01_E2E_aa93ac73_Rx, PduRSrcPduPduRBswModulesRef=CanIf
            UI1_02_XIX_BMC_CAN01_E2E_aa93ac73_Rx_ca25ded9_Rx (PduRDestPdu):
              PduRDestPduHandleId = 48
              PduRDestPduDirection = RECEIVE
              PduRDestPduRoutingType = API_FORWARDING
              PduRDestPduDataProcessing = IMMEDIATE
              PduRPduLengthHandlingStrategy = IGNORE
              PduRDestPduCrossPartitionDestination = false
              PduRTransmissionConfirmation = false
              PduRDestPduRef = UI1_02_XIX_BMC_CAN01_E2E_6d9e0c76_Rx
              PduRDestPduPduRBswModulesRef = Com
          DCM_HCP5_CANFD01_XIX_TPCHType_CANHS_OBDx_XIX_0x18DAF105_XIX_0x18DA05F1_XIX_Physical_9db247ca_Tx: PduRRoutingPathCommunicationType=TRANSPORT_PROTOCOL
            DCM_HCP5_CANFD01_XIX_TPCHType_CANHS_OBDx_XIX_0x18DAF105_XIX_0x18DA05F1_XIX_Physical_71746075_Tx (PduRDestPdu):
              PduRDestPduHandleId = 5
              PduRDestPduDirection = TRANSMIT
              PduRDestPduRoutingType = API_FORWARDING
              PduRDestPduDataProcessing = IMMEDIATE
              PduRPduLengthHandlingStrategy = UNUSED
              PduRDestPduCrossPartitionDestination = false
              PduRDestPduRef = DCM_HCP5_CANFD01_XIX_TPCHType_CANHS_OBDx_XIX_0x18DAF105_XIX_0x18DA05F1_XIX_Physical_71746075_Tx
              PduRDestPduPduRBswModulesRef = CanTp
            PduRSrcPdu_8c8ce63b (PduRSrcPdu):
              PduRSourcePduHandleId = 33
              PduRSrcPduDirection = TRANSMIT
              PduRSrcPduRef = DCM_HCP5_CANFD01_XIX_TPCHType_CANHS_OBDx_XIX_0x18DAF105_XIX_0x18DA05F1_XIX_Physical_9db247ca_Tx
              PduRSrcPduPduRBswModulesRef = Dcm
          SOK_Zeit_Hybrid_01_Resp_01_XIX_HCP5_CANFD01_c7a98a10_Rx: PduRRoutingPathCommunicationType=COMMUNICATION_INTERFACE
            PduRSrcPdu_c1028dd0 (PduRSrcPdu):
              PduRSourcePduHandleId = 63
              PduRSrcPduDirection = RECEIVE
              PduRSrcPduRef = SOK_Zeit_Hybrid_01_Resp_01_XIX_HCP5_CANFD01_c7a98a10_Rx
              PduRSrcPduPduRBswModulesRef = SecOC
            SOK_Zeit_Hybrid_01_Resp_01_XIX_HCP5_CANFD01_c7a98a10_Rx (PduRDestPdu):
              PduRDestPduHandleId = 44
              PduRDestPduDirection = RECEIVE
              PduRDestPduRoutingType = API_FORWARDING
              PduRDestPduDataProcessing = IMMEDIATE
              PduRPduLengthHandlingStrategy = IGNORE
              PduRDestPduCrossPartitionDestination = false
              PduRTransmissionConfirmation = false
              PduRDestPduRef = SOK_Zeit_Hybrid_01_Resp_01_XIX_HCP5_CANFD01_c7a98a10_Rx
              PduRDestPduPduRBswModulesRef = Com
          ComIPduPnc_EIRA_CAN_Rx_cca0f11f_Rx: PduRRoutingPathCommunicationType=COMMUNICATION_INTERFACE
            ComIPduPnc_EIRA_CAN_Rx_cca0f11f_Rx_bb7efc37_Rx (PduRDestPdu):
              PduRDestPduHandleId = 41
              PduRDestPduDirection = RECEIVE
              PduRDestPduRoutingType = API_FORWARDING
              PduRDestPduDataProcessing = IMMEDIATE
              PduRPduLengthHandlingStrategy = IGNORE
              PduRDestPduCrossPartitionDestination = false
              PduRTransmissionConfirmation = false
              PduRDestPduRef = PduPnc_EIRA_CAN_Rx
              PduRDestPduPduRBswModulesRef = Com
            PduRSrcPdu_bb7efc37 (PduRSrcPdu): PduRSourcePduHandleId=36, PduRSrcPduDirection=RECEIVE, PduRSrcPduRef=PduPnc_EIRA_CAN_Rx, PduRSrcPduPduRBswModulesRef=CanNm
          BMC_HV_0bbdd542_Rx: PduRRoutingPathCommunicationType=TRANSPORT_PROTOCOL
            PduRSrcPdu_31fc5fb2 (PduRSrcPdu):
              PduRSourcePduHandleId = 0
              PduRSrcPduDirection = RECEIVE
              PduRSrcPduRef = DCM_HCP5_CANFD01_XIX_TPCHType_CANFD_OBDC_Diagnose_XIX_0x1C410200_XIX_Functional_c81dd985_Rx
              PduRSrcPduPduRBswModulesRef = CanTp
            BMC_HV_d297f2ea_Tx (PduRDestPdu):
              PduRDestPduHandleId = 1
              PduRDestPduDirection = TRANSMIT
              PduRDestPduRoutingType = GATEWAY_ROUTING
              PduRDestPduDataProcessing = IMMEDIATE
              PduRPduLengthHandlingStrategy = UNUSED
              PduRDestPduCrossPartitionDestination = false
              PduRDestPduRef = DCM_BMC_CAN01_XIX_TPCHType_CANHS_OBDC_Diagnose_XIX_0x17FD0200_XIX_Functional_e9b636f2_Tx
              PduRDestPduPduRBswModulesRef = CanTp
              PduRQueueRef = PduRQueue
            BMC_HV_0bbdd542_Rx_31fc5fb2_Rx (PduRDestPdu):
              PduRDestPduHandleId = 5
              PduRDestPduDirection = RECEIVE
              PduRDestPduRoutingType = API_FORWARDING
              PduRDestPduDataProcessing = IMMEDIATE
              PduRPduLengthHandlingStrategy = UNUSED
              PduRDestPduCrossPartitionDestination = false
              PduRDestPduRef = DCM_HCP5_CANFD01_XIX_TPCHType_CANFD_OBDC_Diagnose_XIX_0x1C410200_XIX_Functional_967cb818_Rx
              PduRDestPduPduRBswModulesRef = Dcm
          BMC_HV_1b8f642d_Rx: PduRRoutingPathCommunicationType=COMMUNICATION_INTERFACE
            PduRSrcPdu_4b1bc202 (PduRSrcPdu):
              PduRSourcePduHandleId = 12
              PduRSrcPduDirection = RECEIVE
              PduRSrcPduRef = CDD_DEV_BJB_Resp_FF_XIX_BMC_CAN01_19d429a9_Rx
              PduRSrcPduPduRBswModulesRef = CanIf
            BMC_HV_4d2c4eba_Tx (PduRDestPdu):
              PduRDestPduHandleId = 30
              PduRDestPduDirection = TRANSMIT
              PduRDestPduRoutingType = GATEWAY_ROUTING
              PduRDestPduDataProcessing = IMMEDIATE
              PduRPduLengthHandlingStrategy = IGNORE
              PduRDestPduCrossPartitionDestination = false
              PduRTransmissionConfirmation = false
              PduRDestPduDataProvision = PDUR_DIRECT
              PduRDestPduRef = CDD_DEV_BJB_Resp_FF_XIX_HCP5_CANFD01_77e6d841_Tx
              PduRDestPduPduRBswModulesRef = CanIf
          ELF_06_XIX_HCP5_CANFD01_21ac90a0_Rx: PduRRoutingPathCommunicationType=COMMUNICATION_INTERFACE
            ELF_06_XIX_HCP5_CANFD01_21ac90a0_Rx_f83a5697_Rx (PduRDestPdu):
              PduRDestPduHandleId = 21
              PduRDestPduDirection = RECEIVE
              PduRDestPduRoutingType = API_FORWARDING
              PduRDestPduDataProcessing = IMMEDIATE
              PduRPduLengthHandlingStrategy = IGNORE
              PduRDestPduCrossPartitionDestination = false
              PduRTransmissionConfirmation = false
              PduRDestPduRef = ELF_06_XIX_HCP5_CANFD01_d78b945c_Rx
              PduRDestPduPduRBswModulesRef = Com
            PduRSrcPdu_f83a5697 (PduRSrcPdu): PduRSourcePduHandleId=46, PduRSrcPduDirection=RECEIVE, PduRSrcPduRef=ELF_06_XIX_HCP5_CANFD01_21ac90a0_Rx, PduRSrcPduPduRBswModulesRef=CanIf
          UI2_01_XIX_BMC_CAN01_E2E_04321bb6_Rx: PduRRoutingPathCommunicationType=COMMUNICATION_INTERFACE
            UI2_01_XIX_BMC_CAN01_E2E_04321bb6_Rx_24a65b83_Rx (PduRDestPdu):
              PduRDestPduHandleId = 60
              PduRDestPduDirection = RECEIVE
              PduRDestPduRoutingType = API_FORWARDING
              PduRDestPduDataProcessing = IMMEDIATE
              PduRPduLengthHandlingStrategy = IGNORE
              PduRDestPduCrossPartitionDestination = false
              PduRTransmissionConfirmation = false
              PduRDestPduRef = UI2_01_XIX_BMC_CAN01_E2E_f7b0279f_Rx
              PduRDestPduPduRBswModulesRef = Com
            PduRSrcPdu_24a65b83 (PduRSrcPdu): PduRSourcePduHandleId=78, PduRSrcPduDirection=RECEIVE, PduRSrcPduRef=UI2_01_XIX_BMC_CAN01_E2E_04321bb6_Rx, PduRSrcPduPduRBswModulesRef=CanIf
          BMC_HV_d8ebd2e4_Rx: PduRRoutingPathCommunicationType=COMMUNICATION_INTERFACE
            BMC_HV_f8ff59ea_Tx (PduRDestPdu):
              PduRDestPduHandleId = 49
              PduRDestPduDirection = TRANSMIT
              PduRDestPduRoutingType = GATEWAY_ROUTING
              PduRDestPduDataProcessing = IMMEDIATE
              PduRPduLengthHandlingStrategy = IGNORE
              PduRDestPduCrossPartitionDestination = false
              PduRTransmissionConfirmation = false
              PduRDestPduDataProvision = PDUR_DIRECT
              PduRDestPduRef = OBDC_SSN_BJB_Req_XIX_BMC_CAN01_31b63a85_Tx
              PduRDestPduPduRBswModulesRef = CanIf
            PduRSrcPdu_c8be0ac4 (PduRSrcPdu):
              PduRSourcePduHandleId = 29
              PduRSrcPduDirection = RECEIVE
              PduRSrcPduRef = OBDC_SSN_BJB_Req_XIX_HCP5_CANFD01_87b9d88e_Rx
              PduRSrcPduPduRBswModulesRef = CanIf
          BMC_HV_03_XIX_HCP5_CANFD01_0617c15c_Tx: PduRRoutingPathCommunicationType=COMMUNICATION_INTERFACE
            BMC_HV_03_XIX_HCP5_CANFD01_58321150_Tx (PduRDestPdu):
              PduRDestPduHandleId = 12
              PduRDestPduDirection = TRANSMIT
              PduRDestPduRoutingType = API_FORWARDING
              PduRDestPduDataProcessing = IMMEDIATE
              PduRPduLengthHandlingStrategy = IGNORE
              PduRDestPduCrossPartitionDestination = false
              PduRTransmissionConfirmation = true
              PduRDestPduDataProvision = PDUR_DIRECT
              PduRDestPduRef = BMC_HV_03_XIX_HCP5_CANFD01_58321150_Tx
              PduRDestPduPduRBswModulesRef = CanIf
            PduRSrcPdu_7e555779 (PduRSrcPdu): PduRSourcePduHandleId=12, PduRSrcPduDirection=TRANSMIT, PduRSrcPduRef=BMC_HV_03_XIX_HCP5_CANFD01_0617c15c_Tx, PduRSrcPduPduRBswModulesRef=Com
          BMC_HV_080e5c5f_Rx: PduRRoutingPathCommunicationType=COMMUNICATION_INTERFACE
            PduRSrcPdu_29be98f1 (PduRSrcPdu):
              PduRSourcePduHandleId = 19
              PduRSrcPduDirection = RECEIVE
              PduRSrcPduRef = OBDC_SSN_BJB_Resp_XIX_BMC_CAN01_d5ca69f5_Rx
              PduRSrcPduPduRBswModulesRef = CanIf
            BMC_HV_d112dd40_Tx (PduRDestPdu):
              PduRDestPduHandleId = 50
              PduRDestPduDirection = TRANSMIT
              PduRDestPduRoutingType = GATEWAY_ROUTING
              PduRDestPduDataProcessing = IMMEDIATE
              PduRPduLengthHandlingStrategy = IGNORE
              PduRDestPduCrossPartitionDestination = false
              PduRTransmissionConfirmation = false
              PduRDestPduDataProvision = PDUR_DIRECT
              PduRDestPduRef = OBDC_SSN_BJB_Resp_XIX_HCP5_CANFD01_7c2a070c_Tx
              PduRDestPduPduRBswModulesRef = CanIf
          BMC_HV_f0607c45_Rx: PduRRoutingPathCommunicationType=COMMUNICATION_INTERFACE
            BMC_HV_d9bef722_Tx (PduRDestPdu):
              PduRDestPduHandleId = 59
              PduRDestPduDirection = TRANSMIT
              PduRDestPduRoutingType = GATEWAY_ROUTING
              PduRDestPduDataProcessing = IMMEDIATE
              PduRPduLengthHandlingStrategy = IGNORE
              PduRDestPduCrossPartitionDestination = false
              PduRTransmissionConfirmation = false
              PduRDestPduDataProvision = PDUR_DIRECT
              PduRDestPduRef = OBDx_allOBD_Req_XIX_BMC_CAN01_9cfd1e51_Tx
              PduRDestPduPduRBswModulesRef = CanIf
            PduRSrcPdu_b7f9d39f (PduRSrcPdu):
              PduRSourcePduHandleId = 33
              PduRSrcPduDirection = RECEIVE
              PduRSrcPduRef = OBDx_allOBD_Req_XIX_HCP5_CANFD01_a7e21e7c_Rx
              PduRSrcPduPduRBswModulesRef = CanIf
          NVEM_12_XIX_HCP5_CANFD01_27d236bb_Rx: PduRRoutingPathCommunicationType=COMMUNICATION_INTERFACE
            PduRSrcPdu_8ee67ae6 (PduRSrcPdu): PduRSourcePduHandleId=55, PduRSrcPduDirection=RECEIVE, PduRSrcPduRef=NVEM_12_XIX_HCP5_CANFD01_27d236bb_Rx, PduRSrcPduPduRBswModulesRef=CanIf
            NVEM_12_XIX_HCP5_CANFD01_27d236bb_Rx_8ee67ae6_Rx (PduRDestPdu):
              PduRDestPduHandleId = 30
              PduRDestPduDirection = RECEIVE
              PduRDestPduRoutingType = API_FORWARDING
              PduRDestPduDataProcessing = IMMEDIATE
              PduRPduLengthHandlingStrategy = IGNORE
              PduRDestPduCrossPartitionDestination = false
              PduRTransmissionConfirmation = false
              PduRDestPduRef = NVEM_12_XIX_HCP5_CANFD01_00bae280_Rx
              PduRDestPduPduRBswModulesRef = Com
          DCM_HCP5_CANFD01_XIX_TPCHType_CANFD_ISO_Diagnose_XIX_0x1C42007B_XIX_0x1C40007B_XIX_Physical_4bbc7f71_Tx: PduRRoutingPathCommunicationType=TRANSPORT_PROTOCOL
            PduRSrcPdu_00f99798 (PduRSrcPdu):
              PduRSourcePduHandleId = 30
              PduRSrcPduDirection = TRANSMIT
              PduRSrcPduRef = DCM_HCP5_CANFD01_XIX_TPCHType_CANFD_ISO_Diagnose_XIX_0x1C42007B_XIX_0x1C40007B_XIX_Physical_4bbc7f71_Tx
              PduRSrcPduPduRBswModulesRef = Dcm
            DCM_HCP5_CANFD01_XIX_TPCHType_CANFD_ISO_Diagnose_XIX_0x1C42007B_XIX_0x1C40007B_XIX_Physical_266b033c_Tx (PduRDestPdu):
              PduRDestPduHandleId = 2
              PduRDestPduDirection = TRANSMIT
              PduRDestPduRoutingType = API_FORWARDING
              PduRDestPduDataProcessing = IMMEDIATE
              PduRPduLengthHandlingStrategy = UNUSED
              PduRDestPduCrossPartitionDestination = false
              PduRDestPduRef = DCM_HCP5_CANFD01_XIX_TPCHType_CANFD_ISO_Diagnose_XIX_0x1C42007B_XIX_0x1C40007B_XIX_Physical_266b033c_Tx
              PduRDestPduPduRBswModulesRef = CanTp
          NMH_Hybrid_01_XIX_BMC_CAN01_b22e17f1_Tx: PduRRoutingPathCommunicationType=COMMUNICATION_INTERFACE
            NMH_Hybrid_01_XIX_BMC_CAN01_b22e17f1_Tx_dcfa7b44_Tx (PduRDestPdu):
              PduRDestPduHandleId = 47
              PduRDestPduDirection = TRANSMIT
              PduRDestPduRoutingType = API_FORWARDING
              PduRDestPduDataProcessing = IMMEDIATE
              PduRPduLengthHandlingStrategy = IGNORE
              PduRDestPduCrossPartitionDestination = false
              PduRTransmissionConfirmation = true
              PduRDestPduDataProvision = PDUR_TRIGGERTRANSMIT
              PduRDestPduRef = NMH_Hybrid_01_XIX_BMC_CAN01_b22e17f1_Tx
              PduRDestPduPduRBswModulesRef = CanNm
            PduRSrcPdu_dcfa7b44 (PduRSrcPdu): PduRSourcePduHandleId=40, PduRSrcPduDirection=TRANSMIT, PduRSrcPduRef=NMH_Hybrid_01_XIX_BMC_CAN01_b22e17f1_Tx, PduRSrcPduPduRBswModulesRef=Com
          BJB_11_XIX_BMC_CAN01_E2E_893589f3_Rx: PduRRoutingPathCommunicationType=COMMUNICATION_INTERFACE
            BJB_11_XIX_BMC_CAN01_E2E_893589f3_Rx_6f2be595_Rx (PduRDestPdu):
              PduRDestPduHandleId = 3
              PduRDestPduDirection = RECEIVE
              PduRDestPduRoutingType = API_FORWARDING
              PduRDestPduDataProcessing = IMMEDIATE
              PduRPduLengthHandlingStrategy = IGNORE
              PduRDestPduCrossPartitionDestination = false
              PduRTransmissionConfirmation = false
              PduRDestPduRef = BJB_11_XIX_BMC_CAN01_E2E_416796eb_Rx
              PduRDestPduPduRBswModulesRef = Com
            PduRSrcPdu_6f2be595 (PduRSrcPdu): PduRSourcePduHandleId=3, PduRSrcPduDirection=RECEIVE, PduRSrcPduRef=BJB_11_XIX_BMC_CAN01_E2E_893589f3_Rx, PduRSrcPduPduRBswModulesRef=CanIf
          BJB_10_XIX_BMC_CAN01_E2E_04bd7411_Rx: PduRRoutingPathCommunicationType=COMMUNICATION_INTERFACE
            BJB_10_XIX_BMC_CAN01_E2E_04bd7411_Rx_b8b879bb_Rx (PduRDestPdu):
              PduRDestPduHandleId = 2
              PduRDestPduDirection = RECEIVE
              PduRDestPduRoutingType = API_FORWARDING
              PduRDestPduDataProcessing = IMMEDIATE
              PduRPduLengthHandlingStrategy = IGNORE
              PduRDestPduCrossPartitionDestination = false
              PduRTransmissionConfirmation = false
              PduRDestPduRef = BJB_10_XIX_BMC_CAN01_E2E_968516b3_Rx
              PduRDestPduPduRBswModulesRef = Com
            PduRSrcPdu_b8b879bb (PduRSrcPdu): PduRSourcePduHandleId=2, PduRSrcPduDirection=RECEIVE, PduRSrcPduRef=BJB_10_XIX_BMC_CAN01_E2E_04bd7411_Rx, PduRSrcPduPduRBswModulesRef=CanIf
          DS_Hybrid_01_XIX_HCP5_CANFD01_b3d0b839_Tx: PduRRoutingPathCommunicationType=COMMUNICATION_INTERFACE
            DS_Hybrid_01_XIX_HCP5_CANFD01_ed9ff9e4_Tx (PduRDestPdu):
              PduRDestPduHandleId = 41
              PduRDestPduDirection = TRANSMIT
              PduRDestPduRoutingType = API_FORWARDING
              PduRDestPduDataProcessing = IMMEDIATE
              PduRPduLengthHandlingStrategy = IGNORE
              PduRDestPduCrossPartitionDestination = false
              PduRTransmissionConfirmation = true
              PduRDestPduDataProvision = PDUR_DIRECT
              PduRDestPduRef = DS_Hybrid_01_XIX_HCP5_CANFD01_ed9ff9e4_Tx
              PduRDestPduPduRBswModulesRef = CanIf
            PduRSrcPdu_9d79cb4c (PduRSrcPdu): PduRSourcePduHandleId=35, PduRSrcPduDirection=TRANSMIT, PduRSrcPduRef=DS_Hybrid_01_XIX_HCP5_CANFD01_b3d0b839_Tx, PduRSrcPduPduRBswModulesRef=Com
          BMC_HV_10_XIX_BMC_CAN01_E2E_28add151_Tx: PduRRoutingPathCommunicationType=COMMUNICATION_INTERFACE
            BMC_HV_10_XIX_BMC_CAN01_E2E_31888fd1_Tx (PduRDestPdu):
              PduRDestPduHandleId = 23
              PduRDestPduDirection = TRANSMIT
              PduRDestPduRoutingType = API_FORWARDING
              PduRDestPduDataProcessing = IMMEDIATE
              PduRPduLengthHandlingStrategy = IGNORE
              PduRDestPduCrossPartitionDestination = false
              PduRTransmissionConfirmation = true
              PduRDestPduDataProvision = PDUR_DIRECT
              PduRDestPduRef = BMC_HV_10_XIX_BMC_CAN01_E2E_31888fd1_Tx
              PduRDestPduPduRBswModulesRef = CanIf
            PduRSrcPdu_8f77f31b (PduRSrcPdu): PduRSourcePduHandleId=23, PduRSrcPduDirection=TRANSMIT, PduRSrcPduRef=BMC_HV_10_XIX_BMC_CAN01_E2E_28add151_Tx, PduRSrcPduPduRBswModulesRef=Com
          OBG_01_XIX_HCP5_CANFD01_6af9c66f_Rx: PduRRoutingPathCommunicationType=COMMUNICATION_INTERFACE
            PduRSrcPdu_4d6fef81 (PduRSrcPdu): PduRSourcePduHandleId=58, PduRSrcPduDirection=RECEIVE, PduRSrcPduRef=OBG_01_XIX_HCP5_CANFD01_6af9c66f_Rx, PduRSrcPduPduRBswModulesRef=CanIf
            OBG_01_XIX_HCP5_CANFD01_6af9c66f_Rx_4d6fef81_Rx (PduRDestPdu):
              PduRDestPduHandleId = 35
              PduRDestPduDirection = RECEIVE
              PduRDestPduRoutingType = API_FORWARDING
              PduRDestPduDataProcessing = IMMEDIATE
              PduRPduLengthHandlingStrategy = IGNORE
              PduRDestPduCrossPartitionDestination = false
              PduRTransmissionConfirmation = false
              PduRDestPduRef = OBG_01_XIX_HCP5_CANFD01_8fe2f1e9_Rx
              PduRDestPduPduRBswModulesRef = Com
          BMC_HV_1ef3b795_Rx: PduRRoutingPathCommunicationType=COMMUNICATION_INTERFACE
            BMC_HV_5d87886d_Tx (PduRDestPdu):
              PduRDestPduHandleId = 66
              PduRDestPduDirection = TRANSMIT
              PduRDestPduRoutingType = GATEWAY_ROUTING
              PduRDestPduDataProcessing = IMMEDIATE
              PduRPduLengthHandlingStrategy = IGNORE
              PduRDestPduCrossPartitionDestination = false
              PduRTransmissionConfirmation = false
              PduRDestPduDataProvision = PDUR_DIRECT
              PduRDestPduRef = Systeminfo_01_XIX_BMC_CAN01_e1870ca9_Tx
              PduRDestPduPduRBswModulesRef = CanIf
            PduRSrcPdu_5bfe58e1 (PduRSrcPdu): PduRSourcePduHandleId=14, PduRSrcPduDirection=RECEIVE, PduRSrcPduRef=Systeminfo_01_XIX_HCP5_CANFD01_1ca8fa11_Rx, PduRSrcPduPduRBswModulesRef=CanIf
            BMC_HV_1ef3b795_Rx_5bfe58e1_Rx (PduRDestPdu):
              PduRDestPduHandleId = 45
              PduRDestPduDirection = RECEIVE
              PduRDestPduRoutingType = API_FORWARDING
              PduRDestPduDataProcessing = IMMEDIATE
              PduRPduLengthHandlingStrategy = IGNORE
              PduRDestPduCrossPartitionDestination = false
              PduRTransmissionConfirmation = false
              PduRDestPduRef = Systeminfo_01_XIX_HCP5_CANFD01_fb27c5ed_Rx
              PduRDestPduPduRBswModulesRef = Com
          UI2_03_XIX_BMC_CAN01_E2E_c452e633_Rx: PduRRoutingPathCommunicationType=COMMUNICATION_INTERFACE
            PduRSrcPdu_d907d982 (PduRSrcPdu): PduRSourcePduHandleId=80, PduRSrcPduDirection=RECEIVE, PduRSrcPduRef=UI2_03_XIX_BMC_CAN01_E2E_c452e633_Rx, PduRSrcPduPduRBswModulesRef=CanIf
            UI2_03_XIX_BMC_CAN01_E2E_c452e633_Rx_d907d982_Rx (PduRDestPdu):
              PduRDestPduHandleId = 62
              PduRDestPduDirection = RECEIVE
              PduRDestPduRoutingType = API_FORWARDING
              PduRDestPduDataProcessing = IMMEDIATE
              PduRPduLengthHandlingStrategy = IGNORE
              PduRDestPduCrossPartitionDestination = false
              PduRTransmissionConfirmation = false
              PduRDestPduRef = UI2_03_XIX_BMC_CAN01_E2E_8304216e_Rx
              PduRDestPduPduRBswModulesRef = Com
          BMC_HV_09_XIX_HCP5_CANFD01_149204d3_Tx: PduRRoutingPathCommunicationType=COMMUNICATION_INTERFACE
            PduRSrcPdu_842fa7a9 (PduRSrcPdu): PduRSourcePduHandleId=22, PduRSrcPduDirection=TRANSMIT, PduRSrcPduRef=BMC_HV_09_XIX_HCP5_CANFD01_149204d3_Tx, PduRSrcPduPduRBswModulesRef=Com
            BMC_HV_09_XIX_HCP5_CANFD01_149204d3_Tx (PduRDestPdu):
              PduRDestPduHandleId = 22
              PduRDestPduDirection = TRANSMIT
              PduRDestPduRoutingType = API_FORWARDING
              PduRDestPduDataProcessing = IMMEDIATE
              PduRPduLengthHandlingStrategy = IGNORE
              PduRDestPduCrossPartitionDestination = false
              PduRTransmissionConfirmation = true
              PduRDestPduDataProvision = PDUR_DIRECT
              PduRDestPduRef = BMC_HV_09_XIX_HCP5_CANFD01_149204d3_Tx
              PduRDestPduPduRBswModulesRef = SecOC
          DCDC_NV_Komponentenfehler_01_XIX_HCP5_CANFD01_2b1a3644_Rx: PduRRoutingPathCommunicationType=COMMUNICATION_INTERFACE
            DCDC_NV_Komponentenfehler_01_XIX_HCP5_CANFD01_2b1a3644_Rx_e509db44_Rx (PduRDestPdu):
              PduRDestPduHandleId = 14
              PduRDestPduDirection = RECEIVE
              PduRDestPduRoutingType = API_FORWARDING
              PduRDestPduDataProcessing = IMMEDIATE
              PduRPduLengthHandlingStrategy = IGNORE
              PduRDestPduCrossPartitionDestination = false
              PduRTransmissionConfirmation = false
              PduRDestPduRef = DCDC_NV_Komponentenfehler_01_XIX_HCP5_CANFD01_dd687766_Rx
              PduRDestPduPduRBswModulesRef = Com
            PduRSrcPdu_e509db44 (PduRSrcPdu):
              PduRSourcePduHandleId = 40
              PduRSrcPduDirection = RECEIVE
              PduRSrcPduRef = DCDC_NV_Komponentenfehler_01_XIX_HCP5_CANFD01_2b1a3644_Rx
              PduRSrcPduPduRBswModulesRef = CanIf
          BMC_HV_08_XIX_HCP5_CANFD01_fbc0b232_Tx: PduRRoutingPathCommunicationType=COMMUNICATION_INTERFACE
            PduRSrcPdu_a805d9a1 (PduRSrcPdu): PduRSourcePduHandleId=20, PduRSrcPduDirection=TRANSMIT, PduRSrcPduRef=BMC_HV_08_XIX_HCP5_CANFD01_fbc0b232_Tx, PduRSrcPduPduRBswModulesRef=Com
            BMC_HV_08_XIX_HCP5_CANFD01_fbc0b232_Tx (PduRDestPdu):
              PduRDestPduHandleId = 20
              PduRDestPduDirection = TRANSMIT
              PduRDestPduRoutingType = API_FORWARDING
              PduRDestPduDataProcessing = IMMEDIATE
              PduRPduLengthHandlingStrategy = IGNORE
              PduRDestPduCrossPartitionDestination = false
              PduRTransmissionConfirmation = true
              PduRDestPduDataProvision = PDUR_DIRECT
              PduRDestPduRef = BMC_HV_08_XIX_HCP5_CANFD01_fbc0b232_Tx
              PduRDestPduPduRBswModulesRef = SecOC
          UI1_01_XIX_BMC_CAN01_E2E_e77bac14_Rx: PduRRoutingPathCommunicationType=COMMUNICATION_INTERFACE
            UI1_01_XIX_BMC_CAN01_E2E_e77bac14_Rx_9e0787f4_Rx (PduRDestPdu):
              PduRDestPduHandleId = 47
              PduRDestPduDirection = RECEIVE
              PduRDestPduRoutingType = API_FORWARDING
              PduRDestPduDataProcessing = IMMEDIATE
              PduRPduLengthHandlingStrategy = IGNORE
              PduRDestPduCrossPartitionDestination = false
              PduRTransmissionConfirmation = false
              PduRDestPduRef = UI1_01_XIX_BMC_CAN01_E2E_cec88adf_Rx
              PduRDestPduPduRBswModulesRef = Com
            PduRSrcPdu_9e0787f4 (PduRSrcPdu): PduRSourcePduHandleId=65, PduRSrcPduDirection=RECEIVE, PduRSrcPduRef=UI1_01_XIX_BMC_CAN01_E2E_e77bac14_Rx, PduRSrcPduPduRBswModulesRef=CanIf
          UI1_03_XIX_BMC_CAN01_0abdbc10_Rx: PduRRoutingPathCommunicationType=COMMUNICATION_INTERFACE
            UI1_03_XIX_BMC_CAN01_0abdbc10_Rx_47a5a20b_Rx (PduRDestPdu):
              PduRDestPduHandleId = 49
              PduRDestPduDirection = RECEIVE
              PduRDestPduRoutingType = API_FORWARDING
              PduRDestPduDataProcessing = IMMEDIATE
              PduRPduLengthHandlingStrategy = IGNORE
              PduRDestPduCrossPartitionDestination = false
              PduRTransmissionConfirmation = false
              PduRDestPduRef = UI1_03_XIX_BMC_CAN01_4277cadb_Rx
              PduRDestPduPduRBswModulesRef = Com
            PduRSrcPdu_47a5a20b (PduRSrcPdu): PduRSourcePduHandleId=67, PduRSrcPduDirection=RECEIVE, PduRSrcPduRef=UI1_03_XIX_BMC_CAN01_0abdbc10_Rx, PduRSrcPduPduRBswModulesRef=CanIf
          UI2Sens02_CALID_02_XIX_BMC_CAN01_c59439eb_Rx: PduRRoutingPathCommunicationType=COMMUNICATION_INTERFACE
            UI2Sens02_CALID_02_XIX_BMC_CAN01_c59439eb_Rx_c5309ef2_Rx (PduRDestPdu):
              PduRDestPduHandleId = 58
              PduRDestPduDirection = RECEIVE
              PduRDestPduRoutingType = API_FORWARDING
              PduRDestPduDataProcessing = IMMEDIATE
              PduRPduLengthHandlingStrategy = IGNORE
              PduRDestPduCrossPartitionDestination = false
              PduRTransmissionConfirmation = false
              PduRDestPduRef = UI2Sens02_CALID_02_XIX_BMC_CAN01_baaae1d1_Rx
              PduRDestPduPduRBswModulesRef = Com
            PduRSrcPdu_c5309ef2 (PduRSrcPdu):
              PduRSourcePduHandleId = 76
              PduRSrcPduDirection = RECEIVE
              PduRSrcPduRef = UI2Sens02_CALID_02_XIX_BMC_CAN01_c59439eb_Rx
              PduRSrcPduPduRBswModulesRef = CanIf
          BMC_HV_02_XIX_HCP5_CANFD01_E2E_c5c367a3_Tx: PduRRoutingPathCommunicationType=COMMUNICATION_INTERFACE
            PduRSrcPdu_d75bfe16 (PduRSrcPdu): PduRSourcePduHandleId=11, PduRSrcPduDirection=TRANSMIT, PduRSrcPduRef=BMC_HV_02_XIX_HCP5_CANFD01_E2E_c5c367a3_Tx, PduRSrcPduPduRBswModulesRef=Com
            BMC_HV_02_XIX_HCP5_CANFD01_E2E_c5c367a3_Tx (PduRDestPdu):
              PduRDestPduHandleId = 11
              PduRDestPduDirection = TRANSMIT
              PduRDestPduRoutingType = API_FORWARDING
              PduRDestPduDataProcessing = IMMEDIATE
              PduRPduLengthHandlingStrategy = IGNORE
              PduRDestPduCrossPartitionDestination = false
              PduRTransmissionConfirmation = true
              PduRDestPduDataProvision = PDUR_DIRECT
              PduRDestPduRef = BMC_HV_02_XIX_HCP5_CANFD01_E2E_c5c367a3_Tx
              PduRDestPduPduRBswModulesRef = SecOC
          BMC_HV_a369f88b_Rx: PduRRoutingPathCommunicationType=COMMUNICATION_INTERFACE
            BMC_HV_28ed9af5_Tx (PduRDestPdu):
              PduRDestPduHandleId = 61
              PduRDestPduDirection = TRANSMIT
              PduRDestPduRoutingType = GATEWAY_ROUTING
              PduRDestPduDataProcessing = IMMEDIATE
              PduRPduLengthHandlingStrategy = IGNORE
              PduRDestPduCrossPartitionDestination = false
              PduRTransmissionConfirmation = false
              PduRDestPduDataProvision = PDUR_DIRECT
              PduRDestPduRef = ORU_Control_A_01_XIX_BMC_CAN01_e1a4f99a_Tx
              PduRDestPduPduRBswModulesRef = CanIf
            BMC_HV_a369f88b_Rx_1a7ba619_Rx (PduRDestPdu):
              PduRDestPduHandleId = 37
              PduRDestPduDirection = RECEIVE
              PduRDestPduRoutingType = API_FORWARDING
              PduRDestPduDataProcessing = IMMEDIATE
              PduRPduLengthHandlingStrategy = IGNORE
              PduRDestPduCrossPartitionDestination = false
              PduRTransmissionConfirmation = false
              PduRDestPduRef = ORU_Control_A_01_XIX_HCP5_CANFD01_E2E_3007747a_Rx
              PduRDestPduPduRBswModulesRef = Com
            PduRSrcPdu_1a7ba619 (PduRSrcPdu):
              PduRSourcePduHandleId = 24
              PduRSrcPduDirection = RECEIVE
              PduRSrcPduRef = ORU_Control_A_01_XIX_HCP5_CANFD01_E2E_893c1989_Rx
              PduRSrcPduPduRBswModulesRef = CanIf
          BMC_HV_01_XIX_HCP5_CANFD01_E2E_fcbbcae3_Tx: PduRRoutingPathCommunicationType=COMMUNICATION_INTERFACE
            BMC_HV_01_XIX_HCP5_CANFD01_E2E_fcbbcae3_Tx (PduRDestPdu):
              PduRDestPduHandleId = 9
              PduRDestPduDirection = TRANSMIT
              PduRDestPduRoutingType = API_FORWARDING
              PduRDestPduDataProcessing = IMMEDIATE
              PduRPduLengthHandlingStrategy = IGNORE
              PduRDestPduCrossPartitionDestination = false
              PduRTransmissionConfirmation = true
              PduRDestPduDataProvision = PDUR_DIRECT
              PduRDestPduRef = BMC_HV_01_XIX_HCP5_CANFD01_E2E_fcbbcae3_Tx
              PduRDestPduPduRBswModulesRef = SecOC
            PduRSrcPdu_afcd3b20 (PduRSrcPdu): PduRSourcePduHandleId=9, PduRSrcPduDirection=TRANSMIT, PduRSrcPduRef=BMC_HV_01_XIX_HCP5_CANFD01_E2E_fcbbcae3_Tx, PduRSrcPduPduRBswModulesRef=Com
          CDD_HCP5_CANFD01_XIX_TPCHType_CANFD_DAAP_XIX_0x1C413FDD_XIX_Functional_880c97f7_Rx: PduRRoutingPathCommunicationType=TRANSPORT_PROTOCOL
            CDD_HCP5_CANFD01_XIX_TPCHType_CANFD_DAAP_XIX_0x1C413FDD_XIX_Functional_880c97f7_Rx_17800f7b_Rx (PduRDestPdu):
              PduRDestPduHandleId = 1
              PduRDestPduDirection = RECEIVE
              PduRDestPduRoutingType = API_FORWARDING
              PduRDestPduDataProcessing = IMMEDIATE
              PduRPduLengthHandlingStrategy = UNUSED
              PduRDestPduCrossPartitionDestination = false
              PduRDestPduRef = CDD_HCP5_CANFD01_XIX_TPCHType_CANFD_DAAP_XIX_0x1C413FDD_XIX_Functional_6530545d_Rx
              PduRDestPduPduRBswModulesRef = Dcm
            PduRSrcPdu_17800f7b (PduRSrcPdu):
              PduRSourcePduHandleId = 3
              PduRSrcPduDirection = RECEIVE
              PduRSrcPduRef = CDD_HCP5_CANFD01_XIX_TPCHType_CANFD_DAAP_XIX_0x1C413FDD_XIX_Functional_880c97f7_Rx
              PduRSrcPduPduRBswModulesRef = CanTp
          DCM_HCP5_CANFD01_XIX_TPCHType_CANFD_OBDC_Diagnose_XIX_0x1C40027B_XIX_0x1C42027B_XIX_Physical_8b2e4924_Rx: PduRRoutingPathCommunicationType=TRANSPORT_PROTOCOL
            PduRSrcPdu_2f2c828e (PduRSrcPdu):
              PduRSourcePduHandleId = 5
              PduRSrcPduDirection = RECEIVE
              PduRSrcPduRef = DCM_HCP5_CANFD01_XIX_TPCHType_CANFD_OBDC_Diagnose_XIX_0x1C40027B_XIX_0x1C42027B_XIX_Physical_8b2e4924_Rx
              PduRSrcPduPduRBswModulesRef = CanTp
            DCM_HCP5_CANFD01_XIX_TPCHType_CANFD_OBDC_Diagnose_XIX_0x1C40027B_XIX_0x1C42027B_XIX_Physical_8b2e4924_Rx_2f2c828e_Rx (PduRDestPdu):
              PduRDestPduHandleId = 4
              PduRDestPduDirection = RECEIVE
              PduRDestPduRoutingType = API_FORWARDING
              PduRDestPduDataProcessing = IMMEDIATE
              PduRPduLengthHandlingStrategy = UNUSED
              PduRDestPduCrossPartitionDestination = false
              PduRDestPduRef = DCM_HCP5_CANFD01_XIX_TPCHType_CANFD_OBDC_Diagnose_XIX_0x1C40027B_XIX_0x1C42027B_XIX_Physical_a0b6e66f_Rx
              PduRDestPduPduRBswModulesRef = Dcm
          BMC_HV_4032211c_Rx: PduRRoutingPathCommunicationType=COMMUNICATION_INTERFACE
            PduRSrcPdu_aa61ac1d (PduRSrcPdu): PduRSourcePduHandleId=22, PduRSrcPduDirection=RECEIVE, PduRSrcPduRef=OBD_03_XIX_HCP5_CANFD01_2635ffad_Rx, PduRSrcPduPduRBswModulesRef=CanIf
            BMC_HV_1fc2e024_Tx (PduRDestPdu):
              PduRDestPduHandleId = 55
              PduRDestPduDirection = TRANSMIT
              PduRDestPduRoutingType = GATEWAY_ROUTING
              PduRDestPduDataProcessing = IMMEDIATE
              PduRPduLengthHandlingStrategy = IGNORE
              PduRDestPduCrossPartitionDestination = false
              PduRTransmissionConfirmation = false
              PduRDestPduDataProvision = PDUR_DIRECT
              PduRDestPduRef = OBD_03_XIX_BMC_CAN01_5c2c79fc_Tx
              PduRDestPduPduRBswModulesRef = CanIf
            BMC_HV_4032211c_Rx_aa61ac1d_Rx (PduRDestPdu):
              PduRDestPduHandleId = 31
              PduRDestPduDirection = RECEIVE
              PduRDestPduRoutingType = API_FORWARDING
              PduRDestPduDataProcessing = IMMEDIATE
              PduRPduLengthHandlingStrategy = IGNORE
              PduRDestPduCrossPartitionDestination = false
              PduRTransmissionConfirmation = false
              PduRDestPduRef = OBD_03_XIX_HCP5_CANFD01_f1281889_Rx
              PduRDestPduPduRBswModulesRef = Com
          CDD_HCP5_CANFD01_XIX_TPCHType_CANFD_DAAP_XIX_0x1C423F7B_XIX_0x1C403F7B_XIX_Physical_53df2b54_Tx: PduRRoutingPathCommunicationType=TRANSPORT_PROTOCOL
            PduRSrcPdu_80070619 (PduRSrcPdu):
              PduRSourcePduHandleId = 29
              PduRSrcPduDirection = TRANSMIT
              PduRSrcPduRef = CDD_HCP5_CANFD01_XIX_TPCHType_CANFD_DAAP_XIX_0x1C423F7B_XIX_0x1C403F7B_XIX_Physical_53df2b54_Tx
              PduRSrcPduPduRBswModulesRef = Dcm
            CDD_HCP5_CANFD01_XIX_TPCHType_CANFD_DAAP_XIX_0x1C423F7B_XIX_0x1C403F7B_XIX_Physical_d2cfa6c1_Tx (PduRDestPdu):
              PduRDestPduHandleId = 0
              PduRDestPduDirection = TRANSMIT
              PduRDestPduRoutingType = API_FORWARDING
              PduRDestPduDataProcessing = IMMEDIATE
              PduRPduLengthHandlingStrategy = UNUSED
              PduRDestPduCrossPartitionDestination = false
              PduRDestPduRef = CDD_HCP5_CANFD01_XIX_TPCHType_CANFD_DAAP_XIX_0x1C423F7B_XIX_0x1C403F7B_XIX_Physical_d2cfa6c1_Tx
              PduRDestPduPduRBswModulesRef = CanTp
          OBD_HCP1_SOK_XIX_HCP5_CANFD01_a5806350_Rx: PduRRoutingPathCommunicationType=COMMUNICATION_INTERFACE
            PduRSrcPdu_12c1a9c9 (PduRSrcPdu): PduRSourcePduHandleId=56, PduRSrcPduDirection=RECEIVE, PduRSrcPduRef=OBD_HCP1_SOK_XIX_HCP5_CANFD01_a5806350_Rx, PduRSrcPduPduRBswModulesRef=CanIf
            OBD_HCP1_SOK_XIX_HCP5_CANFD01_a5806350_Rx_12c1a9c9_Rx (PduRDestPdu):
              PduRDestPduHandleId = 33
              PduRDestPduDirection = RECEIVE
              PduRDestPduRoutingType = API_FORWARDING
              PduRDestPduDataProcessing = IMMEDIATE
              PduRPduLengthHandlingStrategy = IGNORE
              PduRDestPduCrossPartitionDestination = false
              PduRTransmissionConfirmation = false
              PduRDestPduRef = OBD_HCP1_SOK_XIX_HCP5_CANFD01_499f5f1b_Rx
              PduRDestPduPduRBswModulesRef = SecOC
          DCM_HCP5_CANFD01_XIX_TPCHType_CANFD_OBDC_Diagnose_XIX_0x1C42027B_XIX_0x1C40027B_XIX_Physical_c887ac0a_Tx: PduRRoutingPathCommunicationType=TRANSPORT_PROTOCOL
            PduRSrcPdu_b085c674 (PduRSrcPdu):
              PduRSourcePduHandleId = 31
              PduRSrcPduDirection = TRANSMIT
              PduRSrcPduRef = DCM_HCP5_CANFD01_XIX_TPCHType_CANFD_OBDC_Diagnose_XIX_0x1C42027B_XIX_0x1C40027B_XIX_Physical_c887ac0a_Tx
              PduRSrcPduPduRBswModulesRef = Dcm
            DCM_HCP5_CANFD01_XIX_TPCHType_CANFD_OBDC_Diagnose_XIX_0x1C42027B_XIX_0x1C40027B_XIX_Physical_4ad10dcb_Tx (PduRDestPdu):
              PduRDestPduHandleId = 3
              PduRDestPduDirection = TRANSMIT
              PduRDestPduRoutingType = API_FORWARDING
              PduRDestPduDataProcessing = IMMEDIATE
              PduRPduLengthHandlingStrategy = UNUSED
              PduRDestPduCrossPartitionDestination = false
              PduRDestPduRef = DCM_HCP5_CANFD01_XIX_TPCHType_CANFD_OBDC_Diagnose_XIX_0x1C42027B_XIX_0x1C40027B_XIX_Physical_4ad10dcb_Tx
              PduRDestPduPduRBswModulesRef = CanTp
          UI2_Komponentenfehler_01_XIX_BMC_CAN01_6d09fe13_Rx: PduRRoutingPathCommunicationType=COMMUNICATION_INTERFACE
            UI2_Komponentenfehler_01_XIX_BMC_CAN01_6d09fe13_Rx_b8d5b81b_Rx (PduRDestPdu):
              PduRDestPduHandleId = 64
              PduRDestPduDirection = RECEIVE
              PduRDestPduRoutingType = API_FORWARDING
              PduRDestPduDataProcessing = IMMEDIATE
              PduRPduLengthHandlingStrategy = IGNORE
              PduRDestPduCrossPartitionDestination = false
              PduRTransmissionConfirmation = false
              PduRDestPduRef = UI2_Komponentenfehler_01_XIX_BMC_CAN01_6c666489_Rx
              PduRDestPduPduRBswModulesRef = Com
            PduRSrcPdu_b8d5b81b (PduRSrcPdu):
              PduRSourcePduHandleId = 82
              PduRSrcPduDirection = RECEIVE
              PduRSrcPduRef = UI2_Komponentenfehler_01_XIX_BMC_CAN01_6d09fe13_Rx
              PduRSrcPduPduRBswModulesRef = CanIf
          HVLM_14_XIX_HCP5_CANFD01_E2E_2623685a_Rx: PduRRoutingPathCommunicationType=COMMUNICATION_INTERFACE
            HVLM_14_XIX_HCP5_CANFD01_E2E_2623685a_Rx_f33ff981_Rx (PduRDestPdu):
              PduRDestPduHandleId = 27
              PduRDestPduDirection = RECEIVE
              PduRDestPduRoutingType = API_FORWARDING
              PduRDestPduDataProcessing = IMMEDIATE
              PduRPduLengthHandlingStrategy = IGNORE
              PduRDestPduCrossPartitionDestination = false
              PduRTransmissionConfirmation = false
              PduRDestPduRef = HVLM_14_XIX_HCP5_CANFD01_E2E_b3d1458f_Rx
              PduRDestPduPduRBswModulesRef = Com
            PduRSrcPdu_f33ff981 (PduRSrcPdu): PduRSourcePduHandleId=52, PduRSrcPduDirection=RECEIVE, PduRSrcPduRef=HVLM_14_XIX_HCP5_CANFD01_E2E_2623685a_Rx, PduRSrcPduPduRBswModulesRef=CanIf
          DCDC_NV_CVN_XIX_HCP5_CANFD01_01267e2b_Rx: PduRRoutingPathCommunicationType=COMMUNICATION_INTERFACE
            PduRSrcPdu_e7e304e9 (PduRSrcPdu): PduRSourcePduHandleId=39, PduRSrcPduDirection=RECEIVE, PduRSrcPduRef=DCDC_NV_CVN_XIX_HCP5_CANFD01_01267e2b_Rx, PduRSrcPduPduRBswModulesRef=CanIf
            DCDC_NV_CVN_XIX_HCP5_CANFD01_01267e2b_Rx_e7e304e9_Rx (PduRDestPdu):
              PduRDestPduHandleId = 13
              PduRDestPduDirection = RECEIVE
              PduRDestPduRoutingType = API_FORWARDING
              PduRDestPduDataProcessing = IMMEDIATE
              PduRPduLengthHandlingStrategy = IGNORE
              PduRDestPduCrossPartitionDestination = false
              PduRTransmissionConfirmation = false
              PduRDestPduRef = DCDC_NV_CVN_XIX_HCP5_CANFD01_55665719_Rx
              PduRDestPduPduRBswModulesRef = Com
          DCM_HCP5_CANFD01_XIX_TPCHType_CANFD_ISO_Diagnose_XIX_0x1C40007B_XIX_0x1C42007B_XIX_Physical_e79447d3_Rx: PduRRoutingPathCommunicationType=TRANSPORT_PROTOCOL
            DCM_HCP5_CANFD01_XIX_TPCHType_CANFD_ISO_Diagnose_XIX_0x1C40007B_XIX_0x1C42007B_XIX_Physical_e79447d3_Rx_d8567614_Rx (PduRDestPdu):
              PduRDestPduHandleId = 2
              PduRDestPduDirection = RECEIVE
              PduRDestPduRoutingType = API_FORWARDING
              PduRDestPduDataProcessing = IMMEDIATE
              PduRPduLengthHandlingStrategy = UNUSED
              PduRDestPduCrossPartitionDestination = false
              PduRDestPduRef = DCM_HCP5_CANFD01_XIX_TPCHType_CANFD_ISO_Diagnose_XIX_0x1C40007B_XIX_0x1C42007B_XIX_Physical_238d3514_Rx
              PduRDestPduPduRBswModulesRef = Dcm
            PduRSrcPdu_d8567614 (PduRSrcPdu):
              PduRSourcePduHandleId = 4
              PduRSrcPduDirection = RECEIVE
              PduRSrcPduRef = DCM_HCP5_CANFD01_XIX_TPCHType_CANFD_ISO_Diagnose_XIX_0x1C40007B_XIX_0x1C42007B_XIX_Physical_e79447d3_Rx
              PduRSrcPduPduRBswModulesRef = CanTp
          BMC_HV_06_XIX_HCP5_CANFD01_e2eda0bb_Tx: PduRRoutingPathCommunicationType=COMMUNICATION_INTERFACE
            BMC_HV_06_XIX_HCP5_CANFD01_e2eda0bb_Tx (PduRDestPdu):
              PduRDestPduHandleId = 16
              PduRDestPduDirection = TRANSMIT
              PduRDestPduRoutingType = API_FORWARDING
              PduRDestPduDataProcessing = IMMEDIATE
              PduRPduLengthHandlingStrategy = IGNORE
              PduRDestPduCrossPartitionDestination = false
              PduRTransmissionConfirmation = true
              PduRDestPduDataProvision = PDUR_DIRECT
              PduRDestPduRef = BMC_HV_06_XIX_HCP5_CANFD01_e2eda0bb_Tx
              PduRDestPduPduRBswModulesRef = SecOC
            PduRSrcPdu_29efbb20 (PduRSrcPdu): PduRSourcePduHandleId=16, PduRSrcPduDirection=TRANSMIT, PduRSrcPduRef=BMC_HV_06_XIX_HCP5_CANFD01_e2eda0bb_Tx, PduRSrcPduPduRBswModulesRef=Com
          BMC_HV_ba0fd24b_Rx: PduRRoutingPathCommunicationType=COMMUNICATION_INTERFACE
            PduRSrcPdu_3290d1c3 (PduRSrcPdu): PduRSourcePduHandleId=27, PduRSrcPduDirection=RECEIVE, PduRSrcPduRef=OBD_04_XIX_HCP5_CANFD01_dc080cfa_Rx, PduRSrcPduPduRBswModulesRef=CanIf
            BMC_HV_ba0fd24b_Rx_3290d1c3_Rx (PduRDestPdu):
              PduRDestPduHandleId = 32
              PduRDestPduDirection = RECEIVE
              PduRDestPduRoutingType = API_FORWARDING
              PduRDestPduDataProcessing = IMMEDIATE
              PduRPduLengthHandlingStrategy = IGNORE
              PduRDestPduCrossPartitionDestination = false
              PduRTransmissionConfirmation = false
              PduRDestPduRef = OBD_04_XIX_HCP5_CANFD01_100612ed_Rx
              PduRDestPduPduRBswModulesRef = Com
            BMC_HV_e04d57a6_Tx (PduRDestPdu):
              PduRDestPduHandleId = 56
              PduRDestPduDirection = TRANSMIT
              PduRDestPduRoutingType = GATEWAY_ROUTING
              PduRDestPduDataProcessing = IMMEDIATE
              PduRPduLengthHandlingStrategy = IGNORE
              PduRDestPduCrossPartitionDestination = false
              PduRTransmissionConfirmation = false
              PduRDestPduDataProvision = PDUR_DIRECT
              PduRDestPduRef = OBD_04_XIX_BMC_CAN01_a3a3ce7e_Tx
              PduRDestPduPduRBswModulesRef = CanIf
          BMC_HV_1b004d69_Rx: PduRRoutingPathCommunicationType=COMMUNICATION_INTERFACE
            PduRSrcPdu_347cf23a (PduRSrcPdu):
              PduRSourcePduHandleId = 13
              PduRSrcPduDirection = RECEIVE
              PduRSrcPduRef = DIA_UI2Sens01_Resp_XIX_BMC_CAN01_2ddec3aa_Rx
              PduRSrcPduPduRBswModulesRef = CanIf
            BMC_HV_a00eedd8_Tx (PduRDestPdu):
              PduRDestPduHandleId = 38
              PduRDestPduDirection = TRANSMIT
              PduRDestPduRoutingType = GATEWAY_ROUTING
              PduRDestPduDataProcessing = IMMEDIATE
              PduRPduLengthHandlingStrategy = IGNORE
              PduRDestPduCrossPartitionDestination = false
              PduRTransmissionConfirmation = false
              PduRDestPduDataProvision = PDUR_DIRECT
              PduRDestPduRef = DIA_UI2Sens01_Resp_XIX_HCP5_CANFD01_dfc9d8b9_Tx
              PduRDestPduPduRBswModulesRef = CanIf
          BMC_CMC_Zellspannung_04_XIX_HCP5_CANFD01_1395de0e_Tx: PduRRoutingPathCommunicationType=COMMUNICATION_INTERFACE
            BMC_CMC_Zellspannung_04_XIX_HCP5_CANFD01_9eddac84_Tx (PduRDestPdu):
              PduRDestPduHandleId = 6
              PduRDestPduDirection = TRANSMIT
              PduRDestPduRoutingType = API_FORWARDING
              PduRDestPduDataProcessing = IMMEDIATE
              PduRPduLengthHandlingStrategy = IGNORE
              PduRDestPduCrossPartitionDestination = false
              PduRTransmissionConfirmation = true
              PduRDestPduDataProvision = PDUR_DIRECT
              PduRDestPduRef = BMC_CMC_Zellspannung_04_XIX_HCP5_CANFD01_9eddac84_Tx
              PduRDestPduPduRBswModulesRef = CanIf
            PduRSrcPdu_025474df (PduRSrcPdu):
              PduRSourcePduHandleId = 6
              PduRSrcPduDirection = TRANSMIT
              PduRSrcPduRef = BMC_CMC_Zellspannung_04_XIX_HCP5_CANFD01_1395de0e_Tx
              PduRSrcPduPduRBswModulesRef = Com
          UI2Sens01_CALID_02_XIX_BMC_CAN01_0ca022e6_Rx: PduRRoutingPathCommunicationType=COMMUNICATION_INTERFACE
            PduRSrcPdu_31992630 (PduRSrcPdu):
              PduRSourcePduHandleId = 73
              PduRSrcPduDirection = RECEIVE
              PduRSrcPduRef = UI2Sens01_CALID_02_XIX_BMC_CAN01_0ca022e6_Rx
              PduRSrcPduPduRBswModulesRef = CanIf
            UI2Sens01_CALID_02_XIX_BMC_CAN01_0ca022e6_Rx_31992630_Rx (PduRDestPdu):
              PduRDestPduHandleId = 55
              PduRDestPduDirection = RECEIVE
              PduRDestPduRoutingType = API_FORWARDING
              PduRDestPduDataProcessing = IMMEDIATE
              PduRPduLengthHandlingStrategy = IGNORE
              PduRDestPduCrossPartitionDestination = false
              PduRTransmissionConfirmation = false
              PduRDestPduRef = UI2Sens01_CALID_02_XIX_BMC_CAN01_e2b448f9_Rx
              PduRDestPduPduRBswModulesRef = Com
          DCDC_NV_Komponentenfehler_04_XIX_HCP5_CANFD01_54dfe7dc_Rx: PduRRoutingPathCommunicationType=COMMUNICATION_INTERFACE
            PduRSrcPdu_624bad38 (PduRSrcPdu):
              PduRSourcePduHandleId = 43
              PduRSrcPduDirection = RECEIVE
              PduRSrcPduRef = DCDC_NV_Komponentenfehler_04_XIX_HCP5_CANFD01_54dfe7dc_Rx
              PduRSrcPduPduRBswModulesRef = CanIf
            DCDC_NV_Komponentenfehler_04_XIX_HCP5_CANFD01_54dfe7dc_Rx_624bad38_Rx (PduRDestPdu):
              PduRDestPduHandleId = 17
              PduRDestPduDirection = RECEIVE
              PduRDestPduRoutingType = API_FORWARDING
              PduRDestPduDataProcessing = IMMEDIATE
              PduRPduLengthHandlingStrategy = IGNORE
              PduRDestPduCrossPartitionDestination = false
              PduRTransmissionConfirmation = false
              PduRDestPduRef = DCDC_NV_Komponentenfehler_04_XIX_HCP5_CANFD01_39921681_Rx
              PduRDestPduPduRBswModulesRef = Com
          UI2_Komponentenfehler_02_XIX_BMC_CAN01_008f0d49_Rx: PduRRoutingPathCommunicationType=COMMUNICATION_INTERFACE
            UI2_Komponentenfehler_02_XIX_BMC_CAN01_008f0d49_Rx_48d15ae7_Rx (PduRDestPdu):
              PduRDestPduHandleId = 65
              PduRDestPduDirection = RECEIVE
              PduRDestPduRoutingType = API_FORWARDING
              PduRDestPduDataProcessing = IMMEDIATE
              PduRPduLengthHandlingStrategy = IGNORE
              PduRDestPduCrossPartitionDestination = false
              PduRTransmissionConfirmation = false
              PduRDestPduRef = UI2_Komponentenfehler_02_XIX_BMC_CAN01_7d1b0ef0_Rx
              PduRDestPduPduRBswModulesRef = Com
            PduRSrcPdu_48d15ae7 (PduRSrcPdu):
              PduRSourcePduHandleId = 83
              PduRSrcPduDirection = RECEIVE
              PduRSrcPduRef = UI2_Komponentenfehler_02_XIX_BMC_CAN01_008f0d49_Rx
              PduRSrcPduPduRBswModulesRef = CanIf
          DCM_HCP5_CANFD01_XIX_TPCHType_CANHS_OBDx_XIX_0x18DA05F1_XIX_0x18DAF105_XIX_Physical_31397855_Rx: PduRRoutingPathCommunicationType=TRANSPORT_PROTOCOL
            DCM_HCP5_CANFD01_XIX_TPCHType_CANHS_OBDx_XIX_0x18DA05F1_XIX_0x18DAF105_XIX_Physical_31397855_Rx_2f3fa766_Rx (PduRDestPdu):
              PduRDestPduHandleId = 7
              PduRDestPduDirection = RECEIVE
              PduRDestPduRoutingType = API_FORWARDING
              PduRDestPduDataProcessing = IMMEDIATE
              PduRPduLengthHandlingStrategy = UNUSED
              PduRDestPduCrossPartitionDestination = false
              PduRDestPduRef = DCM_HCP5_CANFD01_XIX_TPCHType_CANHS_OBDx_XIX_0x18DA05F1_XIX_0x18DAF105_XIX_Physical_c08ed539_Rx
              PduRDestPduPduRBswModulesRef = Dcm
            PduRSrcPdu_2f3fa766 (PduRSrcPdu):
              PduRSourcePduHandleId = 7
              PduRSrcPduDirection = RECEIVE
              PduRSrcPduRef = DCM_HCP5_CANFD01_XIX_TPCHType_CANHS_OBDx_XIX_0x18DA05F1_XIX_0x18DAF105_XIX_Physical_31397855_Rx
              PduRSrcPduPduRBswModulesRef = CanTp
          BMC_HV_9f499ab6_Rx: PduRRoutingPathCommunicationType=COMMUNICATION_INTERFACE
            PduRSrcPdu_611d700c (PduRSrcPdu):
              PduRSourcePduHandleId = 18
              PduRSrcPduDirection = RECEIVE
              PduRSrcPduRef = OBDC_SSN_UI2Sens01_Resp_XIX_BMC_CAN01_327140fa_Rx
              PduRSrcPduPduRBswModulesRef = CanIf
            BMC_HV_78934480_Tx (PduRDestPdu):
              PduRDestPduHandleId = 52
              PduRDestPduDirection = TRANSMIT
              PduRDestPduRoutingType = GATEWAY_ROUTING
              PduRDestPduDataProcessing = IMMEDIATE
              PduRPduLengthHandlingStrategy = IGNORE
              PduRDestPduCrossPartitionDestination = false
              PduRTransmissionConfirmation = false
              PduRDestPduDataProvision = PDUR_DIRECT
              PduRDestPduRef = OBDC_SSN_UI2Sens01_Resp_XIX_HCP5_CANFD01_2773f712_Tx
              PduRDestPduPduRBswModulesRef = CanIf
          HVK_03_E2E_SOK_XIX_HCP5_CANFD01_17f9ff97_Rx: PduRRoutingPathCommunicationType=COMMUNICATION_INTERFACE
            HVK_03_E2E_SOK_XIX_HCP5_CANFD01_17f9ff97_Rx_69fab053_Rx (PduRDestPdu):
              PduRDestPduHandleId = 24
              PduRDestPduDirection = RECEIVE
              PduRDestPduRoutingType = API_FORWARDING
              PduRDestPduDataProcessing = IMMEDIATE
              PduRPduLengthHandlingStrategy = IGNORE
              PduRDestPduCrossPartitionDestination = false
              PduRTransmissionConfirmation = false
              PduRDestPduRef = HVK_03_E2E_SOK_XIX_HCP5_CANFD01_32c3c9b9_Rx
              PduRDestPduPduRBswModulesRef = SecOC
            PduRSrcPdu_69fab053 (PduRSrcPdu):
              PduRSourcePduHandleId = 49
              PduRSrcPduDirection = RECEIVE
              PduRSrcPduRef = HVK_03_E2E_SOK_XIX_HCP5_CANFD01_17f9ff97_Rx
              PduRSrcPduPduRBswModulesRef = CanIf
          KS_Hybrid_01_Response_M_XIX_HCP5_CANFD01_1b34419b_Rx: PduRRoutingPathCommunicationType=COMMUNICATION_INTERFACE
            PduRSrcPdu_150a78db (PduRSrcPdu):
              PduRSourcePduHandleId = 54
              PduRSrcPduDirection = RECEIVE
              PduRSrcPduRef = KS_Hybrid_01_Response_M_XIX_HCP5_CANFD01_1b34419b_Rx
              PduRSrcPduPduRBswModulesRef = CanIf
            KS_Hybrid_01_Response_M_XIX_HCP5_CANFD01_1b34419b_Rx_150a78db_Rx (PduRDestPdu):
              PduRDestPduHandleId = 29
              PduRDestPduDirection = RECEIVE
              PduRDestPduRoutingType = API_FORWARDING
              PduRDestPduDataProcessing = IMMEDIATE
              PduRPduLengthHandlingStrategy = IGNORE
              PduRDestPduCrossPartitionDestination = false
              PduRTransmissionConfirmation = false
              PduRDestPduRef = KS_Hybrid_01_Response_M_XIX_HCP5_CANFD01_78a6c4aa_Rx
              PduRDestPduPduRBswModulesRef = Com
          BMC_CMC_Temperatur_01_XIX_HCP5_CANFD01_13d55235_Tx: PduRRoutingPathCommunicationType=COMMUNICATION_INTERFACE
            BMC_CMC_Temperatur_01_XIX_HCP5_CANFD01_0fcecf3e_Tx (PduRDestPdu):
              PduRDestPduHandleId = 0
              PduRDestPduDirection = TRANSMIT
              PduRDestPduRoutingType = API_FORWARDING
              PduRDestPduDataProcessing = IMMEDIATE
              PduRPduLengthHandlingStrategy = IGNORE
              PduRDestPduCrossPartitionDestination = false
              PduRTransmissionConfirmation = true
              PduRDestPduDataProvision = PDUR_DIRECT
              PduRDestPduRef = BMC_CMC_Temperatur_01_XIX_HCP5_CANFD01_0fcecf3e_Tx
              PduRDestPduPduRBswModulesRef = CanIf
            PduRSrcPdu_4390fcc7 (PduRSrcPdu):
              PduRSourcePduHandleId = 0
              PduRSrcPduDirection = TRANSMIT
              PduRSrcPduRef = BMC_CMC_Temperatur_01_XIX_HCP5_CANFD01_13d55235_Tx
              PduRSrcPduPduRBswModulesRef = Com
          Diagnose_01_XIX_HCP5_CANFD01_95a294dc_Rx: PduRRoutingPathCommunicationType=COMMUNICATION_INTERFACE
            Diagnose_01_XIX_HCP5_CANFD01_95a294dc_Rx_38b07996_Rx (PduRDestPdu):
              PduRDestPduHandleId = 20
              PduRDestPduDirection = RECEIVE
              PduRDestPduRoutingType = API_FORWARDING
              PduRDestPduDataProcessing = IMMEDIATE
              PduRPduLengthHandlingStrategy = IGNORE
              PduRDestPduCrossPartitionDestination = false
              PduRTransmissionConfirmation = false
              PduRDestPduRef = Diagnose_01_XIX_HCP5_CANFD01_426f0ab5_Rx
              PduRDestPduPduRBswModulesRef = Com
            PduRSrcPdu_38b07996 (PduRSrcPdu): PduRSourcePduHandleId=45, PduRSrcPduDirection=RECEIVE, PduRSrcPduRef=Diagnose_01_XIX_HCP5_CANFD01_95a294dc_Rx, PduRSrcPduPduRBswModulesRef=CanIf
          BMC_HV_07_XIX_HCP5_CANFD01_0dbf165a_Tx: PduRRoutingPathCommunicationType=COMMUNICATION_INTERFACE
            BMC_HV_07_XIX_HCP5_CANFD01_0dbf165a_Tx (PduRDestPdu):
              PduRDestPduHandleId = 18
              PduRDestPduDirection = TRANSMIT
              PduRDestPduRoutingType = API_FORWARDING
              PduRDestPduDataProcessing = IMMEDIATE
              PduRPduLengthHandlingStrategy = IGNORE
              PduRDestPduCrossPartitionDestination = false
              PduRTransmissionConfirmation = true
              PduRDestPduDataProvision = PDUR_DIRECT
              PduRDestPduRef = BMC_HV_07_XIX_HCP5_CANFD01_0dbf165a_Tx
              PduRDestPduPduRBswModulesRef = SecOC
            PduRSrcPdu_e322036a (PduRSrcPdu): PduRSourcePduHandleId=18, PduRSrcPduDirection=TRANSMIT, PduRSrcPduRef=BMC_HV_07_XIX_HCP5_CANFD01_0dbf165a_Tx, PduRSrcPduPduRBswModulesRef=Com
          DCDC_NV_CALID_XIX_HCP5_CANFD01_004a20bd_Rx: PduRRoutingPathCommunicationType=COMMUNICATION_INTERFACE
            DCDC_NV_CALID_XIX_HCP5_CANFD01_004a20bd_Rx_e1d44665_Rx (PduRDestPdu):
              PduRDestPduHandleId = 12
              PduRDestPduDirection = RECEIVE
              PduRDestPduRoutingType = API_FORWARDING
              PduRDestPduDataProcessing = IMMEDIATE
              PduRPduLengthHandlingStrategy = IGNORE
              PduRDestPduCrossPartitionDestination = false
              PduRTransmissionConfirmation = false
              PduRDestPduRef = DCDC_NV_CALID_XIX_HCP5_CANFD01_46b970f2_Rx
              PduRDestPduPduRBswModulesRef = Com
            PduRSrcPdu_e1d44665 (PduRSrcPdu): PduRSourcePduHandleId=38, PduRSrcPduDirection=RECEIVE, PduRSrcPduRef=DCDC_NV_CALID_XIX_HCP5_CANFD01_004a20bd_Rx, PduRSrcPduPduRBswModulesRef=CanIf
          OBD_HCP1_XIX_HCP5_CANFD01_1b389b6c_Rx: PduRRoutingPathCommunicationType=COMMUNICATION_INTERFACE
            PduRSrcPdu_5b8ddcf4 (PduRSrcPdu): PduRSourcePduHandleId=57, PduRSrcPduDirection=RECEIVE, PduRSrcPduRef=OBD_HCP1_XIX_HCP5_CANFD01_1b389b6c_Rx, PduRSrcPduPduRBswModulesRef=SecOC
            OBD_HCP1_XIX_HCP5_CANFD01_1b389b6c_Rx (PduRDestPdu):
              PduRDestPduHandleId = 34
              PduRDestPduDirection = RECEIVE
              PduRDestPduRoutingType = API_FORWARDING
              PduRDestPduDataProcessing = IMMEDIATE
              PduRPduLengthHandlingStrategy = IGNORE
              PduRDestPduCrossPartitionDestination = false
              PduRTransmissionConfirmation = false
              PduRDestPduRef = OBD_HCP1_XIX_HCP5_CANFD01_1b389b6c_Rx
              PduRDestPduPduRBswModulesRef = Com
          OTP_01_XIX_HCP5_CANFD01_fd0a6756_Rx: PduRRoutingPathCommunicationType=COMMUNICATION_INTERFACE
            OTP_01_XIX_HCP5_CANFD01_fd0a6756_Rx_c5c247d5_Rx (PduRDestPdu):
              PduRDestPduHandleId = 40
              PduRDestPduDirection = RECEIVE
              PduRDestPduRoutingType = API_FORWARDING
              PduRDestPduDataProcessing = IMMEDIATE
              PduRPduLengthHandlingStrategy = IGNORE
              PduRDestPduCrossPartitionDestination = false
              PduRTransmissionConfirmation = false
              PduRDestPduRef = OTP_01_XIX_HCP5_CANFD01_76e7759c_Rx
              PduRDestPduPduRBswModulesRef = Com
            PduRSrcPdu_c5c247d5 (PduRSrcPdu): PduRSourcePduHandleId=59, PduRSrcPduDirection=RECEIVE, PduRSrcPduRef=OTP_01_XIX_HCP5_CANFD01_fd0a6756_Rx, PduRSrcPduPduRBswModulesRef=CanIf
          ZeitMaster_01_XIX_HCP5_CANFD01_16302e51_Rx: PduRRoutingPathCommunicationType=COMMUNICATION_INTERFACE
            ZeitMaster_01_XIX_HCP5_CANFD01_16302e51_Rx_2f7b3461_Rx (PduRDestPdu):
              PduRDestPduHandleId = 68
              PduRDestPduDirection = RECEIVE
              PduRDestPduRoutingType = API_FORWARDING
              PduRDestPduDataProcessing = IMMEDIATE
              PduRPduLengthHandlingStrategy = IGNORE
              PduRDestPduCrossPartitionDestination = false
              PduRTransmissionConfirmation = false
              PduRDestPduRef = ZeitMaster_01_XIX_HCP5_CANFD01_dad73d21_Rx
              PduRDestPduPduRBswModulesRef = Com
            PduRSrcPdu_2f7b3461 (PduRSrcPdu): PduRSourcePduHandleId=86, PduRSrcPduDirection=RECEIVE, PduRSrcPduRef=ZeitMaster_01_XIX_HCP5_CANFD01_16302e51_Rx, PduRSrcPduPduRBswModulesRef=CanIf
          BMC_HV_02_E2E_SOK_XIX_HCP5_CANFD01_5f228eff_Tx: PduRRoutingPathCommunicationType=COMMUNICATION_INTERFACE
            PduRSrcPdu_868743d6 (PduRSrcPdu):
              PduRSourcePduHandleId = 10
              PduRSrcPduDirection = TRANSMIT
              PduRSrcPduRef = BMC_HV_02_E2E_SOK_XIX_HCP5_CANFD01_5f228eff_Tx
              PduRSrcPduPduRBswModulesRef = SecOC
            BMC_HV_02_E2E_SOK_XIX_HCP5_CANFD01_4f75cc0d_Tx (PduRDestPdu):
              PduRDestPduHandleId = 10
              PduRDestPduDirection = TRANSMIT
              PduRDestPduRoutingType = API_FORWARDING
              PduRDestPduDataProcessing = IMMEDIATE
              PduRPduLengthHandlingStrategy = IGNORE
              PduRDestPduCrossPartitionDestination = false
              PduRTransmissionConfirmation = true
              PduRDestPduDataProvision = PDUR_DIRECT
              PduRDestPduRef = BMC_HV_02_E2E_SOK_XIX_HCP5_CANFD01_4f75cc0d_Tx
              PduRDestPduPduRBswModulesRef = CanIf
          BMC_HV_0b268b06_Rx: PduRRoutingPathCommunicationType=COMMUNICATION_INTERFACE
            PduRSrcPdu_dbb16064 (PduRSrcPdu):
              PduRSourcePduHandleId = 9
              PduRSrcPduDirection = RECEIVE
              PduRSrcPduRef = DIA_UI2Sens02_Req_XIX_HCP5_CANFD01_a61e514a_Rx
              PduRSrcPduPduRBswModulesRef = CanIf
            BMC_HV_d79e3995_Tx (PduRDestPdu):
              PduRDestPduHandleId = 39
              PduRDestPduDirection = TRANSMIT
              PduRDestPduRoutingType = GATEWAY_ROUTING
              PduRDestPduDataProcessing = IMMEDIATE
              PduRPduLengthHandlingStrategy = IGNORE
              PduRDestPduCrossPartitionDestination = false
              PduRTransmissionConfirmation = false
              PduRDestPduDataProvision = PDUR_DIRECT
              PduRDestPduRef = DIA_UI2Sens02_Req_XIX_BMC_CAN01_0a5a0c3f_Tx
              PduRDestPduPduRBswModulesRef = CanIf
          SOK_NoAuthenticTime_01_XIX_HCP5_CANFD01_8db7a3c2_Rx: PduRRoutingPathCommunicationType=COMMUNICATION_INTERFACE
            PduRSrcPdu_80319ce0 (PduRSrcPdu):
              PduRSourcePduHandleId = 61
              PduRSrcPduDirection = RECEIVE
              PduRSrcPduRef = SOK_NoAuthenticTime_01_XIX_HCP5_CANFD01_8db7a3c2_Rx
              PduRSrcPduPduRBswModulesRef = CanIf
            SOK_NoAuthenticTime_01_XIX_HCP5_CANFD01_8db7a3c2_Rx_80319ce0_Rx (PduRDestPdu):
              PduRDestPduHandleId = 42
              PduRDestPduDirection = RECEIVE
              PduRDestPduRoutingType = API_FORWARDING
              PduRDestPduDataProcessing = IMMEDIATE
              PduRPduLengthHandlingStrategy = IGNORE
              PduRDestPduCrossPartitionDestination = false
              PduRTransmissionConfirmation = false
              PduRDestPduRef = SOK_NoAuthenticTime_01_XIX_HCP5_CANFD01_a407ae2f_Rx
              PduRDestPduPduRBswModulesRef = Com
          BMC_HV_12_XIX_BMC_CAN01_E2E_5c19d7a0_Tx: PduRRoutingPathCommunicationType=COMMUNICATION_INTERFACE
            PduRSrcPdu_e5700097 (PduRSrcPdu): PduRSourcePduHandleId=25, PduRSrcPduDirection=TRANSMIT, PduRSrcPduRef=BMC_HV_12_XIX_BMC_CAN01_E2E_5c19d7a0_Tx, PduRSrcPduPduRBswModulesRef=Com
            BMC_HV_12_XIX_BMC_CAN01_E2E_f1e87254_Tx (PduRDestPdu):
              PduRDestPduHandleId = 25
              PduRDestPduDirection = TRANSMIT
              PduRDestPduRoutingType = API_FORWARDING
              PduRDestPduDataProcessing = IMMEDIATE
              PduRPduLengthHandlingStrategy = IGNORE
              PduRDestPduCrossPartitionDestination = false
              PduRTransmissionConfirmation = true
              PduRDestPduDataProvision = PDUR_DIRECT
              PduRDestPduRef = BMC_HV_12_XIX_BMC_CAN01_E2E_f1e87254_Tx
              PduRDestPduPduRBswModulesRef = CanIf
          DEV_Hybrid_01_Resp_FF_XIX_HCP5_CANFD01_7b20ac63_Tx: PduRRoutingPathCommunicationType=COMMUNICATION_INTERFACE
            DEV_Hybrid_01_Resp_FF_XIX_HCP5_CANFD01_3aa35b5c_Tx (PduRDestPdu):
              PduRDestPduHandleId = 34
              PduRDestPduDirection = TRANSMIT
              PduRDestPduRoutingType = API_FORWARDING
              PduRDestPduDataProcessing = IMMEDIATE
              PduRPduLengthHandlingStrategy = IGNORE
              PduRDestPduCrossPartitionDestination = false
              PduRTransmissionConfirmation = true
              PduRDestPduDataProvision = PDUR_DIRECT
              PduRDestPduRef = DEV_Hybrid_01_Resp_FF_XIX_HCP5_CANFD01_3aa35b5c_Tx
              PduRDestPduPduRBswModulesRef = CanIf
            PduRSrcPdu_50b5fcd7 (PduRSrcPdu):
              PduRSourcePduHandleId = 34
              PduRSrcPduDirection = TRANSMIT
              PduRSrcPduRef = DEV_Hybrid_01_Resp_FF_XIX_HCP5_CANFD01_7b20ac63_Tx
              PduRSrcPduPduRBswModulesRef = Com
          BMC_HV_01_E2E_SOK_XIX_HCP5_CANFD01_ad756307_Tx: PduRRoutingPathCommunicationType=COMMUNICATION_INTERFACE
            BMC_HV_01_E2E_SOK_XIX_HCP5_CANFD01_09a7f969_Tx (PduRDestPdu):
              PduRDestPduHandleId = 8
              PduRDestPduDirection = TRANSMIT
              PduRDestPduRoutingType = API_FORWARDING
              PduRDestPduDataProcessing = IMMEDIATE
              PduRPduLengthHandlingStrategy = IGNORE
              PduRDestPduCrossPartitionDestination = false
              PduRTransmissionConfirmation = true
              PduRDestPduDataProvision = PDUR_DIRECT
              PduRDestPduRef = BMC_HV_01_E2E_SOK_XIX_HCP5_CANFD01_09a7f969_Tx
              PduRDestPduPduRBswModulesRef = CanIf
            PduRSrcPdu_09a5b367 (PduRSrcPdu):
              PduRSourcePduHandleId = 8
              PduRSrcPduDirection = TRANSMIT
              PduRSrcPduRef = BMC_HV_01_E2E_SOK_XIX_HCP5_CANFD01_ad756307_Tx
              PduRSrcPduPduRBswModulesRef = SecOC
          BMC_HV_a64aa887_Rx: PduRRoutingPathCommunicationType=COMMUNICATION_INTERFACE
            PduRSrcPdu_6d136cb6 (PduRSrcPdu): PduRSourcePduHandleId=23, PduRSrcPduDirection=RECEIVE, PduRSrcPduRef=DIA_BJB_Resp_XIX_BMC_CAN01_c04d7636_Rx, PduRSrcPduPduRBswModulesRef=CanIf
            BMC_HV_555b0a9f_Tx (PduRDestPdu):
              PduRDestPduHandleId = 36
              PduRDestPduDirection = TRANSMIT
              PduRDestPduRoutingType = GATEWAY_ROUTING
              PduRDestPduDataProcessing = IMMEDIATE
              PduRPduLengthHandlingStrategy = IGNORE
              PduRDestPduCrossPartitionDestination = false
              PduRTransmissionConfirmation = false
              PduRDestPduDataProvision = PDUR_DIRECT
              PduRDestPduRef = DIA_BJB_Resp_XIX_HCP5_CANFD01_6385845c_Tx
              PduRDestPduPduRBswModulesRef = CanIf
          BJB_12_XIX_BMC_CAN01_E2E_c4dd8994_Rx: PduRRoutingPathCommunicationType=COMMUNICATION_INTERFACE
            PduRSrcPdu_7a49b272 (PduRSrcPdu): PduRSourcePduHandleId=4, PduRSrcPduDirection=RECEIVE, PduRSrcPduRef=BJB_12_XIX_BMC_CAN01_E2E_c4dd8994_Rx, PduRSrcPduPduRBswModulesRef=CanIf
            BJB_12_XIX_BMC_CAN01_E2E_c4dd8994_Rx_7a49b272_Rx (PduRDestPdu):
              PduRDestPduHandleId = 4
              PduRDestPduDirection = RECEIVE
              PduRDestPduRoutingType = API_FORWARDING
              PduRDestPduDataProcessing = IMMEDIATE
              PduRPduLengthHandlingStrategy = IGNORE
              PduRDestPduCrossPartitionDestination = false
              PduRTransmissionConfirmation = false
              PduRDestPduRef = BJB_12_XIX_BMC_CAN01_E2E_e2311042_Rx
              PduRDestPduPduRBswModulesRef = Com
          UI1_05_XIX_BMC_CAN01_d1b05aa4_Rx: PduRRoutingPathCommunicationType=COMMUNICATION_INTERFACE
            PduRSrcPdu_472804b0 (PduRSrcPdu): PduRSourcePduHandleId=69, PduRSrcPduDirection=RECEIVE, PduRSrcPduRef=UI1_05_XIX_BMC_CAN01_d1b05aa4_Rx, PduRSrcPduPduRBswModulesRef=CanIf
            UI1_05_XIX_BMC_CAN01_d1b05aa4_Rx_472804b0_Rx (PduRDestPdu):
              PduRDestPduHandleId = 51
              PduRDestPduDirection = RECEIVE
              PduRDestPduRoutingType = API_FORWARDING
              PduRDestPduDataProcessing = IMMEDIATE
              PduRPduLengthHandlingStrategy = IGNORE
              PduRDestPduCrossPartitionDestination = false
              PduRTransmissionConfirmation = false
              PduRDestPduRef = UI1_05_XIX_BMC_CAN01_608d1e29_Rx
              PduRDestPduPduRBswModulesRef = Com
          BMC_HV_0ef050eb_Rx: PduRRoutingPathCommunicationType=COMMUNICATION_INTERFACE
            PduRSrcPdu_44b17292 (PduRSrcPdu):
              PduRSourcePduHandleId = 11
              PduRSrcPduDirection = RECEIVE
              PduRSrcPduRef = CDD_XCP_BJB_DTO_01_XIX_BMC_CAN01_382ede28_Rx
              PduRSrcPduPduRBswModulesRef = CanIf
            BMC_HV_f78d7c04_Tx (PduRDestPdu):
              PduRDestPduHandleId = 32
              PduRDestPduDirection = TRANSMIT
              PduRDestPduRoutingType = GATEWAY_ROUTING
              PduRDestPduDataProcessing = IMMEDIATE
              PduRPduLengthHandlingStrategy = IGNORE
              PduRDestPduCrossPartitionDestination = false
              PduRTransmissionConfirmation = false
              PduRDestPduDataProvision = PDUR_DIRECT
              PduRDestPduRef = CDD_XCP_BJB_DTO_01_XIX_HCP5_CANFD01_884a4965_Tx
              PduRDestPduPduRBswModulesRef = CanIf
          SOK_Zeit_Hybrid_01_Chal_01_XIX_HCP5_CANFD01_5939048b_Tx: PduRRoutingPathCommunicationType=COMMUNICATION_INTERFACE
            PduRSrcPdu_bda03fc7 (PduRSrcPdu):
              PduRSourcePduHandleId = 44
              PduRSrcPduDirection = TRANSMIT
              PduRSrcPduRef = SOK_Zeit_Hybrid_01_Chal_01_XIX_HCP5_CANFD01_5939048b_Tx
              PduRSrcPduPduRBswModulesRef = Com
            SOK_Zeit_Hybrid_01_Chal_01_XIX_HCP5_CANFD01_441f0aae_Tx (PduRDestPdu):
              PduRDestPduHandleId = 65
              PduRDestPduDirection = TRANSMIT
              PduRDestPduRoutingType = API_FORWARDING
              PduRDestPduDataProcessing = IMMEDIATE
              PduRPduLengthHandlingStrategy = IGNORE
              PduRDestPduCrossPartitionDestination = false
              PduRTransmissionConfirmation = true
              PduRDestPduDataProvision = PDUR_DIRECT
              PduRDestPduRef = SOK_Zeit_Hybrid_01_Chal_01_XIX_HCP5_CANFD01_441f0aae_Tx
              PduRDestPduPduRBswModulesRef = CanIf
          UI1_Komponentenfehler_02_XIX_BMC_CAN01_668bd879_Rx: PduRRoutingPathCommunicationType=COMMUNICATION_INTERFACE
            UI1_Komponentenfehler_02_XIX_BMC_CAN01_668bd879_Rx_8494a485_Rx (PduRDestPdu):
              PduRDestPduHandleId = 53
              PduRDestPduDirection = RECEIVE
              PduRDestPduRoutingType = API_FORWARDING
              PduRDestPduDataProcessing = IMMEDIATE
              PduRPduLengthHandlingStrategy = IGNORE
              PduRDestPduCrossPartitionDestination = false
              PduRTransmissionConfirmation = false
              PduRDestPduRef = UI1_Komponentenfehler_02_XIX_BMC_CAN01_19fb750e_Rx
              PduRDestPduPduRBswModulesRef = Com
            PduRSrcPdu_8494a485 (PduRSrcPdu):
              PduRSourcePduHandleId = 71
              PduRSrcPduDirection = RECEIVE
              PduRSrcPduRef = UI1_Komponentenfehler_02_XIX_BMC_CAN01_668bd879_Rx
              PduRSrcPduPduRBswModulesRef = CanIf
          Airbag_10_XIX_HCP5_CANFD01_6624abf2_Rx: PduRRoutingPathCommunicationType=COMMUNICATION_INTERFACE
            Airbag_10_XIX_HCP5_CANFD01_6624abf2_Rx_ec64b73a_Rx (PduRDestPdu):
              PduRDestPduHandleId = 0
              PduRDestPduDirection = RECEIVE
              PduRDestPduRoutingType = API_FORWARDING
              PduRDestPduDataProcessing = IMMEDIATE
              PduRPduLengthHandlingStrategy = IGNORE
              PduRDestPduCrossPartitionDestination = false
              PduRTransmissionConfirmation = false
              PduRDestPduRef = Airbag_10_XIX_HCP5_CANFD01_7f2c77c5_Rx
              PduRDestPduPduRBswModulesRef = Com
            PduRSrcPdu_ec64b73a (PduRSrcPdu): PduRSourcePduHandleId=0, PduRSrcPduDirection=RECEIVE, PduRSrcPduRef=Airbag_10_XIX_HCP5_CANFD01_6624abf2_Rx, PduRSrcPduPduRBswModulesRef=CanIf
          UI2_04_XIX_BMC_CAN01_af5334f2_Rx: PduRRoutingPathCommunicationType=COMMUNICATION_INTERFACE
            UI2_04_XIX_BMC_CAN01_af5334f2_Rx_77fe0f74_Rx (PduRDestPdu):
              PduRDestPduHandleId = 63
              PduRDestPduDirection = RECEIVE
              PduRDestPduRoutingType = API_FORWARDING
              PduRDestPduDataProcessing = IMMEDIATE
              PduRPduLengthHandlingStrategy = IGNORE
              PduRDestPduCrossPartitionDestination = false
              PduRTransmissionConfirmation = false
              PduRDestPduRef = UI2_04_XIX_BMC_CAN01_33f018a3_Rx
              PduRDestPduPduRBswModulesRef = Com
            PduRSrcPdu_77fe0f74 (PduRSrcPdu): PduRSourcePduHandleId=81, PduRSrcPduDirection=RECEIVE, PduRSrcPduRef=UI2_04_XIX_BMC_CAN01_af5334f2_Rx, PduRSrcPduPduRBswModulesRef=CanIf
          KS_Hybrid_01_Response_K_XIX_HCP5_CANFD01_76da782f_Tx: PduRRoutingPathCommunicationType=COMMUNICATION_INTERFACE
            KS_Hybrid_01_Response_K_XIX_HCP5_CANFD01_4e4d208b_Tx (PduRDestPdu):
              PduRDestPduHandleId = 46
              PduRDestPduDirection = TRANSMIT
              PduRDestPduRoutingType = API_FORWARDING
              PduRDestPduDataProcessing = IMMEDIATE
              PduRPduLengthHandlingStrategy = IGNORE
              PduRDestPduCrossPartitionDestination = false
              PduRTransmissionConfirmation = true
              PduRDestPduDataProvision = PDUR_DIRECT
              PduRDestPduRef = KS_Hybrid_01_Response_K_XIX_HCP5_CANFD01_4e4d208b_Tx
              PduRDestPduPduRBswModulesRef = CanIf
            PduRSrcPdu_77f84512 (PduRSrcPdu):
              PduRSourcePduHandleId = 39
              PduRSrcPduDirection = TRANSMIT
              PduRSrcPduRef = KS_Hybrid_01_Response_K_XIX_HCP5_CANFD01_76da782f_Tx
              PduRSrcPduPduRBswModulesRef = Com
          KS_Hybrid_01_Challenge_M_XIX_HCP5_CANFD01_a71be84d_Rx: PduRRoutingPathCommunicationType=COMMUNICATION_INTERFACE
            KS_Hybrid_01_Challenge_M_XIX_HCP5_CANFD01_a71be84d_Rx_60261c85_Rx (PduRDestPdu):
              PduRDestPduHandleId = 28
              PduRDestPduDirection = RECEIVE
              PduRDestPduRoutingType = API_FORWARDING
              PduRDestPduDataProcessing = IMMEDIATE
              PduRPduLengthHandlingStrategy = IGNORE
              PduRDestPduCrossPartitionDestination = false
              PduRTransmissionConfirmation = false
              PduRDestPduRef = KS_Hybrid_01_Challenge_M_XIX_HCP5_CANFD01_3e11d538_Rx
              PduRDestPduPduRBswModulesRef = Com
            PduRSrcPdu_60261c85 (PduRSrcPdu):
              PduRSourcePduHandleId = 53
              PduRSrcPduDirection = RECEIVE
              PduRSrcPduRef = KS_Hybrid_01_Challenge_M_XIX_HCP5_CANFD01_a71be84d_Rx
              PduRSrcPduPduRBswModulesRef = CanIf
          BMC_HV_c89b5192_Rx: PduRRoutingPathCommunicationType=COMMUNICATION_INTERFACE
            PduRSrcPdu_ae5d409e (PduRSrcPdu):
              PduRSourcePduHandleId = 28
              PduRSrcPduDirection = RECEIVE
              PduRSrcPduRef = DIA_UI2Sens02_Resp_XIX_BMC_CAN01_fe45df51_Rx
              PduRSrcPduPduRBswModulesRef = CanIf
            BMC_HV_9fc5934d_Tx (PduRDestPdu):
              PduRDestPduHandleId = 40
              PduRDestPduDirection = TRANSMIT
              PduRDestPduRoutingType = GATEWAY_ROUTING
              PduRDestPduDataProcessing = IMMEDIATE
              PduRPduLengthHandlingStrategy = IGNORE
              PduRDestPduCrossPartitionDestination = false
              PduRTransmissionConfirmation = false
              PduRDestPduDataProvision = PDUR_DIRECT
              PduRDestPduRef = DIA_UI2Sens02_Resp_XIX_HCP5_CANFD01_e002a62c_Tx
              PduRDestPduPduRBswModulesRef = CanIf
          UI2Sens02_CVN_XIX_BMC_CAN01_34f8df4e_Rx: PduRRoutingPathCommunicationType=COMMUNICATION_INTERFACE
            UI2Sens02_CVN_XIX_BMC_CAN01_34f8df4e_Rx_053df0d7_Rx (PduRDestPdu):
              PduRDestPduHandleId = 59
              PduRDestPduDirection = RECEIVE
              PduRDestPduRoutingType = API_FORWARDING
              PduRDestPduDataProcessing = IMMEDIATE
              PduRPduLengthHandlingStrategy = IGNORE
              PduRDestPduCrossPartitionDestination = false
              PduRTransmissionConfirmation = false
              PduRDestPduRef = UI2Sens02_CVN_XIX_BMC_CAN01_5d3dd455_Rx
              PduRDestPduPduRBswModulesRef = Com
            PduRSrcPdu_053df0d7 (PduRSrcPdu): PduRSourcePduHandleId=77, PduRSrcPduDirection=RECEIVE, PduRSrcPduRef=UI2Sens02_CVN_XIX_BMC_CAN01_34f8df4e_Rx, PduRSrcPduPduRBswModulesRef=CanIf
          OBD_Hybrid_01_XIX_HCP5_CANFD01_40f9dae5_Tx: PduRRoutingPathCommunicationType=COMMUNICATION_INTERFACE
            OBD_Hybrid_01_XIX_HCP5_CANFD01_40f9dae5_Tx (PduRDestPdu):
              PduRDestPduHandleId = 58
              PduRDestPduDirection = TRANSMIT
              PduRDestPduRoutingType = API_FORWARDING
              PduRDestPduDataProcessing = IMMEDIATE
              PduRPduLengthHandlingStrategy = IGNORE
              PduRDestPduCrossPartitionDestination = false
              PduRTransmissionConfirmation = true
              PduRDestPduDataProvision = PDUR_DIRECT
              PduRDestPduRef = OBD_Hybrid_01_XIX_HCP5_CANFD01_40f9dae5_Tx
              PduRDestPduPduRBswModulesRef = SecOC
            PduRSrcPdu_1d84387f (PduRSrcPdu): PduRSourcePduHandleId=43, PduRSrcPduDirection=TRANSMIT, PduRSrcPduRef=OBD_Hybrid_01_XIX_HCP5_CANFD01_40f9dae5_Tx, PduRSrcPduPduRBswModulesRef=Com
          BMC_HV_04_XIX_BMC_CAN01_E2E_a4a2e7f5_Tx: PduRRoutingPathCommunicationType=COMMUNICATION_INTERFACE
            PduRSrcPdu_ade43efa (PduRSrcPdu): PduRSourcePduHandleId=13, PduRSrcPduDirection=TRANSMIT, PduRSrcPduRef=BMC_HV_04_XIX_BMC_CAN01_E2E_a4a2e7f5_Tx, PduRSrcPduPduRBswModulesRef=Com
            BMC_HV_04_XIX_BMC_CAN01_E2E_24b17933_Tx (PduRDestPdu):
              PduRDestPduHandleId = 13
              PduRDestPduDirection = TRANSMIT
              PduRDestPduRoutingType = API_FORWARDING
              PduRDestPduDataProcessing = IMMEDIATE
              PduRPduLengthHandlingStrategy = IGNORE
              PduRDestPduCrossPartitionDestination = false
              PduRTransmissionConfirmation = true
              PduRDestPduDataProvision = PDUR_DIRECT
              PduRDestPduRef = BMC_HV_04_XIX_BMC_CAN01_E2E_24b17933_Tx
              PduRDestPduPduRBswModulesRef = CanIf
          BMC_HV_06_SOK_XIX_HCP5_CANFD01_e20cafa8_Tx: PduRRoutingPathCommunicationType=COMMUNICATION_INTERFACE
            PduRSrcPdu_30b6f94e (PduRSrcPdu):
              PduRSourcePduHandleId = 15
              PduRSrcPduDirection = TRANSMIT
              PduRSrcPduRef = BMC_HV_06_SOK_XIX_HCP5_CANFD01_e20cafa8_Tx
              PduRSrcPduPduRBswModulesRef = SecOC
            BMC_HV_06_SOK_XIX_HCP5_CANFD01_daff2390_Tx (PduRDestPdu):
              PduRDestPduHandleId = 15
              PduRDestPduDirection = TRANSMIT
              PduRDestPduRoutingType = API_FORWARDING
              PduRDestPduDataProcessing = IMMEDIATE
              PduRPduLengthHandlingStrategy = IGNORE
              PduRDestPduCrossPartitionDestination = false
              PduRTransmissionConfirmation = true
              PduRDestPduDataProvision = PDUR_DIRECT
              PduRDestPduRef = BMC_HV_06_SOK_XIX_HCP5_CANFD01_daff2390_Tx
              PduRDestPduPduRBswModulesRef = CanIf
          SOK_Zeit_Hybrid_01_Resp_01_SOK_XIX_HCP5_CANFD01_7ac24361_Rx: PduRRoutingPathCommunicationType=COMMUNICATION_INTERFACE
            SOK_Zeit_Hybrid_01_Resp_01_SOK_XIX_HCP5_CANFD01_7ac24361_Rx_e4ce0dcf_Rx (PduRDestPdu):
              PduRDestPduHandleId = 43
              PduRDestPduDirection = RECEIVE
              PduRDestPduRoutingType = API_FORWARDING
              PduRDestPduDataProcessing = IMMEDIATE
              PduRPduLengthHandlingStrategy = IGNORE
              PduRDestPduCrossPartitionDestination = false
              PduRTransmissionConfirmation = false
              PduRDestPduRef = SOK_Zeit_Hybrid_01_Resp_01_SOK_XIX_HCP5_CANFD01_92adacdc_Rx
              PduRDestPduPduRBswModulesRef = SecOC
            PduRSrcPdu_e4ce0dcf (PduRSrcPdu):
              PduRSourcePduHandleId = 62
              PduRSrcPduDirection = RECEIVE
              PduRSrcPduRef = SOK_Zeit_Hybrid_01_Resp_01_SOK_XIX_HCP5_CANFD01_7ac24361_Rx
              PduRSrcPduPduRBswModulesRef = CanIf
          BMC_CMC_Temperatur_03_XIX_HCP5_CANFD01_160139b6_Tx: PduRRoutingPathCommunicationType=COMMUNICATION_INTERFACE
            PduRSrcPdu_685d637f (PduRSrcPdu):
              PduRSourcePduHandleId = 2
              PduRSrcPduDirection = TRANSMIT
              PduRSrcPduRef = BMC_CMC_Temperatur_03_XIX_HCP5_CANFD01_160139b6_Tx
              PduRSrcPduPduRBswModulesRef = Com
            BMC_CMC_Temperatur_03_XIX_HCP5_CANFD01_8a36edf1_Tx (PduRDestPdu):
              PduRDestPduHandleId = 2
              PduRDestPduDirection = TRANSMIT
              PduRDestPduRoutingType = API_FORWARDING
              PduRDestPduDataProcessing = IMMEDIATE
              PduRPduLengthHandlingStrategy = IGNORE
              PduRDestPduCrossPartitionDestination = false
              PduRTransmissionConfirmation = true
              PduRDestPduDataProvision = PDUR_DIRECT
              PduRDestPduRef = BMC_CMC_Temperatur_03_XIX_HCP5_CANFD01_8a36edf1_Tx
              PduRDestPduPduRBswModulesRef = CanIf
          BMC_HV_9ba409ae_Rx: PduRRoutingPathCommunicationType=COMMUNICATION_INTERFACE
            PduRSrcPdu_206bd44b (PduRSrcPdu):
              PduRSourcePduHandleId = 17
              PduRSrcPduDirection = RECEIVE
              PduRSrcPduRef = OBDC_SSN_UI2Sens02_Req_XIX_HCP5_CANFD01_7e9f9397_Rx
              PduRSrcPduPduRBswModulesRef = CanIf
            BMC_HV_20083886_Tx (PduRDestPdu):
              PduRDestPduHandleId = 53
              PduRDestPduDirection = TRANSMIT
              PduRDestPduRoutingType = GATEWAY_ROUTING
              PduRDestPduDataProcessing = IMMEDIATE
              PduRPduLengthHandlingStrategy = IGNORE
              PduRDestPduCrossPartitionDestination = false
              PduRTransmissionConfirmation = false
              PduRDestPduDataProvision = PDUR_DIRECT
              PduRDestPduRef = OBDC_SSN_UI2Sens02_Req_XIX_BMC_CAN01_7f5a32ec_Tx
              PduRDestPduPduRBswModulesRef = CanIf
          BMC_HV_07_SOK_XIX_HCP5_CANFD01_f524cb68_Tx: PduRRoutingPathCommunicationType=COMMUNICATION_INTERFACE
            PduRSrcPdu_982247bd (PduRSrcPdu):
              PduRSourcePduHandleId = 17
              PduRSrcPduDirection = TRANSMIT
              PduRSrcPduRef = BMC_HV_07_SOK_XIX_HCP5_CANFD01_f524cb68_Tx
              PduRSrcPduPduRBswModulesRef = SecOC
            BMC_HV_07_SOK_XIX_HCP5_CANFD01_f0d71bf2_Tx (PduRDestPdu):
              PduRDestPduHandleId = 17
              PduRDestPduDirection = TRANSMIT
              PduRDestPduRoutingType = API_FORWARDING
              PduRDestPduDataProcessing = IMMEDIATE
              PduRPduLengthHandlingStrategy = IGNORE
              PduRDestPduCrossPartitionDestination = false
              PduRTransmissionConfirmation = true
              PduRDestPduDataProvision = PDUR_DIRECT
              PduRDestPduRef = BMC_HV_07_SOK_XIX_HCP5_CANFD01_f0d71bf2_Tx
              PduRDestPduPduRBswModulesRef = CanIf
          BMC_HV_05_XIX_HCP5_CANFD01_086b7dd9_Tx: PduRRoutingPathCommunicationType=COMMUNICATION_INTERFACE
            BMC_HV_05_XIX_HCP5_CANFD01_0d4b7040_Tx (PduRDestPdu):
              PduRDestPduHandleId = 14
              PduRDestPduDirection = TRANSMIT
              PduRDestPduRoutingType = API_FORWARDING
              PduRDestPduDataProcessing = IMMEDIATE
              PduRPduLengthHandlingStrategy = IGNORE
              PduRDestPduCrossPartitionDestination = false
              PduRTransmissionConfirmation = true
              PduRDestPduDataProvision = PDUR_DIRECT
              PduRDestPduRef = BMC_HV_05_XIX_HCP5_CANFD01_0d4b7040_Tx
              PduRDestPduPduRBswModulesRef = CanIf
            PduRSrcPdu_ba63e0cc (PduRSrcPdu): PduRSourcePduHandleId=14, PduRSrcPduDirection=TRANSMIT, PduRSrcPduRef=BMC_HV_05_XIX_HCP5_CANFD01_086b7dd9_Tx, PduRSrcPduPduRBswModulesRef=Com
          DCDC_NV_Komponentenfehler_03_XIX_HCP5_CANFD01_aee2148b_Rx: PduRRoutingPathCommunicationType=COMMUNICATION_INTERFACE
            DCDC_NV_Komponentenfehler_03_XIX_HCP5_CANFD01_aee2148b_Rx_9b9e540a_Rx (PduRDestPdu):
              PduRDestPduHandleId = 16
              PduRDestPduDirection = RECEIVE
              PduRDestPduRoutingType = API_FORWARDING
              PduRDestPduDataProcessing = IMMEDIATE
              PduRPduLengthHandlingStrategy = IGNORE
              PduRDestPduCrossPartitionDestination = false
              PduRTransmissionConfirmation = false
              PduRDestPduRef = DCDC_NV_Komponentenfehler_03_XIX_HCP5_CANFD01_d8bc1ce5_Rx
              PduRDestPduPduRBswModulesRef = Com
            PduRSrcPdu_9b9e540a (PduRSrcPdu):
              PduRSourcePduHandleId = 42
              PduRSrcPduDirection = RECEIVE
              PduRSrcPduRef = DCDC_NV_Komponentenfehler_03_XIX_HCP5_CANFD01_aee2148b_Rx
              PduRSrcPduPduRBswModulesRef = CanIf
          BJB_13_XIX_BMC_CAN01_E2E_49557476_Rx: PduRRoutingPathCommunicationType=COMMUNICATION_INTERFACE
            BJB_13_XIX_BMC_CAN01_E2E_49557476_Rx_739faa04_Rx (PduRDestPdu):
              PduRDestPduHandleId = 5
              PduRDestPduDirection = RECEIVE
              PduRDestPduRoutingType = API_FORWARDING
              PduRDestPduDataProcessing = IMMEDIATE
              PduRPduLengthHandlingStrategy = IGNORE
              PduRDestPduCrossPartitionDestination = false
              PduRTransmissionConfirmation = false
              PduRDestPduRef = BJB_13_XIX_BMC_CAN01_E2E_35d3901a_Rx
              PduRDestPduPduRBswModulesRef = Com
            PduRSrcPdu_739faa04 (PduRSrcPdu): PduRSourcePduHandleId=5, PduRSrcPduDirection=RECEIVE, PduRSrcPduRef=BJB_13_XIX_BMC_CAN01_E2E_49557476_Rx, PduRSrcPduPduRBswModulesRef=CanIf
          HVK_03_XIX_HCP5_CANFD01_E2E_8a76edcb_Rx: PduRRoutingPathCommunicationType=COMMUNICATION_INTERFACE
            HVK_03_XIX_HCP5_CANFD01_E2E_8a76edcb_Rx (PduRDestPdu):
              PduRDestPduHandleId = 25
              PduRDestPduDirection = RECEIVE
              PduRDestPduRoutingType = API_FORWARDING
              PduRDestPduDataProcessing = IMMEDIATE
              PduRPduLengthHandlingStrategy = IGNORE
              PduRDestPduCrossPartitionDestination = false
              PduRTransmissionConfirmation = false
              PduRDestPduRef = HVK_03_XIX_HCP5_CANFD01_E2E_8a76edcb_Rx
              PduRDestPduPduRBswModulesRef = Com
            PduRSrcPdu_352c0879 (PduRSrcPdu): PduRSourcePduHandleId=50, PduRSrcPduDirection=RECEIVE, PduRSrcPduRef=HVK_03_XIX_HCP5_CANFD01_E2E_8a76edcb_Rx, PduRSrcPduPduRBswModulesRef=SecOC
          BMC_HV_755ec3a0_Rx: PduRRoutingPathCommunicationType=COMMUNICATION_INTERFACE
            BMC_HV_9a7639f2_Tx (PduRDestPdu):
              PduRDestPduHandleId = 37
              PduRDestPduDirection = TRANSMIT
              PduRDestPduRoutingType = GATEWAY_ROUTING
              PduRDestPduDataProcessing = IMMEDIATE
              PduRPduLengthHandlingStrategy = IGNORE
              PduRDestPduCrossPartitionDestination = false
              PduRTransmissionConfirmation = false
              PduRDestPduDataProvision = PDUR_DIRECT
              PduRDestPduRef = DIA_UI2Sens01_Req_XIX_BMC_CAN01_47b20c58_Tx
              PduRDestPduPduRBswModulesRef = CanIf
            PduRSrcPdu_d092ae82 (PduRSrcPdu):
              PduRSourcePduHandleId = 20
              PduRSrcPduDirection = RECEIVE
              PduRSrcPduRef = DIA_UI2Sens01_Req_XIX_HCP5_CANFD01_d86619ec_Rx
              PduRSrcPduPduRBswModulesRef = CanIf
          BMC_HV_d77d382e_Rx: PduRRoutingPathCommunicationType=COMMUNICATION_INTERFACE
            BMC_HV_a7ee643b_Tx (PduRDestPdu):
              PduRDestPduHandleId = 31
              PduRDestPduDirection = TRANSMIT
              PduRDestPduRoutingType = GATEWAY_ROUTING
              PduRDestPduDataProcessing = IMMEDIATE
              PduRPduLengthHandlingStrategy = IGNORE
              PduRDestPduCrossPartitionDestination = false
              PduRTransmissionConfirmation = false
              PduRDestPduDataProvision = PDUR_DIRECT
              PduRDestPduRef = CDD_XCP_BJB_CRO_01_XIX_BMC_CAN01_9130eaf8_Tx
              PduRDestPduPduRBswModulesRef = CanIf
            PduRSrcPdu_1d15be7d (PduRSrcPdu):
              PduRSourcePduHandleId = 30
              PduRSrcPduDirection = RECEIVE
              PduRSrcPduRef = CDD_XCP_BJB_CRO_01_XIX_HCP5_CANFD01_a8ba0d4f_Rx
              PduRSrcPduPduRBswModulesRef = CanIf
          DCM_HCP5_CANFD01_XIX_TPCHType_CANHS_ISO_Diagnose_XIX_0x17FC007B_XIX_0x17FE007B_XIX_Physical_fb6bd0a7_Rx: PduRRoutingPathCommunicationType=TRANSPORT_PROTOCOL
            PduRSrcPdu_aace39c6 (PduRSrcPdu):
              PduRSourcePduHandleId = 6
              PduRSrcPduDirection = RECEIVE
              PduRSrcPduRef = DCM_HCP5_CANFD01_XIX_TPCHType_CANHS_ISO_Diagnose_XIX_0x17FC007B_XIX_0x17FE007B_XIX_Physical_fb6bd0a7_Rx
              PduRSrcPduPduRBswModulesRef = CanTp
            DCM_HCP5_CANFD01_XIX_TPCHType_CANHS_ISO_Diagnose_XIX_0x17FC007B_XIX_0x17FE007B_XIX_Physical_fb6bd0a7_Rx_aace39c6_Rx (PduRDestPdu):
              PduRDestPduHandleId = 6
              PduRDestPduDirection = RECEIVE
              PduRDestPduRoutingType = API_FORWARDING
              PduRDestPduDataProcessing = IMMEDIATE
              PduRPduLengthHandlingStrategy = UNUSED
              PduRDestPduCrossPartitionDestination = false
              PduRDestPduRef = DCM_HCP5_CANFD01_XIX_TPCHType_CANHS_ISO_Diagnose_XIX_0x17FC007B_XIX_0x17FE007B_XIX_Physical_f4a1250c_Rx
              PduRDestPduPduRBswModulesRef = Dcm
          KN_Hybrid_01_XIX_HCP5_CANFD01_fef84477_Tx: PduRRoutingPathCommunicationType=COMMUNICATION_INTERFACE
            PduRSrcPdu_6ffd86c6 (PduRSrcPdu): PduRSourcePduHandleId=36, PduRSrcPduDirection=TRANSMIT, PduRSrcPduRef=KN_Hybrid_01_XIX_HCP5_CANFD01_fef84477_Tx, PduRSrcPduPduRBswModulesRef=Com
            KN_Hybrid_01_XIX_HCP5_CANFD01_3c12b6a6_Tx (PduRDestPdu):
              PduRDestPduHandleId = 43
              PduRDestPduDirection = TRANSMIT
              PduRDestPduRoutingType = API_FORWARDING
              PduRDestPduDataProcessing = IMMEDIATE
              PduRPduLengthHandlingStrategy = IGNORE
              PduRDestPduCrossPartitionDestination = false
              PduRTransmissionConfirmation = true
              PduRDestPduDataProvision = PDUR_DIRECT
              PduRDestPduRef = KN_Hybrid_01_XIX_HCP5_CANFD01_3c12b6a6_Tx
              PduRDestPduPduRBswModulesRef = CanIf
          UI2Sens01_CVN_XIX_BMC_CAN01_7910df29_Rx: PduRRoutingPathCommunicationType=COMMUNICATION_INTERFACE
            UI2Sens01_CVN_XIX_BMC_CAN01_7910df29_Rx_987f4326_Rx (PduRDestPdu):
              PduRDestPduHandleId = 56
              PduRDestPduDirection = RECEIVE
              PduRDestPduRoutingType = API_FORWARDING
              PduRDestPduDataProcessing = IMMEDIATE
              PduRPduLengthHandlingStrategy = IGNORE
              PduRDestPduCrossPartitionDestination = false
              PduRTransmissionConfirmation = false
              PduRDestPduRef = UI2Sens01_CVN_XIX_BMC_CAN01_fe6b52fc_Rx
              PduRDestPduPduRBswModulesRef = Com
            PduRSrcPdu_987f4326 (PduRSrcPdu): PduRSourcePduHandleId=74, PduRSrcPduDirection=RECEIVE, PduRSrcPduRef=UI2Sens01_CVN_XIX_BMC_CAN01_7910df29_Rx, PduRSrcPduPduRBswModulesRef=CanIf
          BMC_HV_11_XIX_BMC_CAN01_E2E_ff4f5109_Tx: PduRRoutingPathCommunicationType=COMMUNICATION_INTERFACE
            BMC_HV_11_XIX_BMC_CAN01_E2E_bc007233_Tx (PduRDestPdu):
              PduRDestPduHandleId = 24
              PduRDestPduDirection = TRANSMIT
              PduRDestPduRoutingType = API_FORWARDING
              PduRDestPduDataProcessing = IMMEDIATE
              PduRPduLengthHandlingStrategy = IGNORE
              PduRDestPduCrossPartitionDestination = false
              PduRTransmissionConfirmation = true
              PduRDestPduDataProvision = PDUR_DIRECT
              PduRDestPduRef = BMC_HV_11_XIX_BMC_CAN01_E2E_bc007233_Tx
              PduRDestPduPduRBswModulesRef = CanIf
            PduRSrcPdu_1c3c454f (PduRSrcPdu): PduRSourcePduHandleId=24, PduRSrcPduDirection=TRANSMIT, PduRSrcPduRef=BMC_HV_11_XIX_BMC_CAN01_E2E_ff4f5109_Tx, PduRSrcPduPduRBswModulesRef=Com
          BMC_CMC_Temperatur_02_XIX_HCP5_CANFD01_f9538f57_Tx: PduRRoutingPathCommunicationType=COMMUNICATION_INTERFACE
            PduRSrcPdu_3151cb09 (PduRSrcPdu):
              PduRSourcePduHandleId = 1
              PduRSrcPduDirection = TRANSMIT
              PduRSrcPduRef = BMC_CMC_Temperatur_02_XIX_HCP5_CANFD01_f9538f57_Tx
              PduRSrcPduPduRBswModulesRef = Com
            BMC_CMC_Temperatur_02_XIX_HCP5_CANFD01_25727fb6_Tx (PduRDestPdu):
              PduRDestPduHandleId = 1
              PduRDestPduDirection = TRANSMIT
              PduRDestPduRoutingType = API_FORWARDING
              PduRDestPduDataProcessing = IMMEDIATE
              PduRPduLengthHandlingStrategy = IGNORE
              PduRDestPduCrossPartitionDestination = false
              PduRTransmissionConfirmation = true
              PduRDestPduDataProvision = PDUR_DIRECT
              PduRDestPduRef = BMC_CMC_Temperatur_02_XIX_HCP5_CANFD01_25727fb6_Tx
              PduRDestPduPduRBswModulesRef = CanIf
          BMC_HV_14_SOK_XIX_HCP5_CANFD01_572f8cfc_Tx: PduRRoutingPathCommunicationType=COMMUNICATION_INTERFACE
            BMC_HV_14_SOK_XIX_HCP5_CANFD01_2d397b18_Tx (PduRDestPdu):
              PduRDestPduHandleId = 27
              PduRDestPduDirection = TRANSMIT
              PduRDestPduRoutingType = API_FORWARDING
              PduRDestPduDataProcessing = IMMEDIATE
              PduRPduLengthHandlingStrategy = IGNORE
              PduRDestPduCrossPartitionDestination = false
              PduRTransmissionConfirmation = true
              PduRDestPduDataProvision = PDUR_DIRECT
              PduRDestPduRef = BMC_HV_14_SOK_XIX_HCP5_CANFD01_2d397b18_Tx
              PduRDestPduPduRBswModulesRef = CanIf
            PduRSrcPdu_0601150c (PduRSrcPdu):
              PduRSourcePduHandleId = 27
              PduRSrcPduDirection = TRANSMIT
              PduRSrcPduRef = BMC_HV_14_SOK_XIX_HCP5_CANFD01_572f8cfc_Tx
              PduRSrcPduPduRBswModulesRef = SecOC
          UI2_02_XIX_BMC_CAN01_E2E_49da1bd1_Rx: PduRRoutingPathCommunicationType=COMMUNICATION_INTERFACE
            UI2_02_XIX_BMC_CAN01_E2E_49da1bd1_Rx_ada48f41_Rx (PduRDestPdu):
              PduRDestPduHandleId = 61
              PduRDestPduDirection = RECEIVE
              PduRDestPduRoutingType = API_FORWARDING
              PduRDestPduDataProcessing = IMMEDIATE
              PduRPduLengthHandlingStrategy = IGNORE
              PduRDestPduCrossPartitionDestination = false
              PduRTransmissionConfirmation = false
              PduRDestPduRef = UI2_02_XIX_BMC_CAN01_E2E_54e6a136_Rx
              PduRDestPduPduRBswModulesRef = Com
            PduRSrcPdu_ada48f41 (PduRSrcPdu): PduRSourcePduHandleId=79, PduRSrcPduDirection=RECEIVE, PduRSrcPduRef=UI2_02_XIX_BMC_CAN01_E2E_49da1bd1_Rx, PduRSrcPduPduRBswModulesRef=CanIf
          BJB_08_XIX_BMC_CAN01_7b6df5c6_Rx: PduRRoutingPathCommunicationType=COMMUNICATION_INTERFACE
            BJB_08_XIX_BMC_CAN01_7b6df5c6_Rx_e991396e_Rx (PduRDestPdu):
              PduRDestPduHandleId = 1
              PduRDestPduDirection = RECEIVE
              PduRDestPduRoutingType = API_FORWARDING
              PduRDestPduDataProcessing = IMMEDIATE
              PduRPduLengthHandlingStrategy = IGNORE
              PduRDestPduCrossPartitionDestination = false
              PduRTransmissionConfirmation = false
              PduRDestPduRef = BJB_08_XIX_BMC_CAN01_1db9ae10_Rx
              PduRDestPduPduRBswModulesRef = Com
            PduRSrcPdu_e991396e (PduRSrcPdu): PduRSourcePduHandleId=1, PduRSrcPduDirection=RECEIVE, PduRSrcPduRef=BJB_08_XIX_BMC_CAN01_7b6df5c6_Rx, PduRSrcPduPduRBswModulesRef=CanIf
          BMC_HV_08_SOK_XIX_HCP5_CANFD01_29bed328_Tx: PduRRoutingPathCommunicationType=COMMUNICATION_INTERFACE
            PduRSrcPdu_56bec0d4 (PduRSrcPdu):
              PduRSourcePduHandleId = 19
              PduRSrcPduDirection = TRANSMIT
              PduRSrcPduRef = BMC_HV_08_SOK_XIX_HCP5_CANFD01_29bed328_Tx
              PduRSrcPduPduRBswModulesRef = SecOC
            BMC_HV_08_SOK_XIX_HCP5_CANFD01_ac3f778d_Tx (PduRDestPdu):
              PduRDestPduHandleId = 19
              PduRDestPduDirection = TRANSMIT
              PduRDestPduRoutingType = API_FORWARDING
              PduRDestPduDataProcessing = IMMEDIATE
              PduRPduLengthHandlingStrategy = IGNORE
              PduRDestPduCrossPartitionDestination = false
              PduRTransmissionConfirmation = true
              PduRDestPduDataProvision = PDUR_DIRECT
              PduRDestPduRef = BMC_HV_08_SOK_XIX_HCP5_CANFD01_ac3f778d_Tx
              PduRDestPduPduRBswModulesRef = CanIf
          KS_Hybrid_01_ReqFrame_XIX_HCP5_CANFD01_b04c52dd_Tx: PduRRoutingPathCommunicationType=COMMUNICATION_INTERFACE
            PduRSrcPdu_ff6c54d6 (PduRSrcPdu):
              PduRSourcePduHandleId = 38
              PduRSrcPduDirection = TRANSMIT
              PduRSrcPduRef = KS_Hybrid_01_ReqFrame_XIX_HCP5_CANFD01_b04c52dd_Tx
              PduRSrcPduPduRBswModulesRef = Com
            KS_Hybrid_01_ReqFrame_XIX_HCP5_CANFD01_d7f937e5_Tx (PduRDestPdu):
              PduRDestPduHandleId = 45
              PduRDestPduDirection = TRANSMIT
              PduRDestPduRoutingType = API_FORWARDING
              PduRDestPduDataProcessing = IMMEDIATE
              PduRPduLengthHandlingStrategy = IGNORE
              PduRDestPduCrossPartitionDestination = false
              PduRTransmissionConfirmation = true
              PduRDestPduDataProvision = PDUR_DIRECT
              PduRDestPduRef = KS_Hybrid_01_ReqFrame_XIX_HCP5_CANFD01_d7f937e5_Tx
              PduRDestPduPduRBswModulesRef = CanIf
          BMC_CMC_Zellspannung_01_XIX_HCP5_CANFD01_f76fbfe9_Tx: PduRRoutingPathCommunicationType=COMMUNICATION_INTERFACE
            BMC_CMC_Zellspannung_01_XIX_HCP5_CANFD01_e1187d1c_Tx (PduRDestPdu):
              PduRDestPduHandleId = 3
              PduRDestPduDirection = TRANSMIT
              PduRDestPduRoutingType = API_FORWARDING
              PduRDestPduDataProcessing = IMMEDIATE
              PduRPduLengthHandlingStrategy = IGNORE
              PduRDestPduCrossPartitionDestination = false
              PduRTransmissionConfirmation = true
              PduRDestPduDataProvision = PDUR_DIRECT
              PduRDestPduRef = BMC_CMC_Zellspannung_01_XIX_HCP5_CANFD01_e1187d1c_Tx
              PduRDestPduPduRBswModulesRef = CanIf
            PduRSrcPdu_07a5ffeb (PduRSrcPdu):
              PduRSourcePduHandleId = 3
              PduRSrcPduDirection = TRANSMIT
              PduRSrcPduRef = BMC_CMC_Zellspannung_01_XIX_HCP5_CANFD01_f76fbfe9_Tx
              PduRSrcPduPduRBswModulesRef = Com
          BMC_HV_6854b429_Rx: PduRRoutingPathCommunicationType=COMMUNICATION_INTERFACE
            BMC_HV_6854b429_Rx_c4a7c837_Rx (PduRDestPdu):
              PduRDestPduHandleId = 39
              PduRDestPduDirection = RECEIVE
              PduRDestPduRoutingType = API_FORWARDING
              PduRDestPduDataProcessing = IMMEDIATE
              PduRPduLengthHandlingStrategy = IGNORE
              PduRDestPduCrossPartitionDestination = false
              PduRTransmissionConfirmation = false
              PduRDestPduRef = OTAMC_D_01_XIX_HCP5_CANFD01_E2E_c199b3e6_Rx
              PduRDestPduPduRBswModulesRef = Com
            PduRSrcPdu_c4a7c837 (PduRSrcPdu):
              PduRSourcePduHandleId = 21
              PduRSrcPduDirection = RECEIVE
              PduRSrcPduRef = OTAMC_D_01_XIX_HCP5_CANFD01_E2E_8283a85d_Rx
              PduRSrcPduPduRBswModulesRef = CanIf
            BMC_HV_6006bc36_Tx (PduRDestPdu):
              PduRDestPduHandleId = 63
              PduRDestPduDirection = TRANSMIT
              PduRDestPduRoutingType = GATEWAY_ROUTING
              PduRDestPduDataProcessing = IMMEDIATE
              PduRPduLengthHandlingStrategy = IGNORE
              PduRDestPduCrossPartitionDestination = false
              PduRTransmissionConfirmation = false
              PduRDestPduDataProvision = PDUR_DIRECT
              PduRDestPduRef = OTAMC_D_01_XIX_BMC_CAN01_5e0c6077_Tx
              PduRDestPduPduRBswModulesRef = CanIf
          Zeitmaster_05_XIX_HCP5_CANFD01_1d48ef0a_Rx: PduRRoutingPathCommunicationType=COMMUNICATION_INTERFACE
            Zeitmaster_05_XIX_HCP5_CANFD01_1d48ef0a_Rx_07825d96_Rx (PduRDestPdu):
              PduRDestPduHandleId = 69
              PduRDestPduDirection = RECEIVE
              PduRDestPduRoutingType = API_FORWARDING
              PduRDestPduDataProcessing = IMMEDIATE
              PduRPduLengthHandlingStrategy = IGNORE
              PduRDestPduCrossPartitionDestination = false
              PduRTransmissionConfirmation = false
              PduRDestPduRef = Zeitmaster_05_XIX_HCP5_CANFD01_5eaa5a96_Rx
              PduRDestPduPduRBswModulesRef = Com
            PduRSrcPdu_07825d96 (PduRSrcPdu): PduRSourcePduHandleId=87, PduRSrcPduDirection=RECEIVE, PduRSrcPduRef=Zeitmaster_05_XIX_HCP5_CANFD01_1d48ef0a_Rx, PduRSrcPduPduRBswModulesRef=CanIf
          BMC_HV_14_XIX_HCP5_CANFD01_30db4b60_Tx: PduRRoutingPathCommunicationType=COMMUNICATION_INTERFACE
            BMC_HV_14_XIX_HCP5_CANFD01_30db4b60_Tx (PduRDestPdu):
              PduRDestPduHandleId = 28
              PduRDestPduDirection = TRANSMIT
              PduRDestPduRoutingType = API_FORWARDING
              PduRDestPduDataProcessing = IMMEDIATE
              PduRPduLengthHandlingStrategy = IGNORE
              PduRDestPduCrossPartitionDestination = false
              PduRTransmissionConfirmation = true
              PduRDestPduDataProvision = PDUR_DIRECT
              PduRDestPduRef = BMC_HV_14_XIX_HCP5_CANFD01_30db4b60_Tx
              PduRDestPduPduRBswModulesRef = SecOC
            PduRSrcPdu_861f8eb1 (PduRSrcPdu): PduRSourcePduHandleId=28, PduRSrcPduDirection=TRANSMIT, PduRSrcPduRef=BMC_HV_14_XIX_HCP5_CANFD01_30db4b60_Tx, PduRSrcPduPduRBswModulesRef=Com
          BMC_HV_09_SOK_XIX_HCP5_CANFD01_3e96b7e8_Tx: PduRRoutingPathCommunicationType=COMMUNICATION_INTERFACE
            BMC_HV_09_SOK_XIX_HCP5_CANFD01_86174fef_Tx (PduRDestPdu):
              PduRDestPduHandleId = 21
              PduRDestPduDirection = TRANSMIT
              PduRDestPduRoutingType = API_FORWARDING
              PduRDestPduDataProcessing = IMMEDIATE
              PduRPduLengthHandlingStrategy = IGNORE
              PduRDestPduCrossPartitionDestination = false
              PduRTransmissionConfirmation = true
              PduRDestPduDataProvision = PDUR_DIRECT
              PduRDestPduRef = BMC_HV_09_SOK_XIX_HCP5_CANFD01_86174fef_Tx
              PduRDestPduPduRBswModulesRef = CanIf
            PduRSrcPdu_4946679d (PduRSrcPdu):
              PduRSourcePduHandleId = 21
              PduRSrcPduDirection = TRANSMIT
              PduRSrcPduRef = BMC_HV_09_SOK_XIX_HCP5_CANFD01_3e96b7e8_Tx
              PduRSrcPduPduRBswModulesRef = SecOC
          BMC_HV_2f7dd3f7_Rx: PduRRoutingPathCommunicationType=COMMUNICATION_INTERFACE
            BMC_HV_6d61cb02_Tx (PduRDestPdu):
              PduRDestPduHandleId = 35
              PduRDestPduDirection = TRANSMIT
              PduRDestPduRoutingType = GATEWAY_ROUTING
              PduRDestPduDataProcessing = IMMEDIATE
              PduRPduLengthHandlingStrategy = IGNORE
              PduRDestPduCrossPartitionDestination = false
              PduRTransmissionConfirmation = false
              PduRDestPduDataProvision = PDUR_DIRECT
              PduRDestPduRef = DIA_BJB_Req_XIX_BMC_CAN01_6c84b0d8_Tx
              PduRDestPduPduRBswModulesRef = CanIf
            PduRSrcPdu_fbeacdb4 (PduRSrcPdu): PduRSourcePduHandleId=15, PduRSrcPduDirection=RECEIVE, PduRSrcPduRef=DIA_BJB_Req_XIX_HCP5_CANFD01_f2b9e65d_Rx, PduRSrcPduPduRBswModulesRef=CanIf
          KS_Hybrid_01_Challenge_K_XIX_HCP5_CANFD01_306d69bd_Tx: PduRRoutingPathCommunicationType=COMMUNICATION_INTERFACE
            KS_Hybrid_01_Challenge_K_XIX_HCP5_CANFD01_f262895d_Tx (PduRDestPdu):
              PduRDestPduHandleId = 44
              PduRDestPduDirection = TRANSMIT
              PduRDestPduRoutingType = API_FORWARDING
              PduRDestPduDataProcessing = IMMEDIATE
              PduRPduLengthHandlingStrategy = IGNORE
              PduRDestPduCrossPartitionDestination = false
              PduRTransmissionConfirmation = true
              PduRDestPduDataProvision = PDUR_DIRECT
              PduRDestPduRef = KS_Hybrid_01_Challenge_K_XIX_HCP5_CANFD01_f262895d_Tx
              PduRDestPduPduRBswModulesRef = CanIf
            PduRSrcPdu_b10cf005 (PduRSrcPdu):
              PduRSourcePduHandleId = 37
              PduRSrcPduDirection = TRANSMIT
              PduRSrcPduRef = KS_Hybrid_01_Challenge_K_XIX_HCP5_CANFD01_306d69bd_Tx
              PduRSrcPduPduRBswModulesRef = Com
          HCP1_17_XIX_HCP5_CANFD01_c544c746_Rx: PduRRoutingPathCommunicationType=COMMUNICATION_INTERFACE
            HCP1_17_XIX_HCP5_CANFD01_c544c746_Rx_d4862e32_Rx (PduRDestPdu):
              PduRDestPduHandleId = 22
              PduRDestPduDirection = RECEIVE
              PduRDestPduRoutingType = API_FORWARDING
              PduRDestPduDataProcessing = IMMEDIATE
              PduRPduLengthHandlingStrategy = IGNORE
              PduRDestPduCrossPartitionDestination = false
              PduRTransmissionConfirmation = false
              PduRDestPduRef = HCP1_17_XIX_HCP5_CANFD01_3398d6b5_Rx
              PduRDestPduPduRBswModulesRef = Com
            PduRSrcPdu_d4862e32 (PduRSrcPdu): PduRSourcePduHandleId=47, PduRSrcPduDirection=RECEIVE, PduRSrcPduRef=HCP1_17_XIX_HCP5_CANFD01_c544c746_Rx, PduRSrcPduPduRBswModulesRef=CanIf
          BJB_CVN_01_XIX_BMC_CAN01_4f7fa9e3_Rx: PduRRoutingPathCommunicationType=COMMUNICATION_INTERFACE
            PduRSrcPdu_f31ef42c (PduRSrcPdu): PduRSourcePduHandleId=8, PduRSrcPduDirection=RECEIVE, PduRSrcPduRef=BJB_CVN_01_XIX_BMC_CAN01_4f7fa9e3_Rx, PduRSrcPduPduRBswModulesRef=CanIf
            BJB_CVN_01_XIX_BMC_CAN01_4f7fa9e3_Rx_f31ef42c_Rx (PduRDestPdu):
              PduRDestPduHandleId = 8
              PduRDestPduDirection = RECEIVE
              PduRDestPduRoutingType = API_FORWARDING
              PduRDestPduDataProcessing = IMMEDIATE
              PduRPduLengthHandlingStrategy = IGNORE
              PduRDestPduCrossPartitionDestination = false
              PduRTransmissionConfirmation = false
              PduRDestPduRef = BJB_CVN_01_XIX_BMC_CAN01_301c1ddb_Rx
              PduRDestPduPduRBswModulesRef = Com
          BMC_HV_fac9f523_Rx: PduRRoutingPathCommunicationType=COMMUNICATION_INTERFACE
            BMC_HV_d532ac0a_Tx (PduRDestPdu):
              PduRDestPduHandleId = 42
              PduRDestPduDirection = TRANSMIT
              PduRDestPduRoutingType = GATEWAY_ROUTING
              PduRDestPduDataProcessing = IMMEDIATE
              PduRPduLengthHandlingStrategy = IGNORE
              PduRDestPduCrossPartitionDestination = false
              PduRTransmissionConfirmation = false
              PduRDestPduDataProvision = PDUR_DIRECT
              PduRDestPduRef = ISO_Funktionaler_Req_All_XIX_BMC_CAN01_aaf5996b_Tx
              PduRDestPduPduRBswModulesRef = CanIf
            PduRSrcPdu_33fb826e (PduRSrcPdu):
              PduRSourcePduHandleId = 34
              PduRSrcPduDirection = RECEIVE
              PduRSrcPduRef = ISO_Funktionaler_Req_All_XIX_HCP5_CANFD01_e497e7f8_Rx
              PduRSrcPduPduRBswModulesRef = CanIf
          BMC_HV_b645f520_Rx: PduRRoutingPathCommunicationType=COMMUNICATION_INTERFACE
            BMC_HV_01c76f4c_Tx (PduRDestPdu):
              PduRDestPduHandleId = 29
              PduRDestPduDirection = TRANSMIT
              PduRDestPduRoutingType = GATEWAY_ROUTING
              PduRDestPduDataProcessing = IMMEDIATE
              PduRPduLengthHandlingStrategy = IGNORE
              PduRDestPduCrossPartitionDestination = false
              PduRTransmissionConfirmation = false
              PduRDestPduDataProvision = PDUR_DIRECT
              PduRDestPduRef = CDD_DEV_BJB_Req_01_XIX_BMC_CAN01_3719e18f_Tx
              PduRDestPduPduRBswModulesRef = CanIf
            PduRSrcPdu_8bc3fac3 (PduRSrcPdu):
              PduRSourcePduHandleId = 26
              PduRSrcPduDirection = RECEIVE
              PduRSrcPduRef = CDD_DEV_BJB_Req_01_XIX_HCP5_CANFD01_c982c041_Rx
              PduRSrcPduPduRBswModulesRef = CanIf
          OBD_Hybrid_01_SOK_XIX_HCP5_CANFD01_86ce2f2e_Tx: PduRRoutingPathCommunicationType=COMMUNICATION_INTERFACE
            PduRSrcPdu_519fcae0 (PduRSrcPdu):
              PduRSourcePduHandleId = 42
              PduRSrcPduDirection = TRANSMIT
              PduRSrcPduRef = OBD_Hybrid_01_SOK_XIX_HCP5_CANFD01_86ce2f2e_Tx
              PduRSrcPduPduRBswModulesRef = SecOC
            OBD_Hybrid_01_SOK_XIX_HCP5_CANFD01_c373a414_Tx (PduRDestPdu):
              PduRDestPduHandleId = 57
              PduRDestPduDirection = TRANSMIT
              PduRDestPduRoutingType = API_FORWARDING
              PduRDestPduDataProcessing = IMMEDIATE
              PduRPduLengthHandlingStrategy = IGNORE
              PduRDestPduCrossPartitionDestination = false
              PduRTransmissionConfirmation = true
              PduRDestPduDataProvision = PDUR_DIRECT
              PduRDestPduRef = OBD_Hybrid_01_SOK_XIX_HCP5_CANFD01_c373a414_Tx
              PduRDestPduPduRBswModulesRef = CanIf
          Thermomanagement_01_XIX_HCP5_CANFD01_bb71c5fe_Rx: PduRRoutingPathCommunicationType=COMMUNICATION_INTERFACE
            PduRSrcPdu_0b89624e (PduRSrcPdu):
              PduRSourcePduHandleId = 64
              PduRSrcPduDirection = RECEIVE
              PduRSrcPduRef = Thermomanagement_01_XIX_HCP5_CANFD01_bb71c5fe_Rx
              PduRSrcPduPduRBswModulesRef = CanIf
            Thermomanagement_01_XIX_HCP5_CANFD01_bb71c5fe_Rx_0b89624e_Rx (PduRDestPdu):
              PduRDestPduHandleId = 46
              PduRDestPduDirection = RECEIVE
              PduRDestPduRoutingType = API_FORWARDING
              PduRDestPduDataProcessing = IMMEDIATE
              PduRPduLengthHandlingStrategy = IGNORE
              PduRDestPduCrossPartitionDestination = false
              PduRTransmissionConfirmation = false
              PduRDestPduRef = Thermomanagement_01_XIX_HCP5_CANFD01_60e8cf38_Rx
              PduRDestPduPduRBswModulesRef = Com
          BMC_CMC_Zellspannung_03_XIX_HCP5_CANFD01_f2bbd46a_Tx: PduRRoutingPathCommunicationType=COMMUNICATION_INTERFACE
            PduRSrcPdu_6125e2af (PduRSrcPdu):
              PduRSourcePduHandleId = 5
              PduRSrcPduDirection = TRANSMIT
              PduRSrcPduRef = BMC_CMC_Zellspannung_03_XIX_HCP5_CANFD01_f2bbd46a_Tx
              PduRSrcPduPduRBswModulesRef = Com
            BMC_CMC_Zellspannung_03_XIX_HCP5_CANFD01_64e05fd3_Tx (PduRDestPdu):
              PduRDestPduHandleId = 5
              PduRDestPduDirection = TRANSMIT
              PduRDestPduRoutingType = API_FORWARDING
              PduRDestPduDataProcessing = IMMEDIATE
              PduRPduLengthHandlingStrategy = IGNORE
              PduRDestPduCrossPartitionDestination = false
              PduRTransmissionConfirmation = true
              PduRDestPduDataProvision = PDUR_DIRECT
              PduRDestPduRef = BMC_CMC_Zellspannung_03_XIX_HCP5_CANFD01_64e05fd3_Tx
              PduRDestPduPduRBswModulesRef = CanIf
          BMC_CMC_Zellspannung_05_XIX_HCP5_CANFD01_fcc768ef_Tx: PduRRoutingPathCommunicationType=COMMUNICATION_INTERFACE
            PduRSrcPdu_95e0194f (PduRSrcPdu):
              PduRSourcePduHandleId = 7
              PduRSrcPduDirection = TRANSMIT
              PduRSrcPduRef = BMC_CMC_Zellspannung_05_XIX_HCP5_CANFD01_fcc768ef_Tx
              PduRSrcPduPduRBswModulesRef = Com
            BMC_CMC_Zellspannung_05_XIX_HCP5_CANFD01_31993ec3_Tx (PduRDestPdu):
              PduRDestPduHandleId = 7
              PduRDestPduDirection = TRANSMIT
              PduRDestPduRoutingType = API_FORWARDING
              PduRDestPduDataProcessing = IMMEDIATE
              PduRPduLengthHandlingStrategy = IGNORE
              PduRDestPduCrossPartitionDestination = false
              PduRTransmissionConfirmation = true
              PduRDestPduDataProvision = PDUR_DIRECT
              PduRDestPduRef = BMC_CMC_Zellspannung_05_XIX_HCP5_CANFD01_31993ec3_Tx
              PduRDestPduPduRBswModulesRef = CanIf
          DCDC_04_XIX_HCP5_CANFD01_622db5e5_Rx: PduRRoutingPathCommunicationType=COMMUNICATION_INTERFACE
            PduRSrcPdu_5df8757b (PduRSrcPdu): PduRSourcePduHandleId=37, PduRSrcPduDirection=RECEIVE, PduRSrcPduRef=DCDC_04_XIX_HCP5_CANFD01_622db5e5_Rx, PduRSrcPduPduRBswModulesRef=CanIf
            DCDC_04_XIX_HCP5_CANFD01_622db5e5_Rx_5df8757b_Rx (PduRDestPdu):
              PduRDestPduHandleId = 11
              PduRDestPduDirection = RECEIVE
              PduRDestPduRoutingType = API_FORWARDING
              PduRDestPduDataProcessing = IMMEDIATE
              PduRPduLengthHandlingStrategy = IGNORE
              PduRDestPduCrossPartitionDestination = false
              PduRTransmissionConfirmation = false
              PduRDestPduRef = DCDC_04_XIX_HCP5_CANFD01_8ca88b97_Rx
              PduRDestPduPduRBswModulesRef = Com
          BMC_HV_e5dc4108_Rx: PduRRoutingPathCommunicationType=COMMUNICATION_INTERFACE
            PduRSrcPdu_387b2e73 (PduRSrcPdu):
              PduRSourcePduHandleId = 31
              PduRSrcPduDirection = RECEIVE
              PduRSrcPduRef = OBDC_SSN_UI2Sens01_Req_XIX_HCP5_CANFD01_00e7db31_Rx
              PduRSrcPduPduRBswModulesRef = CanIf
            BMC_HV_6de038e1_Tx (PduRDestPdu):
              PduRDestPduHandleId = 51
              PduRDestPduDirection = TRANSMIT
              PduRDestPduRoutingType = GATEWAY_ROUTING
              PduRDestPduDataProcessing = IMMEDIATE
              PduRPduLengthHandlingStrategy = IGNORE
              PduRDestPduCrossPartitionDestination = false
              PduRTransmissionConfirmation = false
              PduRDestPduDataProvision = PDUR_DIRECT
              PduRDestPduRef = OBDC_SSN_UI2Sens01_Req_XIX_BMC_CAN01_32b2328b_Tx
              PduRDestPduPduRBswModulesRef = CanIf
          UI1_Komponentenfehler_01_XIX_BMC_CAN01_0b0d2b23_Rx: PduRRoutingPathCommunicationType=COMMUNICATION_INTERFACE
            PduRSrcPdu_58b056a0 (PduRSrcPdu):
              PduRSourcePduHandleId = 70
              PduRSrcPduDirection = RECEIVE
              PduRSrcPduRef = UI1_Komponentenfehler_01_XIX_BMC_CAN01_0b0d2b23_Rx
              PduRSrcPduPduRBswModulesRef = CanIf
            UI1_Komponentenfehler_01_XIX_BMC_CAN01_0b0d2b23_Rx_58b056a0_Rx (PduRDestPdu):
              PduRDestPduHandleId = 52
              PduRDestPduDirection = RECEIVE
              PduRDestPduRoutingType = API_FORWARDING
              PduRDestPduDataProcessing = IMMEDIATE
              PduRPduLengthHandlingStrategy = IGNORE
              PduRDestPduCrossPartitionDestination = false
              PduRTransmissionConfirmation = false
              PduRDestPduRef = UI1_Komponentenfehler_01_XIX_BMC_CAN01_08861f77_Rx
              PduRDestPduPduRBswModulesRef = Com
          BMC_HV_13_XIX_BMC_CAN01_E2E_8bfb57f8_Tx: PduRRoutingPathCommunicationType=COMMUNICATION_INTERFACE
            BMC_HV_13_XIX_BMC_CAN01_E2E_7c608fb6_Tx (PduRDestPdu):
              PduRDestPduHandleId = 26
              PduRDestPduDirection = TRANSMIT
              PduRDestPduRoutingType = API_FORWARDING
              PduRDestPduDataProcessing = IMMEDIATE
              PduRPduLengthHandlingStrategy = IGNORE
              PduRDestPduCrossPartitionDestination = false
              PduRTransmissionConfirmation = true
              PduRDestPduDataProvision = PDUR_DIRECT
              PduRDestPduRef = BMC_HV_13_XIX_BMC_CAN01_E2E_7c608fb6_Tx
              PduRDestPduPduRBswModulesRef = CanIf
            PduRSrcPdu_23881bac (PduRSrcPdu): PduRSourcePduHandleId=26, PduRSrcPduDirection=TRANSMIT, PduRSrcPduRef=BMC_HV_13_XIX_BMC_CAN01_E2E_8bfb57f8_Tx, PduRSrcPduPduRBswModulesRef=Com
          BJB_CALID_02_XIX_BMC_CAN01_e45a93f7_Rx: PduRRoutingPathCommunicationType=COMMUNICATION_INTERFACE
            BJB_CALID_02_XIX_BMC_CAN01_e45a93f7_Rx_88b46475_Rx (PduRDestPdu):
              PduRDestPduHandleId = 7
              PduRDestPduDirection = RECEIVE
              PduRDestPduRoutingType = API_FORWARDING
              PduRDestPduDataProcessing = IMMEDIATE
              PduRPduLengthHandlingStrategy = IGNORE
              PduRDestPduCrossPartitionDestination = false
              PduRTransmissionConfirmation = false
              PduRDestPduRef = BJB_CALID_02_XIX_BMC_CAN01_bc93171f_Rx
              PduRDestPduPduRBswModulesRef = Com
            PduRSrcPdu_88b46475 (PduRSrcPdu): PduRSourcePduHandleId=7, PduRSrcPduDirection=RECEIVE, PduRSrcPduRef=BJB_CALID_02_XIX_BMC_CAN01_e45a93f7_Rx, PduRSrcPduPduRBswModulesRef=CanIf
          BMC_HV_0d72e9ae_Rx: PduRRoutingPathCommunicationType=COMMUNICATION_INTERFACE
            BMC_HV_29370756_Tx (PduRDestPdu):
              PduRDestPduHandleId = 33
              PduRDestPduDirection = TRANSMIT
              PduRDestPduRoutingType = GATEWAY_ROUTING
              PduRDestPduDataProcessing = IMMEDIATE
              PduRPduLengthHandlingStrategy = IGNORE
              PduRDestPduCrossPartitionDestination = false
              PduRTransmissionConfirmation = false
              PduRDestPduDataProvision = PDUR_DIRECT
              PduRDestPduRef = ClampControl_01_XIX_BMC_CAN01_6c74ee25_Tx
              PduRDestPduPduRBswModulesRef = CanIf
            BMC_HV_0d72e9ae_Rx_e0f26de2_Rx (PduRDestPdu):
              PduRDestPduHandleId = 10
              PduRDestPduDirection = RECEIVE
              PduRDestPduRoutingType = API_FORWARDING
              PduRDestPduDataProcessing = IMMEDIATE
              PduRPduLengthHandlingStrategy = IGNORE
              PduRDestPduCrossPartitionDestination = false
              PduRTransmissionConfirmation = false
              PduRDestPduRef = ClampControl_01_XIX_HCP5_CANFD01_8c24343b_Rx
              PduRDestPduPduRBswModulesRef = Com
            PduRSrcPdu_e0f26de2 (PduRSrcPdu):
              PduRSourcePduHandleId = 10
              PduRSrcPduDirection = RECEIVE
              PduRSrcPduRef = ClampControl_01_XIX_HCP5_CANFD01_5af08b97_Rx
              PduRSrcPduPduRBswModulesRef = CanIf
          BMC_HV_3cdd220c_Rx: PduRRoutingPathCommunicationType=TRANSPORT_PROTOCOL
            PduRSrcPdu_eff70935 (PduRSrcPdu):
              PduRSourcePduHandleId = 1
              PduRSrcPduDirection = RECEIVE
              PduRSrcPduRef = DCM_HCP5_CANFD01_XIX_TPCHType_CANFD_ISO_Diagnose_XIX_0x1C410000_XIX_Functional_905f44f1_Rx
              PduRSrcPduPduRBswModulesRef = CanTp
            BMC_HV_3cdd220c_Rx_eff70935_Rx (PduRDestPdu):
              PduRDestPduHandleId = 3
              PduRDestPduDirection = RECEIVE
              PduRDestPduRoutingType = API_FORWARDING
              PduRDestPduDataProcessing = IMMEDIATE
              PduRPduLengthHandlingStrategy = UNUSED
              PduRDestPduCrossPartitionDestination = false
              PduRDestPduRef = DCM_HCP5_CANFD01_XIX_TPCHType_CANFD_ISO_Diagnose_XIX_0x1C410000_XIX_Functional_012ca6ee_Rx
              PduRDestPduPduRBswModulesRef = Dcm
          WFS_02_XIX_HCP5_CANFD01_a0e8c21d_Rx: PduRRoutingPathCommunicationType=COMMUNICATION_INTERFACE
            WFS_02_XIX_HCP5_CANFD01_a0e8c21d_Rx_6db56476_Rx (PduRDestPdu):
              PduRDestPduHandleId = 67
              PduRDestPduDirection = RECEIVE
              PduRDestPduRoutingType = API_FORWARDING
              PduRDestPduDataProcessing = IMMEDIATE
              PduRPduLengthHandlingStrategy = IGNORE
              PduRDestPduCrossPartitionDestination = false
              PduRTransmissionConfirmation = false
              PduRDestPduRef = WFS_02_XIX_HCP5_CANFD01_61136cb6_Rx
              PduRDestPduPduRBswModulesRef = Com
            PduRSrcPdu_6db56476 (PduRSrcPdu): PduRSourcePduHandleId=85, PduRSrcPduDirection=RECEIVE, PduRSrcPduRef=WFS_02_XIX_HCP5_CANFD01_a0e8c21d_Rx, PduRSrcPduPduRBswModulesRef=CanIf
          BMC_HV_4cd2864d_Rx: PduRRoutingPathCommunicationType=COMMUNICATION_INTERFACE
            BMC_HV_47583a15_Tx (PduRDestPdu):
              PduRDestPduHandleId = 54
              PduRDestPduDirection = TRANSMIT
              PduRDestPduRoutingType = GATEWAY_ROUTING
              PduRDestPduDataProcessing = IMMEDIATE
              PduRPduLengthHandlingStrategy = IGNORE
              PduRDestPduCrossPartitionDestination = false
              PduRTransmissionConfirmation = false
              PduRDestPduDataProvision = PDUR_DIRECT
              PduRDestPduRef = OBDC_SSN_UI2Sens02_Resp_XIX_HCP5_CANFD01_18b88987_Tx
              PduRDestPduPduRBswModulesRef = CanIf
            PduRSrcPdu_023365d6 (PduRSrcPdu):
              PduRSourcePduHandleId = 16
              PduRSrcPduDirection = RECEIVE
              PduRSrcPduRef = OBDC_SSN_UI2Sens02_Resp_XIX_BMC_CAN01_e1ea5c01_Rx
              PduRSrcPduPduRBswModulesRef = CanIf
          Charisma_20_XIX_HCP5_CANFD01_be5e5e8a_Rx: PduRRoutingPathCommunicationType=COMMUNICATION_INTERFACE
            PduRSrcPdu_6ffd659a (PduRSrcPdu): PduRSourcePduHandleId=35, PduRSrcPduDirection=RECEIVE, PduRSrcPduRef=Charisma_20_XIX_HCP5_CANFD01_be5e5e8a_Rx, PduRSrcPduPduRBswModulesRef=CanIf
            Charisma_20_XIX_HCP5_CANFD01_be5e5e8a_Rx_6ffd659a_Rx (PduRDestPdu):
              PduRDestPduHandleId = 9
              PduRDestPduDirection = RECEIVE
              PduRDestPduRoutingType = API_FORWARDING
              PduRDestPduDataProcessing = IMMEDIATE
              PduRPduLengthHandlingStrategy = IGNORE
              PduRDestPduCrossPartitionDestination = false
              PduRTransmissionConfirmation = false
              PduRDestPduRef = Charisma_20_XIX_HCP5_CANFD01_f51eced8_Rx
              PduRDestPduPduRBswModulesRef = Com
          BMC_HV_e7d003fd_Rx: PduRRoutingPathCommunicationType=COMMUNICATION_INTERFACE
            BMC_HV_e7d003fd_Rx_68280502_Rx (PduRDestPdu):
              PduRDestPduHandleId = 36
              PduRDestPduDirection = RECEIVE
              PduRDestPduRoutingType = API_FORWARDING
              PduRDestPduDataProcessing = IMMEDIATE
              PduRPduLengthHandlingStrategy = IGNORE
              PduRDestPduCrossPartitionDestination = false
              PduRTransmissionConfirmation = false
              PduRDestPduRef = ORU_01_XIX_HCP5_CANFD01_8935a839_Rx
              PduRDestPduPduRBswModulesRef = Com
            BMC_HV_01b8fa87_Tx (PduRDestPdu):
              PduRDestPduHandleId = 60
              PduRDestPduDirection = TRANSMIT
              PduRDestPduRoutingType = GATEWAY_ROUTING
              PduRDestPduDataProcessing = IMMEDIATE
              PduRPduLengthHandlingStrategy = IGNORE
              PduRDestPduCrossPartitionDestination = false
              PduRTransmissionConfirmation = false
              PduRDestPduDataProvision = PDUR_DIRECT
              PduRDestPduRef = ORU_01_XIX_BMC_CAN01_4256635f_Tx
              PduRDestPduPduRBswModulesRef = CanIf
            PduRSrcPdu_68280502 (PduRSrcPdu): PduRSourcePduHandleId=32, PduRSrcPduDirection=RECEIVE, PduRSrcPduRef=ORU_01_XIX_HCP5_CANFD01_81d7dd4c_Rx, PduRSrcPduPduRBswModulesRef=CanIf
          CDD_HCP5_CANFD01_XIX_TPCHType_CANFD_DAAP_XIX_0x1C403F7B_XIX_0x1C423F7B_XIX_Physical_1330e22e_Rx: PduRRoutingPathCommunicationType=TRANSPORT_PROTOCOL
            CDD_HCP5_CANFD01_XIX_TPCHType_CANFD_DAAP_XIX_0x1C403F7B_XIX_0x1C423F7B_XIX_Physical_1330e22e_Rx_2c0fff33_Rx (PduRDestPdu):
              PduRDestPduHandleId = 0
              PduRDestPduDirection = RECEIVE
              PduRDestPduRoutingType = API_FORWARDING
              PduRDestPduDataProcessing = IMMEDIATE
              PduRPduLengthHandlingStrategy = UNUSED
              PduRDestPduCrossPartitionDestination = false
              PduRDestPduRef = CDD_HCP5_CANFD01_XIX_TPCHType_CANFD_DAAP_XIX_0x1C403F7B_XIX_0x1C423F7B_XIX_Physical_3bee6131_Rx
              PduRDestPduPduRBswModulesRef = Dcm
            PduRSrcPdu_2c0fff33 (PduRSrcPdu):
              PduRSourcePduHandleId = 2
              PduRSrcPduDirection = RECEIVE
              PduRSrcPduRef = CDD_HCP5_CANFD01_XIX_TPCHType_CANFD_DAAP_XIX_0x1C403F7B_XIX_0x1C423F7B_XIX_Physical_1330e22e_Rx
              PduRSrcPduPduRBswModulesRef = CanTp
          DCM_HCP5_CANFD01_XIX_TPCHType_CANHS_ISO_Diagnose_XIX_0x17FE007B_XIX_0x17FC007B_XIX_Physical_4cf2fba3_Tx: PduRRoutingPathCommunicationType=TRANSPORT_PROTOCOL
            PduRSrcPdu_bb9fbbb3 (PduRSrcPdu):
              PduRSourcePduHandleId = 32
              PduRSrcPduDirection = TRANSMIT
              PduRSrcPduRef = DCM_HCP5_CANFD01_XIX_TPCHType_CANHS_ISO_Diagnose_XIX_0x17FE007B_XIX_0x17FC007B_XIX_Physical_4cf2fba3_Tx
              PduRSrcPduPduRBswModulesRef = Dcm
            DCM_HCP5_CANFD01_XIX_TPCHType_CANHS_ISO_Diagnose_XIX_0x17FE007B_XIX_0x17FC007B_XIX_Physical_621b1bd7_Tx (PduRDestPdu):
              PduRDestPduHandleId = 4
              PduRDestPduDirection = TRANSMIT
              PduRDestPduRoutingType = API_FORWARDING
              PduRDestPduDataProcessing = IMMEDIATE
              PduRPduLengthHandlingStrategy = UNUSED
              PduRDestPduCrossPartitionDestination = false
              PduRDestPduRef = DCM_HCP5_CANFD01_XIX_TPCHType_CANHS_ISO_Diagnose_XIX_0x17FE007B_XIX_0x17FC007B_XIX_Physical_621b1bd7_Tx
              PduRDestPduPduRBswModulesRef = CanTp
          UI2Sens02_CALID_01_XIX_BMC_CAN01_a812cab1_Rx: PduRRoutingPathCommunicationType=COMMUNICATION_INTERFACE
            PduRSrcPdu_0e1135ae (PduRSrcPdu):
              PduRSourcePduHandleId = 75
              PduRSrcPduDirection = RECEIVE
              PduRSrcPduRef = UI2Sens02_CALID_01_XIX_BMC_CAN01_a812cab1_Rx
              PduRSrcPduPduRBswModulesRef = CanIf
            UI2Sens02_CALID_01_XIX_BMC_CAN01_a812cab1_Rx_0e1135ae_Rx (PduRDestPdu):
              PduRDestPduHandleId = 57
              PduRDestPduDirection = RECEIVE
              PduRDestPduRoutingType = API_FORWARDING
              PduRDestPduDataProcessing = IMMEDIATE
              PduRPduLengthHandlingStrategy = IGNORE
              PduRDestPduCrossPartitionDestination = false
              PduRTransmissionConfirmation = false
              PduRDestPduRef = UI2Sens02_CALID_01_XIX_BMC_CAN01_abd78ba8_Rx
              PduRDestPduPduRBswModulesRef = Com
          PduRRoutingPath_mBAP_Klima_01_0x638_Rx: PduRRoutingPathCommunicationType=COMMUNICATION_INTERFACE
            PDUID_mBAP_Klima_01_0x638_Rx (PduRDestPdu):
              PduRDestPduHandleId = 150
              PduRDestPduDirection = RECEIVE
              PduRDestPduRoutingType = API_FORWARDING
              PduRDestPduDataProcessing = IMMEDIATE
              PduRPduLengthHandlingStrategy = IGNORE
              PduRDestPduCrossPartitionDestination = false
              PduRTransmissionConfirmation = false
              PduRDestPduRef = PDUID_mBAP_Klima_01_0x638_Rx
              PduRDestPduPduRBswModulesRef = BAP
            PduRSrcPdu_PDUID_mBAP_Klima_01_0x638_Rx (PduRSrcPdu): PduRSourcePduHandleId=60, PduRSrcPduDirection=RECEIVE, PduRSrcPduRef=Pdu_BAP_CanIf2PduR_Rx, PduRSrcPduPduRBswModulesRef=CanIf
          PduRRoutingPath_PDUID_mBAP_ASG_01_0x601_Tx: PduRRoutingPathCommunicationType=COMMUNICATION_INTERFACE
            PduRDestPdu_PDUID_mBAP_ASG_01_0x601_Tx (PduRDestPdu):
              PduRDestPduHandleId = 64
              PduRDestPduDirection = TRANSMIT
              PduRDestPduRoutingType = API_FORWARDING
              PduRDestPduDataProcessing = IMMEDIATE
              PduRPduLengthHandlingStrategy = IGNORE
              PduRDestPduCrossPartitionDestination = false
              PduRTransmissionConfirmation = true
              PduRDestPduDataProvision = PDUR_DIRECT
              PduRDestPduRef = Pdu_BAP_PduR2CanIf_Tx
              PduRDestPduPduRBswModulesRef = CanIf
            PDUID_mBAP_ASG_01_0x601_Tx (PduRSrcPdu): PduRSourcePduHandleId=141, PduRSrcPduDirection=TRANSMIT, PduRSrcPduRef=PDUID_mBAP_ASG_01_0x601_Tx, PduRSrcPduPduRBswModulesRef=BAP
      PduRTxBufferTable
        5 x PduRTxBuffer, all with PduRTxBufferUsageType=IMPLICIT_BUFFER:
          PduRTxBuffer_8: PduRPduMaxLength=8
          PduRTxBuffer_32: PduRPduMaxLength=32
          PduRTxBuffer_72: PduRPduMaxLength=72
          PduRTxBuffer_33: PduRPduMaxLength=32
          PduRTxBuffer_34: PduRPduMaxLength=32
      PduRLock_PduRExclusiveArea (PduRLock)
        PduRExclusiveArea: PduRExclusiveAreaId=0
      PduRQueue
        PduRSharedBufferQueue:
          PduRQueueDepth = 2
          PduRTpThreshold = 0
          PduRImplicitTxBufferRef = PduRTxBuffer_32
          PduRImplicitTxBufferRef = PduRTxBuffer_33
          PduRImplicitTxBufferRef = PduRTxBuffer_72
          PduRImplicitTxBufferRef = PduRTxBuffer_34
          PduRImplicitTxBufferRef = PduRTxBuffer_8
    7 x PduRBswModules, all with PduRCancelReceive=false, PduRChangeParameterRequestApi=false:
      CanIf: PduRCancelTransmit=false, PduRCommunicationInterface=true, PduRLowerModule=true, PduRTransportProtocol=false, PduRTriggertransmit=false, PduRTxConfirmation=true, PduRUpperModule=false, PduRUseTag=false, PduRBswModuleRef=CanIf
      CanNm: PduRCancelTransmit=false, PduRCommunicationInterface=true, PduRLowerModule=true, PduRTransportProtocol=false, PduRTriggertransmit=true, PduRTxConfirmation=true, PduRUpperModule=false, PduRUseTag=false, PduRBswModuleRef=CanNm
      CanTp: PduRCancelTransmit=true, PduRCommunicationInterface=false, PduRLowerModule=true, PduRTransportProtocol=true, PduRTriggertransmit=false, PduRTxConfirmation=false, PduRUpperModule=false, PduRUseTag=false, PduRBswModuleRef=CanTp
      Com: PduRCancelTransmit=false, PduRCommunicationInterface=true, PduRLowerModule=false, PduRTransportProtocol=false, PduRTriggertransmit=true, PduRTxConfirmation=true, PduRUpperModule=true, PduRUseTag=false, PduRBswModuleRef=Com
      Dcm: PduRCancelTransmit=true, PduRCommunicationInterface=false, PduRLowerModule=false, PduRTransportProtocol=true, PduRTriggertransmit=false, PduRTxConfirmation=false, PduRUpperModule=true, PduRUseTag=true, PduRBswModuleRef=Dcm
      SecOC: PduRCancelTransmit=false, PduRCommunicationInterface=true, PduRLowerModule=true, PduRTransportProtocol=false, PduRTriggertransmit=false, PduRTxConfirmation=true, PduRUpperModule=true, PduRUseTag=false, PduRBswModuleRef=SecOC
      BAP: PduRCancelTransmit=false, PduRCommunicationInterface=true, PduRLowerModule=false, PduRTransportProtocol=false, PduRTriggertransmit=false, PduRTxConfirmation=true, PduRUpperModule=true, PduRUseTag=false, PduRBswModuleRef=BAP
