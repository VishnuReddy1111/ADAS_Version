AUTOSAR XML (schema 4-3-0)
package /ActiveEcuC
  module config SomeIpXf: implementation-config-variant=VARIANT-PRE-COMPILE, module-description=SomeIpXf_Impl
    XfrmGeneral: XfrmDevErrorDetect=true, XfrmVersionInfoApi=true
