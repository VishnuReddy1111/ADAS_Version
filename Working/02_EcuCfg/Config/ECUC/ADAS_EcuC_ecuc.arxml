AUTOSAR XML (schema 4-3-0)
package /ActiveEcuC
  module config EcuC: implementation-config-variant=VARIANT-PRE-COMPILE, module-description=EcuC_Impl
    EcucPduCollection: PduIdTypeEnum=UINT16, PduLengthTypeEnum=UINT16
      359 x Pdu, all with J1939Requestable=false:
        StartApplication_CCLD_Pdu_SoAdCdd_Udp_Rx: PduLength=508
        StartApplication_CCLD_Pdu_SoAdCdd_Udp_Tx: PduLength=508
        StartApplication_CC_Pdu_SoAdCdd_Udp_Rx: PduLength=8
        StartApplication_CC_Pdu_SoAdCdd_Udp_Tx: PduLength=8
        StartApplication_ETH_Pdu_SoAdCdd_Udp_Rx: PduLength=508
        StartApplication_ETH_Pdu_SoAdCdd_Udp_Tx: PduLength=508
        OTAMC_D_01_XIX_BMC_CAN01_5e0c6077_Tx: DynamicLength=false, PduLength=4, SysTPduToFrameMappingRef=PTF_OTAMC_D_01_XIX_BMC_CAN01
        BJB_CVN_01_XIX_BMC_CAN01_301c1ddb_Rx: DynamicLength=false, PduLength=8
        DCM_BMC_CAN01_XIX_TPCHType_CANHS_OBDC_SSN_Diagnose_XIX_0x17FC71B1_XIX_0x17FE71B1_XIX_Physical_a5d54dec_Tx: DynamicLength=true, PduLength=512
        DCM_HCP5_CANFD01_XIX_TPCHType_CANHS_Flash_DIA_XIX_0x17FC17B2_XIX_0x17FE17B2_XIX_Physical_e187cce2_Rx: DynamicLength=true, PduLength=512
        BMC_HV_11_XIX_BMC_CAN01_E2E_ff4f5109_Tx: DynamicLength=false, PduLength=8
        DCDC_04_XIX_HCP5_CANFD01_8ca88b97_Rx: DynamicLength=false, PduLength=8
        Diagnose_01_XIX_HCP5_CANFD01_95a294dc_Rx: DynamicLength=false, PduLength=8, SysTPduToFrameMappingRef=PTF_Diagnose_01_XIX_HCP5_CANFD01
        UI1_01_XIX_BMC_CAN01_E2E_e77bac14_Rx: DynamicLength=false, PduLength=8, SysTPduToFrameMappingRef=PTF_UI1_01_E2E_XIX_BMC_CAN01
        DCDC_NV_Komponentenfehler_03_XIX_HCP5_CANFD01_d8bc1ce5_Rx: DynamicLength=false, PduLength=8
        UI1_02_XIX_BMC_CAN01_E2E_6d9e0c76_Rx: DynamicLength=false, PduLength=8
        OBDC_SSN_BJB_Req_XIX_BMC_CAN01_31b63a85_Tx: DynamicLength=false, PduLength=8, SysTPduToFrameMappingRef=PTF_OBDC_SSN_BJB_Req_XIX_BMC_CAN01
        BMC_CMC_Temperatur_01_XIX_HCP5_CANFD01_0fcecf3e_Tx: DynamicLength=false, PduLength=64, SysTPduToFrameMappingRef=PTF_BMC_CMC_Temperatur_01_XIX_HCP5_CANFD01
        BMC_HV_13_XIX_BMC_CAN01_E2E_8bfb57f8_Tx: DynamicLength=false, PduLength=8
        SOK_Zeit_Hybrid_01_Chal_01_XIX_HCP5_CANFD01_5939048b_Tx: DynamicLength=false, PduLength=8
        DCM_BMC_CAN01_XIX_TPCHType_CANHS_OBDC_Diagnose_XIX_0x17FD0200_XIX_Functional_e9b636f2_Tx: DynamicLength=true, PduLength=6
        DCM_HCP5_CANFD01_XIX_TPCHType_CANFD_ISO_Diagnose_XIX_0x1C40007B_XIX_0x1C42007B_XIX_Physical_e79447d3_Rx: DynamicLength=true, PduLength=512
        ORU_Control_D_01_XIX_BMC_CAN01_0f07b83a_Tx: DynamicLength=false, PduLength=8, SysTPduToFrameMappingRef=PTF_ORU_Control_D_01_XIX_BMC_CAN01
        SOK_NoAuthenticTime_01_XIX_HCP5_CANFD01_8db7a3c2_Rx: DynamicLength=false, PduLength=8, SysTPduToFrameMappingRef=PTF_SOK_NoAuthenticTime_01_XIX_HCP5_CANFD01
        DCM_HCP5_CANFD01_XIX_TPCHType_CANHS_Flash_DIA_XIX_0x17FE17B1_XIX_0x17FC17B1_XIX_Physical_80bd5cfa_Tx: DynamicLength=true, PduLength=512
        DIA_BJB_Req_XIX_BMC_CAN01_6c84b0d8_Tx: DynamicLength=false, PduLength=8, SysTPduToFrameMappingRef=PTF_DIA_BJB_Req_XIX_BMC_CAN01
        BMC_HV_07_SOK_XIX_HCP5_CANFD01_f0d71bf2_Tx: DynamicLength=false, PduLength=12, SysTPduToFrameMappingRef=PTF_BMC_HV_07_SOK_XIX_HCP5_CANFD01
        ISOx_Funkt_Req_All_FD_XIX_HCP5_CANFD01_1dbb1bad_Rx: DynamicLength=false, PduLength=64, SysTPduToFrameMappingRef=PTF_ISOx_Funkt_Req_All_FD_XIX_HCP5_CANFD01
        CDD_HCP5_CANFD01_XIX_TPCHType_CANFD_DAAP_XIX_0x1C403F7B_XIX_0x1C423F7B_XIX_Physical_3bee6131_Rx: PduLength=512
        KS_Hybrid_01_Challenge_K_XIX_HCP5_CANFD01_306d69bd_Tx: DynamicLength=false, PduLength=12
        Charisma_20_XIX_HCP5_CANFD01_be5e5e8a_Rx: DynamicLength=false, PduLength=20, SysTPduToFrameMappingRef=PTF_Charisma_20_XIX_HCP5_CANFD01
        DCDC_NV_Komponentenfehler_01_XIX_HCP5_CANFD01_dd687766_Rx: DynamicLength=false, PduLength=8
        BJB_CALID_02_XIX_BMC_CAN01_e45a93f7_Rx: DynamicLength=false, PduLength=8, SysTPduToFrameMappingRef=PTF_BJB_CALID_02_XIX_BMC_CAN01
        BMC_CMC_Zellspannung_01_XIX_HCP5_CANFD01_e1187d1c_Tx: DynamicLength=false, PduLength=64, SysTPduToFrameMappingRef=PTF_BMC_CMC_Zellspannung_01_XIX_HCP5_CANFD01
        DCM_BMC_CAN01_XIX_TPCHType_CANHS_OBDC_SSN_Diagnose_XIX_0x17FC71B2_XIX_0x17FE71B2_XIX_Physical_7cbc035b_Tx: DynamicLength=true, PduLength=512
        UI2_02_XIX_BMC_CAN01_E2E_49da1bd1_Rx: DynamicLength=false, PduLength=8, SysTPduToFrameMappingRef=PTF_UI2_02_E2E_XIX_BMC_CAN01
        BJB_CVN_01_XIX_BMC_CAN01_4f7fa9e3_Rx: DynamicLength=false, PduLength=8, SysTPduToFrameMappingRef=PTF_BJB_CVN_01_XIX_BMC_CAN01
        DCM_HCP5_CANFD01_XIX_TPCHType_CANHS_ISO_Diagnose_XIX_0x700_XIX_Functional_7a5202d2_Rx: DynamicLength=true, PduLength=62
        BMC_HV_02_XIX_HCP5_CANFD01_E2E_c5c367a3_Tx: DynamicLength=false, PduLength=44
        ZeitMaster_01_XIX_HCP5_CANFD01_dad73d21_Rx: DynamicLength=false, PduLength=8
        BMC_CMC_Temperatur_02_XIX_HCP5_CANFD01_25727fb6_Tx: DynamicLength=false, PduLength=24, SysTPduToFrameMappingRef=PTF_BMC_CMC_Temperatur_02_XIX_HCP5_CANFD01
        DCDC_NV_Komponentenfehler_01_XIX_HCP5_CANFD01_2b1a3644_Rx: DynamicLength=false, PduLength=8, SysTPduToFrameMappingRef=PTF_DCDC_NV_Komponentenfehler_01_XIX_HCP5_CANFD01
        BMC_HV_14_SOK_XIX_HCP5_CANFD01_572f8cfc_Tx: DynamicLength=false, PduLength=16
        Diagnose_01_XIX_HCP5_CANFD01_426f0ab5_Rx: DynamicLength=false, PduLength=8
        BMC_HV_01_E2E_SOK_XIX_HCP5_CANFD01_ad756307_Tx: DynamicLength=false, PduLength=20
        BMC_HV_08_SOK_XIX_HCP5_CANFD01_29bed328_Tx: DynamicLength=false, PduLength=48
        DCM_BMC_CAN01_XIX_TPCHType_CANHS_OBDC_SSN_Diagnose_XIX_0x17FE71B1_XIX_0x17FC71B1_XIX_Physical_f94f17dc_Rx: DynamicLength=true, PduLength=512
        NmNode_BMC_HV_XIX_BMC_CAN01_a39ed100_Rx: PduLength=8, SysTPduToFrameMappingRef=PTF_NM_Dummy01_XIX_BMC_CAN01
        BMC_HV_05_XIX_HCP5_CANFD01_0d4b7040_Tx: DynamicLength=false, PduLength=8, SysTPduToFrameMappingRef=PTF_BMC_HV_05_XIX_HCP5_CANFD01
        DCM_HCP5_CANFD01_XIX_TPCHType_CANHS_OBDC_SSN_Diagnose_XIX_0x17FC71B1_XIX_0x17FE71B1_XIX_Physical_b69f60a0_Rx: DynamicLength=true, PduLength=512
        DCDC_NV_Komponentenfehler_04_XIX_HCP5_CANFD01_39921681_Rx: DynamicLength=false, PduLength=8
        KN_Hybrid_01_XIX_HCP5_CANFD01_3c12b6a6_Tx: DynamicLength=false, PduLength=16, SysTPduToFrameMappingRef=PTF_KN_Hybrid_01_XIX_HCP5_CANFD01
        DCM_HCP5_CANFD01_XIX_TPCHType_CANHS_OBDx_XIX_0x18DA05F1_XIX_0x18DAF105_XIX_Physical_c08ed539_Rx: DynamicLength=true, PduLength=512
        BMC_CMC_Zellspannung_04_XIX_HCP5_CANFD01_9eddac84_Tx: DynamicLength=false, PduLength=64, SysTPduToFrameMappingRef=PTF_BMC_CMC_Zellspannung_04_XIX_HCP5_CANFD01
        ClampControl_01_XIX_HCP5_CANFD01_5af08b97_Rx: DynamicLength=false, PduLength=8, SysTPduToFrameMappingRef=PTF_ClampControl_01_XIX_HCP5_CANFD01
        DCDC_NV_Komponentenfehler_03_XIX_HCP5_CANFD01_aee2148b_Rx: DynamicLength=false, PduLength=8, SysTPduToFrameMappingRef=PTF_DCDC_NV_Komponentenfehler_03_XIX_HCP5_CANFD01
        BMC_CMC_Zellspannung_05_XIX_HCP5_CANFD01_31993ec3_Tx: DynamicLength=false, PduLength=64, SysTPduToFrameMappingRef=PTF_BMC_CMC_Zellspannung_05_XIX_HCP5_CANFD01
        BMC_HV_04_XIX_BMC_CAN01_E2E_a4a2e7f5_Tx: DynamicLength=false, PduLength=8
        OBDC_SSN_BJB_Resp_XIX_HCP5_CANFD01_7c2a070c_Tx: DynamicLength=false, PduLength=8, SysTPduToFrameMappingRef=PTF_OBDC_SSN_BJB_Resp_XIX_HCP5_CANFD01
        OBDC_SSN_UI2Sens01_Req_XIX_BMC_CAN01_32b2328b_Tx: DynamicLength=false, PduLength=8, SysTPduToFrameMappingRef=PTF_OBDC_SSN_UI2Sens01_Req_XIX_BMC_CAN01
        CDD_HCP5_CANFD01_XIX_TPCHType_CANFD_DAAP_XIX_0x1C423F7B_XIX_0x1C403F7B_XIX_Physical_d2cfa6c1_Tx: PduLength=512
        DIA_UI2Sens01_Req_XIX_HCP5_CANFD01_d86619ec_Rx: DynamicLength=false, PduLength=8, SysTPduToFrameMappingRef=PTF_DIA_UI2Sens01_Req_XIX_HCP5_CANFD01
        OBDC_SSN_UI2Sens02_Resp_XIX_BMC_CAN01_e1ea5c01_Rx: DynamicLength=false, PduLength=8, SysTPduToFrameMappingRef=PTF_OBDC_SSN_UI2Sens02_Resp_XIX_BMC_CAN01
        DCM_HCP5_CANFD01_XIX_TPCHType_CANHS_OBDC_SSN_Diagnose_XIX_0x17FC71B2_XIX_0x17FE71B2_XIX_Physical_9b954fe5_Rx: DynamicLength=true, PduLength=512
        UI1_03_XIX_BMC_CAN01_4277cadb_Rx: DynamicLength=false, PduLength=8
        BMC_HV_10_XIX_BMC_CAN01_E2E_28add151_Tx: DynamicLength=false, PduLength=8
        DCM_HCP5_CANFD01_XIX_TPCHType_CANHS_OBDx_XIX_0x18DA05F1_XIX_0x18DAF105_XIX_Physical_31397855_Rx: DynamicLength=true, PduLength=512
        Thermomanagement_01_XIX_HCP5_CANFD01_bb71c5fe_Rx: DynamicLength=false, PduLength=64, SysTPduToFrameMappingRef=PTF_Thermomanagement_01_XIX_HCP5_CANFD01
        UI2Sens02_CALID_01_XIX_BMC_CAN01_a812cab1_Rx: DynamicLength=false, PduLength=8, SysTPduToFrameMappingRef=PTF_UI2Sens02_CALID_01_XIX_BMC_CAN01
        BMC_HV_02_E2E_SOK_XIX_HCP5_CANFD01_5f228eff_Tx: DynamicLength=false, PduLength=48
        DCM_HCP5_CANFD01_XIX_TPCHType_CANHS_Flash_DIA_XIX_0x17FE16D0_XIX_0x17FC16D0_XIX_Physical_7582832a_Tx: DynamicLength=true, PduLength=512
        OBDC_SSN_UI2Sens02_Req_XIX_HCP5_CANFD01_7e9f9397_Rx: DynamicLength=false, PduLength=8, SysTPduToFrameMappingRef=PTF_OBDC_SSN_UI2Sens02_Req_XIX_HCP5_CANFD01
        Airbag_10_XIX_HCP5_CANFD01_7f2c77c5_Rx: DynamicLength=false, PduLength=16
        CDD_DEV_BJB_Req_01_XIX_HCP5_CANFD01_c982c041_Rx: PduLength=8, SysTPduToFrameMappingRef=PTF_DEV_BJB_Req_01_XIX_HCP5_CANFD01
        DCM_BMC_CAN01_XIX_TPCHType_CANHS_Flash_DIA_XIX_0x17FC16D0_XIX_0x17FE16D0_XIX_Physical_970a5f86_Tx: DynamicLength=true, PduLength=512
        ISO_Funktionaler_Req_All_XIX_HCP5_CANFD01_e497e7f8_Rx: DynamicLength=false, PduLength=8, SysTPduToFrameMappingRef=PTF_ISO_Funktionaler_Req_All_XIX_HCP5_CANFD01
        BMC_CMC_Temperatur_03_XIX_HCP5_CANFD01_8a36edf1_Tx: DynamicLength=false, PduLength=64, SysTPduToFrameMappingRef=PTF_BMC_CMC_Temperatur_03_XIX_HCP5_CANFD01
        OBDC_SSN_BJB_Resp_XIX_BMC_CAN01_d5ca69f5_Rx: DynamicLength=false, PduLength=8, SysTPduToFrameMappingRef=PTF_OBDC_SSN_BJB_Resp_XIX_BMC_CAN01
        CDD_HCP5_CANFD01_XIX_TPCHType_CANFD_DAAP_XIX_0x1C423F7B_XIX_0x1C403F7B_XIX_Physical_53df2b54_Tx: PduLength=512
        HVEM_07_XIX_HCP5_CANFD01_839f516f_Rx: DynamicLength=false, PduLength=32
        ClampControl_01_XIX_BMC_CAN01_6c74ee25_Tx: DynamicLength=false, PduLength=8, SysTPduToFrameMappingRef=PTF_ClampControl_01_XIX_BMC_CAN01
        BMC_HV_03_XIX_HCP5_CANFD01_0617c15c_Tx: DynamicLength=false, PduLength=24
        OBDC_Hybrid_01_Resp_FD_XIX_HCP5_CANFD01_4da12d14_Tx: DynamicLength=false, PduLength=64, SysTPduToFrameMappingRef=PTF_OBDC_Hybrid_01_Resp_FD_XIX_HCP5_CANFD01
        UI2Sens01_CALID_01_XIX_BMC_CAN01_6126d1bc_Rx: DynamicLength=false, PduLength=8, SysTPduToFrameMappingRef=PTF_UI2Sens01_CALID_01_XIX_BMC_CAN01
        DCM_HCP5_CANFD01_XIX_TPCHType_CANFD_OBDC_Diagnose_XIX_0x1C42027B_XIX_0x1C40027B_XIX_Physical_c887ac0a_Tx: DynamicLength=true, PduLength=512
        BJB_12_XIX_BMC_CAN01_E2E_c4dd8994_Rx: DynamicLength=false, PduLength=8, SysTPduToFrameMappingRef=PTF_BJB_12_E2E_XIX_BMC_CAN01
        NVEM_12_XIX_HCP5_CANFD01_27d236bb_Rx: DynamicLength=false, PduLength=12, SysTPduToFrameMappingRef=PTF_NVEM_12_XIX_HCP5_CANFD01
        DCM_BMC_CAN01_XIX_TPCHType_CANHS_Flash_DIA_XIX_0x17FC17B1_XIX_0x17FE17B1_XIX_Physical_91cacfde_Tx: DynamicLength=true, PduLength=512
        XCP_Hybrid_01_DTO_01_FD_XIX_HCP5_CANFD01_ee6930a2_Tx: DynamicLength=true, PduLength=64, SysTPduToFrameMappingRef=PTF_XCP_Hybrid_01_DTO_01_FD_XIX_HCP5_CANFD01
        DCM_BMC_CAN01_XIX_TPCHType_CANHS_Flash_DIA_XIX_0x17FC17B2_XIX_0x17FE17B2_XIX_Physical_bb5ccee1_Tx: DynamicLength=true, PduLength=512
        DCM_HCP5_CANFD01_XIX_TPCHType_CANFD_OBDC_Diagnose_XIX_0x1C40027B_XIX_0x1C42027B_XIX_Physical_8b2e4924_Rx: DynamicLength=true, PduLength=512
        UI2_Komponentenfehler_02_XIX_BMC_CAN01_008f0d49_Rx: DynamicLength=false, PduLength=8, SysTPduToFrameMappingRef=PTF_UI2_Komponentenfehler_02_XIX_BMC_CAN01
        DCM_HCP5_CANFD01_XIX_TPCHType_CANHS_OBDC_SSN_Diagnose_XIX_0x17FE71B1_XIX_0x17FC71B1_XIX_Physical_e337ed9f_Tx: DynamicLength=true, PduLength=512
        ORU_Control_A_01_XIX_HCP5_CANFD01_E2E_3007747a_Rx: DynamicLength=false, PduLength=8
        OTAMC_D_01_XIX_HCP5_CANFD01_E2E_c199b3e6_Rx: DynamicLength=false, PduLength=4
        CDD_XCP_BJB_CRO_01_XIX_HCP5_CANFD01_a8ba0d4f_Rx: PduLength=8, SysTPduToFrameMappingRef=PTF_XCP_BJB_CRO_01_XIX_HCP5_CANFD01
        DCM_BMC_CAN01_XIX_TPCHType_CANHS_Flash_DIA_XIX_0x17FC16D0_XIX_0x17FE16D0_XIX_Physical_9f19b594_Tx: DynamicLength=true, PduLength=512
        BJB_CALID_02_XIX_BMC_CAN01_bc93171f_Rx: DynamicLength=false, PduLength=8
        DCM_HCP5_CANFD01_XIX_TPCHType_CANHS_OBDx_XIX_0x18DB33F1_XIX_Functional_1f67dc03_Rx: DynamicLength=true, PduLength=62
        OTP_01_XIX_HCP5_CANFD01_fd0a6756_Rx: DynamicLength=false, PduLength=8, SysTPduToFrameMappingRef=PTF_OTP_01_XIX_HCP5_CANFD01
        DEV_Hybrid_01_Resp_FF_XIX_HCP5_CANFD01_7b20ac63_Tx: DynamicLength=false, PduLength=64
        CDD_DEV_BMS_Resp_193_XIX_BMC_CAN01_0984efd1_Rx: PduLength=8, SysTPduToFrameMappingRef=PTF_DEV_BMS_Resp_193_XIX_BMC_CAN01
        UI1_02_XIX_BMC_CAN01_E2E_aa93ac73_Rx: DynamicLength=false, PduLength=8, SysTPduToFrameMappingRef=PTF_UI1_02_E2E_XIX_BMC_CAN01
        DCM_HCP5_CANFD01_XIX_TPCHType_CANHS_Flash_DIA_XIX_0x17FE17B2_XIX_0x17FC17B2_XIX_Physical_59d4124d_Tx: DynamicLength=true, PduLength=512
        ORU_01_XIX_BMC_CAN01_4256635f_Tx: DynamicLength=false, PduLength=8, SysTPduToFrameMappingRef=PTF_ORU_01_XIX_BMC_CAN01
        OBD_HCP1_SOK_XIX_HCP5_CANFD01_a5806350_Rx: DynamicLength=false, PduLength=6, SysTPduToFrameMappingRef=PTF_OBD_HCP1_SOK_XIX_HCP5_CANFD01
        DCDC_NV_CALID_XIX_HCP5_CANFD01_004a20bd_Rx: DynamicLength=false, PduLength=16, SysTPduToFrameMappingRef=PTF_DCDC_NV_CALID_XIX_HCP5_CANFD01
        NMH_Hybrid_01_XIX_BMC_CAN01_b22e17f1_Tx: PduLength=6
        DCDC_NV_Komponentenfehler_02_XIX_HCP5_CANFD01_01a686cc_Rx: DynamicLength=false, PduLength=8, SysTPduToFrameMappingRef=PTF_DCDC_NV_Komponentenfehler_02_XIX_HCP5_CANFD01
        BMC_CMC_Zellspannung_03_XIX_HCP5_CANFD01_64e05fd3_Tx: DynamicLength=false, PduLength=64, SysTPduToFrameMappingRef=PTF_BMC_CMC_Zellspannung_03_XIX_HCP5_CANFD01
        DCM_BMC_CAN01_XIX_TPCHType_CANHS_OBDC_SSN_Diagnose_XIX_0x17FC71B1_XIX_0x17FE71B1_XIX_Physical_e2566773_Tx: DynamicLength=true, PduLength=512
        KS_Hybrid_01_Response_M_XIX_HCP5_CANFD01_1b34419b_Rx: DynamicLength=false, PduLength=12, SysTPduToFrameMappingRef=PTF_KS_Hybrid_01_Response_M_XIX_HCP5_CANFD01
        BMC_HV_02_E2E_SOK_XIX_HCP5_CANFD01_4f75cc0d_Tx: DynamicLength=false, PduLength=48, SysTPduToFrameMappingRef=PTF_BMC_HV_02_E2E_SOK_XIX_HCP5_CANFD01
        XCP_Hybrid_01_CRO_01_FD_XIX_HCP5_CANFD01_f21b8ba9_Rx: DynamicLength=true, PduLength=64, SysTPduToFrameMappingRef=PTF_XCP_Hybrid_01_CRO_01_FD_XIX_HCP5_CANFD01
        OBDC_SSN_BJB_Req_XIX_HCP5_CANFD01_87b9d88e_Rx: DynamicLength=false, PduLength=8, SysTPduToFrameMappingRef=PTF_OBDC_SSN_BJB_Req_XIX_HCP5_CANFD01
        NMH_Hybrid_01_XIX_BMC_CAN01_30f8f2db_Tx: DynamicLength=false, PduLength=8, SysTPduToFrameMappingRef=PTF_NMH_Hybrid_01_XIX_BMC_CAN01
        BJB_CALID_01_XIX_BMC_CAN01_adee7d66_Rx: DynamicLength=false, PduLength=8
        Systeminfo_01_XIX_HCP5_CANFD01_1ca8fa11_Rx: DynamicLength=false, PduLength=8, SysTPduToFrameMappingRef=PTF_Systeminfo_01_XIX_HCP5_CANFD01
        UI1_01_XIX_BMC_CAN01_E2E_cec88adf_Rx: DynamicLength=false, PduLength=8
        ORU_Control_D_01_XIX_HCP5_CANFD01_E2E_9ed03939_Rx: DynamicLength=false, PduLength=8, SysTPduToFrameMappingRef=PTF_ORU_Control_D_01_E2E_XIX_HCP5_CANFD01
        BJB_13_XIX_BMC_CAN01_E2E_35d3901a_Rx: DynamicLength=false, PduLength=8
        HCP1_17_XIX_HCP5_CANFD01_c544c746_Rx: DynamicLength=false, PduLength=8, SysTPduToFrameMappingRef=PTF_HCP1_17_XIX_HCP5_CANFD01
        HVLM_14_XIX_HCP5_CANFD01_E2E_2623685a_Rx: DynamicLength=false, PduLength=8, SysTPduToFrameMappingRef=PTF_HVLM_14_E2E_XIX_HCP5_CANFD01
        BMC_HV_13_XIX_BMC_CAN01_E2E_7c608fb6_Tx: DynamicLength=false, PduLength=8, SysTPduToFrameMappingRef=PTF_BMC_HV_13_E2E_XIX_BMC_CAN01
        OBDC_SSN_UI2Sens02_Resp_XIX_HCP5_CANFD01_18b88987_Tx: DynamicLength=false, PduLength=8, SysTPduToFrameMappingRef=PTF_OBDC_SSN_UI2Sens02_Resp_XIX_HCP5_CANFD01
        DCM_HCP5_CANFD01_XIX_TPCHType_CANFD_ISO_Diagnose_XIX_0x1C42007B_XIX_0x1C40007B_XIX_Physical_266b033c_Tx: DynamicLength=true, PduLength=512
        UI2Sens01_CALID_02_XIX_BMC_CAN01_e2b448f9_Rx: DynamicLength=false, PduLength=8
        UI2_Komponentenfehler_02_XIX_BMC_CAN01_7d1b0ef0_Rx: DynamicLength=false, PduLength=8
        DCM_HCP5_CANFD01_XIX_TPCHType_CANHS_ISO_Diagnose_XIX_0x700_XIX_Functional_e754bff6_Rx: DynamicLength=true, PduLength=62
        Systeminfo_01_XIX_HCP5_CANFD01_fb27c5ed_Rx: DynamicLength=false, PduLength=8
        UI2Sens02_CALID_02_XIX_BMC_CAN01_baaae1d1_Rx: DynamicLength=false, PduLength=8
        DCM_HCP5_CANFD01_XIX_TPCHType_CANHS_Flash_DIA_XIX_0x17FC17B2_XIX_0x17FE17B2_XIX_Physical_654058e0_Rx: DynamicLength=true, PduLength=512
        UI1_Komponentenfehler_01_XIX_BMC_CAN01_0b0d2b23_Rx: DynamicLength=false, PduLength=8, SysTPduToFrameMappingRef=PTF_UI1_Komponentenfehler_01_XIX_BMC_CAN01
        UI1_04_XIX_BMC_CAN01_d976c5c1_Rx: DynamicLength=false, PduLength=8
        DCM_HCP5_CANFD01_XIX_TPCHType_CANFD_ISO_Diagnose_XIX_0x1C42007B_XIX_0x1C40007B_XIX_Physical_4bbc7f71_Tx: DynamicLength=true, PduLength=512
        DIA_BJB_Req_XIX_HCP5_CANFD01_f2b9e65d_Rx: DynamicLength=false, PduLength=8, SysTPduToFrameMappingRef=PTF_DIA_BJB_Req_XIX_HCP5_CANFD01
        ORU_Control_D_01_XIX_HCP5_CANFD01_E2E_6e31ae8f_Rx: DynamicLength=false, PduLength=8
        UI2Sens02_CALID_02_XIX_BMC_CAN01_c59439eb_Rx: DynamicLength=false, PduLength=8, SysTPduToFrameMappingRef=PTF_UI2Sens02_CALID_02_XIX_BMC_CAN01
        KS_Hybrid_01_ReqFrame_XIX_HCP5_CANFD01_b04c52dd_Tx: DynamicLength=false, PduLength=8
        CDD_HCP5_CANFD01_XIX_TPCHType_CANFD_DAAP_XIX_0x1C413FDD_XIX_Functional_6530545d_Rx: PduLength=62
        CDD_DEV_BJB_Resp_FF_XIX_HCP5_CANFD01_77e6d841_Tx: PduLength=8, SysTPduToFrameMappingRef=PTF_DEV_BJB_Resp_FF_XIX_HCP5_CANFD01
        DCM_BMC_CAN01_XIX_TPCHType_CANHS_Flash_DIA_XIX_0x17FE16D0_XIX_0x17FC16D0_XIX_Physical_8400c53b_Rx: DynamicLength=true, PduLength=512
        DCM_BMC_CAN01_XIX_TPCHType_CANHS_OBDC_SSN_Diagnose_XIX_0x17FE71B2_XIX_0x17FC71B2_XIX_Physical_c4efddf4_Rx: DynamicLength=true, PduLength=512
        UI1_05_XIX_BMC_CAN01_608d1e29_Rx: DynamicLength=false, PduLength=8
        DIA_BJB_Resp_XIX_HCP5_CANFD01_6385845c_Tx: DynamicLength=false, PduLength=8, SysTPduToFrameMappingRef=PTF_DIA_BJB_Resp_XIX_HCP5_CANFD01
        ClampControl_01_XIX_HCP5_CANFD01_8c24343b_Rx: DynamicLength=false, PduLength=8
        HVLM_13_XIX_HCP5_CANFD01_f34a06e4_Rx: DynamicLength=false, PduLength=32, SysTPduToFrameMappingRef=PTF_HVLM_13_XIX_HCP5_CANFD01
        ISOx_Hybrid_01_Req_XIX_HCP5_CANFD01_bd99bbef_Rx: DynamicLength=false, PduLength=8, SysTPduToFrameMappingRef=PTF_ISOx_Hybrid_01_Req_XIX_HCP5_CANFD01
        DCM_BMC_CAN01_XIX_TPCHType_CANHS_Flash_DIA_XIX_0x17FC17B2_XIX_0x17FE17B2_XIX_Physical_8c0f4baf_Tx: DynamicLength=true, PduLength=512
        OBDC_Hybrid_01_Req_FD_XIX_HCP5_CANFD01_38935bdf_Rx: DynamicLength=false, PduLength=64, SysTPduToFrameMappingRef=PTF_OBDC_Hybrid_01_Req_FD_XIX_HCP5_CANFD01
        Airbag_10_XIX_HCP5_CANFD01_6624abf2_Rx: DynamicLength=false, PduLength=16, SysTPduToFrameMappingRef=PTF_Airbag_10_XIX_HCP5_CANFD01
        DCM_HCP5_CANFD01_XIX_TPCHType_CANFD_OBDC_Diagnose_XIX_0x1C410200_XIX_Functional_c81dd985_Rx: DynamicLength=true, PduLength=62
        OBD_03_XIX_HCP5_CANFD01_f1281889_Rx: DynamicLength=false, PduLength=8
        HVK_03_XIX_HCP5_CANFD01_E2E_8a76edcb_Rx: DynamicLength=false, PduLength=8
        BMC_HV_14_XIX_HCP5_CANFD01_30db4b60_Tx: DynamicLength=false, PduLength=12
        DCM_HCP5_CANFD01_XIX_TPCHType_CANHS_Flash_DIA_XIX_0x17FE17B1_XIX_0x17FC17B1_XIX_Physical_1de2fa9a_Tx: DynamicLength=true, PduLength=512
        OBDx_allOBD_Req_XIX_HCP5_CANFD01_a7e21e7c_Rx: DynamicLength=false, PduLength=8, SysTPduToFrameMappingRef=PTF_OBDx_allOBD_Req_XIX_HCP5_CANFD01
        OTAMC_D_01_XIX_HCP5_CANFD01_E2E_8283a85d_Rx: DynamicLength=false, PduLength=4, SysTPduToFrameMappingRef=PTF_OTAMC_D_01_E2E_XIX_HCP5_CANFD01
        Thermomanagement_01_XIX_HCP5_CANFD01_60e8cf38_Rx: DynamicLength=false, PduLength=64
        DCM_HCP5_CANFD01_XIX_TPCHType_CANHS_ISO_Diagnose_XIX_0x17FC007B_XIX_0x17FE007B_XIX_Physical_fb6bd0a7_Rx: DynamicLength=true, PduLength=512
        DCM_BMC_CAN01_XIX_TPCHType_CANHS_Flash_DIA_XIX_0x17FC17B1_XIX_0x17FE17B1_XIX_Physical_62358056_Tx: DynamicLength=true, PduLength=512
        WFS_02_XIX_HCP5_CANFD01_61136cb6_Rx: DynamicLength=false, PduLength=28
        DCDC_NV_CALID_XIX_HCP5_CANFD01_46b970f2_Rx: DynamicLength=false, PduLength=16
        DIA_UI2Sens02_Resp_XIX_BMC_CAN01_fe45df51_Rx: DynamicLength=false, PduLength=8, SysTPduToFrameMappingRef=PTF_DIA_UI2Sens02_Resp_XIX_BMC_CAN01
        KS_Hybrid_01_Challenge_K_XIX_HCP5_CANFD01_f262895d_Tx: DynamicLength=false, PduLength=12, SysTPduToFrameMappingRef=PTF_KS_Hybrid_01_Challenge_K_XIX_HCP5_CANFD01
        DCM_HCP5_CANFD01_XIX_TPCHType_CANHS_Flash_DIA_XIX_0x17FC16D0_XIX_0x17FE16D0_XIX_Physical_cdd15d85_Rx: DynamicLength=true, PduLength=512
        DCM_BMC_CAN01_XIX_TPCHType_CANHS_OBDC_SSN_Diagnose_XIX_0x17FE71B2_XIX_0x17FC71B2_XIX_Physical_e48a93ad_Rx: DynamicLength=true, PduLength=512
        ISOx_Hybrid_01_Resp_FD_XIX_HCP5_CANFD01_71c0a54e_Tx: DynamicLength=false, PduLength=64, SysTPduToFrameMappingRef=PTF_ISOx_Hybrid_01_Resp_FD_XIX_HCP5_CANFD01
        UI2_01_XIX_BMC_CAN01_E2E_f7b0279f_Rx: DynamicLength=false, PduLength=8
        ISOx_Hybrid_01_Resp_XIX_HCP5_CANFD01_46a576a1_Tx: DynamicLength=false, PduLength=8, SysTPduToFrameMappingRef=PTF_ISOx_Hybrid_01_Resp_XIX_HCP5_CANFD01
        NM_Hybrid_01_XIX_HCP5_CANFD01_c84ff8a5_Tx: PduLength=23
        KS_Hybrid_01_Challenge_M_XIX_HCP5_CANFD01_a71be84d_Rx: DynamicLength=false, PduLength=12, SysTPduToFrameMappingRef=PTF_KS_Hybrid_01_Challenge_M_XIX_HCP5_CANFD01
        OBG_01_XIX_HCP5_CANFD01_8fe2f1e9_Rx: DynamicLength=false, PduLength=60
        OBDx_Hybrid_01_Req_XIX_HCP5_CANFD01_5cba35a0_Rx: DynamicLength=false, PduLength=8, SysTPduToFrameMappingRef=PTF_OBDx_Hybrid_01_Req_XIX_HCP5_CANFD01
        BMC_CMC_Zellspannung_02_XIX_HCP5_CANFD01_1de9628b_Tx: DynamicLength=false, PduLength=64
        DCDC_NV_CVN_XIX_HCP5_CANFD01_55665719_Rx: DynamicLength=false, PduLength=8
        DCM_HCP5_CANFD01_XIX_TPCHType_CANHS_OBDC_SSN_Diagnose_XIX_0x17FE70D0_XIX_0x17FC70D0_XIX_Physical_5430f795_Tx: DynamicLength=true, PduLength=512
        DEV_Hybrid_01_Req_00_XIX_HCP5_CANFD01_5661b344_Rx: DynamicLength=false, PduLength=64
        DCM_HCP5_CANFD01_XIX_TPCHType_CANHS_OBDC_SSN_Diagnose_XIX_0x17FC70D0_XIX_0x17FE70D0_XIX_Physical_cd403ce5_Rx: DynamicLength=true, PduLength=512
        DIA_BJB_Resp_XIX_BMC_CAN01_c04d7636_Rx: DynamicLength=false, PduLength=8, SysTPduToFrameMappingRef=PTF_DIA_BJB_Resp_XIX_BMC_CAN01
        KS_Hybrid_01_Response_K_XIX_HCP5_CANFD01_4e4d208b_Tx: DynamicLength=false, PduLength=12, SysTPduToFrameMappingRef=PTF_KS_Hybrid_01_Response_K_XIX_HCP5_CANFD01
        OBDx_Hybrid_01_Resp_XIX_HCP5_CANFD01_a027092e_Tx: DynamicLength=false, PduLength=8, SysTPduToFrameMappingRef=PTF_OBDx_Hybrid_01_Resp_XIX_HCP5_CANFD01
        PduPnc_EIRA_CAN_Rx: PduLength=7
        DCM_HCP5_CANFD01_XIX_TPCHType_CANFD_OBDC_Diagnose_XIX_0x1C42027B_XIX_0x1C40027B_XIX_Physical_4ad10dcb_Tx: DynamicLength=true, PduLength=512
        OBDC_Funktionaler_Req_All_XIX_BMC_CAN01_c40642be_Tx: DynamicLength=false, PduLength=8, SysTPduToFrameMappingRef=PTF_OBDC_Funktionaler_Req_All_XIX_BMC_CAN01
        UI1_05_XIX_BMC_CAN01_d1b05aa4_Rx: DynamicLength=false, PduLength=8, SysTPduToFrameMappingRef=PTF_UI1_05_XIX_BMC_CAN01
        BMC_HV_04_XIX_BMC_CAN01_E2E_24b17933_Tx: DynamicLength=false, PduLength=8, SysTPduToFrameMappingRef=PTF_BMC_HV_04_E2E_XIX_BMC_CAN01
        DCDC_04_XIX_HCP5_CANFD01_622db5e5_Rx: DynamicLength=false, PduLength=8, SysTPduToFrameMappingRef=PTF_DCDC_04_XIX_HCP5_CANFD01
        DCM_HCP5_CANFD01_XIX_TPCHType_CANHS_ISO_Diagnose_XIX_0x17FE007B_XIX_0x17FC007B_XIX_Physical_621b1bd7_Tx: DynamicLength=true, PduLength=512
        OBD_03_XIX_BMC_CAN01_5c2c79fc_Tx: DynamicLength=false, PduLength=8, SysTPduToFrameMappingRef=PTF_OBD_03_XIX_BMC_CAN01
        ELF_06_XIX_HCP5_CANFD01_d78b945c_Rx: DynamicLength=false, PduLength=8
        DCM_HCP5_CANFD01_XIX_TPCHType_CANHS_ISO_Diagnose_XIX_0x17FC007B_XIX_0x17FE007B_XIX_Physical_f4a1250c_Rx: DynamicLength=true, PduLength=512
        DCM_BMC_CAN01_XIX_TPCHType_CANHS_ISO_Diagnose_XIX_0x700_XIX_Functional_770cc244_Tx: DynamicLength=true, PduLength=6
        UI1_Komponentenfehler_02_XIX_BMC_CAN01_668bd879_Rx: DynamicLength=false, PduLength=8, SysTPduToFrameMappingRef=PTF_UI1_Komponentenfehler_02_XIX_BMC_CAN01
        OBD_04_XIX_BMC_CAN01_a3a3ce7e_Tx: DynamicLength=false, PduLength=8, SysTPduToFrameMappingRef=PTF_OBD_04_XIX_BMC_CAN01
        DEV_Hybrid_01_Req_00_XIX_HCP5_CANFD01_91241766_Rx: DynamicLength=false, PduLength=64, SysTPduToFrameMappingRef=PTF_DEV_Hybrid_01_Req_00_XIX_HCP5_CANFD01
        KS_Hybrid_01_ReqFrame_XIX_HCP5_CANFD01_d7f937e5_Tx: DynamicLength=false, PduLength=8, SysTPduToFrameMappingRef=PTF_KS_Hybrid_01_ReqFrame_XIX_HCP5_CANFD01
        ZeitMaster_01_XIX_HCP5_CANFD01_16302e51_Rx: DynamicLength=false, PduLength=8, SysTPduToFrameMappingRef=PTF_ZeitMaster_01_XIX_HCP5_CANFD01
        UI1_03_XIX_BMC_CAN01_0abdbc10_Rx: DynamicLength=false, PduLength=8, SysTPduToFrameMappingRef=PTF_UI1_03_XIX_BMC_CAN01
        BJB_11_XIX_BMC_CAN01_E2E_893589f3_Rx: DynamicLength=false, PduLength=8, SysTPduToFrameMappingRef=PTF_BJB_11_E2E_XIX_BMC_CAN01
        UI2Sens02_CVN_XIX_BMC_CAN01_5d3dd455_Rx: DynamicLength=false, PduLength=8
        BMC_CMC_Temperatur_02_XIX_HCP5_CANFD01_f9538f57_Tx: DynamicLength=false, PduLength=24
        BMC_CMC_Zellspannung_05_XIX_HCP5_CANFD01_fcc768ef_Tx: DynamicLength=false, PduLength=64
        BJB_CALID_01_XIX_BMC_CAN01_89dc60ad_Rx: DynamicLength=false, PduLength=8, SysTPduToFrameMappingRef=PTF_BJB_CALID_01_XIX_BMC_CAN01
        BMC_CMC_Zellspannung_01_XIX_HCP5_CANFD01_f76fbfe9_Tx: DynamicLength=false, PduLength=64
        HVK_03_E2E_SOK_XIX_HCP5_CANFD01_32c3c9b9_Rx: DynamicLength=false, PduLength=12
        DCM_BMC_CAN01_XIX_TPCHType_CANHS_OBDC_SSN_Diagnose_XIX_0x17FC70D0_XIX_0x17FE70D0_XIX_Physical_ec851d39_Tx: DynamicLength=true, PduLength=512
        DAAP_Hybrid_01_Req_FD_XIX_HCP5_CANFD01_25e2ca12_Rx: DynamicLength=false, PduLength=64, SysTPduToFrameMappingRef=PTF_DAAP_Hybrid_01_Req_FD_XIX_HCP5_CANFD01
        DCM_HCP5_CANFD01_XIX_TPCHType_CANFD_ISO_Diagnose_XIX_0x1C40007B_XIX_0x1C42007B_XIX_Physical_238d3514_Rx: DynamicLength=true, PduLength=512
        BMC_CMC_Temperatur_03_XIX_HCP5_CANFD01_160139b6_Tx: DynamicLength=false, PduLength=64
        BMC_HV_10_XIX_BMC_CAN01_E2E_31888fd1_Tx: DynamicLength=false, PduLength=8, SysTPduToFrameMappingRef=PTF_BMC_HV_10_E2E_XIX_BMC_CAN01
        DCM_BMC_CAN01_XIX_TPCHType_CANHS_Flash_DIA_XIX_0x17FE17B2_XIX_0x17FC17B2_XIX_Physical_97163b00_Rx: DynamicLength=true, PduLength=512
        DCM_HCP5_CANFD01_XIX_TPCHType_CANHS_OBDx_XIX_0x18DB33F1_XIX_Functional_06e701c6_Rx: DynamicLength=true, PduLength=62
        BMC_HV_07_XIX_HCP5_CANFD01_0dbf165a_Tx: DynamicLength=false, PduLength=8
        DCM_BMC_CAN01_XIX_TPCHType_CANHS_Flash_DIA_XIX_0x17FE16D0_XIX_0x17FC16D0_XIX_Physical_2f598129_Rx: DynamicLength=true, PduLength=512
        SOK_Zeit_Hybrid_01_Resp_01_SOK_XIX_HCP5_CANFD01_92adacdc_Rx: DynamicLength=false, PduLength=16
        OBDC_SSN_UI2Sens01_Req_XIX_HCP5_CANFD01_00e7db31_Rx: DynamicLength=false, PduLength=8, SysTPduToFrameMappingRef=PTF_OBDC_SSN_UI2Sens01_Req_XIX_HCP5_CANFD01
        OTP_01_XIX_HCP5_CANFD01_76e7759c_Rx: DynamicLength=false, PduLength=8
        BMC_HV_01_XIX_HCP5_CANFD01_E2E_fcbbcae3_Tx: DynamicLength=false, PduLength=16
        CDD_XCP_BJB_CRO_01_XIX_BMC_CAN01_9130eaf8_Tx: PduLength=8, SysTPduToFrameMappingRef=PTF_XCP_BJB_CRO_01_XIX_BMC_CAN01
        DIA_UI2Sens02_Req_XIX_HCP5_CANFD01_a61e514a_Rx: DynamicLength=false, PduLength=8, SysTPduToFrameMappingRef=PTF_DIA_UI2Sens02_Req_XIX_HCP5_CANFD01
        BJB_08_XIX_BMC_CAN01_7b6df5c6_Rx: DynamicLength=false, PduLength=8, SysTPduToFrameMappingRef=PTF_BJB_08_XIX_BMC_CAN01
        BJB_12_XIX_BMC_CAN01_E2E_e2311042_Rx: DynamicLength=false, PduLength=8
        OBD_HCP1_XIX_HCP5_CANFD01_1b389b6c_Rx: DynamicLength=false, PduLength=2
        DIA_UI2Sens02_Resp_XIX_HCP5_CANFD01_e002a62c_Tx: DynamicLength=false, PduLength=8, SysTPduToFrameMappingRef=PTF_DIA_UI2Sens02_Resp_XIX_HCP5_CANFD01
        SOK_Zeit_Hybrid_01_Chal_01_XIX_HCP5_CANFD01_441f0aae_Tx: DynamicLength=false, PduLength=8, SysTPduToFrameMappingRef=PTF_SOK_Zeit_Hybrid_01_Chal_01_XIX_HCP5_CANFD01
        OBDx_allOBD_Req_XIX_BMC_CAN01_9cfd1e51_Tx: DynamicLength=false, PduLength=8, SysTPduToFrameMappingRef=PTF_OBDx_allOBD_Req_XIX_BMC_CAN01
        DEV_Hybrid_01_Resp_FF_XIX_HCP5_CANFD01_3aa35b5c_Tx: DynamicLength=false, PduLength=64, SysTPduToFrameMappingRef=PTF_DEV_Hybrid_01_Resp_FF_XIX_HCP5_CANFD01
        OBD_04_XIX_HCP5_CANFD01_dc080cfa_Rx: DynamicLength=false, PduLength=8, SysTPduToFrameMappingRef=PTF_OBD_04_XIX_HCP5_CANFD01
        Zeitmaster_05_XIX_HCP5_CANFD01_1d48ef0a_Rx: DynamicLength=false, PduLength=8, SysTPduToFrameMappingRef=PTF_Zeitmaster_05_XIX_HCP5_CANFD01
        DCM_BMC_CAN01_XIX_TPCHType_CANHS_Flash_DIA_XIX_0x17FE17B1_XIX_0x17FC17B1_XIX_Physical_da665ef9_Rx: DynamicLength=true, PduLength=512
        HVLM_14_XIX_HCP5_CANFD01_E2E_b3d1458f_Rx: DynamicLength=false, PduLength=8
        DCM_HCP5_CANFD01_XIX_TPCHType_CANHS_OBDx_XIX_0x18DAF105_XIX_0x18DA05F1_XIX_Physical_9db247ca_Tx: DynamicLength=true, PduLength=512
        DCDC_NV_Komponentenfehler_02_XIX_HCP5_CANFD01_37eeaa04_Rx: DynamicLength=false, PduLength=8
        DIA_UI2Sens02_Req_XIX_BMC_CAN01_0a5a0c3f_Tx: DynamicLength=false, PduLength=8, SysTPduToFrameMappingRef=PTF_DIA_UI2Sens02_Req_XIX_BMC_CAN01
        BMC_CMC_Zellspannung_02_XIX_HCP5_CANFD01_cba4cd94_Tx: DynamicLength=false, PduLength=64, SysTPduToFrameMappingRef=PTF_BMC_CMC_Zellspannung_02_XIX_HCP5_CANFD01
        CDD_DEV_BJB_Req_01_XIX_BMC_CAN01_3719e18f_Tx: PduLength=8, SysTPduToFrameMappingRef=PTF_DEV_BJB_Req_01_XIX_BMC_CAN01
        BMC_CMC_Zellspannung_03_XIX_HCP5_CANFD01_f2bbd46a_Tx: DynamicLength=false, PduLength=64
        OBDC_Funktionaler_Req_All_FD_XIX_HCP5_CANFD01_d0af7a5a_Rx: DynamicLength=false, PduLength=64, SysTPduToFrameMappingRef=PTF_OBDC_Funktionaler_Req_All_FD_XIX_HCP5_CANFD01
        SOK_Zeit_Hybrid_01_Resp_01_XIX_HCP5_CANFD01_c7a98a10_Rx: DynamicLength=false, PduLength=8
        DCM_HCP5_CANFD01_XIX_TPCHType_CANHS_OBDC_SSN_Diagnose_XIX_0x17FE71B1_XIX_0x17FC71B1_XIX_Physical_0eccbe0f_Tx: DynamicLength=true, PduLength=512
        ISO_Funktionaler_Req_All_XIX_BMC_CAN01_aaf5996b_Tx: DynamicLength=false, PduLength=8, SysTPduToFrameMappingRef=PTF_ISO_Funktionaler_Req_All_XIX_BMC_CAN01
        BMC_HV_03_XIX_HCP5_CANFD01_58321150_Tx: DynamicLength=false, PduLength=24, SysTPduToFrameMappingRef=PTF_BMC_HV_03_XIX_HCP5_CANFD01
        KN_Hybrid_01_XIX_HCP5_CANFD01_fef84477_Tx: DynamicLength=false, PduLength=16
        UI2_01_XIX_BMC_CAN01_E2E_04321bb6_Rx: DynamicLength=false, PduLength=8, SysTPduToFrameMappingRef=PTF_UI2_01_E2E_XIX_BMC_CAN01
        BMC_HV_12_XIX_BMC_CAN01_E2E_f1e87254_Tx: DynamicLength=false, PduLength=8, SysTPduToFrameMappingRef=PTF_BMC_HV_12_E2E_XIX_BMC_CAN01
        SOK_NoAuthenticTime_01_XIX_HCP5_CANFD01_a407ae2f_Rx: DynamicLength=false, PduLength=8
        UI2_03_XIX_BMC_CAN01_E2E_c452e633_Rx: DynamicLength=false, PduLength=8, SysTPduToFrameMappingRef=PTF_UI2_03_E2E_XIX_BMC_CAN01
        ORU_01_XIX_HCP5_CANFD01_8935a839_Rx: DynamicLength=false, PduLength=8
        UI2_02_XIX_BMC_CAN01_E2E_54e6a136_Rx: DynamicLength=false, PduLength=8
        BMC_HV_12_XIX_BMC_CAN01_E2E_5c19d7a0_Tx: DynamicLength=false, PduLength=8
        SOK_Zeit_Hybrid_01_Resp_01_SOK_XIX_HCP5_CANFD01_7ac24361_Rx: DynamicLength=false, PduLength=16, SysTPduToFrameMappingRef=PTF_SOK_Zeit_Hybrid_01_Resp_01_SOK_XIX_HCP5_CANFD01
        OBD_04_XIX_HCP5_CANFD01_100612ed_Rx: DynamicLength=false, PduLength=8
        UI2Sens02_CVN_XIX_BMC_CAN01_34f8df4e_Rx: DynamicLength=false, PduLength=8, SysTPduToFrameMappingRef=PTF_UI2Sens02_CVN_XIX_BMC_CAN01
        DCM_HCP5_CANFD01_XIX_TPCHType_CANHS_Flash_DIA_XIX_0x17FC16D0_XIX_0x17FE16D0_XIX_Physical_33952be0_Rx: DynamicLength=true, PduLength=512
        CDD_XCP_BJB_DTO_01_XIX_BMC_CAN01_382ede28_Rx: PduLength=8, SysTPduToFrameMappingRef=PTF_XCP_BJB_DTO_01_XIX_BMC_CAN01
        ELF_06_XIX_HCP5_CANFD01_21ac90a0_Rx: DynamicLength=false, PduLength=8, SysTPduToFrameMappingRef=PTF_ELF_06_XIX_HCP5_CANFD01
        UI2_03_XIX_BMC_CAN01_E2E_8304216e_Rx: DynamicLength=false, PduLength=8
        DAAP_Funkt_Req_MC_FD_XIX_HCP5_CANFD01_dbe988f8_Rx: DynamicLength=false, PduLength=8, SysTPduToFrameMappingRef=PTF_DAAP_Funkt_Req_MC_FD_XIX_HCP5_CANFD01
        DIA_UI2Sens01_Resp_XIX_BMC_CAN01_2ddec3aa_Rx: DynamicLength=false, PduLength=8, SysTPduToFrameMappingRef=PTF_DIA_UI2Sens01_Resp_XIX_BMC_CAN01
        BJB_08_XIX_BMC_CAN01_1db9ae10_Rx: DynamicLength=false, PduLength=8
        BMC_HV_08_SOK_XIX_HCP5_CANFD01_ac3f778d_Tx: DynamicLength=false, PduLength=48, SysTPduToFrameMappingRef=PTF_BMC_HV_08_SOK_XIX_HCP5_CANFD01
        DCM_HCP5_CANFD01_XIX_TPCHType_CANHS_Flash_DIA_XIX_0x17FC17B1_XIX_0x17FE17B1_XIX_Physical_38ee8255_Rx: DynamicLength=true, PduLength=512
        DCM_HCP5_CANFD01_XIX_TPCHType_CANFD_OBDC_Diagnose_XIX_0x1C410200_XIX_Functional_967cb818_Rx: DynamicLength=true, PduLength=62
        DCM_HCP5_CANFD01_XIX_TPCHType_CANHS_OBDC_SSN_Diagnose_XIX_0x17FE71B2_XIX_0x17FC71B2_XIX_Physical_02e58495_Tx: DynamicLength=true, PduLength=512
        HCP1_17_XIX_HCP5_CANFD01_3398d6b5_Rx: DynamicLength=false, PduLength=8
        UI1_Komponentenfehler_02_XIX_BMC_CAN01_19fb750e_Rx: DynamicLength=false, PduLength=8
        BMC_CMC_Temperatur_01_XIX_HCP5_CANFD01_13d55235_Tx: DynamicLength=false, PduLength=64
        DCM_HCP5_CANFD01_XIX_TPCHType_CANHS_OBDC_SSN_Diagnose_XIX_0x17FC71B1_XIX_0x17FE71B1_XIX_Physical_7a4726ef_Rx: DynamicLength=true, PduLength=512
        DS_Hybrid_01_XIX_HCP5_CANFD01_b3d0b839_Tx: DynamicLength=false, PduLength=8
        DCM_BMC_CAN01_XIX_TPCHType_CANHS_OBDC_SSN_Diagnose_XIX_0x17FC70D0_XIX_0x17FE70D0_XIX_Physical_50ea923c_Tx: DynamicLength=true, PduLength=512
        OBDC_SSN_UI2Sens01_Resp_XIX_HCP5_CANFD01_2773f712_Tx: DynamicLength=false, PduLength=8, SysTPduToFrameMappingRef=PTF_OBDC_SSN_UI2Sens01_Resp_XIX_HCP5_CANFD01
        DIA_UI2Sens01_Resp_XIX_HCP5_CANFD01_dfc9d8b9_Tx: DynamicLength=false, PduLength=8, SysTPduToFrameMappingRef=PTF_DIA_UI2Sens01_Resp_XIX_HCP5_CANFD01
        KS_Hybrid_01_Response_M_XIX_HCP5_CANFD01_78a6c4aa_Rx: DynamicLength=false, PduLength=12
        OBG_01_XIX_HCP5_CANFD01_6af9c66f_Rx: DynamicLength=false, PduLength=60, SysTPduToFrameMappingRef=PTF_OBG_01_XIX_HCP5_CANFD01
        NVEM_12_XIX_HCP5_CANFD01_00bae280_Rx: DynamicLength=false, PduLength=12
        ORU_Control_A_01_XIX_HCP5_CANFD01_E2E_893c1989_Rx: DynamicLength=false, PduLength=8, SysTPduToFrameMappingRef=PTF_ORU_Control_A_01_E2E_XIX_HCP5_CANFD01
        DCM_BMC_CAN01_XIX_TPCHType_CANHS_OBDC_SSN_Diagnose_XIX_0x17FE70D0_XIX_0x17FC70D0_XIX_Physical_f79c6d96_Rx: DynamicLength=true, PduLength=512
        DCM_HCP5_CANFD01_XIX_TPCHType_CANHS_OBDC_SSN_Diagnose_XIX_0x17FE71B2_XIX_0x17FC71B2_XIX_Physical_d7a5f0b8_Tx: DynamicLength=true, PduLength=512
        CDD_HCP5_CANFD01_XIX_TPCHType_CANFD_DAAP_XIX_0x1C413FDD_XIX_Functional_880c97f7_Rx: PduLength=7
        DS_Hybrid_01_XIX_HCP5_CANFD01_ed9ff9e4_Tx: DynamicLength=false, PduLength=8, SysTPduToFrameMappingRef=PTF_DS_Hybrid_01_XIX_HCP5_CANFD01
        DCM_BMC_CAN01_XIX_TPCHType_CANHS_Flash_DIA_XIX_0x17FE17B2_XIX_0x17FC17B2_XIX_Physical_030f104e_Rx: DynamicLength=true, PduLength=512
        ISOx_Hybrid_01_Req_FD_XIX_HCP5_CANFD01_5affd0fb_Rx: DynamicLength=false, PduLength=64, SysTPduToFrameMappingRef=PTF_ISOx_Hybrid_01_Req_FD_XIX_HCP5_CANFD01
        OBD_03_XIX_HCP5_CANFD01_2635ffad_Rx: DynamicLength=false, PduLength=8, SysTPduToFrameMappingRef=PTF_OBD_03_XIX_HCP5_CANFD01
        BMC_HV_09_SOK_XIX_HCP5_CANFD01_3e96b7e8_Tx: DynamicLength=false, PduLength=20
        BJB_10_XIX_BMC_CAN01_E2E_04bd7411_Rx: DynamicLength=false, PduLength=8, SysTPduToFrameMappingRef=PTF_BJB_10_E2E_XIX_BMC_CAN01
        UI2Sens02_CALID_01_XIX_BMC_CAN01_abd78ba8_Rx: DynamicLength=false, PduLength=8
        OBDC_SSN_UI2Sens02_Req_XIX_BMC_CAN01_7f5a32ec_Tx: DynamicLength=false, PduLength=8, SysTPduToFrameMappingRef=PTF_OBDC_SSN_UI2Sens02_Req_XIX_BMC_CAN01
        OBD_Hybrid_01_SOK_XIX_HCP5_CANFD01_86ce2f2e_Tx: DynamicLength=false, PduLength=6
        DAAP_Hybrid_01_Resp_FD_XIX_HCP5_CANFD01_a869e288_Tx: DynamicLength=false, PduLength=64, SysTPduToFrameMappingRef=PTF_DAAP_Hybrid_01_Resp_FD_XIX_HCP5_CANFD01
        DCM_HCP5_CANFD01_XIX_TPCHType_CANHS_OBDC_SSN_Diagnose_XIX_0x17FE70D0_XIX_0x17FC70D0_XIX_Physical_fbf361df_Tx: DynamicLength=true, PduLength=512
        DCM_HCP5_CANFD01_XIX_TPCHType_CANHS_OBDC_SSN_Diagnose_XIX_0x17FC70D0_XIX_0x17FE70D0_XIX_Physical_43a0bf70_Rx: DynamicLength=true, PduLength=512
        DCM_HCP5_CANFD01_XIX_TPCHType_CANHS_OBDC_SSN_Diagnose_XIX_0x17FC71B2_XIX_0x17FE71B2_XIX_Physical_6ff62e17_Rx: DynamicLength=true, PduLength=512
        DCDC_NV_CVN_XIX_HCP5_CANFD01_01267e2b_Rx: DynamicLength=false, PduLength=8, SysTPduToFrameMappingRef=PTF_DCDC_NV_CVN_XIX_HCP5_CANFD01
        DCM_HCP5_CANFD01_XIX_TPCHType_CANFD_OBDC_Diagnose_XIX_0x1C40027B_XIX_0x1C42027B_XIX_Physical_a0b6e66f_Rx: DynamicLength=true, PduLength=512
        HVLM_13_XIX_HCP5_CANFD01_f1be44f1_Rx: DynamicLength=false, PduLength=32
        DCM_BMC_CAN01_XIX_TPCHType_CANHS_OBDC_SSN_Diagnose_XIX_0x17FE71B1_XIX_0x17FC71B1_XIX_Physical_1d869343_Rx: DynamicLength=true, PduLength=512
        UI2_Komponentenfehler_01_XIX_BMC_CAN01_6d09fe13_Rx: DynamicLength=false, PduLength=8, SysTPduToFrameMappingRef=PTF_UI2_Komponentenfehler_01_XIX_BMC_CAN01
        UI2Sens01_CALID_02_XIX_BMC_CAN01_0ca022e6_Rx: DynamicLength=false, PduLength=8, SysTPduToFrameMappingRef=PTF_UI2Sens01_CALID_02_XIX_BMC_CAN01
        BMC_HV_01_E2E_SOK_XIX_HCP5_CANFD01_09a7f969_Tx: DynamicLength=false, PduLength=20, SysTPduToFrameMappingRef=PTF_BMC_HV_01_E2E_SOK_XIX_HCP5_CANFD01
        BMC_HV_11_XIX_BMC_CAN01_E2E_bc007233_Tx: DynamicLength=false, PduLength=8, SysTPduToFrameMappingRef=PTF_BMC_HV_11_E2E_XIX_BMC_CAN01
        OBD_HCP1_SOK_XIX_HCP5_CANFD01_499f5f1b_Rx: DynamicLength=false, PduLength=6
        DCM_HCP5_CANFD01_XIX_TPCHType_CANHS_Flash_DIA_XIX_0x17FE16D0_XIX_0x17FC16D0_XIX_Physical_aae5e090_Tx: DynamicLength=true, PduLength=512
        UI2Sens01_CVN_XIX_BMC_CAN01_fe6b52fc_Rx: DynamicLength=false, PduLength=8
        CDD_XCP_BJB_DTO_01_XIX_HCP5_CANFD01_884a4965_Tx: PduLength=8, SysTPduToFrameMappingRef=PTF_XCP_BJB_DTO_01_XIX_HCP5_CANFD01
        DCDC_NV_Komponentenfehler_04_XIX_HCP5_CANFD01_54dfe7dc_Rx: DynamicLength=false, PduLength=8, SysTPduToFrameMappingRef=PTF_DCDC_NV_Komponentenfehler_04_XIX_HCP5_CANFD01
        HVK_03_E2E_SOK_XIX_HCP5_CANFD01_17f9ff97_Rx: DynamicLength=false, PduLength=12, SysTPduToFrameMappingRef=PTF_HVK_03_E2E_SOK_XIX_HCP5_CANFD01
        UI1_Komponentenfehler_01_XIX_BMC_CAN01_08861f77_Rx: DynamicLength=false, PduLength=8
        DIA_UI2Sens01_Req_XIX_BMC_CAN01_47b20c58_Tx: DynamicLength=false, PduLength=8, SysTPduToFrameMappingRef=PTF_DIA_UI2Sens01_Req_XIX_BMC_CAN01
        Zeitmaster_05_XIX_HCP5_CANFD01_5eaa5a96_Rx: DynamicLength=false, PduLength=8
        BJB_11_XIX_BMC_CAN01_E2E_416796eb_Rx: DynamicLength=false, PduLength=8
        ORU_01_XIX_HCP5_CANFD01_81d7dd4c_Rx: DynamicLength=false, PduLength=8, SysTPduToFrameMappingRef=PTF_ORU_01_XIX_HCP5_CANFD01
        DCM_HCP5_CANFD01_XIX_TPCHType_CANFD_ISO_Diagnose_XIX_0x1C410000_XIX_Functional_905f44f1_Rx: DynamicLength=true, PduLength=62
        HVEM_07_XIX_HCP5_CANFD01_6bc428a9_Rx: DynamicLength=false, PduLength=32, SysTPduToFrameMappingRef=PTF_HVEM_07_XIX_HCP5_CANFD01
        ORU_Control_A_01_XIX_BMC_CAN01_e1a4f99a_Tx: DynamicLength=false, PduLength=8, SysTPduToFrameMappingRef=PTF_ORU_Control_A_01_XIX_BMC_CAN01
        VDSO_05_XIX_HCP5_CANFD01_f45d20ad_Rx: DynamicLength=false, PduLength=8, SysTPduToFrameMappingRef=PTF_VDSO_05_XIX_HCP5_CANFD01
        BMC_HV_08_XIX_HCP5_CANFD01_fbc0b232_Tx: DynamicLength=false, PduLength=44
        Systeminfo_01_XIX_BMC_CAN01_e1870ca9_Tx: DynamicLength=false, PduLength=8, SysTPduToFrameMappingRef=PTF_Systeminfo_01_XIX_BMC_CAN01
        OBD_Hybrid_01_XIX_HCP5_CANFD01_40f9dae5_Tx: DynamicLength=false, PduLength=2
        BMC_HV_09_XIX_HCP5_CANFD01_149204d3_Tx: DynamicLength=false, PduLength=16
        Charisma_20_XIX_HCP5_CANFD01_f51eced8_Rx: DynamicLength=false, PduLength=20
        BMC_HV_07_SOK_XIX_HCP5_CANFD01_f524cb68_Tx: DynamicLength=false, PduLength=12
        BMC_HV_09_SOK_XIX_HCP5_CANFD01_86174fef_Tx: DynamicLength=false, PduLength=20, SysTPduToFrameMappingRef=PTF_BMC_HV_09_SOK_XIX_HCP5_CANFD01
        CDD_DEV_BJB_Resp_FF_XIX_BMC_CAN01_19d429a9_Rx: PduLength=8, SysTPduToFrameMappingRef=PTF_DEV_BJB_Resp_FF_XIX_BMC_CAN01
        UI2Sens01_CVN_XIX_BMC_CAN01_7910df29_Rx: DynamicLength=false, PduLength=8, SysTPduToFrameMappingRef=PTF_UI2Sens01_CVN_XIX_BMC_CAN01
        KS_Hybrid_01_Challenge_M_XIX_HCP5_CANFD01_3e11d538_Rx: DynamicLength=false, PduLength=12
        VDSO_05_XIX_HCP5_CANFD01_48366f26_Rx: DynamicLength=false, PduLength=8
        BMC_HV_06_SOK_XIX_HCP5_CANFD01_e20cafa8_Tx: DynamicLength=false, PduLength=12
        DCM_HCP5_CANFD01_XIX_TPCHType_CANFD_ISO_Diagnose_XIX_0x1C410000_XIX_Functional_012ca6ee_Rx: DynamicLength=true, PduLength=62
        NmNode_BMC_HV_XIX_HCP5_CANFD01_c8c687b4_Rx: PduLength=24
        KS_Hybrid_01_Response_K_XIX_HCP5_CANFD01_76da782f_Tx: DynamicLength=false, PduLength=12
        DCM_BMC_CAN01_XIX_TPCHType_CANHS_OBDC_SSN_Diagnose_XIX_0x17FE70D0_XIX_0x17FC70D0_XIX_Physical_e8b94c93_Rx: DynamicLength=true, PduLength=512
        BMC_CMC_Zellspannung_04_XIX_HCP5_CANFD01_1395de0e_Tx: DynamicLength=false, PduLength=64
        DCM_BMC_CAN01_XIX_TPCHType_CANHS_OBDC_SSN_Diagnose_XIX_0x17FC71B2_XIX_0x17FE71B2_XIX_Physical_ff93e302_Tx: DynamicLength=true, PduLength=512
        BJB_13_XIX_BMC_CAN01_E2E_49557476_Rx: DynamicLength=false, PduLength=8, SysTPduToFrameMappingRef=PTF_BJB_13_E2E_XIX_BMC_CAN01
        WFS_02_XIX_HCP5_CANFD01_a0e8c21d_Rx: DynamicLength=false, PduLength=28, SysTPduToFrameMappingRef=PTF_WFS_02_XIX_HCP5_CANFD01
        UI2Sens01_CALID_01_XIX_BMC_CAN01_f3c92280_Rx: DynamicLength=false, PduLength=8
        CDD_HCP5_CANFD01_XIX_TPCHType_CANFD_DAAP_XIX_0x1C403F7B_XIX_0x1C423F7B_XIX_Physical_1330e22e_Rx: PduLength=512
        BMC_HV_05_XIX_HCP5_CANFD01_086b7dd9_Tx: DynamicLength=false, PduLength=8
        UI1_04_XIX_BMC_CAN01_f5320b92_Rx: DynamicLength=false, PduLength=8, SysTPduToFrameMappingRef=PTF_UI1_04_XIX_BMC_CAN01
        BMC_HV_06_XIX_HCP5_CANFD01_e2eda0bb_Tx: DynamicLength=false, PduLength=8
        DCM_BMC_CAN01_XIX_TPCHType_CANHS_Flash_DIA_XIX_0x17FE17B1_XIX_0x17FC17B1_XIX_Physical_8ad3bf71_Rx: DynamicLength=true, PduLength=512
        BMC_HV_14_SOK_XIX_HCP5_CANFD01_2d397b18_Tx: DynamicLength=false, PduLength=16, SysTPduToFrameMappingRef=PTF_BMC_HV_14_SOK_XIX_HCP5_CANFD01
        OBD_Hybrid_01_SOK_XIX_HCP5_CANFD01_c373a414_Tx: DynamicLength=false, PduLength=6, SysTPduToFrameMappingRef=PTF_OBD_Hybrid_01_SOK_XIX_HCP5_CANFD01
        UI2_04_XIX_BMC_CAN01_af5334f2_Rx: DynamicLength=false, PduLength=8, SysTPduToFrameMappingRef=PTF_UI2_04_XIX_BMC_CAN01
        UI2_Komponentenfehler_01_XIX_BMC_CAN01_6c666489_Rx: DynamicLength=false, PduLength=8
        DCM_HCP5_CANFD01_XIX_TPCHType_CANHS_Flash_DIA_XIX_0x17FC17B1_XIX_0x17FE17B1_XIX_Physical_849231ea_Rx: DynamicLength=true, PduLength=512
        DCM_HCP5_CANFD01_XIX_TPCHType_CANHS_Flash_DIA_XIX_0x17FE17B2_XIX_0x17FC17B2_XIX_Physical_fc309390_Tx: DynamicLength=true, PduLength=512
        BJB_10_XIX_BMC_CAN01_E2E_968516b3_Rx: DynamicLength=false, PduLength=8
        DCM_HCP5_CANFD01_XIX_TPCHType_CANHS_ISO_Diagnose_XIX_0x17FE007B_XIX_0x17FC007B_XIX_Physical_4cf2fba3_Tx: DynamicLength=true, PduLength=512
        DCM_HCP5_CANFD01_XIX_TPCHType_CANHS_OBDx_XIX_0x18DAF105_XIX_0x18DA05F1_XIX_Physical_71746075_Tx: DynamicLength=true, PduLength=512
        NM_Hybrid_01_XIX_HCP5_CANFD01_3f17aba9_Tx: DynamicLength=false, PduLength=24, SysTPduToFrameMappingRef=PTF_NM_Hybrid_01_XIX_HCP5_CANFD01
        OBDC_SSN_UI2Sens01_Resp_XIX_BMC_CAN01_327140fa_Rx: DynamicLength=false, PduLength=8, SysTPduToFrameMappingRef=PTF_OBDC_SSN_UI2Sens01_Resp_XIX_BMC_CAN01
        UI2_04_XIX_BMC_CAN01_33f018a3_Rx: DynamicLength=false, PduLength=8
        BMC_HV_06_SOK_XIX_HCP5_CANFD01_daff2390_Tx: DynamicLength=false, PduLength=12, SysTPduToFrameMappingRef=PTF_BMC_HV_06_SOK_XIX_HCP5_CANFD01
        PDUID_mBAP_ASG_01_0x601_Tx: PduLength=8
        PDUID_mBAP_Klima_01_0x638_Rx: PduLength=8
        Pdu_BAP_PduR2CanIf_Tx: PduLength=8
        Pdu_BAP_CanIf2PduR_Rx: PduLength=8
    EcucGeneral:
      CPUType = CPU32Bit
      SizeOfInt = Size32Bit
      ByteOrder = LITTLE_ENDIAN
      BitOrder = LSB_to_MSB
      AtomicBitAccessInBitfield = false
      AtomicVariableAccess = Atomic32BitAccess
      SizeOfEnum = Size32Bit
      SizeOfROMPointer = Size32Bit
      SizeOfRAMPointer = Size32Bit
      BitFieldDataType = INT
      StructAlignment = Auto
      ArrayAlignment = Auto
      StructInArrayAlignment = Auto
      DummyFunction = false
      DummyStatement = true
      DummyStatementKind = SelfAssignment
      ConditionalGenerating = true
      EcucBswImplementationCodeType = EcuCSourceCode
      EcuCUseStdReturnTypeForRte = false
      PostbuildLoadable: AlignmentFillPattern=170, PBROMStartAddress=0, PBRAMStartAddress=0, PBROMEndAddress=0, PBRAMEndAddress=0
      BswInitialization
        92 x InitFunction:
          BswM_InitMemory: Header=BswM.h, InitPhase=INIT_MEMORY, ModuleRef=BswM
          BswM_Init: Header=BswM.h, InitPhase=NO_INIT, ConfigType=BswM_ConfigType, ConfigPtrName=BswM_Config_Ptr, ConfigPtrClass=BSWM_INIT_DATA, ModuleRef=BswM
          CanIf_Init: Header=CanIf.h, InitPhase=INIT_TWO_IF, ConfigType=CanIf_ConfigType, ConfigPtrName=CanIf_Config_Ptr, ConfigPtrClass=CANIF_INIT_DATA, ModuleRef=CanIf
          CanIf_InitMemory: Header=CanIf.h, InitPhase=INIT_MEMORY, ModuleRef=CanIf
          CanNm_InitMemory: Header=CanNm.h, InitPhase=INIT_MEMORY, ModuleRef=CanNm
          CanNm_Init: Header=CanNm.h, InitPhase=INIT_TWO_NM, ConfigType=CanNm_ConfigType, ConfigPtrName=CanNm_Config_Ptr, ConfigPtrClass=CANNM_INIT_DATA, ModuleRef=CanNm
          CanSM_InitMemory: Header=CanSM_EcuM.h, InitPhase=INIT_MEMORY, ModuleRef=CanSM
          CanSM_Init: Header=CanSM_EcuM.h, InitPhase=INIT_TWO_SM, ConfigType=CanSM_ConfigType, ConfigPtrName=CanSM_Config_Ptr, ConfigPtrClass=CANSM_INIT_DATA, ModuleRef=CanSM
          CanTp_InitMemory: Header=CanTp.h, InitPhase=INIT_MEMORY, ModuleRef=CanTp
          CanTp_Init: Header=CanTp.h, InitPhase=INIT_TWO_TP, ConfigType=CanTp_ConfigType, ConfigPtrName=CanTp_Config_Ptr, ConfigPtrClass=CANTP_INIT_DATA, ModuleRef=CanTp
          ComM_Init: Header=ComM.h, InitPhase=INIT_TWO_POST_NVMREADALL, ConfigType=ComM_ConfigType, ConfigPtrName=ComM_Config_Ptr, ConfigPtrClass=COMM_INIT_DATA, ModuleRef=ComM  # /ActiveEcuC/ComM PLAIN_TEXT Init function description of ComM in UnfilteredViewInInvariantProject (UnfilteredInvariantProjectModelView) .
          ComM_InitMemory: Header=ComM.h, InitPhase=INIT_MEMORY, ModuleRef=ComM
          Com_InitMemory: Header=Com.h, InitPhase=INIT_MEMORY, ModuleRef=Com
          Com_Init: Header=Com.h, InitPhase=INIT_TWO_COM, ConfigType=Com_ConfigType, ConfigPtrName=Com_Config_Ptr, ConfigPtrClass=COM_INIT_DATA, ModuleRef=Com
          CryIf_Init: Header=CryIf.h, InitPhase=INIT_TWO_IF, ModuleRef=CryIf
          CryIf_InitMemory: Header=CryIf.h, InitPhase=INIT_MEMORY, ModuleRef=CryIf
          Crypto_30_LibCv_Init: Header=Crypto_30_LibCv.h, InitPhase=INIT_TWO_DRV, ModuleRef=Crypto
          Crypto_30_LibCv_InitMemory: Header=Crypto_30_LibCv.h, InitPhase=INIT_MEMORY, ModuleRef=Crypto
          Csm_Init: Header=Csm.h, InitPhase=INIT_TWO_SYS, ModuleRef=Csm
          Csm_InitMemory: Header=Csm.h, InitPhase=INIT_MEMORY, ModuleRef=Csm
          Dcm_Init: Header=Dcm.h, InitPhase=INIT_TWO_POST_NVMREADALL, ConfigType=Dcm_ConfigType, ConfigPtrName=NULL_PTR, ConfigPtrClass=DCM_CONST, ModuleRef=Dcm
          Dcm_InitMemory: Header=Dcm.h, InitPhase=INIT_MEMORY, ModuleRef=Dcm
          Dem_InitMemory: Header=Dem.h, InitPhase=INIT_MEMORY, ModuleRef=Dem
          Dem_PreInit: Header=Dem.h, InitPhase=INIT_ZERO, ConfigType=Dem_ConfigType, ConfigPtrName=Dem_Config_Ptr, ConfigPtrClass=DEM_INIT_DATA, ModuleRef=Dem
          Dem_Init: Header=Dem.h, InitPhase=INIT_TWO_POST_NVMREADALL, ConfigType=Dem_ConfigType, ConfigPtrName=Dem_Config_Ptr, ConfigPtrClass=DEM_INIT_DATA, ModuleRef=Dem
          Det_InitMemory: Header=Det.h, InitPhase=INIT_MEMORY, ModuleRef=Det
          Det_Init: Header=Det.h, InitPhase=INIT_ZERO, ConfigType=Det_ConfigType, ConfigPtrName=Det_Config_Ptr, ConfigPtrClass=DET_INIT_DATA, ModuleRef=Det
          E2EXf_InitMemory: Header=E2EXf.h, InitPhase=INIT_MEMORY, ModuleRef=E2EXf
          E2EXf_Init: Header=E2EXf.h, InitPhase=INIT_ONE, ConfigType=E2EXf_ConfigType, ConfigPtrName=NULL_PTR, ConfigPtrClass=E2EXF_PBCFG, ModuleRef=E2EXf  # /ActiveEcuC/E2EXf PLAIN_TEXT Automatically generated by EcuCBswInitFctConfigurationService.
          EcuM_Init: Header=EcuM.h, InitPhase=NO_INIT, ConfigType=EcuM_PbConfigType, ConfigPtrName=EcuM_Config_Ptr, ConfigPtrClass=ECUM_INIT_DATA, ModuleRef=EcuM
          Mcu_Init: Header=Mcu.h, InitPhase=INIT_ONE_EARLY, ConfigType=Mcu_ConfigType, ConfigPtrName=&Mcu_Config, ConfigPtrClass=AUTOMATIC, AdditionalInitCode=Mcu_InitClock(0);while (MCU_PLL_LOCKED != Mcu_GetPllStatus());Mcu_DistributePllClock();, ModuleRef=Mcu  # /Mcu/Mcu PLAIN_TEXT Created Mcu_Init by Extended Init XML Service
          Nm_InitMemory: Header=Nm.h, InitPhase=INIT_MEMORY, ModuleRef=Nm
          Nm_Init: Header=Nm.h, InitPhase=INIT_TWO_NM, ConfigType=Nm_ConfigType, ConfigPtrName=Nm_Config_Ptr, ConfigPtrClass=NM_INIT_DATA, ModuleRef=Nm  # /ActiveEcuC/Nm PLAIN_TEXT Init function description of Nm in UnfilteredViewInInvariantProject (UnfilteredInvariantProjectModelView) .
          PduR_InitMemory: Header=PduR.h, InitPhase=INIT_MEMORY, ModuleRef=PduR
          PduR_Init: Header=PduR.h, InitPhase=INIT_TWO_COM, ConfigType=PduR_PBConfigType, ConfigPtrName=PduR_Config_Ptr, ConfigPtrClass=PDUR_INIT_DATA, ModuleRef=PduR
          SchM_Init: Header=Rte_Main.h, InitPhase=NO_INIT, ModuleRef=Rte
          Rte_InitMemory: Header=Rte_Main.h, InitPhase=INIT_MEMORY, ModuleRef=Rte
          SecOC_Init: Header=SecOC.h, InitPhase=INIT_TWO_COM, ConfigType=SecOC_ConfigType, ConfigPtrName=SecOC_Config_Ptr, ConfigPtrClass=SECOC_INIT_DATA, ModuleRef=SecOC
          SecOC_InitMemory: Header=SecOC.h, InitPhase=INIT_MEMORY, ModuleRef=SecOC
          SomeIpXf_Init: Header=SomeIpXf.h, InitPhase=NO_INIT, ModuleRef=SomeIpXf
          Xcp_InitMemory: Header=Xcp.h, InitPhase=INIT_MEMORY, ModuleRef=Xcp
          Xcp_Init: Header=Xcp.h, InitPhase=INIT_TWO_TP, ModuleRef=Xcp
          CanXcp_InitMemory: Header=CanXcp.h, InitPhase=INIT_MEMORY, ModuleRef=Xcp
          CanXcp_Init: Header=CanXcp.h, InitPhase=INIT_TWO_TP, ConfigType=CanXcp_ConfigType, ConfigPtrName=NULL_PTR, ConfigPtrClass=CANXCP_CONST, ModuleRef=Xcp
          Brs_Init: Header=, InitPhase=NO_INIT, ModuleRef=vBRS  # /ActiveEcuC/vBRS PLAIN_TEXT Automatically generated by BswInitFctConfigurationService.
          Fee_Init: Header=Fee.h, InitPhase=INIT_ONE_LATE, ConfigType=Fee_ConfigType, ConfigPtrClass=AUTOMATIC, ConfigPtrName=&Fee_Config, ModuleRef=Fee  # /ActiveEcuC/Fee PLAIN_TEXT Created Fee_Init by Extended Init XML Service
          Port_Init: Header=Port.h, InitPhase=INIT_ONE_EARLY, ConfigType=Port_ConfigType, ConfigPtrName=&Port_Config, ConfigPtrClass=AUTOMATIC, ModuleRef=Port  # /Port/Port PLAIN_TEXT Created Port_Init by Extended Init XML Service
          Vita_Init: Header=, InitPhase=NO_INIT, ModuleRef=vItaSip
          NvM_Init: Header=NvM.h, InitPhase=INIT_TWO_SYS, ModuleRef=NvM
          Gpt_Init: Header=Gpt.h, InitPhase=INIT_ONE, ConfigType=Gpt_ConfigType, ConfigPtrName=&Gpt_Config, ConfigPtrClass=AUTOMATIC, ModuleRef=Gpt  # /ActiveEcuC/Gpt PLAIN_TEXT Created Gpt_Init by Extended Init XML Service
          Rtm_InitMemory: Header=Rtm.h, InitPhase=INIT_MEMORY, ModuleRef=Rtm
          Rtm_Init: Header=Rtm.h, InitPhase=INIT_TWO_POST_NVMREADALL, ModuleRef=Rtm  # /ActiveEcuC/Rtm PLAIN_TEXT Module Initialization function of module Rtm.
          Dbg_Init: Header=Dbg.h, InitPhase=INIT_TWO_SYS, ModuleRef=Dbg
          BswM_PreInit: Header=BswM.h, InitPhase=INIT_ONE, ConfigType=BswM_ConfigType, ConfigPtrName=BswM_Config_Ptr, ConfigPtrClass=BSWM_INIT_DATA, ModuleRef=BswM
          Rte_Start: Header=Rte_Main.h, InitPhase=INIT_THREE, ModuleRef=Rte
          Rte_StartTiming: Header=Rte_Main.h, InitPhase=NO_INIT, ModuleRef=Rte
          vItaSip_Init: Header=, InitPhase=NO_INIT, ModuleRef=vItaSip
          PduR_PreInit: Header=PduR.h, InitPhase=INIT_ONE, ConfigType=PduR_PBConfigType, ConfigPtrName=PduR_Config_Ptr, ConfigPtrClass=PDUR_INIT_DATA, ModuleRef=PduR
          vFotaH_InitMemory: Header=vFotaH.h, InitPhase=INIT_MEMORY, ModuleRef=vFotaH  # /ActiveEcuC/vFotaH PLAIN_TEXT InitMemory function description of vFotaH in UnfilteredViewInInvariantProject (UnfilteredInvariantProjectModelView) .
          vFotaH_Init: Header=vFotaH.h, InitPhase=INIT_TWO_POST_NVMREADALL, ConfigType=vFotaH_ConfigType, ConfigPtrName=vFotaH_Config_Ptr, ConfigPtrClass=VFOTAH_INIT_DATA, ModuleRef=vFotaH  # /ActiveEcuC/vFotaH PLAIN_TEXT Init function description of vFotaH in UnfilteredViewInInvariantProject (UnfilteredInvariantProjectModelView) .
          vMemAccM_Init: Header=vMemAccM.h, InitPhase=INIT_TWO_DRV, ModuleRef=vMemAccM  # /ActiveEcuC/vMemAccM PLAIN_TEXT Initializes the vMemAccM.
          vMemAccM_InitMemory: Header=vMemAccM.h, InitPhase=INIT_MEMORY, ModuleRef=vMemAccM  # /ActiveEcuC/vMemAccM PLAIN_TEXT Initializes all *_INIT_* section variables within the vMemAccM.
          SchM_Start: Header=Rte_Main.h, InitPhase=NO_INIT, ModuleRef=Rte  # /ActiveEcuC/Rte PLAIN_TEXT Automatically generated by EcuCBswInitFctConfigurationService.
          SchM_StartTiming: Header=Rte_Main.h, InitPhase=NO_INIT, ModuleRef=Rte  # /ActiveEcuC/Rte PLAIN_TEXT Automatically generated by EcuCBswInitFctConfigurationService.
          ComM_PostInit: Header=ComM.h, InitPhase=INIT_THREE, ModuleRef=ComM  # /ActiveEcuC/ComM PLAIN_TEXT Post-Initialization of the ComM and its internal state machine
          ComM_PreInit: Header=ComM.h, InitPhase=INIT_ONE, ConfigType=ComM_ConfigType, ConfigPtrName=ComM_Config_Ptr, ConfigPtrClass=COMM_INIT_DATA, ModuleRef=ComM  # /ActiveEcuC/ComM PLAIN_TEXT PreInit function description of ComM in UnfilteredViewInInvariantProject (UnfilteredInvariantProjectModelView) .
          Nm_PreInit: Header=Nm.h, InitPhase=INIT_ONE, ConfigType=Nm_ConfigType, ConfigPtrName=Nm_Config_Ptr, ConfigPtrClass=NM_INIT_DATA, ModuleRef=Nm  # /ActiveEcuC/Nm PLAIN_TEXT PreInit function description of Nm in UnfilteredViewInInvariantProject (UnfilteredInvariantProjectModelView) .
          Nm_PostInit: Header=Nm.h, InitPhase=INIT_THREE, ModuleRef=Nm  # /ActiveEcuC/Nm PLAIN_TEXT Post-Initialization of the Network Management and its internal state machine
          vSwUpdM_Init: Header=vSwUpdM.h, InitPhase=INIT_TWO_SYS, ConfigType=vSwUpdM_ConfigType, ConfigPtrClass=VSWUPDM_INIT_DATA, ConfigPtrName=vSwUpdM_Config_Ptr, ModuleRef=vSwUpdM  # /ActiveEcuC/vSwUpdM PLAIN_TEXT Init function description of vSwUpdM in UnfilteredViewInInvariantProject (UnfilteredInvariantProjectModelView) .
          vSwUpdM_InitMemory: Header=vSwUpdM.h, InitPhase=INIT_MEMORY, ModuleRef=vSwUpdM  # /ActiveEcuC/vSwUpdM PLAIN_TEXT InitMemory function description of vSwUpdM in UnfilteredViewInInvariantProject (UnfilteredInvariantProjectModelView) .
          vStreamProc_Init: Header=vStreamProc.h, InitPhase=INIT_ZERO, ConfigType=vStreamProc_ConfigType, ConfigPtrClass=VSTREAMPROC_INIT_DATA, ConfigPtrName=vStreamProc_Config_Ptr, ModuleRef=vStreamProc  # /ActiveEcuC/vStreamProc PLAIN_TEXT Init function description of vStreamProc in UnfilteredViewInInvariantProject (UnfilteredInvariantProjectModelView) .
          vStreamProc_InitMemory: Header=vStreamProc.h, InitPhase=INIT_MEMORY, ModuleRef=vStreamProc  # /ActiveEcuC/vStreamProc PLAIN_TEXT InitMemory function description of vStreamProc in UnfilteredViewInInvariantProject (UnfilteredInvariantProjectModelView) .
          EthTrcv_30_Ethmii_InitMemory: Header=EthTrcv_30_Ethmii.h, InitPhase=INIT_MEMORY, ModuleRef=EthTrcv  # /ActiveEcuC/EthTrcv PLAIN_TEXT Memory Initialization function of module EthTrcv_30_Ethmii.
          EthTrcv_30_Ethmii_Init: Header=EthTrcv_30_Ethmii.h, InitPhase=INIT_TWO_TRCV, ConfigType=EthTrcv_30_Ethmii_ConfigType, ConfigPtrClass=ETHTRCV_30_ETHMII_INIT_DATA, ConfigPtrName=EthTrcv_30_Ethmii_Config_Ptr, ModuleRef=EthTrcv  # /ActiveEcuC/EthTrcv PLAIN_TEXT Module Initialization function of module EthTrcv_30_Ethmii.
          Wdg_17_Scu_Init: Header=Wdg_17_Scu.h, InitPhase=INIT_ONE, ConfigType=Wdg_17_Scu_ConfigType, ConfigPtrClass=AUTOMATIC, ConfigPtrName=&Wdg_17_Scu_Config_0, ModuleRef=Wdg  # /ActiveEcuC/Wdg PLAIN_TEXT Created Wdg_17_Scu_Init by Extended Init XML Service
          vCan_30_Mcan_Init: Header=vCan_30_Mcan.h, InitPhase=INIT_ONE, ConfigType=vCan_30_Mcan_ConfigType, ConfigPtrClass=VCAN_30_MCAN_INIT_DATA, ConfigPtrName=vCan_30_Mcan_Config_Ptr, ModuleRef=vCan  # /ActiveEcuC/vCan PLAIN_TEXT Init function description of vCan_30_Mcan in UnfilteredViewInInvariantProject (UnfilteredInvariantProjectModelView) .
          vCan_30_Mcan_InitMemory: Header=vCan_30_Mcan.h, InitPhase=INIT_MEMORY, ModuleRef=vCan  # /ActiveEcuC/vCan PLAIN_TEXT InitMemory function description of vCan_30_Mcan in UnfilteredViewInInvariantProject (UnfilteredInvariantProjectModelView) .
          Can_30_Core_InitMemory: Header=Can_30_Core.h, InitPhase=INIT_MEMORY, ModuleRef=Can  # /ActiveEcuC/Can PLAIN_TEXT InitMemory function description of Can_30_Core in UnfilteredViewInInvariantProject (UnfilteredInvariantProjectModelView) .
          Can_30_Core_Init: Header=Can_30_Core.h, InitPhase=INIT_TWO_DRV, ConfigType=Can_30_Core_ConfigType, ConfigPtrClass=CAN_30_CORE_INIT_DATA, ConfigPtrName=Can_30_Core_Config_Ptr, ModuleRef=Can  # /ActiveEcuC/Can PLAIN_TEXT Init function description of Can_30_Core in UnfilteredViewInInvariantProject (UnfilteredInvariantProjectModelView) .
          vBaseEnv_Init: Header=, InitPhase=NO_INIT, ModuleRef=vBaseEnv  # /ActiveEcuC/vBaseEnv PLAIN_TEXT Created vBaseEnv_Init by Extended Init XML Service
          Fls_17_Dmu_Init: Header=Fls_17_Dmu.h, InitPhase=INIT_ONE, ConfigType=Fls_17_Dmu_ConfigType, ConfigPtrClass=AUTOMATIC, ConfigPtrName=&Fls_17_Dmu_Config, ModuleRef=Fls  # /ActiveEcuC/Fls PLAIN_TEXT Created Fls_17_Dmu_Init by Extended Init XML Service
          Irq_Init: Header=Irq.h, InitPhase=NO_INIT, ModuleRef=Irq  # /Irq/Irq PLAIN_TEXT Created Irq_Init by Extended Init XML Service
          McalLib_Init: Header=McalLib.h, InitPhase=NO_INIT, ModuleRef=McalLib  # /McalLib/McalLib PLAIN_TEXT Created McalLib_Init by Extended Init XML Service
          ResourceM_Init: Header=ResourceM.h, InitPhase=NO_INIT, ModuleRef=ResourceM  # /ResourceM/ResourceM PLAIN_TEXT Created ResourceM_Init by Extended Init XML Service
          vLinkGen_Init: Header=vLinkGen_Lcfg.h, InitPhase=NO_INIT, ModuleRef=vLinkGen  # /ActiveEcuC/vLinkGen PLAIN_TEXT Dummy initialization of the vLinkGen
          vFeeAcc_Init: Header=vFeeAcc.h, InitPhase=INIT_TWO_IF, ModuleRef=vFeeAcc  # /ActiveEcuC/vFeeAcc PLAIN_TEXT Initialization of vFeeAcc, to make it ready for usage
          NoInit: Header=noFile, InitPhase=NO_INIT, ModuleRef=vMem_30_Blocking  # /ActiveEcuC/vMem_30_Blocking PLAIN_TEXT vMem_30_Blocking does not have an Init function
          vMem_30_Tc3xxInf01_Init: Header=vMem_30_Tc3xxInf01.h, InitPhase=NO_INIT, ConfigType=vMem_30_Tc3xxInf01_ConfigType, ConfigPtrClass=VMEM_30_TC3XXINF01_INIT_DATA, ConfigPtrName=vMem_30_Tc3xxInf01_Config_Ptr, ModuleRef=vMem  # /ActiveEcuC/vMem PLAIN_TEXT Init function description of vMem_30_Tc3xxInf01 in UnfilteredViewInInvariantProject (UnfilteredInvariantProjectModelView) .
          Dio_Init: Header=Dio.h, InitPhase=NO_INIT, ModuleRef=Dio  # /ActiveEcuC/Dio PLAIN_TEXT Created Dio_Init by Extended Init XML Service
          CddNpmGen2_InitMemory: Header=CddNpmGen2.h, InitPhase=INIT_MEMORY, ModuleRef=CddNpmGen2  # /ActiveEcuC/CddNpmGen2 PLAIN_TEXT Pre-Initialization of CddNpmGen2
          CddNpmGen2_Init: Header=CddNpmGen2.h, InitPhase=INIT_TWO_POST_NVMREADALL, ModuleRef=CddNpmGen2  # /ActiveEcuC/CddNpmGen2 PLAIN_TEXT Initialization of CddNpmGen2
          ComXf_Init: Header=ComXf.h, InitPhase=NO_INIT, ModuleRef=ComXf  # /ActiveEcuC/ComXf PLAIN_TEXT Automatically generated by BswInitFctConfigurationService.
    EcucHardware
      EcucCoreDefinition_Core0 (EcucCoreDefinition): EcucCoreId=0
      EcucCoreDefinition_Core1 (EcucCoreDefinition): EcucCoreId=1
    EcucPartitionCollection
      EcucPartition_SystemApplication_Core0 (EcucPartition):
        EcucPartitionBswModuleExecution = false
        PartitionCanBeRestarted = false
        ASIL = QM
        EcucPartitionSoftwareComponentInstanceRef = Os_OsCore0_swc
        EcucPartitionSoftwareComponentInstanceRef = Det
      EcucPartition_SystemApplication_Core1 (EcucPartition): EcucPartitionBswModuleExecution=false, PartitionCanBeRestarted=false, ASIL=QM, EcucPartitionSoftwareComponentInstanceRef=Os_OsCore1_swc
