AUTOSAR XML (schema 00048)
package /ActiveEcuC
  module config StbM: implementation-config-variant=VARIANT-PRE-COMPILE, module-description=StbM_Impl
    StbMGeneral: StbMDevErrorDetect=true, StbMMainFunctionPeriod=0.01, StbMTimeRecordingSupport=false, StbMVersionInfoApi=true, StbMSafeBswChecks=false
    GlobalTimeDomain_2b08dc4b (StbMSynchronizedTimeBase): StbMIsSystemWideGlobalTimeMaster=true, StbMSynchronizedTimeBaseIdentifier=1
      StbMLocalTimeClock: StbMClockFrequency=2000, StbMClockPrescaler=1, StbMLocalTimeHardware=SystemTimer_Core0
    StbMSynchronizedTimeBase_CAN (StbMSynchronizedTimeBase): StbMIsSystemWideGlobalTimeMaster=false, StbMSynchronizedTimeBaseIdentifier=5
      StbMLocalTimeClock: StbMClockFrequency=2000, StbMClockPrescaler=1, StbMLocalTimeHardware=SystemTimer_Core0
