AUTOSAR XML (schema 4-3-0)
package /ActiveEcuC
  module config Nm: implementation-config-variant=VARIANT-PRE-COMPILE, module-description=Nm_Impl
    NmGlobalConfig
      NmGlobalFeatures:
        NmComControlEnabled = false
        NmComUserDataSupport = true
        NmNodeDetectionEnabled = false
        NmNodeIdEnabled = false
        NmPduRxIndicationEnabled = true
        NmRemoteSleepIndEnabled = false
        NmRepeatMsgIndEnabled = false
        NmStateChangeIndEnabled = true
        NmUserDataEnabled = true
        NmBusSynchronizationEnabled = false
        NmCarWakeUpRxEnabled = false
        NmCoordinatorSupportEnabled = false
        NmMacroLayerEnabled = false
        NmCoordinatorSyncSupport = false
        NmRuntimeMeasurementSupport = true
        NmCoordinatorRequestChannelsInBusSleep = false
        NmCoordinatorPassiveStartUpForwarding = false
        NmStateChangeIndCallback = BswM_Nm_StateChangeNotification
        NmCallbacksPrototypeHeader = BswM_Nm.h
      NmGeneration:
        NmOutOfBoundsWriteSanitizer = false
        NmOutOfBoundsReadSanitizer = false
        NmShortSymbols = false
        NmInterfacesForDeactivatedData = false
        NmReferringKeysInComments = false
      NmGlobalProperties: NmDevErrorDetect=true, NmVersionInfoApi=true, NmSafeBswChecks=false
      NmGlobalConstants
    CN_HCP5_CANFD01_54d90215 (NmChannelConfig):
      NmChannelSleepMaster = false
      NmSynchronizingNetwork = false
      NmChannelId = 1
      NmStateReportEnabled = false
      NmPassiveModeEnabled = false
      NmComMChannelRef = CN_HCP5_CANFD01_54d90215
      NmCluster_HCP5_CANFD01_da2f6b88 (NmBusType)
        NmStandardBusNmConfig: NmStandardBusType=NM_BUSNM_CANNM  # NmCluster_HCP5_CANFD01
    CN_BMC_CAN01_78a85e89 (NmChannelConfig):
      NmChannelSleepMaster = false
      NmSynchronizingNetwork = false
      NmChannelId = 0
      NmStateReportEnabled = false
      NmPassiveModeEnabled = false
      NmComMChannelRef = CN_BMC_CAN01_78a85e89
      NmCluster_BMC_CAN01_44a705e0 (NmBusType)
        NmStandardBusNmConfig: NmStandardBusType=NM_BUSNM_CANNM  # NmCluster_BMC_CAN01
