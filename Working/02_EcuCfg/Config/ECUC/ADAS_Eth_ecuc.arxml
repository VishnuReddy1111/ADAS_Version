AUTOSAR XML (schema 00048)
package /ActiveEcuC
  module config Eth: implementation-config-variant=VARIANT-PRE-COMPILE, module-description=Eth_Impl
    EthConfigSet
      BA_MyECU_0_EPC_d9b4790c (EthCtrlConfig):
        EthCtrlIdx = 0
        EthCtrlPhysAddr = AA:BB:CC:DD:00:0B
        EthCtrlEnableMii = true
        EthCtrlEnableRxInterrupt = true
        EthCtrlEnableTxInterrupt = true
        EthCtrlRxBufLenByte = 1522
        EthCtrlTxBufLenByte = 1522
        EthRxBufTotal = 2
        EthTxBufTotal = 20
        EthCtrlEnableMacWriteAccess = false
        EthCtrlEnableQoS = false
        EthCtrlEnablePtp = false
        EthCtrlEnableTrafficShaping = NO_TRAFFIC_SHAPING
        EthEnableAVBConformance = false
        EthCtrlMiiInterface = ETH_RGMII_MODE
        EthCtrlResetLoopMaxCycles = 1000
        EthCtrlMiiLoopMaxCycles = 1000
        EthCtrlLoopMaxCycles = 1000
        EthEthSwtMgmtHdrLen = 0
        EthCtrlEnableOsfMode = true
        EthCtrlCsrClkRange = CLK_250_300_MHZ
        EthCtrlPrtSpdSel = PS_100_MBITS
        EthCtrlSkewTx = 10
        EthCtrlSkewRx = 0
        EthCtrlEnableVlanIDBasedFramesQueuing = false
        EthCtrlRxProcessMaxFrames = 5
        EthCtrlTxProcessMaxFrames = 5
        EthCtrlEnablePpsEventOnTimeApi = false
        EthRuntimeEnvironment
          EthAutosarOs: EthRegBaseAddress=4026650624
        EthCtrlOffloading:
          EthCtrlEnableOffloadChecksumIPv4 = false
          EthCtrlEnableOffloadChecksumICMP = false
          EthCtrlEnableOffloadChecksumTCP = false
          EthCtrlEnableOffloadChecksumUDP = false
          EthCtrlEnableOffloadChecksumTCPv6 = false
          EthCtrlEnableOffloadChecksumICMPv6 = false
          EthCtrlEnableOffloadChecksumIPv6HeaderRouting = false
          EthCtrlEnableOffloadChecksumIPv6HeaderDestinationOptions = false
          EthCtrlEnableOffloadChecksumIPv6HeaderHopByHopOptions = false
          EthCtrlEnableOffloadChecksumUDPv6 = false
        EthRxBufConfig_1522 (EthRxBufConfig): EthRxSegmentNumber=2, EthRxSegmentSize=1522, EthRxMaxFrameSize=1522
        EthTxBufConfig_1522 (EthTxBufConfig): EthCtrlTxBufLenByte=1522, EthTxBufTotal=20
        EthInterruptMapping
          EthInterruptServiceRoutine_Q0Rx (EthInterruptServiceRoutine): EthPreIsrUserFunction=NULL_PTR, EthPostIsrUserFunction=NULL_PTR
            EthIrqEventList: EthIrqHandlerPos=0, EthIrqHandlerRef=IrqHdlrQ0Rx
          EthInterruptServiceRoutine_Q0Tx (EthInterruptServiceRoutine): EthPreIsrUserFunction=NULL_PTR, EthPostIsrUserFunction=NULL_PTR
            EthIrqEventList: EthIrqHandlerPos=0, EthIrqHandlerRef=IrqHdlrQ0Tx
          IrqHdlrQ0Rx (EthIrqEvent): EthIrqEventDescription=Ethernet Rx interrupt queue 0
          IrqHdlrQ0Tx (EthIrqEvent): EthIrqEventDescription=Ethernet Tx interrupt queue 0
        EthCtrlPinRouting:
          Eth_GPCTL_ALT0 = ETH_ALT_2
          Eth_GPCTL_ALT{1..10} = ETH_ALT_0
    EthGeneral:
      EthDevErrorDetect = true
      EthVersionInfoApi = true
      EthIndex = 0
      EthMaxCtrlsSupported = 1
      EthUpdatePhysAddrFilter = true
      EthEnableRxInterrupt = true
      EthEnableTxInterrupt = true
      EthOsIsrCategory = CATEGORY_2
      EthRuntimeMeasurementSupport = true
      EthEnableZeroCopyExtensions = false
      EthEnableHeaderAccessApi = false
      EthUsePeripheralAccessApi = false
      EthRuntimeEnvironment = ETH_AUTOSAR_OS
      EthSafeBswChecks = false
      EthMainFunctionPeriod = 0.02
      EthGetEtherStatsApi = false
      EthPreCtrlInitUserCallout = NULL_PTR
      EthPostCtrlInitUserCallout = NULL_PTR
      EthEnableExplicitBufferMapping = true
      EthGetAndResetMeasurementDataApi = true
