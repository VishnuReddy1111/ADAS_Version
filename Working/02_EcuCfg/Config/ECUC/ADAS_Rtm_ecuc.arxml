AUTOSAR XML (schema 4-3-0)
package /ActiveEcuC
  module config Rtm: implementation-config-variant=VARIANT-PRE-COMPILE, module-description=Rtm_Impl
    RtmGeneral:
      RtmDevErrorDetect = true
      RtmGetMeasurementTimestampFct = Rtm_GetTimeMeasurement
      RtmMeasurementCtrFrequency = 10000
      RtmCtrDirection = RTM_UP
      RtmMainfunctionCycleTime = 0.01
      RtmTimerOverrunSupport = false
      Rtm32BitTimer = true
      RtmUseNestingCounter = true
      RtmUsedCoreMask = 1
      RtmControl = false
      RtmSafeBswChecks = false
      RtmEcuName = Rtm
      RtmUserConfigFile = ..\01_Appl\Include\Rtm_Stub.h
    60 x RtmMeasurementPoint, all with RtmDisableInterrupts=false, RtmMeasurementType=GrossExecutionTime, RtmMeasurementPointType=Runtime, RtmTargetRuntime=0, RtmAssignedToCore=RtmCore0:
      CANNM_SID_GETUSERDATA: RtmAutostartEnabled=false, RtmMeasurementEnabled=false, RtmMeasurementId=5, RtmMeasurementGroup=CanNm
      CANNM_SID_GETPDUDATA: RtmAutostartEnabled=false, RtmMeasurementEnabled=false, RtmMeasurementId=3, RtmMeasurementGroup=CanNm
      CANNM_SID_INIT: RtmAutostartEnabled=false, RtmMeasurementEnabled=false, RtmMeasurementId=7, RtmMeasurementGroup=CanNm
      CANNM_SID_PASSIVESTARTUP: RtmAutostartEnabled=false, RtmMeasurementEnabled=false, RtmMeasurementId=11, RtmMeasurementGroup=CanNm
      CANNM_SID_GETSTATE: RtmAutostartEnabled=false, RtmMeasurementEnabled=false, RtmMeasurementId=4, RtmMeasurementGroup=CanNm
      CANNM_SID_MAINFUNCTION: RtmAutostartEnabled=false, RtmMeasurementEnabled=false, RtmMeasurementId=8, RtmMeasurementGroup=CanNm
      CANNM_SID_RXINDICATION: RtmAutostartEnabled=false, RtmMeasurementEnabled=false, RtmMeasurementId=12, RtmMeasurementGroup=CanNm
      CANNM_SID_NETWORKREQUEST: RtmAutostartEnabled=false, RtmMeasurementEnabled=false, RtmMeasurementId=10, RtmMeasurementGroup=CanNm
      CANNM_SID_NETWORKRELEASE: RtmAutostartEnabled=false, RtmMeasurementEnabled=false, RtmMeasurementId=9, RtmMeasurementGroup=CanNm
      CANNM_SID_TRANSMIT: RtmAutostartEnabled=false, RtmMeasurementEnabled=false, RtmMeasurementId=13, RtmMeasurementGroup=CanNm
      Eth_ControllerInit: RtmAutostartEnabled=false, RtmMeasurementEnabled=false, RtmMeasurementId=28, RtmMeasurementGroup=Eth
      EthTrcv_30_Canoeemu_TransceiverInit: RtmAutostartEnabled=false, RtmMeasurementEnabled=false, RtmMeasurementId=25, RtmMeasurementGroup=EthTrcv_30_Canoeemu
      Lin_Init: RtmAutostartEnabled=true, RtmMeasurementEnabled=false, RtmMeasurementId=31, RtmMeasurementGroup=LIN  # LIN PLAIN_TEXT Automatically generated by RtmMeasurePointConfigurationService.
      Lin_Interrupt: RtmAutostartEnabled=false, RtmMeasurementEnabled=true, RtmMeasurementId=32, RtmMeasurementGroup=LIN
      LinIf_Init: RtmAutostartEnabled=false, RtmMeasurementEnabled=false, RtmMeasurementId=29, RtmMeasurementGroup=LinIf
      LinTp_Init: RtmAutostartEnabled=false, RtmMeasurementEnabled=false, RtmMeasurementId=30, RtmMeasurementGroup=LinTp
      NM_SID_STATECHANGENOTIFICATION: RtmAutostartEnabled=false, RtmMeasurementEnabled=false, RtmMeasurementId=47, RtmMeasurementGroup=Nm
      NM_SID_PASSIVESTARTUP: RtmAutostartEnabled=false, RtmMeasurementEnabled=false, RtmMeasurementId=44, RtmMeasurementGroup=Nm
      NM_SID_GETSTATE: RtmAutostartEnabled=false, RtmMeasurementEnabled=false, RtmMeasurementId=35, RtmMeasurementGroup=Nm
      NM_SID_MAINFUNCTION: RtmAutostartEnabled=false, RtmMeasurementEnabled=false, RtmMeasurementId=39, RtmMeasurementGroup=Nm
      NM_SID_NETWORKSTARTINDICATION: RtmAutostartEnabled=false, RtmMeasurementEnabled=false, RtmMeasurementId=43, RtmMeasurementGroup=Nm
      NM_SID_NETWORKMODE: RtmAutostartEnabled=false, RtmMeasurementEnabled=false, RtmMeasurementId=40, RtmMeasurementGroup=Nm
      NM_SID_BUSSLEEPMODE: RtmAutostartEnabled=false, RtmMeasurementEnabled=false, RtmMeasurementId=33, RtmMeasurementGroup=Nm
      NM_SID_PREPAREBUSSLEEPMODE: RtmAutostartEnabled=false, RtmMeasurementEnabled=false, RtmMeasurementId=46, RtmMeasurementGroup=Nm
      NM_SID_GETUSERDATA: RtmAutostartEnabled=false, RtmMeasurementEnabled=false, RtmMeasurementId=36, RtmMeasurementGroup=Nm
      NM_SID_GETPDUDATA: RtmAutostartEnabled=false, RtmMeasurementEnabled=false, RtmMeasurementId=34, RtmMeasurementGroup=Nm
      NM_SID_NETWORKREQUEST: RtmAutostartEnabled=false, RtmMeasurementEnabled=false, RtmMeasurementId=42, RtmMeasurementGroup=Nm
      NM_SID_NETWORKRELEASE: RtmAutostartEnabled=false, RtmMeasurementEnabled=false, RtmMeasurementId=41, RtmMeasurementGroup=Nm
      NM_SID_TXTIMEOUTEXCEPTION: RtmAutostartEnabled=false, RtmMeasurementEnabled=false, RtmMeasurementId=48, RtmMeasurementGroup=Nm
      Xcp_MainFunction: RtmAutostartEnabled=false, RtmMeasurementEnabled=false, RtmMeasurementId=74, RtmMeasurementGroup=Xcp
      Xcp_Event: RtmAutostartEnabled=false, RtmMeasurementEnabled=false, RtmMeasurementId=72, RtmMeasurementGroup=Xcp
      Xcp_TlRxIndication: RtmAutostartEnabled=false, RtmMeasurementEnabled=false, RtmMeasurementId=75, RtmMeasurementGroup=Xcp
      Xcp_TlTxConfirmation: RtmAutostartEnabled=false, RtmMeasurementEnabled=false, RtmMeasurementId=76, RtmMeasurementGroup=Xcp
      Xcp_Init: RtmAutostartEnabled=true, RtmMeasurementEnabled=false, RtmMeasurementId=73, RtmMeasurementGroup=Xcp
      NM_SID_INIT: RtmAutostartEnabled=false, RtmMeasurementEnabled=true, RtmMeasurementId=38, RtmMeasurementGroup=Nm
      CANNM_SID_GETVERSIONINFO: RtmAutostartEnabled=false, RtmMeasurementEnabled=true, RtmMeasurementId=6, RtmMeasurementGroup=CanNm
      NM_SID_GETVERSIONINFO: RtmAutostartEnabled=false, RtmMeasurementEnabled=true, RtmMeasurementId=37, RtmMeasurementGroup=Nm
      UDPNM_SID_INIT: RtmAutostartEnabled=false, RtmMeasurementEnabled=true, RtmMeasurementId=63, RtmMeasurementGroup=UdpNm
      UDPNM_SID_PASSIVESTARTUP: RtmAutostartEnabled=false, RtmMeasurementEnabled=true, RtmMeasurementId=67, RtmMeasurementGroup=UdpNm
      UDPNM_SID_GETSTATE: RtmAutostartEnabled=false, RtmMeasurementEnabled=true, RtmMeasurementId=60, RtmMeasurementGroup=UdpNm
      UDPNM_SID_MAINFUNCTION: RtmAutostartEnabled=false, RtmMeasurementEnabled=true, RtmMeasurementId=64, RtmMeasurementGroup=UdpNm
      UDPNM_SID_RXINDICATION: RtmAutostartEnabled=false, RtmMeasurementEnabled=true, RtmMeasurementId=68, RtmMeasurementGroup=UdpNm
      UDPNM_SID_GETNODEIDENTIFIER: RtmAutostartEnabled=false, RtmMeasurementEnabled=true, RtmMeasurementId=58, RtmMeasurementGroup=UdpNm
      UDPNM_SID_GETLOCALNODEIDENTIFIER: RtmAutostartEnabled=false, RtmMeasurementEnabled=true, RtmMeasurementId=57, RtmMeasurementGroup=UdpNm
      UDPNM_SID_TRIGGERTRANSMIT: RtmAutostartEnabled=false, RtmMeasurementEnabled=true, RtmMeasurementId=70, RtmMeasurementGroup=UdpNm
      UDPNM_SID_GETUSERDATA: RtmAutostartEnabled=false, RtmMeasurementEnabled=true, RtmMeasurementId=61, RtmMeasurementGroup=UdpNm
      UDPNM_SID_TRANSMIT: RtmAutostartEnabled=false, RtmMeasurementEnabled=true, RtmMeasurementId=69, RtmMeasurementGroup=UdpNm
      UDPNM_SID_ENABLECOMMUNICATION: RtmAutostartEnabled=false, RtmMeasurementEnabled=true, RtmMeasurementId=56, RtmMeasurementGroup=UdpNm
      UDPNM_SID_DISABLECOMMUNICATION: RtmAutostartEnabled=false, RtmMeasurementEnabled=true, RtmMeasurementId=55, RtmMeasurementGroup=UdpNm
      UDPNM_SID_GETVERSIONINFO: RtmAutostartEnabled=false, RtmMeasurementEnabled=true, RtmMeasurementId=62, RtmMeasurementGroup=UdpNm
      UDPNM_SID_TXCONFIRMATION: RtmAutostartEnabled=false, RtmMeasurementEnabled=true, RtmMeasurementId=71, RtmMeasurementGroup=UdpNm
      UDPNM_SID_NETWORKREQUEST: RtmAutostartEnabled=false, RtmMeasurementEnabled=true, RtmMeasurementId=66, RtmMeasurementGroup=UdpNm
      UDPNM_SID_NETWORKRELEASE: RtmAutostartEnabled=false, RtmMeasurementEnabled=true, RtmMeasurementId=65, RtmMeasurementGroup=UdpNm
      UDPNM_SID_GETPDUDATA: RtmAutostartEnabled=false, RtmMeasurementEnabled=true, RtmMeasurementId=59, RtmMeasurementGroup=UdpNm
      Sd_State_HandleRunMode: RtmAutostartEnabled=false, RtmMeasurementEnabled=true, RtmMeasurementId=51, RtmMeasurementGroup=Sd  # Sd PLAIN_TEXT Sd_State_HandleRunMode() is measured.
      Sd_EventServer_Process: RtmAutostartEnabled=false, RtmMeasurementEnabled=true, RtmMeasurementId=49, RtmMeasurementGroup=Sd  # Sd PLAIN_TEXT Sd_EventServer_Process() is measured.
      Sd_State_Process__ServerSMs: RtmAutostartEnabled=false, RtmMeasurementEnabled=true, RtmMeasurementId=53, RtmMeasurementGroup=Sd  # Sd PLAIN_TEXT Sd_State_Process() for ServerService State Machines is measured.
      Sd_State_Process__ClientSMs: RtmAutostartEnabled=false, RtmMeasurementEnabled=true, RtmMeasurementId=52, RtmMeasurementGroup=Sd  # Sd PLAIN_TEXT Sd_State_Process() for ClientService State Machines is measured.
      Sd_Tx_ProcessPendingMessages: RtmAutostartEnabled=false, RtmMeasurementEnabled=true, RtmMeasurementId=54, RtmMeasurementGroup=Sd  # Sd PLAIN_TEXT Sd_Tx_ProcessPendingMessages() is measured.
      Sd_RxIndication: RtmAutostartEnabled=false, RtmMeasurementEnabled=true, RtmMeasurementId=50, RtmMeasurementGroup=Sd  # Sd PLAIN_TEXT Sd_RxIndication() is measured.
    RtmCore0 (RtmCoreDefinition): RtmCoreDefinitionId=0, RtmBSWCore=true, RtmCore=0
    20 x RtmMeasurementPoint, all with RtmAutostartEnabled=false, RtmMeasurementEnabled=true, RtmDisableInterrupts=false, RtmMeasurementType=GrossExecutionTime, RtmMeasurementPointType=Runtime, RtmTargetRuntime=0, RtmAssignedToCore=RtmCore0:
      Eth_30_Tc3xx_ControllerInit: RtmMeasurementId=27, RtmMeasurementGroup=Eth_30_Tc3xx  # Eth_30_Tc3xx PLAIN_TEXT Measurement point for the Eth_30_Tc3xx_ControllerInit function.
      Can_30_Core_Init: RtmMeasurementId=19, RtmMeasurementGroup=Can_30_Core  # Can_30_Core PLAIN_TEXT global initialization of the CAN module
      Can_30_Core_SetControllerMode: RtmMeasurementId=20, RtmMeasurementGroup=Can_30_Core  # Can_30_Core PLAIN_TEXT change hardware mode of the CAN controller
      Can_30_Core_Write: RtmMeasurementId=21, RtmMeasurementGroup=Can_30_Core  # Can_30_Core PLAIN_TEXT send CAN message
      EthTrcv_30_Ethmii_TransceiverInit: RtmMeasurementId=26, RtmMeasurementGroup=EthTrcv_30_Ethmii  # EthTrcv_30_Ethmii PLAIN_TEXT Measurement point for the EthTrcv_30_Ethmii_TransceiverInit function.
      vCan_30_Mcan_InterruptRx: RtmMeasurementId=78, RtmMeasurementGroup=vCan_30_Mcan  # vCan_30_Mcan PLAIN_TEXT RX interrupt handler
      vCan_30_Mcan_InterruptTx: RtmMeasurementId=79, RtmMeasurementGroup=vCan_30_Mcan  # vCan_30_Mcan PLAIN_TEXT TX interrupt handler
      vCan_30_Mcan_InterruptBusoff: RtmMeasurementId=77, RtmMeasurementGroup=vCan_30_Mcan  # vCan_30_Mcan PLAIN_TEXT Busoff interrupt handler
      Can_Init: RtmMeasurementId=22, RtmMeasurementGroup=Can  # Can PLAIN_TEXT global initialization of the CAN module
      Can_SetControllerMode: RtmMeasurementId=23, RtmMeasurementGroup=Can  # Can PLAIN_TEXT change hardware mode of the CAN controller
      Can_Write: RtmMeasurementId=24, RtmMeasurementGroup=Can  # Can PLAIN_TEXT send CAN message
      CanInterruptTx: RtmMeasurementId=17, RtmMeasurementGroup=Can  # Can PLAIN_TEXT transmit interrupt service routine
      CanInterruptRx: RtmMeasurementId=16, RtmMeasurementGroup=Can  # Can PLAIN_TEXT receive interrupt service routine
      CanInterruptWakeup: RtmMeasurementId=18, RtmMeasurementGroup=Can  # Can PLAIN_TEXT wakeup interrupt service routine
      CanInterruptErr: RtmMeasurementId=15, RtmMeasurementGroup=Can  # Can PLAIN_TEXT error/busoff interrupt service routine
      CANNM_SID_CONFIRMPNAVAILABILITY: RtmMeasurementId=2, RtmMeasurementGroup=CanNm  # CanNm PLAIN_TEXT Measurement point that measures the CanNm_ConfirmPnAvailability function
      NM_SID_PDURXINDICATION: RtmMeasurementId=45, RtmMeasurementGroup=Nm  # Nm PLAIN_TEXT Measurement point that measures the Nm_PduRxIndication function
      CANNM_SID_TXCONFIRMATION: RtmMeasurementId=14, RtmMeasurementGroup=CanNm  # CanNm PLAIN_TEXT Measurement point that measures the CanNm_TxConfirmation function
      CANNM_SID_ENABLECOMMUNICATION: RtmMeasurementId=0, RtmMeasurementGroup=CanNm  # CanNm PLAIN_TEXT Measurement point that measures the CanNm_EnableCommunication function
      CANNM_SID_DISABLECOMMUNICATION: RtmMeasurementId=0, RtmMeasurementGroup=CanNm  # CanNm PLAIN_TEXT Measurement point that measures the CanNm_DisableCommunication function
