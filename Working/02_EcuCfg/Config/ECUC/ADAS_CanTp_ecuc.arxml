AUTOSAR XML (schema 4-3-0)
package /ActiveEcuC
  module config CanTp: implementation-config-variant=VARIANT-PRE-COMPILE, module-description=CanTp_Impl
    CanTpGeneral:
      CanTpChangeParameterApi = false
      CanTpDevErrorDetect = true
      CanTpPaddingByte = 204
      CanTpReadParameterApi = false
      CanTpVersionInfoApi = false
      CanTpPaddingActive = true
      CanTpHavePaddingByte = false
      CanTpNumRxChannels = 0
      CanTpNumTxChannels = 0
      CanTpEnableSplitMainFunction = true
      CanTpSupportStandardAddressing = true
      CanTpSupportExtendedAddressing = true
      CanTpSupportMixed11Addressing = true
      CanTpSupportMixed29Addressing = true
      CanTpSupportNormalFixedAddressing = true
      CanTpSupportCustomAddressing = false
      CanTpOnlyNotifyInformedAppl = true
      CanTpRc = false
      CanTpTc = true
      CanTpSafeBswChecks = false
      CanTpEnableConstantBS = false
      CanTpEnableTransmitQueue = false
      CanTpUseOnlyFirstFc = true
      CanTpEnableSynchronousTransmit = true
      CanTpFlexibleDataRateSupport = true
    CanTpConfig: CanTpMainFunctionPeriod=0.01
      9 x CanTpChannel, all with CanTpChannelMode=CANTP_MODE_HALF_DUPLEX:
        TPC_HCP5_CANFD01_XIX_TPCHType_CANHS_ISO_Diagnose_XIX_0x17FC007B_XIX_0x17FE007B_XIX_Physical_f6febf9e
          CanTpRxNSdu_03261030 (CanTpRxNSdu):
            CanTpBs = 15
            CanTpNar = 1
            CanTpNbr = 0.1
            CanTpNcr = 1
            CanTpRxAddressingFormat = CANTP_STANDARD
            CanTpRxDl = 8
            CanTpRxPaddingActivation = CANTP_ON
            CanTpRxTaType = CANTP_PHYSICAL
            CanTpRxWftMax = 15
            CanTpSTmin = 0.005
            CanTpRxNSduId = 6
            CanTpRxNSduRef = DCM_HCP5_CANFD01_XIX_TPCHType_CANHS_ISO_Diagnose_XIX_0x17FC007B_XIX_0x17FE007B_XIX_Physical_fb6bd0a7_Rx
            CanTpRxNPdu_a2b7f63b (CanTpRxNPdu): CanTpRxNPduId=2, CanTpRxNPduRef=ISOx_Hybrid_01_Req_XIX_HCP5_CANFD01_bd99bbef_Rx
            CanTpTxFcNPdu_a2b7f63b (CanTpTxFcNPdu): CanTpTxFcNPduConfirmationPduId=2, CanTpTxFcNPduRef=ISOx_Hybrid_01_Resp_XIX_HCP5_CANFD01_46a576a1_Tx
          CanTpTxNSdu_03261030 (CanTpTxNSdu):
            CanTpNas = 1
            CanTpNbs = 1
            CanTpNcs = 0.2
            CanTpTxAddressingFormat = CANTP_STANDARD
            CanTpTxDl = 8
            CanTpTxPaddingActivation = CANTP_ON
            CanTpTxTaType = CANTP_PHYSICAL
            CanTpTc = false
            CanTpTxNSduId = 4
            CanTpTxNSduRef = DCM_HCP5_CANFD01_XIX_TPCHType_CANHS_ISO_Diagnose_XIX_0x17FE007B_XIX_0x17FC007B_XIX_Physical_621b1bd7_Tx
            CanTpTxNPdu_804d22c9 (CanTpTxNPdu): CanTpTxNPduConfirmationPduId=2, CanTpTxNPduRef=ISOx_Hybrid_01_Resp_XIX_HCP5_CANFD01_46a576a1_Tx
            CanTpRxFcNPdu_804d22c9 (CanTpRxFcNPdu): CanTpRxFcNPduId=2, CanTpRxFcNPduRef=ISOx_Hybrid_01_Req_XIX_HCP5_CANFD01_bd99bbef_Rx
        TPC_HCP5_CANFD01_XIX_TPCHType_CANFD_OBDC_Diagnose_XIX_0x1C410200_XIX_Functional_91dfb76e
          CanTpRxNSdu_b2b9f46c (CanTpRxNSdu):
            CanTpNbr = 0.1
            CanTpRxAddressingFormat = CANTP_STANDARD
            CanTpRxDl = 64
            CanTpRxPaddingActivation = CANTP_ON
            CanTpRxTaType = CANTP_CANFD_FUNCTIONAL
            CanTpRxNSduId = 5
            CanTpRxNSduRef = DCM_HCP5_CANFD01_XIX_TPCHType_CANFD_OBDC_Diagnose_XIX_0x1C410200_XIX_Functional_c81dd985_Rx
            CanTpRxNPdu_39dd35ba (CanTpRxNPdu): CanTpRxNPduId=7, CanTpRxNPduRef=OBDC_Funktionaler_Req_All_FD_XIX_HCP5_CANFD01_d0af7a5a_Rx
        TPC_HCP5_CANFD01_XIX_TPCHType_CANHS_OBDx_XIX_0x18DA05F1_XIX_0x18DAF105_XIX_Physical_5f70b7ea
          CanTpTxNSdu_dd731bf6 (CanTpTxNSdu):
            CanTpNas = 0.025
            CanTpNbs = 0.075
            CanTpNcs = 0.025
            CanTpTxAddressingFormat = CANTP_STANDARD
            CanTpTxDl = 8
            CanTpTxPaddingActivation = CANTP_ON
            CanTpTxTaType = CANTP_PHYSICAL
            CanTpTc = false
            CanTpTxNSduId = 5
            CanTpTxNSduRef = DCM_HCP5_CANFD01_XIX_TPCHType_CANHS_OBDx_XIX_0x18DAF105_XIX_0x18DA05F1_XIX_Physical_71746075_Tx
            CanTpTxNPdu_2f5c2cf1 (CanTpTxNPdu): CanTpTxNPduConfirmationPduId=4, CanTpTxNPduRef=OBDx_Hybrid_01_Resp_XIX_HCP5_CANFD01_a027092e_Tx
            CanTpRxFcNPdu_2f5c2cf1 (CanTpRxFcNPdu): CanTpRxFcNPduId=4, CanTpRxFcNPduRef=OBDx_Hybrid_01_Req_XIX_HCP5_CANFD01_5cba35a0_Rx
          CanTpRxNSdu_dd731bf6 (CanTpRxNSdu):
            CanTpBs = 15
            CanTpNar = 0.025
            CanTpNbr = 0.001
            CanTpNcr = 0.15
            CanTpRxAddressingFormat = CANTP_STANDARD
            CanTpRxDl = 8
            CanTpRxPaddingActivation = CANTP_ON
            CanTpRxTaType = CANTP_PHYSICAL
            CanTpRxWftMax = 0
            CanTpSTmin = 0.005
            CanTpRxNSduId = 7
            CanTpRxNSduRef = DCM_HCP5_CANFD01_XIX_TPCHType_CANHS_OBDx_XIX_0x18DA05F1_XIX_0x18DAF105_XIX_Physical_31397855_Rx
            CanTpRxNPdu_0da6f803 (CanTpRxNPdu): CanTpRxNPduId=4, CanTpRxNPduRef=OBDx_Hybrid_01_Req_XIX_HCP5_CANFD01_5cba35a0_Rx
            CanTpTxFcNPdu_0da6f803 (CanTpTxFcNPdu): CanTpTxFcNPduConfirmationPduId=4, CanTpTxFcNPduRef=OBDx_Hybrid_01_Resp_XIX_HCP5_CANFD01_a027092e_Tx
        TPC_BMC_CAN01_XIX_TPCHType_CANHS_OBDC_Diagnose_XIX_0x17FD0200_XIX_Functional_4adb040a
          CanTpTxNSdu_44dfe4f4 (CanTpTxNSdu):
            CanTpNas = 1
            CanTpNcs = 0.2
            CanTpTxAddressingFormat = CANTP_STANDARD
            CanTpTxDl = 8
            CanTpTxPaddingActivation = CANTP_ON
            CanTpTxTaType = CANTP_FUNCTIONAL
            CanTpTc = false
            CanTpTxNSduId = 0
            CanTpTxNSduRef = DCM_BMC_CAN01_XIX_TPCHType_CANHS_OBDC_Diagnose_XIX_0x17FD0200_XIX_Functional_e9b636f2_Tx
            CanTpTxNPdu_f9e9d1a6 (CanTpTxNPdu): CanTpTxNPduConfirmationPduId=5, CanTpTxNPduRef=OBDC_Funktionaler_Req_All_XIX_BMC_CAN01_c40642be_Tx
        TPC_HCP5_CANFD01_XIX_TPCHType_CANFD_DAAP_XIX_0x1C403F7B_XIX_0x1C423F7B_XIX_Physical_749702d9
          CanTpRxNSdu_6f740f5b (CanTpRxNSdu):
            CanTpBs = 15
            CanTpNar = 1
            CanTpNbr = 0.1
            CanTpNcr = 1
            CanTpRxAddressingFormat = CANTP_STANDARD
            CanTpRxDl = 64
            CanTpRxPaddingActivation = CANTP_ON
            CanTpRxTaType = CANTP_CANFD_PHYSICAL
            CanTpRxWftMax = 15
            CanTpSTmin = 0.005
            CanTpRxNSduId = 0
            CanTpRxNSduRef = CDD_HCP5_CANFD01_XIX_TPCHType_CANFD_DAAP_XIX_0x1C403F7B_XIX_0x1C423F7B_XIX_Physical_1330e22e_Rx
            CanTpTxFcNPdu_4cda0177 (CanTpTxFcNPdu): CanTpTxFcNPduConfirmationPduId=0, CanTpTxFcNPduRef=DAAP_Hybrid_01_Resp_FD_XIX_HCP5_CANFD01_a869e288_Tx
            CanTpRxNPdu_4cda0177 (CanTpRxNPdu): CanTpRxNPduId=0, CanTpRxNPduRef=DAAP_Hybrid_01_Req_FD_XIX_HCP5_CANFD01_25e2ca12_Rx
          CanTpTxNSdu_6f740f5b (CanTpTxNSdu):
            CanTpNas = 1
            CanTpNbs = 1
            CanTpNcs = 0.2
            CanTpTxAddressingFormat = CANTP_STANDARD
            CanTpTxDl = 8
            CanTpTxPaddingActivation = CANTP_ON
            CanTpTxTaType = CANTP_CANFD_PHYSICAL
            CanTpTc = false
            CanTpTxNSduId = 1
            CanTpTxNSduRef = CDD_HCP5_CANFD01_XIX_TPCHType_CANFD_DAAP_XIX_0x1C423F7B_XIX_0x1C403F7B_XIX_Physical_d2cfa6c1_Tx
            CanTpRxFcNPdu_6e20d585 (CanTpRxFcNPdu): CanTpRxFcNPduId=0, CanTpRxFcNPduRef=DAAP_Hybrid_01_Req_FD_XIX_HCP5_CANFD01_25e2ca12_Rx
            CanTpTxNPdu_6e20d585 (CanTpTxNPdu): CanTpTxNPduConfirmationPduId=0, CanTpTxNPduRef=DAAP_Hybrid_01_Resp_FD_XIX_HCP5_CANFD01_a869e288_Tx
        TPC_HCP5_CANFD01_XIX_TPCHType_CANFD_DAAP_XIX_0x1C413FDD_XIX_Functional_9b011d0c
          CanTpRxNSdu_3e55cafd (CanTpRxNSdu):
            CanTpNbr = 0.1
            CanTpRxAddressingFormat = CANTP_STANDARD
            CanTpRxDl = 8
            CanTpRxPaddingActivation = CANTP_ON
            CanTpRxTaType = CANTP_FUNCTIONAL
            CanTpRxNSduId = 1
            CanTpRxNSduRef = CDD_HCP5_CANFD01_XIX_TPCHType_CANFD_DAAP_XIX_0x1C413FDD_XIX_Functional_880c97f7_Rx
            CanTpRxNPdu_4da76113 (CanTpRxNPdu): CanTpRxNPduId=5, CanTpRxNPduRef=DAAP_Funkt_Req_MC_FD_XIX_HCP5_CANFD01_dbe988f8_Rx
        TPC_HCP5_CANFD01_XIX_TPCHType_CANFD_ISO_Diagnose_XIX_0x1C410000_XIX_Functional_677d3265
          CanTpRxNSdu_bf1fe3fd (CanTpRxNSdu):
            CanTpNbr = 0.1
            CanTpRxAddressingFormat = CANTP_STANDARD
            CanTpRxDl = 64
            CanTpRxPaddingActivation = CANTP_ON
            CanTpRxTaType = CANTP_CANFD_FUNCTIONAL
            CanTpRxNSduId = 3
            CanTpRxNSduRef = DCM_HCP5_CANFD01_XIX_TPCHType_CANFD_ISO_Diagnose_XIX_0x1C410000_XIX_Functional_905f44f1_Rx
            CanTpRxNPdu_d8d6c01a (CanTpRxNPdu): CanTpRxNPduId=6, CanTpRxNPduRef=ISOx_Funkt_Req_All_FD_XIX_HCP5_CANFD01_1dbb1bad_Rx
        TPC_HCP5_CANFD01_XIX_TPCHType_CANFD_OBDC_Diagnose_XIX_0x1C40027B_XIX_0x1C42027B_XIX_Physical_cb702e23
          CanTpRxNSdu_0279f0ba (CanTpRxNSdu):
            CanTpBs = 15
            CanTpNar = 1
            CanTpNbr = 0.1
            CanTpNcr = 1
            CanTpRxAddressingFormat = CANTP_STANDARD
            CanTpRxDl = 64
            CanTpRxPaddingActivation = CANTP_ON
            CanTpRxTaType = CANTP_CANFD_PHYSICAL
            CanTpRxWftMax = 15
            CanTpSTmin = 0.005
            CanTpRxNSduId = 4
            CanTpRxNSduRef = DCM_HCP5_CANFD01_XIX_TPCHType_CANFD_OBDC_Diagnose_XIX_0x1C40027B_XIX_0x1C42027B_XIX_Physical_8b2e4924_Rx
            CanTpRxNPdu_7abc1315 (CanTpRxNPdu): CanTpRxNPduId=3, CanTpRxNPduRef=OBDC_Hybrid_01_Req_FD_XIX_HCP5_CANFD01_38935bdf_Rx
            CanTpTxFcNPdu_7abc1315 (CanTpTxFcNPdu): CanTpTxFcNPduConfirmationPduId=3, CanTpTxFcNPduRef=OBDC_Hybrid_01_Resp_FD_XIX_HCP5_CANFD01_4da12d14_Tx
          CanTpTxNSdu_0279f0ba (CanTpTxNSdu):
            CanTpNas = 1
            CanTpNbs = 1
            CanTpNcs = 0.2
            CanTpTxAddressingFormat = CANTP_STANDARD
            CanTpTxDl = 8
            CanTpTxPaddingActivation = CANTP_ON
            CanTpTxTaType = CANTP_CANFD_PHYSICAL
            CanTpTc = false
            CanTpTxNSduId = 3
            CanTpTxNSduRef = DCM_HCP5_CANFD01_XIX_TPCHType_CANFD_OBDC_Diagnose_XIX_0x1C42027B_XIX_0x1C40027B_XIX_Physical_4ad10dcb_Tx
            CanTpTxNPdu_5846c7e7 (CanTpTxNPdu): CanTpTxNPduConfirmationPduId=3, CanTpTxNPduRef=OBDC_Hybrid_01_Resp_FD_XIX_HCP5_CANFD01_4da12d14_Tx
            CanTpRxFcNPdu_5846c7e7 (CanTpRxFcNPdu): CanTpRxFcNPduId=3, CanTpRxFcNPduRef=OBDC_Hybrid_01_Req_FD_XIX_HCP5_CANFD01_38935bdf_Rx
        TPC_HCP5_CANFD01_XIX_TPCHType_CANFD_ISO_Diagnose_XIX_0x1C40007B_XIX_0x1C42007B_XIX_Physical_0f1ef670
          CanTpRxNSdu_a8e8a4a6 (CanTpRxNSdu):
            CanTpBs = 15
            CanTpNar = 1
            CanTpNbr = 0.1
            CanTpNcr = 1
            CanTpRxAddressingFormat = CANTP_STANDARD
            CanTpRxDl = 64
            CanTpRxPaddingActivation = CANTP_ON
            CanTpRxTaType = CANTP_CANFD_PHYSICAL
            CanTpRxWftMax = 15
            CanTpSTmin = 0.005
            CanTpRxNSduId = 2
            CanTpRxNSduRef = DCM_HCP5_CANFD01_XIX_TPCHType_CANFD_ISO_Diagnose_XIX_0x1C40007B_XIX_0x1C42007B_XIX_Physical_e79447d3_Rx
            CanTpRxNPdu_27bf3fc9 (CanTpRxNPdu): CanTpRxNPduId=1, CanTpRxNPduRef=ISOx_Hybrid_01_Req_FD_XIX_HCP5_CANFD01_5affd0fb_Rx
            CanTpTxFcNPdu_27bf3fc9 (CanTpTxFcNPdu): CanTpTxFcNPduConfirmationPduId=1, CanTpTxFcNPduRef=ISOx_Hybrid_01_Resp_FD_XIX_HCP5_CANFD01_71c0a54e_Tx
          CanTpTxNSdu_a8e8a4a6 (CanTpTxNSdu):
            CanTpNas = 1
            CanTpNbs = 1
            CanTpNcs = 0.2
            CanTpTxAddressingFormat = CANTP_STANDARD
            CanTpTxDl = 8
            CanTpTxPaddingActivation = CANTP_ON
            CanTpTxTaType = CANTP_CANFD_PHYSICAL
            CanTpTc = false
            CanTpTxNSduId = 2
            CanTpTxNSduRef = DCM_HCP5_CANFD01_XIX_TPCHType_CANFD_ISO_Diagnose_XIX_0x1C42007B_XIX_0x1C40007B_XIX_Physical_266b033c_Tx
            CanTpTxNPdu_0545eb3b (CanTpTxNPdu): CanTpTxNPduConfirmationPduId=1, CanTpTxNPduRef=ISOx_Hybrid_01_Resp_FD_XIX_HCP5_CANFD01_71c0a54e_Tx
            CanTpRxFcNPdu_0545eb3b (CanTpRxFcNPdu): CanTpRxFcNPduId=1, CanTpRxFcNPduRef=ISOx_Hybrid_01_Req_FD_XIX_HCP5_CANFD01_5affd0fb_Rx
