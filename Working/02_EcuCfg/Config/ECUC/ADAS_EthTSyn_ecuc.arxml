AUTOSAR XML (schema 00048)
package /ActiveEcuC
  module config EthTSyn: implementation-config-variant=VARIANT-PRE-COMPILE, module-description=EthTSyn_Impl
    GlobalTimeDomain_2b08dc4b (EthTSynGlobalTimeDomain):
      EthTSynGlobalTimeDomainId = 1
      EthTSynIsOffsetTimeDomain = false
      EthTSynEnableTimeValidation = false
      EthTSynSynchronizedTimeBaseRef = GlobalTimeDomain_2b08dc4b
      MyECU_ETH_GlobalTimeMaster_d6e37e38 (EthTSynPortConfig): EthTSynGlobalTimeDebounceTime=0.05, EthTSynPortNumber=1, EthTSynGlobalTimeEthIfRef=MyECU_EEI_U_ee15deea
        EthTSynPortRole
          EthTSynGlobalTimeMaster:
            EthTSynGlobalTimeTxPeriod = 0.125
            EthTSynCyclicMsgResumeTime = 0
            EthTSynGlobalTimeTxCrcSecured = CRC_NOT_SUPPORTED
            EthTSynImmediateTimeSync = false
            EthTSynTLVFollowUpOFSSubTLV = false
            EthTSynTLVFollowUpStatusSubTLV = false
            EthTSynTLVFollowUpTimeSubTLV = false
            EthTSynTLVFollowUpUserDataSubTLV = false
            EthTSynTxAnnouncePeriod = 0.125
            EthTSynTxAnnounce = false
        EthTSynPdelayConfig:
          EthTSynGlobalTimePdelayRespEnable = true
          EthTSynGlobalTimePropagationDelay = 0
          EthTSynGlobalTimeTxPdelayReqPeriod = 1
          EthTSynPdelayRespAndRespFollowUpTimeout = 0
          EthTSynUseStaticPdelay = false
          EthTSynAlwaysAsCapable = true
    EthTSynGeneral:
      EthTSynDestPhyAddr = 01:80:C2:00:00:0E
      EthTSynDevErrorDetect = true
      EthTSynHardwareTimestampSupport = false
      EthTSynMainFunctionPeriod = 0.005
      EthTSynMasterSlaveConflictDetection = false
      EthTSynMessageCompliance = false
      EthTSynVersionInfoApi = true
      EthTSynEnableSwitchMgmt = false
      EthTSynSafeBswChecks = false
      EthTSynEthIfFrameType = EthTSyn_EthTSyn
