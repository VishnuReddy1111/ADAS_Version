AUTOSAR XML (schema 4-3-0)
package /ActiveEcuC
  module config vBRS: implementation-config-variant=VARIANT-PRE-COMPILE, module-description=vBRS_Impl
    vBRSGeneral:
      vBRSEnableCoreSpecificVLinkGenConfig = true
      vBRSEnableSupportLEDs = false
      vBRSEnableSafeContextSupport = false
      vBRSEnableMultiCoreSupport = true
      vBRSEnableSupportToggleWdPin = false
      vBRSEnableSupportToggleCustomPin = false
      vBRSEnableEcuMStubGeneration = false
      vBRSDisableSetupSupport = false
      vBRSEnableSchmStubGeneration = false
      vBRSEnableSchmStubSupportDrvCanAN = false
      vBRSEnableSchmStubEmptyExclusiveAreaHandling = false
      vBRSExecutionInstance = Application
      vBRSFirstInstance = true
      vBRSFblSupportEcuMInit = false
      vBRSFblSupportExceptionTableInRam = true
    vBRSHwConfig:
      vBRSOscClock = 20000000
      vBRSPeriphClock = 100000000
      vBRSTimebaseClock = 300000000
      vBRSPeriphClockDescription = Initial value for Peripheral Clock: 100MHz GPT=100MHz/8 =12.5MHz
      vBRSEnablePortHandling = false
      vBRSEnableWatchdogHandling = true
      vBRSEnablePLLClocksHandling = false
      vBRSPreferPLLWatchdogInit = true
      vBRSEvaluationBoard = TRIBOARD_TC3x7
      vBRSMcuClockReferencePointForBrsPeriphClock = McuClockReferencePoint_CPU
      3 x vBRSEvalBoardInfo:
        TRIBOARD_TC3x7: vBRSEvalBoard=TRIBOARD_TC3x7, vBRSEvalBoardDescription=Toggle Port Group 33 Port 4 for LED support, vBRSEvalBoardOscClock=20000000
        TRIBOARD_TC3x9: vBRSEvalBoard=TRIBOARD_TC3x9, vBRSEvalBoardDescription=Toggle Port Group 33 Port 4 for LED support, vBRSEvalBoardOscClock=20000000
        CUSTOMER_HARDWARE: vBRSEvalBoard=CUSTOMER_HARDWARE, vBRSEvalBoardDescription=This Eval board is used for customer hardware. All pin configuration have to be specify manually in the BrsHw_Ports.h.
      vBRSDriverHandlingCAN:
        vBRSEnableDriverHandlingCAN = true
        vBRSDriverHandlingCAN_channel0 = false
        vBRSDriverHandlingCAN_channel1 = false
        vBRSDriverHandlingCAN_channel2 = true
        vBRSDriverHandlingCAN_channel{3..9} = false
        vBRSDriverHandlingCAN_PeripheralClock = true
        vBRSDriverHandlingCAN_channel{10..19} = false
      vBRSDriverHandlingEthernet: vBRSEnableDriverHandlingEthernet=true, vBRSDriverHandlingEthernet_PeripheralClock=true
      vBRSDriverHandlingLIN:
        vBRSEnableDriverHandlingLIN = true
        vBRSDriverHandlingLIN_channel0 = false
        vBRSDriverHandlingLIN_channel1 = false
        vBRSDriverHandlingLIN_channel2 = true
        vBRSDriverHandlingLIN_channel{3..9} = false
        vBRSDriverHandlingLIN_PeripheralClock = true
        vBRSDriverHandlingLIN_channel{10..22} = false
    vBRSMemoryInit: vBRSInitPatternBlocks=0, vBRSInitPatternHardResetBlocks=0, vBRSInitPatternAreas=0, vBRSInitPatternHardResetAreas=0
