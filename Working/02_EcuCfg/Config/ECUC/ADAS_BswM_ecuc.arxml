AUTOSAR XML (schema 4-3-0)
package /ActiveEcuC
  module config BswM: implementation-config-variant=VARIANT-PRE-COMPILE, module-description=BswM_Impl
    BswMGeneral:
      BswMCanSMEnabled = true
      BswMComMEnabled = true
      BswMDcmEnabled = true
      BswMDevErrorDetect = true
      BswMEcuMEnabled = true
      BswMEthIfEnabled = false
      BswMEthSMEnabled = false
      BswMFrSMEnabled = false
      BswMGenericRequestEnabled = true
      BswMJ1939DcmEnabled = false
      BswMJ1939NmEnabled = false
      BswMLinSMEnabled = false
      BswMLinTPEnabled = false
      BswMNmEnabled = true
      BswMNvMEnabled = true
      BswMPduREnabled = true
      BswMRuleControlEnabled = true
      BswMSdEnabled = false
      BswMVersionInfoApi = true
      BswMWdgMEnabled = true
      BswMModeCheck = true
      BswMActionListQueueSearchAlgorithm = LINEAR_SEARCH
      BswMMainFunctionPeriod = 0.01
      BswMSafeBswChecks = false
      BswMCommonData
      BswMGeneration:
        BswMOutOfBoundsWriteSanitizer = false
        BswMOutOfBoundsReadSanitizer = false
        BswMReduceConstantData2Define = true
        BswMBoolDataInArrayOfStructStrategy = BITMASKING
    BswMConfig_EcucPartition_SystemApplication_Core0 (BswMConfig): BswMPartitionRef=EcucPartition_SystemApplication_Core0
      BswMArbitration
        ESH_RunToPostRun (BswMRule):
          BswMNestedExecutionOnly = false
          BswMRuleId = 37
          BswMRuleInitState = BSWM_FALSE
          BswMRuleExpressionRef = ESH_LE_RunToPostRunTransition
          BswMRuleTrueActionList = ESH_AL_ExitRun
        ESH_Cond_StateIsRun (BswMModeCondition): BswMConditionType=BSWM_EQUALS, BswMConditionMode=ESH_State
          BswMConditionValue
            BswMBswMode: BswMBswRequestedMode=ESH_RUN
        ESH_State (BswMModeRequestPort): BswMArbitrateOnInit=true, BswMRequestProcessing=BSWM_IMMEDIATE
          BswMModeRequestSource
            BswMGenericRequest: BswMModeRequesterId=230, BswMRequestedModeMax=7
              7 x BswMGenericRequestMode:
                ESH_INIT: BswMGenericRequestModeValue=0
                ESH_RUN: BswMGenericRequestModeValue=1
                ESH_POST_RUN: BswMGenericRequestModeValue=2
                ESH_PREP_SHUTDOWN: BswMGenericRequestModeValue=3
                ESH_WAIT_FOR_NVM: BswMGenericRequestModeValue=4
                ESH_SHUTDOWN: BswMGenericRequestModeValue=5
                ESH_WAKEUP: BswMGenericRequestModeValue=6
          BswMModeInitValue
            BswMBswModeInitValue: BswMBswModeInitValueMode=ESH_INIT
        ESH_LE_AllChannelsNoCom (BswMLogicalExpression): BswMLogicalOperator=BSWM_AND, BswMArgumentRef=ESH_Cond_NoComOn_CN_HCP5_CANFD01_54d90215, BswMArgumentRef=ESH_Cond_NoComOn_CN_BMC_CAN01_78a85e89
        ESH_Cond_SelfRunReqTimerExpired (BswMModeCondition): BswMConditionType=BSWM_EQUALS, BswMConditionMode=ESH_SelfRunRequestTimer
          BswMConditionValue
            BswMBswMode: BswMBswRequestedMode=BSWM_TIMER_EXPIRED
        ESH_SelfRunRequestTimer (BswMModeRequestPort): BswMArbitrateOnInit=false, BswMRequestProcessing=BSWM_DEFERRED
          BswMModeRequestSource
            BswMTimer
          BswMModeInitValue
            BswMBswModeInitValue: BswMBswModeInitValueMode=BSWM_TIMER_STOPPED
        ESH_Cond_ModeIsRun (BswMModeCondition): BswMConditionType=BSWM_EQUALS, BswMConditionMode=ESH_ModeNotification
          BswMConditionValue
            BswMModeDeclaration: BswMModeValueRef=RUN
        ESH_ModeNotification (BswMModeRequestPort): BswMArbitrateOnInit=false, BswMRequestProcessing=BSWM_DEFERRED
          BswMModeRequestSource
            BswMSwcModeNotification: BswMSwcModeNotificationModeDeclarationGroupPrototypeRef=BswM_MDGP_ESH_Mode
          BswMModeInitValue
            BswMSwcModeInitValue: BswMSwcModeInitValueRef=STARTUP
        ESH_RunToPostRunNested (BswMRule):
          BswMNestedExecutionOnly = true
          BswMRuleId = 38
          BswMRuleInitState = BSWM_FALSE
          BswMRuleExpressionRef = ESH_LE_ComMNoPendingRequests
          BswMRuleTrueActionList = ESH_AL_RunToPostRun
        ESH_LE_ComMNoPendingRequests (BswMLogicalExpression): BswMLogicalOperator=BSWM_OR, BswMArgumentRef=ESH_Cond_ComMNoPendingRequests
        ESH_Cond_ComMNoPendingRequests (BswMModeCondition): BswMConditionType=BSWM_EQUALS, BswMConditionMode=ESH_ComMPendingRequests
          BswMConditionValue
            BswMBswMode: BswMBswRequestedMode=ESH_COMM_NO_REQUEST
        ESH_ComMPendingRequests (BswMModeRequestPort): BswMArbitrateOnInit=false, BswMRequestProcessing=BSWM_DEFERRED
          BswMModeRequestSource
            BswMGenericRequest: BswMModeRequesterId=232, BswMRequestedModeMax=2
              ESH_COMM_NO_REQUEST (BswMGenericRequestMode): BswMGenericRequestModeValue=0
              ESH_COMM_PENDING_REQUEST (BswMGenericRequestMode): BswMGenericRequestModeValue=1
          BswMModeInitValue
            BswMBswModeInitValue: BswMBswModeInitValueMode=ESH_COMM_NO_REQUEST
        ESH_WaitToShutdown (BswMRule):
          BswMNestedExecutionOnly = false
          BswMRuleId = 39
          BswMRuleInitState = BSWM_FALSE
          BswMRuleExpressionRef = ESH_LE_WaitForNvMToShutdown
          BswMRuleTrueActionList = ESH_AL_WaitForNvMToShutdown
        ESH_LE_WaitForNvMToShutdown (BswMLogicalExpression):
          BswMLogicalOperator = BSWM_AND
          BswMArgumentRef = ESH_Cond_StateIsWaitForNvm
          BswMArgumentRef = ESH_LE_WriteNotPending
          BswMArgumentRef = ESH_LE_NoWakeupOrKillAll
        ESH_Cond_StateIsWaitForNvm (BswMModeCondition): BswMConditionType=BSWM_EQUALS, BswMConditionMode=ESH_State
          BswMConditionValue
            BswMBswMode: BswMBswRequestedMode=ESH_WAIT_FOR_NVM
        ESH_LE_WriteNotPending (BswMLogicalExpression): BswMLogicalOperator=BSWM_OR, BswMArgumentRef=ESH_Cond_NvMWAIsNotPending, BswMArgumentRef=ESH_Cond_NvWWriteAllTimerNotRunning
        ESH_Cond_NvMWAIsNotPending (BswMModeCondition): BswMConditionType=BSWM_EQUALS_NOT, BswMConditionMode=ESH_NvMIndication
          BswMConditionValue
            BswMBswMode: BswMBswRequestedMode=NVM_REQ_PENDING
        ESH_NvMIndication (BswMModeRequestPort): BswMArbitrateOnInit=false, BswMRequestProcessing=BSWM_DEFERRED
          BswMModeRequestSource
            BswMNvMJobModeIndication: BswMNvmService=NvmWriteAll
          BswMModeInitValue
            BswMBswModeInitValue: BswMBswModeInitValueMode=NVM_REQ_OK
        ESH_Cond_NvWWriteAllTimerNotRunning (BswMModeCondition): BswMConditionType=BSWM_EQUALS_NOT, BswMConditionMode=ESH_NvM_WriteAllTimer
          BswMConditionValue
            BswMBswMode: BswMBswRequestedMode=BSWM_TIMER_STARTED
        ESH_NvM_WriteAllTimer (BswMModeRequestPort): BswMArbitrateOnInit=false, BswMRequestProcessing=BSWM_DEFERRED
          BswMModeRequestSource
            BswMTimer
          BswMModeInitValue
            BswMBswModeInitValue: BswMBswModeInitValueMode=BSWM_TIMER_STOPPED
        ESH_LE_NoWakeup (BswMLogicalExpression): BswMLogicalOperator=BSWM_AND, BswMArgumentRef=ESH_Cond_NoValidatedWakeups, BswMArgumentRef=ESH_Cond_ComMNoPendingRequests
        ESH_Cond_NoValidatedWakeups (BswMModeCondition): BswMConditionType=BSWM_EQUALS, BswMConditionMode=ESH_EcuM_GetValidatedWakeupEvents
          BswMConditionValue
            BswMBswMode: BswMBswRequestedMode=0
        ESH_EcuM_GetValidatedWakeupEvents (BswMModeRequestPort): BswMArbitrateOnInit=false, BswMRequestProcessing=BSWM_DEFERRED
          BswMModeRequestSource
            BswMUserConditionRequest: BswMUserCondition=EcuM_GetValidatedWakeupEvents()
        ESH_WakeupToPrep (BswMRule):
          BswMNestedExecutionOnly = false
          BswMRuleId = 41
          BswMRuleInitState = BSWM_FALSE
          BswMRuleExpressionRef = ESH_LE_WakeupToPrepShutdown
          BswMRuleTrueActionList = ESH_AL_WakeupToPrep
        ESH_LE_WakeupToPrepShutdown (BswMLogicalExpression):
          BswMLogicalOperator = BSWM_AND
          BswMArgumentRef = ESH_Cond_StateIsWakeup
          BswMArgumentRef = ESH_LE_CancelNotPending
          BswMArgumentRef = ESH_Cond_NoPendingWakeups
          BswMArgumentRef = ESH_LE_NoWakeup
          BswMArgumentRef = ESH_Cond_ModeIsWakeup
        ESH_Cond_StateIsWakeup (BswMModeCondition): BswMConditionType=BSWM_EQUALS, BswMConditionMode=ESH_State
          BswMConditionValue
            BswMBswMode: BswMBswRequestedMode=ESH_WAKEUP
        ESH_LE_CancelNotPending (BswMLogicalExpression): BswMLogicalOperator=BSWM_OR, BswMArgumentRef=ESH_Cond_NvMWAIsNotPending, BswMArgumentRef=ESH_Cond_NvWCancelTimerNotRunning
        ESH_Cond_NvWCancelTimerNotRunning (BswMModeCondition): BswMConditionType=BSWM_EQUALS_NOT, BswMConditionMode=ESH_NvM_CancelWriteAllTimer
          BswMConditionValue
            BswMBswMode: BswMBswRequestedMode=BSWM_TIMER_STARTED
        ESH_NvM_CancelWriteAllTimer (BswMModeRequestPort): BswMArbitrateOnInit=false, BswMRequestProcessing=BSWM_DEFERRED
          BswMModeRequestSource
            BswMTimer
          BswMModeInitValue
            BswMBswModeInitValue: BswMBswModeInitValueMode=BSWM_TIMER_STOPPED
        ESH_Cond_NoPendingWakeups (BswMModeCondition): BswMConditionType=BSWM_EQUALS, BswMConditionMode=ESH_EcuM_GetPendingWakeupEvents
          BswMConditionValue
            BswMBswMode: BswMBswRequestedMode=0
        ESH_EcuM_GetPendingWakeupEvents (BswMModeRequestPort): BswMArbitrateOnInit=false, BswMRequestProcessing=BSWM_DEFERRED
          BswMModeRequestSource
            BswMUserConditionRequest: BswMUserCondition=EcuM_GetPendingWakeupEvents()
        ESH_Cond_ModeIsWakeup (BswMModeCondition): BswMConditionType=BSWM_EQUALS, BswMConditionMode=ESH_ModeNotification
          BswMConditionValue
            BswMModeDeclaration: BswMModeValueRef=WAKEUP
        ESH_WaitToWakeup (BswMRule):
          BswMNestedExecutionOnly = false
          BswMRuleId = 40
          BswMRuleInitState = BSWM_FALSE
          BswMRuleExpressionRef = ESH_LE_WaitForNvMToWakeup
          BswMRuleTrueActionList = ESH_AL_WaitForNvMWakeup
        ESH_LE_WaitForNvMToWakeup (BswMLogicalExpression): BswMLogicalOperator=BSWM_AND, BswMArgumentRef=ESH_Cond_StateIsWaitForNvm, BswMArgumentRef=ESH_LE_ValidWakeup
        ESH_LE_ValidWakeup (BswMLogicalExpression): BswMLogicalOperator=BSWM_OR, BswMArgumentRef=ESH_Cond_ValidatedWakeups, BswMArgumentRef=ESH_Cond_ComMPendingRequests
        ESH_Cond_ValidatedWakeups (BswMModeCondition): BswMConditionType=BSWM_EQUALS_NOT, BswMConditionMode=ESH_EcuM_GetValidatedWakeupEvents
          BswMConditionValue
            BswMBswMode: BswMBswRequestedMode=0
        ESH_Cond_ComMPendingRequests (BswMModeCondition): BswMConditionType=BSWM_EQUALS, BswMConditionMode=ESH_ComMPendingRequests
          BswMConditionValue
            BswMBswMode: BswMBswRequestedMode=ESH_COMM_PENDING_REQUEST
        ESH_WakeupToRun (BswMRule):
          BswMNestedExecutionOnly = false
          BswMRuleId = 42
          BswMRuleInitState = BSWM_FALSE
          BswMRuleExpressionRef = ESH_LE_WakeupToRun
          BswMRuleTrueActionList = ESH_AL_WakeupToRun
        ESH_LE_WakeupToRun (BswMLogicalExpression):
          BswMLogicalOperator = BSWM_AND
          BswMArgumentRef = ESH_Cond_StateIsWakeup
          BswMArgumentRef = ESH_LE_ValidWakeup
          BswMArgumentRef = ESH_LE_CancelNotPending
          BswMArgumentRef = ESH_Cond_ModeIsWakeup
        ESH_InitToWakeup (BswMRule):
          BswMNestedExecutionOnly = false
          BswMRuleId = 33
          BswMRuleInitState = BSWM_FALSE
          BswMRuleExpressionRef = ESH_LE_InitToWakeup
          BswMRuleTrueActionList = ESH_AL_InitToWakeup
        ESH_LE_InitToWakeup (BswMLogicalExpression): BswMLogicalOperator=BSWM_AND, BswMArgumentRef=ESH_Cond_StateIsInit
        ESH_Cond_StateIsInit (BswMModeCondition): BswMConditionType=BSWM_EQUALS, BswMConditionMode=ESH_State
          BswMConditionValue
            BswMBswMode: BswMBswRequestedMode=ESH_INIT
        ESH_PostRunNested (BswMRule):
          BswMNestedExecutionOnly = true
          BswMRuleId = 35
          BswMRuleInitState = BSWM_FALSE
          BswMRuleExpressionRef = ESH_LE_PostRunToRun
          BswMRuleFalseActionList = ESH_AL_PostRunToPrepShutdown
          BswMRuleTrueActionList = ESH_AL_PostRunToRun
        ESH_LE_RunRequestsOrWakeup (BswMLogicalExpression): BswMLogicalOperator=BSWM_OR, BswMArgumentRef=ESH_LE_RunRequested, BswMArgumentRef=ESH_LE_ValidWakeup
        ESH_PostRun (BswMRule):
          BswMNestedExecutionOnly = false
          BswMRuleId = 34
          BswMRuleInitState = BSWM_FALSE
          BswMRuleExpressionRef = ESH_LE_PostRun
          BswMRuleTrueActionList = ESH_AL_ExitPostRun
        ESH_LE_PostRun (BswMLogicalExpression): BswMLogicalOperator=BSWM_AND, BswMArgumentRef=ESH_Cond_StateIsPostRun, BswMArgumentRef=ESH_Cond_ModeIsPostRun
        ESH_Cond_StateIsPostRun (BswMModeCondition): BswMConditionType=BSWM_EQUALS, BswMConditionMode=ESH_State
          BswMConditionValue
            BswMBswMode: BswMBswRequestedMode=ESH_POST_RUN
        ESH_Cond_ModeIsPostRun (BswMModeCondition): BswMConditionType=BSWM_EQUALS, BswMConditionMode=ESH_ModeNotification
          BswMConditionValue
            BswMModeDeclaration: BswMModeValueRef=POSTRUN
        ESH_PrepToWait (BswMRule):
          BswMNestedExecutionOnly = false
          BswMRuleId = 36
          BswMRuleInitState = BSWM_FALSE
          BswMRuleExpressionRef = ESH_LE_PrepShutdownToWaitForNvM
          BswMRuleTrueActionList = ESH_AL_PrepShutdownToWaitForNvM
        ESH_LE_PrepShutdownToWaitForNvM (BswMLogicalExpression): BswMLogicalOperator=BSWM_AND, BswMArgumentRef=ESH_Cond_StateIsPrepShutdown, BswMArgumentRef=ESH_Cond_ModeIsShutdown
        ESH_Cond_StateIsPrepShutdown (BswMModeCondition): BswMConditionType=BSWM_EQUALS, BswMConditionMode=ESH_State
          BswMConditionValue
            BswMBswMode: BswMBswRequestedMode=ESH_PREP_SHUTDOWN
        ESH_Cond_ModeIsShutdown (BswMModeCondition): BswMConditionType=BSWM_EQUALS, BswMConditionMode=ESH_ModeNotification
          BswMConditionValue
            BswMModeDeclaration: BswMModeValueRef=SHUTDOWN
        6 x BswMLogicalExpression:
          ESH_LE_RunToPostRunTransition: BswMLogicalOperator=BSWM_AND, BswMArgumentRef=ESH_LE_RunReached, BswMArgumentRef=ESH_LE_NoRunAndNoKillAllRequest
          ESH_LE_RunReached: BswMLogicalOperator=BSWM_AND, BswMArgumentRef=ESH_Cond_StateIsRun, BswMArgumentRef=ESH_Cond_ModeIsRun
          ESH_LE_NoRunAndNoKillAllRequest: BswMLogicalOperator=BSWM_OR, BswMArgumentRef=ESH_LE_NoRunReasons
          ESH_LE_NoRunReasons: BswMLogicalOperator=BSWM_AND, BswMArgumentRef=ESH_LE_AllChannelsNoCom, BswMArgumentRef=ESH_LE_RunReleased, BswMArgumentRef=ESH_Cond_SelfRunReqTimerExpired
          ESH_LE_NoWakeupOrKillAll: BswMLogicalOperator=BSWM_OR, BswMArgumentRef=ESH_LE_NoWakeup
          ESH_LE_PostRunToRun: BswMLogicalOperator=BSWM_AND, BswMArgumentRef=ESH_LE_RunRequestsOrWakeup
        BswMModeCondition: BswMConditionType=BSWM_EQUALS, BswMConditionMode=ESH_ComMIndication_CN_HCP5_CANFD01_54d90215
          BswMConditionValue
            BswMBswMode: BswMBswRequestedMode=COMM_NO_COMMUNICATION
        ESH_Cond_NoComOn_CN_HCP5_CANFD01_54d90215 (BswMModeCondition): BswMConditionType=BSWM_EQUALS, BswMConditionMode=ESH_ComMIndication_CN_HCP5_CANFD01_54d90215
          BswMConditionValue
            BswMBswMode: BswMBswRequestedMode=COMM_NO_COMMUNICATION
        ESH_ComMIndication_CN_HCP5_CANFD01_54d90215 (BswMModeRequestPort): BswMArbitrateOnInit=false, BswMRequestProcessing=BSWM_DEFERRED
          BswMModeRequestSource
            BswMComMIndication: BswMComMChannelRef=CN_HCP5_CANFD01_54d90215
          BswMModeInitValue
            BswMBswModeInitValue: BswMBswModeInitValueMode=COMM_NO_COMMUNICATION
        ESH_LE_RunReleased (BswMLogicalExpression): BswMLogicalOperator=BSWM_AND, BswMArgumentRef=ESH_Cond_RunRequest0IsReleased
        ESH_Cond_RunRequest0IsReleased (BswMModeCondition): BswMConditionType=BSWM_EQUALS, BswMConditionMode=ESH_RunRequest_0
          BswMConditionValue
            BswMModeDeclaration: BswMModeValueRef=RELEASED
        ESH_RunRequest_0 (BswMModeRequestPort): BswMArbitrateOnInit=false, BswMRequestProcessing=BSWM_DEFERRED
          BswMModeRequestSource
            BswMSwcModeRequest: BswMModeRequestDataElementPrototypeName=requestedMode, BswMSwcModeRequestModeDeclarationGroupPrototypeRef=BswM_MDGP_ESH_RunRequest
          BswMModeInitValue
            BswMSwcModeInitValue: BswMSwcModeInitValueRef=RELEASED
        ESH_LE_RunRequested (BswMLogicalExpression): BswMLogicalOperator=BSWM_OR, BswMArgumentRef=ESH_Cond_RunRequest0IsRequested
        ESH_Cond_RunRequest0IsRequested (BswMModeCondition): BswMConditionType=BSWM_EQUALS, BswMConditionMode=ESH_RunRequest_0
          BswMConditionValue
            BswMModeDeclaration: BswMModeValueRef=REQUESTED
        ESH_Cond_NoComOn_CN_BMC_CAN01_78a85e89 (BswMModeCondition): BswMConditionType=BSWM_EQUALS, BswMConditionMode=ESH_ComMIndication_CN_BMC_CAN01_78a85e89
          BswMConditionValue
            BswMBswMode: BswMBswRequestedMode=COMM_NO_COMMUNICATION
        ESH_ComMIndication_CN_BMC_CAN01_78a85e89 (BswMModeRequestPort): BswMArbitrateOnInit=false, BswMRequestProcessing=BSWM_DEFERRED
          BswMModeRequestSource
            BswMComMIndication: BswMComMChannelRef=CN_BMC_CAN01_78a85e89
          BswMModeInitValue
            BswMBswModeInitValue: BswMBswModeInitValueMode=COMM_NO_COMMUNICATION
        CC_CN_BMC_CAN01_78a85e89_RX_DM (BswMRule):
          BswMNestedExecutionOnly = false
          BswMRuleId = 2
          BswMRuleInitState = BSWM_FALSE
          BswMRuleExpressionRef = CC_LE_CN_BMC_CAN01_78a85e89_RX_DM
          BswMRuleFalseActionList = CC_AL_CN_BMC_CAN01_78a85e89_Disable_DM
          BswMRuleTrueActionList = CC_AL_CN_BMC_CAN01_78a85e89_Enable_DM
        CC_LE_CN_BMC_CAN01_78a85e89_RX_DM (BswMLogicalExpression): BswMLogicalOperator=BSWM_AND, BswMArgumentRef=CC_Cond_CanSMIndication_CN_BMC_CAN01_78a85e89_EQ_CANSM_BSWM_FULL_COMMUNICATION
        CC_Cond_CanSMIndication_CN_BMC_CAN01_78a85e89_EQ_CANSM_BSWM_FULL_COMMUNICATION (BswMModeCondition): BswMConditionType=BSWM_EQUALS, BswMConditionMode=CC_CanSMIndication_CN_BMC_CAN01_78a85e89
          BswMConditionValue
            BswMBswMode: BswMBswRequestedMode=CANSM_BSWM_FULL_COMMUNICATION
        CC_CanSMIndication_CN_BMC_CAN01_78a85e89 (BswMModeRequestPort): BswMArbitrateOnInit=false, BswMRequestProcessing=BSWM_IMMEDIATE
          BswMModeRequestSource
            BswMCanSMIndication: BswMCanSMChannelRef=CN_BMC_CAN01_78a85e89
          BswMModeInitValue
            BswMBswModeInitValue: BswMBswModeInitValueMode=CANSM_BSWM_NO_COMMUNICATION
        CC_CN_BMC_CAN01_78a85e89_TX (BswMRule):
          BswMNestedExecutionOnly = false
          BswMRuleId = 3
          BswMRuleInitState = BSWM_FALSE
          BswMRuleExpressionRef = CC_LE_CN_BMC_CAN01_78a85e89_TX
          BswMRuleFalseActionList = CC_AL_CN_BMC_CAN01_78a85e89_TX_Disable
          BswMRuleTrueActionList = CC_AL_CN_BMC_CAN01_78a85e89_TX_EnableNoinit
        CC_LE_CN_BMC_CAN01_78a85e89_TX (BswMLogicalExpression): BswMLogicalOperator=BSWM_AND, BswMArgumentRef=CC_Cond_CanSMIndication_CN_BMC_CAN01_78a85e89_EQ_CANSM_BSWM_FULL_COMMUNICATION
        CC_CN_BMC_CAN01_78a85e89_RX (BswMRule):
          BswMNestedExecutionOnly = false
          BswMRuleId = 1
          BswMRuleInitState = BSWM_FALSE
          BswMRuleExpressionRef = CC_LE_CN_BMC_CAN01_78a85e89_RX
          BswMRuleFalseActionList = CC_AL_CN_BMC_CAN01_78a85e89_RX_Disable
          BswMRuleTrueActionList = CC_AL_CN_BMC_CAN01_78a85e89_RX_EnableNoinit
        CC_LE_CN_BMC_CAN01_78a85e89_RX (BswMLogicalExpression): BswMLogicalOperator=BSWM_AND, BswMArgumentRef=CC_Cond_CanSMIndication_CN_BMC_CAN01_78a85e89_NEQ_CANSM_BSWM_NO_COMMUNICATION
        CC_Cond_CanSMIndication_CN_BMC_CAN01_78a85e89_NEQ_CANSM_BSWM_NO_COMMUNICATION (BswMModeCondition): BswMConditionType=BSWM_EQUALS_NOT, BswMConditionMode=CC_CanSMIndication_CN_BMC_CAN01_78a85e89
          BswMConditionValue
            BswMBswMode: BswMBswRequestedMode=CANSM_BSWM_NO_COMMUNICATION
        CC_LE_CN_HCP5_CANFD01_54d90215_PNC_24_ThermoManagement_4f639819_RX (BswMLogicalExpression):
          BswMLogicalOperator = BSWM_AND
          BswMArgumentRef = CC_LE_PNC_CN_HCP5_CANFD01_54d90215_PNC_24_ThermoManagement_4f639819_NEQ_NOCOM
          BswMArgumentRef = CC_Cond_CanSMIndication_CN_HCP5_CANFD01_54d90215_NEQ_CANSM_BSWM_NO_COMMUNICATION
        CC_LE_PNC_CN_HCP5_CANFD01_54d90215_PNC_24_ThermoManagement_4f639819_NEQ_NOCOM (BswMLogicalExpression):
          BswMLogicalOperator = BSWM_OR
          BswMArgumentRef = CC_PNC_PNC_24_ThermoManagement_4f639819_CN_HCP5_CANFD01_54d90215_PNC_24_ThermoManagement_4f639819_NEQ_NOCOM
        CC_PNC_PNC_24_ThermoManagement_4f639819_CN_HCP5_CANFD01_54d90215_PNC_24_ThermoManagement_4f639819_NEQ_NOCOM (BswMModeCondition): BswMConditionType=BSWM_EQUALS_NOT, BswMConditionMode=CC_PNC_PNC_24_ThermoManagement_4f639819
          BswMConditionValue
            BswMBswMode: BswMBswRequestedMode=COMM_PNC_NO_COMMUNICATION
        CC_PNC_PNC_24_ThermoManagement_4f639819 (BswMModeRequestPort): BswMArbitrateOnInit=false, BswMRequestProcessing=BSWM_IMMEDIATE
          BswMModeRequestSource
            BswMComMPncRequest: BswMComMPncRef=PNC_24_ThermoManagement_4f639819
          BswMModeInitValue
            BswMBswModeInitValue: BswMBswModeInitValueMode=COMM_PNC_NO_COMMUNICATION
        CC_Cond_CanSMIndication_CN_HCP5_CANFD01_54d90215_NEQ_CANSM_BSWM_NO_COMMUNICATION (BswMModeCondition): BswMConditionType=BSWM_EQUALS_NOT, BswMConditionMode=CC_CanSMIndication_CN_HCP5_CANFD01_54d90215
          BswMConditionValue
            BswMBswMode: BswMBswRequestedMode=CANSM_BSWM_NO_COMMUNICATION
        CC_CanSMIndication_CN_HCP5_CANFD01_54d90215 (BswMModeRequestPort): BswMArbitrateOnInit=false, BswMRequestProcessing=BSWM_IMMEDIATE
          BswMModeRequestSource
            BswMCanSMIndication: BswMCanSMChannelRef=CN_HCP5_CANFD01_54d90215
          BswMModeInitValue
            BswMBswModeInitValue: BswMBswModeInitValueMode=CANSM_BSWM_NO_COMMUNICATION
        CC_LE_CN_HCP5_CANFD01_54d90215_PNC_30_EnergyManagement_9072504c_RX_DM (BswMLogicalExpression):
          BswMLogicalOperator = BSWM_AND
          BswMArgumentRef = CC_LE_PNC_CN_HCP5_CANFD01_54d90215_PNC_30_EnergyManagement_9072504c_NEQ_NOCOM
          BswMArgumentRef = CC_Cond_CanSMIndication_CN_HCP5_CANFD01_54d90215_EQ_CANSM_BSWM_FULL_COMMUNICATION
        CC_LE_PNC_CN_HCP5_CANFD01_54d90215_PNC_30_EnergyManagement_9072504c_NEQ_NOCOM (BswMLogicalExpression):
          BswMLogicalOperator = BSWM_OR
          BswMArgumentRef = CC_PNC_PNC_30_EnergyManagement_9072504c_CN_HCP5_CANFD01_54d90215_PNC_30_EnergyManagement_9072504c_NEQ_NOCOM
        CC_PNC_PNC_30_EnergyManagement_9072504c_CN_HCP5_CANFD01_54d90215_PNC_30_EnergyManagement_9072504c_NEQ_NOCOM (BswMModeCondition): BswMConditionType=BSWM_EQUALS_NOT, BswMConditionMode=CC_PNC_PNC_30_EnergyManagement_9072504c
          BswMConditionValue
            BswMBswMode: BswMBswRequestedMode=COMM_PNC_NO_COMMUNICATION
        CC_PNC_PNC_30_EnergyManagement_9072504c (BswMModeRequestPort): BswMArbitrateOnInit=false, BswMRequestProcessing=BSWM_IMMEDIATE
          BswMModeRequestSource
            BswMComMPncRequest: BswMComMPncRef=PNC_30_EnergyManagement_9072504c
          BswMModeInitValue
            BswMBswModeInitValue: BswMBswModeInitValueMode=COMM_PNC_NO_COMMUNICATION
        CC_Cond_CanSMIndication_CN_HCP5_CANFD01_54d90215_EQ_CANSM_BSWM_FULL_COMMUNICATION (BswMModeCondition): BswMConditionType=BSWM_EQUALS, BswMConditionMode=CC_CanSMIndication_CN_HCP5_CANFD01_54d90215
          BswMConditionValue
            BswMBswMode: BswMBswRequestedMode=CANSM_BSWM_FULL_COMMUNICATION
        CC_LE_CN_HCP5_CANFD01_54d90215_PNC_27_Timemaster_Timer_8da5bb27_RX_DM (BswMLogicalExpression):
          BswMLogicalOperator = BSWM_AND
          BswMArgumentRef = CC_LE_PNC_CN_HCP5_CANFD01_54d90215_PNC_27_Timemaster_Timer_8da5bb27_NEQ_NOCOM
          BswMArgumentRef = CC_Cond_CanSMIndication_CN_HCP5_CANFD01_54d90215_EQ_CANSM_BSWM_FULL_COMMUNICATION
        CC_LE_PNC_CN_HCP5_CANFD01_54d90215_PNC_27_Timemaster_Timer_8da5bb27_NEQ_NOCOM (BswMLogicalExpression):
          BswMLogicalOperator = BSWM_OR
          BswMArgumentRef = CC_PNC_PNC_27_Timemaster_Timer_8da5bb27_CN_HCP5_CANFD01_54d90215_PNC_27_Timemaster_Timer_8da5bb27_NEQ_NOCOM
        CC_PNC_PNC_27_Timemaster_Timer_8da5bb27_CN_HCP5_CANFD01_54d90215_PNC_27_Timemaster_Timer_8da5bb27_NEQ_NOCOM (BswMModeCondition): BswMConditionType=BSWM_EQUALS_NOT, BswMConditionMode=CC_PNC_PNC_27_Timemaster_Timer_8da5bb27
          BswMConditionValue
            BswMBswMode: BswMBswRequestedMode=COMM_PNC_NO_COMMUNICATION
        CC_PNC_PNC_27_Timemaster_Timer_8da5bb27 (BswMModeRequestPort): BswMArbitrateOnInit=false, BswMRequestProcessing=BSWM_IMMEDIATE
          BswMModeRequestSource
            BswMComMPncRequest: BswMComMPncRef=PNC_27_Timemaster_Timer_8da5bb27
          BswMModeInitValue
            BswMBswModeInitValue: BswMBswModeInitValueMode=COMM_PNC_NO_COMMUNICATION
        CC_LE_CN_HCP5_CANFD01_54d90215_PNC_40_Diagnosis_Energy_40b20ab8_RX (BswMLogicalExpression):
          BswMLogicalOperator = BSWM_AND
          BswMArgumentRef = CC_LE_PNC_CN_HCP5_CANFD01_54d90215_PNC_40_Diagnosis_Energy_40b20ab8_NEQ_NOCOM
          BswMArgumentRef = CC_Cond_CanSMIndication_CN_HCP5_CANFD01_54d90215_NEQ_CANSM_BSWM_NO_COMMUNICATION
        CC_LE_PNC_CN_HCP5_CANFD01_54d90215_PNC_40_Diagnosis_Energy_40b20ab8_NEQ_NOCOM (BswMLogicalExpression):
          BswMLogicalOperator = BSWM_OR
          BswMArgumentRef = CC_PNC_PNC_40_Diagnosis_Energy_40b20ab8_CN_HCP5_CANFD01_54d90215_PNC_40_Diagnosis_Energy_40b20ab8_NEQ_NOCOM
        CC_PNC_PNC_40_Diagnosis_Energy_40b20ab8_CN_HCP5_CANFD01_54d90215_PNC_40_Diagnosis_Energy_40b20ab8_NEQ_NOCOM (BswMModeCondition): BswMConditionType=BSWM_EQUALS_NOT, BswMConditionMode=CC_PNC_PNC_40_Diagnosis_Energy_40b20ab8
          BswMConditionValue
            BswMBswMode: BswMBswRequestedMode=COMM_PNC_NO_COMMUNICATION
        CC_PNC_PNC_40_Diagnosis_Energy_40b20ab8 (BswMModeRequestPort): BswMArbitrateOnInit=false, BswMRequestProcessing=BSWM_IMMEDIATE
          BswMModeRequestSource
            BswMComMPncRequest: BswMComMPncRef=PNC_40_Diagnosis_Energy_40b20ab8
          BswMModeInitValue
            BswMBswModeInitValue: BswMBswModeInitValueMode=COMM_PNC_NO_COMMUNICATION
        CC_LE_CN_HCP5_CANFD01_54d90215_PNC_13_Airbag_727cecad_RX (BswMLogicalExpression):
          BswMLogicalOperator = BSWM_AND
          BswMArgumentRef = CC_LE_PNC_CN_HCP5_CANFD01_54d90215_PNC_13_Airbag_727cecad_NEQ_NOCOM
          BswMArgumentRef = CC_Cond_CanSMIndication_CN_HCP5_CANFD01_54d90215_NEQ_CANSM_BSWM_NO_COMMUNICATION
        CC_LE_PNC_CN_HCP5_CANFD01_54d90215_PNC_13_Airbag_727cecad_NEQ_NOCOM (BswMLogicalExpression): BswMLogicalOperator=BSWM_OR, BswMArgumentRef=CC_PNC_PNC_13_Airbag_727cecad_CN_HCP5_CANFD01_54d90215_PNC_13_Airbag_727cecad_NEQ_NOCOM
        CC_PNC_PNC_13_Airbag_727cecad_CN_HCP5_CANFD01_54d90215_PNC_13_Airbag_727cecad_NEQ_NOCOM (BswMModeCondition): BswMConditionType=BSWM_EQUALS_NOT, BswMConditionMode=CC_PNC_PNC_13_Airbag_727cecad
          BswMConditionValue
            BswMBswMode: BswMBswRequestedMode=COMM_PNC_NO_COMMUNICATION
        CC_PNC_PNC_13_Airbag_727cecad (BswMModeRequestPort): BswMArbitrateOnInit=false, BswMRequestProcessing=BSWM_IMMEDIATE
          BswMModeRequestSource
            BswMComMPncRequest: BswMComMPncRef=PNC_13_Airbag_727cecad
          BswMModeInitValue
            BswMBswModeInitValue: BswMBswModeInitValueMode=COMM_PNC_NO_COMMUNICATION
        CC_LE_CN_HCP5_CANFD01_54d90215_PNC_10_Powertrain_b3959ad4_RX_DM (BswMLogicalExpression):
          BswMLogicalOperator = BSWM_AND
          BswMArgumentRef = CC_LE_PNC_CN_HCP5_CANFD01_54d90215_PNC_10_Powertrain_b3959ad4_NEQ_NOCOM
          BswMArgumentRef = CC_Cond_CanSMIndication_CN_HCP5_CANFD01_54d90215_EQ_CANSM_BSWM_FULL_COMMUNICATION
        CC_LE_PNC_CN_HCP5_CANFD01_54d90215_PNC_10_Powertrain_b3959ad4_NEQ_NOCOM (BswMLogicalExpression): BswMLogicalOperator=BSWM_OR, BswMArgumentRef=CC_PNC_PNC_10_Powertrain_b3959ad4_CN_HCP5_CANFD01_54d90215_PNC_10_Powertrain_b3959ad4_NEQ_NOCOM
        CC_PNC_PNC_10_Powertrain_b3959ad4_CN_HCP5_CANFD01_54d90215_PNC_10_Powertrain_b3959ad4_NEQ_NOCOM (BswMModeCondition): BswMConditionType=BSWM_EQUALS_NOT, BswMConditionMode=CC_PNC_PNC_10_Powertrain_b3959ad4
          BswMConditionValue
            BswMBswMode: BswMBswRequestedMode=COMM_PNC_NO_COMMUNICATION
        CC_PNC_PNC_10_Powertrain_b3959ad4 (BswMModeRequestPort): BswMArbitrateOnInit=false, BswMRequestProcessing=BSWM_IMMEDIATE
          BswMModeRequestSource
            BswMComMPncRequest: BswMComMPncRef=PNC_10_Powertrain_b3959ad4
          BswMModeInitValue
            BswMBswModeInitValue: BswMBswModeInitValueMode=COMM_PNC_NO_COMMUNICATION
        CC_LE_CN_HCP5_CANFD01_54d90215_PNC_40_Diagnosis_Energy_40b20ab8_TX (BswMLogicalExpression):
          BswMLogicalOperator = BSWM_AND
          BswMArgumentRef = CC_LE_PNC_CN_HCP5_CANFD01_54d90215_PNC_40_Diagnosis_Energy_40b20ab8_NEQ_NOCOM
          BswMArgumentRef = CC_Cond_CanSMIndication_CN_HCP5_CANFD01_54d90215_EQ_CANSM_BSWM_FULL_COMMUNICATION
        CC_CN_HCP5_CANFD01_54d90215_TX (BswMRule):
          BswMNestedExecutionOnly = false
          BswMRuleId = 32
          BswMRuleInitState = BSWM_FALSE
          BswMRuleExpressionRef = CC_LE_CN_HCP5_CANFD01_54d90215_TX
          BswMRuleFalseActionList = CC_AL_CN_HCP5_CANFD01_54d90215_TX_Disable
          BswMRuleTrueActionList = CC_AL_CN_HCP5_CANFD01_54d90215_TX_EnableNoinit
        3 x BswMLogicalExpression:
          CC_LE_CN_HCP5_CANFD01_54d90215_TX: BswMLogicalOperator=BSWM_AND, BswMArgumentRef=CC_Cond_CanSMIndication_CN_HCP5_CANFD01_54d90215_EQ_CANSM_BSWM_FULL_COMMUNICATION
          CC_LE_CN_HCP5_CANFD01_54d90215_PNC_02_Basefunction_Powertrain_6b6ac64e_RX: BswMLogicalOperator=BSWM_AND, BswMArgumentRef=CC_LE_PNC_CN_HCP5_CANFD01_54d90215_PNC_02_Basefunction_Powertrain_6b6ac64e_NEQ_NOCOM, BswMArgumentRef=CC_Cond_CanSMIndication_CN_HCP5_CANFD01_54d90215_NEQ_CANSM_BSWM_NO_COMMUNICATION
          CC_LE_PNC_CN_HCP5_CANFD01_54d90215_PNC_02_Basefunction_Powertrain_6b6ac64e_NEQ_NOCOM: BswMLogicalOperator=BSWM_OR, BswMArgumentRef=CC_PNC_PNC_02_Basefunction_Powertrain_6b6ac64e_CN_HCP5_CANFD01_54d90215_PNC_02_Basefunction_Powertrain_6b6ac64e_NEQ_NOCOM
        CC_PNC_PNC_02_Basefunction_Powertrain_6b6ac64e_CN_HCP5_CANFD01_54d90215_PNC_02_Basefunction_Powertrain_6b6ac64e_NEQ_NOCOM (BswMModeCondition): BswMConditionType=BSWM_EQUALS_NOT, BswMConditionMode=CC_PNC_PNC_02_Basefunction_Powertrain_6b6ac64e
          BswMConditionValue
            BswMBswMode: BswMBswRequestedMode=COMM_PNC_NO_COMMUNICATION
        CC_PNC_PNC_02_Basefunction_Powertrain_6b6ac64e (BswMModeRequestPort): BswMArbitrateOnInit=false, BswMRequestProcessing=BSWM_IMMEDIATE
          BswMModeRequestSource
            BswMComMPncRequest: BswMComMPncRef=PNC_02_Basefunction_Powertrain_6b6ac64e
          BswMModeInitValue
            BswMBswModeInitValue: BswMBswModeInitValueMode=COMM_PNC_NO_COMMUNICATION
        3 x BswMLogicalExpression:
          CC_LE_CN_HCP5_CANFD01_54d90215_PNC_30_EnergyManagement_9072504c_TX: BswMLogicalOperator=BSWM_AND, BswMArgumentRef=CC_LE_PNC_CN_HCP5_CANFD01_54d90215_PNC_30_EnergyManagement_9072504c_NEQ_NOCOM, BswMArgumentRef=CC_Cond_CanSMIndication_CN_HCP5_CANFD01_54d90215_EQ_CANSM_BSWM_FULL_COMMUNICATION
          CC_LE_CN_HCP5_CANFD01_54d90215_PNC_06_Basefunction_ComfortLight_d2d0a736_RX_DM: BswMLogicalOperator=BSWM_AND, BswMArgumentRef=CC_LE_PNC_CN_HCP5_CANFD01_54d90215_PNC_06_Basefunction_ComfortLight_d2d0a736_NEQ_NOCOM, BswMArgumentRef=CC_Cond_CanSMIndication_CN_HCP5_CANFD01_54d90215_EQ_CANSM_BSWM_FULL_COMMUNICATION
          CC_LE_PNC_CN_HCP5_CANFD01_54d90215_PNC_06_Basefunction_ComfortLight_d2d0a736_NEQ_NOCOM: BswMLogicalOperator=BSWM_OR, BswMArgumentRef=CC_PNC_PNC_06_Basefunction_ComfortLight_d2d0a736_CN_HCP5_CANFD01_54d90215_PNC_06_Basefunction_ComfortLight_d2d0a736_NEQ_NOCOM
        CC_PNC_PNC_06_Basefunction_ComfortLight_d2d0a736_CN_HCP5_CANFD01_54d90215_PNC_06_Basefunction_ComfortLight_d2d0a736_NEQ_NOCOM (BswMModeCondition): BswMConditionType=BSWM_EQUALS_NOT, BswMConditionMode=CC_PNC_PNC_06_Basefunction_ComfortLight_d2d0a736
          BswMConditionValue
            BswMBswMode: BswMBswRequestedMode=COMM_PNC_NO_COMMUNICATION
        CC_PNC_PNC_06_Basefunction_ComfortLight_d2d0a736 (BswMModeRequestPort): BswMArbitrateOnInit=false, BswMRequestProcessing=BSWM_IMMEDIATE
          BswMModeRequestSource
            BswMComMPncRequest: BswMComMPncRef=PNC_06_Basefunction_ComfortLight_d2d0a736
          BswMModeInitValue
            BswMBswModeInitValue: BswMBswModeInitValueMode=COMM_PNC_NO_COMMUNICATION
        CC_LE_CN_HCP5_CANFD01_54d90215_PNC_02_Basefunction_Powertrain_6b6ac64e_RX_DM (BswMLogicalExpression):
          BswMLogicalOperator = BSWM_AND
          BswMArgumentRef = CC_LE_PNC_CN_HCP5_CANFD01_54d90215_PNC_02_Basefunction_Powertrain_6b6ac64e_NEQ_NOCOM
          BswMArgumentRef = CC_Cond_CanSMIndication_CN_HCP5_CANFD01_54d90215_EQ_CANSM_BSWM_FULL_COMMUNICATION
        CC_LE_CN_HCP5_CANFD01_54d90215_PNC_30_EnergyManagement_9072504c_RX (BswMLogicalExpression):
          BswMLogicalOperator = BSWM_AND
          BswMArgumentRef = CC_LE_PNC_CN_HCP5_CANFD01_54d90215_PNC_30_EnergyManagement_9072504c_NEQ_NOCOM
          BswMArgumentRef = CC_Cond_CanSMIndication_CN_HCP5_CANFD01_54d90215_NEQ_CANSM_BSWM_NO_COMMUNICATION
        CC_CN_HCP5_CANFD01_54d90215_RX_DM (BswMRule):
          BswMNestedExecutionOnly = false
          BswMRuleId = 31
          BswMRuleInitState = BSWM_FALSE
          BswMRuleExpressionRef = CC_LE_CN_HCP5_CANFD01_54d90215_RX_DM
          BswMRuleFalseActionList = CC_AL_CN_HCP5_CANFD01_54d90215_Disable_DM
          BswMRuleTrueActionList = CC_AL_CN_HCP5_CANFD01_54d90215_Enable_DM
        3 x BswMLogicalExpression:
          CC_LE_CN_HCP5_CANFD01_54d90215_RX_DM: BswMLogicalOperator=BSWM_AND, BswMArgumentRef=CC_Cond_CanSMIndication_CN_HCP5_CANFD01_54d90215_EQ_CANSM_BSWM_FULL_COMMUNICATION
          CC_LE_CN_HCP5_CANFD01_54d90215_PNC_26_HighVoltage_Charging_24d89ab8_RX_DM: BswMLogicalOperator=BSWM_AND, BswMArgumentRef=CC_LE_PNC_CN_HCP5_CANFD01_54d90215_PNC_26_HighVoltage_Charging_24d89ab8_NEQ_NOCOM, BswMArgumentRef=CC_Cond_CanSMIndication_CN_HCP5_CANFD01_54d90215_EQ_CANSM_BSWM_FULL_COMMUNICATION
          CC_LE_PNC_CN_HCP5_CANFD01_54d90215_PNC_26_HighVoltage_Charging_24d89ab8_NEQ_NOCOM: BswMLogicalOperator=BSWM_OR, BswMArgumentRef=CC_PNC_PNC_26_HighVoltage_Charging_24d89ab8_CN_HCP5_CANFD01_54d90215_PNC_26_HighVoltage_Charging_24d89ab8_NEQ_NOCOM
        CC_PNC_PNC_26_HighVoltage_Charging_24d89ab8_CN_HCP5_CANFD01_54d90215_PNC_26_HighVoltage_Charging_24d89ab8_NEQ_NOCOM (BswMModeCondition): BswMConditionType=BSWM_EQUALS_NOT, BswMConditionMode=CC_PNC_PNC_26_HighVoltage_Charging_24d89ab8
          BswMConditionValue
            BswMBswMode: BswMBswRequestedMode=COMM_PNC_NO_COMMUNICATION
        CC_PNC_PNC_26_HighVoltage_Charging_24d89ab8 (BswMModeRequestPort): BswMArbitrateOnInit=false, BswMRequestProcessing=BSWM_IMMEDIATE
          BswMModeRequestSource
            BswMComMPncRequest: BswMComMPncRef=PNC_26_HighVoltage_Charging_24d89ab8
          BswMModeInitValue
            BswMBswModeInitValue: BswMBswModeInitValueMode=COMM_PNC_NO_COMMUNICATION
        CC_LE_CN_HCP5_CANFD01_54d90215_PNC_11_Chassis_dce36bbc_RX_DM (BswMLogicalExpression):
          BswMLogicalOperator = BSWM_AND
          BswMArgumentRef = CC_LE_PNC_CN_HCP5_CANFD01_54d90215_PNC_11_Chassis_dce36bbc_NEQ_NOCOM
          BswMArgumentRef = CC_Cond_CanSMIndication_CN_HCP5_CANFD01_54d90215_EQ_CANSM_BSWM_FULL_COMMUNICATION
        CC_LE_PNC_CN_HCP5_CANFD01_54d90215_PNC_11_Chassis_dce36bbc_NEQ_NOCOM (BswMLogicalExpression): BswMLogicalOperator=BSWM_OR, BswMArgumentRef=CC_PNC_PNC_11_Chassis_dce36bbc_CN_HCP5_CANFD01_54d90215_PNC_11_Chassis_dce36bbc_NEQ_NOCOM
        CC_PNC_PNC_11_Chassis_dce36bbc_CN_HCP5_CANFD01_54d90215_PNC_11_Chassis_dce36bbc_NEQ_NOCOM (BswMModeCondition): BswMConditionType=BSWM_EQUALS_NOT, BswMConditionMode=CC_PNC_PNC_11_Chassis_dce36bbc
          BswMConditionValue
            BswMBswMode: BswMBswRequestedMode=COMM_PNC_NO_COMMUNICATION
        CC_PNC_PNC_11_Chassis_dce36bbc (BswMModeRequestPort): BswMArbitrateOnInit=false, BswMRequestProcessing=BSWM_IMMEDIATE
          BswMModeRequestSource
            BswMComMPncRequest: BswMComMPncRef=PNC_11_Chassis_dce36bbc
          BswMModeInitValue
            BswMBswModeInitValue: BswMBswModeInitValueMode=COMM_PNC_NO_COMMUNICATION
        CC_LE_CN_HCP5_CANFD01_54d90215_PNC_11_Chassis_dce36bbc_RX (BswMLogicalExpression):
          BswMLogicalOperator = BSWM_AND
          BswMArgumentRef = CC_LE_PNC_CN_HCP5_CANFD01_54d90215_PNC_11_Chassis_dce36bbc_NEQ_NOCOM
          BswMArgumentRef = CC_Cond_CanSMIndication_CN_HCP5_CANFD01_54d90215_NEQ_CANSM_BSWM_NO_COMMUNICATION
        CC_CN_HCP5_CANFD01_54d90215_PNC_26_HighVoltage_Charging_24d89ab8_TX (BswMRule):
          BswMNestedExecutionOnly = false
          BswMRuleId = 21
          BswMRuleInitState = BSWM_FALSE
          BswMRuleExpressionRef = CC_LE_CN_HCP5_CANFD01_54d90215_PNC_26_HighVoltage_Charging_24d89ab8_TX
          BswMRuleFalseActionList = CC_AL_CN_HCP5_CANFD01_54d90215_PNC_26_HighVoltage_Charging_24d89ab8_TX_Disable
          BswMRuleTrueActionList = CC_AL_CN_HCP5_CANFD01_54d90215_PNC_26_HighVoltage_Charging_24d89ab8_TX_EnableNoinit
        4 x BswMLogicalExpression:
          CC_LE_CN_HCP5_CANFD01_54d90215_PNC_26_HighVoltage_Charging_24d89ab8_TX: BswMLogicalOperator=BSWM_AND, BswMArgumentRef=CC_LE_PNC_CN_HCP5_CANFD01_54d90215_PNC_26_HighVoltage_Charging_24d89ab8_NEQ_NOCOM, BswMArgumentRef=CC_Cond_CanSMIndication_CN_HCP5_CANFD01_54d90215_EQ_CANSM_BSWM_FULL_COMMUNICATION
          CC_LE_CN_HCP5_CANFD01_54d90215_PNC_10_Powertrain_b3959ad4_RX: BswMLogicalOperator=BSWM_AND, BswMArgumentRef=CC_LE_PNC_CN_HCP5_CANFD01_54d90215_PNC_10_Powertrain_b3959ad4_NEQ_NOCOM, BswMArgumentRef=CC_Cond_CanSMIndication_CN_HCP5_CANFD01_54d90215_NEQ_CANSM_BSWM_NO_COMMUNICATION
          CC_LE_CN_HCP5_CANFD01_54d90215_PNC_01_CarWakeUp_d7102746_TX: BswMLogicalOperator=BSWM_AND, BswMArgumentRef=CC_LE_PNC_CN_HCP5_CANFD01_54d90215_PNC_01_CarWakeUp_d7102746_NEQ_NOCOM, BswMArgumentRef=CC_Cond_CanSMIndication_CN_HCP5_CANFD01_54d90215_EQ_CANSM_BSWM_FULL_COMMUNICATION
          CC_LE_PNC_CN_HCP5_CANFD01_54d90215_PNC_01_CarWakeUp_d7102746_NEQ_NOCOM: BswMLogicalOperator=BSWM_OR, BswMArgumentRef=CC_PNC_PNC_01_CarWakeUp_d7102746_CN_HCP5_CANFD01_54d90215_PNC_01_CarWakeUp_d7102746_NEQ_NOCOM
        CC_PNC_PNC_01_CarWakeUp_d7102746_CN_HCP5_CANFD01_54d90215_PNC_01_CarWakeUp_d7102746_NEQ_NOCOM (BswMModeCondition): BswMConditionType=BSWM_EQUALS_NOT, BswMConditionMode=CC_PNC_PNC_01_CarWakeUp_d7102746
          BswMConditionValue
            BswMBswMode: BswMBswRequestedMode=COMM_PNC_NO_COMMUNICATION
        CC_PNC_PNC_01_CarWakeUp_d7102746 (BswMModeRequestPort): BswMArbitrateOnInit=false, BswMRequestProcessing=BSWM_IMMEDIATE
          BswMModeRequestSource
            BswMComMPncRequest: BswMComMPncRef=PNC_01_CarWakeUp_d7102746
          BswMModeInitValue
            BswMBswModeInitValue: BswMBswModeInitValueMode=COMM_PNC_NO_COMMUNICATION
        CC_CN_HCP5_CANFD01_54d90215_RX (BswMRule):
          BswMNestedExecutionOnly = false
          BswMRuleId = 30
          BswMRuleInitState = BSWM_FALSE
          BswMRuleExpressionRef = CC_LE_CN_HCP5_CANFD01_54d90215_RX
          BswMRuleFalseActionList = CC_AL_CN_HCP5_CANFD01_54d90215_RX_Disable
          BswMRuleTrueActionList = CC_AL_CN_HCP5_CANFD01_54d90215_RX_EnableNoinit
        6 x BswMLogicalExpression:
          CC_LE_CN_HCP5_CANFD01_54d90215_RX: BswMLogicalOperator=BSWM_AND, BswMArgumentRef=CC_Cond_CanSMIndication_CN_HCP5_CANFD01_54d90215_NEQ_CANSM_BSWM_NO_COMMUNICATION
          CC_LE_CN_HCP5_CANFD01_54d90215_PNC_13_Airbag_727cecad_RX_DM: BswMLogicalOperator=BSWM_AND, BswMArgumentRef=CC_LE_PNC_CN_HCP5_CANFD01_54d90215_PNC_13_Airbag_727cecad_NEQ_NOCOM, BswMArgumentRef=CC_Cond_CanSMIndication_CN_HCP5_CANFD01_54d90215_EQ_CANSM_BSWM_FULL_COMMUNICATION
          CC_LE_CN_HCP5_CANFD01_54d90215_PNC_27_Timemaster_Timer_8da5bb27_RX: BswMLogicalOperator=BSWM_AND, BswMArgumentRef=CC_LE_PNC_CN_HCP5_CANFD01_54d90215_PNC_27_Timemaster_Timer_8da5bb27_NEQ_NOCOM, BswMArgumentRef=CC_Cond_CanSMIndication_CN_HCP5_CANFD01_54d90215_NEQ_CANSM_BSWM_NO_COMMUNICATION
          CC_LE_CN_HCP5_CANFD01_54d90215_PNC_26_HighVoltage_Charging_24d89ab8_RX: BswMLogicalOperator=BSWM_AND, BswMArgumentRef=CC_LE_PNC_CN_HCP5_CANFD01_54d90215_PNC_26_HighVoltage_Charging_24d89ab8_NEQ_NOCOM, BswMArgumentRef=CC_Cond_CanSMIndication_CN_HCP5_CANFD01_54d90215_NEQ_CANSM_BSWM_NO_COMMUNICATION
          CC_LE_CN_HCP5_CANFD01_54d90215_PNC_07_Basefunction_CrossSection_7b625db2_RX: BswMLogicalOperator=BSWM_AND, BswMArgumentRef=CC_LE_PNC_CN_HCP5_CANFD01_54d90215_PNC_07_Basefunction_CrossSection_7b625db2_NEQ_NOCOM, BswMArgumentRef=CC_Cond_CanSMIndication_CN_HCP5_CANFD01_54d90215_NEQ_CANSM_BSWM_NO_COMMUNICATION
          CC_LE_PNC_CN_HCP5_CANFD01_54d90215_PNC_07_Basefunction_CrossSection_7b625db2_NEQ_NOCOM: BswMLogicalOperator=BSWM_OR, BswMArgumentRef=CC_PNC_PNC_07_Basefunction_CrossSection_7b625db2_CN_HCP5_CANFD01_54d90215_PNC_07_Basefunction_CrossSection_7b625db2_NEQ_NOCOM
        CC_PNC_PNC_07_Basefunction_CrossSection_7b625db2_CN_HCP5_CANFD01_54d90215_PNC_07_Basefunction_CrossSection_7b625db2_NEQ_NOCOM (BswMModeCondition): BswMConditionType=BSWM_EQUALS_NOT, BswMConditionMode=CC_PNC_PNC_07_Basefunction_CrossSection_7b625db2
          BswMConditionValue
            BswMBswMode: BswMBswRequestedMode=COMM_PNC_NO_COMMUNICATION
        CC_PNC_PNC_07_Basefunction_CrossSection_7b625db2 (BswMModeRequestPort): BswMArbitrateOnInit=false, BswMRequestProcessing=BSWM_IMMEDIATE
          BswMModeRequestSource
            BswMComMPncRequest: BswMComMPncRef=PNC_07_Basefunction_CrossSection_7b625db2
          BswMModeInitValue
            BswMBswModeInitValue: BswMBswModeInitValueMode=COMM_PNC_NO_COMMUNICATION
        4 x BswMLogicalExpression, all with BswMLogicalOperator=BSWM_AND:
          CC_LE_CN_HCP5_CANFD01_54d90215_PNC_24_ThermoManagement_4f639819_RX_DM: BswMArgumentRef=CC_LE_PNC_CN_HCP5_CANFD01_54d90215_PNC_24_ThermoManagement_4f639819_NEQ_NOCOM, BswMArgumentRef=CC_Cond_CanSMIndication_CN_HCP5_CANFD01_54d90215_EQ_CANSM_BSWM_FULL_COMMUNICATION
          CC_LE_CN_HCP5_CANFD01_54d90215_PNC_07_Basefunction_CrossSection_7b625db2_RX_DM: BswMArgumentRef=CC_LE_PNC_CN_HCP5_CANFD01_54d90215_PNC_07_Basefunction_CrossSection_7b625db2_NEQ_NOCOM, BswMArgumentRef=CC_Cond_CanSMIndication_CN_HCP5_CANFD01_54d90215_EQ_CANSM_BSWM_FULL_COMMUNICATION
          CC_LE_CN_HCP5_CANFD01_54d90215_PNC_40_Diagnosis_Energy_40b20ab8_RX_DM: BswMArgumentRef=CC_LE_PNC_CN_HCP5_CANFD01_54d90215_PNC_40_Diagnosis_Energy_40b20ab8_NEQ_NOCOM, BswMArgumentRef=CC_Cond_CanSMIndication_CN_HCP5_CANFD01_54d90215_EQ_CANSM_BSWM_FULL_COMMUNICATION
          CC_LE_CN_HCP5_CANFD01_54d90215_PNC_06_Basefunction_ComfortLight_d2d0a736_RX: BswMArgumentRef=CC_LE_PNC_CN_HCP5_CANFD01_54d90215_PNC_06_Basefunction_ComfortLight_d2d0a736_NEQ_NOCOM, BswMArgumentRef=CC_Cond_CanSMIndication_CN_HCP5_CANFD01_54d90215_NEQ_CANSM_BSWM_NO_COMMUNICATION
        SwcModeNotification_IF_ECU_Perform_Reset_Indication (BswMModeRequestPort): BswMArbitrateOnInit=false, BswMRequestProcessing=BSWM_DEFERRED
          BswMModeRequestSource
            BswMSwcModeNotification: BswMSwcModeNotificationModeDeclarationGroupPrototypeRef=IF_ECU_Perform_Reset_Indication
          BswMModeInitValue
            BswMSwcModeInitValue: BswMSwcModeInitValueRef=NoReset
        LE_ECU_RESET (BswMLogicalExpression): BswMArgumentRef=BswMModeCondition_002
        BswMModeCondition_22 (BswMModeCondition): BswMConditionType=BSWM_EQUALS, BswMConditionMode=SwcModeNotification_IF_ECU_Perform_Reset_Indication
          BswMConditionValue
            BswMModeDeclaration: BswMModeValueRef=PerformHard
        26 x BswMRule, all with BswMNestedExecutionOnly=false, BswMRuleInitState=BSWM_FALSE:
          BswMRule_DCMRESET: BswMRuleId=0, BswMRuleExpressionRef=LE_ECU_RESET, BswMRuleTrueActionList=AL_Dcm_Reset
          CC_CN_HCP5_CANFD01_54d90215_PNC_24_ThermoManagement_4f639819_RX: BswMRuleId=17, BswMRuleExpressionRef=CC_LE_CN_HCP5_CANFD01_54d90215_PNC_24_ThermoManagement_4f639819_RX, BswMRuleFalseActionList=CC_AL_CN_HCP5_CANFD01_54d90215_PNC_24_ThermoManagement_4f639819_RX_Disable, BswMRuleTrueActionList=CC_AL_CN_HCP5_CANFD01_54d90215_PNC_24_ThermoManagement_4f639819_RX_EnableNoinit
          CC_CN_HCP5_CANFD01_54d90215_PNC_30_EnergyManagement_9072504c_RX_DM: BswMRuleId=25, BswMRuleExpressionRef=CC_LE_CN_HCP5_CANFD01_54d90215_PNC_30_EnergyManagement_9072504c_RX_DM, BswMRuleFalseActionList=CC_AL_CN_HCP5_CANFD01_54d90215_PNC_30_EnergyManagement_9072504c_Disable_DM, BswMRuleTrueActionList=CC_AL_CN_HCP5_CANFD01_54d90215_PNC_30_EnergyManagement_9072504c_Enable_DM
          CC_CN_HCP5_CANFD01_54d90215_PNC_27_Timemaster_Timer_8da5bb27_RX_DM: BswMRuleId=23, BswMRuleExpressionRef=CC_LE_CN_HCP5_CANFD01_54d90215_PNC_27_Timemaster_Timer_8da5bb27_RX_DM, BswMRuleFalseActionList=CC_AL_CN_HCP5_CANFD01_54d90215_PNC_27_Timemaster_Timer_8da5bb27_Disable_DM, BswMRuleTrueActionList=CC_AL_CN_HCP5_CANFD01_54d90215_PNC_27_Timemaster_Timer_8da5bb27_Enable_DM
          CC_CN_HCP5_CANFD01_54d90215_PNC_40_Diagnosis_Energy_40b20ab8_RX: BswMRuleId=27, BswMRuleExpressionRef=CC_LE_CN_HCP5_CANFD01_54d90215_PNC_40_Diagnosis_Energy_40b20ab8_RX, BswMRuleFalseActionList=CC_AL_CN_HCP5_CANFD01_54d90215_PNC_40_Diagnosis_Energy_40b20ab8_RX_Disable, BswMRuleTrueActionList=CC_AL_CN_HCP5_CANFD01_54d90215_PNC_40_Diagnosis_Energy_40b20ab8_RX_EnableNoinit
          CC_CN_HCP5_CANFD01_54d90215_PNC_13_Airbag_727cecad_RX: BswMRuleId=15, BswMRuleExpressionRef=CC_LE_CN_HCP5_CANFD01_54d90215_PNC_13_Airbag_727cecad_RX, BswMRuleFalseActionList=CC_AL_CN_HCP5_CANFD01_54d90215_PNC_13_Airbag_727cecad_RX_Disable, BswMRuleTrueActionList=CC_AL_CN_HCP5_CANFD01_54d90215_PNC_13_Airbag_727cecad_RX_EnableNoinit
          CC_CN_HCP5_CANFD01_54d90215_PNC_10_Powertrain_b3959ad4_RX_DM: BswMRuleId=12, BswMRuleExpressionRef=CC_LE_CN_HCP5_CANFD01_54d90215_PNC_10_Powertrain_b3959ad4_RX_DM, BswMRuleFalseActionList=CC_AL_CN_HCP5_CANFD01_54d90215_PNC_10_Powertrain_b3959ad4_Disable_DM, BswMRuleTrueActionList=CC_AL_CN_HCP5_CANFD01_54d90215_PNC_10_Powertrain_b3959ad4_Enable_DM
          CC_CN_HCP5_CANFD01_54d90215_PNC_40_Diagnosis_Energy_40b20ab8_TX: BswMRuleId=29, BswMRuleExpressionRef=CC_LE_CN_HCP5_CANFD01_54d90215_PNC_40_Diagnosis_Energy_40b20ab8_TX, BswMRuleFalseActionList=CC_AL_CN_HCP5_CANFD01_54d90215_PNC_40_Diagnosis_Energy_40b20ab8_TX_Disable, BswMRuleTrueActionList=CC_AL_CN_HCP5_CANFD01_54d90215_PNC_40_Diagnosis_Energy_40b20ab8_TX_EnableNoinit
          CC_CN_HCP5_CANFD01_54d90215_PNC_02_Basefunction_Powertrain_6b6ac64e_RX: BswMRuleId=5, BswMRuleExpressionRef=CC_LE_CN_HCP5_CANFD01_54d90215_PNC_02_Basefunction_Powertrain_6b6ac64e_RX, BswMRuleFalseActionList=CC_AL_CN_HCP5_CANFD01_54d90215_PNC_02_Basefunction_Powertrain_6b6ac64e_RX_Disable, BswMRuleTrueActionList=CC_AL_CN_HCP5_CANFD01_54d90215_PNC_02_Basefunction_Powertrain_6b6ac64e_RX_EnableNoinit
          CC_CN_HCP5_CANFD01_54d90215_PNC_30_EnergyManagement_9072504c_TX: BswMRuleId=26, BswMRuleExpressionRef=CC_LE_CN_HCP5_CANFD01_54d90215_PNC_30_EnergyManagement_9072504c_TX, BswMRuleFalseActionList=CC_AL_CN_HCP5_CANFD01_54d90215_PNC_30_EnergyManagement_9072504c_TX_Disable, BswMRuleTrueActionList=CC_AL_CN_HCP5_CANFD01_54d90215_PNC_30_EnergyManagement_9072504c_TX_EnableNoinit
          CC_CN_HCP5_CANFD01_54d90215_PNC_06_Basefunction_ComfortLight_d2d0a736_RX_DM: BswMRuleId=8, BswMRuleExpressionRef=CC_LE_CN_HCP5_CANFD01_54d90215_PNC_06_Basefunction_ComfortLight_d2d0a736_RX_DM, BswMRuleFalseActionList=CC_AL_CN_HCP5_CANFD01_54d90215_PNC_06_Basefunction_ComfortLight_d2d0a736_Disable_DM, BswMRuleTrueActionList=CC_AL_CN_HCP5_CANFD01_54d90215_PNC_06_Basefunction_ComfortLight_d2d0a736_Enable_DM
          CC_CN_HCP5_CANFD01_54d90215_PNC_02_Basefunction_Powertrain_6b6ac64e_RX_DM: BswMRuleId=6, BswMRuleExpressionRef=CC_LE_CN_HCP5_CANFD01_54d90215_PNC_02_Basefunction_Powertrain_6b6ac64e_RX_DM, BswMRuleFalseActionList=CC_AL_CN_HCP5_CANFD01_54d90215_PNC_02_Basefunction_Powertrain_6b6ac64e_Disable_DM, BswMRuleTrueActionList=CC_AL_CN_HCP5_CANFD01_54d90215_PNC_02_Basefunction_Powertrain_6b6ac64e_Enable_DM
          CC_CN_HCP5_CANFD01_54d90215_PNC_30_EnergyManagement_9072504c_RX: BswMRuleId=24, BswMRuleExpressionRef=CC_LE_CN_HCP5_CANFD01_54d90215_PNC_30_EnergyManagement_9072504c_RX, BswMRuleFalseActionList=CC_AL_CN_HCP5_CANFD01_54d90215_PNC_30_EnergyManagement_9072504c_RX_Disable, BswMRuleTrueActionList=CC_AL_CN_HCP5_CANFD01_54d90215_PNC_30_EnergyManagement_9072504c_RX_EnableNoinit
          CC_CN_HCP5_CANFD01_54d90215_PNC_26_HighVoltage_Charging_24d89ab8_RX_DM: BswMRuleId=20, BswMRuleExpressionRef=CC_LE_CN_HCP5_CANFD01_54d90215_PNC_26_HighVoltage_Charging_24d89ab8_RX_DM, BswMRuleFalseActionList=CC_AL_CN_HCP5_CANFD01_54d90215_PNC_26_HighVoltage_Charging_24d89ab8_Disable_DM, BswMRuleTrueActionList=CC_AL_CN_HCP5_CANFD01_54d90215_PNC_26_HighVoltage_Charging_24d89ab8_Enable_DM
          CC_CN_HCP5_CANFD01_54d90215_PNC_11_Chassis_dce36bbc_RX_DM: BswMRuleId=14, BswMRuleExpressionRef=CC_LE_CN_HCP5_CANFD01_54d90215_PNC_11_Chassis_dce36bbc_RX_DM, BswMRuleFalseActionList=CC_AL_CN_HCP5_CANFD01_54d90215_PNC_11_Chassis_dce36bbc_Disable_DM, BswMRuleTrueActionList=CC_AL_CN_HCP5_CANFD01_54d90215_PNC_11_Chassis_dce36bbc_Enable_DM
          CC_CN_HCP5_CANFD01_54d90215_PNC_11_Chassis_dce36bbc_RX: BswMRuleId=13, BswMRuleExpressionRef=CC_LE_CN_HCP5_CANFD01_54d90215_PNC_11_Chassis_dce36bbc_RX, BswMRuleFalseActionList=CC_AL_CN_HCP5_CANFD01_54d90215_PNC_11_Chassis_dce36bbc_RX_Disable, BswMRuleTrueActionList=CC_AL_CN_HCP5_CANFD01_54d90215_PNC_11_Chassis_dce36bbc_RX_EnableNoinit
          CC_CN_HCP5_CANFD01_54d90215_PNC_10_Powertrain_b3959ad4_RX: BswMRuleId=11, BswMRuleExpressionRef=CC_LE_CN_HCP5_CANFD01_54d90215_PNC_10_Powertrain_b3959ad4_RX, BswMRuleFalseActionList=CC_AL_CN_HCP5_CANFD01_54d90215_PNC_10_Powertrain_b3959ad4_RX_Disable, BswMRuleTrueActionList=CC_AL_CN_HCP5_CANFD01_54d90215_PNC_10_Powertrain_b3959ad4_RX_EnableNoinit
          CC_CN_HCP5_CANFD01_54d90215_PNC_01_CarWakeUp_d7102746_TX: BswMRuleId=4, BswMRuleExpressionRef=CC_LE_CN_HCP5_CANFD01_54d90215_PNC_01_CarWakeUp_d7102746_TX, BswMRuleFalseActionList=CC_AL_CN_HCP5_CANFD01_54d90215_PNC_01_CarWakeUp_d7102746_TX_Disable, BswMRuleTrueActionList=CC_AL_CN_HCP5_CANFD01_54d90215_PNC_01_CarWakeUp_d7102746_TX_EnableNoinit
          CC_CN_HCP5_CANFD01_54d90215_PNC_13_Airbag_727cecad_RX_DM: BswMRuleId=16, BswMRuleExpressionRef=CC_LE_CN_HCP5_CANFD01_54d90215_PNC_13_Airbag_727cecad_RX_DM, BswMRuleFalseActionList=CC_AL_CN_HCP5_CANFD01_54d90215_PNC_13_Airbag_727cecad_Disable_DM, BswMRuleTrueActionList=CC_AL_CN_HCP5_CANFD01_54d90215_PNC_13_Airbag_727cecad_Enable_DM
          CC_CN_HCP5_CANFD01_54d90215_PNC_27_Timemaster_Timer_8da5bb27_RX: BswMRuleId=22, BswMRuleExpressionRef=CC_LE_CN_HCP5_CANFD01_54d90215_PNC_27_Timemaster_Timer_8da5bb27_RX, BswMRuleFalseActionList=CC_AL_CN_HCP5_CANFD01_54d90215_PNC_27_Timemaster_Timer_8da5bb27_RX_Disable, BswMRuleTrueActionList=CC_AL_CN_HCP5_CANFD01_54d90215_PNC_27_Timemaster_Timer_8da5bb27_RX_EnableNoinit
          CC_CN_HCP5_CANFD01_54d90215_PNC_26_HighVoltage_Charging_24d89ab8_RX: BswMRuleId=19, BswMRuleExpressionRef=CC_LE_CN_HCP5_CANFD01_54d90215_PNC_26_HighVoltage_Charging_24d89ab8_RX, BswMRuleFalseActionList=CC_AL_CN_HCP5_CANFD01_54d90215_PNC_26_HighVoltage_Charging_24d89ab8_RX_Disable, BswMRuleTrueActionList=CC_AL_CN_HCP5_CANFD01_54d90215_PNC_26_HighVoltage_Charging_24d89ab8_RX_EnableNoinit
          CC_CN_HCP5_CANFD01_54d90215_PNC_07_Basefunction_CrossSection_7b625db2_RX: BswMRuleId=9, BswMRuleExpressionRef=CC_LE_CN_HCP5_CANFD01_54d90215_PNC_07_Basefunction_CrossSection_7b625db2_RX, BswMRuleFalseActionList=CC_AL_CN_HCP5_CANFD01_54d90215_PNC_07_Basefunction_CrossSection_7b625db2_RX_Disable, BswMRuleTrueActionList=CC_AL_CN_HCP5_CANFD01_54d90215_PNC_07_Basefunction_CrossSection_7b625db2_RX_EnableNoinit
          CC_CN_HCP5_CANFD01_54d90215_PNC_24_ThermoManagement_4f639819_RX_DM: BswMRuleId=18, BswMRuleExpressionRef=CC_LE_CN_HCP5_CANFD01_54d90215_PNC_24_ThermoManagement_4f639819_RX_DM, BswMRuleFalseActionList=CC_AL_CN_HCP5_CANFD01_54d90215_PNC_24_ThermoManagement_4f639819_Disable_DM, BswMRuleTrueActionList=CC_AL_CN_HCP5_CANFD01_54d90215_PNC_24_ThermoManagement_4f639819_Enable_DM
          CC_CN_HCP5_CANFD01_54d90215_PNC_07_Basefunction_CrossSection_7b625db2_RX_DM: BswMRuleId=10, BswMRuleExpressionRef=CC_LE_CN_HCP5_CANFD01_54d90215_PNC_07_Basefunction_CrossSection_7b625db2_RX_DM, BswMRuleFalseActionList=CC_AL_CN_HCP5_CANFD01_54d90215_PNC_07_Basefunction_CrossSection_7b625db2_Disable_DM, BswMRuleTrueActionList=CC_AL_CN_HCP5_CANFD01_54d90215_PNC_07_Basefunction_CrossSection_7b625db2_Enable_DM
          CC_CN_HCP5_CANFD01_54d90215_PNC_40_Diagnosis_Energy_40b20ab8_RX_DM: BswMRuleId=28, BswMRuleExpressionRef=CC_LE_CN_HCP5_CANFD01_54d90215_PNC_40_Diagnosis_Energy_40b20ab8_RX_DM, BswMRuleFalseActionList=CC_AL_CN_HCP5_CANFD01_54d90215_PNC_40_Diagnosis_Energy_40b20ab8_Disable_DM, BswMRuleTrueActionList=CC_AL_CN_HCP5_CANFD01_54d90215_PNC_40_Diagnosis_Energy_40b20ab8_Enable_DM
          CC_CN_HCP5_CANFD01_54d90215_PNC_06_Basefunction_ComfortLight_d2d0a736_RX: BswMRuleId=7, BswMRuleExpressionRef=CC_LE_CN_HCP5_CANFD01_54d90215_PNC_06_Basefunction_ComfortLight_d2d0a736_RX, BswMRuleFalseActionList=CC_AL_CN_HCP5_CANFD01_54d90215_PNC_06_Basefunction_ComfortLight_d2d0a736_RX_Disable, BswMRuleTrueActionList=CC_AL_CN_HCP5_CANFD01_54d90215_PNC_06_Basefunction_ComfortLight_d2d0a736_RX_EnableNoinit
        BswMModeCondition_001 (BswMModeCondition): BswMConditionType=BSWM_EQUALS, BswMConditionMode=SwcModeNotification_IF_ECU_Perform_Reset_Indication
          BswMConditionValue
            BswMModeDeclaration: BswMModeValueRef=PerformHard
        BswMModeCondition_002 (BswMModeCondition): BswMConditionType=BSWM_EQUALS, BswMConditionMode=SwcModeNotification_IF_ECU_Perform_Reset_Indication
          BswMConditionValue
            BswMModeDeclaration: BswMModeValueRef=PerformHard
      BswMModeControl: BswMInitActionListRef=INIT_AL_Initialize_BswMConfig_EcucPartition_SystemApplication_Core0
        9 x BswMAction:
          ESH_Action_EcuMClearValidatedWakeupEvents
            BswMAvailableActions
              BswMUserCallout: BswMUserCalloutFunction=EcuM_ClearValidatedWakeupEvent(ECUM_WKSOURCE_ALL_SOURCES), BswMCreateCallout=false, BswMUserIncludeFile=EcuM.h
          CC_DisableDM_BMC_CAN01_Rx
            BswMAvailableActions
              BswMDeadlineMonitoringControl: BswMDisabledDMPduGroupRef=BMC_HV_XIX_BMC_CAN01_Rx_7b388810
          CC_DisablePDUGroup_BMC_CAN01_Rx
            BswMAvailableActions
              BswMPduGroupSwitch: BswMPduGroupSwitchReinit=false, BswMDisabledPduGroupRef=BMC_HV_XIX_BMC_CAN01_Rx_7b388810
          CC_DisablePDUGroup_BMC_CAN01_Tx
            BswMAvailableActions
              BswMPduGroupSwitch: BswMPduGroupSwitchReinit=false, BswMDisabledPduGroupRef=BMC_HV_XIX_BMC_CAN01_Tx_2d622f96
          CC_EnableDM_BMC_CAN01_Rx
            BswMAvailableActions
              BswMDeadlineMonitoringControl: BswMEnabledDMPduGroupRef=BMC_HV_XIX_BMC_CAN01_Rx_7b388810
          CC_EnablePDUGroup_BMC_CAN01_Rx
            BswMAvailableActions
              BswMPduGroupSwitch: BswMPduGroupSwitchReinit=false, BswMEnabledPduGroupRef=BMC_HV_XIX_BMC_CAN01_Rx_7b388810
          CC_EnablePDUGroup_BMC_CAN01_Tx
            BswMAvailableActions
              BswMPduGroupSwitch: BswMPduGroupSwitchReinit=false, BswMEnabledPduGroupRef=BMC_HV_XIX_BMC_CAN01_Tx_2d622f96
          Action_BLOCK_COM_CN_BMC_CAN01
            BswMAvailableActions
              BswMComMAllowCom: BswMComAllowed=false, BswMComMAllowChannelRef=CN_BMC_CAN01_78a85e89
          Action_ALLOW_COM_CN_BMC_CAN01
            BswMAvailableActions
              BswMComMAllowCom: BswMComAllowed=true, BswMComMAllowChannelRef=CN_BMC_CAN01_78a85e89
        ESH_AL_ExitRun (BswMActionList): BswMActionListExecution=BSWM_CONDITION
          4 x BswMActionListItem, all with BswMAbortOnFail=false:
            ESH_Action_EnterExclusiveArea: BswMActionListItemIndex=0, BswMActionListItemRef=BswMModeControl/ESH_Action_EnterExclusiveArea
            ESH_Action_ComMCheckPendingRequests: BswMActionListItemIndex=1, BswMActionListItemRef=BswMModeControl/ESH_Action_ComMCheckPendingRequests
            ESH_RunToPostRunNested: BswMActionListItemIndex=2, BswMActionListItemRef=BswMArbitration/ESH_RunToPostRunNested
            ESH_Action_ExitExclusiveArea: BswMActionListItemIndex=3, BswMActionListItemRef=BswMModeControl/ESH_Action_ExitExclusiveArea
        ESH_Action_EnterExclusiveArea (BswMAction)
          BswMAvailableActions
            BswMUserCallout: BswMUserCalloutFunction=SchM_Enter_BswM_BSWM_EXCLUSIVE_AREA_0(), BswMCreateCallout=false, BswMUserIncludeFile=SchM_BswM.h
        ESH_Action_ComMCheckPendingRequests (BswMAction)
          BswMAvailableActions
            BswMUserCallout:
              BswMUserCalloutFunction = ESH_ComM_CheckPendingRequests()
              BswMCreateCallout = true
              BswMUserCode = ComM_StateType CN_HCP5_CANFD01_54d90215 = COMM_NO_COM_NO_PENDING_REQUEST; ComM_StateType CN_BMC_CAN01_78a85e89 = COMM_NO_COM_NO_PENDING_REQUEST; (void)ComM_GetState(ComMConf_ComMChannel_CN_HCP5_CANFD01_54d90215, &CN_HCP5_CANFD01_54d90215); /* SBSW_BSWM_FCTCALL_LOCALVAR */ (void)ComM_GetState(ComMConf_ComMChannel_CN_BMC_CAN01_78a85e89, &CN_BMC_CAN01_78a85e89); /* SBSW_BSWM_FCTCALL_LOCALVAR */ if((CN_HCP5_CANFD01_54d90215 != COMM_NO_COM_NO_PENDING_REQUEST) || (CN_BMC_CAN01_78a85e89 != COMM_NO_COM_NO_PENDING_REQUEST)) { BswM_RequestMode(BSWM_GENERIC_ESH_ComMPendingRequests, BSWM_GENERICVALUE_ESH_ComMPendingRequests_ESH_COMM_PENDING_REQUEST); } else { BswM_RequestMode(BSWM_GENERIC_ESH_ComMPendingRequests, BSWM_GENERICVALUE_ESH_ComMPendingRequests_ESH_COMM_NO_REQUEST); }
        ESH_AL_RunToPostRun (BswMActionList): BswMActionListExecution=BSWM_CONDITION
          6 x BswMActionListItem, all with BswMAbortOnFail=false:
            ESH_Action_EcuMClearValidatedWakeupEvents: BswMActionListItemIndex=2, BswMActionListItemRef=BswMModeControl/ESH_Action_EcuMClearValidatedWakeupEvents
            ESH_Action_SwitchPostRun: BswMActionListItemIndex=4, BswMActionListItemRef=BswMModeControl/ESH_Action_SwitchPostRun
            ESH_Action_ESH_PostRun: BswMActionListItemIndex=5, BswMActionListItemRef=BswMModeControl/ESH_Action_ESH_PostRun
            ESH_Action_ComMDisallow_CN_HCP5_CANFD01_54d90215: BswMActionListItemIndex=0, BswMActionListItemRef=BswMModeControl/ESH_Action_ComMDisallow_CN_HCP5_CANFD01_54d90215
            ESH_Action_OnEnterPostRun: BswMActionListItemIndex=3, BswMActionListItemRef=BswMModeControl/ESH_Action_OnEnterPostRun
            ESH_Action_ComMDisallow_CN_BMC_CAN01_78a85e89: BswMActionListItemIndex=1, BswMActionListItemRef=BswMModeControl/ESH_Action_ComMDisallow_CN_BMC_CAN01_78a85e89
        ESH_Action_SwitchPostRun (BswMAction)
          BswMAvailableActions
            BswMRteSwitch: BswMSwitchedMode=POSTRUN, BswMRteSwitchPortRef=ESH_ModeSwitch
        ESH_ModeSwitch (BswMSwitchPort): BswMModeSwitchInterfaceRef=BswM_MSI_ESH_Mode
        ESH_Action_ESH_PostRun (BswMAction)
          BswMAvailableActions
            BswMGenericModeSwitch: BswMGenericRequestRef=ESH_State, BswMGenericRequestModeRef=ESH_POST_RUN
        ESH_Action_ExitExclusiveArea (BswMAction)
          BswMAvailableActions
            BswMUserCallout: BswMUserCalloutFunction=SchM_Exit_BswM_BSWM_EXCLUSIVE_AREA_0(), BswMCreateCallout=false, BswMUserIncludeFile=SchM_BswM.h
        ESH_AL_WaitForNvMToShutdown (BswMActionList): BswMActionListExecution=BSWM_CONDITION
          3 x BswMActionListItem, all with BswMAbortOnFail=false:
            ESH_Action_WriteAllTimer_Stop: BswMActionListItemIndex=0, BswMActionListItemRef=BswMModeControl/ESH_Action_WriteAllTimer_Stop
            ESH_Action_EcuMGoToSelectedShutdownTarget: BswMActionListItemIndex=2, BswMActionListItemRef=BswMModeControl/ESH_Action_EcuMGoToSelectedShutdownTarget
            ESH_Action_OnEnterShutdown: BswMActionListItemIndex=1, BswMActionListItemRef=BswMModeControl/ESH_Action_OnEnterShutdown
        ESH_Action_WriteAllTimer_Stop (BswMAction)
          BswMAvailableActions
            BswMTimerControl: BswMTimerAction=BSWM_TIMER_STOP, BswMTimerValue=0, BswMTimerRef=ESH_NvM_WriteAllTimer
        ESH_Action_EcuMGoToSelectedShutdownTarget (BswMAction)
          BswMAvailableActions
            BswMUserCallout: BswMUserCalloutFunction=(void)EcuM_GoToSelectedShutdownTarget(), BswMCreateCallout=false, BswMUserIncludeFile=EcuM.h
        ESH_AL_WakeupToPrep (BswMActionList): BswMActionListExecution=BSWM_CONDITION
          3 x BswMActionListItem, all with BswMAbortOnFail=false:
            ESH_Action_SwitchShutdown: BswMActionListItemIndex=1, BswMActionListItemRef=BswMModeControl/ESH_Action_SwitchShutdown
            ESH_Action_ESH_PrepShutdown: BswMActionListItemIndex=2, BswMActionListItemRef=BswMModeControl/ESH_Action_ESH_PrepShutdown
            ESH_Action_OnEnterPrepShutdown: BswMActionListItemIndex=0, BswMActionListItemRef=BswMModeControl/ESH_Action_OnEnterPrepShutdown
        ESH_Action_SwitchShutdown (BswMAction)
          BswMAvailableActions
            BswMRteSwitch: BswMSwitchedMode=SHUTDOWN, BswMRteSwitchPortRef=ESH_ModeSwitch
        ESH_Action_ESH_PrepShutdown (BswMAction)
          BswMAvailableActions
            BswMGenericModeSwitch: BswMGenericRequestRef=ESH_State, BswMGenericRequestModeRef=ESH_PREP_SHUTDOWN
        ESH_AL_WaitForNvMWakeup (BswMActionList): BswMActionListExecution=BSWM_CONDITION
          6 x BswMActionListItem, all with BswMAbortOnFail=false:
            ESH_Action_WriteAllTimer_Stop: BswMActionListItemIndex=0, BswMActionListItemRef=BswMModeControl/ESH_Action_WriteAllTimer_Stop
            ESH_Action_CancelWriteAllTimer_Start: BswMActionListItemIndex=1, BswMActionListItemRef=BswMModeControl/ESH_Action_CancelWriteAllTimer_Start
            ESH_Action_CancelNvMWriteAll: BswMActionListItemIndex=2, BswMActionListItemRef=BswMModeControl/ESH_Action_CancelNvMWriteAll
            ESH_Action_SwitchWakeup: BswMActionListItemIndex=4, BswMActionListItemRef=BswMModeControl/ESH_Action_SwitchWakeup
            ESH_Action_ESH_Wakeup: BswMActionListItemIndex=5, BswMActionListItemRef=BswMModeControl/ESH_Action_ESH_Wakeup
            ESH_Action_OnEnterWakeup: BswMActionListItemIndex=3, BswMActionListItemRef=BswMModeControl/ESH_Action_OnEnterWakeup
        4 x BswMAction:
          ESH_Action_CancelWriteAllTimer_Start
            BswMAvailableActions
              BswMTimerControl: BswMTimerAction=BSWM_TIMER_START, BswMTimerValue=60, BswMTimerRef=ESH_NvM_CancelWriteAllTimer
          ESH_Action_CancelNvMWriteAll
            BswMAvailableActions
              BswMUserCallout: BswMUserCalloutFunction=NvM_CancelWriteAll(), BswMCreateCallout=false, BswMUserIncludeFile=NvM.h
          ESH_Action_SwitchWakeup
            BswMAvailableActions
              BswMRteSwitch: BswMSwitchedMode=WAKEUP, BswMRteSwitchPortRef=ESH_ModeSwitch
          ESH_Action_ESH_Wakeup
            BswMAvailableActions
              BswMGenericModeSwitch: BswMGenericRequestRef=ESH_State, BswMGenericRequestModeRef=ESH_WAKEUP
        ESH_AL_WakeupToRun (BswMActionList): BswMActionListExecution=BSWM_CONDITION
          9 x BswMActionListItem, all with BswMAbortOnFail=false:
            ESH_Action_CancelWriteAllTimer_Stop: BswMActionListItemIndex=0, BswMActionListItemRef=BswMModeControl/ESH_Action_CancelWriteAllTimer_Stop
            ESH_Action_SelfRunRequestTimer_Start: BswMActionListItemIndex=5, BswMActionListItemRef=BswMModeControl/ESH_Action_SelfRunRequestTimer_Start
            ESH_Action_SwitchRun: BswMActionListItemIndex=7, BswMActionListItemRef=BswMModeControl/ESH_Action_SwitchRun
            ESH_Action_ESH_Run: BswMActionListItemIndex=8, BswMActionListItemRef=BswMModeControl/ESH_Action_ESH_Run
            Action_ALLOW_COM_CN_HCP5_CANFD01_54d90215: BswMActionListItemIndex=1, BswMActionListItemRef=BswMModeControl/Action_ALLOW_COM_CN_HCP5_CANFD01_54d90215
            ESH_Action_ComMAllow_CN_HCP5_CANFD01_54d90215: BswMActionListItemIndex=2, BswMActionListItemRef=BswMModeControl/ESH_Action_ComMAllow_CN_HCP5_CANFD01_54d90215
            ESH_Action_OnEnterRun: BswMActionListItemIndex=6, BswMActionListItemRef=BswMModeControl/ESH_Action_OnEnterRun
            ESH_Action_ComMAllow_CN_BMC_CAN01_78a85e89: BswMActionListItemIndex=4, BswMActionListItemRef=BswMModeControl/ESH_Action_ComMAllow_CN_BMC_CAN01_78a85e89
            Action_ALLOW_COM_CN_BMC_CAN01: BswMActionListItemIndex=3, BswMActionListItemRef=BswMModeControl/Action_ALLOW_COM_CN_BMC_CAN01
        4 x BswMAction:
          ESH_Action_CancelWriteAllTimer_Stop
            BswMAvailableActions
              BswMTimerControl: BswMTimerAction=BSWM_TIMER_STOP, BswMTimerValue=0, BswMTimerRef=ESH_NvM_CancelWriteAllTimer
          ESH_Action_SelfRunRequestTimer_Start
            BswMAvailableActions
              BswMTimerControl: BswMTimerAction=BSWM_TIMER_START, BswMTimerValue=0.1, BswMTimerRef=ESH_SelfRunRequestTimer
          ESH_Action_SwitchRun
            BswMAvailableActions
              BswMRteSwitch: BswMSwitchedMode=RUN, BswMRteSwitchPortRef=ESH_ModeSwitch
          ESH_Action_ESH_Run
            BswMAvailableActions
              BswMGenericModeSwitch: BswMGenericRequestRef=ESH_State, BswMGenericRequestModeRef=ESH_RUN
        5 x BswMActionList, all with BswMActionListExecution=BSWM_CONDITION:
          ESH_AL_InitToWakeup
            3 x BswMActionListItem, all with BswMAbortOnFail=false:
              ESH_Action_SwitchWakeup: BswMActionListItemIndex=1, BswMActionListItemRef=BswMModeControl/ESH_Action_SwitchWakeup
              ESH_Action_ESH_Wakeup: BswMActionListItemIndex=2, BswMActionListItemRef=BswMModeControl/ESH_Action_ESH_Wakeup
              ESH_Action_OnEnterWakeup: BswMActionListItemIndex=0, BswMActionListItemRef=BswMModeControl/ESH_Action_OnEnterWakeup
          ESH_AL_PostRunToPrepShutdown
            3 x BswMActionListItem, all with BswMAbortOnFail=false:
              ESH_Action_SwitchShutdown: BswMActionListItemIndex=1, BswMActionListItemRef=BswMModeControl/ESH_Action_SwitchShutdown
              ESH_Action_ESH_PrepShutdown: BswMActionListItemIndex=2, BswMActionListItemRef=BswMModeControl/ESH_Action_ESH_PrepShutdown
              ESH_Action_OnEnterPrepShutdown: BswMActionListItemIndex=0, BswMActionListItemRef=BswMModeControl/ESH_Action_OnEnterPrepShutdown
          ESH_AL_PostRunToRun
            6 x BswMActionListItem, all with BswMAbortOnFail=false:
              ESH_Action_SelfRunRequestTimer_Start: BswMActionListItemIndex=2, BswMActionListItemRef=BswMModeControl/ESH_Action_SelfRunRequestTimer_Start
              ESH_Action_SwitchRun: BswMActionListItemIndex=4, BswMActionListItemRef=BswMModeControl/ESH_Action_SwitchRun
              ESH_Action_ESH_Run: BswMActionListItemIndex=5, BswMActionListItemRef=BswMModeControl/ESH_Action_ESH_Run
              ESH_Action_ComMAllow_CN_HCP5_CANFD01_54d90215: BswMActionListItemIndex=0, BswMActionListItemRef=BswMModeControl/ESH_Action_ComMAllow_CN_HCP5_CANFD01_54d90215
              ESH_Action_OnEnterRun: BswMActionListItemIndex=3, BswMActionListItemRef=BswMModeControl/ESH_Action_OnEnterRun
              ESH_Action_ComMAllow_CN_BMC_CAN01_78a85e89: BswMActionListItemIndex=1, BswMActionListItemRef=BswMModeControl/ESH_Action_ComMAllow_CN_BMC_CAN01_78a85e89
          ESH_AL_ExitPostRun
            4 x BswMActionListItem, all with BswMAbortOnFail=false:
              ESH_Action_EnterExclusiveArea: BswMActionListItemIndex=0, BswMActionListItemRef=BswMModeControl/ESH_Action_EnterExclusiveArea
              ESH_Action_ComMCheckPendingRequests: BswMActionListItemIndex=1, BswMActionListItemRef=BswMModeControl/ESH_Action_ComMCheckPendingRequests
              ESH_PostRunNested: BswMActionListItemIndex=2, BswMActionListItemRef=BswMArbitration/ESH_PostRunNested
              ESH_Action_ExitExclusiveArea: BswMActionListItemIndex=3, BswMActionListItemRef=BswMModeControl/ESH_Action_ExitExclusiveArea
          ESH_AL_PrepShutdownToWaitForNvM
            5 x BswMActionListItem, all with BswMAbortOnFail=false:
              ESH_Action_WriteAllTimer_Start: BswMActionListItemIndex=0, BswMActionListItemRef=BswMModeControl/ESH_Action_WriteAllTimer_Start
              ESH_Action_NvMWriteAll: BswMActionListItemIndex=1, BswMActionListItemRef=BswMModeControl/ESH_Action_NvMWriteAll
              ESH_Action_ComMCheckPendingRequests: BswMActionListItemIndex=2, BswMActionListItemRef=BswMModeControl/ESH_Action_ComMCheckPendingRequests
              ESH_Action_ESH_WaitForNvm: BswMActionListItemIndex=4, BswMActionListItemRef=BswMModeControl/ESH_Action_ESH_WaitForNvm
              ESH_Action_OnEnterWaitForNvm: BswMActionListItemIndex=3, BswMActionListItemRef=BswMModeControl/ESH_Action_OnEnterWaitForNvm
        32 x BswMAction:
          ESH_Action_WriteAllTimer_Start
            BswMAvailableActions
              BswMTimerControl: BswMTimerAction=BSWM_TIMER_START, BswMTimerValue=60, BswMTimerRef=ESH_NvM_WriteAllTimer
          ESH_Action_NvMWriteAll
            BswMAvailableActions
              BswMUserCallout: BswMUserCalloutFunction=NvM_WriteAll(), BswMCreateCallout=false, BswMUserIncludeFile=NvM.h
          ESH_Action_ESH_WaitForNvm
            BswMAvailableActions
              BswMGenericModeSwitch: BswMGenericRequestRef=ESH_State, BswMGenericRequestModeRef=ESH_WAIT_FOR_NVM
          INIT_Action_Crypto_30_LibCv_Init
            BswMAvailableActions
              BswMUserCallout: BswMUserCalloutFunction=Crypto_30_LibCv_Init(), BswMCreateCallout=false, BswMUserIncludeFile=Crypto_30_LibCv.h
          INIT_Action_CanIf_Init
            BswMAvailableActions
              BswMUserCallout: BswMUserCalloutFunction=CanIf_Init(CanIf_Config_Ptr), BswMCreateCallout=false, BswMUserIncludeFile=CanIf.h
          INIT_Action_CryIf_Init
            BswMAvailableActions
              BswMUserCallout: BswMUserCalloutFunction=CryIf_Init(), BswMCreateCallout=false, BswMUserIncludeFile=CryIf.h
          INIT_Action_WdgM_Init
            BswMAvailableActions
              BswMUserCallout: BswMUserCalloutFunction=WdgM_Init(&WdgMConfig_Mode0_core0), BswMCreateCallout=false, BswMUserIncludeFile=WdgM.h
          INIT_Action_Com_Init
            BswMAvailableActions
              BswMUserCallout: BswMUserCalloutFunction=Com_Init(Com_Config_Ptr), BswMCreateCallout=false, BswMUserIncludeFile=Com.h
          INIT_Action_PduR_Init
            BswMAvailableActions
              BswMUserCallout: BswMUserCalloutFunction=PduR_Init(PduR_Config_Ptr), BswMCreateCallout=false, BswMUserIncludeFile=PduR.h
          INIT_Action_SecOC_Init
            BswMAvailableActions
              BswMUserCallout: BswMUserCalloutFunction=SecOC_Init(SecOC_Config_Ptr), BswMCreateCallout=false, BswMUserIncludeFile=SecOC.h
          INIT_Action_CanSM_Init
            BswMAvailableActions
              BswMUserCallout: BswMUserCalloutFunction=CanSM_Init(CanSM_Config_Ptr), BswMCreateCallout=false, BswMUserIncludeFile=CanSM_EcuM.h
          INIT_Action_CanNm_Init
            BswMAvailableActions
              BswMUserCallout: BswMUserCalloutFunction=CanNm_Init(CanNm_Config_Ptr), BswMCreateCallout=false, BswMUserIncludeFile=CanNm.h
          INIT_Action_Nm_Init
            BswMAvailableActions
              BswMUserCallout: BswMUserCalloutFunction=Nm_Init(Nm_Config_Ptr), BswMCreateCallout=false, BswMUserIncludeFile=Nm.h
          INIT_Action_CanTp_Init
            BswMAvailableActions
              BswMUserCallout: BswMUserCalloutFunction=CanTp_Init(CanTp_Config_Ptr), BswMCreateCallout=false, BswMUserIncludeFile=CanTp.h
          INIT_Action_CanXcp_Init
            BswMAvailableActions
              BswMUserCallout: BswMUserCalloutFunction=CanXcp_Init(NULL_PTR), BswMCreateCallout=false, BswMUserIncludeFile=CanXcp.h
          INIT_Action_Xcp_Init
            BswMAvailableActions
              BswMUserCallout: BswMUserCalloutFunction=Xcp_Init(), BswMCreateCallout=false, BswMUserIncludeFile=Xcp.h
          INIT_Action_Csm_Init
            BswMAvailableActions
              BswMUserCallout: BswMUserCalloutFunction=Csm_Init(), BswMCreateCallout=false, BswMUserIncludeFile=Csm.h
          INIT_Action_NvM_Init
            BswMAvailableActions
              BswMUserCallout: BswMUserCalloutFunction=NvM_Init(), BswMCreateCallout=false, BswMUserIncludeFile=NvM.h
          INIT_Action_ComM_Init
            BswMAvailableActions
              BswMUserCallout: BswMUserCalloutFunction=ComM_Init(ComM_Config_Ptr), BswMCreateCallout=false, BswMUserIncludeFile=ComM.h
          INIT_Action_Dcm_Init
            BswMAvailableActions
              BswMUserCallout: BswMUserCalloutFunction=Dcm_Init(NULL_PTR), BswMCreateCallout=false, BswMUserIncludeFile=Dcm.h
          INIT_Action_Dem_Init
            BswMAvailableActions
              BswMUserCallout: BswMUserCalloutFunction=Dem_Init(Dem_Config_Ptr), BswMCreateCallout=false, BswMUserIncludeFile=Dem.h
          BswMUserCallout_DemoInit
            BswMAvailableActions
              BswMUserCallout: BswMUserCalloutFunction=Demo_Init(), BswMCreateCallout=false, BswMUserIncludeFile=Demo.h
          INIT_Action_Gpt_Init
            BswMAvailableActions
              BswMUserCallout: BswMUserCalloutFunction=Gpt_Init(&Gpt_Config), BswMCreateCallout=false, BswMUserIncludeFile=Gpt.h
          INIT_Action_Dbg_Init
            BswMAvailableActions
              BswMUserCallout: BswMUserCalloutFunction=Dbg_Init(), BswMCreateCallout=false, BswMUserIncludeFile=Dbg.h
          INIT_Action_Rtm_Init
            BswMAvailableActions
              BswMUserCallout: BswMUserCalloutFunction=Rtm_Init(), BswMCreateCallout=false, BswMUserIncludeFile=Rtm.h
          INIT_Action_vMemAccM_Init
            BswMAvailableActions
              BswMUserCallout: BswMUserCalloutFunction=vMemAccM_Init(), BswMCreateCallout=false, BswMUserIncludeFile=vMemAccM.h
          INIT_Action_vSwUpdM_Init
            BswMAvailableActions
              BswMUserCallout: BswMUserCalloutFunction=vSwUpdM_Init(vSwUpdM_Config_Ptr), BswMCreateCallout=false, BswMUserIncludeFile=vSwUpdM.h
          INIT_Action_vFotaH_Init
            BswMAvailableActions
              BswMUserCallout: BswMUserCalloutFunction=vFotaH_Init(vFotaH_Config_Ptr), BswMCreateCallout=false, BswMUserIncludeFile=vFotaH.h
          INIT_Action_ComM_PostInit
            BswMAvailableActions
              BswMUserCallout: BswMUserCalloutFunction=ComM_PostInit(), BswMCreateCallout=false, BswMUserIncludeFile=ComM.h
          INIT_Action_Nm_PostInit
            BswMAvailableActions
              BswMUserCallout: BswMUserCalloutFunction=Nm_PostInit(), BswMCreateCallout=false, BswMUserIncludeFile=Nm.h
          INIT_Action_Wdg_17_Scu_Init
            BswMAvailableActions
              BswMUserCallout: BswMUserCalloutFunction=Wdg_17_Scu_Init(&Wdg_17_Scu_Config_0), BswMCreateCallout=false, BswMUserIncludeFile=Wdg_17_Scu.h
          INIT_Action_Can_30_Core_Init
            BswMAvailableActions
              BswMUserCallout: BswMUserCalloutFunction=Can_30_Core_Init(Can_30_Core_Config_Ptr), BswMCreateCallout=false, BswMUserIncludeFile=Can_30_Core.h
        INIT_AL_Initialize_BswMConfig_EcucPartition_SystemApplication_Core0 (BswMActionList): BswMActionListExecution=BSWM_CONDITION, BswMActionListPriority=100
          34 x BswMActionListItem, all with BswMAbortOnFail=false:
            INIT_Action_Gpt_Init: BswMActionListItemIndex=0, BswMActionListItemRef=BswMModeControl/INIT_Action_Gpt_Init
            INIT_Action_Wdg_17_Scu_Init: BswMActionListItemIndex=1, BswMActionListItemRef=BswMModeControl/INIT_Action_Wdg_17_Scu_Init
            INIT_Action_WdgM_Init: BswMActionListItemIndex=2, BswMActionListItemRef=BswMModeControl/INIT_Action_WdgM_Init
            INIT_Action_Can_30_Core_Init: BswMActionListItemIndex=3, BswMActionListItemRef=BswMModeControl/INIT_Action_Can_30_Core_Init
            INIT_Action_Crypto_30_LibCv_Init: BswMActionListItemIndex=4, BswMActionListItemRef=BswMModeControl/INIT_Action_Crypto_30_LibCv_Init
            INIT_Action_vMemAccM_Init: BswMActionListItemIndex=5, BswMActionListItemRef=BswMModeControl/INIT_Action_vMemAccM_Init
            INIT_Action_CanIf_Init: BswMActionListItemIndex=6, BswMActionListItemRef=BswMModeControl/INIT_Action_CanIf_Init
            INIT_Action_CryIf_Init: BswMActionListItemIndex=7, BswMActionListItemRef=BswMModeControl/INIT_Action_CryIf_Init
            INIT_Action_Com_Init: BswMActionListItemIndex=8, BswMActionListItemRef=BswMModeControl/INIT_Action_Com_Init
            INIT_Action_PduR_Init: BswMActionListItemIndex=9, BswMActionListItemRef=BswMModeControl/INIT_Action_PduR_Init
            INIT_Action_SecOC_Init: BswMActionListItemIndex=10, BswMActionListItemRef=BswMModeControl/INIT_Action_SecOC_Init
            INIT_Action_CanSM_Init: BswMActionListItemIndex=11, BswMActionListItemRef=BswMModeControl/INIT_Action_CanSM_Init
            INIT_Action_CanNm_Init: BswMActionListItemIndex=12, BswMActionListItemRef=BswMModeControl/INIT_Action_CanNm_Init
            INIT_Action_Nm_Init: BswMActionListItemIndex=13, BswMActionListItemRef=BswMModeControl/INIT_Action_Nm_Init
            INIT_Action_CanTp_Init: BswMActionListItemIndex=14, BswMActionListItemRef=BswMModeControl/INIT_Action_CanTp_Init
            INIT_Action_CanXcp_Init: BswMActionListItemIndex=15, BswMActionListItemRef=BswMModeControl/INIT_Action_CanXcp_Init
            INIT_Action_Xcp_Init: BswMActionListItemIndex=17, BswMActionListItemRef=BswMModeControl/INIT_Action_Xcp_Init
            INIT_Action_Csm_Init: BswMActionListItemIndex=18, BswMActionListItemRef=BswMModeControl/INIT_Action_Csm_Init
            INIT_Action_Dbg_Init: BswMActionListItemIndex=19, BswMActionListItemRef=BswMModeControl/INIT_Action_Dbg_Init
            INIT_Action_NvM_Init: BswMActionListItemIndex=20, BswMActionListItemRef=BswMModeControl/INIT_Action_NvM_Init
            INIT_Action_vSwUpdM_Init: BswMActionListItemIndex=16, BswMActionListItemRef=BswMModeControl/INIT_Action_vSwUpdM_Init
            INIT_Action_ComM_Init: BswMActionListItemIndex=23, BswMActionListItemRef=BswMModeControl/INIT_Action_ComM_Init
            INIT_Action_Dcm_Init: BswMActionListItemIndex=24, BswMActionListItemRef=BswMModeControl/INIT_Action_Dcm_Init
            INIT_Action_Dem_Init: BswMActionListItemIndex=25, BswMActionListItemRef=BswMModeControl/INIT_Action_Dem_Init
            INIT_Action_Rtm_Init: BswMActionListItemIndex=26, BswMActionListItemRef=BswMModeControl/INIT_Action_Rtm_Init
            INIT_Action_vFotaH_Init: BswMActionListItemIndex=27, BswMActionListItemRef=BswMModeControl/INIT_Action_vFotaH_Init
            INIT_Action_ComM_PostInit: BswMActionListItemIndex=28, BswMActionListItemRef=BswMModeControl/INIT_Action_ComM_PostInit
            INIT_Action_Nm_PostInit: BswMActionListItemIndex=29, BswMActionListItemRef=BswMModeControl/INIT_Action_Nm_PostInit
            INIT_Action_EnableInterrupts: BswMActionListItemIndex=30, BswMActionListItemRef=BswMModeControl/INIT_Action_EnableInterrupts
            BswMUserCallout: BswMActionListItemIndex=31, BswMActionListItemRef=BswMModeControl/BswMUserCallout
            INIT_Action_NvMReadAll: BswMActionListItemIndex=22, BswMActionListItemRef=BswMModeControl/INIT_Action_NvMReadAll
            INIT_Action_vFeeAcc_Init: BswMActionListItemIndex=21, BswMActionListItemRef=BswMModeControl/INIT_Action_vFeeAcc_Init
            INIT_Action_CddNpmGen2_Init: BswMActionListItemIndex=32, BswMActionListItemRef=BswMModeControl/INIT_Action_CddNpmGen2_Init
            INIT_Action_BAP_Init: BswMActionListItemIndex=33, BswMActionListItemRef=BswMModeControl/INIT_Action_BAP_Init
        17 x BswMAction:
          INIT_Action_NvMReadAll
            BswMAvailableActions
              BswMUserCallout: BswMUserCalloutFunction=BswM_INIT_NvMReadAll(), BswMCreateCallout=true, BswMUserCode=BswInit_NvMReadAll();, BswMUserIncludeFile=BswInit.h
          INIT_Action_EnableInterrupts
            BswMAvailableActions
              BswMUserCallout: BswMUserCalloutFunction=BswM_AL_SetProgrammableInterrupts(), BswMCreateCallout=true
          BswMUserCallout
            BswMAvailableActions
              BswMUserCallout: BswMUserCalloutFunction=ApplBswM_InitDoneSynchronized_Core0(), BswMCreateCallout=false, BswMUserIncludeFile=Demo.h
          INIT_Action_vFeeAcc_Init
            BswMAvailableActions
              BswMUserCallout: BswMUserCalloutFunction=vFeeAcc_Init(), BswMCreateCallout=false, BswMUserIncludeFile=vFeeAcc.h
          Action_BLOCK_COM_CN_HCP5_CANFD01_54d90215
            BswMAvailableActions
              BswMComMAllowCom: BswMComAllowed=false, BswMComMAllowChannelRef=CN_HCP5_CANFD01_54d90215
          Action_ALLOW_COM_CN_HCP5_CANFD01_54d90215
            BswMAvailableActions
              BswMComMAllowCom: BswMComAllowed=true, BswMComMAllowChannelRef=CN_HCP5_CANFD01_54d90215
          INIT_Action_CddNpmGen2_Init
            BswMAvailableActions
              BswMUserCallout: BswMUserCalloutFunction=CddNpmGen2_Init(), BswMCreateCallout=false, BswMUserIncludeFile=CddNpmGen2.h
          ESH_Action_ComMDisallow_CN_HCP5_CANFD01_54d90215
            BswMAvailableActions
              BswMComMAllowCom: BswMComAllowed=false, BswMComMAllowChannelRef=CN_HCP5_CANFD01_54d90215
          ESH_Action_OnEnterPostRun
            BswMAvailableActions
              BswMUserCallout: BswMUserCalloutFunction=BswM_ESH_OnEnterPostRun(), BswMCreateCallout=true
          ESH_Action_OnEnterShutdown
            BswMAvailableActions
              BswMUserCallout: BswMUserCalloutFunction=BswM_ESH_OnEnterShutdown(), BswMCreateCallout=true
          ESH_Action_OnEnterPrepShutdown
            BswMAvailableActions
              BswMUserCallout: BswMUserCalloutFunction=BswM_ESH_OnEnterPrepShutdown(), BswMCreateCallout=true, BswMUserCode=CddNpmGen2_EcuShutdownIndication();
          ESH_Action_OnEnterWakeup
            BswMAvailableActions
              BswMUserCallout: BswMUserCalloutFunction=BswM_ESH_OnEnterWakeup(), BswMCreateCallout=true
          ESH_Action_ComMAllow_CN_HCP5_CANFD01_54d90215
            BswMAvailableActions
              BswMComMAllowCom: BswMComAllowed=true, BswMComMAllowChannelRef=CN_HCP5_CANFD01_54d90215
          ESH_Action_OnEnterRun
            BswMAvailableActions
              BswMUserCallout: BswMUserCalloutFunction=BswM_ESH_OnEnterRun(), BswMCreateCallout=true
          ESH_Action_OnEnterWaitForNvm
            BswMAvailableActions
              BswMUserCallout: BswMUserCalloutFunction=BswM_ESH_OnEnterWaitForNvm(), BswMCreateCallout=true
          ESH_Action_ComMDisallow_CN_BMC_CAN01_78a85e89
            BswMAvailableActions
              BswMComMAllowCom: BswMComAllowed=false, BswMComMAllowChannelRef=CN_BMC_CAN01_78a85e89
          ESH_Action_ComMAllow_CN_BMC_CAN01_78a85e89
            BswMAvailableActions
              BswMComMAllowCom: BswMComAllowed=true, BswMComMAllowChannelRef=CN_BMC_CAN01_78a85e89
        CC_AL_CN_BMC_CAN01_78a85e89_Disable_DM (BswMActionList): BswMActionListExecution=BSWM_TRIGGER
          CC_DisableDM_BMC_HV_XIX_BMC_CAN01_Rx_7b388810 (BswMActionListItem): BswMAbortOnFail=false, BswMActionListItemIndex=0, BswMActionListItemRef=BswMModeControl/CC_DisableDM_BMC_HV_XIX_BMC_CAN01_Rx_7b388810
        CC_DisableDM_BMC_HV_XIX_BMC_CAN01_Rx_7b388810 (BswMAction)
          BswMAvailableActions
            BswMDeadlineMonitoringControl: BswMDisabledDMPduGroupRef=BMC_HV_XIX_BMC_CAN01_Rx_7b388810
        CC_AL_CN_BMC_CAN01_78a85e89_Enable_DM (BswMActionList): BswMActionListExecution=BSWM_TRIGGER
          CC_EnableDM_BMC_HV_XIX_BMC_CAN01_Rx_7b388810 (BswMActionListItem): BswMAbortOnFail=false, BswMActionListItemIndex=0, BswMActionListItemRef=BswMModeControl/CC_EnableDM_BMC_HV_XIX_BMC_CAN01_Rx_7b388810
        CC_EnableDM_BMC_HV_XIX_BMC_CAN01_Rx_7b388810 (BswMAction)
          BswMAvailableActions
            BswMDeadlineMonitoringControl: BswMEnabledDMPduGroupRef=BMC_HV_XIX_BMC_CAN01_Rx_7b388810
        CC_AL_CN_BMC_CAN01_78a85e89_TX_Disable (BswMActionList): BswMActionListExecution=BSWM_TRIGGER
          CC_DisablePDUGroup_BMC_HV_XIX_BMC_CAN01_Tx_2d622f96 (BswMActionListItem): BswMAbortOnFail=false, BswMActionListItemIndex=0, BswMActionListItemRef=BswMModeControl/CC_DisablePDUGroup_BMC_HV_XIX_BMC_CAN01_Tx_2d622f96
        CC_DisablePDUGroup_BMC_HV_XIX_BMC_CAN01_Tx_2d622f96 (BswMAction)
          BswMAvailableActions
            BswMPduGroupSwitch: BswMPduGroupSwitchReinit=false, BswMDisabledPduGroupRef=BMC_HV_XIX_BMC_CAN01_Tx_2d622f96
        CC_AL_CN_BMC_CAN01_78a85e89_TX_EnableNoinit (BswMActionList): BswMActionListExecution=BSWM_TRIGGER
          CC_EnablePDUGroup_BMC_HV_XIX_BMC_CAN01_Tx_2d622f96 (BswMActionListItem): BswMAbortOnFail=false, BswMActionListItemIndex=0, BswMActionListItemRef=BswMModeControl/CC_EnablePDUGroup_BMC_HV_XIX_BMC_CAN01_Tx_2d622f96
        CC_EnablePDUGroup_BMC_HV_XIX_BMC_CAN01_Tx_2d622f96 (BswMAction)
          BswMAvailableActions
            BswMPduGroupSwitch: BswMPduGroupSwitchReinit=false, BswMEnabledPduGroupRef=BMC_HV_XIX_BMC_CAN01_Tx_2d622f96
        CC_AL_CN_BMC_CAN01_78a85e89_RX_Disable (BswMActionList): BswMActionListExecution=BSWM_TRIGGER
          CC_DisablePDUGroup_BMC_HV_XIX_BMC_CAN01_Rx_7b388810 (BswMActionListItem): BswMAbortOnFail=false, BswMActionListItemIndex=0, BswMActionListItemRef=BswMModeControl/CC_DisablePDUGroup_BMC_HV_XIX_BMC_CAN01_Rx_7b388810
        CC_DisablePDUGroup_BMC_HV_XIX_BMC_CAN01_Rx_7b388810 (BswMAction)
          BswMAvailableActions
            BswMPduGroupSwitch: BswMPduGroupSwitchReinit=false, BswMDisabledPduGroupRef=BMC_HV_XIX_BMC_CAN01_Rx_7b388810
        CC_AL_CN_BMC_CAN01_78a85e89_RX_EnableNoinit (BswMActionList): BswMActionListExecution=BSWM_TRIGGER
          CC_EnablePDUGroup_BMC_HV_XIX_BMC_CAN01_Rx_7b388810 (BswMActionListItem): BswMAbortOnFail=false, BswMActionListItemIndex=0, BswMActionListItemRef=BswMModeControl/CC_EnablePDUGroup_BMC_HV_XIX_BMC_CAN01_Rx_7b388810
        CC_EnablePDUGroup_BMC_HV_XIX_BMC_CAN01_Rx_7b388810 (BswMAction)
          BswMAvailableActions
            BswMPduGroupSwitch: BswMPduGroupSwitchReinit=false, BswMEnabledPduGroupRef=BMC_HV_XIX_BMC_CAN01_Rx_7b388810
        CC_AL_CN_HCP5_CANFD01_54d90215_PNC_24_ThermoManagement_4f639819_RX_Disable (BswMActionList): BswMActionListExecution=BSWM_TRIGGER
          CC_DisablePDUGroup_BMC_HV_XIX_PNC_24_ThermoManagement_Rx_9f1a6723 (BswMActionListItem):
            BswMAbortOnFail = false
            BswMActionListItemIndex = 0
            BswMActionListItemRef = BswMModeControl/CC_DisablePDUGroup_BMC_HV_XIX_PNC_24_ThermoManagement_Rx_9f1a6723
        CC_DisablePDUGroup_BMC_HV_XIX_PNC_24_ThermoManagement_Rx_9f1a6723 (BswMAction)
          BswMAvailableActions
            BswMPduGroupSwitch: BswMPduGroupSwitchReinit=false, BswMDisabledPduGroupRef=BMC_HV_XIX_PNC_24_ThermoManagement_Rx_9f1a6723
        CC_AL_CN_HCP5_CANFD01_54d90215_PNC_24_ThermoManagement_4f639819_RX_EnableNoinit (BswMActionList): BswMActionListExecution=BSWM_TRIGGER
          CC_EnablePDUGroup_BMC_HV_XIX_PNC_24_ThermoManagement_Rx_9f1a6723 (BswMActionListItem):
            BswMAbortOnFail = false
            BswMActionListItemIndex = 0
            BswMActionListItemRef = BswMModeControl/CC_EnablePDUGroup_BMC_HV_XIX_PNC_24_ThermoManagement_Rx_9f1a6723
        CC_EnablePDUGroup_BMC_HV_XIX_PNC_24_ThermoManagement_Rx_9f1a6723 (BswMAction)
          BswMAvailableActions
            BswMPduGroupSwitch: BswMPduGroupSwitchReinit=false, BswMEnabledPduGroupRef=BMC_HV_XIX_PNC_24_ThermoManagement_Rx_9f1a6723
        CC_AL_CN_HCP5_CANFD01_54d90215_PNC_30_EnergyManagement_9072504c_Disable_DM (BswMActionList): BswMActionListExecution=BSWM_TRIGGER
          CC_DisableDM_BMC_HV_XIX_PNC_30_EnergyManagement_Rx_a9680a43 (BswMActionListItem):
            BswMAbortOnFail = false
            BswMActionListItemIndex = 0
            BswMActionListItemRef = BswMModeControl/CC_DisableDM_BMC_HV_XIX_PNC_30_EnergyManagement_Rx_a9680a43
        CC_DisableDM_BMC_HV_XIX_PNC_30_EnergyManagement_Rx_a9680a43 (BswMAction)
          BswMAvailableActions
            BswMDeadlineMonitoringControl: BswMDisabledDMPduGroupRef=BMC_HV_XIX_PNC_30_EnergyManagement_Rx_a9680a43
        CC_AL_CN_HCP5_CANFD01_54d90215_PNC_30_EnergyManagement_9072504c_Enable_DM (BswMActionList): BswMActionListExecution=BSWM_TRIGGER
          CC_EnableDM_BMC_HV_XIX_PNC_30_EnergyManagement_Rx_a9680a43 (BswMActionListItem):
            BswMAbortOnFail = false
            BswMActionListItemIndex = 0
            BswMActionListItemRef = BswMModeControl/CC_EnableDM_BMC_HV_XIX_PNC_30_EnergyManagement_Rx_a9680a43
        CC_EnableDM_BMC_HV_XIX_PNC_30_EnergyManagement_Rx_a9680a43 (BswMAction)
          BswMAvailableActions
            BswMDeadlineMonitoringControl: BswMEnabledDMPduGroupRef=BMC_HV_XIX_PNC_30_EnergyManagement_Rx_a9680a43
        CC_AL_CN_HCP5_CANFD01_54d90215_PNC_27_Timemaster_Timer_8da5bb27_Disable_DM (BswMActionList): BswMActionListExecution=BSWM_TRIGGER
          CC_DisableDM_BMC_HV_XIX_PNC_27_Timemaster_Timer_Rx_2db6b092 (BswMActionListItem):
            BswMAbortOnFail = false
            BswMActionListItemIndex = 0
            BswMActionListItemRef = BswMModeControl/CC_DisableDM_BMC_HV_XIX_PNC_27_Timemaster_Timer_Rx_2db6b092
        CC_DisableDM_BMC_HV_XIX_PNC_27_Timemaster_Timer_Rx_2db6b092 (BswMAction)
          BswMAvailableActions
            BswMDeadlineMonitoringControl: BswMDisabledDMPduGroupRef=BMC_HV_XIX_PNC_27_Timemaster_Timer_Rx_2db6b092
        CC_AL_CN_HCP5_CANFD01_54d90215_PNC_27_Timemaster_Timer_8da5bb27_Enable_DM (BswMActionList): BswMActionListExecution=BSWM_TRIGGER
          CC_EnableDM_BMC_HV_XIX_PNC_27_Timemaster_Timer_Rx_2db6b092 (BswMActionListItem):
            BswMAbortOnFail = false
            BswMActionListItemIndex = 0
            BswMActionListItemRef = BswMModeControl/CC_EnableDM_BMC_HV_XIX_PNC_27_Timemaster_Timer_Rx_2db6b092
        CC_EnableDM_BMC_HV_XIX_PNC_27_Timemaster_Timer_Rx_2db6b092 (BswMAction)
          BswMAvailableActions
            BswMDeadlineMonitoringControl: BswMEnabledDMPduGroupRef=BMC_HV_XIX_PNC_27_Timemaster_Timer_Rx_2db6b092
        CC_AL_CN_HCP5_CANFD01_54d90215_PNC_40_Diagnosis_Energy_40b20ab8_RX_Disable (BswMActionList): BswMActionListExecution=BSWM_TRIGGER
          CC_DisablePDUGroup_BMC_HV_XIX_PNC_40_Diagnosis_Energy_Rx_36e9c670 (BswMActionListItem):
            BswMAbortOnFail = false
            BswMActionListItemIndex = 0
            BswMActionListItemRef = BswMModeControl/CC_DisablePDUGroup_BMC_HV_XIX_PNC_40_Diagnosis_Energy_Rx_36e9c670
        CC_DisablePDUGroup_BMC_HV_XIX_PNC_40_Diagnosis_Energy_Rx_36e9c670 (BswMAction)
          BswMAvailableActions
            BswMPduGroupSwitch: BswMPduGroupSwitchReinit=false, BswMDisabledPduGroupRef=BMC_HV_XIX_PNC_40_Diagnosis_Energy_Rx_36e9c670
        CC_AL_CN_HCP5_CANFD01_54d90215_PNC_40_Diagnosis_Energy_40b20ab8_RX_EnableNoinit (BswMActionList): BswMActionListExecution=BSWM_TRIGGER
          CC_EnablePDUGroup_BMC_HV_XIX_PNC_40_Diagnosis_Energy_Rx_36e9c670 (BswMActionListItem):
            BswMAbortOnFail = false
            BswMActionListItemIndex = 0
            BswMActionListItemRef = BswMModeControl/CC_EnablePDUGroup_BMC_HV_XIX_PNC_40_Diagnosis_Energy_Rx_36e9c670
        CC_EnablePDUGroup_BMC_HV_XIX_PNC_40_Diagnosis_Energy_Rx_36e9c670 (BswMAction)
          BswMAvailableActions
            BswMPduGroupSwitch: BswMPduGroupSwitchReinit=false, BswMEnabledPduGroupRef=BMC_HV_XIX_PNC_40_Diagnosis_Energy_Rx_36e9c670
        CC_AL_CN_HCP5_CANFD01_54d90215_PNC_13_Airbag_727cecad_RX_Disable (BswMActionList): BswMActionListExecution=BSWM_TRIGGER
          CC_DisablePDUGroup_BMC_HV_XIX_PNC_13_Airbag_Rx_29234cf7 (BswMActionListItem): BswMAbortOnFail=false, BswMActionListItemIndex=0, BswMActionListItemRef=BswMModeControl/CC_DisablePDUGroup_BMC_HV_XIX_PNC_13_Airbag_Rx_29234cf7
        CC_DisablePDUGroup_BMC_HV_XIX_PNC_13_Airbag_Rx_29234cf7 (BswMAction)
          BswMAvailableActions
            BswMPduGroupSwitch: BswMPduGroupSwitchReinit=false, BswMDisabledPduGroupRef=BMC_HV_XIX_PNC_13_Airbag_Rx_29234cf7
        CC_AL_CN_HCP5_CANFD01_54d90215_PNC_13_Airbag_727cecad_RX_EnableNoinit (BswMActionList): BswMActionListExecution=BSWM_TRIGGER
          CC_EnablePDUGroup_BMC_HV_XIX_PNC_13_Airbag_Rx_29234cf7 (BswMActionListItem): BswMAbortOnFail=false, BswMActionListItemIndex=0, BswMActionListItemRef=BswMModeControl/CC_EnablePDUGroup_BMC_HV_XIX_PNC_13_Airbag_Rx_29234cf7
        CC_EnablePDUGroup_BMC_HV_XIX_PNC_13_Airbag_Rx_29234cf7 (BswMAction)
          BswMAvailableActions
            BswMPduGroupSwitch: BswMPduGroupSwitchReinit=false, BswMEnabledPduGroupRef=BMC_HV_XIX_PNC_13_Airbag_Rx_29234cf7
        CC_AL_CN_HCP5_CANFD01_54d90215_PNC_10_Powertrain_b3959ad4_Disable_DM (BswMActionList): BswMActionListExecution=BSWM_TRIGGER
          CC_DisableDM_BMC_HV_XIX_PNC_10_Powertrain_Rx_c7039922 (BswMActionListItem): BswMAbortOnFail=false, BswMActionListItemIndex=0, BswMActionListItemRef=BswMModeControl/CC_DisableDM_BMC_HV_XIX_PNC_10_Powertrain_Rx_c7039922
        CC_DisableDM_BMC_HV_XIX_PNC_10_Powertrain_Rx_c7039922 (BswMAction)
          BswMAvailableActions
            BswMDeadlineMonitoringControl: BswMDisabledDMPduGroupRef=BMC_HV_XIX_PNC_10_Powertrain_Rx_c7039922
        CC_AL_CN_HCP5_CANFD01_54d90215_PNC_10_Powertrain_b3959ad4_Enable_DM (BswMActionList): BswMActionListExecution=BSWM_TRIGGER
          CC_EnableDM_BMC_HV_XIX_PNC_10_Powertrain_Rx_c7039922 (BswMActionListItem): BswMAbortOnFail=false, BswMActionListItemIndex=0, BswMActionListItemRef=BswMModeControl/CC_EnableDM_BMC_HV_XIX_PNC_10_Powertrain_Rx_c7039922
        CC_EnableDM_BMC_HV_XIX_PNC_10_Powertrain_Rx_c7039922 (BswMAction)
          BswMAvailableActions
            BswMDeadlineMonitoringControl: BswMEnabledDMPduGroupRef=BMC_HV_XIX_PNC_10_Powertrain_Rx_c7039922
        CC_AL_CN_HCP5_CANFD01_54d90215_PNC_40_Diagnosis_Energy_40b20ab8_TX_Disable (BswMActionList): BswMActionListExecution=BSWM_TRIGGER
          CC_DisablePDUGroup_BMC_HV_XIX_PNC_40_Diagnosis_Energy_Tx_60b361f6 (BswMActionListItem):
            BswMAbortOnFail = false
            BswMActionListItemIndex = 0
            BswMActionListItemRef = BswMModeControl/CC_DisablePDUGroup_BMC_HV_XIX_PNC_40_Diagnosis_Energy_Tx_60b361f6
        CC_DisablePDUGroup_BMC_HV_XIX_PNC_40_Diagnosis_Energy_Tx_60b361f6 (BswMAction)
          BswMAvailableActions
            BswMPduGroupSwitch: BswMPduGroupSwitchReinit=false, BswMDisabledPduGroupRef=BMC_HV_XIX_PNC_40_Diagnosis_Energy_Tx_60b361f6
        CC_AL_CN_HCP5_CANFD01_54d90215_PNC_40_Diagnosis_Energy_40b20ab8_TX_EnableNoinit (BswMActionList): BswMActionListExecution=BSWM_TRIGGER
          CC_EnablePDUGroup_BMC_HV_XIX_PNC_40_Diagnosis_Energy_Tx_60b361f6 (BswMActionListItem):
            BswMAbortOnFail = false
            BswMActionListItemIndex = 0
            BswMActionListItemRef = BswMModeControl/CC_EnablePDUGroup_BMC_HV_XIX_PNC_40_Diagnosis_Energy_Tx_60b361f6
        CC_EnablePDUGroup_BMC_HV_XIX_PNC_40_Diagnosis_Energy_Tx_60b361f6 (BswMAction)
          BswMAvailableActions
            BswMPduGroupSwitch: BswMPduGroupSwitchReinit=false, BswMEnabledPduGroupRef=BMC_HV_XIX_PNC_40_Diagnosis_Energy_Tx_60b361f6
        CC_AL_CN_HCP5_CANFD01_54d90215_TX_Disable (BswMActionList): BswMActionListExecution=BSWM_TRIGGER
          CC_DisablePDUGroup_BMC_HV_XIX_HCP5_CANFD01_Tx_3ba05bd9 (BswMActionListItem): BswMAbortOnFail=false, BswMActionListItemIndex=0, BswMActionListItemRef=BswMModeControl/CC_DisablePDUGroup_BMC_HV_XIX_HCP5_CANFD01_Tx_3ba05bd9
        CC_DisablePDUGroup_BMC_HV_XIX_HCP5_CANFD01_Tx_3ba05bd9 (BswMAction)
          BswMAvailableActions
            BswMPduGroupSwitch: BswMPduGroupSwitchReinit=false, BswMDisabledPduGroupRef=BMC_HV_XIX_HCP5_CANFD01_Tx_3ba05bd9
        CC_AL_CN_HCP5_CANFD01_54d90215_TX_EnableNoinit (BswMActionList): BswMActionListExecution=BSWM_TRIGGER
          CC_EnablePDUGroup_BMC_HV_XIX_HCP5_CANFD01_Tx_3ba05bd9 (BswMActionListItem): BswMAbortOnFail=false, BswMActionListItemIndex=0, BswMActionListItemRef=BswMModeControl/CC_EnablePDUGroup_BMC_HV_XIX_HCP5_CANFD01_Tx_3ba05bd9
        CC_EnablePDUGroup_BMC_HV_XIX_HCP5_CANFD01_Tx_3ba05bd9 (BswMAction)
          BswMAvailableActions
            BswMPduGroupSwitch: BswMPduGroupSwitchReinit=false, BswMEnabledPduGroupRef=BMC_HV_XIX_HCP5_CANFD01_Tx_3ba05bd9
        CC_AL_CN_HCP5_CANFD01_54d90215_PNC_02_Basefunction_Powertrain_6b6ac64e_RX_Disable (BswMActionList): BswMActionListExecution=BSWM_TRIGGER
          CC_DisablePDUGroup_BMC_HV_XIX_PNC_02_Basefunction_Powertrain_Rx_dc518468 (BswMActionListItem):
            BswMAbortOnFail = false
            BswMActionListItemIndex = 0
            BswMActionListItemRef = BswMModeControl/CC_DisablePDUGroup_BMC_HV_XIX_PNC_02_Basefunction_Powertrain_Rx_dc518468
        CC_DisablePDUGroup_BMC_HV_XIX_PNC_02_Basefunction_Powertrain_Rx_dc518468 (BswMAction)
          BswMAvailableActions
            BswMPduGroupSwitch: BswMPduGroupSwitchReinit=false, BswMDisabledPduGroupRef=BMC_HV_XIX_PNC_02_Basefunction_Powertrain_Rx_dc518468
        CC_AL_CN_HCP5_CANFD01_54d90215_PNC_02_Basefunction_Powertrain_6b6ac64e_RX_EnableNoinit (BswMActionList): BswMActionListExecution=BSWM_TRIGGER
          CC_EnablePDUGroup_BMC_HV_XIX_PNC_02_Basefunction_Powertrain_Rx_dc518468 (BswMActionListItem):
            BswMAbortOnFail = false
            BswMActionListItemIndex = 0
            BswMActionListItemRef = BswMModeControl/CC_EnablePDUGroup_BMC_HV_XIX_PNC_02_Basefunction_Powertrain_Rx_dc518468
        CC_EnablePDUGroup_BMC_HV_XIX_PNC_02_Basefunction_Powertrain_Rx_dc518468 (BswMAction)
          BswMAvailableActions
            BswMPduGroupSwitch: BswMPduGroupSwitchReinit=false, BswMEnabledPduGroupRef=BMC_HV_XIX_PNC_02_Basefunction_Powertrain_Rx_dc518468
        CC_AL_CN_HCP5_CANFD01_54d90215_PNC_30_EnergyManagement_9072504c_TX_Disable (BswMActionList): BswMActionListExecution=BSWM_TRIGGER
          CC_DisablePDUGroup_BMC_HV_XIX_PNC_30_EnergyManagement_Tx_ff32adc5 (BswMActionListItem):
            BswMAbortOnFail = false
            BswMActionListItemIndex = 0
            BswMActionListItemRef = BswMModeControl/CC_DisablePDUGroup_BMC_HV_XIX_PNC_30_EnergyManagement_Tx_ff32adc5
        CC_DisablePDUGroup_BMC_HV_XIX_PNC_30_EnergyManagement_Tx_ff32adc5 (BswMAction)
          BswMAvailableActions
            BswMPduGroupSwitch: BswMPduGroupSwitchReinit=false, BswMDisabledPduGroupRef=BMC_HV_XIX_PNC_30_EnergyManagement_Tx_ff32adc5
        CC_AL_CN_HCP5_CANFD01_54d90215_PNC_30_EnergyManagement_9072504c_TX_EnableNoinit (BswMActionList): BswMActionListExecution=BSWM_TRIGGER
          CC_EnablePDUGroup_BMC_HV_XIX_PNC_30_EnergyManagement_Tx_ff32adc5 (BswMActionListItem):
            BswMAbortOnFail = false
            BswMActionListItemIndex = 0
            BswMActionListItemRef = BswMModeControl/CC_EnablePDUGroup_BMC_HV_XIX_PNC_30_EnergyManagement_Tx_ff32adc5
        CC_EnablePDUGroup_BMC_HV_XIX_PNC_30_EnergyManagement_Tx_ff32adc5 (BswMAction)
          BswMAvailableActions
            BswMPduGroupSwitch: BswMPduGroupSwitchReinit=false, BswMEnabledPduGroupRef=BMC_HV_XIX_PNC_30_EnergyManagement_Tx_ff32adc5
        CC_AL_CN_HCP5_CANFD01_54d90215_PNC_06_Basefunction_ComfortLight_d2d0a736_Disable_DM (BswMActionList): BswMActionListExecution=BSWM_TRIGGER
          CC_DisableDM_BMC_HV_XIX_PNC_06_Basefunction_ComfortLight_Rx_7861a7a5 (BswMActionListItem):
            BswMAbortOnFail = false
            BswMActionListItemIndex = 0
            BswMActionListItemRef = BswMModeControl/CC_DisableDM_BMC_HV_XIX_PNC_06_Basefunction_ComfortLight_Rx_7861a7a5
        CC_DisableDM_BMC_HV_XIX_PNC_06_Basefunction_ComfortLight_Rx_7861a7a5 (BswMAction)
          BswMAvailableActions
            BswMDeadlineMonitoringControl: BswMDisabledDMPduGroupRef=BMC_HV_XIX_PNC_06_Basefunction_ComfortLight_Rx_7861a7a5
        CC_AL_CN_HCP5_CANFD01_54d90215_PNC_06_Basefunction_ComfortLight_d2d0a736_Enable_DM (BswMActionList): BswMActionListExecution=BSWM_TRIGGER
          CC_EnableDM_BMC_HV_XIX_PNC_06_Basefunction_ComfortLight_Rx_7861a7a5 (BswMActionListItem):
            BswMAbortOnFail = false
            BswMActionListItemIndex = 0
            BswMActionListItemRef = BswMModeControl/CC_EnableDM_BMC_HV_XIX_PNC_06_Basefunction_ComfortLight_Rx_7861a7a5
        CC_EnableDM_BMC_HV_XIX_PNC_06_Basefunction_ComfortLight_Rx_7861a7a5 (BswMAction)
          BswMAvailableActions
            BswMDeadlineMonitoringControl: BswMEnabledDMPduGroupRef=BMC_HV_XIX_PNC_06_Basefunction_ComfortLight_Rx_7861a7a5
        CC_AL_CN_HCP5_CANFD01_54d90215_PNC_02_Basefunction_Powertrain_6b6ac64e_Disable_DM (BswMActionList): BswMActionListExecution=BSWM_TRIGGER
          CC_DisableDM_BMC_HV_XIX_PNC_02_Basefunction_Powertrain_Rx_dc518468 (BswMActionListItem):
            BswMAbortOnFail = false
            BswMActionListItemIndex = 0
            BswMActionListItemRef = BswMModeControl/CC_DisableDM_BMC_HV_XIX_PNC_02_Basefunction_Powertrain_Rx_dc518468
        CC_DisableDM_BMC_HV_XIX_PNC_02_Basefunction_Powertrain_Rx_dc518468 (BswMAction)
          BswMAvailableActions
            BswMDeadlineMonitoringControl: BswMDisabledDMPduGroupRef=BMC_HV_XIX_PNC_02_Basefunction_Powertrain_Rx_dc518468
        CC_AL_CN_HCP5_CANFD01_54d90215_PNC_02_Basefunction_Powertrain_6b6ac64e_Enable_DM (BswMActionList): BswMActionListExecution=BSWM_TRIGGER
          CC_EnableDM_BMC_HV_XIX_PNC_02_Basefunction_Powertrain_Rx_dc518468 (BswMActionListItem):
            BswMAbortOnFail = false
            BswMActionListItemIndex = 0
            BswMActionListItemRef = BswMModeControl/CC_EnableDM_BMC_HV_XIX_PNC_02_Basefunction_Powertrain_Rx_dc518468
        CC_EnableDM_BMC_HV_XIX_PNC_02_Basefunction_Powertrain_Rx_dc518468 (BswMAction)
          BswMAvailableActions
            BswMDeadlineMonitoringControl: BswMEnabledDMPduGroupRef=BMC_HV_XIX_PNC_02_Basefunction_Powertrain_Rx_dc518468
        CC_AL_CN_HCP5_CANFD01_54d90215_PNC_30_EnergyManagement_9072504c_RX_Disable (BswMActionList): BswMActionListExecution=BSWM_TRIGGER
          CC_DisablePDUGroup_BMC_HV_XIX_PNC_30_EnergyManagement_Rx_a9680a43 (BswMActionListItem):
            BswMAbortOnFail = false
            BswMActionListItemIndex = 0
            BswMActionListItemRef = BswMModeControl/CC_DisablePDUGroup_BMC_HV_XIX_PNC_30_EnergyManagement_Rx_a9680a43
        CC_DisablePDUGroup_BMC_HV_XIX_PNC_30_EnergyManagement_Rx_a9680a43 (BswMAction)
          BswMAvailableActions
            BswMPduGroupSwitch: BswMPduGroupSwitchReinit=false, BswMDisabledPduGroupRef=BMC_HV_XIX_PNC_30_EnergyManagement_Rx_a9680a43
        CC_AL_CN_HCP5_CANFD01_54d90215_PNC_30_EnergyManagement_9072504c_RX_EnableNoinit (BswMActionList): BswMActionListExecution=BSWM_TRIGGER
          CC_EnablePDUGroup_BMC_HV_XIX_PNC_30_EnergyManagement_Rx_a9680a43 (BswMActionListItem):
            BswMAbortOnFail = false
            BswMActionListItemIndex = 0
            BswMActionListItemRef = BswMModeControl/CC_EnablePDUGroup_BMC_HV_XIX_PNC_30_EnergyManagement_Rx_a9680a43
        CC_EnablePDUGroup_BMC_HV_XIX_PNC_30_EnergyManagement_Rx_a9680a43 (BswMAction)
          BswMAvailableActions
            BswMPduGroupSwitch: BswMPduGroupSwitchReinit=false, BswMEnabledPduGroupRef=BMC_HV_XIX_PNC_30_EnergyManagement_Rx_a9680a43
        CC_AL_CN_HCP5_CANFD01_54d90215_Disable_DM (BswMActionList): BswMActionListExecution=BSWM_TRIGGER
          CC_DisableDM_BMC_HV_XIX_HCP5_CANFD01_Rx_6dfafc5f (BswMActionListItem): BswMAbortOnFail=false, BswMActionListItemIndex=0, BswMActionListItemRef=BswMModeControl/CC_DisableDM_BMC_HV_XIX_HCP5_CANFD01_Rx_6dfafc5f
        CC_DisableDM_BMC_HV_XIX_HCP5_CANFD01_Rx_6dfafc5f (BswMAction)
          BswMAvailableActions
            BswMDeadlineMonitoringControl: BswMDisabledDMPduGroupRef=BMC_HV_XIX_HCP5_CANFD01_Rx_6dfafc5f
        CC_AL_CN_HCP5_CANFD01_54d90215_Enable_DM (BswMActionList): BswMActionListExecution=BSWM_TRIGGER
          CC_EnableDM_BMC_HV_XIX_HCP5_CANFD01_Rx_6dfafc5f (BswMActionListItem): BswMAbortOnFail=false, BswMActionListItemIndex=0, BswMActionListItemRef=BswMModeControl/CC_EnableDM_BMC_HV_XIX_HCP5_CANFD01_Rx_6dfafc5f
        CC_EnableDM_BMC_HV_XIX_HCP5_CANFD01_Rx_6dfafc5f (BswMAction)
          BswMAvailableActions
            BswMDeadlineMonitoringControl: BswMEnabledDMPduGroupRef=BMC_HV_XIX_HCP5_CANFD01_Rx_6dfafc5f
        CC_AL_CN_HCP5_CANFD01_54d90215_PNC_26_HighVoltage_Charging_24d89ab8_Disable_DM (BswMActionList): BswMActionListExecution=BSWM_TRIGGER
          CC_DisableDM_BMC_HV_XIX_PNC_26_HighVoltage_Charging_Rx_765b82c2 (BswMActionListItem):
            BswMAbortOnFail = false
            BswMActionListItemIndex = 0
            BswMActionListItemRef = BswMModeControl/CC_DisableDM_BMC_HV_XIX_PNC_26_HighVoltage_Charging_Rx_765b82c2
        CC_DisableDM_BMC_HV_XIX_PNC_26_HighVoltage_Charging_Rx_765b82c2 (BswMAction)
          BswMAvailableActions
            BswMDeadlineMonitoringControl: BswMDisabledDMPduGroupRef=BMC_HV_XIX_PNC_26_HighVoltage_Charging_Rx_765b82c2
        CC_AL_CN_HCP5_CANFD01_54d90215_PNC_26_HighVoltage_Charging_24d89ab8_Enable_DM (BswMActionList): BswMActionListExecution=BSWM_TRIGGER
          CC_EnableDM_BMC_HV_XIX_PNC_26_HighVoltage_Charging_Rx_765b82c2 (BswMActionListItem):
            BswMAbortOnFail = false
            BswMActionListItemIndex = 0
            BswMActionListItemRef = BswMModeControl/CC_EnableDM_BMC_HV_XIX_PNC_26_HighVoltage_Charging_Rx_765b82c2
        CC_EnableDM_BMC_HV_XIX_PNC_26_HighVoltage_Charging_Rx_765b82c2 (BswMAction)
          BswMAvailableActions
            BswMDeadlineMonitoringControl: BswMEnabledDMPduGroupRef=BMC_HV_XIX_PNC_26_HighVoltage_Charging_Rx_765b82c2
        CC_AL_CN_HCP5_CANFD01_54d90215_PNC_11_Chassis_dce36bbc_Disable_DM (BswMActionList): BswMActionListExecution=BSWM_TRIGGER
          CC_DisableDM_BMC_HV_XIX_PNC_11_Chassis_Rx_1f7dfb2f (BswMActionListItem): BswMAbortOnFail=false, BswMActionListItemIndex=0, BswMActionListItemRef=BswMModeControl/CC_DisableDM_BMC_HV_XIX_PNC_11_Chassis_Rx_1f7dfb2f
        CC_DisableDM_BMC_HV_XIX_PNC_11_Chassis_Rx_1f7dfb2f (BswMAction)
          BswMAvailableActions
            BswMDeadlineMonitoringControl: BswMDisabledDMPduGroupRef=BMC_HV_XIX_PNC_11_Chassis_Rx_1f7dfb2f
        CC_AL_CN_HCP5_CANFD01_54d90215_PNC_11_Chassis_dce36bbc_Enable_DM (BswMActionList): BswMActionListExecution=BSWM_TRIGGER
          CC_EnableDM_BMC_HV_XIX_PNC_11_Chassis_Rx_1f7dfb2f (BswMActionListItem): BswMAbortOnFail=false, BswMActionListItemIndex=0, BswMActionListItemRef=BswMModeControl/CC_EnableDM_BMC_HV_XIX_PNC_11_Chassis_Rx_1f7dfb2f
        CC_EnableDM_BMC_HV_XIX_PNC_11_Chassis_Rx_1f7dfb2f (BswMAction)
          BswMAvailableActions
            BswMDeadlineMonitoringControl: BswMEnabledDMPduGroupRef=BMC_HV_XIX_PNC_11_Chassis_Rx_1f7dfb2f
        CC_AL_CN_HCP5_CANFD01_54d90215_PNC_11_Chassis_dce36bbc_RX_Disable (BswMActionList): BswMActionListExecution=BSWM_TRIGGER
          CC_DisablePDUGroup_BMC_HV_XIX_PNC_11_Chassis_Rx_1f7dfb2f (BswMActionListItem): BswMAbortOnFail=false, BswMActionListItemIndex=0, BswMActionListItemRef=BswMModeControl/CC_DisablePDUGroup_BMC_HV_XIX_PNC_11_Chassis_Rx_1f7dfb2f
        CC_DisablePDUGroup_BMC_HV_XIX_PNC_11_Chassis_Rx_1f7dfb2f (BswMAction)
          BswMAvailableActions
            BswMPduGroupSwitch: BswMPduGroupSwitchReinit=false, BswMDisabledPduGroupRef=BMC_HV_XIX_PNC_11_Chassis_Rx_1f7dfb2f
        CC_AL_CN_HCP5_CANFD01_54d90215_PNC_11_Chassis_dce36bbc_RX_EnableNoinit (BswMActionList): BswMActionListExecution=BSWM_TRIGGER
          CC_EnablePDUGroup_BMC_HV_XIX_PNC_11_Chassis_Rx_1f7dfb2f (BswMActionListItem): BswMAbortOnFail=false, BswMActionListItemIndex=0, BswMActionListItemRef=BswMModeControl/CC_EnablePDUGroup_BMC_HV_XIX_PNC_11_Chassis_Rx_1f7dfb2f
        CC_EnablePDUGroup_BMC_HV_XIX_PNC_11_Chassis_Rx_1f7dfb2f (BswMAction)
          BswMAvailableActions
            BswMPduGroupSwitch: BswMPduGroupSwitchReinit=false, BswMEnabledPduGroupRef=BMC_HV_XIX_PNC_11_Chassis_Rx_1f7dfb2f
        CC_AL_CN_HCP5_CANFD01_54d90215_PNC_26_HighVoltage_Charging_24d89ab8_TX_Disable (BswMActionList): BswMActionListExecution=BSWM_TRIGGER
          CC_DisablePDUGroup_BMC_HV_XIX_PNC_26_HighVoltage_Charging_Tx_20012544 (BswMActionListItem):
            BswMAbortOnFail = false
            BswMActionListItemIndex = 0
            BswMActionListItemRef = BswMModeControl/CC_DisablePDUGroup_BMC_HV_XIX_PNC_26_HighVoltage_Charging_Tx_20012544
        CC_DisablePDUGroup_BMC_HV_XIX_PNC_26_HighVoltage_Charging_Tx_20012544 (BswMAction)
          BswMAvailableActions
            BswMPduGroupSwitch: BswMPduGroupSwitchReinit=false, BswMDisabledPduGroupRef=BMC_HV_XIX_PNC_26_HighVoltage_Charging_Tx_20012544
        CC_AL_CN_HCP5_CANFD01_54d90215_PNC_26_HighVoltage_Charging_24d89ab8_TX_EnableNoinit (BswMActionList): BswMActionListExecution=BSWM_TRIGGER
          CC_EnablePDUGroup_BMC_HV_XIX_PNC_26_HighVoltage_Charging_Tx_20012544 (BswMActionListItem):
            BswMAbortOnFail = false
            BswMActionListItemIndex = 0
            BswMActionListItemRef = BswMModeControl/CC_EnablePDUGroup_BMC_HV_XIX_PNC_26_HighVoltage_Charging_Tx_20012544
        CC_EnablePDUGroup_BMC_HV_XIX_PNC_26_HighVoltage_Charging_Tx_20012544 (BswMAction)
          BswMAvailableActions
            BswMPduGroupSwitch: BswMPduGroupSwitchReinit=false, BswMEnabledPduGroupRef=BMC_HV_XIX_PNC_26_HighVoltage_Charging_Tx_20012544
        CC_AL_CN_HCP5_CANFD01_54d90215_PNC_10_Powertrain_b3959ad4_RX_Disable (BswMActionList): BswMActionListExecution=BSWM_TRIGGER
          CC_DisablePDUGroup_BMC_HV_XIX_PNC_10_Powertrain_Rx_c7039922 (BswMActionListItem):
            BswMAbortOnFail = false
            BswMActionListItemIndex = 0
            BswMActionListItemRef = BswMModeControl/CC_DisablePDUGroup_BMC_HV_XIX_PNC_10_Powertrain_Rx_c7039922
        CC_DisablePDUGroup_BMC_HV_XIX_PNC_10_Powertrain_Rx_c7039922 (BswMAction)
          BswMAvailableActions
            BswMPduGroupSwitch: BswMPduGroupSwitchReinit=false, BswMDisabledPduGroupRef=BMC_HV_XIX_PNC_10_Powertrain_Rx_c7039922
        CC_AL_CN_HCP5_CANFD01_54d90215_PNC_10_Powertrain_b3959ad4_RX_EnableNoinit (BswMActionList): BswMActionListExecution=BSWM_TRIGGER
          CC_EnablePDUGroup_BMC_HV_XIX_PNC_10_Powertrain_Rx_c7039922 (BswMActionListItem):
            BswMAbortOnFail = false
            BswMActionListItemIndex = 0
            BswMActionListItemRef = BswMModeControl/CC_EnablePDUGroup_BMC_HV_XIX_PNC_10_Powertrain_Rx_c7039922
        CC_EnablePDUGroup_BMC_HV_XIX_PNC_10_Powertrain_Rx_c7039922 (BswMAction)
          BswMAvailableActions
            BswMPduGroupSwitch: BswMPduGroupSwitchReinit=false, BswMEnabledPduGroupRef=BMC_HV_XIX_PNC_10_Powertrain_Rx_c7039922
        CC_AL_CN_HCP5_CANFD01_54d90215_PNC_01_CarWakeUp_d7102746_TX_Disable (BswMActionList): BswMActionListExecution=BSWM_TRIGGER
          CC_DisablePDUGroup_BMC_HV_XIX_PNC_01_CarWakeUp_Tx_29969a84 (BswMActionListItem):
            BswMAbortOnFail = false
            BswMActionListItemIndex = 0
            BswMActionListItemRef = BswMModeControl/CC_DisablePDUGroup_BMC_HV_XIX_PNC_01_CarWakeUp_Tx_29969a84
        CC_DisablePDUGroup_BMC_HV_XIX_PNC_01_CarWakeUp_Tx_29969a84 (BswMAction)
          BswMAvailableActions
            BswMPduGroupSwitch: BswMPduGroupSwitchReinit=false, BswMDisabledPduGroupRef=BMC_HV_XIX_PNC_01_CarWakeUp_Tx_29969a84
        CC_AL_CN_HCP5_CANFD01_54d90215_PNC_01_CarWakeUp_d7102746_TX_EnableNoinit (BswMActionList): BswMActionListExecution=BSWM_TRIGGER
          CC_EnablePDUGroup_BMC_HV_XIX_PNC_01_CarWakeUp_Tx_29969a84 (BswMActionListItem):
            BswMAbortOnFail = false
            BswMActionListItemIndex = 0
            BswMActionListItemRef = BswMModeControl/CC_EnablePDUGroup_BMC_HV_XIX_PNC_01_CarWakeUp_Tx_29969a84
        CC_EnablePDUGroup_BMC_HV_XIX_PNC_01_CarWakeUp_Tx_29969a84 (BswMAction)
          BswMAvailableActions
            BswMPduGroupSwitch: BswMPduGroupSwitchReinit=false, BswMEnabledPduGroupRef=BMC_HV_XIX_PNC_01_CarWakeUp_Tx_29969a84
        CC_AL_CN_HCP5_CANFD01_54d90215_RX_Disable (BswMActionList): BswMActionListExecution=BSWM_TRIGGER
          CC_DisablePDUGroup_BMC_HV_XIX_HCP5_CANFD01_Rx_6dfafc5f (BswMActionListItem): BswMAbortOnFail=false, BswMActionListItemIndex=0, BswMActionListItemRef=BswMModeControl/CC_DisablePDUGroup_BMC_HV_XIX_HCP5_CANFD01_Rx_6dfafc5f
        CC_DisablePDUGroup_BMC_HV_XIX_HCP5_CANFD01_Rx_6dfafc5f (BswMAction)
          BswMAvailableActions
            BswMPduGroupSwitch: BswMPduGroupSwitchReinit=false, BswMDisabledPduGroupRef=BMC_HV_XIX_HCP5_CANFD01_Rx_6dfafc5f
        CC_AL_CN_HCP5_CANFD01_54d90215_RX_EnableNoinit (BswMActionList): BswMActionListExecution=BSWM_TRIGGER
          CC_EnablePDUGroup_BMC_HV_XIX_HCP5_CANFD01_Rx_6dfafc5f (BswMActionListItem): BswMAbortOnFail=false, BswMActionListItemIndex=0, BswMActionListItemRef=BswMModeControl/CC_EnablePDUGroup_BMC_HV_XIX_HCP5_CANFD01_Rx_6dfafc5f
        CC_EnablePDUGroup_BMC_HV_XIX_HCP5_CANFD01_Rx_6dfafc5f (BswMAction)
          BswMAvailableActions
            BswMPduGroupSwitch: BswMPduGroupSwitchReinit=false, BswMEnabledPduGroupRef=BMC_HV_XIX_HCP5_CANFD01_Rx_6dfafc5f
        CC_AL_CN_HCP5_CANFD01_54d90215_PNC_13_Airbag_727cecad_Disable_DM (BswMActionList): BswMActionListExecution=BSWM_TRIGGER
          CC_DisableDM_BMC_HV_XIX_PNC_13_Airbag_Rx_29234cf7 (BswMActionListItem): BswMAbortOnFail=false, BswMActionListItemIndex=0, BswMActionListItemRef=BswMModeControl/CC_DisableDM_BMC_HV_XIX_PNC_13_Airbag_Rx_29234cf7
        CC_DisableDM_BMC_HV_XIX_PNC_13_Airbag_Rx_29234cf7 (BswMAction)
          BswMAvailableActions
            BswMDeadlineMonitoringControl: BswMDisabledDMPduGroupRef=BMC_HV_XIX_PNC_13_Airbag_Rx_29234cf7
        CC_AL_CN_HCP5_CANFD01_54d90215_PNC_13_Airbag_727cecad_Enable_DM (BswMActionList): BswMActionListExecution=BSWM_TRIGGER
          CC_EnableDM_BMC_HV_XIX_PNC_13_Airbag_Rx_29234cf7 (BswMActionListItem): BswMAbortOnFail=false, BswMActionListItemIndex=0, BswMActionListItemRef=BswMModeControl/CC_EnableDM_BMC_HV_XIX_PNC_13_Airbag_Rx_29234cf7
        CC_EnableDM_BMC_HV_XIX_PNC_13_Airbag_Rx_29234cf7 (BswMAction)
          BswMAvailableActions
            BswMDeadlineMonitoringControl: BswMEnabledDMPduGroupRef=BMC_HV_XIX_PNC_13_Airbag_Rx_29234cf7
        CC_AL_CN_HCP5_CANFD01_54d90215_PNC_27_Timemaster_Timer_8da5bb27_RX_Disable (BswMActionList): BswMActionListExecution=BSWM_TRIGGER
          CC_DisablePDUGroup_BMC_HV_XIX_PNC_27_Timemaster_Timer_Rx_2db6b092 (BswMActionListItem):
            BswMAbortOnFail = false
            BswMActionListItemIndex = 0
            BswMActionListItemRef = BswMModeControl/CC_DisablePDUGroup_BMC_HV_XIX_PNC_27_Timemaster_Timer_Rx_2db6b092
        CC_DisablePDUGroup_BMC_HV_XIX_PNC_27_Timemaster_Timer_Rx_2db6b092 (BswMAction)
          BswMAvailableActions
            BswMPduGroupSwitch: BswMPduGroupSwitchReinit=false, BswMDisabledPduGroupRef=BMC_HV_XIX_PNC_27_Timemaster_Timer_Rx_2db6b092
        CC_AL_CN_HCP5_CANFD01_54d90215_PNC_27_Timemaster_Timer_8da5bb27_RX_EnableNoinit (BswMActionList): BswMActionListExecution=BSWM_TRIGGER
          CC_EnablePDUGroup_BMC_HV_XIX_PNC_27_Timemaster_Timer_Rx_2db6b092 (BswMActionListItem):
            BswMAbortOnFail = false
            BswMActionListItemIndex = 0
            BswMActionListItemRef = BswMModeControl/CC_EnablePDUGroup_BMC_HV_XIX_PNC_27_Timemaster_Timer_Rx_2db6b092
        CC_EnablePDUGroup_BMC_HV_XIX_PNC_27_Timemaster_Timer_Rx_2db6b092 (BswMAction)
          BswMAvailableActions
            BswMPduGroupSwitch: BswMPduGroupSwitchReinit=false, BswMEnabledPduGroupRef=BMC_HV_XIX_PNC_27_Timemaster_Timer_Rx_2db6b092
        CC_AL_CN_HCP5_CANFD01_54d90215_PNC_26_HighVoltage_Charging_24d89ab8_RX_Disable (BswMActionList): BswMActionListExecution=BSWM_TRIGGER
          CC_DisablePDUGroup_BMC_HV_XIX_PNC_26_HighVoltage_Charging_Rx_765b82c2 (BswMActionListItem):
            BswMAbortOnFail = false
            BswMActionListItemIndex = 0
            BswMActionListItemRef = BswMModeControl/CC_DisablePDUGroup_BMC_HV_XIX_PNC_26_HighVoltage_Charging_Rx_765b82c2
        CC_DisablePDUGroup_BMC_HV_XIX_PNC_26_HighVoltage_Charging_Rx_765b82c2 (BswMAction)
          BswMAvailableActions
            BswMPduGroupSwitch: BswMPduGroupSwitchReinit=false, BswMDisabledPduGroupRef=BMC_HV_XIX_PNC_26_HighVoltage_Charging_Rx_765b82c2
        CC_AL_CN_HCP5_CANFD01_54d90215_PNC_26_HighVoltage_Charging_24d89ab8_RX_EnableNoinit (BswMActionList): BswMActionListExecution=BSWM_TRIGGER
          CC_EnablePDUGroup_BMC_HV_XIX_PNC_26_HighVoltage_Charging_Rx_765b82c2 (BswMActionListItem):
            BswMAbortOnFail = false
            BswMActionListItemIndex = 0
            BswMActionListItemRef = BswMModeControl/CC_EnablePDUGroup_BMC_HV_XIX_PNC_26_HighVoltage_Charging_Rx_765b82c2
        CC_EnablePDUGroup_BMC_HV_XIX_PNC_26_HighVoltage_Charging_Rx_765b82c2 (BswMAction)
          BswMAvailableActions
            BswMPduGroupSwitch: BswMPduGroupSwitchReinit=false, BswMEnabledPduGroupRef=BMC_HV_XIX_PNC_26_HighVoltage_Charging_Rx_765b82c2
        CC_AL_CN_HCP5_CANFD01_54d90215_PNC_07_Basefunction_CrossSection_7b625db2_RX_Disable (BswMActionList): BswMActionListExecution=BSWM_TRIGGER
          CC_DisablePDUGroup_BMC_HV_XIX_PNC_07_Basefunction_CrossSection_Rx_4fb7c882 (BswMActionListItem):
            BswMAbortOnFail = false
            BswMActionListItemIndex = 0
            BswMActionListItemRef = BswMModeControl/CC_DisablePDUGroup_BMC_HV_XIX_PNC_07_Basefunction_CrossSection_Rx_4fb7c882
        CC_DisablePDUGroup_BMC_HV_XIX_PNC_07_Basefunction_CrossSection_Rx_4fb7c882 (BswMAction)
          BswMAvailableActions
            BswMPduGroupSwitch: BswMPduGroupSwitchReinit=false, BswMDisabledPduGroupRef=BMC_HV_XIX_PNC_07_Basefunction_CrossSection_Rx_4fb7c882
        CC_AL_CN_HCP5_CANFD01_54d90215_PNC_07_Basefunction_CrossSection_7b625db2_RX_EnableNoinit (BswMActionList): BswMActionListExecution=BSWM_TRIGGER
          CC_EnablePDUGroup_BMC_HV_XIX_PNC_07_Basefunction_CrossSection_Rx_4fb7c882 (BswMActionListItem):
            BswMAbortOnFail = false
            BswMActionListItemIndex = 0
            BswMActionListItemRef = BswMModeControl/CC_EnablePDUGroup_BMC_HV_XIX_PNC_07_Basefunction_CrossSection_Rx_4fb7c882
        CC_EnablePDUGroup_BMC_HV_XIX_PNC_07_Basefunction_CrossSection_Rx_4fb7c882 (BswMAction)
          BswMAvailableActions
            BswMPduGroupSwitch: BswMPduGroupSwitchReinit=false, BswMEnabledPduGroupRef=BMC_HV_XIX_PNC_07_Basefunction_CrossSection_Rx_4fb7c882
        CC_AL_CN_HCP5_CANFD01_54d90215_PNC_24_ThermoManagement_4f639819_Disable_DM (BswMActionList): BswMActionListExecution=BSWM_TRIGGER
          CC_DisableDM_BMC_HV_XIX_PNC_24_ThermoManagement_Rx_9f1a6723 (BswMActionListItem):
            BswMAbortOnFail = false
            BswMActionListItemIndex = 0
            BswMActionListItemRef = BswMModeControl/CC_DisableDM_BMC_HV_XIX_PNC_24_ThermoManagement_Rx_9f1a6723
        CC_DisableDM_BMC_HV_XIX_PNC_24_ThermoManagement_Rx_9f1a6723 (BswMAction)
          BswMAvailableActions
            BswMDeadlineMonitoringControl: BswMDisabledDMPduGroupRef=BMC_HV_XIX_PNC_24_ThermoManagement_Rx_9f1a6723
        CC_AL_CN_HCP5_CANFD01_54d90215_PNC_24_ThermoManagement_4f639819_Enable_DM (BswMActionList): BswMActionListExecution=BSWM_TRIGGER
          CC_EnableDM_BMC_HV_XIX_PNC_24_ThermoManagement_Rx_9f1a6723 (BswMActionListItem):
            BswMAbortOnFail = false
            BswMActionListItemIndex = 0
            BswMActionListItemRef = BswMModeControl/CC_EnableDM_BMC_HV_XIX_PNC_24_ThermoManagement_Rx_9f1a6723
        CC_EnableDM_BMC_HV_XIX_PNC_24_ThermoManagement_Rx_9f1a6723 (BswMAction)
          BswMAvailableActions
            BswMDeadlineMonitoringControl: BswMEnabledDMPduGroupRef=BMC_HV_XIX_PNC_24_ThermoManagement_Rx_9f1a6723
        CC_AL_CN_HCP5_CANFD01_54d90215_PNC_07_Basefunction_CrossSection_7b625db2_Disable_DM (BswMActionList): BswMActionListExecution=BSWM_TRIGGER
          CC_DisableDM_BMC_HV_XIX_PNC_07_Basefunction_CrossSection_Rx_4fb7c882 (BswMActionListItem):
            BswMAbortOnFail = false
            BswMActionListItemIndex = 0
            BswMActionListItemRef = BswMModeControl/CC_DisableDM_BMC_HV_XIX_PNC_07_Basefunction_CrossSection_Rx_4fb7c882
        CC_DisableDM_BMC_HV_XIX_PNC_07_Basefunction_CrossSection_Rx_4fb7c882 (BswMAction)
          BswMAvailableActions
            BswMDeadlineMonitoringControl: BswMDisabledDMPduGroupRef=BMC_HV_XIX_PNC_07_Basefunction_CrossSection_Rx_4fb7c882
        CC_AL_CN_HCP5_CANFD01_54d90215_PNC_07_Basefunction_CrossSection_7b625db2_Enable_DM (BswMActionList): BswMActionListExecution=BSWM_TRIGGER
          CC_EnableDM_BMC_HV_XIX_PNC_07_Basefunction_CrossSection_Rx_4fb7c882 (BswMActionListItem):
            BswMAbortOnFail = false
            BswMActionListItemIndex = 0
            BswMActionListItemRef = BswMModeControl/CC_EnableDM_BMC_HV_XIX_PNC_07_Basefunction_CrossSection_Rx_4fb7c882
        CC_EnableDM_BMC_HV_XIX_PNC_07_Basefunction_CrossSection_Rx_4fb7c882 (BswMAction)
          BswMAvailableActions
            BswMDeadlineMonitoringControl: BswMEnabledDMPduGroupRef=BMC_HV_XIX_PNC_07_Basefunction_CrossSection_Rx_4fb7c882
        CC_AL_CN_HCP5_CANFD01_54d90215_PNC_40_Diagnosis_Energy_40b20ab8_Disable_DM (BswMActionList): BswMActionListExecution=BSWM_TRIGGER
          CC_DisableDM_BMC_HV_XIX_PNC_40_Diagnosis_Energy_Rx_36e9c670 (BswMActionListItem):
            BswMAbortOnFail = false
            BswMActionListItemIndex = 0
            BswMActionListItemRef = BswMModeControl/CC_DisableDM_BMC_HV_XIX_PNC_40_Diagnosis_Energy_Rx_36e9c670
        CC_DisableDM_BMC_HV_XIX_PNC_40_Diagnosis_Energy_Rx_36e9c670 (BswMAction)
          BswMAvailableActions
            BswMDeadlineMonitoringControl: BswMDisabledDMPduGroupRef=BMC_HV_XIX_PNC_40_Diagnosis_Energy_Rx_36e9c670
        CC_AL_CN_HCP5_CANFD01_54d90215_PNC_40_Diagnosis_Energy_40b20ab8_Enable_DM (BswMActionList): BswMActionListExecution=BSWM_TRIGGER
          CC_EnableDM_BMC_HV_XIX_PNC_40_Diagnosis_Energy_Rx_36e9c670 (BswMActionListItem):
            BswMAbortOnFail = false
            BswMActionListItemIndex = 0
            BswMActionListItemRef = BswMModeControl/CC_EnableDM_BMC_HV_XIX_PNC_40_Diagnosis_Energy_Rx_36e9c670
        CC_EnableDM_BMC_HV_XIX_PNC_40_Diagnosis_Energy_Rx_36e9c670 (BswMAction)
          BswMAvailableActions
            BswMDeadlineMonitoringControl: BswMEnabledDMPduGroupRef=BMC_HV_XIX_PNC_40_Diagnosis_Energy_Rx_36e9c670
        CC_AL_CN_HCP5_CANFD01_54d90215_PNC_06_Basefunction_ComfortLight_d2d0a736_RX_Disable (BswMActionList): BswMActionListExecution=BSWM_TRIGGER
          CC_DisablePDUGroup_BMC_HV_XIX_PNC_06_Basefunction_ComfortLight_Rx_7861a7a5 (BswMActionListItem):
            BswMAbortOnFail = false
            BswMActionListItemIndex = 0
            BswMActionListItemRef = BswMModeControl/CC_DisablePDUGroup_BMC_HV_XIX_PNC_06_Basefunction_ComfortLight_Rx_7861a7a5
        CC_DisablePDUGroup_BMC_HV_XIX_PNC_06_Basefunction_ComfortLight_Rx_7861a7a5 (BswMAction)
          BswMAvailableActions
            BswMPduGroupSwitch: BswMPduGroupSwitchReinit=false, BswMDisabledPduGroupRef=BMC_HV_XIX_PNC_06_Basefunction_ComfortLight_Rx_7861a7a5
        CC_AL_CN_HCP5_CANFD01_54d90215_PNC_06_Basefunction_ComfortLight_d2d0a736_RX_EnableNoinit (BswMActionList): BswMActionListExecution=BSWM_TRIGGER
          CC_EnablePDUGroup_BMC_HV_XIX_PNC_06_Basefunction_ComfortLight_Rx_7861a7a5 (BswMActionListItem):
            BswMAbortOnFail = false
            BswMActionListItemIndex = 0
            BswMActionListItemRef = BswMModeControl/CC_EnablePDUGroup_BMC_HV_XIX_PNC_06_Basefunction_ComfortLight_Rx_7861a7a5
        3 x BswMAction:
          CC_EnablePDUGroup_BMC_HV_XIX_PNC_06_Basefunction_ComfortLight_Rx_7861a7a5
            BswMAvailableActions
              BswMPduGroupSwitch: BswMPduGroupSwitchReinit=false, BswMEnabledPduGroupRef=BMC_HV_XIX_PNC_06_Basefunction_ComfortLight_Rx_7861a7a5
          INIT_Action_BAP_Init
            BswMAvailableActions
              BswMUserCallout: BswMUserCalloutFunction=BAP_Wrapper_Init(), BswMCreateCallout=false, BswMUserIncludeFile=BAP.h
          ECUReset_BswMAction
            BswMAvailableActions
              Reset_UserCallout (BswMUserCallout): BswMUserCalloutFunction=ECU_Reset_Test(), BswMCreateCallout=true, BswMUserCode=Mcu_PerformReset();, BswMUserIncludeFile=Mcu.h
        AL_Dcm_Reset (BswMActionList): BswMActionListExecution=BSWM_TRIGGER
          ECUReset_BswMAction (BswMActionListItem): BswMAbortOnFail=false, BswMActionListItemIndex=0, BswMActionListItemRef=BswMModeControl/ECUReset_BswMAction
      ESH_Mode (BswMRteModeDclGroup): BswMInitMode=STARTUP
        5 x BswMRteMode:
          STARTUP: BswMModePhysicalValue=0
          RUN: BswMModePhysicalValue=1
          POSTRUN: BswMModePhysicalValue=2
          WAKEUP: BswMModePhysicalValue=3
          SHUTDOWN: BswMModePhysicalValue=4
      BswMDataTypeMappingSets: BswMDataTypeMappingSetRef=BswMMappingSet
      ESH_RunRequest (BswMRteModeDclGroup): BswMInitMode=RELEASED
        RELEASED (BswMRteMode): BswMModePhysicalValue=0
        REQUESTED (BswMRteMode): BswMModePhysicalValue=1
    BswMConfig_EcucPartition_SystemApplication_Core1 (BswMConfig): BswMPartitionRef=EcucPartition_SystemApplication_Core1
      BswMArbitration
      BswMModeControl: BswMInitActionListRef=INIT_AL_Initialize_BswMConfig_EcucPartition_SystemApplication_Core1
        INIT_AL_Initialize_BswMConfig_EcucPartition_SystemApplication_Core1 (BswMActionList): BswMActionListExecution=BSWM_CONDITION, BswMActionListPriority=100
          BswMUserCallout (BswMActionListItem): BswMAbortOnFail=false, BswMActionListItemIndex=1, BswMActionListItemRef=BswMModeControl/BswMUserCallout
          INIT_Action_Wdg_17_Scu_Init (BswMActionListItem): BswMAbortOnFail=false, BswMActionListItemIndex=0, BswMActionListItemRef=BswMModeControl/INIT_Action_Wdg_17_Scu_Init
        3 x BswMAction:
          BswMUserCallout
            BswMAvailableActions
              BswMUserCallout: BswMUserCalloutFunction=ApplBswM_InitDoneSynchronized_Core1(), BswMCreateCallout=false, BswMUserIncludeFile=Demo.h
          INIT_Action_EnableInterrupts
            BswMAvailableActions
              BswMUserCallout: BswMUserCalloutFunction=BswM_AL_SetProgrammableInterrupts(), BswMCreateCallout=true
          INIT_Action_Wdg_17_Scu_Init
            BswMAvailableActions
              BswMUserCallout: BswMUserCalloutFunction=Wdg_17_Scu_Init(&Wdg_17_Scu_Config_1), BswMCreateCallout=false, BswMUserIncludeFile=Wdg_17_Scu.h
