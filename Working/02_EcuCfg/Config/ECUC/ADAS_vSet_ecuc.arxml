AUTOSAR XML (schema 4-3-0)
package /ActiveEcuC
  module config vSet: implementation-config-variant=VARIANT-PRE-COMPILE, module-description=vSet_Impl
    vSetGeneral: vSetDummyStatementKind=SelfAssignment
    vSetPlatform:
      vSetBitOrder = LSB_to_MSB
      vSetSizeOfInt = Size32Bit
      vSetSizeOfRAMPointer = Size32Bit
      vSetSizeOfROMPointer = Size32Bit
      vSetByteOrder = LITTLE_ENDIAN
      vSetCPUType = CPU32Bit
      vSetSizeOfEnum = Size32Bit
    vSetCalibration
    vSetBswInitialization
      124 x vSetInitFunction:
        Brs_Init: vSetHeader=, vSetModuleRef=vBRS  # /ActiveEcuC/vBRS PLAIN_TEXT Automatically generated by BswInitFctConfigurationService.
          vSetInitFunctionInstance: vSetInitPhase=NO_INIT
        BswM_PreInit: vSetHeader=BswM.h, vSetConfigType=BswM_ConfigType, vSetConfigPtrClass=BSWM_INIT_DATA, vSetModuleRef=BswM  # /ActiveEcuC/BswM PLAIN_TEXT PreInit function description of BswM in UnfilteredViewInInvariantProject (UnfilteredInvariantProjectModelView) .
          vSetInitFunctionInstance: vSetInitPhase=INIT_ONE, vSetConfigPtrName=BswM_Config_Ptr
        BswM_InitMemory: vSetHeader=BswM.h, vSetModuleRef=BswM  # /ActiveEcuC/BswM PLAIN_TEXT InitMemory function description of BswM in UnfilteredViewInInvariantProject (UnfilteredInvariantProjectModelView) .
          vSetInitFunctionInstance: vSetInitPhase=INIT_MEMORY
        BswM_Init: vSetHeader=BswM.h, vSetConfigType=BswM_ConfigType, vSetConfigPtrClass=BSWM_INIT_DATA, vSetModuleRef=BswM  # /ActiveEcuC/BswM PLAIN_TEXT Init function description of BswM in UnfilteredViewInInvariantProject (UnfilteredInvariantProjectModelView) .
          vSetInitFunctionInstance: vSetInitPhase=NO_INIT, vSetConfigPtrName=BswM_Config_Ptr
        CanIf_InitMemory: vSetHeader=CanIf.h, vSetModuleRef=CanIf  # /ActiveEcuC/CanIf PLAIN_TEXT InitMemory function description of CanIf in UnfilteredViewInInvariantProject (UnfilteredInvariantProjectModelView) .
          vSetInitFunctionInstance: vSetInitPhase=INIT_MEMORY
        CanIf_Init: vSetHeader=CanIf.h, vSetConfigType=CanIf_ConfigType, vSetConfigPtrClass=CANIF_INIT_DATA, vSetModuleRef=CanIf  # /ActiveEcuC/CanIf PLAIN_TEXT Init function description of CanIf in UnfilteredViewInInvariantProject (UnfilteredInvariantProjectModelView) .
          vSetInitFunctionInstance: vSetInitPhase=INIT_TWO_IF, vSetConfigPtrName=CanIf_Config_Ptr
        CanNm_Init: vSetHeader=CanNm.h, vSetConfigType=CanNm_ConfigType, vSetConfigPtrClass=CANNM_INIT_DATA, vSetModuleRef=CanNm  # /ActiveEcuC/CanNm PLAIN_TEXT Init function description of CanNm in UnfilteredViewInInvariantProject (UnfilteredInvariantProjectModelView) .
          vSetInitFunctionInstance: vSetInitPhase=INIT_TWO_NM, vSetConfigPtrName=CanNm_Config_Ptr
        CanNm_InitMemory: vSetHeader=CanNm.h, vSetModuleRef=CanNm  # /ActiveEcuC/CanNm PLAIN_TEXT InitMemory function description of CanNm in UnfilteredViewInInvariantProject (UnfilteredInvariantProjectModelView) .
          vSetInitFunctionInstance: vSetInitPhase=INIT_MEMORY
        CanSM_InitMemory: vSetHeader=CanSM_EcuM.h, vSetModuleRef=CanSM  # /ActiveEcuC/CanSM PLAIN_TEXT InitMemory function description of CanSM in UnfilteredViewInInvariantProject (UnfilteredInvariantProjectModelView) .
          vSetInitFunctionInstance: vSetInitPhase=INIT_MEMORY
        CanSM_Init: vSetHeader=CanSM_EcuM.h, vSetConfigType=CanSM_ConfigType, vSetConfigPtrClass=CANSM_INIT_DATA, vSetModuleRef=CanSM  # /ActiveEcuC/CanSM PLAIN_TEXT Init function description of CanSM in UnfilteredViewInInvariantProject (UnfilteredInvariantProjectModelView) .
          vSetInitFunctionInstance: vSetInitPhase=INIT_TWO_SM, vSetConfigPtrName=CanSM_Config_Ptr
        CanTp_InitMemory: vSetHeader=CanTp.h, vSetModuleRef=CanTp  # /ActiveEcuC/CanTp PLAIN_TEXT InitMemory function description of CanTp in UnfilteredViewInInvariantProject (UnfilteredInvariantProjectModelView) .
          vSetInitFunctionInstance: vSetInitPhase=INIT_MEMORY
        CanTp_Init: vSetHeader=CanTp.h, vSetConfigType=CanTp_ConfigType, vSetConfigPtrClass=CANTP_INIT_DATA, vSetModuleRef=CanTp  # /ActiveEcuC/CanTp PLAIN_TEXT Init function description of CanTp in UnfilteredViewInInvariantProject (UnfilteredInvariantProjectModelView) .
          vSetInitFunctionInstance: vSetInitPhase=INIT_TWO_TP, vSetConfigPtrName=CanTp_Config_Ptr
        ComM_Init: vSetHeader=ComM.h, vSetConfigType=ComM_ConfigType, vSetConfigPtrClass=COMM_INIT_DATA, vSetModuleRef=ComM  # /ActiveEcuC/ComM PLAIN_TEXT Init function description of ComM in UnfilteredViewInInvariantProject (UnfilteredInvariantProjectModelView) .
          vSetInitFunctionInstance: vSetInitPhase=INIT_TWO_POST_NVMREADALL, vSetConfigPtrName=ComM_Config_Ptr
        ComM_PostInit: vSetHeader=ComM.h, vSetModuleRef=ComM  # /ActiveEcuC/ComM PLAIN_TEXT Post-Initialization of the ComM and its internal state machine
          vSetInitFunctionInstance: vSetInitPhase=INIT_THREE
        ComM_PreInit: vSetHeader=ComM.h, vSetConfigType=ComM_ConfigType, vSetConfigPtrClass=COMM_INIT_DATA, vSetModuleRef=ComM  # /ActiveEcuC/ComM PLAIN_TEXT PreInit function description of ComM in UnfilteredViewInInvariantProject (UnfilteredInvariantProjectModelView) .
          vSetInitFunctionInstance: vSetInitPhase=INIT_ONE, vSetConfigPtrName=ComM_Config_Ptr
        ComM_InitMemory: vSetHeader=ComM.h, vSetModuleRef=ComM  # /ActiveEcuC/ComM PLAIN_TEXT InitMemory function description of ComM in UnfilteredViewInInvariantProject (UnfilteredInvariantProjectModelView) .
          vSetInitFunctionInstance: vSetInitPhase=INIT_MEMORY
        Com_Init: vSetHeader=Com.h, vSetConfigType=Com_ConfigType, vSetConfigPtrClass=COM_INIT_DATA, vSetModuleRef=Com  # /ActiveEcuC/Com PLAIN_TEXT Init function description of Com in UnfilteredViewInInvariantProject (UnfilteredInvariantProjectModelView) .
          vSetInitFunctionInstance: vSetInitPhase=INIT_TWO_COM, vSetConfigPtrName=Com_Config_Ptr
        Com_InitMemory: vSetHeader=Com.h, vSetModuleRef=Com  # /ActiveEcuC/Com PLAIN_TEXT InitMemory function description of Com in UnfilteredViewInInvariantProject (UnfilteredInvariantProjectModelView) .
          vSetInitFunctionInstance: vSetInitPhase=INIT_MEMORY
        CryIf_InitMemory: vSetHeader=CryIf.h, vSetModuleRef=CryIf  # /ActiveEcuC/CryIf PLAIN_TEXT Initializes variables of the Crypto Interface
          vSetInitFunctionInstance: vSetInitPhase=INIT_MEMORY
        CryIf_Init: vSetHeader=CryIf.h, vSetModuleRef=CryIf  # /ActiveEcuC/CryIf PLAIN_TEXT Initializes the Crypto Interface
          vSetInitFunctionInstance: vSetInitPhase=INIT_TWO_IF
        Crypto_30_LibCv_InitMemory: vSetHeader=Crypto_30_LibCv.h, vSetModuleRef=Crypto  # /ActiveEcuC/Crypto PLAIN_TEXT Initializes variables of the Crypto Driver
          vSetInitFunctionInstance: vSetInitPhase=INIT_MEMORY
        Crypto_30_LibCv_Init: vSetHeader=Crypto_30_LibCv.h, vSetModuleRef=Crypto  # /ActiveEcuC/Crypto PLAIN_TEXT Initializes the Crypto Driver
          vSetInitFunctionInstance: vSetInitPhase=INIT_TWO_DRV
        Csm_InitMemory: vSetHeader=Csm.h, vSetModuleRef=Csm  # /ActiveEcuC/Csm PLAIN_TEXT Initializes variables of the Crypto Service Manager
          vSetInitFunctionInstance: vSetInitPhase=INIT_MEMORY
        Csm_Init: vSetHeader=Csm.h, vSetModuleRef=Csm  # /ActiveEcuC/Csm PLAIN_TEXT Initializes the Crypto Service Manager
          vSetInitFunctionInstance: vSetInitPhase=INIT_TWO_SYS
        Dbg_Init: vSetHeader=Dbg.h, vSetModuleRef=Dbg  # /ActiveEcuC/Dbg PLAIN_TEXT Module Initialization function of module Dbg.
          vSetInitFunctionInstance: vSetInitPhase=INIT_TWO_SYS
        Dcm_Init: vSetHeader=Dcm.h, vSetConfigType=Dcm_ConfigType, vSetConfigPtrClass=DCM_CONST, vSetModuleRef=Dcm  # /ActiveEcuC/Dcm PLAIN_TEXT Dcm_Init function description
          vSetInitFunctionInstance: vSetInitPhase=INIT_TWO_POST_NVMREADALL, vSetConfigPtrName=NULL_PTR
        Dcm_InitMemory: vSetHeader=Dcm.h, vSetModuleRef=Dcm  # /ActiveEcuC/Dcm PLAIN_TEXT Dcm_InitMemory function description
          vSetInitFunctionInstance: vSetInitPhase=INIT_MEMORY
        Dem_PreInit: vSetHeader=Dem.h, vSetConfigType=Dem_ConfigType, vSetConfigPtrClass=DEM_INIT_DATA, vSetModuleRef=Dem  # /ActiveEcuC/Dem PLAIN_TEXT PreInit function description of Dem in UnfilteredViewInInvariantProject (UnfilteredInvariantProjectModelView) .
          vSetInitFunctionInstance: vSetInitPhase=INIT_ZERO, vSetConfigPtrName=Dem_Config_Ptr
        Dem_Init: vSetHeader=Dem.h, vSetConfigType=Dem_ConfigType, vSetConfigPtrClass=DEM_INIT_DATA, vSetModuleRef=Dem  # /ActiveEcuC/Dem PLAIN_TEXT Init function description of Dem in UnfilteredViewInInvariantProject (UnfilteredInvariantProjectModelView) .
          vSetInitFunctionInstance: vSetInitPhase=INIT_TWO_POST_NVMREADALL, vSetConfigPtrName=Dem_Config_Ptr
        Dem_InitMemory: vSetHeader=Dem.h, vSetModuleRef=Dem  # /ActiveEcuC/Dem PLAIN_TEXT InitMemory function description of Dem in UnfilteredViewInInvariantProject (UnfilteredInvariantProjectModelView) .
          vSetInitFunctionInstance: vSetInitPhase=INIT_MEMORY
        Det_Init: vSetHeader=Det.h, vSetConfigType=Det_ConfigType, vSetConfigPtrClass=DET_INIT_DATA, vSetModuleRef=Det  # /ActiveEcuC/Det PLAIN_TEXT Init function description of Det in UnfilteredViewInInvariantProject (UnfilteredInvariantProjectModelView) .
          vSetInitFunctionInstance: vSetInitPhase=INIT_ZERO, vSetConfigPtrName=Det_Config_Ptr
        Det_InitMemory: vSetHeader=Det.h, vSetModuleRef=Det  # /ActiveEcuC/Det PLAIN_TEXT InitMemory function description of Det in UnfilteredViewInInvariantProject (UnfilteredInvariantProjectModelView) .
          vSetInitFunctionInstance: vSetInitPhase=INIT_MEMORY
        DoIP_Init: vSetHeader=DoIP.h, vSetConfigType=DoIP_ConfigType, vSetConfigPtrClass=DOIP_INIT_DATA, vSetModuleRef=DoIP  # /ActiveEcuC/DoIP PLAIN_TEXT Init function description of DoIP in UnfilteredViewInInvariantProject (UnfilteredInvariantProjectModelView) .
          vSetInitFunctionInstance: vSetInitPhase=INIT_TWO_TP, vSetConfigPtrName=DoIP_Config_Ptr
        DoIP_InitMemory: vSetHeader=DoIP.h, vSetModuleRef=DoIP  # /ActiveEcuC/DoIP PLAIN_TEXT InitMemory function description of DoIP in UnfilteredViewInInvariantProject (UnfilteredInvariantProjectModelView) .
          vSetInitFunctionInstance: vSetInitPhase=INIT_MEMORY
        E2EXf_InitMemory: vSetHeader=E2EXf.h, vSetModuleRef=E2EXf  # /ActiveEcuC/E2EXf PLAIN_TEXT Automatically generated by BswInitFctConfigurationService.
          vSetInitFunctionInstance: vSetInitPhase=INIT_MEMORY
        E2EXf_Init: vSetHeader=E2EXf.h, vSetConfigType=E2EXf_ConfigType, vSetConfigPtrClass=E2EXF_PBCFG, vSetModuleRef=E2EXf  # /ActiveEcuC/E2EXf PLAIN_TEXT Automatically generated by BswInitFctConfigurationService.
          vSetInitFunctionInstance: vSetInitPhase=INIT_ONE, vSetConfigPtrName=NULL_PTR
        EcuM_Init: vSetHeader=EcuM.h, vSetConfigType=EcuM_PbConfigType, vSetConfigPtrClass=ECUM_INIT_DATA, vSetModuleRef=EcuM  # /ActiveEcuC/EcuM PLAIN_TEXT Init function description of EcuM in UnfilteredViewInInvariantProject (UnfilteredInvariantProjectModelView) .
          vSetInitFunctionInstance: vSetInitPhase=NO_INIT, vSetConfigPtrName=EcuM_Config_Ptr
        EthIf_InitMemory: vSetHeader=EthIf.h, vSetModuleRef=EthIf  # /ActiveEcuC/EthIf PLAIN_TEXT InitMemory function description of EthIf in UnfilteredViewInInvariantProject (UnfilteredInvariantProjectModelView) .
          vSetInitFunctionInstance: vSetInitPhase=INIT_MEMORY
        EthIf_Init: vSetHeader=EthIf.h, vSetConfigType=EthIf_ConfigType, vSetConfigPtrClass=ETHIF_INIT_DATA, vSetModuleRef=EthIf  # /ActiveEcuC/EthIf PLAIN_TEXT Init function description of EthIf in UnfilteredViewInInvariantProject (UnfilteredInvariantProjectModelView) .
          vSetInitFunctionInstance: vSetInitPhase=INIT_TWO_IF, vSetConfigPtrName=EthIf_Config_Ptr
        EthSM_InitMemory: vSetHeader=EthSM.h, vSetModuleRef=EthSM  # /ActiveEcuC/EthSM PLAIN_TEXT InitMemory function description of EthSM in UnfilteredViewInInvariantProject (UnfilteredInvariantProjectModelView) .
          vSetInitFunctionInstance: vSetInitPhase=INIT_MEMORY
        EthSM_Init: vSetHeader=EthSM.h, vSetConfigType=EthSM_ConfigType, vSetConfigPtrClass=ETHSM_INIT_DATA, vSetModuleRef=EthSM  # /ActiveEcuC/EthSM PLAIN_TEXT Init function description of EthSM in UnfilteredViewInInvariantProject (UnfilteredInvariantProjectModelView) .
          vSetInitFunctionInstance: vSetInitPhase=INIT_TWO_SM, vSetConfigPtrName=EthSM_Config_Ptr
        EthTSyn_Init: vSetHeader=EthTSyn.h, vSetConfigType=EthTSyn_ConfigType, vSetConfigPtrClass=ETHTSYN_INIT_DATA, vSetModuleRef=EthTSyn  # /ActiveEcuC/EthTSyn PLAIN_TEXT Init function description of EthTSyn in UnfilteredViewInInvariantProject (UnfilteredInvariantProjectModelView) .
          vSetInitFunctionInstance: vSetInitPhase=INIT_TWO_SYS, vSetConfigPtrName=EthTSyn_Config_Ptr
        EthTSyn_InitMemory: vSetHeader=EthTSyn.h, vSetModuleRef=EthTSyn  # /ActiveEcuC/EthTSyn PLAIN_TEXT InitMemory function description of EthTSyn in UnfilteredViewInInvariantProject (UnfilteredInvariantProjectModelView) .
          vSetInitFunctionInstance: vSetInitPhase=INIT_MEMORY
        Fee_Init: vSetHeader=Fee.h, vSetConfigType=Fee_ConfigType, vSetConfigPtrClass=AUTOMATIC, vSetModuleRef=Fee  # /ActiveEcuC/Fee PLAIN_TEXT Created Fee_Init by Extended Init XML Service
          vSetInitFunctionInstance: vSetInitPhase=INIT_ONE_LATE, vSetConfigPtrName=&Fee_Config
        Gpt_Init: vSetHeader=Gpt.h, vSetConfigType=Gpt_ConfigType, vSetConfigPtrClass=AUTOMATIC, vSetModuleRef=Gpt  # /ActiveEcuC/Gpt PLAIN_TEXT Created Gpt_Init by Extended Init XML Service
          vSetInitFunctionInstance: vSetInitPhase=INIT_ONE, vSetConfigPtrName=&Gpt_Config
        LdCom_Init: vSetHeader=LdCom.h, vSetConfigType=LdCom_ConfigType, vSetConfigPtrClass=LDCOM_INIT_DATA, vSetModuleRef=LdCom  # /ActiveEcuC/LdCom PLAIN_TEXT Init function description of LdCom in UnfilteredViewInInvariantProject (UnfilteredInvariantProjectModelView) .
          vSetInitFunctionInstance: vSetInitPhase=INIT_TWO_COM, vSetConfigPtrName=LdCom_Config_Ptr
        LdCom_InitMemory: vSetHeader=LdCom.h, vSetModuleRef=LdCom  # /ActiveEcuC/LdCom PLAIN_TEXT InitMemory function description of LdCom in UnfilteredViewInInvariantProject (UnfilteredInvariantProjectModelView) .
          vSetInitFunctionInstance: vSetInitPhase=INIT_MEMORY
        LinIf_Init: vSetHeader=LinIf.h, vSetConfigType=LinIf_ConfigType, vSetConfigPtrClass=LINIF_INIT_DATA, vSetModuleRef=LinIf  # /ActiveEcuC/LinIf PLAIN_TEXT Init function description of LinIf in UnfilteredViewInInvariantProject (UnfilteredInvariantProjectModelView) .
          vSetInitFunctionInstance: vSetInitPhase=INIT_TWO_IF, vSetConfigPtrName=LinIf_Config_Ptr
        LinIf_InitMemory: vSetHeader=LinIf.h, vSetModuleRef=LinIf  # /ActiveEcuC/LinIf PLAIN_TEXT InitMemory function description of LinIf in UnfilteredViewInInvariantProject (UnfilteredInvariantProjectModelView) .
          vSetInitFunctionInstance: vSetInitPhase=INIT_MEMORY
        LinSM_InitMemory: vSetHeader=LinSM.h, vSetModuleRef=LinSM  # /ActiveEcuC/LinSM PLAIN_TEXT InitMemory function description of LinSM in UnfilteredViewInInvariantProject (UnfilteredInvariantProjectModelView) .
          vSetInitFunctionInstance: vSetInitPhase=INIT_MEMORY
        LinSM_Init: vSetHeader=LinSM.h, vSetConfigType=LinSM_ConfigType, vSetConfigPtrClass=LINSM_INIT_DATA, vSetModuleRef=LinSM  # /ActiveEcuC/LinSM PLAIN_TEXT Init function description of LinSM in UnfilteredViewInInvariantProject (UnfilteredInvariantProjectModelView) .
          vSetInitFunctionInstance: vSetInitPhase=INIT_TWO_SM, vSetConfigPtrName=LinSM_Config_Ptr
        LinTp_Init: vSetHeader=LinIf.h, vSetConfigType=LinTp_ConfigType, vSetConfigPtrClass=LINTP_INIT_DATA, vSetModuleRef=LinTp  # /ActiveEcuC/LinTp PLAIN_TEXT Init function description of LinTp in UnfilteredViewInInvariantProject (UnfilteredInvariantProjectModelView) .
          vSetInitFunctionInstance: vSetInitPhase=INIT_TWO_TP, vSetConfigPtrName=LinTp_Config_Ptr
        Mcu_Init: vSetHeader=Mcu.h, vSetConfigType=Mcu_ConfigType, vSetConfigPtrClass=AUTOMATIC, vSetModuleRef=Mcu  # /Mcu/Mcu PLAIN_TEXT Created Mcu_Init by Extended Init XML Service
          vSetInitFunctionInstance:
            vSetInitPhase = INIT_ONE_EARLY
            vSetConfigPtrName = &Mcu_Config
            vSetAdditionalInitCode = Mcu_InitClock(0);while (MCU_PLL_LOCKED != Mcu_GetPllStatus());Mcu_DistributePllClock();
        Nm_PreInit: vSetHeader=Nm.h, vSetConfigType=Nm_ConfigType, vSetConfigPtrClass=NM_INIT_DATA, vSetModuleRef=Nm  # /ActiveEcuC/Nm PLAIN_TEXT PreInit function description of Nm in UnfilteredViewInInvariantProject (UnfilteredInvariantProjectModelView) .
          vSetInitFunctionInstance: vSetInitPhase=INIT_ONE, vSetConfigPtrName=Nm_Config_Ptr
        Nm_Init: vSetHeader=Nm.h, vSetConfigType=Nm_ConfigType, vSetConfigPtrClass=NM_INIT_DATA, vSetModuleRef=Nm  # /ActiveEcuC/Nm PLAIN_TEXT Init function description of Nm in UnfilteredViewInInvariantProject (UnfilteredInvariantProjectModelView) .
          vSetInitFunctionInstance: vSetInitPhase=INIT_TWO_NM, vSetConfigPtrName=Nm_Config_Ptr
        Nm_PostInit: vSetHeader=Nm.h, vSetModuleRef=Nm  # /ActiveEcuC/Nm PLAIN_TEXT Post-Initialization of the Network Management and its internal state machine
          vSetInitFunctionInstance: vSetInitPhase=INIT_THREE
        Nm_InitMemory: vSetHeader=Nm.h, vSetModuleRef=Nm  # /ActiveEcuC/Nm PLAIN_TEXT InitMemory function description of Nm in UnfilteredViewInInvariantProject (UnfilteredInvariantProjectModelView) .
          vSetInitFunctionInstance: vSetInitPhase=INIT_MEMORY
        NvM_Init: vSetHeader=NvM.h, vSetModuleRef=NvM  # /ActiveEcuC/NvM PLAIN_TEXT Initialization of the NVRAM Manager, to make it ready for NvM_ReadAll being requested
          vSetInitFunctionInstance: vSetInitPhase=INIT_TWO_SYS
        PduR_InitMemory: vSetHeader=PduR.h, vSetModuleRef=PduR  # /ActiveEcuC/PduR PLAIN_TEXT InitMemory function description of PduR in UnfilteredViewInInvariantProject (UnfilteredInvariantProjectModelView) .
          vSetInitFunctionInstance: vSetInitPhase=INIT_MEMORY
        PduR_Init: vSetHeader=PduR.h, vSetConfigType=PduR_PBConfigType, vSetConfigPtrClass=PDUR_INIT_DATA, vSetModuleRef=PduR  # /ActiveEcuC/PduR PLAIN_TEXT Init function description of PduR in UnfilteredViewInInvariantProject (UnfilteredInvariantProjectModelView) .
          vSetInitFunctionInstance: vSetInitPhase=INIT_TWO_COM, vSetConfigPtrName=PduR_Config_Ptr
        PduR_PreInit: vSetHeader=PduR.h, vSetConfigType=PduR_PBConfigType, vSetConfigPtrClass=PDUR_INIT_DATA, vSetModuleRef=PduR  # /ActiveEcuC/PduR PLAIN_TEXT PreInit function description of PduR in UnfilteredViewInInvariantProject (UnfilteredInvariantProjectModelView) .
          vSetInitFunctionInstance: vSetInitPhase=INIT_ONE, vSetConfigPtrName=PduR_Config_Ptr
        Port_Init: vSetHeader=Port.h, vSetConfigType=Port_ConfigType, vSetConfigPtrClass=AUTOMATIC, vSetModuleRef=Port  # /Port/Port PLAIN_TEXT Created Port_Init by Extended Init XML Service
          vSetInitFunctionInstance: vSetInitPhase=INIT_ONE_EARLY, vSetConfigPtrName=&Port_Config
        SchM_StartTiming: vSetHeader=Rte_Main.h, vSetModuleRef=Rte  # /ActiveEcuC/Rte PLAIN_TEXT Automatically generated by BswInitFctConfigurationService.
          vSetInitFunctionInstance: vSetInitPhase=NO_INIT
        Rte_StartTiming: vSetHeader=Rte_Main.h, vSetModuleRef=Rte  # /ActiveEcuC/Rte PLAIN_TEXT Automatically generated by BswInitFctConfigurationService.
          vSetInitFunctionInstance: vSetInitPhase=NO_INIT
        SchM_Init: vSetHeader=Rte_Main.h, vSetModuleRef=Rte  # /ActiveEcuC/Rte PLAIN_TEXT Automatically generated by BswInitFctConfigurationService.
          vSetInitFunctionInstance: vSetInitPhase=NO_INIT
        SchM_Start: vSetHeader=Rte_Main.h, vSetModuleRef=Rte  # /ActiveEcuC/Rte PLAIN_TEXT Automatically generated by BswInitFctConfigurationService.
          vSetInitFunctionInstance: vSetInitPhase=NO_INIT
        Rte_Start: vSetHeader=Rte_Main.h, vSetModuleRef=Rte  # /ActiveEcuC/Rte PLAIN_TEXT Automatically generated by BswInitFctConfigurationService.
          vSetInitFunctionInstance: vSetInitPhase=INIT_THREE
        Rte_InitMemory: vSetHeader=Rte_Main.h, vSetModuleRef=Rte  # /ActiveEcuC/Rte PLAIN_TEXT Automatically generated by BswInitFctConfigurationService.
          vSetInitFunctionInstance: vSetInitPhase=INIT_MEMORY
        Rtm_Init: vSetHeader=Rtm.h, vSetModuleRef=Rtm  # /ActiveEcuC/Rtm PLAIN_TEXT Module Initialization function of module Rtm.
          vSetInitFunctionInstance: vSetInitPhase=INIT_TWO_POST_NVMREADALL
        Rtm_InitMemory: vSetHeader=Rtm.h, vSetModuleRef=Rtm  # /ActiveEcuC/Rtm PLAIN_TEXT Memory Initialization function of module Rtm.
          vSetInitFunctionInstance: vSetInitPhase=INIT_MEMORY
        Sd_InitMemory: vSetHeader=Sd.h, vSetModuleRef=Sd  # /ActiveEcuC/Sd PLAIN_TEXT InitMemory function description of Sd in UnfilteredViewInInvariantProject (UnfilteredInvariantProjectModelView) .
          vSetInitFunctionInstance: vSetInitPhase=INIT_MEMORY
        Sd_Init: vSetHeader=Sd.h, vSetConfigType=Sd_ConfigType, vSetConfigPtrClass=SD_INIT_DATA, vSetModuleRef=Sd  # /ActiveEcuC/Sd PLAIN_TEXT Init function description of Sd in UnfilteredViewInInvariantProject (UnfilteredInvariantProjectModelView) .
          vSetInitFunctionInstance: vSetInitPhase=INIT_TWO_SYS, vSetConfigPtrName=Sd_Config_Ptr
        SecOC_Init: vSetHeader=SecOC.h, vSetConfigType=SecOC_ConfigType, vSetConfigPtrClass=SECOC_INIT_DATA, vSetModuleRef=SecOC  # /ActiveEcuC/SecOC PLAIN_TEXT Init function description of SecOC in UnfilteredViewInInvariantProject (UnfilteredInvariantProjectModelView) .
          vSetInitFunctionInstance: vSetInitPhase=INIT_TWO_COM, vSetConfigPtrName=SecOC_Config_Ptr
        SecOC_InitMemory: vSetHeader=SecOC.h, vSetModuleRef=SecOC  # /ActiveEcuC/SecOC PLAIN_TEXT InitMemory function description of SecOC in UnfilteredViewInInvariantProject (UnfilteredInvariantProjectModelView) .
          vSetInitFunctionInstance: vSetInitPhase=INIT_MEMORY
        SoAd_Init: vSetHeader=SoAd.h, vSetConfigType=SoAd_ConfigType, vSetConfigPtrClass=SOAD_INIT_DATA, vSetModuleRef=SoAd  # /ActiveEcuC/SoAd PLAIN_TEXT Initialization function of module SoAd.
          vSetInitFunctionInstance: vSetInitPhase=INIT_TWO_IF, vSetConfigPtrName=SoAd_Config_Ptr
        SoAd_InitMemory: vSetHeader=SoAd.h, vSetModuleRef=SoAd  # /ActiveEcuC/SoAd PLAIN_TEXT Memory Initialization function of module SoAd.
          vSetInitFunctionInstance: vSetInitPhase=INIT_MEMORY
        SoAd_PreInit: vSetHeader=SoAd.h, vSetConfigType=SoAd_ConfigType, vSetConfigPtrClass=SOAD_INIT_DATA, vSetModuleRef=SoAd  # /ActiveEcuC/SoAd PLAIN_TEXT Pre Initialization function of module SoAd.
          vSetInitFunctionInstance: vSetInitPhase=INIT_ONE, vSetConfigPtrName=SoAd_Config_Ptr
        SoAd_PostInit: vSetHeader=SoAd.h, vSetModuleRef=SoAd  # /ActiveEcuC/SoAd PLAIN_TEXT Post Initialization function of module SoAd.
          vSetInitFunctionInstance: vSetInitPhase=INIT_THREE
        SomeIpXf_Init: vSetHeader=SomeIpXf.h, vSetModuleRef=SomeIpXf  # /ActiveEcuC/SomeIpXf PLAIN_TEXT Automatically generated by BswInitFctConfigurationService.
          vSetInitFunctionInstance: vSetInitPhase=NO_INIT
        StbM_Init: vSetHeader=StbM.h, vSetConfigType=StbM_ConfigType, vSetConfigPtrClass=STBM_INIT_DATA, vSetModuleRef=StbM  # /ActiveEcuC/StbM PLAIN_TEXT Init function description of StbM in UnfilteredViewInInvariantProject (UnfilteredInvariantProjectModelView) .
          vSetInitFunctionInstance: vSetInitPhase=INIT_TWO_SYS, vSetConfigPtrName=StbM_Config_Ptr
        StbM_InitMemory: vSetHeader=StbM.h, vSetModuleRef=StbM  # /ActiveEcuC/StbM PLAIN_TEXT InitMemory function description of StbM in UnfilteredViewInInvariantProject (UnfilteredInvariantProjectModelView) .
          vSetInitFunctionInstance: vSetInitPhase=INIT_MEMORY
        TcpIp_InitMemory: vSetHeader=TcpIp.h, vSetModuleRef=TcpIp  # /ActiveEcuC/TcpIp PLAIN_TEXT InitMemory function description of TcpIp in UnfilteredViewInInvariantProject (UnfilteredInvariantProjectModelView) .
          vSetInitFunctionInstance: vSetInitPhase=INIT_MEMORY
        TcpIp_Init: vSetHeader=TcpIp.h, vSetConfigType=TcpIp_ConfigType, vSetConfigPtrClass=TCPIP_INIT_DATA, vSetModuleRef=TcpIp  # /ActiveEcuC/TcpIp PLAIN_TEXT Init function description of TcpIp in UnfilteredViewInInvariantProject (UnfilteredInvariantProjectModelView) .
          vSetInitFunctionInstance: vSetInitPhase=INIT_TWO_TP, vSetConfigPtrName=TcpIp_Config_Ptr
        UdpNm_Init: vSetHeader=UdpNm.h, vSetConfigType=UdpNm_ConfigType, vSetConfigPtrClass=UDPNM_INIT_DATA, vSetModuleRef=UdpNm  # /ActiveEcuC/UdpNm PLAIN_TEXT Init function description of UdpNm in UnfilteredViewInInvariantProject (UnfilteredInvariantProjectModelView) .
          vSetInitFunctionInstance: vSetInitPhase=INIT_TWO_NM, vSetConfigPtrName=UdpNm_Config_Ptr
        UdpNm_InitMemory: vSetHeader=UdpNm.h, vSetModuleRef=UdpNm  # /ActiveEcuC/UdpNm PLAIN_TEXT InitMemory function description of UdpNm in UnfilteredViewInInvariantProject (UnfilteredInvariantProjectModelView) .
          vSetInitFunctionInstance: vSetInitPhase=INIT_MEMORY
        CanXcp_Init: vSetHeader=CanXcp.h, vSetConfigType=CanXcp_ConfigType, vSetConfigPtrClass=CANXCP_CONST, vSetModuleRef=Xcp  # /ActiveEcuC/Xcp PLAIN_TEXT Module Initialization function of module CanXcp.
          vSetInitFunctionInstance: vSetInitPhase=INIT_TWO_TP, vSetConfigPtrName=NULL_PTR
        Xcp_InitMemory: vSetHeader=Xcp.h, vSetModuleRef=Xcp  # /ActiveEcuC/Xcp PLAIN_TEXT Memory Initialization function of module Xcp.
          vSetInitFunctionInstance: vSetInitPhase=INIT_MEMORY
        Xcp_Init: vSetHeader=Xcp.h, vSetModuleRef=Xcp  # /ActiveEcuC/Xcp PLAIN_TEXT Module Initialization function of module Xcp.
          vSetInitFunctionInstance: vSetInitPhase=INIT_TWO_TP
        CanXcp_InitMemory: vSetHeader=CanXcp.h, vSetModuleRef=Xcp  # /ActiveEcuC/Xcp PLAIN_TEXT Memory Initialization function of module CanXcp.
          vSetInitFunctionInstance: vSetInitPhase=INIT_MEMORY
        vFotaH_InitMemory: vSetHeader=vFotaH.h, vSetModuleRef=vFotaH  # /ActiveEcuC/vFotaH PLAIN_TEXT InitMemory function description of vFotaH in UnfilteredViewInInvariantProject (UnfilteredInvariantProjectModelView) .
          vSetInitFunctionInstance: vSetInitPhase=INIT_MEMORY
        vFotaH_Init: vSetHeader=vFotaH.h, vSetConfigType=vFotaH_ConfigType, vSetConfigPtrClass=VFOTAH_INIT_DATA, vSetModuleRef=vFotaH  # /ActiveEcuC/vFotaH PLAIN_TEXT Init function description of vFotaH in UnfilteredViewInInvariantProject (UnfilteredInvariantProjectModelView) .
          vSetInitFunctionInstance: vSetInitPhase=INIT_TWO_POST_NVMREADALL, vSetConfigPtrName=vFotaH_Config_Ptr
        vItaSip_Init: vSetHeader=, vSetModuleRef=vItaSip  # /ActiveEcuC/vItaSip PLAIN_TEXT Automatically generated by BswInitFctConfigurationService.
          vSetInitFunctionInstance: vSetInitPhase=NO_INIT
        vMemAccM_InitMemory: vSetHeader=vMemAccM.h, vSetModuleRef=vMemAccM  # /ActiveEcuC/vMemAccM PLAIN_TEXT Initializes all *_INIT_* section variables within the vMemAccM.
          vSetInitFunctionInstance: vSetInitPhase=INIT_MEMORY
        vMemAccM_Init: vSetHeader=vMemAccM.h, vSetModuleRef=vMemAccM  # /ActiveEcuC/vMemAccM PLAIN_TEXT Initializes the vMemAccM.
          vSetInitFunctionInstance: vSetInitPhase=INIT_TWO_DRV
        vSwUpdM_Init: vSetHeader=vSwUpdM.h, vSetConfigType=vSwUpdM_ConfigType, vSetConfigPtrClass=VSWUPDM_INIT_DATA, vSetModuleRef=vSwUpdM  # /ActiveEcuC/vSwUpdM PLAIN_TEXT Init function description of vSwUpdM in UnfilteredViewInInvariantProject (UnfilteredInvariantProjectModelView) .
          vSetInitFunctionInstance: vSetInitPhase=INIT_TWO_SYS, vSetConfigPtrName=vSwUpdM_Config_Ptr
        vSwUpdM_InitMemory: vSetHeader=vSwUpdM.h, vSetModuleRef=vSwUpdM  # /ActiveEcuC/vSwUpdM PLAIN_TEXT InitMemory function description of vSwUpdM in UnfilteredViewInInvariantProject (UnfilteredInvariantProjectModelView) .
          vSetInitFunctionInstance: vSetInitPhase=INIT_MEMORY
        vStreamProc_InitMemory: vSetHeader=vStreamProc.h, vSetModuleRef=vStreamProc  # /ActiveEcuC/vStreamProc PLAIN_TEXT InitMemory function description of vStreamProc in UnfilteredViewInInvariantProject (UnfilteredInvariantProjectModelView) .
          vSetInitFunctionInstance: vSetInitPhase=INIT_MEMORY
        vStreamProc_Init: vSetHeader=vStreamProc.h, vSetConfigType=vStreamProc_ConfigType, vSetConfigPtrClass=VSTREAMPROC_INIT_DATA, vSetModuleRef=vStreamProc  # /ActiveEcuC/vStreamProc PLAIN_TEXT Init function description of vStreamProc in UnfilteredViewInInvariantProject (UnfilteredInvariantProjectModelView) .
          vSetInitFunctionInstance: vSetInitPhase=INIT_ZERO, vSetConfigPtrName=vStreamProc_Config_Ptr
        StbM_PreInit: vSetHeader=StbM.h, vSetConfigType=StbM_ConfigType, vSetConfigPtrClass=STBM_INIT_DATA, vSetModuleRef=StbM  # /ActiveEcuC/StbM PLAIN_TEXT PreInit function description of StbM in UnfilteredViewInInvariantProject (UnfilteredInvariantProjectModelView) .
          vSetInitFunctionInstance: vSetInitPhase=INIT_ONE, vSetConfigPtrName=StbM_Config_Ptr
        StbM_PostInit: vSetHeader=StbM.h, vSetModuleRef=StbM  # /ActiveEcuC/StbM PLAIN_TEXT PostInit function description of StbM in UnfilteredViewInInvariantProject (UnfilteredInvariantProjectModelView) .
          vSetInitFunctionInstance: vSetInitPhase=INIT_THREE
        EthTrcv_30_Ethmii_Init: vSetHeader=EthTrcv_30_Ethmii.h, vSetConfigType=EthTrcv_30_Ethmii_ConfigType, vSetConfigPtrClass=ETHTRCV_30_ETHMII_INIT_DATA, vSetModuleRef=EthTrcv  # /ActiveEcuC/EthTrcv PLAIN_TEXT Module Initialization function of module EthTrcv_30_Ethmii.
          vSetInitFunctionInstance: vSetInitPhase=INIT_TWO_TRCV, vSetConfigPtrName=EthTrcv_30_Ethmii_Config_Ptr
        EthTrcv_30_Ethmii_InitMemory: vSetHeader=EthTrcv_30_Ethmii.h, vSetModuleRef=EthTrcv  # /ActiveEcuC/EthTrcv PLAIN_TEXT Memory Initialization function of module EthTrcv_30_Ethmii.
          vSetInitFunctionInstance: vSetInitPhase=INIT_MEMORY
        Eth_30_Tc3xx_Init: vSetHeader=Eth_30_Tc3xx.h, vSetConfigType=Eth_30_Tc3xx_ConfigType, vSetConfigPtrClass=ETH_30_TC3XX_INIT_DATA, vSetModuleRef=Eth  # /ActiveEcuC/Eth PLAIN_TEXT Module Initialization function of module Eth_30_Tc3xx.
          vSetInitFunctionInstance: vSetInitPhase=INIT_TWO_DRV, vSetConfigPtrName=Eth_30_Tc3xx_Config_Ptr
        Eth_30_Tc3xx_InitMemory: vSetHeader=Eth_30_Tc3xx.h, vSetModuleRef=Eth  # /ActiveEcuC/Eth PLAIN_TEXT Memory Initialization function of module Eth_30_Tc3xx.
          vSetInitFunctionInstance: vSetInitPhase=INIT_MEMORY
        Lin_Init: vSetHeader=Lin.h, vSetConfigType=Lin_ConfigType, vSetConfigPtrClass=LIN_INIT_DATA, vSetModuleRef=Lin  # /ActiveEcuC/Lin PLAIN_TEXT Init function description of Lin in UnfilteredViewInInvariantProject (UnfilteredInvariantProjectModelView) .
          vSetInitFunctionInstance: vSetInitPhase=INIT_TWO_DRV, vSetConfigPtrName=Lin_Config_Ptr
        Lin_InitMemory: vSetHeader=Lin.h, vSetModuleRef=Lin  # /ActiveEcuC/Lin PLAIN_TEXT InitMemory function description of Lin in UnfilteredViewInInvariantProject (UnfilteredInvariantProjectModelView) .
          vSetInitFunctionInstance: vSetInitPhase=INIT_MEMORY
        Wdg_17_Scu_Init: vSetHeader=Wdg_17_Scu.h, vSetConfigType=Wdg_17_Scu_ConfigType, vSetConfigPtrClass=AUTOMATIC, vSetModuleRef=Wdg  # /ActiveEcuC/Wdg PLAIN_TEXT Created Wdg_17_Scu_Init by Extended Init XML Service
          vSetInitFunctionInstance: vSetInitPhase=INIT_ONE, vSetConfigPtrName=&Wdg_17_Scu_Config_0
        vCan_30_Mcan_InitMemory: vSetHeader=vCan_30_Mcan.h, vSetModuleRef=vCan  # /ActiveEcuC/vCan PLAIN_TEXT InitMemory function description of vCan_30_Mcan in UnfilteredViewInInvariantProject (UnfilteredInvariantProjectModelView) .
          vSetInitFunctionInstance: vSetInitPhase=INIT_MEMORY
        vCan_30_Mcan_Init: vSetHeader=vCan_30_Mcan.h, vSetConfigType=vCan_30_Mcan_ConfigType, vSetConfigPtrClass=VCAN_30_MCAN_INIT_DATA, vSetModuleRef=vCan  # /ActiveEcuC/vCan PLAIN_TEXT Init function description of vCan_30_Mcan in UnfilteredViewInInvariantProject (UnfilteredInvariantProjectModelView) .
          vSetInitFunctionInstance: vSetInitPhase=INIT_ONE, vSetConfigPtrName=vCan_30_Mcan_Config_Ptr
        Can_30_Core_InitMemory: vSetHeader=Can_30_Core.h, vSetModuleRef=Can  # /ActiveEcuC/Can PLAIN_TEXT InitMemory function description of Can_30_Core in UnfilteredViewInInvariantProject (UnfilteredInvariantProjectModelView) .
          vSetInitFunctionInstance: vSetInitPhase=INIT_MEMORY
        Can_30_Core_Init: vSetHeader=Can_30_Core.h, vSetConfigType=Can_30_Core_ConfigType, vSetConfigPtrClass=CAN_30_CORE_INIT_DATA, vSetModuleRef=Can  # /ActiveEcuC/Can PLAIN_TEXT Init function description of Can_30_Core in UnfilteredViewInInvariantProject (UnfilteredInvariantProjectModelView) .
          vSetInitFunctionInstance: vSetInitPhase=INIT_TWO_DRV, vSetConfigPtrName=Can_30_Core_Config_Ptr
        vBaseEnv_Init: vSetHeader=, vSetModuleRef=vBaseEnv  # /ActiveEcuC/vBaseEnv PLAIN_TEXT Created vBaseEnv_Init by Extended Init XML Service
          vSetInitFunctionInstance: vSetInitPhase=NO_INIT
        Fls_17_Dmu_Init: vSetHeader=Fls_17_Dmu.h, vSetConfigType=Fls_17_Dmu_ConfigType, vSetConfigPtrClass=AUTOMATIC, vSetModuleRef=Fls  # /ActiveEcuC/Fls PLAIN_TEXT Created Fls_17_Dmu_Init by Extended Init XML Service
          vSetInitFunctionInstance: vSetInitPhase=INIT_ONE, vSetConfigPtrName=&Fls_17_Dmu_Config
        Irq_Init: vSetHeader=Irq.h, vSetModuleRef=Irq  # /Irq/Irq PLAIN_TEXT Created Irq_Init by Extended Init XML Service
          vSetInitFunctionInstance: vSetInitPhase=NO_INIT
        McalLib_Init: vSetHeader=McalLib.h, vSetModuleRef=McalLib  # /McalLib/McalLib PLAIN_TEXT Created McalLib_Init by Extended Init XML Service
          vSetInitFunctionInstance: vSetInitPhase=NO_INIT
        ResourceM_Init: vSetHeader=ResourceM.h, vSetModuleRef=ResourceM  # /ResourceM/ResourceM PLAIN_TEXT Created ResourceM_Init by Extended Init XML Service
          vSetInitFunctionInstance: vSetInitPhase=NO_INIT
        vLinkGen_Init: vSetHeader=vLinkGen_Lcfg.h, vSetModuleRef=vLinkGen  # /ActiveEcuC/vLinkGen PLAIN_TEXT Dummy initialization of the vLinkGen
          vSetInitFunctionInstance: vSetInitPhase=NO_INIT
        vFeeAcc_Init: vSetHeader=vFeeAcc.h, vSetModuleRef=vFeeAcc  # /ActiveEcuC/vFeeAcc PLAIN_TEXT Initialization of vFeeAcc, to make it ready for usage
          vSetInitFunctionInstance: vSetInitPhase=INIT_TWO_IF
        NoInit: vSetHeader=noFile, vSetModuleRef=vMem_30_Blocking  # /ActiveEcuC/vMem_30_Blocking PLAIN_TEXT vMem_30_Blocking does not have an Init function
          vSetInitFunctionInstance: vSetInitPhase=NO_INIT
        vMem_30_Tc3xxInf01_Init: vSetHeader=vMem_30_Tc3xxInf01.h, vSetConfigType=vMem_30_Tc3xxInf01_ConfigType, vSetConfigPtrClass=VMEM_30_TC3XXINF01_INIT_DATA, vSetModuleRef=vMem  # /ActiveEcuC/vMem PLAIN_TEXT Init function description of vMem_30_Tc3xxInf01 in UnfilteredViewInInvariantProject (UnfilteredInvariantProjectModelView) .
          vSetInitFunctionInstance: vSetInitPhase=NO_INIT, vSetConfigPtrName=vMem_30_Tc3xxInf01_Config_Ptr
        Dio_Init: vSetHeader=Dio.h, vSetModuleRef=Dio  # /ActiveEcuC/Dio PLAIN_TEXT Created Dio_Init by Extended Init XML Service
          vSetInitFunctionInstance: vSetInitPhase=NO_INIT
        CddNpmGen2_InitMemory: vSetHeader=CddNpmGen2.h, vSetModuleRef=CddNpmGen2  # /ActiveEcuC/CddNpmGen2 PLAIN_TEXT Pre-Initialization of CddNpmGen2
          vSetInitFunctionInstance: vSetInitPhase=INIT_MEMORY
        CddNpmGen2_Init: vSetHeader=CddNpmGen2.h, vSetModuleRef=CddNpmGen2  # /ActiveEcuC/CddNpmGen2 PLAIN_TEXT Initialization of CddNpmGen2
          vSetInitFunctionInstance: vSetInitPhase=INIT_TWO_POST_NVMREADALL
        ComXf_Init: vSetHeader=ComXf.h, vSetModuleRef=ComXf  # /ActiveEcuC/ComXf PLAIN_TEXT Automatically generated by BswInitFctConfigurationService.
          vSetInitFunctionInstance: vSetInitPhase=NO_INIT
