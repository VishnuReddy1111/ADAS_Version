AUTOSAR XML (schema 00048)
package /ActiveEcuC
  module config Brs: implementation-config-variant=VARIANT-PRE-COMPILE, module-description=Brs_Impl
    BrsGeneral:
      BrsEnableTgfSupport = false
      BrsEnableOsSupport = true
      BrsEnableOsEmulation = false
      BrsEnableTfwSupport = false
      BrsEnableSupportLEDs = false
      BrsEnableSafeContextSupport = false
      BrsEnableMcalTrustedOnly = false
      BrsEnableMultiCoreSupport = false
      BrsEnableSafeWdgSupport = false
      BrsEnableSafeWdgMultiCoreSupport = false
      BrsEnableHLPTestSupport = false
      BrsEnableTcmSupport = false
      BrsEnableExternalWakeup = false
      BrsEnableFblSupport = false
      BrsDisableSetupSupport = true
