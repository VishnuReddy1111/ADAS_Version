AUTOSAR XML (schema 4-3-0)
package /ActiveEcuC
  module config vItaSip: implementation-config-variant=VARIANT-PRE-COMPILE, module-description=vItaSip_Impl
    vItaSipControlCommunication: vItaSipControlCommunicationType=SOAD_CDD
    vItaSipUseCases:
      vItaSipUseCaseCom = true
      vItaSipUseCaseMem = true
      vItaSipUseCaseDiag = true
      vItaSipUseCaseNm = true
      vItaSipUseCaseWdg = true
      vItaSipUseCaseXcp = true
      vItaSipUseCaseJ1939Diag = false
      vItaSipUseCaseMultiCore = true
      vItaSipUseCaseMemoryProtection = false
      vItaSipUseCaseFbl = false
      vItaSipUseCaseEth = true
      vItaSipUseCaseSecurity = true
      vItaSipCom:
        vItaSipComSecOCSupport = true
        vItaSipComTestElementRef = Signal_MyECU_SecOC_Rx1_omsg_SecOC_MyECU_Rx_oCAN_985386a6_Rx
        vItaSipComTestElementRef = Signal_MyECU_SecOC_Tx1_omsg_SecOC_MyECU_Tx_oCAN_fe3fbdd2_Tx
        vItaSipComTestElementRef = Sig_StartAppl_LinData_Rx_oFrame_LinTr_Slave1_oLIN00_149fe319_Rx
        vItaSipComTestElementRef = Sig_StartAppl_LinData_Tx_oFrame_LinTr_MyECU_oLIN00_d383dc6b_Tx
        vItaSipComTestElementRef = Signal_StartAppl_RxData_MyECU_omsg_StartAppl_Rx_MyECU_oCAN_315f9453_Rx
        vItaSipComTestElementRef = Signal_StartAppl_TxData_MyECU_omsg_StartAppl_Tx_MyECU_oCAN_8c58228b_Tx
      vItaSipMultiCore: vItaSipMultiCoreTestElementRef=EcucCoreDefinition_Core1
    vItaSipGeneral
      3 x vItaSipCANoeChannel:
        VitaCanoeChannel_CAN: vItaSipCANoeChannelName=CAN, vItaSipChannelRef=CT_CAN_d43e43a4
        VitaCanoeChannel_LIN: vItaSipCANoeChannelName=LIN, vItaSipChannelRef=CN_LIN00_19b2d5e7
        VitaCanoeChannel_ETH: vItaSipCANoeChannelName=Ethernet, vItaSipChannelRef=BA_MyECU_0_EPC_d9b4790c
