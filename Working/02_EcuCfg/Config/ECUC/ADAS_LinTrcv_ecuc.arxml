AUTOSAR XML (schema 00048)
package /ActiveEcuC
  module config LinTrcv: implementation-config-variant=VARIANT-PRE-COMPILE, module-description=LinTrcv_Impl
    LinTrcvGeneral: LinTrcvSafeBswChecks=false, LinTrcvDevErrorDetect=true, LinTrcvGetVersionInfo=true, LinTrcvIndex=0, LinTrcvWaitCount=0, LinTrcvWakeUpSupport=false
    LinTrcvChannel: LinTrcvChannelId=0, LinTrcvChannelUsed=true, LinTrcvInitState=LINTRCV_TRCV_MODE_NORMAL, LinTrcvWakeupByBusUsed=false, LinTrcvWakeupByPinUsed=false
      LinTrcvAccess
        LinTrcvDioAccess
          3 x LinTrcvDioChannelAccess:
            LinTrcvDioChannelAccessEn: LinTrcvHardwareInterfaceName=LinDioEn, LinTrcvDioSymRefName=DioPort_LinDioEn
            LinTrcvDioChannelAccessRx: LinTrcvHardwareInterfaceName=LinDioRx, LinTrcvDioSymRefName=DioPort_LinDioRx
            LinTrcvDioChannelAccessTx: LinTrcvHardwareInterfaceName=LinDioTx, LinTrcvDioSymRefName=DioPort_LinDioTx
