AUTOSAR XML (schema 4-3-0)
package /ActiveEcuC
  module config vStreamProc: implementation-config-variant=VARIANT-LINK-TIME, module-description=vStreamProc_Impl
    CRCPipe (vStreamProcPipe): vStreamProcPipeId=0
      vStreamProcEdges
        3 x vStreamProcConsumer:
          Read_Entities_In: vStreamProcProcessingNodeInputRef=vStreamProcProcessingNode_Read_Entites_In, vStreamProcStorageNodeRef=vStreamProcStorageNode_Entities
          Read_Range_In: vStreamProcProcessingNodeInputRef=vStreamProcProcessingNode_Read_Range_In, vStreamProcStorageNodeRef=vStreamProcStorageNode_Range
          Crc_Data_In: vStreamProcProcessingNodeInputRef=vStreamProcProcessingNodeInputPort, vStreamProcStorageNodeRef=vStreamProcStorageNode_ReadData
        Read_Data_Out (vStreamProcProducer): vStreamProcStorageNodeRef=vStreamProcStorageNode_ReadData, vStreamProcProcessingNodeOutputRef=vStreamProcProcessingNode_Read_Data_Out
        Crc_Crc_Out (vStreamProcProducer):
          vStreamProcStorageNodeRef = vStreamProcStorageNode_CalculatedCRC
          vStreamProcProcessingNodeOutputRef = vStreamProcProcessingNode_CalculateCRC/vStreamProcProcessingNodeOutputPort
        Compare_CRC1_In (vStreamProcConsumer): vStreamProcProcessingNodeInputRef=vStreamProcProcessingNodeInputPort_CRC1, vStreamProcStorageNodeRef=vStreamProcStorageNode_CalculatedCRC
        Compare_CRC2_In (vStreamProcConsumer): vStreamProcProcessingNodeInputRef=vStreamProcProcessingNodeInputPort_CRC2, vStreamProcStorageNodeRef=vStreamProcStorageNode_CRC
        Compare_Result_Out (vStreamProcProducer):
          vStreamProcStorageNodeRef = vStreamProcStorageNode_Result
          vStreamProcProcessingNodeOutputRef = vStreamProcProcessingNode_CompareCRC/vStreamProcProcessingNodeOutputPort
      vStreamProcStates
      vStreamProcNodes
        6 x vStreamProcStorageNode, all with vStreamProcStorageNodeTypeRef=vStreamProcSimpleBuffer:
          vStreamProcStorageNode_CalculatedCRC: vStreamProcBufferSize=4, vStreamProcStorageNodeId=1, vStreamProcDataTypeRef=uint8
          vStreamProcStorageNode_CRC: vStreamProcBufferSize=4, vStreamProcStorageNodeId=0, vStreamProcDataTypeRef=uint8
          vStreamProcStorageNode_Entities: vStreamProcBufferSize=1, vStreamProcStorageNodeId=2, vStreamProcDataTypeRef=vSwUpdM_EntityIdsType
          vStreamProcStorageNode_Range: vStreamProcBufferSize=1, vStreamProcStorageNodeId=3, vStreamProcDataTypeRef=vSwUpdM_RangeInfoType
          vStreamProcStorageNode_ReadData: vStreamProcBufferSize=256, vStreamProcStorageNodeId=4, vStreamProcDataTypeRef=uint8
          vStreamProcStorageNode_Result: vStreamProcBufferSize=1, vStreamProcStorageNodeId=5, vStreamProcDataTypeRef=Std_ReturnType
        3 x vStreamProcProcessingNode, all with vStreamProcProcessingNodeId=0:
          vStreamProcProcessingNode_Read: vStreamProcProcessingNodeTypeRef=vSwUpdM_Read
            vStreamProcProcessingNode_Read_Range_In (vStreamProcProcessingNodeInputPort): vStreamProcProcessingNodeInput=vStreamProcRequiredInputPorts/RangeInputPort
            vStreamProcProcessingNode_Read_Entites_In (vStreamProcProcessingNodeInputPort): vStreamProcProcessingNodeInput=vStreamProcRequiredInputPorts/EntitiesInputPort
            vStreamProcProcessingNode_Read_Data_Out (vStreamProcProcessingNodeOutputPort): vStreamProcProcessingNodeOutput=vStreamProcOptionalOutputPorts/DataOutputPort
          vStreamProcProcessingNode_CalculateCRC: vStreamProcProcessingNodeTypeRef=CrcNode
            vStreamProcProcessingNodeInputPort: vStreamProcProcessingNodeInput=CRCNode_InputData
            vStreamProcProcessingNodeOutputPort: vStreamProcProcessingNodeOutput=CRCNode_OutputData
          vStreamProcProcessingNode_CompareCRC: vStreamProcProcessingNodeTypeRef=CrcCompare
            vStreamProcProcessingNodeInputPort_CRC1 (vStreamProcProcessingNodeInputPort): vStreamProcProcessingNodeInput=vStreamProcRequiredInputPorts/vStreamProcCompareInputPort_0
            vStreamProcProcessingNodeInputPort_CRC2 (vStreamProcProcessingNodeInputPort): vStreamProcProcessingNodeInput=vStreamProcRequiredInputPorts/vStreamProcCompareInputPort_1
            vStreamProcProcessingNodeOutputPort: vStreamProcProcessingNodeOutput=vStreamProcRequiredOutputPorts/ByteCompareNode_ResultData
      vStreamProcAccessPoints
        3 x vStreamProcEntryPoint:
          vStreamProcEntryPoint_CRC: vStreamProcEntryPointId=0, vStreamProcEntryStorageNode=vStreamProcStorageNode_CRC
          vStreamProcEntryPoint_Entities: vStreamProcEntryPointId=1, vStreamProcEntryStorageNode=vStreamProcStorageNode_Entities
          vStreamProcEntryPoint_Range: vStreamProcEntryPointId=2, vStreamProcEntryStorageNode=vStreamProcStorageNode_Range
        vStreamProcExitPoint_Result (vStreamProcExitPoint): vStreamProcExitPointId=0, vStreamProcExitStorageNode=vStreamProcStorageNode_Result
    vStreamProcGeneral:
      vStreamProcDevErrorDetect = true
      vStreamProcDefragmentThreshold = 32
      vStreamProcVersionInfoApi = false
      vStreamProcNumOfNodesToProcess = 1
      vStreamProcSafeBswChecks = false
    vStreamProcDefinitions
      vStreamProcNodeTypes
        3 x vStreamProcProcessingNodeType:
          CrcNode
            vStreamProcCRCNode:
              vStreamProcFlushFunction = vStreamProc_ProcessingNode_CRC_Flush
              vStreamProcHeaderFile = vStreamProc_ProcessingNode_CRC.h
              vStreamProcInitFunction = vStreamProc_ProcessingNode_CRC_Init
              vStreamProcProcessFunction = vStreamProc_ProcessingNode_CRC_Process
              vStreamProcCRCType = CRC32
              vStreamProcRequiredInputPorts
                CRCNode_InputData: vStreamProcDataTypeRef=uint8
              vStreamProcRequiredOutputPorts
                CRCNode_OutputData: vStreamProcDataTypeRef=uint8
          CrcCompare
            vStreamProcByteCompareNode:
              vStreamProcFlushFunction = vStreamProc_ProcessingNode_ByteCompare_Flush
              vStreamProcHeaderFile = vStreamProc_ProcessingNode_ByteCompare.h
              vStreamProcInitFunction = vStreamProc_ProcessingNode_ByteCompare_Init
              vStreamProcProcessFunction = vStreamProc_ProcessingNode_ByteCompare_Process
              vStreamProcBytesToCompare = 256
              vStreamProcOptionalOutputPorts
                ByteCompareNode_ComparedCount: vStreamProcDataTypeRef=uint8
              vStreamProcRequiredOutputPorts
                ByteCompareNode_ResultData: vStreamProcDataTypeRef=Std_ReturnType
              vStreamProcOptionalInputPorts
              vStreamProcRequiredInputPorts
                vStreamProcCompareInputPort_0 (vStreamProcCompareInputPort): vStreamProcDataTypeRef=uint8
                vStreamProcCompareInputPort_1 (vStreamProcCompareInputPort): vStreamProcDataTypeRef=uint8
          vStreamProcProcessingNodeType
            vStreamProcExternalProcessingNode:
              vStreamProcFlushFunction = vStreamProc_TemplateProcessingNode_Flush
              vStreamProcProcessFunction = vStreamProc_TemplateProcessingNode_Process
              vStreamProcInitFunction = vStreamProc_TemplateProcessingNode_Init
              vStreamProcHeaderFile = vStreamProc_TemplateProcessingNode.h
              vStreamProcRequiredOutputPorts
              vStreamProcRequiredInputPorts
              vStreamProcOptionalOutputPorts
              vStreamProcOptionalInputPorts
        vStreamProcSimpleBuffer (vStreamProcStorageNodeType):
          vStreamProcAnnounceStreamFunction = vStreamProc_SimpleBufferNode_AnnounceStream
          vStreamProcDataAvailableCallout = vStreamProc_Scheduler_HandleDataAvailableCallout
          vStreamProcFlushFunction = vStreamProc_SimpleBufferNode_Flush
          vStreamProcHeaderFile = vStreamProc_SimpleBufferNode.h
          vStreamProcInitFunction = vStreamProc_SimpleBufferNode_Init
          vStreamProcIsEmptyFunction = vStreamProc_SimpleBufferNode_IsEmpty
          vStreamProcProcessFunction = vStreamProc_SimpleBufferNode_Process
          vStreamProcReadAckFunction = vStreamProc_SimpleBufferNode_ReadAck
          vStreamProcReadInfoFunction = vStreamProc_SimpleBufferNode_ReadInfo
          vStreamProcReadRequestFunction = vStreamProc_SimpleBufferNode_ReadRequest
          vStreamProcRequestStreamFunction = vStreamProc_SimpleBufferNode_RequestStream
          vStreamProcSetActivationSignalFunction = vStreamProc_SimpleBufferNode_SetActivationSignal
          vStreamProcStorageAvailableCallout = vStreamProc_Scheduler_HandleStorageAvailableCallout
          vStreamProcStreamAvailableCallout = vStreamProc_Scheduler_HandleStreamAvailableCallout
          vStreamProcWriteAckFunction = vStreamProc_SimpleBufferNode_WriteAck
          vStreamProcWriteInfoFunction = vStreamProc_SimpleBufferNode_WriteInfo
          vStreamProcWriteRequestFunction = vStreamProc_SimpleBufferNode_WriteRequest
        5 x vStreamProcProcessingNodeType:
          vSwUpdM_Write
            vStreamProcExternalProcessingNode:
              vStreamProcExternalProcessingNodeWorkspace = vSwUpdM_ProcNodeWriteWorkspaceType
              vStreamProcExternalProcessingNodeWorkspaceHeaderFile = vSwUpdM_ProcNodeTypes.h
              vStreamProcFlushFunction = vSwUpdM_ProcNodeWrite_Flush
              vStreamProcHeaderFile = vSwUpdM_ProcNodes.h
              vStreamProcInitFunction = vSwUpdM_ProcNodeWrite_Init
              vStreamProcProcessFunction = vSwUpdM_ProcNodeWrite_Process
              vStreamProcRequiredOutputPorts
                ResultOutputPort (vStreamProcRequiredOutputPort): vStreamProcDataTypeRef=Std_ReturnType
              vStreamProcRequiredInputPorts
                3 x vStreamProcRequiredInputPort:
                  DataInputPort: vStreamProcDataTypeRef=uint8
                  EntitiesInputPort: vStreamProcDataTypeRef=vSwUpdM_EntityIdsType
                  RangeInputPort: vStreamProcDataTypeRef=vSwUpdM_RangeInfoType
              vStreamProcOptionalInputPorts
              vStreamProcOptionalOutputPorts
          vSwUpdM_Padding
            vStreamProcExternalProcessingNode:
              vStreamProcExternalProcessingNodeWorkspace = vSwUpdM_ProcNodePaddingWorkspaceType
              vStreamProcExternalProcessingNodeWorkspaceHeaderFile = vSwUpdM_ProcNodeTypes.h
              vStreamProcFlushFunction = vSwUpdM_ProcNodePadding_Flush
              vStreamProcHeaderFile = vSwUpdM_ProcNodes.h
              vStreamProcInitFunction = vSwUpdM_ProcNodePadding_Init
              vStreamProcProcessFunction = vSwUpdM_ProcNodePadding_Process
              vStreamProcRequiredInputPorts
                3 x vStreamProcRequiredInputPort:
                  DataInputPort: vStreamProcDataTypeRef=uint8
                  EntitiesInputPort: vStreamProcDataTypeRef=vSwUpdM_EntityIdsType
                  RangeInputPort: vStreamProcDataTypeRef=vSwUpdM_RangeInfoType
              vStreamProcRequiredOutputPorts
                DataOutputPort (vStreamProcRequiredOutputPort): vStreamProcDataTypeRef=uint8
                AlignedRangeOutputPort (vStreamProcRequiredOutputPort): vStreamProcDataTypeRef=vSwUpdM_RangeInfoType
              vStreamProcOptionalOutputPorts
                ResultingRangesOutputPort (vStreamProcOptionalOutputPort): vStreamProcDataTypeRef=vSwUpdM_RangeInfoType
              vStreamProcOptionalInputPorts
          vSwUpdM_Read
            vStreamProcExternalProcessingNode:
              vStreamProcFlushFunction = vSwUpdM_ProcNodeRead_Flush
              vStreamProcProcessFunction = vSwUpdM_ProcNodeRead_Process
              vStreamProcInitFunction = vSwUpdM_ProcNodeRead_Init
              vStreamProcHeaderFile = vSwUpdM_ProcNodes.h
              vStreamProcExternalProcessingNodeWorkspaceHeaderFile = vSwUpdM_ProcNodeTypes.h
              vStreamProcExternalProcessingNodeWorkspace = vSwUpdM_ProcNodeReadWorkspaceType
              vStreamProcRequiredInputPorts
                EntitiesInputPort (vStreamProcRequiredInputPort): vStreamProcDataTypeRef=vSwUpdM_EntityIdsType
                RangeInputPort (vStreamProcRequiredInputPort): vStreamProcDataTypeRef=vSwUpdM_RangeInfoType
              vStreamProcOptionalOutputPorts
                3 x vStreamProcOptionalOutputPort:
                  DataOutputPort: vStreamProcDataTypeRef=uint8
                  AddrLenDataOutputPort: vStreamProcDataTypeRef=uint8
                  ResultOutputPort: vStreamProcDataTypeRef=Std_ReturnType
              vStreamProcOptionalInputPorts
              vStreamProcRequiredOutputPorts
          vSwUpdM_Compare
            vStreamProcByteCompareNode:
              vStreamProcFlushFunction = vStreamProc_ProcessingNode_ByteCompare_Flush
              vStreamProcHeaderFile = vStreamProc_ProcessingNode_ByteCompare.h
              vStreamProcInitFunction = vStreamProc_ProcessingNode_ByteCompare_Init
              vStreamProcProcessFunction = vStreamProc_ProcessingNode_ByteCompare_Process
              vStreamProcBytesToCompare = 256
              vStreamProcOptionalOutputPorts
                ByteCompareNode_ComparedCount: vStreamProcDataTypeRef=uint8
              vStreamProcRequiredOutputPorts
                ByteCompareNode_ResultData: vStreamProcDataTypeRef=Std_ReturnType
              vStreamProcRequiredInputPorts
                vStreamProcCompareInputPort_0 (vStreamProcCompareInputPort): vStreamProcDataTypeRef=uint8
                vStreamProcCompareInputPort_1 (vStreamProcCompareInputPort): vStreamProcDataTypeRef=uint8
              vStreamProcOptionalInputPorts
          vSwUpdM_TrackCompareProgress
            vStreamProcExternalProcessingNode:
              vStreamProcFlushFunction = vSwUpdM_ProcNodeTrackCompareProgress_Flush
              vStreamProcProcessFunction = vSwUpdM_ProcNodeTrackCompareProgress_Process
              vStreamProcInitFunction = vSwUpdM_ProcNodeTrackCompareProgress_Init
              vStreamProcHeaderFile = vSwUpdM_ProcNodes.h
              vStreamProcExternalProcessingNodeWorkspaceHeaderFile = vSwUpdM_ProcNodeTypes.h
              vStreamProcExternalProcessingNodeWorkspace = vSwUpdM_ProcNodeTrackCompareProgressWorkspaceType
              vStreamProcRequiredOutputPorts
              vStreamProcRequiredInputPorts
                3 x vStreamProcRequiredInputPort:
                  CountInputPort: vStreamProcDataTypeRef=uint8
                  EntitiesInputPort: vStreamProcDataTypeRef=vSwUpdM_EntityIdsType
                  RangeInputPort: vStreamProcDataTypeRef=vSwUpdM_RangeInfoType
              vStreamProcOptionalInputPorts
              vStreamProcOptionalOutputPorts
      8 x vStreamProcDataType:
        vSwUpdM_EntityIdsType: vStreamProcApproximateDataElementSize=36, vStreamProcDataElementType=vSwUpdM_EntityIdsType, vStreamProcHeaderFileOfDataElementType=vSwUpdM_ProcNodeTypes.h, vStreamProcDataTypeId=5
        vSwUpdM_RangeInfoType: vStreamProcApproximateDataElementSize=8, vStreamProcDataElementType=vSwUpdM_RangeInfoType, vStreamProcHeaderFileOfDataElementType=vSwUpdM_ProcNodeTypes.h, vStreamProcDataTypeId=7
        vSwUpdM_ProcNodeOperationType: vStreamProcApproximateDataElementSize=1, vStreamProcDataElementType=vSwUpdM_ProcNodeOperationType, vStreamProcHeaderFileOfDataElementType=vSwUpdM_ProcNodeTypes.h, vStreamProcDataTypeId=6
        Undefined: vStreamProcDataElementType=void, vStreamProcApproximateDataElementSize=1, vStreamProcHeaderFileOfDataElementType=Std_Types.h, vStreamProcDefragmentThreshold=1, vStreamProcDataTypeId=1
        uint8: vStreamProcDataElementType=uint8, vStreamProcHeaderFileOfDataElementType=Std_Types.h, vStreamProcApproximateDataElementSize=1, vStreamProcDataTypeId=2
        uint16: vStreamProcDataElementType=uint16, vStreamProcHeaderFileOfDataElementType=Std_Types.h, vStreamProcApproximateDataElementSize=2, vStreamProcDataTypeId=3
        uint32: vStreamProcDataElementType=uint32, vStreamProcHeaderFileOfDataElementType=Std_Types.h, vStreamProcApproximateDataElementSize=4, vStreamProcDataTypeId=4
        Std_ReturnType: vStreamProcDataElementType=Std_ReturnType, vStreamProcHeaderFileOfDataElementType=Std_Types.h, vStreamProcApproximateDataElementSize=1, vStreamProcDataTypeId=0
    3 x vStreamProcPipe:
      vSwUpdMSyncModuleCopyPipe: vStreamProcPipeId=3
        vStreamProcNodes
          vSwUpdMSyncModuleCopy_Padding_Data (vStreamProcStorageNode): vStreamProcBufferSize=256, vStreamProcStorageNodeId=24, vStreamProcDataTypeRef=uint8, vStreamProcStorageNodeTypeRef=vStreamProcSimpleBuffer
          vSwUpdMSyncModuleCopy_ReadSource_Data (vStreamProcStorageNode): vStreamProcBufferSize=256, vStreamProcStorageNodeId=25, vStreamProcDataTypeRef=uint8, vStreamProcStorageNodeTypeRef=vStreamProcSimpleBuffer
          vSwUpdMSyncModuleCopy_ReadSource (vStreamProcProcessingNode): vStreamProcProcessingNodeId=0, vStreamProcProcessingNodeTypeRef=vSwUpdM_Read
            vSwUpdMSyncModuleCopy_ReadSource_Entities_In (vStreamProcProcessingNodeInputPort): vStreamProcProcessingNodeInput=vStreamProcRequiredInputPorts/EntitiesInputPort
            vSwUpdMSyncModuleCopy_ReadSource_Range_In (vStreamProcProcessingNodeInputPort): vStreamProcProcessingNodeInput=vStreamProcRequiredInputPorts/RangeInputPort
            vSwUpdMSyncModuleCopy_ReadSource_Data_Out (vStreamProcProcessingNodeOutputPort): vStreamProcProcessingNodeOutput=vStreamProcOptionalOutputPorts/DataOutputPort
          vSwUpdMSyncModuleCopy_WriteTarget (vStreamProcProcessingNode): vStreamProcProcessingNodeId=0, vStreamProcProcessingNodeTypeRef=vSwUpdM_Write
            3 x vStreamProcProcessingNodeInputPort:
              vSwUpdMSyncModuleCopy_WriteTarget_Data_In: vStreamProcProcessingNodeInput=vStreamProcRequiredInputPorts/DataInputPort
              vSwUpdMSyncModuleCopy_WriteTarget_AlignedRange_In: vStreamProcProcessingNodeInput=vStreamProcRequiredInputPorts/RangeInputPort
              vSwUpdMSyncModuleCopy_WriteTarget_Entities_In: vStreamProcProcessingNodeInput=vStreamProcRequiredInputPorts/EntitiesInputPort
            vSwUpdMSyncModuleCopy_WriteTarget_Result_Out (vStreamProcProcessingNodeOutputPort): vStreamProcProcessingNodeOutput=vStreamProcRequiredOutputPorts/ResultOutputPort
          5 x vStreamProcStorageNode, all with vStreamProcBufferSize=1, vStreamProcStorageNodeTypeRef=vStreamProcSimpleBuffer:
            vSwUpdMSyncModuleCopy_Entry_SourceEntities: vStreamProcStorageNodeId=21, vStreamProcDataTypeRef=vSwUpdM_EntityIdsType
            vSwUpdMSyncModuleCopy_Entry_TargetEntities: vStreamProcStorageNodeId=22, vStreamProcDataTypeRef=vSwUpdM_EntityIdsType
            vSwUpdMSyncModuleCopy_Entry_Range: vStreamProcStorageNodeId=20, vStreamProcDataTypeRef=vSwUpdM_RangeInfoType
            vSwUpdMSyncModuleCopy_WriteTarget_Result: vStreamProcStorageNodeId=26, vStreamProcDataTypeRef=Std_ReturnType
            vSwUpdMSyncModuleCopy_Padding_AlignedRange: vStreamProcStorageNodeId=23, vStreamProcDataTypeRef=vSwUpdM_RangeInfoType
          vSwUpdMSyncModuleCopy_Padding (vStreamProcProcessingNode): vStreamProcProcessingNodeId=0, vStreamProcProcessingNodeTypeRef=vSwUpdM_Padding
            3 x vStreamProcProcessingNodeInputPort:
              vSwUpdMSyncModuleCopy_Padding_Data_In: vStreamProcProcessingNodeInput=vStreamProcRequiredInputPorts/DataInputPort
              vSwUpdMSyncModuleCopy_Padding_Entities_In: vStreamProcProcessingNodeInput=vStreamProcRequiredInputPorts/EntitiesInputPort
              vSwUpdMSyncModuleCopy_Padding_Range_In: vStreamProcProcessingNodeInput=vStreamProcRequiredInputPorts/RangeInputPort
            vSwUpdMSyncModuleCopy_Padding_Data_Out (vStreamProcProcessingNodeOutputPort): vStreamProcProcessingNodeOutput=vStreamProcRequiredOutputPorts/DataOutputPort
            vSwUpdMSyncModuleCopy_Padding_AlignedRange_Out (vStreamProcProcessingNodeOutputPort): vStreamProcProcessingNodeOutput=AlignedRangeOutputPort
        vStreamProcAccessPoints
          3 x vStreamProcEntryPoint:
            vSwUpdMSyncModuleCopy_SourceEntities_Entry: vStreamProcEntryPointId=10, vStreamProcEntryStorageNode=vSwUpdMSyncModuleCopy_Entry_SourceEntities
            vSwUpdMSyncModuleCopy_TargetEntities_Entry: vStreamProcEntryPointId=11, vStreamProcEntryStorageNode=vSwUpdMSyncModuleCopy_Entry_TargetEntities
            vSwUpdMSyncModuleCopy_Range_Entry: vStreamProcEntryPointId=9, vStreamProcEntryStorageNode=vSwUpdMSyncModuleCopy_Entry_Range
          vSwUpdMSyncModuleCopy_Result_Exit (vStreamProcExitPoint): vStreamProcExitPointId=4, vStreamProcExitStorageNode=vSwUpdMSyncModuleCopy_WriteTarget_Result
        vStreamProcEdges
          ReadSource_Entities_In (vStreamProcConsumer):
            vStreamProcProcessingNodeInputRef = vSwUpdMSyncModuleCopy_ReadSource_Entities_In
            vStreamProcStorageNodeRef = vSwUpdMSyncModuleCopy_Entry_SourceEntities
          ReadSource_Data_Out (vStreamProcProducer): vStreamProcProcessingNodeOutputRef=vSwUpdMSyncModuleCopy_ReadSource_Data_Out, vStreamProcStorageNodeRef=vSwUpdMSyncModuleCopy_ReadSource_Data
          3 x vStreamProcConsumer:
            WriteTarget_Data_In: vStreamProcProcessingNodeInputRef=vSwUpdMSyncModuleCopy_WriteTarget_Data_In, vStreamProcStorageNodeRef=vSwUpdMSyncModuleCopy_Padding_Data
            WriteTarget_AlignedRange_In: vStreamProcProcessingNodeInputRef=vSwUpdMSyncModuleCopy_WriteTarget_AlignedRange_In, vStreamProcStorageNodeRef=vSwUpdMSyncModuleCopy_Padding_AlignedRange
            WriteTarget_Entities_In: vStreamProcProcessingNodeInputRef=vSwUpdMSyncModuleCopy_WriteTarget_Entities_In, vStreamProcStorageNodeRef=vSwUpdMSyncModuleCopy_Entry_TargetEntities
          WriteTarget_Result_Out (vStreamProcProducer):
            vStreamProcProcessingNodeOutputRef = vSwUpdMSyncModuleCopy_WriteTarget_Result_Out
            vStreamProcStorageNodeRef = vSwUpdMSyncModuleCopy_WriteTarget_Result
          4 x vStreamProcConsumer:
            ReadSource_Range_In: vStreamProcProcessingNodeInputRef=vSwUpdMSyncModuleCopy_ReadSource_Range_In, vStreamProcStorageNodeRef=vSwUpdMSyncModuleCopy_Entry_Range
            Padding_Data_In: vStreamProcProcessingNodeInputRef=vSwUpdMSyncModuleCopy_Padding_Data_In, vStreamProcStorageNodeRef=vSwUpdMSyncModuleCopy_ReadSource_Data
            Padding_Entities_In: vStreamProcProcessingNodeInputRef=vSwUpdMSyncModuleCopy_Padding_Entities_In, vStreamProcStorageNodeRef=vSwUpdMSyncModuleCopy_Entry_TargetEntities
            Padding_Range_In: vStreamProcProcessingNodeInputRef=vSwUpdMSyncModuleCopy_Padding_Range_In, vStreamProcStorageNodeRef=vSwUpdMSyncModuleCopy_Entry_Range
          Padding_Data_Out (vStreamProcProducer): vStreamProcProcessingNodeOutputRef=vSwUpdMSyncModuleCopy_Padding_Data_Out, vStreamProcStorageNodeRef=vSwUpdMSyncModuleCopy_Padding_Data
          Padding_AlignedRanges_Out (vStreamProcProducer):
            vStreamProcProcessingNodeOutputRef = vSwUpdMSyncModuleCopy_Padding_AlignedRange_Out
            vStreamProcStorageNodeRef = vSwUpdMSyncModuleCopy_Padding_AlignedRange
        vStreamProcStates
      vSwUpdMSyncModuleComparePipe: vStreamProcPipeId=2
        vStreamProcNodes
          3 x vStreamProcStorageNode, all with vStreamProcDataTypeRef=uint8, vStreamProcStorageNodeTypeRef=vStreamProcSimpleBuffer:
            vSwUpdMSyncModuleCompare_ReadSource_Data: vStreamProcBufferSize=512, vStreamProcStorageNodeId=18
            vSwUpdMSyncModuleCompare_ReadTarget_Data: vStreamProcBufferSize=512, vStreamProcStorageNodeId=19
            vSwUpdMSyncModuleCompare_Compare_Count: vStreamProcBufferSize=4, vStreamProcStorageNodeId=13
          4 x vStreamProcProcessingNode, all with vStreamProcProcessingNodeId=0:
            vSwUpdMSyncModuleCompare_ReadSource: vStreamProcProcessingNodeTypeRef=vSwUpdM_Read
              vSwUpdMSyncModuleCompare_ReadSource_Entities_In (vStreamProcProcessingNodeInputPort): vStreamProcProcessingNodeInput=vStreamProcRequiredInputPorts/EntitiesInputPort
              vSwUpdMSyncModuleCompare_ReadSource_Range_In (vStreamProcProcessingNodeInputPort): vStreamProcProcessingNodeInput=vStreamProcRequiredInputPorts/RangeInputPort
              vSwUpdMSyncModuleCompare_ReadSource_Data_Out (vStreamProcProcessingNodeOutputPort): vStreamProcProcessingNodeOutput=vStreamProcOptionalOutputPorts/DataOutputPort
            vSwUpdMSyncModuleCompare_ReadTarget: vStreamProcProcessingNodeTypeRef=vSwUpdM_Read
              vSwUpdMSyncModuleCompare_ReadTarget_Entities_In (vStreamProcProcessingNodeInputPort): vStreamProcProcessingNodeInput=vStreamProcRequiredInputPorts/EntitiesInputPort
              vSwUpdMSyncModuleCompare_ReadTarget_Range_In (vStreamProcProcessingNodeInputPort): vStreamProcProcessingNodeInput=vStreamProcRequiredInputPorts/RangeInputPort
              vSwUpdMSyncModuleCompare_ReadTarget_Data_Out (vStreamProcProcessingNodeOutputPort): vStreamProcProcessingNodeOutput=vStreamProcOptionalOutputPorts/DataOutputPort
            vSwUpdMSyncModuleCompare_Compare: vStreamProcProcessingNodeTypeRef=vSwUpdM_Compare
              vSwUpdMSyncModuleCompare_Compare_SourceData_In (vStreamProcProcessingNodeInputPort): vStreamProcProcessingNodeInput=vStreamProcRequiredInputPorts/vStreamProcCompareInputPort_0
              vSwUpdMSyncModuleCompare_Compare_TargetData_In (vStreamProcProcessingNodeInputPort): vStreamProcProcessingNodeInput=vStreamProcRequiredInputPorts/vStreamProcCompareInputPort_1
              vSwUpdMSyncModuleCompare_Compare_Result_Out (vStreamProcProcessingNodeOutputPort): vStreamProcProcessingNodeOutput=vStreamProcRequiredOutputPorts/ByteCompareNode_ResultData
              vSwUpdMSyncModuleCompare_Compare_Count_Out (vStreamProcProcessingNodeOutputPort): vStreamProcProcessingNodeOutput=vStreamProcOptionalOutputPorts/ByteCompareNode_ComparedCount
            vSwUpdMSyncModuleCompare_TrackCompareProgress: vStreamProcProcessingNodeTypeRef=vSwUpdM_TrackCompareProgress
              3 x vStreamProcProcessingNodeInputPort:
                vSwUpdMSyncModuleCompare_TrackCompareProgress_Entities_In: vStreamProcProcessingNodeInput=vStreamProcRequiredInputPorts/EntitiesInputPort
                vSwUpdMSyncModuleCompare_TrackCompareProgress_Count_In: vStreamProcProcessingNodeInput=CountInputPort
                vSwUpdMSyncModuleCompare_TrackCompareProgress_Range_In: vStreamProcProcessingNodeInput=vStreamProcRequiredInputPorts/RangeInputPort
          4 x vStreamProcStorageNode, all with vStreamProcBufferSize=1, vStreamProcStorageNodeTypeRef=vStreamProcSimpleBuffer:
            vSwUpdMSyncModuleCompare_Entry_SourceEntities: vStreamProcStorageNodeId=16, vStreamProcDataTypeRef=vSwUpdM_EntityIdsType
            vSwUpdMSyncModuleCompare_Entry_TargetEntities: vStreamProcStorageNodeId=17, vStreamProcDataTypeRef=vSwUpdM_EntityIdsType
            vSwUpdMSyncModuleCompare_Compare_Result: vStreamProcStorageNodeId=14, vStreamProcDataTypeRef=Std_ReturnType
            vSwUpdMSyncModuleCompare_Entry_Range: vStreamProcStorageNodeId=15, vStreamProcDataTypeRef=vSwUpdM_RangeInfoType
        vStreamProcAccessPoints
          3 x vStreamProcEntryPoint:
            vSwUpdMSyncModuleCompare_SourceEntities_Entry: vStreamProcEntryPointId=7, vStreamProcEntryStorageNode=vSwUpdMSyncModuleCompare_Entry_SourceEntities
            vSwUpdMSyncModuleCompare_TargetEntities_Entry: vStreamProcEntryPointId=8, vStreamProcEntryStorageNode=vSwUpdMSyncModuleCompare_Entry_TargetEntities
            vSwUpdMSyncModuleCompare_Range_Entry: vStreamProcEntryPointId=6, vStreamProcEntryStorageNode=vSwUpdMSyncModuleCompare_Entry_Range
          vSwUpdMSyncModuleCompare_Result_Exit (vStreamProcExitPoint): vStreamProcExitPointId=3, vStreamProcExitStorageNode=vSwUpdMSyncModuleCompare_Compare_Result
        vStreamProcEdges
          ReadSource_Entities_In (vStreamProcConsumer):
            vStreamProcProcessingNodeInputRef = vSwUpdMSyncModuleCompare_ReadSource_Entities_In
            vStreamProcStorageNodeRef = vSwUpdMSyncModuleCompare_Entry_SourceEntities
          ReadSource_Range_In (vStreamProcConsumer): vStreamProcProcessingNodeInputRef=vSwUpdMSyncModuleCompare_ReadSource_Range_In, vStreamProcStorageNodeRef=vSwUpdMSyncModuleCompare_Entry_Range
          ReadSource_Data_Out (vStreamProcProducer):
            vStreamProcProcessingNodeOutputRef = vSwUpdMSyncModuleCompare_ReadSource_Data_Out
            vStreamProcStorageNodeRef = vSwUpdMSyncModuleCompare_ReadSource_Data
          ReadTarget_Entities_In (vStreamProcConsumer):
            vStreamProcProcessingNodeInputRef = vSwUpdMSyncModuleCompare_ReadTarget_Entities_In
            vStreamProcStorageNodeRef = vSwUpdMSyncModuleCompare_Entry_TargetEntities
          ReadTarget_Range_In (vStreamProcConsumer): vStreamProcProcessingNodeInputRef=vSwUpdMSyncModuleCompare_ReadTarget_Range_In, vStreamProcStorageNodeRef=vSwUpdMSyncModuleCompare_Entry_Range
          ReadTarget_Data_Out (vStreamProcProducer):
            vStreamProcProcessingNodeOutputRef = vSwUpdMSyncModuleCompare_ReadTarget_Data_Out
            vStreamProcStorageNodeRef = vSwUpdMSyncModuleCompare_ReadTarget_Data
          Compare_SourceData_In (vStreamProcConsumer):
            vStreamProcProcessingNodeInputRef = vSwUpdMSyncModuleCompare_Compare_SourceData_In
            vStreamProcStorageNodeRef = vSwUpdMSyncModuleCompare_ReadSource_Data
          Compare_TargetData_In (vStreamProcConsumer):
            vStreamProcProcessingNodeInputRef = vSwUpdMSyncModuleCompare_Compare_TargetData_In
            vStreamProcStorageNodeRef = vSwUpdMSyncModuleCompare_ReadTarget_Data
          Compare_Result_Out (vStreamProcProducer):
            vStreamProcProcessingNodeOutputRef = vSwUpdMSyncModuleCompare_Compare_Result_Out
            vStreamProcStorageNodeRef = vSwUpdMSyncModuleCompare_Compare_Result
          Compare_Count_Out (vStreamProcProducer):
            vStreamProcProcessingNodeOutputRef = vSwUpdMSyncModuleCompare_Compare_Count_Out
            vStreamProcStorageNodeRef = vSwUpdMSyncModuleCompare_Compare_Count
          3 x vStreamProcConsumer:
            TrackCompareProgress_Entities_In: vStreamProcProcessingNodeInputRef=vSwUpdMSyncModuleCompare_TrackCompareProgress_Entities_In, vStreamProcStorageNodeRef=vSwUpdMSyncModuleCompare_Entry_TargetEntities
            TrackCompareProgress_Count_In: vStreamProcProcessingNodeInputRef=vSwUpdMSyncModuleCompare_TrackCompareProgress_Count_In, vStreamProcStorageNodeRef=vSwUpdMSyncModuleCompare_Compare_Count
            TrackCompareProgress_Range_In: vStreamProcProcessingNodeInputRef=vSwUpdMSyncModuleCompare_TrackCompareProgress_Range_In, vStreamProcStorageNodeRef=vSwUpdMSyncModuleCompare_Entry_Range
        vStreamProcStates
      vSwUpdMStreamDataPipe: vStreamProcPipeId=1
        vStreamProcStates
          vSwUpdMStreamDataPipe_ProcMode_Unprocessed (vStreamProcMode): vStreamProcModeHandleId=0, vStreamProcModeId=2
            vSwUpdMStreamDataPipe_BaseState_Compressed (vStreamProcBaseState): vStreamProcBaseStateActivation=false, vStreamProcBaseStateRef=vStreamProcStates/vSwUpdMStreamDataPipe_BaseState_Compressed
            vSwUpdMStreamDataPipe_BaseState_Encrypted (vStreamProcBaseState): vStreamProcBaseStateActivation=false, vStreamProcBaseStateRef=vStreamProcStates/vSwUpdMStreamDataPipe_BaseState_Encrypted
          3 x vStreamProcBaseState:
            vSwUpdMStreamDataPipe_BaseState_Compressed: vStreamProcDefaultActivation=false, vStreamProcBaseStateId=0
            vSwUpdMStreamDataPipe_BaseState_Local: vStreamProcDefaultActivation=true, vStreamProcBaseStateId=2
            vSwUpdMStreamDataPipe_BaseState_Remote: vStreamProcDefaultActivation=false, vStreamProcBaseStateId=3
          vSwUpdMStreamDataPipe_MetaState_Remote (vStreamProcMetaState): vStreamProcMetaStateId=6, vStreamProcActivationConditionsInfixNotation=vSwUpdMStreamDataPipe_BaseState_Remote
            vStreamProcActivationCondition_Remote (vStreamProcActivationCondition):
              vStreamProcElementPos = 0
              vStreamProcExpectedBaseStateActivation = true
              vStreamProcBaseState = vStreamProcStates/vSwUpdMStreamDataPipe_BaseState_Remote
          vSwUpdMStreamDataPipe_ProcMode_Local (vStreamProcMode): vStreamProcModeId=0
            vSwUpdMStreamDataPipe_BaseState_Local (vStreamProcBaseState): vStreamProcBaseStateActivation=true, vStreamProcBaseStateRef=vStreamProcStates/vSwUpdMStreamDataPipe_BaseState_Local
            vSwUpdMStreamDataPipe_BaseState_Remote (vStreamProcBaseState): vStreamProcBaseStateActivation=false, vStreamProcBaseStateRef=vStreamProcStates/vSwUpdMStreamDataPipe_BaseState_Remote
          vSwUpdMStreamDataPipe_ProcMode_Remote (vStreamProcMode): vStreamProcModeId=1
            vSwUpdMStreamDataPipe_BaseState_Remote (vStreamProcBaseState): vStreamProcBaseStateActivation=true, vStreamProcBaseStateRef=vStreamProcStates/vSwUpdMStreamDataPipe_BaseState_Remote
            vSwUpdMStreamDataPipe_BaseState_Local (vStreamProcBaseState): vStreamProcBaseStateActivation=false, vStreamProcBaseStateRef=vStreamProcStates/vSwUpdMStreamDataPipe_BaseState_Local
          vSwUpdMStreamDataPipe_BaseState_Encrypted (vStreamProcBaseState): vStreamProcDefaultActivation=false, vStreamProcBaseStateId=1
          7 x vStreamProcMetaState:
            vSwUpdMStreamDataPipe_MetaState_Local: vStreamProcMetaStateId=5, vStreamProcActivationConditionsInfixNotation=vSwUpdMStreamDataPipe_BaseState_Local
              vStreamProcActivationCondition_Local (vStreamProcActivationCondition):
                vStreamProcElementPos = 0
                vStreamProcExpectedBaseStateActivation = true
                vStreamProcBaseState = vStreamProcStates/vSwUpdMStreamDataPipe_BaseState_Local
            vSwUpdMStreamDataPipe_MetaState_Unprocessed: vStreamProcMetaStateId=7, vStreamProcActivationConditionsInfixNotation=((!vSwUpdMStreamDataPipe_BaseState_Compressed AND !vSwUpdMStreamDataPipe_BaseState_Encrypted) AND vSwUpdMStreamDataPipe_BaseState_Local)
              3 x vStreamProcActivationCondition:
                vStreamProcActivationCondition_Compressed: vStreamProcExpectedBaseStateActivation=false, vStreamProcElementPos=0, vStreamProcBaseState=vStreamProcStates/vSwUpdMStreamDataPipe_BaseState_Compressed
                vStreamProcActivationCondition_Encrypted: vStreamProcElementPos=1, vStreamProcExpectedBaseStateActivation=false, vStreamProcOperation=AND, vStreamProcBaseState=vStreamProcStates/vSwUpdMStreamDataPipe_BaseState_Encrypted
                vStreamProcActivationCondition_Local: vStreamProcElementPos=2, vStreamProcExpectedBaseStateActivation=true, vStreamProcOperation=AND, vStreamProcBaseState=vStreamProcStates/vSwUpdMStreamDataPipe_BaseState_Local
            vSwUpdMStreamDataPipe_MetaState_Compressed: vStreamProcMetaStateId=0, vStreamProcActivationConditionsInfixNotation=(vSwUpdMStreamDataPipe_BaseState_Compressed AND vSwUpdMStreamDataPipe_BaseState_Local)
              vStreamProcActivationCondition_Compressed (vStreamProcActivationCondition):
                vStreamProcExpectedBaseStateActivation = true
                vStreamProcElementPos = 0
                vStreamProcBaseState = vStreamProcStates/vSwUpdMStreamDataPipe_BaseState_Compressed
              vStreamProcActivationCondition_Local (vStreamProcActivationCondition):
                vStreamProcElementPos = 1
                vStreamProcExpectedBaseStateActivation = true
                vStreamProcOperation = AND
                vStreamProcBaseState = vStreamProcStates/vSwUpdMStreamDataPipe_BaseState_Local
            vSwUpdMStreamDataPipe_MetaState_CompressedOnly: vStreamProcMetaStateId=2, vStreamProcActivationConditionsInfixNotation=((vSwUpdMStreamDataPipe_BaseState_Compressed AND !vSwUpdMStreamDataPipe_BaseState_Encrypted) AND vSwUpdMStreamDataPipe_BaseState_Local)
              3 x vStreamProcActivationCondition:
                vStreamProcActivationCondition_Compressed: vStreamProcExpectedBaseStateActivation=true, vStreamProcElementPos=0, vStreamProcBaseState=vStreamProcStates/vSwUpdMStreamDataPipe_BaseState_Compressed
                vStreamProcActivationCondition_Encrypted: vStreamProcElementPos=1, vStreamProcExpectedBaseStateActivation=false, vStreamProcOperation=AND, vStreamProcBaseState=vStreamProcStates/vSwUpdMStreamDataPipe_BaseState_Encrypted
                vStreamProcActivationCondition_Local: vStreamProcElementPos=2, vStreamProcExpectedBaseStateActivation=true, vStreamProcOperation=AND, vStreamProcBaseState=vStreamProcStates/vSwUpdMStreamDataPipe_BaseState_Local
            vSwUpdMStreamDataPipe_MetaState_Encrypted: vStreamProcMetaStateId=3, vStreamProcActivationConditionsInfixNotation=(vSwUpdMStreamDataPipe_BaseState_Encrypted AND vSwUpdMStreamDataPipe_BaseState_Local)
              vStreamProcActivationCondition_Encrypted (vStreamProcActivationCondition):
                vStreamProcElementPos = 0
                vStreamProcExpectedBaseStateActivation = true
                vStreamProcBaseState = vStreamProcStates/vSwUpdMStreamDataPipe_BaseState_Encrypted
              vStreamProcActivationCondition_Local (vStreamProcActivationCondition):
                vStreamProcElementPos = 1
                vStreamProcExpectedBaseStateActivation = true
                vStreamProcOperation = AND
                vStreamProcBaseState = vStreamProcStates/vSwUpdMStreamDataPipe_BaseState_Local
            vSwUpdMStreamDataPipe_MetaState_EncryptedOnly: vStreamProcMetaStateId=4, vStreamProcActivationConditionsInfixNotation=((!vSwUpdMStreamDataPipe_BaseState_Compressed AND vSwUpdMStreamDataPipe_BaseState_Encrypted) AND vSwUpdMStreamDataPipe_BaseState_Local)
              3 x vStreamProcActivationCondition:
                vStreamProcActivationCondition_Compressed: vStreamProcExpectedBaseStateActivation=false, vStreamProcElementPos=0, vStreamProcBaseState=vStreamProcStates/vSwUpdMStreamDataPipe_BaseState_Compressed
                vStreamProcActivationCondition_Encrypted: vStreamProcElementPos=1, vStreamProcExpectedBaseStateActivation=true, vStreamProcOperation=AND, vStreamProcBaseState=vStreamProcStates/vSwUpdMStreamDataPipe_BaseState_Encrypted
                vStreamProcActivationCondition_Local: vStreamProcElementPos=2, vStreamProcExpectedBaseStateActivation=true, vStreamProcOperation=AND, vStreamProcBaseState=vStreamProcStates/vSwUpdMStreamDataPipe_BaseState_Local
            vSwUpdMStreamDataPipe_MetaState_CompressedAndEncrypted: vStreamProcMetaStateId=1, vStreamProcActivationConditionsInfixNotation=((vSwUpdMStreamDataPipe_BaseState_Compressed AND vSwUpdMStreamDataPipe_BaseState_Encrypted) AND vSwUpdMStreamDataPipe_BaseState_Local)
              3 x vStreamProcActivationCondition, all with vStreamProcExpectedBaseStateActivation=true:
                vStreamProcActivationCondition_Compressed: vStreamProcElementPos=0, vStreamProcBaseState=vStreamProcStates/vSwUpdMStreamDataPipe_BaseState_Compressed
                vStreamProcActivationCondition_Encrypted: vStreamProcElementPos=1, vStreamProcOperation=AND, vStreamProcBaseState=vStreamProcStates/vSwUpdMStreamDataPipe_BaseState_Encrypted
                vStreamProcActivationCondition_Local: vStreamProcElementPos=2, vStreamProcOperation=AND, vStreamProcBaseState=vStreamProcStates/vSwUpdMStreamDataPipe_BaseState_Local
        vStreamProcNodes
          vSwUpdMStreamData_Entry_Data (vStreamProcStorageNode): vStreamProcBufferSize=1024, vStreamProcStorageNodeId=6, vStreamProcDataTypeRef=uint8, vStreamProcStorageNodeTypeRef=vStreamProcSimpleBuffer
          vSwUpdMStreamData_Padding_Data (vStreamProcStorageNode): vStreamProcBufferSize=1024, vStreamProcStorageNodeId=10, vStreamProcDataTypeRef=uint8, vStreamProcStorageNodeTypeRef=vStreamProcSimpleBuffer
          vSwUpdMStreamData_Write (vStreamProcProcessingNode): vStreamProcProcessingNodeId=0, vStreamProcProcessingNodeTypeRef=vSwUpdM_Write
            3 x vStreamProcProcessingNodeInputPort:
              vSwUpdMStreamData_Write_Data_In: vStreamProcProcessingNodeInput=vStreamProcRequiredInputPorts/DataInputPort
              vSwUpdMStreamData_Write_AlignedRange_In: vStreamProcProcessingNodeInput=vStreamProcRequiredInputPorts/RangeInputPort
              vSwUpdMStreamData_Write_Entities_In: vStreamProcProcessingNodeInput=vStreamProcRequiredInputPorts/EntitiesInputPort
            vSwUpdMStreamData_Write_Result_Out (vStreamProcProcessingNodeOutputPort): vStreamProcProcessingNodeOutput=vStreamProcRequiredOutputPorts/ResultOutputPort
          vSwUpdMStreamData_Padding (vStreamProcProcessingNode): vStreamProcProcessingNodeId=0, vStreamProcProcessingNodeTypeRef=vSwUpdM_Padding
            3 x vStreamProcProcessingNodeInputPort:
              vSwUpdMStreamData_Padding_Entities_In: vStreamProcProcessingNodeInput=vStreamProcRequiredInputPorts/EntitiesInputPort
              vSwUpdMStreamData_Padding_Data_In: vStreamProcProcessingNodeInput=vStreamProcRequiredInputPorts/DataInputPort
              vSwUpdMStreamData_Padding_Range_In: vStreamProcProcessingNodeInput=vStreamProcRequiredInputPorts/RangeInputPort
            3 x vStreamProcProcessingNodeOutputPort:
              vSwUpdMStreamData_Padding_AlignedRange_Out: vStreamProcProcessingNodeOutput=AlignedRangeOutputPort
              vSwUpdMStreamData_Padding_Data_Out: vStreamProcProcessingNodeOutput=vStreamProcRequiredOutputPorts/DataOutputPort
              vSwUpdMStreamData_Padding_ResultingRanges_Out: vStreamProcProcessingNodeOutput=ResultingRangesOutputPort
          5 x vStreamProcStorageNode, all with vStreamProcStorageNodeTypeRef=vStreamProcSimpleBuffer:
            vSwUpdMStreamData_Entry_Entities: vStreamProcBufferSize=1, vStreamProcStorageNodeId=7, vStreamProcDataTypeRef=vSwUpdM_EntityIdsType
            vSwUpdMStreamData_Entry_Range: vStreamProcBufferSize=1, vStreamProcStorageNodeId=8, vStreamProcDataTypeRef=vSwUpdM_RangeInfoType
            vSwUpdMStreamData_Padding_AlignedRange: vStreamProcBufferSize=1, vStreamProcStorageNodeId=9, vStreamProcDataTypeRef=vSwUpdM_RangeInfoType
            vSwUpdMStreamData_Padding_ResultingRanges: vStreamProcBufferSize=2, vStreamProcStorageNodeId=11, vStreamProcDataTypeRef=vSwUpdM_RangeInfoType
            vSwUpdMStreamData_Write_Result: vStreamProcBufferSize=1, vStreamProcStorageNodeId=12, vStreamProcDataTypeRef=Std_ReturnType
        vStreamProcAccessPoints
          3 x vStreamProcEntryPoint:
            vSwUpdMStreamData_Entities_Entry: vStreamProcEntryPointId=4, vStreamProcEntryStorageNode=vSwUpdMStreamData_Entry_Entities
            vSwUpdMStreamData_Range_Entry: vStreamProcEntryPointId=5, vStreamProcEntryStorageNode=vSwUpdMStreamData_Entry_Range
            vSwUpdMStreamData_Data_Entry: vStreamProcEntryPointId=3, vStreamProcEntryStorageNode=vSwUpdMStreamData_Entry_Data
          vSwUpdMStreamData_Result_Exit (vStreamProcExitPoint): vStreamProcExitPointId=1, vStreamProcExitStorageNode=vSwUpdMStreamData_Write_Result
          vSwUpdMStreamData_ResultingRanges_Exit (vStreamProcExitPoint): vStreamProcExitPointId=2, vStreamProcExitStorageNode=vSwUpdMStreamData_Padding_ResultingRanges
        vStreamProcEdges
          3 x vStreamProcConsumer, all with vStreamProcMetaStateEdgeActive=vSwUpdMStreamDataPipe_MetaState_Local:
            Write_Data_In: vStreamProcProcessingNodeInputRef=vSwUpdMStreamData_Write_Data_In, vStreamProcStorageNodeRef=vSwUpdMStreamData_Padding_Data
            Write_AlignedRange_In: vStreamProcProcessingNodeInputRef=vSwUpdMStreamData_Write_AlignedRange_In, vStreamProcStorageNodeRef=vSwUpdMStreamData_Padding_AlignedRange
            Write_Entities_In: vStreamProcProcessingNodeInputRef=vSwUpdMStreamData_Write_Entities_In, vStreamProcStorageNodeRef=vSwUpdMStreamData_Entry_Entities
          Write_Result_Out (vStreamProcProducer): vStreamProcProcessingNodeOutputRef=vSwUpdMStreamData_Write_Result_Out, vStreamProcStorageNodeRef=vSwUpdMStreamData_Write_Result
          3 x vStreamProcConsumer:
            Padding_Entities_In: vStreamProcProcessingNodeInputRef=vSwUpdMStreamData_Padding_Entities_In, vStreamProcStorageNodeRef=vSwUpdMStreamData_Entry_Entities, vStreamProcMetaStateEdgeActive=vSwUpdMStreamDataPipe_MetaState_Local
            Padding_Range_In: vStreamProcProcessingNodeInputRef=vSwUpdMStreamData_Padding_Range_In, vStreamProcStorageNodeRef=vSwUpdMStreamData_Entry_Range, vStreamProcMetaStateEdgeActive=vSwUpdMStreamDataPipe_MetaState_Local
            Padding_Data_In: vStreamProcProcessingNodeInputRef=vSwUpdMStreamData_Padding_Data_In, vStreamProcStorageNodeRef=vSwUpdMStreamData_Entry_Data, vStreamProcMetaStateEdgeActive=vSwUpdMStreamDataPipe_MetaState_Unprocessed
          3 x vStreamProcProducer:
            Padding_AlignedRange_Out: vStreamProcProcessingNodeOutputRef=vSwUpdMStreamData_Padding_AlignedRange_Out, vStreamProcStorageNodeRef=vSwUpdMStreamData_Padding_AlignedRange
            Padding_Data_Out: vStreamProcProcessingNodeOutputRef=vSwUpdMStreamData_Padding_Data_Out, vStreamProcStorageNodeRef=vSwUpdMStreamData_Padding_Data
            Padding_ResultingRanges_Out: vStreamProcProcessingNodeOutputRef=vSwUpdMStreamData_Padding_ResultingRanges_Out, vStreamProcStorageNodeRef=vSwUpdMStreamData_Padding_ResultingRanges
