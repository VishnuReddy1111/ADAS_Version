[part 3 of 3: package /ActiveEcuC]
AUTOSAR XML (schema 4-3-0)
package /ActiveEcuC  (continued)
  module config Com: implementation-config-variant=VARIANT-PRE-COMPILE, module-description=Com_Impl  (continued)
    ComConfig: ComConfigurationId=0, ComRxDeferredNotificationCacheSize=1, ComRxImmediateNotificationCacheSize=0  (continued)
      OBD_03_XIX_HCP5_CANFD01_f1281889_Rx (ComIPdu):
        ComIPduDirection = RECEIVE
        ComIPduType = NORMAL
        ComIPduHandleId = 30
        ComIPduSignalProcessing = DEFERRED
        ComIPduCancellationSupport = false
        ComIPduGroupRef = BMC_HV_XIX_HCP5_CANFD01_Rx_6dfafc5f
        ComIPduGroupRef = BMC_HV_XIX_PNC_10_Powertrain_Rx_c7039922
        ComIPduSignalRef = OBD_Abs_Pedal_Pos_XIX_OBD_03_XIX_HCP5_CANFD01_ce8f11ec_Rx
        ComIPduSignalRef = OBD_Aussen_Temp_gef_XIX_OBD_03_XIX_HCP5_CANFD01_4d95c3af_Rx
        ComIPduSignalRef = OBD_Driving_Cycle_XIX_OBD_03_XIX_HCP5_CANFD01_88844414_Rx
        ComIPduSignalRef = OBD_Eng_Cool_Temp_XIX_OBD_03_XIX_HCP5_CANFD01_d0429a53_Rx
        ComIPduSignalRef = OBD_Minimum_Trip_XIX_OBD_03_XIX_HCP5_CANFD01_1da08ec9_Rx
        ComIPduSignalRef = OBD_Normed_Trip_XIX_OBD_03_XIX_HCP5_CANFD01_aff42920_Rx
        ComIPduSignalRef = OBD_Warm_Up_Cycle_XIX_OBD_03_XIX_HCP5_CANFD01_eb6d4da0_Rx
        ComPduIdRef = OBD_03_XIX_HCP5_CANFD01_f1281889_Rx
        ComIPduMainFunctionRef = ComMainFunctionRx
      8 x ComSignal, all with ComSignalEndianness=LITTLE_ENDIAN, ComSignalAccess=ACCESS_UNCLEAR:
        UI1_KompFehlerModus4_06_XIX_UI1_Komponentenfehler_02_XIX_BMC_CAN01_5f7b29e7_Rx: ComBitPosition=27, ComBitSize=3, ComSignalInitValue=0, ComSignalType=UINT8, ComTimeout=1, ComHandleId=382, ComSystemTemplateSystemSignalRef=UI1_KompFehlerModus4_06
        BMC_CMC_Zellspannung_046_XIX_BMC_CMC_Zellspannung_02_XIX_HCP5_CANFD01_8e83fa35_Tx: ComBitPosition=84, ComBitSize=12, ComSignalDataInvalidValue=4095, ComSignalInitValue=4094, ComSignalType=UINT16, ComTransferProperty=PENDING, ComHandleId=157, ComSystemTemplateSystemSignalRef=BMC_CMC_Zellspannung_046
        UI2_KompFehlerModus2_04_XIX_UI2_Komponentenfehler_01_XIX_BMC_CAN01_98ff0545_Rx: ComBitPosition=18, ComBitSize=2, ComSignalInitValue=0, ComSignalType=UINT8, ComTimeout=1, ComHandleId=448, ComSystemTemplateSystemSignalRef=UI2_KompFehlerModus2_04
        BMC_CMC_Zellspannung_117_XIX_BMC_CMC_Zellspannung_03_XIX_HCP5_CANFD01_34451b2b_Tx: ComBitPosition=468, ComBitSize=12, ComSignalDataInvalidValue=4095, ComSignalInitValue=4094, ComSignalType=UINT16, ComTransferProperty=PENDING, ComHandleId=228, ComSystemTemplateSystemSignalRef=BMC_CMC_Zellspannung_117
        DCDC_NV_CALID_Index_14_XIX_DCDC_NV_CALID_XIX_HCP5_CANFD01_a2877f9f_Rx: ComBitPosition=104, ComBitSize=8, ComSignalInitValue=63, ComSignalType=UINT8, ComTimeout=5, ComHandleId=38, ComSystemTemplateSystemSignalRef=DCDC_NV_CALID_Index_14
        KN_Hybrid_01_ECUKnockOut_XIX_KN_Hybrid_01_XIX_HCP5_CANFD01_dd88c4a5_Tx: ComBitPosition=18, ComBitSize=2, ComSignalInitValue=0, ComSignalType=UINT8, ComTransferProperty=PENDING, ComHandleId=411, ComSystemTemplateSystemSignalRef=KN_Hybrid_01_ECUKnockOut
        BMC_RtmWarnBattUnautorisiert_XIX_BMC_HV_08_XIX_HCP5_CANFD01_afa1cdce_Tx: ComBitPosition=320, ComBitSize=3, ComSignalInitValue=0, ComSignalType=UINT8, ComTransferProperty=PENDING, ComHandleId=363, ComSystemTemplateSystemSignalRef=BMC_RtmWarnBattUnautorisiert
        DCDC_NV_Komponentenfehler_18_XIX_DCDC_NV_Komponentenfehler_01_XIX_HCP5_CANFD01_90e8c492_Rx: ComBitPosition=34, ComBitSize=2, ComSignalInitValue=0, ComSignalType=UINT8, ComTimeout=5, ComHandleId=79, ComSystemTemplateSystemSignalRef=DCDC_NV_Komponentenfehler_18
      BMC_HV_XIX_PNC_30_EnergyManagement_Rx_a9680a43 (ComIPduGroup): ComIPduGroupHandleId=15
      21 x ComSignal, all with ComSignalEndianness=LITTLE_ENDIAN, ComSignalAccess=ACCESS_UNCLEAR:
        HVLM_BidiLadeModus_XIX_HVLM_13_XIX_HCP5_CANFD01_0594f11a_Rx: ComBitPosition=224, ComBitSize=2, ComSignalInitValue=0, ComSignalType=UINT8, ComTimeout=1, ComHandleId=154, ComSystemTemplateSystemSignalRef=HVLM_BidiLadeModus
        BMC_RtmWarnSocHoch_XIX_BMC_HV_08_XIX_HCP5_CANFD01_3e921985_Tx: ComBitPosition=31, ComBitSize=3, ComSignalInitValue=0, ComSignalType=UINT8, ComTransferProperty=PENDING, ComHandleId=366, ComSystemTemplateSystemSignalRef=BMC_RtmWarnSocHoch
        UI2Sens01_CALID_Index_08_XIX_UI2Sens01_CALID_01_XIX_BMC_CAN01_4a23b89a_Rx: ComBitPosition=56, ComBitSize=8, ComSignalInitValue=63, ComSignalType=UINT8, ComTimeout=5, ComHandleId=408, ComSystemTemplateSystemSignalRef=UI2Sens01_CALID_Index_08
        BMC_CMC_Zellspannung_023_XIX_BMC_CMC_Zellspannung_01_XIX_HCP5_CANFD01_93fce9d6_Tx: ComBitPosition=276, ComBitSize=12, ComSignalDataInvalidValue=4095, ComSignalInitValue=4094, ComSignalType=UINT16, ComTransferProperty=PENDING, ComHandleId=134, ComSystemTemplateSystemSignalRef=BMC_CMC_Zellspannung_023
        DCDC_NV_Komponentenfehler_VLD_XIX_DCDC_NV_Komponentenfehler_01_XIX_HCP5_CANFD01_edf78d03_Rx: ComBitPosition=63, ComBitSize=1, ComSignalInitValue=0, ComSignalType=UINT8, ComTimeout=5, ComHandleId=142, ComSystemTemplateSystemSignalRef=DCDC_NV_Komponentenfehler_VLD
        BMC_CMC_Zellspannung_149_XIX_BMC_CMC_Zellspannung_04_XIX_HCP5_CANFD01_51edbece_Tx: ComBitPosition=384, ComBitSize=12, ComSignalDataInvalidValue=4095, ComSignalInitValue=4094, ComSignalType=UINT16, ComTransferProperty=PENDING, ComHandleId=260, ComSystemTemplateSystemSignalRef=BMC_CMC_Zellspannung_149
        NM_Hybrid_01_Lokalaktiv_XIX_KN_Hybrid_01_XIX_HCP5_CANFD01_905d7818_Tx: ComBitPosition=21, ComBitSize=1, ComSignalInitValue=0, ComSignalType=UINT8, ComTransferProperty=PENDING, ComHandleId=415, ComSystemTemplateSystemSignalRef=NM_Hybrid_01_Lokalaktiv
        UI1_Iso_Status_XIX_UI1_05_XIX_BMC_CAN01_a67d930e_Rx: ComBitPosition=29, ComBitSize=3, ComSignalDataInvalidValue=1, ComSignalInitValue=0, ComSignalType=UINT8, ComTimeout=1, ComHandleId=350, ComSystemTemplateSystemSignalRef=UI1_Iso_Status
        VIN_4_XIX_WFS_02_XIX_HCP5_CANFD01_4e583561_Rx: ComBitPosition=40, ComBitSize=8, ComSignalInitValue=45, ComSignalType=UINT8, ComTimeout=4, ComHandleId=496, ComSystemTemplateSystemSignalRef=VIN_4
        UI2Sens02_CALID_Index_08_XIX_UI2Sens02_CALID_01_XIX_BMC_CAN01_9154c171_Rx: ComBitPosition=56, ComBitSize=8, ComSignalInitValue=63, ComSignalType=UINT8, ComTimeout=5, ComHandleId=430, ComSystemTemplateSystemSignalRef=UI2Sens02_CALID_Index_08
        BMC_RtmWarnUPackMax_XIX_BMC_HV_08_XIX_HCP5_CANFD01_d9381a91_Tx: ComBitPosition=49, ComBitSize=3, ComSignalInitValue=0, ComSignalType=UINT8, ComTransferProperty=PENDING, ComHandleId=372, ComSystemTemplateSystemSignalRef=BMC_RtmWarnUPackMax
        DCDC_NV_Komponentenfehler_45_XIX_DCDC_NV_Komponentenfehler_02_XIX_HCP5_CANFD01_dc85a108_Rx: ComBitPosition=30, ComBitSize=2, ComSignalInitValue=0, ComSignalType=UINT8, ComTimeout=5, ComHandleId=106, ComSystemTemplateSystemSignalRef=DCDC_NV_Komponentenfehler_45
        BJB_CVN_Byte_3_XIX_BJB_CVN_01_XIX_BMC_CAN01_6044ab27_Rx: ComBitPosition=17, ComBitSize=8, ComSignalInitValue=0, ComSignalType=UINT8, ComTimeout=5, ComHandleId=19, ComSystemTemplateSystemSignalRef=BJB_CVN_Byte_3
        DCDC_NV_Komponentenfehler_47_XIX_DCDC_NV_Komponentenfehler_02_XIX_HCP5_CANFD01_9389406f_Rx: ComBitPosition=34, ComBitSize=2, ComSignalInitValue=0, ComSignalType=UINT8, ComTimeout=5, ComHandleId=108, ComSystemTemplateSystemSignalRef=DCDC_NV_Komponentenfehler_47
        BMC_Bidi_Veto_Temp_XIX_BMC_HV_03_XIX_HCP5_CANFD01_1db44959_Tx: ComBitPosition=184, ComBitSize=1, ComSignalInitValue=0, ComSignalType=UINT8, ComTransferProperty=PENDING, ComHandleId=7, ComSystemTemplateSystemSignalRef=BMC_Bidi_Veto_Temp
        BMC_Max_Entladestrom_02_XIX_BMC_HV_09_XIX_HCP5_CANFD01_af177205_Tx: ComBitPosition=12, ComBitSize=14, ComSignalDataInvalidValue=16383, ComSignalInitValue=16382, ComSignalType=UINT16, ComTransferProperty=PENDING, ComHandleId=324, ComSystemTemplateSystemSignalRef=BMC_Max_Entladestrom_02
        NM_Hybrid_01_NM_aktiv_KL15_XIX_NM_Hybrid_01_XIX_HCP5_CANFD01_d7280503_Tx: ComBitPosition=152, ComBitSize=1, ComSignalInitValue=0, ComSignalType=UINT8, ComTransferProperty=TRIGGERED, ComHandleId=421, ComSystemTemplateSystemSignalRef=NM_Hybrid_01_NM_aktiv_KL15
        BMC_CMC_Temperatur_073_XIX_BMC_CMC_Temperatur_03_XIX_HCP5_CANFD01_94d18d63_Tx: ComBitPosition=16, ComBitSize=8, ComSignalDataInvalidValue=255, ComSignalInitValue=254, ComSignalType=UINT8, ComTransferProperty=PENDING, ComHandleId=83, ComSystemTemplateSystemSignalRef=BMC_CMC_Temperatur_073
        BMC_CMC_Zellspannung_181_XIX_BMC_CMC_Zellspannung_05_XIX_HCP5_CANFD01_75aea44a_Tx: ComBitPosition=300, ComBitSize=12, ComSignalDataInvalidValue=4095, ComSignalInitValue=4094, ComSignalType=UINT16, ComTransferProperty=PENDING, ComHandleId=292, ComSystemTemplateSystemSignalRef=BMC_CMC_Zellspannung_181
        BMC_CMC_Temperatur_091_XIX_BMC_CMC_Temperatur_03_XIX_HCP5_CANFD01_a3f1512a_Tx: ComBitPosition=160, ComBitSize=8, ComSignalDataInvalidValue=255, ComSignalInitValue=254, ComSignalType=UINT8, ComTransferProperty=PENDING, ComHandleId=101, ComSystemTemplateSystemSignalRef=BMC_CMC_Temperatur_091
        BMC_CMC_Zellspannung_122_XIX_BMC_CMC_Zellspannung_04_XIX_HCP5_CANFD01_357eff7e_Tx: ComBitPosition=60, ComBitSize=12, ComSignalDataInvalidValue=4095, ComSignalInitValue=4094, ComSignalType=UINT16, ComTransferProperty=PENDING, ComHandleId=233, ComSystemTemplateSystemSignalRef=BMC_CMC_Zellspannung_122
      BMC_HV_XIX_PNC_02_Basefunction_Powertrain_Rx_dc518468 (ComIPduGroup): ComIPduGroupHandleId=5
      7 x ComSignal, all with ComSignalEndianness=LITTLE_ENDIAN, ComSignalAccess=ACCESS_UNCLEAR:
        BMC_CMC_Temperatur_024_XIX_BMC_CMC_Temperatur_01_XIX_HCP5_CANFD01_0780cc71_Tx: ComBitPosition=200, ComBitSize=8, ComSignalDataInvalidValue=255, ComSignalInitValue=254, ComSignalType=UINT8, ComTransferProperty=PENDING, ComHandleId=34, ComSystemTemplateSystemSignalRef=BMC_CMC_Temperatur_024
        DCDC_NV_Komponentenfehler_60_XIX_DCDC_NV_Komponentenfehler_02_XIX_HCP5_CANFD01_5b3b684f_Rx: ComBitPosition=60, ComBitSize=2, ComSignalInitValue=0, ComSignalType=UINT8, ComTimeout=5, ComHandleId=121, ComSystemTemplateSystemSignalRef=DCDC_NV_Komponentenfehler_60
        DS_Hybrid_01_TestFailedChanged_XIX_DS_Hybrid_01_XIX_HCP5_CANFD01_f799e5e7_Tx: ComBitPosition=16, ComBitSize=1, ComSignalInitValue=0, ComSignalType=UINT8, ComTransferProperty=TRIGGERED_ON_CHANGE_WITHOUT_REPETITION, ComHandleId=399, ComSystemTemplateSystemSignalRef=DS_Hybrid_01_TestFailedChanged
        BMC_CMC_Zellspannung_032_XIX_BMC_CMC_Zellspannung_01_XIX_HCP5_CANFD01_854c7920_Tx: ComBitPosition=384, ComBitSize=12, ComSignalDataInvalidValue=4095, ComSignalInitValue=4094, ComSignalType=UINT16, ComTransferProperty=PENDING, ComHandleId=143, ComSystemTemplateSystemSignalRef=BMC_CMC_Zellspannung_032
        DCDC_NV_Komponentenfehler_3_2_XIX_DCDC_NV_Komponentenfehler_04_XIX_HCP5_CANFD01_c87024d0_Rx: ComBitPosition=3, ComBitSize=3, ComSignalInitValue=0, ComSignalType=UINT8, ComTimeout=5, ComHandleId=47, ComSystemTemplateSystemSignalRef=DCDC_NV_Komponentenfehler_3_2
        UI2_KompFehlerModus2_05_XIX_UI2_Komponentenfehler_01_XIX_BMC_CAN01_b2d73d27_Rx: ComBitPosition=20, ComBitSize=2, ComSignalInitValue=0, ComSignalType=UINT8, ComTimeout=1, ComHandleId=449, ComSystemTemplateSystemSignalRef=UI2_KompFehlerModus2_05
        VIN_1_XIX_WFS_02_XIX_HCP5_CANFD01_7a318e94_Rx: ComBitPosition=16, ComBitSize=8, ComSignalInitValue=45, ComSignalType=UINT8, ComTimeout=4, ComHandleId=493, ComSystemTemplateSystemSignalRef=VIN_1
      SOK_Zeit_Hybrid_01_Resp_01_XIX_HCP5_CANFD01_c7a98a10_Rx (ComIPdu):
        ComIPduDirection = RECEIVE
        ComIPduType = NORMAL
        ComIPduHandleId = 40
        ComIPduSignalProcessing = DEFERRED
        ComIPduCancellationSupport = false
        ComIPduGroupRef = BMC_HV_XIX_HCP5_CANFD01_Rx_6dfafc5f
        ComIPduSignalRef = SOK_Zeit_Hybrid_01_Zeit_XIX_SOK_Zeit_Hybrid_01_Resp_01_XIX_HCP5_CANFD01_41d20ae9_Rx
        ComPduIdRef = SOK_Zeit_Hybrid_01_Resp_01_XIX_HCP5_CANFD01_c7a98a10_Rx
        ComIPduMainFunctionRef = ComMainFunctionRx
      VDSO_Vx3d_XIX_VDSO_05_XIX_HCP5_CANFD01_16f2eb37_Rx (ComSignal):
        ComBitPosition = 12
        ComBitSize = 16
        ComSignalDataInvalidValue = 65535
        ComSignalEndianness = LITTLE_ENDIAN
        ComSignalInitValue = 65534
        ComSignalType = UINT16
        ComTimeout = 0.5
        ComSignalAccess = ACCESS_UNCLEAR
        ComHandleId = 492
        ComSystemTemplateSystemSignalRef = VDSO_Vx3d
      BMC_HV_XIX_PNC_01_CarWakeUp_Tx_29969a84 (ComIPduGroup): ComIPduGroupHandleId=4
      3 x ComSignal, all with ComSignalEndianness=LITTLE_ENDIAN, ComSignalType=UINT8, ComSignalAccess=ACCESS_UNCLEAR:
        BMC_CMC_Temperatur_032_XIX_BMC_CMC_Temperatur_01_XIX_HCP5_CANFD01_58e67571_Tx: ComBitPosition=264, ComBitSize=8, ComSignalDataInvalidValue=255, ComSignalInitValue=254, ComTransferProperty=PENDING, ComHandleId=42, ComSystemTemplateSystemSignalRef=BMC_CMC_Temperatur_032
        SI_NWDF_XIX_Systeminfo_01_XIX_HCP5_CANFD01_5ddebbee_Rx: ComBitPosition=10, ComBitSize=1, ComSignalInitValue=0, ComTimeout=5, ComHandleId=334, ComSystemTemplateSystemSignalRef=SI_NWDF
        UI2_KompFehlerModus2_17_XIX_UI2_Komponentenfehler_01_XIX_BMC_CAN01_451165af_Rx: ComBitPosition=44, ComBitSize=2, ComSignalInitValue=0, ComTimeout=1, ComHandleId=461, ComSystemTemplateSystemSignalRef=UI2_KompFehlerModus2_17
      UI2_Komponentenfehler_02_XIX_BMC_CAN01_7d1b0ef0_Rx (ComIPdu):
        ComIPduDirection = RECEIVE
        ComIPduType = NORMAL
        ComIPduHandleId = 61
        ComIPduSignalProcessing = DEFERRED
        ComIPduCancellationSupport = false
        ComIPduGroupRef = BMC_HV_XIX_BMC_CAN01_Rx_7b388810
        ComIPduSignalRef = UI2_KompFehlerModus4_01_XIX_UI2_Komponentenfehler_02_XIX_BMC_CAN01_a76d8bc9_Rx
        ComIPduSignalRef = UI2_KompFehlerModus4_02_XIX_UI2_Komponentenfehler_02_XIX_BMC_CAN01_d915c36f_Rx
        ComIPduSignalRef = UI2_KompFehlerModus4_03_XIX_UI2_Komponentenfehler_02_XIX_BMC_CAN01_f33dfb0d_Rx
        ComIPduSignalRef = UI2_KompFehlerModus4_04_XIX_UI2_Komponentenfehler_02_XIX_BMC_CAN01_25e55223_Rx
        ComIPduSignalRef = UI2_KompFehlerModus4_05_XIX_UI2_Komponentenfehler_02_XIX_BMC_CAN01_0fcd6a41_Rx
        ComIPduSignalRef = UI2_KompFehlerModus4_06_XIX_UI2_Komponentenfehler_02_XIX_BMC_CAN01_71b522e7_Rx
        ComIPduSignalRef = UI2_KompFehlerModus4_07_XIX_UI2_Komponentenfehler_02_XIX_BMC_CAN01_5b9d1a85_Rx
        ComIPduSignalRef = UI2_KompFehlerModus4_08_XIX_UI2_Komponentenfehler_02_XIX_BMC_CAN01_077576fa_Rx
        ComIPduSignalRef = UI2_KompFehlerModus4_09_XIX_UI2_Komponentenfehler_02_XIX_BMC_CAN01_2d5d4e98_Rx
        ComIPduSignalRef = UI2_KompFehlerModus4_10_XIX_UI2_Komponentenfehler_02_XIX_BMC_CAN01_2ed39be7_Rx
        ComIPduSignalRef = UI2_KompFehlerModus4_11_XIX_UI2_Komponentenfehler_02_XIX_BMC_CAN01_04fba385_Rx
        ComIPduSignalRef = UI2_KompFehlerModus4_12_XIX_UI2_Komponentenfehler_02_XIX_BMC_CAN01_7a83eb23_Rx
        ComIPduSignalRef = UI2_KompFehlerModus4_13_XIX_UI2_Komponentenfehler_02_XIX_BMC_CAN01_50abd341_Rx
        ComIPduSignalRef = UI2_KompFehlerModus4_14_XIX_UI2_Komponentenfehler_02_XIX_BMC_CAN01_86737a6f_Rx
        ComIPduSignalRef = UI2_KompFehlerModus4_15_XIX_UI2_Komponentenfehler_02_XIX_BMC_CAN01_ac5b420d_Rx
        ComIPduSignalRef = UI2_KompFehlerModus4_16_XIX_UI2_Komponentenfehler_02_XIX_BMC_CAN01_d2230aab_Rx
        ComPduIdRef = UI2_Komponentenfehler_02_XIX_BMC_CAN01_7d1b0ef0_Rx
        ComIPduMainFunctionRef = ComMainFunctionRx
      10 x ComSignal, all with ComSignalEndianness=LITTLE_ENDIAN, ComSignalAccess=ACCESS_UNCLEAR:
        UI1_Spannung5_XIX_UI1_03_XIX_BMC_CAN01_c2ef475d_Rx: ComBitPosition=27, ComBitSize=15, ComSignalDataInvalidValue=32767, ComSignalInitValue=32766, ComSignalType=UINT16, ComTimeout=0.5, ComHandleId=394, ComSystemTemplateSystemSignalRef=UI1_Spannung5
        UI2Sens01_CALID_Index_01_XIX_UI2Sens01_CALID_01_XIX_BMC_CAN01_70cabfee_Rx: ComBitPosition=0, ComBitSize=8, ComSignalInitValue=63, ComSignalType=UINT8, ComTimeout=5, ComHandleId=401, ComSystemTemplateSystemSignalRef=UI2Sens01_CALID_Index_01
        BMC_Dauer_Ladeleistung_XIX_BMC_HV_03_XIX_HCP5_CANFD01_680da831_Tx: ComBitPosition=80, ComBitSize=12, ComSignalDataInvalidValue=4095, ComSignalInitValue=4094, ComSignalType=UINT16, ComTransferProperty=PENDING, ComHandleId=307, ComSystemTemplateSystemSignalRef=BMC_Dauer_Ladeleistung
        BMC_CMC_Zellspannung_131_XIX_BMC_CMC_Zellspannung_04_XIX_HCP5_CANFD01_dc5d58ae_Tx: ComBitPosition=168, ComBitSize=12, ComSignalDataInvalidValue=4095, ComSignalInitValue=4094, ComSignalType=UINT16, ComTransferProperty=PENDING, ComHandleId=242, ComSystemTemplateSystemSignalRef=BMC_CMC_Zellspannung_131
        BMC_IstZellSpannungMin_Zell_ID_XIX_BMC_HV_08_XIX_HCP5_CANFD01_3e586fb0_Tx: ComBitPosition=304, ComBitSize=8, ComSignalInitValue=255, ComSignalType=UINT8, ComTransferProperty=PENDING, ComHandleId=319, ComSystemTemplateSystemSignalRef=BMC_IstZellSpannungMin_Zell_ID
        UI1_KompFehlerModus2_05_XIX_UI1_Komponentenfehler_01_XIX_BMC_CAN01_9c193627_Rx: ComBitPosition=20, ComBitSize=2, ComSignalInitValue=0, ComSignalType=UINT8, ComTimeout=1, ComHandleId=355, ComSystemTemplateSystemSignalRef=UI1_KompFehlerModus2_05
        BMC_CMC_Temperatur_086_XIX_BMC_CMC_Temperatur_03_XIX_HCP5_CANFD01_d6bfd048_Tx: ComBitPosition=120, ComBitSize=8, ComSignalDataInvalidValue=255, ComSignalInitValue=254, ComSignalType=UINT8, ComTransferProperty=PENDING, ComHandleId=96, ComSystemTemplateSystemSignalRef=BMC_CMC_Temperatur_086
        BMC_CMC_Zellspannung_160_XIX_BMC_CMC_Zellspannung_05_XIX_HCP5_CANFD01_5b2a556c_Tx: ComBitPosition=48, ComBitSize=12, ComSignalDataInvalidValue=4095, ComSignalInitValue=4094, ComSignalType=UINT16, ComTransferProperty=PENDING, ComHandleId=271, ComSystemTemplateSystemSignalRef=BMC_CMC_Zellspannung_160
        OBD_Aussen_Temp_gef_XIX_OBD_03_XIX_HCP5_CANFD01_4d95c3af_Rx: ComBitPosition=52, ComBitSize=8, ComSignalDataInvalidValue=255, ComSignalInitValue=254, ComSignalType=UINT8, ComTimeout=3.2, ComHandleId=160, ComSystemTemplateSystemSignalRef=OBD_Aussen_Temp_gef
        DCDC_NV_Komponentenfehler_55_XIX_DCDC_NV_Komponentenfehler_02_XIX_HCP5_CANFD01_b5495d05_Rx: ComBitPosition=50, ComBitSize=2, ComSignalInitValue=0, ComSignalType=UINT8, ComTimeout=5, ComHandleId=116, ComSystemTemplateSystemSignalRef=DCDC_NV_Komponentenfehler_55
      SG_UI1_01_XIX_BMC_CAN01_cd9e369a_Rx (ComSignalGroup):
        ComTransferProperty = TRIGGERED_WITHOUT_REPETITION
        ComSignalGroupAccess = ACCESS_UNCLEAR
        ComHandleId = 11
        ComSystemTemplateSignalGroupRef = SG_UI1_01_XIX_BMC_CAN01
        7 x ComGroupSignal, all with ComSignalEndianness=LITTLE_ENDIAN, ComSignalAccess=ACCESS_UNCLEAR:
          ISignalVoid_UI1_01_XIX_BMC_CAN01_1_1e9afe7b_Rx: ComBitPosition=48, ComBitSize=8, ComSignalType=UINT8, ComSignalInitValue=0, ComHandleId=296, ComSystemTemplateSystemSignalRef=SignalVoid_UI1_01_1
          UI1_KL30_Spannung_XIX_UI1_01_XIX_BMC_CAN01_3200e10f_Rx: ComBitPosition=32, ComBitSize=8, ComSignalDataInvalidValue=255, ComSignalInitValue=254, ComSignalType=UINT8, ComHandleId=298, ComSystemTemplateSystemSignalRef=UI1_KL30_Spannung
          UISensorIso_01_CRC_XIX_UI1_01_XIX_BMC_CAN01_8bd876b3_Rx: ComBitPosition=0, ComBitSize=8, ComSignalInitValue=0, ComSignalType=UINT8, ComHandleId=301, ComSystemTemplateSystemSignalRef=UISensorIso_01_CRC
          UI1_Strom_XIX_UI1_01_XIX_BMC_CAN01_3ab480fa_Rx: ComBitPosition=12, ComBitSize=20, ComSignalDataInvalidValue=1048575, ComSignalInitValue=1048574, ComSignalType=UINT32, ComHandleId=299, ComSystemTemplateSystemSignalRef=UI1_Strom
          ISignalVoid_UI1_01_XIX_BMC_CAN01_2_8793afc1_Rx: ComBitPosition=56, ComBitSize=8, ComSignalType=UINT8, ComSignalInitValue=0, ComHandleId=297, ComSystemTemplateSystemSignalRef=SignalVoid_UI1_01_2
          UISensorIso_01_BZ_XIX_UI1_01_XIX_BMC_CAN01_a5e1df82_Rx: ComBitPosition=8, ComBitSize=4, ComSignalInitValue=0, ComSignalType=UINT8, ComHandleId=300, ComSystemTemplateSystemSignalRef=UISensorIso_01_BZ
          ISignalVoid_UI1_01_XIX_BMC_CAN01_0_699dceed_Rx: ComBitPosition=40, ComBitSize=8, ComSignalType=UINT8, ComSignalInitValue=0, ComHandleId=295, ComSystemTemplateSystemSignalRef=SignalVoid_UI1_01_0
      8 x ComSignal, all with ComSignalAccess=ACCESS_UNCLEAR:
        VIN_5_XIX_WFS_02_XIX_HCP5_CANFD01_2d5fec45_Rx: ComBitPosition=48, ComBitSize=8, ComSignalEndianness=LITTLE_ENDIAN, ComSignalInitValue=45, ComSignalType=UINT8, ComTimeout=4, ComHandleId=497, ComSystemTemplateSystemSignalRef=VIN_5
        BMC_UBE_Indikator_XIX_BMC_HV_14_XIX_HCP5_CANFD01_be7dd75f_Tx: ComBitPosition=12, ComBitSize=11, ComSignalDataInvalidValue=2047, ComSignalEndianness=LITTLE_ENDIAN, ComSignalInitValue=2046, ComSignalType=UINT16, ComTransferProperty=PENDING, ComHandleId=385, ComSystemTemplateSystemSignalRef=BMC_UBE_Indikator
        NM_aktiv_SubbusSteuerung_BMC_HV_XIX_NM_Hybrid_01_XIX_HCP5_CANFD01_276a97d5_Tx: ComBitPosition=156, ComBitSize=1, ComSignalEndianness=LITTLE_ENDIAN, ComSignalInitValue=0, ComSignalType=UINT8, ComTransferProperty=TRIGGERED, ComHandleId=431, ComSystemTemplateSystemSignalRef=NM_aktiv_SubbusSteuerung_BMC_HV
        DCDC_NV_Komponentenfehler_62_XIX_DCDC_NV_Komponentenfehler_03_XIX_HCP5_CANFD01_fb653fc9_Rx: ComBitPosition=2, ComBitSize=2, ComSignalEndianness=LITTLE_ENDIAN, ComSignalInitValue=0, ComSignalType=UINT8, ComTimeout=5, ComHandleId=123, ComSystemTemplateSystemSignalRef=DCDC_NV_Komponentenfehler_62
        BMC_CMC_Temperatur_036_XIX_BMC_CMC_Temperatur_01_XIX_HCP5_CANFD01_f04694f9_Tx: ComBitPosition=296, ComBitSize=8, ComSignalDataInvalidValue=255, ComSignalEndianness=LITTLE_ENDIAN, ComSignalInitValue=254, ComSignalType=UINT8, ComTransferProperty=PENDING, ComHandleId=46, ComSystemTemplateSystemSignalRef=BMC_CMC_Temperatur_036
        BMC_CMC_Temperatur_012_XIX_BMC_CMC_Temperatur_01_XIX_HCP5_CANFD01_c4bb23a8_Tx: ComBitPosition=104, ComBitSize=8, ComSignalDataInvalidValue=255, ComSignalEndianness=LITTLE_ENDIAN, ComSignalInitValue=254, ComSignalType=UINT8, ComTransferProperty=PENDING, ComHandleId=22, ComSystemTemplateSystemSignalRef=BMC_CMC_Temperatur_012
        SOK_Zeit_Hybrid_01_Challenge_XIX_SOK_Zeit_Hybrid_01_Chal_01_XIX_HCP5_CANFD01_13ac3f94_Tx: ComBitPosition=0, ComSignalEndianness=opaque, ComSignalLength=8, ComSignalType=UINT8_N, ComTransferProperty=TRIGGERED_ON_CHANGE_WITHOUT_REPETITION, ComSignalInitValue=0 0 0 0 0 0 0 0, ComHandleId=557, ComSystemTemplateSystemSignalRef=SOK_Zeit_Hybrid_01_Challenge
        BMC_CMC_Temperatur_085_XIX_BMC_CMC_Temperatur_03_XIX_HCP5_CANFD01_a8c798ee_Tx: ComBitPosition=112, ComBitSize=8, ComSignalDataInvalidValue=255, ComSignalEndianness=LITTLE_ENDIAN, ComSignalInitValue=254, ComSignalType=UINT8, ComTransferProperty=PENDING, ComHandleId=95, ComSystemTemplateSystemSignalRef=BMC_CMC_Temperatur_085
      SG_KS_Hybrid_01_ReqFrame_XIX_HCP5_CANFD01_619e85fb_Tx (ComSignalGroup):
        ComTimeout = 0
        ComTransferProperty = TRIGGERED_WITHOUT_REPETITION
        ComSignalGroupAccess = ACCESS_UNCLEAR
        ComHandleId = 8
        ComSystemTemplateSignalGroupRef = SG_KS_Hybrid_01_ReqFrame_XIX_HCP5_CANFD01
        8 x ComGroupSignal, all with ComSignalEndianness=LITTLE_ENDIAN, ComSignalInitValue=0, ComSignalAccess=ACCESS_UNCLEAR, ComTransferProperty=PENDING:
          KS_Hybrid_01_Req_SID_XIX_KS_Hybrid_01_ReqFrame_XIX_HCP5_CANFD01_1bcd362d_Tx: ComBitPosition=0, ComBitSize=16, ComSignalType=UINT16, ComHandleId=549, ComSystemTemplateSystemSignalRef=KS_Hybrid_01_Req_SID
          KS_Hybrid_01_Req_SWPat_XIX_KS_Hybrid_01_ReqFrame_XIX_HCP5_CANFD01_c36d1962_Tx: ComBitPosition=48, ComBitSize=8, ComSignalType=UINT8, ComHandleId=552, ComSystemTemplateSystemSignalRef=KS_Hybrid_01_Req_SWPat
          KS_Hybrid_01_Req_IKA_Retry_XIX_KS_Hybrid_01_ReqFrame_XIX_HCP5_CANFD01_9cc0e520_Tx: ComBitPosition=18, ComBitSize=1, ComSignalType=UINT8, ComHandleId=547, ComSystemTemplateSystemSignalRef=KS_Hybrid_01_Req_IKA_Retry
          KS_Hybrid_01_Req_Prio_XIX_KS_Hybrid_01_ReqFrame_XIX_HCP5_CANFD01_10b8493f_Tx: ComBitPosition=16, ComBitSize=1, ComSignalType=UINT8, ComHandleId=548, ComSystemTemplateSystemSignalRef=KS_Hybrid_01_Req_Prio
          KS_Hybrid_01_Req_SWMaj_XIX_KS_Hybrid_01_ReqFrame_XIX_HCP5_CANFD01_f8d0422c_Tx: ComBitPosition=32, ComBitSize=8, ComSignalType=UINT8, ComHandleId=550, ComSystemTemplateSystemSignalRef=KS_Hybrid_01_Req_SWMaj
          KS_Hybrid_01_Req_SWMin_XIX_KS_Hybrid_01_ReqFrame_XIX_HCP5_CANFD01_4c96f203_Tx: ComBitPosition=40, ComBitSize=8, ComSignalType=UINT8, ComHandleId=551, ComSystemTemplateSystemSignalRef=KS_Hybrid_01_Req_SWMin
          KS_Hybrid_01_Req_ErrCtr_XIX_KS_Hybrid_01_ReqFrame_XIX_HCP5_CANFD01_8e83ec82_Tx: ComBitPosition=24, ComBitSize=8, ComSignalType=UINT8, ComHandleId=546, ComSystemTemplateSystemSignalRef=KS_Hybrid_01_Req_ErrCtr
          KS_Hybrid_01_Req_VKMS_Err_XIX_KS_Hybrid_01_ReqFrame_XIX_HCP5_CANFD01_43fd6332_Tx: ComBitPosition=17, ComBitSize=1, ComSignalType=UINT8, ComHandleId=553, ComSystemTemplateSystemSignalRef=KS_Hybrid_01_Req_VKMS_Err
      25 x ComSignal, all with ComSignalAccess=ACCESS_UNCLEAR:
        BMC_CMC_Zellspannung_135_XIX_BMC_CMC_Zellspannung_04_XIX_HCP5_CANFD01_f80a30a3_Tx: ComBitPosition=216, ComBitSize=12, ComSignalDataInvalidValue=4095, ComSignalEndianness=LITTLE_ENDIAN, ComSignalInitValue=4094, ComSignalType=UINT16, ComTransferProperty=PENDING, ComHandleId=246, ComSystemTemplateSystemSignalRef=BMC_CMC_Zellspannung_135
        BMC_CMC_Zellspannung_049_XIX_BMC_CMC_Zellspannung_02_XIX_HCP5_CANFD01_6220ee97_Tx: ComBitPosition=120, ComBitSize=12, ComSignalDataInvalidValue=4095, ComSignalEndianness=LITTLE_ENDIAN, ComSignalInitValue=4094, ComSignalType=UINT16, ComTransferProperty=PENDING, ComHandleId=160, ComSystemTemplateSystemSignalRef=BMC_CMC_Zellspannung_049
        DCDC_NV_Komponentenfehler_12_XIX_DCDC_NV_Komponentenfehler_01_XIX_HCP5_CANFD01_38a6a628_Rx: ComBitPosition=22, ComBitSize=2, ComSignalEndianness=LITTLE_ENDIAN, ComSignalInitValue=0, ComSignalType=UINT8, ComTimeout=5, ComHandleId=73, ComSystemTemplateSystemSignalRef=DCDC_NV_Komponentenfehler_12
        UI2Sens01_CALID_Index_12_XIX_UI2Sens01_CALID_02_XIX_BMC_CAN01_62d6de59_Rx: ComBitPosition=24, ComBitSize=8, ComSignalEndianness=LITTLE_ENDIAN, ComSignalInitValue=63, ComSignalType=UINT8, ComTimeout=5, ComHandleId=412, ComSystemTemplateSystemSignalRef=UI2Sens01_CALID_Index_12
        BMC_CMC_Zellspannung_056_XIX_BMC_CMC_Zellspannung_02_XIX_HCP5_CANFD01_e7faf150_Tx: ComBitPosition=204, ComBitSize=12, ComSignalDataInvalidValue=4095, ComSignalEndianness=LITTLE_ENDIAN, ComSignalInitValue=4094, ComSignalType=UINT16, ComTransferProperty=PENDING, ComHandleId=167, ComSystemTemplateSystemSignalRef=BMC_CMC_Zellspannung_056
        UI2Sens01_CVN_VLD_XIX_UI2Sens01_CVN_XIX_BMC_CAN01_56f8ef91_Rx: ComBitPosition=0, ComBitSize=1, ComSignalEndianness=LITTLE_ENDIAN, ComSignalInitValue=0, ComSignalType=UINT8, ComTimeout=5, ComHandleId=421, ComSystemTemplateSystemSignalRef=UI2Sens01_CVN_VLD
        UI2Sens01_CALID_Index_07_XIX_UI2Sens01_CALID_01_XIX_BMC_CAN01_eb1abf20_Rx: ComBitPosition=48, ComBitSize=8, ComSignalEndianness=LITTLE_ENDIAN, ComSignalInitValue=63, ComSignalType=UINT8, ComTimeout=5, ComHandleId=407, ComSystemTemplateSystemSignalRef=UI2Sens01_CALID_Index_07
        UI2_KompFehlerModus2_09_XIX_UI2_Komponentenfehler_01_XIX_BMC_CAN01_904719fe_Rx: ComBitPosition=28, ComBitSize=2, ComSignalEndianness=LITTLE_ENDIAN, ComSignalInitValue=0, ComSignalType=UINT8, ComTimeout=1, ComHandleId=453, ComSystemTemplateSystemSignalRef=UI2_KompFehlerModus2_09
        ComSignalPnc_EIRA_CAN_Rx: ComSignalLength=7, ComSignalType=UINT8_N, ComBitPosition=0, ComSignalEndianness=opaque, ComSignalInitValue=0 0 0 0 0 0 0, ComHandleId=24, ComNotification=ComM_ComCbk_ComSignalPnc_EIRA_CAN_Rx
        DCDC_NV_Komponentenfehler_32_XIX_DCDC_NV_Komponentenfehler_02_XIX_HCP5_CANFD01_01b98350_Rx: ComBitPosition=4, ComBitSize=2, ComSignalEndianness=LITTLE_ENDIAN, ComSignalInitValue=0, ComSignalType=UINT8, ComTimeout=5, ComHandleId=93, ComSystemTemplateSystemSignalRef=DCDC_NV_Komponentenfehler_32
        UI2_KompFehlerModus2_22_XIX_UI2_Komponentenfehler_01_XIX_BMC_CAN01_f852c2d0_Rx: ComBitPosition=54, ComBitSize=2, ComSignalEndianness=LITTLE_ENDIAN, ComSignalInitValue=0, ComSignalType=UINT8, ComTimeout=1, ComHandleId=466, ComSystemTemplateSystemSignalRef=UI2_KompFehlerModus2_22
        BMC_CMC_Zellspannung_185_XIX_BMC_CMC_Zellspannung_05_XIX_HCP5_CANFD01_51f9cc47_Tx: ComBitPosition=348, ComBitSize=12, ComSignalDataInvalidValue=4095, ComSignalEndianness=LITTLE_ENDIAN, ComSignalInitValue=4094, ComSignalType=UINT16, ComTransferProperty=PENDING, ComHandleId=296, ComSystemTemplateSystemSignalRef=BMC_CMC_Zellspannung_185
        UI1_Spannung6_XIX_UI1_03_XIX_BMC_CAN01_30b8aaa5_Rx: ComBitPosition=42, ComBitSize=15, ComSignalDataInvalidValue=32767, ComSignalEndianness=LITTLE_ENDIAN, ComSignalInitValue=32766, ComSignalType=UINT16, ComTimeout=0.5, ComHandleId=395, ComSystemTemplateSystemSignalRef=UI1_Spannung6
        BMC_Verbrauch_Ueberlauf_XIX_BMC_HV_05_XIX_HCP5_CANFD01_3d34bbf6_Tx: ComBitPosition=12, ComBitSize=1, ComSignalEndianness=LITTLE_ENDIAN, ComSignalInitValue=0, ComSignalType=UINT8, ComTransferProperty=PENDING, ComHandleId=386, ComSystemTemplateSystemSignalRef=BMC_Verbrauch_Ueberlauf
        DCDC_NV_Komponentenfehler_78_XIX_DCDC_NV_Komponentenfehler_03_XIX_HCP5_CANFD01_3ae7a17e_Rx: ComBitPosition=34, ComBitSize=2, ComSignalEndianness=LITTLE_ENDIAN, ComSignalInitValue=0, ComSignalType=UINT8, ComTimeout=5, ComHandleId=139, ComSystemTemplateSystemSignalRef=DCDC_NV_Komponentenfehler_78
        BJB_CALID_Index_07_XIX_BJB_CALID_01_XIX_BMC_CAN01_5da869c8_Rx: ComBitPosition=48, ComBitSize=8, ComSignalEndianness=LITTLE_ENDIAN, ComSignalInitValue=63, ComSignalType=UINT8, ComTimeout=5, ComHandleId=7, ComSystemTemplateSystemSignalRef=BJB_CALID_Index_07
        BMC_CMC_Zellspannung_121_XIX_BMC_CMC_Zellspannung_04_XIX_HCP5_CANFD01_b52453cb_Tx: ComBitPosition=48, ComBitSize=12, ComSignalDataInvalidValue=4095, ComSignalEndianness=LITTLE_ENDIAN, ComSignalInitValue=4094, ComSignalType=UINT16, ComTransferProperty=PENDING, ComHandleId=232, ComSystemTemplateSystemSignalRef=BMC_CMC_Zellspannung_121
        NM_aktiv_Konditionierungsbedarf_XIX_NMH_Hybrid_01_XIX_BMC_CAN01_514ad247_Tx: ComBitPosition=11, ComBitSize=1, ComSignalEndianness=LITTLE_ENDIAN, ComSignalInitValue=0, ComSignalType=UINT8, ComTransferProperty=TRIGGERED, ComHandleId=428, ComSystemTemplateSystemSignalRef=NM_aktiv_Konditionierungsbedarf
        BMC_CMC_Zellspannung_033_XIX_BMC_CMC_Zellspannung_01_XIX_HCP5_CANFD01_fa85e2b3_Tx: ComBitPosition=396, ComBitSize=12, ComSignalDataInvalidValue=4095, ComSignalEndianness=LITTLE_ENDIAN, ComSignalInitValue=4094, ComSignalType=UINT16, ComTransferProperty=PENDING, ComHandleId=144, ComSystemTemplateSystemSignalRef=BMC_CMC_Zellspannung_033
        BMC_CMC_Temperatur_039_XIX_BMC_CMC_Temperatur_01_XIX_HCP5_CANFD01_acaef886_Tx: ComBitPosition=320, ComBitSize=8, ComSignalDataInvalidValue=255, ComSignalEndianness=LITTLE_ENDIAN, ComSignalInitValue=254, ComSignalType=UINT8, ComTransferProperty=PENDING, ComHandleId=49, ComSystemTemplateSystemSignalRef=BMC_CMC_Temperatur_039
        UI2Sens01_CALID_Index_04_XIX_UI2Sens01_CALID_01_XIX_BMC_CAN01_a6f2bf47_Rx: ComBitPosition=24, ComBitSize=8, ComSignalEndianness=LITTLE_ENDIAN, ComSignalInitValue=63, ComSignalType=UINT8, ComTimeout=5, ComHandleId=404, ComSystemTemplateSystemSignalRef=UI2Sens01_CALID_Index_04
        BMC_CMC_Temperatur_011_XIX_BMC_CMC_Temperatur_01_XIX_HCP5_CANFD01_bac36b0e_Tx: ComBitPosition=96, ComBitSize=8, ComSignalDataInvalidValue=255, ComSignalEndianness=LITTLE_ENDIAN, ComSignalInitValue=254, ComSignalType=UINT8, ComTransferProperty=PENDING, ComHandleId=21, ComSystemTemplateSystemSignalRef=BMC_CMC_Temperatur_011
        BMC_CMC_Zellspannung_174_XIX_BMC_CMC_Zellspannung_05_XIX_HCP5_CANFD01_16043604_Tx: ComBitPosition=216, ComBitSize=12, ComSignalDataInvalidValue=4095, ComSignalEndianness=LITTLE_ENDIAN, ComSignalInitValue=4094, ComSignalType=UINT16, ComTransferProperty=PENDING, ComHandleId=285, ComSystemTemplateSystemSignalRef=BMC_CMC_Zellspannung_174
        DCDC_NV_CALID_Index_01_XIX_DCDC_NV_CALID_XIX_HCP5_CANFD01_8f57e482_Rx: ComBitPosition=0, ComBitSize=8, ComSignalEndianness=LITTLE_ENDIAN, ComSignalInitValue=63, ComSignalType=UINT8, ComTimeout=5, ComHandleId=25, ComSystemTemplateSystemSignalRef=DCDC_NV_CALID_Index_01
        BMC_EnergieVorhalt_XIX_BMC_HV_14_XIX_HCP5_CANFD01_33ff2903_Tx: ComBitPosition=54, ComBitSize=16, ComSignalDataInvalidValue=65535, ComSignalEndianness=LITTLE_ENDIAN, ComSignalInitValue=65534, ComSignalType=UINT16, ComTransferProperty=PENDING, ComHandleId=308, ComSystemTemplateSystemSignalRef=BMC_EnergieVorhalt
      BJB_CALID_01_XIX_BMC_CAN01_adee7d66_Rx (ComIPdu):
        ComIPduDirection = RECEIVE
        ComIPduType = NORMAL
        ComIPduHandleId = 6
        ComIPduSignalProcessing = DEFERRED
        ComIPduCancellationSupport = false
        ComIPduGroupRef = BMC_HV_XIX_BMC_CAN01_Rx_7b388810
        ComIPduSignalRef = BJB_CALID_Index_01_XIX_BJB_CALID_01_XIX_BMC_CAN01_14e77ef7_Rx
        ComIPduSignalRef = BJB_CALID_Index_02_XIX_BJB_CALID_01_XIX_BMC_CAN01_ddf87648_Rx
        ComIPduSignalRef = BJB_CALID_Index_03_XIX_BJB_CALID_01_XIX_BMC_CAN01_2c2273e2_Rx
        ComIPduSignalRef = BJB_CALID_Index_04_XIX_BJB_CALID_01_XIX_BMC_CAN01_94b76177_Rx
        ComIPduSignalRef = BJB_CALID_Index_05_XIX_BJB_CALID_01_XIX_BMC_CAN01_656d64dd_Rx
        ComIPduSignalRef = BJB_CALID_Index_06_XIX_BJB_CALID_01_XIX_BMC_CAN01_ac726c62_Rx
        ComIPduSignalRef = BJB_CALID_Index_07_XIX_BJB_CALID_01_XIX_BMC_CAN01_5da869c8_Rx
        ComIPduSignalRef = BJB_CALID_Index_08_XIX_BJB_CALID_01_XIX_BMC_CAN01_06294f09_Rx
        ComPduIdRef = BJB_CALID_01_XIX_BMC_CAN01_adee7d66_Rx
        ComIPduMainFunctionRef = ComMainFunctionRx
      BMC_CMC_Zellspannung_04_XIX_HCP5_CANFD01_1395de0e_Tx (ComIPdu):
        ComIPduDirection = SEND
        ComIPduType = NORMAL
        ComIPduHandleId = 6
        ComIPduSignalProcessing = DEFERRED
        ComIPduCancellationSupport = false
        ComIPduGroupRef = BMC_HV_XIX_HCP5_CANFD01_Tx_3ba05bd9
        ComIPduGroupRef = BMC_HV_XIX_PNC_26_HighVoltage_Charging_Tx_20012544
        ComIPduSignalRef = BMC_CMC_Zellspannung_04_Messzeit_XIX_BMC_CMC_Zellspannung_04_XIX_HCP5_CANFD01_eb17b214_Tx
        ComIPduSignalRef = BMC_CMC_Zellspannung_118_XIX_BMC_CMC_Zellspannung_04_XIX_HCP5_CANFD01_39c805ed_Tx
        ComIPduSignalRef = BMC_CMC_Zellspannung_119_XIX_BMC_CMC_Zellspannung_04_XIX_HCP5_CANFD01_46019e7e_Tx
        ComIPduSignalRef = BMC_CMC_Zellspannung_120_XIX_BMC_CMC_Zellspannung_04_XIX_HCP5_CANFD01_caedc858_Tx
        ComIPduSignalRef = BMC_CMC_Zellspannung_121_XIX_BMC_CMC_Zellspannung_04_XIX_HCP5_CANFD01_b52453cb_Tx
        ComIPduSignalRef = BMC_CMC_Zellspannung_122_XIX_BMC_CMC_Zellspannung_04_XIX_HCP5_CANFD01_357eff7e_Tx
        ComIPduSignalRef = BMC_CMC_Zellspannung_123_XIX_BMC_CMC_Zellspannung_04_XIX_HCP5_CANFD01_4ab764ed_Tx
        ComIPduSignalRef = BMC_CMC_Zellspannung_124_XIX_BMC_CMC_Zellspannung_04_XIX_HCP5_CANFD01_eebaa055_Tx
        ComIPduSignalRef = BMC_CMC_Zellspannung_125_XIX_BMC_CMC_Zellspannung_04_XIX_HCP5_CANFD01_91733bc6_Tx
        ComIPduSignalRef = BMC_CMC_Zellspannung_126_XIX_BMC_CMC_Zellspannung_04_XIX_HCP5_CANFD01_11299773_Tx
        ComIPduSignalRef = BMC_CMC_Zellspannung_127_XIX_BMC_CMC_Zellspannung_04_XIX_HCP5_CANFD01_6ee00ce0_Tx
        ComIPduSignalRef = BMC_CMC_Zellspannung_128_XIX_BMC_CMC_Zellspannung_04_XIX_HCP5_CANFD01_82431842_Tx
        ComIPduSignalRef = BMC_CMC_Zellspannung_129_XIX_BMC_CMC_Zellspannung_04_XIX_HCP5_CANFD01_fd8a83d1_Tx
        ComIPduSignalRef = BMC_CMC_Zellspannung_130_XIX_BMC_CMC_Zellspannung_04_XIX_HCP5_CANFD01_a394c33d_Tx
        ComIPduSignalRef = BMC_CMC_Zellspannung_131_XIX_BMC_CMC_Zellspannung_04_XIX_HCP5_CANFD01_dc5d58ae_Tx
        ComIPduSignalRef = BMC_CMC_Zellspannung_132_XIX_BMC_CMC_Zellspannung_04_XIX_HCP5_CANFD01_5c07f41b_Tx
        ComIPduSignalRef = BMC_CMC_Zellspannung_133_XIX_BMC_CMC_Zellspannung_04_XIX_HCP5_CANFD01_23ce6f88_Tx
        ComIPduSignalRef = BMC_CMC_Zellspannung_134_XIX_BMC_CMC_Zellspannung_04_XIX_HCP5_CANFD01_87c3ab30_Tx
        ComIPduSignalRef = BMC_CMC_Zellspannung_135_XIX_BMC_CMC_Zellspannung_04_XIX_HCP5_CANFD01_f80a30a3_Tx
        ComIPduSignalRef = BMC_CMC_Zellspannung_136_XIX_BMC_CMC_Zellspannung_04_XIX_HCP5_CANFD01_78509c16_Tx
        ComIPduSignalRef = BMC_CMC_Zellspannung_137_XIX_BMC_CMC_Zellspannung_04_XIX_HCP5_CANFD01_07990785_Tx
        ComIPduSignalRef = BMC_CMC_Zellspannung_138_XIX_BMC_CMC_Zellspannung_04_XIX_HCP5_CANFD01_eb3a1327_Tx
        ComIPduSignalRef = BMC_CMC_Zellspannung_139_XIX_BMC_CMC_Zellspannung_04_XIX_HCP5_CANFD01_94f388b4_Tx
        ComIPduSignalRef = BMC_CMC_Zellspannung_140_XIX_BMC_CMC_Zellspannung_04_XIX_HCP5_CANFD01_668af547_Tx
        ComIPduSignalRef = BMC_CMC_Zellspannung_141_XIX_BMC_CMC_Zellspannung_04_XIX_HCP5_CANFD01_19436ed4_Tx
        ComIPduSignalRef = BMC_CMC_Zellspannung_142_XIX_BMC_CMC_Zellspannung_04_XIX_HCP5_CANFD01_9919c261_Tx
        ComIPduSignalRef = BMC_CMC_Zellspannung_143_XIX_BMC_CMC_Zellspannung_04_XIX_HCP5_CANFD01_e6d059f2_Tx
        ComIPduSignalRef = BMC_CMC_Zellspannung_144_XIX_BMC_CMC_Zellspannung_04_XIX_HCP5_CANFD01_42dd9d4a_Tx
        ComIPduSignalRef = BMC_CMC_Zellspannung_145_XIX_BMC_CMC_Zellspannung_04_XIX_HCP5_CANFD01_3d1406d9_Tx
        ComIPduSignalRef = BMC_CMC_Zellspannung_146_XIX_BMC_CMC_Zellspannung_04_XIX_HCP5_CANFD01_bd4eaa6c_Tx
        ComIPduSignalRef = BMC_CMC_Zellspannung_147_XIX_BMC_CMC_Zellspannung_04_XIX_HCP5_CANFD01_c28731ff_Tx
        ComIPduSignalRef = BMC_CMC_Zellspannung_148_XIX_BMC_CMC_Zellspannung_04_XIX_HCP5_CANFD01_2e24255d_Tx
        ComIPduSignalRef = BMC_CMC_Zellspannung_149_XIX_BMC_CMC_Zellspannung_04_XIX_HCP5_CANFD01_51edbece_Tx
        ComIPduSignalRef = BMC_CMC_Zellspannung_150_XIX_BMC_CMC_Zellspannung_04_XIX_HCP5_CANFD01_0ff3fe22_Tx
        ComIPduSignalRef = BMC_CMC_Zellspannung_151_XIX_BMC_CMC_Zellspannung_04_XIX_HCP5_CANFD01_703a65b1_Tx
        ComIPduSignalRef = BMC_CMC_Zellspannung_152_XIX_BMC_CMC_Zellspannung_04_XIX_HCP5_CANFD01_f060c904_Tx
        ComIPduSignalRef = BMC_CMC_Zellspannung_153_XIX_BMC_CMC_Zellspannung_04_XIX_HCP5_CANFD01_8fa95297_Tx
        ComIPduSignalRef = BMC_CMC_Zellspannung_154_XIX_BMC_CMC_Zellspannung_04_XIX_HCP5_CANFD01_2ba4962f_Tx
        ComIPduSignalRef = BMC_CMC_Zellspannung_155_XIX_BMC_CMC_Zellspannung_04_XIX_HCP5_CANFD01_546d0dbc_Tx
        ComIPduSignalRef = BMC_CMC_Zellspannung_156_XIX_BMC_CMC_Zellspannung_04_XIX_HCP5_CANFD01_d437a109_Tx
        ComPduIdRef = BMC_CMC_Zellspannung_04_XIX_HCP5_CANFD01_1395de0e_Tx
        ComIPduMainFunctionRef = ComMainFunctionTx
        ComTxIPdu: ComTxIPduUnusedAreasDefault=0, ComMinimumDelayTime=0
          ComTxModeTrue
            ComTxMode: ComTxModeMode=PERIODIC, ComTxModeTimeOffset=0, ComTxModeTimePeriod=1
          ComTxModeFalse
            ComTxMode: ComTxModeMode=NONE
      3 x ComSignal, all with ComSignalEndianness=LITTLE_ENDIAN, ComSignalType=UINT8, ComSignalAccess=ACCESS_UNCLEAR:
        BMC_CMC_Zellspannung_01_Messzeit_XIX_BMC_CMC_Zellspannung_01_XIX_HCP5_CANFD01_a5e0aca3_Tx: ComBitPosition=480, ComBitSize=8, ComSignalDataInvalidValue=255, ComSignalInitValue=254, ComTransferProperty=PENDING, ComHandleId=107, ComSystemTemplateSystemSignalRef=BMC_CMC_Zellspannung_01_Messzeit
        UI2_KompFehlerModus4_11_XIX_UI2_Komponentenfehler_02_XIX_BMC_CAN01_04fba385_Rx: ComBitPosition=42, ComBitSize=3, ComSignalInitValue=0, ComTimeout=1, ComHandleId=481, ComSystemTemplateSystemSignalRef=UI2_KompFehlerModus4_11
        KST_KL_15_XIX_ClampControl_01_XIX_HCP5_CANFD01_06301fa5_Rx: ComBitPosition=17, ComBitSize=1, ComSignalInitValue=0, ComTimeout=1, ComHandleId=155, ComSystemTemplateSystemSignalRef=KST_KL_15
      KS_Hybrid_01_Response_K_XIX_HCP5_CANFD01_76da782f_Tx (ComIPdu):
        ComIPduDirection = SEND
        ComIPduType = NORMAL
        ComIPduHandleId = 27
        ComIPduSignalProcessing = DEFERRED
        ComIPduCancellationSupport = false
        ComIPduGroupRef = BMC_HV_XIX_HCP5_CANFD01_Tx_3ba05bd9
        ComIPduSignalGroupRef = SG_KS_Hybrid_01_Response_K_XIX_HCP5_CANFD01_adb36dae_Tx
        ComPduIdRef = KS_Hybrid_01_Response_K_XIX_HCP5_CANFD01_76da782f_Tx
        ComIPduMainFunctionRef = ComMainFunctionTx
        ComTxIPdu: ComTxIPduUnusedAreasDefault=0, ComMinimumDelayTime=0
          ComTxModeTrue
            ComTxMode: ComTxModeMode=DIRECT, ComTxModeNumberOfRepetitions=0, ComTxModeRepetitionPeriod=0
          ComTxModeFalse
            ComTxMode: ComTxModeMode=NONE
      6 x ComSignal, all with ComSignalEndianness=LITTLE_ENDIAN, ComSignalAccess=ACCESS_UNCLEAR:
        UI1_KompFehlerModus2_09_XIX_UI1_Komponentenfehler_01_XIX_BMC_CAN01_be8912fe_Rx: ComBitPosition=28, ComBitSize=2, ComSignalInitValue=0, ComSignalType=UINT8, ComTimeout=1, ComHandleId=359, ComSystemTemplateSystemSignalRef=UI1_KompFehlerModus2_09
        BMC_CMC_Zellspannung_172_XIX_BMC_CMC_Zellspannung_05_XIX_HCP5_CANFD01_cdc0692f_Tx: ComBitPosition=192, ComBitSize=12, ComSignalDataInvalidValue=4095, ComSignalInitValue=4094, ComSignalType=UINT16, ComTransferProperty=PENDING, ComHandleId=283, ComSystemTemplateSystemSignalRef=BMC_CMC_Zellspannung_172
        BMC_CMC_Temperatur_070_XIX_BMC_CMC_Temperatur_02_XIX_HCP5_CANFD01_05fb7324_Tx: ComBitPosition=104, ComBitSize=8, ComSignalDataInvalidValue=255, ComSignalInitValue=254, ComSignalType=UINT8, ComTransferProperty=PENDING, ComHandleId=80, ComSystemTemplateSystemSignalRef=BMC_CMC_Temperatur_070
        DCDC_NV_CALID_Index_15_XIX_DCDC_NV_CALID_XIX_HCP5_CANFD01_37f7ab0a_Rx: ComBitPosition=112, ComBitSize=8, ComSignalInitValue=63, ComSignalType=UINT8, ComTimeout=5, ComHandleId=39, ComSystemTemplateSystemSignalRef=DCDC_NV_CALID_Index_15
        DCDC_NV_Komponentenfehler_70_XIX_DCDC_NV_Komponentenfehler_03_XIX_HCP5_CANFD01_dda522a3_Rx: ComBitPosition=18, ComBitSize=2, ComSignalInitValue=0, ComSignalType=UINT8, ComTimeout=5, ComHandleId=131, ComSystemTemplateSystemSignalRef=DCDC_NV_Komponentenfehler_70
        DCDC_NV_Komponentenfehler_3_12_XIX_DCDC_NV_Komponentenfehler_04_XIX_HCP5_CANFD01_129d46bf_Rx: ComBitPosition=33, ComBitSize=3, ComSignalInitValue=0, ComSignalType=UINT8, ComTimeout=5, ComHandleId=57, ComSystemTemplateSystemSignalRef=DCDC_NV_Komponentenfehler_3_12
      KS_Hybrid_01_Response_M_XIX_HCP5_CANFD01_78a6c4aa_Rx (ComIPdu):
        ComIPduDirection = RECEIVE
        ComIPduType = NORMAL
        ComIPduHandleId = 28
        ComIPduSignalProcessing = DEFERRED
        ComIPduCancellationSupport = false
        ComIPduGroupRef = BMC_HV_XIX_HCP5_CANFD01_Rx_6dfafc5f
        ComIPduSignalGroupRef = SG_KS_Hybrid_01_Response_M_XIX_HCP5_CANFD01_a3cfd12b_Rx
        ComPduIdRef = KS_Hybrid_01_Response_M_XIX_HCP5_CANFD01_78a6c4aa_Rx
        ComIPduMainFunctionRef = ComMainFunctionRx
      NM_Hybrid_01_XIX_HCP5_CANFD01_c84ff8a5_Tx (ComIPdu):
        ComIPduDirection = SEND
        ComIPduType = NORMAL
        ComIPduHandleId = 29
        ComIPduSignalProcessing = DEFERRED
        ComIPduCancellationSupport = false
        ComIPduSignalRef = NM_Hybrid_01_FCAB_XIX_NM_Hybrid_01_XIX_HCP5_CANFD01_38c188fa_Tx
        ComIPduSignalRef = NM_Hybrid_01_NM_State_XIX_NM_Hybrid_01_XIX_HCP5_CANFD01_9a9758f9_Tx
        ComIPduSignalRef = NM_Hybrid_01_NM_aktiv_Diag_XIX_NM_Hybrid_01_XIX_HCP5_CANFD01_6143673a_Tx
        ComIPduSignalRef = NM_Hybrid_01_NM_aktiv_KL15_XIX_NM_Hybrid_01_XIX_HCP5_CANFD01_d7280503_Tx
        ComIPduSignalRef = NM_Hybrid_01_NM_aktiv_Tmin_XIX_NM_Hybrid_01_XIX_HCP5_CANFD01_cfd9c50b_Tx
        ComIPduSignalRef = NM_Hybrid_01_SNI_10_XIX_NM_Hybrid_01_XIX_HCP5_CANFD01_4ea5afc8_Tx
        ComIPduSignalRef = NM_Hybrid_01_UDS_CC_XIX_NM_Hybrid_01_XIX_HCP5_CANFD01_d82615ea_Tx
        ComIPduSignalRef = NM_Hybrid_01_Wakeup_V12_XIX_NM_Hybrid_01_XIX_HCP5_CANFD01_450fdf96_Tx
        ComIPduSignalRef = NM_aktiv_Konditionierungsbedarf_XIX_NM_Hybrid_01_XIX_HCP5_CANFD01_91de24c0_Tx
        ComIPduSignalRef = NM_aktiv_SubbusSteuerung_BMC_HV_XIX_NM_Hybrid_01_XIX_HCP5_CANFD01_276a97d5_Tx
        ComPduIdRef = NM_Hybrid_01_XIX_HCP5_CANFD01_c84ff8a5_Tx
        ComIPduMainFunctionRef = ComMainFunctionTx
        ComTxIPdu: ComTxIPduUnusedAreasDefault=0, ComMinimumDelayTime=0  # NM_Hybrid_01_XIX_HCP5_CANFD01
          ComTxModeTrue
            ComTxMode: ComTxModeMode=NONE
          ComTxModeFalse
            ComTxMode: ComTxModeMode=NONE
      7 x ComSignal, all with ComSignalEndianness=LITTLE_ENDIAN, ComSignalAccess=ACCESS_UNCLEAR:
        BMC_CMC_Zellspannung_178_XIX_BMC_CMC_Zellspannung_05_XIX_HCP5_CANFD01_7afd8e13_Tx: ComBitPosition=264, ComBitSize=12, ComSignalDataInvalidValue=4095, ComSignalInitValue=4094, ComSignalType=UINT16, ComTransferProperty=PENDING, ComHandleId=289, ComSystemTemplateSystemSignalRef=BMC_CMC_Zellspannung_178
        CHA_ReqPrgBms_XIX_Charisma_20_XIX_HCP5_CANFD01_9364cd45_Rx: ComBitPosition=12, ComBitSize=4, ComSignalInitValue=0, ComSignalType=UINT8, ComTimeout=5, ComHandleId=23, ComSystemTemplateSystemSignalRef=CHA_ReqPrgBms
        BMC_CMC_Zellspannung_170_XIX_BMC_CMC_Zellspannung_05_XIX_HCP5_CANFD01_32535e09_Tx: ComBitPosition=168, ComBitSize=12, ComSignalDataInvalidValue=4095, ComSignalInitValue=4094, ComSignalType=UINT16, ComTransferProperty=PENDING, ComHandleId=281, ComSystemTemplateSystemSignalRef=BMC_CMC_Zellspannung_170
        BMC_CMC_Temperatur_027_XIX_BMC_CMC_Temperatur_01_XIX_HCP5_CANFD01_79f884d7_Tx: ComBitPosition=224, ComBitSize=8, ComSignalDataInvalidValue=255, ComSignalInitValue=254, ComSignalType=UINT8, ComTransferProperty=PENDING, ComHandleId=37, ComSystemTemplateSystemSignalRef=BMC_CMC_Temperatur_027
        BMC_CMC_Temperatur_056_XIX_BMC_CMC_Temperatur_01_XIX_HCP5_CANFD01_8fd069d3_Tx: ComBitPosition=456, ComBitSize=8, ComSignalDataInvalidValue=255, ComSignalInitValue=254, ComSignalType=UINT8, ComTransferProperty=PENDING, ComHandleId=66, ComSystemTemplateSystemSignalRef=BMC_CMC_Temperatur_056
        BMC_CMC_Temperatur_045_XIX_BMC_CMC_Temperatur_01_XIX_HCP5_CANFD01_523e0939_Tx: ComBitPosition=368, ComBitSize=8, ComSignalDataInvalidValue=255, ComSignalInitValue=254, ComSignalType=UINT8, ComTransferProperty=PENDING, ComHandleId=55, ComSystemTemplateSystemSignalRef=BMC_CMC_Temperatur_045
        UI2_KompFehlerModus2_21_XIX_UI2_Komponentenfehler_01_XIX_BMC_CAN01_862a8a76_Rx: ComBitPosition=52, ComBitSize=2, ComSignalInitValue=0, ComSignalType=UINT8, ComTimeout=1, ComHandleId=465, ComSystemTemplateSystemSignalRef=UI2_KompFehlerModus2_21
      SG_ORU_Control_D_01_XIX_HCP5_CANFD01_25c40c08_Rx (ComSignalGroup):
        ComTransferProperty = TRIGGERED_WITHOUT_REPETITION
        ComSignalGroupAccess = ACCESS_UNCLEAR
        ComHandleId = 9
        ComSystemTemplateSignalGroupRef = SG_ORU_Control_D_01_XIX_HCP5_CANFD01
        12 x ComGroupSignal, all with ComSignalEndianness=LITTLE_ENDIAN, ComSignalInitValue=0, ComSignalAccess=ACCESS_UNCLEAR:
          OnlineRemoteUpdateControlD_XIX_ORU_Control_D_01_XIX_HCP5_CANFD01_52c8221f_Rx: ComBitPosition=12, ComBitSize=4, ComSignalDataInvalidValue=15, ComSignalType=UINT8, ComHandleId=281, ComSystemTemplateSystemSignalRef=OnlineRemoteUpdateControlD
          OnlineRemoteUpdateControlOldD_XIX_ORU_Control_D_01_XIX_HCP5_CANFD01_7dd490fb_Rx: ComBitPosition=16, ComBitSize=4, ComSignalDataInvalidValue=15, ComSignalType=UINT8, ComHandleId=282, ComSystemTemplateSystemSignalRef=OnlineRemoteUpdateControlOldD
          OruControlReleaseD_XIX_ORU_Control_D_01_XIX_HCP5_CANFD01_c5054959_Rx: ComBitPosition=24, ComBitSize=16, ComSignalType=UINT16, ComHandleId=283, ComSystemTemplateSystemSignalRef=OruControlReleaseD
          OruIntegrityCheckActiveD_XIX_ORU_Control_D_01_XIX_HCP5_CANFD01_1c06bd37_Rx: ComBitPosition=22, ComBitSize=2, ComSignalDataInvalidValue=3, ComSignalType=UINT8, ComHandleId=286, ComSystemTemplateSystemSignalRef=OruIntegrityCheckActiveD
          ISignalVoid_ORU_Control_D_01_XIX_HCP5_CANFD01_0_4303eae2_Rx: ComBitPosition=53, ComBitSize=3, ComSignalType=UINT8, ComHandleId=277, ComSystemTemplateSystemSignalRef=SignalVoid_ORU_Control_D_01_0
          ORU_Control_D_01_CRC_XIX_ORU_Control_D_01_XIX_HCP5_CANFD01_1b88220f_Rx: ComBitPosition=0, ComBitSize=8, ComSignalType=UINT8, ComHandleId=280, ComSystemTemplateSystemSignalRef=ORU_Control_D_01_CRC
          OruControlStateD_XIX_ORU_Control_D_01_XIX_HCP5_CANFD01_347b60ad_Rx: ComBitPosition=40, ComBitSize=8, ComSignalDataInvalidValue=129, ComSignalType=UINT8, ComHandleId=284, ComSystemTemplateSystemSignalRef=OruControlStateD
          OruHostUpdateD_XIX_ORU_Control_D_01_XIX_HCP5_CANFD01_16f4d1de_Rx: ComBitPosition=50, ComBitSize=3, ComSignalDataInvalidValue=4, ComSignalType=UINT8, ComHandleId=285, ComSystemTemplateSystemSignalRef=OruHostUpdateD
          ORU_Control_D_01_BZ_XIX_ORU_Control_D_01_XIX_HCP5_CANFD01_feb38b7c_Rx: ComBitPosition=8, ComBitSize=4, ComSignalType=UINT8, ComHandleId=279, ComSystemTemplateSystemSignalRef=ORU_Control_D_01_BZ
          ISignalVoid_ORU_Control_D_01_XIX_HCP5_CANFD01_1_3404da74_Rx: ComBitPosition=56, ComBitSize=8, ComSignalType=UINT8, ComHandleId=278, ComSystemTemplateSystemSignalRef=SignalVoid_ORU_Control_D_01_1
          OruReleasePartitionSwitchD_XIX_ORU_Control_D_01_XIX_HCP5_CANFD01_7a4005b4_Rx: ComBitPosition=48, ComBitSize=2, ComSignalDataInvalidValue=3, ComSignalType=UINT8, ComHandleId=287, ComSystemTemplateSystemSignalRef=OruReleasePartitionSwitchD
          OruVehicleLockRequestD_XIX_ORU_Control_D_01_XIX_HCP5_CANFD01_54fd095b_Rx: ComBitPosition=20, ComBitSize=2, ComSignalDataInvalidValue=3, ComSignalType=UINT8, ComHandleId=288, ComSystemTemplateSystemSignalRef=OruVehicleLockRequestD
      BMC_RtmWarnTZelleDiff_XIX_BMC_HV_08_XIX_HCP5_CANFD01_733ec90e_Tx (ComSignal):
        ComBitPosition = 40
        ComBitSize = 3
        ComSignalEndianness = LITTLE_ENDIAN
        ComSignalInitValue = 0
        ComSignalType = UINT8
        ComTransferProperty = PENDING
        ComSignalAccess = ACCESS_UNCLEAR
        ComHandleId = 369
        ComSystemTemplateSystemSignalRef = BMC_RtmWarnTZelleDiff
      DCDC_NV_Komponentenfehler_28_XIX_DCDC_NV_Komponentenfehler_01_XIX_HCP5_CANFD01_2abdc085_Rx (ComSignal):
        ComBitPosition = 54
        ComBitSize = 2
        ComSignalEndianness = LITTLE_ENDIAN
        ComSignalInitValue = 0
        ComSignalType = UINT8
        ComTimeout = 5
        ComSignalAccess = ACCESS_UNCLEAR
        ComHandleId = 89
        ComSystemTemplateSystemSignalRef = DCDC_NV_Komponentenfehler_28
      UI2Sens01_CVN_XIX_BMC_CAN01_fe6b52fc_Rx (ComIPdu):
        ComIPduDirection = RECEIVE
        ComIPduType = NORMAL
        ComIPduHandleId = 52
        ComIPduSignalProcessing = DEFERRED
        ComIPduCancellationSupport = false
        ComIPduGroupRef = BMC_HV_XIX_BMC_CAN01_Rx_7b388810
        ComIPduSignalRef = UI2Sens01_CVN_Byte_1_XIX_UI2Sens01_CVN_XIX_BMC_CAN01_0510ee62_Rx
        ComIPduSignalRef = UI2Sens01_CVN_Byte_2_XIX_UI2Sens01_CVN_XIX_BMC_CAN01_5e075f77_Rx
        ComIPduSignalRef = UI2Sens01_CVN_Byte_3_XIX_UI2Sens01_CVN_XIX_BMC_CAN01_68f5cf84_Rx
        ComIPduSignalRef = UI2Sens01_CVN_Byte_4_XIX_UI2Sens01_CVN_XIX_BMC_CAN01_e8283d5d_Rx
        ComIPduSignalRef = UI2Sens01_CVN_VLD_XIX_UI2Sens01_CVN_XIX_BMC_CAN01_56f8ef91_Rx
        ComPduIdRef = UI2Sens01_CVN_XIX_BMC_CAN01_fe6b52fc_Rx
        ComIPduMainFunctionRef = ComMainFunctionRx
      5 x ComSignal, all with ComSignalEndianness=LITTLE_ENDIAN, ComSignalAccess=ACCESS_UNCLEAR:
        ZM_HV_Auszeit_XIX_ZeitMaster_01_XIX_HCP5_CANFD01_870dc7b8_Rx: ComBitPosition=52, ComBitSize=12, ComSignalDataInvalidValue=4095, ComSignalInitValue=4094, ComSignalType=UINT16, ComTimeout=5, ComHandleId=512, ComSystemTemplateSystemSignalRef=ZM_HV_Auszeit
        UI2Sens02_CALID_Index_14_XIX_UI2Sens02_CALID_02_XIX_BMC_CAN01_2271a77c_Rx: ComBitPosition=40, ComBitSize=8, ComSignalInitValue=63, ComSignalType=UINT8, ComTimeout=5, ComHandleId=436, ComSystemTemplateSystemSignalRef=UI2Sens02_CALID_Index_14
        BMC_Pack_SN_12_XIX_BMC_HV_08_XIX_HCP5_CANFD01_26d975d7_Tx: ComBitPosition=152, ComBitSize=8, ComSignalInitValue=255, ComSignalType=UINT8, ComTransferProperty=PENDING, ComHandleId=345, ComSystemTemplateSystemSignalRef=BMC_Pack_SN_12
        PCM_BMC_VTD_RecentReset_Req_XIX_HCP1_17_XIX_HCP5_CANFD01_6b228b48_Rx: ComBitPosition=40, ComBitSize=2, ComSignalDataInvalidValue=3, ComSignalInitValue=2, ComSignalType=UINT8, ComTimeout=5, ComHandleId=182, ComSystemTemplateSystemSignalRef=PCM_BMC_VTD_RecentReset_Req
        BMC_CMC_Zellspannung_04_Messzeit_XIX_BMC_CMC_Zellspannung_04_XIX_HCP5_CANFD01_eb17b214_Tx: ComBitPosition=480, ComBitSize=8, ComSignalDataInvalidValue=255, ComSignalInitValue=254, ComSignalType=UINT8, ComTransferProperty=PENDING, ComHandleId=110, ComSystemTemplateSystemSignalRef=BMC_CMC_Zellspannung_04_Messzeit
      BMC_HV_XIX_BMC_CAN01_Tx_2d622f96 (ComIPduGroup): ComIPduGroupHandleId=1
      6 x ComSignal, all with ComSignalEndianness=LITTLE_ENDIAN, ComSignalAccess=ACCESS_UNCLEAR:
        BJB_CALID_Index_15_XIX_BJB_CALID_02_XIX_BMC_CAN01_42e29e57_Rx: ComBitPosition=48, ComBitSize=8, ComSignalInitValue=63, ComSignalType=UINT8, ComTimeout=5, ComHandleId=15, ComSystemTemplateSystemSignalRef=BJB_CALID_Index_15
        KN_Hybrid_01_ECUKnockOutTimer_XIX_KN_Hybrid_01_XIX_HCP5_CANFD01_7ea3be84_Tx: ComBitPosition=24, ComBitSize=6, ComSignalInitValue=15, ComSignalType=UINT8, ComTransferProperty=PENDING, ComHandleId=410, ComSystemTemplateSystemSignalRef=KN_Hybrid_01_ECUKnockOutTimer
        DCDC_NV_Komponentenfehler_37_XIX_DCDC_NV_Komponentenfehler_02_XIX_HCP5_CANFD01_559eb20d_Rx: ComBitPosition=14, ComBitSize=2, ComSignalInitValue=0, ComSignalType=UINT8, ComTimeout=5, ComHandleId=98, ComSystemTemplateSystemSignalRef=DCDC_NV_Komponentenfehler_37
        UI1_Iso_Pos_XIX_UI1_05_XIX_BMC_CAN01_c7179271_Rx: ComBitPosition=32, ComBitSize=16, ComSignalDataInvalidValue=65535, ComSignalInitValue=65534, ComSignalType=UINT16, ComTimeout=1, ComHandleId=349, ComSystemTemplateSystemSignalRef=UI1_Iso_Pos
        BMC_Bidi_Min_SoC_XIX_BMC_HV_03_XIX_HCP5_CANFD01_1b8c15d1_Tx: ComBitPosition=161, ComBitSize=7, ComSignalDataInvalidValue=127, ComSignalInitValue=126, ComSignalType=UINT8, ComTransferProperty=PENDING, ComHandleId=5, ComSystemTemplateSystemSignalRef=BMC_Bidi_Min_SoC
        BMC_Pack_SN_17_XIX_BMC_HV_08_XIX_HCP5_CANFD01_a6896a57_Tx: ComBitPosition=192, ComBitSize=8, ComSignalInitValue=255, ComSignalType=UINT8, ComTransferProperty=PENDING, ComHandleId=350, ComSystemTemplateSystemSignalRef=BMC_Pack_SN_17
      OTP_01_XIX_HCP5_CANFD01_76e7759c_Rx (ComIPdu):
        ComIPduDirection = RECEIVE
        ComIPduType = NORMAL
        ComIPduHandleId = 38
        ComIPduSignalProcessing = DEFERRED
        ComIPduCancellationSupport = false
        ComIPduGroupRef = BMC_HV_XIX_HCP5_CANFD01_Rx_6dfafc5f
        ComIPduGroupRef = BMC_HV_XIX_PNC_24_ThermoManagement_Rx_9f1a6723
        ComIPduSignalRef = OTP_Aussen_Temp_OBD_XIX_OTP_01_XIX_HCP5_CANFD01_6e627cce_Rx
        ComIPduSignalRef = OTP_Aussen_Temp_ungef_XIX_OTP_01_XIX_HCP5_CANFD01_c0bbb4b6_Rx
        ComPduIdRef = OTP_01_XIX_HCP5_CANFD01_76e7759c_Rx
        ComIPduMainFunctionRef = ComMainFunctionRx
      8 x ComSignal, all with ComSignalEndianness=LITTLE_ENDIAN, ComSignalAccess=ACCESS_UNCLEAR:
        BMC_ExtLadeleistung_XIX_BMC_HV_08_XIX_HCP5_CANFD01_0def2e7f_Tx: ComBitPosition=328, ComBitSize=16, ComSignalDataInvalidValue=65535, ComSignalInitValue=65534, ComSignalType=UINT16, ComTransferProperty=PENDING, ComHandleId=311, ComSystemTemplateSystemSignalRef=BMC_ExtLadeleistung
        UI1_KompFehlerModus4_02_XIX_UI1_Komponentenfehler_02_XIX_BMC_CAN01_f7dbc86f_Rx: ComBitPosition=15, ComBitSize=3, ComSignalInitValue=0, ComSignalType=UINT8, ComTimeout=1, ComHandleId=378, ComSystemTemplateSystemSignalRef=UI1_KompFehlerModus4_02
        DCDC_NV_Komponentenfehler_3_3_XIX_DCDC_NV_Komponentenfehler_04_XIX_HCP5_CANFD01_024ed743_Rx: ComBitPosition=6, ComBitSize=3, ComSignalInitValue=0, ComSignalType=UINT8, ComTimeout=5, ComHandleId=48, ComSystemTemplateSystemSignalRef=DCDC_NV_Komponentenfehler_3_3
        UH_Tag_XIX_Diagnose_01_XIX_HCP5_CANFD01_743028a3_Rx: ComBitPosition=39, ComBitSize=5, ComSignalInitValue=0, ComSignalType=UINT8, ComTimeout=5, ComHandleId=347, ComSystemTemplateSystemSignalRef=UH_Tag
        BMC_CMC_Temperatur_029_XIX_BMC_CMC_Temperatur_01_XIX_HCP5_CANFD01_0f38d0ca_Tx: ComBitPosition=240, ComBitSize=8, ComSignalDataInvalidValue=255, ComSignalInitValue=254, ComSignalType=UINT8, ComTransferProperty=PENDING, ComHandleId=39, ComSystemTemplateSystemSignalRef=BMC_CMC_Temperatur_029
        BMC_Min_Spannung_XIX_BMC_HV_06_XIX_HCP5_CANFD01_a39bb5e4_Tx: ComBitPosition=22, ComBitSize=10, ComSignalDataInvalidValue=1023, ComSignalInitValue=1022, ComSignalType=UINT16, ComTransferProperty=TRIGGERED_ON_CHANGE_WITHOUT_REPETITION, ComHandleId=328, ComSystemTemplateSystemSignalRef=BMC_Min_Spannung
        DCDC_NV_Komponentenfehler_40_XIX_DCDC_NV_Komponentenfehler_02_XIX_HCP5_CANFD01_88a29055_Rx: ComBitPosition=20, ComBitSize=2, ComSignalInitValue=0, ComSignalType=UINT8, ComTimeout=5, ComHandleId=101, ComSystemTemplateSystemSignalRef=DCDC_NV_Komponentenfehler_40
        BMC_CMC_Temperatur_002_XIX_BMC_CMC_Temperatur_01_XIX_HCP5_CANFD01_672d0be4_Tx: ComBitPosition=24, ComBitSize=8, ComSignalDataInvalidValue=255, ComSignalInitValue=254, ComSignalType=UINT8, ComTransferProperty=PENDING, ComHandleId=12, ComSystemTemplateSystemSignalRef=BMC_CMC_Temperatur_002
      Thermomanagement_01_XIX_HCP5_CANFD01_60e8cf38_Rx (ComIPdu):
        ComIPduDirection = RECEIVE
        ComIPduType = NORMAL
        ComIPduHandleId = 42
        ComIPduSignalProcessing = DEFERRED
        ComIPduCancellationSupport = false
        ComIPduGroupRef = BMC_HV_XIX_HCP5_CANFD01_Rx_6dfafc5f
        ComIPduGroupRef = BMC_HV_XIX_PNC_24_ThermoManagement_Rx_9f1a6723
        ComIPduSignalRef = EKK_HVK_EoHVL_Status_XIX_Thermomanagement_01_XIX_HCP5_CANFD01_0b35afaa_Rx
        ComIPduSignalRef = TME_Batt_Kond_Verf_XIX_Thermomanagement_01_XIX_HCP5_CANFD01_ac1763e7_Rx
        ComIPduSignalRef = TME_Therm_IstLeistung_HVBatterie_XIX_Thermomanagement_01_XIX_HCP5_CANFD01_705b15a6_Rx
        ComPduIdRef = Thermomanagement_01_XIX_HCP5_CANFD01_60e8cf38_Rx
        ComIPduMainFunctionRef = ComMainFunctionRx
      BMC_Pack_SN_04_XIX_BMC_HV_08_XIX_HCP5_CANFD01_5964f21b_Tx (ComSignal):
        ComBitPosition = 88
        ComBitSize = 8
        ComSignalEndianness = LITTLE_ENDIAN
        ComSignalInitValue = 255
        ComSignalType = UINT8
        ComTransferProperty = PENDING
        ComSignalAccess = ACCESS_UNCLEAR
        ComHandleId = 337
        ComSystemTemplateSystemSignalRef = BMC_Pack_SN_04
      DCDC_NV_CALID_XIX_HCP5_CANFD01_46b970f2_Rx (ComIPdu):
        ComIPduDirection = RECEIVE
        ComIPduType = NORMAL
        ComIPduHandleId = 13
        ComIPduSignalProcessing = DEFERRED
        ComIPduCancellationSupport = false
        ComIPduGroupRef = BMC_HV_XIX_HCP5_CANFD01_Rx_6dfafc5f
        ComIPduGroupRef = BMC_HV_XIX_PNC_40_Diagnosis_Energy_Rx_36e9c670
        ComIPduSignalRef = DCDC_NV_CALID_Index_01_XIX_DCDC_NV_CALID_XIX_HCP5_CANFD01_8f57e482_Rx
        ComIPduSignalRef = DCDC_NV_CALID_Index_02_XIX_DCDC_NV_CALID_XIX_HCP5_CANFD01_ebb79f7c_Rx
        ComIPduSignalRef = DCDC_NV_CALID_Index_03_XIX_DCDC_NV_CALID_XIX_HCP5_CANFD01_7ec74be9_Rx
        ComIPduSignalRef = DCDC_NV_CALID_Index_04_XIX_DCDC_NV_CALID_XIX_HCP5_CANFD01_22776880_Rx
        ComIPduSignalRef = DCDC_NV_CALID_Index_05_XIX_DCDC_NV_CALID_XIX_HCP5_CANFD01_b707bc15_Rx
        ComIPduSignalRef = DCDC_NV_CALID_Index_06_XIX_DCDC_NV_CALID_XIX_HCP5_CANFD01_d3e7c7eb_Rx
        ComIPduSignalRef = DCDC_NV_CALID_Index_07_XIX_DCDC_NV_CALID_XIX_HCP5_CANFD01_4697137e_Rx
        ComIPduSignalRef = DCDC_NV_CALID_Index_08_XIX_DCDC_NV_CALID_XIX_HCP5_CANFD01_6a878139_Rx
        ComIPduSignalRef = DCDC_NV_CALID_Index_09_XIX_DCDC_NV_CALID_XIX_HCP5_CANFD01_fff755ac_Rx
        ComIPduSignalRef = DCDC_NV_CALID_Index_10_XIX_DCDC_NV_CALID_XIX_HCP5_CANFD01_9ad72708_Rx
        ComIPduSignalRef = DCDC_NV_CALID_Index_11_XIX_DCDC_NV_CALID_XIX_HCP5_CANFD01_0fa7f39d_Rx
        ComIPduSignalRef = DCDC_NV_CALID_Index_12_XIX_DCDC_NV_CALID_XIX_HCP5_CANFD01_6b478863_Rx
        ComIPduSignalRef = DCDC_NV_CALID_Index_13_XIX_DCDC_NV_CALID_XIX_HCP5_CANFD01_fe375cf6_Rx
        ComIPduSignalRef = DCDC_NV_CALID_Index_14_XIX_DCDC_NV_CALID_XIX_HCP5_CANFD01_a2877f9f_Rx
        ComIPduSignalRef = DCDC_NV_CALID_Index_15_XIX_DCDC_NV_CALID_XIX_HCP5_CANFD01_37f7ab0a_Rx
        ComIPduSignalRef = DCDC_NV_CALID_Index_16_XIX_DCDC_NV_CALID_XIX_HCP5_CANFD01_5317d0f4_Rx
        ComPduIdRef = DCDC_NV_CALID_XIX_HCP5_CANFD01_46b970f2_Rx
        ComIPduMainFunctionRef = ComMainFunctionRx
      8 x ComSignal, all with ComSignalEndianness=LITTLE_ENDIAN, ComSignalAccess=ACCESS_UNCLEAR:
        BMC_CMC_Temperatur_090_XIX_BMC_CMC_Temperatur_03_XIX_HCP5_CANFD01_89d96948_Tx: ComBitPosition=152, ComBitSize=8, ComSignalDataInvalidValue=255, ComSignalInitValue=254, ComSignalType=UINT8, ComTransferProperty=PENDING, ComHandleId=100, ComSystemTemplateSystemSignalRef=BMC_CMC_Temperatur_090
        BMC_CMC_Zellspannung_189_XIX_BMC_CMC_Zellspannung_05_XIX_HCP5_CANFD01_3d007450_Tx: ComBitPosition=396, ComBitSize=12, ComSignalDataInvalidValue=4095, ComSignalInitValue=4094, ComSignalType=UINT16, ComTransferProperty=PENDING, ComHandleId=300, ComSystemTemplateSystemSignalRef=BMC_CMC_Zellspannung_189
        BMC_CMC_Zellspannung_105_XIX_BMC_CMC_Zellspannung_03_XIX_HCP5_CANFD01_a2af2768_Tx: ComBitPosition=324, ComBitSize=12, ComSignalDataInvalidValue=4095, ComSignalInitValue=4094, ComSignalType=UINT16, ComTransferProperty=PENDING, ComHandleId=216, ComSystemTemplateSystemSignalRef=BMC_CMC_Zellspannung_105
        BMC_CMC_Zellspannung_152_XIX_BMC_CMC_Zellspannung_04_XIX_HCP5_CANFD01_f060c904_Tx: ComBitPosition=420, ComBitSize=12, ComSignalDataInvalidValue=4095, ComSignalInitValue=4094, ComSignalType=UINT16, ComTransferProperty=PENDING, ComHandleId=263, ComSystemTemplateSystemSignalRef=BMC_CMC_Zellspannung_152
        BMC_CMC_Zellspannung_184_XIX_BMC_CMC_Zellspannung_05_XIX_HCP5_CANFD01_2e3057d4_Tx: ComBitPosition=336, ComBitSize=12, ComSignalDataInvalidValue=4095, ComSignalInitValue=4094, ComSignalType=UINT16, ComTransferProperty=PENDING, ComHandleId=295, ComSystemTemplateSystemSignalRef=BMC_CMC_Zellspannung_184
        ORU_Status_XIX_ORU_01_XIX_HCP5_CANFD01_ee2b347d_Rx: ComBitPosition=61, ComBitSize=3, ComSignalInitValue=0, ComSignalType=UINT8, ComTimeout=5, ComHandleId=176, ComSystemTemplateSystemSignalRef=ORU_Status
        BMC_CMC_Zellspannung_091_XIX_BMC_CMC_Zellspannung_03_XIX_HCP5_CANFD01_2f1aff76_Tx: ComBitPosition=156, ComBitSize=12, ComSignalDataInvalidValue=4095, ComSignalInitValue=4094, ComSignalType=UINT16, ComTransferProperty=PENDING, ComHandleId=202, ComSystemTemplateSystemSignalRef=BMC_CMC_Zellspannung_091
        BMC_Range_Indikator_XIX_BMC_HV_14_XIX_HCP5_CANFD01_21f53466_Tx: ComBitPosition=23, ComBitSize=11, ComSignalDataInvalidValue=2047, ComSignalInitValue=2046, ComSignalType=UINT16, ComTransferProperty=PENDING, ComHandleId=360, ComSystemTemplateSystemSignalRef=BMC_Range_Indikator
      SG_HVK_03_XIX_HCP5_CANFD01_2b81aede_Rx (ComSignalGroup):
        ComTransferProperty = TRIGGERED_WITHOUT_REPETITION
        ComSignalGroupAccess = ACCESS_UNCLEAR
        ComHandleId = 4
        ComSystemTemplateSignalGroupRef = SG_HVK_03_XIX_HCP5_CANFD01
        23 x ComGroupSignal, all with ComSignalEndianness=LITTLE_ENDIAN, ComSignalAccess=ACCESS_UNCLEAR:
          HVK_Iso_Messung_Start_XIX_HVK_03_XIX_HCP5_CANFD01_9030ca71_Rx: ComBitPosition=36, ComBitSize=3, ComSignalInitValue=0, ComSignalType=UINT8, ComHandleId=230, ComSystemTemplateSystemSignalRef=HVK_Iso_Messung_Start
          HVK_DCDC_Sollmodus_XIX_HVK_03_XIX_HCP5_CANFD01_4ee29c42_Rx: ComBitPosition=24, ComBitSize=3, ComSignalInitValue=7, ComSignalType=UINT8, ComHandleId=221, ComSystemTemplateSystemSignalRef=HVK_DCDC_Sollmodus
          HVK_HVLM_Sollmodus_XIX_HVK_03_XIX_HCP5_CANFD01_15b9bef2_Rx: ComBitPosition=48, ComBitSize=3, ComSignalInitValue=7, ComSignalType=UINT8, ComHandleId=227, ComSystemTemplateSystemSignalRef=HVK_HVLM_Sollmodus
          HV_Bordnetz_aktiv_XIX_HVK_03_XIX_HCP5_CANFD01_4f42f3b3_Rx: ComBitPosition=51, ComBitSize=1, ComSignalInitValue=0, ComSignalType=UINT8, ComHandleId=235, ComSystemTemplateSystemSignalRef=HV_Bordnetz_aktiv
          HVK_EKK_Sollmodus_XIX_HVK_03_XIX_HCP5_CANFD01_f62409f8_Rx: ComBitPosition=27, ComBitSize=3, ComSignalInitValue=7, ComSignalType=UINT8, ComHandleId=222, ComSystemTemplateSystemSignalRef=HVK_EKK_Sollmodus
          HVK_ETM_Freigabe_XIX_HVK_03_XIX_HCP5_CANFD01_edeb1f2b_Rx: ComBitPosition=30, ComBitSize=2, ComSignalInitValue=3, ComSignalType=UINT8, ComHandleId=223, ComSystemTemplateSystemSignalRef=HVK_ETM_Freigabe
          HVK_BMC_Spannung_Anf_XIX_HVK_03_XIX_HCP5_CANFD01_c314cf2e_Rx: ComBitPosition=16, ComBitSize=4, ComSignalInitValue=3, ComSignalType=UINT8, ComHandleId=220, ComSystemTemplateSystemSignalRef=HVK_BMC_Spannung_Anf
          HVK_eKAT_Sollmodus_XIX_HVK_03_XIX_HCP5_CANFD01_9a721cec_Rx: ComBitPosition=44, ComBitSize=2, ComSignalInitValue=3, ComSignalType=UINT8, ComHandleId=233, ComSystemTemplateSystemSignalRef=HVK_eKAT_Sollmodus
          HVK_Vorladung_aktiv_XIX_HVK_03_XIX_HCP5_CANFD01_cca6e5eb_Rx: ComBitPosition=39, ComBitSize=1, ComSignalInitValue=0, ComSignalType=UINT8, ComHandleId=232, ComSystemTemplateSystemSignalRef=HVK_Vorladung_aktiv
          HVK_BMC_Sollmodus_XIX_HVK_03_XIX_HCP5_CANFD01_4f73c6c7_Rx: ComBitPosition=13, ComBitSize=3, ComSignalInitValue=7, ComSignalType=UINT8, ComHandleId=219, ComSystemTemplateSystemSignalRef=HVK_BMC_Sollmodus
          HVK_Gesamtst_Spgfreiheit_XIX_HVK_03_XIX_HCP5_CANFD01_0729cb7e_Rx: ComBitPosition=40, ComBitSize=2, ComSignalDataInvalidValue=3, ComSignalInitValue=0, ComSignalType=UINT8, ComHandleId=224, ComSystemTemplateSystemSignalRef=HVK_Gesamtst_Spgfreiheit
          HVK_HV_Netz_Warnungen_XIX_HVK_03_XIX_HCP5_CANFD01_ce1fd60e_Rx: ComBitPosition=42, ComBitSize=2, ComSignalInitValue=0, ComSignalType=UINT8, ComHandleId=228, ComSystemTemplateSystemSignalRef=HVK_HV_Netz_Warnungen
          HVK_HV_Netz_Zustand_XIX_HVK_03_XIX_HCP5_CANFD01_9bc46e63_Rx: ComBitPosition=32, ComBitSize=4, ComSignalInitValue=15, ComSignalType=UINT8, ComHandleId=229, ComSystemTemplateSystemSignalRef=HVK_HV_Netz_Zustand
          ISignalVoid_HVK_03_XIX_HCP5_CANFD01_0_ba2f5215_Rx: ComBitPosition=54, ComBitSize=2, ComSignalType=UINT8, ComSignalInitValue=0, ComHandleId=236, ComSystemTemplateSystemSignalRef=SignalVoid_HVK_03_0
          HVK_HVHW_Sollmodus_XIX_HVK_03_XIX_HCP5_CANFD01_724712e2_Rx: ComBitPosition=22, ComBitSize=2, ComSignalInitValue=3, ComSignalType=UINT8, ComHandleId=226, ComSystemTemplateSystemSignalRef=HVK_HVHW_Sollmodus
          HVK_AIAD_Sollmodus_XIX_HVK_03_XIX_HCP5_CANFD01_6d835f5e_Rx: ComBitPosition=46, ComBitSize=2, ComSignalInitValue=3, ComSignalType=UINT8, ComHandleId=217, ComSystemTemplateSystemSignalRef=HVK_AIAD_Sollmodus
          HV_Bordnetz_Fehler_XIX_HVK_03_XIX_HCP5_CANFD01_7d897576_Rx: ComBitPosition=53, ComBitSize=1, ComSignalDataInvalidValue=1, ComSignalInitValue=0, ComSignalType=UINT8, ComHandleId=234, ComSystemTemplateSystemSignalRef=HV_Bordnetz_Fehler
          ISignalVoid_HVK_03_XIX_HCP5_CANFD01_1_cd286283_Rx: ComBitPosition=56, ComBitSize=8, ComSignalType=UINT8, ComSignalInitValue=0, ComHandleId=237, ComSystemTemplateSystemSignalRef=SignalVoid_HVK_03_1
          HVK_03_BZ_XIX_HVK_03_XIX_HCP5_CANFD01_f1822d14_Rx: ComBitPosition=8, ComBitSize=4, ComSignalInitValue=0, ComSignalType=UINT8, ComHandleId=215, ComSystemTemplateSystemSignalRef=HVK_03_BZ
          HVK_03_CRC_XIX_HVK_03_XIX_HCP5_CANFD01_d0e04876_Rx: ComBitPosition=0, ComBitSize=8, ComSignalInitValue=0, ComSignalType=UINT8, ComHandleId=216, ComSystemTemplateSystemSignalRef=HVK_03_CRC
          HVK_AktiveEntladung_Anf_XIX_HVK_03_XIX_HCP5_CANFD01_c41b276e_Rx: ComBitPosition=52, ComBitSize=1, ComSignalInitValue=0, ComSignalType=UINT8, ComHandleId=218, ComSystemTemplateSystemSignalRef=HVK_AktiveEntladung_Anf
          HVK_HVHL_Sollmodus_XIX_HVK_03_XIX_HCP5_CANFD01_8bb1f684_Rx: ComBitPosition=20, ComBitSize=2, ComSignalInitValue=3, ComSignalType=UINT8, ComHandleId=225, ComSystemTemplateSystemSignalRef=HVK_HVHL_Sollmodus
          HVK_Istmodus_Anf_XIX_HVK_03_XIX_HCP5_CANFD01_7cdd2f14_Rx: ComBitPosition=12, ComBitSize=1, ComSignalInitValue=0, ComSignalType=BOOLEAN, ComHandleId=231, ComSystemTemplateSystemSignalRef=HVK_Istmodus_Anf
      5 x ComSignal, all with ComSignalEndianness=LITTLE_ENDIAN, ComSignalAccess=ACCESS_UNCLEAR:
        BMC_CMC_Zellspannung_072_XIX_BMC_CMC_Zellspannung_02_XIX_HCP5_CANFD01_115f8f97_Tx: ComBitPosition=396, ComBitSize=12, ComSignalDataInvalidValue=4095, ComSignalInitValue=4094, ComSignalType=UINT16, ComTransferProperty=PENDING, ComHandleId=183, ComSystemTemplateSystemSignalRef=BMC_CMC_Zellspannung_072
        DCDC_NV_Komponentenfehler_38_XIX_DCDC_NV_Komponentenfehler_02_XIX_HCP5_CANFD01_a9f7e1ea_Rx: ComBitPosition=16, ComBitSize=2, ComSignalInitValue=0, ComSignalType=UINT8, ComTimeout=5, ComHandleId=99, ComSystemTemplateSystemSignalRef=DCDC_NV_Komponentenfehler_38
        BMC_Max_Ladeleistung_02_XIX_BMC_HV_09_XIX_HCP5_CANFD01_a9e1b473_Tx: ComBitPosition=41, ComBitSize=15, ComSignalDataInvalidValue=32767, ComSignalInitValue=32766, ComSignalType=UINT16, ComTransferProperty=PENDING, ComHandleId=325, ComSystemTemplateSystemSignalRef=BMC_Max_Ladeleistung_02
        BMC_CMC_Zellspannung_115_XIX_BMC_CMC_Zellspannung_03_XIX_HCP5_CANFD01_cbd62c0d_Tx: ComBitPosition=444, ComBitSize=12, ComSignalDataInvalidValue=4095, ComSignalInitValue=4094, ComSignalType=UINT16, ComTransferProperty=PENDING, ComHandleId=226, ComSystemTemplateSystemSignalRef=BMC_CMC_Zellspannung_115
        BMC_Verbrauch_XIX_BMC_HV_05_XIX_HCP5_CANFD01_8e72d45b_Tx: ComBitPosition=16, ComBitSize=16, ComSignalInitValue=0, ComSignalType=UINT16, ComTransferProperty=PENDING, ComHandleId=387, ComSystemTemplateSystemSignalRef=BMC_Verbrauch
      BMC_HV_XIX_BMC_CAN01_Rx_7b388810 (ComIPduGroup): ComIPduGroupHandleId=0
      3 x ComSignal, all with ComSignalEndianness=LITTLE_ENDIAN, ComTransferProperty=PENDING, ComSignalAccess=ACCESS_UNCLEAR:
        BMC_CMC_Zellspannung_040_XIX_BMC_CMC_Zellspannung_02_XIX_HCP5_CANFD01_5547a51e_Tx: ComBitPosition=12, ComBitSize=12, ComSignalDataInvalidValue=4095, ComSignalInitValue=4094, ComSignalType=UINT16, ComHandleId=151, ComSystemTemplateSystemSignalRef=BMC_CMC_Zellspannung_040
        BMC_CMC_Temperatur_047_XIX_BMC_CMC_Temperatur_01_XIX_HCP5_CANFD01_066e79fd_Tx: ComBitPosition=384, ComBitSize=8, ComSignalDataInvalidValue=255, ComSignalInitValue=254, ComSignalType=UINT8, ComHandleId=57, ComSystemTemplateSystemSignalRef=BMC_CMC_Temperatur_047
        BMC_CMC_Temperatur_050_XIX_BMC_CMC_Temperatur_01_XIX_HCP5_CANFD01_7320f89f_Tx: ComBitPosition=408, ComBitSize=8, ComSignalDataInvalidValue=255, ComSignalInitValue=254, ComSignalType=UINT8, ComHandleId=60, ComSystemTemplateSystemSignalRef=BMC_CMC_Temperatur_050
      UI2Sens01_CALID_02_XIX_BMC_CAN01_e2b448f9_Rx (ComIPdu):
        ComIPduDirection = RECEIVE
        ComIPduType = NORMAL
        ComIPduHandleId = 51
        ComIPduSignalProcessing = DEFERRED
        ComIPduCancellationSupport = false
        ComIPduGroupRef = BMC_HV_XIX_BMC_CAN01_Rx_7b388810
        ComIPduSignalRef = UI2Sens01_CALID_Index_09_XIX_UI2Sens01_CALID_02_XIX_BMC_CAN01_d6d62f01_Rx
        ComIPduSignalRef = UI2Sens01_CALID_Index_10_XIX_UI2Sens01_CALID_02_XIX_BMC_CAN01_a2b623dc_Rx
        ComIPduSignalRef = UI2Sens01_CALID_Index_11_XIX_UI2Sens01_CALID_02_XIX_BMC_CAN01_2f3ede3e_Rx
        ComIPduSignalRef = UI2Sens01_CALID_Index_12_XIX_UI2Sens01_CALID_02_XIX_BMC_CAN01_62d6de59_Rx
        ComIPduSignalRef = UI2Sens01_CALID_Index_13_XIX_UI2Sens01_CALID_02_XIX_BMC_CAN01_ef5e23bb_Rx
        ComIPduSignalRef = UI2Sens01_CALID_Index_14_XIX_UI2Sens01_CALID_02_XIX_BMC_CAN01_f906de97_Rx
        ComIPduSignalRef = UI2Sens01_CALID_Index_15_XIX_UI2Sens01_CALID_02_XIX_BMC_CAN01_748e2375_Rx
        ComIPduSignalRef = UI2Sens01_CALID_Index_16_XIX_UI2Sens01_CALID_02_XIX_BMC_CAN01_39662312_Rx
        ComPduIdRef = UI2Sens01_CALID_02_XIX_BMC_CAN01_e2b448f9_Rx
        ComIPduMainFunctionRef = ComMainFunctionRx
      4 x ComSignal, all with ComSignalEndianness=LITTLE_ENDIAN, ComSignalAccess=ACCESS_UNCLEAR:
        UI1_KompFehlerModus2_06_XIX_UI1_Komponentenfehler_01_XIX_BMC_CAN01_e2617e81_Rx: ComBitPosition=22, ComBitSize=2, ComSignalInitValue=0, ComSignalType=UINT8, ComTimeout=1, ComHandleId=356, ComSystemTemplateSystemSignalRef=UI1_KompFehlerModus2_06
        UI1_KompFehlerModus4_08_XIX_UI1_Komponentenfehler_02_XIX_BMC_CAN01_29bb7dfa_Rx: ComBitPosition=33, ComBitSize=3, ComSignalInitValue=0, ComSignalType=UINT8, ComTimeout=1, ComHandleId=384, ComSystemTemplateSystemSignalRef=UI1_KompFehlerModus4_08
        BMC_CMC_Zellspannung_171_XIX_BMC_CMC_Zellspannung_05_XIX_HCP5_CANFD01_4d9ac59a_Tx: ComBitPosition=180, ComBitSize=12, ComSignalDataInvalidValue=4095, ComSignalInitValue=4094, ComSignalType=UINT16, ComTransferProperty=PENDING, ComHandleId=282, ComSystemTemplateSystemSignalRef=BMC_CMC_Zellspannung_171
        BMC_CMC_Temperatur_057_XIX_BMC_CMC_Temperatur_01_XIX_HCP5_CANFD01_a5f851b1_Tx: ComBitPosition=464, ComBitSize=8, ComSignalDataInvalidValue=255, ComSignalInitValue=254, ComSignalType=UINT8, ComTransferProperty=PENDING, ComHandleId=67, ComSystemTemplateSystemSignalRef=BMC_CMC_Temperatur_057
      SG_UI2_02_XIX_BMC_CAN01_36658181_Rx (ComSignalGroup):
        ComTransferProperty = TRIGGERED_WITHOUT_REPETITION
        ComSignalGroupAccess = ACCESS_UNCLEAR
        ComHandleId = 14
        ComSystemTemplateSignalGroupRef = SG_UI2_02_XIX_BMC_CAN01
        8 x ComGroupSignal, all with ComSignalEndianness=LITTLE_ENDIAN, ComSignalAccess=ACCESS_UNCLEAR:
          UI2_Spannung2_XIX_UI2_02_XIX_BMC_CAN01_2db1410f_Rx: ComBitPosition=27, ComBitSize=15, ComSignalDataInvalidValue=32767, ComSignalInitValue=32766, ComSignalType=UINT16, ComHandleId=321, ComSystemTemplateSystemSignalRef=UI2_Spannung2
          UI2_Spannung2_Schalt_Status_XIX_UI2_02_XIX_BMC_CAN01_bf263033_Rx: ComBitPosition=60, ComBitSize=3, ComSignalDataInvalidValue=7, ComSignalInitValue=6, ComSignalType=UINT8, ComHandleId=320, ComSystemTemplateSystemSignalRef=UI2_Spannung2_Schalt_Status
          UI2_Spannung1_XIX_UI2_02_XIX_BMC_CAN01_dfe6acf7_Rx: ComBitPosition=12, ComBitSize=15, ComSignalDataInvalidValue=32767, ComSignalInitValue=32766, ComSignalType=UINT16, ComHandleId=319, ComSystemTemplateSystemSignalRef=UI2_Spannung1
          UI2_Spannung3_XIX_UI2_02_XIX_BMC_CAN01_caace798_Rx: ComBitPosition=42, ComBitSize=15, ComSignalDataInvalidValue=32767, ComSignalInitValue=32766, ComSignalType=UINT16, ComHandleId=322, ComSystemTemplateSystemSignalRef=UI2_Spannung3
          UISensorPyro_02_CRC_XIX_UI2_02_XIX_BMC_CAN01_f65a3c19_Rx: ComBitPosition=0, ComBitSize=8, ComSignalInitValue=0, ComSignalType=UINT8, ComHandleId=324, ComSystemTemplateSystemSignalRef=UISensorPyro_02_CRC
          UI2_Spannung1_Schalt_Status_XIX_UI2_02_XIX_BMC_CAN01_959a80bb_Rx: ComBitPosition=57, ComBitSize=3, ComSignalDataInvalidValue=7, ComSignalInitValue=6, ComSignalType=UINT8, ComHandleId=318, ComSystemTemplateSystemSignalRef=UI2_Spannung1_Schalt_Status
          UISensorPyro_02_BZ_XIX_UI2_02_XIX_BMC_CAN01_f4350d49_Rx: ComBitPosition=8, ComBitSize=4, ComSignalInitValue=0, ComSignalType=UINT8, ComHandleId=323, ComSystemTemplateSystemSignalRef=UISensorPyro_02_BZ
          ISignalVoid_UI2_02_XIX_BMC_CAN01_0_95aed8a3_Rx: ComBitPosition=63, ComBitSize=1, ComSignalType=UINT8, ComSignalInitValue=0, ComHandleId=317, ComSystemTemplateSystemSignalRef=SignalVoid_UI2_02_0
      BMC_CMC_Temperatur_042_XIX_BMC_CMC_Temperatur_01_XIX_HCP5_CANFD01_84e6a017_Tx (ComSignal):
        ComBitPosition = 344
        ComBitSize = 8
        ComSignalDataInvalidValue = 255
        ComSignalEndianness = LITTLE_ENDIAN
        ComSignalInitValue = 254
        ComSignalType = UINT8
        ComTransferProperty = PENDING
        ComSignalAccess = ACCESS_UNCLEAR
        ComHandleId = 52
        ComSystemTemplateSystemSignalRef = BMC_CMC_Temperatur_042
      BMC_HV_05_XIX_HCP5_CANFD01_086b7dd9_Tx (ComIPdu):
        ComIPduDirection = SEND
        ComIPduType = NORMAL
        ComIPduHandleId = 12
        ComIPduSignalProcessing = DEFERRED
        ComIPduCancellationSupport = false
        ComIPduGroupRef = BMC_HV_XIX_HCP5_CANFD01_Tx_3ba05bd9
        ComIPduGroupRef = BMC_HV_XIX_PNC_26_HighVoltage_Charging_Tx_20012544
        ComIPduSignalRef = BMC_Rekuperation_Ueberlauf_XIX_BMC_HV_05_XIX_HCP5_CANFD01_34ba06c8_Tx
        ComIPduSignalRef = BMC_Rekuperation_XIX_BMC_HV_05_XIX_HCP5_CANFD01_0550c77c_Tx
        ComIPduSignalRef = BMC_Verbrauch_Ueberlauf_XIX_BMC_HV_05_XIX_HCP5_CANFD01_3d34bbf6_Tx
        ComIPduSignalRef = BMC_Verbrauch_XIX_BMC_HV_05_XIX_HCP5_CANFD01_8e72d45b_Tx
        ComPduIdRef = BMC_HV_05_XIX_HCP5_CANFD01_086b7dd9_Tx
        ComIPduMainFunctionRef = ComMainFunctionTx
        ComTxIPdu: ComTxIPduUnusedAreasDefault=0, ComMinimumDelayTime=0
          ComTxModeTrue
            ComTxMode: ComTxModeMode=PERIODIC, ComTxModeTimeOffset=0, ComTxModeTimePeriod=0.05
          ComTxModeFalse
            ComTxMode: ComTxModeMode=NONE
      20 x ComSignal, all with ComSignalEndianness=LITTLE_ENDIAN, ComSignalAccess=ACCESS_UNCLEAR:
        BMC_Dauer_Ladeleistung_02_XIX_BMC_HV_09_XIX_HCP5_CANFD01_1af3699d_Tx: ComBitPosition=84, ComBitSize=14, ComSignalDataInvalidValue=16383, ComSignalInitValue=16382, ComSignalType=UINT16, ComTransferProperty=PENDING, ComHandleId=306, ComSystemTemplateSystemSignalRef=BMC_Dauer_Ladeleistung_02
        BMC_CMC_Zellspannung_090_XIX_BMC_CMC_Zellspannung_03_XIX_HCP5_CANFD01_50d364e5_Tx: ComBitPosition=144, ComBitSize=12, ComSignalDataInvalidValue=4095, ComSignalInitValue=4094, ComSignalType=UINT16, ComTransferProperty=PENDING, ComHandleId=201, ComSystemTemplateSystemSignalRef=BMC_CMC_Zellspannung_090
        BMC_CMC_Zellspannung_182_XIX_BMC_CMC_Zellspannung_05_XIX_HCP5_CANFD01_f5f408ff_Tx: ComBitPosition=312, ComBitSize=12, ComSignalDataInvalidValue=4095, ComSignalInitValue=4094, ComSignalType=UINT16, ComTransferProperty=PENDING, ComHandleId=293, ComSystemTemplateSystemSignalRef=BMC_CMC_Zellspannung_182
        BMC_CMC_Temperatur_076_XIX_BMC_CMC_Temperatur_03_XIX_HCP5_CANFD01_16595489_Tx: ComBitPosition=40, ComBitSize=8, ComSignalDataInvalidValue=255, ComSignalInitValue=254, ComSignalType=UINT8, ComTransferProperty=PENDING, ComHandleId=86, ComSystemTemplateSystemSignalRef=BMC_CMC_Temperatur_076
        MM_PropulsionSystemActive_XIX_OBD_04_XIX_HCP5_CANFD01_e1fc58e2_Rx: ComBitPosition=24, ComBitSize=1, ComSignalInitValue=0, ComSignalType=UINT8, ComTimeout=3.2, ComHandleId=156, ComSystemTemplateSystemSignalRef=MM_PropulsionSystemActive
        BMC_CMC_Temperatur_058_XIX_BMC_CMC_Temperatur_01_XIX_HCP5_CANFD01_f9103dce_Tx: ComBitPosition=472, ComBitSize=8, ComSignalDataInvalidValue=255, ComSignalInitValue=254, ComSignalType=UINT8, ComTransferProperty=PENDING, ComHandleId=68, ComSystemTemplateSystemSignalRef=BMC_CMC_Temperatur_058
        UI1_KompFehlerModus2_19_XIX_UI1_Komponentenfehler_01_XIX_BMC_CAN01_1d1f3ab2_Rx: ComBitPosition=48, ComBitSize=2, ComSignalInitValue=0, ComSignalType=UINT8, ComTimeout=1, ComHandleId=369, ComSystemTemplateSystemSignalRef=UI1_KompFehlerModus2_19
        VIN_2_XIX_WFS_02_XIX_HCP5_CANFD01_df39e5f8_Rx: ComBitPosition=24, ComBitSize=8, ComSignalInitValue=45, ComSignalType=UINT8, ComTimeout=4, ComHandleId=494, ComSystemTemplateSystemSignalRef=VIN_2
        BMC_CMC_Zellspannung_147_XIX_BMC_CMC_Zellspannung_04_XIX_HCP5_CANFD01_c28731ff_Tx: ComBitPosition=360, ComBitSize=12, ComSignalDataInvalidValue=4095, ComSignalInitValue=4094, ComSignalType=UINT16, ComTransferProperty=PENDING, ComHandleId=258, ComSystemTemplateSystemSignalRef=BMC_CMC_Zellspannung_147
        BMC_CMC_Zellspannung_153_XIX_BMC_CMC_Zellspannung_04_XIX_HCP5_CANFD01_8fa95297_Tx: ComBitPosition=432, ComBitSize=12, ComSignalDataInvalidValue=4095, ComSignalInitValue=4094, ComSignalType=UINT16, ComTransferProperty=PENDING, ComHandleId=264, ComSystemTemplateSystemSignalRef=BMC_CMC_Zellspannung_153
        OBD_ClearMem_Inhibit_XIX_OBD_04_XIX_HCP5_CANFD01_6714a457_Rx: ComBitPosition=20, ComBitSize=1, ComSignalInitValue=0, ComSignalType=UINT8, ComTimeout=3.2, ComHandleId=163, ComSystemTemplateSystemSignalRef=OBD_ClearMem_Inhibit
        UI1_KompFehlerModus2_20_XIX_UI1_Komponentenfehler_01_XIX_BMC_CAN01_82ccb914_Rx: ComBitPosition=50, ComBitSize=2, ComSignalInitValue=0, ComSignalType=UINT8, ComTimeout=1, ComHandleId=370, ComSystemTemplateSystemSignalRef=UI1_KompFehlerModus2_20
        BJB_CALID_Index_01_XIX_BJB_CALID_01_XIX_BMC_CAN01_14e77ef7_Rx: ComBitPosition=0, ComBitSize=8, ComSignalInitValue=63, ComSignalType=UINT8, ComTimeout=5, ComHandleId=1, ComSystemTemplateSystemSignalRef=BJB_CALID_Index_01
        UI2_KompFehlerModus4_05_XIX_UI2_Komponentenfehler_02_XIX_BMC_CAN01_0fcd6a41_Rx: ComBitPosition=24, ComBitSize=3, ComSignalInitValue=0, ComSignalType=UINT8, ComTimeout=1, ComHandleId=475, ComSystemTemplateSystemSignalRef=UI2_KompFehlerModus4_05
        DCDC_NV_Komponentenfehler_3_1_XIX_DCDC_NV_Komponentenfehler_04_XIX_HCP5_CANFD01_4d423624_Rx: ComBitPosition=0, ComBitSize=3, ComSignalInitValue=0, ComSignalType=UINT8, ComTimeout=5, ComHandleId=46, ComSystemTemplateSystemSignalRef=DCDC_NV_Komponentenfehler_3_1
        VIN_17_XIX_WFS_02_XIX_HCP5_CANFD01_7f2ee732_Rx: ComBitPosition=144, ComBitSize=8, ComSignalInitValue=45, ComSignalType=UINT8, ComTimeout=4, ComHandleId=509, ComSystemTemplateSystemSignalRef=VIN_17
        BMC_CMC_Zellspannung_019_XIX_BMC_CMC_Zellspannung_01_XIX_HCP5_CANFD01_9f4a1345_Tx: ComBitPosition=228, ComBitSize=12, ComSignalDataInvalidValue=4095, ComSignalInitValue=4094, ComSignalType=UINT16, ComTransferProperty=PENDING, ComHandleId=130, ComSystemTemplateSystemSignalRef=BMC_CMC_Zellspannung_019
        BMC_PCM_VTD_RecentReset_Req_XIX_BMC_HV_14_XIX_HCP5_CANFD01_827fd905_Tx: ComBitPosition=76, ComBitSize=2, ComSignalDataInvalidValue=3, ComSignalInitValue=2, ComSignalType=UINT8, ComTransferProperty=PENDING, ComHandleId=333, ComSystemTemplateSystemSignalRef=BMC_PCM_VTD_RecentReset_Req
        UI1_KompFehlerModus4_11_XIX_UI1_Komponentenfehler_02_XIX_BMC_CAN01_2a35a885_Rx: ComBitPosition=42, ComBitSize=3, ComSignalInitValue=0, ComSignalType=UINT8, ComTimeout=1, ComHandleId=387, ComSystemTemplateSystemSignalRef=UI1_KompFehlerModus4_11
        UI2_Stromintegral_Laden_XIX_UI2_04_XIX_BMC_CAN01_01ef1f59_Rx: ComBitPosition=16, ComBitSize=16, ComSignalDataInvalidValue=65535, ComSignalInitValue=65534, ComSignalType=UINT16, ComTimeout=1, ComHandleId=489, ComSystemTemplateSystemSignalRef=UI2_Stromintegral_Laden
      HVLM_13_XIX_HCP5_CANFD01_f1be44f1_Rx (ComIPdu):
        ComIPduDirection = RECEIVE
        ComIPduType = NORMAL
        ComIPduHandleId = 25
        ComIPduSignalProcessing = DEFERRED
        ComIPduCancellationSupport = false
        ComIPduGroupRef = BMC_HV_XIX_HCP5_CANFD01_Rx_6dfafc5f
        ComIPduGroupRef = BMC_HV_XIX_PNC_26_HighVoltage_Charging_Rx_765b82c2
        ComIPduSignalRef = HVLM_BidiLadeModus_XIX_HVLM_13_XIX_HCP5_CANFD01_0594f11a_Rx
        ComPduIdRef = HVLM_13_XIX_HCP5_CANFD01_f1be44f1_Rx
        ComIPduMainFunctionRef = ComMainFunctionRx
      6 x ComSignal, all with ComSignalEndianness=LITTLE_ENDIAN, ComSignalAccess=ACCESS_UNCLEAR:
        UI1_KompFehlerModus2_23_XIX_UI1_Komponentenfehler_01_XIX_BMC_CAN01_fcb4f1b2_Rx: ComBitPosition=56, ComBitSize=2, ComSignalInitValue=0, ComSignalType=UINT8, ComTimeout=1, ComHandleId=373, ComSystemTemplateSystemSignalRef=UI1_KompFehlerModus2_23
        UI2_Temperatur_2_XIX_UI2_04_XIX_BMC_CAN01_25026599_Rx: ComBitPosition=56, ComBitSize=8, ComSignalDataInvalidValue=255, ComSignalInitValue=254, ComSignalType=UINT8, ComTimeout=1, ComHandleId=491, ComSystemTemplateSystemSignalRef=UI2_Temperatur_2
        BMC_MaxEnergieinhalt_XIX_BMC_HV_03_XIX_HCP5_CANFD01_bd0ef2f1_Tx: ComBitPosition=112, ComBitSize=16, ComSignalDataInvalidValue=65535, ComSignalInitValue=65534, ComSignalType=UINT16, ComTransferProperty=PENDING, ComHandleId=322, ComSystemTemplateSystemSignalRef=BMC_MaxEnergieinhalt
        BMC_CMC_Temperatur_004_XIX_BMC_CMC_Temperatur_01_XIX_HCP5_CANFD01_9bdd9aa8_Tx: ComBitPosition=40, ComBitSize=8, ComSignalDataInvalidValue=255, ComSignalInitValue=254, ComSignalType=UINT8, ComTransferProperty=PENDING, ComHandleId=14, ComSystemTemplateSystemSignalRef=BMC_CMC_Temperatur_004
        BMC_CMC_Zellspannung_038_XIX_BMC_CMC_Zellspannung_01_XIX_HCP5_CANFD01_32719e1c_Tx: ComBitPosition=456, ComBitSize=12, ComSignalDataInvalidValue=4095, ComSignalInitValue=4094, ComSignalType=UINT16, ComTransferProperty=PENDING, ComHandleId=149, ComSystemTemplateSystemSignalRef=BMC_CMC_Zellspannung_038
        BMC_CMC_Zellspannung_100_XIX_BMC_CMC_Zellspannung_03_XIX_HCP5_CANFD01_f931d4f6_Tx: ComBitPosition=264, ComBitSize=12, ComSignalDataInvalidValue=4095, ComSignalInitValue=4094, ComSignalType=UINT16, ComTransferProperty=PENDING, ComHandleId=211, ComSystemTemplateSystemSignalRef=BMC_CMC_Zellspannung_100
      ELF_06_XIX_HCP5_CANFD01_d78b945c_Rx (ComIPdu):
        ComIPduDirection = RECEIVE
        ComIPduType = NORMAL
        ComIPduHandleId = 21
        ComIPduSignalProcessing = DEFERRED
        ComIPduCancellationSupport = false
        ComIPduGroupRef = BMC_HV_XIX_HCP5_CANFD01_Rx_6dfafc5f
        ComIPduGroupRef = BMC_HV_XIX_PNC_26_HighVoltage_Charging_Rx_765b82c2
        ComIPduSignalRef = HVLM_BCAM_Aktiv_XIX_ELF_06_XIX_HCP5_CANFD01_9b6861e7_Rx
        ComPduIdRef = ELF_06_XIX_HCP5_CANFD01_d78b945c_Rx
        ComIPduMainFunctionRef = ComMainFunctionRx
      8 x ComSignal, all with ComSignalEndianness=LITTLE_ENDIAN, ComSignalType=UINT8, ComSignalAccess=ACCESS_UNCLEAR:
        DCDC_NV_Komponentenfehler_09_XIX_DCDC_NV_Komponentenfehler_01_XIX_HCP5_CANFD01_331acb0c_Rx: ComBitPosition=16, ComBitSize=2, ComSignalInitValue=0, ComTimeout=5, ComHandleId=70, ComSystemTemplateSystemSignalRef=DCDC_NV_Komponentenfehler_09
        BMC_CMC_Temperatur_089_XIX_BMC_CMC_Temperatur_03_XIX_HCP5_CANFD01_8a57bc37_Tx: ComBitPosition=144, ComBitSize=8, ComSignalDataInvalidValue=255, ComSignalInitValue=254, ComTransferProperty=PENDING, ComHandleId=99, ComSystemTemplateSystemSignalRef=BMC_CMC_Temperatur_089
        BJB_CVN_Byte_2_XIX_BJB_CVN_01_XIX_BMC_CAN01_5c24482f_Rx: ComBitPosition=9, ComBitSize=8, ComSignalInitValue=0, ComTimeout=5, ComHandleId=18, ComSystemTemplateSystemSignalRef=BJB_CVN_Byte_2
        UI2_KompFehlerModus4_15_XIX_UI2_Komponentenfehler_02_XIX_BMC_CAN01_ac5b420d_Rx: ComBitPosition=54, ComBitSize=3, ComSignalInitValue=0, ComTimeout=1, ComHandleId=485, ComSystemTemplateSystemSignalRef=UI2_KompFehlerModus4_15
        UI2Sens02_CALID_Index_15_XIX_UI2Sens02_CALID_02_XIX_BMC_CAN01_aff95a9e_Rx: ComBitPosition=48, ComBitSize=8, ComSignalInitValue=63, ComTimeout=5, ComHandleId=437, ComSystemTemplateSystemSignalRef=UI2Sens02_CALID_Index_15
        DCDC_NV_Komponentenfehler_59_XIX_DCDC_NV_Komponentenfehler_02_XIX_HCP5_CANFD01_cc121c16_Rx: ComBitPosition=58, ComBitSize=2, ComSignalInitValue=0, ComTimeout=5, ComHandleId=120, ComSystemTemplateSystemSignalRef=DCDC_NV_Komponentenfehler_59
        DCDC_NV_Komponentenfehler_61_XIX_DCDC_NV_Komponentenfehler_03_XIX_HCP5_CANFD01_7e572d3d_Rx: ComBitPosition=0, ComBitSize=2, ComSignalInitValue=0, ComTimeout=5, ComHandleId=122, ComSystemTemplateSystemSignalRef=DCDC_NV_Komponentenfehler_61
        Hybrid_01_Indc_StFail_XIX_OBD_Hybrid_01_XIX_HCP5_CANFD01_6c961b98_Tx: ComBitPosition=5, ComBitSize=1, ComSignalInitValue=0, ComTransferProperty=PENDING, ComHandleId=402, ComSystemTemplateSystemSignalRef=Hybrid_01_Indc_StFail
      Diagnose_01_XIX_HCP5_CANFD01_426f0ab5_Rx (ComIPdu):
        ComIPduDirection = RECEIVE
        ComIPduType = NORMAL
        ComIPduHandleId = 20
        ComIPduSignalProcessing = DEFERRED
        ComIPduCancellationSupport = false
        ComIPduGroupRef = BMC_HV_XIX_HCP5_CANFD01_Rx_6dfafc5f
        ComIPduGroupRef = BMC_HV_XIX_PNC_07_Basefunction_CrossSection_Rx_4fb7c882
        ComIPduGroupRef = BMC_HV_XIX_PNC_27_Timemaster_Timer_Rx_2db6b092
        ComIPduSignalRef = DW_Kilometerstand_XIX_Diagnose_01_XIX_HCP5_CANFD01_78853316_Rx
        ComIPduSignalRef = UH_Jahr_XIX_Diagnose_01_XIX_HCP5_CANFD01_d17ea5cb_Rx
        ComIPduSignalRef = UH_Minute_XIX_Diagnose_01_XIX_HCP5_CANFD01_a1eb26ec_Rx
        ComIPduSignalRef = UH_Monat_XIX_Diagnose_01_XIX_HCP5_CANFD01_f93e0419_Rx
        ComIPduSignalRef = UH_Sekunde_XIX_Diagnose_01_XIX_HCP5_CANFD01_7411385f_Rx
        ComIPduSignalRef = UH_Stunde_XIX_Diagnose_01_XIX_HCP5_CANFD01_7d2acaf0_Rx
        ComIPduSignalRef = UH_Tag_XIX_Diagnose_01_XIX_HCP5_CANFD01_743028a3_Rx
        ComPduIdRef = Diagnose_01_XIX_HCP5_CANFD01_426f0ab5_Rx
        ComIPduMainFunctionRef = ComMainFunctionRx
      5 x ComSignal, all with ComSignalEndianness=LITTLE_ENDIAN, ComSignalAccess=ACCESS_UNCLEAR:
        BMC_Pack_SN_20_XIX_BMC_HV_08_XIX_HCP5_CANFD01_450bc9d7_Tx: ComBitPosition=216, ComBitSize=8, ComSignalInitValue=255, ComSignalType=UINT8, ComTransferProperty=PENDING, ComHandleId=353, ComSystemTemplateSystemSignalRef=BMC_Pack_SN_20
        BMC_Pack_SN_14_XIX_BMC_HV_08_XIX_HCP5_CANFD01_6f9662e8_Tx: ComBitPosition=168, ComBitSize=8, ComSignalInitValue=255, ComSignalType=UINT8, ComTransferProperty=PENDING, ComHandleId=347, ComSystemTemplateSystemSignalRef=BMC_Pack_SN_14
        BMC_CMC_Zellspannung_086_XIX_BMC_CMC_Zellspannung_03_XIX_HCP5_CANFD01_e26e30ab_Tx: ComBitPosition=96, ComBitSize=12, ComSignalDataInvalidValue=4095, ComSignalInitValue=4094, ComSignalType=UINT16, ComTransferProperty=PENDING, ComHandleId=197, ComSystemTemplateSystemSignalRef=BMC_CMC_Zellspannung_086
        DCDC_NV_Komponentenfehler_52_XIX_DCDC_NV_Komponentenfehler_02_XIX_HCP5_CANFD01_ae628d3f_Rx: ComBitPosition=44, ComBitSize=2, ComSignalInitValue=0, ComSignalType=UINT8, ComTimeout=5, ComHandleId=113, ComSystemTemplateSystemSignalRef=DCDC_NV_Komponentenfehler_52
        UI2Sens01_CALID_Index_02_XIX_UI2Sens01_CALID_01_XIX_BMC_CAN01_3d22bf89_Rx: ComBitPosition=8, ComBitSize=8, ComSignalInitValue=63, ComSignalType=UINT8, ComTimeout=5, ComHandleId=402, ComSystemTemplateSystemSignalRef=UI2Sens01_CALID_Index_02
      BMC_HV_09_XIX_HCP5_CANFD01_149204d3_Tx (ComIPdu):
        ComIPduDirection = SEND
        ComIPduType = NORMAL
        ComIPduHandleId = 16
        ComIPduSignalProcessing = DEFERRED
        ComIPduCancellationSupport = false
        ComIPduGroupRef = BMC_HV_XIX_HCP5_CANFD01_Tx_3ba05bd9
        ComIPduGroupRef = BMC_HV_XIX_PNC_26_HighVoltage_Charging_Tx_20012544
        ComIPduSignalRef = BMC_Dauer_Entladeleistung_02_XIX_BMC_HV_09_XIX_HCP5_CANFD01_c6e0343a_Tx
        ComIPduSignalRef = BMC_Dauer_Ladeleistung_02_XIX_BMC_HV_09_XIX_HCP5_CANFD01_1af3699d_Tx
        ComIPduSignalRef = BMC_Max_Entladeleistung_02_XIX_BMC_HV_09_XIX_HCP5_CANFD01_a2b30339_Tx
        ComIPduSignalRef = BMC_Max_Entladestrom_02_XIX_BMC_HV_09_XIX_HCP5_CANFD01_af177205_Tx
        ComIPduSignalRef = BMC_Max_Ladeleistung_02_XIX_BMC_HV_09_XIX_HCP5_CANFD01_a9e1b473_Tx
        ComIPduSignalRef = BMC_Max_Ladestrom_02_XIX_BMC_HV_09_XIX_HCP5_CANFD01_e47fe8b0_Tx
        ComPduIdRef = BMC_HV_09_XIX_HCP5_CANFD01_149204d3_Tx
        ComIPduMainFunctionRef = ComMainFunctionTx
        ComTxIPdu: ComTxIPduUnusedAreasDefault=0, ComMinimumDelayTime=0
          ComTxModeTrue
            ComTxMode: ComTxModeMode=PERIODIC, ComTxModeTimeOffset=0, ComTxModeTimePeriod=0.1
          ComTxModeFalse
            ComTxMode: ComTxModeMode=NONE
      6 x ComSignal, all with ComSignalEndianness=LITTLE_ENDIAN, ComSignalAccess=ACCESS_UNCLEAR:
        BMC_CMC_Zellspannung_077_XIX_BMC_CMC_Zellspannung_02_XIX_HCP5_CANFD01_4ac17c09_Tx: ComBitPosition=456, ComBitSize=12, ComSignalDataInvalidValue=4095, ComSignalInitValue=4094, ComSignalType=UINT16, ComTransferProperty=PENDING, ComHandleId=188, ComSystemTemplateSystemSignalRef=BMC_CMC_Zellspannung_077
        DCDC_NV_Komponentenfehler_03_XIX_DCDC_NV_Komponentenfehler_01_XIX_HCP5_CANFD01_9b54a9b6_Rx: ComBitPosition=4, ComBitSize=2, ComSignalInitValue=0, ComSignalType=UINT8, ComTimeout=5, ComHandleId=64, ComSystemTemplateSystemSignalRef=DCDC_NV_Komponentenfehler_03
        DCDC_NV_Komponentenfehler_56_XIX_DCDC_NV_Komponentenfehler_02_XIX_HCP5_CANFD01_307b4ff1_Rx: ComBitPosition=52, ComBitSize=2, ComSignalInitValue=0, ComSignalType=UINT8, ComTimeout=5, ComHandleId=117, ComSystemTemplateSystemSignalRef=DCDC_NV_Komponentenfehler_56
        BMC_CMC_Zellspannung_137_XIX_BMC_CMC_Zellspannung_04_XIX_HCP5_CANFD01_07990785_Tx: ComBitPosition=240, ComBitSize=12, ComSignalDataInvalidValue=4095, ComSignalInitValue=4094, ComSignalType=UINT16, ComTransferProperty=PENDING, ComHandleId=248, ComSystemTemplateSystemSignalRef=BMC_CMC_Zellspannung_137
        BMC_RtmWarnPackKommunikation_XIX_BMC_HV_08_XIX_HCP5_CANFD01_49192821_Tx: ComBitPosition=25, ComBitSize=3, ComSignalInitValue=0, ComSignalType=UINT8, ComTransferProperty=PENDING, ComHandleId=364, ComSystemTemplateSystemSignalRef=BMC_RtmWarnPackKommunikation
        UI2_Temperatur_1_XIX_UI2_04_XIX_BMC_CAN01_d7558861_Rx: ComBitPosition=48, ComBitSize=8, ComSignalDataInvalidValue=255, ComSignalInitValue=254, ComSignalType=UINT8, ComTimeout=1, ComHandleId=490, ComSystemTemplateSystemSignalRef=UI2_Temperatur_1
      OTAMC_D_01_XIX_HCP5_CANFD01_E2E_c199b3e6_Rx (ComIPdu):
        ComIPduDirection = RECEIVE
        ComIPduType = NORMAL
        ComIPduHandleId = 37
        ComIPduSignalProcessing = DEFERRED
        ComIPduCancellationSupport = false
        ComIPduGroupRef = BMC_HV_XIX_HCP5_CANFD01_Rx_6dfafc5f
        ComIPduGroupRef = BMC_HV_XIX_PNC_02_Basefunction_Powertrain_Rx_dc518468
        ComIPduSignalGroupRef = SG_OTAMC_D_01_XIX_HCP5_CANFD01_e331bc6d_Rx
        ComPduIdRef = OTAMC_D_01_XIX_HCP5_CANFD01_E2E_c199b3e6_Rx
        ComIPduMainFunctionRef = ComMainFunctionRx
      BMC_CMC_Temperatur_02_XIX_HCP5_CANFD01_f9538f57_Tx (ComIPdu):
        ComIPduDirection = SEND
        ComIPduType = NORMAL
        ComIPduHandleId = 1
        ComIPduSignalProcessing = DEFERRED
        ComIPduCancellationSupport = false
        ComIPduGroupRef = BMC_HV_XIX_HCP5_CANFD01_Tx_3ba05bd9
        ComIPduGroupRef = BMC_HV_XIX_PNC_26_HighVoltage_Charging_Tx_20012544
        ComIPduSignalRef = BMC_CMC_Temperatur_02_Messzeit_XIX_BMC_CMC_Temperatur_02_XIX_HCP5_CANFD01_8c2bd22d_Tx
        ComIPduSignalRef = BMC_CMC_Temperatur_059_XIX_BMC_CMC_Temperatur_02_XIX_HCP5_CANFD01_39bed8ce_Tx
        ComIPduSignalRef = BMC_CMC_Temperatur_060_XIX_BMC_CMC_Temperatur_02_XIX_HCP5_CANFD01_a66d5b68_Tx
        ComIPduSignalRef = BMC_CMC_Temperatur_061_XIX_BMC_CMC_Temperatur_02_XIX_HCP5_CANFD01_8c45630a_Tx
        ComIPduSignalRef = BMC_CMC_Temperatur_062_XIX_BMC_CMC_Temperatur_02_XIX_HCP5_CANFD01_f23d2bac_Tx
        ComIPduSignalRef = BMC_CMC_Temperatur_063_XIX_BMC_CMC_Temperatur_02_XIX_HCP5_CANFD01_d81513ce_Tx
        ComIPduSignalRef = BMC_CMC_Temperatur_064_XIX_BMC_CMC_Temperatur_02_XIX_HCP5_CANFD01_0ecdbae0_Tx
        ComIPduSignalRef = BMC_CMC_Temperatur_065_XIX_BMC_CMC_Temperatur_02_XIX_HCP5_CANFD01_24e58282_Tx
        ComIPduSignalRef = BMC_CMC_Temperatur_066_XIX_BMC_CMC_Temperatur_02_XIX_HCP5_CANFD01_5a9dca24_Tx
        ComIPduSignalRef = BMC_CMC_Temperatur_067_XIX_BMC_CMC_Temperatur_02_XIX_HCP5_CANFD01_70b5f246_Tx
        ComIPduSignalRef = BMC_CMC_Temperatur_068_XIX_BMC_CMC_Temperatur_02_XIX_HCP5_CANFD01_2c5d9e39_Tx
        ComIPduSignalRef = BMC_CMC_Temperatur_069_XIX_BMC_CMC_Temperatur_02_XIX_HCP5_CANFD01_0675a65b_Tx
        ComIPduSignalRef = BMC_CMC_Temperatur_070_XIX_BMC_CMC_Temperatur_02_XIX_HCP5_CANFD01_05fb7324_Tx
        ComIPduSignalRef = BMC_CMC_Temperatur_071_XIX_BMC_CMC_Temperatur_02_XIX_HCP5_CANFD01_2fd34b46_Tx
        ComIPduSignalRef = BMC_CMC_Temperatur_072_XIX_BMC_CMC_Temperatur_02_XIX_HCP5_CANFD01_51ab03e0_Tx
        ComPduIdRef = BMC_CMC_Temperatur_02_XIX_HCP5_CANFD01_f9538f57_Tx
        ComIPduMainFunctionRef = ComMainFunctionTx
        ComTxIPdu: ComTxIPduUnusedAreasDefault=0, ComMinimumDelayTime=0
          ComTxModeTrue
            ComTxMode: ComTxModeMode=PERIODIC, ComTxModeTimeOffset=0, ComTxModeTimePeriod=1
          ComTxModeFalse
            ComTxMode: ComTxModeMode=NONE
      UI2Sens01_CALID_Index_09_XIX_UI2Sens01_CALID_02_XIX_BMC_CAN01_d6d62f01_Rx (ComSignal):
        ComBitPosition = 0
        ComBitSize = 8
        ComSignalEndianness = LITTLE_ENDIAN
        ComSignalInitValue = 63
        ComSignalType = UINT8
        ComTimeout = 5
        ComSignalAccess = ACCESS_UNCLEAR
        ComHandleId = 409
        ComSystemTemplateSystemSignalRef = UI2Sens01_CALID_Index_09
      OBDProtocol_Hybrid_01_XIX_OBD_Hybrid_01_XIX_HCP5_CANFD01_aa11071d_Tx (ComSignal):
        ComBitPosition = 0
        ComBitSize = 4
        ComSignalDataInvalidValue = 15
        ComSignalEndianness = LITTLE_ENDIAN
        ComSignalInitValue = 14
        ComSignalType = UINT8
        ComTransferProperty = PENDING
        ComSignalAccess = ACCESS_UNCLEAR
        ComHandleId = 432
        ComSystemTemplateSystemSignalRef = OBDProtocol_Hybrid_01
      DEV_Hybrid_01_Resp_FF_XIX_HCP5_CANFD01_7b20ac63_Tx (ComIPdu):
        ComIPduDirection = SEND
        ComIPduType = NORMAL
        ComIPduHandleId = 22
        ComIPduSignalProcessing = DEFERRED
        ComIPduCancellationSupport = false
        ComIPduGroupRef = BMC_HV_XIX_HCP5_CANFD01_Tx_3ba05bd9
        ComIPduSignalRef = DEV_Hybrid_01_Resp_FF_FD_Data_XIX_DEV_Hybrid_01_Resp_FF_XIX_HCP5_CANFD01_c5a91adf_Tx
        ComPduIdRef = DEV_Hybrid_01_Resp_FF_XIX_HCP5_CANFD01_7b20ac63_Tx
        ComIPduMainFunctionRef = ComMainFunctionTx
        ComTxIPdu: ComTxIPduUnusedAreasDefault=0, ComMinimumDelayTime=0
          ComTxModeTrue
            ComTxMode: ComTxModeMode=DIRECT, ComTxModeNumberOfRepetitions=0, ComTxModeRepetitionPeriod=0
          ComTxModeFalse
            ComTxMode: ComTxModeMode=NONE
      4 x ComSignal, all with ComSignalEndianness=LITTLE_ENDIAN, ComSignalType=UINT8, ComSignalAccess=ACCESS_UNCLEAR:
        UI2_KompFehlerModus4_14_XIX_UI2_Komponentenfehler_02_XIX_BMC_CAN01_86737a6f_Rx: ComBitPosition=51, ComBitSize=3, ComSignalInitValue=0, ComTimeout=1, ComHandleId=484, ComSystemTemplateSystemSignalRef=UI2_KompFehlerModus4_14
        BMC_PCM_VTD_LifeTimeReset_Resp_XIX_BMC_HV_14_XIX_HCP5_CANFD01_fcdaf120_Tx: ComBitPosition=74, ComBitSize=2, ComSignalDataInvalidValue=3, ComSignalInitValue=2, ComTransferProperty=PENDING, ComHandleId=332, ComSystemTemplateSystemSignalRef=BMC_PCM_VTD_LifeTimeReset_Resp
        DCDC_NV_Komponentenfehler_35_XIX_DCDC_NV_Komponentenfehler_02_XIX_HCP5_CANFD01_1a92536a_Rx: ComBitPosition=10, ComBitSize=2, ComSignalInitValue=0, ComTimeout=5, ComHandleId=96, ComSystemTemplateSystemSignalRef=DCDC_NV_Komponentenfehler_35
        DCDC_NV_Komponentenfehler_14_XIX_DCDC_NV_Komponentenfehler_01_XIX_HCP5_CANFD01_e9b38581_Rx: ComBitPosition=26, ComBitSize=2, ComSignalInitValue=0, ComTimeout=5, ComHandleId=75, ComSystemTemplateSystemSignalRef=DCDC_NV_Komponentenfehler_14
      SOK_Zeit_Hybrid_01_Chal_01_XIX_HCP5_CANFD01_5939048b_Tx (ComIPdu):
        ComIPduDirection = SEND
        ComIPduType = NORMAL
        ComIPduHandleId = 31
        ComIPduSignalProcessing = DEFERRED
        ComIPduCancellationSupport = false
        ComIPduGroupRef = BMC_HV_XIX_HCP5_CANFD01_Tx_3ba05bd9
        ComIPduSignalRef = SOK_Zeit_Hybrid_01_Challenge_XIX_SOK_Zeit_Hybrid_01_Chal_01_XIX_HCP5_CANFD01_13ac3f94_Tx
        ComPduIdRef = SOK_Zeit_Hybrid_01_Chal_01_XIX_HCP5_CANFD01_5939048b_Tx
        ComIPduMainFunctionRef = ComMainFunctionTx
        ComTxIPdu: ComMinimumDelayTime=0.1, ComTxIPduUnusedAreasDefault=0
          ComTxModeTrue
            ComTxMode: ComTxModeMode=DIRECT, ComTxModeNumberOfRepetitions=0, ComTxModeRepetitionPeriod=0
          ComTxModeFalse
            ComTxMode: ComTxModeMode=NONE
      5 x ComSignal, all with ComSignalEndianness=LITTLE_ENDIAN, ComSignalAccess=ACCESS_UNCLEAR:
        BMC_CMC_Zellspannung_126_XIX_BMC_CMC_Zellspannung_04_XIX_HCP5_CANFD01_11299773_Tx: ComBitPosition=108, ComBitSize=12, ComSignalDataInvalidValue=4095, ComSignalInitValue=4094, ComSignalType=UINT16, ComTransferProperty=PENDING, ComHandleId=237, ComSystemTemplateSystemSignalRef=BMC_CMC_Zellspannung_126
        DCDC_NV_Komponentenfehler_27_XIX_DCDC_NV_Komponentenfehler_01_XIX_HCP5_CANFD01_d6d49362_Rx: ComBitPosition=52, ComBitSize=2, ComSignalInitValue=0, ComSignalType=UINT8, ComTimeout=5, ComHandleId=88, ComSystemTemplateSystemSignalRef=DCDC_NV_Komponentenfehler_27
        BMC_CMC_Zellspannung_068_XIX_BMC_CMC_Zellspannung_02_XIX_HCP5_CANFD01_cf1b63ce_Tx: ComBitPosition=348, ComBitSize=12, ComSignalDataInvalidValue=4095, ComSignalInitValue=4094, ComSignalType=UINT16, ComTransferProperty=PENDING, ComHandleId=179, ComSystemTemplateSystemSignalRef=BMC_CMC_Zellspannung_068
        BMC_VerlustEnergie_XIX_BMC_HV_03_XIX_HCP5_CANFD01_c05628a7_Tx: ComBitPosition=92, ComBitSize=13, ComSignalDataInvalidValue=8191, ComSignalInitValue=8190, ComSignalType=UINT16, ComTransferProperty=PENDING, ComHandleId=388, ComSystemTemplateSystemSignalRef=BMC_VerlustEnergie
        NM_Hybrid_01_NM_aktiv_KL15_XIX_NMH_Hybrid_01_XIX_BMC_CAN01_7114d801_Tx: ComBitPosition=8, ComBitSize=1, ComSignalInitValue=0, ComSignalType=UINT8, ComTransferProperty=TRIGGERED, ComHandleId=420, ComSystemTemplateSystemSignalRef=NM_Hybrid_01_NM_aktiv_KL15
      BMC_HV_XIX_PNC_07_Basefunction_CrossSection_Rx_4fb7c882 (ComIPduGroup): ComIPduGroupHandleId=7
      10 x ComSignal, all with ComSignalEndianness=LITTLE_ENDIAN, ComSignalAccess=ACCESS_UNCLEAR:
        BMC_CMC_Temperatur_080_XIX_BMC_CMC_Temperatur_03_XIX_HCP5_CANFD01_2a4f4104_Tx: ComBitPosition=72, ComBitSize=8, ComSignalDataInvalidValue=255, ComSignalInitValue=254, ComSignalType=UINT8, ComTransferProperty=PENDING, ComHandleId=90, ComSystemTemplateSystemSignalRef=BMC_CMC_Temperatur_080
        BMC_CMC_Zellspannung_113_XIX_BMC_CMC_Zellspannung_03_XIX_HCP5_CANFD01_10127326_Tx: ComBitPosition=420, ComBitSize=12, ComSignalDataInvalidValue=4095, ComSignalInitValue=4094, ComSignalType=UINT16, ComTransferProperty=PENDING, ComHandleId=224, ComSystemTemplateSystemSignalRef=BMC_CMC_Zellspannung_113
        UI1_KompFehlerModus4_13_XIX_UI1_Komponentenfehler_02_XIX_BMC_CAN01_7e65d841_Rx: ComBitPosition=48, ComBitSize=3, ComSignalInitValue=0, ComSignalType=UINT8, ComTimeout=1, ComHandleId=389, ComSystemTemplateSystemSignalRef=UI1_KompFehlerModus4_13
        UI2_KompFehlerModus4_12_XIX_UI2_Komponentenfehler_02_XIX_BMC_CAN01_7a83eb23_Rx: ComBitPosition=45, ComBitSize=3, ComSignalInitValue=0, ComSignalType=UINT8, ComTimeout=1, ComHandleId=482, ComSystemTemplateSystemSignalRef=UI2_KompFehlerModus4_12
        BMC_CMC_Temperatur_069_XIX_BMC_CMC_Temperatur_02_XIX_HCP5_CANFD01_0675a65b_Tx: ComBitPosition=96, ComBitSize=8, ComSignalDataInvalidValue=255, ComSignalInitValue=254, ComSignalType=UINT8, ComTransferProperty=PENDING, ComHandleId=79, ComSystemTemplateSystemSignalRef=BMC_CMC_Temperatur_069
        BMC_CMC_Zellspannung_156_XIX_BMC_CMC_Zellspannung_04_XIX_HCP5_CANFD01_d437a109_Tx: ComBitPosition=468, ComBitSize=12, ComSignalDataInvalidValue=4095, ComSignalInitValue=4094, ComSignalType=UINT16, ComTransferProperty=PENDING, ComHandleId=267, ComSystemTemplateSystemSignalRef=BMC_CMC_Zellspannung_156
        BMC_CMC_Temperatur_020_XIX_BMC_CMC_Temperatur_01_XIX_HCP5_CANFD01_af202df9_Tx: ComBitPosition=168, ComBitSize=8, ComSignalDataInvalidValue=255, ComSignalInitValue=254, ComSignalType=UINT8, ComTransferProperty=PENDING, ComHandleId=30, ComSystemTemplateSystemSignalRef=BMC_CMC_Temperatur_020
        BMC_CMC_Temperatur_044_XIX_BMC_CMC_Temperatur_01_XIX_HCP5_CANFD01_7816315b_Tx: ComBitPosition=360, ComBitSize=8, ComSignalDataInvalidValue=255, ComSignalInitValue=254, ComSignalType=UINT8, ComTransferProperty=PENDING, ComHandleId=54, ComSystemTemplateSystemSignalRef=BMC_CMC_Temperatur_044
        BMC_CMC_Zellspannung_050_XIX_BMC_CMC_Zellspannung_02_XIX_HCP5_CANFD01_3c3eae7b_Tx: ComBitPosition=132, ComBitSize=12, ComSignalDataInvalidValue=4095, ComSignalInitValue=4094, ComSignalType=UINT16, ComTransferProperty=PENDING, ComHandleId=161, ComSystemTemplateSystemSignalRef=BMC_CMC_Zellspannung_050
        ZM_HV_Auszeit_HiRes_XIX_Zeitmaster_05_XIX_HCP5_CANFD01_2f334ec5_Rx: ComBitPosition=32, ComBitSize=16, ComSignalDataInvalidValue=65535, ComSignalInitValue=65534, ComSignalType=UINT16, ComTimeout=5, ComHandleId=510, ComSystemTemplateSystemSignalRef=ZM_HV_Auszeit_HiRes
      BJB_CALID_02_XIX_BMC_CAN01_bc93171f_Rx (ComIPdu):
        ComIPduDirection = RECEIVE
        ComIPduType = NORMAL
        ComIPduHandleId = 7
        ComIPduSignalProcessing = DEFERRED
        ComIPduCancellationSupport = false
        ComIPduGroupRef = BMC_HV_XIX_BMC_CAN01_Rx_7b388810
        ComIPduSignalRef = BJB_CALID_Index_09_XIX_BJB_CALID_02_XIX_BMC_CAN01_e68e20da_Rx
        ComIPduSignalRef = BJB_CALID_Index_10_XIX_BJB_CALID_02_XIX_BMC_CAN01_c2b281d7_Rx
        ComIPduSignalRef = BJB_CALID_Index_11_XIX_BJB_CALID_02_XIX_BMC_CAN01_3368847d_Rx
        ComIPduSignalRef = BJB_CALID_Index_12_XIX_BJB_CALID_02_XIX_BMC_CAN01_fa778cc2_Rx
        ComIPduSignalRef = BJB_CALID_Index_13_XIX_BJB_CALID_02_XIX_BMC_CAN01_0bad8968_Rx
        ComIPduSignalRef = BJB_CALID_Index_14_XIX_BJB_CALID_02_XIX_BMC_CAN01_b3389bfd_Rx
        ComIPduSignalRef = BJB_CALID_Index_15_XIX_BJB_CALID_02_XIX_BMC_CAN01_42e29e57_Rx
        ComIPduSignalRef = BJB_CALID_Index_16_XIX_BJB_CALID_02_XIX_BMC_CAN01_8bfd96e8_Rx
        ComPduIdRef = BJB_CALID_02_XIX_BMC_CAN01_bc93171f_Rx
        ComIPduMainFunctionRef = ComMainFunctionRx
      UI2_KompFehlerModus2_14_XIX_UI2_Komponentenfehler_01_XIX_BMC_CAN01_3b692d09_Rx (ComSignal):
        ComBitPosition = 38
        ComBitSize = 2
        ComSignalEndianness = LITTLE_ENDIAN
        ComSignalInitValue = 0
        ComSignalType = UINT8
        ComTimeout = 1
        ComSignalAccess = ACCESS_UNCLEAR
        ComHandleId = 458
        ComSystemTemplateSystemSignalRef = UI2_KompFehlerModus2_14
      SG_UI1_02_XIX_BMC_CAN01_dce35ce3_Rx (ComSignalGroup):
        ComTransferProperty = TRIGGERED_WITHOUT_REPETITION
        ComSignalGroupAccess = ACCESS_UNCLEAR
        ComHandleId = 12
        ComSystemTemplateSignalGroupRef = SG_UI1_02_XIX_BMC_CAN01
        8 x ComGroupSignal, all with ComSignalEndianness=LITTLE_ENDIAN, ComSignalAccess=ACCESS_UNCLEAR:
          UI1_Spannung3_XIX_UI1_02_XIX_BMC_CAN01_44ca4104_Rx: ComBitPosition=42, ComBitSize=15, ComSignalDataInvalidValue=32767, ComSignalInitValue=32766, ComSignalType=UINT16, ComHandleId=307, ComSystemTemplateSystemSignalRef=UI1_Spannung3
          ISignalVoid_UI1_02_XIX_BMC_CAN01_0_3a079569_Rx: ComBitPosition=63, ComBitSize=1, ComSignalType=UINT8, ComSignalInitValue=0, ComHandleId=302, ComSystemTemplateSystemSignalRef=SignalVoid_UI1_02_0
          UI1_Spannung1_Schalt_Status_XIX_UI1_02_XIX_BMC_CAN01_283e718b_Rx: ComBitPosition=57, ComBitSize=3, ComSignalDataInvalidValue=7, ComSignalInitValue=6, ComSignalType=UINT8, ComHandleId=303, ComSystemTemplateSystemSignalRef=UI1_Spannung1_Schalt_Status
          UI1_Spannung1_XIX_UI1_02_XIX_BMC_CAN01_51800a6b_Rx: ComBitPosition=12, ComBitSize=15, ComSignalDataInvalidValue=32767, ComSignalInitValue=32766, ComSignalType=UINT16, ComHandleId=304, ComSystemTemplateSystemSignalRef=UI1_Spannung1
          UISensorIso_02_BZ_XIX_UI1_02_XIX_BMC_CAN01_1194de97_Rx: ComBitPosition=8, ComBitSize=4, ComSignalInitValue=0, ComSignalType=UINT8, ComHandleId=308, ComSystemTemplateSystemSignalRef=UISensorIso_02_BZ
          UI1_Spannung2_Schalt_Status_XIX_UI1_02_XIX_BMC_CAN01_0282c103_Rx: ComBitPosition=60, ComBitSize=3, ComSignalDataInvalidValue=7, ComSignalInitValue=6, ComSignalType=UINT8, ComHandleId=305, ComSystemTemplateSystemSignalRef=UI1_Spannung2_Schalt_Status
          UI1_Spannung2_XIX_UI1_02_XIX_BMC_CAN01_a3d7e793_Rx: ComBitPosition=27, ComBitSize=15, ComSignalDataInvalidValue=32767, ComSignalInitValue=32766, ComSignalType=UINT16, ComHandleId=306, ComSystemTemplateSystemSignalRef=UI1_Spannung2
          UISensorIso_02_CRC_XIX_UI1_02_XIX_BMC_CAN01_de0439d2_Rx: ComBitPosition=0, ComBitSize=8, ComSignalInitValue=0, ComSignalType=UINT8, ComHandleId=309, ComSystemTemplateSystemSignalRef=UISensorIso_02_CRC
      10 x ComSignal, all with ComSignalEndianness=LITTLE_ENDIAN, ComSignalAccess=ACCESS_UNCLEAR:
        BMC_CMC_Zellspannung_043_XIX_BMC_CMC_Zellspannung_02_XIX_HCP5_CANFD01_d51d09ab_Tx: ComBitPosition=48, ComBitSize=12, ComSignalDataInvalidValue=4095, ComSignalInitValue=4094, ComSignalType=UINT16, ComTransferProperty=PENDING, ComHandleId=154, ComSystemTemplateSystemSignalRef=BMC_CMC_Zellspannung_043
        DS_Hybrid_01_WIRChanged_XIX_DS_Hybrid_01_XIX_HCP5_CANFD01_296545f7_Tx: ComBitPosition=18, ComBitSize=1, ComSignalInitValue=0, ComSignalType=UINT8, ComTransferProperty=TRIGGERED_ON_CHANGE_WITHOUT_REPETITION, ComHandleId=400, ComSystemTemplateSystemSignalRef=DS_Hybrid_01_WIRChanged
        UI2Sens02_CALID_Index_05_XIX_UI2Sens02_CALID_01_XIX_BMC_CAN01_f00d3b4e_Rx: ComBitPosition=32, ComBitSize=8, ComSignalInitValue=63, ComSignalType=UINT8, ComTimeout=5, ComHandleId=427, ComSystemTemplateSystemSignalRef=UI2Sens02_CALID_Index_05
        UI2Sens01_CVN_Byte_2_XIX_UI2Sens01_CVN_XIX_BMC_CAN01_5e075f77_Rx: ComBitPosition=9, ComBitSize=8, ComSignalInitValue=0, ComSignalType=UINT8, ComTimeout=5, ComHandleId=418, ComSystemTemplateSystemSignalRef=UI2Sens01_CVN_Byte_2
        BMC_CMC_Zellspannung_037_XIX_BMC_CMC_Zellspannung_01_XIX_HCP5_CANFD01_ded28abe_Tx: ComBitPosition=444, ComBitSize=12, ComSignalDataInvalidValue=4095, ComSignalInitValue=4094, ComSignalType=UINT16, ComTransferProperty=PENDING, ComHandleId=148, ComSystemTemplateSystemSignalRef=BMC_CMC_Zellspannung_037
        UI2_KompFehlerModus2_11_XIX_UI2_Komponentenfehler_01_XIX_BMC_CAN01_b9e1f4e3_Rx: ComBitPosition=32, ComBitSize=2, ComSignalInitValue=0, ComSignalType=UINT8, ComTimeout=1, ComHandleId=455, ComSystemTemplateSystemSignalRef=UI2_KompFehlerModus2_11
        BMC_CMC_Zellspannung_048_XIX_BMC_CMC_Zellspannung_02_XIX_HCP5_CANFD01_1de97504_Tx: ComBitPosition=108, ComBitSize=12, ComSignalDataInvalidValue=4095, ComSignalInitValue=4094, ComSignalType=UINT16, ComTransferProperty=PENDING, ComHandleId=159, ComSystemTemplateSystemSignalRef=BMC_CMC_Zellspannung_048
        VIN_3_XIX_WFS_02_XIX_HCP5_CANFD01_bc3e3cdc_Rx: ComBitPosition=32, ComBitSize=8, ComSignalInitValue=45, ComSignalType=UINT8, ComTimeout=4, ComHandleId=495, ComSystemTemplateSystemSignalRef=VIN_3
        HVLE_IstSpannung_HV_XIX_OBG_01_XIX_HCP5_CANFD01_577040d9_Rx: ComBitPosition=12, ComBitSize=10, ComSignalDataInvalidValue=1023, ComSignalInitValue=1022, ComSignalType=UINT16, ComTimeout=1, ComHandleId=151, ComSystemTemplateSystemSignalRef=HVLE_IstSpannung_HV
        UI2Sens02_CALID_Index_03_XIX_UI2Sens02_CALID_01_XIX_BMC_CAN01_6bdd3b80_Rx: ComBitPosition=16, ComBitSize=8, ComSignalInitValue=63, ComSignalType=UINT8, ComTimeout=5, ComHandleId=425, ComSystemTemplateSystemSignalRef=UI2Sens02_CALID_Index_03
      BMC_HV_XIX_PNC_13_Airbag_Rx_29234cf7 (ComIPduGroup): ComIPduGroupHandleId=10
      4 x ComSignal, all with ComSignalEndianness=LITTLE_ENDIAN, ComSignalAccess=ACCESS_UNCLEAR:
        DS_Hybrid_01_Lokalaktiv_XIX_DS_Hybrid_01_XIX_HCP5_CANFD01_8a807ec5_Tx: ComBitPosition=23, ComBitSize=1, ComSignalInitValue=0, ComSignalType=UINT8, ComTransferProperty=PENDING, ComHandleId=394, ComSystemTemplateSystemSignalRef=DS_Hybrid_01_Lokalaktiv
        DS_Hybrid_01_IdentValid_XIX_DS_Hybrid_01_XIX_HCP5_CANFD01_1ffc9aaf_Tx: ComBitPosition=22, ComBitSize=1, ComSignalInitValue=1, ComSignalType=UINT8, ComTransferProperty=TRIGGERED_ON_CHANGE_WITHOUT_REPETITION, ComHandleId=393, ComSystemTemplateSystemSignalRef=DS_Hybrid_01_IdentValid
        BMC_CMC_Temperatur_03_Messzeit_XIX_BMC_CMC_Temperatur_03_XIX_HCP5_CANFD01_1da1d48d_Tx: ComBitPosition=480, ComBitSize=8, ComSignalDataInvalidValue=255, ComSignalInitValue=254, ComSignalType=UINT8, ComTransferProperty=PENDING, ComHandleId=10, ComSystemTemplateSystemSignalRef=BMC_CMC_Temperatur_03_Messzeit
        BMC_CMC_Zellspannung_016_XIX_BMC_CMC_Zellspannung_01_XIX_HCP5_CANFD01_73e907e7_Tx: ComBitPosition=192, ComBitSize=12, ComSignalDataInvalidValue=4095, ComSignalInitValue=4094, ComSignalType=UINT16, ComTransferProperty=PENDING, ComHandleId=127, ComSystemTemplateSystemSignalRef=BMC_CMC_Zellspannung_016
      BMC_HV_06_XIX_HCP5_CANFD01_e2eda0bb_Tx (ComIPdu):
        ComIPduDirection = SEND
        ComIPduType = NORMAL
        ComIPduHandleId = 13
        ComIPduSignalProcessing = DEFERRED
        ComIPduCancellationSupport = false
        ComIPduGroupRef = BMC_HV_XIX_HCP5_CANFD01_Tx_3ba05bd9
        ComIPduGroupRef = BMC_HV_XIX_PNC_26_HighVoltage_Charging_Tx_20012544
        ComIPduSignalRef = BMC_Bidi_Energie_Absolut_XIX_BMC_HV_06_XIX_HCP5_CANFD01_b94683d1_Tx
        ComIPduSignalRef = BMC_Bidi_Freigabe_XIX_BMC_HV_06_XIX_HCP5_CANFD01_da88ae89_Tx
        ComIPduSignalRef = BMC_Bidi_Veto_Energie_XIX_BMC_HV_06_XIX_HCP5_CANFD01_c682e8ed_Tx
        ComIPduSignalRef = BMC_KundenWarnung_XIX_BMC_HV_06_XIX_HCP5_CANFD01_8664a2d8_Tx
        ComIPduSignalRef = BMC_Max_Spannung_XIX_BMC_HV_06_XIX_HCP5_CANFD01_ed13d04e_Tx
        ComIPduSignalRef = BMC_Min_Spannung_XIX_BMC_HV_06_XIX_HCP5_CANFD01_a39bb5e4_Tx
        ComPduIdRef = BMC_HV_06_XIX_HCP5_CANFD01_e2eda0bb_Tx
        ComIPduMainFunctionRef = ComMainFunctionTx
        ComTxIPdu: ComMinimumDelayTime=0.05, ComTxIPduUnusedAreasDefault=0
          ComTxModeTrue
            ComTxMode: ComTxModeMode=MIXED, ComTxModeNumberOfRepetitions=0, ComTxModeRepetitionPeriod=0, ComTxModeTimeOffset=0, ComTxModeTimePeriod=0.5
          ComTxModeFalse
            ComTxMode: ComTxModeMode=NONE
      BJB_10_XIX_BMC_CAN01_E2E_968516b3_Rx (ComIPdu):
        ComIPduDirection = RECEIVE
        ComIPduType = NORMAL
        ComIPduHandleId = 2
        ComIPduSignalProcessing = DEFERRED
        ComIPduCancellationSupport = false
        ComIPduCallout = ComIPduCallout_BJB_10_XIX_BMC_CAN01_E2E_968516b3_Rx
        ComIPduGroupRef = BMC_HV_XIX_BMC_CAN01_Rx_7b388810
        ComIPduSignalGroupRef = SG_BJB_10_XIX_BMC_CAN01_5b37bed6_Rx
        ComPduIdRef = BJB_10_XIX_BMC_CAN01_E2E_968516b3_Rx
        ComIPduMainFunctionRef = ComMainFunctionRx
      4 x ComSignal, all with ComSignalEndianness=LITTLE_ENDIAN, ComSignalAccess=ACCESS_UNCLEAR:
        UI1_KompFehlerModus2_21_XIX_UI1_Komponentenfehler_01_XIX_BMC_CAN01_a8e48176_Rx: ComBitPosition=52, ComBitSize=2, ComSignalInitValue=0, ComSignalType=UINT8, ComTimeout=1, ComHandleId=371, ComSystemTemplateSystemSignalRef=UI1_KompFehlerModus2_21
        DCDC_NV_Komponentenfehler_3_16_XIX_DCDC_NV_Komponentenfehler_04_XIX_HCP5_CANFD01_8c848471_Rx: ComBitPosition=45, ComBitSize=3, ComSignalInitValue=0, ComSignalType=UINT8, ComTimeout=5, ComHandleId=61, ComSystemTemplateSystemSignalRef=DCDC_NV_Komponentenfehler_3_16
        Hybrid_01_KD_Fehler_XIX_KN_Hybrid_01_XIX_HCP5_CANFD01_3ce83ada_Tx: ComBitPosition=23, ComBitSize=1, ComSignalInitValue=0, ComSignalType=UINT8, ComTransferProperty=PENDING, ComHandleId=403, ComSystemTemplateSystemSignalRef=Hybrid_01_KD_Fehler
        BMC_CMC_Zellspannung_018_XIX_BMC_CMC_Zellspannung_01_XIX_HCP5_CANFD01_e08388d6_Tx: ComBitPosition=216, ComBitSize=12, ComSignalDataInvalidValue=4095, ComSignalInitValue=4094, ComSignalType=UINT16, ComTransferProperty=PENDING, ComHandleId=129, ComSystemTemplateSystemSignalRef=BMC_CMC_Zellspannung_018
      UI1_02_XIX_BMC_CAN01_E2E_6d9e0c76_Rx (ComIPdu):
        ComIPduDirection = RECEIVE
        ComIPduType = NORMAL
        ComIPduHandleId = 44
        ComIPduSignalProcessing = DEFERRED
        ComIPduCancellationSupport = false
        ComIPduGroupRef = BMC_HV_XIX_BMC_CAN01_Rx_7b388810
        ComIPduSignalGroupRef = SG_UI1_02_XIX_BMC_CAN01_dce35ce3_Rx
        ComPduIdRef = UI1_02_XIX_BMC_CAN01_E2E_6d9e0c76_Rx
        ComIPduMainFunctionRef = ComMainFunctionRx
      TME_Therm_IstLeistung_HVBatterie_XIX_Thermomanagement_01_XIX_HCP5_CANFD01_705b15a6_Rx (ComSignal):
        ComBitPosition = 289
        ComBitSize = 9
        ComSignalDataInvalidValue = 511
        ComSignalEndianness = LITTLE_ENDIAN
        ComSignalInitValue = 510
        ComSignalType = UINT16
        ComTimeout = 1
        ComSignalAccess = ACCESS_UNCLEAR
        ComHandleId = 341
        ComSystemTemplateSystemSignalRef = TME_Therm_IstLeistung_HVBatterie
      UI2_04_XIX_BMC_CAN01_33f018a3_Rx (ComIPdu):
        ComIPduDirection = RECEIVE
        ComIPduType = NORMAL
        ComIPduHandleId = 59
        ComIPduSignalProcessing = DEFERRED
        ComIPduCancellationSupport = false
        ComIPduGroupRef = BMC_HV_XIX_BMC_CAN01_Rx_7b388810
        ComIPduSignalRef = UI2Sens02_ErrMem_State_XIX_UI2_04_XIX_BMC_CAN01_1e9c0075_Rx
        ComIPduSignalRef = UI2_Status_XIX_UI2_04_XIX_BMC_CAN01_1a276de9_Rx
        ComIPduSignalRef = UI2_Stromintegral_Entladen_XIX_UI2_04_XIX_BMC_CAN01_f5109cf0_Rx
        ComIPduSignalRef = UI2_Stromintegral_Laden_XIX_UI2_04_XIX_BMC_CAN01_01ef1f59_Rx
        ComIPduSignalRef = UI2_Temperatur_1_XIX_UI2_04_XIX_BMC_CAN01_d7558861_Rx
        ComIPduSignalRef = UI2_Temperatur_2_XIX_UI2_04_XIX_BMC_CAN01_25026599_Rx
        ComPduIdRef = UI2_04_XIX_BMC_CAN01_33f018a3_Rx
        ComIPduMainFunctionRef = ComMainFunctionRx
      TME_Batt_Kond_Verf_XIX_Thermomanagement_01_XIX_HCP5_CANFD01_ac1763e7_Rx (ComSignal):
        ComBitPosition = 120
        ComBitSize = 3
        ComSignalEndianness = LITTLE_ENDIAN
        ComSignalInitValue = 0
        ComSignalType = UINT8
        ComTimeout = 1
        ComSignalAccess = ACCESS_UNCLEAR
        ComHandleId = 340
        ComSystemTemplateSystemSignalRef = TME_Batt_Kond_Verf
      BMC_HV_XIX_PNC_06_Basefunction_ComfortLight_Rx_7861a7a5 (ComIPduGroup): ComIPduGroupHandleId=6
      9 x ComSignal, all with ComSignalEndianness=LITTLE_ENDIAN, ComSignalAccess=ACCESS_UNCLEAR:
        BMC_CMC_Zellspannung_029_XIX_BMC_CMC_Zellspannung_01_XIX_HCP5_CANFD01_24c10eea_Tx: ComBitPosition=348, ComBitSize=12, ComSignalDataInvalidValue=4095, ComSignalInitValue=4094, ComSignalType=UINT16, ComTransferProperty=PENDING, ComHandleId=140, ComSystemTemplateSystemSignalRef=BMC_CMC_Zellspannung_029
        DCDC_NV_Komponentenfehler_49_XIX_DCDC_NV_Komponentenfehler_02_XIX_HCP5_CANFD01_a5dee01b_Rx: ComBitPosition=38, ComBitSize=2, ComSignalInitValue=0, ComSignalType=UINT8, ComTimeout=5, ComHandleId=110, ComSystemTemplateSystemSignalRef=DCDC_NV_Komponentenfehler_49
        UI1_KompFehlerModus2_17_XIX_UI1_Komponentenfehler_01_XIX_BMC_CAN01_6bdf6eaf_Rx: ComBitPosition=44, ComBitSize=2, ComSignalInitValue=0, ComSignalType=UINT8, ComTimeout=1, ComHandleId=367, ComSystemTemplateSystemSignalRef=UI1_KompFehlerModus2_17
        HVLM_BCAM_Aktiv_XIX_ELF_06_XIX_HCP5_CANFD01_9b6861e7_Rx: ComBitPosition=45, ComBitSize=1, ComSignalInitValue=0, ComSignalType=UINT8, ComTimeout=2, ComHandleId=153, ComSystemTemplateSystemSignalRef=HVLM_BCAM_Aktiv
        NM_Hybrid_01_Subsystemaktiv_XIX_KN_Hybrid_01_XIX_HCP5_CANFD01_0d256d16_Tx: ComBitPosition=22, ComBitSize=1, ComSignalInitValue=0, ComSignalType=UINT8, ComTransferProperty=PENDING, ComHandleId=425, ComSystemTemplateSystemSignalRef=NM_Hybrid_01_Subsystemaktiv
        KN_Hybrid_01_BusKnockOutTimer_XIX_KN_Hybrid_01_XIX_HCP5_CANFD01_e5089bb3_Tx: ComBitPosition=32, ComBitSize=8, ComSignalInitValue=15, ComSignalType=UINT8, ComTransferProperty=PENDING, ComHandleId=407, ComSystemTemplateSystemSignalRef=KN_Hybrid_01_BusKnockOutTimer
        BMC_CMC_Temperatur_040_XIX_BMC_CMC_Temperatur_01_XIX_HCP5_CANFD01_d0b6d0d3_Tx: ComBitPosition=328, ComBitSize=8, ComSignalDataInvalidValue=255, ComSignalInitValue=254, ComSignalType=UINT8, ComTransferProperty=PENDING, ComHandleId=50, ComSystemTemplateSystemSignalRef=BMC_CMC_Temperatur_040
        UI2_KompFehlerModus2_01_XIX_UI2_Komponentenfehler_01_XIX_BMC_CAN01_1a77dcaf_Rx: ComBitPosition=12, ComBitSize=2, ComSignalInitValue=0, ComSignalType=UINT8, ComTimeout=1, ComHandleId=445, ComSystemTemplateSystemSignalRef=UI2_KompFehlerModus2_01
        UI2Sens02_CALID_Index_10_XIX_UI2Sens02_CALID_02_XIX_BMC_CAN01_79c15a37_Rx: ComBitPosition=8, ComBitSize=8, ComSignalInitValue=63, ComSignalType=UINT8, ComTimeout=5, ComHandleId=432, ComSystemTemplateSystemSignalRef=UI2Sens02_CALID_Index_10
      SG_KS_Hybrid_01_Response_M_XIX_HCP5_CANFD01_a3cfd12b_Rx (ComSignalGroup):
        ComTimeout = 0
        ComTransferProperty = TRIGGERED_WITHOUT_REPETITION
        ComSignalGroupAccess = ACCESS_UNCLEAR
        ComHandleId = 7
        ComSystemTemplateSignalGroupRef = SG_KS_Hybrid_01_Response_M_XIX_HCP5_CANFD01
        3 x ComGroupSignal, all with ComSignalAccess=ACCESS_UNCLEAR:
          KS_Hybrid_01_ReM_XIX_KS_Hybrid_01_Response_M_XIX_HCP5_CANFD01_34c0d6bb_Rx: ComBitPosition=24, ComSignalEndianness=opaque, ComSignalInitValue=0 0 0 0 0 0 0 0, ComSignalLength=8, ComSignalType=UINT8_N, ComHandleId=264, ComSystemTemplateSystemSignalRef=KS_Hybrid_01_ReM
          KS_Hybrid_01_ReM_IKACtr_XIX_KS_Hybrid_01_Response_M_XIX_HCP5_CANFD01_1f510c7e_Rx: ComBitPosition=16, ComBitSize=8, ComSignalEndianness=LITTLE_ENDIAN, ComSignalInitValue=0, ComSignalType=UINT8, ComHandleId=262, ComSystemTemplateSystemSignalRef=KS_Hybrid_01_ReM_IKACtr
          KS_Hybrid_01_ReM_SID_XIX_KS_Hybrid_01_Response_M_XIX_HCP5_CANFD01_d3494a39_Rx: ComBitPosition=0, ComBitSize=16, ComSignalEndianness=LITTLE_ENDIAN, ComSignalInitValue=0, ComSignalType=UINT16, ComHandleId=263, ComSystemTemplateSystemSignalRef=KS_Hybrid_01_ReM_SID
      UI1_KompFehlerModus2_04_XIX_UI1_Komponentenfehler_01_XIX_BMC_CAN01_b6310e45_Rx (ComSignal):
        ComBitPosition = 18
        ComBitSize = 2
        ComSignalEndianness = LITTLE_ENDIAN
        ComSignalInitValue = 0
        ComSignalType = UINT8
        ComTimeout = 1
        ComSignalAccess = ACCESS_UNCLEAR
        ComHandleId = 354
        ComSystemTemplateSystemSignalRef = UI1_KompFehlerModus2_04
      SG_HVLM_14_XIX_HCP5_CANFD01_09e92b9c_Rx (ComSignalGroup):
        ComTransferProperty = TRIGGERED_WITHOUT_REPETITION
        ComSignalGroupAccess = ACCESS_UNCLEAR
        ComHandleId = 5
        ComSystemTemplateSignalGroupRef = SG_HVLM_14_XIX_HCP5_CANFD01
        21 x ComGroupSignal, all with ComSignalEndianness=LITTLE_ENDIAN, ComSignalAccess=ACCESS_UNCLEAR:
          HVLM_Aktive_Ladeart_XIX_HVLM_14_XIX_HCP5_CANFD01_3e6c92a5_Rx: ComBitPosition=12, ComBitSize=3, ComSignalDataInvalidValue=7, ComSignalInitValue=0, ComSignalType=UINT8, ComHandleId=240, ComSystemTemplateSystemSignalRef=HVLM_Aktive_Ladeart
          HVLM_Ladeniveau_Anf_XIX_HVLM_14_XIX_HCP5_CANFD01_083f3bc2_Rx: ComBitPosition=37, ComBitSize=3, ComSignalDataInvalidValue=7, ComSignalInitValue=6, ComSignalType=UINT8, ComHandleId=247, ComSystemTemplateSystemSignalRef=HVLM_Ladeniveau_Anf
          HVLM_Ladevorgang_Anf_XIX_HVLM_14_XIX_HCP5_CANFD01_4b9de30b_Rx: ComBitPosition=53, ComBitSize=3, ComSignalInitValue=0, ComSignalType=UINT8, ComHandleId=249, ComSystemTemplateSystemSignalRef=HVLM_Ladevorgang_Anf
          HVLM_PrkCtl_StAlyReq_XIX_HVLM_14_XIX_HCP5_CANFD01_d9f73b2d_Rx: ComBitPosition=27, ComBitSize=3, ComSignalDataInvalidValue=7, ComSignalInitValue=6, ComSignalType=UINT8, ComHandleId=250, ComSystemTemplateSystemSignalRef=HVLM_PrkCtl_StAlyReq
          HVLM_PrkCtl_StPrkLockReq_XIX_HVLM_14_XIX_HCP5_CANFD01_ac6108b6_Rx: ComBitPosition=30, ComBitSize=2, ComSignalDataInvalidValue=3, ComSignalInitValue=2, ComSignalType=UINT8, ComHandleId=251, ComSystemTemplateSystemSignalRef=HVLM_PrkCtl_StPrkLockReq
          HVLM_14_BZ_XIX_HVLM_14_XIX_HCP5_CANFD01_95000b4e_Rx: ComBitPosition=8, ComBitSize=4, ComSignalInitValue=0, ComSignalType=UINT8, ComHandleId=238, ComSystemTemplateSystemSignalRef=HVLM_14_BZ
          HVLM_Laden_ISO_Messung_Anf_XIX_HVLM_14_XIX_HCP5_CANFD01_81fe7f1f_Rx: ComBitPosition=63, ComBitSize=1, ComSignalInitValue=1, ComSignalType=UINT8, ComHandleId=245, ComSystemTemplateSystemSignalRef=HVLM_Laden_ISO_Messung_Anf
          HVLM_Intensitaet_Lk2_XIX_HVLM_14_XIX_HCP5_CANFD01_75db43c3_Rx: ComBitPosition=20, ComBitSize=7, ComSignalDataInvalidValue=127, ComSignalInitValue=126, ComSignalType=UINT8, ComHandleId=244, ComSystemTemplateSystemSignalRef=HVLM_Intensitaet_Lk2
          HVLM_Start_Pulserkennung_XIX_HVLM_14_XIX_HCP5_CANFD01_5376c852_Rx: ComBitPosition=41, ComBitSize=1, ComSignalInitValue=0, ComSignalType=BOOLEAN, ComHandleId=253, ComSystemTemplateSystemSignalRef=HVLM_Start_Pulserkennung
          HVLM_ZustandLadeablauf_XIX_HVLM_14_XIX_HCP5_CANFD01_2597de22_Rx: ComBitPosition=42, ComBitSize=4, ComSignalDataInvalidValue=3, ComSignalInitValue=0, ComSignalType=UINT8, ComHandleId=256, ComSystemTemplateSystemSignalRef=HVLM_ZustandLadeablauf
          ISignalVoid_HVLM_14_XIX_HCP5_CANFD01_1_89c2fe79_Rx: ComBitPosition=33, ComBitSize=2, ComSignalType=UINT8, ComSignalInitValue=0, ComHandleId=258, ComSystemTemplateSystemSignalRef=SignalVoid_HVLM_14_1
          HVLM_Intensitaet_Lk1_XIX_HVLM_14_XIX_HCP5_CANFD01_317a66db_Rx: ComBitPosition=56, ComBitSize=7, ComSignalDataInvalidValue=127, ComSignalInitValue=126, ComSignalType=UINT8, ComHandleId=243, ComSystemTemplateSystemSignalRef=HVLM_Intensitaet_Lk1
          HVLM_Grundladen_Anf_XIX_HVLM_14_XIX_HCP5_CANFD01_f365712a_Rx: ComBitPosition=15, ComBitSize=1, ComSignalInitValue=0, ComSignalType=UINT8, ComHandleId=242, ComSystemTemplateSystemSignalRef=HVLM_Grundladen_Anf
          HVLM_14_CRC_XIX_HVLM_14_XIX_HCP5_CANFD01_fcfa0c25_Rx: ComBitPosition=0, ComBitSize=8, ComSignalInitValue=0, ComSignalType=UINT8, ComHandleId=239, ComSystemTemplateSystemSignalRef=HVLM_14_CRC
          HVLM_Pulsierstufe_XIX_HVLM_14_XIX_HCP5_CANFD01_ff56f5e0_Rx: ComBitPosition=17, ComBitSize=3, ComSignalInitValue=0, ComSignalType=UINT8, ComHandleId=252, ComSystemTemplateSystemSignalRef=HVLM_Pulsierstufe
          HVLM_Ladeszenario_XIX_HVLM_14_XIX_HCP5_CANFD01_9752bea6_Rx: ComBitPosition=48, ComBitSize=5, ComSignalDataInvalidValue=31, ComSignalInitValue=30, ComSignalType=UINT8, ComHandleId=248, ComSystemTemplateSystemSignalRef=HVLM_Ladeszenario
          HVLM_Steckerstatus_XIX_HVLM_14_XIX_HCP5_CANFD01_e501277b_Rx: ComBitPosition=35, ComBitSize=2, ComSignalDataInvalidValue=3, ComSignalInitValue=0, ComSignalType=UINT8, ComHandleId=254, ComSystemTemplateSystemSignalRef=HVLM_Steckerstatus
          HVLM_DC_Aufstartmodus_XIX_HVLM_14_XIX_HCP5_CANFD01_c89fb2cb_Rx: ComBitPosition=46, ComBitSize=2, ComSignalInitValue=0, ComSignalType=UINT8, ComHandleId=241, ComSystemTemplateSystemSignalRef=HVLM_DC_Aufstartmodus
          HVLM_WakeUpZaehlerResetAnf_XIX_HVLM_14_XIX_HCP5_CANFD01_40bfec16_Rx: ComBitPosition=32, ComBitSize=1, ComSignalInitValue=0, ComSignalType=UINT8, ComHandleId=255, ComSystemTemplateSystemSignalRef=HVLM_WakeUpZaehlerResetAnf
          ISignalVoid_HVLM_14_XIX_HCP5_CANFD01_0_fec5ceef_Rx: ComBitPosition=16, ComBitSize=1, ComSignalType=UINT8, ComSignalInitValue=0, ComHandleId=257, ComSystemTemplateSystemSignalRef=SignalVoid_HVLM_14_0
          HVLM_Ladenaktiv_Standzyklus_XIX_HVLM_14_XIX_HCP5_CANFD01_268101c6_Rx: ComBitPosition=40, ComBitSize=1, ComSignalInitValue=0, ComSignalType=UINT8, ComHandleId=246, ComSystemTemplateSystemSignalRef=HVLM_Ladenaktiv_Standzyklus
      18 x ComSignal, all with ComSignalEndianness=LITTLE_ENDIAN, ComSignalAccess=ACCESS_UNCLEAR:
        DCDC_NV_Komponentenfehler_65_XIX_DCDC_NV_Komponentenfehler_03_XIX_HCP5_CANFD01_e04eeff3_Rx: ComBitPosition=8, ComBitSize=2, ComSignalInitValue=0, ComSignalType=UINT8, ComTimeout=5, ComHandleId=126, ComSystemTemplateSystemSignalRef=DCDC_NV_Komponentenfehler_65
        BMC_CMC_Zellspannung_186_XIX_BMC_CMC_Zellspannung_05_XIX_HCP5_CANFD01_d1a360f2_Tx: ComBitPosition=360, ComBitSize=12, ComSignalDataInvalidValue=4095, ComSignalInitValue=4094, ComSignalType=UINT16, ComTransferProperty=PENDING, ComHandleId=297, ComSystemTemplateSystemSignalRef=BMC_CMC_Zellspannung_186
        BJB_ErrMem_State_XIX_BJB_08_XIX_BMC_CAN01_418604a2_Rx: ComBitPosition=12, ComBitSize=2, ComSignalInitValue=2, ComSignalType=UINT8, ComTimeout=1, ComHandleId=22, ComSystemTemplateSystemSignalRef=BJB_ErrMem_State
        BMC_CMC_Zellspannung_136_XIX_BMC_CMC_Zellspannung_04_XIX_HCP5_CANFD01_78509c16_Tx: ComBitPosition=228, ComBitSize=12, ComSignalDataInvalidValue=4095, ComSignalInitValue=4094, ComSignalType=UINT16, ComTransferProperty=PENDING, ComHandleId=247, ComSystemTemplateSystemSignalRef=BMC_CMC_Zellspannung_136
        BMC_CMC_Zellspannung_035_XIX_BMC_CMC_Zellspannung_01_XIX_HCP5_CANFD01_2141bd98_Tx: ComBitPosition=420, ComBitSize=12, ComSignalDataInvalidValue=4095, ComSignalInitValue=4094, ComSignalType=UINT16, ComTransferProperty=PENDING, ComHandleId=146, ComSystemTemplateSystemSignalRef=BMC_CMC_Zellspannung_035
        UI2_KompFehlerModus2_08_XIX_UI2_Komponentenfehler_01_XIX_BMC_CAN01_ba6f219c_Rx: ComBitPosition=26, ComBitSize=2, ComSignalInitValue=0, ComSignalType=UINT8, ComTimeout=1, ComHandleId=452, ComSystemTemplateSystemSignalRef=UI2_KompFehlerModus2_08
        DCDC_NV_Komponentenfehler_06_XIX_DCDC_NV_Komponentenfehler_01_XIX_HCP5_CANFD01_cf7398eb_Rx: ComBitPosition=10, ComBitSize=2, ComSignalInitValue=0, ComSignalType=UINT8, ComTimeout=5, ComHandleId=67, ComSystemTemplateSystemSignalRef=DCDC_NV_Komponentenfehler_06
        DCDC_NV_Komponentenfehler_30_XIX_DCDC_NV_Komponentenfehler_02_XIX_HCP5_CANFD01_4eb56237_Rx: ComBitPosition=0, ComBitSize=2, ComSignalInitValue=0, ComSignalType=UINT8, ComTimeout=5, ComHandleId=91, ComSystemTemplateSystemSignalRef=DCDC_NV_Komponentenfehler_30
        DCDC_NV_Komponentenfehler_04_XIX_DCDC_NV_Komponentenfehler_01_XIX_HCP5_CANFD01_807f798c_Rx: ComBitPosition=6, ComBitSize=2, ComSignalInitValue=0, ComSignalType=UINT8, ComTimeout=5, ComHandleId=65, ComSystemTemplateSystemSignalRef=DCDC_NV_Komponentenfehler_04
        BMC_NutzbareKapazitaet_XIX_BMC_HV_03_XIX_HCP5_CANFD01_b7a047cf_Tx: ComBitPosition=56, ComBitSize=12, ComSignalDataInvalidValue=4095, ComSignalInitValue=4094, ComSignalType=UINT16, ComTransferProperty=PENDING, ComHandleId=329, ComSystemTemplateSystemSignalRef=BMC_NutzbareKapazitaet
        BMC_Pack_SN_13_XIX_BMC_HV_08_XIX_HCP5_CANFD01_d703707d_Tx: ComBitPosition=160, ComBitSize=8, ComSignalInitValue=255, ComSignalType=UINT8, ComTransferProperty=PENDING, ComHandleId=346, ComSystemTemplateSystemSignalRef=BMC_Pack_SN_13
        UI2_KompFehlerModus2_13_XIX_UI2_Komponentenfehler_01_XIX_BMC_CAN01_edb18427_Rx: ComBitPosition=36, ComBitSize=2, ComSignalInitValue=0, ComSignalType=UINT8, ComTimeout=1, ComHandleId=457, ComSystemTemplateSystemSignalRef=UI2_KompFehlerModus2_13
        UI1_KompFehlerModus2_01_XIX_UI1_Komponentenfehler_01_XIX_BMC_CAN01_34b9d7af_Rx: ComBitPosition=12, ComBitSize=2, ComSignalInitValue=0, ComSignalType=UINT8, ComTimeout=1, ComHandleId=351, ComSystemTemplateSystemSignalRef=UI1_KompFehlerModus2_01
        BMC_IstTemperaturMax_Sensor_ID_XIX_BMC_HV_08_XIX_HCP5_CANFD01_ea25f749_Tx: ComBitPosition=17, ComBitSize=5, ComSignalInitValue=31, ComSignalType=UINT8, ComTransferProperty=PENDING, ComHandleId=313, ComSystemTemplateSystemSignalRef=BMC_IstTemperaturMax_Sensor_ID
        DCDC_NV_Komponentenfehler_3_7_XIX_DCDC_NV_Komponentenfehler_04_XIX_HCP5_CANFD01_9c57158d_Rx: ComBitPosition=18, ComBitSize=3, ComSignalInitValue=0, ComSignalType=UINT8, ComTimeout=5, ComHandleId=52, ComSystemTemplateSystemSignalRef=DCDC_NV_Komponentenfehler_3_7
        DCDC_NV_Komponentenfehler_57_XIX_DCDC_NV_Komponentenfehler_02_XIX_HCP5_CANFD01_fa45bc62_Rx: ComBitPosition=54, ComBitSize=2, ComSignalInitValue=0, ComSignalType=UINT8, ComTimeout=5, ComHandleId=118, ComSystemTemplateSystemSignalRef=DCDC_NV_Komponentenfehler_57
        BMC_Temperatur_niedrigste_XIX_BMC_HV_07_XIX_HCP5_CANFD01_2e3528f4_Tx: ComBitPosition=22, ComBitSize=10, ComSignalDataInvalidValue=1023, ComSignalInitValue=1022, ComSignalType=UINT16, ComTransferProperty=PENDING, ComHandleId=381, ComSystemTemplateSystemSignalRef=BMC_Temperatur_niedrigste
        BMC_CMC_Temperatur_074_XIX_BMC_CMC_Temperatur_03_XIX_HCP5_CANFD01_4209244d_Tx: ComBitPosition=24, ComBitSize=8, ComSignalDataInvalidValue=255, ComSignalInitValue=254, ComSignalType=UINT8, ComTransferProperty=PENDING, ComHandleId=84, ComSystemTemplateSystemSignalRef=BMC_CMC_Temperatur_074
      DCDC_NV_Komponentenfehler_04_XIX_HCP5_CANFD01_39921681_Rx (ComIPdu):
        ComIPduDirection = RECEIVE
        ComIPduType = NORMAL
        ComIPduHandleId = 18
        ComIPduSignalProcessing = DEFERRED
        ComIPduCancellationSupport = false
        ComIPduGroupRef = BMC_HV_XIX_HCP5_CANFD01_Rx_6dfafc5f
        ComIPduGroupRef = BMC_HV_XIX_PNC_26_HighVoltage_Charging_Rx_765b82c2
        ComIPduSignalRef = DCDC_NV_Komponentenfehler_3_10_XIX_DCDC_NV_Komponentenfehler_04_XIX_HCP5_CANFD01_5d91a7d8_Rx
        ComIPduSignalRef = DCDC_NV_Komponentenfehler_3_11_XIX_DCDC_NV_Komponentenfehler_04_XIX_HCP5_CANFD01_97af544b_Rx
        ComIPduSignalRef = DCDC_NV_Komponentenfehler_3_12_XIX_DCDC_NV_Komponentenfehler_04_XIX_HCP5_CANFD01_129d46bf_Rx
        ComIPduSignalRef = DCDC_NV_Komponentenfehler_3_13_XIX_DCDC_NV_Komponentenfehler_04_XIX_HCP5_CANFD01_d8a3b52c_Rx
        ComIPduSignalRef = DCDC_NV_Komponentenfehler_3_14_XIX_DCDC_NV_Komponentenfehler_04_XIX_HCP5_CANFD01_c3886516_Rx
        ComIPduSignalRef = DCDC_NV_Komponentenfehler_3_15_XIX_DCDC_NV_Komponentenfehler_04_XIX_HCP5_CANFD01_09b69685_Rx
        ComIPduSignalRef = DCDC_NV_Komponentenfehler_3_16_XIX_DCDC_NV_Komponentenfehler_04_XIX_HCP5_CANFD01_8c848471_Rx
        ComIPduSignalRef = DCDC_NV_Komponentenfehler_3_1_XIX_DCDC_NV_Komponentenfehler_04_XIX_HCP5_CANFD01_4d423624_Rx
        ComIPduSignalRef = DCDC_NV_Komponentenfehler_3_2_XIX_DCDC_NV_Komponentenfehler_04_XIX_HCP5_CANFD01_c87024d0_Rx
        ComIPduSignalRef = DCDC_NV_Komponentenfehler_3_3_XIX_DCDC_NV_Komponentenfehler_04_XIX_HCP5_CANFD01_024ed743_Rx
        ComIPduSignalRef = DCDC_NV_Komponentenfehler_3_4_XIX_DCDC_NV_Komponentenfehler_04_XIX_HCP5_CANFD01_19650779_Rx
        ComIPduSignalRef = DCDC_NV_Komponentenfehler_3_5_XIX_DCDC_NV_Komponentenfehler_04_XIX_HCP5_CANFD01_d35bf4ea_Rx
        ComIPduSignalRef = DCDC_NV_Komponentenfehler_3_6_XIX_DCDC_NV_Komponentenfehler_04_XIX_HCP5_CANFD01_5669e61e_Rx
        ComIPduSignalRef = DCDC_NV_Komponentenfehler_3_7_XIX_DCDC_NV_Komponentenfehler_04_XIX_HCP5_CANFD01_9c57158d_Rx
        ComIPduSignalRef = DCDC_NV_Komponentenfehler_3_8_XIX_DCDC_NV_Komponentenfehler_04_XIX_HCP5_CANFD01_603e466a_Rx
        ComIPduSignalRef = DCDC_NV_Komponentenfehler_3_9_XIX_DCDC_NV_Komponentenfehler_04_XIX_HCP5_CANFD01_aa00b5f9_Rx
        ComPduIdRef = DCDC_NV_Komponentenfehler_04_XIX_HCP5_CANFD01_39921681_Rx
        ComIPduMainFunctionRef = ComMainFunctionRx
      13 x ComSignal, all with ComSignalEndianness=LITTLE_ENDIAN, ComSignalAccess=ACCESS_UNCLEAR:
        BMC_CMC_Zellspannung_036_XIX_BMC_CMC_Zellspannung_01_XIX_HCP5_CANFD01_a11b112d_Tx: ComBitPosition=432, ComBitSize=12, ComSignalDataInvalidValue=4095, ComSignalInitValue=4094, ComSignalType=UINT16, ComTransferProperty=PENDING, ComHandleId=147, ComSystemTemplateSystemSignalRef=BMC_CMC_Zellspannung_036
        BMC_CMC_Temperatur_084_XIX_BMC_CMC_Temperatur_03_XIX_HCP5_CANFD01_82efa08c_Tx: ComBitPosition=104, ComBitSize=8, ComSignalDataInvalidValue=255, ComSignalInitValue=254, ComSignalType=UINT8, ComTransferProperty=PENDING, ComHandleId=94, ComSystemTemplateSystemSignalRef=BMC_CMC_Temperatur_084
        BMC_CMC_Temperatur_013_XIX_BMC_CMC_Temperatur_01_XIX_HCP5_CANFD01_ee931bca_Tx: ComBitPosition=112, ComBitSize=8, ComSignalDataInvalidValue=255, ComSignalInitValue=254, ComSignalType=UINT8, ComTransferProperty=PENDING, ComHandleId=23, ComSystemTemplateSystemSignalRef=BMC_CMC_Temperatur_013
        BMC_CMC_Zellspannung_053_XIX_BMC_CMC_Zellspannung_02_XIX_HCP5_CANFD01_bc6402ce_Tx: ComBitPosition=168, ComBitSize=12, ComSignalDataInvalidValue=4095, ComSignalInitValue=4094, ComSignalType=UINT16, ComTransferProperty=PENDING, ComHandleId=164, ComSystemTemplateSystemSignalRef=BMC_CMC_Zellspannung_053
        BMC_CMC_Temperatur_067_XIX_BMC_CMC_Temperatur_02_XIX_HCP5_CANFD01_70b5f246_Tx: ComBitPosition=80, ComBitSize=8, ComSignalDataInvalidValue=255, ComSignalInitValue=254, ComSignalType=UINT8, ComTransferProperty=PENDING, ComHandleId=77, ComSystemTemplateSystemSignalRef=BMC_CMC_Temperatur_067
        BMC_CMC_Zellspannung_075_XIX_BMC_CMC_Zellspannung_02_XIX_HCP5_CANFD01_b5524b2f_Tx: ComBitPosition=432, ComBitSize=12, ComSignalDataInvalidValue=4095, ComSignalInitValue=4094, ComSignalType=UINT16, ComTransferProperty=PENDING, ComHandleId=186, ComSystemTemplateSystemSignalRef=BMC_CMC_Zellspannung_075
        BMC_CMC_Temperatur_041_XIX_BMC_CMC_Temperatur_01_XIX_HCP5_CANFD01_fa9ee8b1_Tx: ComBitPosition=336, ComBitSize=8, ComSignalDataInvalidValue=255, ComSignalInitValue=254, ComSignalType=UINT8, ComTransferProperty=PENDING, ComHandleId=51, ComSystemTemplateSystemSignalRef=BMC_CMC_Temperatur_041
        UH_Jahr_XIX_Diagnose_01_XIX_HCP5_CANFD01_d17ea5cb_Rx: ComBitPosition=28, ComBitSize=7, ComSignalInitValue=0, ComSignalType=UINT8, ComTimeout=5, ComHandleId=342, ComSystemTemplateSystemSignalRef=UH_Jahr
        BMC_CMC_Zellspannung_025_XIX_BMC_CMC_Zellspannung_01_XIX_HCP5_CANFD01_4838b6fd_Tx: ComBitPosition=300, ComBitSize=12, ComSignalDataInvalidValue=4095, ComSignalInitValue=4094, ComSignalType=UINT16, ComTransferProperty=PENDING, ComHandleId=136, ComSystemTemplateSystemSignalRef=BMC_CMC_Zellspannung_025
        BMC_CMC_Zellspannung_079_XIX_BMC_CMC_Zellspannung_03_XIX_HCP5_CANFD01_36f945d9_Tx: ComBitPosition=12, ComBitSize=12, ComSignalDataInvalidValue=4095, ComSignalInitValue=4094, ComSignalType=UINT16, ComTransferProperty=PENDING, ComHandleId=190, ComSystemTemplateSystemSignalRef=BMC_CMC_Zellspannung_079
        BMC_CMC_Zellspannung_017_XIX_BMC_CMC_Zellspannung_01_XIX_HCP5_CANFD01_0c209c74_Tx: ComBitPosition=204, ComBitSize=12, ComSignalDataInvalidValue=4095, ComSignalInitValue=4094, ComSignalType=UINT16, ComTransferProperty=PENDING, ComHandleId=128, ComSystemTemplateSystemSignalRef=BMC_CMC_Zellspannung_017
        DCDC_NV_Komponentenfehler_46_XIX_DCDC_NV_Komponentenfehler_02_XIX_HCP5_CANFD01_59b7b3fc_Rx: ComBitPosition=32, ComBitSize=2, ComSignalInitValue=0, ComSignalType=UINT8, ComTimeout=5, ComHandleId=107, ComSystemTemplateSystemSignalRef=DCDC_NV_Komponentenfehler_46
        BMC_CMC_Zellspannung_088_XIX_BMC_CMC_Zellspannung_03_XIX_HCP5_CANFD01_7104bf9a_Tx: ComBitPosition=120, ComBitSize=12, ComSignalDataInvalidValue=4095, ComSignalInitValue=4094, ComSignalType=UINT16, ComTransferProperty=PENDING, ComHandleId=199, ComSystemTemplateSystemSignalRef=BMC_CMC_Zellspannung_088
      DEV_Hybrid_01_Req_00_XIX_HCP5_CANFD01_5661b344_Rx (ComIPdu):
        ComIPduDirection = RECEIVE
        ComIPduType = NORMAL
        ComIPduHandleId = 19
        ComIPduSignalProcessing = DEFERRED
        ComIPduCancellationSupport = false
        ComIPduGroupRef = BMC_HV_XIX_HCP5_CANFD01_Rx_6dfafc5f
        ComIPduSignalRef = DEV_Hybrid_01_Req_00_FD_Data_XIX_DEV_Hybrid_01_Req_00_XIX_HCP5_CANFD01_5095de8e_Rx
        ComPduIdRef = DEV_Hybrid_01_Req_00_XIX_HCP5_CANFD01_5661b344_Rx
        ComIPduMainFunctionRef = ComMainFunctionRx
      3 x ComSignal, all with ComSignalEndianness=LITTLE_ENDIAN, ComSignalAccess=ACCESS_UNCLEAR:
        BMC_CMC_Zellspannung_187_XIX_BMC_CMC_Zellspannung_05_XIX_HCP5_CANFD01_ae6afb61_Tx: ComBitPosition=372, ComBitSize=12, ComSignalDataInvalidValue=4095, ComSignalInitValue=4094, ComSignalType=UINT16, ComTransferProperty=PENDING, ComHandleId=298, ComSystemTemplateSystemSignalRef=BMC_CMC_Zellspannung_187
        UI1_Temperatur_2_XIX_UI1_04_XIX_BMC_CAN01_1c1fa400_Rx: ComBitPosition=16, ComBitSize=8, ComSignalDataInvalidValue=255, ComSignalInitValue=254, ComSignalType=UINT8, ComTimeout=1, ComHandleId=400, ComSystemTemplateSystemSignalRef=UI1_Temperatur_2
        BMC_CMC_Zellspannung_180_XIX_BMC_CMC_Zellspannung_05_XIX_HCP5_CANFD01_0a673fd9_Tx: ComBitPosition=288, ComBitSize=12, ComSignalDataInvalidValue=4095, ComSignalInitValue=4094, ComSignalType=UINT16, ComTransferProperty=PENDING, ComHandleId=291, ComSystemTemplateSystemSignalRef=BMC_CMC_Zellspannung_180
      BJB_08_XIX_BMC_CAN01_1db9ae10_Rx (ComIPdu):
        ComIPduDirection = RECEIVE
        ComIPduType = NORMAL
        ComIPduHandleId = 1
        ComIPduSignalProcessing = DEFERRED
        ComIPduCancellationSupport = false
        ComIPduGroupRef = BMC_HV_XIX_BMC_CAN01_Rx_7b388810
        ComIPduSignalRef = BJB_ErrMem_State_XIX_BJB_08_XIX_BMC_CAN01_418604a2_Rx
        ComPduIdRef = BJB_08_XIX_BMC_CAN01_1db9ae10_Rx
        ComIPduMainFunctionRef = ComMainFunctionRx
      8 x ComSignal, all with ComSignalEndianness=LITTLE_ENDIAN, ComSignalAccess=ACCESS_UNCLEAR:
        UI1_KompFehlerModus4_14_XIX_UI1_Komponentenfehler_02_XIX_BMC_CAN01_a8bd716f_Rx: ComBitPosition=51, ComBitSize=3, ComSignalInitValue=0, ComSignalType=UINT8, ComTimeout=1, ComHandleId=390, ComSystemTemplateSystemSignalRef=UI1_KompFehlerModus4_14
        BMC_CMC_Zellspannung_141_XIX_BMC_CMC_Zellspannung_04_XIX_HCP5_CANFD01_19436ed4_Tx: ComBitPosition=288, ComBitSize=12, ComSignalDataInvalidValue=4095, ComSignalInitValue=4094, ComSignalType=UINT16, ComTransferProperty=PENDING, ComHandleId=252, ComSystemTemplateSystemSignalRef=BMC_CMC_Zellspannung_141
        UI1_Status_XIX_UI1_04_XIX_BMC_CAN01_abb6019e_Rx: ComBitPosition=15, ComBitSize=1, ComSignalInitValue=0, ComSignalType=UINT8, ComTimeout=1, ComHandleId=396, ComSystemTemplateSystemSignalRef=UI1_Status
        BMC_CMC_Temperatur_025_XIX_BMC_CMC_Temperatur_01_XIX_HCP5_CANFD01_2da8f413_Tx: ComBitPosition=208, ComBitSize=8, ComSignalDataInvalidValue=255, ComSignalInitValue=254, ComSignalType=UINT8, ComTransferProperty=PENDING, ComHandleId=35, ComSystemTemplateSystemSignalRef=BMC_CMC_Temperatur_025
        BMC_Bidi_Freigabe_XIX_BMC_HV_06_XIX_HCP5_CANFD01_da88ae89_Tx: ComBitPosition=35, ComBitSize=2, ComSignalDataInvalidValue=3, ComSignalInitValue=2, ComSignalType=UINT8, ComTransferProperty=PENDING, ComHandleId=2, ComSystemTemplateSystemSignalRef=BMC_Bidi_Freigabe
        DCDC_NV_Komponentenfehler_17_XIX_DCDC_NV_Komponentenfehler_01_XIX_HCP5_CANFD01_6c819775_Rx: ComBitPosition=32, ComBitSize=2, ComSignalInitValue=0, ComSignalType=UINT8, ComTimeout=5, ComHandleId=78, ComSystemTemplateSystemSignalRef=DCDC_NV_Komponentenfehler_17
        HVEM_SystemMinLeistungsgrenze_XIX_HVEM_07_XIX_HCP5_CANFD01_b8be9fb0_Rx: ComBitPosition=160, ComBitSize=7, ComSignalDataInvalidValue=127, ComSignalInitValue=126, ComSignalType=UINT8, ComTimeout=0.8, ComHandleId=150, ComSystemTemplateSystemSignalRef=HVEM_SystemMinLeistungsgrenze
        BMC_CMC_Zellspannung_061_XIX_BMC_CMC_Zellspannung_02_XIX_HCP5_CANFD01_f87c2847_Tx: ComBitPosition=264, ComBitSize=12, ComSignalDataInvalidValue=4095, ComSignalInitValue=4094, ComSignalType=UINT16, ComTransferProperty=PENDING, ComHandleId=172, ComSystemTemplateSystemSignalRef=BMC_CMC_Zellspannung_061
      3 x ComIPdu, all with ComIPduType=NORMAL, ComIPduSignalProcessing=DEFERRED, ComIPduCancellationSupport=false:
        ORU_Control_D_01_XIX_HCP5_CANFD01_E2E_6e31ae8f_Rx: ComIPduDirection=RECEIVE, ComIPduHandleId=36, ComIPduGroupRef=BMC_HV_XIX_HCP5_CANFD01_Rx_6dfafc5f, ComIPduGroupRef=BMC_HV_XIX_PNC_02_Basefunction_Powertrain_Rx_dc518468, ComIPduSignalGroupRef=SG_ORU_Control_D_01_XIX_HCP5_CANFD01_25c40c08_Rx, ComPduIdRef=ORU_Control_D_01_XIX_HCP5_CANFD01_E2E_6e31ae8f_Rx, ComIPduMainFunctionRef=ComMainFunctionRx
        OBD_HCP1_XIX_HCP5_CANFD01_1b389b6c_Rx: ComIPduDirection=RECEIVE, ComIPduHandleId=32, ComIPduGroupRef=BMC_HV_XIX_HCP5_CANFD01_Rx_6dfafc5f, ComIPduGroupRef=BMC_HV_XIX_PNC_10_Powertrain_Rx_c7039922, ComIPduSignalRef=OBDProtocol_req_XIX_OBD_HCP1_XIX_HCP5_CANFD01_70c5c055_Rx, ComPduIdRef=OBD_HCP1_XIX_HCP5_CANFD01_1b389b6c_Rx, ComIPduMainFunctionRef=ComMainFunctionRx
        BMC_HV_11_XIX_BMC_CAN01_E2E_ff4f5109_Tx: ComIPduDirection=SEND, ComIPduHandleId=18, ComIPduCallout=ComIPduCallout_BMC_HV_11_XIX_BMC_CAN01_E2E_ff4f5109_Tx, ComIPduGroupRef=BMC_HV_XIX_BMC_CAN01_Tx_2d622f96, ComIPduSignalGroupRef=SG_BMC_HV_11_XIX_BMC_CAN01_91b60c9a_Tx, ComPduIdRef=BMC_HV_11_XIX_BMC_CAN01_E2E_ff4f5109_Tx, ComIPduMainFunctionRef=ComMainFunctionTx
          ComTxIPdu: ComTxIPduUnusedAreasDefault=0, ComMinimumDelayTime=0.2
            ComTxModeTrue
              ComTxMode: ComTxModeMode=PERIODIC, ComTxModeNumberOfRepetitions=0, ComTxModeRepetitionPeriod=0, ComTxModeTimePeriod=1, ComTxModeTimeOffset=0
            ComTxModeFalse
              ComTxMode: ComTxModeMode=PERIODIC, ComTxModeTimePeriod=2, ComTxModeTimeOffset=0.2
      5 x ComSignal, all with ComSignalEndianness=LITTLE_ENDIAN, ComSignalAccess=ACCESS_UNCLEAR:
        UI2Sens02_CVN_Byte_4_XIX_UI2Sens02_CVN_XIX_BMC_CAN01_3506f352_Rx: ComBitPosition=25, ComBitSize=8, ComSignalInitValue=0, ComSignalType=UINT8, ComTimeout=5, ComHandleId=442, ComSystemTemplateSystemSignalRef=UI2Sens02_CVN_Byte_4
        BJB_CALID_Index_09_XIX_BJB_CALID_02_XIX_BMC_CAN01_e68e20da_Rx: ComBitPosition=0, ComBitSize=8, ComSignalInitValue=63, ComSignalType=UINT8, ComTimeout=5, ComHandleId=9, ComSystemTemplateSystemSignalRef=BJB_CALID_Index_09
        BMC_CMC_Zellspannung_104_XIX_BMC_CMC_Zellspannung_03_XIX_HCP5_CANFD01_dd66bcfb_Tx: ComBitPosition=312, ComBitSize=12, ComSignalDataInvalidValue=4095, ComSignalInitValue=4094, ComSignalType=UINT16, ComTransferProperty=PENDING, ComHandleId=215, ComSystemTemplateSystemSignalRef=BMC_CMC_Zellspannung_104
        OBD_Warm_Up_Cycle_XIX_OBD_03_XIX_HCP5_CANFD01_eb6d4da0_Rx: ComBitPosition=62, ComBitSize=1, ComSignalInitValue=0, ComSignalType=UINT8, ComTimeout=3.2, ComHandleId=175, ComSystemTemplateSystemSignalRef=OBD_Warm_Up_Cycle
        DCDC_NV_Komponentenfehler_13_XIX_DCDC_NV_Komponentenfehler_01_XIX_HCP5_CANFD01_f29855bb_Rx: ComBitPosition=24, ComBitSize=2, ComSignalInitValue=0, ComSignalType=UINT8, ComTimeout=5, ComHandleId=74, ComSystemTemplateSystemSignalRef=DCDC_NV_Komponentenfehler_13
      BMC_HV_10_XIX_BMC_CAN01_E2E_28add151_Tx (ComIPdu):
        ComIPduDirection = SEND
        ComIPduType = NORMAL
        ComIPduHandleId = 17
        ComIPduSignalProcessing = DEFERRED
        ComIPduCancellationSupport = false
        ComIPduGroupRef = BMC_HV_XIX_BMC_CAN01_Tx_2d622f96
        ComIPduSignalGroupRef = SG_BMC_HV_10_XIX_BMC_CAN01_284dd772_Tx
        ComPduIdRef = BMC_HV_10_XIX_BMC_CAN01_E2E_28add151_Tx
        ComIPduMainFunctionRef = ComMainFunctionTx
        ComTxIPdu: ComTxIPduUnusedAreasDefault=0, ComMinimumDelayTime=0
          ComTxModeTrue
            ComTxMode: ComTxModeMode=PERIODIC, ComTxModeNumberOfRepetitions=0, ComTxModeRepetitionPeriod=0, ComTxModeTimePeriod=1, ComTxModeTimeOffset=0
          ComTxModeFalse
            ComTxMode: ComTxModeMode=NONE
      7 x ComSignal, all with ComSignalEndianness=LITTLE_ENDIAN, ComSignalAccess=ACCESS_UNCLEAR:
        DCDC_NV_Komponentenfehler_24_XIX_DCDC_NV_Komponentenfehler_01_XIX_HCP5_CANFD01_53e68196_Rx: ComBitPosition=46, ComBitSize=2, ComSignalInitValue=0, ComSignalType=UINT8, ComTimeout=5, ComHandleId=85, ComSystemTemplateSystemSignalRef=DCDC_NV_Komponentenfehler_24
        OTP_Aussen_Temp_ungef_XIX_OTP_01_XIX_HCP5_CANFD01_c0bbb4b6_Rx: ComBitPosition=24, ComBitSize=8, ComSignalDataInvalidValue=255, ComSignalInitValue=254, ComSignalType=UINT8, ComTimeout=2, ComHandleId=178, ComSystemTemplateSystemSignalRef=OTP_Aussen_Temp_ungef
        BMC_CMC_Temperatur_095_XIX_BMC_CMC_Temperatur_03_XIX_HCP5_CANFD01_0b51b0a2_Tx: ComBitPosition=192, ComBitSize=8, ComSignalDataInvalidValue=255, ComSignalInitValue=254, ComSignalType=UINT8, ComTransferProperty=PENDING, ComHandleId=105, ComSystemTemplateSystemSignalRef=BMC_CMC_Temperatur_095
        DCDC_NV_Komponentenfehler_3_15_XIX_DCDC_NV_Komponentenfehler_04_XIX_HCP5_CANFD01_09b69685_Rx: ComBitPosition=42, ComBitSize=3, ComSignalInitValue=0, ComSignalType=UINT8, ComTimeout=5, ComHandleId=60, ComSystemTemplateSystemSignalRef=DCDC_NV_Komponentenfehler_3_15
        UI1_KompFehlerModus4_07_XIX_UI1_Komponentenfehler_02_XIX_BMC_CAN01_75531185_Rx: ComBitPosition=30, ComBitSize=3, ComSignalInitValue=0, ComSignalType=UINT8, ComTimeout=1, ComHandleId=383, ComSystemTemplateSystemSignalRef=UI1_KompFehlerModus4_07
        UI1_KompFehlerModus2_08_XIX_UI1_Komponentenfehler_01_XIX_BMC_CAN01_94a12a9c_Rx: ComBitPosition=26, ComBitSize=2, ComSignalInitValue=0, ComSignalType=UINT8, ComTimeout=1, ComHandleId=358, ComSystemTemplateSystemSignalRef=UI1_KompFehlerModus2_08
        BMC_CMC_Zellspannung_039_XIX_BMC_CMC_Zellspannung_01_XIX_HCP5_CANFD01_4db8058f_Tx: ComBitPosition=468, ComBitSize=12, ComSignalDataInvalidValue=4095, ComSignalInitValue=4094, ComSignalType=UINT16, ComTransferProperty=PENDING, ComHandleId=150, ComSystemTemplateSystemSignalRef=BMC_CMC_Zellspannung_039
    ComGeneral:
      ComConfigurationUseDet = true
      ComSafeBswChecks = false
      ComEnableSignalGroupArrayApi = true
      ComRetryFailedTransmitRequests = true
      ComSupportedIPduGroups = 19
      ComVersionInfoApi = true
      ComMetaDataSupport = false
      ComDeferredEventCacheSupport = false
      ComDescriptionGateway = false
      ComStrictRepetitionPeriod = false
      ComMixedModePeriodicSuppression = false
      ComSignalGateway = NONE
      ComMultiPartition = false
      ComUserCbkHeaderFile = Appl_Cbk.h
