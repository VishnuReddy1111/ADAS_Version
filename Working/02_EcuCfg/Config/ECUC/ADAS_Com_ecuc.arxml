[part 2 of 3: package /ActiveEcuC]
AUTOSAR XML (schema 4-3-0)
package /ActiveEcuC  (continued)
  module config Com: implementation-config-variant=VARIANT-PRE-COMPILE, module-description=Com_Impl  (continued)
    ComConfig: ComConfigurationId=0, ComRxDeferredNotificationCacheSize=1, ComRxImmediateNotificationCacheSize=0  (continued)
      3 x ComSignal, all with ComSignalEndianness=LITTLE_ENDIAN, ComSignalAccess=ACCESS_UNCLEAR:
        UI1_Stromintegral_Laden_XIX_UI1_04_XIX_BMC_CAN01_6b336e8e_Rx: ComBitPosition=32, ComBitSize=16, ComSignalDataInvalidValue=65535, ComSignalInitValue=65534, ComSignalType=UINT16, ComTimeout=1, ComHandleId=398, ComSystemTemplateSystemSignalRef=UI1_Stromintegral_Laden
        BMC_CMC_Temperatur_052_XIX_BMC_CMC_Temperatur_01_XIX_HCP5_CANFD01_2770885b_Tx: ComBitPosition=424, ComBitSize=8, ComSignalDataInvalidValue=255, ComSignalInitValue=254, ComSignalType=UINT8, ComTransferProperty=PENDING, ComHandleId=62, ComSystemTemplateSystemSignalRef=BMC_CMC_Temperatur_052
        BMC_CMC_Zellspannung_097_XIX_BMC_CMC_Zellspannung_03_XIX_HCP5_CANFD01_f4dea05d_Tx: ComBitPosition=228, ComBitSize=12, ComSignalDataInvalidValue=4095, ComSignalInitValue=4094, ComSignalType=UINT16, ComTransferProperty=PENDING, ComHandleId=208, ComSystemTemplateSystemSignalRef=BMC_CMC_Zellspannung_097
      BMC_HV_XIX_PNC_40_Diagnosis_Energy_Rx_36e9c670 (ComIPduGroup): ComIPduGroupHandleId=17
      UI1_KompFehlerModus2_12_XIX_UI1_Komponentenfehler_01_XIX_BMC_CAN01_e957b745_Rx (ComSignal):
        ComBitPosition = 34
        ComBitSize = 2
        ComSignalEndianness = LITTLE_ENDIAN
        ComSignalInitValue = 0
        ComSignalType = UINT8
        ComTimeout = 1
        ComSignalAccess = ACCESS_UNCLEAR
        ComHandleId = 362
        ComSystemTemplateSystemSignalRef = UI1_KompFehlerModus2_12
      SG_KS_Hybrid_01_Challenge_K_XIX_HCP5_CANFD01_aa09b31e_Tx (ComSignalGroup):
        ComTimeout = 0
        ComTransferProperty = TRIGGERED_WITHOUT_REPETITION
        ComSignalGroupAccess = ACCESS_UNCLEAR
        ComHandleId = 7
        ComSystemTemplateSignalGroupRef = SG_KS_Hybrid_01_Challenge_K_XIX_HCP5_CANFD01
        3 x ComGroupSignal, all with ComSignalAccess=ACCESS_UNCLEAR, ComTransferProperty=PENDING:
          KS_Hybrid_01_ChK_IKACtr_XIX_KS_Hybrid_01_Challenge_K_XIX_HCP5_CANFD01_cabdb47b_Tx: ComBitPosition=16, ComBitSize=8, ComSignalEndianness=LITTLE_ENDIAN, ComSignalInitValue=0, ComSignalType=UINT8, ComHandleId=543, ComSystemTemplateSystemSignalRef=KS_Hybrid_01_ChK_IKACtr
          KS_Hybrid_01_ChK_SID_XIX_KS_Hybrid_01_Challenge_K_XIX_HCP5_CANFD01_9b492ca3_Tx: ComBitPosition=0, ComBitSize=16, ComSignalEndianness=LITTLE_ENDIAN, ComSignalInitValue=0, ComSignalType=UINT16, ComHandleId=544, ComSystemTemplateSystemSignalRef=KS_Hybrid_01_ChK_SID
          KS_Hybrid_01_ChK_XIX_KS_Hybrid_01_Challenge_K_XIX_HCP5_CANFD01_1c99de21_Tx: ComBitPosition=24, ComSignalEndianness=opaque, ComSignalInitValue=0 0 0 0 0 0 0 0, ComSignalLength=8, ComSignalType=UINT8_N, ComHandleId=545, ComSystemTemplateSystemSignalRef=KS_Hybrid_01_ChK
      UI1_KompFehlerModus2_10_XIX_UI1_Komponentenfehler_01_XIX_BMC_CAN01_bd07c781_Rx (ComSignal):
        ComBitPosition = 30
        ComBitSize = 2
        ComSignalEndianness = LITTLE_ENDIAN
        ComSignalInitValue = 0
        ComSignalType = UINT8
        ComTimeout = 1
        ComSignalAccess = ACCESS_UNCLEAR
        ComHandleId = 360
        ComSystemTemplateSystemSignalRef = UI1_KompFehlerModus2_10
      OBD_Typ_XIX_OBD_04_XIX_HCP5_CANFD01_f88154eb_Rx (ComSignal):
        ComBitPosition = 25
        ComBitSize = 1
        ComSignalEndianness = LITTLE_ENDIAN
        ComSignalInitValue = 0
        ComSignalType = UINT8
        ComTimeout = 3.2
        ComSignalAccess = ACCESS_UNCLEAR
        ComHandleId = 174
        ComSystemTemplateSystemSignalRef = OBD_Typ
      UI2Sens02_CVN_XIX_BMC_CAN01_5d3dd455_Rx (ComIPdu):
        ComIPduDirection = RECEIVE
        ComIPduType = NORMAL
        ComIPduHandleId = 55
        ComIPduSignalProcessing = DEFERRED
        ComIPduCancellationSupport = false
        ComIPduGroupRef = BMC_HV_XIX_BMC_CAN01_Rx_7b388810
        ComIPduSignalRef = UI2Sens02_CVN_Byte_1_XIX_UI2Sens02_CVN_XIX_BMC_CAN01_d83e206d_Rx
        ComIPduSignalRef = UI2Sens02_CVN_Byte_2_XIX_UI2Sens02_CVN_XIX_BMC_CAN01_83299178_Rx
        ComIPduSignalRef = UI2Sens02_CVN_Byte_3_XIX_UI2Sens02_CVN_XIX_BMC_CAN01_b5db018b_Rx
        ComIPduSignalRef = UI2Sens02_CVN_Byte_4_XIX_UI2Sens02_CVN_XIX_BMC_CAN01_3506f352_Rx
        ComIPduSignalRef = UI2Sens02_CVN_VLD_XIX_UI2Sens02_CVN_XIX_BMC_CAN01_16e7de9a_Rx
        ComPduIdRef = UI2Sens02_CVN_XIX_BMC_CAN01_5d3dd455_Rx
        ComIPduMainFunctionRef = ComMainFunctionRx
      BMC_HV_XIX_PNC_10_Powertrain_Rx_c7039922 (ComIPduGroup): ComIPduGroupHandleId=8
      BMC_CMC_Temperatur_081_XIX_BMC_CMC_Temperatur_03_XIX_HCP5_CANFD01_00677966_Tx (ComSignal):
        ComBitPosition = 80
        ComBitSize = 8
        ComSignalDataInvalidValue = 255
        ComSignalEndianness = LITTLE_ENDIAN
        ComSignalInitValue = 254
        ComSignalType = UINT8
        ComTransferProperty = PENDING
        ComSignalAccess = ACCESS_UNCLEAR
        ComHandleId = 91
        ComSystemTemplateSystemSignalRef = BMC_CMC_Temperatur_081
      BMC_CMC_Zellspannung_057_XIX_BMC_CMC_Zellspannung_02_XIX_HCP5_CANFD01_98336ac3_Tx (ComSignal):
        ComBitPosition = 216
        ComBitSize = 12
        ComSignalDataInvalidValue = 4095
        ComSignalEndianness = LITTLE_ENDIAN
        ComSignalInitValue = 4094
        ComSignalType = UINT16
        ComTransferProperty = PENDING
        ComSignalAccess = ACCESS_UNCLEAR
        ComHandleId = 168
        ComSystemTemplateSystemSignalRef = BMC_CMC_Zellspannung_057
      OBD_Hybrid_01_XIX_HCP5_CANFD01_40f9dae5_Tx (ComIPdu):
        ComIPduDirection = SEND
        ComIPduType = NORMAL
        ComIPduHandleId = 30
        ComIPduSignalProcessing = DEFERRED
        ComIPduCancellationSupport = false
        ComIPduGroupRef = BMC_HV_XIX_HCP5_CANFD01_Tx_3ba05bd9
        ComIPduGroupRef = BMC_HV_XIX_PNC_40_Diagnosis_Energy_Tx_60b361f6
        ComIPduSignalRef = Hybrid_01_Indc_StChk_XIX_OBD_Hybrid_01_XIX_HCP5_CANFD01_0ff5b24f_Tx
        ComIPduSignalRef = Hybrid_01_Indc_StFail_XIX_OBD_Hybrid_01_XIX_HCP5_CANFD01_6c961b98_Tx
        ComIPduSignalRef = OBDProtocol_Hybrid_01_XIX_OBD_Hybrid_01_XIX_HCP5_CANFD01_aa11071d_Tx
        ComPduIdRef = OBD_Hybrid_01_XIX_HCP5_CANFD01_40f9dae5_Tx
        ComIPduMainFunctionRef = ComMainFunctionTx
        ComTxIPdu: ComTxIPduUnusedAreasDefault=0, ComMinimumDelayTime=0
          ComTxModeTrue
            ComTxMode: ComTxModeMode=PERIODIC, ComTxModeTimeOffset=0, ComTxModeTimePeriod=0.32
          ComTxModeFalse
            ComTxMode: ComTxModeMode=NONE
      5 x ComSignal, all with ComSignalEndianness=LITTLE_ENDIAN, ComSignalAccess=ACCESS_UNCLEAR:
        UI2Sens02_CALID_Index_01_XIX_UI2Sens02_CALID_01_XIX_BMC_CAN01_abbdc605_Rx: ComBitPosition=0, ComBitSize=8, ComSignalInitValue=63, ComSignalType=UINT8, ComTimeout=5, ComHandleId=423, ComSystemTemplateSystemSignalRef=UI2Sens02_CALID_Index_01
        DCDC_NV_Komponentenfehler_51_XIX_DCDC_NV_Komponentenfehler_02_XIX_HCP5_CANFD01_2b509fcb_Rx: ComBitPosition=42, ComBitSize=2, ComSignalInitValue=0, ComSignalType=UINT8, ComTimeout=5, ComHandleId=112, ComSystemTemplateSystemSignalRef=DCDC_NV_Komponentenfehler_51
        BMC_CMC_Zellspannung_084_XIX_BMC_CMC_Zellspannung_03_XIX_HCP5_CANFD01_1dfd078d_Tx: ComBitPosition=72, ComBitSize=12, ComSignalDataInvalidValue=4095, ComSignalInitValue=4094, ComSignalType=UINT16, ComTransferProperty=PENDING, ComHandleId=195, ComSystemTemplateSystemSignalRef=BMC_CMC_Zellspannung_084
        DCDC_NV_Komponentenfehler_3_4_XIX_DCDC_NV_Komponentenfehler_04_XIX_HCP5_CANFD01_19650779_Rx: ComBitPosition=9, ComBitSize=3, ComSignalInitValue=0, ComSignalType=UINT8, ComTimeout=5, ComHandleId=49, ComSystemTemplateSystemSignalRef=DCDC_NV_Komponentenfehler_3_4
        BMC_RtmWarnTZelleMin_XIX_BMC_HV_08_XIX_HCP5_CANFD01_7df184bf_Tx: ComBitPosition=46, ComBitSize=3, ComSignalInitValue=0, ComSignalType=UINT8, ComTransferProperty=PENDING, ComHandleId=371, ComSystemTemplateSystemSignalRef=BMC_RtmWarnTZelleMin
      Zeitmaster_05_XIX_HCP5_CANFD01_5eaa5a96_Rx (ComIPdu):
        ComIPduDirection = RECEIVE
        ComIPduType = NORMAL
        ComIPduHandleId = 65
        ComIPduSignalProcessing = DEFERRED
        ComIPduCancellationSupport = false
        ComIPduGroupRef = BMC_HV_XIX_HCP5_CANFD01_Rx_6dfafc5f
        ComIPduGroupRef = BMC_HV_XIX_PNC_27_Timemaster_Timer_Rx_2db6b092
        ComIPduSignalRef = ZM_HV_Auszeit_HiRes_XIX_Zeitmaster_05_XIX_HCP5_CANFD01_2f334ec5_Rx
        ComPduIdRef = Zeitmaster_05_XIX_HCP5_CANFD01_5eaa5a96_Rx
        ComIPduMainFunctionRef = ComMainFunctionRx
      6 x ComSignal, all with ComSignalEndianness=LITTLE_ENDIAN, ComSignalAccess=ACCESS_UNCLEAR:
        OBD_Minimum_Trip_XIX_OBD_03_XIX_HCP5_CANFD01_1da08ec9_Rx: ComBitPosition=60, ComBitSize=1, ComSignalInitValue=0, ComSignalType=UINT8, ComTimeout=3.2, ComHandleId=168, ComSystemTemplateSystemSignalRef=OBD_Minimum_Trip
        UI1_KompFehlerModus4_16_XIX_UI1_Komponentenfehler_02_XIX_BMC_CAN01_fced01ab_Rx: ComBitPosition=57, ComBitSize=3, ComSignalInitValue=0, ComSignalType=UINT8, ComTimeout=1, ComHandleId=392, ComSystemTemplateSystemSignalRef=UI1_KompFehlerModus4_16
        BMC_CMC_Zellspannung_119_XIX_BMC_CMC_Zellspannung_04_XIX_HCP5_CANFD01_46019e7e_Tx: ComBitPosition=24, ComBitSize=12, ComSignalDataInvalidValue=4095, ComSignalInitValue=4094, ComSignalType=UINT16, ComTransferProperty=PENDING, ComHandleId=230, ComSystemTemplateSystemSignalRef=BMC_CMC_Zellspannung_119
        BMC_CMC_Zellspannung_028_XIX_BMC_CMC_Zellspannung_01_XIX_HCP5_CANFD01_5b089579_Tx: ComBitPosition=336, ComBitSize=12, ComSignalDataInvalidValue=4095, ComSignalInitValue=4094, ComSignalType=UINT16, ComTransferProperty=PENDING, ComHandleId=139, ComSystemTemplateSystemSignalRef=BMC_CMC_Zellspannung_028
        BMC_Pack_SN_22_XIX_BMC_HV_08_XIX_HCP5_CANFD01_7dcec4c2_Tx: ComBitPosition=232, ComBitSize=8, ComSignalInitValue=255, ComSignalType=UINT8, ComTransferProperty=PENDING, ComHandleId=355, ComSystemTemplateSystemSignalRef=BMC_Pack_SN_22
        DCDC_NV_Komponentenfehler_53_XIX_DCDC_NV_Komponentenfehler_02_XIX_HCP5_CANFD01_645c7eac_Rx: ComBitPosition=46, ComBitSize=2, ComSignalInitValue=0, ComSignalType=UINT8, ComTimeout=5, ComHandleId=114, ComSystemTemplateSystemSignalRef=DCDC_NV_Komponentenfehler_53
      BJB_13_XIX_BMC_CAN01_E2E_35d3901a_Rx (ComIPdu):
        ComIPduDirection = RECEIVE
        ComIPduType = NORMAL
        ComIPduHandleId = 5
        ComIPduSignalProcessing = DEFERRED
        ComIPduCancellationSupport = false
        ComIPduGroupRef = BMC_HV_XIX_BMC_CAN01_Rx_7b388810
        ComIPduSignalGroupRef = SG_BJB_13_XIX_BMC_CAN01_4a4ad4af_Rx
        ComPduIdRef = BJB_13_XIX_BMC_CAN01_E2E_35d3901a_Rx
        ComIPduMainFunctionRef = ComMainFunctionRx
      4 x ComSignal, all with ComSignalEndianness=LITTLE_ENDIAN, ComSignalAccess=ACCESS_UNCLEAR:
        BMC_CMC_Zellspannung_169_XIX_BMC_CMC_Zellspannung_05_XIX_HCP5_CANFD01_6c4d1ee5_Tx: ComBitPosition=156, ComBitSize=12, ComSignalDataInvalidValue=4095, ComSignalInitValue=4094, ComSignalType=UINT16, ComTransferProperty=PENDING, ComHandleId=280, ComSystemTemplateSystemSignalRef=BMC_CMC_Zellspannung_169
        UI2_KompFehlerModus2_12_XIX_UI2_Komponentenfehler_01_XIX_BMC_CAN01_c799bc45_Rx: ComBitPosition=34, ComBitSize=2, ComSignalInitValue=0, ComSignalType=UINT8, ComTimeout=1, ComHandleId=456, ComSystemTemplateSystemSignalRef=UI2_KompFehlerModus2_12
        BMC_CMC_Zellspannung_116_XIX_BMC_CMC_Zellspannung_03_XIX_HCP5_CANFD01_4b8c80b8_Tx: ComBitPosition=456, ComBitSize=12, ComSignalDataInvalidValue=4095, ComSignalInitValue=4094, ComSignalType=UINT16, ComTransferProperty=PENDING, ComHandleId=227, ComSystemTemplateSystemSignalRef=BMC_CMC_Zellspannung_116
        DCDC_NV_Komponentenfehler_07_XIX_DCDC_NV_Komponentenfehler_01_XIX_HCP5_CANFD01_054d6b78_Rx: ComBitPosition=12, ComBitSize=2, ComSignalInitValue=0, ComSignalType=UINT8, ComTimeout=5, ComHandleId=68, ComSystemTemplateSystemSignalRef=DCDC_NV_Komponentenfehler_07
      SG_BJB_13_XIX_BMC_CAN01_4a4ad4af_Rx (ComSignalGroup):
        ComTransferProperty = TRIGGERED_WITHOUT_REPETITION
        ComSignalGroupAccess = ACCESS_UNCLEAR
        ComHandleId = 3
        ComSystemTemplateSignalGroupRef = SG_BJB_13_XIX_BMC_CAN01
        8 x ComGroupSignal, all with ComSignalEndianness=LITTLE_ENDIAN, ComSignalAccess=ACCESS_UNCLEAR:
          BJB_13_BZ_XIX_BJB_13_XIX_BMC_CAN01_12402006_Rx: ComBitPosition=8, ComBitSize=4, ComSignalInitValue=0, ComSignalType=UINT8, ComHandleId=207, ComSystemTemplateSystemSignalRef=BJB_13_BZ
          BJB_Unterspannungszaehler_CMC03_XIX_BJB_13_XIX_BMC_CAN01_1e0cea0e_Rx: ComBitPosition=30, ComBitSize=9, ComSignalDataInvalidValue=511, ComSignalInitValue=510, ComSignalType=UINT16, ComHandleId=211, ComSystemTemplateSystemSignalRef=BJB_Unterspannungszaehler_CMC03
          BJB_Unterspannungszaehler_CMC01_XIX_BJB_13_XIX_BMC_CAN01_0b46a161_Rx: ComBitPosition=12, ComBitSize=9, ComSignalDataInvalidValue=511, ComSignalInitValue=510, ComSignalType=UINT16, ComHandleId=209, ComSystemTemplateSystemSignalRef=BJB_Unterspannungszaehler_CMC01
          ISignalVoid_BJB_13_XIX_BMC_CAN01_1_f2af384d_Rx: ComBitPosition=56, ComBitSize=8, ComSignalType=UINT8, ComSignalInitValue=0, ComHandleId=214, ComSystemTemplateSystemSignalRef=SignalVoid_BJB_13_1
          BJB_13_CRC_XIX_BJB_13_XIX_BMC_CAN01_b05a6281_Rx: ComBitPosition=0, ComBitSize=8, ComSignalInitValue=0, ComSignalType=UINT8, ComHandleId=208, ComSystemTemplateSystemSignalRef=BJB_13_CRC
          BJB_Unterspannungszaehler_CMC02_XIX_BJB_13_XIX_BMC_CAN01_f9114c99_Rx: ComBitPosition=21, ComBitSize=9, ComSignalDataInvalidValue=511, ComSignalInitValue=510, ComSignalType=UINT16, ComHandleId=210, ComSystemTemplateSystemSignalRef=BJB_Unterspannungszaehler_CMC02
          BJB_Unterspannungszaehler_CMC04_XIX_BJB_13_XIX_BMC_CAN01_c6cf9128_Rx: ComBitPosition=39, ComBitSize=9, ComSignalDataInvalidValue=511, ComSignalInitValue=510, ComSignalType=UINT16, ComHandleId=212, ComSystemTemplateSystemSignalRef=BJB_Unterspannungszaehler_CMC04
          ISignalVoid_BJB_13_XIX_BMC_CAN01_0_85a808db_Rx: ComBitPosition=48, ComBitSize=8, ComSignalType=UINT8, ComSignalInitValue=0, ComHandleId=213, ComSystemTemplateSystemSignalRef=SignalVoid_BJB_13_0
      DCDC_NV_CALID_Index_16_XIX_DCDC_NV_CALID_XIX_HCP5_CANFD01_5317d0f4_Rx (ComSignal):
        ComBitPosition = 120
        ComBitSize = 8
        ComSignalEndianness = LITTLE_ENDIAN
        ComSignalInitValue = 63
        ComSignalType = UINT8
        ComTimeout = 5
        ComSignalAccess = ACCESS_UNCLEAR
        ComHandleId = 40
        ComSystemTemplateSystemSignalRef = DCDC_NV_CALID_Index_16
      OBD_04_XIX_HCP5_CANFD01_100612ed_Rx (ComIPdu):
        ComIPduDirection = RECEIVE
        ComIPduType = NORMAL
        ComIPduHandleId = 31
        ComIPduSignalProcessing = DEFERRED
        ComIPduCancellationSupport = false
        ComIPduGroupRef = BMC_HV_XIX_HCP5_CANFD01_Rx_6dfafc5f
        ComIPduGroupRef = BMC_HV_XIX_PNC_10_Powertrain_Rx_c7039922
        ComIPduSignalRef = MM_PropulsionSystemActive_XIX_OBD_04_XIX_HCP5_CANFD01_e1fc58e2_Rx
        ComIPduSignalRef = OBD_Barometric_Pressure_XIX_OBD_04_XIX_HCP5_CANFD01_26455454_Rx
        ComIPduSignalRef = OBD_Calc_Load_Val_XIX_OBD_04_XIX_HCP5_CANFD01_8b454e40_Rx
        ComIPduSignalRef = OBD_ClearMem_Inhibit_XIX_OBD_04_XIX_HCP5_CANFD01_6714a457_Rx
        ComIPduSignalRef = OBD_Engine_RPM_XIX_OBD_04_XIX_HCP5_CANFD01_78b10114_Rx
        ComIPduSignalRef = OBD_Kaltstart_Denominator_XIX_OBD_04_XIX_HCP5_CANFD01_6c8e10da_Rx
        ComIPduSignalRef = OBD_NumDcyMilOnReq_XIX_OBD_04_XIX_HCP5_CANFD01_fc3c8d9d_Rx
        ComIPduSignalRef = OBD_QBit_Aussen_Temp_XIX_OBD_04_XIX_HCP5_CANFD01_2cf7f3a2_Rx
        ComIPduSignalRef = OBD_Sperrung_IUMPR_XIX_OBD_04_XIX_HCP5_CANFD01_d58d72d8_Rx
        ComIPduSignalRef = OBD_Sperrung_Kaltstart_Denom_XIX_OBD_04_XIX_HCP5_CANFD01_9ec37dc6_Rx
        ComIPduSignalRef = OBD_Typ_XIX_OBD_04_XIX_HCP5_CANFD01_f88154eb_Rx
        ComPduIdRef = OBD_04_XIX_HCP5_CANFD01_100612ed_Rx
        ComIPduMainFunctionRef = ComMainFunctionRx
      20 x ComSignal, all with ComSignalEndianness=LITTLE_ENDIAN, ComSignalAccess=ACCESS_UNCLEAR:
        BMC_CMC_Zellspannung_069_XIX_BMC_CMC_Zellspannung_02_XIX_HCP5_CANFD01_b0d2f85d_Tx: ComBitPosition=360, ComBitSize=12, ComSignalDataInvalidValue=4095, ComSignalInitValue=4094, ComSignalType=UINT16, ComTransferProperty=PENDING, ComHandleId=180, ComSystemTemplateSystemSignalRef=BMC_CMC_Zellspannung_069
        UI1_KompFehlerModus4_03_XIX_UI1_Komponentenfehler_02_XIX_BMC_CAN01_ddf3f00d_Rx: ComBitPosition=18, ComBitSize=3, ComSignalInitValue=0, ComSignalType=UINT8, ComTimeout=1, ComHandleId=379, ComSystemTemplateSystemSignalRef=UI1_KompFehlerModus4_03
        BMC_CMC_Zellspannung_081_XIX_BMC_CMC_Zellspannung_03_XIX_HCP5_CANFD01_4663f413_Tx: ComBitPosition=36, ComBitSize=12, ComSignalDataInvalidValue=4095, ComSignalInitValue=4094, ComSignalType=UINT16, ComTransferProperty=PENDING, ComHandleId=192, ComSystemTemplateSystemSignalRef=BMC_CMC_Zellspannung_081
        BMC_Pack_SN_09_XIX_BMC_HV_08_XIX_HCP5_CANFD01_3a20d9cf_Tx: ComBitPosition=128, ComBitSize=8, ComSignalInitValue=255, ComSignalType=UINT8, ComTransferProperty=PENDING, ComHandleId=342, ComSystemTemplateSystemSignalRef=BMC_Pack_SN_09
        BMC_CMC_Temperatur_082_XIX_BMC_CMC_Temperatur_03_XIX_HCP5_CANFD01_7e1f31c0_Tx: ComBitPosition=88, ComBitSize=8, ComSignalDataInvalidValue=255, ComSignalInitValue=254, ComSignalType=UINT8, ComTransferProperty=PENDING, ComHandleId=92, ComSystemTemplateSystemSignalRef=BMC_CMC_Temperatur_082
        BMC_CMC_Zellspannung_161_XIX_BMC_CMC_Zellspannung_05_XIX_HCP5_CANFD01_24e3ceff_Tx: ComBitPosition=60, ComBitSize=12, ComSignalDataInvalidValue=4095, ComSignalInitValue=4094, ComSignalType=UINT16, ComTransferProperty=PENDING, ComHandleId=272, ComSystemTemplateSystemSignalRef=BMC_CMC_Zellspannung_161
        KN_Hybrid_01_BusKnockOut_XIX_KN_Hybrid_01_XIX_HCP5_CANFD01_b162d19d_Tx: ComBitPosition=30, ComBitSize=2, ComSignalInitValue=0, ComSignalType=UINT8, ComTransferProperty=PENDING, ComHandleId=408, ComSystemTemplateSystemSignalRef=KN_Hybrid_01_BusKnockOut
        BMC_CMC_Zellspannung_125_XIX_BMC_CMC_Zellspannung_04_XIX_HCP5_CANFD01_91733bc6_Tx: ComBitPosition=96, ComBitSize=12, ComSignalDataInvalidValue=4095, ComSignalInitValue=4094, ComSignalType=UINT16, ComTransferProperty=PENDING, ComHandleId=236, ComSystemTemplateSystemSignalRef=BMC_CMC_Zellspannung_125
        UI1_KompFehlerModus2_25_XIX_UI1_Komponentenfehler_01_XIX_BMC_CAN01_004460fe_Rx: ComBitPosition=60, ComBitSize=2, ComSignalInitValue=0, ComSignalType=UINT8, ComTimeout=1, ComHandleId=375, ComSystemTemplateSystemSignalRef=UI1_KompFehlerModus2_25
        BMC_CMC_Temperatur_075_XIX_BMC_CMC_Temperatur_03_XIX_HCP5_CANFD01_68211c2f_Tx: ComBitPosition=32, ComBitSize=8, ComSignalDataInvalidValue=255, ComSignalInitValue=254, ComSignalType=UINT8, ComTransferProperty=PENDING, ComHandleId=85, ComSystemTemplateSystemSignalRef=BMC_CMC_Temperatur_075
        BMC_CMC_Zellspannung_154_XIX_BMC_CMC_Zellspannung_04_XIX_HCP5_CANFD01_2ba4962f_Tx: ComBitPosition=444, ComBitSize=12, ComSignalDataInvalidValue=4095, ComSignalInitValue=4094, ComSignalType=UINT16, ComTransferProperty=PENDING, ComHandleId=265, ComSystemTemplateSystemSignalRef=BMC_CMC_Zellspannung_154
        BMC_CMC_Temperatur_072_XIX_BMC_CMC_Temperatur_02_XIX_HCP5_CANFD01_51ab03e0_Tx: ComBitPosition=120, ComBitSize=8, ComSignalDataInvalidValue=255, ComSignalInitValue=254, ComSignalType=UINT8, ComTransferProperty=PENDING, ComHandleId=82, ComSystemTemplateSystemSignalRef=BMC_CMC_Temperatur_072
        BMC_Dauer_Entladeleistung_XIX_BMC_HV_03_XIX_HCP5_CANFD01_eeda29b5_Tx: ComBitPosition=68, ComBitSize=12, ComSignalDataInvalidValue=4095, ComSignalInitValue=4094, ComSignalType=UINT16, ComTransferProperty=PENDING, ComHandleId=305, ComSystemTemplateSystemSignalRef=BMC_Dauer_Entladeleistung
        BMC_CMC_Zellspannung_085_XIX_BMC_CMC_Zellspannung_03_XIX_HCP5_CANFD01_62349c1e_Tx: ComBitPosition=84, ComBitSize=12, ComSignalDataInvalidValue=4095, ComSignalInitValue=4094, ComSignalType=UINT16, ComTransferProperty=PENDING, ComHandleId=196, ComSystemTemplateSystemSignalRef=BMC_CMC_Zellspannung_085
        BMC_CMC_Temperatur_017_XIX_BMC_CMC_Temperatur_01_XIX_HCP5_CANFD01_4633fa42_Tx: ComBitPosition=144, ComBitSize=8, ComSignalDataInvalidValue=255, ComSignalInitValue=254, ComSignalType=UINT8, ComTransferProperty=PENDING, ComHandleId=27, ComSystemTemplateSystemSignalRef=BMC_CMC_Temperatur_017
        VIN_10_XIX_WFS_02_XIX_HCP5_CANFD01_8d48ee8f_Rx: ComBitPosition=88, ComBitSize=8, ComSignalInitValue=45, ComSignalType=UINT8, ComTimeout=4, ComHandleId=502, ComSystemTemplateSystemSignalRef=VIN_10
        BMC_CMC_Temperatur_028_XIX_BMC_CMC_Temperatur_01_XIX_HCP5_CANFD01_2510e8a8_Tx: ComBitPosition=232, ComBitSize=8, ComSignalDataInvalidValue=255, ComSignalInitValue=254, ComSignalType=UINT8, ComTransferProperty=PENDING, ComHandleId=38, ComSystemTemplateSystemSignalRef=BMC_CMC_Temperatur_028
        BMC_CMC_Zellspannung_128_XIX_BMC_CMC_Zellspannung_04_XIX_HCP5_CANFD01_82431842_Tx: ComBitPosition=132, ComBitSize=12, ComSignalDataInvalidValue=4095, ComSignalInitValue=4094, ComSignalType=UINT16, ComTransferProperty=PENDING, ComHandleId=239, ComSystemTemplateSystemSignalRef=BMC_CMC_Zellspannung_128
        BMC_IstTemperaturMin_Modul_ID_XIX_BMC_HV_08_XIX_HCP5_CANFD01_688b548e_Tx: ComBitPosition=280, ComBitSize=8, ComSignalInitValue=255, ComSignalType=UINT8, ComTransferProperty=PENDING, ComHandleId=314, ComSystemTemplateSystemSignalRef=BMC_IstTemperaturMin_Modul_ID
        BMC_CMC_Temperatur_022_XIX_BMC_CMC_Temperatur_01_XIX_HCP5_CANFD01_fb705d3d_Tx: ComBitPosition=184, ComBitSize=8, ComSignalDataInvalidValue=255, ComSignalInitValue=254, ComSignalType=UINT8, ComTransferProperty=PENDING, ComHandleId=32, ComSystemTemplateSystemSignalRef=BMC_CMC_Temperatur_022
      UI2Sens01_CALID_01_XIX_BMC_CAN01_f3c92280_Rx (ComIPdu):
        ComIPduDirection = RECEIVE
        ComIPduType = NORMAL
        ComIPduHandleId = 50
        ComIPduSignalProcessing = DEFERRED
        ComIPduCancellationSupport = false
        ComIPduGroupRef = BMC_HV_XIX_BMC_CAN01_Rx_7b388810
        ComIPduSignalRef = UI2Sens01_CALID_Index_01_XIX_UI2Sens01_CALID_01_XIX_BMC_CAN01_70cabfee_Rx
        ComIPduSignalRef = UI2Sens01_CALID_Index_02_XIX_UI2Sens01_CALID_01_XIX_BMC_CAN01_3d22bf89_Rx
        ComIPduSignalRef = UI2Sens01_CALID_Index_03_XIX_UI2Sens01_CALID_01_XIX_BMC_CAN01_b0aa426b_Rx
        ComIPduSignalRef = UI2Sens01_CALID_Index_04_XIX_UI2Sens01_CALID_01_XIX_BMC_CAN01_a6f2bf47_Rx
        ComIPduSignalRef = UI2Sens01_CALID_Index_05_XIX_UI2Sens01_CALID_01_XIX_BMC_CAN01_2b7a42a5_Rx
        ComIPduSignalRef = UI2Sens01_CALID_Index_06_XIX_UI2Sens01_CALID_01_XIX_BMC_CAN01_669242c2_Rx
        ComIPduSignalRef = UI2Sens01_CALID_Index_07_XIX_UI2Sens01_CALID_01_XIX_BMC_CAN01_eb1abf20_Rx
        ComIPduSignalRef = UI2Sens01_CALID_Index_08_XIX_UI2Sens01_CALID_01_XIX_BMC_CAN01_4a23b89a_Rx
        ComPduIdRef = UI2Sens01_CALID_01_XIX_BMC_CAN01_f3c92280_Rx
        ComIPduMainFunctionRef = ComMainFunctionRx
      22 x ComSignal, all with ComSignalEndianness=LITTLE_ENDIAN, ComSignalAccess=ACCESS_UNCLEAR:
        UI2_KompFehlerModus4_13_XIX_UI2_Komponentenfehler_02_XIX_BMC_CAN01_50abd341_Rx: ComBitPosition=48, ComBitSize=3, ComSignalInitValue=0, ComSignalType=UINT8, ComTimeout=1, ComHandleId=483, ComSystemTemplateSystemSignalRef=UI2_KompFehlerModus4_13
        BMC_CMC_Temperatur_003_XIX_BMC_CMC_Temperatur_01_XIX_HCP5_CANFD01_4d053386_Tx: ComBitPosition=32, ComBitSize=8, ComSignalDataInvalidValue=255, ComSignalInitValue=254, ComSignalType=UINT8, ComTransferProperty=PENDING, ComHandleId=13, ComSystemTemplateSystemSignalRef=BMC_CMC_Temperatur_003
        BMC_CMC_Temperatur_001_XIX_BMC_CMC_Temperatur_01_XIX_HCP5_CANFD01_19554342_Tx: ComBitPosition=16, ComBitSize=8, ComSignalDataInvalidValue=255, ComSignalInitValue=254, ComSignalType=UINT8, ComTransferProperty=PENDING, ComHandleId=11, ComSystemTemplateSystemSignalRef=BMC_CMC_Temperatur_001
        BMC_CMC_Temperatur_031_XIX_BMC_CMC_Temperatur_01_XIX_HCP5_CANFD01_269e3dd7_Tx: ComBitPosition=256, ComBitSize=8, ComSignalDataInvalidValue=255, ComSignalInitValue=254, ComSignalType=UINT8, ComTransferProperty=PENDING, ComHandleId=41, ComSystemTemplateSystemSignalRef=BMC_CMC_Temperatur_031
        BMC_CMC_Zellspannung_192_XIX_BMC_CMC_Zellspannung_05_XIX_HCP5_CANFD01_9c8d039a_Tx: ComBitPosition=432, ComBitSize=12, ComSignalDataInvalidValue=4095, ComSignalInitValue=4094, ComSignalType=UINT16, ComTransferProperty=PENDING, ComHandleId=303, ComSystemTemplateSystemSignalRef=BMC_CMC_Zellspannung_192
        BMC_CMC_Temperatur_055_XIX_BMC_CMC_Temperatur_01_XIX_HCP5_CANFD01_f1a82175_Tx: ComBitPosition=448, ComBitSize=8, ComSignalDataInvalidValue=255, ComSignalInitValue=254, ComSignalType=UINT8, ComTransferProperty=PENDING, ComHandleId=65, ComSystemTemplateSystemSignalRef=BMC_CMC_Temperatur_055
        NM_Hybrid_01_NM_State_XIX_NM_Hybrid_01_XIX_HCP5_CANFD01_9a9758f9_Tx: ComBitPosition=136, ComBitSize=6, ComSignalInitValue=0, ComSignalType=UINT8, ComTransferProperty=TRIGGERED, ComHandleId=417, ComSystemTemplateSystemSignalRef=NM_Hybrid_01_NM_State
        DCDC_NV_CALID_Index_05_XIX_DCDC_NV_CALID_XIX_HCP5_CANFD01_b707bc15_Rx: ComBitPosition=32, ComBitSize=8, ComSignalInitValue=63, ComSignalType=UINT8, ComTimeout=5, ComHandleId=29, ComSystemTemplateSystemSignalRef=DCDC_NV_CALID_Index_05
        DCDC_NV_CVN_Byte_1_XIX_DCDC_NV_CVN_XIX_HCP5_CANFD01_f6f9fc9d_Rx: ComBitPosition=1, ComBitSize=8, ComSignalInitValue=0, ComSignalType=UINT8, ComTimeout=5, ComHandleId=41, ComSystemTemplateSystemSignalRef=DCDC_NV_CVN_Byte_1
        SI_T_Mode_XIX_Systeminfo_01_XIX_HCP5_CANFD01_01a376d2_Rx: ComBitPosition=9, ComBitSize=1, ComSignalInitValue=0, ComSignalType=UINT8, ComTimeout=5, ComHandleId=337, ComSystemTemplateSystemSignalRef=SI_T_Mode
        DCDC_NV_CALID_Index_02_XIX_DCDC_NV_CALID_XIX_HCP5_CANFD01_ebb79f7c_Rx: ComBitPosition=8, ComBitSize=8, ComSignalInitValue=63, ComSignalType=UINT8, ComTimeout=5, ComHandleId=26, ComSystemTemplateSystemSignalRef=DCDC_NV_CALID_Index_02
        UI2Sens01_CALID_Index_10_XIX_UI2Sens01_CALID_02_XIX_BMC_CAN01_a2b623dc_Rx: ComBitPosition=8, ComBitSize=8, ComSignalInitValue=63, ComSignalType=UINT8, ComTimeout=5, ComHandleId=410, ComSystemTemplateSystemSignalRef=UI2Sens01_CALID_Index_10
        BMC_CMC_Zellspannung_076_XIX_BMC_CMC_Zellspannung_02_XIX_HCP5_CANFD01_3508e79a_Tx: ComBitPosition=444, ComBitSize=12, ComSignalDataInvalidValue=4095, ComSignalInitValue=4094, ComSignalType=UINT16, ComTransferProperty=PENDING, ComHandleId=187, ComSystemTemplateSystemSignalRef=BMC_CMC_Zellspannung_076
        DCDC_NV_Komponentenfehler_50_XIX_DCDC_NV_Komponentenfehler_02_XIX_HCP5_CANFD01_e16e6c58_Rx: ComBitPosition=40, ComBitSize=2, ComSignalInitValue=0, ComSignalType=UINT8, ComTimeout=5, ComHandleId=111, ComSystemTemplateSystemSignalRef=DCDC_NV_Komponentenfehler_50
        BMC_CMC_Temperatur_053_XIX_BMC_CMC_Temperatur_01_XIX_HCP5_CANFD01_0d58b039_Tx: ComBitPosition=432, ComBitSize=8, ComSignalDataInvalidValue=255, ComSignalInitValue=254, ComSignalType=UINT8, ComTransferProperty=PENDING, ComHandleId=63, ComSystemTemplateSystemSignalRef=BMC_CMC_Temperatur_053
        UI2_KompFehlerModus4_02_XIX_UI2_Komponentenfehler_02_XIX_BMC_CAN01_d915c36f_Rx: ComBitPosition=15, ComBitSize=3, ComSignalInitValue=0, ComSignalType=UINT8, ComTimeout=1, ComHandleId=472, ComSystemTemplateSystemSignalRef=UI2_KompFehlerModus4_02
        OBD_Engine_RPM_XIX_OBD_04_XIX_HCP5_CANFD01_78b10114_Rx: ComBitPosition=40, ComBitSize=16, ComSignalInitValue=0, ComSignalType=UINT16, ComTimeout=3.2, ComHandleId=166, ComSystemTemplateSystemSignalRef=OBD_Engine_RPM
        BMC_CMC_Temperatur_078_XIX_BMC_CMC_Temperatur_03_XIX_HCP5_CANFD01_60990094_Tx: ComBitPosition=56, ComBitSize=8, ComSignalDataInvalidValue=255, ComSignalInitValue=254, ComSignalType=UINT8, ComTransferProperty=PENDING, ComHandleId=88, ComSystemTemplateSystemSignalRef=BMC_CMC_Temperatur_078
        BMC_CMC_Zellspannung_164_XIX_BMC_CMC_Zellspannung_05_XIX_HCP5_CANFD01_7f7d3d61_Tx: ComBitPosition=96, ComBitSize=12, ComSignalDataInvalidValue=4095, ComSignalInitValue=4094, ComSignalType=UINT16, ComTransferProperty=PENDING, ComHandleId=275, ComSystemTemplateSystemSignalRef=BMC_CMC_Zellspannung_164
        BMC_CMC_Temperatur_048_XIX_BMC_CMC_Temperatur_01_XIX_HCP5_CANFD01_5a861582_Tx: ComBitPosition=392, ComBitSize=8, ComSignalDataInvalidValue=255, ComSignalInitValue=254, ComSignalType=UINT8, ComTransferProperty=PENDING, ComHandleId=58, ComSystemTemplateSystemSignalRef=BMC_CMC_Temperatur_048
        DCDC_NV_Komponentenfehler_3_11_XIX_DCDC_NV_Komponentenfehler_04_XIX_HCP5_CANFD01_97af544b_Rx: ComBitPosition=30, ComBitSize=3, ComSignalInitValue=0, ComSignalType=UINT8, ComTimeout=5, ComHandleId=56, ComSystemTemplateSystemSignalRef=DCDC_NV_Komponentenfehler_3_11
        BJB_CALID_Index_10_XIX_BJB_CALID_02_XIX_BMC_CAN01_c2b281d7_Rx: ComBitPosition=8, ComBitSize=8, ComSignalInitValue=63, ComSignalType=UINT8, ComTimeout=5, ComHandleId=10, ComSystemTemplateSystemSignalRef=BJB_CALID_Index_10
      BMC_CMC_Temperatur_03_XIX_HCP5_CANFD01_160139b6_Tx (ComIPdu):
        ComIPduDirection = SEND
        ComIPduType = NORMAL
        ComIPduHandleId = 2
        ComIPduSignalProcessing = DEFERRED
        ComIPduCancellationSupport = false
        ComIPduGroupRef = BMC_HV_XIX_HCP5_CANFD01_Tx_3ba05bd9
        ComIPduGroupRef = BMC_HV_XIX_PNC_26_HighVoltage_Charging_Tx_20012544
        ComIPduSignalRef = BMC_CMC_Temperatur_03_Messzeit_XIX_BMC_CMC_Temperatur_03_XIX_HCP5_CANFD01_1da1d48d_Tx
        ComIPduSignalRef = BMC_CMC_Temperatur_073_XIX_BMC_CMC_Temperatur_03_XIX_HCP5_CANFD01_94d18d63_Tx
        ComIPduSignalRef = BMC_CMC_Temperatur_074_XIX_BMC_CMC_Temperatur_03_XIX_HCP5_CANFD01_4209244d_Tx
        ComIPduSignalRef = BMC_CMC_Temperatur_075_XIX_BMC_CMC_Temperatur_03_XIX_HCP5_CANFD01_68211c2f_Tx
        ComIPduSignalRef = BMC_CMC_Temperatur_076_XIX_BMC_CMC_Temperatur_03_XIX_HCP5_CANFD01_16595489_Tx
        ComIPduSignalRef = BMC_CMC_Temperatur_077_XIX_BMC_CMC_Temperatur_03_XIX_HCP5_CANFD01_3c716ceb_Tx
        ComIPduSignalRef = BMC_CMC_Temperatur_078_XIX_BMC_CMC_Temperatur_03_XIX_HCP5_CANFD01_60990094_Tx
        ComIPduSignalRef = BMC_CMC_Temperatur_079_XIX_BMC_CMC_Temperatur_03_XIX_HCP5_CANFD01_4ab138f6_Tx
        ComIPduSignalRef = BMC_CMC_Temperatur_080_XIX_BMC_CMC_Temperatur_03_XIX_HCP5_CANFD01_2a4f4104_Tx
        ComIPduSignalRef = BMC_CMC_Temperatur_081_XIX_BMC_CMC_Temperatur_03_XIX_HCP5_CANFD01_00677966_Tx
        ComIPduSignalRef = BMC_CMC_Temperatur_082_XIX_BMC_CMC_Temperatur_03_XIX_HCP5_CANFD01_7e1f31c0_Tx
        ComIPduSignalRef = BMC_CMC_Temperatur_083_XIX_BMC_CMC_Temperatur_03_XIX_HCP5_CANFD01_543709a2_Tx
        ComIPduSignalRef = BMC_CMC_Temperatur_084_XIX_BMC_CMC_Temperatur_03_XIX_HCP5_CANFD01_82efa08c_Tx
        ComIPduSignalRef = BMC_CMC_Temperatur_085_XIX_BMC_CMC_Temperatur_03_XIX_HCP5_CANFD01_a8c798ee_Tx
        ComIPduSignalRef = BMC_CMC_Temperatur_086_XIX_BMC_CMC_Temperatur_03_XIX_HCP5_CANFD01_d6bfd048_Tx
        ComIPduSignalRef = BMC_CMC_Temperatur_087_XIX_BMC_CMC_Temperatur_03_XIX_HCP5_CANFD01_fc97e82a_Tx
        ComIPduSignalRef = BMC_CMC_Temperatur_088_XIX_BMC_CMC_Temperatur_03_XIX_HCP5_CANFD01_a07f8455_Tx
        ComIPduSignalRef = BMC_CMC_Temperatur_089_XIX_BMC_CMC_Temperatur_03_XIX_HCP5_CANFD01_8a57bc37_Tx
        ComIPduSignalRef = BMC_CMC_Temperatur_090_XIX_BMC_CMC_Temperatur_03_XIX_HCP5_CANFD01_89d96948_Tx
        ComIPduSignalRef = BMC_CMC_Temperatur_091_XIX_BMC_CMC_Temperatur_03_XIX_HCP5_CANFD01_a3f1512a_Tx
        ComIPduSignalRef = BMC_CMC_Temperatur_092_XIX_BMC_CMC_Temperatur_03_XIX_HCP5_CANFD01_dd89198c_Tx
        ComIPduSignalRef = BMC_CMC_Temperatur_093_XIX_BMC_CMC_Temperatur_03_XIX_HCP5_CANFD01_f7a121ee_Tx
        ComIPduSignalRef = BMC_CMC_Temperatur_094_XIX_BMC_CMC_Temperatur_03_XIX_HCP5_CANFD01_217988c0_Tx
        ComIPduSignalRef = BMC_CMC_Temperatur_095_XIX_BMC_CMC_Temperatur_03_XIX_HCP5_CANFD01_0b51b0a2_Tx
        ComIPduSignalRef = BMC_CMC_Temperatur_096_XIX_BMC_CMC_Temperatur_03_XIX_HCP5_CANFD01_7529f804_Tx
        ComPduIdRef = BMC_CMC_Temperatur_03_XIX_HCP5_CANFD01_160139b6_Tx
        ComIPduMainFunctionRef = ComMainFunctionTx
        ComTxIPdu: ComTxIPduUnusedAreasDefault=0, ComMinimumDelayTime=0
          ComTxModeTrue
            ComTxMode: ComTxModeMode=PERIODIC, ComTxModeTimeOffset=0, ComTxModeTimePeriod=1
          ComTxModeFalse
            ComTxMode: ComTxModeMode=NONE
      BMC_CMC_Temperatur_006_XIX_BMC_CMC_Temperatur_01_XIX_HCP5_CANFD01_cf8dea6c_Tx (ComSignal):
        ComBitPosition = 56
        ComBitSize = 8
        ComSignalDataInvalidValue = 255
        ComSignalEndianness = LITTLE_ENDIAN
        ComSignalInitValue = 254
        ComSignalType = UINT8
        ComTransferProperty = PENDING
        ComSignalAccess = ACCESS_UNCLEAR
        ComHandleId = 16
        ComSystemTemplateSystemSignalRef = BMC_CMC_Temperatur_006
      BMC_HV_XIX_PNC_40_Diagnosis_Energy_Tx_60b361f6 (ComIPduGroup): ComIPduGroupHandleId=18
      4 x ComSignal, all with ComSignalEndianness=LITTLE_ENDIAN, ComSignalAccess=ACCESS_UNCLEAR:
        UI2_KompFehlerModus2_15_XIX_UI2_Komponentenfehler_01_XIX_BMC_CAN01_1141156b_Rx: ComBitPosition=40, ComBitSize=2, ComSignalInitValue=0, ComSignalType=UINT8, ComTimeout=1, ComHandleId=459, ComSystemTemplateSystemSignalRef=UI2_KompFehlerModus2_15
        UI1_KompFehlerModus2_07_XIX_UI1_Komponentenfehler_01_XIX_BMC_CAN01_c84946e3_Rx: ComBitPosition=24, ComBitSize=2, ComSignalInitValue=0, ComSignalType=UINT8, ComTimeout=1, ComHandleId=357, ComSystemTemplateSystemSignalRef=UI1_KompFehlerModus2_07
        BMC_CMC_Zellspannung_144_XIX_BMC_CMC_Zellspannung_04_XIX_HCP5_CANFD01_42dd9d4a_Tx: ComBitPosition=324, ComBitSize=12, ComSignalDataInvalidValue=4095, ComSignalInitValue=4094, ComSignalType=UINT16, ComTransferProperty=PENDING, ComHandleId=255, ComSystemTemplateSystemSignalRef=BMC_CMC_Zellspannung_144
        UI2Sens02_CALID_Index_13_XIX_UI2Sens02_CALID_02_XIX_BMC_CAN01_34295a50_Rx: ComBitPosition=32, ComBitSize=8, ComSignalInitValue=63, ComSignalType=UINT8, ComTimeout=5, ComHandleId=435, ComSystemTemplateSystemSignalRef=UI2Sens02_CALID_Index_13
      WFS_02_XIX_HCP5_CANFD01_61136cb6_Rx (ComIPdu):
        ComIPduDirection = RECEIVE
        ComIPduType = NORMAL
        ComIPduHandleId = 63
        ComIPduSignalProcessing = DEFERRED
        ComIPduCancellationSupport = false
        ComIPduGroupRef = BMC_HV_XIX_HCP5_CANFD01_Rx_6dfafc5f
        ComIPduGroupRef = BMC_HV_XIX_PNC_06_Basefunction_ComfortLight_Rx_7861a7a5
        ComIPduSignalRef = VIN_10_XIX_WFS_02_XIX_HCP5_CANFD01_8d48ee8f_Rx
        ComIPduSignalRef = VIN_11_XIX_WFS_02_XIX_HCP5_CANFD01_ee4f37ab_Rx
        ComIPduSignalRef = VIN_12_XIX_WFS_02_XIX_HCP5_CANFD01_4b475cc7_Rx
        ComIPduSignalRef = VIN_13_XIX_WFS_02_XIX_HCP5_CANFD01_284085e3_Rx
        ComIPduSignalRef = VIN_14_XIX_WFS_02_XIX_HCP5_CANFD01_da268c5e_Rx
        ComIPduSignalRef = VIN_15_XIX_WFS_02_XIX_HCP5_CANFD01_b921557a_Rx
        ComIPduSignalRef = VIN_16_XIX_WFS_02_XIX_HCP5_CANFD01_1c293e16_Rx
        ComIPduSignalRef = VIN_17_XIX_WFS_02_XIX_HCP5_CANFD01_7f2ee732_Rx
        ComIPduSignalRef = VIN_1_XIX_WFS_02_XIX_HCP5_CANFD01_7a318e94_Rx
        ComIPduSignalRef = VIN_2_XIX_WFS_02_XIX_HCP5_CANFD01_df39e5f8_Rx
        ComIPduSignalRef = VIN_3_XIX_WFS_02_XIX_HCP5_CANFD01_bc3e3cdc_Rx
        ComIPduSignalRef = VIN_4_XIX_WFS_02_XIX_HCP5_CANFD01_4e583561_Rx
        ComIPduSignalRef = VIN_5_XIX_WFS_02_XIX_HCP5_CANFD01_2d5fec45_Rx
        ComIPduSignalRef = VIN_6_XIX_WFS_02_XIX_HCP5_CANFD01_88578729_Rx
        ComIPduSignalRef = VIN_7_XIX_WFS_02_XIX_HCP5_CANFD01_eb505e0d_Rx
        ComIPduSignalRef = VIN_8_XIX_WFS_02_XIX_HCP5_CANFD01_b7ea9212_Rx
        ComIPduSignalRef = VIN_9_XIX_WFS_02_XIX_HCP5_CANFD01_d4ed4b36_Rx
        ComPduIdRef = WFS_02_XIX_HCP5_CANFD01_61136cb6_Rx
        ComIPduMainFunctionRef = ComMainFunctionRx
      UH_Sekunde_XIX_Diagnose_01_XIX_HCP5_CANFD01_7411385f_Rx (ComSignal):
        ComBitPosition = 55
        ComBitSize = 6
        ComSignalEndianness = LITTLE_ENDIAN
        ComSignalInitValue = 0
        ComSignalType = UINT8
        ComTimeout = 5
        ComSignalAccess = ACCESS_UNCLEAR
        ComHandleId = 345
        ComSystemTemplateSystemSignalRef = UH_Sekunde
      BMC_HV_XIX_PNC_24_ThermoManagement_Rx_9f1a6723 (ComIPduGroup): ComIPduGroupHandleId=11
      6 x ComSignal, all with ComSignalEndianness=LITTLE_ENDIAN, ComSignalType=UINT8, ComSignalAccess=ACCESS_UNCLEAR:
        UI2_KompFehlerModus4_10_XIX_UI2_Komponentenfehler_02_XIX_BMC_CAN01_2ed39be7_Rx: ComBitPosition=39, ComBitSize=3, ComSignalInitValue=0, ComTimeout=1, ComHandleId=480, ComSystemTemplateSystemSignalRef=UI2_KompFehlerModus4_10
        BMC_Pack_SN_18_XIX_BMC_HV_08_XIX_HCP5_CANFD01_fd084c96_Tx: ComBitPosition=200, ComBitSize=8, ComSignalInitValue=255, ComTransferProperty=PENDING, ComHandleId=351, ComSystemTemplateSystemSignalRef=BMC_Pack_SN_18
        BJB_CALID_Index_13_XIX_BJB_CALID_02_XIX_BMC_CAN01_0bad8968_Rx: ComBitPosition=32, ComBitSize=8, ComSignalInitValue=63, ComTimeout=5, ComHandleId=13, ComSystemTemplateSystemSignalRef=BJB_CALID_Index_13
        UI2Sens02_CALID_Index_02_XIX_UI2Sens02_CALID_01_XIX_BMC_CAN01_e655c662_Rx: ComBitPosition=8, ComBitSize=8, ComSignalInitValue=63, ComTimeout=5, ComHandleId=424, ComSystemTemplateSystemSignalRef=UI2Sens02_CALID_Index_02
        BMC_CMC_Temperatur_035_XIX_BMC_CMC_Temperatur_01_XIX_HCP5_CANFD01_8e3edc5f_Tx: ComBitPosition=288, ComBitSize=8, ComSignalDataInvalidValue=255, ComSignalInitValue=254, ComTransferProperty=PENDING, ComHandleId=45, ComSystemTemplateSystemSignalRef=BMC_CMC_Temperatur_035
        SI_P_Mode_XIX_Systeminfo_01_XIX_HCP5_CANFD01_171f38d4_Rx: ComBitPosition=15, ComBitSize=1, ComSignalInitValue=0, ComTimeout=5, ComHandleId=335, ComSystemTemplateSystemSignalRef=SI_P_Mode
      SG_BMC_HV_04_XIX_BMC_CAN01_0c592380_Tx (ComSignalGroup):
        ComTransferProperty = TRIGGERED_WITHOUT_REPETITION
        ComSignalGroupAccess = ACCESS_NEEDED_BY_SWC_OR_COM
        ComHandleId = 2
        ComErrorNotification = ComErrorNotification_SG_BMC_HV_04_XIX_BMC_CAN01_0c592380_Tx
        ComSystemTemplateSignalGroupRef = SG_BMC_HV_04_XIX_BMC_CAN01
        15 x ComGroupSignal, all with ComSignalEndianness=LITTLE_ENDIAN, ComSignalInitValue=0, ComSignalType=UINT8, ComTransferProperty=PENDING:
          BMC_UI1_Spannung1_Schalt_Anf_XIX_BMC_HV_04_XIX_BMC_CAN01_6fcc6b71_Tx: ComBitPosition=15, ComBitSize=1, ComSignalAccess=ACCESS_UNCLEAR, ComHandleId=500, ComSystemTemplateSystemSignalRef=BMC_UI1_Spannung1_Schalt_Anf
          ISignalVoid_BMC_HV_04_XIX_BMC_CAN01_3_9417ab30_Tx: ComBitPosition=40, ComBitSize=8, ComSignalAccess=ACCESS_UNCLEAR, ComHandleId=507, ComSystemTemplateSystemSignalRef=SignalVoid_BMC_HV_04_3
          ISignalVoid_BMC_HV_04_XIX_BMC_CAN01_0_0d1efa8a_Tx: ComBitPosition=21, ComBitSize=3, ComSignalAccess=ACCESS_UNCLEAR, ComHandleId=504, ComSystemTemplateSystemSignalRef=SignalVoid_BMC_HV_04_0
          ISignalVoid_BMC_HV_04_XIX_BMC_CAN01_5_7d740e05_Tx: ComBitPosition=56, ComBitSize=8, ComSignalAccess=ACCESS_UNCLEAR, ComHandleId=509, ComSystemTemplateSystemSignalRef=SignalVoid_BMC_HV_04_5
          BMC_HV_04_BZ_XIX_BMC_HV_04_XIX_BMC_CAN01_508387a5_Tx: ComBitPosition=8, ComBitSize=4, ComSignalAccess=ACCESS_NEEDED_BY_SWC_OR_COM, ComHandleId=497, ComSystemTemplateSystemSignalRef=BMC_HV_04_BZ
          BMC_UI2_Spannung2_Schalt_Anf_XIX_BMC_HV_04_XIX_BMC_CAN01_1252f7ab_Tx: ComBitPosition=18, ComBitSize=1, ComSignalAccess=ACCESS_UNCLEAR, ComHandleId=503, ComSystemTemplateSystemSignalRef=BMC_UI2_Spannung2_Schalt_Anf
          BMC_Dev_Freigabe_XIX_BMC_HV_04_XIX_BMC_CAN01_61d04ea4_Tx: ComBitPosition=20, ComBitSize=1, ComSignalAccess=ACCESS_NEEDED_BY_SWC_OR_COM, ComHandleId=495, ComSystemTemplateSystemSignalRef=BMC_Dev_Freigabe
          BMC_Iso_Mode_Anf_XIX_BMC_HV_04_XIX_BMC_CAN01_4e14e0ef_Tx: ComBitPosition=12, ComBitSize=3, ComSignalAccess=ACCESS_NEEDED_BY_SWC_OR_COM, ComHandleId=499, ComSystemTemplateSystemSignalRef=BMC_Iso_Mode_Anf
          ISignalVoid_BMC_HV_04_XIX_BMC_CAN01_2_e3109ba6_Tx: ComBitPosition=32, ComBitSize=8, ComSignalAccess=ACCESS_UNCLEAR, ComHandleId=506, ComSystemTemplateSystemSignalRef=SignalVoid_BMC_HV_04_2
          ISignalVoid_BMC_HV_04_XIX_BMC_CAN01_4_0a733e93_Tx: ComBitPosition=48, ComBitSize=8, ComSignalAccess=ACCESS_UNCLEAR, ComHandleId=508, ComSystemTemplateSystemSignalRef=SignalVoid_BMC_HV_04_4
          BMC_Flash_Freigabe_XIX_BMC_HV_04_XIX_BMC_CAN01_b37a831f_Tx: ComBitPosition=19, ComBitSize=1, ComSignalAccess=ACCESS_NEEDED_BY_SWC_OR_COM, ComHandleId=496, ComSystemTemplateSystemSignalRef=BMC_Flash_Freigabe
          BMC_UI1_Spannung2_Schalt_Anf_XIX_BMC_HV_04_XIX_BMC_CAN01_4570dbf9_Tx: ComBitPosition=16, ComBitSize=1, ComSignalAccess=ACCESS_UNCLEAR, ComHandleId=501, ComSystemTemplateSystemSignalRef=BMC_UI1_Spannung2_Schalt_Anf
          BMC_UI2_Spannung1_Schalt_Anf_XIX_BMC_HV_04_XIX_BMC_CAN01_38ee4723_Tx: ComBitPosition=17, ComBitSize=1, ComSignalAccess=ACCESS_UNCLEAR, ComHandleId=502, ComSystemTemplateSystemSignalRef=BMC_UI2_Spannung1_Schalt_Anf
          BMC_HV_04_CRC_XIX_BMC_HV_04_XIX_BMC_CAN01_c70be3e6_Tx: ComBitPosition=0, ComBitSize=8, ComSignalAccess=ACCESS_NEEDED_BY_SWC_OR_COM, ComHandleId=498, ComSystemTemplateSystemSignalRef=BMC_HV_04_CRC
          ISignalVoid_BMC_HV_04_XIX_BMC_CAN01_1_7a19ca1c_Tx: ComBitPosition=24, ComBitSize=8, ComSignalAccess=ACCESS_UNCLEAR, ComHandleId=505, ComSystemTemplateSystemSignalRef=SignalVoid_BMC_HV_04_1
      ComIPduPnc_EIRA_CAN_Rx (ComIPdu):
        ComIPduDirection = RECEIVE
        ComIPduHandleId = 11
        ComIPduSignalProcessing = DEFERRED
        ComIPduType = NORMAL
        ComIPduCancellationSupport = false
        ComIPduSignalRef = ComSignalPnc_EIRA_CAN_Rx
        ComPduIdRef = PduPnc_EIRA_CAN_Rx
        ComIPduMainFunctionRef = ComMainFunctionRx
      BJB_CVN_Byte_1_XIX_BJB_CVN_01_XIX_BMC_CAN01_18856d37_Rx (ComSignal):
        ComBitPosition = 1
        ComBitSize = 8
        ComSignalEndianness = LITTLE_ENDIAN
        ComSignalInitValue = 0
        ComSignalType = UINT8
        ComTimeout = 5
        ComSignalAccess = ACCESS_UNCLEAR
        ComHandleId = 17
        ComSystemTemplateSystemSignalRef = BJB_CVN_Byte_1
      BMC_CMC_Zellspannung_132_XIX_BMC_CMC_Zellspannung_04_XIX_HCP5_CANFD01_5c07f41b_Tx (ComSignal):
        ComBitPosition = 180
        ComBitSize = 12
        ComSignalDataInvalidValue = 4095
        ComSignalEndianness = LITTLE_ENDIAN
        ComSignalInitValue = 4094
        ComSignalType = UINT16
        ComTransferProperty = PENDING
        ComSignalAccess = ACCESS_UNCLEAR
        ComHandleId = 243
        ComSystemTemplateSystemSignalRef = BMC_CMC_Zellspannung_132
      UI1_05_XIX_BMC_CAN01_608d1e29_Rx (ComIPdu):
        ComIPduDirection = RECEIVE
        ComIPduType = NORMAL
        ComIPduHandleId = 47
        ComIPduSignalProcessing = DEFERRED
        ComIPduCancellationSupport = false
        ComIPduGroupRef = BMC_HV_XIX_BMC_CAN01_Rx_7b388810
        ComIPduSignalRef = UI1_Iso_Neg_XIX_UI1_05_XIX_BMC_CAN01_4b0788a9_Rx
        ComIPduSignalRef = UI1_Iso_Pos_XIX_UI1_05_XIX_BMC_CAN01_c7179271_Rx
        ComIPduSignalRef = UI1_Iso_Status_XIX_UI1_05_XIX_BMC_CAN01_a67d930e_Rx
        ComPduIdRef = UI1_05_XIX_BMC_CAN01_608d1e29_Rx
        ComIPduMainFunctionRef = ComMainFunctionRx
      4 x ComSignal, all with ComSignalEndianness=LITTLE_ENDIAN, ComSignalAccess=ACCESS_UNCLEAR:
        BMC_CMC_Zellspannung_044_XIX_BMC_CMC_Zellspannung_02_XIX_HCP5_CANFD01_7110cd13_Tx: ComBitPosition=60, ComBitSize=12, ComSignalDataInvalidValue=4095, ComSignalInitValue=4094, ComSignalType=UINT16, ComTransferProperty=PENDING, ComHandleId=155, ComSystemTemplateSystemSignalRef=BMC_CMC_Zellspannung_044
        DCDC_NV_Komponentenfehler_21_XIX_DCDC_NV_Komponentenfehler_01_XIX_HCP5_CANFD01_07c1b0cb_Rx: ComBitPosition=40, ComBitSize=2, ComSignalInitValue=0, ComSignalType=UINT8, ComTimeout=5, ComHandleId=82, ComSystemTemplateSystemSignalRef=DCDC_NV_Komponentenfehler_21
        UI2_KompFehlerModus4_01_XIX_UI2_Komponentenfehler_02_XIX_BMC_CAN01_a76d8bc9_Rx: ComBitPosition=12, ComBitSize=3, ComSignalInitValue=0, ComSignalType=UINT8, ComTimeout=1, ComHandleId=471, ComSystemTemplateSystemSignalRef=UI2_KompFehlerModus4_01
        BMC_CMC_Temperatur_014_XIX_BMC_CMC_Temperatur_01_XIX_HCP5_CANFD01_384bb2e4_Tx: ComBitPosition=120, ComBitSize=8, ComSignalDataInvalidValue=255, ComSignalInitValue=254, ComSignalType=UINT8, ComTransferProperty=PENDING, ComHandleId=24, ComSystemTemplateSystemSignalRef=BMC_CMC_Temperatur_014
      DS_Hybrid_01_XIX_HCP5_CANFD01_b3d0b839_Tx (ComIPdu):
        ComIPduDirection = SEND
        ComIPduType = NORMAL
        ComIPduHandleId = 23
        ComIPduSignalProcessing = DEFERRED
        ComIPduCancellationSupport = false
        ComIPduGroupRef = BMC_HV_XIX_HCP5_CANFD01_Tx_3ba05bd9
        ComIPduGroupRef = BMC_HV_XIX_PNC_01_CarWakeUp_Tx_29969a84
        ComIPduGroupRef = BMC_HV_XIX_PNC_40_Diagnosis_Energy_Tx_60b361f6
        ComIPduSignalRef = DS_Hybrid_01_ConfDTCChanged_XIX_DS_Hybrid_01_XIX_HCP5_CANFD01_2044f478_Tx
        ComIPduSignalRef = DS_Hybrid_01_DiagAdr_XIX_DS_Hybrid_01_XIX_HCP5_CANFD01_ecf98c5e_Tx
        ComIPduSignalRef = DS_Hybrid_01_IdentValid_XIX_DS_Hybrid_01_XIX_HCP5_CANFD01_1ffc9aaf_Tx
        ComIPduSignalRef = DS_Hybrid_01_Lokalaktiv_XIX_DS_Hybrid_01_XIX_HCP5_CANFD01_8a807ec5_Tx
        ComIPduSignalRef = DS_Hybrid_01_MemSel10Changed_XIX_DS_Hybrid_01_XIX_HCP5_CANFD01_040fbf45_Tx
        ComIPduSignalRef = DS_Hybrid_01_MemSelChanged_XIX_DS_Hybrid_01_XIX_HCP5_CANFD01_a7dec6c2_Tx
        ComIPduSignalRef = DS_Hybrid_01_StMemChanged_XIX_DS_Hybrid_01_XIX_HCP5_CANFD01_c527befd_Tx
        ComIPduSignalRef = DS_Hybrid_01_Subsystemaktiv_XIX_DS_Hybrid_01_XIX_HCP5_CANFD01_cb6ff8bb_Tx
        ComIPduSignalRef = DS_Hybrid_01_TestFailedChanged_XIX_DS_Hybrid_01_XIX_HCP5_CANFD01_f799e5e7_Tx
        ComIPduSignalRef = DS_Hybrid_01_WIRChanged_XIX_DS_Hybrid_01_XIX_HCP5_CANFD01_296545f7_Tx
        ComPduIdRef = DS_Hybrid_01_XIX_HCP5_CANFD01_b3d0b839_Tx
        ComIPduMainFunctionRef = ComMainFunctionTx
        ComTxIPdu: ComMinimumDelayTime=0.08, ComTxIPduUnusedAreasDefault=0
          ComTxModeTrue
            ComTxMode: ComTxModeMode=MIXED, ComTxModeNumberOfRepetitions=0, ComTxModeRepetitionPeriod=0, ComTxModeTimeOffset=0, ComTxModeTimePeriod=1
          ComTxModeFalse
            ComTxMode: ComTxModeMode=NONE
      3 x ComSignal, all with ComSignalEndianness=LITTLE_ENDIAN, ComSignalInitValue=0, ComSignalType=UINT8, ComSignalAccess=ACCESS_UNCLEAR:
        DCDC_NV_CVN_VLD_XIX_DCDC_NV_CVN_XIX_HCP5_CANFD01_0c97b82e_Rx: ComBitPosition=0, ComBitSize=1, ComTimeout=5, ComHandleId=45, ComSystemTemplateSystemSignalRef=DCDC_NV_CVN_VLD
        NM_Hybrid_01_NM_aktiv_Diag_XIX_NM_Hybrid_01_XIX_HCP5_CANFD01_6143673a_Tx: ComBitPosition=153, ComBitSize=1, ComTransferProperty=TRIGGERED, ComHandleId=419, ComSystemTemplateSystemSignalRef=NM_Hybrid_01_NM_aktiv_Diag
        DCDC_NV_Komponentenfehler_26_XIX_DCDC_NV_Komponentenfehler_01_XIX_HCP5_CANFD01_1cea60f1_Rx: ComBitPosition=50, ComBitSize=2, ComTimeout=5, ComHandleId=87, ComSystemTemplateSystemSignalRef=DCDC_NV_Komponentenfehler_26
      SOK_NoAuthenticTime_01_XIX_HCP5_CANFD01_a407ae2f_Rx (ComIPdu):
        ComIPduDirection = RECEIVE
        ComIPduType = NORMAL
        ComIPduHandleId = 39
        ComIPduSignalProcessing = DEFERRED
        ComIPduCancellationSupport = false
        ComIPduGroupRef = BMC_HV_XIX_HCP5_CANFD01_Rx_6dfafc5f
        ComIPduSignalRef = SOK_ungeschuetzte_Zeit_XIX_SOK_NoAuthenticTime_01_XIX_HCP5_CANFD01_d9562906_Rx
        ComPduIdRef = SOK_NoAuthenticTime_01_XIX_HCP5_CANFD01_a407ae2f_Rx
        ComIPduMainFunctionRef = ComMainFunctionRx
      3 x ComSignal, all with ComSignalEndianness=LITTLE_ENDIAN, ComTransferProperty=PENDING, ComSignalAccess=ACCESS_UNCLEAR:
        BMC_CMC_Zellspannung_007_XIX_BMC_CMC_Zellspannung_01_XIX_HCP5_CANFD01_65599711_Tx: ComBitPosition=84, ComBitSize=12, ComSignalDataInvalidValue=4095, ComSignalInitValue=4094, ComSignalType=UINT16, ComHandleId=118, ComSystemTemplateSystemSignalRef=BMC_CMC_Zellspannung_007
        BMC_CMC_Zellspannung_130_XIX_BMC_CMC_Zellspannung_04_XIX_HCP5_CANFD01_a394c33d_Tx: ComBitPosition=156, ComBitSize=12, ComSignalDataInvalidValue=4095, ComSignalInitValue=4094, ComSignalType=UINT16, ComHandleId=241, ComSystemTemplateSystemSignalRef=BMC_CMC_Zellspannung_130
        BMC_CMC_Temperatur_060_XIX_BMC_CMC_Temperatur_02_XIX_HCP5_CANFD01_a66d5b68_Tx: ComBitPosition=24, ComBitSize=8, ComSignalDataInvalidValue=255, ComSignalInitValue=254, ComSignalType=UINT8, ComHandleId=70, ComSystemTemplateSystemSignalRef=BMC_CMC_Temperatur_060
      BMC_HV_01_XIX_HCP5_CANFD01_E2E_fcbbcae3_Tx (ComIPdu):
        ComIPduDirection = SEND
        ComIPduType = NORMAL
        ComIPduHandleId = 8
        ComIPduSignalProcessing = DEFERRED
        ComIPduCancellationSupport = false
        ComIPduGroupRef = BMC_HV_XIX_HCP5_CANFD01_Tx_3ba05bd9
        ComIPduGroupRef = BMC_HV_XIX_PNC_26_HighVoltage_Charging_Tx_20012544
        ComIPduGroupRef = BMC_HV_XIX_PNC_30_EnergyManagement_Tx_ff32adc5
        ComIPduSignalGroupRef = SG_BMC_HV_01_XIX_HCP5_CANFD01_efd99d38_Tx
        ComPduIdRef = BMC_HV_01_XIX_HCP5_CANFD01_E2E_fcbbcae3_Tx
        ComIPduMainFunctionRef = ComMainFunctionTx
        ComTxIPdu: ComTxIPduUnusedAreasDefault=0, ComMinimumDelayTime=0
          ComTxModeTrue
            ComTxMode: ComTxModeMode=DIRECT, ComTxModeNumberOfRepetitions=0, ComTxModeRepetitionPeriod=0
          ComTxModeFalse
            ComTxMode: ComTxModeMode=NONE
      7 x ComSignal, all with ComSignalEndianness=LITTLE_ENDIAN, ComSignalAccess=ACCESS_UNCLEAR:
        BMC_CMC_Temperatur_030_XIX_BMC_CMC_Temperatur_01_XIX_HCP5_CANFD01_0cb605b5_Tx: ComBitPosition=248, ComBitSize=8, ComSignalDataInvalidValue=255, ComSignalInitValue=254, ComSignalType=UINT8, ComTransferProperty=PENDING, ComHandleId=40, ComSystemTemplateSystemSignalRef=BMC_CMC_Temperatur_030
        BMC_IstZellSpannungMax_Modul_ID_XIX_BMC_HV_08_XIX_HCP5_CANFD01_4cf696ba_Tx: ComBitPosition=296, ComBitSize=8, ComSignalInitValue=255, ComSignalType=UINT8, ComTransferProperty=PENDING, ComHandleId=316, ComSystemTemplateSystemSignalRef=BMC_IstZellSpannungMax_Modul_ID
        UI1_KompFehlerModus2_02_XIX_UI1_Komponentenfehler_01_XIX_BMC_CAN01_4ac19f09_Rx: ComBitPosition=14, ComBitSize=2, ComSignalInitValue=0, ComSignalType=UINT8, ComTimeout=1, ComHandleId=352, ComSystemTemplateSystemSignalRef=UI1_KompFehlerModus2_02
        DCDC_NV_CALID_Index_07_XIX_DCDC_NV_CALID_XIX_HCP5_CANFD01_4697137e_Rx: ComBitPosition=48, ComBitSize=8, ComSignalInitValue=63, ComSignalType=UINT8, ComTimeout=5, ComHandleId=31, ComSystemTemplateSystemSignalRef=DCDC_NV_CALID_Index_07
        BMC_CMC_Zellspannung_089_XIX_BMC_CMC_Zellspannung_03_XIX_HCP5_CANFD01_0ecd2409_Tx: ComBitPosition=132, ComBitSize=12, ComSignalDataInvalidValue=4095, ComSignalInitValue=4094, ComSignalType=UINT16, ComTransferProperty=PENDING, ComHandleId=200, ComSystemTemplateSystemSignalRef=BMC_CMC_Zellspannung_089
        BMC_CMC_Temperatur_02_Messzeit_XIX_BMC_CMC_Temperatur_02_XIX_HCP5_CANFD01_8c2bd22d_Tx: ComBitPosition=128, ComBitSize=8, ComSignalDataInvalidValue=255, ComSignalInitValue=254, ComSignalType=UINT8, ComTransferProperty=PENDING, ComHandleId=9, ComSystemTemplateSystemSignalRef=BMC_CMC_Temperatur_02_Messzeit
        DCDC_NV_Komponentenfehler_48_XIX_DCDC_NV_Komponentenfehler_02_XIX_HCP5_CANFD01_6fe01388_Rx: ComBitPosition=36, ComBitSize=2, ComSignalInitValue=0, ComSignalType=UINT8, ComTimeout=5, ComHandleId=109, ComSystemTemplateSystemSignalRef=DCDC_NV_Komponentenfehler_48
      UI1_04_XIX_BMC_CAN01_d976c5c1_Rx (ComIPdu):
        ComIPduDirection = RECEIVE
        ComIPduType = NORMAL
        ComIPduHandleId = 46
        ComIPduSignalProcessing = DEFERRED
        ComIPduCancellationSupport = false
        ComIPduGroupRef = BMC_HV_XIX_BMC_CAN01_Rx_7b388810
        ComIPduSignalRef = UI1_Status_XIX_UI1_04_XIX_BMC_CAN01_abb6019e_Rx
        ComIPduSignalRef = UI1_Stromintegral_Entladen_XIX_UI1_04_XIX_BMC_CAN01_550f36e6_Rx
        ComIPduSignalRef = UI1_Stromintegral_Laden_XIX_UI1_04_XIX_BMC_CAN01_6b336e8e_Rx
        ComIPduSignalRef = UI1_Temperatur_1_XIX_UI1_04_XIX_BMC_CAN01_ee4849f8_Rx
        ComIPduSignalRef = UI1_Temperatur_2_XIX_UI1_04_XIX_BMC_CAN01_1c1fa400_Rx
        ComIPduSignalRef = UI2Sens01_ErrMem_State_XIX_UI1_04_XIX_BMC_CAN01_2781c1ec_Rx
        ComPduIdRef = UI1_04_XIX_BMC_CAN01_d976c5c1_Rx
        ComIPduMainFunctionRef = ComMainFunctionRx
      4 x ComSignal, all with ComSignalAccess=ACCESS_UNCLEAR:
        BMC_CMC_Zellspannung_005_XIX_BMC_CMC_Zellspannung_01_XIX_HCP5_CANFD01_9acaa037_Tx: ComBitPosition=60, ComBitSize=12, ComSignalDataInvalidValue=4095, ComSignalEndianness=LITTLE_ENDIAN, ComSignalInitValue=4094, ComSignalType=UINT16, ComTransferProperty=PENDING, ComHandleId=116, ComSystemTemplateSystemSignalRef=BMC_CMC_Zellspannung_005
        DEV_Hybrid_01_Resp_FF_FD_Data_XIX_DEV_Hybrid_01_Resp_FF_XIX_HCP5_CANFD01_c5a91adf_Tx: ComBitPosition=0, ComSignalEndianness=opaque, ComSignalInitValue=0 0 0 0 0 0 0 0 0 0 0 0 0 0 0 0 0 0 0 0 0 0 0 0 0 0 0 0 0 0 0 0 0 0 0 0 0 0 0 0 0 0 0 0 0 0 0 0 0 0 0 0 0 0 0 0 0 0 0 0 0 0 0 0, ComSignalLength=64, ComSignalType=UINT8_N, ComTransferProperty=TRIGGERED_ON_CHANGE_WITHOUT_REPETITION, ComHandleId=390, ComSystemTemplateSystemSignalRef=DEV_Hybrid_01_Resp_FF_FD_Data
        UI1_KompFehlerModus2_26_XIX_UI1_Komponentenfehler_01_XIX_BMC_CAN01_7e3c2858_Rx: ComBitPosition=62, ComBitSize=2, ComSignalEndianness=LITTLE_ENDIAN, ComSignalInitValue=0, ComSignalType=UINT8, ComTimeout=1, ComHandleId=376, ComSystemTemplateSystemSignalRef=UI1_KompFehlerModus2_26
        SOK_ungeschuetzte_Zeit_XIX_SOK_NoAuthenticTime_01_XIX_HCP5_CANFD01_d9562906_Rx: ComBitPosition=8, ComSignalEndianness=opaque, ComSignalInitValue=0 0 0 0 0 0 0, ComSignalLength=7, ComSignalType=UINT8_N, ComHandleId=339, ComSystemTemplateSystemSignalRef=SOK_ungeschuetzte_Zeit
      BMC_HV_14_XIX_HCP5_CANFD01_30db4b60_Tx (ComIPdu):
        ComIPduDirection = SEND
        ComIPduType = NORMAL
        ComIPduHandleId = 21
        ComIPduSignalProcessing = DEFERRED
        ComIPduCancellationSupport = false
        ComIPduGroupRef = BMC_HV_XIX_HCP5_CANFD01_Tx_3ba05bd9
        ComIPduGroupRef = BMC_HV_XIX_PNC_26_HighVoltage_Charging_Tx_20012544
        ComIPduSignalRef = BMC_EnergieVorhalt_XIX_BMC_HV_14_XIX_HCP5_CANFD01_33ff2903_Tx
        ComIPduSignalRef = BMC_PCM_VTD_Freeze_Req_XIX_BMC_HV_14_XIX_HCP5_CANFD01_f4d42d86_Tx
        ComIPduSignalRef = BMC_PCM_VTD_LifeTimeReset_Req_XIX_BMC_HV_14_XIX_HCP5_CANFD01_85186af1_Tx
        ComIPduSignalRef = BMC_PCM_VTD_LifeTimeReset_Resp_XIX_BMC_HV_14_XIX_HCP5_CANFD01_fcdaf120_Tx
        ComIPduSignalRef = BMC_PCM_VTD_RecentReset_Req_XIX_BMC_HV_14_XIX_HCP5_CANFD01_827fd905_Tx
        ComIPduSignalRef = BMC_Range_Indikator_XIX_BMC_HV_14_XIX_HCP5_CANFD01_21f53466_Tx
        ComIPduSignalRef = BMC_UBE_Indik_last_update_km_XIX_BMC_HV_14_XIX_HCP5_CANFD01_c953ffca_Tx
        ComIPduSignalRef = BMC_UBE_Indikator_XIX_BMC_HV_14_XIX_HCP5_CANFD01_be7dd75f_Tx
        ComPduIdRef = BMC_HV_14_XIX_HCP5_CANFD01_30db4b60_Tx
        ComIPduMainFunctionRef = ComMainFunctionTx
        ComTxIPdu: ComTxIPduUnusedAreasDefault=0, ComMinimumDelayTime=0
          ComTxModeTrue
            ComTxMode: ComTxModeMode=PERIODIC, ComTxModeTimeOffset=0, ComTxModeTimePeriod=0.1
          ComTxModeFalse
            ComTxMode: ComTxModeMode=NONE
      18 x ComSignal, all with ComSignalAccess=ACCESS_UNCLEAR:
        DCDC_NV_Komponentenfehler_36_XIX_DCDC_NV_Komponentenfehler_02_XIX_HCP5_CANFD01_9fa0419e_Rx: ComBitPosition=12, ComBitSize=2, ComSignalEndianness=LITTLE_ENDIAN, ComSignalInitValue=0, ComSignalType=UINT8, ComTimeout=5, ComHandleId=97, ComSystemTemplateSystemSignalRef=DCDC_NV_Komponentenfehler_36
        KN_Hybrid_01_DiagPfad_V12_XIX_KN_Hybrid_01_XIX_HCP5_CANFD01_9879167d_Tx: ComBitPosition=20, ComBitSize=1, ComSignalEndianness=LITTLE_ENDIAN, ComSignalInitValue=0, ComSignalType=UINT8, ComTransferProperty=PENDING, ComHandleId=409, ComSystemTemplateSystemSignalRef=KN_Hybrid_01_DiagPfad_V12
        OBDProtocol_req_XIX_OBD_HCP1_XIX_HCP5_CANFD01_70c5c055_Rx: ComBitPosition=0, ComBitSize=4, ComSignalDataInvalidValue=15, ComSignalEndianness=LITTLE_ENDIAN, ComSignalInitValue=14, ComSignalType=UINT8, ComTimeout=3.2, ComHandleId=158, ComSystemTemplateSystemSignalRef=OBDProtocol_req
        UI2Sens01_CALID_Index_13_XIX_UI2Sens01_CALID_02_XIX_BMC_CAN01_ef5e23bb_Rx: ComBitPosition=32, ComBitSize=8, ComSignalEndianness=LITTLE_ENDIAN, ComSignalInitValue=63, ComSignalType=UINT8, ComTimeout=5, ComHandleId=413, ComSystemTemplateSystemSignalRef=UI2Sens01_CALID_Index_13
        DCDC_NV_Komponentenfehler_33_XIX_DCDC_NV_Komponentenfehler_02_XIX_HCP5_CANFD01_cb8770c3_Rx: ComBitPosition=6, ComBitSize=2, ComSignalEndianness=LITTLE_ENDIAN, ComSignalInitValue=0, ComSignalType=UINT8, ComTimeout=5, ComHandleId=94, ComSystemTemplateSystemSignalRef=DCDC_NV_Komponentenfehler_33
        BMC_CMC_Temperatur_064_XIX_BMC_CMC_Temperatur_02_XIX_HCP5_CANFD01_0ecdbae0_Tx: ComBitPosition=56, ComBitSize=8, ComSignalDataInvalidValue=255, ComSignalEndianness=LITTLE_ENDIAN, ComSignalInitValue=254, ComSignalType=UINT8, ComTransferProperty=PENDING, ComHandleId=74, ComSystemTemplateSystemSignalRef=BMC_CMC_Temperatur_064
        BMC_CMC_Temperatur_010_XIX_BMC_CMC_Temperatur_01_XIX_HCP5_CANFD01_90eb536c_Tx: ComBitPosition=88, ComBitSize=8, ComSignalDataInvalidValue=255, ComSignalEndianness=LITTLE_ENDIAN, ComSignalInitValue=254, ComSignalType=UINT8, ComTransferProperty=PENDING, ComHandleId=20, ComSystemTemplateSystemSignalRef=BMC_CMC_Temperatur_010
        BMC_CMC_Zellspannung_042_XIX_BMC_CMC_Zellspannung_02_XIX_HCP5_CANFD01_aad49238_Tx: ComBitPosition=36, ComBitSize=12, ComSignalDataInvalidValue=4095, ComSignalEndianness=LITTLE_ENDIAN, ComSignalInitValue=4094, ComSignalType=UINT16, ComTransferProperty=PENDING, ComHandleId=153, ComSystemTemplateSystemSignalRef=BMC_CMC_Zellspannung_042
        DCDC_NV_Komponentenfehler_39_XIX_DCDC_NV_Komponentenfehler_02_XIX_HCP5_CANFD01_63c91279_Rx: ComBitPosition=18, ComBitSize=2, ComSignalEndianness=LITTLE_ENDIAN, ComSignalInitValue=0, ComSignalType=UINT8, ComTimeout=5, ComHandleId=100, ComSystemTemplateSystemSignalRef=DCDC_NV_Komponentenfehler_39
        BMC_CMC_Temperatur_088_XIX_BMC_CMC_Temperatur_03_XIX_HCP5_CANFD01_a07f8455_Tx: ComBitPosition=136, ComBitSize=8, ComSignalDataInvalidValue=255, ComSignalEndianness=LITTLE_ENDIAN, ComSignalInitValue=254, ComSignalType=UINT8, ComTransferProperty=PENDING, ComHandleId=98, ComSystemTemplateSystemSignalRef=BMC_CMC_Temperatur_088
        BMC_CMC_Zellspannung_110_XIX_BMC_CMC_Zellspannung_03_XIX_HCP5_CANFD01_9048df93_Tx: ComBitPosition=384, ComBitSize=12, ComSignalDataInvalidValue=4095, ComSignalEndianness=LITTLE_ENDIAN, ComSignalInitValue=4094, ComSignalType=UINT16, ComTransferProperty=PENDING, ComHandleId=221, ComSystemTemplateSystemSignalRef=BMC_CMC_Zellspannung_110
        BMC_CMC_Zellspannung_173_XIX_BMC_CMC_Zellspannung_05_XIX_HCP5_CANFD01_b209f2bc_Tx: ComBitPosition=204, ComBitSize=12, ComSignalDataInvalidValue=4095, ComSignalEndianness=LITTLE_ENDIAN, ComSignalInitValue=4094, ComSignalType=UINT16, ComTransferProperty=PENDING, ComHandleId=284, ComSystemTemplateSystemSignalRef=BMC_CMC_Zellspannung_173
        NM_Hybrid_01_FCAB_XIX_NM_Hybrid_01_XIX_HCP5_CANFD01_38c188fa_Tx: ComBitPosition=0, ComSignalEndianness=opaque, ComSignalInitValue=0 0 0 0 0 0 0, ComSignalLength=7, ComSignalType=UINT8_N, ComTransferProperty=TRIGGERED_ON_CHANGE, ComHandleId=413, ComSystemTemplateSystemSignalRef=NM_Hybrid_01_FCAB
        BMC_CMC_Temperatur_054_XIX_BMC_CMC_Temperatur_01_XIX_HCP5_CANFD01_db801917_Tx: ComBitPosition=440, ComBitSize=8, ComSignalDataInvalidValue=255, ComSignalEndianness=LITTLE_ENDIAN, ComSignalInitValue=254, ComSignalType=UINT8, ComTransferProperty=PENDING, ComHandleId=64, ComSystemTemplateSystemSignalRef=BMC_CMC_Temperatur_054
        UI1_KompFehlerModus4_04_XIX_UI1_Komponentenfehler_02_XIX_BMC_CAN01_0b2b5923_Rx: ComBitPosition=21, ComBitSize=3, ComSignalEndianness=LITTLE_ENDIAN, ComSignalInitValue=0, ComSignalType=UINT8, ComTimeout=1, ComHandleId=380, ComSystemTemplateSystemSignalRef=UI1_KompFehlerModus4_04
        UI2Sens01_CALID_Index_03_XIX_UI2Sens01_CALID_01_XIX_BMC_CAN01_b0aa426b_Rx: ComBitPosition=16, ComBitSize=8, ComSignalEndianness=LITTLE_ENDIAN, ComSignalInitValue=63, ComSignalType=UINT8, ComTimeout=5, ComHandleId=403, ComSystemTemplateSystemSignalRef=UI2Sens01_CALID_Index_03
        BMC_IstZellSpannungMin_Modul_ID_XIX_BMC_HV_08_XIX_HCP5_CANFD01_027ef310_Tx: ComBitPosition=288, ComBitSize=8, ComSignalEndianness=LITTLE_ENDIAN, ComSignalInitValue=255, ComSignalType=UINT8, ComTransferProperty=PENDING, ComHandleId=318, ComSystemTemplateSystemSignalRef=BMC_IstZellSpannungMin_Modul_ID
        BMC_CMC_Zellspannung_011_XIX_BMC_CMC_Zellspannung_01_XIX_HCP5_CANFD01_d7e4c35f_Tx: ComBitPosition=132, ComBitSize=12, ComSignalDataInvalidValue=4095, ComSignalEndianness=LITTLE_ENDIAN, ComSignalInitValue=4094, ComSignalType=UINT16, ComTransferProperty=PENDING, ComHandleId=122, ComSystemTemplateSystemSignalRef=BMC_CMC_Zellspannung_011
      SG_OTAMC_D_01_XIX_HCP5_CANFD01_e331bc6d_Rx (ComSignalGroup):
        ComTransferProperty = TRIGGERED_WITHOUT_REPETITION
        ComSignalGroupAccess = ACCESS_UNCLEAR
        ComHandleId = 10
        ComSystemTemplateSignalGroupRef = SG_OTAMC_D_01_XIX_HCP5_CANFD01
        6 x ComGroupSignal, all with ComSignalEndianness=LITTLE_ENDIAN, ComSignalType=UINT8, ComSignalInitValue=0, ComSignalAccess=ACCESS_UNCLEAR:
          ISignalVoid_OTAMC_D_01_XIX_HCP5_CANFD01_2_dd5f6cf8_Rx: ComBitPosition=24, ComBitSize=8, ComHandleId=291, ComSystemTemplateSystemSignalRef=SignalVoid_OTAMC_D_01_2
          ISignalVoid_OTAMC_D_01_XIX_HCP5_CANFD01_1_44563d42_Rx: ComBitPosition=16, ComBitSize=8, ComHandleId=290, ComSystemTemplateSystemSignalRef=SignalVoid_OTAMC_D_01_1
          OTAMC_D_01_BZ_XIX_OTAMC_D_01_XIX_HCP5_CANFD01_c1a59846_Rx: ComBitPosition=8, ComBitSize=4, ComHandleId=292, ComSystemTemplateSystemSignalRef=OTAMC_D_01_BZ
          OTAMC_D_01_CRC_XIX_OTAMC_D_01_XIX_HCP5_CANFD01_194e47e0_Rx: ComBitPosition=0, ComBitSize=8, ComHandleId=293, ComSystemTemplateSystemSignalRef=OTAMC_D_01_CRC
          ISignalVoid_OTAMC_D_01_XIX_HCP5_CANFD01_0_33510dd4_Rx: ComBitPosition=14, ComBitSize=2, ComHandleId=289, ComSystemTemplateSystemSignalRef=SignalVoid_OTAMC_D_01_0
          VehicleProtectedEnvironment_D_XIX_OTAMC_D_01_XIX_HCP5_CANFD01_c9d358b3_Rx: ComBitPosition=12, ComBitSize=2, ComHandleId=294, ComSystemTemplateSystemSignalRef=VehicleProtectedEnvironment_D
      7 x ComSignal, all with ComSignalEndianness=LITTLE_ENDIAN, ComSignalAccess=ACCESS_UNCLEAR:
        BJB_CALID_Index_05_XIX_BJB_CALID_01_XIX_BMC_CAN01_656d64dd_Rx: ComBitPosition=32, ComBitSize=8, ComSignalInitValue=63, ComSignalType=UINT8, ComTimeout=5, ComHandleId=5, ComSystemTemplateSystemSignalRef=BJB_CALID_Index_05
        BMC_CMC_Zellspannung_140_XIX_BMC_CMC_Zellspannung_04_XIX_HCP5_CANFD01_668af547_Tx: ComBitPosition=276, ComBitSize=12, ComSignalDataInvalidValue=4095, ComSignalInitValue=4094, ComSignalType=UINT16, ComTransferProperty=PENDING, ComHandleId=251, ComSystemTemplateSystemSignalRef=BMC_CMC_Zellspannung_140
        BMC_CMC_Zellspannung_066_XIX_BMC_CMC_Zellspannung_02_XIX_HCP5_CANFD01_5c71ecff_Tx: ComBitPosition=324, ComBitSize=12, ComSignalDataInvalidValue=4095, ComSignalInitValue=4094, ComSignalType=UINT16, ComTransferProperty=PENDING, ComHandleId=177, ComSystemTemplateSystemSignalRef=BMC_CMC_Zellspannung_066
        UH_Stunde_XIX_Diagnose_01_XIX_HCP5_CANFD01_7d2acaf0_Rx: ComBitPosition=44, ComBitSize=5, ComSignalInitValue=0, ComSignalType=UINT8, ComTimeout=5, ComHandleId=346, ComSystemTemplateSystemSignalRef=UH_Stunde
        BMC_CMC_Zellspannung_183_XIX_BMC_CMC_Zellspannung_05_XIX_HCP5_CANFD01_8a3d936c_Tx: ComBitPosition=324, ComBitSize=12, ComSignalDataInvalidValue=4095, ComSignalInitValue=4094, ComSignalType=UINT16, ComTransferProperty=PENDING, ComHandleId=294, ComSystemTemplateSystemSignalRef=BMC_CMC_Zellspannung_183
        DCDC_NV_Komponentenfehler_54_XIX_DCDC_NV_Komponentenfehler_02_XIX_HCP5_CANFD01_7f77ae96_Rx: ComBitPosition=48, ComBitSize=2, ComSignalInitValue=0, ComSignalType=UINT8, ComTimeout=5, ComHandleId=115, ComSystemTemplateSystemSignalRef=DCDC_NV_Komponentenfehler_54
        Hybrid_01_Indc_StChk_XIX_OBD_Hybrid_01_XIX_HCP5_CANFD01_0ff5b24f_Tx: ComBitPosition=4, ComBitSize=1, ComSignalInitValue=1, ComSignalType=UINT8, ComTransferProperty=PENDING, ComHandleId=401, ComSystemTemplateSystemSignalRef=Hybrid_01_Indc_StChk
      DCDC_NV_CVN_XIX_HCP5_CANFD01_55665719_Rx (ComIPdu):
        ComIPduDirection = RECEIVE
        ComIPduType = NORMAL
        ComIPduHandleId = 14
        ComIPduSignalProcessing = DEFERRED
        ComIPduCancellationSupport = false
        ComIPduGroupRef = BMC_HV_XIX_HCP5_CANFD01_Rx_6dfafc5f
        ComIPduGroupRef = BMC_HV_XIX_PNC_40_Diagnosis_Energy_Rx_36e9c670
        ComIPduSignalRef = DCDC_NV_CVN_Byte_1_XIX_DCDC_NV_CVN_XIX_HCP5_CANFD01_f6f9fc9d_Rx
        ComIPduSignalRef = DCDC_NV_CVN_Byte_2_XIX_DCDC_NV_CVN_XIX_HCP5_CANFD01_9b7f0fc7_Rx
        ComIPduSignalRef = DCDC_NV_CVN_Byte_3_XIX_DCDC_NV_CVN_XIX_HCP5_CANFD01_bffd5ef1_Rx
        ComIPduSignalRef = DCDC_NV_CVN_Byte_4_XIX_DCDC_NV_CVN_XIX_HCP5_CANFD01_4072e973_Rx
        ComIPduSignalRef = DCDC_NV_CVN_VLD_XIX_DCDC_NV_CVN_XIX_HCP5_CANFD01_0c97b82e_Rx
        ComPduIdRef = DCDC_NV_CVN_XIX_HCP5_CANFD01_55665719_Rx
        ComIPduMainFunctionRef = ComMainFunctionRx
      4 x ComSignal, all with ComSignalEndianness=LITTLE_ENDIAN, ComSignalType=UINT8, ComSignalAccess=ACCESS_UNCLEAR:
        DCDC_NV_Komponentenfehler_10_XIX_DCDC_NV_Komponentenfehler_01_XIX_HCP5_CANFD01_77aa474f_Rx: ComBitPosition=18, ComBitSize=2, ComSignalInitValue=0, ComTimeout=5, ComHandleId=71, ComSystemTemplateSystemSignalRef=DCDC_NV_Komponentenfehler_10
        BMC_CMC_Temperatur_038_XIX_BMC_CMC_Temperatur_01_XIX_HCP5_CANFD01_8686c0e4_Tx: ComBitPosition=312, ComBitSize=8, ComSignalDataInvalidValue=255, ComSignalInitValue=254, ComTransferProperty=PENDING, ComHandleId=48, ComSystemTemplateSystemSignalRef=BMC_CMC_Temperatur_038
        UI2Sens02_CVN_Byte_2_XIX_UI2Sens02_CVN_XIX_BMC_CAN01_83299178_Rx: ComBitPosition=9, ComBitSize=8, ComSignalInitValue=0, ComTimeout=5, ComHandleId=440, ComSystemTemplateSystemSignalRef=UI2Sens02_CVN_Byte_2
        UI2Sens02_CALID_Index_07_XIX_UI2Sens02_CALID_01_XIX_BMC_CAN01_306dc6cb_Rx: ComBitPosition=48, ComBitSize=8, ComSignalInitValue=63, ComTimeout=5, ComHandleId=429, ComSystemTemplateSystemSignalRef=UI2Sens02_CALID_Index_07
      SG_BMC_HV_13_XIX_BMC_CAN01_3930bd0b_Tx (ComSignalGroup):
        ComTransferProperty = TRIGGERED_WITHOUT_REPETITION
        ComSignalGroupAccess = ACCESS_UNCLEAR
        ComHandleId = 6
        ComSystemTemplateSignalGroupRef = SG_BMC_HV_13_XIX_BMC_CAN01
        8 x ComGroupSignal, all with ComSignalEndianness=LITTLE_ENDIAN, ComSignalAccess=ACCESS_UNCLEAR, ComTransferProperty=PENDING:
          BMC_HV_13_BZ_XIX_BMC_HV_13_XIX_BMC_CAN01_eb8d9b48_Tx: ComBitPosition=8, ComBitSize=4, ComSignalInitValue=0, ComSignalType=UINT8, ComHandleId=535, ComSystemTemplateSystemSignalRef=BMC_HV_13_BZ
          ISignalVoid_BMC_HV_13_XIX_BMC_CAN01_0_c2de3020_Tx: ComBitPosition=48, ComBitSize=8, ComSignalType=UINT8, ComSignalInitValue=0, ComHandleId=541, ComSystemTemplateSystemSignalRef=SignalVoid_BMC_HV_13_0
          BMC_Unterspannungszaehler_CMC04_XIX_BMC_HV_13_XIX_BMC_CAN01_fa1886b1_Tx: ComBitPosition=39, ComBitSize=9, ComSignalDataInvalidValue=511, ComSignalInitValue=510, ComSignalType=UINT16, ComHandleId=540, ComSystemTemplateSystemSignalRef=BMC_Unterspannungszaehler_CMC04
          BMC_Unterspannungszaehler_CMC03_XIX_BMC_HV_13_XIX_BMC_CAN01_087e8f0c_Tx: ComBitPosition=30, ComBitSize=9, ComSignalDataInvalidValue=511, ComSignalInitValue=510, ComSignalType=UINT16, ComHandleId=539, ComSystemTemplateSystemSignalRef=BMC_Unterspannungszaehler_CMC03
          BMC_Unterspannungszaehler_CMC02_XIX_BMC_HV_13_XIX_BMC_CAN01_6b795628_Tx: ComBitPosition=21, ComBitSize=9, ComSignalDataInvalidValue=511, ComSignalInitValue=510, ComSignalType=UINT16, ComHandleId=538, ComSystemTemplateSystemSignalRef=BMC_Unterspannungszaehler_CMC02
          ISignalVoid_BMC_HV_13_XIX_BMC_CAN01_1_b5d900b6_Tx: ComBitPosition=56, ComBitSize=8, ComSignalType=UINT8, ComSignalInitValue=0, ComHandleId=542, ComSystemTemplateSystemSignalRef=SignalVoid_BMC_HV_13_1
          BMC_Unterspannungszaehler_CMC01_XIX_BMC_HV_13_XIX_BMC_CAN01_ce713d44_Tx: ComBitPosition=12, ComBitSize=9, ComSignalDataInvalidValue=511, ComSignalInitValue=510, ComSignalType=UINT16, ComHandleId=537, ComSystemTemplateSystemSignalRef=BMC_Unterspannungszaehler_CMC01
          BMC_HV_13_CRC_XIX_BMC_HV_13_XIX_BMC_CAN01_563dde82_Tx: ComBitPosition=0, ComBitSize=8, ComSignalInitValue=0, ComSignalType=UINT8, ComHandleId=536, ComSystemTemplateSystemSignalRef=BMC_HV_13_CRC
      11 x ComSignal, all with ComSignalAccess=ACCESS_UNCLEAR:
        UI2_KompFehlerModus2_02_XIX_UI2_Komponentenfehler_01_XIX_BMC_CAN01_640f9409_Rx: ComBitPosition=14, ComBitSize=2, ComSignalEndianness=LITTLE_ENDIAN, ComSignalInitValue=0, ComSignalType=UINT8, ComTimeout=1, ComHandleId=446, ComSystemTemplateSystemSignalRef=UI2_KompFehlerModus2_02
        BJB_CALID_Index_12_XIX_BJB_CALID_02_XIX_BMC_CAN01_fa778cc2_Rx: ComBitPosition=24, ComBitSize=8, ComSignalEndianness=LITTLE_ENDIAN, ComSignalInitValue=63, ComSignalType=UINT8, ComTimeout=5, ComHandleId=12, ComSystemTemplateSystemSignalRef=BJB_CALID_Index_12
        DCDC_NV_Komponentenfehler_44_XIX_DCDC_NV_Komponentenfehler_02_XIX_HCP5_CANFD01_16bb529b_Rx: ComBitPosition=28, ComBitSize=2, ComSignalEndianness=LITTLE_ENDIAN, ComSignalInitValue=0, ComSignalType=UINT8, ComTimeout=5, ComHandleId=105, ComSystemTemplateSystemSignalRef=DCDC_NV_Komponentenfehler_44
        BMC_CMC_Temperatur_046_XIX_BMC_CMC_Temperatur_01_XIX_HCP5_CANFD01_2c46419f_Tx: ComBitPosition=376, ComBitSize=8, ComSignalDataInvalidValue=255, ComSignalEndianness=LITTLE_ENDIAN, ComSignalInitValue=254, ComSignalType=UINT8, ComTransferProperty=PENDING, ComHandleId=56, ComSystemTemplateSystemSignalRef=BMC_CMC_Temperatur_046
        DEV_Hybrid_01_Req_00_FD_Data_XIX_DEV_Hybrid_01_Req_00_XIX_HCP5_CANFD01_5095de8e_Rx: ComBitPosition=0, ComSignalEndianness=opaque, ComSignalInitValue=0 0 0 0 0 0 0 0 0 0 0 0 0 0 0 0 0 0 0 0 0 0 0 0 0 0 0 0 0 0 0 0 0 0 0 0 0 0 0 0 0 0 0 0 0 0 0 0 0 0 0 0 0 0 0 0 0 0 0 0 0 0 0 0, ComSignalLength=64, ComSignalType=UINT8_N, ComHandleId=144, ComSystemTemplateSystemSignalRef=DEV_Hybrid_01_Req_00_FD_Data
        DCDC_NV_Komponentenfehler_22_XIX_DCDC_NV_Komponentenfehler_01_XIX_HCP5_CANFD01_82f3a23f_Rx: ComBitPosition=42, ComBitSize=2, ComSignalEndianness=LITTLE_ENDIAN, ComSignalInitValue=0, ComSignalType=UINT8, ComTimeout=5, ComHandleId=83, ComSystemTemplateSystemSignalRef=DCDC_NV_Komponentenfehler_22
        BMC_CMC_Temperatur_066_XIX_BMC_CMC_Temperatur_02_XIX_HCP5_CANFD01_5a9dca24_Tx: ComBitPosition=72, ComBitSize=8, ComSignalDataInvalidValue=255, ComSignalEndianness=LITTLE_ENDIAN, ComSignalInitValue=254, ComSignalType=UINT8, ComTransferProperty=PENDING, ComHandleId=76, ComSystemTemplateSystemSignalRef=BMC_CMC_Temperatur_066
        DCDC_NV_Komponentenfehler_29_XIX_DCDC_NV_Komponentenfehler_01_XIX_HCP5_CANFD01_e0833316_Rx: ComBitPosition=56, ComBitSize=2, ComSignalEndianness=LITTLE_ENDIAN, ComSignalInitValue=0, ComSignalType=UINT8, ComTimeout=5, ComHandleId=90, ComSystemTemplateSystemSignalRef=DCDC_NV_Komponentenfehler_29
        BMC_CMC_Zellspannung_020_XIX_BMC_CMC_Zellspannung_01_XIX_HCP5_CANFD01_13a64563_Tx: ComBitPosition=240, ComBitSize=12, ComSignalDataInvalidValue=4095, ComSignalEndianness=LITTLE_ENDIAN, ComSignalInitValue=4094, ComSignalType=UINT16, ComTransferProperty=PENDING, ComHandleId=131, ComSystemTemplateSystemSignalRef=BMC_CMC_Zellspannung_020
        BMC_Pack_SN_11_XIX_BMC_HV_08_XIX_HCP5_CANFD01_efc67d68_Tx: ComBitPosition=144, ComBitSize=8, ComSignalEndianness=LITTLE_ENDIAN, ComSignalInitValue=255, ComSignalType=UINT8, ComTransferProperty=PENDING, ComHandleId=344, ComSystemTemplateSystemSignalRef=BMC_Pack_SN_11
        DCDC_NV_Komponentenfehler_3_9_XIX_DCDC_NV_Komponentenfehler_04_XIX_HCP5_CANFD01_aa00b5f9_Rx: ComBitPosition=24, ComBitSize=3, ComSignalEndianness=LITTLE_ENDIAN, ComSignalInitValue=0, ComSignalType=UINT8, ComTimeout=5, ComHandleId=54, ComSystemTemplateSystemSignalRef=DCDC_NV_Komponentenfehler_3_9
      BMC_HV_XIX_PNC_30_EnergyManagement_Tx_ff32adc5 (ComIPduGroup): ComIPduGroupHandleId=16
      SG_KS_Hybrid_01_Challenge_M_XIX_HCP5_CANFD01_a4750f9b_Rx (ComSignalGroup):
        ComTimeout = 0
        ComTransferProperty = TRIGGERED_WITHOUT_REPETITION
        ComSignalGroupAccess = ACCESS_UNCLEAR
        ComHandleId = 6
        ComSystemTemplateSignalGroupRef = SG_KS_Hybrid_01_Challenge_M_XIX_HCP5_CANFD01
        3 x ComGroupSignal, all with ComSignalAccess=ACCESS_UNCLEAR:
          KS_Hybrid_01_ChM_IKACtr_XIX_KS_Hybrid_01_Challenge_M_XIX_HCP5_CANFD01_c11cfd4a_Rx: ComBitPosition=16, ComBitSize=8, ComSignalEndianness=LITTLE_ENDIAN, ComSignalInitValue=0, ComSignalType=UINT8, ComHandleId=259, ComSystemTemplateSystemSignalRef=KS_Hybrid_01_ChM_IKACtr
          KS_Hybrid_01_ChM_XIX_KS_Hybrid_01_Challenge_M_XIX_HCP5_CANFD01_be825fbb_Rx: ComBitPosition=24, ComSignalEndianness=opaque, ComSignalInitValue=0 0 0 0 0 0 0 0, ComSignalLength=8, ComSignalType=UINT8_N, ComHandleId=261, ComSystemTemplateSystemSignalRef=KS_Hybrid_01_ChM
          KS_Hybrid_01_ChM_SID_XIX_KS_Hybrid_01_Challenge_M_XIX_HCP5_CANFD01_4420b38f_Rx: ComBitPosition=0, ComBitSize=16, ComSignalEndianness=LITTLE_ENDIAN, ComSignalInitValue=0, ComSignalType=UINT16, ComHandleId=260, ComSystemTemplateSystemSignalRef=KS_Hybrid_01_ChM_SID
      UI2_KompFehlerModus2_20_XIX_UI2_Komponentenfehler_01_XIX_BMC_CAN01_ac02b214_Rx (ComSignal):
        ComBitPosition = 50
        ComBitSize = 2
        ComSignalEndianness = LITTLE_ENDIAN
        ComSignalInitValue = 0
        ComSignalType = UINT8
        ComTimeout = 1
        ComSignalAccess = ACCESS_UNCLEAR
        ComHandleId = 464
        ComSystemTemplateSystemSignalRef = UI2_KompFehlerModus2_20
      ORU_01_XIX_HCP5_CANFD01_8935a839_Rx (ComIPdu):
        ComIPduDirection = RECEIVE
        ComIPduType = NORMAL
        ComIPduHandleId = 34
        ComIPduSignalProcessing = DEFERRED
        ComIPduCancellationSupport = false
        ComIPduGroupRef = BMC_HV_XIX_HCP5_CANFD01_Rx_6dfafc5f
        ComIPduSignalRef = ORU_Status_XIX_ORU_01_XIX_HCP5_CANFD01_ee2b347d_Rx
        ComPduIdRef = ORU_01_XIX_HCP5_CANFD01_8935a839_Rx
        ComIPduMainFunctionRef = ComMainFunctionRx
      17 x ComSignal, all with ComSignalAccess=ACCESS_UNCLEAR:
        BJB_CALID_Index_14_XIX_BJB_CALID_02_XIX_BMC_CAN01_b3389bfd_Rx: ComBitPosition=40, ComBitSize=8, ComSignalEndianness=LITTLE_ENDIAN, ComSignalInitValue=63, ComSignalType=UINT8, ComTimeout=5, ComHandleId=14, ComSystemTemplateSystemSignalRef=BJB_CALID_Index_14
        BMC_CMC_Temperatur_062_XIX_BMC_CMC_Temperatur_02_XIX_HCP5_CANFD01_f23d2bac_Tx: ComBitPosition=40, ComBitSize=8, ComSignalDataInvalidValue=255, ComSignalEndianness=LITTLE_ENDIAN, ComSignalInitValue=254, ComSignalType=UINT8, ComTransferProperty=PENDING, ComHandleId=72, ComSystemTemplateSystemSignalRef=BMC_CMC_Temperatur_062
        BMC_CMC_Zellspannung_034_XIX_BMC_CMC_Zellspannung_01_XIX_HCP5_CANFD01_5e88260b_Tx: ComBitPosition=408, ComBitSize=12, ComSignalDataInvalidValue=4095, ComSignalEndianness=LITTLE_ENDIAN, ComSignalInitValue=4094, ComSignalType=UINT16, ComTransferProperty=PENDING, ComHandleId=145, ComSystemTemplateSystemSignalRef=BMC_CMC_Zellspannung_034
        VIN_7_XIX_WFS_02_XIX_HCP5_CANFD01_eb505e0d_Rx: ComBitPosition=64, ComBitSize=8, ComSignalEndianness=LITTLE_ENDIAN, ComSignalInitValue=45, ComSignalType=UINT8, ComTimeout=4, ComHandleId=499, ComSystemTemplateSystemSignalRef=VIN_7
        BMC_CMC_Zellspannung_012_XIX_BMC_CMC_Zellspannung_01_XIX_HCP5_CANFD01_57be6fea_Tx: ComBitPosition=144, ComBitSize=12, ComSignalDataInvalidValue=4095, ComSignalEndianness=LITTLE_ENDIAN, ComSignalInitValue=4094, ComSignalType=UINT16, ComTransferProperty=PENDING, ComHandleId=123, ComSystemTemplateSystemSignalRef=BMC_CMC_Zellspannung_012
        HVEM_BMC_CHA_Wunschleistung_XIX_HVEM_07_XIX_HCP5_CANFD01_7884fa49_Rx: ComBitPosition=147, ComBitSize=13, ComSignalDataInvalidValue=8191, ComSignalEndianness=LITTLE_ENDIAN, ComSignalInitValue=8190, ComSignalType=UINT16, ComTimeout=0.8, ComHandleId=148, ComSystemTemplateSystemSignalRef=HVEM_BMC_CHA_Wunschleistung
        BMC_CMC_Zellspannung_155_XIX_BMC_CMC_Zellspannung_04_XIX_HCP5_CANFD01_546d0dbc_Tx: ComBitPosition=456, ComBitSize=12, ComSignalDataInvalidValue=4095, ComSignalEndianness=LITTLE_ENDIAN, ComSignalInitValue=4094, ComSignalType=UINT16, ComTransferProperty=PENDING, ComHandleId=266, ComSystemTemplateSystemSignalRef=BMC_CMC_Zellspannung_155
        NM_Hybrid_01_FCIB_XIX_KN_Hybrid_01_XIX_HCP5_CANFD01_7ed68506_Tx: ComBitPosition=40, ComSignalEndianness=opaque, ComSignalInitValue=1 0 0 34 128 0 0, ComSignalLength=7, ComSignalType=UINT8_N, ComTransferProperty=PENDING, ComHandleId=414, ComSystemTemplateSystemSignalRef=NM_Hybrid_01_FCIB
        UI2Sens02_CVN_Byte_1_XIX_UI2Sens02_CVN_XIX_BMC_CAN01_d83e206d_Rx: ComBitPosition=1, ComBitSize=8, ComSignalEndianness=LITTLE_ENDIAN, ComSignalInitValue=0, ComSignalType=UINT8, ComTimeout=5, ComHandleId=439, ComSystemTemplateSystemSignalRef=UI2Sens02_CVN_Byte_1
        DCDC_NV_Komponentenfehler_41_XIX_DCDC_NV_Komponentenfehler_02_XIX_HCP5_CANFD01_429c63c6_Rx: ComBitPosition=22, ComBitSize=2, ComSignalEndianness=LITTLE_ENDIAN, ComSignalInitValue=0, ComSignalType=UINT8, ComTimeout=5, ComHandleId=102, ComSystemTemplateSystemSignalRef=DCDC_NV_Komponentenfehler_41
        DS_Hybrid_01_MemSelChanged_XIX_DS_Hybrid_01_XIX_HCP5_CANFD01_a7dec6c2_Tx: ComBitPosition=21, ComBitSize=1, ComSignalEndianness=LITTLE_ENDIAN, ComSignalInitValue=0, ComSignalType=UINT8, ComTransferProperty=TRIGGERED_ON_CHANGE_WITHOUT_REPETITION, ComHandleId=396, ComSystemTemplateSystemSignalRef=DS_Hybrid_01_MemSelChanged
        BMC_CMC_Temperatur_096_XIX_BMC_CMC_Temperatur_03_XIX_HCP5_CANFD01_7529f804_Tx: ComBitPosition=200, ComBitSize=8, ComSignalDataInvalidValue=255, ComSignalEndianness=LITTLE_ENDIAN, ComSignalInitValue=254, ComSignalType=UINT8, ComTransferProperty=PENDING, ComHandleId=106, ComSystemTemplateSystemSignalRef=BMC_CMC_Temperatur_096
        BMC_CMC_Zellspannung_05_Messzeit_XIX_BMC_CMC_Zellspannung_05_XIX_HCP5_CANFD01_2646b7e5_Tx: ComBitPosition=444, ComBitSize=8, ComSignalDataInvalidValue=255, ComSignalEndianness=LITTLE_ENDIAN, ComSignalInitValue=254, ComSignalType=UINT8, ComTransferProperty=PENDING, ComHandleId=111, ComSystemTemplateSystemSignalRef=BMC_CMC_Zellspannung_05_Messzeit
        DCDC_NV_Komponentenfehler_79_XIX_DCDC_NV_Komponentenfehler_03_XIX_HCP5_CANFD01_f0d952ed_Rx: ComBitPosition=36, ComBitSize=2, ComSignalEndianness=LITTLE_ENDIAN, ComSignalInitValue=0, ComSignalType=UINT8, ComTimeout=5, ComHandleId=140, ComSystemTemplateSystemSignalRef=DCDC_NV_Komponentenfehler_79
        DCDC_NV_Komponentenfehler_3_10_XIX_DCDC_NV_Komponentenfehler_04_XIX_HCP5_CANFD01_5d91a7d8_Rx: ComBitPosition=27, ComBitSize=3, ComSignalEndianness=LITTLE_ENDIAN, ComSignalInitValue=0, ComSignalType=UINT8, ComTimeout=5, ComHandleId=55, ComSystemTemplateSystemSignalRef=DCDC_NV_Komponentenfehler_3_10
        BMC_Pack_SN_02_XIX_BMC_HV_08_XIX_HCP5_CANFD01_102be524_Tx: ComBitPosition=72, ComBitSize=8, ComSignalEndianness=LITTLE_ENDIAN, ComSignalInitValue=255, ComSignalType=UINT8, ComTransferProperty=PENDING, ComHandleId=335, ComSystemTemplateSystemSignalRef=BMC_Pack_SN_02
        UI2_KompFehlerModus4_04_XIX_UI2_Komponentenfehler_02_XIX_BMC_CAN01_25e55223_Rx: ComBitPosition=21, ComBitSize=3, ComSignalEndianness=LITTLE_ENDIAN, ComSignalInitValue=0, ComSignalType=UINT8, ComTimeout=1, ComHandleId=474, ComSystemTemplateSystemSignalRef=UI2_KompFehlerModus4_04
      BJB_12_XIX_BMC_CAN01_E2E_e2311042_Rx (ComIPdu):
        ComIPduDirection = RECEIVE
        ComIPduType = NORMAL
        ComIPduHandleId = 4
        ComIPduSignalProcessing = DEFERRED
        ComIPduCancellationSupport = false
        ComIPduGroupRef = BMC_HV_XIX_BMC_CAN01_Rx_7b388810
        ComIPduSignalGroupRef = SG_BJB_12_XIX_BMC_CAN01_f3b10f47_Rx
        ComPduIdRef = BJB_12_XIX_BMC_CAN01_E2E_e2311042_Rx
        ComIPduMainFunctionRef = ComMainFunctionRx
      6 x ComSignal, all with ComSignalEndianness=LITTLE_ENDIAN, ComSignalAccess=ACCESS_UNCLEAR:
        BMC_Pack_SN_05_XIX_BMC_HV_08_XIX_HCP5_CANFD01_a8bef7b1_Tx: ComBitPosition=96, ComBitSize=8, ComSignalInitValue=255, ComSignalType=UINT8, ComTransferProperty=PENDING, ComHandleId=338, ComSystemTemplateSystemSignalRef=BMC_Pack_SN_05
        DC_IstLeistung_HV_XIX_DCDC_04_XIX_HCP5_CANFD01_7ce6573a_Rx: ComBitPosition=54, ComBitSize=10, ComSignalDataInvalidValue=1023, ComSignalInitValue=1022, ComSignalType=UINT16, ComTimeout=0.5, ComHandleId=143, ComSystemTemplateSystemSignalRef=DC_IstLeistung_HV
        BMC_Rekuperation_XIX_BMC_HV_05_XIX_HCP5_CANFD01_0550c77c_Tx: ComBitPosition=32, ComBitSize=16, ComSignalInitValue=0, ComSignalType=UINT16, ComTransferProperty=PENDING, ComHandleId=362, ComSystemTemplateSystemSignalRef=BMC_Rekuperation
        DCDC_NV_Komponentenfehler_73_XIX_DCDC_NV_Komponentenfehler_03_XIX_HCP5_CANFD01_58973057_Rx: ComBitPosition=24, ComBitSize=2, ComSignalInitValue=0, ComSignalType=UINT8, ComTimeout=5, ComHandleId=134, ComSystemTemplateSystemSignalRef=DCDC_NV_Komponentenfehler_73
        NM_aktiv_Konditionierungsbedarf_XIX_NM_Hybrid_01_XIX_HCP5_CANFD01_91de24c0_Tx: ComBitPosition=155, ComBitSize=1, ComSignalInitValue=0, ComSignalType=UINT8, ComTransferProperty=TRIGGERED, ComHandleId=429, ComSystemTemplateSystemSignalRef=NM_aktiv_Konditionierungsbedarf
        DCDC_NV_CALID_Index_04_XIX_DCDC_NV_CALID_XIX_HCP5_CANFD01_22776880_Rx: ComBitPosition=24, ComBitSize=8, ComSignalInitValue=63, ComSignalType=UINT8, ComTimeout=5, ComHandleId=28, ComSystemTemplateSystemSignalRef=DCDC_NV_CALID_Index_04
      KS_Hybrid_01_ReqFrame_XIX_HCP5_CANFD01_b04c52dd_Tx (ComIPdu):
        ComIPduDirection = SEND
        ComIPduType = NORMAL
        ComIPduHandleId = 26
        ComIPduSignalProcessing = DEFERRED
        ComIPduCancellationSupport = false
        ComIPduGroupRef = BMC_HV_XIX_HCP5_CANFD01_Tx_3ba05bd9
        ComIPduSignalGroupRef = SG_KS_Hybrid_01_ReqFrame_XIX_HCP5_CANFD01_619e85fb_Tx
        ComPduIdRef = KS_Hybrid_01_ReqFrame_XIX_HCP5_CANFD01_b04c52dd_Tx
        ComIPduMainFunctionRef = ComMainFunctionTx
        ComTxIPdu: ComTxIPduUnusedAreasDefault=0, ComMinimumDelayTime=0
          ComTxModeTrue
            ComTxMode: ComTxModeMode=DIRECT, ComTxModeNumberOfRepetitions=0, ComTxModeRepetitionPeriod=0
          ComTxModeFalse
            ComTxMode: ComTxModeMode=NONE
      6 x ComSignal, all with ComSignalEndianness=LITTLE_ENDIAN, ComSignalAccess=ACCESS_UNCLEAR:
        BMC_IstTemperaturMin_Sensor_ID_XIX_BMC_HV_08_XIX_HCP5_CANFD01_dc6835da_Tx: ComBitPosition=12, ComBitSize=5, ComSignalInitValue=31, ComSignalType=UINT8, ComTransferProperty=PENDING, ComHandleId=315, ComSystemTemplateSystemSignalRef=BMC_IstTemperaturMin_Sensor_ID
        BMC_CMC_Zellspannung_177_XIX_BMC_CMC_Zellspannung_05_XIX_HCP5_CANFD01_965e9ab1_Tx: ComBitPosition=252, ComBitSize=12, ComSignalDataInvalidValue=4095, ComSignalInitValue=4094, ComSignalType=UINT16, ComTransferProperty=PENDING, ComHandleId=288, ComSystemTemplateSystemSignalRef=BMC_CMC_Zellspannung_177
        BJB_CALID_Index_04_XIX_BJB_CALID_01_XIX_BMC_CAN01_94b76177_Rx: ComBitPosition=24, ComBitSize=8, ComSignalInitValue=63, ComSignalType=UINT8, ComTimeout=5, ComHandleId=4, ComSystemTemplateSystemSignalRef=BJB_CALID_Index_04
        BMC_CMC_Zellspannung_013_XIX_BMC_CMC_Zellspannung_01_XIX_HCP5_CANFD01_2877f479_Tx: ComBitPosition=156, ComBitSize=12, ComSignalDataInvalidValue=4095, ComSignalInitValue=4094, ComSignalType=UINT16, ComTransferProperty=PENDING, ComHandleId=124, ComSystemTemplateSystemSignalRef=BMC_CMC_Zellspannung_013
        BMC_Temperatur_XIX_BMC_HV_03_XIX_HCP5_CANFD01_eb74ed8d_Tx: ComBitPosition=36, ComBitSize=10, ComSignalDataInvalidValue=1023, ComSignalInitValue=1022, ComSignalType=UINT16, ComTransferProperty=PENDING, ComHandleId=379, ComSystemTemplateSystemSignalRef=BMC_Temperatur
        BMC_CMC_Zellspannung_051_XIX_BMC_CMC_Zellspannung_02_XIX_HCP5_CANFD01_43f735e8_Tx: ComBitPosition=144, ComBitSize=12, ComSignalDataInvalidValue=4095, ComSignalInitValue=4094, ComSignalType=UINT16, ComTransferProperty=PENDING, ComHandleId=162, ComSystemTemplateSystemSignalRef=BMC_CMC_Zellspannung_051
      BMC_HV_XIX_HCP5_CANFD01_Rx_6dfafc5f (ComIPduGroup): ComIPduGroupHandleId=2
      13 x ComSignal, all with ComSignalEndianness=LITTLE_ENDIAN, ComSignalAccess=ACCESS_UNCLEAR:
        UI2_KompFehlerModus2_16_XIX_UI2_Komponentenfehler_01_XIX_BMC_CAN01_6f395dcd_Rx: ComBitPosition=42, ComBitSize=2, ComSignalInitValue=0, ComSignalType=UINT8, ComTimeout=1, ComHandleId=460, ComSystemTemplateSystemSignalRef=UI2_KompFehlerModus2_16
        BMC_CMC_Temperatur_007_XIX_BMC_CMC_Temperatur_01_XIX_HCP5_CANFD01_e5a5d20e_Tx: ComBitPosition=64, ComBitSize=8, ComSignalDataInvalidValue=255, ComSignalInitValue=254, ComSignalType=UINT8, ComTransferProperty=PENDING, ComHandleId=17, ComSystemTemplateSystemSignalRef=BMC_CMC_Temperatur_007
        BMC_CMC_Zellspannung_114_XIX_BMC_CMC_Zellspannung_03_XIX_HCP5_CANFD01_b41fb79e_Tx: ComBitPosition=432, ComBitSize=12, ComSignalDataInvalidValue=4095, ComSignalInitValue=4094, ComSignalType=UINT16, ComTransferProperty=PENDING, ComHandleId=225, ComSystemTemplateSystemSignalRef=BMC_CMC_Zellspannung_114
        BMC_CMC_Zellspannung_138_XIX_BMC_CMC_Zellspannung_04_XIX_HCP5_CANFD01_eb3a1327_Tx: ComBitPosition=252, ComBitSize=12, ComSignalDataInvalidValue=4095, ComSignalInitValue=4094, ComSignalType=UINT16, ComTransferProperty=PENDING, ComHandleId=249, ComSystemTemplateSystemSignalRef=BMC_CMC_Zellspannung_138
        UI2_KompFehlerModus4_08_XIX_UI2_Komponentenfehler_02_XIX_BMC_CAN01_077576fa_Rx: ComBitPosition=33, ComBitSize=3, ComSignalInitValue=0, ComSignalType=UINT8, ComTimeout=1, ComHandleId=478, ComSystemTemplateSystemSignalRef=UI2_KompFehlerModus4_08
        DCDC_NV_Komponentenfehler_76_XIX_DCDC_NV_Komponentenfehler_03_XIX_HCP5_CANFD01_0cb0010a_Rx: ComBitPosition=30, ComBitSize=2, ComSignalInitValue=0, ComSignalType=UINT8, ComTimeout=5, ComHandleId=137, ComSystemTemplateSystemSignalRef=DCDC_NV_Komponentenfehler_76
        BMC_Pack_SN_10_XIX_BMC_HV_08_XIX_HCP5_CANFD01_1e1c78c2_Tx: ComBitPosition=136, ComBitSize=8, ComSignalInitValue=255, ComSignalType=UINT8, ComTransferProperty=PENDING, ComHandleId=343, ComSystemTemplateSystemSignalRef=BMC_Pack_SN_10
        NM_Hybrid_01_UDS_CC_XIX_NM_Hybrid_01_XIX_HCP5_CANFD01_d82615ea_Tx: ComBitPosition=143, ComBitSize=1, ComSignalInitValue=0, ComSignalType=UINT8, ComTransferProperty=TRIGGERED, ComHandleId=426, ComSystemTemplateSystemSignalRef=NM_Hybrid_01_UDS_CC
        DCDC_NV_Komponentenfehler_23_XIX_DCDC_NV_Komponentenfehler_01_XIX_HCP5_CANFD01_48cd51ac_Rx: ComBitPosition=44, ComBitSize=2, ComSignalInitValue=0, ComSignalType=UINT8, ComTimeout=5, ComHandleId=84, ComSystemTemplateSystemSignalRef=DCDC_NV_Komponentenfehler_23
        OBD_Normed_Trip_XIX_OBD_03_XIX_HCP5_CANFD01_aff42920_Rx: ComBitPosition=63, ComBitSize=1, ComSignalInitValue=0, ComSignalType=UINT8, ComTimeout=3.2, ComHandleId=169, ComSystemTemplateSystemSignalRef=OBD_Normed_Trip
        BMC_Rekuperation_Ueberlauf_XIX_BMC_HV_05_XIX_HCP5_CANFD01_34ba06c8_Tx: ComBitPosition=14, ComBitSize=1, ComSignalInitValue=0, ComSignalType=UINT8, ComTransferProperty=PENDING, ComHandleId=361, ComSystemTemplateSystemSignalRef=BMC_Rekuperation_Ueberlauf
        NM_Hybrid_01_NM_aktiv_Tmin_XIX_NM_Hybrid_01_XIX_HCP5_CANFD01_cfd9c50b_Tx: ComBitPosition=154, ComBitSize=1, ComSignalInitValue=0, ComSignalType=UINT8, ComTransferProperty=TRIGGERED, ComHandleId=423, ComSystemTemplateSystemSignalRef=NM_Hybrid_01_NM_aktiv_Tmin
        VIN_8_XIX_WFS_02_XIX_HCP5_CANFD01_b7ea9212_Rx: ComBitPosition=72, ComBitSize=8, ComSignalInitValue=45, ComSignalType=UINT8, ComTimeout=4, ComHandleId=500, ComSystemTemplateSystemSignalRef=VIN_8
      NVEM_12_XIX_HCP5_CANFD01_00bae280_Rx (ComIPdu):
        ComIPduDirection = RECEIVE
        ComIPduType = NORMAL
        ComIPduHandleId = 29
        ComIPduSignalProcessing = DEFERRED
        ComIPduCancellationSupport = false
        ComIPduGroupRef = BMC_HV_XIX_HCP5_CANFD01_Rx_6dfafc5f
        ComIPduGroupRef = BMC_HV_XIX_PNC_30_EnergyManagement_Rx_a9680a43
        ComIPduSignalRef = NVEM_Abschaltstufe_XIX_NVEM_12_XIX_HCP5_CANFD01_cc082583_Rx
        ComPduIdRef = NVEM_12_XIX_HCP5_CANFD01_00bae280_Rx
        ComIPduMainFunctionRef = ComMainFunctionRx
      5 x ComSignal, all with ComSignalEndianness=LITTLE_ENDIAN, ComSignalAccess=ACCESS_UNCLEAR:
        DCDC_NV_Komponentenfehler_58_XIX_DCDC_NV_Komponentenfehler_02_XIX_HCP5_CANFD01_062cef85_Rx: ComBitPosition=56, ComBitSize=2, ComSignalInitValue=0, ComSignalType=UINT8, ComTimeout=5, ComHandleId=119, ComSystemTemplateSystemSignalRef=DCDC_NV_Komponentenfehler_58
        BMC_CMC_Zellspannung_058_XIX_BMC_CMC_Zellspannung_02_XIX_HCP5_CANFD01_74907e61_Tx: ComBitPosition=228, ComBitSize=12, ComSignalDataInvalidValue=4095, ComSignalInitValue=4094, ComSignalType=UINT16, ComTransferProperty=PENDING, ComHandleId=169, ComSystemTemplateSystemSignalRef=BMC_CMC_Zellspannung_058
        UI1_Iso_Neg_XIX_UI1_05_XIX_BMC_CAN01_4b0788a9_Rx: ComBitPosition=48, ComBitSize=16, ComSignalDataInvalidValue=65535, ComSignalInitValue=65534, ComSignalType=UINT16, ComTimeout=1, ComHandleId=348, ComSystemTemplateSystemSignalRef=UI1_Iso_Neg
        BMC_CMC_Zellspannung_133_XIX_BMC_CMC_Zellspannung_04_XIX_HCP5_CANFD01_23ce6f88_Tx: ComBitPosition=192, ComBitSize=12, ComSignalDataInvalidValue=4095, ComSignalInitValue=4094, ComSignalType=UINT16, ComTransferProperty=PENDING, ComHandleId=244, ComSystemTemplateSystemSignalRef=BMC_CMC_Zellspannung_133
        DCDC_NV_Komponentenfehler_34_XIX_DCDC_NV_Komponentenfehler_02_XIX_HCP5_CANFD01_d0aca0f9_Rx: ComBitPosition=8, ComBitSize=2, ComSignalInitValue=0, ComSignalType=UINT8, ComTimeout=5, ComHandleId=95, ComSystemTemplateSystemSignalRef=DCDC_NV_Komponentenfehler_34
      Systeminfo_01_XIX_HCP5_CANFD01_fb27c5ed_Rx (ComIPdu):
        ComIPduDirection = RECEIVE
        ComIPduType = NORMAL
        ComIPduHandleId = 41
        ComIPduSignalProcessing = DEFERRED
        ComIPduCancellationSupport = false
        ComIPduGroupRef = BMC_HV_XIX_HCP5_CANFD01_Rx_6dfafc5f
        ComIPduGroupRef = BMC_HV_XIX_PNC_07_Basefunction_CrossSection_Rx_4fb7c882
        ComIPduSignalRef = SI_NWDF_30_XIX_Systeminfo_01_XIX_HCP5_CANFD01_b3e489e1_Rx
        ComIPduSignalRef = SI_NWDF_XIX_Systeminfo_01_XIX_HCP5_CANFD01_5ddebbee_Rx
        ComIPduSignalRef = SI_P_Mode_XIX_Systeminfo_01_XIX_HCP5_CANFD01_171f38d4_Rx
        ComIPduSignalRef = SI_P_Mode_gueltig_XIX_Systeminfo_01_XIX_HCP5_CANFD01_f5c30274_Rx
        ComIPduSignalRef = SI_T_Mode_XIX_Systeminfo_01_XIX_HCP5_CANFD01_01a376d2_Rx
        ComPduIdRef = Systeminfo_01_XIX_HCP5_CANFD01_fb27c5ed_Rx
        ComIPduMainFunctionRef = ComMainFunctionRx
      DCDC_NV_Komponentenfehler_02_XIX_HCP5_CANFD01_37eeaa04_Rx (ComIPdu):
        ComIPduDirection = RECEIVE
        ComIPduType = NORMAL
        ComIPduHandleId = 16
        ComIPduSignalProcessing = DEFERRED
        ComIPduCancellationSupport = false
        ComIPduGroupRef = BMC_HV_XIX_HCP5_CANFD01_Rx_6dfafc5f
        ComIPduGroupRef = BMC_HV_XIX_PNC_26_HighVoltage_Charging_Rx_765b82c2
        ComIPduSignalRef = DCDC_NV_Komponentenfehler_30_XIX_DCDC_NV_Komponentenfehler_02_XIX_HCP5_CANFD01_4eb56237_Rx
        ComIPduSignalRef = DCDC_NV_Komponentenfehler_31_XIX_DCDC_NV_Komponentenfehler_02_XIX_HCP5_CANFD01_848b91a4_Rx
        ComIPduSignalRef = DCDC_NV_Komponentenfehler_32_XIX_DCDC_NV_Komponentenfehler_02_XIX_HCP5_CANFD01_01b98350_Rx
        ComIPduSignalRef = DCDC_NV_Komponentenfehler_33_XIX_DCDC_NV_Komponentenfehler_02_XIX_HCP5_CANFD01_cb8770c3_Rx
        ComIPduSignalRef = DCDC_NV_Komponentenfehler_34_XIX_DCDC_NV_Komponentenfehler_02_XIX_HCP5_CANFD01_d0aca0f9_Rx
        ComIPduSignalRef = DCDC_NV_Komponentenfehler_35_XIX_DCDC_NV_Komponentenfehler_02_XIX_HCP5_CANFD01_1a92536a_Rx
        ComIPduSignalRef = DCDC_NV_Komponentenfehler_36_XIX_DCDC_NV_Komponentenfehler_02_XIX_HCP5_CANFD01_9fa0419e_Rx
        ComIPduSignalRef = DCDC_NV_Komponentenfehler_37_XIX_DCDC_NV_Komponentenfehler_02_XIX_HCP5_CANFD01_559eb20d_Rx
        ComIPduSignalRef = DCDC_NV_Komponentenfehler_38_XIX_DCDC_NV_Komponentenfehler_02_XIX_HCP5_CANFD01_a9f7e1ea_Rx
        ComIPduSignalRef = DCDC_NV_Komponentenfehler_39_XIX_DCDC_NV_Komponentenfehler_02_XIX_HCP5_CANFD01_63c91279_Rx
        ComIPduSignalRef = DCDC_NV_Komponentenfehler_40_XIX_DCDC_NV_Komponentenfehler_02_XIX_HCP5_CANFD01_88a29055_Rx
        ComIPduSignalRef = DCDC_NV_Komponentenfehler_41_XIX_DCDC_NV_Komponentenfehler_02_XIX_HCP5_CANFD01_429c63c6_Rx
        ComIPduSignalRef = DCDC_NV_Komponentenfehler_42_XIX_DCDC_NV_Komponentenfehler_02_XIX_HCP5_CANFD01_c7ae7132_Rx
        ComIPduSignalRef = DCDC_NV_Komponentenfehler_43_XIX_DCDC_NV_Komponentenfehler_02_XIX_HCP5_CANFD01_0d9082a1_Rx
        ComIPduSignalRef = DCDC_NV_Komponentenfehler_44_XIX_DCDC_NV_Komponentenfehler_02_XIX_HCP5_CANFD01_16bb529b_Rx
        ComIPduSignalRef = DCDC_NV_Komponentenfehler_45_XIX_DCDC_NV_Komponentenfehler_02_XIX_HCP5_CANFD01_dc85a108_Rx
        ComIPduSignalRef = DCDC_NV_Komponentenfehler_46_XIX_DCDC_NV_Komponentenfehler_02_XIX_HCP5_CANFD01_59b7b3fc_Rx
        ComIPduSignalRef = DCDC_NV_Komponentenfehler_47_XIX_DCDC_NV_Komponentenfehler_02_XIX_HCP5_CANFD01_9389406f_Rx
        ComIPduSignalRef = DCDC_NV_Komponentenfehler_48_XIX_DCDC_NV_Komponentenfehler_02_XIX_HCP5_CANFD01_6fe01388_Rx
        ComIPduSignalRef = DCDC_NV_Komponentenfehler_49_XIX_DCDC_NV_Komponentenfehler_02_XIX_HCP5_CANFD01_a5dee01b_Rx
        ComIPduSignalRef = DCDC_NV_Komponentenfehler_50_XIX_DCDC_NV_Komponentenfehler_02_XIX_HCP5_CANFD01_e16e6c58_Rx
        ComIPduSignalRef = DCDC_NV_Komponentenfehler_51_XIX_DCDC_NV_Komponentenfehler_02_XIX_HCP5_CANFD01_2b509fcb_Rx
        ComIPduSignalRef = DCDC_NV_Komponentenfehler_52_XIX_DCDC_NV_Komponentenfehler_02_XIX_HCP5_CANFD01_ae628d3f_Rx
        ComIPduSignalRef = DCDC_NV_Komponentenfehler_53_XIX_DCDC_NV_Komponentenfehler_02_XIX_HCP5_CANFD01_645c7eac_Rx
        ComIPduSignalRef = DCDC_NV_Komponentenfehler_54_XIX_DCDC_NV_Komponentenfehler_02_XIX_HCP5_CANFD01_7f77ae96_Rx
        ComIPduSignalRef = DCDC_NV_Komponentenfehler_55_XIX_DCDC_NV_Komponentenfehler_02_XIX_HCP5_CANFD01_b5495d05_Rx
        ComIPduSignalRef = DCDC_NV_Komponentenfehler_56_XIX_DCDC_NV_Komponentenfehler_02_XIX_HCP5_CANFD01_307b4ff1_Rx
        ComIPduSignalRef = DCDC_NV_Komponentenfehler_57_XIX_DCDC_NV_Komponentenfehler_02_XIX_HCP5_CANFD01_fa45bc62_Rx
        ComIPduSignalRef = DCDC_NV_Komponentenfehler_58_XIX_DCDC_NV_Komponentenfehler_02_XIX_HCP5_CANFD01_062cef85_Rx
        ComIPduSignalRef = DCDC_NV_Komponentenfehler_59_XIX_DCDC_NV_Komponentenfehler_02_XIX_HCP5_CANFD01_cc121c16_Rx
        ComIPduSignalRef = DCDC_NV_Komponentenfehler_60_XIX_DCDC_NV_Komponentenfehler_02_XIX_HCP5_CANFD01_5b3b684f_Rx
        ComPduIdRef = DCDC_NV_Komponentenfehler_02_XIX_HCP5_CANFD01_37eeaa04_Rx
        ComIPduMainFunctionRef = ComMainFunctionRx
      8 x ComSignal, all with ComSignalEndianness=LITTLE_ENDIAN, ComSignalAccess=ACCESS_UNCLEAR:
        BMC_CMC_Temperatur_093_XIX_BMC_CMC_Temperatur_03_XIX_HCP5_CANFD01_f7a121ee_Tx: ComBitPosition=176, ComBitSize=8, ComSignalDataInvalidValue=255, ComSignalInitValue=254, ComSignalType=UINT8, ComTransferProperty=PENDING, ComHandleId=103, ComSystemTemplateSystemSignalRef=BMC_CMC_Temperatur_093
        BJB_CALID_Index_06_XIX_BJB_CALID_01_XIX_BMC_CAN01_ac726c62_Rx: ComBitPosition=40, ComBitSize=8, ComSignalInitValue=63, ComSignalType=UINT8, ComTimeout=5, ComHandleId=6, ComSystemTemplateSystemSignalRef=BJB_CALID_Index_06
        OBD_Abs_Pedal_Pos_XIX_OBD_03_XIX_HCP5_CANFD01_ce8f11ec_Rx: ComBitPosition=44, ComBitSize=8, ComSignalInitValue=255, ComSignalType=UINT8, ComTimeout=3.2, ComHandleId=159, ComSystemTemplateSystemSignalRef=OBD_Abs_Pedal_Pos
        BMC_RuecklaufTemperatur_XIX_BMC_HV_03_XIX_HCP5_CANFD01_73222ba7_Tx: ComBitPosition=26, ComBitSize=10, ComSignalDataInvalidValue=1023, ComSignalInitValue=1022, ComSignalType=UINT16, ComTransferProperty=PENDING, ComHandleId=378, ComSystemTemplateSystemSignalRef=BMC_RuecklaufTemperatur
        UI2Sens02_CALID_Index_12_XIX_UI2Sens02_CALID_02_XIX_BMC_CAN01_b9a1a7b2_Rx: ComBitPosition=24, ComBitSize=8, ComSignalInitValue=63, ComSignalType=UINT8, ComTimeout=5, ComHandleId=434, ComSystemTemplateSystemSignalRef=UI2Sens02_CALID_Index_12
        UI2_Status_XIX_UI2_04_XIX_BMC_CAN01_1a276de9_Rx: ComBitPosition=15, ComBitSize=1, ComSignalInitValue=0, ComSignalType=UINT8, ComTimeout=1, ComHandleId=487, ComSystemTemplateSystemSignalRef=UI2_Status
        BMC_CMC_Temperatur_008_XIX_BMC_CMC_Temperatur_01_XIX_HCP5_CANFD01_b94dbe71_Tx: ComBitPosition=72, ComBitSize=8, ComSignalDataInvalidValue=255, ComSignalInitValue=254, ComSignalType=UINT8, ComTransferProperty=PENDING, ComHandleId=18, ComSystemTemplateSystemSignalRef=BMC_CMC_Temperatur_008
        UI1_KompFehlerModus2_22_XIX_UI1_Komponentenfehler_01_XIX_BMC_CAN01_d69cc9d0_Rx: ComBitPosition=54, ComBitSize=2, ComSignalInitValue=0, ComSignalType=UINT8, ComTimeout=1, ComHandleId=372, ComSystemTemplateSystemSignalRef=UI1_KompFehlerModus2_22
      KS_Hybrid_01_Challenge_M_XIX_HCP5_CANFD01_3e11d538_Rx (ComIPdu):
        ComIPduDirection = RECEIVE
        ComIPduType = NORMAL
        ComIPduHandleId = 27
        ComIPduSignalProcessing = DEFERRED
        ComIPduCancellationSupport = false
        ComIPduGroupRef = BMC_HV_XIX_HCP5_CANFD01_Rx_6dfafc5f
        ComIPduSignalGroupRef = SG_KS_Hybrid_01_Challenge_M_XIX_HCP5_CANFD01_a4750f9b_Rx
        ComPduIdRef = KS_Hybrid_01_Challenge_M_XIX_HCP5_CANFD01_3e11d538_Rx
        ComIPduMainFunctionRef = ComMainFunctionRx
      9 x ComSignal, all with ComSignalEndianness=LITTLE_ENDIAN, ComSignalAccess=ACCESS_UNCLEAR:
        UI1_KompFehlerModus2_03_XIX_UI1_Komponentenfehler_01_XIX_BMC_CAN01_60e9a76b_Rx: ComBitPosition=16, ComBitSize=2, ComSignalInitValue=0, ComSignalType=UINT8, ComTimeout=1, ComHandleId=353, ComSystemTemplateSystemSignalRef=UI1_KompFehlerModus2_03
        EKK_HVK_EoHVL_Status_XIX_Thermomanagement_01_XIX_HCP5_CANFD01_0b35afaa_Rx: ComBitPosition=58, ComBitSize=2, ComSignalDataInvalidValue=3, ComSignalInitValue=0, ComSignalType=UINT8, ComTimeout=1, ComHandleId=146, ComSystemTemplateSystemSignalRef=EKK_HVK_EoHVL_Status
        BMC_CMC_Zellspannung_065_XIX_BMC_CMC_Zellspannung_02_XIX_HCP5_CANFD01_dc2b404a_Tx: ComBitPosition=312, ComBitSize=12, ComSignalDataInvalidValue=4095, ComSignalInitValue=4094, ComSignalType=UINT16, ComTransferProperty=PENDING, ComHandleId=176, ComSystemTemplateSystemSignalRef=BMC_CMC_Zellspannung_065
        DCDC_NV_CVN_Byte_4_XIX_DCDC_NV_CVN_XIX_HCP5_CANFD01_4072e973_Rx: ComBitPosition=25, ComBitSize=8, ComSignalInitValue=0, ComSignalType=UINT8, ComTimeout=5, ComHandleId=44, ComSystemTemplateSystemSignalRef=DCDC_NV_CVN_Byte_4
        SI_P_Mode_gueltig_XIX_Systeminfo_01_XIX_HCP5_CANFD01_f5c30274_Rx: ComBitPosition=6, ComBitSize=1, ComSignalInitValue=0, ComSignalType=UINT8, ComTimeout=5, ComHandleId=336, ComSystemTemplateSystemSignalRef=SI_P_Mode_gueltig
        DCDC_NV_CALID_Index_10_XIX_DCDC_NV_CALID_XIX_HCP5_CANFD01_9ad72708_Rx: ComBitPosition=72, ComBitSize=8, ComSignalInitValue=63, ComSignalType=UINT8, ComTimeout=5, ComHandleId=34, ComSystemTemplateSystemSignalRef=DCDC_NV_CALID_Index_10
        DCDC_NV_Komponentenfehler_72_XIX_DCDC_NV_Komponentenfehler_03_XIX_HCP5_CANFD01_92a9c3c4_Rx: ComBitPosition=22, ComBitSize=2, ComSignalInitValue=0, ComSignalType=UINT8, ComTimeout=5, ComHandleId=133, ComSystemTemplateSystemSignalRef=DCDC_NV_Komponentenfehler_72
        DCDC_NV_Komponentenfehler_66_XIX_DCDC_NV_Komponentenfehler_03_XIX_HCP5_CANFD01_657cfd07_Rx: ComBitPosition=10, ComBitSize=2, ComSignalInitValue=0, ComSignalType=UINT8, ComTimeout=5, ComHandleId=127, ComSystemTemplateSystemSignalRef=DCDC_NV_Komponentenfehler_66
        BMC_CMC_Zellspannung_139_XIX_BMC_CMC_Zellspannung_04_XIX_HCP5_CANFD01_94f388b4_Tx: ComBitPosition=264, ComBitSize=12, ComSignalDataInvalidValue=4095, ComSignalInitValue=4094, ComSignalType=UINT16, ComTransferProperty=PENDING, ComHandleId=250, ComSystemTemplateSystemSignalRef=BMC_CMC_Zellspannung_139
      SG_BJB_10_XIX_BMC_CAN01_5b37bed6_Rx (ComSignalGroup):
        ComTransferProperty = TRIGGERED_WITHOUT_REPETITION
        ComSignalGroupAccess = ACCESS_NEEDED_BY_SWC_OR_COM
        ComHandleId = 0
        ComNotification = ComNotification_SG_BJB_10_XIX_BMC_CAN01_5b37bed6_Rx
        ComInvalidNotification = ComInvalidNotification_SG_BJB_10_XIX_BMC_CAN01_5b37bed6_Rx
        ComTimeoutNotification = ComTimeoutNotification_SG_BJB_10_XIX_BMC_CAN01_5b37bed6_Rx
        ComTimeout = 1
        ComRxDataTimeoutAction = REPLACE
        ComDataInvalidAction = NOTIFY
        ComSignalGroupArrayAccess = false
        ComFirstTimeout = 0.5
        ComSystemTemplateSignalGroupRef = SG_BJB_10_XIX_BMC_CAN01
        10 x ComGroupSignal, all with ComSignalEndianness=LITTLE_ENDIAN, ComSignalAccess=ACCESS_NEEDED_BY_SWC_OR_COM:
          BJB_Lebensdauer_Trennelemente_XIX_BJB_10_XIX_BMC_CAN01_b0789cdc_Rx: ComBitPosition=15, ComBitSize=17, ComSignalDataInvalidValue=131071, ComSignalInitValue=131070, ComSignalType=UINT32, ComHandleId=185, ComSystemTemplateSystemSignalRef=BJB_Lebensdauer_Trennelemente
          BJB_10_BZ_XIX_BJB_10_XIX_BMC_CAN01_a6352113_Rx: ComBitPosition=8, ComBitSize=4, ComSignalInitValue=0, ComSignalType=UINT8, ComHandleId=183, ComSystemTemplateSystemSignalRef=BJB_10_BZ
          BJB_Sperrung_Unterspannung_XIX_BJB_10_XIX_BMC_CAN01_5ca05f2f_Rx: ComBitPosition=12, ComBitSize=2, ComSignalDataInvalidValue=3, ComSignalInitValue=2, ComSignalType=UINT8, ComHandleId=186, ComSystemTemplateSystemSignalRef=BJB_Sperrung_Unterspannung
          BJB_Status_Trennelemente_XIX_BJB_10_XIX_BMC_CAN01_968ddb16_Rx: ComBitPosition=32, ComBitSize=3, ComSignalDataInvalidValue=7, ComSignalInitValue=6, ComSignalType=UINT8, ComHandleId=188, ComSystemTemplateSystemSignalRef=BJB_Status_Trennelemente
          BJB_10_CRC_XIX_BJB_10_XIX_BMC_CAN01_e5862de0_Rx: ComBitPosition=0, ComBitSize=8, ComSignalInitValue=0, ComSignalType=UINT8, ComHandleId=184, ComSystemTemplateSystemSignalRef=BJB_10_CRC
          ISignalVoid_BJB_10_XIX_BMC_CAN01_0_d632535f_Rx: ComBitPosition=35, ComBitSize=5, ComSignalType=UINT8, ComSignalInitValue=0, ComHandleId=189, ComSystemTemplateSystemSignalRef=SignalVoid_BJB_10_0
          ISignalVoid_BJB_10_XIX_BMC_CAN01_1_a13563c9_Rx: ComBitPosition=40, ComBitSize=8, ComSignalType=UINT8, ComSignalInitValue=0, ComHandleId=190, ComSystemTemplateSystemSignalRef=SignalVoid_BJB_10_1
          ISignalVoid_BJB_10_XIX_BMC_CAN01_3_4f3b02e5_Rx: ComBitPosition=56, ComBitSize=8, ComSignalType=UINT8, ComSignalInitValue=0, ComHandleId=192, ComSystemTemplateSystemSignalRef=SignalVoid_BJB_10_3
          ISignalVoid_BJB_10_XIX_BMC_CAN01_2_383c3273_Rx: ComBitPosition=48, ComBitSize=8, ComSignalType=UINT8, ComSignalInitValue=0, ComHandleId=191, ComSystemTemplateSystemSignalRef=SignalVoid_BJB_10_2
          BJB_Status_HV_Spannungssensorik_XIX_BJB_10_XIX_BMC_CAN01_cb195691_Rx: ComBitPosition=14, ComBitSize=1, ComSignalDataInvalidValue=1, ComSignalInitValue=0, ComSignalType=UINT8, ComHandleId=187, ComSystemTemplateSystemSignalRef=BJB_Status_HV_Spannungssensorik
      5 x ComSignal, all with ComSignalEndianness=LITTLE_ENDIAN, ComSignalAccess=ACCESS_UNCLEAR:
        BMC_CMC_Zellspannung_179_XIX_BMC_CMC_Zellspannung_05_XIX_HCP5_CANFD01_05341580_Tx: ComBitPosition=276, ComBitSize=12, ComSignalDataInvalidValue=4095, ComSignalInitValue=4094, ComSignalType=UINT16, ComTransferProperty=PENDING, ComHandleId=290, ComSystemTemplateSystemSignalRef=BMC_CMC_Zellspannung_179
        DCDC_NV_Komponentenfehler_31_XIX_DCDC_NV_Komponentenfehler_02_XIX_HCP5_CANFD01_848b91a4_Rx: ComBitPosition=2, ComBitSize=2, ComSignalInitValue=0, ComSignalType=UINT8, ComTimeout=5, ComHandleId=92, ComSystemTemplateSystemSignalRef=DCDC_NV_Komponentenfehler_31
        DCDC_NV_CALID_Index_06_XIX_DCDC_NV_CALID_XIX_HCP5_CANFD01_d3e7c7eb_Rx: ComBitPosition=40, ComBitSize=8, ComSignalInitValue=63, ComSignalType=UINT8, ComTimeout=5, ComHandleId=30, ComSystemTemplateSystemSignalRef=DCDC_NV_CALID_Index_06
        NVEM_Abschaltstufe_XIX_NVEM_12_XIX_HCP5_CANFD01_cc082583_Rx: ComBitPosition=19, ComBitSize=2, ComSignalInitValue=0, ComSignalType=UINT8, ComTimeout=1, ComHandleId=157, ComSystemTemplateSystemSignalRef=NVEM_Abschaltstufe
        BMC_CMC_Zellspannung_009_XIX_BMC_CMC_Zellspannung_01_XIX_HCP5_CANFD01_f6331820_Tx: ComBitPosition=108, ComBitSize=12, ComSignalDataInvalidValue=4095, ComSignalInitValue=4094, ComSignalType=UINT16, ComTransferProperty=PENDING, ComHandleId=120, ComSystemTemplateSystemSignalRef=BMC_CMC_Zellspannung_009
      SG_UI2_03_XIX_BMC_CAN01_8f9e5a69_Rx (ComSignalGroup):
        ComTransferProperty = TRIGGERED_WITHOUT_REPETITION
        ComSignalGroupAccess = ACCESS_UNCLEAR
        ComHandleId = 15
        ComSystemTemplateSignalGroupRef = SG_UI2_03_XIX_BMC_CAN01
        8 x ComGroupSignal, all with ComSignalEndianness=LITTLE_ENDIAN, ComSignalAccess=ACCESS_UNCLEAR:
          UI2_Pyro_Status_XIX_UI2_03_XIX_BMC_CAN01_0ab0a689_Rx: ComBitPosition=60, ComBitSize=3, ComSignalDataInvalidValue=1, ComSignalInitValue=0, ComSignalType=UINT8, ComHandleId=327, ComSystemTemplateSystemSignalRef=UI2_Pyro_Status
          UI2_Spannung5_XIX_UI2_03_XIX_BMC_CAN01_4c89e1c1_Rx: ComBitPosition=27, ComBitSize=15, ComSignalDataInvalidValue=32767, ComSignalInitValue=32766, ComSignalType=UINT16, ComHandleId=329, ComSystemTemplateSystemSignalRef=UI2_Spannung5
          UI2_Spannung6_XIX_UI2_03_XIX_BMC_CAN01_bede0c39_Rx: ComBitPosition=42, ComBitSize=15, ComSignalDataInvalidValue=32767, ComSignalInitValue=32766, ComSignalType=UINT16, ComHandleId=330, ComSystemTemplateSystemSignalRef=UI2_Spannung6
          UI2_Spannung4_XIX_UI2_03_XIX_BMC_CAN01_ab944756_Rx: ComBitPosition=12, ComBitSize=15, ComSignalDataInvalidValue=32767, ComSignalInitValue=32766, ComSignalType=UINT16, ComHandleId=328, ComSystemTemplateSystemSignalRef=UI2_Spannung4
          ISignalVoid_UI2_03_XIX_BMC_CAN01_0_120813e0_Rx: ComBitPosition=63, ComBitSize=1, ComSignalType=UINT8, ComSignalInitValue=0, ComHandleId=325, ComSystemTemplateSystemSignalRef=SignalVoid_UI2_03_0
          UISensorPyro_03_BZ_XIX_UI2_03_XIX_BMC_CAN01_2ec90f85_Rx: ComBitPosition=8, ComBitSize=4, ComSignalInitValue=0, ComSignalType=UINT8, ComHandleId=331, ComSystemTemplateSystemSignalRef=UISensorPyro_03_BZ
          UI2_HW_Crashleitung_Status_XIX_UI2_03_XIX_BMC_CAN01_ebcebdeb_Rx: ComBitPosition=57, ComBitSize=3, ComSignalDataInvalidValue=1, ComSignalInitValue=0, ComSignalType=UINT8, ComHandleId=326, ComSystemTemplateSystemSignalRef=UI2_HW_Crashleitung_Status
          UISensorPyro_03_CRC_XIX_UI2_03_XIX_BMC_CAN01_73c104f9_Rx: ComBitPosition=0, ComBitSize=8, ComSignalInitValue=0, ComSignalType=UINT8, ComHandleId=332, ComSystemTemplateSystemSignalRef=UISensorPyro_03_CRC
      BMC_CMC_Zellspannung_108_XIX_BMC_CMC_Zellspannung_03_XIX_HCP5_CANFD01_b19f04ec_Tx (ComSignal):
        ComBitPosition = 360
        ComBitSize = 12
        ComSignalDataInvalidValue = 4095
        ComSignalEndianness = LITTLE_ENDIAN
        ComSignalInitValue = 4094
        ComSignalType = UINT16
        ComTransferProperty = PENDING
        ComSignalAccess = ACCESS_UNCLEAR
        ComHandleId = 219
        ComSystemTemplateSystemSignalRef = BMC_CMC_Zellspannung_108
      BMC_HV_13_XIX_BMC_CAN01_E2E_8bfb57f8_Tx (ComIPdu):
        ComIPduDirection = SEND
        ComIPduType = NORMAL
        ComIPduHandleId = 20
        ComIPduSignalProcessing = DEFERRED
        ComIPduCancellationSupport = false
        ComIPduGroupRef = BMC_HV_XIX_BMC_CAN01_Tx_2d622f96
        ComIPduSignalGroupRef = SG_BMC_HV_13_XIX_BMC_CAN01_3930bd0b_Tx
        ComPduIdRef = BMC_HV_13_XIX_BMC_CAN01_E2E_8bfb57f8_Tx
        ComIPduMainFunctionRef = ComMainFunctionTx
        ComTxIPdu: ComTxIPduUnusedAreasDefault=0, ComMinimumDelayTime=0
          ComTxModeTrue
            ComTxMode: ComTxModeMode=DIRECT, ComTxModeNumberOfRepetitions=0, ComTxModeRepetitionPeriod=0
          ComTxModeFalse
            ComTxMode: ComTxModeMode=NONE
      3 x ComSignal, all with ComSignalEndianness=LITTLE_ENDIAN, ComSignalAccess=ACCESS_UNCLEAR:
        BMC_CMC_Temperatur_037_XIX_BMC_CMC_Temperatur_01_XIX_HCP5_CANFD01_da6eac9b_Tx: ComBitPosition=304, ComBitSize=8, ComSignalDataInvalidValue=255, ComSignalInitValue=254, ComSignalType=UINT8, ComTransferProperty=PENDING, ComHandleId=47, ComSystemTemplateSystemSignalRef=BMC_CMC_Temperatur_037
        VIN_9_XIX_WFS_02_XIX_HCP5_CANFD01_d4ed4b36_Rx: ComBitPosition=80, ComBitSize=8, ComSignalInitValue=45, ComSignalType=UINT8, ComTimeout=4, ComHandleId=501, ComSystemTemplateSystemSignalRef=VIN_9
        BMC_CMC_Zellspannung_087_XIX_BMC_CMC_Zellspannung_03_XIX_HCP5_CANFD01_9da7ab38_Tx: ComBitPosition=108, ComBitSize=12, ComSignalDataInvalidValue=4095, ComSignalInitValue=4094, ComSignalType=UINT16, ComTransferProperty=PENDING, ComHandleId=198, ComSystemTemplateSystemSignalRef=BMC_CMC_Zellspannung_087
      UI2_01_XIX_BMC_CAN01_E2E_f7b0279f_Rx (ComIPdu):
        ComIPduDirection = RECEIVE
        ComIPduType = NORMAL
        ComIPduHandleId = 56
        ComIPduSignalProcessing = DEFERRED
        ComIPduCancellationSupport = false
        ComIPduGroupRef = BMC_HV_XIX_BMC_CAN01_Rx_7b388810
        ComIPduSignalGroupRef = SG_UI2_01_XIX_BMC_CAN01_2718ebf8_Rx
        ComPduIdRef = UI2_01_XIX_BMC_CAN01_E2E_f7b0279f_Rx
        ComIPduMainFunctionRef = ComMainFunctionRx
      8 x ComSignal, all with ComSignalEndianness=LITTLE_ENDIAN, ComSignalAccess=ACCESS_UNCLEAR:
        DCDC_NV_CALID_Index_03_XIX_DCDC_NV_CALID_XIX_HCP5_CANFD01_7ec74be9_Rx: ComBitPosition=16, ComBitSize=8, ComSignalInitValue=63, ComSignalType=UINT8, ComTimeout=5, ComHandleId=27, ComSystemTemplateSystemSignalRef=DCDC_NV_CALID_Index_03
        BMC_CMC_Temperatur_094_XIX_BMC_CMC_Temperatur_03_XIX_HCP5_CANFD01_217988c0_Tx: ComBitPosition=184, ComBitSize=8, ComSignalDataInvalidValue=255, ComSignalInitValue=254, ComSignalType=UINT8, ComTransferProperty=PENDING, ComHandleId=104, ComSystemTemplateSystemSignalRef=BMC_CMC_Temperatur_094
        BMC_CMC_Zellspannung_015_XIX_BMC_CMC_Zellspannung_01_XIX_HCP5_CANFD01_f3b3ab52_Tx: ComBitPosition=180, ComBitSize=12, ComSignalDataInvalidValue=4095, ComSignalInitValue=4094, ComSignalType=UINT16, ComTransferProperty=PENDING, ComHandleId=126, ComSystemTemplateSystemSignalRef=BMC_CMC_Zellspannung_015
        BMC_Max_Spannung_XIX_BMC_HV_06_XIX_HCP5_CANFD01_ed13d04e_Tx: ComBitPosition=12, ComBitSize=10, ComSignalDataInvalidValue=1023, ComSignalInitValue=1022, ComSignalType=UINT16, ComTransferProperty=TRIGGERED_ON_CHANGE_WITHOUT_REPETITION, ComHandleId=327, ComSystemTemplateSystemSignalRef=BMC_Max_Spannung
        UI2_KompFehlerModus2_07_XIX_UI2_Komponentenfehler_01_XIX_BMC_CAN01_e6874de3_Rx: ComBitPosition=24, ComBitSize=2, ComSignalInitValue=0, ComSignalType=UINT8, ComTimeout=1, ComHandleId=451, ComSystemTemplateSystemSignalRef=UI2_KompFehlerModus2_07
        DCDC_NV_Komponentenfehler_74_XIX_DCDC_NV_Komponentenfehler_03_XIX_HCP5_CANFD01_43bce06d_Rx: ComBitPosition=26, ComBitSize=2, ComSignalInitValue=0, ComSignalType=UINT8, ComTimeout=5, ComHandleId=135, ComSystemTemplateSystemSignalRef=DCDC_NV_Komponentenfehler_74
        BMC_RtmWarnUZelleMin_XIX_BMC_HV_08_XIX_HCP5_CANFD01_d2b516f8_Tx: ComBitPosition=58, ComBitSize=3, ComSignalInitValue=0, ComSignalType=UINT8, ComTransferProperty=PENDING, ComHandleId=375, ComSystemTemplateSystemSignalRef=BMC_RtmWarnUZelleMin
        DS_Hybrid_01_Subsystemaktiv_XIX_DS_Hybrid_01_XIX_HCP5_CANFD01_cb6ff8bb_Tx: ComBitPosition=24, ComBitSize=1, ComSignalInitValue=0, ComSignalType=UINT8, ComTransferProperty=PENDING, ComHandleId=398, ComSystemTemplateSystemSignalRef=DS_Hybrid_01_Subsystemaktiv
      Airbag_10_XIX_HCP5_CANFD01_7f2c77c5_Rx (ComIPdu):
        ComIPduDirection = RECEIVE
        ComIPduType = NORMAL
        ComIPduHandleId = 0
        ComIPduSignalProcessing = DEFERRED
        ComIPduCancellationSupport = false
        ComIPduGroupRef = BMC_HV_XIX_HCP5_CANFD01_Rx_6dfafc5f
        ComIPduGroupRef = BMC_HV_XIX_PNC_13_Airbag_Rx_29234cf7
        ComIPduSignalRef = AB_Deaktivierung_HV_XIX_Airbag_10_XIX_HCP5_CANFD01_e8982158_Rx
        ComPduIdRef = Airbag_10_XIX_HCP5_CANFD01_7f2c77c5_Rx
        ComIPduMainFunctionRef = ComMainFunctionRx
      DCDC_NV_Komponentenfehler_03_XIX_HCP5_CANFD01_d8bc1ce5_Rx (ComIPdu):
        ComIPduDirection = RECEIVE
        ComIPduType = NORMAL
        ComIPduHandleId = 17
        ComIPduSignalProcessing = DEFERRED
        ComIPduCancellationSupport = false
        ComIPduGroupRef = BMC_HV_XIX_HCP5_CANFD01_Rx_6dfafc5f
        ComIPduGroupRef = BMC_HV_XIX_PNC_26_HighVoltage_Charging_Rx_765b82c2
        ComIPduSignalRef = DCDC_NV_Komponentenfehler_61_XIX_DCDC_NV_Komponentenfehler_03_XIX_HCP5_CANFD01_7e572d3d_Rx
        ComIPduSignalRef = DCDC_NV_Komponentenfehler_62_XIX_DCDC_NV_Komponentenfehler_03_XIX_HCP5_CANFD01_fb653fc9_Rx
        ComIPduSignalRef = DCDC_NV_Komponentenfehler_63_XIX_DCDC_NV_Komponentenfehler_03_XIX_HCP5_CANFD01_315bcc5a_Rx
        ComIPduSignalRef = DCDC_NV_Komponentenfehler_64_XIX_DCDC_NV_Komponentenfehler_03_XIX_HCP5_CANFD01_2a701c60_Rx
        ComIPduSignalRef = DCDC_NV_Komponentenfehler_65_XIX_DCDC_NV_Komponentenfehler_03_XIX_HCP5_CANFD01_e04eeff3_Rx
        ComIPduSignalRef = DCDC_NV_Komponentenfehler_66_XIX_DCDC_NV_Komponentenfehler_03_XIX_HCP5_CANFD01_657cfd07_Rx
        ComIPduSignalRef = DCDC_NV_Komponentenfehler_67_XIX_DCDC_NV_Komponentenfehler_03_XIX_HCP5_CANFD01_af420e94_Rx
        ComIPduSignalRef = DCDC_NV_Komponentenfehler_68_XIX_DCDC_NV_Komponentenfehler_03_XIX_HCP5_CANFD01_532b5d73_Rx
        ComIPduSignalRef = DCDC_NV_Komponentenfehler_69_XIX_DCDC_NV_Komponentenfehler_03_XIX_HCP5_CANFD01_9915aee0_Rx
        ComIPduSignalRef = DCDC_NV_Komponentenfehler_70_XIX_DCDC_NV_Komponentenfehler_03_XIX_HCP5_CANFD01_dda522a3_Rx
        ComIPduSignalRef = DCDC_NV_Komponentenfehler_71_XIX_DCDC_NV_Komponentenfehler_03_XIX_HCP5_CANFD01_179bd130_Rx
        ComIPduSignalRef = DCDC_NV_Komponentenfehler_72_XIX_DCDC_NV_Komponentenfehler_03_XIX_HCP5_CANFD01_92a9c3c4_Rx
        ComIPduSignalRef = DCDC_NV_Komponentenfehler_73_XIX_DCDC_NV_Komponentenfehler_03_XIX_HCP5_CANFD01_58973057_Rx
        ComIPduSignalRef = DCDC_NV_Komponentenfehler_74_XIX_DCDC_NV_Komponentenfehler_03_XIX_HCP5_CANFD01_43bce06d_Rx
        ComIPduSignalRef = DCDC_NV_Komponentenfehler_75_XIX_DCDC_NV_Komponentenfehler_03_XIX_HCP5_CANFD01_898213fe_Rx
        ComIPduSignalRef = DCDC_NV_Komponentenfehler_76_XIX_DCDC_NV_Komponentenfehler_03_XIX_HCP5_CANFD01_0cb0010a_Rx
        ComIPduSignalRef = DCDC_NV_Komponentenfehler_77_XIX_DCDC_NV_Komponentenfehler_03_XIX_HCP5_CANFD01_c68ef299_Rx
        ComIPduSignalRef = DCDC_NV_Komponentenfehler_78_XIX_DCDC_NV_Komponentenfehler_03_XIX_HCP5_CANFD01_3ae7a17e_Rx
        ComIPduSignalRef = DCDC_NV_Komponentenfehler_79_XIX_DCDC_NV_Komponentenfehler_03_XIX_HCP5_CANFD01_f0d952ed_Rx
        ComIPduSignalRef = DCDC_NV_Komponentenfehler_80_XIX_DCDC_NV_Komponentenfehler_03_XIX_HCP5_CANFD01_e3373c2b_Rx
        ComPduIdRef = DCDC_NV_Komponentenfehler_03_XIX_HCP5_CANFD01_d8bc1ce5_Rx
        ComIPduMainFunctionRef = ComMainFunctionRx
      9 x ComSignal, all with ComSignalEndianness=LITTLE_ENDIAN, ComSignalAccess=ACCESS_UNCLEAR:
        BMC_CMC_Temperatur_043_XIX_BMC_CMC_Temperatur_01_XIX_HCP5_CANFD01_aece9875_Tx: ComBitPosition=352, ComBitSize=8, ComSignalDataInvalidValue=255, ComSignalInitValue=254, ComSignalType=UINT8, ComTransferProperty=PENDING, ComHandleId=53, ComSystemTemplateSystemSignalRef=BMC_CMC_Temperatur_043
        Hybrid_01_Nachlauftyp_XIX_KN_Hybrid_01_XIX_HCP5_CANFD01_26798f2d_Tx: ComBitPosition=4, ComBitSize=4, ComSignalInitValue=2, ComSignalType=UINT8, ComTransferProperty=PENDING, ComHandleId=405, ComSystemTemplateSystemSignalRef=Hybrid_01_Nachlauftyp
        UI2Sens01_CALID_Index_06_XIX_UI2Sens01_CALID_01_XIX_BMC_CAN01_669242c2_Rx: ComBitPosition=40, ComBitSize=8, ComSignalInitValue=63, ComSignalType=UINT8, ComTimeout=5, ComHandleId=406, ComSystemTemplateSystemSignalRef=UI2Sens01_CALID_Index_06
        BMC_CMC_Temperatur_023_XIX_BMC_CMC_Temperatur_01_XIX_HCP5_CANFD01_d158655f_Tx: ComBitPosition=192, ComBitSize=8, ComSignalDataInvalidValue=255, ComSignalInitValue=254, ComSignalType=UINT8, ComTransferProperty=PENDING, ComHandleId=33, ComSystemTemplateSystemSignalRef=BMC_CMC_Temperatur_023
        BMC_IstZellSpannungMax_Zell_ID_XIX_BMC_HV_08_XIX_HCP5_CANFD01_b2be9152_Tx: ComBitPosition=312, ComBitSize=8, ComSignalInitValue=255, ComSignalType=UINT8, ComTransferProperty=PENDING, ComHandleId=317, ComSystemTemplateSystemSignalRef=BMC_IstZellSpannungMax_Zell_ID
        BMC_CMC_Zellspannung_145_XIX_BMC_CMC_Zellspannung_04_XIX_HCP5_CANFD01_3d1406d9_Tx: ComBitPosition=336, ComBitSize=12, ComSignalDataInvalidValue=4095, ComSignalInitValue=4094, ComSignalType=UINT16, ComTransferProperty=PENDING, ComHandleId=256, ComSystemTemplateSystemSignalRef=BMC_CMC_Zellspannung_145
        VIN_6_XIX_WFS_02_XIX_HCP5_CANFD01_88578729_Rx: ComBitPosition=56, ComBitSize=8, ComSignalInitValue=45, ComSignalType=UINT8, ComTimeout=4, ComHandleId=498, ComSystemTemplateSystemSignalRef=VIN_6
        BMC_Bidi_Energie_Absolut_XIX_BMC_HV_06_XIX_HCP5_CANFD01_b94683d1_Tx: ComBitPosition=48, ComBitSize=16, ComSignalDataInvalidValue=65535, ComSignalInitValue=65534, ComSignalType=UINT16, ComTransferProperty=PENDING, ComHandleId=1, ComSystemTemplateSystemSignalRef=BMC_Bidi_Energie_Absolut
        PCM_BMC_VTD_Freeze_Req_XIX_HCP1_17_XIX_HCP5_CANFD01_4dcab581_Rx: ComBitPosition=34, ComBitSize=2, ComSignalDataInvalidValue=3, ComSignalInitValue=2, ComSignalType=UINT8, ComTimeout=5, ComHandleId=179, ComSystemTemplateSystemSignalRef=PCM_BMC_VTD_Freeze_Req
      BMC_CMC_Zellspannung_01_XIX_HCP5_CANFD01_f76fbfe9_Tx (ComIPdu):
        ComIPduDirection = SEND
        ComIPduType = NORMAL
        ComIPduHandleId = 3
        ComIPduSignalProcessing = DEFERRED
        ComIPduCancellationSupport = false
        ComIPduGroupRef = BMC_HV_XIX_HCP5_CANFD01_Tx_3ba05bd9
        ComIPduGroupRef = BMC_HV_XIX_PNC_26_HighVoltage_Charging_Tx_20012544
        ComIPduSignalRef = BMC_CMC_Zellspannung_001_XIX_BMC_CMC_Zellspannung_01_XIX_HCP5_CANFD01_be9dc83a_Tx
        ComIPduSignalRef = BMC_CMC_Zellspannung_002_XIX_BMC_CMC_Zellspannung_01_XIX_HCP5_CANFD01_3ec7648f_Tx
        ComIPduSignalRef = BMC_CMC_Zellspannung_003_XIX_BMC_CMC_Zellspannung_01_XIX_HCP5_CANFD01_410eff1c_Tx
        ComIPduSignalRef = BMC_CMC_Zellspannung_004_XIX_BMC_CMC_Zellspannung_01_XIX_HCP5_CANFD01_e5033ba4_Tx
        ComIPduSignalRef = BMC_CMC_Zellspannung_005_XIX_BMC_CMC_Zellspannung_01_XIX_HCP5_CANFD01_9acaa037_Tx
        ComIPduSignalRef = BMC_CMC_Zellspannung_006_XIX_BMC_CMC_Zellspannung_01_XIX_HCP5_CANFD01_1a900c82_Tx
        ComIPduSignalRef = BMC_CMC_Zellspannung_007_XIX_BMC_CMC_Zellspannung_01_XIX_HCP5_CANFD01_65599711_Tx
        ComIPduSignalRef = BMC_CMC_Zellspannung_008_XIX_BMC_CMC_Zellspannung_01_XIX_HCP5_CANFD01_89fa83b3_Tx
        ComIPduSignalRef = BMC_CMC_Zellspannung_009_XIX_BMC_CMC_Zellspannung_01_XIX_HCP5_CANFD01_f6331820_Tx
        ComIPduSignalRef = BMC_CMC_Zellspannung_010_XIX_BMC_CMC_Zellspannung_01_XIX_HCP5_CANFD01_a82d58cc_Tx
        ComIPduSignalRef = BMC_CMC_Zellspannung_011_XIX_BMC_CMC_Zellspannung_01_XIX_HCP5_CANFD01_d7e4c35f_Tx
        ComIPduSignalRef = BMC_CMC_Zellspannung_012_XIX_BMC_CMC_Zellspannung_01_XIX_HCP5_CANFD01_57be6fea_Tx
        ComIPduSignalRef = BMC_CMC_Zellspannung_013_XIX_BMC_CMC_Zellspannung_01_XIX_HCP5_CANFD01_2877f479_Tx
        ComIPduSignalRef = BMC_CMC_Zellspannung_014_XIX_BMC_CMC_Zellspannung_01_XIX_HCP5_CANFD01_8c7a30c1_Tx
        ComIPduSignalRef = BMC_CMC_Zellspannung_015_XIX_BMC_CMC_Zellspannung_01_XIX_HCP5_CANFD01_f3b3ab52_Tx
        ComIPduSignalRef = BMC_CMC_Zellspannung_016_XIX_BMC_CMC_Zellspannung_01_XIX_HCP5_CANFD01_73e907e7_Tx
        ComIPduSignalRef = BMC_CMC_Zellspannung_017_XIX_BMC_CMC_Zellspannung_01_XIX_HCP5_CANFD01_0c209c74_Tx
        ComIPduSignalRef = BMC_CMC_Zellspannung_018_XIX_BMC_CMC_Zellspannung_01_XIX_HCP5_CANFD01_e08388d6_Tx
        ComIPduSignalRef = BMC_CMC_Zellspannung_019_XIX_BMC_CMC_Zellspannung_01_XIX_HCP5_CANFD01_9f4a1345_Tx
        ComIPduSignalRef = BMC_CMC_Zellspannung_01_Messzeit_XIX_BMC_CMC_Zellspannung_01_XIX_HCP5_CANFD01_a5e0aca3_Tx
        ComIPduSignalRef = BMC_CMC_Zellspannung_020_XIX_BMC_CMC_Zellspannung_01_XIX_HCP5_CANFD01_13a64563_Tx
        ComIPduSignalRef = BMC_CMC_Zellspannung_021_XIX_BMC_CMC_Zellspannung_01_XIX_HCP5_CANFD01_6c6fdef0_Tx
        ComIPduSignalRef = BMC_CMC_Zellspannung_022_XIX_BMC_CMC_Zellspannung_01_XIX_HCP5_CANFD01_ec357245_Tx
        ComIPduSignalRef = BMC_CMC_Zellspannung_023_XIX_BMC_CMC_Zellspannung_01_XIX_HCP5_CANFD01_93fce9d6_Tx
        ComIPduSignalRef = BMC_CMC_Zellspannung_024_XIX_BMC_CMC_Zellspannung_01_XIX_HCP5_CANFD01_37f12d6e_Tx
        ComIPduSignalRef = BMC_CMC_Zellspannung_025_XIX_BMC_CMC_Zellspannung_01_XIX_HCP5_CANFD01_4838b6fd_Tx
        ComIPduSignalRef = BMC_CMC_Zellspannung_026_XIX_BMC_CMC_Zellspannung_01_XIX_HCP5_CANFD01_c8621a48_Tx
        ComIPduSignalRef = BMC_CMC_Zellspannung_027_XIX_BMC_CMC_Zellspannung_01_XIX_HCP5_CANFD01_b7ab81db_Tx
        ComIPduSignalRef = BMC_CMC_Zellspannung_028_XIX_BMC_CMC_Zellspannung_01_XIX_HCP5_CANFD01_5b089579_Tx
        ComIPduSignalRef = BMC_CMC_Zellspannung_029_XIX_BMC_CMC_Zellspannung_01_XIX_HCP5_CANFD01_24c10eea_Tx
        ComIPduSignalRef = BMC_CMC_Zellspannung_030_XIX_BMC_CMC_Zellspannung_01_XIX_HCP5_CANFD01_7adf4e06_Tx
        ComIPduSignalRef = BMC_CMC_Zellspannung_031_XIX_BMC_CMC_Zellspannung_01_XIX_HCP5_CANFD01_0516d595_Tx
        ComIPduSignalRef = BMC_CMC_Zellspannung_032_XIX_BMC_CMC_Zellspannung_01_XIX_HCP5_CANFD01_854c7920_Tx
        ComIPduSignalRef = BMC_CMC_Zellspannung_033_XIX_BMC_CMC_Zellspannung_01_XIX_HCP5_CANFD01_fa85e2b3_Tx
        ComIPduSignalRef = BMC_CMC_Zellspannung_034_XIX_BMC_CMC_Zellspannung_01_XIX_HCP5_CANFD01_5e88260b_Tx
        ComIPduSignalRef = BMC_CMC_Zellspannung_035_XIX_BMC_CMC_Zellspannung_01_XIX_HCP5_CANFD01_2141bd98_Tx
        ComIPduSignalRef = BMC_CMC_Zellspannung_036_XIX_BMC_CMC_Zellspannung_01_XIX_HCP5_CANFD01_a11b112d_Tx
        ComIPduSignalRef = BMC_CMC_Zellspannung_037_XIX_BMC_CMC_Zellspannung_01_XIX_HCP5_CANFD01_ded28abe_Tx
        ComIPduSignalRef = BMC_CMC_Zellspannung_038_XIX_BMC_CMC_Zellspannung_01_XIX_HCP5_CANFD01_32719e1c_Tx
        ComIPduSignalRef = BMC_CMC_Zellspannung_039_XIX_BMC_CMC_Zellspannung_01_XIX_HCP5_CANFD01_4db8058f_Tx
        ComPduIdRef = BMC_CMC_Zellspannung_01_XIX_HCP5_CANFD01_f76fbfe9_Tx
        ComIPduMainFunctionRef = ComMainFunctionTx
        ComTxIPdu: ComTxIPduUnusedAreasDefault=0, ComMinimumDelayTime=0
          ComTxModeTrue
            ComTxMode: ComTxModeMode=PERIODIC, ComTxModeTimeOffset=0, ComTxModeTimePeriod=1
          ComTxModeFalse
            ComTxMode: ComTxModeMode=NONE
      3 x ComSignal, all with ComSignalEndianness=LITTLE_ENDIAN, ComSignalType=UINT8, ComSignalAccess=ACCESS_UNCLEAR:
        VIN_14_XIX_WFS_02_XIX_HCP5_CANFD01_da268c5e_Rx: ComBitPosition=120, ComBitSize=8, ComSignalInitValue=45, ComTimeout=4, ComHandleId=506, ComSystemTemplateSystemSignalRef=VIN_14
        OBD_Barometric_Pressure_XIX_OBD_04_XIX_HCP5_CANFD01_26455454_Rx: ComBitPosition=56, ComBitSize=8, ComSignalInitValue=0, ComTimeout=3.2, ComHandleId=161, ComSystemTemplateSystemSignalRef=OBD_Barometric_Pressure
        DCDC_NV_Komponentenfehler_25_XIX_DCDC_NV_Komponentenfehler_01_XIX_HCP5_CANFD01_99d87205_Rx: ComBitPosition=48, ComBitSize=2, ComSignalInitValue=0, ComTimeout=5, ComHandleId=86, ComSystemTemplateSystemSignalRef=DCDC_NV_Komponentenfehler_25
      BMC_CMC_Zellspannung_05_XIX_HCP5_CANFD01_fcc768ef_Tx (ComIPdu):
        ComIPduDirection = SEND
        ComIPduType = NORMAL
        ComIPduHandleId = 7
        ComIPduSignalProcessing = DEFERRED
        ComIPduCancellationSupport = false
        ComIPduGroupRef = BMC_HV_XIX_HCP5_CANFD01_Tx_3ba05bd9
        ComIPduGroupRef = BMC_HV_XIX_PNC_26_HighVoltage_Charging_Tx_20012544
        ComIPduSignalRef = BMC_CMC_Zellspannung_05_Messzeit_XIX_BMC_CMC_Zellspannung_05_XIX_HCP5_CANFD01_2646b7e5_Tx
        ComIPduSignalRef = BMC_CMC_Zellspannung_157_XIX_BMC_CMC_Zellspannung_05_XIX_HCP5_CANFD01_44ac8c7b_Tx
        ComIPduSignalRef = BMC_CMC_Zellspannung_158_XIX_BMC_CMC_Zellspannung_05_XIX_HCP5_CANFD01_a80f98d9_Tx
        ComIPduSignalRef = BMC_CMC_Zellspannung_159_XIX_BMC_CMC_Zellspannung_05_XIX_HCP5_CANFD01_d7c6034a_Tx
        ComIPduSignalRef = BMC_CMC_Zellspannung_160_XIX_BMC_CMC_Zellspannung_05_XIX_HCP5_CANFD01_5b2a556c_Tx
        ComIPduSignalRef = BMC_CMC_Zellspannung_161_XIX_BMC_CMC_Zellspannung_05_XIX_HCP5_CANFD01_24e3ceff_Tx
        ComIPduSignalRef = BMC_CMC_Zellspannung_162_XIX_BMC_CMC_Zellspannung_05_XIX_HCP5_CANFD01_a4b9624a_Tx
        ComIPduSignalRef = BMC_CMC_Zellspannung_163_XIX_BMC_CMC_Zellspannung_05_XIX_HCP5_CANFD01_db70f9d9_Tx
        ComIPduSignalRef = BMC_CMC_Zellspannung_164_XIX_BMC_CMC_Zellspannung_05_XIX_HCP5_CANFD01_7f7d3d61_Tx
        ComIPduSignalRef = BMC_CMC_Zellspannung_165_XIX_BMC_CMC_Zellspannung_05_XIX_HCP5_CANFD01_00b4a6f2_Tx
        ComIPduSignalRef = BMC_CMC_Zellspannung_166_XIX_BMC_CMC_Zellspannung_05_XIX_HCP5_CANFD01_80ee0a47_Tx
        ComIPduSignalRef = BMC_CMC_Zellspannung_167_XIX_BMC_CMC_Zellspannung_05_XIX_HCP5_CANFD01_ff2791d4_Tx
        ComIPduSignalRef = BMC_CMC_Zellspannung_168_XIX_BMC_CMC_Zellspannung_05_XIX_HCP5_CANFD01_13848576_Tx
        ComIPduSignalRef = BMC_CMC_Zellspannung_169_XIX_BMC_CMC_Zellspannung_05_XIX_HCP5_CANFD01_6c4d1ee5_Tx
        ComIPduSignalRef = BMC_CMC_Zellspannung_170_XIX_BMC_CMC_Zellspannung_05_XIX_HCP5_CANFD01_32535e09_Tx
        ComIPduSignalRef = BMC_CMC_Zellspannung_171_XIX_BMC_CMC_Zellspannung_05_XIX_HCP5_CANFD01_4d9ac59a_Tx
        ComIPduSignalRef = BMC_CMC_Zellspannung_172_XIX_BMC_CMC_Zellspannung_05_XIX_HCP5_CANFD01_cdc0692f_Tx
        ComIPduSignalRef = BMC_CMC_Zellspannung_173_XIX_BMC_CMC_Zellspannung_05_XIX_HCP5_CANFD01_b209f2bc_Tx
        ComIPduSignalRef = BMC_CMC_Zellspannung_174_XIX_BMC_CMC_Zellspannung_05_XIX_HCP5_CANFD01_16043604_Tx
        ComIPduSignalRef = BMC_CMC_Zellspannung_175_XIX_BMC_CMC_Zellspannung_05_XIX_HCP5_CANFD01_69cdad97_Tx
        ComIPduSignalRef = BMC_CMC_Zellspannung_176_XIX_BMC_CMC_Zellspannung_05_XIX_HCP5_CANFD01_e9970122_Tx
        ComIPduSignalRef = BMC_CMC_Zellspannung_177_XIX_BMC_CMC_Zellspannung_05_XIX_HCP5_CANFD01_965e9ab1_Tx
        ComIPduSignalRef = BMC_CMC_Zellspannung_178_XIX_BMC_CMC_Zellspannung_05_XIX_HCP5_CANFD01_7afd8e13_Tx
        ComIPduSignalRef = BMC_CMC_Zellspannung_179_XIX_BMC_CMC_Zellspannung_05_XIX_HCP5_CANFD01_05341580_Tx
        ComIPduSignalRef = BMC_CMC_Zellspannung_180_XIX_BMC_CMC_Zellspannung_05_XIX_HCP5_CANFD01_0a673fd9_Tx
        ComIPduSignalRef = BMC_CMC_Zellspannung_181_XIX_BMC_CMC_Zellspannung_05_XIX_HCP5_CANFD01_75aea44a_Tx
        ComIPduSignalRef = BMC_CMC_Zellspannung_182_XIX_BMC_CMC_Zellspannung_05_XIX_HCP5_CANFD01_f5f408ff_Tx
        ComIPduSignalRef = BMC_CMC_Zellspannung_183_XIX_BMC_CMC_Zellspannung_05_XIX_HCP5_CANFD01_8a3d936c_Tx
        ComIPduSignalRef = BMC_CMC_Zellspannung_184_XIX_BMC_CMC_Zellspannung_05_XIX_HCP5_CANFD01_2e3057d4_Tx
        ComIPduSignalRef = BMC_CMC_Zellspannung_185_XIX_BMC_CMC_Zellspannung_05_XIX_HCP5_CANFD01_51f9cc47_Tx
        ComIPduSignalRef = BMC_CMC_Zellspannung_186_XIX_BMC_CMC_Zellspannung_05_XIX_HCP5_CANFD01_d1a360f2_Tx
        ComIPduSignalRef = BMC_CMC_Zellspannung_187_XIX_BMC_CMC_Zellspannung_05_XIX_HCP5_CANFD01_ae6afb61_Tx
        ComIPduSignalRef = BMC_CMC_Zellspannung_188_XIX_BMC_CMC_Zellspannung_05_XIX_HCP5_CANFD01_42c9efc3_Tx
        ComIPduSignalRef = BMC_CMC_Zellspannung_189_XIX_BMC_CMC_Zellspannung_05_XIX_HCP5_CANFD01_3d007450_Tx
        ComIPduSignalRef = BMC_CMC_Zellspannung_190_XIX_BMC_CMC_Zellspannung_05_XIX_HCP5_CANFD01_631e34bc_Tx
        ComIPduSignalRef = BMC_CMC_Zellspannung_191_XIX_BMC_CMC_Zellspannung_05_XIX_HCP5_CANFD01_1cd7af2f_Tx
        ComIPduSignalRef = BMC_CMC_Zellspannung_192_XIX_BMC_CMC_Zellspannung_05_XIX_HCP5_CANFD01_9c8d039a_Tx
        ComPduIdRef = BMC_CMC_Zellspannung_05_XIX_HCP5_CANFD01_fcc768ef_Tx
        ComIPduMainFunctionRef = ComMainFunctionTx
        ComTxIPdu: ComTxIPduUnusedAreasDefault=0, ComMinimumDelayTime=0
          ComTxModeTrue
            ComTxMode: ComTxModeMode=PERIODIC, ComTxModeTimeOffset=0, ComTxModeTimePeriod=1
          ComTxModeFalse
            ComTxMode: ComTxModeMode=NONE
      BMC_CMC_Zellspannung_022_XIX_BMC_CMC_Zellspannung_01_XIX_HCP5_CANFD01_ec357245_Tx (ComSignal):
        ComBitPosition = 264
        ComBitSize = 12
        ComSignalDataInvalidValue = 4095
        ComSignalEndianness = LITTLE_ENDIAN
        ComSignalInitValue = 4094
        ComSignalType = UINT16
        ComTransferProperty = PENDING
        ComSignalAccess = ACCESS_UNCLEAR
        ComHandleId = 133
        ComSystemTemplateSystemSignalRef = BMC_CMC_Zellspannung_022
      BMC_CMC_Zellspannung_004_XIX_BMC_CMC_Zellspannung_01_XIX_HCP5_CANFD01_e5033ba4_Tx (ComSignal):
        ComBitPosition = 48
        ComBitSize = 12
        ComSignalDataInvalidValue = 4095
        ComSignalEndianness = LITTLE_ENDIAN
        ComSignalInitValue = 4094
        ComSignalType = UINT16
        ComTransferProperty = PENDING
        ComSignalAccess = ACCESS_UNCLEAR
        ComHandleId = 115
        ComSystemTemplateSystemSignalRef = BMC_CMC_Zellspannung_004
      BJB_CVN_01_XIX_BMC_CAN01_301c1ddb_Rx (ComIPdu):
        ComIPduDirection = RECEIVE
        ComIPduType = NORMAL
        ComIPduHandleId = 8
        ComIPduSignalProcessing = DEFERRED
        ComIPduCancellationSupport = false
        ComIPduGroupRef = BMC_HV_XIX_BMC_CAN01_Rx_7b388810
        ComIPduSignalRef = BJB_CVN_Byte_1_XIX_BJB_CVN_01_XIX_BMC_CAN01_18856d37_Rx
        ComIPduSignalRef = BJB_CVN_Byte_2_XIX_BJB_CVN_01_XIX_BMC_CAN01_5c24482f_Rx
        ComIPduSignalRef = BJB_CVN_Byte_3_XIX_BJB_CVN_01_XIX_BMC_CAN01_6044ab27_Rx
        ComIPduSignalRef = BJB_CVN_Byte_4_XIX_BJB_CVN_01_XIX_BMC_CAN01_d566021f_Rx
        ComIPduSignalRef = BJB_CVN_VLD_XIX_BJB_CVN_01_XIX_BMC_CAN01_7412dbc7_Rx
        ComPduIdRef = BJB_CVN_01_XIX_BMC_CAN01_301c1ddb_Rx
        ComIPduMainFunctionRef = ComMainFunctionRx
      5 x ComSignal, all with ComSignalEndianness=LITTLE_ENDIAN, ComSignalAccess=ACCESS_UNCLEAR:
        UI2_KompFehlerModus4_07_XIX_UI2_Komponentenfehler_02_XIX_BMC_CAN01_5b9d1a85_Rx: ComBitPosition=30, ComBitSize=3, ComSignalInitValue=0, ComSignalType=UINT8, ComTimeout=1, ComHandleId=477, ComSystemTemplateSystemSignalRef=UI2_KompFehlerModus4_07
        UI1_KompFehlerModus4_10_XIX_UI1_Komponentenfehler_02_XIX_BMC_CAN01_001d90e7_Rx: ComBitPosition=39, ComBitSize=3, ComSignalInitValue=0, ComSignalType=UINT8, ComTimeout=1, ComHandleId=386, ComSystemTemplateSystemSignalRef=UI1_KompFehlerModus4_10
        BJB_CALID_Index_16_XIX_BJB_CALID_02_XIX_BMC_CAN01_8bfd96e8_Rx: ComBitPosition=56, ComBitSize=8, ComSignalInitValue=63, ComSignalType=UINT8, ComTimeout=5, ComHandleId=16, ComSystemTemplateSystemSignalRef=BJB_CALID_Index_16
        BMC_Energie_Laden_XIX_BMC_HV_03_XIX_HCP5_CANFD01_44ca086e_Tx: ComBitPosition=144, ComBitSize=16, ComSignalDataInvalidValue=65535, ComSignalInitValue=65534, ComSignalType=UINT16, ComTransferProperty=PENDING, ComHandleId=310, ComSystemTemplateSystemSignalRef=BMC_Energie_Laden
        UI2Sens01_CALID_Index_16_XIX_UI2Sens01_CALID_02_XIX_BMC_CAN01_39662312_Rx: ComBitPosition=56, ComBitSize=8, ComSignalInitValue=63, ComSignalType=UINT8, ComTimeout=5, ComHandleId=416, ComSystemTemplateSystemSignalRef=UI2Sens01_CALID_Index_16
      UI1_Komponentenfehler_01_XIX_BMC_CAN01_08861f77_Rx (ComIPdu):
        ComIPduDirection = RECEIVE
        ComIPduType = NORMAL
        ComIPduHandleId = 48
        ComIPduSignalProcessing = DEFERRED
        ComIPduCancellationSupport = false
        ComIPduGroupRef = BMC_HV_XIX_BMC_CAN01_Rx_7b388810
        ComIPduSignalRef = UI1_KompFehlerModus2_01_XIX_UI1_Komponentenfehler_01_XIX_BMC_CAN01_34b9d7af_Rx
        ComIPduSignalRef = UI1_KompFehlerModus2_02_XIX_UI1_Komponentenfehler_01_XIX_BMC_CAN01_4ac19f09_Rx
        ComIPduSignalRef = UI1_KompFehlerModus2_03_XIX_UI1_Komponentenfehler_01_XIX_BMC_CAN01_60e9a76b_Rx
        ComIPduSignalRef = UI1_KompFehlerModus2_04_XIX_UI1_Komponentenfehler_01_XIX_BMC_CAN01_b6310e45_Rx
        ComIPduSignalRef = UI1_KompFehlerModus2_05_XIX_UI1_Komponentenfehler_01_XIX_BMC_CAN01_9c193627_Rx
        ComIPduSignalRef = UI1_KompFehlerModus2_06_XIX_UI1_Komponentenfehler_01_XIX_BMC_CAN01_e2617e81_Rx
        ComIPduSignalRef = UI1_KompFehlerModus2_07_XIX_UI1_Komponentenfehler_01_XIX_BMC_CAN01_c84946e3_Rx
        ComIPduSignalRef = UI1_KompFehlerModus2_08_XIX_UI1_Komponentenfehler_01_XIX_BMC_CAN01_94a12a9c_Rx
        ComIPduSignalRef = UI1_KompFehlerModus2_09_XIX_UI1_Komponentenfehler_01_XIX_BMC_CAN01_be8912fe_Rx
        ComIPduSignalRef = UI1_KompFehlerModus2_10_XIX_UI1_Komponentenfehler_01_XIX_BMC_CAN01_bd07c781_Rx
        ComIPduSignalRef = UI1_KompFehlerModus2_11_XIX_UI1_Komponentenfehler_01_XIX_BMC_CAN01_972fffe3_Rx
        ComIPduSignalRef = UI1_KompFehlerModus2_12_XIX_UI1_Komponentenfehler_01_XIX_BMC_CAN01_e957b745_Rx
        ComIPduSignalRef = UI1_KompFehlerModus2_13_XIX_UI1_Komponentenfehler_01_XIX_BMC_CAN01_c37f8f27_Rx
        ComIPduSignalRef = UI1_KompFehlerModus2_14_XIX_UI1_Komponentenfehler_01_XIX_BMC_CAN01_15a72609_Rx
        ComIPduSignalRef = UI1_KompFehlerModus2_15_XIX_UI1_Komponentenfehler_01_XIX_BMC_CAN01_3f8f1e6b_Rx
        ComIPduSignalRef = UI1_KompFehlerModus2_16_XIX_UI1_Komponentenfehler_01_XIX_BMC_CAN01_41f756cd_Rx
        ComIPduSignalRef = UI1_KompFehlerModus2_17_XIX_UI1_Komponentenfehler_01_XIX_BMC_CAN01_6bdf6eaf_Rx
        ComIPduSignalRef = UI1_KompFehlerModus2_18_XIX_UI1_Komponentenfehler_01_XIX_BMC_CAN01_373702d0_Rx
        ComIPduSignalRef = UI1_KompFehlerModus2_19_XIX_UI1_Komponentenfehler_01_XIX_BMC_CAN01_1d1f3ab2_Rx
        ComIPduSignalRef = UI1_KompFehlerModus2_20_XIX_UI1_Komponentenfehler_01_XIX_BMC_CAN01_82ccb914_Rx
        ComIPduSignalRef = UI1_KompFehlerModus2_21_XIX_UI1_Komponentenfehler_01_XIX_BMC_CAN01_a8e48176_Rx
        ComIPduSignalRef = UI1_KompFehlerModus2_22_XIX_UI1_Komponentenfehler_01_XIX_BMC_CAN01_d69cc9d0_Rx
        ComIPduSignalRef = UI1_KompFehlerModus2_23_XIX_UI1_Komponentenfehler_01_XIX_BMC_CAN01_fcb4f1b2_Rx
        ComIPduSignalRef = UI1_KompFehlerModus2_24_XIX_UI1_Komponentenfehler_01_XIX_BMC_CAN01_2a6c589c_Rx
        ComIPduSignalRef = UI1_KompFehlerModus2_25_XIX_UI1_Komponentenfehler_01_XIX_BMC_CAN01_004460fe_Rx
        ComIPduSignalRef = UI1_KompFehlerModus2_26_XIX_UI1_Komponentenfehler_01_XIX_BMC_CAN01_7e3c2858_Rx
        ComPduIdRef = UI1_Komponentenfehler_01_XIX_BMC_CAN01_08861f77_Rx
        ComIPduMainFunctionRef = ComMainFunctionRx
      OBD_Sperrung_IUMPR_XIX_OBD_04_XIX_HCP5_CANFD01_d58d72d8_Rx (ComSignal):
        ComBitPosition = 21
        ComBitSize = 1
        ComSignalEndianness = LITTLE_ENDIAN
        ComSignalInitValue = 0
        ComSignalType = UINT8
        ComTimeout = 3.2
        ComSignalAccess = ACCESS_UNCLEAR
        ComHandleId = 172
        ComSystemTemplateSystemSignalRef = OBD_Sperrung_IUMPR
      SG_ORU_Control_A_01_XIX_HCP5_CANFD01_a8e78b2d_Rx (ComSignalGroup):
        ComTransferProperty = TRIGGERED_WITHOUT_REPETITION
        ComSignalGroupAccess = ACCESS_UNCLEAR
        ComHandleId = 8
        ComSystemTemplateSignalGroupRef = SG_ORU_Control_A_01_XIX_HCP5_CANFD01
        12 x ComGroupSignal, all with ComSignalEndianness=LITTLE_ENDIAN, ComSignalInitValue=0, ComSignalAccess=ACCESS_UNCLEAR:
          OruHostUpdateA_XIX_ORU_Control_A_01_XIX_HCP5_CANFD01_340b75b7_Rx: ComBitPosition=50, ComBitSize=3, ComSignalDataInvalidValue=4, ComSignalType=UINT8, ComHandleId=273, ComSystemTemplateSystemSignalRef=OruHostUpdateA
          OruVehicleLockRequestA_XIX_ORU_Control_A_01_XIX_HCP5_CANFD01_7602ad32_Rx: ComBitPosition=20, ComBitSize=2, ComSignalDataInvalidValue=3, ComSignalType=UINT8, ComHandleId=276, ComSystemTemplateSystemSignalRef=OruVehicleLockRequestA
          OruIntegrityCheckActiveA_XIX_ORU_Control_A_01_XIX_HCP5_CANFD01_3ef9195e_Rx: ComBitPosition=22, ComBitSize=2, ComSignalDataInvalidValue=3, ComSignalType=UINT8, ComHandleId=274, ComSystemTemplateSystemSignalRef=OruIntegrityCheckActiveA
          ISignalVoid_ORU_Control_A_01_XIX_HCP5_CANFD01_0_d82ca1a5_Rx: ComBitPosition=53, ComBitSize=3, ComSignalType=UINT8, ComHandleId=265, ComSystemTemplateSystemSignalRef=SignalVoid_ORU_Control_A_01_0
          OruReleasePartitionSwitchA_XIX_ORU_Control_A_01_XIX_HCP5_CANFD01_58bfa1dd_Rx: ComBitPosition=48, ComBitSize=2, ComSignalDataInvalidValue=3, ComSignalType=UINT8, ComHandleId=275, ComSystemTemplateSystemSignalRef=OruReleasePartitionSwitchA
          ISignalVoid_ORU_Control_A_01_XIX_HCP5_CANFD01_1_af2b9133_Rx: ComBitPosition=56, ComBitSize=8, ComSignalType=UINT8, ComHandleId=266, ComSystemTemplateSystemSignalRef=SignalVoid_ORU_Control_A_01_1
          OnlineRemoteUpdateControlA_XIX_ORU_Control_A_01_XIX_HCP5_CANFD01_70378676_Rx: ComBitPosition=12, ComBitSize=4, ComSignalDataInvalidValue=15, ComSignalType=UINT8, ComHandleId=269, ComSystemTemplateSystemSignalRef=OnlineRemoteUpdateControlA
          OnlineRemoteUpdateControlOldA_XIX_ORU_Control_A_01_XIX_HCP5_CANFD01_5f2b3492_Rx: ComBitPosition=16, ComBitSize=4, ComSignalDataInvalidValue=15, ComSignalType=UINT8, ComHandleId=270, ComSystemTemplateSystemSignalRef=OnlineRemoteUpdateControlOldA
          OruControlStateA_XIX_ORU_Control_A_01_XIX_HCP5_CANFD01_1684c4c4_Rx: ComBitPosition=40, ComBitSize=8, ComSignalDataInvalidValue=129, ComSignalType=UINT8, ComHandleId=272, ComSystemTemplateSystemSignalRef=OruControlStateA
          ORU_Control_A_01_CRC_XIX_ORU_Control_A_01_XIX_HCP5_CANFD01_cd3556b4_Rx: ComBitPosition=0, ComBitSize=8, ComSignalType=UINT8, ComHandleId=268, ComSystemTemplateSystemSignalRef=ORU_Control_A_01_CRC
          ORU_Control_A_01_BZ_XIX_ORU_Control_A_01_XIX_HCP5_CANFD01_33cd8fe6_Rx: ComBitPosition=8, ComBitSize=4, ComSignalType=UINT8, ComHandleId=267, ComSystemTemplateSystemSignalRef=ORU_Control_A_01_BZ
          OruControlReleaseA_XIX_ORU_Control_A_01_XIX_HCP5_CANFD01_e7faed30_Rx: ComBitPosition=24, ComBitSize=16, ComSignalType=UINT16, ComHandleId=271, ComSystemTemplateSystemSignalRef=OruControlReleaseA
      SG_BMC_HV_02_XIX_HCP5_CANFD01_055f405a_Tx (ComSignalGroup):
        ComTransferProperty = TRIGGERED_WITHOUT_REPETITION
        ComSignalGroupAccess = ACCESS_UNCLEAR
        ComHandleId = 1
        ComSystemTemplateSignalGroupRef = SG_BMC_HV_02_XIX_HCP5_CANFD01
        45 x ComGroupSignal, all with ComSignalEndianness=LITTLE_ENDIAN, ComSignalAccess=ACCESS_UNCLEAR, ComTransferProperty=PENDING:
          Anzeige_SOC_XIX_BMC_HV_02_XIX_HCP5_CANFD01_33722566_Tx: ComBitPosition=192, ComBitSize=10, ComSignalDataInvalidValue=1023, ComSignalInitValue=1022, ComSignalType=UINT16, ComHandleId=450, ComSystemTemplateSystemSignalRef=Anzeige_SOC
          BMC_HV_02_CRC_XIX_BMC_HV_02_XIX_HCP5_CANFD01_ce5ae769_Tx: ComBitPosition=0, ComBitSize=8, ComSignalInitValue=0, ComSignalType=UINT8, ComHandleId=461, ComSystemTemplateSystemSignalRef=BMC_HV_02_CRC
          BMC_Bank_Notlauf_erlaubt_XIX_BMC_HV_02_XIX_HCP5_CANFD01_b1b7657f_Tx: ComBitPosition=47, ComBitSize=1, ComSignalInitValue=1, ComSignalType=UINT8, ComHandleId=452, ComSystemTemplateSystemSignalRef=BMC_Bank_Notlauf_erlaubt
          BMC_DC_Laden_XIX_BMC_HV_02_XIX_HCP5_CANFD01_2117dd81_Tx: ComBitPosition=144, ComBitSize=2, ComSignalDataInvalidValue=3, ComSignalInitValue=0, ComSignalType=UINT8, ComHandleId=455, ComSystemTemplateSystemSignalRef=BMC_DC_Laden
          BMC_Leerlaufspannung_XIX_BMC_HV_02_XIX_HCP5_CANFD01_d1e622c7_Tx: ComBitPosition=228, ComBitSize=10, ComSignalDataInvalidValue=1023, ComSignalInitValue=1022, ComSignalType=UINT16, ComHandleId=467, ComSystemTemplateSystemSignalRef=BMC_Leerlaufspannung
          BMC_MinDyn_Ladespannung_XIX_BMC_HV_02_XIX_HCP5_CANFD01_f42858bf_Tx: ComBitPosition=218, ComBitSize=10, ComSignalDataInvalidValue=1023, ComSignalInitValue=1022, ComSignalType=UINT16, ComHandleId=474, ComSystemTemplateSystemSignalRef=BMC_MinDyn_Ladespannung
          BMC_Verbauinfo_ACSchuetz_XIX_BMC_HV_02_XIX_HCP5_CANFD01_8875581d_Tx: ComBitPosition=133, ComBitSize=2, ComSignalInitValue=0, ComSignalType=UINT8, ComHandleId=483, ComSystemTemplateSystemSignalRef=BMC_Verbauinfo_ACSchuetz
          BMC_Energie_Sockel_SoC_XIX_BMC_HV_02_XIX_HCP5_CANFD01_eaf60dc0_Tx: ComBitPosition=285, ComBitSize=10, ComSignalDataInvalidValue=1023, ComSignalInitValue=1022, ComSignalType=UINT16, ComHandleId=456, ComSystemTemplateSystemSignalRef=BMC_Energie_Sockel_SoC
          ISignalVoid_BMC_HV_02_XIX_HCP5_CANFD01_4_2c8a980a_Tx: ComBitPosition=336, ComBitSize=8, ComSignalType=UINT8, ComSignalInitValue=0, ComHandleId=493, ComSystemTemplateSystemSignalRef=SignalVoid_BMC_HV_02_4
          BMC_Fehler_Leistungsred_XIX_BMC_HV_02_XIX_HCP5_CANFD01_1063d945_Tx: ComBitPosition=204, ComBitSize=1, ComSignalInitValue=0, ComSignalType=UINT8, ComHandleId=458, ComSystemTemplateSystemSignalRef=BMC_Fehler_Leistungsred
          BMC_IstZellspannungMin_XIX_BMC_HV_02_XIX_HCP5_CANFD01_c69e0e49_Tx: ComBitPosition=250, ComBitSize=12, ComSignalDataInvalidValue=4095, ComSignalInitValue=4094, ComSignalType=UINT16, ComHandleId=466, ComSystemTemplateSystemSignalRef=BMC_IstZellspannungMin
          BMC_HV_02_BZ_XIX_BMC_HV_02_XIX_HCP5_CANFD01_5b63fc59_Tx: ComBitPosition=8, ComBitSize=4, ComSignalInitValue=0, ComSignalType=UINT8, ComHandleId=460, ComSystemTemplateSystemSignalRef=BMC_HV_02_BZ
          ISignalVoid_BMC_HV_02_XIX_HCP5_CANFD01_1_5ce06c85_Tx: ComBitPosition=315, ComBitSize=5, ComSignalType=UINT8, ComSignalInitValue=0, ComHandleId=490, ComSystemTemplateSystemSignalRef=SignalVoid_BMC_HV_02_1
          BMC_IWU_Wert_neg_XIX_BMC_HV_02_XIX_HCP5_CANFD01_475b0f1e_Tx: ComBitPosition=160, ComBitSize=16, ComSignalDataInvalidValue=65535, ComSignalInitValue=65534, ComSignalType=UINT16, ComHandleId=463, ComSystemTemplateSystemSignalRef=BMC_IWU_Wert_neg
          BMC_NutzbarerSOC_XIX_BMC_HV_02_XIX_HCP5_CANFD01_256e065e_Tx: ComBitPosition=148, ComBitSize=12, ComSignalDataInvalidValue=4095, ComSignalInitValue=4094, ComSignalType=UINT16, ComHandleId=475, ComSystemTemplateSystemSignalRef=BMC_NutzbarerSOC
          BMC_Max_Ladeleistung_XIX_BMC_HV_02_XIX_HCP5_CANFD01_f9f2d80f_Tx: ComBitPosition=64, ComBitSize=13, ComSignalDataInvalidValue=8191, ComSignalInitValue=8190, ComSignalType=UINT16, ComHandleId=471, ComSystemTemplateSystemSignalRef=BMC_Max_Ladeleistung
          BMC_Verbauinfo_Bank_XIX_BMC_HV_02_XIX_HCP5_CANFD01_106b9581_Tx: ComBitPosition=202, ComBitSize=2, ComSignalInitValue=0, ComSignalType=UINT8, ComHandleId=484, ComSystemTemplateSystemSignalRef=BMC_Verbauinfo_Bank
          BMC_ZellTemp_virtuell_max_XIX_BMC_HV_02_XIX_HCP5_CANFD01_51ca2c01_Tx: ComBitPosition=305, ComBitSize=10, ComSignalDataInvalidValue=1023, ComSignalInitValue=1022, ComSignalType=UINT16, ComHandleId=486, ComSystemTemplateSystemSignalRef=BMC_ZellTemp_virtuell_max
          BMC_Unterboden_Warnung_XIX_BMC_HV_02_XIX_HCP5_CANFD01_8193ec14_Tx: ComBitPosition=205, ComBitSize=3, ComSignalDataInvalidValue=7, ComSignalInitValue=0, ComSignalType=UINT8, ComHandleId=482, ComSystemTemplateSystemSignalRef=BMC_Unterboden_Warnung
          ISignalVoid_BMC_HV_02_XIX_HCP5_CANFD01_5_5b8da89c_Tx: ComBitPosition=344, ComBitSize=8, ComSignalType=UINT8, ComSignalInitValue=0, ComHandleId=494, ComSystemTemplateSystemSignalRef=SignalVoid_BMC_HV_02_5
          BMC_Fehler_Warnung_XIX_BMC_HV_02_XIX_HCP5_CANFD01_c65ad143_Tx: ComBitPosition=136, ComBitSize=2, ComSignalInitValue=0, ComSignalType=UINT8, ComHandleId=459, ComSystemTemplateSystemSignalRef=BMC_Fehler_Warnung
          BMC_Bank_seriell_erlaubt_XIX_BMC_HV_02_XIX_HCP5_CANFD01_bf16937c_Tx: ComBitPosition=88, ComBitSize=1, ComSignalInitValue=1, ComSignalType=UINT8, ComHandleId=454, ComSystemTemplateSystemSignalRef=BMC_Bank_seriell_erlaubt
          BMC_Max_Entladestrom_XIX_BMC_HV_02_XIX_HCP5_CANFD01_27287224_Tx: ComBitPosition=117, ComBitSize=13, ComSignalDataInvalidValue=8191, ComSignalInitValue=8190, ComSignalType=UINT16, ComHandleId=470, ComSystemTemplateSystemSignalRef=BMC_Max_Entladestrom
          BMC_IWU_Status_XIX_BMC_HV_02_XIX_HCP5_CANFD01_b8152992_Tx: ComBitPosition=130, ComBitSize=3, ComSignalInitValue=0, ComSignalType=UINT8, ComHandleId=462, ComSystemTemplateSystemSignalRef=BMC_IWU_Status
          BMC_MMTR_Status_XIX_BMC_HV_02_XIX_HCP5_CANFD01_ebcb9fa7_Tx: ComBitPosition=138, ComBitSize=4, ComSignalDataInvalidValue=15, ComSignalInitValue=14, ComSignalType=UINT8, ComHandleId=468, ComSystemTemplateSystemSignalRef=BMC_MMTR_Status
          BMC_Status_DCLS_XIX_BMC_HV_02_XIX_HCP5_CANFD01_9f28eb72_Tx: ComBitPosition=45, ComBitSize=2, ComSignalInitValue=0, ComSignalType=UINT8, ComHandleId=480, ComSystemTemplateSystemSignalRef=BMC_Status_DCLS
          ISignalVoid_BMC_HV_02_XIX_HCP5_CANFD01_2_c5e93d3f_Tx: ComBitPosition=320, ComBitSize=8, ComSignalType=UINT8, ComSignalInitValue=0, ComHandleId=491, ComSystemTemplateSystemSignalRef=SignalVoid_BMC_HV_02_2
          BMC_PredLeistung_StuetzungNV_XIX_BMC_HV_02_XIX_HCP5_CANFD01_7291cb43_Tx: ComBitPosition=262, ComBitSize=12, ComSignalDataInvalidValue=4095, ComSignalInitValue=4094, ComSignalType=UINT16, ComHandleId=478, ComSystemTemplateSystemSignalRef=BMC_PredLeistung_StuetzungNV
          BMC_TechnischerSOC_XIX_BMC_HV_02_XIX_HCP5_CANFD01_d4a48305_Tx: ComBitPosition=274, ComBitSize=11, ComSignalDataInvalidValue=2047, ComSignalInitValue=2046, ComSignalType=UINT16, ComHandleId=481, ComSystemTemplateSystemSignalRef=BMC_TechnischerSOC
          BMC_MinDyn_Entladespannung_XIX_BMC_HV_02_XIX_HCP5_CANFD01_223599ce_Tx: ComBitPosition=208, ComBitSize=10, ComSignalDataInvalidValue=1023, ComSignalInitValue=1022, ComSignalType=UINT16, ComHandleId=473, ComSystemTemplateSystemSignalRef=BMC_MinDyn_Entladespannung
          ISignalVoid_BMC_HV_02_XIX_HCP5_CANFD01_3_b2ee0da9_Tx: ComBitPosition=328, ComBitSize=8, ComSignalType=UINT8, ComSignalInitValue=0, ComHandleId=492, ComSystemTemplateSystemSignalRef=SignalVoid_BMC_HV_02_3
          BMC_PerfInd_Entladen_XIX_BMC_HV_02_XIX_HCP5_CANFD01_a6a6dabf_Tx: ComBitPosition=77, ComBitSize=10, ComSignalDataInvalidValue=1023, ComSignalInitValue=1022, ComSignalType=UINT16, ComHandleId=476, ComSystemTemplateSystemSignalRef=BMC_PerfInd_Entladen
          BMC_Bank_parallel_erlaubt_XIX_BMC_HV_02_XIX_HCP5_CANFD01_aa46a7a8_Tx: ComBitPosition=87, ComBitSize=1, ComSignalInitValue=1, ComSignalType=UINT8, ComHandleId=453, ComSystemTemplateSystemSignalRef=BMC_Bank_parallel_erlaubt
          BMC_Max_Ladestrom_XIX_BMC_HV_02_XIX_HCP5_CANFD01_f2d66d83_Tx: ComBitPosition=104, ComBitSize=13, ComSignalDataInvalidValue=8191, ComSignalInitValue=8190, ComSignalType=UINT16, ComHandleId=472, ComSystemTemplateSystemSignalRef=BMC_Max_Ladestrom
          BMC_IstZellspannungMax_XIX_BMC_HV_02_XIX_HCP5_CANFD01_fe6df646_Tx: ComBitPosition=238, ComBitSize=12, ComSignalDataInvalidValue=4095, ComSignalInitValue=4094, ComSignalType=UINT16, ComHandleId=465, ComSystemTemplateSystemSignalRef=BMC_IstZellspannungMax
          BMC_PerfInd_Laden_XIX_BMC_HV_02_XIX_HCP5_CANFD01_56fee846_Tx: ComBitPosition=22, ComBitSize=10, ComSignalDataInvalidValue=1023, ComSignalInitValue=1022, ComSignalType=UINT16, ComHandleId=477, ComSystemTemplateSystemSignalRef=BMC_PerfInd_Laden
          BMC_Max_Entladeleistung_XIX_BMC_HV_02_XIX_HCP5_CANFD01_b29a42ba_Tx: ComBitPosition=32, ComBitSize=13, ComSignalDataInvalidValue=8191, ComSignalInitValue=8190, ComSignalType=UINT16, ComHandleId=469, ComSystemTemplateSystemSignalRef=BMC_Max_Entladeleistung
          Hybrid_01_OBD_Lampe_Anf_XIX_BMC_HV_02_XIX_HCP5_CANFD01_058f5c89_Tx: ComBitPosition=135, ComBitSize=1, ComSignalInitValue=0, ComSignalType=UINT8, ComHandleId=488, ComSystemTemplateSystemSignalRef=Hybrid_01_OBD_Lampe_Anf
          BMC_IWU_Wert_pos_XIX_BMC_HV_02_XIX_HCP5_CANFD01_2b50ab04_Tx: ComBitPosition=176, ComBitSize=16, ComSignalDataInvalidValue=65535, ComSignalInitValue=65534, ComSignalType=UINT16, ComHandleId=464, ComSystemTemplateSystemSignalRef=BMC_IWU_Wert_pos
          BMC_Spannung_DC_Ladesaeule_XIX_BMC_HV_02_XIX_HCP5_CANFD01_cf986e8b_Tx: ComBitPosition=89, ComBitSize=15, ComSignalDataInvalidValue=32767, ComSignalInitValue=32766, ComSignalType=UINT16, ComHandleId=479, ComSystemTemplateSystemSignalRef=BMC_Spannung_DC_Ladesaeule
          BMC_AC_Laden_XIX_BMC_HV_02_XIX_HCP5_CANFD01_8ecbfecd_Tx: ComBitPosition=146, ComBitSize=2, ComSignalDataInvalidValue=3, ComSignalInitValue=0, ComSignalType=UINT8, ComHandleId=451, ComSystemTemplateSystemSignalRef=BMC_AC_Laden
          ISignalVoid_BMC_HV_02_XIX_HCP5_CANFD01_0_2be75c13_Tx: ComBitPosition=142, ComBitSize=2, ComSignalType=UINT8, ComSignalInitValue=0, ComHandleId=489, ComSystemTemplateSystemSignalRef=SignalVoid_BMC_HV_02_0
          BMC_Vorlade_Zielspannung_XIX_BMC_HV_02_XIX_HCP5_CANFD01_a51a619b_Tx: ComBitPosition=12, ComBitSize=10, ComSignalDataInvalidValue=1023, ComSignalInitValue=1022, ComSignalType=UINT16, ComHandleId=485, ComSystemTemplateSystemSignalRef=BMC_Vorlade_Zielspannung
          BMC_Energieinhalt_XIX_BMC_HV_02_XIX_HCP5_CANFD01_7eb2adbb_Tx: ComBitPosition=48, ComBitSize=16, ComSignalDataInvalidValue=65535, ComSignalInitValue=65534, ComSignalType=UINT16, ComHandleId=457, ComSystemTemplateSystemSignalRef=BMC_Energieinhalt
          BMC_ZellTemp_virtuell_min_XIX_BMC_HV_02_XIX_HCP5_CANFD01_6939d40e_Tx: ComBitPosition=295, ComBitSize=10, ComSignalDataInvalidValue=1023, ComSignalInitValue=1022, ComSignalType=UINT16, ComHandleId=487, ComSystemTemplateSystemSignalRef=BMC_ZellTemp_virtuell_min
      BMC_CMC_Temperatur_087_XIX_BMC_CMC_Temperatur_03_XIX_HCP5_CANFD01_fc97e82a_Tx (ComSignal):
        ComBitPosition = 128
        ComBitSize = 8
        ComSignalDataInvalidValue = 255
        ComSignalEndianness = LITTLE_ENDIAN
        ComSignalInitValue = 254
        ComSignalType = UINT8
        ComTransferProperty = PENDING
        ComSignalAccess = ACCESS_UNCLEAR
        ComHandleId = 97
        ComSystemTemplateSystemSignalRef = BMC_CMC_Temperatur_087
      UI1_01_XIX_BMC_CAN01_E2E_cec88adf_Rx (ComIPdu):
        ComIPduDirection = RECEIVE
        ComIPduType = NORMAL
        ComIPduHandleId = 43
        ComIPduSignalProcessing = DEFERRED
        ComIPduCancellationSupport = false
        ComIPduGroupRef = BMC_HV_XIX_BMC_CAN01_Rx_7b388810
        ComIPduSignalGroupRef = SG_UI1_01_XIX_BMC_CAN01_cd9e369a_Rx
        ComPduIdRef = UI1_01_XIX_BMC_CAN01_E2E_cec88adf_Rx
        ComIPduMainFunctionRef = ComMainFunctionRx
      BMC_CMC_Temperatur_034_XIX_BMC_CMC_Temperatur_01_XIX_HCP5_CANFD01_a416e43d_Tx (ComSignal):
        ComBitPosition = 280
        ComBitSize = 8
        ComSignalDataInvalidValue = 255
        ComSignalEndianness = LITTLE_ENDIAN
        ComSignalInitValue = 254
        ComSignalType = UINT8
        ComTransferProperty = PENDING
        ComSignalAccess = ACCESS_UNCLEAR
        ComHandleId = 44
        ComSystemTemplateSystemSignalRef = BMC_CMC_Temperatur_034
      BMC_Pack_SN_07_XIX_BMC_HV_08_XIX_HCP5_CANFD01_907bfaa4_Tx (ComSignal):
        ComBitPosition = 112
        ComBitSize = 8
        ComSignalEndianness = LITTLE_ENDIAN
        ComSignalInitValue = 255
        ComSignalType = UINT8
        ComTransferProperty = PENDING
        ComSignalAccess = ACCESS_UNCLEAR
        ComHandleId = 340
        ComSystemTemplateSystemSignalRef = BMC_Pack_SN_07
