[part 1 of 3: package /ActiveEcuC]
AUTOSAR XML (schema 4-3-0)
package /ActiveEcuC
  module config Com: implementation-config-variant=VARIANT-PRE-COMPILE, module-description=Com_Impl
    ComGeneration:
      ComOutOfBoundsWriteProtectionStrategy = NONE
      ComOutOfBoundsWriteSanitizer = false
      ComOutOfBoundsReadSanitizer = false
      ComReduceConstantData2Define = false
      ComBoolDataInArrayOfStructStrategy = BOOLEAN
      ComDeduplicateIndirectedData = true
      ComDataDeduplicationStrategy = WITH_CAST
      ComReduceBoolDataByNegationThreshold = 2
      ComReduceBoolDataByNumericalComparisonThreshold = 2
      ComReduceBoolDataByNumericalRelationThreshold = 2
      ComReduceBoolDataByNumericalOperandStrategy = WITH_ANY_VALUE
      ComReduceNumericalDataByOffsetThreshold = 2
      ComReduceNumericalDataByArraySubtractionThreshold = 2
      ComReduceDataByStreaming = false
      ComShortSymbols = false
      ComInterfacesForDeactivatedData = false
      ComReferringKeysInComments = false
      ComNumberOfElementsCommentThreshold = 1000
    ComOptimization:
      ComTxProcessingISRLockThreshold = 1
      ComRxProcessingISRLockThreshold = 1
      ComGatewayProcessingISRLockThreshold = 1
      ComGatewayDescriptionProcessingISRLockThreshold = 1
      ComIPduGroupISRLockThreshold = 1
    ComConfig: ComConfigurationId=0, ComRxDeferredNotificationCacheSize=1, ComRxImmediateNotificationCacheSize=0
      ComMainFunctionRx: ComMainRxTimeBase=0.005
      ComMainFunctionTx: ComMainTxTimeBase=0.005
      BMC_RtmWarnUZelleMax_XIX_BMC_HV_08_XIX_HCP5_CANFD01_ea46eef7_Tx (ComSignal):
        ComBitPosition = 55
        ComBitSize = 3
        ComSignalEndianness = LITTLE_ENDIAN
        ComSignalInitValue = 0
        ComSignalType = UINT8
        ComTransferProperty = PENDING
        ComSignalAccess = ACCESS_UNCLEAR
        ComHandleId = 374
        ComSystemTemplateSystemSignalRef = BMC_RtmWarnUZelleMax
      BMC_HV_XIX_HCP5_CANFD01_Tx_3ba05bd9 (ComIPduGroup): ComIPduGroupHandleId=3
      15 x ComSignal, all with ComSignalEndianness=LITTLE_ENDIAN, ComSignalAccess=ACCESS_UNCLEAR:
        BMC_CMC_Zellspannung_006_XIX_BMC_CMC_Zellspannung_01_XIX_HCP5_CANFD01_1a900c82_Tx: ComBitPosition=72, ComBitSize=12, ComSignalDataInvalidValue=4095, ComSignalInitValue=4094, ComSignalType=UINT16, ComTransferProperty=PENDING, ComHandleId=117, ComSystemTemplateSystemSignalRef=BMC_CMC_Zellspannung_006
        BMC_Bidi_GenutzteEnergie_XIX_BMC_HV_03_XIX_HCP5_CANFD01_71b918c9_Tx: ComBitPosition=168, ComBitSize=16, ComSignalDataInvalidValue=65535, ComSignalInitValue=65534, ComSignalType=UINT16, ComTransferProperty=PENDING, ComHandleId=3, ComSystemTemplateSystemSignalRef=BMC_Bidi_GenutzteEnergie
        BMC_CMC_Temperatur_01_Messzeit_XIX_BMC_CMC_Temperatur_01_XIX_HCP5_CANFD01_e5c4df8c_Tx: ComBitPosition=480, ComBitSize=8, ComSignalDataInvalidValue=255, ComSignalInitValue=254, ComSignalType=UINT8, ComTransferProperty=PENDING, ComHandleId=8, ComSystemTemplateSystemSignalRef=BMC_CMC_Temperatur_01_Messzeit
        BMC_CMC_Zellspannung_099_XIX_BMC_CMC_Zellspannung_03_XIX_HCP5_CANFD01_67b42f6c_Tx: ComBitPosition=252, ComBitSize=12, ComSignalDataInvalidValue=4095, ComSignalInitValue=4094, ComSignalType=UINT16, ComTransferProperty=PENDING, ComHandleId=210, ComSystemTemplateSystemSignalRef=BMC_CMC_Zellspannung_099
        OBD_Kaltstart_Denominator_XIX_OBD_04_XIX_HCP5_CANFD01_6c8e10da_Rx: ComBitPosition=23, ComBitSize=1, ComSignalInitValue=0, ComSignalType=UINT8, ComTimeout=3.2, ComHandleId=167, ComSystemTemplateSystemSignalRef=OBD_Kaltstart_Denominator
        BMC_CMC_Zellspannung_059_XIX_BMC_CMC_Zellspannung_02_XIX_HCP5_CANFD01_0b59e5f2_Tx: ComBitPosition=240, ComBitSize=12, ComSignalDataInvalidValue=4095, ComSignalInitValue=4094, ComSignalType=UINT16, ComTransferProperty=PENDING, ComHandleId=170, ComSystemTemplateSystemSignalRef=BMC_CMC_Zellspannung_059
        BMC_CMC_Zellspannung_127_XIX_BMC_CMC_Zellspannung_04_XIX_HCP5_CANFD01_6ee00ce0_Tx: ComBitPosition=120, ComBitSize=12, ComSignalDataInvalidValue=4095, ComSignalInitValue=4094, ComSignalType=UINT16, ComTransferProperty=PENDING, ComHandleId=238, ComSystemTemplateSystemSignalRef=BMC_CMC_Zellspannung_127
        DCDC_NV_CALID_Index_08_XIX_DCDC_NV_CALID_XIX_HCP5_CANFD01_6a878139_Rx: ComBitPosition=56, ComBitSize=8, ComSignalInitValue=63, ComSignalType=UINT8, ComTimeout=5, ComHandleId=32, ComSystemTemplateSystemSignalRef=DCDC_NV_CALID_Index_08
        BMC_CMC_Zellspannung_024_XIX_BMC_CMC_Zellspannung_01_XIX_HCP5_CANFD01_37f12d6e_Tx: ComBitPosition=288, ComBitSize=12, ComSignalDataInvalidValue=4095, ComSignalInitValue=4094, ComSignalType=UINT16, ComTransferProperty=PENDING, ComHandleId=135, ComSystemTemplateSystemSignalRef=BMC_CMC_Zellspannung_024
        HVLE_OBG_IstModus_XIX_OBG_01_XIX_HCP5_CANFD01_6564feea_Rx: ComBitPosition=133, ComBitSize=3, ComSignalDataInvalidValue=7, ComSignalInitValue=6, ComSignalType=UINT8, ComTimeout=1, ComHandleId=152, ComSystemTemplateSystemSignalRef=HVLE_OBG_IstModus
        BMC_UBE_Indik_last_update_km_XIX_BMC_HV_14_XIX_HCP5_CANFD01_c953ffca_Tx: ComBitPosition=34, ComBitSize=20, ComSignalDataInvalidValue=1048575, ComSignalInitValue=1048574, ComSignalType=UINT32, ComTransferProperty=PENDING, ComHandleId=384, ComSystemTemplateSystemSignalRef=BMC_UBE_Indik_last_update_km
        DS_Hybrid_01_MemSel10Changed_XIX_DS_Hybrid_01_XIX_HCP5_CANFD01_040fbf45_Tx: ComBitPosition=20, ComBitSize=1, ComSignalInitValue=0, ComSignalType=UINT8, ComTransferProperty=TRIGGERED_ON_CHANGE_WITHOUT_REPETITION, ComHandleId=395, ComSystemTemplateSystemSignalRef=DS_Hybrid_01_MemSel10Changed
        VIN_12_XIX_WFS_02_XIX_HCP5_CANFD01_4b475cc7_Rx: ComBitPosition=104, ComBitSize=8, ComSignalInitValue=45, ComSignalType=UINT8, ComTimeout=4, ComHandleId=504, ComSystemTemplateSystemSignalRef=VIN_12
        DCDC_NV_Komponentenfehler_20_XIX_DCDC_NV_Komponentenfehler_01_XIX_HCP5_CANFD01_cdff4358_Rx: ComBitPosition=38, ComBitSize=2, ComSignalInitValue=0, ComSignalType=UINT8, ComTimeout=5, ComHandleId=81, ComSystemTemplateSystemSignalRef=DCDC_NV_Komponentenfehler_20
        BMC_CMC_Zellspannung_027_XIX_BMC_CMC_Zellspannung_01_XIX_HCP5_CANFD01_b7ab81db_Tx: ComBitPosition=324, ComBitSize=12, ComSignalDataInvalidValue=4095, ComSignalInitValue=4094, ComSignalType=UINT16, ComTransferProperty=PENDING, ComHandleId=138, ComSystemTemplateSystemSignalRef=BMC_CMC_Zellspannung_027
      BMC_HV_08_XIX_HCP5_CANFD01_fbc0b232_Tx (ComIPdu):
        ComIPduDirection = SEND
        ComIPduType = NORMAL
        ComIPduHandleId = 15
        ComIPduSignalProcessing = DEFERRED
        ComIPduCancellationSupport = false
        ComIPduGroupRef = BMC_HV_XIX_HCP5_CANFD01_Tx_3ba05bd9
        ComIPduGroupRef = BMC_HV_XIX_PNC_26_HighVoltage_Charging_Tx_20012544
        ComIPduSignalRef = BMC_ExtLadeleistung_XIX_BMC_HV_08_XIX_HCP5_CANFD01_0def2e7f_Tx
        ComIPduSignalRef = BMC_IstTemperaturMax_Modul_ID_XIX_BMC_HV_08_XIX_HCP5_CANFD01_26033124_Tx
        ComIPduSignalRef = BMC_IstTemperaturMax_Sensor_ID_XIX_BMC_HV_08_XIX_HCP5_CANFD01_ea25f749_Tx
        ComIPduSignalRef = BMC_IstTemperaturMin_Modul_ID_XIX_BMC_HV_08_XIX_HCP5_CANFD01_688b548e_Tx
        ComIPduSignalRef = BMC_IstTemperaturMin_Sensor_ID_XIX_BMC_HV_08_XIX_HCP5_CANFD01_dc6835da_Tx
        ComIPduSignalRef = BMC_IstZellSpannungMax_Modul_ID_XIX_BMC_HV_08_XIX_HCP5_CANFD01_4cf696ba_Tx
        ComIPduSignalRef = BMC_IstZellSpannungMax_Zell_ID_XIX_BMC_HV_08_XIX_HCP5_CANFD01_b2be9152_Tx
        ComIPduSignalRef = BMC_IstZellSpannungMin_Modul_ID_XIX_BMC_HV_08_XIX_HCP5_CANFD01_027ef310_Tx
        ComIPduSignalRef = BMC_IstZellSpannungMin_Zell_ID_XIX_BMC_HV_08_XIX_HCP5_CANFD01_3e586fb0_Tx
        ComIPduSignalRef = BMC_Pack_SN_01_XIX_BMC_HV_08_XIX_HCP5_CANFD01_d934ed9b_Tx
        ComIPduSignalRef = BMC_Pack_SN_02_XIX_BMC_HV_08_XIX_HCP5_CANFD01_102be524_Tx
        ComIPduSignalRef = BMC_Pack_SN_03_XIX_BMC_HV_08_XIX_HCP5_CANFD01_e1f1e08e_Tx
        ComIPduSignalRef = BMC_Pack_SN_04_XIX_BMC_HV_08_XIX_HCP5_CANFD01_5964f21b_Tx
        ComIPduSignalRef = BMC_Pack_SN_05_XIX_BMC_HV_08_XIX_HCP5_CANFD01_a8bef7b1_Tx
        ComIPduSignalRef = BMC_Pack_SN_06_XIX_BMC_HV_08_XIX_HCP5_CANFD01_61a1ff0e_Tx
        ComIPduSignalRef = BMC_Pack_SN_07_XIX_BMC_HV_08_XIX_HCP5_CANFD01_907bfaa4_Tx
        ComIPduSignalRef = BMC_Pack_SN_08_XIX_BMC_HV_08_XIX_HCP5_CANFD01_cbfadc65_Tx
        ComIPduSignalRef = BMC_Pack_SN_09_XIX_BMC_HV_08_XIX_HCP5_CANFD01_3a20d9cf_Tx
        ComIPduSignalRef = BMC_Pack_SN_10_XIX_BMC_HV_08_XIX_HCP5_CANFD01_1e1c78c2_Tx
        ComIPduSignalRef = BMC_Pack_SN_11_XIX_BMC_HV_08_XIX_HCP5_CANFD01_efc67d68_Tx
        ComIPduSignalRef = BMC_Pack_SN_12_XIX_BMC_HV_08_XIX_HCP5_CANFD01_26d975d7_Tx
        ComIPduSignalRef = BMC_Pack_SN_13_XIX_BMC_HV_08_XIX_HCP5_CANFD01_d703707d_Tx
        ComIPduSignalRef = BMC_Pack_SN_14_XIX_BMC_HV_08_XIX_HCP5_CANFD01_6f9662e8_Tx
        ComIPduSignalRef = BMC_Pack_SN_15_XIX_BMC_HV_08_XIX_HCP5_CANFD01_9e4c6742_Tx
        ComIPduSignalRef = BMC_Pack_SN_16_XIX_BMC_HV_08_XIX_HCP5_CANFD01_57536ffd_Tx
        ComIPduSignalRef = BMC_Pack_SN_17_XIX_BMC_HV_08_XIX_HCP5_CANFD01_a6896a57_Tx
        ComIPduSignalRef = BMC_Pack_SN_18_XIX_BMC_HV_08_XIX_HCP5_CANFD01_fd084c96_Tx
        ComIPduSignalRef = BMC_Pack_SN_19_XIX_BMC_HV_08_XIX_HCP5_CANFD01_0cd2493c_Tx
        ComIPduSignalRef = BMC_Pack_SN_20_XIX_BMC_HV_08_XIX_HCP5_CANFD01_450bc9d7_Tx
        ComIPduSignalRef = BMC_Pack_SN_21_XIX_BMC_HV_08_XIX_HCP5_CANFD01_b4d1cc7d_Tx
        ComIPduSignalRef = BMC_Pack_SN_22_XIX_BMC_HV_08_XIX_HCP5_CANFD01_7dcec4c2_Tx
        ComIPduSignalRef = BMC_Pack_SN_23_XIX_BMC_HV_08_XIX_HCP5_CANFD01_8c14c168_Tx
        ComIPduSignalRef = BMC_Pack_SN_24_XIX_BMC_HV_08_XIX_HCP5_CANFD01_3481d3fd_Tx
        ComIPduSignalRef = BMC_Pack_SN_25_XIX_BMC_HV_08_XIX_HCP5_CANFD01_c55bd657_Tx
        ComIPduSignalRef = BMC_Pack_SN_26_XIX_BMC_HV_08_XIX_HCP5_CANFD01_0c44dee8_Tx
        ComIPduSignalRef = BMC_RtmWarnBattUnautorisiert_XIX_BMC_HV_08_XIX_HCP5_CANFD01_afa1cdce_Tx
        ComIPduSignalRef = BMC_RtmWarnPackKommunikation_XIX_BMC_HV_08_XIX_HCP5_CANFD01_49192821_Tx
        ComIPduSignalRef = BMC_RtmWarnPackUeberladen_XIX_BMC_HV_08_XIX_HCP5_CANFD01_cef699a9_Tx
        ComIPduSignalRef = BMC_RtmWarnSocHoch_XIX_BMC_HV_08_XIX_HCP5_CANFD01_3e921985_Tx
        ComIPduSignalRef = BMC_RtmWarnSocNiedrig_XIX_BMC_HV_08_XIX_HCP5_CANFD01_e8831b4c_Tx
        ComIPduSignalRef = BMC_RtmWarnSocSprung_XIX_BMC_HV_08_XIX_HCP5_CANFD01_4f634010_Tx
        ComIPduSignalRef = BMC_RtmWarnTZelleDiff_XIX_BMC_HV_08_XIX_HCP5_CANFD01_733ec90e_Tx
        ComIPduSignalRef = BMC_RtmWarnTZelleMax_XIX_BMC_HV_08_XIX_HCP5_CANFD01_45027cb0_Tx
        ComIPduSignalRef = BMC_RtmWarnTZelleMin_XIX_BMC_HV_08_XIX_HCP5_CANFD01_7df184bf_Tx
        ComIPduSignalRef = BMC_RtmWarnUPackMax_XIX_BMC_HV_08_XIX_HCP5_CANFD01_d9381a91_Tx
        ComIPduSignalRef = BMC_RtmWarnUPackMin_XIX_BMC_HV_08_XIX_HCP5_CANFD01_e1cbe29e_Tx
        ComIPduSignalRef = BMC_RtmWarnUZelleMax_XIX_BMC_HV_08_XIX_HCP5_CANFD01_ea46eef7_Tx
        ComIPduSignalRef = BMC_RtmWarnUZelleMin_XIX_BMC_HV_08_XIX_HCP5_CANFD01_d2b516f8_Tx
        ComIPduSignalRef = BMC_RtmWarnUeberstrom_XIX_BMC_HV_08_XIX_HCP5_CANFD01_e0808499_Tx
        ComIPduSignalRef = BMC_RtmWarnZelleZustand_XIX_BMC_HV_08_XIX_HCP5_CANFD01_688df887_Tx
        ComPduIdRef = BMC_HV_08_XIX_HCP5_CANFD01_fbc0b232_Tx
        ComIPduMainFunctionRef = ComMainFunctionTx
        ComTxIPdu: ComTxIPduUnusedAreasDefault=0, ComMinimumDelayTime=0
          ComTxModeTrue
            ComTxMode: ComTxModeMode=PERIODIC, ComTxModeTimeOffset=0, ComTxModeTimePeriod=1
          ComTxModeFalse
            ComTxMode: ComTxModeMode=NONE
      4 x ComSignal, all with ComSignalEndianness=LITTLE_ENDIAN, ComSignalAccess=ACCESS_UNCLEAR:
        UI1_Spannung4_XIX_UI1_03_XIX_BMC_CAN01_25f2e1ca_Rx: ComBitPosition=12, ComBitSize=15, ComSignalDataInvalidValue=32767, ComSignalInitValue=32766, ComSignalType=UINT16, ComTimeout=0.5, ComHandleId=393, ComSystemTemplateSystemSignalRef=UI1_Spannung4
        BMC_CMC_Zellspannung_163_XIX_BMC_CMC_Zellspannung_05_XIX_HCP5_CANFD01_db70f9d9_Tx: ComBitPosition=84, ComBitSize=12, ComSignalDataInvalidValue=4095, ComSignalInitValue=4094, ComSignalType=UINT16, ComTransferProperty=PENDING, ComHandleId=274, ComSystemTemplateSystemSignalRef=BMC_CMC_Zellspannung_163
        BMC_RtmWarnSocNiedrig_XIX_BMC_HV_08_XIX_HCP5_CANFD01_e8831b4c_Tx: ComBitPosition=34, ComBitSize=3, ComSignalInitValue=0, ComSignalType=UINT8, ComTransferProperty=PENDING, ComHandleId=367, ComSystemTemplateSystemSignalRef=BMC_RtmWarnSocNiedrig
        NM_Hybrid_01_NM_State_XIX_NMH_Hybrid_01_XIX_BMC_CAN01_20dc868b_Tx: ComBitPosition=0, ComBitSize=6, ComSignalInitValue=0, ComSignalType=UINT8, ComTransferProperty=TRIGGERED_ON_CHANGE, ComHandleId=416, ComSystemTemplateSystemSignalRef=NM_Hybrid_01_NM_State
      UI2_03_XIX_BMC_CAN01_E2E_8304216e_Rx (ComIPdu):
        ComIPduDirection = RECEIVE
        ComIPduType = NORMAL
        ComIPduHandleId = 58
        ComIPduSignalProcessing = DEFERRED
        ComIPduCancellationSupport = false
        ComIPduGroupRef = BMC_HV_XIX_BMC_CAN01_Rx_7b388810
        ComIPduSignalGroupRef = SG_UI2_03_XIX_BMC_CAN01_8f9e5a69_Rx
        ComPduIdRef = UI2_03_XIX_BMC_CAN01_E2E_8304216e_Rx
        ComIPduMainFunctionRef = ComMainFunctionRx
      5 x ComSignal, all with ComSignalEndianness=LITTLE_ENDIAN, ComSignalAccess=ACCESS_UNCLEAR:
        UI2_KompFehlerModus2_23_XIX_UI2_Komponentenfehler_01_XIX_BMC_CAN01_d27afab2_Rx: ComBitPosition=56, ComBitSize=2, ComSignalInitValue=0, ComSignalType=UINT8, ComTimeout=1, ComHandleId=467, ComSystemTemplateSystemSignalRef=UI2_KompFehlerModus2_23
        HVEM_BMC_CHA_Wunschleistung_02_XIX_HVEM_07_XIX_HCP5_CANFD01_7eeecd70_Rx: ComBitPosition=213, ComBitSize=15, ComSignalDataInvalidValue=32767, ComSignalInitValue=32766, ComSignalType=UINT16, ComTimeout=0.8, ComHandleId=147, ComSystemTemplateSystemSignalRef=HVEM_BMC_CHA_Wunschleistung_02
        BMC_CMC_Zellspannung_095_XIX_BMC_CMC_Zellspannung_03_XIX_HCP5_CANFD01_0b4d977b_Tx: ComBitPosition=204, ComBitSize=12, ComSignalDataInvalidValue=4095, ComSignalInitValue=4094, ComSignalType=UINT16, ComTransferProperty=PENDING, ComHandleId=206, ComSystemTemplateSystemSignalRef=BMC_CMC_Zellspannung_095
        UI2Sens02_ErrMem_State_XIX_UI2_04_XIX_BMC_CAN01_1e9c0075_Rx: ComBitPosition=13, ComBitSize=2, ComSignalInitValue=2, ComSignalType=UINT8, ComTimeout=1, ComHandleId=444, ComSystemTemplateSystemSignalRef=UI2Sens02_ErrMem_State
        BMC_Max_Entladeleistung_02_XIX_BMC_HV_09_XIX_HCP5_CANFD01_a2b30339_Tx: ComBitPosition=26, ComBitSize=15, ComSignalDataInvalidValue=32767, ComSignalInitValue=32766, ComSignalType=UINT16, ComTransferProperty=PENDING, ComHandleId=323, ComSystemTemplateSystemSignalRef=BMC_Max_Entladeleistung_02
      HCP1_17_XIX_HCP5_CANFD01_3398d6b5_Rx (ComIPdu):
        ComIPduDirection = RECEIVE
        ComIPduType = NORMAL
        ComIPduHandleId = 22
        ComIPduSignalProcessing = DEFERRED
        ComIPduCancellationSupport = false
        ComIPduGroupRef = BMC_HV_XIX_HCP5_CANFD01_Rx_6dfafc5f
        ComIPduGroupRef = BMC_HV_XIX_PNC_10_Powertrain_Rx_c7039922
        ComIPduSignalRef = PCM_BMC_VTD_Freeze_Req_XIX_HCP1_17_XIX_HCP5_CANFD01_4dcab581_Rx
        ComIPduSignalRef = PCM_BMC_VTD_LifeTimeReset_Req_XIX_HCP1_17_XIX_HCP5_CANFD01_b7cc45cb_Rx
        ComIPduSignalRef = PCM_BMC_VTD_LifeTimeReset_Resp_XIX_HCP1_17_XIX_HCP5_CANFD01_37f0f42a_Rx
        ComIPduSignalRef = PCM_BMC_VTD_RecentReset_Req_XIX_HCP1_17_XIX_HCP5_CANFD01_6b228b48_Rx
        ComPduIdRef = HCP1_17_XIX_HCP5_CANFD01_3398d6b5_Rx
        ComIPduMainFunctionRef = ComMainFunctionRx
      5 x ComSignal, all with ComSignalEndianness=LITTLE_ENDIAN, ComSignalAccess=ACCESS_UNCLEAR:
        BMC_CMC_Zellspannung_014_XIX_BMC_CMC_Zellspannung_01_XIX_HCP5_CANFD01_8c7a30c1_Tx: ComBitPosition=168, ComBitSize=12, ComSignalDataInvalidValue=4095, ComSignalInitValue=4094, ComSignalType=UINT16, ComTransferProperty=PENDING, ComHandleId=125, ComSystemTemplateSystemSignalRef=BMC_CMC_Zellspannung_014
        BMC_CMC_Zellspannung_158_XIX_BMC_CMC_Zellspannung_05_XIX_HCP5_CANFD01_a80f98d9_Tx: ComBitPosition=24, ComBitSize=12, ComSignalDataInvalidValue=4095, ComSignalInitValue=4094, ComSignalType=UINT16, ComTransferProperty=PENDING, ComHandleId=269, ComSystemTemplateSystemSignalRef=BMC_CMC_Zellspannung_158
        UI1_KompFehlerModus2_18_XIX_UI1_Komponentenfehler_01_XIX_BMC_CAN01_373702d0_Rx: ComBitPosition=46, ComBitSize=2, ComSignalInitValue=0, ComSignalType=UINT8, ComTimeout=1, ComHandleId=368, ComSystemTemplateSystemSignalRef=UI1_KompFehlerModus2_18
        BMC_IstTemperaturMax_Modul_ID_XIX_BMC_HV_08_XIX_HCP5_CANFD01_26033124_Tx: ComBitPosition=272, ComBitSize=8, ComSignalInitValue=255, ComSignalType=UINT8, ComTransferProperty=PENDING, ComHandleId=312, ComSystemTemplateSystemSignalRef=BMC_IstTemperaturMax_Modul_ID
        UI2Sens01_CALID_Index_05_XIX_UI2Sens01_CALID_01_XIX_BMC_CAN01_2b7a42a5_Rx: ComBitPosition=32, ComBitSize=8, ComSignalInitValue=63, ComSignalType=UINT8, ComTimeout=5, ComHandleId=405, ComSystemTemplateSystemSignalRef=UI2Sens01_CALID_Index_05
      BMC_HV_XIX_PNC_27_Timemaster_Timer_Rx_2db6b092 (ComIPduGroup): ComIPduGroupHandleId=14
      20 x ComSignal, all with ComSignalEndianness=LITTLE_ENDIAN, ComSignalAccess=ACCESS_UNCLEAR:
        BMC_CMC_Zellspannung_054_XIX_BMC_CMC_Zellspannung_02_XIX_HCP5_CANFD01_1869c676_Tx: ComBitPosition=180, ComBitSize=12, ComSignalDataInvalidValue=4095, ComSignalInitValue=4094, ComSignalType=UINT16, ComTransferProperty=PENDING, ComHandleId=165, ComSystemTemplateSystemSignalRef=BMC_CMC_Zellspannung_054
        BMC_CMC_Zellspannung_124_XIX_BMC_CMC_Zellspannung_04_XIX_HCP5_CANFD01_eebaa055_Tx: ComBitPosition=84, ComBitSize=12, ComSignalDataInvalidValue=4095, ComSignalInitValue=4094, ComSignalType=UINT16, ComTransferProperty=PENDING, ComHandleId=235, ComSystemTemplateSystemSignalRef=BMC_CMC_Zellspannung_124
        BJB_CALID_Index_03_XIX_BJB_CALID_01_XIX_BMC_CAN01_2c2273e2_Rx: ComBitPosition=16, ComBitSize=8, ComSignalInitValue=63, ComSignalType=UINT8, ComTimeout=5, ComHandleId=3, ComSystemTemplateSystemSignalRef=BJB_CALID_Index_03
        BMC_Dauer_Entladeleistung_02_XIX_BMC_HV_09_XIX_HCP5_CANFD01_c6e0343a_Tx: ComBitPosition=70, ComBitSize=14, ComSignalDataInvalidValue=16383, ComSignalInitValue=16382, ComSignalType=UINT16, ComTransferProperty=PENDING, ComHandleId=304, ComSystemTemplateSystemSignalRef=BMC_Dauer_Entladeleistung_02
        UI2_KompFehlerModus2_26_XIX_UI2_Komponentenfehler_01_XIX_BMC_CAN01_50f22358_Rx: ComBitPosition=62, ComBitSize=2, ComSignalInitValue=0, ComSignalType=UINT8, ComTimeout=1, ComHandleId=470, ComSystemTemplateSystemSignalRef=UI2_KompFehlerModus2_26
        BMC_CMC_Zellspannung_107_XIX_BMC_CMC_Zellspannung_03_XIX_HCP5_CANFD01_5d3c104e_Tx: ComBitPosition=348, ComBitSize=12, ComSignalDataInvalidValue=4095, ComSignalInitValue=4094, ComSignalType=UINT16, ComTransferProperty=PENDING, ComHandleId=218, ComSystemTemplateSystemSignalRef=BMC_CMC_Zellspannung_107
        BMC_CMC_Zellspannung_02_Messzeit_XIX_BMC_CMC_Zellspannung_02_XIX_HCP5_CANFD01_2962a4f1_Tx: ComBitPosition=480, ComBitSize=8, ComSignalDataInvalidValue=255, ComSignalInitValue=254, ComSignalType=UINT8, ComTransferProperty=PENDING, ComHandleId=108, ComSystemTemplateSystemSignalRef=BMC_CMC_Zellspannung_02_Messzeit
        NM_Hybrid_01_NM_aktiv_Diag_XIX_NMH_Hybrid_01_XIX_BMC_CAN01_537ad98b_Tx: ComBitPosition=9, ComBitSize=1, ComSignalInitValue=0, ComSignalType=UINT8, ComTransferProperty=TRIGGERED, ComHandleId=418, ComSystemTemplateSystemSignalRef=NM_Hybrid_01_NM_aktiv_Diag
        BMC_CMC_Temperatur_019_XIX_BMC_CMC_Temperatur_01_XIX_HCP5_CANFD01_30f3ae5f_Tx: ComBitPosition=160, ComBitSize=8, ComSignalDataInvalidValue=255, ComSignalInitValue=254, ComSignalType=UINT8, ComTransferProperty=PENDING, ComHandleId=29, ComSystemTemplateSystemSignalRef=BMC_CMC_Temperatur_019
        UI2_KompFehlerModus2_19_XIX_UI2_Komponentenfehler_01_XIX_BMC_CAN01_33d131b2_Rx: ComBitPosition=48, ComBitSize=2, ComSignalInitValue=0, ComSignalType=UINT8, ComTimeout=1, ComHandleId=463, ComSystemTemplateSystemSignalRef=UI2_KompFehlerModus2_19
        BMC_VorlaufTemperatur_XIX_BMC_HV_03_XIX_HCP5_CANFD01_b115c7c1_Tx: ComBitPosition=16, ComBitSize=10, ComSignalDataInvalidValue=1023, ComSignalInitValue=1022, ComSignalType=UINT16, ComTransferProperty=PENDING, ComHandleId=389, ComSystemTemplateSystemSignalRef=BMC_VorlaufTemperatur
        BMC_CMC_Zellspannung_146_XIX_BMC_CMC_Zellspannung_04_XIX_HCP5_CANFD01_bd4eaa6c_Tx: ComBitPosition=348, ComBitSize=12, ComSignalDataInvalidValue=4095, ComSignalInitValue=4094, ComSignalType=UINT16, ComTransferProperty=PENDING, ComHandleId=257, ComSystemTemplateSystemSignalRef=BMC_CMC_Zellspannung_146
        DS_Hybrid_01_ConfDTCChanged_XIX_DS_Hybrid_01_XIX_HCP5_CANFD01_2044f478_Tx: ComBitPosition=17, ComBitSize=1, ComSignalInitValue=0, ComSignalType=UINT8, ComTransferProperty=TRIGGERED_ON_CHANGE_WITHOUT_REPETITION, ComHandleId=391, ComSystemTemplateSystemSignalRef=DS_Hybrid_01_ConfDTCChanged
        BMC_CMC_Zellspannung_142_XIX_BMC_CMC_Zellspannung_04_XIX_HCP5_CANFD01_9919c261_Tx: ComBitPosition=300, ComBitSize=12, ComSignalDataInvalidValue=4095, ComSignalInitValue=4094, ComSignalType=UINT16, ComTransferProperty=PENDING, ComHandleId=253, ComSystemTemplateSystemSignalRef=BMC_CMC_Zellspannung_142
        BMC_CMC_Zellspannung_106_XIX_BMC_CMC_Zellspannung_03_XIX_HCP5_CANFD01_22f58bdd_Tx: ComBitPosition=336, ComBitSize=12, ComSignalDataInvalidValue=4095, ComSignalInitValue=4094, ComSignalType=UINT16, ComTransferProperty=PENDING, ComHandleId=217, ComSystemTemplateSystemSignalRef=BMC_CMC_Zellspannung_106
        UI1_KompFehlerModus2_13_XIX_UI1_Komponentenfehler_01_XIX_BMC_CAN01_c37f8f27_Rx: ComBitPosition=36, ComBitSize=2, ComSignalInitValue=0, ComSignalType=UINT8, ComTimeout=1, ComHandleId=363, ComSystemTemplateSystemSignalRef=UI1_KompFehlerModus2_13
        UI1_KompFehlerModus4_15_XIX_UI1_Komponentenfehler_02_XIX_BMC_CAN01_8295490d_Rx: ComBitPosition=54, ComBitSize=3, ComSignalInitValue=0, ComSignalType=UINT8, ComTimeout=1, ComHandleId=391, ComSystemTemplateSystemSignalRef=UI1_KompFehlerModus4_15
        DCDC_NV_Komponentenfehler_3_8_XIX_DCDC_NV_Komponentenfehler_04_XIX_HCP5_CANFD01_603e466a_Rx: ComBitPosition=21, ComBitSize=3, ComSignalInitValue=0, ComSignalType=UINT8, ComTimeout=5, ComHandleId=53, ComSystemTemplateSystemSignalRef=DCDC_NV_Komponentenfehler_3_8
        DCDC_NV_Komponentenfehler_05_XIX_DCDC_NV_Komponentenfehler_01_XIX_HCP5_CANFD01_4a418a1f_Rx: ComBitPosition=8, ComBitSize=2, ComSignalInitValue=0, ComSignalType=UINT8, ComTimeout=5, ComHandleId=66, ComSystemTemplateSystemSignalRef=DCDC_NV_Komponentenfehler_05
        OBD_Sperrung_Kaltstart_Denom_XIX_OBD_04_XIX_HCP5_CANFD01_9ec37dc6_Rx: ComBitPosition=22, ComBitSize=1, ComSignalInitValue=0, ComSignalType=UINT8, ComTimeout=3.2, ComHandleId=173, ComSystemTemplateSystemSignalRef=OBD_Sperrung_Kaltstart_Denom
      DCDC_NV_Komponentenfehler_01_XIX_HCP5_CANFD01_dd687766_Rx (ComIPdu):
        ComIPduDirection = RECEIVE
        ComIPduType = NORMAL
        ComIPduHandleId = 15
        ComIPduSignalProcessing = DEFERRED
        ComIPduCancellationSupport = false
        ComIPduGroupRef = BMC_HV_XIX_HCP5_CANFD01_Rx_6dfafc5f
        ComIPduGroupRef = BMC_HV_XIX_PNC_26_HighVoltage_Charging_Rx_765b82c2
        ComIPduSignalRef = DCDC_NV_Komponentenfehler_01_XIX_DCDC_NV_Komponentenfehler_01_XIX_HCP5_CANFD01_d45848d1_Rx
        ComIPduSignalRef = DCDC_NV_Komponentenfehler_02_XIX_DCDC_NV_Komponentenfehler_01_XIX_HCP5_CANFD01_516a5a25_Rx
        ComIPduSignalRef = DCDC_NV_Komponentenfehler_03_XIX_DCDC_NV_Komponentenfehler_01_XIX_HCP5_CANFD01_9b54a9b6_Rx
        ComIPduSignalRef = DCDC_NV_Komponentenfehler_04_XIX_DCDC_NV_Komponentenfehler_01_XIX_HCP5_CANFD01_807f798c_Rx
        ComIPduSignalRef = DCDC_NV_Komponentenfehler_05_XIX_DCDC_NV_Komponentenfehler_01_XIX_HCP5_CANFD01_4a418a1f_Rx
        ComIPduSignalRef = DCDC_NV_Komponentenfehler_06_XIX_DCDC_NV_Komponentenfehler_01_XIX_HCP5_CANFD01_cf7398eb_Rx
        ComIPduSignalRef = DCDC_NV_Komponentenfehler_07_XIX_DCDC_NV_Komponentenfehler_01_XIX_HCP5_CANFD01_054d6b78_Rx
        ComIPduSignalRef = DCDC_NV_Komponentenfehler_08_XIX_DCDC_NV_Komponentenfehler_01_XIX_HCP5_CANFD01_f924389f_Rx
        ComIPduSignalRef = DCDC_NV_Komponentenfehler_09_XIX_DCDC_NV_Komponentenfehler_01_XIX_HCP5_CANFD01_331acb0c_Rx
        ComIPduSignalRef = DCDC_NV_Komponentenfehler_10_XIX_DCDC_NV_Komponentenfehler_01_XIX_HCP5_CANFD01_77aa474f_Rx
        ComIPduSignalRef = DCDC_NV_Komponentenfehler_11_XIX_DCDC_NV_Komponentenfehler_01_XIX_HCP5_CANFD01_bd94b4dc_Rx
        ComIPduSignalRef = DCDC_NV_Komponentenfehler_12_XIX_DCDC_NV_Komponentenfehler_01_XIX_HCP5_CANFD01_38a6a628_Rx
        ComIPduSignalRef = DCDC_NV_Komponentenfehler_13_XIX_DCDC_NV_Komponentenfehler_01_XIX_HCP5_CANFD01_f29855bb_Rx
        ComIPduSignalRef = DCDC_NV_Komponentenfehler_14_XIX_DCDC_NV_Komponentenfehler_01_XIX_HCP5_CANFD01_e9b38581_Rx
        ComIPduSignalRef = DCDC_NV_Komponentenfehler_15_XIX_DCDC_NV_Komponentenfehler_01_XIX_HCP5_CANFD01_238d7612_Rx
        ComIPduSignalRef = DCDC_NV_Komponentenfehler_16_XIX_DCDC_NV_Komponentenfehler_01_XIX_HCP5_CANFD01_a6bf64e6_Rx
        ComIPduSignalRef = DCDC_NV_Komponentenfehler_17_XIX_DCDC_NV_Komponentenfehler_01_XIX_HCP5_CANFD01_6c819775_Rx
        ComIPduSignalRef = DCDC_NV_Komponentenfehler_18_XIX_DCDC_NV_Komponentenfehler_01_XIX_HCP5_CANFD01_90e8c492_Rx
        ComIPduSignalRef = DCDC_NV_Komponentenfehler_19_XIX_DCDC_NV_Komponentenfehler_01_XIX_HCP5_CANFD01_5ad63701_Rx
        ComIPduSignalRef = DCDC_NV_Komponentenfehler_20_XIX_DCDC_NV_Komponentenfehler_01_XIX_HCP5_CANFD01_cdff4358_Rx
        ComIPduSignalRef = DCDC_NV_Komponentenfehler_21_XIX_DCDC_NV_Komponentenfehler_01_XIX_HCP5_CANFD01_07c1b0cb_Rx
        ComIPduSignalRef = DCDC_NV_Komponentenfehler_22_XIX_DCDC_NV_Komponentenfehler_01_XIX_HCP5_CANFD01_82f3a23f_Rx
        ComIPduSignalRef = DCDC_NV_Komponentenfehler_23_XIX_DCDC_NV_Komponentenfehler_01_XIX_HCP5_CANFD01_48cd51ac_Rx
        ComIPduSignalRef = DCDC_NV_Komponentenfehler_24_XIX_DCDC_NV_Komponentenfehler_01_XIX_HCP5_CANFD01_53e68196_Rx
        ComIPduSignalRef = DCDC_NV_Komponentenfehler_25_XIX_DCDC_NV_Komponentenfehler_01_XIX_HCP5_CANFD01_99d87205_Rx
        ComIPduSignalRef = DCDC_NV_Komponentenfehler_26_XIX_DCDC_NV_Komponentenfehler_01_XIX_HCP5_CANFD01_1cea60f1_Rx
        ComIPduSignalRef = DCDC_NV_Komponentenfehler_27_XIX_DCDC_NV_Komponentenfehler_01_XIX_HCP5_CANFD01_d6d49362_Rx
        ComIPduSignalRef = DCDC_NV_Komponentenfehler_28_XIX_DCDC_NV_Komponentenfehler_01_XIX_HCP5_CANFD01_2abdc085_Rx
        ComIPduSignalRef = DCDC_NV_Komponentenfehler_29_XIX_DCDC_NV_Komponentenfehler_01_XIX_HCP5_CANFD01_e0833316_Rx
        ComIPduSignalRef = DCDC_NV_Komponentenfehler_VLD_XIX_DCDC_NV_Komponentenfehler_01_XIX_HCP5_CANFD01_edf78d03_Rx
        ComPduIdRef = DCDC_NV_Komponentenfehler_01_XIX_HCP5_CANFD01_dd687766_Rx
        ComIPduMainFunctionRef = ComMainFunctionRx
      KN_Hybrid_01_XIX_HCP5_CANFD01_fef84477_Tx (ComIPdu):
        ComIPduDirection = SEND
        ComIPduType = NORMAL
        ComIPduHandleId = 24
        ComIPduSignalProcessing = DEFERRED
        ComIPduCancellationSupport = false
        ComIPduGroupRef = BMC_HV_XIX_HCP5_CANFD01_Tx_3ba05bd9
        ComIPduGroupRef = BMC_HV_XIX_PNC_01_CarWakeUp_Tx_29969a84
        ComIPduGroupRef = BMC_HV_XIX_PNC_40_Diagnosis_Energy_Tx_60b361f6
        ComIPduSignalRef = Hybrid_01_KD_Fehler_XIX_KN_Hybrid_01_XIX_HCP5_CANFD01_3ce83ada_Tx
        ComIPduSignalRef = Hybrid_01_KompSchutz_XIX_KN_Hybrid_01_XIX_HCP5_CANFD01_b32281c3_Tx
        ComIPduSignalRef = Hybrid_01_Nachlauftyp_XIX_KN_Hybrid_01_XIX_HCP5_CANFD01_26798f2d_Tx
        ComIPduSignalRef = Hybrid_01_SNI_10_XIX_KN_Hybrid_01_XIX_HCP5_CANFD01_ea872ae4_Tx
        ComIPduSignalRef = KN_Hybrid_01_BusKnockOutTimer_XIX_KN_Hybrid_01_XIX_HCP5_CANFD01_e5089bb3_Tx
        ComIPduSignalRef = KN_Hybrid_01_BusKnockOut_XIX_KN_Hybrid_01_XIX_HCP5_CANFD01_b162d19d_Tx
        ComIPduSignalRef = KN_Hybrid_01_DiagPfad_V12_XIX_KN_Hybrid_01_XIX_HCP5_CANFD01_9879167d_Tx
        ComIPduSignalRef = KN_Hybrid_01_ECUKnockOutTimer_XIX_KN_Hybrid_01_XIX_HCP5_CANFD01_7ea3be84_Tx
        ComIPduSignalRef = KN_Hybrid_01_ECUKnockOut_XIX_KN_Hybrid_01_XIX_HCP5_CANFD01_dd88c4a5_Tx
        ComIPduSignalRef = NM_Hybrid_01_FCIB_XIX_KN_Hybrid_01_XIX_HCP5_CANFD01_7ed68506_Tx
        ComIPduSignalRef = NM_Hybrid_01_Lokalaktiv_XIX_KN_Hybrid_01_XIX_HCP5_CANFD01_905d7818_Tx
        ComIPduSignalRef = NM_Hybrid_01_Subsystemaktiv_XIX_KN_Hybrid_01_XIX_HCP5_CANFD01_0d256d16_Tx
        ComPduIdRef = KN_Hybrid_01_XIX_HCP5_CANFD01_fef84477_Tx
        ComIPduMainFunctionRef = ComMainFunctionTx
        ComTxIPdu: ComTxIPduUnusedAreasDefault=0, ComMinimumDelayTime=0
          ComTxModeTrue
            ComTxMode: ComTxModeMode=PERIODIC, ComTxModeTimeOffset=0, ComTxModeTimePeriod=0.5
          ComTxModeFalse
            ComTxMode: ComTxModeMode=NONE
      BMC_CMC_Zellspannung_008_XIX_BMC_CMC_Zellspannung_01_XIX_HCP5_CANFD01_89fa83b3_Tx (ComSignal):
        ComBitPosition = 96
        ComBitSize = 12
        ComSignalDataInvalidValue = 4095
        ComSignalEndianness = LITTLE_ENDIAN
        ComSignalInitValue = 4094
        ComSignalType = UINT16
        ComTransferProperty = PENDING
        ComSignalAccess = ACCESS_UNCLEAR
        ComHandleId = 119
        ComSystemTemplateSystemSignalRef = BMC_CMC_Zellspannung_008
      UI2_KompFehlerModus4_06_XIX_UI2_Komponentenfehler_02_XIX_BMC_CAN01_71b522e7_Rx (ComSignal):
        ComBitPosition = 27
        ComBitSize = 3
        ComSignalEndianness = LITTLE_ENDIAN
        ComSignalInitValue = 0
        ComSignalType = UINT8
        ComTimeout = 1
        ComSignalAccess = ACCESS_UNCLEAR
        ComHandleId = 476
        ComSystemTemplateSystemSignalRef = UI2_KompFehlerModus4_06
      BMC_CMC_Temperatur_01_XIX_HCP5_CANFD01_13d55235_Tx (ComIPdu):
        ComIPduDirection = SEND
        ComIPduType = NORMAL
        ComIPduHandleId = 0
        ComIPduSignalProcessing = DEFERRED
        ComIPduCancellationSupport = false
        ComIPduGroupRef = BMC_HV_XIX_HCP5_CANFD01_Tx_3ba05bd9
        ComIPduGroupRef = BMC_HV_XIX_PNC_26_HighVoltage_Charging_Tx_20012544
        ComIPduSignalRef = BMC_CMC_Temperatur_001_XIX_BMC_CMC_Temperatur_01_XIX_HCP5_CANFD01_19554342_Tx
        ComIPduSignalRef = BMC_CMC_Temperatur_002_XIX_BMC_CMC_Temperatur_01_XIX_HCP5_CANFD01_672d0be4_Tx
        ComIPduSignalRef = BMC_CMC_Temperatur_003_XIX_BMC_CMC_Temperatur_01_XIX_HCP5_CANFD01_4d053386_Tx
        ComIPduSignalRef = BMC_CMC_Temperatur_004_XIX_BMC_CMC_Temperatur_01_XIX_HCP5_CANFD01_9bdd9aa8_Tx
        ComIPduSignalRef = BMC_CMC_Temperatur_005_XIX_BMC_CMC_Temperatur_01_XIX_HCP5_CANFD01_b1f5a2ca_Tx
        ComIPduSignalRef = BMC_CMC_Temperatur_006_XIX_BMC_CMC_Temperatur_01_XIX_HCP5_CANFD01_cf8dea6c_Tx
        ComIPduSignalRef = BMC_CMC_Temperatur_007_XIX_BMC_CMC_Temperatur_01_XIX_HCP5_CANFD01_e5a5d20e_Tx
        ComIPduSignalRef = BMC_CMC_Temperatur_008_XIX_BMC_CMC_Temperatur_01_XIX_HCP5_CANFD01_b94dbe71_Tx
        ComIPduSignalRef = BMC_CMC_Temperatur_009_XIX_BMC_CMC_Temperatur_01_XIX_HCP5_CANFD01_93658613_Tx
        ComIPduSignalRef = BMC_CMC_Temperatur_010_XIX_BMC_CMC_Temperatur_01_XIX_HCP5_CANFD01_90eb536c_Tx
        ComIPduSignalRef = BMC_CMC_Temperatur_011_XIX_BMC_CMC_Temperatur_01_XIX_HCP5_CANFD01_bac36b0e_Tx
        ComIPduSignalRef = BMC_CMC_Temperatur_012_XIX_BMC_CMC_Temperatur_01_XIX_HCP5_CANFD01_c4bb23a8_Tx
        ComIPduSignalRef = BMC_CMC_Temperatur_013_XIX_BMC_CMC_Temperatur_01_XIX_HCP5_CANFD01_ee931bca_Tx
        ComIPduSignalRef = BMC_CMC_Temperatur_014_XIX_BMC_CMC_Temperatur_01_XIX_HCP5_CANFD01_384bb2e4_Tx
        ComIPduSignalRef = BMC_CMC_Temperatur_015_XIX_BMC_CMC_Temperatur_01_XIX_HCP5_CANFD01_12638a86_Tx
        ComIPduSignalRef = BMC_CMC_Temperatur_016_XIX_BMC_CMC_Temperatur_01_XIX_HCP5_CANFD01_6c1bc220_Tx
        ComIPduSignalRef = BMC_CMC_Temperatur_017_XIX_BMC_CMC_Temperatur_01_XIX_HCP5_CANFD01_4633fa42_Tx
        ComIPduSignalRef = BMC_CMC_Temperatur_018_XIX_BMC_CMC_Temperatur_01_XIX_HCP5_CANFD01_1adb963d_Tx
        ComIPduSignalRef = BMC_CMC_Temperatur_019_XIX_BMC_CMC_Temperatur_01_XIX_HCP5_CANFD01_30f3ae5f_Tx
        ComIPduSignalRef = BMC_CMC_Temperatur_01_Messzeit_XIX_BMC_CMC_Temperatur_01_XIX_HCP5_CANFD01_e5c4df8c_Tx
        ComIPduSignalRef = BMC_CMC_Temperatur_020_XIX_BMC_CMC_Temperatur_01_XIX_HCP5_CANFD01_af202df9_Tx
        ComIPduSignalRef = BMC_CMC_Temperatur_021_XIX_BMC_CMC_Temperatur_01_XIX_HCP5_CANFD01_8508159b_Tx
        ComIPduSignalRef = BMC_CMC_Temperatur_022_XIX_BMC_CMC_Temperatur_01_XIX_HCP5_CANFD01_fb705d3d_Tx
        ComIPduSignalRef = BMC_CMC_Temperatur_023_XIX_BMC_CMC_Temperatur_01_XIX_HCP5_CANFD01_d158655f_Tx
        ComIPduSignalRef = BMC_CMC_Temperatur_024_XIX_BMC_CMC_Temperatur_01_XIX_HCP5_CANFD01_0780cc71_Tx
        ComIPduSignalRef = BMC_CMC_Temperatur_025_XIX_BMC_CMC_Temperatur_01_XIX_HCP5_CANFD01_2da8f413_Tx
        ComIPduSignalRef = BMC_CMC_Temperatur_026_XIX_BMC_CMC_Temperatur_01_XIX_HCP5_CANFD01_53d0bcb5_Tx
        ComIPduSignalRef = BMC_CMC_Temperatur_027_XIX_BMC_CMC_Temperatur_01_XIX_HCP5_CANFD01_79f884d7_Tx
        ComIPduSignalRef = BMC_CMC_Temperatur_028_XIX_BMC_CMC_Temperatur_01_XIX_HCP5_CANFD01_2510e8a8_Tx
        ComIPduSignalRef = BMC_CMC_Temperatur_029_XIX_BMC_CMC_Temperatur_01_XIX_HCP5_CANFD01_0f38d0ca_Tx
        ComIPduSignalRef = BMC_CMC_Temperatur_030_XIX_BMC_CMC_Temperatur_01_XIX_HCP5_CANFD01_0cb605b5_Tx
        ComIPduSignalRef = BMC_CMC_Temperatur_031_XIX_BMC_CMC_Temperatur_01_XIX_HCP5_CANFD01_269e3dd7_Tx
        ComIPduSignalRef = BMC_CMC_Temperatur_032_XIX_BMC_CMC_Temperatur_01_XIX_HCP5_CANFD01_58e67571_Tx
        ComIPduSignalRef = BMC_CMC_Temperatur_033_XIX_BMC_CMC_Temperatur_01_XIX_HCP5_CANFD01_72ce4d13_Tx
        ComIPduSignalRef = BMC_CMC_Temperatur_034_XIX_BMC_CMC_Temperatur_01_XIX_HCP5_CANFD01_a416e43d_Tx
        ComIPduSignalRef = BMC_CMC_Temperatur_035_XIX_BMC_CMC_Temperatur_01_XIX_HCP5_CANFD01_8e3edc5f_Tx
        ComIPduSignalRef = BMC_CMC_Temperatur_036_XIX_BMC_CMC_Temperatur_01_XIX_HCP5_CANFD01_f04694f9_Tx
        ComIPduSignalRef = BMC_CMC_Temperatur_037_XIX_BMC_CMC_Temperatur_01_XIX_HCP5_CANFD01_da6eac9b_Tx
        ComIPduSignalRef = BMC_CMC_Temperatur_038_XIX_BMC_CMC_Temperatur_01_XIX_HCP5_CANFD01_8686c0e4_Tx
        ComIPduSignalRef = BMC_CMC_Temperatur_039_XIX_BMC_CMC_Temperatur_01_XIX_HCP5_CANFD01_acaef886_Tx
        ComIPduSignalRef = BMC_CMC_Temperatur_040_XIX_BMC_CMC_Temperatur_01_XIX_HCP5_CANFD01_d0b6d0d3_Tx
        ComIPduSignalRef = BMC_CMC_Temperatur_041_XIX_BMC_CMC_Temperatur_01_XIX_HCP5_CANFD01_fa9ee8b1_Tx
        ComIPduSignalRef = BMC_CMC_Temperatur_042_XIX_BMC_CMC_Temperatur_01_XIX_HCP5_CANFD01_84e6a017_Tx
        ComIPduSignalRef = BMC_CMC_Temperatur_043_XIX_BMC_CMC_Temperatur_01_XIX_HCP5_CANFD01_aece9875_Tx
        ComIPduSignalRef = BMC_CMC_Temperatur_044_XIX_BMC_CMC_Temperatur_01_XIX_HCP5_CANFD01_7816315b_Tx
        ComIPduSignalRef = BMC_CMC_Temperatur_045_XIX_BMC_CMC_Temperatur_01_XIX_HCP5_CANFD01_523e0939_Tx
        ComIPduSignalRef = BMC_CMC_Temperatur_046_XIX_BMC_CMC_Temperatur_01_XIX_HCP5_CANFD01_2c46419f_Tx
        ComIPduSignalRef = BMC_CMC_Temperatur_047_XIX_BMC_CMC_Temperatur_01_XIX_HCP5_CANFD01_066e79fd_Tx
        ComIPduSignalRef = BMC_CMC_Temperatur_048_XIX_BMC_CMC_Temperatur_01_XIX_HCP5_CANFD01_5a861582_Tx
        ComIPduSignalRef = BMC_CMC_Temperatur_049_XIX_BMC_CMC_Temperatur_01_XIX_HCP5_CANFD01_70ae2de0_Tx
        ComIPduSignalRef = BMC_CMC_Temperatur_050_XIX_BMC_CMC_Temperatur_01_XIX_HCP5_CANFD01_7320f89f_Tx
        ComIPduSignalRef = BMC_CMC_Temperatur_051_XIX_BMC_CMC_Temperatur_01_XIX_HCP5_CANFD01_5908c0fd_Tx
        ComIPduSignalRef = BMC_CMC_Temperatur_052_XIX_BMC_CMC_Temperatur_01_XIX_HCP5_CANFD01_2770885b_Tx
        ComIPduSignalRef = BMC_CMC_Temperatur_053_XIX_BMC_CMC_Temperatur_01_XIX_HCP5_CANFD01_0d58b039_Tx
        ComIPduSignalRef = BMC_CMC_Temperatur_054_XIX_BMC_CMC_Temperatur_01_XIX_HCP5_CANFD01_db801917_Tx
        ComIPduSignalRef = BMC_CMC_Temperatur_055_XIX_BMC_CMC_Temperatur_01_XIX_HCP5_CANFD01_f1a82175_Tx
        ComIPduSignalRef = BMC_CMC_Temperatur_056_XIX_BMC_CMC_Temperatur_01_XIX_HCP5_CANFD01_8fd069d3_Tx
        ComIPduSignalRef = BMC_CMC_Temperatur_057_XIX_BMC_CMC_Temperatur_01_XIX_HCP5_CANFD01_a5f851b1_Tx
        ComIPduSignalRef = BMC_CMC_Temperatur_058_XIX_BMC_CMC_Temperatur_01_XIX_HCP5_CANFD01_f9103dce_Tx
        ComPduIdRef = BMC_CMC_Temperatur_01_XIX_HCP5_CANFD01_13d55235_Tx
        ComIPduMainFunctionRef = ComMainFunctionTx
        ComTxIPdu: ComTxIPduUnusedAreasDefault=0, ComMinimumDelayTime=0
          ComTxModeTrue
            ComTxMode: ComTxModeMode=PERIODIC, ComTxModeTimeOffset=0, ComTxModeTimePeriod=1
          ComTxModeFalse
            ComTxMode: ComTxModeMode=NONE
      8 x ComSignal, all with ComSignalEndianness=LITTLE_ENDIAN, ComSignalAccess=ACCESS_UNCLEAR:
        BMC_Pack_SN_16_XIX_BMC_HV_08_XIX_HCP5_CANFD01_57536ffd_Tx: ComBitPosition=184, ComBitSize=8, ComSignalInitValue=255, ComSignalType=UINT8, ComTransferProperty=PENDING, ComHandleId=349, ComSystemTemplateSystemSignalRef=BMC_Pack_SN_16
        DCDC_NV_Komponentenfehler_08_XIX_DCDC_NV_Komponentenfehler_01_XIX_HCP5_CANFD01_f924389f_Rx: ComBitPosition=14, ComBitSize=2, ComSignalInitValue=0, ComSignalType=UINT8, ComTimeout=5, ComHandleId=69, ComSystemTemplateSystemSignalRef=DCDC_NV_Komponentenfehler_08
        UI2Sens01_CVN_Byte_1_XIX_UI2Sens01_CVN_XIX_BMC_CAN01_0510ee62_Rx: ComBitPosition=1, ComBitSize=8, ComSignalInitValue=0, ComSignalType=UINT8, ComTimeout=5, ComHandleId=417, ComSystemTemplateSystemSignalRef=UI2Sens01_CVN_Byte_1
        BMC_CMC_Zellspannung_148_XIX_BMC_CMC_Zellspannung_04_XIX_HCP5_CANFD01_2e24255d_Tx: ComBitPosition=372, ComBitSize=12, ComSignalDataInvalidValue=4095, ComSignalInitValue=4094, ComSignalType=UINT16, ComTransferProperty=PENDING, ComHandleId=259, ComSystemTemplateSystemSignalRef=BMC_CMC_Zellspannung_148
        DCDC_NV_CALID_Index_12_XIX_DCDC_NV_CALID_XIX_HCP5_CANFD01_6b478863_Rx: ComBitPosition=88, ComBitSize=8, ComSignalInitValue=63, ComSignalType=UINT8, ComTimeout=5, ComHandleId=36, ComSystemTemplateSystemSignalRef=DCDC_NV_CALID_Index_12
        BMC_CMC_Temperatur_065_XIX_BMC_CMC_Temperatur_02_XIX_HCP5_CANFD01_24e58282_Tx: ComBitPosition=64, ComBitSize=8, ComSignalDataInvalidValue=255, ComSignalInitValue=254, ComSignalType=UINT8, ComTransferProperty=PENDING, ComHandleId=75, ComSystemTemplateSystemSignalRef=BMC_CMC_Temperatur_065
        UI2Sens01_ErrMem_State_XIX_UI1_04_XIX_BMC_CAN01_2781c1ec_Rx: ComBitPosition=13, ComBitSize=2, ComSignalInitValue=2, ComSignalType=UINT8, ComTimeout=1, ComHandleId=422, ComSystemTemplateSystemSignalRef=UI2Sens01_ErrMem_State
        BMC_Bidi_Veto_Energie_XIX_BMC_HV_06_XIX_HCP5_CANFD01_c682e8ed_Tx: ComBitPosition=34, ComBitSize=1, ComSignalInitValue=0, ComSignalType=UINT8, ComTransferProperty=PENDING, ComHandleId=6, ComSystemTemplateSystemSignalRef=BMC_Bidi_Veto_Energie
      BMC_HV_04_XIX_BMC_CAN01_E2E_a4a2e7f5_Tx (ComIPdu):
        ComIPduDirection = SEND
        ComIPduType = NORMAL
        ComIPduHandleId = 11
        ComIPduSignalProcessing = DEFERRED
        ComIPduCancellationSupport = false
        ComIPduGroupRef = BMC_HV_XIX_BMC_CAN01_Tx_2d622f96
        ComIPduSignalGroupRef = SG_BMC_HV_04_XIX_BMC_CAN01_0c592380_Tx
        ComPduIdRef = BMC_HV_04_XIX_BMC_CAN01_E2E_a4a2e7f5_Tx
        ComIPduMainFunctionRef = ComMainFunctionTx
        ComTxIPdu: ComMinimumDelayTime=0.05, ComTxIPduUnusedAreasDefault=0
          ComTxModeTrue
            ComTxMode: ComTxModeMode=PERIODIC, ComTxModeNumberOfRepetitions=0, ComTxModeRepetitionPeriod=0, ComTxModeTimePeriod=1, ComTxModeTimeOffset=0.1
          ComTxModeFalse
            ComTxMode: ComTxModeMode=NONE
      3 x ComSignal, all with ComSignalEndianness=LITTLE_ENDIAN, ComSignalAccess=ACCESS_UNCLEAR:
        BMC_CMC_Temperatur_021_XIX_BMC_CMC_Temperatur_01_XIX_HCP5_CANFD01_8508159b_Tx: ComBitPosition=176, ComBitSize=8, ComSignalDataInvalidValue=255, ComSignalInitValue=254, ComSignalType=UINT8, ComTransferProperty=PENDING, ComHandleId=31, ComSystemTemplateSystemSignalRef=BMC_CMC_Temperatur_021
        BMC_CMC_Zellspannung_191_XIX_BMC_CMC_Zellspannung_05_XIX_HCP5_CANFD01_1cd7af2f_Tx: ComBitPosition=420, ComBitSize=12, ComSignalDataInvalidValue=4095, ComSignalInitValue=4094, ComSignalType=UINT16, ComTransferProperty=PENDING, ComHandleId=302, ComSystemTemplateSystemSignalRef=BMC_CMC_Zellspannung_191
        UI2Sens01_CALID_Index_15_XIX_UI2Sens01_CALID_02_XIX_BMC_CAN01_748e2375_Rx: ComBitPosition=48, ComBitSize=8, ComSignalInitValue=63, ComSignalType=UINT8, ComTimeout=5, ComHandleId=415, ComSystemTemplateSystemSignalRef=UI2Sens01_CALID_Index_15
      Charisma_20_XIX_HCP5_CANFD01_f51eced8_Rx (ComIPdu):
        ComIPduDirection = RECEIVE
        ComIPduType = NORMAL
        ComIPduHandleId = 9
        ComIPduSignalProcessing = DEFERRED
        ComIPduCancellationSupport = false
        ComIPduGroupRef = BMC_HV_XIX_HCP5_CANFD01_Rx_6dfafc5f
        ComIPduGroupRef = BMC_HV_XIX_PNC_07_Basefunction_CrossSection_Rx_4fb7c882
        ComIPduSignalRef = CHA_ReqPrgBms_XIX_Charisma_20_XIX_HCP5_CANFD01_9364cd45_Rx
        ComPduIdRef = Charisma_20_XIX_HCP5_CANFD01_f51eced8_Rx
        ComIPduMainFunctionRef = ComMainFunctionRx
      BMC_Konditionierung_Anf_XIX_BMC_HV_03_XIX_HCP5_CANFD01_f6c01bb8_Tx (ComSignal):
        ComBitPosition = 160
        ComBitSize = 1
        ComSignalEndianness = LITTLE_ENDIAN
        ComSignalInitValue = 0
        ComSignalType = UINT8
        ComTransferProperty = PENDING
        ComSignalAccess = ACCESS_UNCLEAR
        ComHandleId = 320
        ComSystemTemplateSystemSignalRef = BMC_Konditionierung_Anf
      BMC_CMC_Zellspannung_112_XIX_BMC_CMC_Zellspannung_03_XIX_HCP5_CANFD01_6fdbe8b5_Tx (ComSignal):
        ComBitPosition = 408
        ComBitSize = 12
        ComSignalDataInvalidValue = 4095
        ComSignalEndianness = LITTLE_ENDIAN
        ComSignalInitValue = 4094
        ComSignalType = UINT16
        ComTransferProperty = PENDING
        ComSignalAccess = ACCESS_UNCLEAR
        ComHandleId = 223
        ComSystemTemplateSystemSignalRef = BMC_CMC_Zellspannung_112
      BMC_CMC_Zellspannung_02_XIX_HCP5_CANFD01_1de9628b_Tx (ComIPdu):
        ComIPduDirection = SEND
        ComIPduType = NORMAL
        ComIPduHandleId = 4
        ComIPduSignalProcessing = DEFERRED
        ComIPduCancellationSupport = false
        ComIPduGroupRef = BMC_HV_XIX_HCP5_CANFD01_Tx_3ba05bd9
        ComIPduGroupRef = BMC_HV_XIX_PNC_26_HighVoltage_Charging_Tx_20012544
        ComIPduSignalRef = BMC_CMC_Zellspannung_02_Messzeit_XIX_BMC_CMC_Zellspannung_02_XIX_HCP5_CANFD01_2962a4f1_Tx
        ComIPduSignalRef = BMC_CMC_Zellspannung_040_XIX_BMC_CMC_Zellspannung_02_XIX_HCP5_CANFD01_5547a51e_Tx
        ComIPduSignalRef = BMC_CMC_Zellspannung_041_XIX_BMC_CMC_Zellspannung_02_XIX_HCP5_CANFD01_2a8e3e8d_Tx
        ComIPduSignalRef = BMC_CMC_Zellspannung_042_XIX_BMC_CMC_Zellspannung_02_XIX_HCP5_CANFD01_aad49238_Tx
        ComIPduSignalRef = BMC_CMC_Zellspannung_043_XIX_BMC_CMC_Zellspannung_02_XIX_HCP5_CANFD01_d51d09ab_Tx
        ComIPduSignalRef = BMC_CMC_Zellspannung_044_XIX_BMC_CMC_Zellspannung_02_XIX_HCP5_CANFD01_7110cd13_Tx
        ComIPduSignalRef = BMC_CMC_Zellspannung_045_XIX_BMC_CMC_Zellspannung_02_XIX_HCP5_CANFD01_0ed95680_Tx
        ComIPduSignalRef = BMC_CMC_Zellspannung_046_XIX_BMC_CMC_Zellspannung_02_XIX_HCP5_CANFD01_8e83fa35_Tx
        ComIPduSignalRef = BMC_CMC_Zellspannung_047_XIX_BMC_CMC_Zellspannung_02_XIX_HCP5_CANFD01_f14a61a6_Tx
        ComIPduSignalRef = BMC_CMC_Zellspannung_048_XIX_BMC_CMC_Zellspannung_02_XIX_HCP5_CANFD01_1de97504_Tx
        ComIPduSignalRef = BMC_CMC_Zellspannung_049_XIX_BMC_CMC_Zellspannung_02_XIX_HCP5_CANFD01_6220ee97_Tx
        ComIPduSignalRef = BMC_CMC_Zellspannung_050_XIX_BMC_CMC_Zellspannung_02_XIX_HCP5_CANFD01_3c3eae7b_Tx
        ComIPduSignalRef = BMC_CMC_Zellspannung_051_XIX_BMC_CMC_Zellspannung_02_XIX_HCP5_CANFD01_43f735e8_Tx
        ComIPduSignalRef = BMC_CMC_Zellspannung_052_XIX_BMC_CMC_Zellspannung_02_XIX_HCP5_CANFD01_c3ad995d_Tx
        ComIPduSignalRef = BMC_CMC_Zellspannung_053_XIX_BMC_CMC_Zellspannung_02_XIX_HCP5_CANFD01_bc6402ce_Tx
        ComIPduSignalRef = BMC_CMC_Zellspannung_054_XIX_BMC_CMC_Zellspannung_02_XIX_HCP5_CANFD01_1869c676_Tx
        ComIPduSignalRef = BMC_CMC_Zellspannung_055_XIX_BMC_CMC_Zellspannung_02_XIX_HCP5_CANFD01_67a05de5_Tx
        ComIPduSignalRef = BMC_CMC_Zellspannung_056_XIX_BMC_CMC_Zellspannung_02_XIX_HCP5_CANFD01_e7faf150_Tx
        ComIPduSignalRef = BMC_CMC_Zellspannung_057_XIX_BMC_CMC_Zellspannung_02_XIX_HCP5_CANFD01_98336ac3_Tx
        ComIPduSignalRef = BMC_CMC_Zellspannung_058_XIX_BMC_CMC_Zellspannung_02_XIX_HCP5_CANFD01_74907e61_Tx
        ComIPduSignalRef = BMC_CMC_Zellspannung_059_XIX_BMC_CMC_Zellspannung_02_XIX_HCP5_CANFD01_0b59e5f2_Tx
        ComIPduSignalRef = BMC_CMC_Zellspannung_060_XIX_BMC_CMC_Zellspannung_02_XIX_HCP5_CANFD01_87b5b3d4_Tx
        ComIPduSignalRef = BMC_CMC_Zellspannung_061_XIX_BMC_CMC_Zellspannung_02_XIX_HCP5_CANFD01_f87c2847_Tx
        ComIPduSignalRef = BMC_CMC_Zellspannung_062_XIX_BMC_CMC_Zellspannung_02_XIX_HCP5_CANFD01_782684f2_Tx
        ComIPduSignalRef = BMC_CMC_Zellspannung_063_XIX_BMC_CMC_Zellspannung_02_XIX_HCP5_CANFD01_07ef1f61_Tx
        ComIPduSignalRef = BMC_CMC_Zellspannung_064_XIX_BMC_CMC_Zellspannung_02_XIX_HCP5_CANFD01_a3e2dbd9_Tx
        ComIPduSignalRef = BMC_CMC_Zellspannung_065_XIX_BMC_CMC_Zellspannung_02_XIX_HCP5_CANFD01_dc2b404a_Tx
        ComIPduSignalRef = BMC_CMC_Zellspannung_066_XIX_BMC_CMC_Zellspannung_02_XIX_HCP5_CANFD01_5c71ecff_Tx
        ComIPduSignalRef = BMC_CMC_Zellspannung_067_XIX_BMC_CMC_Zellspannung_02_XIX_HCP5_CANFD01_23b8776c_Tx
        ComIPduSignalRef = BMC_CMC_Zellspannung_068_XIX_BMC_CMC_Zellspannung_02_XIX_HCP5_CANFD01_cf1b63ce_Tx
        ComIPduSignalRef = BMC_CMC_Zellspannung_069_XIX_BMC_CMC_Zellspannung_02_XIX_HCP5_CANFD01_b0d2f85d_Tx
        ComIPduSignalRef = BMC_CMC_Zellspannung_070_XIX_BMC_CMC_Zellspannung_02_XIX_HCP5_CANFD01_eeccb8b1_Tx
        ComIPduSignalRef = BMC_CMC_Zellspannung_071_XIX_BMC_CMC_Zellspannung_02_XIX_HCP5_CANFD01_91052322_Tx
        ComIPduSignalRef = BMC_CMC_Zellspannung_072_XIX_BMC_CMC_Zellspannung_02_XIX_HCP5_CANFD01_115f8f97_Tx
        ComIPduSignalRef = BMC_CMC_Zellspannung_073_XIX_BMC_CMC_Zellspannung_02_XIX_HCP5_CANFD01_6e961404_Tx
        ComIPduSignalRef = BMC_CMC_Zellspannung_074_XIX_BMC_CMC_Zellspannung_02_XIX_HCP5_CANFD01_ca9bd0bc_Tx
        ComIPduSignalRef = BMC_CMC_Zellspannung_075_XIX_BMC_CMC_Zellspannung_02_XIX_HCP5_CANFD01_b5524b2f_Tx
        ComIPduSignalRef = BMC_CMC_Zellspannung_076_XIX_BMC_CMC_Zellspannung_02_XIX_HCP5_CANFD01_3508e79a_Tx
        ComIPduSignalRef = BMC_CMC_Zellspannung_077_XIX_BMC_CMC_Zellspannung_02_XIX_HCP5_CANFD01_4ac17c09_Tx
        ComIPduSignalRef = BMC_CMC_Zellspannung_078_XIX_BMC_CMC_Zellspannung_02_XIX_HCP5_CANFD01_a66268ab_Tx
        ComPduIdRef = BMC_CMC_Zellspannung_02_XIX_HCP5_CANFD01_1de9628b_Tx
        ComIPduMainFunctionRef = ComMainFunctionTx
        ComTxIPdu: ComTxIPduUnusedAreasDefault=0, ComMinimumDelayTime=0
          ComTxModeTrue
            ComTxMode: ComTxModeMode=PERIODIC, ComTxModeTimeOffset=0, ComTxModeTimePeriod=1
          ComTxModeFalse
            ComTxMode: ComTxModeMode=NONE
      13 x ComSignal, all with ComSignalEndianness=LITTLE_ENDIAN, ComSignalAccess=ACCESS_UNCLEAR:
        BMC_Abschaltankuendigung_XIX_BMC_HV_03_XIX_HCP5_CANFD01_971531f5_Tx: ComBitPosition=46, ComBitSize=10, ComSignalDataInvalidValue=1023, ComSignalInitValue=1022, ComSignalType=UINT16, ComTransferProperty=PENDING, ComHandleId=0, ComSystemTemplateSystemSignalRef=BMC_Abschaltankuendigung
        BMC_Pack_SN_03_XIX_BMC_HV_08_XIX_HCP5_CANFD01_e1f1e08e_Tx: ComBitPosition=80, ComBitSize=8, ComSignalInitValue=255, ComSignalType=UINT8, ComTransferProperty=PENDING, ComHandleId=336, ComSystemTemplateSystemSignalRef=BMC_Pack_SN_03
        BMC_RtmWarnUPackMin_XIX_BMC_HV_08_XIX_HCP5_CANFD01_e1cbe29e_Tx: ComBitPosition=52, ComBitSize=3, ComSignalInitValue=0, ComSignalType=UINT8, ComTransferProperty=PENDING, ComHandleId=373, ComSystemTemplateSystemSignalRef=BMC_RtmWarnUPackMin
        BMC_CMC_Zellspannung_071_XIX_BMC_CMC_Zellspannung_02_XIX_HCP5_CANFD01_91052322_Tx: ComBitPosition=384, ComBitSize=12, ComSignalDataInvalidValue=4095, ComSignalInitValue=4094, ComSignalType=UINT16, ComTransferProperty=PENDING, ComHandleId=182, ComSystemTemplateSystemSignalRef=BMC_CMC_Zellspannung_071
        DS_Hybrid_01_DiagAdr_XIX_DS_Hybrid_01_XIX_HCP5_CANFD01_ecf98c5e_Tx: ComBitPosition=0, ComBitSize=16, ComSignalInitValue=140, ComSignalType=UINT16, ComTransferProperty=PENDING, ComHandleId=392, ComSystemTemplateSystemSignalRef=DS_Hybrid_01_DiagAdr
        BMC_CMC_Zellspannung_111_XIX_BMC_CMC_Zellspannung_03_XIX_HCP5_CANFD01_ef814400_Tx: ComBitPosition=396, ComBitSize=12, ComSignalDataInvalidValue=4095, ComSignalInitValue=4094, ComSignalType=UINT16, ComTransferProperty=PENDING, ComHandleId=222, ComSystemTemplateSystemSignalRef=BMC_CMC_Zellspannung_111
        BMC_CMC_Temperatur_015_XIX_BMC_CMC_Temperatur_01_XIX_HCP5_CANFD01_12638a86_Tx: ComBitPosition=128, ComBitSize=8, ComSignalDataInvalidValue=255, ComSignalInitValue=254, ComSignalType=UINT8, ComTransferProperty=PENDING, ComHandleId=25, ComSystemTemplateSystemSignalRef=BMC_CMC_Temperatur_015
        BMC_CMC_Temperatur_051_XIX_BMC_CMC_Temperatur_01_XIX_HCP5_CANFD01_5908c0fd_Tx: ComBitPosition=416, ComBitSize=8, ComSignalDataInvalidValue=255, ComSignalInitValue=254, ComSignalType=UINT8, ComTransferProperty=PENDING, ComHandleId=61, ComSystemTemplateSystemSignalRef=BMC_CMC_Temperatur_051
        BJB_CVN_Byte_4_XIX_BJB_CVN_01_XIX_BMC_CAN01_d566021f_Rx: ComBitPosition=25, ComBitSize=8, ComSignalInitValue=0, ComSignalType=UINT8, ComTimeout=5, ComHandleId=20, ComSystemTemplateSystemSignalRef=BJB_CVN_Byte_4
        HVEM_MMTR_State_XIX_HVEM_07_XIX_HCP5_CANFD01_6d943f0f_Rx: ComBitPosition=179, ComBitSize=4, ComSignalDataInvalidValue=15, ComSignalInitValue=0, ComSignalType=UINT8, ComTimeout=0.8, ComHandleId=149, ComSystemTemplateSystemSignalRef=HVEM_MMTR_State
        DCDC_NV_Komponentenfehler_64_XIX_DCDC_NV_Komponentenfehler_03_XIX_HCP5_CANFD01_2a701c60_Rx: ComBitPosition=6, ComBitSize=2, ComSignalInitValue=0, ComSignalType=UINT8, ComTimeout=5, ComHandleId=125, ComSystemTemplateSystemSignalRef=DCDC_NV_Komponentenfehler_64
        UI2Sens02_CALID_Index_06_XIX_UI2Sens02_CALID_01_XIX_BMC_CAN01_bde53b29_Rx: ComBitPosition=40, ComBitSize=8, ComSignalInitValue=63, ComSignalType=UINT8, ComTimeout=5, ComHandleId=428, ComSystemTemplateSystemSignalRef=UI2Sens02_CALID_Index_06
        BMC_CMC_Temperatur_068_XIX_BMC_CMC_Temperatur_02_XIX_HCP5_CANFD01_2c5d9e39_Tx: ComBitPosition=88, ComBitSize=8, ComSignalDataInvalidValue=255, ComSignalInitValue=254, ComSignalType=UINT8, ComTransferProperty=PENDING, ComHandleId=78, ComSystemTemplateSystemSignalRef=BMC_CMC_Temperatur_068
      KS_Hybrid_01_Challenge_K_XIX_HCP5_CANFD01_306d69bd_Tx (ComIPdu):
        ComIPduDirection = SEND
        ComIPduType = NORMAL
        ComIPduHandleId = 25
        ComIPduSignalProcessing = DEFERRED
        ComIPduCancellationSupport = false
        ComIPduGroupRef = BMC_HV_XIX_HCP5_CANFD01_Tx_3ba05bd9
        ComIPduSignalGroupRef = SG_KS_Hybrid_01_Challenge_K_XIX_HCP5_CANFD01_aa09b31e_Tx
        ComPduIdRef = KS_Hybrid_01_Challenge_K_XIX_HCP5_CANFD01_306d69bd_Tx
        ComIPduMainFunctionRef = ComMainFunctionTx
        ComTxIPdu: ComTxIPduUnusedAreasDefault=0, ComMinimumDelayTime=0
          ComTxModeTrue
            ComTxMode: ComTxModeMode=DIRECT, ComTxModeNumberOfRepetitions=0, ComTxModeRepetitionPeriod=0
          ComTxModeFalse
            ComTxMode: ComTxModeMode=NONE
      3 x ComSignal, all with ComSignalEndianness=LITTLE_ENDIAN, ComSignalAccess=ACCESS_UNCLEAR:
        BMC_ThermAuslastung_XIX_BMC_HV_03_XIX_HCP5_CANFD01_5abb920e_Tx: ComBitPosition=105, ComBitSize=7, ComSignalDataInvalidValue=127, ComSignalInitValue=126, ComSignalType=UINT8, ComTransferProperty=PENDING, ComHandleId=382, ComSystemTemplateSystemSignalRef=BMC_ThermAuslastung
        BMC_CMC_Zellspannung_134_XIX_BMC_CMC_Zellspannung_04_XIX_HCP5_CANFD01_87c3ab30_Tx: ComBitPosition=204, ComBitSize=12, ComSignalDataInvalidValue=4095, ComSignalInitValue=4094, ComSignalType=UINT16, ComTransferProperty=PENDING, ComHandleId=245, ComSystemTemplateSystemSignalRef=BMC_CMC_Zellspannung_134
        UI2Sens02_CVN_Byte_3_XIX_UI2Sens02_CVN_XIX_BMC_CAN01_b5db018b_Rx: ComBitPosition=17, ComBitSize=8, ComSignalInitValue=0, ComSignalType=UINT8, ComTimeout=5, ComHandleId=441, ComSystemTemplateSystemSignalRef=UI2Sens02_CVN_Byte_3
      SG_BMC_HV_12_XIX_BMC_CAN01_80cb66e3_Tx (ComSignalGroup):
        ComTransferProperty = TRIGGERED_WITHOUT_REPETITION
        ComSignalGroupAccess = ACCESS_UNCLEAR
        ComHandleId = 5
        ComSystemTemplateSignalGroupRef = SG_BMC_HV_12_XIX_BMC_CAN01
        7 x ComGroupSignal, all with ComSignalEndianness=LITTLE_ENDIAN, ComSignalAccess=ACCESS_NEEDED_BY_SWC_OR_COM, ComTransferProperty=PENDING:
          BMC_Sperrung_Uebertemperatur_XIX_BMC_HV_12_XIX_BMC_CAN01_2ce8de10_Tx: ComBitPosition=12, ComBitSize=2, ComSignalDataInvalidValue=3, ComSignalInitValue=2, ComSignalType=UINT8, ComHandleId=530, ComSystemTemplateSystemSignalRef=BMC_Sperrung_Uebertemperatur
          BMC_Uebertemperaturzaehler_CMC03_XIX_BMC_HV_12_XIX_BMC_CAN01_d7ca2be7_Tx: ComBitPosition=32, ComBitSize=16, ComSignalDataInvalidValue=65535, ComSignalInitValue=65534, ComSignalType=UINT16, ComHandleId=533, ComSystemTemplateSystemSignalRef=BMC_Uebertemperaturzaehler_CMC03
          BMC_Uebertemperaturzaehler_CMC04_XIX_BMC_HV_12_XIX_BMC_CAN01_25ac225a_Tx: ComBitPosition=48, ComBitSize=16, ComSignalDataInvalidValue=65535, ComSignalInitValue=65534, ComSignalType=UINT16, ComHandleId=534, ComSystemTemplateSystemSignalRef=BMC_Uebertemperaturzaehler_CMC04
          BMC_Ueberspannungszaehler_CMC04_XIX_BMC_HV_12_XIX_BMC_CAN01_11cd50e0_Tx: ComBitPosition=23, ComBitSize=9, ComSignalDataInvalidValue=511, ComSignalInitValue=510, ComSignalType=UINT16, ComHandleId=532, ComSystemTemplateSystemSignalRef=BMC_Ueberspannungszaehler_CMC04
          BMC_HV_12_CRC_XIX_BMC_HV_12_XIX_BMC_CAN01_d9349599_Tx: ComBitPosition=0, ComBitSize=8, ComSignalInitValue=0, ComSignalType=UINT8, ComHandleId=529, ComSystemTemplateSystemSignalRef=BMC_HV_12_CRC
          BMC_HV_12_BZ_XIX_BMC_HV_12_XIX_BMC_CAN01_a3ac450a_Tx: ComBitPosition=8, ComBitSize=4, ComSignalInitValue=0, ComSignalType=UINT8, ComHandleId=528, ComSystemTemplateSystemSignalRef=BMC_HV_12_BZ
          BMC_Ueberspannungszaehler_CMC03_XIX_BMC_HV_12_XIX_BMC_CAN01_e3ab595d_Tx: ComBitPosition=14, ComBitSize=9, ComSignalDataInvalidValue=511, ComSignalInitValue=510, ComSignalType=UINT16, ComHandleId=531, ComSystemTemplateSystemSignalRef=BMC_Ueberspannungszaehler_CMC03
      3 x ComSignal, all with ComSignalEndianness=LITTLE_ENDIAN, ComSignalType=UINT8, ComSignalAccess=ACCESS_UNCLEAR:
        OTP_Aussen_Temp_OBD_XIX_OTP_01_XIX_HCP5_CANFD01_6e627cce_Rx: ComBitPosition=32, ComBitSize=1, ComSignalInitValue=1, ComTimeout=2, ComHandleId=177, ComSystemTemplateSystemSignalRef=OTP_Aussen_Temp_OBD
        BMC_RtmWarnZelleZustand_XIX_BMC_HV_08_XIX_HCP5_CANFD01_688df887_Tx: ComBitPosition=61, ComBitSize=3, ComSignalInitValue=0, ComTransferProperty=PENDING, ComHandleId=377, ComSystemTemplateSystemSignalRef=BMC_RtmWarnZelleZustand
        PCM_BMC_VTD_LifeTimeReset_Req_XIX_HCP1_17_XIX_HCP5_CANFD01_b7cc45cb_Rx: ComBitPosition=36, ComBitSize=2, ComSignalDataInvalidValue=3, ComSignalInitValue=2, ComTimeout=5, ComHandleId=180, ComSystemTemplateSystemSignalRef=PCM_BMC_VTD_LifeTimeReset_Req
      UI1_Komponentenfehler_02_XIX_BMC_CAN01_19fb750e_Rx (ComIPdu):
        ComIPduDirection = RECEIVE
        ComIPduType = NORMAL
        ComIPduHandleId = 49
        ComIPduSignalProcessing = DEFERRED
        ComIPduCancellationSupport = false
        ComIPduGroupRef = BMC_HV_XIX_BMC_CAN01_Rx_7b388810
        ComIPduSignalRef = UI1_KompFehlerModus4_01_XIX_UI1_Komponentenfehler_02_XIX_BMC_CAN01_89a380c9_Rx
        ComIPduSignalRef = UI1_KompFehlerModus4_02_XIX_UI1_Komponentenfehler_02_XIX_BMC_CAN01_f7dbc86f_Rx
        ComIPduSignalRef = UI1_KompFehlerModus4_03_XIX_UI1_Komponentenfehler_02_XIX_BMC_CAN01_ddf3f00d_Rx
        ComIPduSignalRef = UI1_KompFehlerModus4_04_XIX_UI1_Komponentenfehler_02_XIX_BMC_CAN01_0b2b5923_Rx
        ComIPduSignalRef = UI1_KompFehlerModus4_05_XIX_UI1_Komponentenfehler_02_XIX_BMC_CAN01_21036141_Rx
        ComIPduSignalRef = UI1_KompFehlerModus4_06_XIX_UI1_Komponentenfehler_02_XIX_BMC_CAN01_5f7b29e7_Rx
        ComIPduSignalRef = UI1_KompFehlerModus4_07_XIX_UI1_Komponentenfehler_02_XIX_BMC_CAN01_75531185_Rx
        ComIPduSignalRef = UI1_KompFehlerModus4_08_XIX_UI1_Komponentenfehler_02_XIX_BMC_CAN01_29bb7dfa_Rx
        ComIPduSignalRef = UI1_KompFehlerModus4_09_XIX_UI1_Komponentenfehler_02_XIX_BMC_CAN01_03934598_Rx
        ComIPduSignalRef = UI1_KompFehlerModus4_10_XIX_UI1_Komponentenfehler_02_XIX_BMC_CAN01_001d90e7_Rx
        ComIPduSignalRef = UI1_KompFehlerModus4_11_XIX_UI1_Komponentenfehler_02_XIX_BMC_CAN01_2a35a885_Rx
        ComIPduSignalRef = UI1_KompFehlerModus4_12_XIX_UI1_Komponentenfehler_02_XIX_BMC_CAN01_544de023_Rx
        ComIPduSignalRef = UI1_KompFehlerModus4_13_XIX_UI1_Komponentenfehler_02_XIX_BMC_CAN01_7e65d841_Rx
        ComIPduSignalRef = UI1_KompFehlerModus4_14_XIX_UI1_Komponentenfehler_02_XIX_BMC_CAN01_a8bd716f_Rx
        ComIPduSignalRef = UI1_KompFehlerModus4_15_XIX_UI1_Komponentenfehler_02_XIX_BMC_CAN01_8295490d_Rx
        ComIPduSignalRef = UI1_KompFehlerModus4_16_XIX_UI1_Komponentenfehler_02_XIX_BMC_CAN01_fced01ab_Rx
        ComPduIdRef = UI1_Komponentenfehler_02_XIX_BMC_CAN01_19fb750e_Rx
        ComIPduMainFunctionRef = ComMainFunctionRx
      14 x ComSignal, all with ComSignalEndianness=LITTLE_ENDIAN, ComSignalAccess=ACCESS_UNCLEAR:
        UI1_KompFehlerModus2_16_XIX_UI1_Komponentenfehler_01_XIX_BMC_CAN01_41f756cd_Rx: ComBitPosition=42, ComBitSize=2, ComSignalInitValue=0, ComSignalType=UINT8, ComTimeout=1, ComHandleId=366, ComSystemTemplateSystemSignalRef=UI1_KompFehlerModus2_16
        BMC_CMC_Zellspannung_083_XIX_BMC_CMC_Zellspannung_03_XIX_HCP5_CANFD01_b9f0c335_Tx: ComBitPosition=60, ComBitSize=12, ComSignalDataInvalidValue=4095, ComSignalInitValue=4094, ComSignalType=UINT16, ComTransferProperty=PENDING, ComHandleId=194, ComSystemTemplateSystemSignalRef=BMC_CMC_Zellspannung_083
        NM_aktiv_SubbusSteuerung_BMC_HV_XIX_NMH_Hybrid_01_XIX_BMC_CAN01_c2e71061_Tx: ComBitPosition=12, ComBitSize=1, ComSignalInitValue=0, ComSignalType=UINT8, ComTransferProperty=TRIGGERED, ComHandleId=430, ComSystemTemplateSystemSignalRef=NM_aktiv_SubbusSteuerung_BMC_HV
        BMC_CMC_Temperatur_071_XIX_BMC_CMC_Temperatur_02_XIX_HCP5_CANFD01_2fd34b46_Tx: ComBitPosition=112, ComBitSize=8, ComSignalDataInvalidValue=255, ComSignalInitValue=254, ComSignalType=UINT8, ComTransferProperty=PENDING, ComHandleId=81, ComSystemTemplateSystemSignalRef=BMC_CMC_Temperatur_071
        BMC_CMC_Zellspannung_082_XIX_BMC_CMC_Zellspannung_03_XIX_HCP5_CANFD01_c63958a6_Tx: ComBitPosition=48, ComBitSize=12, ComSignalDataInvalidValue=4095, ComSignalInitValue=4094, ComSignalType=UINT16, ComTransferProperty=PENDING, ComHandleId=193, ComSystemTemplateSystemSignalRef=BMC_CMC_Zellspannung_082
        BMC_Pack_SN_15_XIX_BMC_HV_08_XIX_HCP5_CANFD01_9e4c6742_Tx: ComBitPosition=176, ComBitSize=8, ComSignalInitValue=255, ComSignalType=UINT8, ComTransferProperty=PENDING, ComHandleId=348, ComSystemTemplateSystemSignalRef=BMC_Pack_SN_15
        BMC_ThermSpreizung_XIX_BMC_HV_03_XIX_HCP5_CANFD01_fd3f685b_Tx: ComBitPosition=12, ComBitSize=4, ComSignalDataInvalidValue=15, ComSignalInitValue=14, ComSignalType=UINT8, ComTransferProperty=PENDING, ComHandleId=383, ComSystemTemplateSystemSignalRef=BMC_ThermSpreizung
        DCDC_NV_Komponentenfehler_67_XIX_DCDC_NV_Komponentenfehler_03_XIX_HCP5_CANFD01_af420e94_Rx: ComBitPosition=12, ComBitSize=2, ComSignalInitValue=0, ComSignalType=UINT8, ComTimeout=5, ComHandleId=128, ComSystemTemplateSystemSignalRef=DCDC_NV_Komponentenfehler_67
        DW_Kilometerstand_XIX_Diagnose_01_XIX_HCP5_CANFD01_78853316_Rx: ComBitPosition=8, ComBitSize=20, ComSignalDataInvalidValue=1048575, ComSignalInitValue=1048574, ComSignalType=UINT32, ComTimeout=5, ComHandleId=145, ComSystemTemplateSystemSignalRef=DW_Kilometerstand
        UI2_KompFehlerModus2_03_XIX_UI2_Komponentenfehler_01_XIX_BMC_CAN01_4e27ac6b_Rx: ComBitPosition=16, ComBitSize=2, ComSignalInitValue=0, ComSignalType=UINT8, ComTimeout=1, ComHandleId=447, ComSystemTemplateSystemSignalRef=UI2_KompFehlerModus2_03
        BMC_CMC_Zellspannung_190_XIX_BMC_CMC_Zellspannung_05_XIX_HCP5_CANFD01_631e34bc_Tx: ComBitPosition=408, ComBitSize=12, ComSignalDataInvalidValue=4095, ComSignalInitValue=4094, ComSignalType=UINT16, ComTransferProperty=PENDING, ComHandleId=301, ComSystemTemplateSystemSignalRef=BMC_CMC_Zellspannung_190
        DCDC_NV_Komponentenfehler_02_XIX_DCDC_NV_Komponentenfehler_01_XIX_HCP5_CANFD01_516a5a25_Rx: ComBitPosition=2, ComBitSize=2, ComSignalInitValue=0, ComSignalType=UINT8, ComTimeout=5, ComHandleId=63, ComSystemTemplateSystemSignalRef=DCDC_NV_Komponentenfehler_02
        DCDC_NV_Komponentenfehler_68_XIX_DCDC_NV_Komponentenfehler_03_XIX_HCP5_CANFD01_532b5d73_Rx: ComBitPosition=14, ComBitSize=2, ComSignalInitValue=0, ComSignalType=UINT8, ComTimeout=5, ComHandleId=129, ComSystemTemplateSystemSignalRef=DCDC_NV_Komponentenfehler_68
        BMC_CMC_Zellspannung_052_XIX_BMC_CMC_Zellspannung_02_XIX_HCP5_CANFD01_c3ad995d_Tx: ComBitPosition=156, ComBitSize=12, ComSignalDataInvalidValue=4095, ComSignalInitValue=4094, ComSignalType=UINT16, ComTransferProperty=PENDING, ComHandleId=163, ComSystemTemplateSystemSignalRef=BMC_CMC_Zellspannung_052
      SG_UI2_01_XIX_BMC_CAN01_2718ebf8_Rx (ComSignalGroup):
        ComTransferProperty = TRIGGERED_WITHOUT_REPETITION
        ComSignalGroupAccess = ACCESS_UNCLEAR
        ComHandleId = 13
        ComSystemTemplateSignalGroupRef = SG_UI2_01_XIX_BMC_CAN01
        7 x ComGroupSignal, all with ComSignalEndianness=LITTLE_ENDIAN, ComSignalAccess=ACCESS_UNCLEAR:
          ISignalVoid_UI2_01_XIX_BMC_CAN01_0_c6348327_Rx: ComBitPosition=40, ComBitSize=8, ComSignalType=UINT8, ComSignalInitValue=0, ComHandleId=310, ComSystemTemplateSystemSignalRef=SignalVoid_UI2_01_0
          UISensorPyro_01_BZ_XIX_UI2_01_XIX_BMC_CAN01_40400c5c_Rx: ComBitPosition=8, ComBitSize=4, ComSignalInitValue=0, ComSignalType=UINT8, ComHandleId=315, ComSystemTemplateSystemSignalRef=UISensorPyro_01_BZ
          UISensorPyro_01_CRC_XIX_UI2_01_XIX_BMC_CAN01_a3867378_Rx: ComBitPosition=0, ComBitSize=8, ComSignalInitValue=0, ComSignalType=UINT8, ComHandleId=316, ComSystemTemplateSystemSignalRef=UISensorPyro_01_CRC
          UI2_Strom_XIX_UI2_01_XIX_BMC_CAN01_192d5527_Rx: ComBitPosition=12, ComBitSize=20, ComSignalDataInvalidValue=1048575, ComSignalInitValue=1048574, ComSignalType=UINT32, ComHandleId=314, ComSystemTemplateSystemSignalRef=UI2_Strom
          ISignalVoid_UI2_01_XIX_BMC_CAN01_1_b133b3b1_Rx: ComBitPosition=48, ComBitSize=8, ComSignalType=UINT8, ComSignalInitValue=0, ComHandleId=311, ComSystemTemplateSystemSignalRef=SignalVoid_UI2_01_1
          UI2_KL30_Spannung_XIX_UI2_01_XIX_BMC_CAN01_f23a8ce5_Rx: ComBitPosition=32, ComBitSize=8, ComSignalDataInvalidValue=255, ComSignalInitValue=254, ComSignalType=UINT8, ComHandleId=313, ComSystemTemplateSystemSignalRef=UI2_KL30_Spannung
          ISignalVoid_UI2_01_XIX_BMC_CAN01_2_283ae20b_Rx: ComBitPosition=56, ComBitSize=8, ComSignalType=UINT8, ComSignalInitValue=0, ComHandleId=312, ComSystemTemplateSystemSignalRef=SignalVoid_UI2_01_2
      4 x ComSignal, all with ComSignalEndianness=LITTLE_ENDIAN, ComSignalType=UINT8, ComSignalAccess=ACCESS_UNCLEAR:
        BMC_Pack_SN_01_XIX_BMC_HV_08_XIX_HCP5_CANFD01_d934ed9b_Tx: ComBitPosition=64, ComBitSize=8, ComSignalInitValue=255, ComTransferProperty=PENDING, ComHandleId=334, ComSystemTemplateSystemSignalRef=BMC_Pack_SN_01
        DCDC_NV_Komponentenfehler_3_13_XIX_DCDC_NV_Komponentenfehler_04_XIX_HCP5_CANFD01_d8a3b52c_Rx: ComBitPosition=36, ComBitSize=3, ComSignalInitValue=0, ComTimeout=5, ComHandleId=58, ComSystemTemplateSystemSignalRef=DCDC_NV_Komponentenfehler_3_13
        UI2Sens02_CALID_Index_04_XIX_UI2Sens02_CALID_01_XIX_BMC_CAN01_7d85c6ac_Rx: ComBitPosition=24, ComBitSize=8, ComSignalInitValue=63, ComTimeout=5, ComHandleId=426, ComSystemTemplateSystemSignalRef=UI2Sens02_CALID_Index_04
        UI2Sens02_CALID_Index_16_XIX_UI2Sens02_CALID_02_XIX_BMC_CAN01_e2115af9_Rx: ComBitPosition=56, ComBitSize=8, ComSignalInitValue=63, ComTimeout=5, ComHandleId=438, ComSystemTemplateSystemSignalRef=UI2Sens02_CALID_Index_16
      OBG_01_XIX_HCP5_CANFD01_8fe2f1e9_Rx (ComIPdu):
        ComIPduDirection = RECEIVE
        ComIPduType = NORMAL
        ComIPduHandleId = 33
        ComIPduSignalProcessing = DEFERRED
        ComIPduCancellationSupport = false
        ComIPduGroupRef = BMC_HV_XIX_HCP5_CANFD01_Rx_6dfafc5f
        ComIPduGroupRef = BMC_HV_XIX_PNC_26_HighVoltage_Charging_Rx_765b82c2
        ComIPduSignalRef = HVLE_IstSpannung_HV_XIX_OBG_01_XIX_HCP5_CANFD01_577040d9_Rx
        ComIPduSignalRef = HVLE_OBG_IstModus_XIX_OBG_01_XIX_HCP5_CANFD01_6564feea_Rx
        ComPduIdRef = OBG_01_XIX_HCP5_CANFD01_8fe2f1e9_Rx
        ComIPduMainFunctionRef = ComMainFunctionRx
      4 x ComSignal, all with ComSignalEndianness=LITTLE_ENDIAN, ComSignalType=UINT16, ComSignalAccess=ACCESS_UNCLEAR:
        BMC_CMC_Zellspannung_045_XIX_BMC_CMC_Zellspannung_02_XIX_HCP5_CANFD01_0ed95680_Tx: ComBitPosition=72, ComBitSize=12, ComSignalDataInvalidValue=4095, ComSignalInitValue=4094, ComTransferProperty=PENDING, ComHandleId=156, ComSystemTemplateSystemSignalRef=BMC_CMC_Zellspannung_045
        BMC_CMC_Zellspannung_098_XIX_BMC_CMC_Zellspannung_03_XIX_HCP5_CANFD01_187db4ff_Tx: ComBitPosition=240, ComBitSize=12, ComSignalDataInvalidValue=4095, ComSignalInitValue=4094, ComTransferProperty=PENDING, ComHandleId=209, ComSystemTemplateSystemSignalRef=BMC_CMC_Zellspannung_098
        UI2_Stromintegral_Entladen_XIX_UI2_04_XIX_BMC_CAN01_f5109cf0_Rx: ComBitPosition=32, ComBitSize=16, ComSignalDataInvalidValue=65535, ComSignalInitValue=65534, ComTimeout=1, ComHandleId=488, ComSystemTemplateSystemSignalRef=UI2_Stromintegral_Entladen
        BMC_CMC_Zellspannung_041_XIX_BMC_CMC_Zellspannung_02_XIX_HCP5_CANFD01_2a8e3e8d_Tx: ComBitPosition=24, ComBitSize=12, ComSignalDataInvalidValue=4095, ComSignalInitValue=4094, ComTransferProperty=PENDING, ComHandleId=152, ComSystemTemplateSystemSignalRef=BMC_CMC_Zellspannung_041
      SG_BJB_11_XIX_BMC_CAN01_e2cc653e_Rx (ComSignalGroup):
        ComTransferProperty = TRIGGERED_WITHOUT_REPETITION
        ComSignalGroupAccess = ACCESS_NEEDED_BY_SWC_OR_COM
        ComHandleId = 1
        ComInvalidNotification = ComInvalidNotification_SG_BJB_11_XIX_BMC_CAN01_e2cc653e_Rx
        ComDataInvalidAction = NOTIFY
        ComSignalGroupArrayAccess = false
        ComSystemTemplateSignalGroupRef = SG_BJB_11_XIX_BMC_CAN01
        7 x ComGroupSignal, all with ComSignalEndianness=LITTLE_ENDIAN, ComSignalAccess=ACCESS_NEEDED_BY_SWC_OR_COM:
          BJB_Uebertemperaturzaehler_CMC01_XIX_BJB_11_XIX_BMC_CAN01_b2ff03fc_Rx: ComBitPosition=32, ComBitSize=16, ComSignalDataInvalidValue=65535, ComSignalInitValue=65534, ComSignalType=UINT16, ComHandleId=198, ComSystemTemplateSystemSignalRef=BJB_Uebertemperaturzaehler_CMC01
          BJB_11_CRC_XIX_BJB_11_XIX_BMC_CAN01_601d1500_Rx: ComBitPosition=0, ComBitSize=8, ComSignalInitValue=0, ComSignalType=UINT8, ComHandleId=194, ComSystemTemplateSystemSignalRef=BJB_11_CRC
          BJB_Sperrung_Ueberspannung_XIX_BJB_11_XIX_BMC_CAN01_4b1d8379_Rx: ComBitPosition=12, ComBitSize=2, ComSignalDataInvalidValue=3, ComSignalInitValue=2, ComSignalType=UINT8, ComHandleId=195, ComSystemTemplateSystemSignalRef=BJB_Sperrung_Ueberspannung
          BJB_Uebertemperaturzaehler_CMC02_XIX_BJB_11_XIX_BMC_CAN01_40a8ee04_Rx: ComBitPosition=48, ComBitSize=16, ComSignalDataInvalidValue=65535, ComSignalInitValue=65534, ComSignalType=UINT16, ComHandleId=199, ComSystemTemplateSystemSignalRef=BJB_Uebertemperaturzaehler_CMC02
          BJB_Ueberspannungszaehler_CMC02_XIX_BJB_11_XIX_BMC_CAN01_b38f86d8_Rx: ComBitPosition=23, ComBitSize=9, ComSignalDataInvalidValue=511, ComSignalInitValue=510, ComSignalType=UINT16, ComHandleId=197, ComSystemTemplateSystemSignalRef=BJB_Ueberspannungszaehler_CMC02
          BJB_Ueberspannungszaehler_CMC01_XIX_BJB_11_XIX_BMC_CAN01_41d86b20_Rx: ComBitPosition=14, ComBitSize=9, ComSignalDataInvalidValue=511, ComSignalInitValue=510, ComSignalType=UINT16, ComHandleId=196, ComSystemTemplateSystemSignalRef=BJB_Ueberspannungszaehler_CMC01
          BJB_11_BZ_XIX_BJB_11_XIX_BMC_CAN01_7cc923df_Rx: ComBitPosition=8, ComBitSize=4, ComSignalInitValue=0, ComSignalType=UINT8, ComHandleId=193, ComSystemTemplateSystemSignalRef=BJB_11_BZ
      UI2Sens02_CALID_02_XIX_BMC_CAN01_baaae1d1_Rx (ComIPdu):
        ComIPduDirection = RECEIVE
        ComIPduType = NORMAL
        ComIPduHandleId = 54
        ComIPduSignalProcessing = DEFERRED
        ComIPduCancellationSupport = false
        ComIPduGroupRef = BMC_HV_XIX_BMC_CAN01_Rx_7b388810
        ComIPduSignalRef = UI2Sens02_CALID_Index_09_XIX_UI2Sens02_CALID_02_XIX_BMC_CAN01_0da156ea_Rx
        ComIPduSignalRef = UI2Sens02_CALID_Index_10_XIX_UI2Sens02_CALID_02_XIX_BMC_CAN01_79c15a37_Rx
        ComIPduSignalRef = UI2Sens02_CALID_Index_11_XIX_UI2Sens02_CALID_02_XIX_BMC_CAN01_f449a7d5_Rx
        ComIPduSignalRef = UI2Sens02_CALID_Index_12_XIX_UI2Sens02_CALID_02_XIX_BMC_CAN01_b9a1a7b2_Rx
        ComIPduSignalRef = UI2Sens02_CALID_Index_13_XIX_UI2Sens02_CALID_02_XIX_BMC_CAN01_34295a50_Rx
        ComIPduSignalRef = UI2Sens02_CALID_Index_14_XIX_UI2Sens02_CALID_02_XIX_BMC_CAN01_2271a77c_Rx
        ComIPduSignalRef = UI2Sens02_CALID_Index_15_XIX_UI2Sens02_CALID_02_XIX_BMC_CAN01_aff95a9e_Rx
        ComIPduSignalRef = UI2Sens02_CALID_Index_16_XIX_UI2Sens02_CALID_02_XIX_BMC_CAN01_e2115af9_Rx
        ComPduIdRef = UI2Sens02_CALID_02_XIX_BMC_CAN01_baaae1d1_Rx
        ComIPduMainFunctionRef = ComMainFunctionRx
      UI2_KompFehlerModus2_06_XIX_UI2_Komponentenfehler_01_XIX_BMC_CAN01_ccaf7581_Rx (ComSignal):
        ComBitPosition = 22
        ComBitSize = 2
        ComSignalEndianness = LITTLE_ENDIAN
        ComSignalInitValue = 0
        ComSignalType = UINT8
        ComTimeout = 1
        ComSignalAccess = ACCESS_UNCLEAR
        ComHandleId = 450
        ComSystemTemplateSystemSignalRef = UI2_KompFehlerModus2_06
      BMC_HV_12_XIX_BMC_CAN01_E2E_5c19d7a0_Tx (ComIPdu):
        ComIPduDirection = SEND
        ComIPduType = NORMAL
        ComIPduHandleId = 19
        ComIPduSignalProcessing = DEFERRED
        ComIPduCancellationSupport = false
        ComIPduGroupRef = BMC_HV_XIX_BMC_CAN01_Tx_2d622f96
        ComIPduSignalGroupRef = SG_BMC_HV_12_XIX_BMC_CAN01_80cb66e3_Tx
        ComPduIdRef = BMC_HV_12_XIX_BMC_CAN01_E2E_5c19d7a0_Tx
        ComIPduMainFunctionRef = ComMainFunctionTx
        ComTxIPdu: ComTxIPduUnusedAreasDefault=0, ComMinimumDelayTime=0.3
          ComTxModeTrue
            ComTxMode: ComTxModeMode=PERIODIC, ComTxModeNumberOfRepetitions=0, ComTxModeRepetitionPeriod=0, ComTxModeTimePeriod=1, ComTxModeTimeOffset=0
          ComTxModeFalse
            ComTxMode: ComTxModeMode=NONE
      AB_Deaktivierung_HV_XIX_Airbag_10_XIX_HCP5_CANFD01_e8982158_Rx (ComSignal):
        ComBitPosition = 83
        ComBitSize = 3
        ComSignalDataInvalidValue = 7
        ComSignalEndianness = LITTLE_ENDIAN
        ComSignalInitValue = 0
        ComSignalType = UINT8
        ComTimeout = 0.5
        ComSignalAccess = ACCESS_UNCLEAR
        ComHandleId = 0
        ComSystemTemplateSystemSignalRef = AB_Deaktivierung_HV
      Hybrid_01_KompSchutz_XIX_KN_Hybrid_01_XIX_HCP5_CANFD01_b32281c3_Tx (ComSignal):
        ComBitPosition = 0
        ComBitSize = 1
        ComSignalEndianness = LITTLE_ENDIAN
        ComSignalInitValue = 0
        ComSignalType = UINT8
        ComTransferProperty = PENDING
        ComSignalAccess = ACCESS_UNCLEAR
        ComHandleId = 404
        ComSystemTemplateSystemSignalRef = Hybrid_01_KompSchutz
      BMC_HV_03_XIX_HCP5_CANFD01_0617c15c_Tx (ComIPdu):
        ComIPduDirection = SEND
        ComIPduType = NORMAL
        ComIPduHandleId = 10
        ComIPduSignalProcessing = DEFERRED
        ComIPduCancellationSupport = false
        ComIPduGroupRef = BMC_HV_XIX_HCP5_CANFD01_Tx_3ba05bd9
        ComIPduGroupRef = BMC_HV_XIX_PNC_26_HighVoltage_Charging_Tx_20012544
        ComIPduSignalRef = BMC_Abschaltankuendigung_XIX_BMC_HV_03_XIX_HCP5_CANFD01_971531f5_Tx
        ComIPduSignalRef = BMC_Bidi_GenutzteEnergie_XIX_BMC_HV_03_XIX_HCP5_CANFD01_71b918c9_Tx
        ComIPduSignalRef = BMC_Bidi_Max_SoC_XIX_BMC_HV_03_XIX_HCP5_CANFD01_efab2d0f_Tx
        ComIPduSignalRef = BMC_Bidi_Min_SoC_XIX_BMC_HV_03_XIX_HCP5_CANFD01_1b8c15d1_Tx
        ComIPduSignalRef = BMC_Bidi_Veto_Temp_XIX_BMC_HV_03_XIX_HCP5_CANFD01_1db44959_Tx
        ComIPduSignalRef = BMC_Dauer_Entladeleistung_XIX_BMC_HV_03_XIX_HCP5_CANFD01_eeda29b5_Tx
        ComIPduSignalRef = BMC_Dauer_Ladeleistung_XIX_BMC_HV_03_XIX_HCP5_CANFD01_680da831_Tx
        ComIPduSignalRef = BMC_Energie_Entladen_XIX_BMC_HV_03_XIX_HCP5_CANFD01_9fbaffd3_Tx
        ComIPduSignalRef = BMC_Energie_Laden_XIX_BMC_HV_03_XIX_HCP5_CANFD01_44ca086e_Tx
        ComIPduSignalRef = BMC_Konditionierung_Anf_XIX_BMC_HV_03_XIX_HCP5_CANFD01_f6c01bb8_Tx
        ComIPduSignalRef = BMC_MaxEnergieinhalt_XIX_BMC_HV_03_XIX_HCP5_CANFD01_bd0ef2f1_Tx
        ComIPduSignalRef = BMC_NutzbareKapazitaet_XIX_BMC_HV_03_XIX_HCP5_CANFD01_b7a047cf_Tx
        ComIPduSignalRef = BMC_RuecklaufTemperatur_XIX_BMC_HV_03_XIX_HCP5_CANFD01_73222ba7_Tx
        ComIPduSignalRef = BMC_Temperatur_XIX_BMC_HV_03_XIX_HCP5_CANFD01_eb74ed8d_Tx
        ComIPduSignalRef = BMC_ThermAuslastung_XIX_BMC_HV_03_XIX_HCP5_CANFD01_5abb920e_Tx
        ComIPduSignalRef = BMC_ThermSpreizung_XIX_BMC_HV_03_XIX_HCP5_CANFD01_fd3f685b_Tx
        ComIPduSignalRef = BMC_VerlustEnergie_XIX_BMC_HV_03_XIX_HCP5_CANFD01_c05628a7_Tx
        ComIPduSignalRef = BMC_VorlaufTemperatur_XIX_BMC_HV_03_XIX_HCP5_CANFD01_b115c7c1_Tx
        ComPduIdRef = BMC_HV_03_XIX_HCP5_CANFD01_0617c15c_Tx
        ComIPduMainFunctionRef = ComMainFunctionTx
        ComTxIPdu: ComTxIPduUnusedAreasDefault=0, ComMinimumDelayTime=0
          ComTxModeTrue
            ComTxMode: ComTxModeMode=PERIODIC, ComTxModeTimeOffset=0, ComTxModeTimePeriod=0.5
          ComTxModeFalse
            ComTxMode: ComTxModeMode=NONE
      DCDC_04_XIX_HCP5_CANFD01_8ca88b97_Rx (ComIPdu):
        ComIPduDirection = RECEIVE
        ComIPduType = NORMAL
        ComIPduHandleId = 12
        ComIPduSignalProcessing = DEFERRED
        ComIPduCancellationSupport = false
        ComIPduGroupRef = BMC_HV_XIX_HCP5_CANFD01_Rx_6dfafc5f
        ComIPduGroupRef = BMC_HV_XIX_PNC_26_HighVoltage_Charging_Rx_765b82c2
        ComIPduSignalRef = DC_IstLeistung_HV_XIX_DCDC_04_XIX_HCP5_CANFD01_7ce6573a_Rx
        ComPduIdRef = DCDC_04_XIX_HCP5_CANFD01_8ca88b97_Rx
        ComIPduMainFunctionRef = ComMainFunctionRx
      5 x ComSignal, all with ComSignalEndianness=LITTLE_ENDIAN, ComSignalAccess=ACCESS_UNCLEAR:
        BMC_Energie_Entladen_XIX_BMC_HV_03_XIX_HCP5_CANFD01_9fbaffd3_Tx: ComBitPosition=128, ComBitSize=16, ComSignalDataInvalidValue=65535, ComSignalInitValue=65534, ComSignalType=UINT16, ComTransferProperty=PENDING, ComHandleId=309, ComSystemTemplateSystemSignalRef=BMC_Energie_Entladen
        BMC_CMC_Zellspannung_123_XIX_BMC_CMC_Zellspannung_04_XIX_HCP5_CANFD01_4ab764ed_Tx: ComBitPosition=72, ComBitSize=12, ComSignalDataInvalidValue=4095, ComSignalInitValue=4094, ComSignalType=UINT16, ComTransferProperty=PENDING, ComHandleId=234, ComSystemTemplateSystemSignalRef=BMC_CMC_Zellspannung_123
        UH_Minute_XIX_Diagnose_01_XIX_HCP5_CANFD01_a1eb26ec_Rx: ComBitPosition=49, ComBitSize=6, ComSignalInitValue=0, ComSignalType=UINT8, ComTimeout=5, ComHandleId=343, ComSystemTemplateSystemSignalRef=UH_Minute
        BMC_CMC_Zellspannung_166_XIX_BMC_CMC_Zellspannung_05_XIX_HCP5_CANFD01_80ee0a47_Tx: ComBitPosition=120, ComBitSize=12, ComSignalDataInvalidValue=4095, ComSignalInitValue=4094, ComSignalType=UINT16, ComTransferProperty=PENDING, ComHandleId=277, ComSystemTemplateSystemSignalRef=BMC_CMC_Zellspannung_166
        BMC_CMC_Temperatur_016_XIX_BMC_CMC_Temperatur_01_XIX_HCP5_CANFD01_6c1bc220_Tx: ComBitPosition=136, ComBitSize=8, ComSignalDataInvalidValue=255, ComSignalInitValue=254, ComSignalType=UINT8, ComTransferProperty=PENDING, ComHandleId=26, ComSystemTemplateSystemSignalRef=BMC_CMC_Temperatur_016
      UI2_Komponentenfehler_01_XIX_BMC_CAN01_6c666489_Rx (ComIPdu):
        ComIPduDirection = RECEIVE
        ComIPduType = NORMAL
        ComIPduHandleId = 60
        ComIPduSignalProcessing = DEFERRED
        ComIPduCancellationSupport = false
        ComIPduGroupRef = BMC_HV_XIX_BMC_CAN01_Rx_7b388810
        ComIPduSignalRef = UI2_KompFehlerModus2_01_XIX_UI2_Komponentenfehler_01_XIX_BMC_CAN01_1a77dcaf_Rx
        ComIPduSignalRef = UI2_KompFehlerModus2_02_XIX_UI2_Komponentenfehler_01_XIX_BMC_CAN01_640f9409_Rx
        ComIPduSignalRef = UI2_KompFehlerModus2_03_XIX_UI2_Komponentenfehler_01_XIX_BMC_CAN01_4e27ac6b_Rx
        ComIPduSignalRef = UI2_KompFehlerModus2_04_XIX_UI2_Komponentenfehler_01_XIX_BMC_CAN01_98ff0545_Rx
        ComIPduSignalRef = UI2_KompFehlerModus2_05_XIX_UI2_Komponentenfehler_01_XIX_BMC_CAN01_b2d73d27_Rx
        ComIPduSignalRef = UI2_KompFehlerModus2_06_XIX_UI2_Komponentenfehler_01_XIX_BMC_CAN01_ccaf7581_Rx
        ComIPduSignalRef = UI2_KompFehlerModus2_07_XIX_UI2_Komponentenfehler_01_XIX_BMC_CAN01_e6874de3_Rx
        ComIPduSignalRef = UI2_KompFehlerModus2_08_XIX_UI2_Komponentenfehler_01_XIX_BMC_CAN01_ba6f219c_Rx
        ComIPduSignalRef = UI2_KompFehlerModus2_09_XIX_UI2_Komponentenfehler_01_XIX_BMC_CAN01_904719fe_Rx
        ComIPduSignalRef = UI2_KompFehlerModus2_10_XIX_UI2_Komponentenfehler_01_XIX_BMC_CAN01_93c9cc81_Rx
        ComIPduSignalRef = UI2_KompFehlerModus2_11_XIX_UI2_Komponentenfehler_01_XIX_BMC_CAN01_b9e1f4e3_Rx
        ComIPduSignalRef = UI2_KompFehlerModus2_12_XIX_UI2_Komponentenfehler_01_XIX_BMC_CAN01_c799bc45_Rx
        ComIPduSignalRef = UI2_KompFehlerModus2_13_XIX_UI2_Komponentenfehler_01_XIX_BMC_CAN01_edb18427_Rx
        ComIPduSignalRef = UI2_KompFehlerModus2_14_XIX_UI2_Komponentenfehler_01_XIX_BMC_CAN01_3b692d09_Rx
        ComIPduSignalRef = UI2_KompFehlerModus2_15_XIX_UI2_Komponentenfehler_01_XIX_BMC_CAN01_1141156b_Rx
        ComIPduSignalRef = UI2_KompFehlerModus2_16_XIX_UI2_Komponentenfehler_01_XIX_BMC_CAN01_6f395dcd_Rx
        ComIPduSignalRef = UI2_KompFehlerModus2_17_XIX_UI2_Komponentenfehler_01_XIX_BMC_CAN01_451165af_Rx
        ComIPduSignalRef = UI2_KompFehlerModus2_18_XIX_UI2_Komponentenfehler_01_XIX_BMC_CAN01_19f909d0_Rx
        ComIPduSignalRef = UI2_KompFehlerModus2_19_XIX_UI2_Komponentenfehler_01_XIX_BMC_CAN01_33d131b2_Rx
        ComIPduSignalRef = UI2_KompFehlerModus2_20_XIX_UI2_Komponentenfehler_01_XIX_BMC_CAN01_ac02b214_Rx
        ComIPduSignalRef = UI2_KompFehlerModus2_21_XIX_UI2_Komponentenfehler_01_XIX_BMC_CAN01_862a8a76_Rx
        ComIPduSignalRef = UI2_KompFehlerModus2_22_XIX_UI2_Komponentenfehler_01_XIX_BMC_CAN01_f852c2d0_Rx
        ComIPduSignalRef = UI2_KompFehlerModus2_23_XIX_UI2_Komponentenfehler_01_XIX_BMC_CAN01_d27afab2_Rx
        ComIPduSignalRef = UI2_KompFehlerModus2_24_XIX_UI2_Komponentenfehler_01_XIX_BMC_CAN01_04a2539c_Rx
        ComIPduSignalRef = UI2_KompFehlerModus2_25_XIX_UI2_Komponentenfehler_01_XIX_BMC_CAN01_2e8a6bfe_Rx
        ComIPduSignalRef = UI2_KompFehlerModus2_26_XIX_UI2_Komponentenfehler_01_XIX_BMC_CAN01_50f22358_Rx
        ComPduIdRef = UI2_Komponentenfehler_01_XIX_BMC_CAN01_6c666489_Rx
        ComIPduMainFunctionRef = ComMainFunctionRx
      22 x ComSignal, all with ComSignalEndianness=LITTLE_ENDIAN, ComSignalAccess=ACCESS_UNCLEAR:
        UI1_Stromintegral_Entladen_XIX_UI1_04_XIX_BMC_CAN01_550f36e6_Rx: ComBitPosition=48, ComBitSize=16, ComSignalDataInvalidValue=65535, ComSignalInitValue=65534, ComSignalType=UINT16, ComTimeout=1, ComHandleId=397, ComSystemTemplateSystemSignalRef=UI1_Stromintegral_Entladen
        UI2Sens01_CALID_Index_11_XIX_UI2Sens01_CALID_02_XIX_BMC_CAN01_2f3ede3e_Rx: ComBitPosition=16, ComBitSize=8, ComSignalInitValue=63, ComSignalType=UINT8, ComTimeout=5, ComHandleId=411, ComSystemTemplateSystemSignalRef=UI2Sens01_CALID_Index_11
        BMC_CMC_Zellspannung_120_XIX_BMC_CMC_Zellspannung_04_XIX_HCP5_CANFD01_caedc858_Tx: ComBitPosition=36, ComBitSize=12, ComSignalDataInvalidValue=4095, ComSignalInitValue=4094, ComSignalType=UINT16, ComTransferProperty=PENDING, ComHandleId=231, ComSystemTemplateSystemSignalRef=BMC_CMC_Zellspannung_120
        PCM_BMC_VTD_LifeTimeReset_Resp_XIX_HCP1_17_XIX_HCP5_CANFD01_37f0f42a_Rx: ComBitPosition=38, ComBitSize=2, ComSignalDataInvalidValue=3, ComSignalInitValue=2, ComSignalType=UINT8, ComTimeout=5, ComHandleId=181, ComSystemTemplateSystemSignalRef=PCM_BMC_VTD_LifeTimeReset_Resp
        BMC_CMC_Zellspannung_078_XIX_BMC_CMC_Zellspannung_02_XIX_HCP5_CANFD01_a66268ab_Tx: ComBitPosition=468, ComBitSize=12, ComSignalDataInvalidValue=4095, ComSignalInitValue=4094, ComSignalType=UINT16, ComTransferProperty=PENDING, ComHandleId=189, ComSystemTemplateSystemSignalRef=BMC_CMC_Zellspannung_078
        DCDC_NV_Komponentenfehler_19_XIX_DCDC_NV_Komponentenfehler_01_XIX_HCP5_CANFD01_5ad63701_Rx: ComBitPosition=36, ComBitSize=2, ComSignalInitValue=0, ComSignalType=UINT8, ComTimeout=5, ComHandleId=80, ComSystemTemplateSystemSignalRef=DCDC_NV_Komponentenfehler_19
        UI1_KompFehlerModus2_15_XIX_UI1_Komponentenfehler_01_XIX_BMC_CAN01_3f8f1e6b_Rx: ComBitPosition=40, ComBitSize=2, ComSignalInitValue=0, ComSignalType=UINT8, ComTimeout=1, ComHandleId=365, ComSystemTemplateSystemSignalRef=UI1_KompFehlerModus2_15
        BMC_CMC_Zellspannung_109_XIX_BMC_CMC_Zellspannung_03_XIX_HCP5_CANFD01_ce569f7f_Tx: ComBitPosition=372, ComBitSize=12, ComSignalDataInvalidValue=4095, ComSignalInitValue=4094, ComSignalType=UINT16, ComTransferProperty=PENDING, ComHandleId=220, ComSystemTemplateSystemSignalRef=BMC_CMC_Zellspannung_109
        VIN_15_XIX_WFS_02_XIX_HCP5_CANFD01_b921557a_Rx: ComBitPosition=128, ComBitSize=8, ComSignalInitValue=45, ComSignalType=UINT8, ComTimeout=4, ComHandleId=507, ComSystemTemplateSystemSignalRef=VIN_15
        BMC_CMC_Zellspannung_101_XIX_BMC_CMC_Zellspannung_03_XIX_HCP5_CANFD01_86f84f65_Tx: ComBitPosition=276, ComBitSize=12, ComSignalDataInvalidValue=4095, ComSignalInitValue=4094, ComSignalType=UINT16, ComTransferProperty=PENDING, ComHandleId=212, ComSystemTemplateSystemSignalRef=BMC_CMC_Zellspannung_101
        BMC_CMC_Zellspannung_03_Messzeit_XIX_BMC_CMC_Zellspannung_03_XIX_HCP5_CANFD01_e433a100_Tx: ComBitPosition=480, ComBitSize=8, ComSignalDataInvalidValue=255, ComSignalInitValue=254, ComSignalType=UINT8, ComTransferProperty=PENDING, ComHandleId=109, ComSystemTemplateSystemSignalRef=BMC_CMC_Zellspannung_03_Messzeit
        DCDC_NV_Komponentenfehler_3_14_XIX_DCDC_NV_Komponentenfehler_04_XIX_HCP5_CANFD01_c3886516_Rx: ComBitPosition=39, ComBitSize=3, ComSignalInitValue=0, ComSignalType=UINT8, ComTimeout=5, ComHandleId=59, ComSystemTemplateSystemSignalRef=DCDC_NV_Komponentenfehler_3_14
        UI2_KompFehlerModus2_18_XIX_UI2_Komponentenfehler_01_XIX_BMC_CAN01_19f909d0_Rx: ComBitPosition=46, ComBitSize=2, ComSignalInitValue=0, ComSignalType=UINT8, ComTimeout=1, ComHandleId=462, ComSystemTemplateSystemSignalRef=UI2_KompFehlerModus2_18
        VIN_13_XIX_WFS_02_XIX_HCP5_CANFD01_284085e3_Rx: ComBitPosition=112, ComBitSize=8, ComSignalInitValue=45, ComSignalType=UINT8, ComTimeout=4, ComHandleId=505, ComSystemTemplateSystemSignalRef=VIN_13
        DCDC_NV_Komponentenfehler_3_5_XIX_DCDC_NV_Komponentenfehler_04_XIX_HCP5_CANFD01_d35bf4ea_Rx: ComBitPosition=12, ComBitSize=3, ComSignalInitValue=0, ComSignalType=UINT8, ComTimeout=5, ComHandleId=50, ComSystemTemplateSystemSignalRef=DCDC_NV_Komponentenfehler_3_5
        UI2Sens02_CALID_Index_11_XIX_UI2Sens02_CALID_02_XIX_BMC_CAN01_f449a7d5_Rx: ComBitPosition=16, ComBitSize=8, ComSignalInitValue=63, ComSignalType=UINT8, ComTimeout=5, ComHandleId=433, ComSystemTemplateSystemSignalRef=UI2Sens02_CALID_Index_11
        BMC_CMC_Zellspannung_176_XIX_BMC_CMC_Zellspannung_05_XIX_HCP5_CANFD01_e9970122_Tx: ComBitPosition=240, ComBitSize=12, ComSignalDataInvalidValue=4095, ComSignalInitValue=4094, ComSignalType=UINT16, ComTransferProperty=PENDING, ComHandleId=287, ComSystemTemplateSystemSignalRef=BMC_CMC_Zellspannung_176
        DCDC_NV_Komponentenfehler_69_XIX_DCDC_NV_Komponentenfehler_03_XIX_HCP5_CANFD01_9915aee0_Rx: ComBitPosition=16, ComBitSize=2, ComSignalInitValue=0, ComSignalType=UINT8, ComTimeout=5, ComHandleId=130, ComSystemTemplateSystemSignalRef=DCDC_NV_Komponentenfehler_69
        BMC_CMC_Temperatur_009_XIX_BMC_CMC_Temperatur_01_XIX_HCP5_CANFD01_93658613_Tx: ComBitPosition=80, ComBitSize=8, ComSignalDataInvalidValue=255, ComSignalInitValue=254, ComSignalType=UINT8, ComTransferProperty=PENDING, ComHandleId=19, ComSystemTemplateSystemSignalRef=BMC_CMC_Temperatur_009
        BMC_CMC_Zellspannung_010_XIX_BMC_CMC_Zellspannung_01_XIX_HCP5_CANFD01_a82d58cc_Tx: ComBitPosition=120, ComBitSize=12, ComSignalDataInvalidValue=4095, ComSignalInitValue=4094, ComSignalType=UINT16, ComTransferProperty=PENDING, ComHandleId=121, ComSystemTemplateSystemSignalRef=BMC_CMC_Zellspannung_010
        BMC_CMC_Zellspannung_063_XIX_BMC_CMC_Zellspannung_02_XIX_HCP5_CANFD01_07ef1f61_Tx: ComBitPosition=288, ComBitSize=12, ComSignalDataInvalidValue=4095, ComSignalInitValue=4094, ComSignalType=UINT16, ComTransferProperty=PENDING, ComHandleId=174, ComSystemTemplateSystemSignalRef=BMC_CMC_Zellspannung_063
        BMC_CMC_Zellspannung_060_XIX_BMC_CMC_Zellspannung_02_XIX_HCP5_CANFD01_87b5b3d4_Tx: ComBitPosition=252, ComBitSize=12, ComSignalDataInvalidValue=4095, ComSignalInitValue=4094, ComSignalType=UINT16, ComTransferProperty=PENDING, ComHandleId=171, ComSystemTemplateSystemSignalRef=BMC_CMC_Zellspannung_060
      SG_BMC_HV_01_XIX_HCP5_CANFD01_efd99d38_Tx (ComSignalGroup):
        ComTransferProperty = TRIGGERED_WITHOUT_REPETITION
        ComSignalGroupAccess = ACCESS_UNCLEAR
        ComHandleId = 0
        ComSystemTemplateSignalGroupRef = SG_BMC_HV_01_XIX_HCP5_CANFD01
        17 x ComGroupSignal, all with ComSignalEndianness=LITTLE_ENDIAN, ComSignalAccess=ACCESS_UNCLEAR, ComTransferProperty=PENDING:
          BMC_Strom_02_XIX_BMC_HV_01_XIX_HCP5_CANFD01_f306148f_Tx: ComBitPosition=104, ComBitSize=17, ComSignalDataInvalidValue=131071, ComSignalInitValue=131070, ComSignalType=UINT32, ComHandleId=446, ComSystemTemplateSystemSignalRef=BMC_Strom_02
          BMC_HVK_Fehler_HVIL_XIX_BMC_HV_01_XIX_HCP5_CANFD01_a073e875_Tx: ComBitPosition=54, ComBitSize=2, ComSignalDataInvalidValue=2, ComSignalInitValue=3, ComSignalType=UINT8, ComHandleId=435, ComSystemTemplateSystemSignalRef=BMC_HVK_Fehler_HVIL
          BMC_Spannung_Messzeit_XIX_BMC_HV_01_XIX_HCP5_CANFD01_e49c7918_Tx: ComBitPosition=96, ComBitSize=8, ComSignalDataInvalidValue=255, ComSignalInitValue=254, ComSignalType=UINT8, ComHandleId=441, ComSystemTemplateSystemSignalRef=BMC_Spannung_Messzeit
          BMC_Spannung_ZwischenKreis_XIX_BMC_HV_01_XIX_HCP5_CANFD01_69be15b1_Tx: ComBitPosition=40, ComBitSize=14, ComSignalDataInvalidValue=16383, ComSignalInitValue=16382, ComSignalType=UINT16, ComHandleId=444, ComSystemTemplateSystemSignalRef=BMC_Spannung_ZwischenKreis
          BMC_Strom_Messzeit_XIX_BMC_HV_01_XIX_HCP5_CANFD01_13ff988a_Tx: ComBitPosition=88, ComBitSize=8, ComSignalDataInvalidValue=255, ComSignalInitValue=254, ComSignalType=UINT8, ComHandleId=447, ComSystemTemplateSystemSignalRef=BMC_Strom_Messzeit
          BMC_Strom_XIX_BMC_HV_01_XIX_HCP5_CANFD01_96bfb491_Tx: ComBitPosition=56, ComBitSize=16, ComSignalDataInvalidValue=65535, ComSignalInitValue=65534, ComSignalType=UINT16, ComHandleId=448, ComSystemTemplateSystemSignalRef=BMC_Strom
          BMC_Modus_XIX_BMC_HV_01_XIX_HCP5_CANFD01_51805a50_Tx: ComBitPosition=32, ComBitSize=4, ComSignalInitValue=15, ComSignalType=UINT8, ComHandleId=440, ComSystemTemplateSystemSignalRef=BMC_Modus
          ISignalVoid_BMC_HV_01_XIX_HCP5_CANFD01_0_844e11d9_Tx: ComBitPosition=121, ComBitSize=7, ComSignalType=UINT8, ComSignalInitValue=0, ComHandleId=449, ComSystemTemplateSystemSignalRef=SignalVoid_BMC_HV_01_0
          BMC_Bankstatus_XIX_BMC_HV_01_XIX_HCP5_CANFD01_0b765180_Tx: ComBitPosition=12, ComBitSize=4, ComSignalDataInvalidValue=15, ComSignalInitValue=14, ComSignalType=UINT8, ComHandleId=433, ComSystemTemplateSystemSignalRef=BMC_Bankstatus
          BMC_Spannung_XIX_BMC_HV_01_XIX_HCP5_CANFD01_49e05688_Tx: ComBitPosition=16, ComBitSize=14, ComSignalDataInvalidValue=16383, ComSignalInitValue=16382, ComSignalType=UINT16, ComHandleId=442, ComSystemTemplateSystemSignalRef=BMC_Spannung
          BMC_Status_Spgfreiheit_XIX_BMC_HV_01_XIX_HCP5_CANFD01_cc0d64c0_Tx: ComBitPosition=86, ComBitSize=2, ComSignalInitValue=0, ComSignalType=UINT8, ComHandleId=445, ComSystemTemplateSystemSignalRef=BMC_Status_Spgfreiheit
          BMC_HVK_Fehler_SD_XIX_BMC_HV_01_XIX_HCP5_CANFD01_da1d4b3c_Tx: ComBitPosition=38, ComBitSize=2, ComSignalDataInvalidValue=2, ComSignalInitValue=3, ComSignalType=UINT8, ComHandleId=437, ComSystemTemplateSystemSignalRef=BMC_HVK_Fehler_SD
          BMC_Spannung_ZwischenKreis_2_XIX_BMC_HV_01_XIX_HCP5_CANFD01_5762ebd7_Tx: ComBitPosition=72, ComBitSize=14, ComSignalDataInvalidValue=16383, ComSignalInitValue=16382, ComSignalType=UINT16, ComHandleId=443, ComSystemTemplateSystemSignalRef=BMC_Spannung_ZwischenKreis_2
          BMC_HVK_EoHVL_Status_XIX_BMC_HV_01_XIX_HCP5_CANFD01_f332fab3_Tx: ComBitPosition=30, ComBitSize=2, ComSignalDataInvalidValue=3, ComSignalInitValue=0, ComSignalType=UINT8, ComHandleId=434, ComSystemTemplateSystemSignalRef=BMC_HVK_EoHVL_Status
          BMC_HV_01_BZ_XIX_BMC_HV_01_XIX_HCP5_CANFD01_3a361f22_Tx: ComBitPosition=8, ComBitSize=4, ComSignalInitValue=0, ComSignalType=UINT8, ComHandleId=438, ComSystemTemplateSystemSignalRef=BMC_HV_01_BZ
          BMC_HV_01_CRC_XIX_BMC_HV_01_XIX_HCP5_CANFD01_403c41f5_Tx: ComBitPosition=0, ComBitSize=8, ComSignalInitValue=0, ComSignalType=UINT8, ComHandleId=439, ComSystemTemplateSystemSignalRef=BMC_HV_01_CRC
          BMC_HVK_Fehler_Intern_XIX_BMC_HV_01_XIX_HCP5_CANFD01_ed40d4a6_Tx: ComBitPosition=36, ComBitSize=2, ComSignalDataInvalidValue=2, ComSignalInitValue=3, ComSignalType=UINT8, ComHandleId=436, ComSystemTemplateSystemSignalRef=BMC_HVK_Fehler_Intern
      SG_BMC_HV_11_XIX_BMC_CAN01_91b60c9a_Tx (ComSignalGroup):
        ComTransferProperty = TRIGGERED_WITHOUT_REPETITION
        ComSignalGroupAccess = ACCESS_NEEDED_BY_SWC_OR_COM
        ComHandleId = 4
        ComSystemTemplateSignalGroupRef = SG_BMC_HV_11_XIX_BMC_CAN01
        7 x ComGroupSignal, all with ComSignalEndianness=LITTLE_ENDIAN, ComSignalAccess=ACCESS_NEEDED_BY_SWC_OR_COM, ComTransferProperty=PENDING:
          BMC_Uebertemperaturzaehler_CMC02_XIX_BMC_HV_11_XIX_BMC_CAN01_a5b098ba_Tx: ComBitPosition=48, ComBitSize=16, ComSignalDataInvalidValue=65535, ComSignalInitValue=65534, ComSignalType=UINT16, ComHandleId=527, ComSystemTemplateSystemSignalRef=BMC_Uebertemperaturzaehler_CMC02
          BMC_Sperrung_Ueberspannung_XIX_BMC_HV_11_XIX_BMC_CAN01_d725cad5_Tx: ComBitPosition=12, ComBitSize=2, ComSignalDataInvalidValue=3, ComSignalInitValue=2, ComSignalType=UINT8, ComHandleId=523, ComSystemTemplateSystemSignalRef=BMC_Sperrung_Ueberspannung
          BMC_HV_11_BZ_XIX_BMC_HV_11_XIX_BMC_CAN01_7bce27cc_Tx: ComBitPosition=8, ComBitSize=4, ComSignalInitValue=0, ComSignalType=UINT8, ComHandleId=521, ComSystemTemplateSystemSignalRef=BMC_HV_11_BZ
          BMC_HV_11_CRC_XIX_BMC_HV_11_XIX_BMC_CAN01_935e4ef5_Tx: ComBitPosition=0, ComBitSize=8, ComSignalInitValue=0, ComSignalType=UINT8, ComHandleId=522, ComSystemTemplateSystemSignalRef=BMC_HV_11_CRC
          BMC_Ueberspannungszaehler_CMC01_XIX_BMC_HV_11_XIX_BMC_CAN01_34d9816c_Tx: ComBitPosition=14, ComBitSize=9, ComSignalDataInvalidValue=511, ComSignalInitValue=510, ComSignalType=UINT16, ComHandleId=524, ComSystemTemplateSystemSignalRef=BMC_Ueberspannungszaehler_CMC01
          BMC_Ueberspannungszaehler_CMC02_XIX_BMC_HV_11_XIX_BMC_CAN01_91d1ea00_Tx: ComBitPosition=23, ComBitSize=9, ComSignalDataInvalidValue=511, ComSignalInitValue=510, ComSignalType=UINT16, ComHandleId=525, ComSystemTemplateSystemSignalRef=BMC_Ueberspannungszaehler_CMC02
          BMC_Uebertemperaturzaehler_CMC01_XIX_BMC_HV_11_XIX_BMC_CAN01_00b8f3d6_Tx: ComBitPosition=32, ComBitSize=16, ComSignalDataInvalidValue=65535, ComSignalInitValue=65534, ComSignalType=UINT16, ComHandleId=526, ComSystemTemplateSystemSignalRef=BMC_Uebertemperaturzaehler_CMC01
      4 x ComSignal, all with ComSignalEndianness=LITTLE_ENDIAN, ComSignalAccess=ACCESS_UNCLEAR:
        BMC_CMC_Zellspannung_002_XIX_BMC_CMC_Zellspannung_01_XIX_HCP5_CANFD01_3ec7648f_Tx: ComBitPosition=24, ComBitSize=12, ComSignalDataInvalidValue=4095, ComSignalInitValue=4094, ComSignalType=UINT16, ComTransferProperty=PENDING, ComHandleId=113, ComSystemTemplateSystemSignalRef=BMC_CMC_Zellspannung_002
        BMC_CMC_Zellspannung_096_XIX_BMC_CMC_Zellspannung_03_XIX_HCP5_CANFD01_8b173bce_Tx: ComBitPosition=216, ComBitSize=12, ComSignalDataInvalidValue=4095, ComSignalInitValue=4094, ComSignalType=UINT16, ComTransferProperty=PENDING, ComHandleId=207, ComSystemTemplateSystemSignalRef=BMC_CMC_Zellspannung_096
        BMC_Temperatur_hoechste_XIX_BMC_HV_07_XIX_HCP5_CANFD01_70360ca3_Tx: ComBitPosition=12, ComBitSize=10, ComSignalDataInvalidValue=1023, ComSignalInitValue=1022, ComSignalType=UINT16, ComTransferProperty=PENDING, ComHandleId=380, ComSystemTemplateSystemSignalRef=BMC_Temperatur_hoechste
        DCDC_NV_CALID_Index_13_XIX_DCDC_NV_CALID_XIX_HCP5_CANFD01_fe375cf6_Rx: ComBitPosition=96, ComBitSize=8, ComSignalInitValue=63, ComSignalType=UINT8, ComTimeout=5, ComHandleId=37, ComSystemTemplateSystemSignalRef=DCDC_NV_CALID_Index_13
      VDSO_05_XIX_HCP5_CANFD01_48366f26_Rx (ComIPdu):
        ComIPduDirection = RECEIVE
        ComIPduType = NORMAL
        ComIPduHandleId = 62
        ComIPduSignalProcessing = DEFERRED
        ComIPduCancellationSupport = false
        ComIPduGroupRef = BMC_HV_XIX_HCP5_CANFD01_Rx_6dfafc5f
        ComIPduGroupRef = BMC_HV_XIX_PNC_11_Chassis_Rx_1f7dfb2f
        ComIPduSignalRef = VDSO_Vx3d_XIX_VDSO_05_XIX_HCP5_CANFD01_16f2eb37_Rx
        ComPduIdRef = VDSO_05_XIX_HCP5_CANFD01_48366f26_Rx
        ComIPduMainFunctionRef = ComMainFunctionRx
      6 x ComSignal, all with ComSignalEndianness=LITTLE_ENDIAN, ComTransferProperty=PENDING, ComSignalAccess=ACCESS_UNCLEAR:
        BMC_CMC_Zellspannung_067_XIX_BMC_CMC_Zellspannung_02_XIX_HCP5_CANFD01_23b8776c_Tx: ComBitPosition=336, ComBitSize=12, ComSignalDataInvalidValue=4095, ComSignalInitValue=4094, ComSignalType=UINT16, ComHandleId=178, ComSystemTemplateSystemSignalRef=BMC_CMC_Zellspannung_067
        BMC_CMC_Zellspannung_031_XIX_BMC_CMC_Zellspannung_01_XIX_HCP5_CANFD01_0516d595_Tx: ComBitPosition=372, ComBitSize=12, ComSignalDataInvalidValue=4095, ComSignalInitValue=4094, ComSignalType=UINT16, ComHandleId=142, ComSystemTemplateSystemSignalRef=BMC_CMC_Zellspannung_031
        BMC_CMC_Zellspannung_168_XIX_BMC_CMC_Zellspannung_05_XIX_HCP5_CANFD01_13848576_Tx: ComBitPosition=144, ComBitSize=12, ComSignalDataInvalidValue=4095, ComSignalInitValue=4094, ComSignalType=UINT16, ComHandleId=279, ComSystemTemplateSystemSignalRef=BMC_CMC_Zellspannung_168
        BMC_RtmWarnSocSprung_XIX_BMC_HV_08_XIX_HCP5_CANFD01_4f634010_Tx: ComBitPosition=37, ComBitSize=3, ComSignalInitValue=0, ComSignalType=UINT8, ComHandleId=368, ComSystemTemplateSystemSignalRef=BMC_RtmWarnSocSprung
        BMC_CMC_Zellspannung_021_XIX_BMC_CMC_Zellspannung_01_XIX_HCP5_CANFD01_6c6fdef0_Tx: ComBitPosition=252, ComBitSize=12, ComSignalDataInvalidValue=4095, ComSignalInitValue=4094, ComSignalType=UINT16, ComHandleId=132, ComSystemTemplateSystemSignalRef=BMC_CMC_Zellspannung_021
        BMC_CMC_Zellspannung_103_XIX_BMC_CMC_Zellspannung_03_XIX_HCP5_CANFD01_796b7843_Tx: ComBitPosition=300, ComBitSize=12, ComSignalDataInvalidValue=4095, ComSignalInitValue=4094, ComSignalType=UINT16, ComHandleId=214, ComSystemTemplateSystemSignalRef=BMC_CMC_Zellspannung_103
      ORU_Control_A_01_XIX_HCP5_CANFD01_E2E_3007747a_Rx (ComIPdu):
        ComIPduDirection = RECEIVE
        ComIPduType = NORMAL
        ComIPduHandleId = 35
        ComIPduSignalProcessing = DEFERRED
        ComIPduCancellationSupport = false
        ComIPduGroupRef = BMC_HV_XIX_HCP5_CANFD01_Rx_6dfafc5f
        ComIPduGroupRef = BMC_HV_XIX_PNC_07_Basefunction_CrossSection_Rx_4fb7c882
        ComIPduSignalGroupRef = SG_ORU_Control_A_01_XIX_HCP5_CANFD01_a8e78b2d_Rx
        ComPduIdRef = ORU_Control_A_01_XIX_HCP5_CANFD01_E2E_3007747a_Rx
        ComIPduMainFunctionRef = ComMainFunctionRx
      4 x ComSignal, all with ComSignalEndianness=LITTLE_ENDIAN, ComSignalAccess=ACCESS_UNCLEAR:
        BMC_CMC_Zellspannung_080_XIX_BMC_CMC_Zellspannung_03_XIX_HCP5_CANFD01_39aa6f80_Tx: ComBitPosition=24, ComBitSize=12, ComSignalDataInvalidValue=4095, ComSignalInitValue=4094, ComSignalType=UINT16, ComTransferProperty=PENDING, ComHandleId=191, ComSystemTemplateSystemSignalRef=BMC_CMC_Zellspannung_080
        BMC_CMC_Zellspannung_165_XIX_BMC_CMC_Zellspannung_05_XIX_HCP5_CANFD01_00b4a6f2_Tx: ComBitPosition=108, ComBitSize=12, ComSignalDataInvalidValue=4095, ComSignalInitValue=4094, ComSignalType=UINT16, ComTransferProperty=PENDING, ComHandleId=276, ComSystemTemplateSystemSignalRef=BMC_CMC_Zellspannung_165
        BMC_CMC_Zellspannung_162_XIX_BMC_CMC_Zellspannung_05_XIX_HCP5_CANFD01_a4b9624a_Tx: ComBitPosition=72, ComBitSize=12, ComSignalDataInvalidValue=4095, ComSignalInitValue=4094, ComSignalType=UINT16, ComTransferProperty=PENDING, ComHandleId=273, ComSystemTemplateSystemSignalRef=BMC_CMC_Zellspannung_162
        UI2_KompFehlerModus2_10_XIX_UI2_Komponentenfehler_01_XIX_BMC_CAN01_93c9cc81_Rx: ComBitPosition=30, ComBitSize=2, ComSignalInitValue=0, ComSignalType=UINT8, ComTimeout=1, ComHandleId=454, ComSystemTemplateSystemSignalRef=UI2_KompFehlerModus2_10
      UI1_03_XIX_BMC_CAN01_4277cadb_Rx (ComIPdu):
        ComIPduDirection = RECEIVE
        ComIPduType = NORMAL
        ComIPduHandleId = 45
        ComIPduSignalProcessing = DEFERRED
        ComIPduCancellationSupport = false
        ComIPduGroupRef = BMC_HV_XIX_BMC_CAN01_Rx_7b388810
        ComIPduSignalRef = UI1_Spannung4_XIX_UI1_03_XIX_BMC_CAN01_25f2e1ca_Rx
        ComIPduSignalRef = UI1_Spannung5_XIX_UI1_03_XIX_BMC_CAN01_c2ef475d_Rx
        ComIPduSignalRef = UI1_Spannung6_XIX_UI1_03_XIX_BMC_CAN01_30b8aaa5_Rx
        ComPduIdRef = UI1_03_XIX_BMC_CAN01_4277cadb_Rx
        ComIPduMainFunctionRef = ComMainFunctionRx
      30 x ComSignal, all with ComSignalEndianness=LITTLE_ENDIAN, ComSignalAccess=ACCESS_UNCLEAR:
        DCDC_NV_Komponentenfehler_80_XIX_DCDC_NV_Komponentenfehler_03_XIX_HCP5_CANFD01_e3373c2b_Rx: ComBitPosition=38, ComBitSize=2, ComSignalInitValue=0, ComSignalType=UINT8, ComTimeout=5, ComHandleId=141, ComSystemTemplateSystemSignalRef=DCDC_NV_Komponentenfehler_80
        BMC_CMC_Temperatur_092_XIX_BMC_CMC_Temperatur_03_XIX_HCP5_CANFD01_dd89198c_Tx: ComBitPosition=168, ComBitSize=8, ComSignalDataInvalidValue=255, ComSignalInitValue=254, ComSignalType=UINT8, ComTransferProperty=PENDING, ComHandleId=102, ComSystemTemplateSystemSignalRef=BMC_CMC_Temperatur_092
        BMC_PCM_VTD_LifeTimeReset_Req_XIX_BMC_HV_14_XIX_HCP5_CANFD01_85186af1_Tx: ComBitPosition=72, ComBitSize=2, ComSignalDataInvalidValue=3, ComSignalInitValue=2, ComSignalType=UINT8, ComTransferProperty=PENDING, ComHandleId=331, ComSystemTemplateSystemSignalRef=BMC_PCM_VTD_LifeTimeReset_Req
        OBD_QBit_Aussen_Temp_XIX_OBD_04_XIX_HCP5_CANFD01_2cf7f3a2_Rx: ComBitPosition=27, ComBitSize=1, ComSignalInitValue=1, ComSignalType=UINT8, ComTimeout=3.2, ComHandleId=171, ComSystemTemplateSystemSignalRef=OBD_QBit_Aussen_Temp
        BMC_CMC_Zellspannung_055_XIX_BMC_CMC_Zellspannung_02_XIX_HCP5_CANFD01_67a05de5_Tx: ComBitPosition=192, ComBitSize=12, ComSignalDataInvalidValue=4095, ComSignalInitValue=4094, ComSignalType=UINT16, ComTransferProperty=PENDING, ComHandleId=166, ComSystemTemplateSystemSignalRef=BMC_CMC_Zellspannung_055
        BMC_CMC_Zellspannung_118_XIX_BMC_CMC_Zellspannung_04_XIX_HCP5_CANFD01_39c805ed_Tx: ComBitPosition=12, ComBitSize=12, ComSignalDataInvalidValue=4095, ComSignalInitValue=4094, ComSignalType=UINT16, ComTransferProperty=PENDING, ComHandleId=229, ComSystemTemplateSystemSignalRef=BMC_CMC_Zellspannung_118
        Hybrid_01_SNI_10_XIX_KN_Hybrid_01_XIX_HCP5_CANFD01_ea872ae4_Tx: ComBitPosition=8, ComBitSize=10, ComSignalInitValue=123, ComSignalType=UINT16, ComTransferProperty=PENDING, ComHandleId=406, ComSystemTemplateSystemSignalRef=Hybrid_01_SNI_10
        UI2_KompFehlerModus4_09_XIX_UI2_Komponentenfehler_02_XIX_BMC_CAN01_2d5d4e98_Rx: ComBitPosition=36, ComBitSize=3, ComSignalInitValue=0, ComSignalType=UINT8, ComTimeout=1, ComHandleId=479, ComSystemTemplateSystemSignalRef=UI2_KompFehlerModus4_09
        BMC_CMC_Zellspannung_093_XIX_BMC_CMC_Zellspannung_03_XIX_HCP5_CANFD01_d089c850_Tx: ComBitPosition=180, ComBitSize=12, ComSignalDataInvalidValue=4095, ComSignalInitValue=4094, ComSignalType=UINT16, ComTransferProperty=PENDING, ComHandleId=204, ComSystemTemplateSystemSignalRef=BMC_CMC_Zellspannung_093
        BMC_CMC_Temperatur_059_XIX_BMC_CMC_Temperatur_02_XIX_HCP5_CANFD01_39bed8ce_Tx: ComBitPosition=16, ComBitSize=8, ComSignalDataInvalidValue=255, ComSignalInitValue=254, ComSignalType=UINT8, ComTransferProperty=PENDING, ComHandleId=69, ComSystemTemplateSystemSignalRef=BMC_CMC_Temperatur_059
        BMC_CMC_Zellspannung_159_XIX_BMC_CMC_Zellspannung_05_XIX_HCP5_CANFD01_d7c6034a_Tx: ComBitPosition=36, ComBitSize=12, ComSignalDataInvalidValue=4095, ComSignalInitValue=4094, ComSignalType=UINT16, ComTransferProperty=PENDING, ComHandleId=270, ComSystemTemplateSystemSignalRef=BMC_CMC_Zellspannung_159
        BMC_CMC_Zellspannung_151_XIX_BMC_CMC_Zellspannung_04_XIX_HCP5_CANFD01_703a65b1_Tx: ComBitPosition=408, ComBitSize=12, ComSignalDataInvalidValue=4095, ComSignalInitValue=4094, ComSignalType=UINT16, ComTransferProperty=PENDING, ComHandleId=262, ComSystemTemplateSystemSignalRef=BMC_CMC_Zellspannung_151
        DCDC_NV_Komponentenfehler_42_XIX_DCDC_NV_Komponentenfehler_02_XIX_HCP5_CANFD01_c7ae7132_Rx: ComBitPosition=24, ComBitSize=2, ComSignalInitValue=0, ComSignalType=UINT8, ComTimeout=5, ComHandleId=103, ComSystemTemplateSystemSignalRef=DCDC_NV_Komponentenfehler_42
        OBD_Driving_Cycle_XIX_OBD_03_XIX_HCP5_CANFD01_88844414_Rx: ComBitPosition=61, ComBitSize=1, ComSignalInitValue=0, ComSignalType=UINT8, ComTimeout=3.2, ComHandleId=164, ComSystemTemplateSystemSignalRef=OBD_Driving_Cycle
        SI_NWDF_30_XIX_Systeminfo_01_XIX_HCP5_CANFD01_b3e489e1_Rx: ComBitPosition=31, ComBitSize=1, ComSignalInitValue=0, ComSignalType=UINT8, ComTimeout=5, ComHandleId=333, ComSystemTemplateSystemSignalRef=SI_NWDF_30
        BMC_CMC_Zellspannung_070_XIX_BMC_CMC_Zellspannung_02_XIX_HCP5_CANFD01_eeccb8b1_Tx: ComBitPosition=372, ComBitSize=12, ComSignalDataInvalidValue=4095, ComSignalInitValue=4094, ComSignalType=UINT16, ComTransferProperty=PENDING, ComHandleId=181, ComSystemTemplateSystemSignalRef=BMC_CMC_Zellspannung_070
        BJB_CALID_Index_08_XIX_BJB_CALID_01_XIX_BMC_CAN01_06294f09_Rx: ComBitPosition=56, ComBitSize=8, ComSignalInitValue=63, ComSignalType=UINT8, ComTimeout=5, ComHandleId=8, ComSystemTemplateSystemSignalRef=BJB_CALID_Index_08
        UI2Sens02_CVN_VLD_XIX_UI2Sens02_CVN_XIX_BMC_CAN01_16e7de9a_Rx: ComBitPosition=0, ComBitSize=1, ComSignalInitValue=0, ComSignalType=UINT8, ComTimeout=5, ComHandleId=443, ComSystemTemplateSystemSignalRef=UI2Sens02_CVN_VLD
        BMC_CMC_Temperatur_079_XIX_BMC_CMC_Temperatur_03_XIX_HCP5_CANFD01_4ab138f6_Tx: ComBitPosition=64, ComBitSize=8, ComSignalDataInvalidValue=255, ComSignalInitValue=254, ComSignalType=UINT8, ComTransferProperty=PENDING, ComHandleId=89, ComSystemTemplateSystemSignalRef=BMC_CMC_Temperatur_079
        BMC_CMC_Zellspannung_175_XIX_BMC_CMC_Zellspannung_05_XIX_HCP5_CANFD01_69cdad97_Tx: ComBitPosition=228, ComBitSize=12, ComSignalDataInvalidValue=4095, ComSignalInitValue=4094, ComSignalType=UINT16, ComTransferProperty=PENDING, ComHandleId=286, ComSystemTemplateSystemSignalRef=BMC_CMC_Zellspannung_175
        UI2Sens02_CALID_Index_09_XIX_UI2Sens02_CALID_02_XIX_BMC_CAN01_0da156ea_Rx: ComBitPosition=0, ComBitSize=8, ComSignalInitValue=63, ComSignalType=UINT8, ComTimeout=5, ComHandleId=431, ComSystemTemplateSystemSignalRef=UI2Sens02_CALID_Index_09
        BMC_Pack_SN_19_XIX_BMC_HV_08_XIX_HCP5_CANFD01_0cd2493c_Tx: ComBitPosition=208, ComBitSize=8, ComSignalInitValue=255, ComSignalType=UINT8, ComTransferProperty=PENDING, ComHandleId=352, ComSystemTemplateSystemSignalRef=BMC_Pack_SN_19
        BMC_Pack_SN_26_XIX_BMC_HV_08_XIX_HCP5_CANFD01_0c44dee8_Tx: ComBitPosition=264, ComBitSize=8, ComSignalInitValue=255, ComSignalType=UINT8, ComTransferProperty=PENDING, ComHandleId=359, ComSystemTemplateSystemSignalRef=BMC_Pack_SN_26
        BMC_CMC_Temperatur_063_XIX_BMC_CMC_Temperatur_02_XIX_HCP5_CANFD01_d81513ce_Tx: ComBitPosition=48, ComBitSize=8, ComSignalDataInvalidValue=255, ComSignalInitValue=254, ComSignalType=UINT8, ComTransferProperty=PENDING, ComHandleId=73, ComSystemTemplateSystemSignalRef=BMC_CMC_Temperatur_063
        BMC_CMC_Zellspannung_157_XIX_BMC_CMC_Zellspannung_05_XIX_HCP5_CANFD01_44ac8c7b_Tx: ComBitPosition=12, ComBitSize=12, ComSignalDataInvalidValue=4095, ComSignalInitValue=4094, ComSignalType=UINT16, ComTransferProperty=PENDING, ComHandleId=268, ComSystemTemplateSystemSignalRef=BMC_CMC_Zellspannung_157
        BMC_CMC_Temperatur_026_XIX_BMC_CMC_Temperatur_01_XIX_HCP5_CANFD01_53d0bcb5_Tx: ComBitPosition=216, ComBitSize=8, ComSignalDataInvalidValue=255, ComSignalInitValue=254, ComSignalType=UINT8, ComTransferProperty=PENDING, ComHandleId=36, ComSystemTemplateSystemSignalRef=BMC_CMC_Temperatur_026
        BMC_RtmWarnUeberstrom_XIX_BMC_HV_08_XIX_HCP5_CANFD01_e0808499_Tx: ComBitPosition=22, ComBitSize=3, ComSignalInitValue=0, ComSignalType=UINT8, ComTransferProperty=PENDING, ComHandleId=376, ComSystemTemplateSystemSignalRef=BMC_RtmWarnUeberstrom
        UI1_Temperatur_1_XIX_UI1_04_XIX_BMC_CAN01_ee4849f8_Rx: ComBitPosition=24, ComBitSize=8, ComSignalDataInvalidValue=255, ComSignalInitValue=254, ComSignalType=UINT8, ComTimeout=1, ComHandleId=399, ComSystemTemplateSystemSignalRef=UI1_Temperatur_1
        DCDC_NV_Komponentenfehler_75_XIX_DCDC_NV_Komponentenfehler_03_XIX_HCP5_CANFD01_898213fe_Rx: ComBitPosition=28, ComBitSize=2, ComSignalInitValue=0, ComSignalType=UINT8, ComTimeout=5, ComHandleId=136, ComSystemTemplateSystemSignalRef=DCDC_NV_Komponentenfehler_75
        DCDC_NV_Komponentenfehler_43_XIX_DCDC_NV_Komponentenfehler_02_XIX_HCP5_CANFD01_0d9082a1_Rx: ComBitPosition=26, ComBitSize=2, ComSignalInitValue=0, ComSignalType=UINT8, ComTimeout=5, ComHandleId=104, ComSystemTemplateSystemSignalRef=DCDC_NV_Komponentenfehler_43
      BMC_HV_XIX_PNC_26_HighVoltage_Charging_Rx_765b82c2 (ComIPduGroup): ComIPduGroupHandleId=12
      9 x ComSignal, all with ComSignalEndianness=LITTLE_ENDIAN, ComSignalAccess=ACCESS_UNCLEAR:
        BMC_CMC_Temperatur_083_XIX_BMC_CMC_Temperatur_03_XIX_HCP5_CANFD01_543709a2_Tx: ComBitPosition=96, ComBitSize=8, ComSignalDataInvalidValue=255, ComSignalInitValue=254, ComSignalType=UINT8, ComTransferProperty=PENDING, ComHandleId=93, ComSystemTemplateSystemSignalRef=BMC_CMC_Temperatur_083
        BMC_CMC_Zellspannung_129_XIX_BMC_CMC_Zellspannung_04_XIX_HCP5_CANFD01_fd8a83d1_Tx: ComBitPosition=144, ComBitSize=12, ComSignalDataInvalidValue=4095, ComSignalInitValue=4094, ComSignalType=UINT16, ComTransferProperty=PENDING, ComHandleId=240, ComSystemTemplateSystemSignalRef=BMC_CMC_Zellspannung_129
        UH_Monat_XIX_Diagnose_01_XIX_HCP5_CANFD01_f93e0419_Rx: ComBitPosition=35, ComBitSize=4, ComSignalDataInvalidValue=15, ComSignalInitValue=0, ComSignalType=UINT8, ComTimeout=5, ComHandleId=344, ComSystemTemplateSystemSignalRef=UH_Monat
        BJB_CVN_VLD_XIX_BJB_CVN_01_XIX_BMC_CAN01_7412dbc7_Rx: ComBitPosition=0, ComBitSize=1, ComSignalInitValue=0, ComSignalType=UINT8, ComTimeout=5, ComHandleId=21, ComSystemTemplateSystemSignalRef=BJB_CVN_VLD
        BMC_CMC_Zellspannung_062_XIX_BMC_CMC_Zellspannung_02_XIX_HCP5_CANFD01_782684f2_Tx: ComBitPosition=276, ComBitSize=12, ComSignalDataInvalidValue=4095, ComSignalInitValue=4094, ComSignalType=UINT16, ComTransferProperty=PENDING, ComHandleId=173, ComSystemTemplateSystemSignalRef=BMC_CMC_Zellspannung_062
        BMC_CMC_Zellspannung_102_XIX_BMC_CMC_Zellspannung_03_XIX_HCP5_CANFD01_06a2e3d0_Tx: ComBitPosition=288, ComBitSize=12, ComSignalDataInvalidValue=4095, ComSignalInitValue=4094, ComSignalType=UINT16, ComTransferProperty=PENDING, ComHandleId=213, ComSystemTemplateSystemSignalRef=BMC_CMC_Zellspannung_102
        ZM_HV_Auszeit_Status_XIX_ZeitMaster_01_XIX_HCP5_CANFD01_de3b0265_Rx: ComBitPosition=38, ComBitSize=2, ComSignalInitValue=0, ComSignalType=UINT8, ComTimeout=5, ComHandleId=511, ComSystemTemplateSystemSignalRef=ZM_HV_Auszeit_Status
        UI2_KompFehlerModus4_16_XIX_UI2_Komponentenfehler_02_XIX_BMC_CAN01_d2230aab_Rx: ComBitPosition=57, ComBitSize=3, ComSignalInitValue=0, ComSignalType=UINT8, ComTimeout=1, ComHandleId=486, ComSystemTemplateSystemSignalRef=UI2_KompFehlerModus4_16
        DS_Hybrid_01_StMemChanged_XIX_DS_Hybrid_01_XIX_HCP5_CANFD01_c527befd_Tx: ComBitPosition=19, ComBitSize=1, ComSignalInitValue=0, ComSignalType=UINT8, ComTransferProperty=TRIGGERED_ON_CHANGE_WITHOUT_REPETITION, ComHandleId=397, ComSystemTemplateSystemSignalRef=DS_Hybrid_01_StMemChanged
      BMC_HV_XIX_PNC_26_HighVoltage_Charging_Tx_20012544 (ComIPduGroup): ComIPduGroupHandleId=13
      6 x ComSignal, all with ComSignalAccess=ACCESS_UNCLEAR:
        BMC_CMC_Zellspannung_003_XIX_BMC_CMC_Zellspannung_01_XIX_HCP5_CANFD01_410eff1c_Tx: ComBitPosition=36, ComBitSize=12, ComSignalDataInvalidValue=4095, ComSignalEndianness=LITTLE_ENDIAN, ComSignalInitValue=4094, ComSignalType=UINT16, ComTransferProperty=PENDING, ComHandleId=114, ComSystemTemplateSystemSignalRef=BMC_CMC_Zellspannung_003
        BMC_CMC_Temperatur_005_XIX_BMC_CMC_Temperatur_01_XIX_HCP5_CANFD01_b1f5a2ca_Tx: ComBitPosition=48, ComBitSize=8, ComSignalDataInvalidValue=255, ComSignalEndianness=LITTLE_ENDIAN, ComSignalInitValue=254, ComSignalType=UINT8, ComTransferProperty=PENDING, ComHandleId=15, ComSystemTemplateSystemSignalRef=BMC_CMC_Temperatur_005
        BMC_CMC_Temperatur_077_XIX_BMC_CMC_Temperatur_03_XIX_HCP5_CANFD01_3c716ceb_Tx: ComBitPosition=48, ComBitSize=8, ComSignalDataInvalidValue=255, ComSignalEndianness=LITTLE_ENDIAN, ComSignalInitValue=254, ComSignalType=UINT8, ComTransferProperty=PENDING, ComHandleId=87, ComSystemTemplateSystemSignalRef=BMC_CMC_Temperatur_077
        NM_Hybrid_01_CAB_V12_XIX_NMH_Hybrid_01_XIX_BMC_CAN01_6448e8c9_Tx: ComBitPosition=24, ComSignalEndianness=opaque, ComSignalInitValue=0 0 0, ComSignalLength=3, ComSignalType=UINT8_N, ComTransferProperty=TRIGGERED, ComHandleId=412, ComSystemTemplateSystemSignalRef=NM_Hybrid_01_CAB_V12
        BMC_RtmWarnPackUeberladen_XIX_BMC_HV_08_XIX_HCP5_CANFD01_cef699a9_Tx: ComBitPosition=28, ComBitSize=3, ComSignalEndianness=LITTLE_ENDIAN, ComSignalInitValue=0, ComSignalType=UINT8, ComTransferProperty=PENDING, ComHandleId=365, ComSystemTemplateSystemSignalRef=BMC_RtmWarnPackUeberladen
        UI1_KompFehlerModus4_01_XIX_UI1_Komponentenfehler_02_XIX_BMC_CAN01_89a380c9_Rx: ComBitPosition=12, ComBitSize=3, ComSignalEndianness=LITTLE_ENDIAN, ComSignalInitValue=0, ComSignalType=UINT8, ComTimeout=1, ComHandleId=377, ComSystemTemplateSystemSignalRef=UI1_KompFehlerModus4_01
      UI2_02_XIX_BMC_CAN01_E2E_54e6a136_Rx (ComIPdu):
        ComIPduDirection = RECEIVE
        ComIPduType = NORMAL
        ComIPduHandleId = 57
        ComIPduSignalProcessing = DEFERRED
        ComIPduCancellationSupport = false
        ComIPduGroupRef = BMC_HV_XIX_BMC_CAN01_Rx_7b388810
        ComIPduSignalGroupRef = SG_UI2_02_XIX_BMC_CAN01_36658181_Rx
        ComPduIdRef = UI2_02_XIX_BMC_CAN01_E2E_54e6a136_Rx
        ComIPduMainFunctionRef = ComMainFunctionRx
      4 x ComSignal, all with ComSignalEndianness=LITTLE_ENDIAN, ComSignalAccess=ACCESS_UNCLEAR:
        BMC_KundenWarnung_XIX_BMC_HV_06_XIX_HCP5_CANFD01_8664a2d8_Tx: ComBitPosition=32, ComBitSize=2, ComSignalInitValue=0, ComSignalType=UINT8, ComTransferProperty=TRIGGERED_ON_CHANGE_WITHOUT_REPETITION, ComHandleId=321, ComSystemTemplateSystemSignalRef=BMC_KundenWarnung
        DCDC_NV_Komponentenfehler_01_XIX_DCDC_NV_Komponentenfehler_01_XIX_HCP5_CANFD01_d45848d1_Rx: ComBitPosition=0, ComBitSize=2, ComSignalInitValue=0, ComSignalType=UINT8, ComTimeout=5, ComHandleId=62, ComSystemTemplateSystemSignalRef=DCDC_NV_Komponentenfehler_01
        BMC_CMC_Zellspannung_064_XIX_BMC_CMC_Zellspannung_02_XIX_HCP5_CANFD01_a3e2dbd9_Tx: ComBitPosition=300, ComBitSize=12, ComSignalDataInvalidValue=4095, ComSignalInitValue=4094, ComSignalType=UINT16, ComTransferProperty=PENDING, ComHandleId=175, ComSystemTemplateSystemSignalRef=BMC_CMC_Zellspannung_064
        BMC_CMC_Temperatur_049_XIX_BMC_CMC_Temperatur_01_XIX_HCP5_CANFD01_70ae2de0_Tx: ComBitPosition=400, ComBitSize=8, ComSignalDataInvalidValue=255, ComSignalInitValue=254, ComSignalType=UINT8, ComTransferProperty=PENDING, ComHandleId=59, ComSystemTemplateSystemSignalRef=BMC_CMC_Temperatur_049
      SG_BJB_12_XIX_BMC_CAN01_f3b10f47_Rx (ComSignalGroup):
        ComTransferProperty = TRIGGERED_WITHOUT_REPETITION
        ComSignalGroupAccess = ACCESS_NEEDED_BY_SWC_OR_COM
        ComHandleId = 2
        ComSystemTemplateSignalGroupRef = SG_BJB_12_XIX_BMC_CAN01
        7 x ComGroupSignal, all with ComSignalEndianness=LITTLE_ENDIAN, ComSignalAccess=ACCESS_UNCLEAR:
          BJB_Uebertemperaturzaehler_CMC04_XIX_BJB_12_XIX_BMC_CAN01_6e0b59cc_Rx: ComBitPosition=48, ComBitSize=16, ComSignalDataInvalidValue=65535, ComSignalInitValue=65534, ComSignalType=UINT16, ComHandleId=206, ComSystemTemplateSystemSignalRef=BJB_Uebertemperaturzaehler_CMC04
          BJB_Ueberspannungszaehler_CMC04_XIX_BJB_12_XIX_BMC_CAN01_9d2c3110_Rx: ComBitPosition=23, ComBitSize=9, ComSignalDataInvalidValue=511, ComSignalInitValue=510, ComSignalType=UINT16, ComHandleId=204, ComSystemTemplateSystemSignalRef=BJB_Ueberspannungszaehler_CMC04
          BJB_12_BZ_XIX_BJB_12_XIX_BMC_CAN01_c8bc22ca_Rx: ComBitPosition=8, ComBitSize=4, ComSignalInitValue=0, ComSignalType=UINT8, ComHandleId=200, ComSystemTemplateSystemSignalRef=BJB_12_BZ
          BJB_Ueberspannungszaehler_CMC03_XIX_BJB_12_XIX_BMC_CAN01_45ef4a36_Rx: ComBitPosition=14, ComBitSize=9, ComSignalDataInvalidValue=511, ComSignalInitValue=510, ComSignalType=UINT16, ComHandleId=203, ComSystemTemplateSystemSignalRef=BJB_Ueberspannungszaehler_CMC03
          BJB_Uebertemperaturzaehler_CMC03_XIX_BJB_12_XIX_BMC_CAN01_b6c822ea_Rx: ComBitPosition=32, ComBitSize=16, ComSignalDataInvalidValue=65535, ComSignalInitValue=65534, ComSignalType=UINT16, ComHandleId=205, ComSystemTemplateSystemSignalRef=BJB_Uebertemperaturzaehler_CMC03
          BJB_Sperrung_Uebertemperatur_XIX_BJB_12_XIX_BMC_CAN01_7c0d3e2e_Rx: ComBitPosition=12, ComBitSize=2, ComSignalDataInvalidValue=3, ComSignalInitValue=2, ComSignalType=UINT8, ComHandleId=202, ComSystemTemplateSystemSignalRef=BJB_Sperrung_Uebertemperatur
          BJB_12_CRC_XIX_BJB_12_XIX_BMC_CAN01_35c15a61_Rx: ComBitPosition=0, ComBitSize=8, ComSignalInitValue=0, ComSignalType=UINT8, ComHandleId=201, ComSystemTemplateSystemSignalRef=BJB_12_CRC
      3 x ComSignal, all with ComSignalAccess=ACCESS_UNCLEAR:
        DCDC_NV_CVN_Byte_2_XIX_DCDC_NV_CVN_XIX_HCP5_CANFD01_9b7f0fc7_Rx: ComBitPosition=9, ComBitSize=8, ComSignalEndianness=LITTLE_ENDIAN, ComSignalInitValue=0, ComSignalType=UINT8, ComTimeout=5, ComHandleId=42, ComSystemTemplateSystemSignalRef=DCDC_NV_CVN_Byte_2
        NM_Hybrid_01_Wakeup_V12_XIX_NM_Hybrid_01_XIX_HCP5_CANFD01_450fdf96_Tx: ComBitPosition=144, ComBitSize=8, ComSignalEndianness=LITTLE_ENDIAN, ComSignalInitValue=0, ComSignalType=UINT8, ComTransferProperty=TRIGGERED, ComHandleId=427, ComSystemTemplateSystemSignalRef=NM_Hybrid_01_Wakeup_V12
        SOK_Zeit_Hybrid_01_Zeit_XIX_SOK_Zeit_Hybrid_01_Resp_01_XIX_HCP5_CANFD01_41d20ae9_Rx: ComBitPosition=0, ComSignalEndianness=opaque, ComSignalLength=7, ComSignalType=UINT8_N, ComSignalInitValue=0 0 0 0 0 0 0, ComHandleId=338, ComSystemTemplateSystemSignalRef=SOK_Zeit_Hybrid_01_Zeit
      ClampControl_01_XIX_HCP5_CANFD01_8c24343b_Rx (ComIPdu):
        ComIPduDirection = RECEIVE
        ComIPduType = NORMAL
        ComIPduHandleId = 10
        ComIPduSignalProcessing = DEFERRED
        ComIPduCancellationSupport = false
        ComIPduGroupRef = BMC_HV_XIX_HCP5_CANFD01_Rx_6dfafc5f
        ComIPduGroupRef = BMC_HV_XIX_PNC_06_Basefunction_ComfortLight_Rx_7861a7a5
        ComIPduSignalRef = KST_KL_15_XIX_ClampControl_01_XIX_HCP5_CANFD01_06301fa5_Rx
        ComPduIdRef = ClampControl_01_XIX_HCP5_CANFD01_8c24343b_Rx
        ComIPduMainFunctionRef = ComMainFunctionRx
      13 x ComSignal, all with ComSignalEndianness=LITTLE_ENDIAN, ComSignalAccess=ACCESS_UNCLEAR:
        BMC_CMC_Zellspannung_150_XIX_BMC_CMC_Zellspannung_04_XIX_HCP5_CANFD01_0ff3fe22_Tx: ComBitPosition=396, ComBitSize=12, ComSignalDataInvalidValue=4095, ComSignalInitValue=4094, ComSignalType=UINT16, ComTransferProperty=PENDING, ComHandleId=261, ComSystemTemplateSystemSignalRef=BMC_CMC_Zellspannung_150
        UI1_KompFehlerModus4_05_XIX_UI1_Komponentenfehler_02_XIX_BMC_CAN01_21036141_Rx: ComBitPosition=24, ComBitSize=3, ComSignalInitValue=0, ComSignalType=UINT8, ComTimeout=1, ComHandleId=381, ComSystemTemplateSystemSignalRef=UI1_KompFehlerModus4_05
        BMC_CMC_Zellspannung_047_XIX_BMC_CMC_Zellspannung_02_XIX_HCP5_CANFD01_f14a61a6_Tx: ComBitPosition=96, ComBitSize=12, ComSignalDataInvalidValue=4095, ComSignalInitValue=4094, ComSignalType=UINT16, ComTransferProperty=PENDING, ComHandleId=158, ComSystemTemplateSystemSignalRef=BMC_CMC_Zellspannung_047
        BMC_Pack_SN_06_XIX_BMC_HV_08_XIX_HCP5_CANFD01_61a1ff0e_Tx: ComBitPosition=104, ComBitSize=8, ComSignalInitValue=255, ComSignalType=UINT8, ComTransferProperty=PENDING, ComHandleId=339, ComSystemTemplateSystemSignalRef=BMC_Pack_SN_06
        DCDC_NV_Komponentenfehler_77_XIX_DCDC_NV_Komponentenfehler_03_XIX_HCP5_CANFD01_c68ef299_Rx: ComBitPosition=32, ComBitSize=2, ComSignalInitValue=0, ComSignalType=UINT8, ComTimeout=5, ComHandleId=138, ComSystemTemplateSystemSignalRef=DCDC_NV_Komponentenfehler_77
        BJB_CALID_Index_02_XIX_BJB_CALID_01_XIX_BMC_CAN01_ddf87648_Rx: ComBitPosition=8, ComBitSize=8, ComSignalInitValue=63, ComSignalType=UINT8, ComTimeout=5, ComHandleId=2, ComSystemTemplateSystemSignalRef=BJB_CALID_Index_02
        UI1_KompFehlerModus4_09_XIX_UI1_Komponentenfehler_02_XIX_BMC_CAN01_03934598_Rx: ComBitPosition=36, ComBitSize=3, ComSignalInitValue=0, ComSignalType=UINT8, ComTimeout=1, ComHandleId=385, ComSystemTemplateSystemSignalRef=UI1_KompFehlerModus4_09
        UI2_KompFehlerModus4_03_XIX_UI2_Komponentenfehler_02_XIX_BMC_CAN01_f33dfb0d_Rx: ComBitPosition=18, ComBitSize=3, ComSignalInitValue=0, ComSignalType=UINT8, ComTimeout=1, ComHandleId=473, ComSystemTemplateSystemSignalRef=UI2_KompFehlerModus4_03
        VIN_11_XIX_WFS_02_XIX_HCP5_CANFD01_ee4f37ab_Rx: ComBitPosition=96, ComBitSize=8, ComSignalInitValue=45, ComSignalType=UINT8, ComTimeout=4, ComHandleId=503, ComSystemTemplateSystemSignalRef=VIN_11
        UI2Sens01_CALID_Index_14_XIX_UI2Sens01_CALID_02_XIX_BMC_CAN01_f906de97_Rx: ComBitPosition=40, ComBitSize=8, ComSignalInitValue=63, ComSignalType=UINT8, ComTimeout=5, ComHandleId=414, ComSystemTemplateSystemSignalRef=UI2Sens01_CALID_Index_14
        BMC_Pack_SN_24_XIX_BMC_HV_08_XIX_HCP5_CANFD01_3481d3fd_Tx: ComBitPosition=248, ComBitSize=8, ComSignalInitValue=255, ComSignalType=UINT8, ComTransferProperty=PENDING, ComHandleId=357, ComSystemTemplateSystemSignalRef=BMC_Pack_SN_24
        BMC_CMC_Zellspannung_094_XIX_BMC_CMC_Zellspannung_03_XIX_HCP5_CANFD01_74840ce8_Tx: ComBitPosition=192, ComBitSize=12, ComSignalDataInvalidValue=4095, ComSignalInitValue=4094, ComSignalType=UINT16, ComTransferProperty=PENDING, ComHandleId=205, ComSystemTemplateSystemSignalRef=BMC_CMC_Zellspannung_094
        OBD_NumDcyMilOnReq_XIX_OBD_04_XIX_HCP5_CANFD01_fc3c8d9d_Rx: ComBitPosition=28, ComBitSize=8, ComSignalInitValue=0, ComSignalType=UINT8, ComTimeout=3.2, ComHandleId=170, ComSystemTemplateSystemSignalRef=OBD_NumDcyMilOnReq
      SG_KS_Hybrid_01_Response_K_XIX_HCP5_CANFD01_adb36dae_Tx (ComSignalGroup):
        ComTimeout = 0
        ComTransferProperty = TRIGGERED_WITHOUT_REPETITION
        ComSignalGroupAccess = ACCESS_UNCLEAR
        ComHandleId = 9
        ComSystemTemplateSignalGroupRef = SG_KS_Hybrid_01_Response_K_XIX_HCP5_CANFD01
        3 x ComGroupSignal, all with ComSignalAccess=ACCESS_UNCLEAR, ComTransferProperty=PENDING:
          KS_Hybrid_01_ReK_IKACtr_XIX_KS_Hybrid_01_Response_K_XIX_HCP5_CANFD01_cc8f173c_Tx: ComBitPosition=16, ComBitSize=8, ComSignalEndianness=LITTLE_ENDIAN, ComSignalInitValue=0, ComSignalType=UINT8, ComHandleId=554, ComSystemTemplateSystemSignalRef=KS_Hybrid_01_ReK_IKACtr
          KS_Hybrid_01_ReK_SID_XIX_KS_Hybrid_01_Response_K_XIX_HCP5_CANFD01_7371ae18_Tx: ComBitPosition=0, ComBitSize=16, ComSignalEndianness=LITTLE_ENDIAN, ComSignalInitValue=0, ComSignalType=UINT16, ComHandleId=555, ComSystemTemplateSystemSignalRef=KS_Hybrid_01_ReK_SID
          KS_Hybrid_01_ReK_XIX_KS_Hybrid_01_Response_K_XIX_HCP5_CANFD01_e1783515_Tx: ComBitPosition=24, ComSignalEndianness=opaque, ComSignalInitValue=0 0 0 0 0 0 0 0, ComSignalLength=8, ComSignalType=UINT8_N, ComHandleId=556, ComSystemTemplateSystemSignalRef=KS_Hybrid_01_ReK
      UI2Sens02_CALID_01_XIX_BMC_CAN01_abd78ba8_Rx (ComIPdu):
        ComIPduDirection = RECEIVE
        ComIPduType = NORMAL
        ComIPduHandleId = 53
        ComIPduSignalProcessing = DEFERRED
        ComIPduCancellationSupport = false
        ComIPduGroupRef = BMC_HV_XIX_BMC_CAN01_Rx_7b388810
        ComIPduSignalRef = UI2Sens02_CALID_Index_01_XIX_UI2Sens02_CALID_01_XIX_BMC_CAN01_abbdc605_Rx
        ComIPduSignalRef = UI2Sens02_CALID_Index_02_XIX_UI2Sens02_CALID_01_XIX_BMC_CAN01_e655c662_Rx
        ComIPduSignalRef = UI2Sens02_CALID_Index_03_XIX_UI2Sens02_CALID_01_XIX_BMC_CAN01_6bdd3b80_Rx
        ComIPduSignalRef = UI2Sens02_CALID_Index_04_XIX_UI2Sens02_CALID_01_XIX_BMC_CAN01_7d85c6ac_Rx
        ComIPduSignalRef = UI2Sens02_CALID_Index_05_XIX_UI2Sens02_CALID_01_XIX_BMC_CAN01_f00d3b4e_Rx
        ComIPduSignalRef = UI2Sens02_CALID_Index_06_XIX_UI2Sens02_CALID_01_XIX_BMC_CAN01_bde53b29_Rx
        ComIPduSignalRef = UI2Sens02_CALID_Index_07_XIX_UI2Sens02_CALID_01_XIX_BMC_CAN01_306dc6cb_Rx
        ComIPduSignalRef = UI2Sens02_CALID_Index_08_XIX_UI2Sens02_CALID_01_XIX_BMC_CAN01_9154c171_Rx
        ComPduIdRef = UI2Sens02_CALID_01_XIX_BMC_CAN01_abd78ba8_Rx
        ComIPduMainFunctionRef = ComMainFunctionRx
      19 x ComSignal, all with ComSignalEndianness=LITTLE_ENDIAN, ComSignalAccess=ACCESS_UNCLEAR:
        BMC_CMC_Zellspannung_167_XIX_BMC_CMC_Zellspannung_05_XIX_HCP5_CANFD01_ff2791d4_Tx: ComBitPosition=132, ComBitSize=12, ComSignalDataInvalidValue=4095, ComSignalInitValue=4094, ComSignalType=UINT16, ComTransferProperty=PENDING, ComHandleId=278, ComSystemTemplateSystemSignalRef=BMC_CMC_Zellspannung_167
        BMC_CMC_Temperatur_061_XIX_BMC_CMC_Temperatur_02_XIX_HCP5_CANFD01_8c45630a_Tx: ComBitPosition=32, ComBitSize=8, ComSignalDataInvalidValue=255, ComSignalInitValue=254, ComSignalType=UINT8, ComTransferProperty=PENDING, ComHandleId=71, ComSystemTemplateSystemSignalRef=BMC_CMC_Temperatur_061
        BMC_RtmWarnTZelleMax_XIX_BMC_HV_08_XIX_HCP5_CANFD01_45027cb0_Tx: ComBitPosition=43, ComBitSize=3, ComSignalInitValue=0, ComSignalType=UINT8, ComTransferProperty=PENDING, ComHandleId=370, ComSystemTemplateSystemSignalRef=BMC_RtmWarnTZelleMax
        UI1_KompFehlerModus2_14_XIX_UI1_Komponentenfehler_01_XIX_BMC_CAN01_15a72609_Rx: ComBitPosition=38, ComBitSize=2, ComSignalInitValue=0, ComSignalType=UINT8, ComTimeout=1, ComHandleId=364, ComSystemTemplateSystemSignalRef=UI1_KompFehlerModus2_14
        BMC_CMC_Temperatur_033_XIX_BMC_CMC_Temperatur_01_XIX_HCP5_CANFD01_72ce4d13_Tx: ComBitPosition=272, ComBitSize=8, ComSignalDataInvalidValue=255, ComSignalInitValue=254, ComSignalType=UINT8, ComTransferProperty=PENDING, ComHandleId=43, ComSystemTemplateSystemSignalRef=BMC_CMC_Temperatur_033
        BMC_CMC_Zellspannung_074_XIX_BMC_CMC_Zellspannung_02_XIX_HCP5_CANFD01_ca9bd0bc_Tx: ComBitPosition=420, ComBitSize=12, ComSignalDataInvalidValue=4095, ComSignalInitValue=4094, ComSignalType=UINT16, ComTransferProperty=PENDING, ComHandleId=185, ComSystemTemplateSystemSignalRef=BMC_CMC_Zellspannung_074
        BMC_Pack_SN_23_XIX_BMC_HV_08_XIX_HCP5_CANFD01_8c14c168_Tx: ComBitPosition=240, ComBitSize=8, ComSignalInitValue=255, ComSignalType=UINT8, ComTransferProperty=PENDING, ComHandleId=356, ComSystemTemplateSystemSignalRef=BMC_Pack_SN_23
        UI2_KompFehlerModus2_24_XIX_UI2_Komponentenfehler_01_XIX_BMC_CAN01_04a2539c_Rx: ComBitPosition=58, ComBitSize=2, ComSignalInitValue=0, ComSignalType=UINT8, ComTimeout=1, ComHandleId=468, ComSystemTemplateSystemSignalRef=UI2_KompFehlerModus2_24
        DCDC_NV_Komponentenfehler_11_XIX_DCDC_NV_Komponentenfehler_01_XIX_HCP5_CANFD01_bd94b4dc_Rx: ComBitPosition=20, ComBitSize=2, ComSignalInitValue=0, ComSignalType=UINT8, ComTimeout=5, ComHandleId=72, ComSystemTemplateSystemSignalRef=DCDC_NV_Komponentenfehler_11
        UI2_KompFehlerModus2_25_XIX_UI2_Komponentenfehler_01_XIX_BMC_CAN01_2e8a6bfe_Rx: ComBitPosition=60, ComBitSize=2, ComSignalInitValue=0, ComSignalType=UINT8, ComTimeout=1, ComHandleId=469, ComSystemTemplateSystemSignalRef=UI2_KompFehlerModus2_25
        NM_Hybrid_01_NM_aktiv_Tmin_XIX_NMH_Hybrid_01_XIX_BMC_CAN01_9fd576ae_Tx: ComBitPosition=10, ComBitSize=1, ComSignalInitValue=0, ComSignalType=UINT8, ComTransferProperty=TRIGGERED, ComHandleId=422, ComSystemTemplateSystemSignalRef=NM_Hybrid_01_NM_aktiv_Tmin
        BMC_Bidi_Max_SoC_XIX_BMC_HV_03_XIX_HCP5_CANFD01_efab2d0f_Tx: ComBitPosition=185, ComBitSize=7, ComSignalDataInvalidValue=127, ComSignalInitValue=126, ComSignalType=UINT8, ComTransferProperty=PENDING, ComHandleId=4, ComSystemTemplateSystemSignalRef=BMC_Bidi_Max_SoC
        DCDC_NV_CALID_Index_09_XIX_DCDC_NV_CALID_XIX_HCP5_CANFD01_fff755ac_Rx: ComBitPosition=64, ComBitSize=8, ComSignalInitValue=63, ComSignalType=UINT8, ComTimeout=5, ComHandleId=33, ComSystemTemplateSystemSignalRef=DCDC_NV_CALID_Index_09
        BMC_CMC_Zellspannung_073_XIX_BMC_CMC_Zellspannung_02_XIX_HCP5_CANFD01_6e961404_Tx: ComBitPosition=408, ComBitSize=12, ComSignalDataInvalidValue=4095, ComSignalInitValue=4094, ComSignalType=UINT16, ComTransferProperty=PENDING, ComHandleId=184, ComSystemTemplateSystemSignalRef=BMC_CMC_Zellspannung_073
        BMC_Pack_SN_25_XIX_BMC_HV_08_XIX_HCP5_CANFD01_c55bd657_Tx: ComBitPosition=256, ComBitSize=8, ComSignalInitValue=255, ComSignalType=UINT8, ComTransferProperty=PENDING, ComHandleId=358, ComSystemTemplateSystemSignalRef=BMC_Pack_SN_25
        NM_Hybrid_01_SNI_10_XIX_NM_Hybrid_01_XIX_HCP5_CANFD01_4ea5afc8_Tx: ComBitPosition=120, ComBitSize=10, ComSignalInitValue=123, ComSignalType=UINT16, ComTransferProperty=TRIGGERED, ComHandleId=424, ComSystemTemplateSystemSignalRef=NM_Hybrid_01_SNI_10
        DCDC_NV_Komponentenfehler_71_XIX_DCDC_NV_Komponentenfehler_03_XIX_HCP5_CANFD01_179bd130_Rx: ComBitPosition=20, ComBitSize=2, ComSignalInitValue=0, ComSignalType=UINT8, ComTimeout=5, ComHandleId=132, ComSystemTemplateSystemSignalRef=DCDC_NV_Komponentenfehler_71
        UI2Sens01_CVN_Byte_3_XIX_UI2Sens01_CVN_XIX_BMC_CAN01_68f5cf84_Rx: ComBitPosition=17, ComBitSize=8, ComSignalInitValue=0, ComSignalType=UINT8, ComTimeout=5, ComHandleId=419, ComSystemTemplateSystemSignalRef=UI2Sens01_CVN_Byte_3
        OBD_Eng_Cool_Temp_XIX_OBD_03_XIX_HCP5_CANFD01_d0429a53_Rx: ComBitPosition=12, ComBitSize=8, ComSignalInitValue=255, ComSignalType=UINT8, ComTimeout=3.2, ComHandleId=165, ComSystemTemplateSystemSignalRef=OBD_Eng_Cool_Temp
      BMC_HV_07_XIX_HCP5_CANFD01_0dbf165a_Tx (ComIPdu):
        ComIPduDirection = SEND
        ComIPduType = NORMAL
        ComIPduHandleId = 14
        ComIPduSignalProcessing = DEFERRED
        ComIPduCancellationSupport = false
        ComIPduGroupRef = BMC_HV_XIX_HCP5_CANFD01_Tx_3ba05bd9
        ComIPduGroupRef = BMC_HV_XIX_PNC_26_HighVoltage_Charging_Tx_20012544
        ComIPduSignalRef = BMC_Temperatur_hoechste_XIX_BMC_HV_07_XIX_HCP5_CANFD01_70360ca3_Tx
        ComIPduSignalRef = BMC_Temperatur_niedrigste_XIX_BMC_HV_07_XIX_HCP5_CANFD01_2e3528f4_Tx
        ComPduIdRef = BMC_HV_07_XIX_HCP5_CANFD01_0dbf165a_Tx
        ComIPduMainFunctionRef = ComMainFunctionTx
        ComTxIPdu: ComTxIPduUnusedAreasDefault=0, ComMinimumDelayTime=0
          ComTxModeTrue
            ComTxMode: ComTxModeMode=PERIODIC, ComTxModeTimeOffset=0, ComTxModeTimePeriod=0.2
          ComTxModeFalse
            ComTxMode: ComTxModeMode=NONE
      4 x ComSignal, all with ComSignalEndianness=LITTLE_ENDIAN, ComSignalAccess=ACCESS_UNCLEAR:
        BMC_CMC_Zellspannung_143_XIX_BMC_CMC_Zellspannung_04_XIX_HCP5_CANFD01_e6d059f2_Tx: ComBitPosition=312, ComBitSize=12, ComSignalDataInvalidValue=4095, ComSignalInitValue=4094, ComSignalType=UINT16, ComTransferProperty=PENDING, ComHandleId=254, ComSystemTemplateSystemSignalRef=BMC_CMC_Zellspannung_143
        BMC_CMC_Zellspannung_188_XIX_BMC_CMC_Zellspannung_05_XIX_HCP5_CANFD01_42c9efc3_Tx: ComBitPosition=384, ComBitSize=12, ComSignalDataInvalidValue=4095, ComSignalInitValue=4094, ComSignalType=UINT16, ComTransferProperty=PENDING, ComHandleId=299, ComSystemTemplateSystemSignalRef=BMC_CMC_Zellspannung_188
        UI2Sens01_CVN_Byte_4_XIX_UI2Sens01_CVN_XIX_BMC_CAN01_e8283d5d_Rx: ComBitPosition=25, ComBitSize=8, ComSignalInitValue=0, ComSignalType=UINT8, ComTimeout=5, ComHandleId=420, ComSystemTemplateSystemSignalRef=UI2Sens01_CVN_Byte_4
        BMC_CMC_Zellspannung_092_XIX_BMC_CMC_Zellspannung_03_XIX_HCP5_CANFD01_af4053c3_Tx: ComBitPosition=168, ComBitSize=12, ComSignalDataInvalidValue=4095, ComSignalInitValue=4094, ComSignalType=UINT16, ComTransferProperty=PENDING, ComHandleId=203, ComSystemTemplateSystemSignalRef=BMC_CMC_Zellspannung_092
      ZeitMaster_01_XIX_HCP5_CANFD01_dad73d21_Rx (ComIPdu):
        ComIPduDirection = RECEIVE
        ComIPduType = NORMAL
        ComIPduHandleId = 64
        ComIPduSignalProcessing = DEFERRED
        ComIPduCancellationSupport = false
        ComIPduGroupRef = BMC_HV_XIX_HCP5_CANFD01_Rx_6dfafc5f
        ComIPduGroupRef = BMC_HV_XIX_PNC_27_Timemaster_Timer_Rx_2db6b092
        ComIPduSignalRef = ZM_HV_Auszeit_Status_XIX_ZeitMaster_01_XIX_HCP5_CANFD01_de3b0265_Rx
        ComIPduSignalRef = ZM_HV_Auszeit_XIX_ZeitMaster_01_XIX_HCP5_CANFD01_870dc7b8_Rx
        ComPduIdRef = ZeitMaster_01_XIX_HCP5_CANFD01_dad73d21_Rx
        ComIPduMainFunctionRef = ComMainFunctionRx
      HVEM_07_XIX_HCP5_CANFD01_839f516f_Rx (ComIPdu):
        ComIPduDirection = RECEIVE
        ComIPduType = NORMAL
        ComIPduHandleId = 23
        ComIPduSignalProcessing = DEFERRED
        ComIPduCancellationSupport = false
        ComIPduGroupRef = BMC_HV_XIX_HCP5_CANFD01_Rx_6dfafc5f
        ComIPduGroupRef = BMC_HV_XIX_PNC_30_EnergyManagement_Rx_a9680a43
        ComIPduSignalRef = HVEM_BMC_CHA_Wunschleistung_02_XIX_HVEM_07_XIX_HCP5_CANFD01_7eeecd70_Rx
        ComIPduSignalRef = HVEM_BMC_CHA_Wunschleistung_XIX_HVEM_07_XIX_HCP5_CANFD01_7884fa49_Rx
        ComIPduSignalRef = HVEM_MMTR_State_XIX_HVEM_07_XIX_HCP5_CANFD01_6d943f0f_Rx
        ComIPduSignalRef = HVEM_SystemMinLeistungsgrenze_XIX_HVEM_07_XIX_HCP5_CANFD01_b8be9fb0_Rx
        ComPduIdRef = HVEM_07_XIX_HCP5_CANFD01_839f516f_Rx
        ComIPduMainFunctionRef = ComMainFunctionRx
      BMC_CMC_Temperatur_018_XIX_BMC_CMC_Temperatur_01_XIX_HCP5_CANFD01_1adb963d_Tx (ComSignal):
        ComBitPosition = 152
        ComBitSize = 8
        ComSignalDataInvalidValue = 255
        ComSignalEndianness = LITTLE_ENDIAN
        ComSignalInitValue = 254
        ComSignalType = UINT8
        ComTransferProperty = PENDING
        ComSignalAccess = ACCESS_UNCLEAR
        ComHandleId = 28
        ComSystemTemplateSystemSignalRef = BMC_CMC_Temperatur_018
      BMC_CMC_Zellspannung_026_XIX_BMC_CMC_Zellspannung_01_XIX_HCP5_CANFD01_c8621a48_Tx (ComSignal):
        ComBitPosition = 312
        ComBitSize = 12
        ComSignalDataInvalidValue = 4095
        ComSignalEndianness = LITTLE_ENDIAN
        ComSignalInitValue = 4094
        ComSignalType = UINT16
        ComTransferProperty = PENDING
        ComSignalAccess = ACCESS_UNCLEAR
        ComHandleId = 137
        ComSystemTemplateSystemSignalRef = BMC_CMC_Zellspannung_026
      HVLM_14_XIX_HCP5_CANFD01_E2E_b3d1458f_Rx (ComIPdu):
        ComIPduDirection = RECEIVE
        ComIPduType = NORMAL
        ComIPduHandleId = 26
        ComIPduSignalProcessing = DEFERRED
        ComIPduCancellationSupport = false
        ComIPduGroupRef = BMC_HV_XIX_HCP5_CANFD01_Rx_6dfafc5f
        ComIPduGroupRef = BMC_HV_XIX_PNC_26_HighVoltage_Charging_Rx_765b82c2
        ComIPduSignalGroupRef = SG_HVLM_14_XIX_HCP5_CANFD01_09e92b9c_Rx
        ComPduIdRef = HVLM_14_XIX_HCP5_CANFD01_E2E_b3d1458f_Rx
        ComIPduMainFunctionRef = ComMainFunctionRx
      DCDC_NV_CALID_Index_11_XIX_DCDC_NV_CALID_XIX_HCP5_CANFD01_0fa7f39d_Rx (ComSignal):
        ComBitPosition = 80
        ComBitSize = 8
        ComSignalEndianness = LITTLE_ENDIAN
        ComSignalInitValue = 63
        ComSignalType = UINT8
        ComTimeout = 5
        ComSignalAccess = ACCESS_UNCLEAR
        ComHandleId = 35
        ComSystemTemplateSystemSignalRef = DCDC_NV_CALID_Index_11
      HVK_03_XIX_HCP5_CANFD01_E2E_8a76edcb_Rx (ComIPdu):
        ComIPduDirection = RECEIVE
        ComIPduType = NORMAL
        ComIPduHandleId = 24
        ComIPduSignalProcessing = DEFERRED
        ComIPduCancellationSupport = false
        ComIPduGroupRef = BMC_HV_XIX_HCP5_CANFD01_Rx_6dfafc5f
        ComIPduGroupRef = BMC_HV_XIX_PNC_30_EnergyManagement_Rx_a9680a43
        ComIPduSignalGroupRef = SG_HVK_03_XIX_HCP5_CANFD01_2b81aede_Rx
        ComPduIdRef = HVK_03_XIX_HCP5_CANFD01_E2E_8a76edcb_Rx
        ComIPduMainFunctionRef = ComMainFunctionRx
      6 x ComSignal, all with ComSignalEndianness=LITTLE_ENDIAN, ComSignalAccess=ACCESS_UNCLEAR:
        DCDC_NV_Komponentenfehler_3_6_XIX_DCDC_NV_Komponentenfehler_04_XIX_HCP5_CANFD01_5669e61e_Rx: ComBitPosition=15, ComBitSize=3, ComSignalInitValue=0, ComSignalType=UINT8, ComTimeout=5, ComHandleId=51, ComSystemTemplateSystemSignalRef=DCDC_NV_Komponentenfehler_3_6
        UI1_KompFehlerModus4_12_XIX_UI1_Komponentenfehler_02_XIX_BMC_CAN01_544de023_Rx: ComBitPosition=45, ComBitSize=3, ComSignalInitValue=0, ComSignalType=UINT8, ComTimeout=1, ComHandleId=388, ComSystemTemplateSystemSignalRef=UI1_KompFehlerModus4_12
        BMC_Max_Ladestrom_02_XIX_BMC_HV_09_XIX_HCP5_CANFD01_e47fe8b0_Tx: ComBitPosition=56, ComBitSize=14, ComSignalDataInvalidValue=16383, ComSignalInitValue=16382, ComSignalType=UINT16, ComTransferProperty=PENDING, ComHandleId=326, ComSystemTemplateSystemSignalRef=BMC_Max_Ladestrom_02
        BMC_Pack_SN_08_XIX_BMC_HV_08_XIX_HCP5_CANFD01_cbfadc65_Tx: ComBitPosition=120, ComBitSize=8, ComSignalInitValue=255, ComSignalType=UINT8, ComTransferProperty=PENDING, ComHandleId=341, ComSystemTemplateSystemSignalRef=BMC_Pack_SN_08
        DCDC_NV_Komponentenfehler_63_XIX_DCDC_NV_Komponentenfehler_03_XIX_HCP5_CANFD01_315bcc5a_Rx: ComBitPosition=4, ComBitSize=2, ComSignalInitValue=0, ComSignalType=UINT8, ComTimeout=5, ComHandleId=124, ComSystemTemplateSystemSignalRef=DCDC_NV_Komponentenfehler_63
        DCDC_NV_Komponentenfehler_16_XIX_DCDC_NV_Komponentenfehler_01_XIX_HCP5_CANFD01_a6bf64e6_Rx: ComBitPosition=30, ComBitSize=2, ComSignalInitValue=0, ComSignalType=UINT8, ComTimeout=5, ComHandleId=77, ComSystemTemplateSystemSignalRef=DCDC_NV_Komponentenfehler_16
      NMH_Hybrid_01_XIX_BMC_CAN01_b22e17f1_Tx (ComIPdu):
        ComIPduDirection = SEND
        ComIPduType = NORMAL
        ComIPduHandleId = 28
        ComIPduSignalProcessing = DEFERRED
        ComIPduCancellationSupport = false
        ComIPduSignalRef = NM_Hybrid_01_CAB_V12_XIX_NMH_Hybrid_01_XIX_BMC_CAN01_6448e8c9_Tx
        ComIPduSignalRef = NM_Hybrid_01_NM_State_XIX_NMH_Hybrid_01_XIX_BMC_CAN01_20dc868b_Tx
        ComIPduSignalRef = NM_Hybrid_01_NM_aktiv_Diag_XIX_NMH_Hybrid_01_XIX_BMC_CAN01_537ad98b_Tx
        ComIPduSignalRef = NM_Hybrid_01_NM_aktiv_KL15_XIX_NMH_Hybrid_01_XIX_BMC_CAN01_7114d801_Tx
        ComIPduSignalRef = NM_Hybrid_01_NM_aktiv_Tmin_XIX_NMH_Hybrid_01_XIX_BMC_CAN01_9fd576ae_Tx
        ComIPduSignalRef = NM_aktiv_Konditionierungsbedarf_XIX_NMH_Hybrid_01_XIX_BMC_CAN01_514ad247_Tx
        ComIPduSignalRef = NM_aktiv_SubbusSteuerung_BMC_HV_XIX_NMH_Hybrid_01_XIX_BMC_CAN01_c2e71061_Tx
        ComPduIdRef = NMH_Hybrid_01_XIX_BMC_CAN01_b22e17f1_Tx
        ComIPduMainFunctionRef = ComMainFunctionTx
        ComTxIPdu: ComTxIPduUnusedAreasDefault=0, ComMinimumDelayTime=0  # NMH_Hybrid_01_XIX_BMC_CAN01
          ComTxModeTrue
            ComTxMode: ComTxModeMode=NONE
          ComTxModeFalse
            ComTxMode: ComTxModeMode=NONE
      BMC_Pack_SN_21_XIX_BMC_HV_08_XIX_HCP5_CANFD01_b4d1cc7d_Tx (ComSignal):
        ComBitPosition = 224
        ComBitSize = 8
        ComSignalEndianness = LITTLE_ENDIAN
        ComSignalInitValue = 255
        ComSignalType = UINT8
        ComTransferProperty = PENDING
        ComSignalAccess = ACCESS_UNCLEAR
        ComHandleId = 354
        ComSystemTemplateSystemSignalRef = BMC_Pack_SN_21
      VIN_16_XIX_WFS_02_XIX_HCP5_CANFD01_1c293e16_Rx (ComSignal):
        ComBitPosition = 136
        ComBitSize = 8
        ComSignalEndianness = LITTLE_ENDIAN
        ComSignalInitValue = 45
        ComSignalType = UINT8
        ComTimeout = 4
        ComSignalAccess = ACCESS_UNCLEAR
        ComHandleId = 508
        ComSystemTemplateSystemSignalRef = VIN_16
      BJB_11_XIX_BMC_CAN01_E2E_416796eb_Rx (ComIPdu):
        ComIPduDirection = RECEIVE
        ComIPduType = NORMAL
        ComIPduHandleId = 3
        ComIPduSignalProcessing = DEFERRED
        ComIPduCancellationSupport = false
        ComIPduGroupRef = BMC_HV_XIX_BMC_CAN01_Rx_7b388810
        ComIPduSignalGroupRef = SG_BJB_11_XIX_BMC_CAN01_e2cc653e_Rx
        ComPduIdRef = BJB_11_XIX_BMC_CAN01_E2E_416796eb_Rx
        ComIPduMainFunctionRef = ComMainFunctionRx
      5 x ComSignal, all with ComSignalEndianness=LITTLE_ENDIAN, ComSignalAccess=ACCESS_UNCLEAR:
        DCDC_NV_Komponentenfehler_15_XIX_DCDC_NV_Komponentenfehler_01_XIX_HCP5_CANFD01_238d7612_Rx: ComBitPosition=28, ComBitSize=2, ComSignalInitValue=0, ComSignalType=UINT8, ComTimeout=5, ComHandleId=76, ComSystemTemplateSystemSignalRef=DCDC_NV_Komponentenfehler_15
        BMC_CMC_Zellspannung_001_XIX_BMC_CMC_Zellspannung_01_XIX_HCP5_CANFD01_be9dc83a_Tx: ComBitPosition=12, ComBitSize=12, ComSignalDataInvalidValue=4095, ComSignalInitValue=4094, ComSignalType=UINT16, ComTransferProperty=PENDING, ComHandleId=112, ComSystemTemplateSystemSignalRef=BMC_CMC_Zellspannung_001
        BJB_CALID_Index_11_XIX_BJB_CALID_02_XIX_BMC_CAN01_3368847d_Rx: ComBitPosition=16, ComBitSize=8, ComSignalInitValue=63, ComSignalType=UINT8, ComTimeout=5, ComHandleId=11, ComSystemTemplateSystemSignalRef=BJB_CALID_Index_11
        BMC_PCM_VTD_Freeze_Req_XIX_BMC_HV_14_XIX_HCP5_CANFD01_f4d42d86_Tx: ComBitPosition=70, ComBitSize=2, ComSignalDataInvalidValue=3, ComSignalInitValue=2, ComSignalType=UINT8, ComTransferProperty=PENDING, ComHandleId=330, ComSystemTemplateSystemSignalRef=BMC_PCM_VTD_Freeze_Req
        BMC_CMC_Zellspannung_030_XIX_BMC_CMC_Zellspannung_01_XIX_HCP5_CANFD01_7adf4e06_Tx: ComBitPosition=360, ComBitSize=12, ComSignalDataInvalidValue=4095, ComSignalInitValue=4094, ComSignalType=UINT16, ComTransferProperty=PENDING, ComHandleId=141, ComSystemTemplateSystemSignalRef=BMC_CMC_Zellspannung_030
      SG_BMC_HV_10_XIX_BMC_CAN01_284dd772_Tx (ComSignalGroup):
        ComTransferProperty = PENDING
        ComSignalGroupAccess = ACCESS_NEEDED_BY_SWC_OR_COM
        ComHandleId = 3
        ComNotification = ComNotification_SG_BMC_HV_10_XIX_BMC_CAN01_284dd772_Tx
        ComTimeout = 2
        ComTimeoutNotification = ComTimeoutNotification_SG_BMC_HV_10_XIX_BMC_CAN01_284dd772_Tx
        ComInvalidNotification = ComInvalidNotification_SG_BMC_HV_10_XIX_BMC_CAN01_284dd772_Tx
        ComSignalGroupArrayAccess = true
        ComSystemTemplateSignalGroupRef = SG_BMC_HV_10_XIX_BMC_CAN01
        11 x ComGroupSignal, all with ComSignalEndianness=LITTLE_ENDIAN, ComTransferProperty=PENDING:
          ISignalVoid_BMC_HV_10_XIX_BMC_CAN01_0_91446ba4_Tx: ComBitPosition=36, ComBitSize=4, ComSignalType=UINT8, ComSignalInitValue=0, ComSignalAccess=ACCESS_UNCLEAR, ComHandleId=517, ComSystemTemplateSystemSignalRef=SignalVoid_BMC_HV_10_0
          ISignalVoid_BMC_HV_10_XIX_BMC_CAN01_2_7f4a0a88_Tx: ComBitPosition=48, ComBitSize=8, ComSignalType=UINT8, ComSignalInitValue=0, ComSignalAccess=ACCESS_UNCLEAR, ComHandleId=519, ComSystemTemplateSystemSignalRef=SignalVoid_BMC_HV_10_2
          BMC_Datenuebernahme_Anf_XIX_BMC_HV_10_XIX_BMC_CAN01_5ffc7cd0_Tx: ComBitPosition=35, ComBitSize=1, ComSignalInitValue=0, ComSignalType=UINT8, ComSignalAccess=ACCESS_NEEDED_BY_SWC_OR_COM, ComHandleId=510, ComSystemTemplateSystemSignalRef=BMC_Datenuebernahme_Anf
          BMC_Sperrung_Unterspannung_XIX_BMC_HV_10_XIX_BMC_CAN01_71e0b0eb_Tx: ComBitPosition=12, ComBitSize=2, ComSignalDataInvalidValue=3, ComSignalInitValue=2, ComSignalType=UINT8, ComSignalAccess=ACCESS_NEEDED_BY_SWC_OR_COM, ComHandleId=514, ComSystemTemplateSystemSignalRef=BMC_Sperrung_Unterspannung
          BMC_Lebensdauer_Trennelemente_XIX_BMC_HV_10_XIX_BMC_CAN01_16e3805b_Tx: ComBitPosition=15, ComBitSize=17, ComSignalDataInvalidValue=131071, ComSignalInitValue=131070, ComSignalType=UINT32, ComSignalAccess=ACCESS_NEEDED_BY_SWC_OR_COM, ComHandleId=513, ComSystemTemplateSystemSignalRef=BMC_Lebensdauer_Trennelemente
          BMC_HV_10_BZ_XIX_BMC_HV_10_XIX_BMC_CAN01_33eff98e_Tx: ComBitPosition=8, ComBitSize=4, ComSignalInitValue=0, ComSignalType=UINT8, ComSignalAccess=ACCESS_NEEDED_BY_SWC_OR_COM, ComHandleId=511, ComSystemTemplateSystemSignalRef=BMC_HV_10_BZ
          BMC_HV_10_CRC_XIX_BMC_HV_10_XIX_BMC_CAN01_1c5705ee_Tx: ComBitPosition=0, ComBitSize=8, ComSignalInitValue=0, ComSignalType=UINT8, ComSignalAccess=ACCESS_NEEDED_BY_SWC_OR_COM, ComHandleId=512, ComSystemTemplateSystemSignalRef=BMC_HV_10_CRC
          ISignalVoid_BMC_HV_10_XIX_BMC_CAN01_3_084d3a1e_Tx: ComBitPosition=56, ComBitSize=8, ComSignalType=UINT8, ComSignalInitValue=0, ComSignalAccess=ACCESS_NEEDED_BY_SWC_OR_COM, ComHandleId=520, ComSystemTemplateSystemSignalRef=SignalVoid_BMC_HV_10_3
          BMC_Status_Trennelemente_XIX_BMC_HV_10_XIX_BMC_CAN01_15c64d44_Tx: ComBitPosition=32, ComBitSize=3, ComSignalDataInvalidValue=7, ComSignalInitValue=6, ComSignalType=UINT8, ComSignalAccess=ACCESS_NEEDED_BY_SWC_OR_COM, ComHandleId=516, ComSystemTemplateSystemSignalRef=BMC_Status_Trennelemente
          ISignalVoid_BMC_HV_10_XIX_BMC_CAN01_1_e6435b32_Tx: ComBitPosition=40, ComBitSize=8, ComSignalType=UINT8, ComSignalInitValue=0, ComSignalAccess=ACCESS_UNCLEAR, ComHandleId=518, ComSystemTemplateSystemSignalRef=SignalVoid_BMC_HV_10_1
          BMC_Status_HV_Spannungssensorik_XIX_BMC_HV_10_XIX_BMC_CAN01_2067c250_Tx: ComBitPosition=14, ComBitSize=1, ComSignalDataInvalidValue=1, ComSignalInitValue=0, ComSignalType=UINT8, ComSignalAccess=ACCESS_NEEDED_BY_SWC_OR_COM, ComHandleId=515, ComSystemTemplateSystemSignalRef=BMC_Status_HV_Spannungssensorik
      UI1_KompFehlerModus2_11_XIX_UI1_Komponentenfehler_01_XIX_BMC_CAN01_972fffe3_Rx (ComSignal):
        ComBitPosition = 32
        ComBitSize = 2
        ComSignalEndianness = LITTLE_ENDIAN
        ComSignalInitValue = 0
        ComSignalType = UINT8
        ComTimeout = 1
        ComSignalAccess = ACCESS_UNCLEAR
        ComHandleId = 361
        ComSystemTemplateSystemSignalRef = UI1_KompFehlerModus2_11
      BMC_HV_XIX_PNC_11_Chassis_Rx_1f7dfb2f (ComIPduGroup): ComIPduGroupHandleId=9
      OBD_Calc_Load_Val_XIX_OBD_04_XIX_HCP5_CANFD01_8b454e40_Rx (ComSignal):
        ComBitPosition = 12
        ComBitSize = 8
        ComSignalEndianness = LITTLE_ENDIAN
        ComSignalInitValue = 255
        ComSignalType = UINT8
        ComTimeout = 3.2
        ComSignalAccess = ACCESS_UNCLEAR
        ComHandleId = 162
        ComSystemTemplateSystemSignalRef = OBD_Calc_Load_Val
      UI1_KompFehlerModus2_24_XIX_UI1_Komponentenfehler_01_XIX_BMC_CAN01_2a6c589c_Rx (ComSignal):
        ComBitPosition = 58
        ComBitSize = 2
        ComSignalEndianness = LITTLE_ENDIAN
        ComSignalInitValue = 0
        ComSignalType = UINT8
        ComTimeout = 1
        ComSignalAccess = ACCESS_UNCLEAR
        ComHandleId = 374
        ComSystemTemplateSystemSignalRef = UI1_KompFehlerModus2_24
      BMC_CMC_Zellspannung_03_XIX_HCP5_CANFD01_f2bbd46a_Tx (ComIPdu):
        ComIPduDirection = SEND
        ComIPduType = NORMAL
        ComIPduHandleId = 5
        ComIPduSignalProcessing = DEFERRED
        ComIPduCancellationSupport = false
        ComIPduGroupRef = BMC_HV_XIX_HCP5_CANFD01_Tx_3ba05bd9
        ComIPduGroupRef = BMC_HV_XIX_PNC_26_HighVoltage_Charging_Tx_20012544
        ComIPduSignalRef = BMC_CMC_Zellspannung_03_Messzeit_XIX_BMC_CMC_Zellspannung_03_XIX_HCP5_CANFD01_e433a100_Tx
        ComIPduSignalRef = BMC_CMC_Zellspannung_079_XIX_BMC_CMC_Zellspannung_03_XIX_HCP5_CANFD01_36f945d9_Tx
        ComIPduSignalRef = BMC_CMC_Zellspannung_080_XIX_BMC_CMC_Zellspannung_03_XIX_HCP5_CANFD01_39aa6f80_Tx
        ComIPduSignalRef = BMC_CMC_Zellspannung_081_XIX_BMC_CMC_Zellspannung_03_XIX_HCP5_CANFD01_4663f413_Tx
        ComIPduSignalRef = BMC_CMC_Zellspannung_082_XIX_BMC_CMC_Zellspannung_03_XIX_HCP5_CANFD01_c63958a6_Tx
        ComIPduSignalRef = BMC_CMC_Zellspannung_083_XIX_BMC_CMC_Zellspannung_03_XIX_HCP5_CANFD01_b9f0c335_Tx
        ComIPduSignalRef = BMC_CMC_Zellspannung_084_XIX_BMC_CMC_Zellspannung_03_XIX_HCP5_CANFD01_1dfd078d_Tx
        ComIPduSignalRef = BMC_CMC_Zellspannung_085_XIX_BMC_CMC_Zellspannung_03_XIX_HCP5_CANFD01_62349c1e_Tx
        ComIPduSignalRef = BMC_CMC_Zellspannung_086_XIX_BMC_CMC_Zellspannung_03_XIX_HCP5_CANFD01_e26e30ab_Tx
        ComIPduSignalRef = BMC_CMC_Zellspannung_087_XIX_BMC_CMC_Zellspannung_03_XIX_HCP5_CANFD01_9da7ab38_Tx
        ComIPduSignalRef = BMC_CMC_Zellspannung_088_XIX_BMC_CMC_Zellspannung_03_XIX_HCP5_CANFD01_7104bf9a_Tx
        ComIPduSignalRef = BMC_CMC_Zellspannung_089_XIX_BMC_CMC_Zellspannung_03_XIX_HCP5_CANFD01_0ecd2409_Tx
        ComIPduSignalRef = BMC_CMC_Zellspannung_090_XIX_BMC_CMC_Zellspannung_03_XIX_HCP5_CANFD01_50d364e5_Tx
        ComIPduSignalRef = BMC_CMC_Zellspannung_091_XIX_BMC_CMC_Zellspannung_03_XIX_HCP5_CANFD01_2f1aff76_Tx
        ComIPduSignalRef = BMC_CMC_Zellspannung_092_XIX_BMC_CMC_Zellspannung_03_XIX_HCP5_CANFD01_af4053c3_Tx
        ComIPduSignalRef = BMC_CMC_Zellspannung_093_XIX_BMC_CMC_Zellspannung_03_XIX_HCP5_CANFD01_d089c850_Tx
        ComIPduSignalRef = BMC_CMC_Zellspannung_094_XIX_BMC_CMC_Zellspannung_03_XIX_HCP5_CANFD01_74840ce8_Tx
        ComIPduSignalRef = BMC_CMC_Zellspannung_095_XIX_BMC_CMC_Zellspannung_03_XIX_HCP5_CANFD01_0b4d977b_Tx
        ComIPduSignalRef = BMC_CMC_Zellspannung_096_XIX_BMC_CMC_Zellspannung_03_XIX_HCP5_CANFD01_8b173bce_Tx
        ComIPduSignalRef = BMC_CMC_Zellspannung_097_XIX_BMC_CMC_Zellspannung_03_XIX_HCP5_CANFD01_f4dea05d_Tx
        ComIPduSignalRef = BMC_CMC_Zellspannung_098_XIX_BMC_CMC_Zellspannung_03_XIX_HCP5_CANFD01_187db4ff_Tx
        ComIPduSignalRef = BMC_CMC_Zellspannung_099_XIX_BMC_CMC_Zellspannung_03_XIX_HCP5_CANFD01_67b42f6c_Tx
        ComIPduSignalRef = BMC_CMC_Zellspannung_100_XIX_BMC_CMC_Zellspannung_03_XIX_HCP5_CANFD01_f931d4f6_Tx
        ComIPduSignalRef = BMC_CMC_Zellspannung_101_XIX_BMC_CMC_Zellspannung_03_XIX_HCP5_CANFD01_86f84f65_Tx
        ComIPduSignalRef = BMC_CMC_Zellspannung_102_XIX_BMC_CMC_Zellspannung_03_XIX_HCP5_CANFD01_06a2e3d0_Tx
        ComIPduSignalRef = BMC_CMC_Zellspannung_103_XIX_BMC_CMC_Zellspannung_03_XIX_HCP5_CANFD01_796b7843_Tx
        ComIPduSignalRef = BMC_CMC_Zellspannung_104_XIX_BMC_CMC_Zellspannung_03_XIX_HCP5_CANFD01_dd66bcfb_Tx
        ComIPduSignalRef = BMC_CMC_Zellspannung_105_XIX_BMC_CMC_Zellspannung_03_XIX_HCP5_CANFD01_a2af2768_Tx
        ComIPduSignalRef = BMC_CMC_Zellspannung_106_XIX_BMC_CMC_Zellspannung_03_XIX_HCP5_CANFD01_22f58bdd_Tx
        ComIPduSignalRef = BMC_CMC_Zellspannung_107_XIX_BMC_CMC_Zellspannung_03_XIX_HCP5_CANFD01_5d3c104e_Tx
        ComIPduSignalRef = BMC_CMC_Zellspannung_108_XIX_BMC_CMC_Zellspannung_03_XIX_HCP5_CANFD01_b19f04ec_Tx
        ComIPduSignalRef = BMC_CMC_Zellspannung_109_XIX_BMC_CMC_Zellspannung_03_XIX_HCP5_CANFD01_ce569f7f_Tx
        ComIPduSignalRef = BMC_CMC_Zellspannung_110_XIX_BMC_CMC_Zellspannung_03_XIX_HCP5_CANFD01_9048df93_Tx
        ComIPduSignalRef = BMC_CMC_Zellspannung_111_XIX_BMC_CMC_Zellspannung_03_XIX_HCP5_CANFD01_ef814400_Tx
        ComIPduSignalRef = BMC_CMC_Zellspannung_112_XIX_BMC_CMC_Zellspannung_03_XIX_HCP5_CANFD01_6fdbe8b5_Tx
        ComIPduSignalRef = BMC_CMC_Zellspannung_113_XIX_BMC_CMC_Zellspannung_03_XIX_HCP5_CANFD01_10127326_Tx
        ComIPduSignalRef = BMC_CMC_Zellspannung_114_XIX_BMC_CMC_Zellspannung_03_XIX_HCP5_CANFD01_b41fb79e_Tx
        ComIPduSignalRef = BMC_CMC_Zellspannung_115_XIX_BMC_CMC_Zellspannung_03_XIX_HCP5_CANFD01_cbd62c0d_Tx
        ComIPduSignalRef = BMC_CMC_Zellspannung_116_XIX_BMC_CMC_Zellspannung_03_XIX_HCP5_CANFD01_4b8c80b8_Tx
        ComIPduSignalRef = BMC_CMC_Zellspannung_117_XIX_BMC_CMC_Zellspannung_03_XIX_HCP5_CANFD01_34451b2b_Tx
        ComPduIdRef = BMC_CMC_Zellspannung_03_XIX_HCP5_CANFD01_f2bbd46a_Tx
        ComIPduMainFunctionRef = ComMainFunctionTx
        ComTxIPdu: ComTxIPduUnusedAreasDefault=0, ComMinimumDelayTime=0
          ComTxModeTrue
            ComTxMode: ComTxModeMode=PERIODIC, ComTxModeTimeOffset=0, ComTxModeTimePeriod=1
          ComTxModeFalse
            ComTxMode: ComTxModeMode=NONE
      DCDC_NV_CVN_Byte_3_XIX_DCDC_NV_CVN_XIX_HCP5_CANFD01_bffd5ef1_Rx (ComSignal):
        ComBitPosition = 17
        ComBitSize = 8
        ComSignalEndianness = LITTLE_ENDIAN
        ComSignalInitValue = 0
        ComSignalType = UINT8
        ComTimeout = 5
        ComSignalAccess = ACCESS_UNCLEAR
        ComHandleId = 43
        ComSystemTemplateSystemSignalRef = DCDC_NV_CVN_Byte_3
      BMC_HV_02_XIX_HCP5_CANFD01_E2E_c5c367a3_Tx (ComIPdu):
        ComIPduDirection = SEND
        ComIPduType = NORMAL
        ComIPduHandleId = 9
        ComIPduSignalProcessing = DEFERRED
        ComIPduCancellationSupport = false
        ComIPduGroupRef = BMC_HV_XIX_HCP5_CANFD01_Tx_3ba05bd9
        ComIPduGroupRef = BMC_HV_XIX_PNC_26_HighVoltage_Charging_Tx_20012544
        ComIPduGroupRef = BMC_HV_XIX_PNC_30_EnergyManagement_Tx_ff32adc5
        ComIPduGroupRef = BMC_HV_XIX_PNC_40_Diagnosis_Energy_Tx_60b361f6
        ComIPduSignalGroupRef = SG_BMC_HV_02_XIX_HCP5_CANFD01_055f405a_Tx
        ComPduIdRef = BMC_HV_02_XIX_HCP5_CANFD01_E2E_c5c367a3_Tx
        ComIPduMainFunctionRef = ComMainFunctionTx
        ComTxIPdu: ComTxIPduUnusedAreasDefault=0, ComMinimumDelayTime=0
          ComTxModeTrue
            ComTxMode: ComTxModeMode=DIRECT, ComTxModeNumberOfRepetitions=0, ComTxModeRepetitionPeriod=0
          ComTxModeFalse
            ComTxMode: ComTxModeMode=NONE
