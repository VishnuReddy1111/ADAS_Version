AUTOSAR XML (schema 4-3-0)
package /ActiveEcuC
  module config WdgM: implementation-config-variant=VARIANT-PRE-COMPILE, module-description=WdgM_Impl
    WdgMConfigSet_Core0 (WdgMConfigSet): WdgMInitialMode=WdgMMode_Core0
      WdgMMode_Core0 (WdgMMode):
        WdgMExpiredSupervisionCycleTol = 10
        WdgMModeId = 0
        WdgMSupervisionCycle = 0.01
        WdgMInitialTriggerModeId = 0
        WdgMModeCoreAssignment = 0
        WdgMTicksPerSecond = 100
        WdgMReportStatusViaRte = true
        WdgMGlobalMemoryAppTaskRef = OsApplication_SystemApplication_Core0
        WdgMAliveSupervision_StartApplication (WdgMAliveSupervision):
          WdgMExpectedAliveIndications = 10
          WdgMMaxMargin = 10
          WdgMMinMargin = 9
          WdgMSupervisionReferenceCycle = 10
          WdgMAliveSupervisionCheckpointRef = WdgMCheckpoint_StartApplication
        WdgMLocalStatusParams_StartApplication (WdgMLocalStatusParams):
          WdgMFailedAliveSupervisionRefCycleTol = 0
          WdgMSupervisedEntityInitialMode = WDGM_LOCAL_STATUS_OK
          WdgMFailedDeadlineRefCycleTol = 0
          WdgMDeadlineReferenceCycle = 0
          WdgMFailedProgramFlowRefCycleTol = 0
          WdgMProgramFlowReferenceCycle = 0
          WdgMLocalStatusSupervisedEntityRef = WdgMSupervisedEntity_StartApplication
        WdgMTrigger: WdgMWatchdogMode=WDGIF_SLOW_MODE, WdgMTriggerConditionValue=500, WdgMTriggerModeId=0, WdgMTriggerWatchdogRef=WdgMWatchdog
      WdgMDemEventParameterRefs:
        WDGM_E_SET_MODE = AutoCreatedDemEvent_WdgMDemEventParameterRefs_WDGM_E_SET_MODE
        WDGM_E_MONITORING = AutoCreatedDemEvent_WdgMDemEventParameterRefs_WDGM_E_MONITORING
        WDGM_E_IMPROPER_CALLER = AutoCreatedDemEvent_WdgMDemEventParameterRefs_WDGM_E_IMPROPER_CALLER
    WdgMGeneral:
      WdgMDevErrorDetect = false
      WdgMDemReport = false
      WdgMImmediateReset = true
      WdgMOffModeEnabled = false
      WdgMVersionInfoApi = true
      WdgMDefensiveBehavior = false
      WdgMUseRte = true
      WdgMDemSupervisionReport = false
      WdgMFirstCycleAliveCounterReset = false
      WdgMAutosarDebugging = false
      WdgMUseOsSuspendInterrupt = true
      WdgMTimebaseSource = WDGM_INTERNAL_SOFTWARE_TICK
      WdgMSecondResetPath = true
      WdgMTickOverrunCorrection = false
      WdgMEntityDeactivationEnabled = false
      WdgMGenerateCPIdAsPortDefinedArgument = false
      WdgMStatusReportingMechanism = WDGM_USE_NOTIFICATIONS
      WdgMUseOsCoreIdentification = true
      WdgMCallerIds: WdgMCallerId=0
      WdgMSupervisedEntity_StartApplication (WdgMSupervisedEntity):
        WdgMSupervisedEntityId = 0
        WdgMEnableEntityDeactivation = false
        WdgMReportStatusViaRte = true
        WdgMInternalCheckpointInitialRef = WdgMCheckpoint_StartApplication
        WdgMAppTaskRef = OsApplication_SystemApplication_Core0
        WdgMCheckpoint_StartApplication (WdgMCheckpoint): WdgMCheckpointId=0
      WdgMWatchdog: WdgMWatchdogName=, WdgMWatchdogDeviceRef=WdgIfDevice_Core0
    WdgMConfigSet_Core1 (WdgMConfigSet): WdgMInitialMode=WdgMMode_Core1
      WdgMMode_Core1 (WdgMMode):
        WdgMExpiredSupervisionCycleTol = 10
        WdgMModeId = 0
        WdgMSupervisionCycle = 0.01
        WdgMInitialTriggerModeId = 0
        WdgMModeCoreAssignment = 1
        WdgMTicksPerSecond = 100
        WdgMReportStatusViaRte = true
        WdgMGlobalMemoryAppTaskRef = OsApplication_SystemApplication_Core1
        WdgMTrigger_Core1 (WdgMTrigger): WdgMWatchdogMode=WDGIF_SLOW_MODE, WdgMTriggerConditionValue=500, WdgMTriggerModeId=0, WdgMTriggerWatchdogRef=WdgMWatchdog
      WdgMDemEventParameterRefs:
        WDGM_E_IMPROPER_CALLER = AutoCreatedDemEvent_WdgMDemEventParameterRefs_WDGM_E_IMPROPER_CALLER
        WDGM_E_MONITORING = AutoCreatedDemEvent_WdgMDemEventParameterRefs_WDGM_E_MONITORING
        WDGM_E_SET_MODE = AutoCreatedDemEvent_WdgMDemEventParameterRefs_WDGM_E_SET_MODE
