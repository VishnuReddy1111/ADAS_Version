AUTOSAR XML (schema 00048)
package /ActiveEcuC
  module config Sd: implementation-config-variant=VARIANT-PRE-COMPILE, module-description=Sd_Impl
    SdConfig
      MyECU_EEI_U_ee15deea (SdInstance): SdMaxNrDestAddr=10, SdInOutQueueSize=10, SdInQueueProcessLimit=0
        SdInstanceTxPdu: SdTxPduRef=SD_Ctrl_Tx_86d8d410_Tx
        CSI_Basics_0bfbbc03 (SdClientService):
          SdClientServiceId = 10
          SdClientServiceInstanceId = 1
          SdClientServiceMajorVersion = 1
          SdClientServiceMinorVersion = 0
          SdClientServiceAutoRequire = false
          SdClientServiceHandleId = 0
          SdVersionDrivenFindBehavior = EXACT_OR_ANY_MINOR_VERSION
          SdClientServiceTimerRef = CSI_Basics_a309a914
          SdClientServiceUdpRef = SCB_Basics_d6d2116a
          CEG_Basics_72dd3cbe (SdConsumedEventGroup):
            SdConsumedEventGroupId = 1
            SdConsumedEventGroupAutoRequire = false
            SdConsumedEventGroupHandleId = 0
            SdConsumedEventGroupTimerRef = CEG_Basics_1e1472d1
            SdConsumedEventGroupUdpActivationRef = Basics_events_d39e7277
        SdInstanceMulticastRxPdu: SdRxPduId=0, SdRxPduRef=SD_Ctrl_Rx_Multicast_abf0bc8f_Rx
        SdInstanceUnicastRxPdu: SdRxPduId=1, SdRxPduRef=SD_Ctrl_Rx_cf97c32f_Rx
        PSI_Maths_5547a58a (SdServerService):
          SdServerServiceId = 11
          SdServerServiceInstanceId = 2
          SdServerServiceMajorVersion = 1
          SdServerServiceMinorVersion = 0
          SdServerServiceAutoAvailable = false
          SdServerServiceHandleId = 0
          SdServerServiceTimerRef = PSI_Maths_62c2f1b2
          SdServerServiceUdpRef = SCB_Math_83c40fa4
          EH_Maths_8810a8d8 (SdEventHandler):
            SdEventHandlerEventGroupId = 3
            SdEventHandlerMulticastThreshold = 0
            SdEventHandlerHandleId = 0
            SdEventHandlerMaxRemoteClients = 0
            SdEventHandlerTimerRef = EH_Maths_4cfc0881
            SdEventHandlerUdp: SdEventActivationRef=Math_events_3e1d7af9, SdEventTriggeringRef=Math_events_3e1d7af9
          SdProvidedMethods: SdServerServiceActivationRef=Math_methods_04e78f72
        PSI_Maths_62c2f1b2 (SdServerTimer):
          SdServerTimerInitialOfferDelayMax = 2
          SdServerTimerInitialOfferDelayMin = 0.5
          SdServerTimerInitialOfferRepetitionBaseDelay = 0.2
          SdServerTimerInitialOfferRepetitionsMax = 4
          SdServerTimerOfferCyclicDelay = 2
          SdServerTimerRequestResponseMaxDelay = 1
          SdServerTimerRequestResponseMinDelay = 0.1
          SdServerTimerTTL = 3
        CEG_Basics_1e1472d1 (SdClientTimer): SdClientTimerRequestResponseMaxDelay=0.2, SdClientTimerRequestResponseMinDelay=0.02, SdClientTimerTTL=5
        EH_Maths_4cfc0881 (SdServerTimer): SdServerTimerRequestResponseMaxDelay=1, SdServerTimerRequestResponseMinDelay=0.1, SdServerTimerTTL=3
        CSI_Basics_a309a914 (SdClientTimer):
          SdClientTimerInitialFindDelayMax = 0.5
          SdClientTimerInitialFindDelayMin = 0.1
          SdClientTimerInitialFindRepetitionsBaseDelay = 1.5
          SdClientTimerInitialFindRepetitionsMax = 6
          SdClientTimerTTL = 5
    SdGeneral:
      SdDevErrorDetect = true
      SdMainFunctionCycleTime = 0.005
      SdVersionInfoApi = true
      SdMaxNrOptionsPerMsg = 10
      SdRandomNumberFunctionIncludeFile = Demo.h
      SdRandomNumberFunction = Demo_GetRandNo
      SdSafeBswChecks = false
      SdSetRemAddrOfClientRxMulticastSoCon = true
      SdSubscribeEventgroupRetryEnable = false
      SdGetAndResetMeasurementDataApi = false
      SdRuntimeMeasurementSupport = true
      SdRuntimeErrorReport = true
      SdGeneration:
        SdOutOfBoundsWriteProtectionStrategy = NONE
        SdOutOfBoundsWriteSanitizer = false
        SdOutOfBoundsReadSanitizer = false
        SdReduceConstantData2Define = false
        SdBoolDataInArrayOfStructStrategy = BOOLEAN
        SdDeduplicateIndirectedData = false
        SdDataDeduplicationStrategy = NONE
        SdReduceBoolDataByNegationThreshold = 0
        SdReduceBoolDataByNumericalComparisonThreshold = 0
        SdReduceBoolDataByNumericalRelationThreshold = 0
        SdReduceBoolDataByNumericalOperandStrategy = NONE
        SdReduceNumericalDataByOffsetThreshold = 0
        SdReduceNumericalDataByArraySubtractionThreshold = 0
        SdReduceDataByStreaming = false
        SdShortSymbols = false
        SdInterfacesForDeactivatedData = false
        SdReferringKeysInComments = false
