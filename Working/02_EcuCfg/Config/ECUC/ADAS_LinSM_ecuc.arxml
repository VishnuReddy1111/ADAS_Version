AUTOSAR XML (schema 00048)
package /ActiveEcuC
  module config LinSM: implementation-config-variant=VARIANT-PRE-COMPILE, module-description=LinSM_Impl
    LinSMConfigSet
      CHNL_45618847 (LinSMChannel):
        LinSMNodeType = MASTER
        LinSMConfirmationTimeout = 1
        LinSMSleepSupport = true
        LinSMTransceiverHandling = false
        LinSMComMNetworkHandleRef = CN_LIN00_19b2d5e7
        3 x LinSMSchedule:
          Diagnose_09c374bf: LinSMScheduleIndex=1, LinSMScheduleIndexRef=Diagnose_09c374bf
          CHNL_45618847_32a17f26: LinSMScheduleIndex=0, LinSMScheduleIndexRef=NULLSchedule
          Normal_48a571ca: LinSMScheduleIndex=2, LinSMScheduleIndexRef=Normal_48a571ca
    LinSMGeneral: LinSMDevErrorDetect=true, LinSMMainProcessingPeriod=0.01, LinSMVersionInfoApi=true, LinSMSafeBswChecks=true
      LinSMGeneration: LinSMOutOfBoundsWriteSanitizer=false, LinSMOutOfBoundsReadSanitizer=false, LinSMShortSymbols=false
