AUTOSAR XML (schema 4-3-0)
package /ResourceM
  module config ResourceM: implementation-config-variant=VARIANT-PRE-COMPILE
    ResourceMMcalConfig_0 (ResourceMMcalConfig): ResourceMMasterCore=CORE0
      ResourceMMcalCore0 (ResourceMMcalCore): ResourceMCoreID=CORE0
        ResourceMAllocation: ResourceMModuleName=STM, ResourceMResourceRef=McuStmAllocationConf_0
      ResourceMMcalCore1 (ResourceMMcalCore): ResourceMCoreID=CORE1
        ResourceMAllocation: ResourceMModuleName=STM, ResourceMResourceRef=McuStmAllocationConf_1
