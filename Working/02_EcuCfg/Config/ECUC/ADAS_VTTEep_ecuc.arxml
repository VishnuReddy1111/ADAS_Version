AUTOSAR XML (schema 00048)
package /ActiveEcuC
  module config VTTEep: implementation-config-variant=VARIANT-PRE-COMPILE, module-description=VTTEep_Impl
    EepGeneral: EepDevErrorDetect=true, EepVersionInfoApi=true, EepSafeBswChecks=false
    EepPublishedInformation: EepAllowedWriteCycles=50000, EepEraseTime=20000, EepEraseUnitSize=4, EepEraseValue=255, EepReadUnitSize=1, EepWriteUnitSize=4
    EepInitConfiguration:
      EepBaseAddress = 0
      EepFastReadBlockSize = 256
      EepFastWriteBlockSize = 256
      EepJobCallCycle = 0.005
      EepNormalReadBlockSize = 32
      EepNormalWriteBlockSize = 32
      EepSize = 8192
      EepDefaultMode = MEMIF_MODE_SLOW
      EepDemEventParameterRefs:
        EEP_E_WRITE_FAILED = AutoCreatedDemEvent_EEP_E_WRITE_FAILED_1
        EEP_E_READ_FAILED = AutoCreatedDemEvent_EEP_E_READ_FAILED_1
        EEP_E_ERASE_FAILED = AutoCreatedDemEvent_EEP_E_ERASE_FAILED_1
        EEP_E_COMPARE_FAILED = AutoCreatedDemEvent_EEP_E_COMPARE_FAILED_1
