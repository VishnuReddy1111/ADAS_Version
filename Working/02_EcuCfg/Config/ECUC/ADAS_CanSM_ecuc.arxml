AUTOSAR XML (schema 4-3-0)
package /ActiveEcuC
  module config CanSM: implementation-config-variant=VARIANT-PRE-COMPILE, module-description=CanSM_Impl
    CanSMConfiguration: CanSMModeRequestRepetitionMax=10, CanSMModeRequestRepetitionTime=0.1
      CHNL_b74a53a7 (CanSMManagerNetwork):
        CanSMBorCounterL1ToL2 = 6
        CanSMBorTimeL1 = 0.05
        CanSMBorTimeL2 = 1
        CanSMBorTimeTxEnsured = 2
        CanSMBorTxConfirmationPolling = true
        CanSMComMNetworkHandleRef = CN_HCP5_CANFD01_54d90215
        CT_HCP5_CANFD01_2159a909 (CanSMController): CanSMControllerId=CT_HCP5_CANFD01_e05ce4e2
        CanSMDemEventParameterRefs: CANSM_E_BUS_OFF=AutoCreatedDemEvent_CHNL_346f2748_CANSM_E_BUS_OFF
      CHNL_eb535f7d (CanSMManagerNetwork):
        CanSMBorCounterL1ToL2 = 6
        CanSMBorTimeL1 = 0.05
        CanSMBorTimeL2 = 1
        CanSMBorTimeTxEnsured = 2
        CanSMBorTxConfirmationPolling = true
        CanSMComMNetworkHandleRef = CN_BMC_CAN01_78a85e89
        CT_BMC_CAN01_c53677ab (CanSMController): CanSMControllerId=CT_BMC_CAN01_34f1c2c6
        CanSMDemEventParameterRefs: CANSM_E_BUS_OFF=Busoff_Event
    CanSMGeneral:
      CanSMDevErrorDetect = true
      CanSMMainFunctionTimePeriod = 0.01
      CanSMVersionInfoApi = true
      CanSMBorCheckLevel = true
      CanSMSafeBswChecks = true
      CanSMSetBaudrateApi = false
      CanSMBusOffBegin = J1939Nm_GetBusOffDelay
      CanSMBusOffEnd = J1939Nm_BusOffEnd
      CanSMGeneration: CanSMOutOfBoundsWriteSanitizer=false, CanSMOutOfBoundsReadSanitizer=false
