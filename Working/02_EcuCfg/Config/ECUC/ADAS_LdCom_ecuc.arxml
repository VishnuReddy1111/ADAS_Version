AUTOSAR XML (schema 00048)
package /ActiveEcuC
  module config LdCom: implementation-config-variant=VARIANT-PRE-COMPILE, module-description=LdCom_Impl
    LdComGeneral: LdComDevErrorDetect=true, LdComVersionInfoApi=true, LdComSafeBswChecks=false
      LdComGeneration:
        LdComReduceConstantData2Define = false
        LdComReduceBoolDataByNumericalComparisonThreshold = 2
        LdComReduceDataByStreaming = false
        LdComReduceBoolDataByNumericalRelationThreshold = 2
        LdComOutOfBoundsReadSanitizer = false
        LdComShortSymbols = false
        LdComInterfacesForDeactivatedData = false
        LdComReferringKeysInComments = false
    LdComConfig
      10 x LdComIPdu, all with LdComApiType=LDCOM_IF:
        Basics_Echo_Dashboard_a1beb3bc_Rx: LdComIPduDirection=LDCOM_RECEIVE, LdComHandleId=0, LdComRxIndication=Rte_LdComCbkRxIndication_Basics_Echo_Dashboard_a1beb3bc_Rx, LdComPduRef=Basics_Echo_Dashboard_a1beb3bc_Rx, LdComSystemTemplateSignalRef=EchoDataElement_EchoInterface
        Maths_Multiply_return_MyECU_04446d92_Tx: LdComIPduDirection=LDCOM_SEND, LdComHandleId=6, LdComPduRef=Maths_Multiply_return_MyECU_04446d92_Tx, LdComSystemTemplateSignalRef=Multiply_SI_MathsInterface
        Maths_Triangle_MyECU_98c07da1_Tx: LdComIPduDirection=LDCOM_SEND, LdComHandleId=9, LdComTxTriggerTransmit=Rte_LdComCbkTriggerTransmit_Maths_Triangle_MyECU_98c07da1_Tx, LdComPduRef=Maths_Triangle_MyECU_98c07da1_Tx, LdComSystemTemplateSignalRef=TriangleDataElement_TriangleInterface
        Maths_Substract_call_Dashboard_8bf09c9d_Rx: LdComIPduDirection=LDCOM_RECEIVE, LdComHandleId=7, LdComRxIndication=Rte_LdComCbkRxIndication_Maths_Substract_call_Dashboard_8bf09c9d_Rx, LdComPduRef=Maths_Substract_call_Dashboard_8bf09c9d_Rx, LdComSystemTemplateSignalRef=Substract_SI_MathsInterface
        Maths_Add_call_Dashboard_48c68a8a_Rx: LdComIPduDirection=LDCOM_RECEIVE, LdComHandleId=1, LdComRxIndication=Rte_LdComCbkRxIndication_Maths_Add_call_Dashboard_48c68a8a_Rx, LdComPduRef=Maths_Add_call_Dashboard_48c68a8a_Rx, LdComSystemTemplateSignalRef=Add_SI_MathsInterface
        Maths_Add_return_MyECU_9f735252_Tx: LdComIPduDirection=LDCOM_SEND, LdComHandleId=2, LdComPduRef=Maths_Add_return_MyECU_9f735252_Tx, LdComSystemTemplateSignalRef=Add_SI_MathsInterface
        Maths_Divide_return_MyECU_241d5fc2_Tx: LdComIPduDirection=LDCOM_SEND, LdComHandleId=4, LdComPduRef=Maths_Divide_return_MyECU_241d5fc2_Tx, LdComSystemTemplateSignalRef=Divide_SI_MathsInterface
        Maths_Multiply_call_Dashboard_355aebce_Rx: LdComIPduDirection=LDCOM_RECEIVE, LdComHandleId=5, LdComRxIndication=Rte_LdComCbkRxIndication_Maths_Multiply_call_Dashboard_355aebce_Rx, LdComPduRef=Maths_Multiply_call_Dashboard_355aebce_Rx, LdComSystemTemplateSignalRef=Multiply_SI_MathsInterface
        Maths_Divide_call_Dashboard_4736c743_Rx: LdComIPduDirection=LDCOM_RECEIVE, LdComHandleId=3, LdComRxIndication=Rte_LdComCbkRxIndication_Maths_Divide_call_Dashboard_4736c743_Rx, LdComPduRef=Maths_Divide_call_Dashboard_4736c743_Rx, LdComSystemTemplateSignalRef=Divide_SI_MathsInterface
        Maths_Substract_return_MyECU_b2946133_Tx: LdComIPduDirection=LDCOM_SEND, LdComHandleId=8, LdComPduRef=Maths_Substract_return_MyECU_b2946133_Tx, LdComSystemTemplateSignalRef=Substract_SI_MathsInterface
