AUTOSAR XML (schema 4-3-0)
package /ActiveEcuC
  module config E2EXf: implementation-config-variant=VARIANT-PRE-COMPILE, module-description=E2EXf_Impl
    XfrmGeneral: XfrmDevErrorDetect=true, XfrmVersionInfoApi=true, XfrmSafeBswChecks=false
