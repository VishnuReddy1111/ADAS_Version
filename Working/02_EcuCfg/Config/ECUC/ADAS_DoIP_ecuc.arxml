AUTOSAR XML (schema 00048)
package /ActiveEcuC
  module config DoIP: implementation-config-variant=VARIANT-PRE-COMPILE, module-description=DoIP_Impl
    DoIPConfigSet: DoIPLogicalAddress=512, DoIPGid=1103823438081
      DoIPConfigSet_96e5a5d4 (DoIPInterface):
        DoIPAliveCheckResponseTimeout = 0.5
        DoIPGeneralInactivityTime = 300
        DoIPInitialInactivityTime = 2
        DoIPInterfaceId = 0
        DoIPMaxTesterConnections = 2
        DoIPInterfaceActLineCtrl = false
        DoIPInitialVehicleAnnouncementTime = 0.5
        DoIPUseVehicleIdentificationSyncStatus = false
        DoIPUseMacAddressForIdentification = true
        DoIPInterfaceAnnouncementStart = DOIP_AUTOMATIC_ANNOUNCE
        DoIPInterfaceActLineInactiveTimeout = 0
        DoIPVehicleAnnouncementInterval = 0.5
        DoIPVehicleAnnouncementCount = 3
        DoIPRoutingActivation: DoIPRoutingActivationNumber=0, DoIPTargetAddressRef=DoIP_TA_funct_ae1d8e81, DoIPTargetAddressRef=DoIP_TA_MyECU_bf2fb2d1
        DoIPRoutingActivation_Flash (DoIPRoutingActivation): DoIPRoutingActivationNumber=0, DoIPTargetAddressRef=DoIP_TA_funct_Flash_4e98aa3d, DoIPTargetAddressRef=DoIP_TA_MyECU_Flash_61010e20
        DoIPConnections
          SCB_DoIP_UDP_c2bf8e34 (DoIPUdpVehicleAnnouncementConnection): DoIPRequestAddressAssignment=false
            DoIPSoAdUdpVehicleAnnouncementTxPdu: DoIPSoAdUdpVehicleAnnouncementTxPduId=3, DoIPSoAdUdpVehicleAnnouncementTxPduRef=DoIP_UDP_VehicleAnnouncement_59a8c6e3_Tx
          SCB_DoIP_UDP_6c08ed5a (DoIPUdpConnection): DoIPRequestAddressAssignment=false
            DoIPSoAdUdpRxPdu_9413567d (DoIPSoAdUdpRxPdu): DoIPSoAdUdpRxPduId=2, DoIPSoAdUdpRxPduRef=DoIP_UDP_Tester_Tx_MyECU_Rx_c8039ea2_Rx
            DoIPSoAdUdpTxPdu_9413567d (DoIPSoAdUdpTxPdu): DoIPSoAdUdpTxPduId=2, DoIPSoAdUdpTxPduRef=DoIP_UDP_MyECU_Tx_Tester_Rx_cf0a4108_Tx
          DoIP_TA_MyECU_Flash_61010e20 (DoIPTargetAddress): DoIPTargetAddressValue=512, DoIPTargetAddressVerification=false
          SCB_DoIP_TCP_14c6c034 (DoIPTcpConnection): DoIPRequestAddressAssignment=false, DoIPUsePlusOneSocket=true
            DoIPSoAdTcpTxPdu_fc95cec4 (DoIPSoAdTcpTxPdu): DoIPSoAdTcpTxPduId=0, DoIPSoAdTcpTxPduRef=DoIP_TCP01_MyECU_Tx_Tester_Rx_c55a3b76_Tx
            DoIPSoAdTcpRxPdu_fc95cec4 (DoIPSoAdTcpRxPdu): DoIPSoAdTcpRxPduId=0, DoIPSoAdTcpRxPduRef=DoIP_TCP01_Tester_Tx_MyECU_Rx_c253e4dc_Rx
          SCB_DoIP_TCP_b2b1cb80 (DoIPTcpConnection): DoIPRequestAddressAssignment=false, DoIPUsePlusOneSocket=true
            DoIPSoAdTcpRxPdu_b631e762 (DoIPSoAdTcpRxPdu): DoIPSoAdTcpRxPduId=1, DoIPSoAdTcpRxPduRef=DoIP_TCP02_Tester_Tx_MyECU_Rx_9571c88e_Rx
            DoIPSoAdTcpTxPdu_b631e762 (DoIPSoAdTcpTxPdu): DoIPSoAdTcpTxPduId=1, DoIPSoAdTcpTxPduRef=DoIP_TCP02_MyECU_Tx_Tester_Rx_92781724_Tx
          3 x DoIPTargetAddress, all with DoIPTargetAddressVerification=false:
            DoIP_TA_MyECU_bf2fb2d1: DoIPTargetAddressValue=512
            DoIP_TA_funct_Flash_4e98aa3d: DoIPTargetAddressValue=58368
            DoIP_TA_funct_ae1d8e81: DoIPTargetAddressValue=58368
          DoIPIpAddressAssignment_NEP_MyECU_b5eec5f0_NEP_MyECU_22f7945c (DoIPIpAddressAssignment): DoIPControlIpAssignment=false, DoIPIpAddressAssignmentRef=NEP_MyECU_22f7945c
        4 x DoIPChannel, all with DoIPTargetMaxBufSize=4095:
          DoIP_Conn_funct_987241d4: DoIPChannelId=0, DoIPChannelSARef=DoIP_SA_Tester_53e814ef, DoIPChannelTARef=DoIP_TA_funct_ae1d8e81
            DoIPPduRRxPdu_80c9338e (DoIPPduRRxPdu): DoIPPduRRxPduId=0, DoIPPduRRxPduRef=DoIP_Functional_Request_all_nodes_d1a1a43b_Rx
          DoIP_Conn_MyECU_Physical_Request_5153bcd1: DoIPChannelId=1, DoIPChannelSARef=DoIP_SA_Tester_53e814ef, DoIPChannelTARef=DoIP_TA_MyECU_bf2fb2d1
            DoIPPduRRxPdu_4eb8f14b (DoIPPduRRxPdu): DoIPPduRRxPduId=1, DoIPPduRRxPduRef=DoIP_MyECU_Physical_Request_Tester_MyECU_c384336a_Rx
            DoIPPduRTxPdu_4eb8f14b (DoIPPduRTxPdu): DoIPPduType=DOIP_TPPDU, DoIPPduRTxPduId=0, DoIPPduRTxPduRef=DoIP_MyECU_Response_MyECU_Tester_d65932b1_Tx
          DoIP_Conn_MyECU_Physical_Request_Flasher_d4d21492: DoIPChannelId=2, DoIPChannelSARef=DoIP_SA_Flasher_010ddfd1, DoIPChannelTARef=DoIP_TA_MyECU_Flash_61010e20
            DoIPPduRRxPdu_94a90dd4 (DoIPPduRRxPdu): DoIPPduRRxPduId=2, DoIPPduRRxPduRef=DoIP_MyECU_Physical_Request_Tester_MyECU_Flasher_b47b8d10_Rx
            DoIPPduRTxPdu_94a90dd4 (DoIPPduRTxPdu): DoIPPduType=DOIP_TPPDU, DoIPPduRTxPduId=1, DoIPPduRTxPduRef=DoIP_MyECU_Response_MyECU_Tester_Flasher_4fdbfbed_Tx
          DoIP_Conn_funct_Flasher_4aed9a55: DoIPChannelId=3, DoIPChannelSARef=DoIP_SA_Flasher_010ddfd1, DoIPChannelTARef=DoIP_TA_funct_Flash_4e98aa3d
            DoIPPduRRxPdu_fa4b8731 (DoIPPduRRxPdu): DoIPPduRRxPduId=3, DoIPPduRRxPduRef=DoIP_Functional_Request_DoIP_Flasher_9a43d774_Rx
        DoIP_SA_Flasher_010ddfd1 (DoIPTester): DoIPTesterSA=1, DoIPNumByteDiagAckNack=256, DoIPRoutingActivationRef=DoIPRoutingActivation_Flash
        DoIP_SA_Tester_53e814ef (DoIPTester): DoIPTesterSA=409, DoIPNumByteDiagAckNack=256, DoIPRoutingActivationRef=DoIPRoutingActivation
    DoIPGeneral:
      DoIPDevelopmentErrorDetect = true
      DoIPDhcpOptionVinUse = false
      DoIPEntityStatusMaxByteFieldUse = false
      DoIPGIDInvalidityPattern = 0
      DoIPHostNameSizeMax = DoIP-
      DoIPMainFunctionPeriod = 0.005
      DoIPMaxRequestBytes = 4099
      DoIPMaxUDPRequestPerMessage = 1
      DoIPNodeType = DOIP_GATEWAY
      DoIPUseEIDasGID = false
      DoIPGetAndResetMeasurementDataApi = false
      DoIPVersionInfoApi = true
      DoIPVinGidMaster = false
      DoIPVinInvalidityPattern = 0
      DoIPSupportEntityState = false
      DoIPSupportVidWithEId = false
      DoIPSupportPduSizeRouting = false
      DoIPTcpTxMgtQueueSize = 2
      DoIPUdpTxMgtListSize = 2
      DoIPSupportShutdown = false
      DoIPSupportOemSpecificPayloadTypes = false
      DoIPSafeBswChecks = false
      DoIPTcpRxMultiMessage = false
      DoIPTcpTxMgtQueueProcessLimit = 2
      DoIPDhcpOptionVendorEntNum3210Use = false
      DoIPOverwriteLogicalTargetAddressApi = false
      DoIPSupportGracefulClose = false
      DoIPUserDataSizeOnStartOfReception = 2
      DoIPHeaderFileInclusion = Demo.h
      DoIPGetVinCallback: DoIPGetVinDirect=Demo_DoIpGetVin
      DoIPPowerModeCallback: DoIPPowerModeDirect=Demo_DoIpGetDiagPowerMode
      DoIPGeneration:
        DoIPOutOfBoundsWriteProtectionStrategy = NONE
        DoIPOutOfBoundsWriteSanitizer = false
        DoIPOutOfBoundsReadSanitizer = false
        DoIPReduceConstantData2Define = false
        DoIPBoolDataInArrayOfStructStrategy = BITMASKING
        DoIPDeduplicateIndirectedData = true
        DoIPDataDeduplicationStrategy = DEDUPLICATE_CONST_DATA_WITH_CAST
        DoIPReduceBoolDataByNegationThreshold = 2
        DoIPReduceBoolDataByNumericalComparisonThreshold = 2
        DoIPReduceBoolDataByNumericalRelationThreshold = 2
        DoIPReduceBoolDataByNumericalOperandStrategy = DEDUPLICATE_DATA_WITH_ANY_VALUE
        DoIPReduceNumericalDataByOffsetThreshold = 2
        DoIPReduceNumericalDataByArraySubtractionThreshold = 2
        DoIPReduceDataByStreaming = false
        DoIPShortSymbols = false
        DoIPInterfacesForDeactivatedData = false
        DoIPReferringKeysInComments = false
