AUTOSAR XML (schema 4-3-0)
package /ActiveEcuC
  module config Os: implementation-config-variant=VARIANT-PRE-COMPILE, module-description=Os_Impl
    vCan_30_Mcan_Isr_2 (OsIsr):
      OsIsrInterruptPriority = 21
      OsIsrCategory = CATEGORY_2
      OsIsrInterruptType = EXTERNAL
      OsIsrInterruptSource = 1464
      OsIsrStackSize = 1024
      OsIsrEnableNesting = false
      OsIsrUsesFpu = false
      OsIsrInitialEnableInterruptSource = true
    OsBarrier_SyncInit_Core0_Core1 (OsBarrier): OsBarrierTaskRef=Os/Default_Init_Task, OsBarrierTaskRef=Os/Default_Init_Task_Core1
    OsPublishedInformation: OsKernelVersion=7, OsPlatformName=TriCoreAurix
      TC39x (OsDerivativeInformation):
        OsMpuAlignment = 8
        OsMpuMemoryGapSize = 16
        OsMpuEndAddressAccessible = false
        OsStackAlignment = 8
        OsExceptionVectorTableAlignment = 256
        OsInterruptVectorTableAlignment = 8192
        OsHardwareManuals = User Manual: TC3XX_ts__TargetSpec_rev1v3v0.pdf V1.3.0, 2016-02 Errata Sheet: TC39x AA_Errata_Sheet_rev1v0_2016-06-08.pdf Rel. 1.0, 2016-06-08
        OsCyberSecurityConfiguration = false
        OsMpuPrivilegedRegionsConfigurable = false
        6 x OsPhysicalCore, all with OsPhysicalCoreType=TC1.6.2P, OsPhysicalCoreExceptionSources=8, OsPhysicalCorePrivelegedHwAccess=true:
          Core0: OsPhysicalCoreId=0, OsPhysicalCoreDefaultEntrySymbol=_start_tc0, OsPhysicalCoreMasterStartAllowed=true, OsPhysicalCoreIsAutostart=true, OsPhysicalCoreStackProtectionUnit=OsPhysicalCore0DataMpu
            OsPhysicalCore0DataMpu (OsPhysicalCoreMpu): OsPhysicalCoreMpuId=0, OsPhysicalCoreMpuMaxRegions=18, OsPhysicalCoreMpuType=DATA
            OsPhysicalCore0CodeMpu (OsPhysicalCoreMpu): OsPhysicalCoreMpuId=1, OsPhysicalCoreMpuMaxRegions=10, OsPhysicalCoreMpuType=CODE
          Core1: OsPhysicalCoreId=1, OsPhysicalCoreDefaultEntrySymbol=_start_tc1, OsPhysicalCoreMasterStartAllowed=false, OsPhysicalCoreIsAutostart=false, OsPhysicalCoreStackProtectionUnit=OsPhysicalCore1DataMpu
            OsPhysicalCore1DataMpu (OsPhysicalCoreMpu): OsPhysicalCoreMpuId=0, OsPhysicalCoreMpuMaxRegions=18, OsPhysicalCoreMpuType=DATA
            OsPhysicalCore1CodeMpu (OsPhysicalCoreMpu): OsPhysicalCoreMpuId=1, OsPhysicalCoreMpuMaxRegions=10, OsPhysicalCoreMpuType=CODE
          Core2: OsPhysicalCoreId=2, OsPhysicalCoreDefaultEntrySymbol=_start_tc2, OsPhysicalCoreMasterStartAllowed=false, OsPhysicalCoreIsAutostart=false, OsPhysicalCoreStackProtectionUnit=OsPhysicalCore2DataMpu
            OsPhysicalCore2DataMpu (OsPhysicalCoreMpu): OsPhysicalCoreMpuId=0, OsPhysicalCoreMpuMaxRegions=18, OsPhysicalCoreMpuType=DATA
            OsPhysicalCore2CodeMpu (OsPhysicalCoreMpu): OsPhysicalCoreMpuId=1, OsPhysicalCoreMpuMaxRegions=10, OsPhysicalCoreMpuType=CODE
          Core3: OsPhysicalCoreId=3, OsPhysicalCoreDefaultEntrySymbol=_start_tc3, OsPhysicalCoreMasterStartAllowed=false, OsPhysicalCoreIsAutostart=false, OsPhysicalCoreStackProtectionUnit=OsPhysicalCore3DataMpu
            OsPhysicalCore3DataMpu (OsPhysicalCoreMpu): OsPhysicalCoreMpuId=0, OsPhysicalCoreMpuMaxRegions=18, OsPhysicalCoreMpuType=DATA
            OsPhysicalCore3CodeMpu (OsPhysicalCoreMpu): OsPhysicalCoreMpuId=1, OsPhysicalCoreMpuMaxRegions=10, OsPhysicalCoreMpuType=CODE
          Core4: OsPhysicalCoreId=4, OsPhysicalCoreDefaultEntrySymbol=_start_tc4, OsPhysicalCoreMasterStartAllowed=false, OsPhysicalCoreIsAutostart=false, OsPhysicalCoreStackProtectionUnit=OsPhysicalCore4DataMpu
            OsPhysicalCore4DataMpu (OsPhysicalCoreMpu): OsPhysicalCoreMpuId=0, OsPhysicalCoreMpuMaxRegions=18, OsPhysicalCoreMpuType=DATA
            OsPhysicalCore4CodeMpu (OsPhysicalCoreMpu): OsPhysicalCoreMpuId=1, OsPhysicalCoreMpuMaxRegions=10, OsPhysicalCoreMpuType=CODE
          Core5: OsPhysicalCoreId=6, OsPhysicalCoreDefaultEntrySymbol=_start_tc5, OsPhysicalCoreMasterStartAllowed=false, OsPhysicalCoreIsAutostart=false, OsPhysicalCoreStackProtectionUnit=OsPhysicalCore5DataMpu
            OsPhysicalCore5DataMpu (OsPhysicalCoreMpu): OsPhysicalCoreMpuId=0, OsPhysicalCoreMpuMaxRegions=18, OsPhysicalCoreMpuType=DATA
            OsPhysicalCore5CodeMpu (OsPhysicalCoreMpu): OsPhysicalCoreMpuId=1, OsPhysicalCoreMpuMaxRegions=10, OsPhysicalCoreMpuType=CODE
        6 x OsHardwareTimer, all with OsHardwareTimerSize=32, OsHardwareTimerUnit=FRT, OsHardwareTimerType=STM:
          STM0: OsHardwareTimerBaseAddress=4026535936, OsHardwareTimerId=0
            STM0_Ch0 (OsHardwareTimerChannel): OsHardwareTimerChannelIntSource=768, OsHardwareTimerChannelOffset=0, OsHardwareTimerChannelId=0
            STM0_Ch1 (OsHardwareTimerChannel): OsHardwareTimerChannelIntSource=772, OsHardwareTimerChannelOffset=1, OsHardwareTimerChannelId=1
          STM1: OsHardwareTimerBaseAddress=4026536192, OsHardwareTimerId=1
            STM1_Ch0 (OsHardwareTimerChannel): OsHardwareTimerChannelIntSource=776, OsHardwareTimerChannelOffset=0, OsHardwareTimerChannelId=0
            STM1_Ch1 (OsHardwareTimerChannel): OsHardwareTimerChannelIntSource=780, OsHardwareTimerChannelOffset=1, OsHardwareTimerChannelId=1
          STM2: OsHardwareTimerBaseAddress=4026536448, OsHardwareTimerId=2
            STM2_Ch0 (OsHardwareTimerChannel): OsHardwareTimerChannelIntSource=784, OsHardwareTimerChannelOffset=0, OsHardwareTimerChannelId=0
            STM2_Ch1 (OsHardwareTimerChannel): OsHardwareTimerChannelIntSource=788, OsHardwareTimerChannelOffset=1, OsHardwareTimerChannelId=1
          STM3: OsHardwareTimerBaseAddress=4026536704, OsHardwareTimerId=3
            STM3_Ch0 (OsHardwareTimerChannel): OsHardwareTimerChannelIntSource=792, OsHardwareTimerChannelOffset=0, OsHardwareTimerChannelId=0
            STM3_Ch1 (OsHardwareTimerChannel): OsHardwareTimerChannelIntSource=796, OsHardwareTimerChannelOffset=1, OsHardwareTimerChannelId=1
          STM4: OsHardwareTimerBaseAddress=4026536960, OsHardwareTimerId=4
            STM4_Ch0 (OsHardwareTimerChannel): OsHardwareTimerChannelIntSource=800, OsHardwareTimerChannelOffset=0, OsHardwareTimerChannelId=0
            STM4_Ch1 (OsHardwareTimerChannel): OsHardwareTimerChannelIntSource=804, OsHardwareTimerChannelOffset=1, OsHardwareTimerChannelId=1
          STM5: OsHardwareTimerBaseAddress=4026537216, OsHardwareTimerId=5
            STM5_Ch0 (OsHardwareTimerChannel): OsHardwareTimerChannelIntSource=808, OsHardwareTimerChannelOffset=0, OsHardwareTimerChannelId=0
            STM5_Ch1 (OsHardwareTimerChannel): OsHardwareTimerChannelIntSource=812, OsHardwareTimerChannelOffset=1, OsHardwareTimerChannelId=1
        AURIXTC3XX_IR (OsSystemIntCtrl): OsSystemIntCtrlMaxPrios=255, OsSystemIntCtrlPrioOrder=ASC, OsSystemIntCtrlMaxSources=8192, OsSystemIntCtrlBaseAddress=4026757120
        GPT (OsHardwareTimer): OsHardwareTimerSize=16, OsHardwareTimerUnit=PIT, OsHardwareTimerBaseAddress=4026537984, OsHardwareTimerId=0, OsHardwareTimerType=PIT
          GPT_Ch0 (OsHardwareTimerChannel): OsHardwareTimerChannelIntSource=744, OsHardwareTimerChannelOffset=0, OsHardwareTimerChannelId=0
          GPT_Ch1 (OsHardwareTimerChannel): OsHardwareTimerChannelIntSource=756, OsHardwareTimerChannelOffset=1, OsHardwareTimerChannelId=1
        OsMemoryRegionSpecifics
          18 x OsMemoryRegionAccess:
            PS0_R: OsMemoryRegionAccessRights=R, OsMemoryRegionAccessType=PROTECTION_SET0
            PS0_W: OsMemoryRegionAccessRights=W, OsMemoryRegionAccessType=PROTECTION_SET0
            PS0_X: OsMemoryRegionAccessRights=X, OsMemoryRegionAccessType=PROTECTION_SET0
            PS1_R: OsMemoryRegionAccessRights=R, OsMemoryRegionAccessType=PROTECTION_SET1
            PS1_W: OsMemoryRegionAccessRights=W, OsMemoryRegionAccessType=PROTECTION_SET1
            PS1_X: OsMemoryRegionAccessRights=X, OsMemoryRegionAccessType=PROTECTION_SET1
            PS2_R: OsMemoryRegionAccessRights=R, OsMemoryRegionAccessType=PROTECTION_SET2
            PS2_W: OsMemoryRegionAccessRights=W, OsMemoryRegionAccessType=PROTECTION_SET2
            PS2_X: OsMemoryRegionAccessRights=X, OsMemoryRegionAccessType=PROTECTION_SET2
            PS3_R: OsMemoryRegionAccessRights=R, OsMemoryRegionAccessType=PROTECTION_SET3
            PS3_W: OsMemoryRegionAccessRights=W, OsMemoryRegionAccessType=PROTECTION_SET3
            PS3_X: OsMemoryRegionAccessRights=X, OsMemoryRegionAccessType=PROTECTION_SET3
            PS4_R: OsMemoryRegionAccessRights=R, OsMemoryRegionAccessType=PROTECTION_SET4
            PS4_W: OsMemoryRegionAccessRights=W, OsMemoryRegionAccessType=PROTECTION_SET4
            PS4_X: OsMemoryRegionAccessRights=X, OsMemoryRegionAccessType=PROTECTION_SET4
            PS5_R: OsMemoryRegionAccessRights=R, OsMemoryRegionAccessType=PROTECTION_SET5
            PS5_W: OsMemoryRegionAccessRights=W, OsMemoryRegionAccessType=PROTECTION_SET5
            PS5_X: OsMemoryRegionAccessRights=X, OsMemoryRegionAccessType=PROTECTION_SET5
        DMA (OsInterruptSupportedType):
          OsInterruptSupportedTypeSeparateSources = false
          OsInterruptSupportedTypeSeparatePriority = true
          OsInterruptSupportedTypeIsMapped = false
          OsInterruptSupportedTypePostActionRequired = false
    OS_APPMODE_ANY (OsAppMode)
    OSDEFAULTAPPMODE (OsAppMode)
    OsOS:
      OsGenerateMemMap = COMPLETE
      OsGenerateMemMapForThreads = false
      OsStackMonitoring = true
      OsStatus = STANDARD
      OsUseGetServiceId = false
      OsUseParameterAccess = false
      OsUseResScheduler = true
      OsForcibleTermination = false
      OsGenerateCalloutStubs = true
      OsGenerateMemMapForNearAddressing = true
      OsServiceProtection = false
      OsStackUsageMeasurement = true
      OsUseXSignalAsyncApiCalls = false
      OsFpuUsage = NONE
      OsNumberOfCores = 2
      OsScalabilityClass = SC1
      OsUseCase = STANDARD
      OsUseArti = false
      OsMasterCore = OsCore0
      OsSystemTimer = SystemTimer_Core0
      OsHooks: OsErrorHook=true, OsPostTaskHook=false, OsPreTaskHook=false, OsShutdownHook=true, OsStartupHook=false
      OsStackSummary
        25 x OsStack:
          OsCore0_Error: OsStackSize=1024, OsStackType=CORE_ERROR_STACK, OsStackCore=OsCore0, OsStackUser=OsCore0
          OsCore0_Init: OsStackSize=1024, OsStackType=CORE_INIT_STACK, OsStackCore=OsCore0, OsStackUser=OsCore0
          OsCore0_Kernel: OsStackSize=1024, OsStackType=CORE_KERNEL_STACK, OsStackCore=OsCore0, OsStackUser=OsCore0
          OsCore0_Isr_Core: OsStackSize=4096, OsStackType=ISR_SHARED_CORE_STACK, OsStackCore=OsCore0, OsStackUser=CounterIsr_SystemTimer_Core0, OsStackUser=XSignalIsr_OsCore0, OsStackUser=vCan_30_Mcan_Isr_2, OsStackUser=vCan_30_Mcan_Isr_9
          Default_Appl_Task: OsStackSize=4096, OsStackType=TASK_EXTENDED_STACK, OsStackCore=OsCore0, OsStackUser=Os/Default_Appl_Task
          Default_BSW_Async_Task: OsStackSize=4096, OsStackType=TASK_EXTENDED_STACK, OsStackCore=OsCore0, OsStackUser=Os/Default_BSW_Async_Task
          OsCore0_Task_Prio10: OsStackSize=1024, OsStackType=TASK_SHARED_PRIORITY_STACK, OsStackCore=OsCore0, OsStackUser=Default_RTE_Mode_switch_Task
          OsCore0_Task_Prio4294967295: OsStackSize=1024, OsStackType=TASK_SHARED_PRIORITY_STACK, OsStackCore=OsCore0, OsStackUser=IdleTask_OsCore0
          OsCore0_Task_Prio45: OsStackSize=1024, OsStackType=TASK_SHARED_PRIORITY_STACK, OsStackCore=OsCore0, OsStackUser=Default_Appl_Init_Task, OsStackUser=StartApplication_Appl_Init_Task, OsStackUser=StartApplication_NoSwc_Init_Task
          OsCore0_Task_Prio5: OsStackSize=1024, OsStackType=TASK_SHARED_PRIORITY_STACK, OsStackCore=OsCore0, OsStackUser=StartApplication_Appl_Task
          StartApplication_NoSwc_Appl_Task: OsStackSize=1024, OsStackType=TASK_EXTENDED_STACK, OsStackCore=OsCore0, OsStackUser=Os/StartApplication_NoSwc_Appl_Task
          OsCore0_Task_Prio0: OsStackSize=1024, OsStackType=TASK_SHARED_PRIORITY_STACK, OsStackCore=OsCore0, OsStackUser=BswBackgroundTask
          OsCore0_Task_Prio49: OsStackSize=1024, OsStackType=TASK_SHARED_PRIORITY_STACK, OsStackCore=OsCore0, OsStackUser=Default_Init_Task_Trusted
          OsCore1_Task_Prio4294967295: OsStackSize=1024, OsStackType=TASK_SHARED_PRIORITY_STACK, OsStackCore=OsCore1, OsStackUser=IdleTask_OsCore1
          OsCore1_Kernel: OsStackSize=1024, OsStackType=CORE_KERNEL_STACK, OsStackCore=OsCore1, OsStackUser=OsCore1
          OsCore1_Init: OsStackSize=1024, OsStackType=CORE_INIT_STACK, OsStackCore=OsCore1, OsStackUser=OsCore1
          OsCore1_Error: OsStackSize=1024, OsStackType=CORE_ERROR_STACK, OsStackCore=OsCore1, OsStackUser=OsCore1
          OsCore1_Isr_Core: OsStackSize=1024, OsStackType=ISR_SHARED_CORE_STACK, OsStackCore=OsCore1, OsStackUser=XSignalIsr_OsCore1, OsStackUser=CounterIsr_SystemTimer_Core1
          OsCore1_Task_Prio49: OsStackSize=1024, OsStackType=TASK_SHARED_PRIORITY_STACK, OsStackCore=OsCore1, OsStackUser=Default_Init_Task_Core1_Trusted
          Default_Init_Task_Core1: OsStackSize=1024, OsStackType=TASK_EXTENDED_STACK, OsStackCore=OsCore1, OsStackUser=Os/Default_Init_Task_Core1
          Default_Init_Task: OsStackSize=1024, OsStackType=TASK_EXTENDED_STACK, OsStackCore=OsCore0, OsStackUser=Os/Default_Init_Task
          Default_BSW_Task_Core1: OsStackSize=1024, OsStackType=TASK_EXTENDED_STACK, OsStackCore=OsCore1, OsStackUser=Os/Default_BSW_Task_Core1
          OsCore0_Task_Prio40: OsStackSize=4096, OsStackType=TASK_SHARED_PRIORITY_STACK, OsStackCore=OsCore0, OsStackUser=Default_BSW_Sync_Task
          OsCore0_Shutdown: OsStackSize=1024, OsStackType=CORE_SHUTDOWN_STACK, OsStackCore=OsCore0, OsStackUser=OsCore0
          OsCore1_Shutdown: OsStackSize=1024, OsStackType=CORE_SHUTDOWN_STACK, OsStackCore=OsCore1, OsStackUser=OsCore1
    SystemTimer_Core0 (OsCounter):
      OsCounterMaxAllowedValue = 1073741823
      OsCounterMinCycle = 1
      OsCounterType = HARDWARE
      OsSecondsPerTick = 0.001
      OsCounterTicksPerBase = 100000
      OsCounterAccessingApplication = OsApplication_SystemApplication_Core0
      OsCounterAccessingApplication = OsApplication_SystemApplication_Core1
      OsDriver: OsDriverHighResolution=false, OsDriverHardwareTimerChannelRef=STM0_Ch0, OsDriverIsrRef=CounterIsr_SystemTimer_Core0
    OsCore0 (OsCore):
      OsCoreIsAutosar = true
      OsCoreIsAutostart = true
      OsCoreEntrySymbol = _start_tc0
      OsCorePhysicalCoreRef = Core0
      OsCoreIdleTask = IdleTask_OsCore0
      OsCoreSystemApplication = OsApplication_SystemApplication_Core0
      OsCoreEcucCoreRef = EcucCoreDefinition_Core0
      OsCoreResScheduler = RES_SCHEDULER_OsCore0
      OsCoreStacks:
        OsCoreKernelStackSize = 1024
        OsCoreStartupStackSize = 1024
        OsCoreShutdownStackSize = 1024
        OsCoreErrorStackSize = 1024
        OsCoreProtectionStackSize = 1024
        OsCoreInitStackSize = 1024
      XSignalChl_OsCore1 (OsCoreXSignalChannel): OsCoreXSignalChannelSize=1, OsCoreXSignalChannelReceiverIsr=XSignalIsr_OsCore1
    IdleTask_OsCore0 (OsTask):
      OsTaskActivation = 1
      OsTaskPriority = 4294967295
      OsTaskSchedule = FULL
      OsTaskStackSharing = false
      OsTaskStackSize = 1024
      OsTaskType = AUTO
      OsTaskUsesFpu = false
      OsTaskAccessingApplication = OsApplication_SystemApplication_Core0
      OsTaskAccessingApplication = OsApplication_SystemApplication_Core1
      OsTaskResourceRef = RES_SCHEDULER_OsCore0
      OsTaskAutostart: OsTaskAppModeRef=OS_APPMODE_ANY
    OsApplication_SystemApplication_Core0 (OsApplication):
      OsTrusted = true
      OsTrustedApplicationDelayTimingViolationCall = false
      OsTrustedApplicationWithProtection = false
      OsApplicationIsPrivileged = true
      OsAppUseTrustedFunctionStubs = false
      OsApplicationCoreRef = EcucCoreDefinition_Core0
      OsAppCounterRef = SystemTimer_Core0
      OsAppTaskRef = IdleTask_OsCore0
      OsAppTaskRef = Default_Appl_Init_Task
      OsAppTaskRef = Os/Default_Appl_Task
      OsAppTaskRef = Os/Default_BSW_Async_Task
      OsAppTaskRef = Default_BSW_Sync_Task
      OsAppTaskRef = Os/Default_Init_Task
      OsAppTaskRef = Default_RTE_Mode_switch_Task
      OsAppAlarmRef = Rte_Al_TE2_Default_BSW_Async_Task_0_10ms
      OsAppAlarmRef = Rte_Al_TE2_Default_BSW_Async_Task_0_20ms
      OsAppAlarmRef = Rte_Al_TE2_Default_BSW_Async_Task_0_5ms
      OsAppAlarmRef = Rte_Al_TE2_Default_BSW_Sync_Task_0_5ms
      OsAppAlarmRef = Rte_Al_TE_StartApplication_StartApplication_Cyclic1000ms
      OsAppAlarmRef = Rte_Al_TE_StartApplication_StartApplication_Cyclic1ms
      OsAppAlarmRef = Rte_Al_TE_StartApplication_StartApplication_Cyclic250ms
      OsAppIsrRef = CounterIsr_SystemTimer_Core0
      OsAppAlarmRef = Rte_Al_TE2_Default_BSW_Async_Task_0_2ms
      OsAppTaskRef = StartApplication_Appl_Init_Task
      OsAppTaskRef = StartApplication_Appl_Task
      OsAppAlarmRef = StartApplication_NoSwc_Appl_Task_Alarm
      OsAppTaskRef = Os/StartApplication_NoSwc_Appl_Task
      OsAppTaskRef = StartApplication_NoSwc_Init_Task
      OsAppTaskRef = BswBackgroundTask
      OsAppTaskRef = Default_Init_Task_Trusted
      OsAppIsrRef = XSignalIsr_OsCore0
      OsAppEcucPartitionRef = EcucPartition_SystemApplication_Core0
      OsAppAlarmRef = Rte_Al_TE_Can_30_Core_Can_30_Core_MainFunction_Write
      OsAppIsrRef = vCan_30_Mcan_Isr_2
      OsAppIsrRef = vCan_30_Mcan_Isr_9
      OsAppAlarmRef = Rte_Al_TE_Default_Appl_Task_0_100ms
      OsAppAlarmRef = Rte_Al_TE2_Default_Appl_Task_0_100ms
      OsAppAlarmRef = Rte_Al_TE_Default_Appl_Task_0_10ms
      OsAppAlarmRef = Rte_Al_TE_Default_Appl_Task_0_50ms
      OsApplicationHooks: OsAppErrorHook=false, OsAppShutdownHook=false, OsAppStartupHook=false
    6 x OsTask, all with OsTaskActivation=1, OsTaskStackSharing=false, OsTaskUsesFpu=false, OsTaskAccessingApplication=OsApplication_SystemApplication_Core0, OsTaskAccessingApplication=OsApplication_SystemApplication_Core1, OsTaskResourceRef=RES_SCHEDULER_OsCore0:
      Default_Init_Task: OsTaskPriority=1000, OsTaskSchedule=NON, OsTaskStackSize=1024, OsTaskType=AUTO, OsTaskEventRef=BswM_Init_Core0
        OsTaskAutostart: OsTaskAppModeRef=OS_APPMODE_ANY
      Default_BSW_Sync_Task: OsTaskPriority=40, OsTaskSchedule=NON, OsTaskStackSize=4096, OsTaskType=AUTO, OsTaskResourceRef=OsResource
      Default_BSW_Async_Task: OsTaskPriority=30, OsTaskSchedule=FULL, OsTaskStackSize=4096, OsTaskType=AUTO, OsTaskResourceRef=OsResource, OsTaskEventRef=Rte_Ev_Cyclic2_Default_BSW_Async_Task_0_10ms, OsTaskEventRef=Rte_Ev_Cyclic2_Default_BSW_Async_Task_0_20ms, OsTaskEventRef=Rte_Ev_Cyclic2_Default_BSW_Async_Task_0_5ms, OsTaskEventRef=Rte_Ev_Cyclic2_Default_BSW_Async_Task_0_2ms, OsTaskEventRef=Rte_Ev_Run_Can_30_Core_Can_30_Core_MainFunction_Write
      Default_RTE_Mode_switch_Task: OsTaskPriority=10, OsTaskSchedule=NON, OsTaskStackSize=1024, OsTaskType=AUTO, OsTaskResourceRef=OsResource
      Default_Appl_Task: OsTaskPriority=5, OsTaskSchedule=NON, OsTaskStackSize=4096, OsTaskType=AUTO, OsTaskResourceRef=OsResource, OsTaskEventRef=Rte_Ev_Run_StartApplication_StartApplication_Cyclic1000ms, OsTaskEventRef=Rte_Ev_Run_StartApplication_StartApplication_Cyclic1ms, OsTaskEventRef=Rte_Ev_Run_StartApplication_StartApplication_Cyclic250ms, OsTaskEventRef=Rte_Ev_Run_StartApplication_StartApplication_OnDataRec_RxCtrl, OsTaskEventRef=Rte_Ev_Run_StartApplication_StartApplication_OnDataRec_RxData, OsTaskEventRef=Rte_Ev_Run_StartApplication_StartApplication_OnDataRec_RxLargeData, OsTaskEventRef=Rte_Ev_Run_StartApplication_StartApplication_OnDataRec_SlaveCore1, OsTaskEventRef=Rte_Ev_Run_StartApplication_StartApplication_OnDataRec_EthernetCommunication, OsTaskEventRef=Rte_Ev_Cyclic_Default_Appl_Task_0_100ms, OsTaskEventRef=Rte_Ev_Run_ShA_Ivd_CurrentMode_PostRun, OsTaskEventRef=Rte_Ev_Run_ShA_Ivd_CurrentMode_Run, OsTaskEventRef=Rte_Ev_Cyclic2_Default_Appl_Task_0_100ms, OsTaskEventRef=Rte_Ev_Cyclic_Default_Appl_Task_0_10ms, OsTaskEventRef=Rte_Ev_Cyclic_Default_Appl_Task_0_50ms
      Default_Appl_Init_Task: OsTaskPriority=45, OsTaskSchedule=NON, OsTaskStackSize=1024, OsTaskType=BASIC
    OsResource: OsResourceProperty=STANDARD, OsResourceAccessingApplication=OsApplication_SystemApplication_Core0
    7 x OsAlarm, all with OsAlarmCounterRef=SystemTimer_Core0, OsAlarmAccessingApplication=OsApplication_SystemApplication_Core0, OsAlarmAccessingApplication=OsApplication_SystemApplication_Core1:
      Rte_Al_TE_StartApplication_StartApplication_Cyclic1000ms
        OsAlarmAction
          OsAlarmSetEvent: OsAlarmSetEventRef=Rte_Ev_Run_StartApplication_StartApplication_Cyclic1000ms, OsAlarmSetEventTaskRef=Os/Default_Appl_Task
      Rte_Al_TE_StartApplication_StartApplication_Cyclic1ms
        OsAlarmAction
          OsAlarmSetEvent: OsAlarmSetEventRef=Rte_Ev_Run_StartApplication_StartApplication_Cyclic1ms, OsAlarmSetEventTaskRef=Os/Default_Appl_Task
      Rte_Al_TE_StartApplication_StartApplication_Cyclic250ms
        OsAlarmAction
          OsAlarmSetEvent: OsAlarmSetEventRef=Rte_Ev_Run_StartApplication_StartApplication_Cyclic250ms, OsAlarmSetEventTaskRef=Os/Default_Appl_Task
      Rte_Al_TE2_Default_BSW_Async_Task_0_10ms
        OsAlarmAction
          OsAlarmSetEvent: OsAlarmSetEventRef=Rte_Ev_Cyclic2_Default_BSW_Async_Task_0_10ms, OsAlarmSetEventTaskRef=Os/Default_BSW_Async_Task
      Rte_Al_TE2_Default_BSW_Async_Task_0_20ms
        OsAlarmAction
          OsAlarmSetEvent: OsAlarmSetEventRef=Rte_Ev_Cyclic2_Default_BSW_Async_Task_0_20ms, OsAlarmSetEventTaskRef=Os/Default_BSW_Async_Task
      Rte_Al_TE2_Default_BSW_Async_Task_0_5ms
        OsAlarmAction
          OsAlarmSetEvent: OsAlarmSetEventRef=Rte_Ev_Cyclic2_Default_BSW_Async_Task_0_5ms, OsAlarmSetEventTaskRef=Os/Default_BSW_Async_Task
      Rte_Al_TE2_Default_BSW_Sync_Task_0_5ms
        OsAlarmAction
          OsAlarmActivateTask: OsAlarmActivateTaskRef=Default_BSW_Sync_Task
    8 x OsEvent:
      Rte_Ev_Cyclic2_Default_BSW_Async_Task_0_10ms
      Rte_Ev_Cyclic2_Default_BSW_Async_Task_0_20ms
      Rte_Ev_Cyclic2_Default_BSW_Async_Task_0_5ms
      Rte_Ev_Run_StartApplication_StartApplication_Cyclic1000ms
      Rte_Ev_Run_StartApplication_StartApplication_Cyclic1ms
      Rte_Ev_Run_StartApplication_StartApplication_Cyclic250ms
      Rte_Ev_Run_StartApplication_StartApplication_OnDataRec_RxCtrl
      Rte_Ev_Run_StartApplication_StartApplication_OnDataRec_RxData
    CounterIsr_SystemTimer_Core0 (OsIsr):
      OsIsrCategory = CATEGORY_2
      OsIsrInterruptType = EXTERNAL
      OsIsrInterruptSource = 768
      OsIsrInterruptPriority = 20
      OsIsrStackSize = 4096
      OsIsrEnableNesting = false
      OsIsrUsesFpu = false
      OsIsrSpecialFunctionName = Os_TimerPfrtIsr
      OsIsrInitialEnableInterruptSource = false
    Rte_Al_TE2_Default_BSW_Async_Task_0_2ms (OsAlarm):
      OsAlarmCounterRef = SystemTimer_Core0
      OsAlarmAccessingApplication = OsApplication_SystemApplication_Core0
      OsAlarmAccessingApplication = OsApplication_SystemApplication_Core1
      OsAlarmAction
        OsAlarmSetEvent: OsAlarmSetEventRef=Rte_Ev_Cyclic2_Default_BSW_Async_Task_0_2ms, OsAlarmSetEventTaskRef=Os/Default_BSW_Async_Task
    Rte_Ev_Cyclic2_Default_BSW_Async_Task_0_2ms (OsEvent)
    3 x OsTask, all with OsTaskActivation=1, OsTaskSchedule=NON, OsTaskStackSharing=false, OsTaskStackSize=1024, OsTaskUsesFpu=false, OsTaskAccessingApplication=OsApplication_SystemApplication_Core0, OsTaskAccessingApplication=OsApplication_SystemApplication_Core1, OsTaskResourceRef=RES_SCHEDULER_OsCore0:
      StartApplication_Appl_Task: OsTaskPriority=5, OsTaskType=AUTO
      StartApplication_Appl_Init_Task: OsTaskPriority=45, OsTaskType=BASIC
      StartApplication_NoSwc_Appl_Task: OsTaskPriority=5, OsTaskType=EXTENDED, OsTaskEventRef=StartApplication_NoSwc_Appl_Task_Event
    StartApplication_NoSwc_Appl_Task_Event (OsEvent)
    StartApplication_NoSwc_Appl_Task_Alarm (OsAlarm):
      OsAlarmCounterRef = SystemTimer_Core0
      OsAlarmAccessingApplication = OsApplication_SystemApplication_Core0
      OsAlarmAccessingApplication = OsApplication_SystemApplication_Core1
      OsAlarmAction
        OsAlarmSetEvent: OsAlarmSetEventRef=StartApplication_NoSwc_Appl_Task_Event, OsAlarmSetEventTaskRef=Os/StartApplication_NoSwc_Appl_Task
    StartApplication_NoSwc_Init_Task (OsTask):
      OsTaskActivation = 1
      OsTaskPriority = 45
      OsTaskSchedule = NON
      OsTaskStackSharing = false
      OsTaskStackSize = 1024
      OsTaskType = BASIC
      OsTaskUsesFpu = false
      OsTaskAccessingApplication = OsApplication_SystemApplication_Core0
      OsTaskAccessingApplication = OsApplication_SystemApplication_Core1
      OsTaskResourceRef = RES_SCHEDULER_OsCore0
      OsTaskAutostart: OsTaskAppModeRef=OS_APPMODE_ANY
    BswBackgroundTask (OsTask):
      OsTaskActivation = 1
      OsTaskPriority = 0
      OsTaskSchedule = FULL
      OsTaskStackSharing = false
      OsTaskStackSize = 1024
      OsTaskType = AUTO
      OsTaskUsesFpu = false
      OsTaskAccessingApplication = OsApplication_SystemApplication_Core0
      OsTaskAccessingApplication = OsApplication_SystemApplication_Core1
      OsTaskResourceRef = RES_SCHEDULER_OsCore0
    Rte_Ev_Run_StartApplication_StartApplication_OnDataRec_RxLargeData (OsEvent)
    Default_Init_Task_Trusted (OsTask):
      OsTaskActivation = 1
      OsTaskPriority = 49
      OsTaskSchedule = FULL
      OsTaskStackSharing = false
      OsTaskStackSize = 1024
      OsTaskType = BASIC
      OsTaskUsesFpu = false
      OsTaskAccessingApplication = OsApplication_SystemApplication_Core0
      OsTaskAccessingApplication = OsApplication_SystemApplication_Core1
      OsTaskResourceRef = RES_SCHEDULER_OsCore0
      OsTaskAutostart: OsTaskAppModeRef=OS_APPMODE_ANY
    OsCore1 (OsCore):
      OsCoreIsAutostart = false
      OsCoreIsAutosar = true
      OsCoreEntrySymbol = _start_tc1
      OsCorePhysicalCoreRef = Core1
      OsCoreEcucCoreRef = EcucCoreDefinition_Core1
      OsCoreIdleTask = IdleTask_OsCore1
      OsCoreSystemApplication = OsApplication_SystemApplication_Core1
      OsCoreResScheduler = RES_SCHEDULER_OsCore1
      OsCoreStacks:
        OsCoreKernelStackSize = 1024
        OsCoreStartupStackSize = 1024
        OsCoreShutdownStackSize = 1024
        OsCoreErrorStackSize = 1024
        OsCoreProtectionStackSize = 1024
        OsCoreInitStackSize = 1024
      XSignalChl_OsCore0 (OsCoreXSignalChannel): OsCoreXSignalChannelSize=1, OsCoreXSignalChannelReceiverIsr=XSignalIsr_OsCore0
    IdleTask_OsCore1 (OsTask):
      OsTaskActivation = 1
      OsTaskPriority = 4294967295
      OsTaskSchedule = FULL
      OsTaskStackSharing = false
      OsTaskStackSize = 1024
      OsTaskType = AUTO
      OsTaskUsesFpu = false
      OsTaskAccessingApplication = OsApplication_SystemApplication_Core0
      OsTaskAccessingApplication = OsApplication_SystemApplication_Core1
      OsTaskResourceRef = RES_SCHEDULER_OsCore1
      OsTaskAutostart: OsTaskAppModeRef=OS_APPMODE_ANY
    OsApplication_SystemApplication_Core1 (OsApplication):
      OsTrusted = true
      OsTrustedApplicationDelayTimingViolationCall = false
      OsTrustedApplicationWithProtection = false
      OsApplicationIsPrivileged = true
      OsAppUseTrustedFunctionStubs = false
      OsApplicationCoreRef = EcucCoreDefinition_Core1
      OsAppTaskRef = IdleTask_OsCore1
      OsAppIsrRef = XSignalIsr_OsCore1
      OsAppCounterRef = SystemTimer_Core1
      OsAppIsrRef = CounterIsr_SystemTimer_Core1
      OsAppTaskRef = Os/Default_Init_Task_Core1
      OsAppTaskRef = Os/Default_BSW_Task_Core1
      OsAppTaskRef = Default_Init_Task_Core1_Trusted
      OsAppAlarmRef = Rte_Al_TE2_Default_BSW_Task_Core1_0_10ms
      OsAppEcucPartitionRef = EcucPartition_SystemApplication_Core1
      OsApplicationHooks: OsAppErrorHook=false, OsAppShutdownHook=false, OsAppStartupHook=false
    XSignalIsr_OsCore0 (OsIsr):
      OsIsrInterruptPriority = 30
      OsIsrCategory = CATEGORY_2
      OsIsrInterruptType = EXTERNAL
      OsIsrInterruptSource = 2448
      OsIsrStackSize = 1024
      OsIsrEnableNesting = false
      OsIsrUsesFpu = false
      OsIsrInitialEnableInterruptSource = false
      OsIsrSpecialFunctionName = Os_XSigRecvIsrHandler
      OsIsrXSignalReceiver:
        OsIsrXSignalReceiverProvidedApis = ShutdownAllCores
        OsIsrXSignalReceiverProvidedApis = ActivateTask
        OsIsrXSignalReceiverProvidedApis = CancelAlarm
        OsIsrXSignalReceiverProvidedApis = ChainTask
        OsIsrXSignalReceiverProvidedApis = ControlIdle
        OsIsrXSignalReceiverProvidedApis = GetAlarm
        OsIsrXSignalReceiverProvidedApis = GetApplicationState
        OsIsrXSignalReceiverProvidedApis = GetCounterValue
        OsIsrXSignalReceiverProvidedApis = GetElapsedValue
        OsIsrXSignalReceiverProvidedApis = GetErrorHookStackUsage
        OsIsrXSignalReceiverProvidedApis = GetEvent
        OsIsrXSignalReceiverProvidedApis = GetISRStackUsage
        OsIsrXSignalReceiverProvidedApis = GetKernelStackUsage
        OsIsrXSignalReceiverProvidedApis = GetNonTrustedFunctionStackUsage
        OsIsrXSignalReceiverProvidedApis = GetProtectionHookStackUsage
        OsIsrXSignalReceiverProvidedApis = GetScheduleTableStatus
        OsIsrXSignalReceiverProvidedApis = GetShutdownHookStackUsage
        OsIsrXSignalReceiverProvidedApis = GetStartupHookStackUsage
        OsIsrXSignalReceiverProvidedApis = GetTaskStackUsage
        OsIsrXSignalReceiverProvidedApis = GetTaskState
        OsIsrXSignalReceiverProvidedApis = HookCallCallback
        OsIsrXSignalReceiverProvidedApis = NextScheduleTable
        OsIsrXSignalReceiverProvidedApis = SetAbsAlarm
        OsIsrXSignalReceiverProvidedApis = SetEvent
        OsIsrXSignalReceiverProvidedApis = SetRelAlarm
        OsIsrXSignalReceiverProvidedApis = StartScheduleTableAbs
        OsIsrXSignalReceiverProvidedApis = StartScheduleTableRel
        OsIsrXSignalReceiverProvidedApis = StopScheduleTable
        OsIsrXSignalReceiverProvidedApis = TerminateApplication
    XSignalIsr_OsCore1 (OsIsr):
      OsIsrInterruptPriority = 30
      OsIsrCategory = CATEGORY_2
      OsIsrInterruptType = EXTERNAL
      OsIsrInterruptSource = 2452
      OsIsrStackSize = 1024
      OsIsrEnableNesting = false
      OsIsrUsesFpu = false
      OsIsrInitialEnableInterruptSource = false
      OsIsrSpecialFunctionName = Os_XSigRecvIsrHandler
      OsIsrXSignalReceiver:
        OsIsrXSignalReceiverProvidedApis = ShutdownAllCores
        OsIsrXSignalReceiverProvidedApis = ActivateTask
        OsIsrXSignalReceiverProvidedApis = CancelAlarm
        OsIsrXSignalReceiverProvidedApis = ChainTask
        OsIsrXSignalReceiverProvidedApis = ControlIdle
        OsIsrXSignalReceiverProvidedApis = GetAlarm
        OsIsrXSignalReceiverProvidedApis = GetApplicationState
        OsIsrXSignalReceiverProvidedApis = GetCounterValue
        OsIsrXSignalReceiverProvidedApis = GetElapsedValue
        OsIsrXSignalReceiverProvidedApis = GetErrorHookStackUsage
        OsIsrXSignalReceiverProvidedApis = GetEvent
        OsIsrXSignalReceiverProvidedApis = GetISRStackUsage
        OsIsrXSignalReceiverProvidedApis = GetKernelStackUsage
        OsIsrXSignalReceiverProvidedApis = GetNonTrustedFunctionStackUsage
        OsIsrXSignalReceiverProvidedApis = GetProtectionHookStackUsage
        OsIsrXSignalReceiverProvidedApis = GetScheduleTableStatus
        OsIsrXSignalReceiverProvidedApis = GetShutdownHookStackUsage
        OsIsrXSignalReceiverProvidedApis = GetStartupHookStackUsage
        OsIsrXSignalReceiverProvidedApis = GetTaskStackUsage
        OsIsrXSignalReceiverProvidedApis = GetTaskState
        OsIsrXSignalReceiverProvidedApis = HookCallCallback
        OsIsrXSignalReceiverProvidedApis = NextScheduleTable
        OsIsrXSignalReceiverProvidedApis = SetAbsAlarm
        OsIsrXSignalReceiverProvidedApis = SetEvent
        OsIsrXSignalReceiverProvidedApis = SetRelAlarm
        OsIsrXSignalReceiverProvidedApis = StartScheduleTableAbs
        OsIsrXSignalReceiverProvidedApis = StartScheduleTableRel
        OsIsrXSignalReceiverProvidedApis = StopScheduleTable
        OsIsrXSignalReceiverProvidedApis = TerminateApplication
    SystemTimer_Core1 (OsCounter):
      OsCounterMaxAllowedValue = 1073741823
      OsCounterMinCycle = 1
      OsCounterTicksPerBase = 100000
      OsCounterType = HARDWARE
      OsSecondsPerTick = 0.001
      OsCounterAccessingApplication = OsApplication_SystemApplication_Core0
      OsCounterAccessingApplication = OsApplication_SystemApplication_Core1
      OsDriver: OsDriverHighResolution=false, OsDriverHardwareTimerChannelRef=STM1_Ch0, OsDriverIsrRef=CounterIsr_SystemTimer_Core1
    CounterIsr_SystemTimer_Core1 (OsIsr):
      OsIsrInterruptPriority = 15
      OsIsrCategory = CATEGORY_2
      OsIsrInterruptType = EXTERNAL
      OsIsrInterruptSource = 776
      OsIsrStackSize = 1024
      OsIsrEnableNesting = false
      OsIsrUsesFpu = false
      OsIsrInitialEnableInterruptSource = false
      OsIsrSpecialFunctionName = Os_TimerPfrtIsr
    3 x OsTask, all with OsTaskActivation=1, OsTaskStackSharing=false, OsTaskStackSize=1024, OsTaskUsesFpu=false, OsTaskAccessingApplication=OsApplication_SystemApplication_Core0, OsTaskAccessingApplication=OsApplication_SystemApplication_Core1, OsTaskResourceRef=RES_SCHEDULER_OsCore1:
      Default_Init_Task_Core1: OsTaskPriority=200, OsTaskSchedule=NON, OsTaskType=AUTO, OsTaskEventRef=BswM_Init_Core1
        OsTaskAutostart: OsTaskAppModeRef=OS_APPMODE_ANY
      Default_BSW_Task_Core1: OsTaskPriority=20, OsTaskSchedule=FULL, OsTaskType=AUTO, OsTaskEventRef=Rte_Ev_Cyclic2_Default_BSW_Task_Core1_0_10ms, OsTaskEventRef=Rte_Ev_Run_StartApplicationSlaveCore1_StartApplicationSlaveCore_OnDataRec_MasterCore
      Default_Init_Task_Core1_Trusted: OsTaskPriority=49, OsTaskSchedule=FULL, OsTaskType=BASIC
        OsTaskAutostart: OsTaskAppModeRef=OS_APPMODE_ANY
    Rte_Al_TE2_Default_BSW_Task_Core1_0_10ms (OsAlarm):
      OsAlarmCounterRef = SystemTimer_Core1
      OsAlarmAccessingApplication = OsApplication_SystemApplication_Core0
      OsAlarmAccessingApplication = OsApplication_SystemApplication_Core1
      OsAlarmAction
        OsAlarmSetEvent: OsAlarmSetEventRef=Rte_Ev_Cyclic2_Default_BSW_Task_Core1_0_10ms, OsAlarmSetEventTaskRef=Os/Default_BSW_Task_Core1
    Spinlock_StbM_STBM_EXCLUSIVE_AREA_1_Custom (OsSpinlock):
      OsSpinlockLockMethod = LOCK_WITH_RES_SCHEDULER
      OsSpinlockLockType = STANDARD
      OsSpinlockAccessingApplication = OsApplication_SystemApplication_Core0
      OsSpinlockAccessingApplication = OsApplication_SystemApplication_Core1
    RES_SCHEDULER_OsCore0 (OsResource): OsResourceProperty=STANDARD, OsResourceAccessingApplication=OsApplication_SystemApplication_Core0
    RES_SCHEDULER_OsCore1 (OsResource): OsResourceProperty=STANDARD, OsResourceAccessingApplication=OsApplication_SystemApplication_Core1
    BswM_Init_Core0 (OsEvent)
    BswM_Init_Core1 (OsEvent)
    OsBarrier_Sync_RteStart_Core0_Core1 (OsBarrier): OsBarrierTaskRef=Os/Default_Init_Task, OsBarrierTaskRef=Os/Default_Init_Task_Core1
    3 x OsEvent:
      Rte_Ev_Cyclic2_Default_BSW_Task_Core1_0_10ms
      Rte_Ev_Run_StartApplication_StartApplication_OnDataRec_SlaveCore1
      Rte_Ev_Run_StartApplicationSlaveCore1_StartApplicationSlaveCore_OnDataRec_MasterCore
    Rte_Spinlock_StartApplicationSlaveCore1_PpSlaveCoreData_DeInterCoreSlave (OsSpinlock):
      OsSpinlockLockMethod = LOCK_CAT2_INTERRUPTS
      OsSpinlockLockType = STANDARD
      OsSpinlockAccessingApplication = OsApplication_SystemApplication_Core0
      OsSpinlockAccessingApplication = OsApplication_SystemApplication_Core1
    Rte_Al_TE_Can_30_Core_Can_30_Core_MainFunction_Write (OsAlarm):
      OsAlarmCounterRef = SystemTimer_Core0
      OsAlarmAccessingApplication = OsApplication_SystemApplication_Core0
      OsAlarmAccessingApplication = OsApplication_SystemApplication_Core1
      OsAlarmAction
        OsAlarmSetEvent: OsAlarmSetEventRef=Rte_Ev_Run_Can_30_Core_Can_30_Core_MainFunction_Write, OsAlarmSetEventTaskRef=Os/Default_BSW_Async_Task
    Rte_Ev_Run_Can_30_Core_Can_30_Core_MainFunction_Write (OsEvent)
    Rte_Ev_Run_StartApplication_StartApplication_OnDataRec_EthernetCommunication (OsEvent)
    vCan_30_Mcan_Isr_9 (OsIsr):
      OsIsrInterruptPriority = 22
      OsIsrCategory = CATEGORY_2
      OsIsrInterruptType = EXTERNAL
      OsIsrInterruptSource = 1588
      OsIsrStackSize = 1024
      OsIsrEnableNesting = false
      OsIsrUsesFpu = false
      OsIsrInitialEnableInterruptSource = true
    Rte_Al_TE_Default_Appl_Task_0_100ms (OsAlarm):
      OsAlarmCounterRef = SystemTimer_Core0
      OsAlarmAccessingApplication = OsApplication_SystemApplication_Core0
      OsAlarmAccessingApplication = OsApplication_SystemApplication_Core1
      OsAlarmAction
        OsAlarmSetEvent: OsAlarmSetEventRef=Rte_Ev_Cyclic_Default_Appl_Task_0_100ms, OsAlarmSetEventTaskRef=Os/Default_Appl_Task
    3 x OsEvent:
      Rte_Ev_Cyclic_Default_Appl_Task_0_100ms
      Rte_Ev_Run_ShA_Ivd_CurrentMode_PostRun
      Rte_Ev_Run_ShA_Ivd_CurrentMode_Run
    Rte_Al_TE2_Default_Appl_Task_0_100ms (OsAlarm):
      OsAlarmCounterRef = SystemTimer_Core0
      OsAlarmAccessingApplication = OsApplication_SystemApplication_Core0
      OsAlarmAccessingApplication = OsApplication_SystemApplication_Core1
      OsAlarmAction
        OsAlarmSetEvent: OsAlarmSetEventRef=Rte_Ev_Cyclic2_Default_Appl_Task_0_100ms, OsAlarmSetEventTaskRef=Os/Default_Appl_Task
    Rte_Ev_Cyclic2_Default_Appl_Task_0_100ms (OsEvent)
    Rte_Al_TE_Default_Appl_Task_0_10ms (OsAlarm):
      OsAlarmCounterRef = SystemTimer_Core0
      OsAlarmAccessingApplication = OsApplication_SystemApplication_Core0
      OsAlarmAccessingApplication = OsApplication_SystemApplication_Core1
      OsAlarmAction
        OsAlarmSetEvent: OsAlarmSetEventRef=Rte_Ev_Cyclic_Default_Appl_Task_0_10ms, OsAlarmSetEventTaskRef=Os/Default_Appl_Task
    Rte_Ev_Cyclic_Default_Appl_Task_0_10ms (OsEvent)
    Rte_Al_TE_Default_Appl_Task_0_50ms (OsAlarm):
      OsAlarmCounterRef = SystemTimer_Core0
      OsAlarmAccessingApplication = OsApplication_SystemApplication_Core0
      OsAlarmAccessingApplication = OsApplication_SystemApplication_Core1
      OsAlarmAction
        OsAlarmSetEvent: OsAlarmSetEventRef=Rte_Ev_Cyclic_Default_Appl_Task_0_50ms, OsAlarmSetEventTaskRef=Os/Default_Appl_Task
    Rte_Ev_Cyclic_Default_Appl_Task_0_50ms (OsEvent)
