AUTOSAR XML (schema 4-3-0)
package /ActiveEcuC
  module config MemMap: implementation-config-variant=VARIANT-PRE-COMPILE, module-description=MemMap_Impl
    MemMap_Common (MemMapModule): MemMapGenerateAdditionalMemorySections=true
      113 x MemMapAdditionalMemorySection, all with MemMapMemorySectionFileName=MemMap_Common.h, MemMapMemorySectionPrefix=:
        CODE: MemMapMemorySectionSymbol=CODE, MemMapMemorySectionSwAddrMethodRef=CODE
        CODE_FAST: MemMapMemorySectionSymbol=CODE_FAST, MemMapMemorySectionSwAddrMethodRef=CODE_FAST
        CODE_ISR: MemMapMemorySectionSymbol=CODE_ISR, MemMapMemorySectionSwAddrMethodRef=CODE_ISR
        CONST: MemMapMemorySectionAlignment=UNSPECIFIED, MemMapMemorySectionSymbol=CONST, MemMapMemorySectionSwAddrMethodRef=CONST
        CONST_8BIT: MemMapMemorySectionAlignment=8, MemMapMemorySectionSymbol=CONST_8BIT, MemMapMemorySectionSwAddrMethodRef=CONST
        CONST_16BIT: MemMapMemorySectionAlignment=16, MemMapMemorySectionSymbol=CONST_16BIT, MemMapMemorySectionSwAddrMethodRef=CONST
        CONST_32BIT: MemMapMemorySectionAlignment=32, MemMapMemorySectionSymbol=CONST_32BIT, MemMapMemorySectionSwAddrMethodRef=CONST
        CONST_64BIT: MemMapMemorySectionAlignment=64, MemMapMemorySectionSymbol=CONST_64BIT, MemMapMemorySectionSwAddrMethodRef=CONST
        CONST_8: MemMapMemorySectionAlignment=8, MemMapMemorySectionSymbol=CONST_8, MemMapMemorySectionSwAddrMethodRef=CONST
        CONST_16: MemMapMemorySectionAlignment=16, MemMapMemorySectionSymbol=CONST_16, MemMapMemorySectionSwAddrMethodRef=CONST
        CONST_32: MemMapMemorySectionAlignment=32, MemMapMemorySectionSymbol=CONST_32, MemMapMemorySectionSwAddrMethodRef=CONST
        CONST_64: MemMapMemorySectionAlignment=64, MemMapMemorySectionSymbol=CONST_64, MemMapMemorySectionSwAddrMethodRef=CONST
        CONST_UNSPECIFIED: MemMapMemorySectionAlignment=UNSPECIFIED, MemMapMemorySectionSymbol=CONST_UNSPECIFIED, MemMapMemorySectionSwAddrMethodRef=CONST
        CONST_FAST_8BIT: MemMapMemorySectionAlignment=8, MemMapMemorySectionSymbol=CONST_FAST_8BIT, MemMapMemorySectionSwAddrMethodRef=CONST_FAST
        CONST_FAST_16BIT: MemMapMemorySectionAlignment=16, MemMapMemorySectionSymbol=CONST_FAST_16BIT, MemMapMemorySectionSwAddrMethodRef=CONST_FAST
        CONST_FAST_32BIT: MemMapMemorySectionAlignment=32, MemMapMemorySectionSymbol=CONST_FAST_32BIT, MemMapMemorySectionSwAddrMethodRef=CONST_FAST
        CONST_FAST_64BIT: MemMapMemorySectionAlignment=64, MemMapMemorySectionSymbol=CONST_FAST_64BIT, MemMapMemorySectionSwAddrMethodRef=CONST_FAST
        CONST_FAST_8: MemMapMemorySectionAlignment=8, MemMapMemorySectionSymbol=CONST_FAST_8, MemMapMemorySectionSwAddrMethodRef=CONST_FAST
        CONST_FAST_16: MemMapMemorySectionAlignment=16, MemMapMemorySectionSymbol=CONST_FAST_16, MemMapMemorySectionSwAddrMethodRef=CONST_FAST
        CONST_FAST_32: MemMapMemorySectionAlignment=32, MemMapMemorySectionSymbol=CONST_FAST_32, MemMapMemorySectionSwAddrMethodRef=CONST_FAST
        CONST_FAST_64: MemMapMemorySectionAlignment=64, MemMapMemorySectionSymbol=CONST_FAST_64, MemMapMemorySectionSwAddrMethodRef=CONST_FAST
        CONST_FAST_UNSPECIFIED: MemMapMemorySectionAlignment=UNSPECIFIED, MemMapMemorySectionSymbol=CONST_FAST_UNSPECIFIED, MemMapMemorySectionSwAddrMethodRef=CONST_FAST
        CONST_PBCFG: MemMapMemorySectionSymbol=CONST_PBCFG, MemMapMemorySectionSwAddrMethodRef=CONST_PBCFG
        PBCFG_GLOBALROOT: MemMapMemorySectionSymbol=PBCFG_GLOBALROOT, MemMapMemorySectionSwAddrMethodRef=PBCFG_GLOBALROOT
        VAR: MemMapMemorySectionAlignment=UNSPECIFIED, MemMapMemorySectionSymbol=VAR, MemMapMemorySectionSwAddrMethodRef=VAR_INIT
        VAR_INIT_8BIT: MemMapMemorySectionAlignment=8, MemMapMemorySectionSymbol=VAR_INIT_8BIT, MemMapMemorySectionSwAddrMethodRef=VAR_INIT
        VAR_INIT_16BIT: MemMapMemorySectionAlignment=16, MemMapMemorySectionSymbol=VAR_INIT_16BIT, MemMapMemorySectionSwAddrMethodRef=VAR_INIT
        VAR_INIT_32BIT: MemMapMemorySectionAlignment=32, MemMapMemorySectionSymbol=VAR_INIT_32BIT, MemMapMemorySectionSwAddrMethodRef=VAR_INIT
        VAR_INIT_64BIT: MemMapMemorySectionAlignment=64, MemMapMemorySectionSymbol=VAR_INIT_64BIT, MemMapMemorySectionSwAddrMethodRef=VAR_INIT
        VAR_INIT_8: MemMapMemorySectionAlignment=8, MemMapMemorySectionSymbol=VAR_INIT_8, MemMapMemorySectionSwAddrMethodRef=VAR_INIT
        VAR_INIT_16: MemMapMemorySectionAlignment=16, MemMapMemorySectionSymbol=VAR_INIT_16, MemMapMemorySectionSwAddrMethodRef=VAR_INIT
        VAR_INIT_32: MemMapMemorySectionAlignment=32, MemMapMemorySectionSymbol=VAR_INIT_32, MemMapMemorySectionSwAddrMethodRef=VAR_INIT
        VAR_INIT_64: MemMapMemorySectionAlignment=64, MemMapMemorySectionSymbol=VAR_INIT_64, MemMapMemorySectionSwAddrMethodRef=VAR_INIT
        VAR_INIT_UNSPECIFIED: MemMapMemorySectionAlignment=UNSPECIFIED, MemMapMemorySectionSymbol=VAR_INIT_UNSPECIFIED, MemMapMemorySectionSwAddrMethodRef=VAR_INIT
        VAR_NOINIT_8BIT: MemMapMemorySectionAlignment=8, MemMapMemorySectionSymbol=VAR_NOINIT_8BIT, MemMapMemorySectionSwAddrMethodRef=VAR_NO_INIT
        VAR_NOINIT_16BIT: MemMapMemorySectionAlignment=16, MemMapMemorySectionSymbol=VAR_NOINIT_16BIT, MemMapMemorySectionSwAddrMethodRef=VAR_NO_INIT
        VAR_NOINIT_32BIT: MemMapMemorySectionAlignment=32, MemMapMemorySectionSymbol=VAR_NOINIT_32BIT, MemMapMemorySectionSwAddrMethodRef=VAR_NO_INIT
        VAR_NOINIT_64BIT: MemMapMemorySectionAlignment=64, MemMapMemorySectionSymbol=VAR_NOINIT_64BIT, MemMapMemorySectionSwAddrMethodRef=VAR_NO_INIT
        VAR_NO_INIT_8: MemMapMemorySectionAlignment=8, MemMapMemorySectionSymbol=VAR_NO_INIT_8, MemMapMemorySectionSwAddrMethodRef=VAR_NO_INIT
        VAR_NO_INIT_16: MemMapMemorySectionAlignment=16, MemMapMemorySectionSymbol=VAR_NO_INIT_16, MemMapMemorySectionSwAddrMethodRef=VAR_NO_INIT
        VAR_NO_INIT_32: MemMapMemorySectionAlignment=32, MemMapMemorySectionSymbol=VAR_NO_INIT_32, MemMapMemorySectionSwAddrMethodRef=VAR_NO_INIT
        VAR_NO_INIT_64: MemMapMemorySectionAlignment=64, MemMapMemorySectionSymbol=VAR_NO_INIT_64, MemMapMemorySectionSwAddrMethodRef=VAR_NO_INIT
        VAR_NOINIT_UNSPECIFIED: MemMapMemorySectionAlignment=UNSPECIFIED, MemMapMemorySectionSymbol=VAR_NOINIT_UNSPECIFIED, MemMapMemorySectionSwAddrMethodRef=VAR_NO_INIT
        VAR_NO_INIT_UNSPECIFIED: MemMapMemorySectionAlignment=UNSPECIFIED, MemMapMemorySectionSymbol=VAR_NO_INIT_UNSPECIFIED, MemMapMemorySectionSwAddrMethodRef=VAR_NO_INIT
        VAR_ZERO_INIT_8BIT: MemMapMemorySectionAlignment=8, MemMapMemorySectionSymbol=VAR_ZERO_INIT_8BIT, MemMapMemorySectionSwAddrMethodRef=VAR_CLEARED
        VAR_ZERO_INIT_16BIT: MemMapMemorySectionAlignment=16, MemMapMemorySectionSymbol=VAR_ZERO_INIT_16BIT, MemMapMemorySectionSwAddrMethodRef=VAR_CLEARED
        VAR_ZERO_INIT_32BIT: MemMapMemorySectionAlignment=32, MemMapMemorySectionSymbol=VAR_ZERO_INIT_32BIT, MemMapMemorySectionSwAddrMethodRef=VAR_CLEARED
        VAR_ZERO_INIT_64BIT: MemMapMemorySectionAlignment=64, MemMapMemorySectionSymbol=VAR_ZERO_INIT_64BIT, MemMapMemorySectionSwAddrMethodRef=VAR_CLEARED
        VAR_CLEARED_8: MemMapMemorySectionAlignment=8, MemMapMemorySectionSymbol=VAR_CLEARED_8, MemMapMemorySectionSwAddrMethodRef=VAR_CLEARED
        VAR_CLEARED_16: MemMapMemorySectionAlignment=16, MemMapMemorySectionSymbol=VAR_CLEARED_16, MemMapMemorySectionSwAddrMethodRef=VAR_CLEARED
        VAR_CLEARED_32: MemMapMemorySectionAlignment=32, MemMapMemorySectionSymbol=VAR_CLEARED_32, MemMapMemorySectionSwAddrMethodRef=VAR_CLEARED
        VAR_CLEARED_64: MemMapMemorySectionAlignment=64, MemMapMemorySectionSymbol=VAR_CLEARED_64, MemMapMemorySectionSwAddrMethodRef=VAR_CLEARED
        VAR_CLEARED_UNSPECIFIED: MemMapMemorySectionAlignment=UNSPECIFIED, MemMapMemorySectionSymbol=VAR_CLEARED_UNSPECIFIED, MemMapMemorySectionSwAddrMethodRef=VAR_CLEARED
        VAR_ZERO_INIT_UNSPECIFIED: MemMapMemorySectionAlignment=UNSPECIFIED, MemMapMemorySectionSymbol=VAR_ZERO_INIT_UNSPECIFIED, MemMapMemorySectionSwAddrMethodRef=VAR_CLEARED
        VAR_FAST_INIT_8BIT: MemMapMemorySectionAlignment=8, MemMapMemorySectionSymbol=VAR_FAST_INIT_8BIT, MemMapMemorySectionSwAddrMethodRef=VAR_FAST_INIT
        VAR_FAST_INIT_16BIT: MemMapMemorySectionAlignment=16, MemMapMemorySectionSymbol=VAR_FAST_INIT_16BIT, MemMapMemorySectionSwAddrMethodRef=VAR_FAST_INIT
        VAR_FAST_INIT_32BIT: MemMapMemorySectionAlignment=32, MemMapMemorySectionSymbol=VAR_FAST_INIT_32BIT, MemMapMemorySectionSwAddrMethodRef=VAR_FAST_INIT
        VAR_FAST_INIT_64BIT: MemMapMemorySectionAlignment=64, MemMapMemorySectionSymbol=VAR_FAST_INIT_64BIT, MemMapMemorySectionSwAddrMethodRef=VAR_FAST_INIT
        VAR_FAST_INIT_8: MemMapMemorySectionAlignment=8, MemMapMemorySectionSymbol=VAR_FAST_INIT_8, MemMapMemorySectionSwAddrMethodRef=VAR_FAST_INIT
        VAR_FAST_INIT_16: MemMapMemorySectionAlignment=16, MemMapMemorySectionSymbol=VAR_FAST_INIT_16, MemMapMemorySectionSwAddrMethodRef=VAR_FAST_INIT
        VAR_FAST_INIT_32: MemMapMemorySectionAlignment=32, MemMapMemorySectionSymbol=VAR_FAST_INIT_32, MemMapMemorySectionSwAddrMethodRef=VAR_FAST_INIT
        VAR_FAST_INIT_64: MemMapMemorySectionAlignment=64, MemMapMemorySectionSymbol=VAR_FAST_INIT_64, MemMapMemorySectionSwAddrMethodRef=VAR_FAST_INIT
        VAR_FAST_INIT_UNSPECIFIED: MemMapMemorySectionAlignment=UNSPECIFIED, MemMapMemorySectionSymbol=VAR_FAST_INIT_UNSPECIFIED, MemMapMemorySectionSwAddrMethodRef=VAR_FAST_INIT
        VAR_FAST_NOINIT_8BIT: MemMapMemorySectionAlignment=8, MemMapMemorySectionSymbol=VAR_FAST_NOINIT_8BIT, MemMapMemorySectionSwAddrMethodRef=VAR_FAST_NO_INIT
        VAR_FAST_NOINIT_16BIT: MemMapMemorySectionAlignment=16, MemMapMemorySectionSymbol=VAR_FAST_NOINIT_16BIT, MemMapMemorySectionSwAddrMethodRef=VAR_FAST_NO_INIT
        VAR_FAST_NOINIT_32BIT: MemMapMemorySectionAlignment=32, MemMapMemorySectionSymbol=VAR_FAST_NOINIT_32BIT, MemMapMemorySectionSwAddrMethodRef=VAR_FAST_NO_INIT
        VAR_FAST_NOINIT_64BIT: MemMapMemorySectionAlignment=64, MemMapMemorySectionSymbol=VAR_FAST_NOINIT_64BIT, MemMapMemorySectionSwAddrMethodRef=VAR_FAST_NO_INIT
        VAR_FAST_NO_INIT_8: MemMapMemorySectionAlignment=8, MemMapMemorySectionSymbol=VAR_FAST_NO_INIT_8, MemMapMemorySectionSwAddrMethodRef=VAR_FAST_NO_INIT
        VAR_FAST_NO_INIT_16: MemMapMemorySectionAlignment=16, MemMapMemorySectionSymbol=VAR_FAST_NO_INIT_16, MemMapMemorySectionSwAddrMethodRef=VAR_FAST_NO_INIT
        VAR_FAST_NO_INIT_32: MemMapMemorySectionAlignment=32, MemMapMemorySectionSymbol=VAR_FAST_NO_INIT_32, MemMapMemorySectionSwAddrMethodRef=VAR_FAST_NO_INIT
        VAR_FAST_NO_INIT_64: MemMapMemorySectionAlignment=64, MemMapMemorySectionSymbol=VAR_FAST_NO_INIT_64, MemMapMemorySectionSwAddrMethodRef=VAR_FAST_NO_INIT
        VAR_FAST_NOINIT_UNSPECIFIED: MemMapMemorySectionAlignment=UNSPECIFIED, MemMapMemorySectionSymbol=VAR_FAST_NOINIT_UNSPECIFIED, MemMapMemorySectionSwAddrMethodRef=VAR_FAST_NO_INIT
        VAR_FAST_NO_INIT_UNSPECIFIED: MemMapMemorySectionAlignment=UNSPECIFIED, MemMapMemorySectionSymbol=VAR_FAST_NO_INIT_UNSPECIFIED, MemMapMemorySectionSwAddrMethodRef=VAR_FAST_NO_INIT
        VAR_FAST_ZERO_INIT_8BIT: MemMapMemorySectionAlignment=8, MemMapMemorySectionSymbol=VAR_FAST_ZERO_INIT_8BIT, MemMapMemorySectionSwAddrMethodRef=VAR_FAST_CLEARED
        VAR_FAST_ZERO_INIT_16BIT: MemMapMemorySectionAlignment=16, MemMapMemorySectionSymbol=VAR_FAST_ZERO_INIT_16BIT, MemMapMemorySectionSwAddrMethodRef=VAR_FAST_CLEARED
        VAR_FAST_ZERO_INIT_32BIT: MemMapMemorySectionAlignment=32, MemMapMemorySectionSymbol=VAR_FAST_ZERO_INIT_32BIT, MemMapMemorySectionSwAddrMethodRef=VAR_FAST_CLEARED
        VAR_FAST_ZERO_INIT_64BIT: MemMapMemorySectionAlignment=64, MemMapMemorySectionSymbol=VAR_FAST_ZERO_INIT_64BIT, MemMapMemorySectionSwAddrMethodRef=VAR_FAST_CLEARED
        VAR_FAST_CLEARED_8: MemMapMemorySectionAlignment=8, MemMapMemorySectionSymbol=VAR_FAST_CLEARED_8, MemMapMemorySectionSwAddrMethodRef=VAR_FAST_CLEARED
        VAR_FAST_CLEARED_16: MemMapMemorySectionAlignment=16, MemMapMemorySectionSymbol=VAR_FAST_CLEARED_16, MemMapMemorySectionSwAddrMethodRef=VAR_FAST_CLEARED
        VAR_FAST_CLEARED_32: MemMapMemorySectionAlignment=32, MemMapMemorySectionSymbol=VAR_FAST_CLEARED_32, MemMapMemorySectionSwAddrMethodRef=VAR_FAST_CLEARED
        VAR_FAST_CLEARED_64: MemMapMemorySectionAlignment=64, MemMapMemorySectionSymbol=VAR_FAST_CLEARED_64, MemMapMemorySectionSwAddrMethodRef=VAR_FAST_CLEARED
        VAR_FAST_CLEARED_UNSPECIFIED: MemMapMemorySectionAlignment=UNSPECIFIED, MemMapMemorySectionSymbol=VAR_FAST_CLEARED_UNSPECIFIED, MemMapMemorySectionSwAddrMethodRef=VAR_FAST_CLEARED
        VAR_FAST_ZERO_INIT_UNSPECIFIED: MemMapMemorySectionAlignment=UNSPECIFIED, MemMapMemorySectionSymbol=VAR_FAST_ZERO_INIT_UNSPECIFIED, MemMapMemorySectionSwAddrMethodRef=VAR_FAST_CLEARED
        VAR_NOCACHE_INIT_8BIT: MemMapMemorySectionAlignment=8, MemMapMemorySectionSymbol=VAR_NOCACHE_INIT_8BIT, MemMapMemorySectionSwAddrMethodRef=VAR_NOCACHE_INIT
        VAR_NOCACHE_INIT_16BIT: MemMapMemorySectionAlignment=16, MemMapMemorySectionSymbol=VAR_NOCACHE_INIT_16BIT, MemMapMemorySectionSwAddrMethodRef=VAR_NOCACHE_INIT
        VAR_NOCACHE_INIT_32BIT: MemMapMemorySectionAlignment=32, MemMapMemorySectionSymbol=VAR_NOCACHE_INIT_32BIT, MemMapMemorySectionSwAddrMethodRef=VAR_NOCACHE_INIT
        VAR_NOCACHE_INIT_64BIT: MemMapMemorySectionAlignment=64, MemMapMemorySectionSymbol=VAR_NOCACHE_INIT_64BIT, MemMapMemorySectionSwAddrMethodRef=VAR_NOCACHE_INIT
        VAR_NOCACHE_INIT_8: MemMapMemorySectionAlignment=8, MemMapMemorySectionSymbol=VAR_NOCACHE_INIT_8, MemMapMemorySectionSwAddrMethodRef=VAR_NOCACHE_INIT
        VAR_NOCACHE_INIT_16: MemMapMemorySectionAlignment=16, MemMapMemorySectionSymbol=VAR_NOCACHE_INIT_16, MemMapMemorySectionSwAddrMethodRef=VAR_NOCACHE_INIT
        VAR_NOCACHE_INIT_32: MemMapMemorySectionAlignment=32, MemMapMemorySectionSymbol=VAR_NOCACHE_INIT_32, MemMapMemorySectionSwAddrMethodRef=VAR_NOCACHE_INIT
        VAR_NOCACHE_INIT_64: MemMapMemorySectionAlignment=64, MemMapMemorySectionSymbol=VAR_NOCACHE_INIT_64, MemMapMemorySectionSwAddrMethodRef=VAR_NOCACHE_INIT
        VAR_NOCACHE_INIT_UNSPECIFIED: MemMapMemorySectionAlignment=UNSPECIFIED, MemMapMemorySectionSymbol=VAR_NOCACHE_INIT_UNSPECIFIED, MemMapMemorySectionSwAddrMethodRef=VAR_NOCACHE_INIT
        VAR_NOCACHE_NOINIT_8BIT: MemMapMemorySectionAlignment=8, MemMapMemorySectionSymbol=VAR_NOCACHE_NOINIT_8BIT, MemMapMemorySectionSwAddrMethodRef=VAR_NOCACHE_NO_INIT
        VAR_NOCACHE_NOINIT_16BIT: MemMapMemorySectionAlignment=16, MemMapMemorySectionSymbol=VAR_NOCACHE_NOINIT_16BIT, MemMapMemorySectionSwAddrMethodRef=VAR_NOCACHE_NO_INIT
        VAR_NOCACHE_NOINIT_32BIT: MemMapMemorySectionAlignment=32, MemMapMemorySectionSymbol=VAR_NOCACHE_NOINIT_32BIT, MemMapMemorySectionSwAddrMethodRef=VAR_NOCACHE_NO_INIT
        VAR_NOCACHE_NOINIT_64BIT: MemMapMemorySectionAlignment=64, MemMapMemorySectionSymbol=VAR_NOCACHE_NOINIT_64BIT, MemMapMemorySectionSwAddrMethodRef=VAR_NOCACHE_NO_INIT
        VAR_NOCACHE_NO_INIT_8: MemMapMemorySectionAlignment=8, MemMapMemorySectionSymbol=VAR_NOCACHE_NO_INIT_8, MemMapMemorySectionSwAddrMethodRef=VAR_NOCACHE_NO_INIT
        VAR_NOCACHE_NO_INIT_16: MemMapMemorySectionAlignment=16, MemMapMemorySectionSymbol=VAR_NOCACHE_NO_INIT_16, MemMapMemorySectionSwAddrMethodRef=VAR_NOCACHE_NO_INIT
        VAR_NOCACHE_NO_INIT_32: MemMapMemorySectionAlignment=32, MemMapMemorySectionSymbol=VAR_NOCACHE_NO_INIT_32, MemMapMemorySectionSwAddrMethodRef=VAR_NOCACHE_NO_INIT
        VAR_NOCACHE_NO_INIT_64: MemMapMemorySectionAlignment=64, MemMapMemorySectionSymbol=VAR_NOCACHE_NO_INIT_64, MemMapMemorySectionSwAddrMethodRef=VAR_NOCACHE_NO_INIT
        VAR_NOCACHE_NOINIT_UNSPECIFIED: MemMapMemorySectionAlignment=UNSPECIFIED, MemMapMemorySectionSymbol=VAR_NOCACHE_NOINIT_UNSPECIFIED, MemMapMemorySectionSwAddrMethodRef=VAR_NOCACHE_NO_INIT
        VAR_NOCACHE_NO_INIT_UNSPECIFIED: MemMapMemorySectionAlignment=UNSPECIFIED, MemMapMemorySectionSymbol=VAR_NOCACHE_NO_INIT_UNSPECIFIED, MemMapMemorySectionSwAddrMethodRef=VAR_NOCACHE_NO_INIT
        VAR_NOCACHE_ZERO_INIT_8BIT: MemMapMemorySectionAlignment=8, MemMapMemorySectionSymbol=VAR_NOCACHE_ZERO_INIT_8BIT, MemMapMemorySectionSwAddrMethodRef=VAR_NOCACHE_CLEARED
        VAR_NOCACHE_ZERO_INIT_16BIT: MemMapMemorySectionAlignment=16, MemMapMemorySectionSymbol=VAR_NOCACHE_ZERO_INIT_16BIT, MemMapMemorySectionSwAddrMethodRef=VAR_NOCACHE_CLEARED
        VAR_NOCACHE_ZERO_INIT_32BIT: MemMapMemorySectionAlignment=32, MemMapMemorySectionSymbol=VAR_NOCACHE_ZERO_INIT_32BIT, MemMapMemorySectionSwAddrMethodRef=VAR_NOCACHE_CLEARED
        VAR_NOCACHE_ZERO_INIT_64BIT: MemMapMemorySectionAlignment=64, MemMapMemorySectionSymbol=VAR_NOCACHE_ZERO_INIT_64BIT, MemMapMemorySectionSwAddrMethodRef=VAR_NOCACHE_CLEARED
        VAR_NOCACHE_CLEARED_8: MemMapMemorySectionAlignment=8, MemMapMemorySectionSymbol=VAR_NOCACHE_CLEARED_8, MemMapMemorySectionSwAddrMethodRef=VAR_NOCACHE_CLEARED
        VAR_NOCACHE_CLEARED_16: MemMapMemorySectionAlignment=16, MemMapMemorySectionSymbol=VAR_NOCACHE_CLEARED_16, MemMapMemorySectionSwAddrMethodRef=VAR_NOCACHE_CLEARED
        VAR_NOCACHE_CLEARED_32: MemMapMemorySectionAlignment=32, MemMapMemorySectionSymbol=VAR_NOCACHE_CLEARED_32, MemMapMemorySectionSwAddrMethodRef=VAR_NOCACHE_CLEARED
        VAR_NOCACHE_CLEARED_64: MemMapMemorySectionAlignment=64, MemMapMemorySectionSymbol=VAR_NOCACHE_CLEARED_64, MemMapMemorySectionSwAddrMethodRef=VAR_NOCACHE_CLEARED
        VAR_NOCACHE_CLEARED_UNSPECIFIED: MemMapMemorySectionAlignment=UNSPECIFIED, MemMapMemorySectionSymbol=VAR_NOCACHE_CLEARED_UNSPECIFIED, MemMapMemorySectionSwAddrMethodRef=VAR_NOCACHE_CLEARED
        VAR_NOCACHE_ZERO_INIT_UNSPECIFIED: MemMapMemorySectionAlignment=UNSPECIFIED, MemMapMemorySectionSymbol=VAR_NOCACHE_ZERO_INIT_UNSPECIFIED, MemMapMemorySectionSwAddrMethodRef=VAR_NOCACHE_CLEARED
        VAR_PBCFG: MemMapMemorySectionAlignment=UNSPECIFIED, MemMapMemorySectionSymbol=VAR_PBCFG, MemMapMemorySectionSwAddrMethodRef=VAR_PBCFG
    MSR_Generic (MemMapAllocation)
      8 x MemMapGenericMapping:
        MSR_CODE: MemMapAddressingModeSetRef=MemMap/MSR_CODE, MemMapSwAddressMethodRef=CALLOUT_CODE, MemMapSwAddressMethodRef=CODE, MemMapSwAddressMethodRef=CODE_FAST, MemMapSwAddressMethodRef=CODE_ISR
        MSR_CONST: MemMapAddressingModeSetRef=MemMap/MSR_CONST, MemMapSwAddressMethodRef=CONST_8, MemMapSwAddressMethodRef=CONST_UNSPECIFIED, MemMapSwAddressMethodRef=CONST_FAST_UNSPECIFIED, MemMapSwAddressMethodRef=CONST_FAST_64, MemMapSwAddressMethodRef=CONST_FAST, MemMapSwAddressMethodRef=CONST_BOOLEAN, MemMapSwAddressMethodRef=CONST, MemMapSwAddressMethodRef=CONST_FAST_BOOLEAN, MemMapSwAddressMethodRef=CONST_FAST_8, MemMapSwAddressMethodRef=CONST_FAST_32, MemMapSwAddressMethodRef=CONST_32, MemMapSwAddressMethodRef=CONST_16, MemMapSwAddressMethodRef=CONFIG_DATA, MemMapSwAddressMethodRef=CONST_FAST_16, MemMapSwAddressMethodRef=CONST_64
        MSR_PBCFG_CONST: MemMapAddressingModeSetRef=MemMap/MSR_PBCFG_CONST, MemMapSwAddressMethodRef=CONST_PBCFG, MemMapSwAddressMethodRef=PBCFG_GLOBALROOT
        MSR_PBCFG_VAR: MemMapAddressingModeSetRef=MemMap/MSR_PBCFG_VAR, MemMapSwAddressMethodRef=VAR_PBCFG
        MSR_VAR_CLEARED: MemMapAddressingModeSetRef=MemMap/MSR_VAR_CLEARED, MemMapSwAddressMethodRef=VAR_FAST_ZERO_INIT_16, MemMapSwAddressMethodRef=VAR_FAST_CLEARED_8, MemMapSwAddressMethodRef=VAR_FAST_CLEARED_32, MemMapSwAddressMethodRef=VAR_NOCACHE_CLEARED_64, MemMapSwAddressMethodRef=VAR_CLEARED, MemMapSwAddressMethodRef=VAR_NOCACHE_CLEARED_BOOLEAN, MemMapSwAddressMethodRef=VAR_FAST_CLEARED_16, MemMapSwAddressMethodRef=VAR_NOCACHE_ZERO_INIT_64, MemMapSwAddressMethodRef=VAR_NOCACHE_ZERO_INIT_32, MemMapSwAddressMethodRef=VAR_CLEARED_8, MemMapSwAddressMethodRef=VAR_FAST_CLEARED_UNSPECIFIED, MemMapSwAddressMethodRef=VAR_ZERO_INIT_8, MemMapSwAddressMethodRef=VAR_NOCACHE_ZERO_INIT_16, MemMapSwAddressMethodRef=VAR_FAST_ZERO_INIT_BOOLEAN, MemMapSwAddressMethodRef=VAR_ZERO_INIT_BOOLEAN, MemMapSwAddressMethodRef=VAR_CLEARED_64, MemMapSwAddressMethodRef=VAR_ZERO_INIT_64, MemMapSwAddressMethodRef=VAR_CLEARED_32, MemMapSwAddressMethodRef=VAR_ZERO_INIT_32, MemMapSwAddressMethodRef=VAR_FAST_ZERO_INIT_UNSPECIFIED, MemMapSwAddressMethodRef=VAR_FAST_ZERO_INIT_8, MemMapSwAddressMethodRef=VAR_NOCACHE_CLEARED, MemMapSwAddressMethodRef=VAR_NOCACHE_CLEARED_32, MemMapSwAddressMethodRef=VAR_CLEARED_16, MemMapSwAddressMethodRef=VAR_CLEARED_UNSPECIFIED, MemMapSwAddressMethodRef=VAR_ZERO_INIT_16, MemMapSwAddressMethodRef=VAR_FAST_CLEARED, MemMapSwAddressMethodRef=VAR_NOCACHE_ZERO_INIT_8, MemMapSwAddressMethodRef=VAR_NOCACHE_ZERO_INIT_BOOLEAN, MemMapSwAddressMethodRef=VAR_NOCACHE_CLEARED_16, MemMapSwAddressMethodRef=VAR_ZERO_INIT_UNSPECIFIED, MemMapSwAddressMethodRef=VAR_ZERO_INIT, MemMapSwAddressMethodRef=VAR_NOCACHE_ZERO_INIT_UNSPECIFIED, MemMapSwAddressMethodRef=VAR_CLEARED_BOOLEAN, MemMapSwAddressMethodRef=VAR_NOCACHE_CLEARED_8, MemMapSwAddressMethodRef=VAR_FAST_ZERO_INIT_64, MemMapSwAddressMethodRef=VAR_NOCACHE_CLEARED_UNSPECIFIED, MemMapSwAddressMethodRef=VAR_FAST_CLEARED_BOOLEAN, MemMapSwAddressMethodRef=VAR_FAST_ZERO_INIT_32, MemMapSwAddressMethodRef=VAR_FAST_CLEARED_64
        MSR_VAR_INIT: MemMapAddressingModeSetRef=MemMap/MSR_VAR_INIT, MemMapSwAddressMethodRef=VAR_INIT_16, MemMapSwAddressMethodRef=VAR_NOCACHE_INIT_8, MemMapSwAddressMethodRef=VAR_NOCACHE_INIT_UNSPECIFIED, MemMapSwAddressMethodRef=VAR_INIT_8, MemMapSwAddressMethodRef=VAR_NOCACHE_INIT_32, MemMapSwAddressMethodRef=VAR_INIT_BOOLEAN, MemMapSwAddressMethodRef=VAR_NOCACHE_INIT, MemMapSwAddressMethodRef=VAR_FAST_INIT_64, MemMapSwAddressMethodRef=VAR_NOCACHE_INIT_64, MemMapSwAddressMethodRef=VAR_FAST_INIT_32, MemMapSwAddressMethodRef=VAR_FAST_INIT, MemMapSwAddressMethodRef=VAR_FAST_INIT_UNSPECIFIED, MemMapSwAddressMethodRef=VAR_FAST_INIT_16, MemMapSwAddressMethodRef=VAR_NOCACHE_INIT_16, MemMapSwAddressMethodRef=VAR_INIT_64, MemMapSwAddressMethodRef=VAR_FAST_INIT_8, MemMapSwAddressMethodRef=VAR_FAST_INIT_BOOLEAN, MemMapSwAddressMethodRef=VAR_INIT_UNSPECIFIED, MemMapSwAddressMethodRef=VAR_NOCACHE_INIT_BOOLEAN, MemMapSwAddressMethodRef=VAR_INIT_32, MemMapSwAddressMethodRef=VAR_INIT
        MSR_VAR_NO_INIT: MemMapAddressingModeSetRef=MemMap/MSR_VAR_NO_INIT, MemMapSwAddressMethodRef=VAR_NO_INIT_16, MemMapSwAddressMethodRef=VAR_NO_INIT_8, MemMapSwAddressMethodRef=VAR_FAST_NO_INIT_8, MemMapSwAddressMethodRef=VAR_FAST_NOINIT_8, MemMapSwAddressMethodRef=VAR_NOCACHE_NO_INIT, MemMapSwAddressMethodRef=VAR_FAST_NOINIT_UNSPECIFIED, MemMapSwAddressMethodRef=VAR_NOCACHE_NO_INIT_UNSPECIFIED, MemMapSwAddressMethodRef=VAR_NOINIT_64, MemMapSwAddressMethodRef=VAR_NOCACHE_NO_INIT_8, MemMapSwAddressMethodRef=VAR_FAST_NO_INIT_BOOLEAN, MemMapSwAddressMethodRef=VAR_NOCACHE_NOINIT_UNSPECIFIED, MemMapSwAddressMethodRef=VAR_NOCACHE_NO_INIT_64, MemMapSwAddressMethodRef=VAR_NOINIT_8, MemMapSwAddressMethodRef=VAR_NOINIT_UNSPECIFIED, MemMapSwAddressMethodRef=VAR_NO_INIT_64, MemMapSwAddressMethodRef=VAR_NO_INIT, MemMapSwAddressMethodRef=VAR_FAST_NO_INIT, MemMapSwAddressMethodRef=VAR_NOINIT_32, MemMapSwAddressMethodRef=VAR_NO_INIT_BOOLEAN, MemMapSwAddressMethodRef=VAR_FAST_NOINIT_64, MemMapSwAddressMethodRef=VAR_NOINIT_16, MemMapSwAddressMethodRef=VAR_FAST_NOINIT_32, MemMapSwAddressMethodRef=VAR_NOINIT_BOOLEAN, MemMapSwAddressMethodRef=VAR_NOCACHE_NOINIT_8, MemMapSwAddressMethodRef=VAR_NOCACHE_NOINIT_BOOLEAN, MemMapSwAddressMethodRef=VAR_FAST_NOINIT_16, MemMapSwAddressMethodRef=VAR_FAST_NOINIT_BOOLEAN, MemMapSwAddressMethodRef=VAR_NOCACHE_NOINIT_64, MemMapSwAddressMethodRef=VAR_NOCACHE_NO_INIT_32, MemMapSwAddressMethodRef=VAR_FAST_NO_INIT_UNSPECIFIED, MemMapSwAddressMethodRef=VAR_FAST_NO_INIT_64, MemMapSwAddressMethodRef=VAR_NOCACHE_NO_INIT_BOOLEAN, MemMapSwAddressMethodRef=VAR_NOCACHE_NOINIT_32, MemMapSwAddressMethodRef=VAR_NOCACHE_NO_INIT_16, MemMapSwAddressMethodRef=VAR_FAST_NO_INIT_32, MemMapSwAddressMethodRef=VAR_NO_INIT_UNSPECIFIED, MemMapSwAddressMethodRef=VAR_NO_INIT_32, MemMapSwAddressMethodRef=VAR_NOCACHE_NOINIT_16, MemMapSwAddressMethodRef=VAR_FAST_NO_INIT_16
        MSR_VAR_SAVED_ZONE: MemMapAddressingModeSetRef=MemMap/MSR_VAR_SAVED_ZONE, MemMapSwAddressMethodRef=VAR_SAVED_ZONE, MemMapSwAddressMethodRef=VAR_SAVED_ZONE_64, MemMapSwAddressMethodRef=VAR_SAVED_ZONE_32, MemMapSwAddressMethodRef=VAR_SAVED_ZONE_UNSPECIFIED, MemMapSwAddressMethodRef=VAR_SAVED_ZONE_8, MemMapSwAddressMethodRef=VAR_SAVED_ZONE_16, MemMapSwAddressMethodRef=VAR_SAVED_ZONE_BOOLEAN
    8 x MemMapAddressingModeSet, all with MemMapCompilerMemClassSymbolImpl=:
      MSR_CODE
        MSR_CODE (MemMapAddressingMode):
          MemMapAlignmentSelector = UNSPECIFIED
          MemMapAlignmentSelector = 8
          MemMapAlignmentSelector = 16
          MemMapAlignmentSelector = 32
          MemMapAlignmentSelector = 64
          MemMapAlignmentSelector = BOOLEAN
      MSR_CONST
        MSR_CONST (MemMapAddressingMode):
          MemMapAlignmentSelector = UNSPECIFIED
          MemMapAlignmentSelector = 8
          MemMapAlignmentSelector = 16
          MemMapAlignmentSelector = 32
          MemMapAlignmentSelector = 64
          MemMapAlignmentSelector = BOOLEAN
          MemMapLinkerLogicalGroupRef = MSR_CONST
      MSR_PBCFG_CONST
        MSR_PBCFG_CONST (MemMapAddressingMode):
          MemMapAlignmentSelector = UNSPECIFIED
          MemMapAlignmentSelector = 8
          MemMapAlignmentSelector = 16
          MemMapAlignmentSelector = 32
          MemMapAlignmentSelector = 64
          MemMapAlignmentSelector = BOOLEAN
          MemMapLinkerLogicalGroupRef = MSR_PBCFG_CONST
      MSR_PBCFG_VAR
        MSR_PBCFG_VAR (MemMapAddressingMode):
          MemMapAlignmentSelector = UNSPECIFIED
          MemMapAlignmentSelector = 8
          MemMapAlignmentSelector = 16
          MemMapAlignmentSelector = 32
          MemMapAlignmentSelector = 64
          MemMapAlignmentSelector = BOOLEAN
          MemMapLinkerLogicalGroupRef = MSR_PBCFG_VAR
      MSR_VAR_CLEARED
        MSR_VAR_CLEARED (MemMapAddressingMode):
          MemMapAlignmentSelector = UNSPECIFIED
          MemMapAlignmentSelector = 8
          MemMapAlignmentSelector = 16
          MemMapAlignmentSelector = 32
          MemMapAlignmentSelector = 64
          MemMapAlignmentSelector = BOOLEAN
          MemMapLinkerLogicalGroupRef = MSR_VAR
      MSR_VAR_INIT
        MSR_VAR_INIT (MemMapAddressingMode):
          MemMapAlignmentSelector = UNSPECIFIED
          MemMapAlignmentSelector = 8
          MemMapAlignmentSelector = 16
          MemMapAlignmentSelector = 32
          MemMapAlignmentSelector = 64
          MemMapAlignmentSelector = BOOLEAN
          MemMapLinkerLogicalGroupRef = MSR_VAR
      MSR_VAR_NO_INIT
        MSR_VAR_NO_INIT (MemMapAddressingMode):
          MemMapAlignmentSelector = UNSPECIFIED
          MemMapAlignmentSelector = 8
          MemMapAlignmentSelector = 16
          MemMapAlignmentSelector = 32
          MemMapAlignmentSelector = 64
          MemMapAlignmentSelector = BOOLEAN
          MemMapAlignmentSelector = 128
          MemMapLinkerLogicalGroupRef = MSR_VAR
      MSR_VAR_SAVED_ZONE
        MSR_VAR_SAVED_ZONE (MemMapAddressingMode):
          MemMapAlignmentSelector = UNSPECIFIED
          MemMapAlignmentSelector = 8
          MemMapAlignmentSelector = 16
          MemMapAlignmentSelector = 32
          MemMapAlignmentSelector = 64
          MemMapAlignmentSelector = BOOLEAN
          MemMapLinkerLogicalGroupRef = MSR_VAR_SAVED_ZONE
    MemMapGeneral:
      MemMapGeneration = FULL
      MemMapCompatibilityGeneration = FULL
      MemMapTypedPragmas = true
      MemMapGeneratePragmas = true
      MemMapErrorChecks = ALL
      MemMapGeneratePragmasForNearAddressing = true
    12 x MemMapAddressingModeSet, all with MemMapCompilerMemClassSymbolImpl=:
      OS_OsApplication_SystemApplication_Core0_VAR_INIT
        OS_OsApplication_SystemApplication_Core0_VAR_INIT (MemMapAddressingMode):
          MemMapAlignmentSelector = BOOLEAN
          MemMapAlignmentSelector = 8
          MemMapAlignmentSelector = 16
          MemMapAlignmentSelector = 32
          MemMapAlignmentSelector = 64
          MemMapAlignmentSelector = UNSPECIFIED
          MemMapLinkerLogicalGroupRef = OS_DATA_CORE0_VAR
      OS_OsApplication_SystemApplication_Core0_VAR_NOINIT
        OS_OsApplication_SystemApplication_Core0_VAR_NOINIT (MemMapAddressingMode):
          MemMapAlignmentSelector = BOOLEAN
          MemMapAlignmentSelector = 8
          MemMapAlignmentSelector = 16
          MemMapAlignmentSelector = 32
          MemMapAlignmentSelector = 64
          MemMapAlignmentSelector = UNSPECIFIED
          MemMapLinkerLogicalGroupRef = OS_DATA_CORE0_VAR
      OS_OsApplication_SystemApplication_Core0_VAR_ZERO_INIT
        OS_OsApplication_SystemApplication_Core0_VAR_ZERO_INIT (MemMapAddressingMode):
          MemMapAlignmentSelector = BOOLEAN
          MemMapAlignmentSelector = 8
          MemMapAlignmentSelector = 16
          MemMapAlignmentSelector = 32
          MemMapAlignmentSelector = 64
          MemMapAlignmentSelector = UNSPECIFIED
          MemMapLinkerLogicalGroupRef = OS_DATA_CORE0_VAR
      OS_OsApplication_SystemApplication_Core0_VAR_SAVED_ZONE
        OS_OsApplication_SystemApplication_Core0_VAR_SAVED_ZONE (MemMapAddressingMode):
          MemMapAlignmentSelector = BOOLEAN
          MemMapAlignmentSelector = 8
          MemMapAlignmentSelector = 16
          MemMapAlignmentSelector = 32
          MemMapAlignmentSelector = 64
          MemMapAlignmentSelector = UNSPECIFIED
          MemMapLinkerLogicalGroupRef = OS_DATA_CORE0_VAR
      OS_OsApplication_SystemApplication_Core1_VAR_INIT
        OS_OsApplication_SystemApplication_Core1_VAR_INIT (MemMapAddressingMode):
          MemMapAlignmentSelector = BOOLEAN
          MemMapAlignmentSelector = 8
          MemMapAlignmentSelector = 16
          MemMapAlignmentSelector = 32
          MemMapAlignmentSelector = 64
          MemMapAlignmentSelector = UNSPECIFIED
          MemMapLinkerLogicalGroupRef = OS_DATA_CORE1_VAR
      OS_OsApplication_SystemApplication_Core1_VAR_NOINIT
        OS_OsApplication_SystemApplication_Core1_VAR_NOINIT (MemMapAddressingMode):
          MemMapAlignmentSelector = BOOLEAN
          MemMapAlignmentSelector = 8
          MemMapAlignmentSelector = 16
          MemMapAlignmentSelector = 32
          MemMapAlignmentSelector = 64
          MemMapAlignmentSelector = UNSPECIFIED
          MemMapLinkerLogicalGroupRef = OS_DATA_CORE1_VAR
      OS_OsApplication_SystemApplication_Core1_VAR_ZERO_INIT
        OS_OsApplication_SystemApplication_Core1_VAR_ZERO_INIT (MemMapAddressingMode):
          MemMapAlignmentSelector = BOOLEAN
          MemMapAlignmentSelector = 8
          MemMapAlignmentSelector = 16
          MemMapAlignmentSelector = 32
          MemMapAlignmentSelector = 64
          MemMapAlignmentSelector = UNSPECIFIED
          MemMapLinkerLogicalGroupRef = OS_DATA_CORE1_VAR
      OS_OsApplication_SystemApplication_Core1_VAR_SAVED_ZONE
        OS_OsApplication_SystemApplication_Core1_VAR_SAVED_ZONE (MemMapAddressingMode):
          MemMapAlignmentSelector = BOOLEAN
          MemMapAlignmentSelector = 8
          MemMapAlignmentSelector = 16
          MemMapAlignmentSelector = 32
          MemMapAlignmentSelector = 64
          MemMapAlignmentSelector = UNSPECIFIED
          MemMapLinkerLogicalGroupRef = OS_DATA_CORE1_VAR
      OS_GLOBALSHARED_VAR_INIT
        OS_GLOBALSHARED_VAR_INIT (MemMapAddressingMode):
          MemMapAlignmentSelector = BOOLEAN
          MemMapAlignmentSelector = 8
          MemMapAlignmentSelector = 16
          MemMapAlignmentSelector = 32
          MemMapAlignmentSelector = 64
          MemMapAlignmentSelector = UNSPECIFIED
          MemMapLinkerLogicalGroupRef = OS_GLOBALSHARED_VAR
      OS_GLOBALSHARED_VAR_NOINIT
        OS_GLOBALSHARED_VAR_NOINIT (MemMapAddressingMode):
          MemMapAlignmentSelector = BOOLEAN
          MemMapAlignmentSelector = 8
          MemMapAlignmentSelector = 16
          MemMapAlignmentSelector = 32
          MemMapAlignmentSelector = 64
          MemMapAlignmentSelector = UNSPECIFIED
          MemMapLinkerLogicalGroupRef = OS_GLOBALSHARED_VAR
      OS_GLOBALSHARED_VAR_ZERO_INIT
        OS_GLOBALSHARED_VAR_ZERO_INIT (MemMapAddressingMode):
          MemMapAlignmentSelector = BOOLEAN
          MemMapAlignmentSelector = 8
          MemMapAlignmentSelector = 16
          MemMapAlignmentSelector = 32
          MemMapAlignmentSelector = 64
          MemMapAlignmentSelector = UNSPECIFIED
          MemMapLinkerLogicalGroupRef = OS_GLOBALSHARED_VAR
      OS_GLOBALSHARED_VAR_SAVED_ZONE
        OS_GLOBALSHARED_VAR_SAVED_ZONE (MemMapAddressingMode):
          MemMapAlignmentSelector = BOOLEAN
          MemMapAlignmentSelector = 8
          MemMapAlignmentSelector = 16
          MemMapAlignmentSelector = 32
          MemMapAlignmentSelector = 64
          MemMapAlignmentSelector = UNSPECIFIED
          MemMapLinkerLogicalGroupRef = OS_GLOBALSHARED_VAR_SAVED_ZONE
    OS_Generic (MemMapAllocation)
      15 x MemMapGenericMapping:
        OS_OsApplication_SystemApplication_Core0_VAR_INIT: MemMapAddressingModeSetRef=MemMap/OS_OsApplication_SystemApplication_Core0_VAR_INIT, MemMapSwAddressMethodRef=OsApplication_SystemApplication_Core0_VAR_FAST_INIT, MemMapSwAddressMethodRef=OsApplication_SystemApplication_Core0_VAR_NOCACHE_INIT, MemMapSwAddressMethodRef=OsApplication_SystemApplication_Core0_VAR_INIT
        OS_OsApplication_SystemApplication_Core0_VAR_NOINIT: MemMapAddressingModeSetRef=MemMap/OS_OsApplication_SystemApplication_Core0_VAR_NOINIT, MemMapSwAddressMethodRef=OsApplication_SystemApplication_Core0_VAR_FAST_NO_INIT, MemMapSwAddressMethodRef=OsApplication_SystemApplication_Core0_VAR_NOCACHE_NO_INIT, MemMapSwAddressMethodRef=OsApplication_SystemApplication_Core0_VAR_NO_INIT
        OS_OsApplication_SystemApplication_Core0_VAR_ZERO_INIT: MemMapAddressingModeSetRef=MemMap/OS_OsApplication_SystemApplication_Core0_VAR_ZERO_INIT, MemMapSwAddressMethodRef=OsApplication_SystemApplication_Core0_VAR_NOCACHE_CLEARED, MemMapSwAddressMethodRef=OsApplication_SystemApplication_Core0_VAR_FAST_CLEARED, MemMapSwAddressMethodRef=OsApplication_SystemApplication_Core0_VAR_CLEARED
        OS_OsApplication_SystemApplication_Core0_VAR_SAVED_ZONE: MemMapAddressingModeSetRef=MemMap/OS_OsApplication_SystemApplication_Core0_VAR_SAVED_ZONE, MemMapSwAddressMethodRef=OsApplication_SystemApplication_Core0_VAR_SAVED_ZONE
        OS_OsApplication_SystemApplication_Core0_CONST: MemMapAddressingModeSetRef=MemMap/MSR_CONST, MemMapSwAddressMethodRef=OsApplication_SystemApplication_Core0_CONST_FAST, MemMapSwAddressMethodRef=OsApplication_SystemApplication_Core0_CONST
        OS_OsApplication_SystemApplication_Core1_VAR_INIT: MemMapAddressingModeSetRef=MemMap/OS_OsApplication_SystemApplication_Core1_VAR_INIT, MemMapSwAddressMethodRef=OsApplication_SystemApplication_Core1_VAR_NOCACHE_INIT, MemMapSwAddressMethodRef=OsApplication_SystemApplication_Core1_VAR_FAST_INIT, MemMapSwAddressMethodRef=OsApplication_SystemApplication_Core1_VAR_INIT
        OS_OsApplication_SystemApplication_Core1_VAR_NOINIT: MemMapAddressingModeSetRef=MemMap/OS_OsApplication_SystemApplication_Core1_VAR_NOINIT, MemMapSwAddressMethodRef=OsApplication_SystemApplication_Core1_VAR_NO_INIT, MemMapSwAddressMethodRef=OsApplication_SystemApplication_Core1_VAR_NOCACHE_NO_INIT, MemMapSwAddressMethodRef=OsApplication_SystemApplication_Core1_VAR_FAST_NO_INIT
        OS_OsApplication_SystemApplication_Core1_VAR_ZERO_INIT: MemMapAddressingModeSetRef=MemMap/OS_OsApplication_SystemApplication_Core1_VAR_ZERO_INIT, MemMapSwAddressMethodRef=OsApplication_SystemApplication_Core1_VAR_FAST_CLEARED, MemMapSwAddressMethodRef=OsApplication_SystemApplication_Core1_VAR_NOCACHE_CLEARED, MemMapSwAddressMethodRef=OsApplication_SystemApplication_Core1_VAR_CLEARED
        OS_OsApplication_SystemApplication_Core1_VAR_SAVED_ZONE: MemMapAddressingModeSetRef=MemMap/OS_OsApplication_SystemApplication_Core1_VAR_SAVED_ZONE, MemMapSwAddressMethodRef=OsApplication_SystemApplication_Core1_VAR_SAVED_ZONE
        OS_OsApplication_SystemApplication_Core1_CONST: MemMapAddressingModeSetRef=MemMap/MSR_CONST, MemMapSwAddressMethodRef=OsApplication_SystemApplication_Core1_CONST_FAST, MemMapSwAddressMethodRef=OsApplication_SystemApplication_Core1_CONST
        OS_GLOBALSHARED_VAR_INIT: MemMapAddressingModeSetRef=MemMap/OS_GLOBALSHARED_VAR_INIT, MemMapSwAddressMethodRef=GLOBALSHARED_VAR_INIT, MemMapSwAddressMethodRef=GLOBALSHARED_VAR_FAST_INIT, MemMapSwAddressMethodRef=GLOBALSHARED_VAR_NOCACHE_INIT
        OS_GLOBALSHARED_VAR_NOINIT: MemMapAddressingModeSetRef=MemMap/OS_GLOBALSHARED_VAR_NOINIT, MemMapSwAddressMethodRef=GLOBALSHARED_VAR_NOCACHE_NO_INIT, MemMapSwAddressMethodRef=GLOBALSHARED_VAR_FAST_NO_INIT, MemMapSwAddressMethodRef=GLOBALSHARED_VAR_NO_INIT
        OS_GLOBALSHARED_VAR_ZERO_INIT: MemMapAddressingModeSetRef=MemMap/OS_GLOBALSHARED_VAR_ZERO_INIT, MemMapSwAddressMethodRef=GLOBALSHARED_VAR_NOCACHE_CLEARED, MemMapSwAddressMethodRef=GLOBALSHARED_VAR_CLEARED, MemMapSwAddressMethodRef=GLOBALSHARED_VAR_FAST_CLEARED
        OS_GLOBALSHARED_VAR_SAVED_ZONE: MemMapAddressingModeSetRef=MemMap/OS_GLOBALSHARED_VAR_SAVED_ZONE, MemMapSwAddressMethodRef=GLOBALSHARED_VAR_SAVED_ZONE
        OS_GLOBALSHARED_CONST: MemMapAddressingModeSetRef=MemMap/MSR_CONST, MemMapSwAddressMethodRef=GLOBALSHARED_CONST, MemMapSwAddressMethodRef=GLOBALSHARED_CONST_FAST
    RTM_VAR_INIT (MemMapAddressingModeSet): MemMapCompilerMemClassSymbolImpl=
      MemMapAddressingMode: MemMapAlignmentSelector=, MemMapAlignmentSelector=UNSPECIFIED
    11 x MemMapAllocation:
      Rtm_Generic
        RTM_VAR_INIT (MemMapGenericMapping): MemMapAddressingModeSetRef=MemMap/RTM_VAR_INIT, MemMapSwAddressMethodRef=VAR_INIT_UNSPECIFIED_SAFE
      SWC_BswM
        3 x MemMapSectionSpecificMapping:
          BswM_START_SEC_VAR_NOINIT_UNSPECIFIED: MemMapAddressingModeSetRef=MemMap/OS_OsApplication_SystemApplication_Core0_VAR_NOINIT, MemMapMemorySectionRef=BswM_OsApplication_SystemApplication_Core0_START_SEC_VAR_NOINIT_UNSPECIFIED
          BswM_START_SEC_VAR_INIT_UNSPECIFIED: MemMapAddressingModeSetRef=MemMap/OS_OsApplication_SystemApplication_Core0_VAR_INIT, MemMapMemorySectionRef=BswM_OsApplication_SystemApplication_Core0_START_SEC_VAR_INIT_UNSPECIFIED
          BswM_START_SEC_VAR_ZERO_INIT_UNSPECIFIED: MemMapAddressingModeSetRef=MemMap/OS_OsApplication_SystemApplication_Core0_VAR_ZERO_INIT, MemMapMemorySectionRef=BswM_OsApplication_SystemApplication_Core0_START_SEC_VAR_ZERO_INIT_UNSPECIFIED
      SWC_BswM_OsApplication_SystemApplication_Core1
        3 x MemMapSectionSpecificMapping:
          BswM_OsApplication_SystemApplication_Core1_START_SEC_VAR_NOINIT_UNSPECIFIED: MemMapAddressingModeSetRef=MemMap/OS_OsApplication_SystemApplication_Core1_VAR_NOINIT, MemMapMemorySectionRef=BswM_OsApplication_SystemApplication_Core1_START_SEC_VAR_NOINIT_UNSPECIFIED
          BswM_OsApplication_SystemApplication_Core1_START_SEC_VAR_INIT_UNSPECIFIED: MemMapAddressingModeSetRef=MemMap/OS_OsApplication_SystemApplication_Core1_VAR_INIT, MemMapMemorySectionRef=BswM_OsApplication_SystemApplication_Core1_START_SEC_VAR_INIT_UNSPECIFIED
          BswM_OsApplication_SystemApplication_Core1_START_SEC_VAR_ZERO_INIT_UNSPECIFIED: MemMapAddressingModeSetRef=MemMap/OS_OsApplication_SystemApplication_Core1_VAR_ZERO_INIT, MemMapMemorySectionRef=BswM_OsApplication_SystemApplication_Core1_START_SEC_VAR_ZERO_INIT_UNSPECIFIED
      SWC_ComM
        3 x MemMapSectionSpecificMapping:
          ComM_START_SEC_VAR_NOINIT_UNSPECIFIED: MemMapAddressingModeSetRef=MemMap/OS_OsApplication_SystemApplication_Core0_VAR_NOINIT, MemMapMemorySectionRef=ComM_START_SEC_VAR_NOINIT_UNSPECIFIED
          ComM_START_SEC_VAR_INIT_UNSPECIFIED: MemMapAddressingModeSetRef=MemMap/OS_OsApplication_SystemApplication_Core0_VAR_INIT, MemMapMemorySectionRef=ComM_START_SEC_VAR_INIT_UNSPECIFIED
          ComM_START_SEC_VAR_ZERO_INIT_UNSPECIFIED: MemMapAddressingModeSetRef=MemMap/OS_OsApplication_SystemApplication_Core0_VAR_ZERO_INIT, MemMapMemorySectionRef=ComM_START_SEC_VAR_ZERO_INIT_UNSPECIFIED
      SWC_Dcm
        3 x MemMapSectionSpecificMapping:
          Dcm_START_SEC_VAR_NOINIT_UNSPECIFIED: MemMapAddressingModeSetRef=MemMap/OS_OsApplication_SystemApplication_Core0_VAR_NOINIT, MemMapMemorySectionRef=Dcm_START_SEC_VAR_NOINIT_UNSPECIFIED
          Dcm_START_SEC_VAR_INIT_UNSPECIFIED: MemMapAddressingModeSetRef=MemMap/OS_OsApplication_SystemApplication_Core0_VAR_INIT, MemMapMemorySectionRef=Dcm_START_SEC_VAR_INIT_UNSPECIFIED
          Dcm_START_SEC_VAR_ZERO_INIT_UNSPECIFIED: MemMapAddressingModeSetRef=MemMap/OS_OsApplication_SystemApplication_Core0_VAR_ZERO_INIT, MemMapMemorySectionRef=Dcm_START_SEC_VAR_ZERO_INIT_UNSPECIFIED
      SWC_EcuM
        3 x MemMapSectionSpecificMapping:
          EcuM_START_SEC_VAR_NOINIT_UNSPECIFIED: MemMapAddressingModeSetRef=MemMap/OS_OsApplication_SystemApplication_Core0_VAR_NOINIT, MemMapMemorySectionRef=EcuM_START_SEC_VAR_NOINIT_UNSPECIFIED
          EcuM_START_SEC_VAR_INIT_UNSPECIFIED: MemMapAddressingModeSetRef=MemMap/OS_OsApplication_SystemApplication_Core0_VAR_INIT, MemMapMemorySectionRef=EcuM_START_SEC_VAR_INIT_UNSPECIFIED
          EcuM_START_SEC_VAR_ZERO_INIT_UNSPECIFIED: MemMapAddressingModeSetRef=MemMap/OS_OsApplication_SystemApplication_Core0_VAR_ZERO_INIT, MemMapMemorySectionRef=EcuM_START_SEC_VAR_ZERO_INIT_UNSPECIFIED
      SWC_StartApplicationEth
        3 x MemMapSectionSpecificMapping:
          StartApplicationEth_START_SEC_VAR_NOINIT_UNSPECIFIED: MemMapAddressingModeSetRef=MemMap/OS_OsApplication_SystemApplication_Core0_VAR_NOINIT, MemMapMemorySectionRef=StartApplicationEth_START_SEC_VAR_NOINIT_UNSPECIFIED
          StartApplicationEth_START_SEC_VAR_INIT_UNSPECIFIED: MemMapAddressingModeSetRef=MemMap/OS_OsApplication_SystemApplication_Core0_VAR_INIT, MemMapMemorySectionRef=StartApplicationEth_START_SEC_VAR_INIT_UNSPECIFIED
          StartApplicationEth_START_SEC_VAR_ZERO_INIT_UNSPECIFIED: MemMapAddressingModeSetRef=MemMap/OS_OsApplication_SystemApplication_Core0_VAR_ZERO_INIT, MemMapMemorySectionRef=StartApplicationEth_START_SEC_VAR_ZERO_INIT_UNSPECIFIED
      ShA_Adapter
        ShA_START_SEC_CODE (MemMapSectionSpecificMapping): MemMapAddressingModeSetRef=MemMap/MSR_CODE, MemMapMemorySectionRef=SHA_APPL_CODE, MemMapMemorySectionRef=VAR_INIT_UNSPECIFIED
        ShA_STOP_SEC_CODE (MemMapSectionSpecificMapping): MemMapAddressingModeSetRef=MemMap/MSR_CODE, MemMapMemorySectionRef=CODE
      NvA_Adapter
        NvA_START_SEC_CODE (MemMapSectionSpecificMapping): MemMapAddressingModeSetRef=MemMap/MSR_CODE, MemMapMemorySectionRef=CODE, MemMapMemorySectionRef=CONST_UNSPECIFIED
      Diag_Adapter
        DiagA_START_SEC_CONST_UNSPECIFIED (MemMapSectionSpecificMapping):
          MemMapAddressingModeSetRef = MemMap/MSR_CODE
          MemMapMemorySectionRef = DIAGA_APPL_CODE
          MemMapMemorySectionRef = CONST_UNSPECIFIED
          MemMapMemorySectionRef = CODE
      AppData_Adapter
        AppDataA_START_SEC_CODE (MemMapSectionSpecificMapping): MemMapAddressingModeSetRef=MemMap/MSR_CODE, MemMapMemorySectionRef=CODE
