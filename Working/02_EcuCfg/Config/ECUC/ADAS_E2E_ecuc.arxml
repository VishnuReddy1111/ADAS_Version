AUTOSAR XML (schema 4-3-0)
package /ActiveEcuC
  module config E2E: implementation-config-variant=VARIANT-PRE-COMPILE, module-description=E2E_Impl
