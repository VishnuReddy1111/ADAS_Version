AUTOSAR XML (schema 4-3-0)
package /ActiveEcuC
  module config ComM: implementation-config-variant=VARIANT-PRE-COMPILE, module-description=ComM_Impl
    ComMGeneral:
      ComMPncGatewayEnabled = false
      ComMPncIdCounting = COMM_PNC_ID_COUNT_FROM_NM_MESSAGE
      ComMPncPrepareSleepTimer = 0
      ComMPncSupport = true
      ComMDevErrorDetect = true
      ComMEcuGroupClassification = 3
      ComMModeLimitationEnabled = false
      ComMSynchronousWakeUp = false
      ComMTMinFullComModeDuration = 5
      ComMVersionInfoApi = true
      ComMWakeupInhibitionEnabled = false
      ComMSafeBswChecks = false
      ComMGeneration: ComMOutOfBoundsWriteSanitizer=false, ComMOutOfBoundsReadSanitizer=false
    ComMConfigSet: ComMPncEnabled=true
      3 x ComMPnc, all with ComMChannelPerPnc=CN_HCP5_CANFD01_54d90215:
        PNC_36_Preheater_b14f0d7f: ComMPncId=43, ComMUserPerPnc=PNC_36_Preheater_5e289989
          ComSignalPnc_EIRA_CAN_Rx_1e4792f2 (ComMPncComSignal): ComMPncComSignalDirection=RX, ComMPncComSignalKind=EIRA, ComMPncComSignalRef=ComSignalPnc_EIRA_CAN_Rx
          NM_Hybrid_01_FCAB_XIX_NM_Hybrid_01_XIX_HCP5_CANFD01_38c188fa_Tx_8c6d3281 (ComMPncComSignal):
            ComMPncComSignalDirection = TX
            ComMPncComSignalKind = EIRA
            ComMPncComSignalChannelRef = CN_HCP5_CANFD01_54d90215
            ComMPncComSignalRef = NM_Hybrid_01_FCAB_XIX_NM_Hybrid_01_XIX_HCP5_CANFD01_38c188fa_Tx
        PNC_45_Diagnosis_Comfort_54b3da15: ComMPncId=52, ComMUserPerPnc=PNC_45_Diagnosis_Comfort_7eea372a
          ComSignalPnc_EIRA_CAN_Rx_1e4792f2 (ComMPncComSignal): ComMPncComSignalDirection=RX, ComMPncComSignalKind=EIRA, ComMPncComSignalRef=ComSignalPnc_EIRA_CAN_Rx
          NM_Hybrid_01_FCAB_XIX_NM_Hybrid_01_XIX_HCP5_CANFD01_38c188fa_Tx_8c6d3281 (ComMPncComSignal):
            ComMPncComSignalDirection = TX
            ComMPncComSignalKind = EIRA
            ComMPncComSignalChannelRef = CN_HCP5_CANFD01_54d90215
            ComMPncComSignalRef = NM_Hybrid_01_FCAB_XIX_NM_Hybrid_01_XIX_HCP5_CANFD01_38c188fa_Tx
        PNC_26_HighVoltage_Charging_24d89ab8: ComMPncId=33, ComMUserPerPnc=PNC_26_HighVoltage_Charging_c00f85a2
          ComSignalPnc_EIRA_CAN_Rx_1e4792f2 (ComMPncComSignal): ComMPncComSignalDirection=RX, ComMPncComSignalKind=EIRA, ComMPncComSignalRef=ComSignalPnc_EIRA_CAN_Rx
          NM_Hybrid_01_FCAB_XIX_NM_Hybrid_01_XIX_HCP5_CANFD01_38c188fa_Tx_8c6d3281 (ComMPncComSignal):
            ComMPncComSignalDirection = TX
            ComMPncComSignalKind = EIRA
            ComMPncComSignalChannelRef = CN_HCP5_CANFD01_54d90215
            ComMPncComSignalRef = NM_Hybrid_01_FCAB_XIX_NM_Hybrid_01_XIX_HCP5_CANFD01_38c188fa_Tx
      CN_HCP5_CANFD01_84d44928 (ComMUser): ComMUserIdentifier=1, ComMUserModeNotification=false
      PNC_18_VirtualSideMirrors_5814f436 (ComMPnc): ComMPncId=25, ComMChannelPerPnc=CN_HCP5_CANFD01_54d90215, ComMUserPerPnc=PNC_18_VirtualSideMirrors_dca4d4b3
        ComSignalPnc_EIRA_CAN_Rx_1e4792f2 (ComMPncComSignal): ComMPncComSignalDirection=RX, ComMPncComSignalKind=EIRA, ComMPncComSignalRef=ComSignalPnc_EIRA_CAN_Rx
        NM_Hybrid_01_FCAB_XIX_NM_Hybrid_01_XIX_HCP5_CANFD01_38c188fa_Tx_8c6d3281 (ComMPncComSignal):
          ComMPncComSignalDirection = TX
          ComMPncComSignalKind = EIRA
          ComMPncComSignalChannelRef = CN_HCP5_CANFD01_54d90215
          ComMPncComSignalRef = NM_Hybrid_01_FCAB_XIX_NM_Hybrid_01_XIX_HCP5_CANFD01_38c188fa_Tx
      PNC_56_Charging_Status_19bd3663 (ComMPnc): ComMPncId=63, ComMChannelPerPnc=CN_HCP5_CANFD01_54d90215, ComMUserPerPnc=PNC_56_Charging_Status_cad5dfb4
        ComSignalPnc_EIRA_CAN_Rx_1e4792f2 (ComMPncComSignal): ComMPncComSignalDirection=RX, ComMPncComSignalKind=EIRA, ComMPncComSignalRef=ComSignalPnc_EIRA_CAN_Rx
        NM_Hybrid_01_FCAB_XIX_NM_Hybrid_01_XIX_HCP5_CANFD01_38c188fa_Tx_8c6d3281 (ComMPncComSignal):
          ComMPncComSignalDirection = TX
          ComMPncComSignalKind = EIRA
          ComMPncComSignalChannelRef = CN_HCP5_CANFD01_54d90215
          ComMPncComSignalRef = NM_Hybrid_01_FCAB_XIX_NM_Hybrid_01_XIX_HCP5_CANFD01_38c188fa_Tx
      PNC_04_Basefunction_DrivingAssistance_2e755e80 (ComMUser): ComMUserIdentifier=5, ComMUserModeNotification=false
      CN_HCP5_CANFD01_54d90215 (ComMChannel):
        ComMBusType = COMM_BUS_TYPE_CAN
        ComMChannelId = 1
        ComMPncGatewayType = COMM_GATEWAY_TYPE_NONE
        ComMFullCommRequestNotificationEnabled = false
        ComMMainFunctionPeriod = 0.02
        ComMNoCom = false
        ComMNoWakeup = false
        ComMNetworkManagement: ComMNmVariant=FULL, ComMPncNmRequest=false
        CN_HCP5_CANFD01_828294e2 (ComMUserPerChannel): ComMUserChannel=CN_HCP5_CANFD01_84d44928
      PNC_31_MultifunctionalSteeringWheel_4e0a8e7c (ComMPnc): ComMPncId=38, ComMChannelPerPnc=CN_HCP5_CANFD01_54d90215, ComMUserPerPnc=PNC_31_MultifunctionalSteeringWheel_48e6d667
        ComSignalPnc_EIRA_CAN_Rx_1e4792f2 (ComMPncComSignal): ComMPncComSignalDirection=RX, ComMPncComSignalKind=EIRA, ComMPncComSignalRef=ComSignalPnc_EIRA_CAN_Rx
        NM_Hybrid_01_FCAB_XIX_NM_Hybrid_01_XIX_HCP5_CANFD01_38c188fa_Tx_8c6d3281 (ComMPncComSignal):
          ComMPncComSignalDirection = TX
          ComMPncComSignalKind = EIRA
          ComMPncComSignalChannelRef = CN_HCP5_CANFD01_54d90215
          ComMPncComSignalRef = NM_Hybrid_01_FCAB_XIX_NM_Hybrid_01_XIX_HCP5_CANFD01_38c188fa_Tx
      PNC_15_InstrumentclusterDisplay_afd3c636 (ComMPnc): ComMPncId=22, ComMChannelPerPnc=CN_HCP5_CANFD01_54d90215, ComMUserPerPnc=PNC_15_InstrumentclusterDisplay_1a610817
        ComSignalPnc_EIRA_CAN_Rx_1e4792f2 (ComMPncComSignal): ComMPncComSignalDirection=RX, ComMPncComSignalKind=EIRA, ComMPncComSignalRef=ComSignalPnc_EIRA_CAN_Rx
        NM_Hybrid_01_FCAB_XIX_NM_Hybrid_01_XIX_HCP5_CANFD01_38c188fa_Tx_8c6d3281 (ComMPncComSignal):
          ComMPncComSignalDirection = TX
          ComMPncComSignalKind = EIRA
          ComMPncComSignalChannelRef = CN_HCP5_CANFD01_54d90215
          ComMPncComSignalRef = NM_Hybrid_01_FCAB_XIX_NM_Hybrid_01_XIX_HCP5_CANFD01_38c188fa_Tx
      5 x ComMUser, all with ComMUserModeNotification=false:
        PNC_43_Diagnosis_DrivingAssistance_84f09039: ComMUserIdentifier=41
        PNC_12_GearSelector_2aa5ddd0: ComMUserIdentifier=12
        PNC_16_InfotainmentDisplay_1d18259d: ComMUserIdentifier=16
        PNC_27_Timemaster_Timer_53539b48: ComMUserIdentifier=27
        PNC_48_Diagnosis_ClimateTmeLINs_b4c40b49: ComMUserIdentifier=46
      PNC_13_Airbag_727cecad (ComMPnc): ComMPncId=20, ComMChannelPerPnc=CN_HCP5_CANFD01_54d90215, ComMUserPerPnc=PNC_13_Airbag_2554061c
        ComSignalPnc_EIRA_CAN_Rx_1e4792f2 (ComMPncComSignal): ComMPncComSignalDirection=RX, ComMPncComSignalKind=EIRA, ComMPncComSignalRef=ComSignalPnc_EIRA_CAN_Rx
        NM_Hybrid_01_FCAB_XIX_NM_Hybrid_01_XIX_HCP5_CANFD01_38c188fa_Tx_8c6d3281 (ComMPncComSignal):
          ComMPncComSignalDirection = TX
          ComMPncComSignalKind = EIRA
          ComMPncComSignalChannelRef = CN_HCP5_CANFD01_54d90215
          ComMPncComSignalRef = NM_Hybrid_01_FCAB_XIX_NM_Hybrid_01_XIX_HCP5_CANFD01_38c188fa_Tx
      PNC_33_ExternalWirelessCommunication_779a8708 (ComMUser): ComMUserIdentifier=33, ComMUserModeNotification=false
      PNC_46_Diagnosis_Light_2422ec0e (ComMPnc): ComMPncId=53, ComMChannelPerPnc=CN_HCP5_CANFD01_54d90215, ComMUserPerPnc=PNC_46_Diagnosis_Light_5140c135
        ComSignalPnc_EIRA_CAN_Rx_1e4792f2 (ComMPncComSignal): ComMPncComSignalDirection=RX, ComMPncComSignalKind=EIRA, ComMPncComSignalRef=ComSignalPnc_EIRA_CAN_Rx
        NM_Hybrid_01_FCAB_XIX_NM_Hybrid_01_XIX_HCP5_CANFD01_38c188fa_Tx_8c6d3281 (ComMPncComSignal):
          ComMPncComSignalDirection = TX
          ComMPncComSignalKind = EIRA
          ComMPncComSignalChannelRef = CN_HCP5_CANFD01_54d90215
          ComMPncComSignalRef = NM_Hybrid_01_FCAB_XIX_NM_Hybrid_01_XIX_HCP5_CANFD01_38c188fa_Tx
      PNC_16_InfotainmentDisplay_e8d84b12 (ComMPnc): ComMPncId=23, ComMChannelPerPnc=CN_HCP5_CANFD01_54d90215, ComMUserPerPnc=PNC_16_InfotainmentDisplay_1d18259d
        ComSignalPnc_EIRA_CAN_Rx_1e4792f2 (ComMPncComSignal): ComMPncComSignalDirection=RX, ComMPncComSignalKind=EIRA, ComMPncComSignalRef=ComSignalPnc_EIRA_CAN_Rx
        NM_Hybrid_01_FCAB_XIX_NM_Hybrid_01_XIX_HCP5_CANFD01_38c188fa_Tx_8c6d3281 (ComMPncComSignal):
          ComMPncComSignalDirection = TX
          ComMPncComSignalKind = EIRA
          ComMPncComSignalChannelRef = CN_HCP5_CANFD01_54d90215
          ComMPncComSignalRef = NM_Hybrid_01_FCAB_XIX_NM_Hybrid_01_XIX_HCP5_CANFD01_38c188fa_Tx
      5 x ComMUser, all with ComMUserModeNotification=false:
        PNC_28_OnboardTester_DataCollector_c7d92e04: ComMUserIdentifier=28
        PNC_30_EnergyManagement_82f39188: ComMUserIdentifier=30
        PNC_42_Diagnosis_FlexRay_f6dcf44d: ComMUserIdentifier=40
        PNC_21_AirSuspension_3e4d6d03: ComMUserIdentifier=21
        PNC_36_Preheater_5e289989: ComMUserIdentifier=36
      PNC_25_AccessSystemSensors_0f593a4b (ComMPnc): ComMPncId=32, ComMChannelPerPnc=CN_HCP5_CANFD01_54d90215, ComMUserPerPnc=PNC_25_AccessSystemSensors_863389c2
        ComSignalPnc_EIRA_CAN_Rx_1e4792f2 (ComMPncComSignal): ComMPncComSignalDirection=RX, ComMPncComSignalKind=EIRA, ComMPncComSignalRef=ComSignalPnc_EIRA_CAN_Rx
        NM_Hybrid_01_FCAB_XIX_NM_Hybrid_01_XIX_HCP5_CANFD01_38c188fa_Tx_8c6d3281 (ComMPncComSignal):
          ComMPncComSignalDirection = TX
          ComMPncComSignalKind = EIRA
          ComMPncComSignalChannelRef = CN_HCP5_CANFD01_54d90215
          ComMPncComSignalRef = NM_Hybrid_01_FCAB_XIX_NM_Hybrid_01_XIX_HCP5_CANFD01_38c188fa_Tx
      PNC_20_OptionalComfort_76e30655 (ComMUser): ComMUserIdentifier=20, ComMUserModeNotification=false
      PNC_22_ExteriorLights_ee477910 (ComMPnc): ComMPncId=29, ComMChannelPerPnc=CN_HCP5_CANFD01_54d90215, ComMUserPerPnc=PNC_22_ExteriorLights_3bdfbcd3
        ComSignalPnc_EIRA_CAN_Rx_1e4792f2 (ComMPncComSignal): ComMPncComSignalDirection=RX, ComMPncComSignalKind=EIRA, ComMPncComSignalRef=ComSignalPnc_EIRA_CAN_Rx
        NM_Hybrid_01_FCAB_XIX_NM_Hybrid_01_XIX_HCP5_CANFD01_38c188fa_Tx_8c6d3281 (ComMPncComSignal):
          ComMPncComSignalDirection = TX
          ComMPncComSignalKind = EIRA
          ComMPncComSignalChannelRef = CN_HCP5_CANFD01_54d90215
          ComMPncComSignalRef = NM_Hybrid_01_FCAB_XIX_NM_Hybrid_01_XIX_HCP5_CANFD01_38c188fa_Tx
      PNC_13_Airbag_2554061c (ComMUser): ComMUserIdentifier=13, ComMUserModeNotification=false
      PNC_15_InstrumentclusterDisplay_1a610817 (ComMUser): ComMUserIdentifier=15, ComMUserModeNotification=false
      PNC_12_GearSelector_9f4a754a (ComMPnc): ComMPncId=19, ComMChannelPerPnc=CN_HCP5_CANFD01_54d90215, ComMUserPerPnc=PNC_12_GearSelector_2aa5ddd0
        ComSignalPnc_EIRA_CAN_Rx_1e4792f2 (ComMPncComSignal): ComMPncComSignalDirection=RX, ComMPncComSignalKind=EIRA, ComMPncComSignalRef=ComSignalPnc_EIRA_CAN_Rx
        NM_Hybrid_01_FCAB_XIX_NM_Hybrid_01_XIX_HCP5_CANFD01_38c188fa_Tx_8c6d3281 (ComMPncComSignal):
          ComMPncComSignalDirection = TX
          ComMPncComSignalKind = EIRA
          ComMPncComSignalChannelRef = CN_HCP5_CANFD01_54d90215
          ComMPncComSignalRef = NM_Hybrid_01_FCAB_XIX_NM_Hybrid_01_XIX_HCP5_CANFD01_38c188fa_Tx
      4 x ComMUser, all with ComMUserModeNotification=false:
        PNC_17_Audio_d11279f4: ComMUserIdentifier=17
        PNC_35_ExteriorSound_9764238b: ComMUserIdentifier=35
        PNC_08_Basefunction_Connectivity_33115909: ComMUserIdentifier=9
        PNC_26_HighVoltage_Charging_c00f85a2: ComMUserIdentifier=26
      3 x ComMPnc, all with ComMChannelPerPnc=CN_HCP5_CANFD01_54d90215:
        PNC_29_SteeringColumnLock_af7c21af: ComMPncId=36, ComMUserPerPnc=PNC_29_SteeringColumnLock_44a1738d
          ComSignalPnc_EIRA_CAN_Rx_1e4792f2 (ComMPncComSignal): ComMPncComSignalDirection=RX, ComMPncComSignalKind=EIRA, ComMPncComSignalRef=ComSignalPnc_EIRA_CAN_Rx
          NM_Hybrid_01_FCAB_XIX_NM_Hybrid_01_XIX_HCP5_CANFD01_38c188fa_Tx_8c6d3281 (ComMPncComSignal):
            ComMPncComSignalDirection = TX
            ComMPncComSignalKind = EIRA
            ComMPncComSignalChannelRef = CN_HCP5_CANFD01_54d90215
            ComMPncComSignalRef = NM_Hybrid_01_FCAB_XIX_NM_Hybrid_01_XIX_HCP5_CANFD01_38c188fa_Tx
        PNC_17_Audio_8cbcad43: ComMPncId=24, ComMUserPerPnc=PNC_17_Audio_d11279f4
          ComSignalPnc_EIRA_CAN_Rx_1e4792f2 (ComMPncComSignal): ComMPncComSignalDirection=RX, ComMPncComSignalKind=EIRA, ComMPncComSignalRef=ComSignalPnc_EIRA_CAN_Rx
          NM_Hybrid_01_FCAB_XIX_NM_Hybrid_01_XIX_HCP5_CANFD01_38c188fa_Tx_8c6d3281 (ComMPncComSignal):
            ComMPncComSignalDirection = TX
            ComMPncComSignalKind = EIRA
            ComMPncComSignalChannelRef = CN_HCP5_CANFD01_54d90215
            ComMPncComSignalRef = NM_Hybrid_01_FCAB_XIX_NM_Hybrid_01_XIX_HCP5_CANFD01_38c188fa_Tx
        PNC_35_ExteriorSound_90ecdcdb: ComMPncId=42, ComMUserPerPnc=PNC_35_ExteriorSound_9764238b
          ComSignalPnc_EIRA_CAN_Rx_1e4792f2 (ComMPncComSignal): ComMPncComSignalDirection=RX, ComMPncComSignalKind=EIRA, ComMPncComSignalRef=ComSignalPnc_EIRA_CAN_Rx
          NM_Hybrid_01_FCAB_XIX_NM_Hybrid_01_XIX_HCP5_CANFD01_38c188fa_Tx_8c6d3281 (ComMPncComSignal):
            ComMPncComSignalDirection = TX
            ComMPncComSignalKind = EIRA
            ComMPncComSignalChannelRef = CN_HCP5_CANFD01_54d90215
            ComMPncComSignalRef = NM_Hybrid_01_FCAB_XIX_NM_Hybrid_01_XIX_HCP5_CANFD01_38c188fa_Tx
      PNC_37_HighVoltage_WirelessChargingStation_f111c76f (ComMUser): ComMUserIdentifier=37, ComMUserModeNotification=false
      4 x ComMPnc, all with ComMChannelPerPnc=CN_HCP5_CANFD01_54d90215:
        PNC_40_Diagnosis_Energy_40b20ab8: ComMPncId=47, ComMUserPerPnc=PNC_40_Diagnosis_Energy_532c6fb4
          ComSignalPnc_EIRA_CAN_Rx_1e4792f2 (ComMPncComSignal): ComMPncComSignalDirection=RX, ComMPncComSignalKind=EIRA, ComMPncComSignalRef=ComSignalPnc_EIRA_CAN_Rx
          NM_Hybrid_01_FCAB_XIX_NM_Hybrid_01_XIX_HCP5_CANFD01_38c188fa_Tx_8c6d3281 (ComMPncComSignal):
            ComMPncComSignalDirection = TX
            ComMPncComSignalKind = EIRA
            ComMPncComSignalChannelRef = CN_HCP5_CANFD01_54d90215
            ComMPncComSignalRef = NM_Hybrid_01_FCAB_XIX_NM_Hybrid_01_XIX_HCP5_CANFD01_38c188fa_Tx
        PNC_21_AirSuspension_32658f46: ComMPncId=28, ComMUserPerPnc=PNC_21_AirSuspension_3e4d6d03
          ComSignalPnc_EIRA_CAN_Rx_1e4792f2 (ComMPncComSignal): ComMPncComSignalDirection=RX, ComMPncComSignalKind=EIRA, ComMPncComSignalRef=ComSignalPnc_EIRA_CAN_Rx
          NM_Hybrid_01_FCAB_XIX_NM_Hybrid_01_XIX_HCP5_CANFD01_38c188fa_Tx_8c6d3281 (ComMPncComSignal):
            ComMPncComSignalDirection = TX
            ComMPncComSignalKind = EIRA
            ComMPncComSignalChannelRef = CN_HCP5_CANFD01_54d90215
            ComMPncComSignalRef = NM_Hybrid_01_FCAB_XIX_NM_Hybrid_01_XIX_HCP5_CANFD01_38c188fa_Tx
        PNC_02_Basefunction_Powertrain_6b6ac64e: ComMPncId=9, ComMUserPerPnc=PNC_02_Basefunction_Powertrain_6e8e3f0b
          ComSignalPnc_EIRA_CAN_Rx_1e4792f2 (ComMPncComSignal): ComMPncComSignalDirection=RX, ComMPncComSignalKind=EIRA, ComMPncComSignalRef=ComSignalPnc_EIRA_CAN_Rx
          NM_Hybrid_01_FCAB_XIX_NM_Hybrid_01_XIX_HCP5_CANFD01_38c188fa_Tx_8c6d3281 (ComMPncComSignal):
            ComMPncComSignalDirection = TX
            ComMPncComSignalKind = EIRA
            ComMPncComSignalChannelRef = CN_HCP5_CANFD01_54d90215
            ComMPncComSignalRef = NM_Hybrid_01_FCAB_XIX_NM_Hybrid_01_XIX_HCP5_CANFD01_38c188fa_Tx
        PNC_48_Diagnosis_ClimateTmeLINs_cce3bfb2: ComMPncId=55, ComMUserPerPnc=PNC_48_Diagnosis_ClimateTmeLINs_b4c40b49
          ComSignalPnc_EIRA_CAN_Rx_1e4792f2 (ComMPncComSignal): ComMPncComSignalDirection=RX, ComMPncComSignalKind=EIRA, ComMPncComSignalRef=ComSignalPnc_EIRA_CAN_Rx
          NM_Hybrid_01_FCAB_XIX_NM_Hybrid_01_XIX_HCP5_CANFD01_38c188fa_Tx_8c6d3281 (ComMPncComSignal):
            ComMPncComSignalDirection = TX
            ComMPncComSignalKind = EIRA
            ComMPncComSignalChannelRef = CN_HCP5_CANFD01_54d90215
            ComMPncComSignalRef = NM_Hybrid_01_FCAB_XIX_NM_Hybrid_01_XIX_HCP5_CANFD01_38c188fa_Tx
      5 x ComMUser, all with ComMUserModeNotification=false:
        PNC_29_SteeringColumnLock_44a1738d: ComMUserIdentifier=29
        PNC_14_InfotainmentExtensions_d7c4346a: ComMUserIdentifier=14
        PNC_40_Diagnosis_Energy_532c6fb4: ComMUserIdentifier=38
        PNC_22_ExteriorLights_3bdfbcd3: ComMUserIdentifier=22
        PNC_47_Diagnosis_ComfortLINs_70cf0372: ComMUserIdentifier=45
      4 x ComMPnc, all with ComMChannelPerPnc=CN_HCP5_CANFD01_54d90215:
        PNC_01_CarWakeUp_d7102746: ComMPncId=8, ComMUserPerPnc=PNC_01_CarWakeUp_bf3ce487
          ComSignalPnc_EIRA_CAN_Rx_1e4792f2 (ComMPncComSignal): ComMPncComSignalDirection=RX, ComMPncComSignalKind=EIRA, ComMPncComSignalRef=ComSignalPnc_EIRA_CAN_Rx
          NM_Hybrid_01_FCAB_XIX_NM_Hybrid_01_XIX_HCP5_CANFD01_38c188fa_Tx_8c6d3281 (ComMPncComSignal):
            ComMPncComSignalDirection = TX
            ComMPncComSignalKind = EIRA
            ComMPncComSignalChannelRef = CN_HCP5_CANFD01_54d90215
            ComMPncComSignalRef = NM_Hybrid_01_FCAB_XIX_NM_Hybrid_01_XIX_HCP5_CANFD01_38c188fa_Tx
        PNC_07_Basefunction_CrossSection_7b625db2: ComMPncId=14, ComMUserPerPnc=PNC_07_Basefunction_CrossSection_5c9febde
          ComSignalPnc_EIRA_CAN_Rx_1e4792f2 (ComMPncComSignal): ComMPncComSignalDirection=RX, ComMPncComSignalKind=EIRA, ComMPncComSignalRef=ComSignalPnc_EIRA_CAN_Rx
          NM_Hybrid_01_FCAB_XIX_NM_Hybrid_01_XIX_HCP5_CANFD01_38c188fa_Tx_8c6d3281 (ComMPncComSignal):
            ComMPncComSignalDirection = TX
            ComMPncComSignalKind = EIRA
            ComMPncComSignalChannelRef = CN_HCP5_CANFD01_54d90215
            ComMPncComSignalRef = NM_Hybrid_01_FCAB_XIX_NM_Hybrid_01_XIX_HCP5_CANFD01_38c188fa_Tx
        PNC_37_HighVoltage_WirelessChargingStation_717f15f0: ComMPncId=44, ComMUserPerPnc=PNC_37_HighVoltage_WirelessChargingStation_f111c76f
          ComSignalPnc_EIRA_CAN_Rx_1e4792f2 (ComMPncComSignal): ComMPncComSignalDirection=RX, ComMPncComSignalKind=EIRA, ComMPncComSignalRef=ComSignalPnc_EIRA_CAN_Rx
          NM_Hybrid_01_FCAB_XIX_NM_Hybrid_01_XIX_HCP5_CANFD01_38c188fa_Tx_8c6d3281 (ComMPncComSignal):
            ComMPncComSignalDirection = TX
            ComMPncComSignalKind = EIRA
            ComMPncComSignalChannelRef = CN_HCP5_CANFD01_54d90215
            ComMPncComSignalRef = NM_Hybrid_01_FCAB_XIX_NM_Hybrid_01_XIX_HCP5_CANFD01_38c188fa_Tx
        PNC_14_InfotainmentExtensions_ca9cb1f5: ComMPncId=21, ComMUserPerPnc=PNC_14_InfotainmentExtensions_d7c4346a
          ComSignalPnc_EIRA_CAN_Rx_1e4792f2 (ComMPncComSignal): ComMPncComSignalDirection=RX, ComMPncComSignalKind=EIRA, ComMPncComSignalRef=ComSignalPnc_EIRA_CAN_Rx
          NM_Hybrid_01_FCAB_XIX_NM_Hybrid_01_XIX_HCP5_CANFD01_38c188fa_Tx_8c6d3281 (ComMPncComSignal):
            ComMPncComSignalDirection = TX
            ComMPncComSignalKind = EIRA
            ComMPncComSignalChannelRef = CN_HCP5_CANFD01_54d90215
            ComMPncComSignalRef = NM_Hybrid_01_FCAB_XIX_NM_Hybrid_01_XIX_HCP5_CANFD01_38c188fa_Tx
      5 x ComMUser, all with ComMUserModeNotification=false:
        PNC_34_GPS_Lokalization_72b0f580: ComMUserIdentifier=34
        PNC_06_Basefunction_ComfortLight_8074acb0: ComMUserIdentifier=7
        PNC_07_Basefunction_CrossSection_5c9febde: ComMUserIdentifier=8
        PNC_11_Chassis_fd87aaa6: ComMUserIdentifier=11
        PNC_31_MultifunctionalSteeringWheel_48e6d667: ComMUserIdentifier=31
      3 x ComMPnc, all with ComMChannelPerPnc=CN_HCP5_CANFD01_54d90215:
        PNC_33_ExternalWirelessCommunication_85f99735: ComMPncId=40, ComMUserPerPnc=PNC_33_ExternalWirelessCommunication_779a8708
          ComSignalPnc_EIRA_CAN_Rx_1e4792f2 (ComMPncComSignal): ComMPncComSignalDirection=RX, ComMPncComSignalKind=EIRA, ComMPncComSignalRef=ComSignalPnc_EIRA_CAN_Rx
          NM_Hybrid_01_FCAB_XIX_NM_Hybrid_01_XIX_HCP5_CANFD01_38c188fa_Tx_8c6d3281 (ComMPncComSignal):
            ComMPncComSignalDirection = TX
            ComMPncComSignalKind = EIRA
            ComMPncComSignalChannelRef = CN_HCP5_CANFD01_54d90215
            ComMPncComSignalRef = NM_Hybrid_01_FCAB_XIX_NM_Hybrid_01_XIX_HCP5_CANFD01_38c188fa_Tx
        PNC_06_Basefunction_ComfortLight_d2d0a736: ComMPncId=13, ComMUserPerPnc=PNC_06_Basefunction_ComfortLight_8074acb0
          ComSignalPnc_EIRA_CAN_Rx_1e4792f2 (ComMPncComSignal): ComMPncComSignalDirection=RX, ComMPncComSignalKind=EIRA, ComMPncComSignalRef=ComSignalPnc_EIRA_CAN_Rx
          NM_Hybrid_01_FCAB_XIX_NM_Hybrid_01_XIX_HCP5_CANFD01_38c188fa_Tx_8c6d3281 (ComMPncComSignal):
            ComMPncComSignalDirection = TX
            ComMPncComSignalKind = EIRA
            ComMPncComSignalChannelRef = CN_HCP5_CANFD01_54d90215
            ComMPncComSignalRef = NM_Hybrid_01_FCAB_XIX_NM_Hybrid_01_XIX_HCP5_CANFD01_38c188fa_Tx
        PNC_44_Diagnosis_Infotainment_d2af29c0: ComMPncId=51, ComMUserPerPnc=PNC_44_Diagnosis_Infotainment_3909218a
          ComSignalPnc_EIRA_CAN_Rx_1e4792f2 (ComMPncComSignal): ComMPncComSignalDirection=RX, ComMPncComSignalKind=EIRA, ComMPncComSignalRef=ComSignalPnc_EIRA_CAN_Rx
          NM_Hybrid_01_FCAB_XIX_NM_Hybrid_01_XIX_HCP5_CANFD01_38c188fa_Tx_8c6d3281 (ComMPncComSignal):
            ComMPncComSignalDirection = TX
            ComMPncComSignalKind = EIRA
            ComMPncComSignalChannelRef = CN_HCP5_CANFD01_54d90215
            ComMPncComSignalRef = NM_Hybrid_01_FCAB_XIX_NM_Hybrid_01_XIX_HCP5_CANFD01_38c188fa_Tx
      CN_BMC_CAN01_908d0059 (ComMUser): ComMUserIdentifier=0, ComMUserModeNotification=false
      4 x ComMPnc, all with ComMChannelPerPnc=CN_HCP5_CANFD01_54d90215:
        PNC_32_OnlineAccess_91b6041d: ComMPncId=39, ComMUserPerPnc=PNC_32_OnlineAccess_c5b851bc
          ComSignalPnc_EIRA_CAN_Rx_1e4792f2 (ComMPncComSignal): ComMPncComSignalDirection=RX, ComMPncComSignalKind=EIRA, ComMPncComSignalRef=ComSignalPnc_EIRA_CAN_Rx
          NM_Hybrid_01_FCAB_XIX_NM_Hybrid_01_XIX_HCP5_CANFD01_38c188fa_Tx_8c6d3281 (ComMPncComSignal):
            ComMPncComSignalDirection = TX
            ComMPncComSignalKind = EIRA
            ComMPncComSignalChannelRef = CN_HCP5_CANFD01_54d90215
            ComMPncComSignalRef = NM_Hybrid_01_FCAB_XIX_NM_Hybrid_01_XIX_HCP5_CANFD01_38c188fa_Tx
        PNC_05_Basefunction_Infotainment_f043623b: ComMPncId=12, ComMUserPerPnc=PNC_05_Basefunction_Infotainment_d739ca28
          ComSignalPnc_EIRA_CAN_Rx_1e4792f2 (ComMPncComSignal): ComMPncComSignalDirection=RX, ComMPncComSignalKind=EIRA, ComMPncComSignalRef=ComSignalPnc_EIRA_CAN_Rx
          NM_Hybrid_01_FCAB_XIX_NM_Hybrid_01_XIX_HCP5_CANFD01_38c188fa_Tx_8c6d3281 (ComMPncComSignal):
            ComMPncComSignalDirection = TX
            ComMPncComSignalKind = EIRA
            ComMPncComSignalChannelRef = CN_HCP5_CANFD01_54d90215
            ComMPncComSignalRef = NM_Hybrid_01_FCAB_XIX_NM_Hybrid_01_XIX_HCP5_CANFD01_38c188fa_Tx
        PNC_03_Basefunction_Chassis_a155dfc3: ComMPncId=10, ComMUserPerPnc=PNC_03_Basefunction_Chassis_74381a7a
          ComSignalPnc_EIRA_CAN_Rx_1e4792f2 (ComMPncComSignal): ComMPncComSignalDirection=RX, ComMPncComSignalKind=EIRA, ComMPncComSignalRef=ComSignalPnc_EIRA_CAN_Rx
          NM_Hybrid_01_FCAB_XIX_NM_Hybrid_01_XIX_HCP5_CANFD01_38c188fa_Tx_8c6d3281 (ComMPncComSignal):
            ComMPncComSignalDirection = TX
            ComMPncComSignalKind = EIRA
            ComMPncComSignalChannelRef = CN_HCP5_CANFD01_54d90215
            ComMPncComSignalRef = NM_Hybrid_01_FCAB_XIX_NM_Hybrid_01_XIX_HCP5_CANFD01_38c188fa_Tx
        PNC_43_Diagnosis_DrivingAssistance_906b6e52: ComMPncId=50, ComMUserPerPnc=PNC_43_Diagnosis_DrivingAssistance_84f09039
          ComSignalPnc_EIRA_CAN_Rx_1e4792f2 (ComMPncComSignal): ComMPncComSignalDirection=RX, ComMPncComSignalKind=EIRA, ComMPncComSignalRef=ComSignalPnc_EIRA_CAN_Rx
          NM_Hybrid_01_FCAB_XIX_NM_Hybrid_01_XIX_HCP5_CANFD01_38c188fa_Tx_8c6d3281 (ComMPncComSignal):
            ComMPncComSignalDirection = TX
            ComMPncComSignalKind = EIRA
            ComMPncComSignalChannelRef = CN_HCP5_CANFD01_54d90215
            ComMPncComSignalRef = NM_Hybrid_01_FCAB_XIX_NM_Hybrid_01_XIX_HCP5_CANFD01_38c188fa_Tx
      PNC_03_Basefunction_Chassis_74381a7a (ComMUser): ComMUserIdentifier=4, ComMUserModeNotification=false
      PNC_46_Diagnosis_Light_5140c135 (ComMUser): ComMUserIdentifier=44, ComMUserModeNotification=false
      CN_BMC_CAN01_78a85e89 (ComMChannel):
        ComMBusType = COMM_BUS_TYPE_CAN
        ComMChannelId = 0
        ComMFullCommRequestNotificationEnabled = false
        ComMMainFunctionPeriod = 0.02
        ComMNoCom = false
        ComMNoWakeup = false
        ComMNetworkManagement: ComMNmVariant=FULL, ComMPncNmRequest=false
        CN_BMC_CAN01_30c09f28 (ComMUserPerChannel): ComMUserChannel=CN_BMC_CAN01_908d0059
      4 x ComMPnc, all with ComMChannelPerPnc=CN_HCP5_CANFD01_54d90215:
        PNC_28_OnboardTester_DataCollector_1afa9561: ComMPncId=35, ComMUserPerPnc=PNC_28_OnboardTester_DataCollector_c7d92e04
          ComSignalPnc_EIRA_CAN_Rx_1e4792f2 (ComMPncComSignal): ComMPncComSignalDirection=RX, ComMPncComSignalKind=EIRA, ComMPncComSignalRef=ComSignalPnc_EIRA_CAN_Rx
          NM_Hybrid_01_FCAB_XIX_NM_Hybrid_01_XIX_HCP5_CANFD01_38c188fa_Tx_8c6d3281 (ComMPncComSignal):
            ComMPncComSignalDirection = TX
            ComMPncComSignalKind = EIRA
            ComMPncComSignalChannelRef = CN_HCP5_CANFD01_54d90215
            ComMPncComSignalRef = NM_Hybrid_01_FCAB_XIX_NM_Hybrid_01_XIX_HCP5_CANFD01_38c188fa_Tx
        PNC_19_Doors_Hatches_6a90831c: ComMPncId=26, ComMUserPerPnc=PNC_19_Doors_Hatches_58052c40
          ComSignalPnc_EIRA_CAN_Rx_1e4792f2 (ComMPncComSignal): ComMPncComSignalDirection=RX, ComMPncComSignalKind=EIRA, ComMPncComSignalRef=ComSignalPnc_EIRA_CAN_Rx
          NM_Hybrid_01_FCAB_XIX_NM_Hybrid_01_XIX_HCP5_CANFD01_38c188fa_Tx_8c6d3281 (ComMPncComSignal):
            ComMPncComSignalDirection = TX
            ComMPncComSignalKind = EIRA
            ComMPncComSignalChannelRef = CN_HCP5_CANFD01_54d90215
            ComMPncComSignalRef = NM_Hybrid_01_FCAB_XIX_NM_Hybrid_01_XIX_HCP5_CANFD01_38c188fa_Tx
        PNC_20_OptionalComfort_769509a7: ComMPncId=27, ComMUserPerPnc=PNC_20_OptionalComfort_76e30655
          ComSignalPnc_EIRA_CAN_Rx_1e4792f2 (ComMPncComSignal): ComMPncComSignalDirection=RX, ComMPncComSignalKind=EIRA, ComMPncComSignalRef=ComSignalPnc_EIRA_CAN_Rx
          NM_Hybrid_01_FCAB_XIX_NM_Hybrid_01_XIX_HCP5_CANFD01_38c188fa_Tx_8c6d3281 (ComMPncComSignal):
            ComMPncComSignalDirection = TX
            ComMPncComSignalKind = EIRA
            ComMPncComSignalChannelRef = CN_HCP5_CANFD01_54d90215
            ComMPncComSignalRef = NM_Hybrid_01_FCAB_XIX_NM_Hybrid_01_XIX_HCP5_CANFD01_38c188fa_Tx
        PNC_04_Basefunction_DrivingAssistance_f26b19b4: ComMPncId=11, ComMUserPerPnc=PNC_04_Basefunction_DrivingAssistance_2e755e80
          ComSignalPnc_EIRA_CAN_Rx_1e4792f2 (ComMPncComSignal): ComMPncComSignalDirection=RX, ComMPncComSignalKind=EIRA, ComMPncComSignalRef=ComSignalPnc_EIRA_CAN_Rx
          NM_Hybrid_01_FCAB_XIX_NM_Hybrid_01_XIX_HCP5_CANFD01_38c188fa_Tx_8c6d3281 (ComMPncComSignal):
            ComMPncComSignalDirection = TX
            ComMPncComSignalKind = EIRA
            ComMPncComSignalChannelRef = CN_HCP5_CANFD01_54d90215
            ComMPncComSignalRef = NM_Hybrid_01_FCAB_XIX_NM_Hybrid_01_XIX_HCP5_CANFD01_38c188fa_Tx
      3 x ComMUser, all with ComMUserModeNotification=false:
        PNC_19_Doors_Hatches_58052c40: ComMUserIdentifier=19
        PNC_41_Diagnosis_Powertrain_0ac6ac8b: ComMUserIdentifier=39
        PNC_23_Climate_69d3b4ed: ComMUserIdentifier=23
      PNC_41_Diagnosis_Powertrain_d7bd9faf (ComMPnc): ComMPncId=48, ComMChannelPerPnc=CN_HCP5_CANFD01_54d90215, ComMUserPerPnc=PNC_41_Diagnosis_Powertrain_0ac6ac8b
        ComSignalPnc_EIRA_CAN_Rx_1e4792f2 (ComMPncComSignal): ComMPncComSignalDirection=RX, ComMPncComSignalKind=EIRA, ComMPncComSignalRef=ComSignalPnc_EIRA_CAN_Rx
        NM_Hybrid_01_FCAB_XIX_NM_Hybrid_01_XIX_HCP5_CANFD01_38c188fa_Tx_8c6d3281 (ComMPncComSignal):
          ComMPncComSignalDirection = TX
          ComMPncComSignalKind = EIRA
          ComMPncComSignalChannelRef = CN_HCP5_CANFD01_54d90215
          ComMPncComSignalRef = NM_Hybrid_01_FCAB_XIX_NM_Hybrid_01_XIX_HCP5_CANFD01_38c188fa_Tx
      PNC_42_Diagnosis_FlexRay_e9cd26c7 (ComMPnc): ComMPncId=49, ComMChannelPerPnc=CN_HCP5_CANFD01_54d90215, ComMUserPerPnc=PNC_42_Diagnosis_FlexRay_f6dcf44d
        ComSignalPnc_EIRA_CAN_Rx_1e4792f2 (ComMPncComSignal): ComMPncComSignalDirection=RX, ComMPncComSignalKind=EIRA, ComMPncComSignalRef=ComSignalPnc_EIRA_CAN_Rx
        NM_Hybrid_01_FCAB_XIX_NM_Hybrid_01_XIX_HCP5_CANFD01_38c188fa_Tx_8c6d3281 (ComMPncComSignal):
          ComMPncComSignalDirection = TX
          ComMPncComSignalKind = EIRA
          ComMPncComSignalChannelRef = CN_HCP5_CANFD01_54d90215
          ComMPncComSignalRef = NM_Hybrid_01_FCAB_XIX_NM_Hybrid_01_XIX_HCP5_CANFD01_38c188fa_Tx
      3 x ComMUser, all with ComMUserModeNotification=false:
        PNC_02_Basefunction_Powertrain_6e8e3f0b: ComMUserIdentifier=3
        PNC_05_Basefunction_Infotainment_d739ca28: ComMUserIdentifier=6
        PNC_10_Powertrain_5fe7c550: ComMUserIdentifier=10
      PNC_30_EnergyManagement_9072504c (ComMPnc): ComMPncId=37, ComMChannelPerPnc=CN_HCP5_CANFD01_54d90215, ComMUserPerPnc=PNC_30_EnergyManagement_82f39188
        ComSignalPnc_EIRA_CAN_Rx_1e4792f2 (ComMPncComSignal): ComMPncComSignalDirection=RX, ComMPncComSignalKind=EIRA, ComMPncComSignalRef=ComSignalPnc_EIRA_CAN_Rx
        NM_Hybrid_01_FCAB_XIX_NM_Hybrid_01_XIX_HCP5_CANFD01_38c188fa_Tx_8c6d3281 (ComMPncComSignal):
          ComMPncComSignalDirection = TX
          ComMPncComSignalKind = EIRA
          ComMPncComSignalChannelRef = CN_HCP5_CANFD01_54d90215
          ComMPncComSignalRef = NM_Hybrid_01_FCAB_XIX_NM_Hybrid_01_XIX_HCP5_CANFD01_38c188fa_Tx
      PNC_47_Diagnosis_ComfortLINs_fb22fd75 (ComMPnc): ComMPncId=54, ComMChannelPerPnc=CN_HCP5_CANFD01_54d90215, ComMUserPerPnc=PNC_47_Diagnosis_ComfortLINs_70cf0372
        ComSignalPnc_EIRA_CAN_Rx_1e4792f2 (ComMPncComSignal): ComMPncComSignalDirection=RX, ComMPncComSignalKind=EIRA, ComMPncComSignalRef=ComSignalPnc_EIRA_CAN_Rx
        NM_Hybrid_01_FCAB_XIX_NM_Hybrid_01_XIX_HCP5_CANFD01_38c188fa_Tx_8c6d3281 (ComMPncComSignal):
          ComMPncComSignalDirection = TX
          ComMPncComSignalKind = EIRA
          ComMPncComSignalChannelRef = CN_HCP5_CANFD01_54d90215
          ComMPncComSignalRef = NM_Hybrid_01_FCAB_XIX_NM_Hybrid_01_XIX_HCP5_CANFD01_38c188fa_Tx
      PNC_56_Charging_Status_cad5dfb4 (ComMUser): ComMUserIdentifier=49, ComMUserModeNotification=false
      PNC_45_Diagnosis_Comfort_7eea372a (ComMUser): ComMUserIdentifier=43, ComMUserModeNotification=false
      PNC_24_ThermoManagement_4f639819 (ComMPnc): ComMPncId=31, ComMChannelPerPnc=CN_HCP5_CANFD01_54d90215, ComMUserPerPnc=PNC_24_ThermoManagement_31b4f0b3
        ComSignalPnc_EIRA_CAN_Rx_1e4792f2 (ComMPncComSignal): ComMPncComSignalDirection=RX, ComMPncComSignalKind=EIRA, ComMPncComSignalRef=ComSignalPnc_EIRA_CAN_Rx
        NM_Hybrid_01_FCAB_XIX_NM_Hybrid_01_XIX_HCP5_CANFD01_38c188fa_Tx_8c6d3281 (ComMPncComSignal):
          ComMPncComSignalDirection = TX
          ComMPncComSignalKind = EIRA
          ComMPncComSignalChannelRef = CN_HCP5_CANFD01_54d90215
          ComMPncComSignalRef = NM_Hybrid_01_FCAB_XIX_NM_Hybrid_01_XIX_HCP5_CANFD01_38c188fa_Tx
      PNC_53_Lock_Unlock_51015b9a (ComMPnc): ComMPncId=60, ComMChannelPerPnc=CN_HCP5_CANFD01_54d90215, ComMUserPerPnc=PNC_53_Lock_Unlock_bfb0b2ca
        ComSignalPnc_EIRA_CAN_Rx_1e4792f2 (ComMPncComSignal): ComMPncComSignalDirection=RX, ComMPncComSignalKind=EIRA, ComMPncComSignalRef=ComSignalPnc_EIRA_CAN_Rx
        NM_Hybrid_01_FCAB_XIX_NM_Hybrid_01_XIX_HCP5_CANFD01_38c188fa_Tx_8c6d3281 (ComMPncComSignal):
          ComMPncComSignalDirection = TX
          ComMPncComSignalKind = EIRA
          ComMPncComSignalChannelRef = CN_HCP5_CANFD01_54d90215
          ComMPncComSignalRef = NM_Hybrid_01_FCAB_XIX_NM_Hybrid_01_XIX_HCP5_CANFD01_38c188fa_Tx
      6 x ComMUser, all with ComMUserModeNotification=false:
        PNC_55_Dimming_4909a14c: ComMUserIdentifier=48
        PNC_25_AccessSystemSensors_863389c2: ComMUserIdentifier=25
        PNC_32_OnlineAccess_c5b851bc: ComMUserIdentifier=32
        PNC_24_ThermoManagement_31b4f0b3: ComMUserIdentifier=24
        PNC_53_Lock_Unlock_bfb0b2ca: ComMUserIdentifier=47
        PNC_01_CarWakeUp_bf3ce487: ComMUserIdentifier=2
      PNC_34_GPS_Lokalization_74821ca8 (ComMPnc): ComMPncId=41, ComMChannelPerPnc=CN_HCP5_CANFD01_54d90215, ComMUserPerPnc=PNC_34_GPS_Lokalization_72b0f580
        ComSignalPnc_EIRA_CAN_Rx_1e4792f2 (ComMPncComSignal): ComMPncComSignalDirection=RX, ComMPncComSignalKind=EIRA, ComMPncComSignalRef=ComSignalPnc_EIRA_CAN_Rx
        NM_Hybrid_01_FCAB_XIX_NM_Hybrid_01_XIX_HCP5_CANFD01_38c188fa_Tx_8c6d3281 (ComMPncComSignal):
          ComMPncComSignalDirection = TX
          ComMPncComSignalKind = EIRA
          ComMPncComSignalChannelRef = CN_HCP5_CANFD01_54d90215
          ComMPncComSignalRef = NM_Hybrid_01_FCAB_XIX_NM_Hybrid_01_XIX_HCP5_CANFD01_38c188fa_Tx
      PNC_18_VirtualSideMirrors_dca4d4b3 (ComMUser): ComMUserIdentifier=18, ComMUserModeNotification=false
      6 x ComMPnc, all with ComMChannelPerPnc=CN_HCP5_CANFD01_54d90215:
        PNC_23_Climate_ab0b2697: ComMPncId=30, ComMUserPerPnc=PNC_23_Climate_69d3b4ed
          ComSignalPnc_EIRA_CAN_Rx_1e4792f2 (ComMPncComSignal): ComMPncComSignalDirection=RX, ComMPncComSignalKind=EIRA, ComMPncComSignalRef=ComSignalPnc_EIRA_CAN_Rx
          NM_Hybrid_01_FCAB_XIX_NM_Hybrid_01_XIX_HCP5_CANFD01_38c188fa_Tx_8c6d3281 (ComMPncComSignal):
            ComMPncComSignalDirection = TX
            ComMPncComSignalKind = EIRA
            ComMPncComSignalChannelRef = CN_HCP5_CANFD01_54d90215
            ComMPncComSignalRef = NM_Hybrid_01_FCAB_XIX_NM_Hybrid_01_XIX_HCP5_CANFD01_38c188fa_Tx
        PNC_55_Dimming_ea37854f: ComMPncId=62, ComMUserPerPnc=PNC_55_Dimming_4909a14c
          ComSignalPnc_EIRA_CAN_Rx_1e4792f2 (ComMPncComSignal): ComMPncComSignalDirection=RX, ComMPncComSignalKind=EIRA, ComMPncComSignalRef=ComSignalPnc_EIRA_CAN_Rx
          NM_Hybrid_01_FCAB_XIX_NM_Hybrid_01_XIX_HCP5_CANFD01_38c188fa_Tx_8c6d3281 (ComMPncComSignal):
            ComMPncComSignalDirection = TX
            ComMPncComSignalKind = EIRA
            ComMPncComSignalChannelRef = CN_HCP5_CANFD01_54d90215
            ComMPncComSignalRef = NM_Hybrid_01_FCAB_XIX_NM_Hybrid_01_XIX_HCP5_CANFD01_38c188fa_Tx
        PNC_10_Powertrain_b3959ad4: ComMPncId=17, ComMUserPerPnc=PNC_10_Powertrain_5fe7c550
          ComSignalPnc_EIRA_CAN_Rx_1e4792f2 (ComMPncComSignal): ComMPncComSignalDirection=RX, ComMPncComSignalKind=EIRA, ComMPncComSignalRef=ComSignalPnc_EIRA_CAN_Rx
          NM_Hybrid_01_FCAB_XIX_NM_Hybrid_01_XIX_HCP5_CANFD01_38c188fa_Tx_8c6d3281 (ComMPncComSignal):
            ComMPncComSignalDirection = TX
            ComMPncComSignalKind = EIRA
            ComMPncComSignalChannelRef = CN_HCP5_CANFD01_54d90215
            ComMPncComSignalRef = NM_Hybrid_01_FCAB_XIX_NM_Hybrid_01_XIX_HCP5_CANFD01_38c188fa_Tx
        PNC_27_Timemaster_Timer_8da5bb27: ComMPncId=34, ComMUserPerPnc=PNC_27_Timemaster_Timer_53539b48
          ComSignalPnc_EIRA_CAN_Rx_1e4792f2 (ComMPncComSignal): ComMPncComSignalDirection=RX, ComMPncComSignalKind=EIRA, ComMPncComSignalRef=ComSignalPnc_EIRA_CAN_Rx
          NM_Hybrid_01_FCAB_XIX_NM_Hybrid_01_XIX_HCP5_CANFD01_38c188fa_Tx_8c6d3281 (ComMPncComSignal):
            ComMPncComSignalDirection = TX
            ComMPncComSignalKind = EIRA
            ComMPncComSignalChannelRef = CN_HCP5_CANFD01_54d90215
            ComMPncComSignalRef = NM_Hybrid_01_FCAB_XIX_NM_Hybrid_01_XIX_HCP5_CANFD01_38c188fa_Tx
        PNC_11_Chassis_dce36bbc: ComMPncId=18, ComMUserPerPnc=PNC_11_Chassis_fd87aaa6
          ComSignalPnc_EIRA_CAN_Rx_1e4792f2 (ComMPncComSignal): ComMPncComSignalDirection=RX, ComMPncComSignalKind=EIRA, ComMPncComSignalRef=ComSignalPnc_EIRA_CAN_Rx
          NM_Hybrid_01_FCAB_XIX_NM_Hybrid_01_XIX_HCP5_CANFD01_38c188fa_Tx_8c6d3281 (ComMPncComSignal):
            ComMPncComSignalDirection = TX
            ComMPncComSignalKind = EIRA
            ComMPncComSignalChannelRef = CN_HCP5_CANFD01_54d90215
            ComMPncComSignalRef = NM_Hybrid_01_FCAB_XIX_NM_Hybrid_01_XIX_HCP5_CANFD01_38c188fa_Tx
        PNC_08_Basefunction_Connectivity_56f2bd6b: ComMPncId=15, ComMUserPerPnc=PNC_08_Basefunction_Connectivity_33115909
          ComSignalPnc_EIRA_CAN_Rx_1e4792f2 (ComMPncComSignal): ComMPncComSignalDirection=RX, ComMPncComSignalKind=EIRA, ComMPncComSignalRef=ComSignalPnc_EIRA_CAN_Rx
          NM_Hybrid_01_FCAB_XIX_NM_Hybrid_01_XIX_HCP5_CANFD01_38c188fa_Tx_8c6d3281 (ComMPncComSignal):
            ComMPncComSignalDirection = TX
            ComMPncComSignalKind = EIRA
            ComMPncComSignalChannelRef = CN_HCP5_CANFD01_54d90215
            ComMPncComSignalRef = NM_Hybrid_01_FCAB_XIX_NM_Hybrid_01_XIX_HCP5_CANFD01_38c188fa_Tx
      PNC_44_Diagnosis_Infotainment_3909218a (ComMUser): ComMUserIdentifier=42, ComMUserModeNotification=false
