AUTOSAR XML (schema 4-3-0)
package /ActiveEcuC
  module config CryIf: implementation-config-variant=VARIANT-PRE-COMPILE, module-description=CryIf_Impl
    3 x CryIfKey:
      StartApplication_CryIfKey_Dec: CryIfKeyId=30, CryIfKeyRef=StartApplication_CryptoKey_Dec
      StartApplication_CryIfKey_Enc: CryIfKeyId=31, CryIfKeyRef=StartApplication_CryptoKey_Enc
      StartApplication_CryIfKey_MAC: CryIfKeyId=32, CryIfKeyRef=StartApplication_CryptoKey_MAC
    StartApplication_CryIfChannel (CryIfChannel): CryIfChannelId=6, CryIfDriverObjectRef=Crypto_30_LibCv
    StartApplication_CryIfKey (CryIfKey): CryIfKeyId=29, CryIfKeyRef=CryptoKey_CryIfKey
    CryIfGeneral:
      CryIfDevErrorDetect = true
      CryIfMaxNumberOfKeyElements = 30
      CryIfMaxSizeOfKeyElement = 400
      CryIfVersionInfoApi = true
      CryIfRedirection = true
      CryIfSafeBswChecks = false
    Crypto (CryIfCryptoModule): CryIfSupportsKeyElementCopyPartial=true, CryIfCancelJobApiUsesJobType=true, CryIfCryptoModuleRef=Crypto
    CryIfChannel: CryIfChannelId=0, CryIfDriverObjectRef=Crypto_30_LibCv
    CryIfChannel_Scc (CryIfChannel): CryIfChannelId=1, CryIfDriverObjectRef=CryptoDriverObject_Scc
    25 x CryIfKey:
      CryIfKey_Crypto_SccContractPrivKey: CryIfKeyId=0, CryIfKeyRef=Crypto_SccContractPrivKey
      CryIfKey_Crypto_SccProvisioningPrivKey: CryIfKeyId=2, CryIfKeyRef=Crypto_SccProvisioningPrivKey
      CryIf_SccAesKey: CryIfKeyId=23, CryIfKeyRef=Crypto_SccAesKey
      CryIf_SccContractKeyPair: CryIfKeyId=24, CryIfKeyRef=Crypto_SccContractKeyPair
      CryIf_SccEcdhExchange: CryIfKeyId=25, CryIfKeyRef=Crypto_SccEcdhExchange
      CryIf_SccKdfSHA256Key: CryIfKeyId=26, CryIfKeyRef=Crypto_SccKdfSHA256Key
      CryIf_SccProvisioningKeyPair: CryIfKeyId=27, CryIfKeyRef=Crypto_SccProvisioningKeyPair
      CryIf_SccPublicKey: CryIfKeyId=28, CryIfKeyRef=Crypto_SccPublicKey
      CryIfKey_Tls_Conn0_Aes128Cbc_Encrypt: CryIfKeyId=7, CryIfKeyRef=CryptoKey_Tls_Conn0_Aes128Cbc_Encrypt
      CryIfKey_Tls_Conn0_Prf_ResultPrivate: CryIfKeyId=18, CryIfKeyRef=CryptoKey_Tls_Conn0_Prf_ResultPrivate
      CryIfKey_Tls_Global_HashSha1: CryIfKeyId=22, CryIfKeyRef=CryptoKey_Tls_Global_HashSha1
      CryIfKey_Tls_Conn0_HS_HashSha256_ToServerFinished: CryIfKeyId=12, CryIfKeyRef=CryptoKey_Tls_Conn0_HS_HashSha256_ToServerFinished
      CryIfKey_Tls_Conn0_PreMasterSecretInfo: CryIfKeyId=15, CryIfKeyRef=CryptoKey_Tls_Conn0_PreMasterSecretInfo
      CryIfKey_Tls_Conn0_HMacShaX_Generate: CryIfKeyId=9, CryIfKeyRef=CryptoKey_Tls_Conn0_HMacShaX_Generate
      CryIfKey_Tls_Conn0_Aes128Cbc_Decrypt: CryIfKeyId=6, CryIfKeyRef=CryptoKey_Tls_Conn0_Aes128Cbc_Decrypt
      CryIfKey_Tls_Conn0_HMacShaX_Verify: CryIfKeyId=10, CryIfKeyRef=CryptoKey_Tls_Conn0_HMacShaX_Verify
      CryIfKey_Tls_Conn0_Prf_ResultPublic: CryIfKeyId=19, CryIfKeyRef=CryptoKey_Tls_Conn0_Prf_ResultPublic
      CryIfKey_Tls_Conn0_MasterSecret: CryIfKeyId=14, CryIfKeyRef=CryptoKey_Tls_Conn0_MasterSecret
      CryIfKey_Tls_Conn0_HS_RandomNumber: CryIfKeyId=13, CryIfKeyRef=CryptoKey_Tls_Conn0_HS_RandomNumber
      CryIfKey_Tls_Conn0_Prf_Secret: CryIfKeyId=20, CryIfKeyRef=CryptoKey_Tls_Conn0_Prf_Secret
      CryIfKey_Tls_Conn0_PrfCalculationValuesPublic: CryIfKeyId=17, CryIfKeyRef=CryptoKey_Tls_Conn0_PrfCalculationValuesPublic
      CryIfKey_Tls_Conn0_TmpBuffer: CryIfKeyId=21, CryIfKeyRef=CryptoKey_Tls_Conn0_TmpBuffer
      CryIfKey_Tls_Conn0_PrfCalculationValuesPrivate: CryIfKeyId=16, CryIfKeyRef=CryptoKey_Tls_Conn0_PrfCalculationValuesPrivate
      CryIfKey_Tls_Conn0_CertVerify_PubKey: CryIfKeyId=8, CryIfKeyRef=CryptoKey_Tls_Conn0_CertVerify_PubKey
      CryIfKey_Tls_Conn0_HS_HashSha256_ToClientFinished: CryIfKeyId=11, CryIfKeyRef=CryptoKey_Tls_Conn0_HS_HashSha256_ToClientFinished
    4 x CryIfChannel:
      CryIfChannel_Tls_Conn0: CryIfChannelId=2, CryIfDriverObjectRef=CryptoDriverObject_Tls_Conn0
      CryIfChannel_Tls_Conn0_HS_HashSha256_ToClientFinished: CryIfChannelId=3, CryIfDriverObjectRef=CryptoDriverObject_Tls_Conn0_HS_HashSha256_ToClientFinished
      CryIfChannel_Tls_Conn0_HS_HashSha256_ToServerFinished: CryIfChannelId=4, CryIfDriverObjectRef=CryptoDriverObject_Tls_Conn0_HS_HashSha256_ToServerFinished
      CryIfChannel_Tls_Global_HashSha1: CryIfChannelId=5, CryIfDriverObjectRef=CryptoDriverObject_Tls_Global_HashSha1
    4 x CryIfKey:
      CryIfKey_Crypto_SccContractPrivKeyTemp: CryIfKeyId=1, CryIfKeyRef=Crypto_SccContractPrivKeyTemp
      CryIfKey_StartApplication_Dec: CryIfKeyId=3, CryIfKeyRef=StartApplication_CryptoKey_Dec
      CryIfKey_StartApplication_Enc: CryIfKeyId=4, CryIfKeyRef=StartApplication_CryptoKey_Enc
      CryIfKey_StartApplication_MAC: CryIfKeyId=5, CryIfKeyRef=StartApplication_CryptoKey_MAC
