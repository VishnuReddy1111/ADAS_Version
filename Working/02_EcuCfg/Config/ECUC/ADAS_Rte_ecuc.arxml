[part 1 of 4: package /ActiveEcuC]
AUTOSAR XML (schema 4-3-0)
package /ActiveEcuC
  module config Rte: implementation-config-variant=VARIANT-PRE-COMPILE, module-description=Rte_Impl
    RteInitializationBehavior: RteInitializationStrategy=RTE_INITIALIZATION_STRATEGY_AT_DATA_DECLARATION, RteSectionInitializationPolicy=INIT
    RteGeneration:
      RteGenerationMode = COMPATIBILITY_MODE
      RteIocInteractionReturnValue = RTE_IOC
      RteValueRangeCheckEnabled = false
      RteCalibrationSupport = SINGLE_POINTERED
      RteCodeVendorId = 30
      RteDevErrorDetect = true
      RteDevErrorDetectUninit = true
      RteMeasurementSupport = true
      RteOptimizationMode = MEMORY
      RteVfbTraceEnabled = true
      RteVttVfbTraceFunction = Rte_Vtt_Task_Dispatch
      RteVttVfbTraceFunction = Rte_Vtt_Task_WaitEventRet
    RteBswGeneral: RteSchMVersionInfoApi=true, RteUseComShadowSignalApi=false
    RteOsInteraction
      14 x RteUsedOsActivation, all with RteExpectedActivationOffset=0, RteExpectedTickDuration=0:
        Rte_Al_TE_StartApplication_StartApplication_Cyclic1000ms: RteActivationOsAlarmRef=Rte_Al_TE_StartApplication_StartApplication_Cyclic1000ms, RteActivationOsTaskRef=Default_Appl_Task
        Rte_Al_TE_StartApplication_StartApplication_Cyclic1ms: RteActivationOsAlarmRef=Rte_Al_TE_StartApplication_StartApplication_Cyclic1ms, RteActivationOsTaskRef=Default_Appl_Task
        Rte_Al_TE_StartApplication_StartApplication_Cyclic250ms: RteActivationOsAlarmRef=Rte_Al_TE_StartApplication_StartApplication_Cyclic250ms, RteActivationOsTaskRef=Default_Appl_Task
        Rte_Al_TE2_Default_BSW_Async_Task_0_10ms: RteActivationOsAlarmRef=Rte_Al_TE2_Default_BSW_Async_Task_0_10ms, RteActivationOsTaskRef=Default_BSW_Async_Task
        Rte_Al_TE2_Default_BSW_Async_Task_0_20ms: RteActivationOsAlarmRef=Rte_Al_TE2_Default_BSW_Async_Task_0_20ms, RteActivationOsTaskRef=Default_BSW_Async_Task
        Rte_Al_TE2_Default_BSW_Async_Task_0_5ms: RteActivationOsAlarmRef=Rte_Al_TE2_Default_BSW_Async_Task_0_5ms, RteActivationOsTaskRef=Default_BSW_Async_Task
        Rte_Al_TE2_Default_BSW_Sync_Task_0_5ms: RteActivationOsAlarmRef=Rte_Al_TE2_Default_BSW_Sync_Task_0_5ms, RteActivationOsTaskRef=Default_BSW_Sync_Task
        Rte_Al_TE2_Default_BSW_Async_Task_0_2ms: RteActivationOsAlarmRef=Rte_Al_TE2_Default_BSW_Async_Task_0_2ms, RteActivationOsTaskRef=Default_BSW_Async_Task
        Rte_Al_TE2_Default_BSW_Task_Core1_0_10ms: RteActivationOsAlarmRef=Rte_Al_TE2_Default_BSW_Task_Core1_0_10ms, RteActivationOsTaskRef=Default_BSW_Task_Core1
        Rte_Al_TE_Can_30_Core_Can_30_Core_MainFunction_Write: RteActivationOsAlarmRef=Rte_Al_TE_Can_30_Core_Can_30_Core_MainFunction_Write, RteActivationOsTaskRef=Default_BSW_Async_Task
        Rte_Al_TE_Default_Appl_Task_0_100ms: RteActivationOsAlarmRef=Rte_Al_TE_Default_Appl_Task_0_100ms, RteActivationOsTaskRef=Default_Appl_Task
        Rte_Al_TE2_Default_Appl_Task_0_100ms: RteActivationOsAlarmRef=Rte_Al_TE2_Default_Appl_Task_0_100ms, RteActivationOsTaskRef=Default_Appl_Task
        Rte_Al_TE_Default_Appl_Task_0_10ms: RteActivationOsAlarmRef=Rte_Al_TE_Default_Appl_Task_0_10ms, RteActivationOsTaskRef=Default_Appl_Task
        Rte_Al_TE_Default_Appl_Task_0_50ms: RteActivationOsAlarmRef=Rte_Al_TE_Default_Appl_Task_0_50ms, RteActivationOsTaskRef=Default_Appl_Task
    20 x RteBswModuleInstance:
      BswM: RteBswImplementationRef=BswM_Impl, RteBswModuleConfigurationRef=BswM
        BSWM_EXCLUSIVE_AREA_0 (RteBswExclusiveAreaImpl): RteExclusiveAreaImplMechanism=ALL_INTERRUPT_BLOCKING, RteBswExclusiveAreaRef=BSWM_EXCLUSIVE_AREA_0
        BswM_MainFunction_OsApplication_SystemApplication_Core1TimingEvent0 (RteBswEventToTaskMapping):
          RteBswImmediateRestart = false
          RteBswPositionInTask = 0
          RteBswEventRef = BswM_MainFunction_OsApplication_SystemApplication_Core1TimingEvent0
          RteBswMappedToTaskRef = Default_BSW_Task_Core1
          RteBswUsedOsAlarmRef = Rte_Al_TE2_Default_BSW_Task_Core1_0_10ms
          RteBswUsedOsEventRef = Rte_Ev_Cyclic2_Default_BSW_Task_Core1_0_10ms
        BswM_MainFunction_OsApplication_SystemApplication_Core0TimingEvent0 (RteBswEventToTaskMapping):
          RteBswImmediateRestart = false
          RteBswPositionInTask = 0
          RteBswEventRef = BswM_MainFunction_OsApplication_SystemApplication_Core0TimingEvent0
          RteBswMappedToTaskRef = Default_BSW_Async_Task
          RteBswUsedOsEventRef = Rte_Ev_Cyclic2_Default_BSW_Async_Task_0_10ms
          RteBswUsedOsAlarmRef = Rte_Al_TE2_Default_BSW_Async_Task_0_10ms
      CanIf: RteBswImplementationRef=CanIf_Impl, RteBswModuleConfigurationRef=CanIf
        8 x RteBswExclusiveAreaImpl:
          CANIF_EXCLUSIVE_AREA_0: RteExclusiveAreaImplMechanism=CUSTOM, RteBswExclusiveAreaRef=CANIF_EXCLUSIVE_AREA_0
          CANIF_EXCLUSIVE_AREA_{1..7}: RteExclusiveAreaImplMechanism=ALL_INTERRUPT_BLOCKING, RteBswExclusiveAreaRef=CANIF_EXCLUSIVE_AREA_{1..7}
      CanNm: RteBswImplementationRef=CanNm_Impl, RteBswModuleConfigurationRef=CanNm
        CanNm_MainFunctionTimingEvent0 (RteBswEventToTaskMapping):
          RteBswImmediateRestart = false
          RteBswPositionInTask = 10
          RteBswEventRef = CanNm_MainFunctionTimingEvent0
          RteBswMappedToTaskRef = Default_BSW_Async_Task
          RteBswUsedOsEventRef = Rte_Ev_Cyclic2_Default_BSW_Async_Task_0_10ms
          RteBswUsedOsAlarmRef = Rte_Al_TE2_Default_BSW_Async_Task_0_10ms
        8 x RteBswExclusiveAreaImpl, all with RteExclusiveAreaImplMechanism=ALL_INTERRUPT_BLOCKING:
          CANNM_EXCLUSIVE_AREA_{0..7}: RteBswExclusiveAreaRef=CANNM_EXCLUSIVE_AREA_{0..7}
      CanSM: RteBswImplementationRef=CanSM_Impl, RteBswModuleConfigurationRef=CanSM
        CanSM_MainFunctionTimingEvent0 (RteBswEventToTaskMapping):
          RteBswImmediateRestart = false
          RteBswPositionInTask = 9
          RteBswEventRef = CanSM_MainFunctionTimingEvent0
          RteBswMappedToTaskRef = Default_BSW_Async_Task
          RteBswUsedOsEventRef = Rte_Ev_Cyclic2_Default_BSW_Async_Task_0_10ms
          RteBswUsedOsAlarmRef = Rte_Al_TE2_Default_BSW_Async_Task_0_10ms
        6 x RteBswExclusiveAreaImpl:
          CANSM_EXCLUSIVE_AREA_1: RteExclusiveAreaImplMechanism=CUSTOM, RteBswExclusiveAreaRef=CANSM_EXCLUSIVE_AREA_1
          CANSM_EXCLUSIVE_AREA_2: RteExclusiveAreaImplMechanism=ALL_INTERRUPT_BLOCKING, RteBswExclusiveAreaRef=CANSM_EXCLUSIVE_AREA_2
          CANSM_EXCLUSIVE_AREA_3: RteExclusiveAreaImplMechanism=ALL_INTERRUPT_BLOCKING, RteBswExclusiveAreaRef=CANSM_EXCLUSIVE_AREA_3
          CANSM_EXCLUSIVE_AREA_4: RteExclusiveAreaImplMechanism=CUSTOM, RteBswExclusiveAreaRef=CANSM_EXCLUSIVE_AREA_4
          CANSM_EXCLUSIVE_AREA_5: RteExclusiveAreaImplMechanism=ALL_INTERRUPT_BLOCKING, RteBswExclusiveAreaRef=CANSM_EXCLUSIVE_AREA_5
          CANSM_EXCLUSIVE_AREA_6: RteExclusiveAreaImplMechanism=ALL_INTERRUPT_BLOCKING, RteBswExclusiveAreaRef=CANSM_EXCLUSIVE_AREA_6
      CanTp: RteBswImplementationRef=CanTp_Impl, RteBswModuleConfigurationRef=CanTp
        CANTP_EXCLUSIVE_AREA_0 (RteBswExclusiveAreaImpl): RteExclusiveAreaImplMechanism=ALL_INTERRUPT_BLOCKING, RteBswExclusiveAreaRef=CANTP_EXCLUSIVE_AREA_0
        CanTp_MainFunctionRxTimingEvent0 (RteBswEventToTaskMapping):
          RteBswImmediateRestart = false
          RteBswPositionInTask = 11
          RteBswEventRef = CanTp_MainFunctionRxTimingEvent0
          RteBswMappedToTaskRef = Default_BSW_Async_Task
          RteBswUsedOsEventRef = Rte_Ev_Cyclic2_Default_BSW_Async_Task_0_10ms
          RteBswUsedOsAlarmRef = Rte_Al_TE2_Default_BSW_Async_Task_0_10ms
        CanTp_MainFunctionTxTimingEvent0 (RteBswEventToTaskMapping):
          RteBswImmediateRestart = false
          RteBswPositionInTask = 27
          RteBswEventRef = CanTp_MainFunctionTxTimingEvent0
          RteBswMappedToTaskRef = Default_BSW_Async_Task
          RteBswUsedOsEventRef = Rte_Ev_Cyclic2_Default_BSW_Async_Task_0_10ms
          RteBswUsedOsAlarmRef = Rte_Al_TE2_Default_BSW_Async_Task_0_10ms
      Com: RteBswImplementationRef=Com_Impl, RteBswModuleConfigurationRef=Com
        3 x RteBswExclusiveAreaImpl, all with RteExclusiveAreaImplMechanism=ALL_INTERRUPT_BLOCKING:
          COM_EXCLUSIVE_AREA_TX: RteBswExclusiveAreaRef=COM_EXCLUSIVE_AREA_TX
          COM_EXCLUSIVE_AREA_RX: RteBswExclusiveAreaRef=COM_EXCLUSIVE_AREA_RX
          COM_EXCLUSIVE_AREA_BOTH: RteBswExclusiveAreaRef=COM_EXCLUSIVE_AREA_BOTH
        Com_MainFunctionTx_ComMainFunctionTxTimingEvent0 (RteBswEventToTaskMapping):
          RteBswImmediateRestart = false
          RteBswPositionInTask = 6
          RteBswEventRef = Com_MainFunctionTx_ComMainFunctionTxTimingEvent0
          RteBswMappedToTaskRef = Default_BSW_Sync_Task
          RteBswUsedOsAlarmRef = Rte_Al_TE2_Default_BSW_Sync_Task_0_5ms
        Com_MainFunctionRx_ComMainFunctionRxTimingEvent0 (RteBswEventToTaskMapping):
          RteBswImmediateRestart = false
          RteBswPositionInTask = 5
          RteBswEventRef = Com_MainFunctionRx_ComMainFunctionRxTimingEvent0
          RteBswMappedToTaskRef = Default_BSW_Sync_Task
          RteBswUsedOsAlarmRef = Rte_Al_TE2_Default_BSW_Sync_Task_0_5ms
      ComM: RteBswImplementationRef=ComM_Impl, RteBswModuleConfigurationRef=ComM
        ComM_MainFunction_0TimingEvent0 (RteBswEventToTaskMapping):
          RteBswImmediateRestart = false
          RteBswPositionInTask = 2
          RteBswEventRef = ComM_MainFunction_0TimingEvent0
          RteBswMappedToTaskRef = Default_BSW_Async_Task
          RteBswUsedOsEventRef = Rte_Ev_Cyclic2_Default_BSW_Async_Task_0_20ms
          RteBswUsedOsAlarmRef = Rte_Al_TE2_Default_BSW_Async_Task_0_20ms
        ComM_MainFunction_1TimingEvent0 (RteBswEventToTaskMapping):
          RteBswImmediateRestart = false
          RteBswPositionInTask = 3
          RteBswEventRef = ComM_MainFunction_1TimingEvent0
          RteBswMappedToTaskRef = Default_BSW_Async_Task
          RteBswUsedOsEventRef = Rte_Ev_Cyclic2_Default_BSW_Async_Task_0_20ms
          RteBswUsedOsAlarmRef = Rte_Al_TE2_Default_BSW_Async_Task_0_20ms
        8 x RteBswExclusiveAreaImpl:
          COMM_EXCLUSIVE_AREA_0: RteExclusiveAreaImplMechanism=ALL_INTERRUPT_BLOCKING, RteBswExclusiveAreaRef=COMM_EXCLUSIVE_AREA_0
          COMM_EXCLUSIVE_AREA_1: RteExclusiveAreaImplMechanism=CUSTOM, RteBswExclusiveAreaRef=COMM_EXCLUSIVE_AREA_1
          COMM_EXCLUSIVE_AREA_{2..7}: RteExclusiveAreaImplMechanism=NONE, RteBswExclusiveAreaRef=COMM_EXCLUSIVE_AREA_{2..7}
      Crypto: RteBswImplementationRef=Crypto_Impl, RteBswModuleConfigurationRef=Crypto
        Crypto_30_LibCv_MainFunctionTimingEvent0 (RteBswEventToTaskMapping):
          RteBswImmediateRestart = false
          RteBswPositionInTask = 23
          RteBswEventRef = Crypto_30_LibCv_MainFunctionTimingEvent0
          RteBswMappedToTaskRef = Default_BSW_Async_Task
          RteBswUsedOsEventRef = Rte_Ev_Cyclic2_Default_BSW_Async_Task_0_10ms
          RteBswUsedOsAlarmRef = Rte_Al_TE2_Default_BSW_Async_Task_0_10ms
        CRYPTO_30_LIBCV_EXCLUSIVE_AREA_0 (RteBswExclusiveAreaImpl): RteExclusiveAreaImplMechanism=ALL_INTERRUPT_BLOCKING, RteBswExclusiveAreaRef=CRYPTO_30_LIBCV_EXCLUSIVE_AREA_0
        CRYPTO_30_LIBCV_EXCLUSIVE_AREA_1 (RteBswExclusiveAreaImpl): RteExclusiveAreaImplMechanism=ALL_INTERRUPT_BLOCKING, RteBswExclusiveAreaRef=CRYPTO_30_LIBCV_EXCLUSIVE_AREA_1
      Csm: RteBswImplementationRef=Csm_Impl, RteBswModuleConfigurationRef=Csm
        Csm_MainFunctionTimingEvent0 (RteBswEventToTaskMapping):
          RteBswImmediateRestart = false
          RteBswPositionInTask = 24
          RteBswEventRef = Csm_MainFunctionTimingEvent0
          RteBswMappedToTaskRef = Default_BSW_Async_Task
          RteBswUsedOsEventRef = Rte_Ev_Cyclic2_Default_BSW_Async_Task_0_2ms
          RteBswUsedOsAlarmRef = Rte_Al_TE2_Default_BSW_Async_Task_0_2ms
        CSM_EXCLUSIVE_AREA_0 (RteBswExclusiveAreaImpl): RteExclusiveAreaImplMechanism=ALL_INTERRUPT_BLOCKING, RteBswExclusiveAreaRef=CSM_EXCLUSIVE_AREA_0
      Dcm: RteBswImplementationRef=Dcm_Impl, RteBswModuleConfigurationRef=Dcm
        Dcm_MainFunctionTimingEvent0 (RteBswEventToTaskMapping):
          RteBswImmediateRestart = false
          RteBswPositionInTask = 14
          RteBswEventRef = Dcm_MainFunctionTimingEvent0
          RteBswMappedToTaskRef = Default_BSW_Async_Task
          RteBswUsedOsEventRef = Rte_Ev_Cyclic2_Default_BSW_Async_Task_0_10ms
          RteBswUsedOsAlarmRef = Rte_Al_TE2_Default_BSW_Async_Task_0_10ms
        DCM_EXCLUSIVE_AREA_0 (RteBswExclusiveAreaImpl): RteExclusiveAreaImplMechanism=ALL_INTERRUPT_BLOCKING, RteBswExclusiveAreaRef=DCM_EXCLUSIVE_AREA_0
      Dem: RteBswImplementationRef=Dem_Impl, RteBswModuleConfigurationRef=Dem
        Dem_MasterMainFunctionTimingEvent0 (RteBswEventToTaskMapping):
          RteBswImmediateRestart = false
          RteBswPositionInTask = 19
          RteBswEventRef = Dem_MasterMainFunctionTimingEvent0
          RteBswMappedToTaskRef = Default_BSW_Async_Task
          RteBswUsedOsEventRef = Rte_Ev_Cyclic2_Default_BSW_Async_Task_0_10ms
          RteBswUsedOsAlarmRef = Rte_Al_TE2_Default_BSW_Async_Task_0_10ms
        Dem_SatelliteMainFunctionTimingEvent0 (RteBswEventToTaskMapping):
          RteBswImmediateRestart = false
          RteBswPositionInTask = 20
          RteBswEventRef = Dem_SatelliteMainFunctionTimingEvent0
          RteBswUsedOsEventRef = Rte_Ev_Cyclic2_Default_BSW_Async_Task_0_10ms
          RteBswUsedOsAlarmRef = Rte_Al_TE2_Default_BSW_Async_Task_0_10ms
          RteBswMappedToTaskRef = Default_BSW_Async_Task
        5 x RteBswExclusiveAreaImpl, all with RteExclusiveAreaImplMechanism=ALL_INTERRUPT_BLOCKING:
          DEM_EXCLUSIVE_AREA_{0..4}: RteBswExclusiveAreaRef=DEM_EXCLUSIVE_AREA_{0..4}
      Det: RteBswImplementationRef=Det_Impl, RteBswModuleConfigurationRef=Det
        DET_EXCLUSIVE_AREA_0 (RteBswExclusiveAreaImpl): RteExclusiveAreaImplMechanism=ALL_INTERRUPT_BLOCKING, RteBswExclusiveAreaRef=DET_EXCLUSIVE_AREA_0
      E2EXf: RteBswImplementationRef=E2EXf_Impl, RteBswModuleConfigurationRef=E2EXf
      EcuM: RteBswImplementationRef=EcuM_Impl, RteBswModuleConfigurationRef=EcuM
        EcuM_MainFunctionTimingEvent0 (RteBswEventToTaskMapping):
          RteBswImmediateRestart = false
          RteBswPositionInTask = 1
          RteBswEventRef = EcuM_MainFunctionTimingEvent0
          RteBswMappedToTaskRef = Default_BSW_Async_Task
          RteBswUsedOsEventRef = Rte_Ev_Cyclic2_Default_BSW_Async_Task_0_10ms
          RteBswUsedOsAlarmRef = Rte_Al_TE2_Default_BSW_Async_Task_0_10ms
        4 x RteBswExclusiveAreaImpl, all with RteExclusiveAreaImplMechanism=ALL_INTERRUPT_BLOCKING:
          ECUM_EXCLUSIVE_AREA_{0..3}: RteBswExclusiveAreaRef=ECUM_EXCLUSIVE_AREA_{0..3}
        EcuM_MainFunctionTimingEvent1 (RteBswEventToTaskMapping):
          RteBswImmediateRestart = false
          RteBswPositionInTask = 1
          RteBswEventRef = EcuM_MainFunctionTimingEvent1
          RteBswMappedToTaskRef = Default_BSW_Task_Core1
          RteBswUsedOsAlarmRef = Rte_Al_TE2_Default_BSW_Task_Core1_0_10ms
          RteBswUsedOsEventRef = Rte_Ev_Cyclic2_Default_BSW_Task_Core1_0_10ms
      Nm: RteBswImplementationRef=Nm_Impl, RteBswModuleConfigurationRef=Nm
        4 x RteBswExclusiveAreaImpl, all with RteExclusiveAreaImplMechanism=ALL_INTERRUPT_BLOCKING:
          NM_EXCLUSIVE_AREA_{0..3}: RteBswExclusiveAreaRef=NM_EXCLUSIVE_AREA_{0..3}
      PduR: RteBswImplementationRef=PduR_Impl, RteBswModuleConfigurationRef=PduR
        PDUR_EXCLUSIVE_AREA_0 (RteBswExclusiveAreaImpl): RteExclusiveAreaImplMechanism=ALL_INTERRUPT_BLOCKING, RteBswExclusiveAreaRef=PDUR_EXCLUSIVE_AREA_0
      Rte: RteBswImplementationRef=Rte_Impl, RteBswModuleConfigurationRef=Rte
        Rte_ComSendSignalProxyPeriodicTimingEvent0 (RteBswEventToTaskMapping): RteBswImmediateRestart=false, RteBswEventRef=Rte_ComSendSignalProxyPeriodicTimingEvent0
      SecOC: RteBswImplementationRef=SecOC_Impl, RteBswModuleConfigurationRef=SecOC
        SecOC_MainFunctionRxTimingEvent0 (RteBswEventToTaskMapping):
          RteBswImmediateRestart = false
          RteBswPositionInTask = 4
          RteBswEventRef = SecOC_MainFunctionRxTimingEvent0
          RteBswMappedToTaskRef = Default_BSW_Sync_Task
          RteBswUsedOsAlarmRef = Rte_Al_TE2_Default_BSW_Sync_Task_0_5ms
        SecOC_MainFunctionTxTimingEvent0 (RteBswEventToTaskMapping):
          RteBswImmediateRestart = false
          RteBswPositionInTask = 7
          RteBswEventRef = SecOC_MainFunctionTxTimingEvent0
          RteBswMappedToTaskRef = Default_BSW_Sync_Task
          RteBswUsedOsAlarmRef = Rte_Al_TE2_Default_BSW_Sync_Task_0_5ms
        SECOC_EXCLUSIVE_AREA_RXSTATE (RteBswExclusiveAreaImpl): RteExclusiveAreaImplMechanism=ALL_INTERRUPT_BLOCKING, RteBswExclusiveAreaRef=SECOC_EXCLUSIVE_AREA_RXSTATE
        SECOC_EXCLUSIVE_AREA_TXSTATE (RteBswExclusiveAreaImpl): RteExclusiveAreaImplMechanism=ALL_INTERRUPT_BLOCKING, RteBswExclusiveAreaRef=SECOC_EXCLUSIVE_AREA_TXSTATE
      SomeIpXf: RteBswImplementationRef=SomeIpXf_Impl, RteBswModuleConfigurationRef=SomeIpXf
      Xcp: RteBswImplementationRef=Xcp_Impl, RteBswModuleConfigurationRef=Xcp
        Xcp_MainFunctionTimingEvent0 (RteBswEventToTaskMapping):
          RteBswImmediateRestart = false
          RteBswPositionInTask = 25
          RteBswEventRef = Xcp_MainFunctionTimingEvent0
          RteBswMappedToTaskRef = Default_BSW_Async_Task
          RteBswUsedOsEventRef = Rte_Ev_Cyclic2_Default_BSW_Async_Task_0_5ms
          RteBswUsedOsAlarmRef = Rte_Al_TE2_Default_BSW_Async_Task_0_5ms
        8 x RteBswExclusiveAreaImpl, all with RteExclusiveAreaImplMechanism=ALL_INTERRUPT_BLOCKING:
          XCP_EXCLUSIVE_AREA_{0..2}: RteBswExclusiveAreaRef=XCP_EXCLUSIVE_AREA_{0..2}
          CANXCP_EXCLUSIVE_AREA_0: RteBswExclusiveAreaRef=CANXCP_EXCLUSIVE_AREA_0
          FRXCP_EXCLUSIVE_AREA_{0..2}: RteBswExclusiveAreaRef=FRXCP_EXCLUSIVE_AREA_{0..2}
          TCPIPXCP_EXCLUSIVE_AREA_0: RteBswExclusiveAreaRef=TCPIPXCP_EXCLUSIVE_AREA_0
        CanXcp_MainFunctionTimingEvent0 (RteBswEventToTaskMapping):
          RteBswImmediateRestart = false
          RteBswPositionInTask = 22
          RteBswEventRef = CanXcp_MainFunctionTimingEvent0
          RteBswMappedToTaskRef = Default_BSW_Async_Task
          RteBswUsedOsEventRef = Rte_Ev_Cyclic2_Default_BSW_Async_Task_0_5ms
          RteBswUsedOsAlarmRef = Rte_Al_TE2_Default_BSW_Async_Task_0_5ms
    7 x RteSwComponentInstance:
      Det_EcuSwComposition: RteSoftwareComponentInstanceRef=Det
      EcuM_EcuSwComposition: RteSoftwareComponentInstanceRef=EcuM
        8 x RteEventToTaskMapping, all with RteImmediateRestart=false:
          Timer_EcuM_MainFunction: RtePositionInTask=1, RteEventRef=Timer_EcuM_MainFunction, RteMappedToTaskRef=Default_BSW_Async_Task, RteUsedOsEventRef=Rte_Ev_Cyclic2_Default_BSW_Async_Task_0_10ms, RteUsedOsAlarmRef=Rte_Al_TE2_Default_BSW_Async_Task_0_10ms
          OpEventSelectShutdownTarget_SelectShutdownTarget_EcuM_ShutdownTarget: RteEventRef=OpEventSelectShutdownTarget_SelectShutdownTarget_EcuM_ShutdownTarget
          OpEventGetShutdownTarget_GetShutdownTarget_EcuM_ShutdownTarget: RteEventRef=OpEventGetShutdownTarget_GetShutdownTarget_EcuM_ShutdownTarget
          OpEventGetLastShutdownTarget_GetLastShutdownTarget_EcuM_ShutdownTarget: RteEventRef=OpEventGetLastShutdownTarget_GetLastShutdownTarget_EcuM_ShutdownTarget
          OpEventSelectShutdownCause_SelectShutdownCause_EcuM_ShutdownTarget: RteEventRef=OpEventSelectShutdownCause_SelectShutdownCause_EcuM_ShutdownTarget
          OpEventGetShutdownCause_GetShutdownCause_EcuM_ShutdownTarget: RteEventRef=OpEventGetShutdownCause_GetShutdownCause_EcuM_ShutdownTarget
          OpEventSelectBootTarget_SelectBootTarget_EcuM_BootTarget: RteEventRef=OpEventSelectBootTarget_SelectBootTarget_EcuM_BootTarget
          OpEventGetBootTarget_GetBootTarget_EcuM_BootTarget: RteEventRef=OpEventGetBootTarget_GetBootTarget_EcuM_BootTarget
      ComM_EcuSwComposition: RteSoftwareComponentInstanceRef=ComM
        264 x RteEventToTaskMapping, all with RteImmediateRestart=false:
          Timer_ComM_MainFunction_0: RtePositionInTask=2, RteEventRef=Timer_ComM_MainFunction_0, RteMappedToTaskRef=Default_BSW_Async_Task, RteUsedOsEventRef=Rte_Ev_Cyclic2_Default_BSW_Async_Task_0_20ms, RteUsedOsAlarmRef=Rte_Al_TE2_Default_BSW_Async_Task_0_20ms
          Timer_ComM_MainFunction_1: RtePositionInTask=3, RteEventRef=Timer_ComM_MainFunction_1, RteMappedToTaskRef=Default_BSW_Async_Task, RteUsedOsEventRef=Rte_Ev_Cyclic2_Default_BSW_Async_Task_0_20ms, RteUsedOsAlarmRef=Rte_Al_TE2_Default_BSW_Async_Task_0_20ms
          OpEventLimitECUToNoComMode_LimitECUToNoComMode_modeLimitation: RteEventRef=OpEventLimitECUToNoComMode_LimitECUToNoComMode_modeLimitation
          OpEventReadInhibitCounter_ReadInhibitCounter_modeLimitation: RteEventRef=OpEventReadInhibitCounter_ReadInhibitCounter_modeLimitation
          OpEventResetInhibitCounter_ResetInhibitCounter_modeLimitation: RteEventRef=OpEventResetInhibitCounter_ResetInhibitCounter_modeLimitation
          OpEventSetECUGroupClassification_SetECUGroupClassification_modeLimitation: RteEventRef=OpEventSetECUGroupClassification_SetECUGroupClassification_modeLimitation
          OpEventGetInhibitionStatus_GetInhibitionStatus_CL_CN_BMC_CAN01_78a85e89: RteEventRef=OpEventGetInhibitionStatus_GetInhibitionStatus_CL_CN_BMC_CAN01_78a85e89
          OpEventGetInhibitionStatus_GetInhibitionStatus_CW_CN_BMC_CAN01_78a85e89: RteEventRef=OpEventGetInhibitionStatus_GetInhibitionStatus_CW_CN_BMC_CAN01_78a85e89
          OpEventGetInhibitionStatus_GetInhibitionStatus_CL_CN_HCP5_CANFD01_54d90215: RteEventRef=OpEventGetInhibitionStatus_GetInhibitionStatus_CL_CN_HCP5_CANFD01_54d90215
          OpEventGetInhibitionStatus_GetInhibitionStatus_CW_CN_HCP5_CANFD01_54d90215: RteEventRef=OpEventGetInhibitionStatus_GetInhibitionStatus_CW_CN_HCP5_CANFD01_54d90215
          OpEventLimitChannelToNoComMode_LimitChannelToNoComMode_CL_CN_BMC_CAN01_78a85e89: RteEventRef=OpEventLimitChannelToNoComMode_LimitChannelToNoComMode_CL_CN_BMC_CAN01_78a85e89
          OpEventLimitChannelToNoComMode_LimitChannelToNoComMode_CL_CN_HCP5_CANFD01_54d90215: RteEventRef=OpEventLimitChannelToNoComMode_LimitChannelToNoComMode_CL_CN_HCP5_CANFD01_54d90215
          OpEventPreventWakeUp_PreventWakeUp_CW_CN_BMC_CAN01_78a85e89: RteEventRef=OpEventPreventWakeUp_PreventWakeUp_CW_CN_BMC_CAN01_78a85e89
          OpEventPreventWakeUp_PreventWakeUp_CW_CN_HCP5_CANFD01_54d90215: RteEventRef=OpEventPreventWakeUp_PreventWakeUp_CW_CN_HCP5_CANFD01_54d90215
          OpEventRequestComMode_RequestComMode_UR_CN_BMC_CAN01_908d0059: RteEventRef=OpEventRequestComMode_RequestComMode_UR_CN_BMC_CAN01_908d0059
          OpEventRequestComMode_RequestComMode_UR_CN_HCP5_CANFD01_84d44928: RteEventRef=OpEventRequestComMode_RequestComMode_UR_CN_HCP5_CANFD01_84d44928
          OpEventRequestComMode_RequestComMode_UR_PNC_01_CarWakeUp_bf3ce487: RteEventRef=OpEventRequestComMode_RequestComMode_UR_PNC_01_CarWakeUp_bf3ce487
          OpEventRequestComMode_RequestComMode_UR_PNC_02_Basefunction_Powertrain_6e8e3f0b: RteEventRef=OpEventRequestComMode_RequestComMode_UR_PNC_02_Basefunction_Powertrain_6e8e3f0b
          OpEventRequestComMode_RequestComMode_UR_PNC_03_Basefunction_Chassis_74381a7a: RteEventRef=OpEventRequestComMode_RequestComMode_UR_PNC_03_Basefunction_Chassis_74381a7a
          OpEventRequestComMode_RequestComMode_UR_PNC_04_Basefunction_DrivingAssistance_2e755e80: RteEventRef=OpEventRequestComMode_RequestComMode_UR_PNC_04_Basefunction_DrivingAssistance_2e755e80
          OpEventRequestComMode_RequestComMode_UR_PNC_05_Basefunction_Infotainment_d739ca28: RteEventRef=OpEventRequestComMode_RequestComMode_UR_PNC_05_Basefunction_Infotainment_d739ca28
          OpEventRequestComMode_RequestComMode_UR_PNC_06_Basefunction_ComfortLight_8074acb0: RteEventRef=OpEventRequestComMode_RequestComMode_UR_PNC_06_Basefunction_ComfortLight_8074acb0
          OpEventRequestComMode_RequestComMode_UR_PNC_07_Basefunction_CrossSection_5c9febde: RteEventRef=OpEventRequestComMode_RequestComMode_UR_PNC_07_Basefunction_CrossSection_5c9febde
          OpEventRequestComMode_RequestComMode_UR_PNC_08_Basefunction_Connectivity_33115909: RteEventRef=OpEventRequestComMode_RequestComMode_UR_PNC_08_Basefunction_Connectivity_33115909
          OpEventRequestComMode_RequestComMode_UR_PNC_10_Powertrain_5fe7c550: RteEventRef=OpEventRequestComMode_RequestComMode_UR_PNC_10_Powertrain_5fe7c550
          OpEventRequestComMode_RequestComMode_UR_PNC_11_Chassis_fd87aaa6: RteEventRef=OpEventRequestComMode_RequestComMode_UR_PNC_11_Chassis_fd87aaa6
          OpEventRequestComMode_RequestComMode_UR_PNC_12_GearSelector_2aa5ddd0: RteEventRef=OpEventRequestComMode_RequestComMode_UR_PNC_12_GearSelector_2aa5ddd0
          OpEventRequestComMode_RequestComMode_UR_PNC_13_Airbag_2554061c: RteEventRef=OpEventRequestComMode_RequestComMode_UR_PNC_13_Airbag_2554061c
          OpEventRequestComMode_RequestComMode_UR_PNC_14_InfotainmentExtensions_d7c4346a: RteEventRef=OpEventRequestComMode_RequestComMode_UR_PNC_14_InfotainmentExtensions_d7c4346a
          OpEventRequestComMode_RequestComMode_UR_PNC_15_InstrumentclusterDisplay_1a610817: RteEventRef=OpEventRequestComMode_RequestComMode_UR_PNC_15_InstrumentclusterDisplay_1a610817
          OpEventRequestComMode_RequestComMode_UR_PNC_16_InfotainmentDisplay_1d18259d: RteEventRef=OpEventRequestComMode_RequestComMode_UR_PNC_16_InfotainmentDisplay_1d18259d
          OpEventRequestComMode_RequestComMode_UR_PNC_17_Audio_d11279f4: RteEventRef=OpEventRequestComMode_RequestComMode_UR_PNC_17_Audio_d11279f4
          OpEventRequestComMode_RequestComMode_UR_PNC_18_VirtualSideMirrors_dca4d4b3: RteEventRef=OpEventRequestComMode_RequestComMode_UR_PNC_18_VirtualSideMirrors_dca4d4b3
          OpEventRequestComMode_RequestComMode_UR_PNC_19_Doors_Hatches_58052c40: RteEventRef=OpEventRequestComMode_RequestComMode_UR_PNC_19_Doors_Hatches_58052c40
          OpEventRequestComMode_RequestComMode_UR_PNC_20_OptionalComfort_76e30655: RteEventRef=OpEventRequestComMode_RequestComMode_UR_PNC_20_OptionalComfort_76e30655
          OpEventRequestComMode_RequestComMode_UR_PNC_21_AirSuspension_3e4d6d03: RteEventRef=OpEventRequestComMode_RequestComMode_UR_PNC_21_AirSuspension_3e4d6d03
          OpEventRequestComMode_RequestComMode_UR_PNC_22_ExteriorLights_3bdfbcd3: RteEventRef=OpEventRequestComMode_RequestComMode_UR_PNC_22_ExteriorLights_3bdfbcd3
          OpEventRequestComMode_RequestComMode_UR_PNC_23_Climate_69d3b4ed: RteEventRef=OpEventRequestComMode_RequestComMode_UR_PNC_23_Climate_69d3b4ed
          OpEventRequestComMode_RequestComMode_UR_PNC_24_ThermoManagement_31b4f0b3: RteEventRef=OpEventRequestComMode_RequestComMode_UR_PNC_24_ThermoManagement_31b4f0b3
          OpEventRequestComMode_RequestComMode_UR_PNC_25_AccessSystemSensors_863389c2: RteEventRef=OpEventRequestComMode_RequestComMode_UR_PNC_25_AccessSystemSensors_863389c2
          OpEventRequestComMode_RequestComMode_UR_PNC_26_HighVoltage_Charging_c00f85a2: RteEventRef=OpEventRequestComMode_RequestComMode_UR_PNC_26_HighVoltage_Charging_c00f85a2
          OpEventRequestComMode_RequestComMode_UR_PNC_27_Timemaster_Timer_53539b48: RteEventRef=OpEventRequestComMode_RequestComMode_UR_PNC_27_Timemaster_Timer_53539b48
          OpEventRequestComMode_RequestComMode_UR_PNC_28_OnboardTester_DataCollector_c7d92e04: RteEventRef=OpEventRequestComMode_RequestComMode_UR_PNC_28_OnboardTester_DataCollector_c7d92e04
          OpEventRequestComMode_RequestComMode_UR_PNC_29_SteeringColumnLock_44a1738d: RteEventRef=OpEventRequestComMode_RequestComMode_UR_PNC_29_SteeringColumnLock_44a1738d
          OpEventRequestComMode_RequestComMode_UR_PNC_30_EnergyManagement_82f39188: RteEventRef=OpEventRequestComMode_RequestComMode_UR_PNC_30_EnergyManagement_82f39188
          OpEventRequestComMode_RequestComMode_UR_PNC_31_MultifunctionalSteeringWheel_48e6d667: RteEventRef=OpEventRequestComMode_RequestComMode_UR_PNC_31_MultifunctionalSteeringWheel_48e6d667
          OpEventRequestComMode_RequestComMode_UR_PNC_32_OnlineAccess_c5b851bc: RteEventRef=OpEventRequestComMode_RequestComMode_UR_PNC_32_OnlineAccess_c5b851bc
          OpEventRequestComMode_RequestComMode_UR_PNC_33_ExternalWirelessCommunication_779a8708: RteEventRef=OpEventRequestComMode_RequestComMode_UR_PNC_33_ExternalWirelessCommunication_779a8708
          OpEventRequestComMode_RequestComMode_UR_PNC_34_GPS_Lokalization_72b0f580: RteEventRef=OpEventRequestComMode_RequestComMode_UR_PNC_34_GPS_Lokalization_72b0f580
          OpEventRequestComMode_RequestComMode_UR_PNC_35_ExteriorSound_9764238b: RteEventRef=OpEventRequestComMode_RequestComMode_UR_PNC_35_ExteriorSound_9764238b
          OpEventRequestComMode_RequestComMode_UR_PNC_36_Preheater_5e289989: RteEventRef=OpEventRequestComMode_RequestComMode_UR_PNC_36_Preheater_5e289989
          OpEventRequestComMode_RequestComMode_UR_PNC_37_HighVoltage_WirelessChargingStation_f111c76f: RteEventRef=OpEventRequestComMode_RequestComMode_UR_PNC_37_HighVoltage_WirelessChargingStation_f111c76f
          OpEventRequestComMode_RequestComMode_UR_PNC_40_Diagnosis_Energy_532c6fb4: RteEventRef=OpEventRequestComMode_RequestComMode_UR_PNC_40_Diagnosis_Energy_532c6fb4
          OpEventRequestComMode_RequestComMode_UR_PNC_41_Diagnosis_Powertrain_0ac6ac8b: RteEventRef=OpEventRequestComMode_RequestComMode_UR_PNC_41_Diagnosis_Powertrain_0ac6ac8b
          OpEventRequestComMode_RequestComMode_UR_PNC_42_Diagnosis_FlexRay_f6dcf44d: RteEventRef=OpEventRequestComMode_RequestComMode_UR_PNC_42_Diagnosis_FlexRay_f6dcf44d
          OpEventRequestComMode_RequestComMode_UR_PNC_43_Diagnosis_DrivingAssistance_84f09039: RteEventRef=OpEventRequestComMode_RequestComMode_UR_PNC_43_Diagnosis_DrivingAssistance_84f09039
          OpEventRequestComMode_RequestComMode_UR_PNC_44_Diagnosis_Infotainment_3909218a: RteEventRef=OpEventRequestComMode_RequestComMode_UR_PNC_44_Diagnosis_Infotainment_3909218a
          OpEventRequestComMode_RequestComMode_UR_PNC_45_Diagnosis_Comfort_7eea372a: RteEventRef=OpEventRequestComMode_RequestComMode_UR_PNC_45_Diagnosis_Comfort_7eea372a
          OpEventRequestComMode_RequestComMode_UR_PNC_46_Diagnosis_Light_5140c135: RteEventRef=OpEventRequestComMode_RequestComMode_UR_PNC_46_Diagnosis_Light_5140c135
          OpEventRequestComMode_RequestComMode_UR_PNC_47_Diagnosis_ComfortLINs_70cf0372: RteEventRef=OpEventRequestComMode_RequestComMode_UR_PNC_47_Diagnosis_ComfortLINs_70cf0372
          OpEventRequestComMode_RequestComMode_UR_PNC_48_Diagnosis_ClimateTmeLINs_b4c40b49: RteEventRef=OpEventRequestComMode_RequestComMode_UR_PNC_48_Diagnosis_ClimateTmeLINs_b4c40b49
          OpEventRequestComMode_RequestComMode_UR_PNC_53_Lock_Unlock_bfb0b2ca: RteEventRef=OpEventRequestComMode_RequestComMode_UR_PNC_53_Lock_Unlock_bfb0b2ca
          OpEventRequestComMode_RequestComMode_UR_PNC_55_Dimming_4909a14c: RteEventRef=OpEventRequestComMode_RequestComMode_UR_PNC_55_Dimming_4909a14c
          OpEventRequestComMode_RequestComMode_UR_PNC_56_Charging_Status_cad5dfb4: RteEventRef=OpEventRequestComMode_RequestComMode_UR_PNC_56_Charging_Status_cad5dfb4
          OpEventGetCurrentComMode_GetCurrentComMode_UR_CN_BMC_CAN01_908d0059: RteEventRef=OpEventGetCurrentComMode_GetCurrentComMode_UR_CN_BMC_CAN01_908d0059
          OpEventGetCurrentComMode_GetCurrentComMode_UR_CN_HCP5_CANFD01_84d44928: RteEventRef=OpEventGetCurrentComMode_GetCurrentComMode_UR_CN_HCP5_CANFD01_84d44928
          OpEventGetCurrentComMode_GetCurrentComMode_UR_PNC_01_CarWakeUp_bf3ce487: RteEventRef=OpEventGetCurrentComMode_GetCurrentComMode_UR_PNC_01_CarWakeUp_bf3ce487
          OpEventGetCurrentComMode_GetCurrentComMode_UR_PNC_02_Basefunction_Powertrain_6e8e3f0b: RteEventRef=OpEventGetCurrentComMode_GetCurrentComMode_UR_PNC_02_Basefunction_Powertrain_6e8e3f0b
          OpEventGetCurrentComMode_GetCurrentComMode_UR_PNC_03_Basefunction_Chassis_74381a7a: RteEventRef=OpEventGetCurrentComMode_GetCurrentComMode_UR_PNC_03_Basefunction_Chassis_74381a7a
          OpEventGetCurrentComMode_GetCurrentComMode_UR_PNC_04_Basefunction_DrivingAssistance_2e755e80: RteEventRef=OpEventGetCurrentComMode_GetCurrentComMode_UR_PNC_04_Basefunction_DrivingAssistance_2e755e80
          OpEventGetCurrentComMode_GetCurrentComMode_UR_PNC_05_Basefunction_Infotainment_d739ca28: RteEventRef=OpEventGetCurrentComMode_GetCurrentComMode_UR_PNC_05_Basefunction_Infotainment_d739ca28
          OpEventGetCurrentComMode_GetCurrentComMode_UR_PNC_06_Basefunction_ComfortLight_8074acb0: RteEventRef=OpEventGetCurrentComMode_GetCurrentComMode_UR_PNC_06_Basefunction_ComfortLight_8074acb0
          OpEventGetCurrentComMode_GetCurrentComMode_UR_PNC_07_Basefunction_CrossSection_5c9febde: RteEventRef=OpEventGetCurrentComMode_GetCurrentComMode_UR_PNC_07_Basefunction_CrossSection_5c9febde
          OpEventGetCurrentComMode_GetCurrentComMode_UR_PNC_08_Basefunction_Connectivity_33115909: RteEventRef=OpEventGetCurrentComMode_GetCurrentComMode_UR_PNC_08_Basefunction_Connectivity_33115909
          OpEventGetCurrentComMode_GetCurrentComMode_UR_PNC_10_Powertrain_5fe7c550: RteEventRef=OpEventGetCurrentComMode_GetCurrentComMode_UR_PNC_10_Powertrain_5fe7c550
          OpEventGetCurrentComMode_GetCurrentComMode_UR_PNC_11_Chassis_fd87aaa6: RteEventRef=OpEventGetCurrentComMode_GetCurrentComMode_UR_PNC_11_Chassis_fd87aaa6
          OpEventGetCurrentComMode_GetCurrentComMode_UR_PNC_12_GearSelector_2aa5ddd0: RteEventRef=OpEventGetCurrentComMode_GetCurrentComMode_UR_PNC_12_GearSelector_2aa5ddd0
          OpEventGetCurrentComMode_GetCurrentComMode_UR_PNC_13_Airbag_2554061c: RteEventRef=OpEventGetCurrentComMode_GetCurrentComMode_UR_PNC_13_Airbag_2554061c
          OpEventGetCurrentComMode_GetCurrentComMode_UR_PNC_14_InfotainmentExtensions_d7c4346a: RteEventRef=OpEventGetCurrentComMode_GetCurrentComMode_UR_PNC_14_InfotainmentExtensions_d7c4346a
          OpEventGetCurrentComMode_GetCurrentComMode_UR_PNC_15_InstrumentclusterDisplay_1a610817: RteEventRef=OpEventGetCurrentComMode_GetCurrentComMode_UR_PNC_15_InstrumentclusterDisplay_1a610817
          OpEventGetCurrentComMode_GetCurrentComMode_UR_PNC_16_InfotainmentDisplay_1d18259d: RteEventRef=OpEventGetCurrentComMode_GetCurrentComMode_UR_PNC_16_InfotainmentDisplay_1d18259d
          OpEventGetCurrentComMode_GetCurrentComMode_UR_PNC_17_Audio_d11279f4: RteEventRef=OpEventGetCurrentComMode_GetCurrentComMode_UR_PNC_17_Audio_d11279f4
          OpEventGetCurrentComMode_GetCurrentComMode_UR_PNC_18_VirtualSideMirrors_dca4d4b3: RteEventRef=OpEventGetCurrentComMode_GetCurrentComMode_UR_PNC_18_VirtualSideMirrors_dca4d4b3
          OpEventGetCurrentComMode_GetCurrentComMode_UR_PNC_19_Doors_Hatches_58052c40: RteEventRef=OpEventGetCurrentComMode_GetCurrentComMode_UR_PNC_19_Doors_Hatches_58052c40
          OpEventGetCurrentComMode_GetCurrentComMode_UR_PNC_20_OptionalComfort_76e30655: RteEventRef=OpEventGetCurrentComMode_GetCurrentComMode_UR_PNC_20_OptionalComfort_76e30655
          OpEventGetCurrentComMode_GetCurrentComMode_UR_PNC_21_AirSuspension_3e4d6d03: RteEventRef=OpEventGetCurrentComMode_GetCurrentComMode_UR_PNC_21_AirSuspension_3e4d6d03
          OpEventGetCurrentComMode_GetCurrentComMode_UR_PNC_22_ExteriorLights_3bdfbcd3: RteEventRef=OpEventGetCurrentComMode_GetCurrentComMode_UR_PNC_22_ExteriorLights_3bdfbcd3
          OpEventGetCurrentComMode_GetCurrentComMode_UR_PNC_23_Climate_69d3b4ed: RteEventRef=OpEventGetCurrentComMode_GetCurrentComMode_UR_PNC_23_Climate_69d3b4ed
          OpEventGetCurrentComMode_GetCurrentComMode_UR_PNC_24_ThermoManagement_31b4f0b3: RteEventRef=OpEventGetCurrentComMode_GetCurrentComMode_UR_PNC_24_ThermoManagement_31b4f0b3
          OpEventGetCurrentComMode_GetCurrentComMode_UR_PNC_25_AccessSystemSensors_863389c2: RteEventRef=OpEventGetCurrentComMode_GetCurrentComMode_UR_PNC_25_AccessSystemSensors_863389c2
          OpEventGetCurrentComMode_GetCurrentComMode_UR_PNC_26_HighVoltage_Charging_c00f85a2: RteEventRef=OpEventGetCurrentComMode_GetCurrentComMode_UR_PNC_26_HighVoltage_Charging_c00f85a2
          OpEventGetCurrentComMode_GetCurrentComMode_UR_PNC_27_Timemaster_Timer_53539b48: RteEventRef=OpEventGetCurrentComMode_GetCurrentComMode_UR_PNC_27_Timemaster_Timer_53539b48
          OpEventGetCurrentComMode_GetCurrentComMode_UR_PNC_28_OnboardTester_DataCollector_c7d92e04: RteEventRef=OpEventGetCurrentComMode_GetCurrentComMode_UR_PNC_28_OnboardTester_DataCollector_c7d92e04
          OpEventGetCurrentComMode_GetCurrentComMode_UR_PNC_29_SteeringColumnLock_44a1738d: RteEventRef=OpEventGetCurrentComMode_GetCurrentComMode_UR_PNC_29_SteeringColumnLock_44a1738d
          OpEventGetCurrentComMode_GetCurrentComMode_UR_PNC_30_EnergyManagement_82f39188: RteEventRef=OpEventGetCurrentComMode_GetCurrentComMode_UR_PNC_30_EnergyManagement_82f39188
          OpEventGetCurrentComMode_GetCurrentComMode_UR_PNC_31_MultifunctionalSteeringWheel_48e6d667: RteEventRef=OpEventGetCurrentComMode_GetCurrentComMode_UR_PNC_31_MultifunctionalSteeringWheel_48e6d667
          OpEventGetCurrentComMode_GetCurrentComMode_UR_PNC_32_OnlineAccess_c5b851bc: RteEventRef=OpEventGetCurrentComMode_GetCurrentComMode_UR_PNC_32_OnlineAccess_c5b851bc
          OpEventGetCurrentComMode_GetCurrentComMode_UR_PNC_33_ExternalWirelessCommunication_779a8708: RteEventRef=OpEventGetCurrentComMode_GetCurrentComMode_UR_PNC_33_ExternalWirelessCommunication_779a8708
          OpEventGetCurrentComMode_GetCurrentComMode_UR_PNC_34_GPS_Lokalization_72b0f580: RteEventRef=OpEventGetCurrentComMode_GetCurrentComMode_UR_PNC_34_GPS_Lokalization_72b0f580
          OpEventGetCurrentComMode_GetCurrentComMode_UR_PNC_35_ExteriorSound_9764238b: RteEventRef=OpEventGetCurrentComMode_GetCurrentComMode_UR_PNC_35_ExteriorSound_9764238b
          OpEventGetCurrentComMode_GetCurrentComMode_UR_PNC_36_Preheater_5e289989: RteEventRef=OpEventGetCurrentComMode_GetCurrentComMode_UR_PNC_36_Preheater_5e289989
          OpEventGetCurrentComMode_GetCurrentComMode_UR_PNC_37_HighVoltage_WirelessChargingStation_f111c76f: RteEventRef=OpEventGetCurrentComMode_GetCurrentComMode_UR_PNC_37_HighVoltage_WirelessChargingStation_f111c76f
          OpEventGetCurrentComMode_GetCurrentComMode_UR_PNC_40_Diagnosis_Energy_532c6fb4: RteEventRef=OpEventGetCurrentComMode_GetCurrentComMode_UR_PNC_40_Diagnosis_Energy_532c6fb4
          OpEventGetCurrentComMode_GetCurrentComMode_UR_PNC_41_Diagnosis_Powertrain_0ac6ac8b: RteEventRef=OpEventGetCurrentComMode_GetCurrentComMode_UR_PNC_41_Diagnosis_Powertrain_0ac6ac8b
          OpEventGetCurrentComMode_GetCurrentComMode_UR_PNC_42_Diagnosis_FlexRay_f6dcf44d: RteEventRef=OpEventGetCurrentComMode_GetCurrentComMode_UR_PNC_42_Diagnosis_FlexRay_f6dcf44d
          OpEventGetCurrentComMode_GetCurrentComMode_UR_PNC_43_Diagnosis_DrivingAssistance_84f09039: RteEventRef=OpEventGetCurrentComMode_GetCurrentComMode_UR_PNC_43_Diagnosis_DrivingAssistance_84f09039
          OpEventGetCurrentComMode_GetCurrentComMode_UR_PNC_44_Diagnosis_Infotainment_3909218a: RteEventRef=OpEventGetCurrentComMode_GetCurrentComMode_UR_PNC_44_Diagnosis_Infotainment_3909218a
          OpEventGetCurrentComMode_GetCurrentComMode_UR_PNC_45_Diagnosis_Comfort_7eea372a: RteEventRef=OpEventGetCurrentComMode_GetCurrentComMode_UR_PNC_45_Diagnosis_Comfort_7eea372a
          OpEventGetCurrentComMode_GetCurrentComMode_UR_PNC_46_Diagnosis_Light_5140c135: RteEventRef=OpEventGetCurrentComMode_GetCurrentComMode_UR_PNC_46_Diagnosis_Light_5140c135
          OpEventGetCurrentComMode_GetCurrentComMode_UR_PNC_47_Diagnosis_ComfortLINs_70cf0372: RteEventRef=OpEventGetCurrentComMode_GetCurrentComMode_UR_PNC_47_Diagnosis_ComfortLINs_70cf0372
          OpEventGetCurrentComMode_GetCurrentComMode_UR_PNC_48_Diagnosis_ClimateTmeLINs_b4c40b49: RteEventRef=OpEventGetCurrentComMode_GetCurrentComMode_UR_PNC_48_Diagnosis_ClimateTmeLINs_b4c40b49
          OpEventGetCurrentComMode_GetCurrentComMode_UR_PNC_53_Lock_Unlock_bfb0b2ca: RteEventRef=OpEventGetCurrentComMode_GetCurrentComMode_UR_PNC_53_Lock_Unlock_bfb0b2ca
          OpEventGetCurrentComMode_GetCurrentComMode_UR_PNC_55_Dimming_4909a14c: RteEventRef=OpEventGetCurrentComMode_GetCurrentComMode_UR_PNC_55_Dimming_4909a14c
          OpEventGetCurrentComMode_GetCurrentComMode_UR_PNC_56_Charging_Status_cad5dfb4: RteEventRef=OpEventGetCurrentComMode_GetCurrentComMode_UR_PNC_56_Charging_Status_cad5dfb4
          OpEventGetCurrentPNCComMode_GetCurrentPNCComMode_UR_CN_BMC_CAN01_908d0059: RteEventRef=OpEventGetCurrentPNCComMode_GetCurrentPNCComMode_UR_CN_BMC_CAN01_908d0059
          OpEventGetCurrentPNCComMode_GetCurrentPNCComMode_UR_CN_HCP5_CANFD01_84d44928: RteEventRef=OpEventGetCurrentPNCComMode_GetCurrentPNCComMode_UR_CN_HCP5_CANFD01_84d44928
          OpEventGetCurrentPNCComMode_GetCurrentPNCComMode_UR_PNC_01_CarWakeUp_bf3ce487: RteEventRef=OpEventGetCurrentPNCComMode_GetCurrentPNCComMode_UR_PNC_01_CarWakeUp_bf3ce487
          OpEventGetCurrentPNCComMode_GetCurrentPNCComMode_UR_PNC_02_Basefunction_Powertrain_6e8e3f0b: RteEventRef=OpEventGetCurrentPNCComMode_GetCurrentPNCComMode_UR_PNC_02_Basefunction_Powertrain_6e8e3f0b
          OpEventGetCurrentPNCComMode_GetCurrentPNCComMode_UR_PNC_03_Basefunction_Chassis_74381a7a: RteEventRef=OpEventGetCurrentPNCComMode_GetCurrentPNCComMode_UR_PNC_03_Basefunction_Chassis_74381a7a
          OpEventGetCurrentPNCComMode_GetCurrentPNCComMode_UR_PNC_04_Basefunction_DrivingAssistance_2e755e80: RteEventRef=OpEventGetCurrentPNCComMode_GetCurrentPNCComMode_UR_PNC_04_Basefunction_DrivingAssistance_2e755e80
          OpEventGetCurrentPNCComMode_GetCurrentPNCComMode_UR_PNC_05_Basefunction_Infotainment_d739ca28: RteEventRef=OpEventGetCurrentPNCComMode_GetCurrentPNCComMode_UR_PNC_05_Basefunction_Infotainment_d739ca28
          OpEventGetCurrentPNCComMode_GetCurrentPNCComMode_UR_PNC_06_Basefunction_ComfortLight_8074acb0: RteEventRef=OpEventGetCurrentPNCComMode_GetCurrentPNCComMode_UR_PNC_06_Basefunction_ComfortLight_8074acb0
          OpEventGetCurrentPNCComMode_GetCurrentPNCComMode_UR_PNC_07_Basefunction_CrossSection_5c9febde: RteEventRef=OpEventGetCurrentPNCComMode_GetCurrentPNCComMode_UR_PNC_07_Basefunction_CrossSection_5c9febde
          OpEventGetCurrentPNCComMode_GetCurrentPNCComMode_UR_PNC_08_Basefunction_Connectivity_33115909: RteEventRef=OpEventGetCurrentPNCComMode_GetCurrentPNCComMode_UR_PNC_08_Basefunction_Connectivity_33115909
          OpEventGetCurrentPNCComMode_GetCurrentPNCComMode_UR_PNC_10_Powertrain_5fe7c550: RteEventRef=OpEventGetCurrentPNCComMode_GetCurrentPNCComMode_UR_PNC_10_Powertrain_5fe7c550
          OpEventGetCurrentPNCComMode_GetCurrentPNCComMode_UR_PNC_11_Chassis_fd87aaa6: RteEventRef=OpEventGetCurrentPNCComMode_GetCurrentPNCComMode_UR_PNC_11_Chassis_fd87aaa6
          OpEventGetCurrentPNCComMode_GetCurrentPNCComMode_UR_PNC_12_GearSelector_2aa5ddd0: RteEventRef=OpEventGetCurrentPNCComMode_GetCurrentPNCComMode_UR_PNC_12_GearSelector_2aa5ddd0
          OpEventGetCurrentPNCComMode_GetCurrentPNCComMode_UR_PNC_13_Airbag_2554061c: RteEventRef=OpEventGetCurrentPNCComMode_GetCurrentPNCComMode_UR_PNC_13_Airbag_2554061c
          OpEventGetCurrentPNCComMode_GetCurrentPNCComMode_UR_PNC_14_InfotainmentExtensions_d7c4346a: RteEventRef=OpEventGetCurrentPNCComMode_GetCurrentPNCComMode_UR_PNC_14_InfotainmentExtensions_d7c4346a
          OpEventGetCurrentPNCComMode_GetCurrentPNCComMode_UR_PNC_15_InstrumentclusterDisplay_1a610817: RteEventRef=OpEventGetCurrentPNCComMode_GetCurrentPNCComMode_UR_PNC_15_InstrumentclusterDisplay_1a610817
          OpEventGetCurrentPNCComMode_GetCurrentPNCComMode_UR_PNC_16_InfotainmentDisplay_1d18259d: RteEventRef=OpEventGetCurrentPNCComMode_GetCurrentPNCComMode_UR_PNC_16_InfotainmentDisplay_1d18259d
          OpEventGetCurrentPNCComMode_GetCurrentPNCComMode_UR_PNC_17_Audio_d11279f4: RteEventRef=OpEventGetCurrentPNCComMode_GetCurrentPNCComMode_UR_PNC_17_Audio_d11279f4
          OpEventGetCurrentPNCComMode_GetCurrentPNCComMode_UR_PNC_18_VirtualSideMirrors_dca4d4b3: RteEventRef=OpEventGetCurrentPNCComMode_GetCurrentPNCComMode_UR_PNC_18_VirtualSideMirrors_dca4d4b3
          OpEventGetCurrentPNCComMode_GetCurrentPNCComMode_UR_PNC_19_Doors_Hatches_58052c40: RteEventRef=OpEventGetCurrentPNCComMode_GetCurrentPNCComMode_UR_PNC_19_Doors_Hatches_58052c40
          OpEventGetCurrentPNCComMode_GetCurrentPNCComMode_UR_PNC_20_OptionalComfort_76e30655: RteEventRef=OpEventGetCurrentPNCComMode_GetCurrentPNCComMode_UR_PNC_20_OptionalComfort_76e30655
          OpEventGetCurrentPNCComMode_GetCurrentPNCComMode_UR_PNC_21_AirSuspension_3e4d6d03: RteEventRef=OpEventGetCurrentPNCComMode_GetCurrentPNCComMode_UR_PNC_21_AirSuspension_3e4d6d03
          OpEventGetCurrentPNCComMode_GetCurrentPNCComMode_UR_PNC_22_ExteriorLights_3bdfbcd3: RteEventRef=OpEventGetCurrentPNCComMode_GetCurrentPNCComMode_UR_PNC_22_ExteriorLights_3bdfbcd3
          OpEventGetCurrentPNCComMode_GetCurrentPNCComMode_UR_PNC_23_Climate_69d3b4ed: RteEventRef=OpEventGetCurrentPNCComMode_GetCurrentPNCComMode_UR_PNC_23_Climate_69d3b4ed
          OpEventGetCurrentPNCComMode_GetCurrentPNCComMode_UR_PNC_24_ThermoManagement_31b4f0b3: RteEventRef=OpEventGetCurrentPNCComMode_GetCurrentPNCComMode_UR_PNC_24_ThermoManagement_31b4f0b3
          OpEventGetCurrentPNCComMode_GetCurrentPNCComMode_UR_PNC_25_AccessSystemSensors_863389c2: RteEventRef=OpEventGetCurrentPNCComMode_GetCurrentPNCComMode_UR_PNC_25_AccessSystemSensors_863389c2
          OpEventGetCurrentPNCComMode_GetCurrentPNCComMode_UR_PNC_26_HighVoltage_Charging_c00f85a2: RteEventRef=OpEventGetCurrentPNCComMode_GetCurrentPNCComMode_UR_PNC_26_HighVoltage_Charging_c00f85a2
          OpEventGetCurrentPNCComMode_GetCurrentPNCComMode_UR_PNC_27_Timemaster_Timer_53539b48: RteEventRef=OpEventGetCurrentPNCComMode_GetCurrentPNCComMode_UR_PNC_27_Timemaster_Timer_53539b48
          OpEventGetCurrentPNCComMode_GetCurrentPNCComMode_UR_PNC_28_OnboardTester_DataCollector_c7d92e04: RteEventRef=OpEventGetCurrentPNCComMode_GetCurrentPNCComMode_UR_PNC_28_OnboardTester_DataCollector_c7d92e04
          OpEventGetCurrentPNCComMode_GetCurrentPNCComMode_UR_PNC_29_SteeringColumnLock_44a1738d: RteEventRef=OpEventGetCurrentPNCComMode_GetCurrentPNCComMode_UR_PNC_29_SteeringColumnLock_44a1738d
          OpEventGetCurrentPNCComMode_GetCurrentPNCComMode_UR_PNC_30_EnergyManagement_82f39188: RteEventRef=OpEventGetCurrentPNCComMode_GetCurrentPNCComMode_UR_PNC_30_EnergyManagement_82f39188
          OpEventGetCurrentPNCComMode_GetCurrentPNCComMode_UR_PNC_31_MultifunctionalSteeringWheel_48e6d667: RteEventRef=OpEventGetCurrentPNCComMode_GetCurrentPNCComMode_UR_PNC_31_MultifunctionalSteeringWheel_48e6d667
          OpEventGetCurrentPNCComMode_GetCurrentPNCComMode_UR_PNC_32_OnlineAccess_c5b851bc: RteEventRef=OpEventGetCurrentPNCComMode_GetCurrentPNCComMode_UR_PNC_32_OnlineAccess_c5b851bc
          OpEventGetCurrentPNCComMode_GetCurrentPNCComMode_UR_PNC_33_ExternalWirelessCommunication_779a8708: RteEventRef=OpEventGetCurrentPNCComMode_GetCurrentPNCComMode_UR_PNC_33_ExternalWirelessCommunication_779a8708
          OpEventGetCurrentPNCComMode_GetCurrentPNCComMode_UR_PNC_34_GPS_Lokalization_72b0f580: RteEventRef=OpEventGetCurrentPNCComMode_GetCurrentPNCComMode_UR_PNC_34_GPS_Lokalization_72b0f580
          OpEventGetCurrentPNCComMode_GetCurrentPNCComMode_UR_PNC_35_ExteriorSound_9764238b: RteEventRef=OpEventGetCurrentPNCComMode_GetCurrentPNCComMode_UR_PNC_35_ExteriorSound_9764238b
          OpEventGetCurrentPNCComMode_GetCurrentPNCComMode_UR_PNC_36_Preheater_5e289989: RteEventRef=OpEventGetCurrentPNCComMode_GetCurrentPNCComMode_UR_PNC_36_Preheater_5e289989
          OpEventGetCurrentPNCComMode_GetCurrentPNCComMode_UR_PNC_37_HighVoltage_WirelessChargingStation_f111c76f: RteEventRef=OpEventGetCurrentPNCComMode_GetCurrentPNCComMode_UR_PNC_37_HighVoltage_WirelessChargingStation_f111c76f
          OpEventGetCurrentPNCComMode_GetCurrentPNCComMode_UR_PNC_40_Diagnosis_Energy_532c6fb4: RteEventRef=OpEventGetCurrentPNCComMode_GetCurrentPNCComMode_UR_PNC_40_Diagnosis_Energy_532c6fb4
          OpEventGetCurrentPNCComMode_GetCurrentPNCComMode_UR_PNC_41_Diagnosis_Powertrain_0ac6ac8b: RteEventRef=OpEventGetCurrentPNCComMode_GetCurrentPNCComMode_UR_PNC_41_Diagnosis_Powertrain_0ac6ac8b
          OpEventGetCurrentPNCComMode_GetCurrentPNCComMode_UR_PNC_42_Diagnosis_FlexRay_f6dcf44d: RteEventRef=OpEventGetCurrentPNCComMode_GetCurrentPNCComMode_UR_PNC_42_Diagnosis_FlexRay_f6dcf44d
          OpEventGetCurrentPNCComMode_GetCurrentPNCComMode_UR_PNC_43_Diagnosis_DrivingAssistance_84f09039: RteEventRef=OpEventGetCurrentPNCComMode_GetCurrentPNCComMode_UR_PNC_43_Diagnosis_DrivingAssistance_84f09039
          OpEventGetCurrentPNCComMode_GetCurrentPNCComMode_UR_PNC_44_Diagnosis_Infotainment_3909218a: RteEventRef=OpEventGetCurrentPNCComMode_GetCurrentPNCComMode_UR_PNC_44_Diagnosis_Infotainment_3909218a
          OpEventGetCurrentPNCComMode_GetCurrentPNCComMode_UR_PNC_45_Diagnosis_Comfort_7eea372a: RteEventRef=OpEventGetCurrentPNCComMode_GetCurrentPNCComMode_UR_PNC_45_Diagnosis_Comfort_7eea372a
          OpEventGetCurrentPNCComMode_GetCurrentPNCComMode_UR_PNC_46_Diagnosis_Light_5140c135: RteEventRef=OpEventGetCurrentPNCComMode_GetCurrentPNCComMode_UR_PNC_46_Diagnosis_Light_5140c135
          OpEventGetCurrentPNCComMode_GetCurrentPNCComMode_UR_PNC_47_Diagnosis_ComfortLINs_70cf0372: RteEventRef=OpEventGetCurrentPNCComMode_GetCurrentPNCComMode_UR_PNC_47_Diagnosis_ComfortLINs_70cf0372
          OpEventGetCurrentPNCComMode_GetCurrentPNCComMode_UR_PNC_48_Diagnosis_ClimateTmeLINs_b4c40b49: RteEventRef=OpEventGetCurrentPNCComMode_GetCurrentPNCComMode_UR_PNC_48_Diagnosis_ClimateTmeLINs_b4c40b49
          OpEventGetCurrentPNCComMode_GetCurrentPNCComMode_UR_PNC_53_Lock_Unlock_bfb0b2ca: RteEventRef=OpEventGetCurrentPNCComMode_GetCurrentPNCComMode_UR_PNC_53_Lock_Unlock_bfb0b2ca
          OpEventGetCurrentPNCComMode_GetCurrentPNCComMode_UR_PNC_55_Dimming_4909a14c: RteEventRef=OpEventGetCurrentPNCComMode_GetCurrentPNCComMode_UR_PNC_55_Dimming_4909a14c
          OpEventGetCurrentPNCComMode_GetCurrentPNCComMode_UR_PNC_56_Charging_Status_cad5dfb4: RteEventRef=OpEventGetCurrentPNCComMode_GetCurrentPNCComMode_UR_PNC_56_Charging_Status_cad5dfb4
          OpEventGetMaxComMode_GetMaxComMode_UR_CN_BMC_CAN01_908d0059: RteEventRef=OpEventGetMaxComMode_GetMaxComMode_UR_CN_BMC_CAN01_908d0059
          OpEventGetMaxComMode_GetMaxComMode_UR_CN_HCP5_CANFD01_84d44928: RteEventRef=OpEventGetMaxComMode_GetMaxComMode_UR_CN_HCP5_CANFD01_84d44928
          OpEventGetMaxComMode_GetMaxComMode_UR_PNC_01_CarWakeUp_bf3ce487: RteEventRef=OpEventGetMaxComMode_GetMaxComMode_UR_PNC_01_CarWakeUp_bf3ce487
          OpEventGetMaxComMode_GetMaxComMode_UR_PNC_02_Basefunction_Powertrain_6e8e3f0b: RteEventRef=OpEventGetMaxComMode_GetMaxComMode_UR_PNC_02_Basefunction_Powertrain_6e8e3f0b
          OpEventGetMaxComMode_GetMaxComMode_UR_PNC_03_Basefunction_Chassis_74381a7a: RteEventRef=OpEventGetMaxComMode_GetMaxComMode_UR_PNC_03_Basefunction_Chassis_74381a7a
          OpEventGetMaxComMode_GetMaxComMode_UR_PNC_04_Basefunction_DrivingAssistance_2e755e80: RteEventRef=OpEventGetMaxComMode_GetMaxComMode_UR_PNC_04_Basefunction_DrivingAssistance_2e755e80
          OpEventGetMaxComMode_GetMaxComMode_UR_PNC_05_Basefunction_Infotainment_d739ca28: RteEventRef=OpEventGetMaxComMode_GetMaxComMode_UR_PNC_05_Basefunction_Infotainment_d739ca28
          OpEventGetMaxComMode_GetMaxComMode_UR_PNC_06_Basefunction_ComfortLight_8074acb0: RteEventRef=OpEventGetMaxComMode_GetMaxComMode_UR_PNC_06_Basefunction_ComfortLight_8074acb0
          OpEventGetMaxComMode_GetMaxComMode_UR_PNC_07_Basefunction_CrossSection_5c9febde: RteEventRef=OpEventGetMaxComMode_GetMaxComMode_UR_PNC_07_Basefunction_CrossSection_5c9febde
          OpEventGetMaxComMode_GetMaxComMode_UR_PNC_08_Basefunction_Connectivity_33115909: RteEventRef=OpEventGetMaxComMode_GetMaxComMode_UR_PNC_08_Basefunction_Connectivity_33115909
          OpEventGetMaxComMode_GetMaxComMode_UR_PNC_10_Powertrain_5fe7c550: RteEventRef=OpEventGetMaxComMode_GetMaxComMode_UR_PNC_10_Powertrain_5fe7c550
          OpEventGetMaxComMode_GetMaxComMode_UR_PNC_11_Chassis_fd87aaa6: RteEventRef=OpEventGetMaxComMode_GetMaxComMode_UR_PNC_11_Chassis_fd87aaa6
          OpEventGetMaxComMode_GetMaxComMode_UR_PNC_12_GearSelector_2aa5ddd0: RteEventRef=OpEventGetMaxComMode_GetMaxComMode_UR_PNC_12_GearSelector_2aa5ddd0
          OpEventGetMaxComMode_GetMaxComMode_UR_PNC_13_Airbag_2554061c: RteEventRef=OpEventGetMaxComMode_GetMaxComMode_UR_PNC_13_Airbag_2554061c
          OpEventGetMaxComMode_GetMaxComMode_UR_PNC_14_InfotainmentExtensions_d7c4346a: RteEventRef=OpEventGetMaxComMode_GetMaxComMode_UR_PNC_14_InfotainmentExtensions_d7c4346a
          OpEventGetMaxComMode_GetMaxComMode_UR_PNC_15_InstrumentclusterDisplay_1a610817: RteEventRef=OpEventGetMaxComMode_GetMaxComMode_UR_PNC_15_InstrumentclusterDisplay_1a610817
          OpEventGetMaxComMode_GetMaxComMode_UR_PNC_16_InfotainmentDisplay_1d18259d: RteEventRef=OpEventGetMaxComMode_GetMaxComMode_UR_PNC_16_InfotainmentDisplay_1d18259d
          OpEventGetMaxComMode_GetMaxComMode_UR_PNC_17_Audio_d11279f4: RteEventRef=OpEventGetMaxComMode_GetMaxComMode_UR_PNC_17_Audio_d11279f4
          OpEventGetMaxComMode_GetMaxComMode_UR_PNC_18_VirtualSideMirrors_dca4d4b3: RteEventRef=OpEventGetMaxComMode_GetMaxComMode_UR_PNC_18_VirtualSideMirrors_dca4d4b3
          OpEventGetMaxComMode_GetMaxComMode_UR_PNC_19_Doors_Hatches_58052c40: RteEventRef=OpEventGetMaxComMode_GetMaxComMode_UR_PNC_19_Doors_Hatches_58052c40
          OpEventGetMaxComMode_GetMaxComMode_UR_PNC_20_OptionalComfort_76e30655: RteEventRef=OpEventGetMaxComMode_GetMaxComMode_UR_PNC_20_OptionalComfort_76e30655
          OpEventGetMaxComMode_GetMaxComMode_UR_PNC_21_AirSuspension_3e4d6d03: RteEventRef=OpEventGetMaxComMode_GetMaxComMode_UR_PNC_21_AirSuspension_3e4d6d03
          OpEventGetMaxComMode_GetMaxComMode_UR_PNC_22_ExteriorLights_3bdfbcd3: RteEventRef=OpEventGetMaxComMode_GetMaxComMode_UR_PNC_22_ExteriorLights_3bdfbcd3
          OpEventGetMaxComMode_GetMaxComMode_UR_PNC_23_Climate_69d3b4ed: RteEventRef=OpEventGetMaxComMode_GetMaxComMode_UR_PNC_23_Climate_69d3b4ed
          OpEventGetMaxComMode_GetMaxComMode_UR_PNC_24_ThermoManagement_31b4f0b3: RteEventRef=OpEventGetMaxComMode_GetMaxComMode_UR_PNC_24_ThermoManagement_31b4f0b3
          OpEventGetMaxComMode_GetMaxComMode_UR_PNC_25_AccessSystemSensors_863389c2: RteEventRef=OpEventGetMaxComMode_GetMaxComMode_UR_PNC_25_AccessSystemSensors_863389c2
          OpEventGetMaxComMode_GetMaxComMode_UR_PNC_26_HighVoltage_Charging_c00f85a2: RteEventRef=OpEventGetMaxComMode_GetMaxComMode_UR_PNC_26_HighVoltage_Charging_c00f85a2
          OpEventGetMaxComMode_GetMaxComMode_UR_PNC_27_Timemaster_Timer_53539b48: RteEventRef=OpEventGetMaxComMode_GetMaxComMode_UR_PNC_27_Timemaster_Timer_53539b48
          OpEventGetMaxComMode_GetMaxComMode_UR_PNC_28_OnboardTester_DataCollector_c7d92e04: RteEventRef=OpEventGetMaxComMode_GetMaxComMode_UR_PNC_28_OnboardTester_DataCollector_c7d92e04
          OpEventGetMaxComMode_GetMaxComMode_UR_PNC_29_SteeringColumnLock_44a1738d: RteEventRef=OpEventGetMaxComMode_GetMaxComMode_UR_PNC_29_SteeringColumnLock_44a1738d
          OpEventGetMaxComMode_GetMaxComMode_UR_PNC_30_EnergyManagement_82f39188: RteEventRef=OpEventGetMaxComMode_GetMaxComMode_UR_PNC_30_EnergyManagement_82f39188
          OpEventGetMaxComMode_GetMaxComMode_UR_PNC_31_MultifunctionalSteeringWheel_48e6d667: RteEventRef=OpEventGetMaxComMode_GetMaxComMode_UR_PNC_31_MultifunctionalSteeringWheel_48e6d667
          OpEventGetMaxComMode_GetMaxComMode_UR_PNC_32_OnlineAccess_c5b851bc: RteEventRef=OpEventGetMaxComMode_GetMaxComMode_UR_PNC_32_OnlineAccess_c5b851bc
          OpEventGetMaxComMode_GetMaxComMode_UR_PNC_33_ExternalWirelessCommunication_779a8708: RteEventRef=OpEventGetMaxComMode_GetMaxComMode_UR_PNC_33_ExternalWirelessCommunication_779a8708
          OpEventGetMaxComMode_GetMaxComMode_UR_PNC_34_GPS_Lokalization_72b0f580: RteEventRef=OpEventGetMaxComMode_GetMaxComMode_UR_PNC_34_GPS_Lokalization_72b0f580
          OpEventGetMaxComMode_GetMaxComMode_UR_PNC_35_ExteriorSound_9764238b: RteEventRef=OpEventGetMaxComMode_GetMaxComMode_UR_PNC_35_ExteriorSound_9764238b
          OpEventGetMaxComMode_GetMaxComMode_UR_PNC_36_Preheater_5e289989: RteEventRef=OpEventGetMaxComMode_GetMaxComMode_UR_PNC_36_Preheater_5e289989
          OpEventGetMaxComMode_GetMaxComMode_UR_PNC_37_HighVoltage_WirelessChargingStation_f111c76f: RteEventRef=OpEventGetMaxComMode_GetMaxComMode_UR_PNC_37_HighVoltage_WirelessChargingStation_f111c76f
          OpEventGetMaxComMode_GetMaxComMode_UR_PNC_40_Diagnosis_Energy_532c6fb4: RteEventRef=OpEventGetMaxComMode_GetMaxComMode_UR_PNC_40_Diagnosis_Energy_532c6fb4
          OpEventGetMaxComMode_GetMaxComMode_UR_PNC_41_Diagnosis_Powertrain_0ac6ac8b: RteEventRef=OpEventGetMaxComMode_GetMaxComMode_UR_PNC_41_Diagnosis_Powertrain_0ac6ac8b
          OpEventGetMaxComMode_GetMaxComMode_UR_PNC_42_Diagnosis_FlexRay_f6dcf44d: RteEventRef=OpEventGetMaxComMode_GetMaxComMode_UR_PNC_42_Diagnosis_FlexRay_f6dcf44d
          OpEventGetMaxComMode_GetMaxComMode_UR_PNC_43_Diagnosis_DrivingAssistance_84f09039: RteEventRef=OpEventGetMaxComMode_GetMaxComMode_UR_PNC_43_Diagnosis_DrivingAssistance_84f09039
          OpEventGetMaxComMode_GetMaxComMode_UR_PNC_44_Diagnosis_Infotainment_3909218a: RteEventRef=OpEventGetMaxComMode_GetMaxComMode_UR_PNC_44_Diagnosis_Infotainment_3909218a
          OpEventGetMaxComMode_GetMaxComMode_UR_PNC_45_Diagnosis_Comfort_7eea372a: RteEventRef=OpEventGetMaxComMode_GetMaxComMode_UR_PNC_45_Diagnosis_Comfort_7eea372a
          OpEventGetMaxComMode_GetMaxComMode_UR_PNC_46_Diagnosis_Light_5140c135: RteEventRef=OpEventGetMaxComMode_GetMaxComMode_UR_PNC_46_Diagnosis_Light_5140c135
          OpEventGetMaxComMode_GetMaxComMode_UR_PNC_47_Diagnosis_ComfortLINs_70cf0372: RteEventRef=OpEventGetMaxComMode_GetMaxComMode_UR_PNC_47_Diagnosis_ComfortLINs_70cf0372
          OpEventGetMaxComMode_GetMaxComMode_UR_PNC_48_Diagnosis_ClimateTmeLINs_b4c40b49: RteEventRef=OpEventGetMaxComMode_GetMaxComMode_UR_PNC_48_Diagnosis_ClimateTmeLINs_b4c40b49
          OpEventGetMaxComMode_GetMaxComMode_UR_PNC_53_Lock_Unlock_bfb0b2ca: RteEventRef=OpEventGetMaxComMode_GetMaxComMode_UR_PNC_53_Lock_Unlock_bfb0b2ca
          OpEventGetMaxComMode_GetMaxComMode_UR_PNC_55_Dimming_4909a14c: RteEventRef=OpEventGetMaxComMode_GetMaxComMode_UR_PNC_55_Dimming_4909a14c
          OpEventGetMaxComMode_GetMaxComMode_UR_PNC_56_Charging_Status_cad5dfb4: RteEventRef=OpEventGetMaxComMode_GetMaxComMode_UR_PNC_56_Charging_Status_cad5dfb4
          OpEventGetRequestedComMode_GetRequestedComMode_UR_CN_BMC_CAN01_908d0059: RteEventRef=OpEventGetRequestedComMode_GetRequestedComMode_UR_CN_BMC_CAN01_908d0059
          OpEventGetRequestedComMode_GetRequestedComMode_UR_CN_HCP5_CANFD01_84d44928: RteEventRef=OpEventGetRequestedComMode_GetRequestedComMode_UR_CN_HCP5_CANFD01_84d44928
          OpEventGetRequestedComMode_GetRequestedComMode_UR_PNC_01_CarWakeUp_bf3ce487: RteEventRef=OpEventGetRequestedComMode_GetRequestedComMode_UR_PNC_01_CarWakeUp_bf3ce487
          OpEventGetRequestedComMode_GetRequestedComMode_UR_PNC_02_Basefunction_Powertrain_6e8e3f0b: RteEventRef=OpEventGetRequestedComMode_GetRequestedComMode_UR_PNC_02_Basefunction_Powertrain_6e8e3f0b
          OpEventGetRequestedComMode_GetRequestedComMode_UR_PNC_03_Basefunction_Chassis_74381a7a: RteEventRef=OpEventGetRequestedComMode_GetRequestedComMode_UR_PNC_03_Basefunction_Chassis_74381a7a
          OpEventGetRequestedComMode_GetRequestedComMode_UR_PNC_04_Basefunction_DrivingAssistance_2e755e80: RteEventRef=OpEventGetRequestedComMode_GetRequestedComMode_UR_PNC_04_Basefunction_DrivingAssistance_2e755e80
          OpEventGetRequestedComMode_GetRequestedComMode_UR_PNC_05_Basefunction_Infotainment_d739ca28: RteEventRef=OpEventGetRequestedComMode_GetRequestedComMode_UR_PNC_05_Basefunction_Infotainment_d739ca28
          OpEventGetRequestedComMode_GetRequestedComMode_UR_PNC_06_Basefunction_ComfortLight_8074acb0: RteEventRef=OpEventGetRequestedComMode_GetRequestedComMode_UR_PNC_06_Basefunction_ComfortLight_8074acb0
          OpEventGetRequestedComMode_GetRequestedComMode_UR_PNC_07_Basefunction_CrossSection_5c9febde: RteEventRef=OpEventGetRequestedComMode_GetRequestedComMode_UR_PNC_07_Basefunction_CrossSection_5c9febde
          OpEventGetRequestedComMode_GetRequestedComMode_UR_PNC_08_Basefunction_Connectivity_33115909: RteEventRef=OpEventGetRequestedComMode_GetRequestedComMode_UR_PNC_08_Basefunction_Connectivity_33115909
          OpEventGetRequestedComMode_GetRequestedComMode_UR_PNC_10_Powertrain_5fe7c550: RteEventRef=OpEventGetRequestedComMode_GetRequestedComMode_UR_PNC_10_Powertrain_5fe7c550
          OpEventGetRequestedComMode_GetRequestedComMode_UR_PNC_11_Chassis_fd87aaa6: RteEventRef=OpEventGetRequestedComMode_GetRequestedComMode_UR_PNC_11_Chassis_fd87aaa6
          OpEventGetRequestedComMode_GetRequestedComMode_UR_PNC_12_GearSelector_2aa5ddd0: RteEventRef=OpEventGetRequestedComMode_GetRequestedComMode_UR_PNC_12_GearSelector_2aa5ddd0
          OpEventGetRequestedComMode_GetRequestedComMode_UR_PNC_13_Airbag_2554061c: RteEventRef=OpEventGetRequestedComMode_GetRequestedComMode_UR_PNC_13_Airbag_2554061c
          OpEventGetRequestedComMode_GetRequestedComMode_UR_PNC_14_InfotainmentExtensions_d7c4346a: RteEventRef=OpEventGetRequestedComMode_GetRequestedComMode_UR_PNC_14_InfotainmentExtensions_d7c4346a
          OpEventGetRequestedComMode_GetRequestedComMode_UR_PNC_15_InstrumentclusterDisplay_1a610817: RteEventRef=OpEventGetRequestedComMode_GetRequestedComMode_UR_PNC_15_InstrumentclusterDisplay_1a610817
          OpEventGetRequestedComMode_GetRequestedComMode_UR_PNC_16_InfotainmentDisplay_1d18259d: RteEventRef=OpEventGetRequestedComMode_GetRequestedComMode_UR_PNC_16_InfotainmentDisplay_1d18259d
          OpEventGetRequestedComMode_GetRequestedComMode_UR_PNC_17_Audio_d11279f4: RteEventRef=OpEventGetRequestedComMode_GetRequestedComMode_UR_PNC_17_Audio_d11279f4
          OpEventGetRequestedComMode_GetRequestedComMode_UR_PNC_18_VirtualSideMirrors_dca4d4b3: RteEventRef=OpEventGetRequestedComMode_GetRequestedComMode_UR_PNC_18_VirtualSideMirrors_dca4d4b3
          OpEventGetRequestedComMode_GetRequestedComMode_UR_PNC_19_Doors_Hatches_58052c40: RteEventRef=OpEventGetRequestedComMode_GetRequestedComMode_UR_PNC_19_Doors_Hatches_58052c40
          OpEventGetRequestedComMode_GetRequestedComMode_UR_PNC_20_OptionalComfort_76e30655: RteEventRef=OpEventGetRequestedComMode_GetRequestedComMode_UR_PNC_20_OptionalComfort_76e30655
          OpEventGetRequestedComMode_GetRequestedComMode_UR_PNC_21_AirSuspension_3e4d6d03: RteEventRef=OpEventGetRequestedComMode_GetRequestedComMode_UR_PNC_21_AirSuspension_3e4d6d03
          OpEventGetRequestedComMode_GetRequestedComMode_UR_PNC_22_ExteriorLights_3bdfbcd3: RteEventRef=OpEventGetRequestedComMode_GetRequestedComMode_UR_PNC_22_ExteriorLights_3bdfbcd3
          OpEventGetRequestedComMode_GetRequestedComMode_UR_PNC_23_Climate_69d3b4ed: RteEventRef=OpEventGetRequestedComMode_GetRequestedComMode_UR_PNC_23_Climate_69d3b4ed
          OpEventGetRequestedComMode_GetRequestedComMode_UR_PNC_24_ThermoManagement_31b4f0b3: RteEventRef=OpEventGetRequestedComMode_GetRequestedComMode_UR_PNC_24_ThermoManagement_31b4f0b3
          OpEventGetRequestedComMode_GetRequestedComMode_UR_PNC_25_AccessSystemSensors_863389c2: RteEventRef=OpEventGetRequestedComMode_GetRequestedComMode_UR_PNC_25_AccessSystemSensors_863389c2
          OpEventGetRequestedComMode_GetRequestedComMode_UR_PNC_26_HighVoltage_Charging_c00f85a2: RteEventRef=OpEventGetRequestedComMode_GetRequestedComMode_UR_PNC_26_HighVoltage_Charging_c00f85a2
          OpEventGetRequestedComMode_GetRequestedComMode_UR_PNC_27_Timemaster_Timer_53539b48: RteEventRef=OpEventGetRequestedComMode_GetRequestedComMode_UR_PNC_27_Timemaster_Timer_53539b48
          OpEventGetRequestedComMode_GetRequestedComMode_UR_PNC_28_OnboardTester_DataCollector_c7d92e04: RteEventRef=OpEventGetRequestedComMode_GetRequestedComMode_UR_PNC_28_OnboardTester_DataCollector_c7d92e04
          OpEventGetRequestedComMode_GetRequestedComMode_UR_PNC_29_SteeringColumnLock_44a1738d: RteEventRef=OpEventGetRequestedComMode_GetRequestedComMode_UR_PNC_29_SteeringColumnLock_44a1738d
          OpEventGetRequestedComMode_GetRequestedComMode_UR_PNC_30_EnergyManagement_82f39188: RteEventRef=OpEventGetRequestedComMode_GetRequestedComMode_UR_PNC_30_EnergyManagement_82f39188
          OpEventGetRequestedComMode_GetRequestedComMode_UR_PNC_31_MultifunctionalSteeringWheel_48e6d667: RteEventRef=OpEventGetRequestedComMode_GetRequestedComMode_UR_PNC_31_MultifunctionalSteeringWheel_48e6d667
          OpEventGetRequestedComMode_GetRequestedComMode_UR_PNC_32_OnlineAccess_c5b851bc: RteEventRef=OpEventGetRequestedComMode_GetRequestedComMode_UR_PNC_32_OnlineAccess_c5b851bc
          OpEventGetRequestedComMode_GetRequestedComMode_UR_PNC_33_ExternalWirelessCommunication_779a8708: RteEventRef=OpEventGetRequestedComMode_GetRequestedComMode_UR_PNC_33_ExternalWirelessCommunication_779a8708
          OpEventGetRequestedComMode_GetRequestedComMode_UR_PNC_34_GPS_Lokalization_72b0f580: RteEventRef=OpEventGetRequestedComMode_GetRequestedComMode_UR_PNC_34_GPS_Lokalization_72b0f580
          OpEventGetRequestedComMode_GetRequestedComMode_UR_PNC_35_ExteriorSound_9764238b: RteEventRef=OpEventGetRequestedComMode_GetRequestedComMode_UR_PNC_35_ExteriorSound_9764238b
          OpEventGetRequestedComMode_GetRequestedComMode_UR_PNC_36_Preheater_5e289989: RteEventRef=OpEventGetRequestedComMode_GetRequestedComMode_UR_PNC_36_Preheater_5e289989
          OpEventGetRequestedComMode_GetRequestedComMode_UR_PNC_37_HighVoltage_WirelessChargingStation_f111c76f: RteEventRef=OpEventGetRequestedComMode_GetRequestedComMode_UR_PNC_37_HighVoltage_WirelessChargingStation_f111c76f
          OpEventGetRequestedComMode_GetRequestedComMode_UR_PNC_40_Diagnosis_Energy_532c6fb4: RteEventRef=OpEventGetRequestedComMode_GetRequestedComMode_UR_PNC_40_Diagnosis_Energy_532c6fb4
          OpEventGetRequestedComMode_GetRequestedComMode_UR_PNC_41_Diagnosis_Powertrain_0ac6ac8b: RteEventRef=OpEventGetRequestedComMode_GetRequestedComMode_UR_PNC_41_Diagnosis_Powertrain_0ac6ac8b
          OpEventGetRequestedComMode_GetRequestedComMode_UR_PNC_42_Diagnosis_FlexRay_f6dcf44d: RteEventRef=OpEventGetRequestedComMode_GetRequestedComMode_UR_PNC_42_Diagnosis_FlexRay_f6dcf44d
          OpEventGetRequestedComMode_GetRequestedComMode_UR_PNC_43_Diagnosis_DrivingAssistance_84f09039: RteEventRef=OpEventGetRequestedComMode_GetRequestedComMode_UR_PNC_43_Diagnosis_DrivingAssistance_84f09039
          OpEventGetRequestedComMode_GetRequestedComMode_UR_PNC_44_Diagnosis_Infotainment_3909218a: RteEventRef=OpEventGetRequestedComMode_GetRequestedComMode_UR_PNC_44_Diagnosis_Infotainment_3909218a
          OpEventGetRequestedComMode_GetRequestedComMode_UR_PNC_45_Diagnosis_Comfort_7eea372a: RteEventRef=OpEventGetRequestedComMode_GetRequestedComMode_UR_PNC_45_Diagnosis_Comfort_7eea372a
          OpEventGetRequestedComMode_GetRequestedComMode_UR_PNC_46_Diagnosis_Light_5140c135: RteEventRef=OpEventGetRequestedComMode_GetRequestedComMode_UR_PNC_46_Diagnosis_Light_5140c135
          OpEventGetRequestedComMode_GetRequestedComMode_UR_PNC_47_Diagnosis_ComfortLINs_70cf0372: RteEventRef=OpEventGetRequestedComMode_GetRequestedComMode_UR_PNC_47_Diagnosis_ComfortLINs_70cf0372
          OpEventGetRequestedComMode_GetRequestedComMode_UR_PNC_48_Diagnosis_ClimateTmeLINs_b4c40b49: RteEventRef=OpEventGetRequestedComMode_GetRequestedComMode_UR_PNC_48_Diagnosis_ClimateTmeLINs_b4c40b49
          OpEventGetRequestedComMode_GetRequestedComMode_UR_PNC_53_Lock_Unlock_bfb0b2ca: RteEventRef=OpEventGetRequestedComMode_GetRequestedComMode_UR_PNC_53_Lock_Unlock_bfb0b2ca
          OpEventGetRequestedComMode_GetRequestedComMode_UR_PNC_55_Dimming_4909a14c: RteEventRef=OpEventGetRequestedComMode_GetRequestedComMode_UR_PNC_55_Dimming_4909a14c
          OpEventGetRequestedComMode_GetRequestedComMode_UR_PNC_56_Charging_Status_cad5dfb4: RteEventRef=OpEventGetRequestedComMode_GetRequestedComMode_UR_PNC_56_Charging_Status_cad5dfb4
      DemMaster_0_EcuSwComposition: RteSoftwareComponentInstanceRef=DemMaster_0
        24 x RteEventToTaskMapping, all with RteImmediateRestart=false:
          Timer_Dem_MasterMainFunction: RtePositionInTask=19, RteEventRef=Timer_Dem_MasterMainFunction, RteMappedToTaskRef=Default_BSW_Async_Task, RteUsedOsEventRef=Rte_Ev_Cyclic2_Default_BSW_Async_Task_0_10ms, RteUsedOsAlarmRef=Rte_Al_TE2_Default_BSW_Async_Task_0_10ms
          OpEventPostRunRequested_GetPostRunRequested_DemServices: RteEventRef=OpEventPostRunRequested_GetPostRunRequested_DemServices
          OpEventGetDTCStatusAvailabilityMask_GetDTCStatusAvailabilityMask_DemServices: RteEventRef=OpEventGetDTCStatusAvailabilityMask_GetDTCStatusAvailabilityMask_DemServices
          OpEventGetOperationCycleState_GetOperationCycleState_OpCycle_PowerCycle: RteEventRef=OpEventGetOperationCycleState_GetOperationCycleState_OpCycle_PowerCycle
          OpEventSetOperationCycleState_SetOperationCycleState_OpCycle_PowerCycle: RteEventRef=OpEventSetOperationCycleState_SetOperationCycleState_OpCycle_PowerCycle
          OpEventGetNumberOfEventMemoryEntries_GetNumberOfEventMemoryEntries_OverflowIndPrimaryMemory_DemClient_DCM: RteEventRef=OpEventGetNumberOfEventMemoryEntries_GetNumberOfEventMemoryEntries_OverflowIndPrimaryMemory_DemClient_DCM
          OpEventGetEventMemoryOverflow_GetEventMemoryOverflow_OverflowIndPrimaryMemory_DemClient_DCM: RteEventRef=OpEventGetEventMemoryOverflow_GetEventMemoryOverflow_OverflowIndPrimaryMemory_DemClient_DCM
          OpEventClearDTC_ClearDTC_ClearDTC_DemClient_DCM: RteEventRef=OpEventClearDTC_ClearDTC_ClearDTC_DemClient_DCM
          OpEventSelectDTC_SelectDTC_ClearDTC_DemClient_DCM: RteEventRef=OpEventSelectDTC_SelectDTC_ClearDTC_DemClient_DCM
          OpEventGetEventEnableCondition_GetEventEnableCondition_GeneralEvtInfo: RteEventRef=OpEventGetEventEnableCondition_GetEventEnableCondition_GeneralEvtInfo
          OpEventGetDTCOfEvent_GetDTCOfEvent_GeneralEvtInfo: RteEventRef=OpEventGetDTCOfEvent_GetDTCOfEvent_GeneralEvtInfo
          OpEventGetEventUdsStatus_GetEventUdsStatus_GeneralEvtInfo: RteEventRef=OpEventGetEventUdsStatus_GetEventUdsStatus_GeneralEvtInfo
          OpEventGetEventFailed_GetEventFailed_GeneralEvtInfo: RteEventRef=OpEventGetEventFailed_GetEventFailed_GeneralEvtInfo
          OpEventGetEventStatus_GetEventStatus_GeneralEvtInfo: RteEventRef=OpEventGetEventStatus_GetEventStatus_GeneralEvtInfo
          OpEventGetEventTested_GetEventTested_GeneralEvtInfo: RteEventRef=OpEventGetEventTested_GetEventTested_GeneralEvtInfo
          OpEventGetMonitorStatus_GetMonitorStatus_GeneralEvtInfo: RteEventRef=OpEventGetMonitorStatus_GetMonitorStatus_GeneralEvtInfo
          OpEventGetEventExtendedDataRecordEx_GetEventExtendedDataRecordEx_GeneralEvtInfo: RteEventRef=OpEventGetEventExtendedDataRecordEx_GetEventExtendedDataRecordEx_GeneralEvtInfo
          OpEventGetEventFreezeFrameDataEx_GetEventFreezeFrameDataEx_GeneralEvtInfo: RteEventRef=OpEventGetEventFreezeFrameDataEx_GetEventFreezeFrameDataEx_GeneralEvtInfo
          OpEventGetDebouncingOfEvent_GetDebouncingOfEvent_GeneralEvtInfo: RteEventRef=OpEventGetDebouncingOfEvent_GetDebouncingOfEvent_GeneralEvtInfo
          OpEventGetFaultDetectionCounter_GetFaultDetectionCounter_GeneralEvtInfo: RteEventRef=OpEventGetFaultDetectionCounter_GetFaultDetectionCounter_GeneralEvtInfo
          OpEventGetOperationCycleState_GetOperationCycleState_OpCycle_RT_Test_OpCycle: RteEventRef=OpEventGetOperationCycleState_GetOperationCycleState_OpCycle_RT_Test_OpCycle
          OpEventSetOperationCycleState_SetOperationCycleState_OpCycle_RT_Test_OpCycle: RteEventRef=OpEventSetOperationCycleState_SetOperationCycleState_OpCycle_RT_Test_OpCycle
          OpEventSetDTCSuppression_SetDTCSuppression_ControlDTCSuppression_DemClient_DCM: RteEventRef=OpEventSetDTCSuppression_SetDTCSuppression_ControlDTCSuppression_DemClient_DCM
          OpEventGetDTCSuppression_GetDTCSuppression_ControlDTCSuppression_DemClient_DCM: RteEventRef=OpEventGetDTCSuppression_GetDTCSuppression_ControlDTCSuppression_DemClient_DCM
      SecOC_EcuSwComposition: RteSoftwareComponentInstanceRef=SecOC
        3 x RteEventToTaskMapping, all with RteImmediateRestart=false:
          Timer_SecOC_MainFunctionRx: RtePositionInTask=4, RteEventRef=Timer_SecOC_MainFunctionRx, RteMappedToTaskRef=Default_BSW_Sync_Task, RteUsedOsAlarmRef=Rte_Al_TE2_Default_BSW_Sync_Task_0_5ms
          Timer_SecOC_MainFunctionTx: RtePositionInTask=7, RteEventRef=Timer_SecOC_MainFunctionTx, RteMappedToTaskRef=Default_BSW_Sync_Task, RteUsedOsAlarmRef=Rte_Al_TE2_Default_BSW_Sync_Task_0_5ms
          OpEventVerifyStatusOverride_VerifyStatusOverride_VerifyStatusConfiguration: RteEventRef=OpEventVerifyStatusOverride_VerifyStatusOverride_VerifyStatusConfiguration
      Csm_EcuSwComposition: RteSoftwareComponentInstanceRef=Csm
        61 x RteEventToTaskMapping, all with RteImmediateRestart=false:
          OpEventKeyElementSet_KeyElementSet_StartApplication_CsmKey: RteEventRef=OpEventKeyElementSet_KeyElementSet_StartApplication_CsmKey
          OpEventKeySetValid_KeySetValid_StartApplication_CsmKey: RteEventRef=OpEventKeySetValid_KeySetValid_StartApplication_CsmKey
          Timer_Csm_MainFunction: RtePositionInTask=24, RteEventRef=Timer_Csm_MainFunction, RteMappedToTaskRef=Default_BSW_Async_Task, RteUsedOsEventRef=Rte_Ev_Cyclic2_Default_BSW_Async_Task_0_2ms, RteUsedOsAlarmRef=Rte_Al_TE2_Default_BSW_Async_Task_0_2ms
          OpEventRandomSeed_RandomSeed_StartApplication_CsmKey: RteEventRef=OpEventRandomSeed_RandomSeed_StartApplication_CsmKey
          OpEventKeyElementCopyPartial_KeyElementCopyPartial_StartApplication_CsmKey: RteEventRef=OpEventKeyElementCopyPartial_KeyElementCopyPartial_StartApplication_CsmKey
          OpEventKeyGenerate43x_KeyGenerate_StartApplication_CsmKey: RteEventRef=OpEventKeyGenerate43x_KeyGenerate_StartApplication_CsmKey
          OpEventKeyExchangeCalcSecret43x_KeyExchangeCalcSecret_StartApplication_CsmKey: RteEventRef=OpEventKeyExchangeCalcSecret43x_KeyExchangeCalcSecret_StartApplication_CsmKey
          OpEventKeyElementGet43x_KeyElementGet_StartApplication_CsmKey: RteEventRef=OpEventKeyElementGet43x_KeyElementGet_StartApplication_CsmKey
          OpEventKeyElementCopy43x_KeyElementCopy_StartApplication_CsmKey: RteEventRef=OpEventKeyElementCopy43x_KeyElementCopy_StartApplication_CsmKey
          OpEventCertificateVerify43x_CertificateVerify_StartApplication_CsmKey: RteEventRef=OpEventCertificateVerify43x_CertificateVerify_StartApplication_CsmKey
          OpEventKeyDerive43x_KeyDerive_StartApplication_CsmKey: RteEventRef=OpEventKeyDerive43x_KeyDerive_StartApplication_CsmKey
          OpEventCertificateParse43x_CertificateParse_StartApplication_CsmKey: RteEventRef=OpEventCertificateParse43x_CertificateParse_StartApplication_CsmKey
          OpEventKeyCopy43x_KeyCopy_StartApplication_CsmKey: RteEventRef=OpEventKeyCopy43x_KeyCopy_StartApplication_CsmKey
          OpEventKeyExchangeCalcPubVal43x_KeyExchangeCalcPubVal_StartApplication_CsmKey: RteEventRef=OpEventKeyExchangeCalcPubVal43x_KeyExchangeCalcPubVal_StartApplication_CsmKey
          OpEventKeyGenerate43x_KeyGenerate_StartApplication_CsmKey_Enc: RteEventRef=OpEventKeyGenerate43x_KeyGenerate_StartApplication_CsmKey_Enc
          OpEventKeyGenerate43x_KeyGenerate_StartApplication_CsmKey_Dec: RteEventRef=OpEventKeyGenerate43x_KeyGenerate_StartApplication_CsmKey_Dec
          OpEventKeyGenerate43x_KeyGenerate_StartApplication_CsmKey_MAC: RteEventRef=OpEventKeyGenerate43x_KeyGenerate_StartApplication_CsmKey_MAC
          OpEventKeyElementSet_KeyElementSet_StartApplication_CsmKey_Dec: RteEventRef=OpEventKeyElementSet_KeyElementSet_StartApplication_CsmKey_Dec
          OpEventKeyElementSet_KeyElementSet_StartApplication_CsmKey_Enc: RteEventRef=OpEventKeyElementSet_KeyElementSet_StartApplication_CsmKey_Enc
          OpEventKeyElementSet_KeyElementSet_StartApplication_CsmKey_MAC: RteEventRef=OpEventKeyElementSet_KeyElementSet_StartApplication_CsmKey_MAC
          OpEventCertificateVerify43x_CertificateVerify_StartApplication_CsmKey_Enc: RteEventRef=OpEventCertificateVerify43x_CertificateVerify_StartApplication_CsmKey_Enc
          OpEventCertificateVerify43x_CertificateVerify_StartApplication_CsmKey_MAC: RteEventRef=OpEventCertificateVerify43x_CertificateVerify_StartApplication_CsmKey_MAC
          OpEventCertificateVerify43x_CertificateVerify_StartApplication_CsmKey_Dec: RteEventRef=OpEventCertificateVerify43x_CertificateVerify_StartApplication_CsmKey_Dec
          OpEventMacVerify43x_MacVerify_StartApplication_MAC_Verify_MacVerify: RteEventRef=OpEventMacVerify43x_MacVerify_StartApplication_MAC_Verify_MacVerify
          OpEventKeyElementCopy43x_KeyElementCopy_StartApplication_CsmKey_MAC: RteEventRef=OpEventKeyElementCopy43x_KeyElementCopy_StartApplication_CsmKey_MAC
          OpEventKeyElementCopy43x_KeyElementCopy_StartApplication_CsmKey_Dec: RteEventRef=OpEventKeyElementCopy43x_KeyElementCopy_StartApplication_CsmKey_Dec
          OpEventKeyElementCopy43x_KeyElementCopy_StartApplication_CsmKey_Enc: RteEventRef=OpEventKeyElementCopy43x_KeyElementCopy_StartApplication_CsmKey_Enc
          OpEventCancelJob43x_CancelJob_StartApplication_MAC_Verify_MacVerify: RteEventRef=OpEventCancelJob43x_CancelJob_StartApplication_MAC_Verify_MacVerify
          OpEventCancelJob43x_CancelJob_StartApplication_MAC_Generate_MacGenerate: RteEventRef=OpEventCancelJob43x_CancelJob_StartApplication_MAC_Generate_MacGenerate
          OpEventKeyElementGet43x_KeyElementGet_StartApplication_CsmKey_MAC: RteEventRef=OpEventKeyElementGet43x_KeyElementGet_StartApplication_CsmKey_MAC
          OpEventKeyElementGet43x_KeyElementGet_StartApplication_CsmKey_Dec: RteEventRef=OpEventKeyElementGet43x_KeyElementGet_StartApplication_CsmKey_Dec
          OpEventKeyElementGet43x_KeyElementGet_StartApplication_CsmKey_Enc: RteEventRef=OpEventKeyElementGet43x_KeyElementGet_StartApplication_CsmKey_Enc
          OpEventRandomSeed_RandomSeed_StartApplication_CsmKey_Enc: RteEventRef=OpEventRandomSeed_RandomSeed_StartApplication_CsmKey_Enc
          OpEventRandomSeed_RandomSeed_StartApplication_CsmKey_MAC: RteEventRef=OpEventRandomSeed_RandomSeed_StartApplication_CsmKey_MAC
          OpEventRandomSeed_RandomSeed_StartApplication_CsmKey_Dec: RteEventRef=OpEventRandomSeed_RandomSeed_StartApplication_CsmKey_Dec
          OpEventKeyElementCopyPartial_KeyElementCopyPartial_StartApplication_CsmKey_MAC: RteEventRef=OpEventKeyElementCopyPartial_KeyElementCopyPartial_StartApplication_CsmKey_MAC
          OpEventKeyElementCopyPartial_KeyElementCopyPartial_StartApplication_CsmKey_Dec: RteEventRef=OpEventKeyElementCopyPartial_KeyElementCopyPartial_StartApplication_CsmKey_Dec
          OpEventKeyElementCopyPartial_KeyElementCopyPartial_StartApplication_CsmKey_Enc: RteEventRef=OpEventKeyElementCopyPartial_KeyElementCopyPartial_StartApplication_CsmKey_Enc
          OpEventCertificateParse43x_CertificateParse_StartApplication_CsmKey_MAC: RteEventRef=OpEventCertificateParse43x_CertificateParse_StartApplication_CsmKey_MAC
          OpEventCertificateParse43x_CertificateParse_StartApplication_CsmKey_Dec: RteEventRef=OpEventCertificateParse43x_CertificateParse_StartApplication_CsmKey_Dec
          OpEventCertificateParse43x_CertificateParse_StartApplication_CsmKey_Enc: RteEventRef=OpEventCertificateParse43x_CertificateParse_StartApplication_CsmKey_Enc
          OpEventKeyCopy43x_KeyCopy_StartApplication_CsmKey_Dec: RteEventRef=OpEventKeyCopy43x_KeyCopy_StartApplication_CsmKey_Dec
          OpEventKeyCopy43x_KeyCopy_StartApplication_CsmKey_Enc: RteEventRef=OpEventKeyCopy43x_KeyCopy_StartApplication_CsmKey_Enc
          OpEventKeyCopy43x_KeyCopy_StartApplication_CsmKey_MAC: RteEventRef=OpEventKeyCopy43x_KeyCopy_StartApplication_CsmKey_MAC
          OpEventKeyExchangeCalcPubVal43x_KeyExchangeCalcPubVal_StartApplication_CsmKey_Dec: RteEventRef=OpEventKeyExchangeCalcPubVal43x_KeyExchangeCalcPubVal_StartApplication_CsmKey_Dec
          OpEventKeyExchangeCalcPubVal43x_KeyExchangeCalcPubVal_StartApplication_CsmKey_MAC: RteEventRef=OpEventKeyExchangeCalcPubVal43x_KeyExchangeCalcPubVal_StartApplication_CsmKey_MAC
          OpEventKeyExchangeCalcPubVal43x_KeyExchangeCalcPubVal_StartApplication_CsmKey_Enc: RteEventRef=OpEventKeyExchangeCalcPubVal43x_KeyExchangeCalcPubVal_StartApplication_CsmKey_Enc
          OpEventKeyDerive43x_KeyDerive_StartApplication_CsmKey_Enc: RteEventRef=OpEventKeyDerive43x_KeyDerive_StartApplication_CsmKey_Enc
          OpEventKeyDerive43x_KeyDerive_StartApplication_CsmKey_Dec: RteEventRef=OpEventKeyDerive43x_KeyDerive_StartApplication_CsmKey_Dec
          OpEventKeyDerive43x_KeyDerive_StartApplication_CsmKey_MAC: RteEventRef=OpEventKeyDerive43x_KeyDerive_StartApplication_CsmKey_MAC
          OpEventKeySetValid_KeySetValid_StartApplication_CsmKey_Enc: RteEventRef=OpEventKeySetValid_KeySetValid_StartApplication_CsmKey_Enc
          OpEventKeySetValid_KeySetValid_StartApplication_CsmKey_MAC: RteEventRef=OpEventKeySetValid_KeySetValid_StartApplication_CsmKey_MAC
          OpEventKeySetValid_KeySetValid_StartApplication_CsmKey_Dec: RteEventRef=OpEventKeySetValid_KeySetValid_StartApplication_CsmKey_Dec
          OpEventEncrypt_Encrypt_StartApplication_ECB_AES_Encrypt_Encrypt: RteEventRef=OpEventEncrypt_Encrypt_StartApplication_ECB_AES_Encrypt_Encrypt
          OpEventCancelJob_CancelJob_StartApplication_ECB_AES_Encrypt_Encrypt: RteEventRef=OpEventCancelJob_CancelJob_StartApplication_ECB_AES_Encrypt_Encrypt
          OpEventCancelJob_CancelJob_StartApplication_ECB_AES_Decrypt_Decrypt: RteEventRef=OpEventCancelJob_CancelJob_StartApplication_ECB_AES_Decrypt_Decrypt
          OpEventKeyExchangeCalcSecret43x_KeyExchangeCalcSecret_StartApplication_CsmKey_Enc: RteEventRef=OpEventKeyExchangeCalcSecret43x_KeyExchangeCalcSecret_StartApplication_CsmKey_Enc
          OpEventKeyExchangeCalcSecret43x_KeyExchangeCalcSecret_StartApplication_CsmKey_Dec: RteEventRef=OpEventKeyExchangeCalcSecret43x_KeyExchangeCalcSecret_StartApplication_CsmKey_Dec
          OpEventKeyExchangeCalcSecret43x_KeyExchangeCalcSecret_StartApplication_CsmKey_MAC: RteEventRef=OpEventKeyExchangeCalcSecret43x_KeyExchangeCalcSecret_StartApplication_CsmKey_MAC
          OpEventMacGenerate43x_MacGenerate_StartApplication_MAC_Generate_MacGenerate: RteEventRef=OpEventMacGenerate43x_MacGenerate_StartApplication_MAC_Generate_MacGenerate
          OpEventDecrypt_Decrypt_StartApplication_ECB_AES_Decrypt_Decrypt: RteEventRef=OpEventDecrypt_Decrypt_StartApplication_ECB_AES_Decrypt_Decrypt
      DemSatellite_0_EcuSwComposition: RteSoftwareComponentInstanceRef=DemSatellite_0
        3147 x RteEventToTaskMapping, all with RteImmediateRestart=false:
          Timer_Dem_SatelliteMainFunction: RtePositionInTask=20, RteEventRef=Timer_Dem_SatelliteMainFunction, RteUsedOsEventRef=Rte_Ev_Cyclic2_Default_BSW_Async_Task_0_10ms, RteUsedOsAlarmRef=Rte_Al_TE2_Default_BSW_Async_Task_0_10ms, RteMappedToTaskRef=Default_BSW_Async_Task
          OpEventGetEventTested_GetEventTested_EvtInfo_AutoCreatedDemEvent_FLS_E_READ_FAILED: RteEventRef=OpEventGetEventTested_GetEventTested_EvtInfo_AutoCreatedDemEvent_FLS_E_READ_FAILED
          OpEventGetEventUdsStatus_GetEventUdsStatus_EvtInfo_AutoCreatedDemEvent_MyECU_6c1a0d52_FrDemCtrlTestResultRef: RteEventRef=OpEventGetEventUdsStatus_GetEventUdsStatus_EvtInfo_AutoCreatedDemEvent_MyECU_6c1a0d52_FrDemCtrlTestResultRef
          OpEventGetEventStatus_GetEventStatus_EvtInfo_AutoCreatedDemEvent_FLS_E_UNEXPECTED_FLASH_ID_1: RteEventRef=OpEventGetEventStatus_GetEventStatus_EvtInfo_AutoCreatedDemEvent_FLS_E_UNEXPECTED_FLASH_ID_1
          OpEventGetDTCOfEvent_GetDTCOfEvent_EvtInfo_AutoCreatedDemEvent_FLS_E_ERASE_FAILED_1: RteEventRef=OpEventGetDTCOfEvent_GetDTCOfEvent_EvtInfo_AutoCreatedDemEvent_FLS_E_ERASE_FAILED_1
          OpEventGetDTCOfEvent_GetDTCOfEvent_EvtInfo_AutoCreatedDemEvent_FLS_E_WRITE_FAILED_1: RteEventRef=OpEventGetDTCOfEvent_GetDTCOfEvent_EvtInfo_AutoCreatedDemEvent_FLS_E_WRITE_FAILED_1
          OpEventGetEventFreezeFrameDataEx_GetEventFreezeFrameDataEx_EvtInfo_AutoCreatedDemEvent_EEP_E_ERASE_FAILED: RteEventRef=OpEventGetEventFreezeFrameDataEx_GetEventFreezeFrameDataEx_EvtInfo_AutoCreatedDemEvent_EEP_E_ERASE_FAILED
          OpEventGetEventEnableCondition_GetEventEnableCondition_EvtInfo_AutoCreatedDemEvent_ECUM_E_CONFIGURATION_DATA_INCONSISTENT: RteEventRef=OpEventGetEventEnableCondition_GetEventEnableCondition_EvtInfo_AutoCreatedDemEvent_ECUM_E_CONFIGURATION_DATA_INCONSISTENT
          OpEventGetEventTested_GetEventTested_EvtInfo_AutoCreatedDemEvent_NVM_E_WRONG_BLOCK_ID: RteEventRef=OpEventGetEventTested_GetEventTested_EvtInfo_AutoCreatedDemEvent_NVM_E_WRONG_BLOCK_ID
          OpEventGetEventExtendedDataRecordEx_GetEventExtendedDataRecordEx_EvtInfo_AutoCreatedDemEvent_FLS_E_WRITE_FAILED: RteEventRef=OpEventGetEventExtendedDataRecordEx_GetEventExtendedDataRecordEx_EvtInfo_AutoCreatedDemEvent_FLS_E_WRITE_FAILED
          OpEventGetEventExtendedDataRecordEx_GetEventExtendedDataRecordEx_EvtInfo_AutoCreatedDemEvent_McuModuleConfiguration_MCU_e954d94f: RteEventRef=OpEventGetEventExtendedDataRecordEx_GetEventExtendedDataRecordEx_EvtInfo_AutoCreatedDemEvent_McuModuleConfiguration_MCU_e954d94f
          OpEventGetEventUdsStatus_GetEventUdsStatus_EvtInfo_AutoCreatedDemEvent_McuModuleConfiguration_MCU_E_CLOCK_FAILURE_1: RteEventRef=OpEventGetEventUdsStatus_GetEventUdsStatus_EvtInfo_AutoCreatedDemEvent_McuModuleConfiguration_MCU_E_CLOCK_FAILURE_1
          OpEventGetEventTested_GetEventTested_EvtInfo_AutoCreatedDemEvent_EEP_E_WRITE_FAILED: RteEventRef=OpEventGetEventTested_GetEventTested_EvtInfo_AutoCreatedDemEvent_EEP_E_WRITE_FAILED
          OpEventGetEventFailed_GetEventFailed_EvtInfo_AutoCreatedDemEvent_ECUM_E_IMPROPER_CALLER: RteEventRef=OpEventGetEventFailed_GetEventFailed_EvtInfo_AutoCreatedDemEvent_ECUM_E_IMPROPER_CALLER
          OpEventGetEventTested_GetEventTested_EvtInfo_AutoCreatedDemEvent_FLS_E_COMPARE_FAILED_1: RteEventRef=OpEventGetEventTested_GetEventTested_EvtInfo_AutoCreatedDemEvent_FLS_E_COMPARE_FAILED_1
          OpEventGetEventExtendedDataRecordEx_GetEventExtendedDataRecordEx_EvtInfo_AutoCreatedDemEvent_NVM_E_LOSS_OF_REDUNDANCY: RteEventRef=OpEventGetEventExtendedDataRecordEx_GetEventExtendedDataRecordEx_EvtInfo_AutoCreatedDemEvent_NVM_E_LOSS_OF_REDUNDANCY
          OpEventGetEventFreezeFrameDataEx_GetEventFreezeFrameDataEx_EvtInfo_AutoCreatedDemEvent_ECUM_E_IMPROPER_CALLER: RteEventRef=OpEventGetEventFreezeFrameDataEx_GetEventFreezeFrameDataEx_EvtInfo_AutoCreatedDemEvent_ECUM_E_IMPROPER_CALLER
          OpEventGetEventFailed_GetEventFailed_EvtInfo_AutoCreatedDemEvent_CHNL_346f2748_CANSM_E_BUS_OFF: RteEventRef=OpEventGetEventFailed_GetEventFailed_EvtInfo_AutoCreatedDemEvent_CHNL_346f2748_CANSM_E_BUS_OFF
          OpEventGetEventStatus_GetEventStatus_EvtInfo_AutoCreatedDemEvent_ECUM_E_CONFIGURATION_DATA_INCONSISTENT: RteEventRef=OpEventGetEventStatus_GetEventStatus_EvtInfo_AutoCreatedDemEvent_ECUM_E_CONFIGURATION_DATA_INCONSISTENT
          OpEventGetEventExtendedDataRecordEx_GetEventExtendedDataRecordEx_EvtInfo_AutoCreatedDemEvent_ECUM_E_IMPROPER_CALLER: RteEventRef=OpEventGetEventExtendedDataRecordEx_GetEventExtendedDataRecordEx_EvtInfo_AutoCreatedDemEvent_ECUM_E_IMPROPER_CALLER
          OpEventGetEventEnableCondition_GetEventEnableCondition_EvtInfo_AutoCreatedDemEvent_ECUM_E_IMPROPER_CALLER: RteEventRef=OpEventGetEventEnableCondition_GetEventEnableCondition_EvtInfo_AutoCreatedDemEvent_ECUM_E_IMPROPER_CALLER
          OpEventGetEventUdsStatus_GetEventUdsStatus_EvtInfo_AutoCreatedDemEvent_FLS_E_UNEXPECTED_FLASH_ID_1: RteEventRef=OpEventGetEventUdsStatus_GetEventUdsStatus_EvtInfo_AutoCreatedDemEvent_FLS_E_UNEXPECTED_FLASH_ID_1
          OpEventGetFaultDetectionCounter_GetFaultDetectionCounter_EvtInfo_AutoCreatedDemEvent_EEP_E_WRITE_FAILED: RteEventRef=OpEventGetFaultDetectionCounter_GetFaultDetectionCounter_EvtInfo_AutoCreatedDemEvent_EEP_E_WRITE_FAILED
          OpEventGetDebouncingOfEvent_GetDebouncingOfEvent_EvtInfo_AutoCreatedDemEvent_FLS_E_UNEXPECTED_FLASH_ID: RteEventRef=OpEventGetDebouncingOfEvent_GetDebouncingOfEvent_EvtInfo_AutoCreatedDemEvent_FLS_E_UNEXPECTED_FLASH_ID
          OpEventGetDebouncingOfEvent_GetDebouncingOfEvent_EvtInfo_AutoCreatedDemEvent_ECUM_E_IMPROPER_CALLER: RteEventRef=OpEventGetDebouncingOfEvent_GetDebouncingOfEvent_EvtInfo_AutoCreatedDemEvent_ECUM_E_IMPROPER_CALLER
          OpEventGetFaultDetectionCounter_GetFaultDetectionCounter_EvtInfo_AutoCreatedDemEvent_EEP_E_COMPARE_FAILED_1: RteEventRef=OpEventGetFaultDetectionCounter_GetFaultDetectionCounter_EvtInfo_AutoCreatedDemEvent_EEP_E_COMPARE_FAILED_1
          OpEventGetEventTested_GetEventTested_EvtInfo_AutoCreatedDemEvent_FLS_E_COMPARE_FAILED: RteEventRef=OpEventGetEventTested_GetEventTested_EvtInfo_AutoCreatedDemEvent_FLS_E_COMPARE_FAILED
          OpEventGetDebouncingOfEvent_GetDebouncingOfEvent_EvtInfo_AutoCreatedDemEvent_XCP_E_INIT_FAILED: RteEventRef=OpEventGetDebouncingOfEvent_GetDebouncingOfEvent_EvtInfo_AutoCreatedDemEvent_XCP_E_INIT_FAILED
          OpEventGetEventFailed_GetEventFailed_EvtInfo_AutoCreatedDemEvent_FLS_E_ERASE_FAILED_1: RteEventRef=OpEventGetEventFailed_GetEventFailed_EvtInfo_AutoCreatedDemEvent_FLS_E_ERASE_FAILED_1
          OpEventGetFaultDetectionCounter_GetFaultDetectionCounter_EvtInfo_AutoCreatedDemEvent_FLS_E_ERASE_FAILED: RteEventRef=OpEventGetFaultDetectionCounter_GetFaultDetectionCounter_EvtInfo_AutoCreatedDemEvent_FLS_E_ERASE_FAILED
          OpEventGetEventStatus_GetEventStatus_EvtInfo_AutoCreatedDemEvent_EEP_E_WRITE_FAILED_1: RteEventRef=OpEventGetEventStatus_GetEventStatus_EvtInfo_AutoCreatedDemEvent_EEP_E_WRITE_FAILED_1
          OpEventGetEventStatus_GetEventStatus_EvtInfo_AutoCreatedDemEvent_FLS_E_ERASE_FAILED: RteEventRef=OpEventGetEventStatus_GetEventStatus_EvtInfo_AutoCreatedDemEvent_FLS_E_ERASE_FAILED
          OpEventGetEventUdsStatus_GetEventUdsStatus_EvtInfo_AutoCreatedDemEvent_EEP_E_COMPARE_FAILED: RteEventRef=OpEventGetEventUdsStatus_GetEventUdsStatus_EvtInfo_AutoCreatedDemEvent_EEP_E_COMPARE_FAILED
          OpEventGetEventTested_GetEventTested_EvtInfo_AutoCreatedDemEvent_EEP_E_ERASE_FAILED_1: RteEventRef=OpEventGetEventTested_GetEventTested_EvtInfo_AutoCreatedDemEvent_EEP_E_ERASE_FAILED_1
          OpEventGetEventEnableCondition_GetEventEnableCondition_EvtInfo_AutoCreatedDemEvent_FLS_E_READ_FAILED: RteEventRef=OpEventGetEventEnableCondition_GetEventEnableCondition_EvtInfo_AutoCreatedDemEvent_FLS_E_READ_FAILED
          OpEventGetEventExtendedDataRecordEx_GetEventExtendedDataRecordEx_EvtInfo_AutoCreatedDemEvent_FLS_E_WRITE_FAILED_1: RteEventRef=OpEventGetEventExtendedDataRecordEx_GetEventExtendedDataRecordEx_EvtInfo_AutoCreatedDemEvent_FLS_E_WRITE_FAILED_1
          OpEventGetEventFreezeFrameDataEx_GetEventFreezeFrameDataEx_EvtInfo_AutoCreatedDemEvent_EEP_E_WRITE_FAILED_1: RteEventRef=OpEventGetEventFreezeFrameDataEx_GetEventFreezeFrameDataEx_EvtInfo_AutoCreatedDemEvent_EEP_E_WRITE_FAILED_1
          OpEventGetEventFailed_GetEventFailed_EvtInfo_AutoCreatedDemEvent_XFRM_E_MALFORMED_MESSAGE_1: RteEventRef=OpEventGetEventFailed_GetEventFailed_EvtInfo_AutoCreatedDemEvent_XFRM_E_MALFORMED_MESSAGE_1
          OpEventGetEventFreezeFrameDataEx_GetEventFreezeFrameDataEx_EvtInfo_AutoCreatedDemEvent_ECUM_E_ALL_RUN_REQUESTS_KILLED: RteEventRef=OpEventGetEventFreezeFrameDataEx_GetEventFreezeFrameDataEx_EvtInfo_AutoCreatedDemEvent_ECUM_E_ALL_RUN_REQUESTS_KILLED
          OpEventGetFaultDetectionCounter_GetFaultDetectionCounter_EvtInfo_AutoCreatedDemEvent_EEP_E_ERASE_FAILED_1: RteEventRef=OpEventGetFaultDetectionCounter_GetFaultDetectionCounter_EvtInfo_AutoCreatedDemEvent_EEP_E_ERASE_FAILED_1
          OpEventGetDTCOfEvent_GetDTCOfEvent_EvtInfo_AutoCreatedDemEvent_NVM_E_INTEGRITY_FAILED: RteEventRef=OpEventGetDTCOfEvent_GetDTCOfEvent_EvtInfo_AutoCreatedDemEvent_NVM_E_INTEGRITY_FAILED
          OpEventGetMonitorStatus_GetMonitorStatus_EvtInfo_AutoCreatedDemEvent_NVM_E_LOSS_OF_REDUNDANCY: RteEventRef=OpEventGetMonitorStatus_GetMonitorStatus_EvtInfo_AutoCreatedDemEvent_NVM_E_LOSS_OF_REDUNDANCY
          OpEventGetDebouncingOfEvent_GetDebouncingOfEvent_EvtInfo_AutoCreatedDemEvent_NVM_E_WRITE_PROTECTED: RteEventRef=OpEventGetDebouncingOfEvent_GetDebouncingOfEvent_EvtInfo_AutoCreatedDemEvent_NVM_E_WRITE_PROTECTED
          OpEventGetEventStatus_GetEventStatus_EvtInfo_AutoCreatedDemEvent_FLS_E_WRITE_FAILED_1: RteEventRef=OpEventGetEventStatus_GetEventStatus_EvtInfo_AutoCreatedDemEvent_FLS_E_WRITE_FAILED_1
          OpEventGetEventUdsStatus_GetEventUdsStatus_EvtInfo_AutoCreatedDemEvent_EEP_E_ERASE_FAILED_1: RteEventRef=OpEventGetEventUdsStatus_GetEventUdsStatus_EvtInfo_AutoCreatedDemEvent_EEP_E_ERASE_FAILED_1
          OpEventGetEventTested_GetEventTested_EvtInfo_AutoCreatedDemEvent_MyECU_6c1a0d52_FrDemCtrlTestResultRef_1: RteEventRef=OpEventGetEventTested_GetEventTested_EvtInfo_AutoCreatedDemEvent_MyECU_6c1a0d52_FrDemCtrlTestResultRef_1
          OpEventGetDTCOfEvent_GetDTCOfEvent_EvtInfo_AutoCreatedDemEvent_NVM_E_VERIFY_FAILED: RteEventRef=OpEventGetDTCOfEvent_GetDTCOfEvent_EvtInfo_AutoCreatedDemEvent_NVM_E_VERIFY_FAILED
          OpEventGetFaultDetectionCounter_GetFaultDetectionCounter_EvtInfo_AutoCreatedDemEvent_XFRM_E_MALFORMED_MESSAGE_1: RteEventRef=OpEventGetFaultDetectionCounter_GetFaultDetectionCounter_EvtInfo_AutoCreatedDemEvent_XFRM_E_MALFORMED_MESSAGE_1
          OpEventGetEventUdsStatus_GetEventUdsStatus_EvtInfo_AutoCreatedDemEvent_FLS_E_READ_FAILED_1: RteEventRef=OpEventGetEventUdsStatus_GetEventUdsStatus_EvtInfo_AutoCreatedDemEvent_FLS_E_READ_FAILED_1
          OpEventGetFaultDetectionCounter_GetFaultDetectionCounter_EvtInfo_AutoCreatedDemEvent_FLS_E_READ_FAILED_1: RteEventRef=OpEventGetFaultDetectionCounter_GetFaultDetectionCounter_EvtInfo_AutoCreatedDemEvent_FLS_E_READ_FAILED_1
          OpEventGetMonitorStatus_GetMonitorStatus_EvtInfo_AutoCreatedDemEvent_EEP_E_READ_FAILED: RteEventRef=OpEventGetMonitorStatus_GetMonitorStatus_EvtInfo_AutoCreatedDemEvent_EEP_E_READ_FAILED
          OpEventGetDTCOfEvent_GetDTCOfEvent_EvtInfo_AutoCreatedDemEvent_XFRM_E_MALFORMED_MESSAGE_2: RteEventRef=OpEventGetDTCOfEvent_GetDTCOfEvent_EvtInfo_AutoCreatedDemEvent_XFRM_E_MALFORMED_MESSAGE_2
          OpEventGetEventUdsStatus_GetEventUdsStatus_EvtInfo_AutoCreatedDemEvent_ECUM_E_ALL_RUN_REQUESTS_KILLED: RteEventRef=OpEventGetEventUdsStatus_GetEventUdsStatus_EvtInfo_AutoCreatedDemEvent_ECUM_E_ALL_RUN_REQUESTS_KILLED
          OpEventGetDTCOfEvent_GetDTCOfEvent_EvtInfo_AutoCreatedDemEvent_NVM_E_REQ_FAILED: RteEventRef=OpEventGetDTCOfEvent_GetDTCOfEvent_EvtInfo_AutoCreatedDemEvent_NVM_E_REQ_FAILED
          OpEventGetEventFailed_GetEventFailed_EvtInfo_AutoCreatedDemEvent_NVM_E_WRITE_PROTECTED: RteEventRef=OpEventGetEventFailed_GetEventFailed_EvtInfo_AutoCreatedDemEvent_NVM_E_WRITE_PROTECTED
          OpEventGetEventStatus_GetEventStatus_EvtInfo_AutoCreatedDemEvent_NVM_E_WRITE_PROTECTED: RteEventRef=OpEventGetEventStatus_GetEventStatus_EvtInfo_AutoCreatedDemEvent_NVM_E_WRITE_PROTECTED
          OpEventGetDebouncingOfEvent_GetDebouncingOfEvent_EvtInfo_AutoCreatedDemEvent_FLS_E_WRITE_FAILED_1: RteEventRef=OpEventGetDebouncingOfEvent_GetDebouncingOfEvent_EvtInfo_AutoCreatedDemEvent_FLS_E_WRITE_FAILED_1
          OpEventGetEventStatus_GetEventStatus_EvtInfo_AutoCreatedDemEvent_McuModuleConfiguration_MCU_E_CLOCK_FAILURE: RteEventRef=OpEventGetEventStatus_GetEventStatus_EvtInfo_AutoCreatedDemEvent_McuModuleConfiguration_MCU_E_CLOCK_FAILURE
          OpEventGetFaultDetectionCounter_GetFaultDetectionCounter_EvtInfo_AutoCreatedDemEvent_NVM_E_WRITE_PROTECTED: RteEventRef=OpEventGetFaultDetectionCounter_GetFaultDetectionCounter_EvtInfo_AutoCreatedDemEvent_NVM_E_WRITE_PROTECTED
          OpEventGetDTCOfEvent_GetDTCOfEvent_EvtInfo_AutoCreatedDemEvent_ECUM_E_CONFIGURATION_DATA_INCONSISTENT: RteEventRef=OpEventGetDTCOfEvent_GetDTCOfEvent_EvtInfo_AutoCreatedDemEvent_ECUM_E_CONFIGURATION_DATA_INCONSISTENT
          OpEventGetEventExtendedDataRecordEx_GetEventExtendedDataRecordEx_EvtInfo_AutoCreatedDemEvent_NVM_E_WRITE_PROTECTED: RteEventRef=OpEventGetEventExtendedDataRecordEx_GetEventExtendedDataRecordEx_EvtInfo_AutoCreatedDemEvent_NVM_E_WRITE_PROTECTED
          OpEventGetEventFreezeFrameDataEx_GetEventFreezeFrameDataEx_EvtInfo_AutoCreatedDemEvent_EEP_E_COMPARE_FAILED: RteEventRef=OpEventGetEventFreezeFrameDataEx_GetEventFreezeFrameDataEx_EvtInfo_AutoCreatedDemEvent_EEP_E_COMPARE_FAILED
          OpEventGetDTCOfEvent_GetDTCOfEvent_EvtInfo_AutoCreatedDemEvent_EEP_E_WRITE_FAILED: RteEventRef=OpEventGetDTCOfEvent_GetDTCOfEvent_EvtInfo_AutoCreatedDemEvent_EEP_E_WRITE_FAILED
          OpEventGetDebouncingOfEvent_GetDebouncingOfEvent_EvtInfo_AutoCreatedDemEvent_EEP_E_COMPARE_FAILED_1: RteEventRef=OpEventGetDebouncingOfEvent_GetDebouncingOfEvent_EvtInfo_AutoCreatedDemEvent_EEP_E_COMPARE_FAILED_1
          OpEventGetEventTested_GetEventTested_EvtInfo_AutoCreatedDemEvent_NVM_E_REQ_FAILED: RteEventRef=OpEventGetEventTested_GetEventTested_EvtInfo_AutoCreatedDemEvent_NVM_E_REQ_FAILED
          OpEventGetEventEnableCondition_GetEventEnableCondition_EvtInfo_AutoCreatedDemEvent_EEP_E_WRITE_FAILED_1: RteEventRef=OpEventGetEventEnableCondition_GetEventEnableCondition_EvtInfo_AutoCreatedDemEvent_EEP_E_WRITE_FAILED_1
          OpEventGetEventFreezeFrameDataEx_GetEventFreezeFrameDataEx_EvtInfo_AutoCreatedDemEvent_BswMConfig_BswMReportFailToDemRef: RteEventRef=OpEventGetEventFreezeFrameDataEx_GetEventFreezeFrameDataEx_EvtInfo_AutoCreatedDemEvent_BswMConfig_BswMReportFailToDemRef
          OpEventGetMonitorStatus_GetMonitorStatus_EvtInfo_AutoCreatedDemEvent_FLS_E_COMPARE_FAILED: RteEventRef=OpEventGetMonitorStatus_GetMonitorStatus_EvtInfo_AutoCreatedDemEvent_FLS_E_COMPARE_FAILED
          OpEventGetEventFailed_GetEventFailed_EvtInfo_AutoCreatedDemEvent_NVM_E_VERIFY_FAILED: RteEventRef=OpEventGetEventFailed_GetEventFailed_EvtInfo_AutoCreatedDemEvent_NVM_E_VERIFY_FAILED
          OpEventGetEventTested_GetEventTested_EvtInfo_AutoCreatedDemEvent_EEP_E_ERASE_FAILED: RteEventRef=OpEventGetEventTested_GetEventTested_EvtInfo_AutoCreatedDemEvent_EEP_E_ERASE_FAILED
          OpEventGetEventExtendedDataRecordEx_GetEventExtendedDataRecordEx_EvtInfo_AutoCreatedDemEvent_ECUM_E_RAM_CHECK_FAILED: RteEventRef=OpEventGetEventExtendedDataRecordEx_GetEventExtendedDataRecordEx_EvtInfo_AutoCreatedDemEvent_ECUM_E_RAM_CHECK_FAILED
          OpEventGetEventFreezeFrameDataEx_GetEventFreezeFrameDataEx_EvtInfo_AutoCreatedDemEvent_EEP_E_READ_FAILED: RteEventRef=OpEventGetEventFreezeFrameDataEx_GetEventFreezeFrameDataEx_EvtInfo_AutoCreatedDemEvent_EEP_E_READ_FAILED
          OpEventGetFaultDetectionCounter_GetFaultDetectionCounter_EvtInfo_AutoCreatedDemEvent_FLS_E_ERASE_FAILED_1: RteEventRef=OpEventGetFaultDetectionCounter_GetFaultDetectionCounter_EvtInfo_AutoCreatedDemEvent_FLS_E_ERASE_FAILED_1
          OpEventGetEventFreezeFrameDataEx_GetEventFreezeFrameDataEx_EvtInfo_AutoCreatedDemEvent_FLS_E_WRITE_FAILED: RteEventRef=OpEventGetEventFreezeFrameDataEx_GetEventFreezeFrameDataEx_EvtInfo_AutoCreatedDemEvent_FLS_E_WRITE_FAILED
          OpEventGetEventTested_GetEventTested_EvtInfo_AutoCreatedDemEvent_XFRM_E_MALFORMED_MESSAGE_1: RteEventRef=OpEventGetEventTested_GetEventTested_EvtInfo_AutoCreatedDemEvent_XFRM_E_MALFORMED_MESSAGE_1
          OpEventGetEventFailed_GetEventFailed_EvtInfo_AutoCreatedDemEvent_XFRM_E_MALFORMED_MESSAGE: RteEventRef=OpEventGetEventFailed_GetEventFailed_EvtInfo_AutoCreatedDemEvent_XFRM_E_MALFORMED_MESSAGE
          OpEventGetEventEnableCondition_GetEventEnableCondition_EvtInfo_AutoCreatedDemEvent_CHNL_346f2748_CANSM_E_BUS_OFF: RteEventRef=OpEventGetEventEnableCondition_GetEventEnableCondition_EvtInfo_AutoCreatedDemEvent_CHNL_346f2748_CANSM_E_BUS_OFF
          OpEventGetEventExtendedDataRecordEx_GetEventExtendedDataRecordEx_EvtInfo_AutoCreatedDemEvent_NVM_E_VERIFY_FAILED: RteEventRef=OpEventGetEventExtendedDataRecordEx_GetEventExtendedDataRecordEx_EvtInfo_AutoCreatedDemEvent_NVM_E_VERIFY_FAILED
          OpEventGetEventTested_GetEventTested_EvtInfo_AutoCreatedDemEvent_CHNL_346f2748_CANSM_E_BUS_OFF: RteEventRef=OpEventGetEventTested_GetEventTested_EvtInfo_AutoCreatedDemEvent_CHNL_346f2748_CANSM_E_BUS_OFF
          OpEventGetEventFreezeFrameDataEx_GetEventFreezeFrameDataEx_EvtInfo_AutoCreatedDemEvent_CHNL_346f2748_CANSM_E_MODE_REQUE_3803679d: RteEventRef=OpEventGetEventFreezeFrameDataEx_GetEventFreezeFrameDataEx_EvtInfo_AutoCreatedDemEvent_CHNL_346f2748_CANSM_E_MODE_REQUE_3803679d
          OpEventGetDTCOfEvent_GetDTCOfEvent_EvtInfo_AutoCreatedDemEvent_FLS_E_READ_FAILED_1: RteEventRef=OpEventGetDTCOfEvent_GetDTCOfEvent_EvtInfo_AutoCreatedDemEvent_FLS_E_READ_FAILED_1
          OpEventGetEventEnableCondition_GetEventEnableCondition_EvtInfo_AutoCreatedDemEvent_EEP_E_ERASE_FAILED_1: RteEventRef=OpEventGetEventEnableCondition_GetEventEnableCondition_EvtInfo_AutoCreatedDemEvent_EEP_E_ERASE_FAILED_1
          OpEventGetEventFreezeFrameDataEx_GetEventFreezeFrameDataEx_EvtInfo_AutoCreatedDemEvent_XFRM_E_MALFORMED_MESSAGE_1: RteEventRef=OpEventGetEventFreezeFrameDataEx_GetEventFreezeFrameDataEx_EvtInfo_AutoCreatedDemEvent_XFRM_E_MALFORMED_MESSAGE_1
          OpEventGetEventFreezeFrameDataEx_GetEventFreezeFrameDataEx_EvtInfo_AutoCreatedDemEvent_EEP_E_ERASE_FAILED_1: RteEventRef=OpEventGetEventFreezeFrameDataEx_GetEventFreezeFrameDataEx_EvtInfo_AutoCreatedDemEvent_EEP_E_ERASE_FAILED_1
          OpEventGetEventExtendedDataRecordEx_GetEventExtendedDataRecordEx_EvtInfo_AutoCreatedDemEvent_FLS_E_READ_FAILED: RteEventRef=OpEventGetEventExtendedDataRecordEx_GetEventExtendedDataRecordEx_EvtInfo_AutoCreatedDemEvent_FLS_E_READ_FAILED
          OpEventGetEventFailed_GetEventFailed_EvtInfo_AutoCreatedDemEvent_CHNL_346f2748_CANSM_E_MODE_REQUEST_TIMEOUT: RteEventRef=OpEventGetEventFailed_GetEventFailed_EvtInfo_AutoCreatedDemEvent_CHNL_346f2748_CANSM_E_MODE_REQUEST_TIMEOUT
          OpEventGetEventUdsStatus_GetEventUdsStatus_EvtInfo_AutoCreatedDemEvent_ECUM_E_RAM_CHECK_FAILED: RteEventRef=OpEventGetEventUdsStatus_GetEventUdsStatus_EvtInfo_AutoCreatedDemEvent_ECUM_E_RAM_CHECK_FAILED
          OpEventGetEventTested_GetEventTested_EvtInfo_AutoCreatedDemEvent_ECUM_E_ALL_RUN_REQUESTS_KILLED: RteEventRef=OpEventGetEventTested_GetEventTested_EvtInfo_AutoCreatedDemEvent_ECUM_E_ALL_RUN_REQUESTS_KILLED
          OpEventGetEventExtendedDataRecordEx_GetEventExtendedDataRecordEx_EvtInfo_AutoCreatedDemEvent_ECUM_E_CONFIGURATION_DATA_22f5ed01: RteEventRef=OpEventGetEventExtendedDataRecordEx_GetEventExtendedDataRecordEx_EvtInfo_AutoCreatedDemEvent_ECUM_E_CONFIGURATION_DATA_22f5ed01
          OpEventGetEventFailed_GetEventFailed_EvtInfo_AutoCreatedDemEvent_EEP_E_READ_FAILED: RteEventRef=OpEventGetEventFailed_GetEventFailed_EvtInfo_AutoCreatedDemEvent_EEP_E_READ_FAILED
          OpEventGetMonitorStatus_GetMonitorStatus_EvtInfo_AutoCreatedDemEvent_EEP_E_ERASE_FAILED_1: RteEventRef=OpEventGetMonitorStatus_GetMonitorStatus_EvtInfo_AutoCreatedDemEvent_EEP_E_ERASE_FAILED_1
          OpEventGetMonitorStatus_GetMonitorStatus_EvtInfo_AutoCreatedDemEvent_LIN_E_TIMEOUT: RteEventRef=OpEventGetMonitorStatus_GetMonitorStatus_EvtInfo_AutoCreatedDemEvent_LIN_E_TIMEOUT
          OpEventGetMonitorStatus_GetMonitorStatus_EvtInfo_AutoCreatedDemEvent_NVM_E_INTEGRITY_FAILED: RteEventRef=OpEventGetMonitorStatus_GetMonitorStatus_EvtInfo_AutoCreatedDemEvent_NVM_E_INTEGRITY_FAILED
          OpEventGetDebouncingOfEvent_GetDebouncingOfEvent_EvtInfo_AutoCreatedDemEvent_NVM_E_INTEGRITY_FAILED: RteEventRef=OpEventGetDebouncingOfEvent_GetDebouncingOfEvent_EvtInfo_AutoCreatedDemEvent_NVM_E_INTEGRITY_FAILED
          OpEventGetEventEnableCondition_GetEventEnableCondition_EvtInfo_AutoCreatedDemEvent_XFRM_E_MALFORMED_MESSAGE_1: RteEventRef=OpEventGetEventEnableCondition_GetEventEnableCondition_EvtInfo_AutoCreatedDemEvent_XFRM_E_MALFORMED_MESSAGE_1
          OpEventGetMonitorStatus_GetMonitorStatus_EvtInfo_AutoCreatedDemEvent_MyECU_6c1a0d52_FrDemCtrlTestResultRef: RteEventRef=OpEventGetMonitorStatus_GetMonitorStatus_EvtInfo_AutoCreatedDemEvent_MyECU_6c1a0d52_FrDemCtrlTestResultRef
          OpEventGetEventStatus_GetEventStatus_EvtInfo_AutoCreatedDemEvent_FLS_E_COMPARE_FAILED_1: RteEventRef=OpEventGetEventStatus_GetEventStatus_EvtInfo_AutoCreatedDemEvent_FLS_E_COMPARE_FAILED_1
          OpEventGetEventFreezeFrameDataEx_GetEventFreezeFrameDataEx_EvtInfo_AutoCreatedDemEvent_ECUM_E_RAM_CHECK_FAILED: RteEventRef=OpEventGetEventFreezeFrameDataEx_GetEventFreezeFrameDataEx_EvtInfo_AutoCreatedDemEvent_ECUM_E_RAM_CHECK_FAILED
          OpEventGetEventStatus_GetEventStatus_EvtInfo_AutoCreatedDemEvent_XCP_E_INIT_FAILED: RteEventRef=OpEventGetEventStatus_GetEventStatus_EvtInfo_AutoCreatedDemEvent_XCP_E_INIT_FAILED
          OpEventGetDebouncingOfEvent_GetDebouncingOfEvent_EvtInfo_AutoCreatedDemEvent_FLS_E_WRITE_FAILED: RteEventRef=OpEventGetDebouncingOfEvent_GetDebouncingOfEvent_EvtInfo_AutoCreatedDemEvent_FLS_E_WRITE_FAILED
          OpEventGetDTCOfEvent_GetDTCOfEvent_EvtInfo_AutoCreatedDemEvent_EEP_E_ERASE_FAILED_1: RteEventRef=OpEventGetDTCOfEvent_GetDTCOfEvent_EvtInfo_AutoCreatedDemEvent_EEP_E_ERASE_FAILED_1
          OpEventGetEventStatus_GetEventStatus_EvtInfo_AutoCreatedDemEvent_MyECU_6c1a0d52_FrDemCtrlTestResultRef: RteEventRef=OpEventGetEventStatus_GetEventStatus_EvtInfo_AutoCreatedDemEvent_MyECU_6c1a0d52_FrDemCtrlTestResultRef
          OpEventGetEventFreezeFrameDataEx_GetEventFreezeFrameDataEx_EvtInfo_AutoCreatedDemEvent_MyECU_6c1a0d52_FrDemCtrlTestResultRef_1: RteEventRef=OpEventGetEventFreezeFrameDataEx_GetEventFreezeFrameDataEx_EvtInfo_AutoCreatedDemEvent_MyECU_6c1a0d52_FrDemCtrlTestResultRef_1
          OpEventGetFaultDetectionCounter_GetFaultDetectionCounter_EvtInfo_AutoCreatedDemEvent_EEP_E_READ_FAILED_1: RteEventRef=OpEventGetFaultDetectionCounter_GetFaultDetectionCounter_EvtInfo_AutoCreatedDemEvent_EEP_E_READ_FAILED_1
          OpEventGetEventUdsStatus_GetEventUdsStatus_EvtInfo_AutoCreatedDemEvent_FLS_E_WRITE_FAILED_1: RteEventRef=OpEventGetEventUdsStatus_GetEventUdsStatus_EvtInfo_AutoCreatedDemEvent_FLS_E_WRITE_FAILED_1
          OpEventGetEventFailed_GetEventFailed_EvtInfo_AutoCreatedDemEvent_MyECU_6c1a0d52_FrDemCtrlTestResultRef_1: RteEventRef=OpEventGetEventFailed_GetEventFailed_EvtInfo_AutoCreatedDemEvent_MyECU_6c1a0d52_FrDemCtrlTestResultRef_1
          OpEventGetEventFailed_GetEventFailed_EvtInfo_AutoCreatedDemEvent_NVM_E_REQ_FAILED: RteEventRef=OpEventGetEventFailed_GetEventFailed_EvtInfo_AutoCreatedDemEvent_NVM_E_REQ_FAILED
          OpEventGetDTCOfEvent_GetDTCOfEvent_EvtInfo_AutoCreatedDemEvent_MyECU_6c1a0d52_FrDemCtrlTestResultRef_1: RteEventRef=OpEventGetDTCOfEvent_GetDTCOfEvent_EvtInfo_AutoCreatedDemEvent_MyECU_6c1a0d52_FrDemCtrlTestResultRef_1
          OpEventGetEventFailed_GetEventFailed_EvtInfo_AutoCreatedDemEvent_NVM_E_INTEGRITY_FAILED: RteEventRef=OpEventGetEventFailed_GetEventFailed_EvtInfo_AutoCreatedDemEvent_NVM_E_INTEGRITY_FAILED
          OpEventGetFaultDetectionCounter_GetFaultDetectionCounter_EvtInfo_AutoCreatedDemEvent_XFRM_E_MALFORMED_MESSAGE: RteEventRef=OpEventGetFaultDetectionCounter_GetFaultDetectionCounter_EvtInfo_AutoCreatedDemEvent_XFRM_E_MALFORMED_MESSAGE
          OpEventGetEventStatus_GetEventStatus_EvtInfo_AutoCreatedDemEvent_EEP_E_ERASE_FAILED_1: RteEventRef=OpEventGetEventStatus_GetEventStatus_EvtInfo_AutoCreatedDemEvent_EEP_E_ERASE_FAILED_1
          OpEventGetEventStatus_GetEventStatus_EvtInfo_AutoCreatedDemEvent_ECUM_E_RAM_CHECK_FAILED: RteEventRef=OpEventGetEventStatus_GetEventStatus_EvtInfo_AutoCreatedDemEvent_ECUM_E_RAM_CHECK_FAILED
          OpEventGetMonitorStatus_GetMonitorStatus_EvtInfo_AutoCreatedDemEvent_EEP_E_WRITE_FAILED_1: RteEventRef=OpEventGetMonitorStatus_GetMonitorStatus_EvtInfo_AutoCreatedDemEvent_EEP_E_WRITE_FAILED_1
          OpEventGetEventFreezeFrameDataEx_GetEventFreezeFrameDataEx_EvtInfo_AutoCreatedDemEvent_NVM_E_WRITE_PROTECTED: RteEventRef=OpEventGetEventFreezeFrameDataEx_GetEventFreezeFrameDataEx_EvtInfo_AutoCreatedDemEvent_NVM_E_WRITE_PROTECTED
          OpEventGetMonitorStatus_GetMonitorStatus_EvtInfo_AutoCreatedDemEvent_FLS_E_UNEXPECTED_FLASH_ID: RteEventRef=OpEventGetMonitorStatus_GetMonitorStatus_EvtInfo_AutoCreatedDemEvent_FLS_E_UNEXPECTED_FLASH_ID
          OpEventGetEventFailed_GetEventFailed_EvtInfo_AutoCreatedDemEvent_FLS_E_UNEXPECTED_FLASH_ID_1: RteEventRef=OpEventGetEventFailed_GetEventFailed_EvtInfo_AutoCreatedDemEvent_FLS_E_UNEXPECTED_FLASH_ID_1
          OpEventGetFaultDetectionCounter_GetFaultDetectionCounter_EvtInfo_AutoCreatedDemEvent_XCP_E_INIT_FAILED: RteEventRef=OpEventGetFaultDetectionCounter_GetFaultDetectionCounter_EvtInfo_AutoCreatedDemEvent_XCP_E_INIT_FAILED
          OpEventGetEventEnableCondition_GetEventEnableCondition_EvtInfo_AutoCreatedDemEvent_FLS_E_ERASE_FAILED: RteEventRef=OpEventGetEventEnableCondition_GetEventEnableCondition_EvtInfo_AutoCreatedDemEvent_FLS_E_ERASE_FAILED
          OpEventGetEventTested_GetEventTested_EvtInfo_AutoCreatedDemEvent_MyECU_6c1a0d52_FrDemCtrlTestResultRef: RteEventRef=OpEventGetEventTested_GetEventTested_EvtInfo_AutoCreatedDemEvent_MyECU_6c1a0d52_FrDemCtrlTestResultRef
          OpEventGetDebouncingOfEvent_GetDebouncingOfEvent_EvtInfo_AutoCreatedDemEvent_EEP_E_ERASE_FAILED: RteEventRef=OpEventGetDebouncingOfEvent_GetDebouncingOfEvent_EvtInfo_AutoCreatedDemEvent_EEP_E_ERASE_FAILED
          OpEventGetDTCOfEvent_GetDTCOfEvent_EvtInfo_AutoCreatedDemEvent_NVM_E_QUEUE_OVERFLOW: RteEventRef=OpEventGetDTCOfEvent_GetDTCOfEvent_EvtInfo_AutoCreatedDemEvent_NVM_E_QUEUE_OVERFLOW
          OpEventGetDebouncingOfEvent_GetDebouncingOfEvent_EvtInfo_AutoCreatedDemEvent_BswMConfig_BswMReportFailToDemRef: RteEventRef=OpEventGetDebouncingOfEvent_GetDebouncingOfEvent_EvtInfo_AutoCreatedDemEvent_BswMConfig_BswMReportFailToDemRef
          OpEventGetEventStatus_GetEventStatus_EvtInfo_AutoCreatedDemEvent_ECUM_E_ALL_RUN_REQUESTS_KILLED: RteEventRef=OpEventGetEventStatus_GetEventStatus_EvtInfo_AutoCreatedDemEvent_ECUM_E_ALL_RUN_REQUESTS_KILLED
          OpEventGetDebouncingOfEvent_GetDebouncingOfEvent_EvtInfo_AutoCreatedDemEvent_FLS_E_UNEXPECTED_FLASH_ID_1: RteEventRef=OpEventGetDebouncingOfEvent_GetDebouncingOfEvent_EvtInfo_AutoCreatedDemEvent_FLS_E_UNEXPECTED_FLASH_ID_1
          OpEventGetEventExtendedDataRecordEx_GetEventExtendedDataRecordEx_EvtInfo_AutoCreatedDemEvent_MyECU_6c1a0d52_FrDemCtrlTe_6c2b3e3b: RteEventRef=OpEventGetEventExtendedDataRecordEx_GetEventExtendedDataRecordEx_EvtInfo_AutoCreatedDemEvent_MyECU_6c1a0d52_FrDemCtrlTe_6c2b3e3b
          OpEventGetEventUdsStatus_GetEventUdsStatus_EvtInfo_AutoCreatedDemEvent_EEP_E_READ_FAILED: RteEventRef=OpEventGetEventUdsStatus_GetEventUdsStatus_EvtInfo_AutoCreatedDemEvent_EEP_E_READ_FAILED
          OpEventGetEventEnableCondition_GetEventEnableCondition_EvtInfo_AutoCreatedDemEvent_FLS_E_ERASE_FAILED_1: RteEventRef=OpEventGetEventEnableCondition_GetEventEnableCondition_EvtInfo_AutoCreatedDemEvent_FLS_E_ERASE_FAILED_1
          OpEventGetDTCOfEvent_GetDTCOfEvent_EvtInfo_AutoCreatedDemEvent_FLS_E_UNEXPECTED_FLASH_ID: RteEventRef=OpEventGetDTCOfEvent_GetDTCOfEvent_EvtInfo_AutoCreatedDemEvent_FLS_E_UNEXPECTED_FLASH_ID
          OpEventGetEventExtendedDataRecordEx_GetEventExtendedDataRecordEx_EvtInfo_AutoCreatedDemEvent_NVM_E_INTEGRITY_FAILED: RteEventRef=OpEventGetEventExtendedDataRecordEx_GetEventExtendedDataRecordEx_EvtInfo_AutoCreatedDemEvent_NVM_E_INTEGRITY_FAILED
          OpEventGetEventExtendedDataRecordEx_GetEventExtendedDataRecordEx_EvtInfo_AutoCreatedDemEvent_BswMConfig_BswMReportFailToDemRef: RteEventRef=OpEventGetEventExtendedDataRecordEx_GetEventExtendedDataRecordEx_EvtInfo_AutoCreatedDemEvent_BswMConfig_BswMReportFailToDemRef
          OpEventGetFaultDetectionCounter_GetFaultDetectionCounter_EvtInfo_AutoCreatedDemEvent_LIN_E_TIMEOUT: RteEventRef=OpEventGetFaultDetectionCounter_GetFaultDetectionCounter_EvtInfo_AutoCreatedDemEvent_LIN_E_TIMEOUT
          OpEventGetEventTested_GetEventTested_EvtInfo_AutoCreatedDemEvent_McuModuleConfiguration_MCU_E_CLOCK_FAILURE_1: RteEventRef=OpEventGetEventTested_GetEventTested_EvtInfo_AutoCreatedDemEvent_McuModuleConfiguration_MCU_E_CLOCK_FAILURE_1
          OpEventGetEventUdsStatus_GetEventUdsStatus_EvtInfo_AutoCreatedDemEvent_FLS_E_COMPARE_FAILED_1: RteEventRef=OpEventGetEventUdsStatus_GetEventUdsStatus_EvtInfo_AutoCreatedDemEvent_FLS_E_COMPARE_FAILED_1
          OpEventGetDebouncingOfEvent_GetDebouncingOfEvent_EvtInfo_AutoCreatedDemEvent_LIN_E_TIMEOUT: RteEventRef=OpEventGetDebouncingOfEvent_GetDebouncingOfEvent_EvtInfo_AutoCreatedDemEvent_LIN_E_TIMEOUT
          OpEventGetEventUdsStatus_GetEventUdsStatus_EvtInfo_AutoCreatedDemEvent_CHNL_346f2748_CANSM_E_MODE_REQUEST_TIMEOUT: RteEventRef=OpEventGetEventUdsStatus_GetEventUdsStatus_EvtInfo_AutoCreatedDemEvent_CHNL_346f2748_CANSM_E_MODE_REQUEST_TIMEOUT
          OpEventGetEventUdsStatus_GetEventUdsStatus_EvtInfo_AutoCreatedDemEvent_FLS_E_WRITE_FAILED: RteEventRef=OpEventGetEventUdsStatus_GetEventUdsStatus_EvtInfo_AutoCreatedDemEvent_FLS_E_WRITE_FAILED
          OpEventGetFaultDetectionCounter_GetFaultDetectionCounter_EvtInfo_AutoCreatedDemEvent_MyECU_6c1a0d52_FrDemCtrlTestResultRef: RteEventRef=OpEventGetFaultDetectionCounter_GetFaultDetectionCounter_EvtInfo_AutoCreatedDemEvent_MyECU_6c1a0d52_FrDemCtrlTestResultRef
          OpEventGetMonitorStatus_GetMonitorStatus_EvtInfo_AutoCreatedDemEvent_FLS_E_WRITE_FAILED_1: RteEventRef=OpEventGetMonitorStatus_GetMonitorStatus_EvtInfo_AutoCreatedDemEvent_FLS_E_WRITE_FAILED_1
          OpEventGetEventTested_GetEventTested_EvtInfo_AutoCreatedDemEvent_LIN_E_TIMEOUT: RteEventRef=OpEventGetEventTested_GetEventTested_EvtInfo_AutoCreatedDemEvent_LIN_E_TIMEOUT
          OpEventGetEventStatus_GetEventStatus_EvtInfo_AutoCreatedDemEvent_XFRM_E_MALFORMED_MESSAGE_1: RteEventRef=OpEventGetEventStatus_GetEventStatus_EvtInfo_AutoCreatedDemEvent_XFRM_E_MALFORMED_MESSAGE_1
          OpEventGetEventEnableCondition_GetEventEnableCondition_EvtInfo_AutoCreatedDemEvent_CHNL_346f2748_CANSM_E_MODE_REQUEST_TIMEOUT: RteEventRef=OpEventGetEventEnableCondition_GetEventEnableCondition_EvtInfo_AutoCreatedDemEvent_CHNL_346f2748_CANSM_E_MODE_REQUEST_TIMEOUT
          OpEventGetEventFreezeFrameDataEx_GetEventFreezeFrameDataEx_EvtInfo_AutoCreatedDemEvent_NVM_E_WRONG_BLOCK_ID: RteEventRef=OpEventGetEventFreezeFrameDataEx_GetEventFreezeFrameDataEx_EvtInfo_AutoCreatedDemEvent_NVM_E_WRONG_BLOCK_ID
          OpEventGetEventFailed_GetEventFailed_EvtInfo_AutoCreatedDemEvent_FLS_E_WRITE_FAILED: RteEventRef=OpEventGetEventFailed_GetEventFailed_EvtInfo_AutoCreatedDemEvent_FLS_E_WRITE_FAILED
          OpEventGetEventFailed_GetEventFailed_EvtInfo_AutoCreatedDemEvent_ECUM_E_RAM_CHECK_FAILED: RteEventRef=OpEventGetEventFailed_GetEventFailed_EvtInfo_AutoCreatedDemEvent_ECUM_E_RAM_CHECK_FAILED
          OpEventGetMonitorStatus_GetMonitorStatus_EvtInfo_AutoCreatedDemEvent_CHNL_346f2748_CANSM_E_BUS_OFF: RteEventRef=OpEventGetMonitorStatus_GetMonitorStatus_EvtInfo_AutoCreatedDemEvent_CHNL_346f2748_CANSM_E_BUS_OFF
          OpEventGetEventExtendedDataRecordEx_GetEventExtendedDataRecordEx_EvtInfo_AutoCreatedDemEvent_EEP_E_WRITE_FAILED: RteEventRef=OpEventGetEventExtendedDataRecordEx_GetEventExtendedDataRecordEx_EvtInfo_AutoCreatedDemEvent_EEP_E_WRITE_FAILED
          OpEventGetDTCOfEvent_GetDTCOfEvent_EvtInfo_AutoCreatedDemEvent_FLS_E_WRITE_FAILED: RteEventRef=OpEventGetDTCOfEvent_GetDTCOfEvent_EvtInfo_AutoCreatedDemEvent_FLS_E_WRITE_FAILED
          OpEventGetEventUdsStatus_GetEventUdsStatus_EvtInfo_AutoCreatedDemEvent_LIN_E_TIMEOUT: RteEventRef=OpEventGetEventUdsStatus_GetEventUdsStatus_EvtInfo_AutoCreatedDemEvent_LIN_E_TIMEOUT
          OpEventGetFaultDetectionCounter_GetFaultDetectionCounter_EvtInfo_AutoCreatedDemEvent_FLS_E_READ_FAILED: RteEventRef=OpEventGetFaultDetectionCounter_GetFaultDetectionCounter_EvtInfo_AutoCreatedDemEvent_FLS_E_READ_FAILED
          OpEventGetFaultDetectionCounter_GetFaultDetectionCounter_EvtInfo_AutoCreatedDemEvent_NVM_E_REQ_FAILED: RteEventRef=OpEventGetFaultDetectionCounter_GetFaultDetectionCounter_EvtInfo_AutoCreatedDemEvent_NVM_E_REQ_FAILED
          OpEventGetEventEnableCondition_GetEventEnableCondition_EvtInfo_AutoCreatedDemEvent_NVM_E_LOSS_OF_REDUNDANCY: RteEventRef=OpEventGetEventEnableCondition_GetEventEnableCondition_EvtInfo_AutoCreatedDemEvent_NVM_E_LOSS_OF_REDUNDANCY
          OpEventGetMonitorStatus_GetMonitorStatus_EvtInfo_AutoCreatedDemEvent_EEP_E_ERASE_FAILED: RteEventRef=OpEventGetMonitorStatus_GetMonitorStatus_EvtInfo_AutoCreatedDemEvent_EEP_E_ERASE_FAILED
          OpEventGetEventStatus_GetEventStatus_EvtInfo_AutoCreatedDemEvent_McuModuleConfiguration_MCU_E_CLOCK_FAILURE_1: RteEventRef=OpEventGetEventStatus_GetEventStatus_EvtInfo_AutoCreatedDemEvent_McuModuleConfiguration_MCU_E_CLOCK_FAILURE_1
          OpEventGetEventUdsStatus_GetEventUdsStatus_EvtInfo_AutoCreatedDemEvent_EEP_E_COMPARE_FAILED_1: RteEventRef=OpEventGetEventUdsStatus_GetEventUdsStatus_EvtInfo_AutoCreatedDemEvent_EEP_E_COMPARE_FAILED_1
          OpEventGetEventFreezeFrameDataEx_GetEventFreezeFrameDataEx_EvtInfo_AutoCreatedDemEvent_NVM_E_VERIFY_FAILED: RteEventRef=OpEventGetEventFreezeFrameDataEx_GetEventFreezeFrameDataEx_EvtInfo_AutoCreatedDemEvent_NVM_E_VERIFY_FAILED
          OpEventGetFaultDetectionCounter_GetFaultDetectionCounter_EvtInfo_AutoCreatedDemEvent_EEP_E_WRITE_FAILED_1: RteEventRef=OpEventGetFaultDetectionCounter_GetFaultDetectionCounter_EvtInfo_AutoCreatedDemEvent_EEP_E_WRITE_FAILED_1
          OpEventGetDebouncingOfEvent_GetDebouncingOfEvent_EvtInfo_AutoCreatedDemEvent_ECUM_E_RAM_CHECK_FAILED: RteEventRef=OpEventGetDebouncingOfEvent_GetDebouncingOfEvent_EvtInfo_AutoCreatedDemEvent_ECUM_E_RAM_CHECK_FAILED
          OpEventGetEventExtendedDataRecordEx_GetEventExtendedDataRecordEx_EvtInfo_AutoCreatedDemEvent_XFRM_E_MALFORMED_MESSAGE_2: RteEventRef=OpEventGetEventExtendedDataRecordEx_GetEventExtendedDataRecordEx_EvtInfo_AutoCreatedDemEvent_XFRM_E_MALFORMED_MESSAGE_2
          OpEventGetEventUdsStatus_GetEventUdsStatus_EvtInfo_AutoCreatedDemEvent_NVM_E_INTEGRITY_FAILED: RteEventRef=OpEventGetEventUdsStatus_GetEventUdsStatus_EvtInfo_AutoCreatedDemEvent_NVM_E_INTEGRITY_FAILED
          OpEventGetEventFailed_GetEventFailed_EvtInfo_AutoCreatedDemEvent_ECUM_E_CONFIGURATION_DATA_INCONSISTENT: RteEventRef=OpEventGetEventFailed_GetEventFailed_EvtInfo_AutoCreatedDemEvent_ECUM_E_CONFIGURATION_DATA_INCONSISTENT
          OpEventGetEventFreezeFrameDataEx_GetEventFreezeFrameDataEx_EvtInfo_AutoCreatedDemEvent_NVM_E_REQ_FAILED: RteEventRef=OpEventGetEventFreezeFrameDataEx_GetEventFreezeFrameDataEx_EvtInfo_AutoCreatedDemEvent_NVM_E_REQ_FAILED
          OpEventGetDTCOfEvent_GetDTCOfEvent_EvtInfo_AutoCreatedDemEvent_FLS_E_COMPARE_FAILED_1: RteEventRef=OpEventGetDTCOfEvent_GetDTCOfEvent_EvtInfo_AutoCreatedDemEvent_FLS_E_COMPARE_FAILED_1
          OpEventGetEventTested_GetEventTested_EvtInfo_AutoCreatedDemEvent_FLS_E_UNEXPECTED_FLASH_ID_1: RteEventRef=OpEventGetEventTested_GetEventTested_EvtInfo_AutoCreatedDemEvent_FLS_E_UNEXPECTED_FLASH_ID_1
          OpEventGetEventExtendedDataRecordEx_GetEventExtendedDataRecordEx_EvtInfo_AutoCreatedDemEvent_CHNL_346f2748_CANSM_E_MODE_da20ac36: RteEventRef=OpEventGetEventExtendedDataRecordEx_GetEventExtendedDataRecordEx_EvtInfo_AutoCreatedDemEvent_CHNL_346f2748_CANSM_E_MODE_da20ac36
          OpEventGetEventStatus_GetEventStatus_EvtInfo_AutoCreatedDemEvent_NVM_E_LOSS_OF_REDUNDANCY: RteEventRef=OpEventGetEventStatus_GetEventStatus_EvtInfo_AutoCreatedDemEvent_NVM_E_LOSS_OF_REDUNDANCY
          OpEventGetDTCOfEvent_GetDTCOfEvent_EvtInfo_AutoCreatedDemEvent_XCP_E_INIT_FAILED: RteEventRef=OpEventGetDTCOfEvent_GetDTCOfEvent_EvtInfo_AutoCreatedDemEvent_XCP_E_INIT_FAILED
          OpEventGetMonitorStatus_GetMonitorStatus_EvtInfo_AutoCreatedDemEvent_FLS_E_WRITE_FAILED: RteEventRef=OpEventGetMonitorStatus_GetMonitorStatus_EvtInfo_AutoCreatedDemEvent_FLS_E_WRITE_FAILED
          OpEventGetDTCOfEvent_GetDTCOfEvent_EvtInfo_AutoCreatedDemEvent_LIN_E_TIMEOUT: RteEventRef=OpEventGetDTCOfEvent_GetDTCOfEvent_EvtInfo_AutoCreatedDemEvent_LIN_E_TIMEOUT
          OpEventGetFaultDetectionCounter_GetFaultDetectionCounter_EvtInfo_AutoCreatedDemEvent_CHNL_346f2748_CANSM_E_BUS_OFF: RteEventRef=OpEventGetFaultDetectionCounter_GetFaultDetectionCounter_EvtInfo_AutoCreatedDemEvent_CHNL_346f2748_CANSM_E_BUS_OFF
          OpEventGetEventStatus_GetEventStatus_EvtInfo_AutoCreatedDemEvent_FLS_E_UNEXPECTED_FLASH_ID: RteEventRef=OpEventGetEventStatus_GetEventStatus_EvtInfo_AutoCreatedDemEvent_FLS_E_UNEXPECTED_FLASH_ID
          OpEventGetDebouncingOfEvent_GetDebouncingOfEvent_EvtInfo_AutoCreatedDemEvent_NVM_E_LOSS_OF_REDUNDANCY: RteEventRef=OpEventGetDebouncingOfEvent_GetDebouncingOfEvent_EvtInfo_AutoCreatedDemEvent_NVM_E_LOSS_OF_REDUNDANCY
          OpEventGetDTCOfEvent_GetDTCOfEvent_EvtInfo_AutoCreatedDemEvent_EEP_E_COMPARE_FAILED: RteEventRef=OpEventGetDTCOfEvent_GetDTCOfEvent_EvtInfo_AutoCreatedDemEvent_EEP_E_COMPARE_FAILED
          OpEventGetEventExtendedDataRecordEx_GetEventExtendedDataRecordEx_EvtInfo_AutoCreatedDemEvent_EEP_E_ERASE_FAILED: RteEventRef=OpEventGetEventExtendedDataRecordEx_GetEventExtendedDataRecordEx_EvtInfo_AutoCreatedDemEvent_EEP_E_ERASE_FAILED
          OpEventGetEventTested_GetEventTested_EvtInfo_AutoCreatedDemEvent_FLS_E_READ_FAILED_1: RteEventRef=OpEventGetEventTested_GetEventTested_EvtInfo_AutoCreatedDemEvent_FLS_E_READ_FAILED_1
          OpEventGetEventExtendedDataRecordEx_GetEventExtendedDataRecordEx_EvtInfo_AutoCreatedDemEvent_XFRM_E_MALFORMED_MESSAGE_1: RteEventRef=OpEventGetEventExtendedDataRecordEx_GetEventExtendedDataRecordEx_EvtInfo_AutoCreatedDemEvent_XFRM_E_MALFORMED_MESSAGE_1
          OpEventGetEventFreezeFrameDataEx_GetEventFreezeFrameDataEx_EvtInfo_AutoCreatedDemEvent_EEP_E_WRITE_FAILED: RteEventRef=OpEventGetEventFreezeFrameDataEx_GetEventFreezeFrameDataEx_EvtInfo_AutoCreatedDemEvent_EEP_E_WRITE_FAILED
          OpEventGetEventFreezeFrameDataEx_GetEventFreezeFrameDataEx_EvtInfo_AutoCreatedDemEvent_NVM_E_INTEGRITY_FAILED: RteEventRef=OpEventGetEventFreezeFrameDataEx_GetEventFreezeFrameDataEx_EvtInfo_AutoCreatedDemEvent_NVM_E_INTEGRITY_FAILED
          OpEventGetFaultDetectionCounter_GetFaultDetectionCounter_EvtInfo_AutoCreatedDemEvent_FLS_E_COMPARE_FAILED_1: RteEventRef=OpEventGetFaultDetectionCounter_GetFaultDetectionCounter_EvtInfo_AutoCreatedDemEvent_FLS_E_COMPARE_FAILED_1
          OpEventGetDebouncingOfEvent_GetDebouncingOfEvent_EvtInfo_AutoCreatedDemEvent_NVM_E_WRONG_BLOCK_ID: RteEventRef=OpEventGetDebouncingOfEvent_GetDebouncingOfEvent_EvtInfo_AutoCreatedDemEvent_NVM_E_WRONG_BLOCK_ID
          OpEventGetEventTested_GetEventTested_EvtInfo_AutoCreatedDemEvent_XFRM_E_MALFORMED_MESSAGE_2: RteEventRef=OpEventGetEventTested_GetEventTested_EvtInfo_AutoCreatedDemEvent_XFRM_E_MALFORMED_MESSAGE_2
          OpEventGetEventFailed_GetEventFailed_EvtInfo_AutoCreatedDemEvent_EEP_E_ERASE_FAILED_1: RteEventRef=OpEventGetEventFailed_GetEventFailed_EvtInfo_AutoCreatedDemEvent_EEP_E_ERASE_FAILED_1
          OpEventGetDebouncingOfEvent_GetDebouncingOfEvent_EvtInfo_AutoCreatedDemEvent_XFRM_E_MALFORMED_MESSAGE_1: RteEventRef=OpEventGetDebouncingOfEvent_GetDebouncingOfEvent_EvtInfo_AutoCreatedDemEvent_XFRM_E_MALFORMED_MESSAGE_1
          OpEventGetEventEnableCondition_GetEventEnableCondition_EvtInfo_AutoCreatedDemEvent_EEP_E_WRITE_FAILED: RteEventRef=OpEventGetEventEnableCondition_GetEventEnableCondition_EvtInfo_AutoCreatedDemEvent_EEP_E_WRITE_FAILED
          OpEventGetMonitorStatus_GetMonitorStatus_EvtInfo_AutoCreatedDemEvent_EEP_E_READ_FAILED_1: RteEventRef=OpEventGetMonitorStatus_GetMonitorStatus_EvtInfo_AutoCreatedDemEvent_EEP_E_READ_FAILED_1
          OpEventGetEventStatus_GetEventStatus_EvtInfo_AutoCreatedDemEvent_NVM_E_VERIFY_FAILED: RteEventRef=OpEventGetEventStatus_GetEventStatus_EvtInfo_AutoCreatedDemEvent_NVM_E_VERIFY_FAILED
          OpEventGetEventFailed_GetEventFailed_EvtInfo_AutoCreatedDemEvent_EEP_E_WRITE_FAILED_1: RteEventRef=OpEventGetEventFailed_GetEventFailed_EvtInfo_AutoCreatedDemEvent_EEP_E_WRITE_FAILED_1
          OpEventGetDebouncingOfEvent_GetDebouncingOfEvent_EvtInfo_AutoCreatedDemEvent_EEP_E_WRITE_FAILED: RteEventRef=OpEventGetDebouncingOfEvent_GetDebouncingOfEvent_EvtInfo_AutoCreatedDemEvent_EEP_E_WRITE_FAILED
          OpEventGetEventExtendedDataRecordEx_GetEventExtendedDataRecordEx_EvtInfo_AutoCreatedDemEvent_EEP_E_ERASE_FAILED_1: RteEventRef=OpEventGetEventExtendedDataRecordEx_GetEventExtendedDataRecordEx_EvtInfo_AutoCreatedDemEvent_EEP_E_ERASE_FAILED_1
          OpEventGetMonitorStatus_GetMonitorStatus_EvtInfo_AutoCreatedDemEvent_FLS_E_ERASE_FAILED: RteEventRef=OpEventGetMonitorStatus_GetMonitorStatus_EvtInfo_AutoCreatedDemEvent_FLS_E_ERASE_FAILED
          OpEventGetDebouncingOfEvent_GetDebouncingOfEvent_EvtInfo_AutoCreatedDemEvent_CHNL_346f2748_CANSM_E_BUS_OFF: RteEventRef=OpEventGetDebouncingOfEvent_GetDebouncingOfEvent_EvtInfo_AutoCreatedDemEvent_CHNL_346f2748_CANSM_E_BUS_OFF
          OpEventGetEventFailed_GetEventFailed_EvtInfo_AutoCreatedDemEvent_FLS_E_COMPARE_FAILED_1: RteEventRef=OpEventGetEventFailed_GetEventFailed_EvtInfo_AutoCreatedDemEvent_FLS_E_COMPARE_FAILED_1
          OpEventGetMonitorStatus_GetMonitorStatus_EvtInfo_AutoCreatedDemEvent_NVM_E_WRITE_PROTECTED: RteEventRef=OpEventGetMonitorStatus_GetMonitorStatus_EvtInfo_AutoCreatedDemEvent_NVM_E_WRITE_PROTECTED
          OpEventGetFaultDetectionCounter_GetFaultDetectionCounter_EvtInfo_AutoCreatedDemEvent_McuModuleConfiguration_MCU_E_CLOCK_0053dbfe: RteEventRef=OpEventGetFaultDetectionCounter_GetFaultDetectionCounter_EvtInfo_AutoCreatedDemEvent_McuModuleConfiguration_MCU_E_CLOCK_0053dbfe
          OpEventGetEventEnableCondition_GetEventEnableCondition_EvtInfo_AutoCreatedDemEvent_EEP_E_COMPARE_FAILED_1: RteEventRef=OpEventGetEventEnableCondition_GetEventEnableCondition_EvtInfo_AutoCreatedDemEvent_EEP_E_COMPARE_FAILED_1
          OpEventGetDTCOfEvent_GetDTCOfEvent_EvtInfo_AutoCreatedDemEvent_ECUM_E_RAM_CHECK_FAILED: RteEventRef=OpEventGetDTCOfEvent_GetDTCOfEvent_EvtInfo_AutoCreatedDemEvent_ECUM_E_RAM_CHECK_FAILED
          OpEventGetEventEnableCondition_GetEventEnableCondition_EvtInfo_AutoCreatedDemEvent_NVM_E_QUEUE_OVERFLOW: RteEventRef=OpEventGetEventEnableCondition_GetEventEnableCondition_EvtInfo_AutoCreatedDemEvent_NVM_E_QUEUE_OVERFLOW
          OpEventGetEventUdsStatus_GetEventUdsStatus_EvtInfo_AutoCreatedDemEvent_XFRM_E_MALFORMED_MESSAGE_2: RteEventRef=OpEventGetEventUdsStatus_GetEventUdsStatus_EvtInfo_AutoCreatedDemEvent_XFRM_E_MALFORMED_MESSAGE_2
          OpEventGetEventExtendedDataRecordEx_GetEventExtendedDataRecordEx_EvtInfo_AutoCreatedDemEvent_EEP_E_COMPARE_FAILED_1: RteEventRef=OpEventGetEventExtendedDataRecordEx_GetEventExtendedDataRecordEx_EvtInfo_AutoCreatedDemEvent_EEP_E_COMPARE_FAILED_1
          OpEventGetEventUdsStatus_GetEventUdsStatus_EvtInfo_AutoCreatedDemEvent_FLS_E_ERASE_FAILED: RteEventRef=OpEventGetEventUdsStatus_GetEventUdsStatus_EvtInfo_AutoCreatedDemEvent_FLS_E_ERASE_FAILED
          OpEventGetEventFreezeFrameDataEx_GetEventFreezeFrameDataEx_EvtInfo_AutoCreatedDemEvent_FLS_E_READ_FAILED: RteEventRef=OpEventGetEventFreezeFrameDataEx_GetEventFreezeFrameDataEx_EvtInfo_AutoCreatedDemEvent_FLS_E_READ_FAILED
          OpEventGetEventTested_GetEventTested_EvtInfo_AutoCreatedDemEvent_NVM_E_LOSS_OF_REDUNDANCY: RteEventRef=OpEventGetEventTested_GetEventTested_EvtInfo_AutoCreatedDemEvent_NVM_E_LOSS_OF_REDUNDANCY
          OpEventGetEventExtendedDataRecordEx_GetEventExtendedDataRecordEx_EvtInfo_AutoCreatedDemEvent_FLS_E_ERASE_FAILED_1: RteEventRef=OpEventGetEventExtendedDataRecordEx_GetEventExtendedDataRecordEx_EvtInfo_AutoCreatedDemEvent_FLS_E_ERASE_FAILED_1
          OpEventGetEventEnableCondition_GetEventEnableCondition_EvtInfo_AutoCreatedDemEvent_FLS_E_COMPARE_FAILED_1: RteEventRef=OpEventGetEventEnableCondition_GetEventEnableCondition_EvtInfo_AutoCreatedDemEvent_FLS_E_COMPARE_FAILED_1
          OpEventGetEventTested_GetEventTested_EvtInfo_AutoCreatedDemEvent_ECUM_E_RAM_CHECK_FAILED: RteEventRef=OpEventGetEventTested_GetEventTested_EvtInfo_AutoCreatedDemEvent_ECUM_E_RAM_CHECK_FAILED
          OpEventGetEventUdsStatus_GetEventUdsStatus_EvtInfo_AutoCreatedDemEvent_FLS_E_UNEXPECTED_FLASH_ID: RteEventRef=OpEventGetEventUdsStatus_GetEventUdsStatus_EvtInfo_AutoCreatedDemEvent_FLS_E_UNEXPECTED_FLASH_ID
          OpEventGetEventUdsStatus_GetEventUdsStatus_EvtInfo_AutoCreatedDemEvent_XCP_E_INIT_FAILED: RteEventRef=OpEventGetEventUdsStatus_GetEventUdsStatus_EvtInfo_AutoCreatedDemEvent_XCP_E_INIT_FAILED
          OpEventGetEventTested_GetEventTested_EvtInfo_AutoCreatedDemEvent_EEP_E_READ_FAILED_1: RteEventRef=OpEventGetEventTested_GetEventTested_EvtInfo_AutoCreatedDemEvent_EEP_E_READ_FAILED_1
          OpEventGetEventEnableCondition_GetEventEnableCondition_EvtInfo_AutoCreatedDemEvent_FLS_E_WRITE_FAILED: RteEventRef=OpEventGetEventEnableCondition_GetEventEnableCondition_EvtInfo_AutoCreatedDemEvent_FLS_E_WRITE_FAILED
          OpEventGetEventFreezeFrameDataEx_GetEventFreezeFrameDataEx_EvtInfo_AutoCreatedDemEvent_FLS_E_ERASE_FAILED: RteEventRef=OpEventGetEventFreezeFrameDataEx_GetEventFreezeFrameDataEx_EvtInfo_AutoCreatedDemEvent_FLS_E_ERASE_FAILED
          OpEventGetEventUdsStatus_GetEventUdsStatus_EvtInfo_AutoCreatedDemEvent_BswMConfig_BswMReportFailToDemRef: RteEventRef=OpEventGetEventUdsStatus_GetEventUdsStatus_EvtInfo_AutoCreatedDemEvent_BswMConfig_BswMReportFailToDemRef
          OpEventGetMonitorStatus_GetMonitorStatus_EvtInfo_AutoCreatedDemEvent_FLS_E_ERASE_FAILED_1: RteEventRef=OpEventGetMonitorStatus_GetMonitorStatus_EvtInfo_AutoCreatedDemEvent_FLS_E_ERASE_FAILED_1
          OpEventGetDTCOfEvent_GetDTCOfEvent_EvtInfo_AutoCreatedDemEvent_ECUM_E_ALL_RUN_REQUESTS_KILLED: RteEventRef=OpEventGetDTCOfEvent_GetDTCOfEvent_EvtInfo_AutoCreatedDemEvent_ECUM_E_ALL_RUN_REQUESTS_KILLED
          OpEventGetEventTested_GetEventTested_EvtInfo_AutoCreatedDemEvent_EEP_E_READ_FAILED: RteEventRef=OpEventGetEventTested_GetEventTested_EvtInfo_AutoCreatedDemEvent_EEP_E_READ_FAILED
          OpEventGetMonitorStatus_GetMonitorStatus_EvtInfo_AutoCreatedDemEvent_McuModuleConfiguration_MCU_E_CLOCK_FAILURE: RteEventRef=OpEventGetMonitorStatus_GetMonitorStatus_EvtInfo_AutoCreatedDemEvent_McuModuleConfiguration_MCU_E_CLOCK_FAILURE
          OpEventGetFaultDetectionCounter_GetFaultDetectionCounter_EvtInfo_AutoCreatedDemEvent_FLS_E_WRITE_FAILED: RteEventRef=OpEventGetFaultDetectionCounter_GetFaultDetectionCounter_EvtInfo_AutoCreatedDemEvent_FLS_E_WRITE_FAILED
          OpEventGetEventStatus_GetEventStatus_EvtInfo_AutoCreatedDemEvent_BswMConfig_BswMReportFailToDemRef: RteEventRef=OpEventGetEventStatus_GetEventStatus_EvtInfo_AutoCreatedDemEvent_BswMConfig_BswMReportFailToDemRef
          OpEventGetEventUdsStatus_GetEventUdsStatus_EvtInfo_AutoCreatedDemEvent_NVM_E_WRONG_BLOCK_ID: RteEventRef=OpEventGetEventUdsStatus_GetEventUdsStatus_EvtInfo_AutoCreatedDemEvent_NVM_E_WRONG_BLOCK_ID
          OpEventGetEventExtendedDataRecordEx_GetEventExtendedDataRecordEx_EvtInfo_AutoCreatedDemEvent_ECUM_E_ALL_RUN_REQUESTS_KILLED: RteEventRef=OpEventGetEventExtendedDataRecordEx_GetEventExtendedDataRecordEx_EvtInfo_AutoCreatedDemEvent_ECUM_E_ALL_RUN_REQUESTS_KILLED
          OpEventGetEventEnableCondition_GetEventEnableCondition_EvtInfo_AutoCreatedDemEvent_ECUM_E_RAM_CHECK_FAILED: RteEventRef=OpEventGetEventEnableCondition_GetEventEnableCondition_EvtInfo_AutoCreatedDemEvent_ECUM_E_RAM_CHECK_FAILED
          OpEventGetEventUdsStatus_GetEventUdsStatus_EvtInfo_AutoCreatedDemEvent_EEP_E_ERASE_FAILED: RteEventRef=OpEventGetEventUdsStatus_GetEventUdsStatus_EvtInfo_AutoCreatedDemEvent_EEP_E_ERASE_FAILED
          OpEventGetEventExtendedDataRecordEx_GetEventExtendedDataRecordEx_EvtInfo_AutoCreatedDemEvent_LIN_E_TIMEOUT: RteEventRef=OpEventGetEventExtendedDataRecordEx_GetEventExtendedDataRecordEx_EvtInfo_AutoCreatedDemEvent_LIN_E_TIMEOUT
          OpEventGetEventFreezeFrameDataEx_GetEventFreezeFrameDataEx_EvtInfo_AutoCreatedDemEvent_XCP_E_INIT_FAILED: RteEventRef=OpEventGetEventFreezeFrameDataEx_GetEventFreezeFrameDataEx_EvtInfo_AutoCreatedDemEvent_XCP_E_INIT_FAILED
          OpEventGetEventFailed_GetEventFailed_EvtInfo_AutoCreatedDemEvent_BswMConfig_BswMReportFailToDemRef: RteEventRef=OpEventGetEventFailed_GetEventFailed_EvtInfo_AutoCreatedDemEvent_BswMConfig_BswMReportFailToDemRef
          OpEventGetEventUdsStatus_GetEventUdsStatus_EvtInfo_AutoCreatedDemEvent_XFRM_E_MALFORMED_MESSAGE_1: RteEventRef=OpEventGetEventUdsStatus_GetEventUdsStatus_EvtInfo_AutoCreatedDemEvent_XFRM_E_MALFORMED_MESSAGE_1
          OpEventGetEventTested_GetEventTested_EvtInfo_AutoCreatedDemEvent_NVM_E_INTEGRITY_FAILED: RteEventRef=OpEventGetEventTested_GetEventTested_EvtInfo_AutoCreatedDemEvent_NVM_E_INTEGRITY_FAILED
          OpEventGetEventExtendedDataRecordEx_GetEventExtendedDataRecordEx_EvtInfo_AutoCreatedDemEvent_FLS_E_READ_FAILED_1: RteEventRef=OpEventGetEventExtendedDataRecordEx_GetEventExtendedDataRecordEx_EvtInfo_AutoCreatedDemEvent_FLS_E_READ_FAILED_1
          OpEventGetEventUdsStatus_GetEventUdsStatus_EvtInfo_AutoCreatedDemEvent_NVM_E_QUEUE_OVERFLOW: RteEventRef=OpEventGetEventUdsStatus_GetEventUdsStatus_EvtInfo_AutoCreatedDemEvent_NVM_E_QUEUE_OVERFLOW
          OpEventGetDebouncingOfEvent_GetDebouncingOfEvent_EvtInfo_AutoCreatedDemEvent_EEP_E_WRITE_FAILED_1: RteEventRef=OpEventGetDebouncingOfEvent_GetDebouncingOfEvent_EvtInfo_AutoCreatedDemEvent_EEP_E_WRITE_FAILED_1
          OpEventGetEventStatus_GetEventStatus_EvtInfo_AutoCreatedDemEvent_NVM_E_QUEUE_OVERFLOW: RteEventRef=OpEventGetEventStatus_GetEventStatus_EvtInfo_AutoCreatedDemEvent_NVM_E_QUEUE_OVERFLOW
          OpEventGetFaultDetectionCounter_GetFaultDetectionCounter_EvtInfo_AutoCreatedDemEvent_NVM_E_QUEUE_OVERFLOW: RteEventRef=OpEventGetFaultDetectionCounter_GetFaultDetectionCounter_EvtInfo_AutoCreatedDemEvent_NVM_E_QUEUE_OVERFLOW
          OpEventGetDTCOfEvent_GetDTCOfEvent_EvtInfo_AutoCreatedDemEvent_NVM_E_WRITE_PROTECTED: RteEventRef=OpEventGetDTCOfEvent_GetDTCOfEvent_EvtInfo_AutoCreatedDemEvent_NVM_E_WRITE_PROTECTED
          OpEventGetFaultDetectionCounter_GetFaultDetectionCounter_EvtInfo_AutoCreatedDemEvent_FLS_E_UNEXPECTED_FLASH_ID: RteEventRef=OpEventGetFaultDetectionCounter_GetFaultDetectionCounter_EvtInfo_AutoCreatedDemEvent_FLS_E_UNEXPECTED_FLASH_ID
          OpEventGetFaultDetectionCounter_GetFaultDetectionCounter_EvtInfo_AutoCreatedDemEvent_NVM_E_INTEGRITY_FAILED: RteEventRef=OpEventGetFaultDetectionCounter_GetFaultDetectionCounter_EvtInfo_AutoCreatedDemEvent_NVM_E_INTEGRITY_FAILED
          OpEventGetEventExtendedDataRecordEx_GetEventExtendedDataRecordEx_EvtInfo_AutoCreatedDemEvent_FLS_E_COMPARE_FAILED: RteEventRef=OpEventGetEventExtendedDataRecordEx_GetEventExtendedDataRecordEx_EvtInfo_AutoCreatedDemEvent_FLS_E_COMPARE_FAILED
          OpEventGetFaultDetectionCounter_GetFaultDetectionCounter_EvtInfo_AutoCreatedDemEvent_MyECU_6c1a0d52_FrDemCtrlTestResultRef_1: RteEventRef=OpEventGetFaultDetectionCounter_GetFaultDetectionCounter_EvtInfo_AutoCreatedDemEvent_MyECU_6c1a0d52_FrDemCtrlTestResultRef_1
          OpEventGetEventExtendedDataRecordEx_GetEventExtendedDataRecordEx_EvtInfo_AutoCreatedDemEvent_NVM_E_WRONG_BLOCK_ID: RteEventRef=OpEventGetEventExtendedDataRecordEx_GetEventExtendedDataRecordEx_EvtInfo_AutoCreatedDemEvent_NVM_E_WRONG_BLOCK_ID
          OpEventGetMonitorStatus_GetMonitorStatus_EvtInfo_AutoCreatedDemEvent_NVM_E_WRONG_BLOCK_ID: RteEventRef=OpEventGetMonitorStatus_GetMonitorStatus_EvtInfo_AutoCreatedDemEvent_NVM_E_WRONG_BLOCK_ID
          OpEventGetEventExtendedDataRecordEx_GetEventExtendedDataRecordEx_EvtInfo_AutoCreatedDemEvent_EEP_E_READ_FAILED_1: RteEventRef=OpEventGetEventExtendedDataRecordEx_GetEventExtendedDataRecordEx_EvtInfo_AutoCreatedDemEvent_EEP_E_READ_FAILED_1
          OpEventGetEventStatus_GetEventStatus_EvtInfo_AutoCreatedDemEvent_FLS_E_READ_FAILED: RteEventRef=OpEventGetEventStatus_GetEventStatus_EvtInfo_AutoCreatedDemEvent_FLS_E_READ_FAILED
          OpEventGetFaultDetectionCounter_GetFaultDetectionCounter_EvtInfo_AutoCreatedDemEvent_NVM_E_LOSS_OF_REDUNDANCY: RteEventRef=OpEventGetFaultDetectionCounter_GetFaultDetectionCounter_EvtInfo_AutoCreatedDemEvent_NVM_E_LOSS_OF_REDUNDANCY
          OpEventGetEventStatus_GetEventStatus_EvtInfo_AutoCreatedDemEvent_EEP_E_COMPARE_FAILED_1: RteEventRef=OpEventGetEventStatus_GetEventStatus_EvtInfo_AutoCreatedDemEvent_EEP_E_COMPARE_FAILED_1
          OpEventGetDebouncingOfEvent_GetDebouncingOfEvent_EvtInfo_AutoCreatedDemEvent_ECUM_E_ALL_RUN_REQUESTS_KILLED: RteEventRef=OpEventGetDebouncingOfEvent_GetDebouncingOfEvent_EvtInfo_AutoCreatedDemEvent_ECUM_E_ALL_RUN_REQUESTS_KILLED
          OpEventGetDTCOfEvent_GetDTCOfEvent_EvtInfo_AutoCreatedDemEvent_EEP_E_ERASE_FAILED: RteEventRef=OpEventGetDTCOfEvent_GetDTCOfEvent_EvtInfo_AutoCreatedDemEvent_EEP_E_ERASE_FAILED
          OpEventGetFaultDetectionCounter_GetFaultDetectionCounter_EvtInfo_AutoCreatedDemEvent_NVM_E_WRONG_BLOCK_ID: RteEventRef=OpEventGetFaultDetectionCounter_GetFaultDetectionCounter_EvtInfo_AutoCreatedDemEvent_NVM_E_WRONG_BLOCK_ID
          OpEventGetEventStatus_GetEventStatus_EvtInfo_AutoCreatedDemEvent_EEP_E_ERASE_FAILED: RteEventRef=OpEventGetEventStatus_GetEventStatus_EvtInfo_AutoCreatedDemEvent_EEP_E_ERASE_FAILED
          OpEventGetEventEnableCondition_GetEventEnableCondition_EvtInfo_AutoCreatedDemEvent_XFRM_E_MALFORMED_MESSAGE: RteEventRef=OpEventGetEventEnableCondition_GetEventEnableCondition_EvtInfo_AutoCreatedDemEvent_XFRM_E_MALFORMED_MESSAGE
          OpEventGetEventExtendedDataRecordEx_GetEventExtendedDataRecordEx_EvtInfo_AutoCreatedDemEvent_EEP_E_READ_FAILED: RteEventRef=OpEventGetEventExtendedDataRecordEx_GetEventExtendedDataRecordEx_EvtInfo_AutoCreatedDemEvent_EEP_E_READ_FAILED
          OpEventGetMonitorStatus_GetMonitorStatus_EvtInfo_AutoCreatedDemEvent_MyECU_6c1a0d52_FrDemCtrlTestResultRef_1: RteEventRef=OpEventGetMonitorStatus_GetMonitorStatus_EvtInfo_AutoCreatedDemEvent_MyECU_6c1a0d52_FrDemCtrlTestResultRef_1
          OpEventGetEventFailed_GetEventFailed_EvtInfo_AutoCreatedDemEvent_FLS_E_READ_FAILED: RteEventRef=OpEventGetEventFailed_GetEventFailed_EvtInfo_AutoCreatedDemEvent_FLS_E_READ_FAILED
          OpEventGetEventEnableCondition_GetEventEnableCondition_EvtInfo_AutoCreatedDemEvent_EEP_E_ERASE_FAILED: RteEventRef=OpEventGetEventEnableCondition_GetEventEnableCondition_EvtInfo_AutoCreatedDemEvent_EEP_E_ERASE_FAILED
          OpEventGetFaultDetectionCounter_GetFaultDetectionCounter_EvtInfo_AutoCreatedDemEvent_McuModuleConfiguration_MCU_E_CLOCK_FAILURE: RteEventRef=OpEventGetFaultDetectionCounter_GetFaultDetectionCounter_EvtInfo_AutoCreatedDemEvent_McuModuleConfiguration_MCU_E_CLOCK_FAILURE
          OpEventGetEventExtendedDataRecordEx_GetEventExtendedDataRecordEx_EvtInfo_AutoCreatedDemEvent_MyECU_6c1a0d52_FrDemCtrlTe_ccda8acf: RteEventRef=OpEventGetEventExtendedDataRecordEx_GetEventExtendedDataRecordEx_EvtInfo_AutoCreatedDemEvent_MyECU_6c1a0d52_FrDemCtrlTe_ccda8acf
          OpEventGetFaultDetectionCounter_GetFaultDetectionCounter_EvtInfo_AutoCreatedDemEvent_CHNL_346f2748_CANSM_E_MODE_REQUEST_TIMEOUT: RteEventRef=OpEventGetFaultDetectionCounter_GetFaultDetectionCounter_EvtInfo_AutoCreatedDemEvent_CHNL_346f2748_CANSM_E_MODE_REQUEST_TIMEOUT
          OpEventGetEventTested_GetEventTested_EvtInfo_AutoCreatedDemEvent_CHNL_346f2748_CANSM_E_MODE_REQUEST_TIMEOUT: RteEventRef=OpEventGetEventTested_GetEventTested_EvtInfo_AutoCreatedDemEvent_CHNL_346f2748_CANSM_E_MODE_REQUEST_TIMEOUT
          OpEventGetEventFailed_GetEventFailed_EvtInfo_AutoCreatedDemEvent_NVM_E_QUEUE_OVERFLOW: RteEventRef=OpEventGetEventFailed_GetEventFailed_EvtInfo_AutoCreatedDemEvent_NVM_E_QUEUE_OVERFLOW
          OpEventGetMonitorStatus_GetMonitorStatus_EvtInfo_AutoCreatedDemEvent_FLS_E_READ_FAILED_1: RteEventRef=OpEventGetMonitorStatus_GetMonitorStatus_EvtInfo_AutoCreatedDemEvent_FLS_E_READ_FAILED_1
          OpEventGetEventUdsStatus_GetEventUdsStatus_EvtInfo_AutoCreatedDemEvent_NVM_E_WRITE_PROTECTED: RteEventRef=OpEventGetEventUdsStatus_GetEventUdsStatus_EvtInfo_AutoCreatedDemEvent_NVM_E_WRITE_PROTECTED
          OpEventGetMonitorStatus_GetMonitorStatus_EvtInfo_AutoCreatedDemEvent_McuModuleConfiguration_MCU_E_CLOCK_FAILURE_1: RteEventRef=OpEventGetMonitorStatus_GetMonitorStatus_EvtInfo_AutoCreatedDemEvent_McuModuleConfiguration_MCU_E_CLOCK_FAILURE_1
          OpEventGetEventStatus_GetEventStatus_EvtInfo_AutoCreatedDemEvent_FLS_E_COMPARE_FAILED: RteEventRef=OpEventGetEventStatus_GetEventStatus_EvtInfo_AutoCreatedDemEvent_FLS_E_COMPARE_FAILED
          OpEventGetDTCOfEvent_GetDTCOfEvent_EvtInfo_AutoCreatedDemEvent_ECUM_E_IMPROPER_CALLER: RteEventRef=OpEventGetDTCOfEvent_GetDTCOfEvent_EvtInfo_AutoCreatedDemEvent_ECUM_E_IMPROPER_CALLER
          OpEventGetEventExtendedDataRecordEx_GetEventExtendedDataRecordEx_EvtInfo_AutoCreatedDemEvent_FLS_E_ERASE_FAILED: RteEventRef=OpEventGetEventExtendedDataRecordEx_GetEventExtendedDataRecordEx_EvtInfo_AutoCreatedDemEvent_FLS_E_ERASE_FAILED
          OpEventGetMonitorStatus_GetMonitorStatus_EvtInfo_AutoCreatedDemEvent_ECUM_E_RAM_CHECK_FAILED: RteEventRef=OpEventGetMonitorStatus_GetMonitorStatus_EvtInfo_AutoCreatedDemEvent_ECUM_E_RAM_CHECK_FAILED
          OpEventGetDebouncingOfEvent_GetDebouncingOfEvent_EvtInfo_AutoCreatedDemEvent_FLS_E_READ_FAILED: RteEventRef=OpEventGetDebouncingOfEvent_GetDebouncingOfEvent_EvtInfo_AutoCreatedDemEvent_FLS_E_READ_FAILED
          OpEventGetEventStatus_GetEventStatus_EvtInfo_AutoCreatedDemEvent_CHNL_346f2748_CANSM_E_BUS_OFF: RteEventRef=OpEventGetEventStatus_GetEventStatus_EvtInfo_AutoCreatedDemEvent_CHNL_346f2748_CANSM_E_BUS_OFF
          OpEventGetEventTested_GetEventTested_EvtInfo_AutoCreatedDemEvent_FLS_E_WRITE_FAILED: RteEventRef=OpEventGetEventTested_GetEventTested_EvtInfo_AutoCreatedDemEvent_FLS_E_WRITE_FAILED
          OpEventGetEventExtendedDataRecordEx_GetEventExtendedDataRecordEx_EvtInfo_AutoCreatedDemEvent_EEP_E_COMPARE_FAILED: RteEventRef=OpEventGetEventExtendedDataRecordEx_GetEventExtendedDataRecordEx_EvtInfo_AutoCreatedDemEvent_EEP_E_COMPARE_FAILED
          OpEventGetMonitorStatus_GetMonitorStatus_EvtInfo_AutoCreatedDemEvent_NVM_E_QUEUE_OVERFLOW: RteEventRef=OpEventGetMonitorStatus_GetMonitorStatus_EvtInfo_AutoCreatedDemEvent_NVM_E_QUEUE_OVERFLOW
          OpEventGetEventUdsStatus_GetEventUdsStatus_EvtInfo_AutoCreatedDemEvent_FLS_E_READ_FAILED: RteEventRef=OpEventGetEventUdsStatus_GetEventUdsStatus_EvtInfo_AutoCreatedDemEvent_FLS_E_READ_FAILED
          OpEventGetEventUdsStatus_GetEventUdsStatus_EvtInfo_AutoCreatedDemEvent_MyECU_6c1a0d52_FrDemCtrlTestResultRef_1: RteEventRef=OpEventGetEventUdsStatus_GetEventUdsStatus_EvtInfo_AutoCreatedDemEvent_MyECU_6c1a0d52_FrDemCtrlTestResultRef_1
          OpEventGetEventTested_GetEventTested_EvtInfo_AutoCreatedDemEvent_ECUM_E_IMPROPER_CALLER: RteEventRef=OpEventGetEventTested_GetEventTested_EvtInfo_AutoCreatedDemEvent_ECUM_E_IMPROPER_CALLER
          OpEventGetEventEnableCondition_GetEventEnableCondition_EvtInfo_AutoCreatedDemEvent_EEP_E_READ_FAILED: RteEventRef=OpEventGetEventEnableCondition_GetEventEnableCondition_EvtInfo_AutoCreatedDemEvent_EEP_E_READ_FAILED
          OpEventGetEventFreezeFrameDataEx_GetEventFreezeFrameDataEx_EvtInfo_AutoCreatedDemEvent_NVM_E_QUEUE_OVERFLOW: RteEventRef=OpEventGetEventFreezeFrameDataEx_GetEventFreezeFrameDataEx_EvtInfo_AutoCreatedDemEvent_NVM_E_QUEUE_OVERFLOW
          OpEventGetMonitorStatus_GetMonitorStatus_EvtInfo_AutoCreatedDemEvent_XFRM_E_MALFORMED_MESSAGE: RteEventRef=OpEventGetMonitorStatus_GetMonitorStatus_EvtInfo_AutoCreatedDemEvent_XFRM_E_MALFORMED_MESSAGE
          OpEventGetDTCOfEvent_GetDTCOfEvent_EvtInfo_AutoCreatedDemEvent_EEP_E_READ_FAILED: RteEventRef=OpEventGetDTCOfEvent_GetDTCOfEvent_EvtInfo_AutoCreatedDemEvent_EEP_E_READ_FAILED
          OpEventGetFaultDetectionCounter_GetFaultDetectionCounter_EvtInfo_AutoCreatedDemEvent_FLS_E_COMPARE_FAILED: RteEventRef=OpEventGetFaultDetectionCounter_GetFaultDetectionCounter_EvtInfo_AutoCreatedDemEvent_FLS_E_COMPARE_FAILED
          OpEventGetEventFailed_GetEventFailed_EvtInfo_AutoCreatedDemEvent_FLS_E_UNEXPECTED_FLASH_ID: RteEventRef=OpEventGetEventFailed_GetEventFailed_EvtInfo_AutoCreatedDemEvent_FLS_E_UNEXPECTED_FLASH_ID
          OpEventGetFaultDetectionCounter_GetFaultDetectionCounter_EvtInfo_AutoCreatedDemEvent_FLS_E_UNEXPECTED_FLASH_ID_1: RteEventRef=OpEventGetFaultDetectionCounter_GetFaultDetectionCounter_EvtInfo_AutoCreatedDemEvent_FLS_E_UNEXPECTED_FLASH_ID_1
          OpEventGetEventEnableCondition_GetEventEnableCondition_EvtInfo_AutoCreatedDemEvent_FLS_E_WRITE_FAILED_1: RteEventRef=OpEventGetEventEnableCondition_GetEventEnableCondition_EvtInfo_AutoCreatedDemEvent_FLS_E_WRITE_FAILED_1
          OpEventGetEventTested_GetEventTested_EvtInfo_AutoCreatedDemEvent_XCP_E_INIT_FAILED: RteEventRef=OpEventGetEventTested_GetEventTested_EvtInfo_AutoCreatedDemEvent_XCP_E_INIT_FAILED
          OpEventGetDebouncingOfEvent_GetDebouncingOfEvent_EvtInfo_AutoCreatedDemEvent_McuModuleConfiguration_MCU_E_CLOCK_FAILURE_1: RteEventRef=OpEventGetDebouncingOfEvent_GetDebouncingOfEvent_EvtInfo_AutoCreatedDemEvent_McuModuleConfiguration_MCU_E_CLOCK_FAILURE_1
          OpEventGetEventFreezeFrameDataEx_GetEventFreezeFrameDataEx_EvtInfo_AutoCreatedDemEvent_FLS_E_ERASE_FAILED_1: RteEventRef=OpEventGetEventFreezeFrameDataEx_GetEventFreezeFrameDataEx_EvtInfo_AutoCreatedDemEvent_FLS_E_ERASE_FAILED_1
          OpEventGetDTCOfEvent_GetDTCOfEvent_EvtInfo_AutoCreatedDemEvent_FLS_E_ERASE_FAILED: RteEventRef=OpEventGetDTCOfEvent_GetDTCOfEvent_EvtInfo_AutoCreatedDemEvent_FLS_E_ERASE_FAILED
          OpEventGetEventEnableCondition_GetEventEnableCondition_EvtInfo_AutoCreatedDemEvent_XFRM_E_MALFORMED_MESSAGE_2: RteEventRef=OpEventGetEventEnableCondition_GetEventEnableCondition_EvtInfo_AutoCreatedDemEvent_XFRM_E_MALFORMED_MESSAGE_2
          OpEventGetEventStatus_GetEventStatus_EvtInfo_AutoCreatedDemEvent_LIN_E_TIMEOUT: RteEventRef=OpEventGetEventStatus_GetEventStatus_EvtInfo_AutoCreatedDemEvent_LIN_E_TIMEOUT
          OpEventGetDebouncingOfEvent_GetDebouncingOfEvent_EvtInfo_AutoCreatedDemEvent_EEP_E_READ_FAILED: RteEventRef=OpEventGetDebouncingOfEvent_GetDebouncingOfEvent_EvtInfo_AutoCreatedDemEvent_EEP_E_READ_FAILED
          OpEventGetEventFreezeFrameDataEx_GetEventFreezeFrameDataEx_EvtInfo_AutoCreatedDemEvent_ECUM_E_CONFIGURATION_DATA_INCONSISTENT: RteEventRef=OpEventGetEventFreezeFrameDataEx_GetEventFreezeFrameDataEx_EvtInfo_AutoCreatedDemEvent_ECUM_E_CONFIGURATION_DATA_INCONSISTENT
          OpEventGetDebouncingOfEvent_GetDebouncingOfEvent_EvtInfo_AutoCreatedDemEvent_McuModuleConfiguration_MCU_E_CLOCK_FAILURE: RteEventRef=OpEventGetDebouncingOfEvent_GetDebouncingOfEvent_EvtInfo_AutoCreatedDemEvent_McuModuleConfiguration_MCU_E_CLOCK_FAILURE
          OpEventGetEventFailed_GetEventFailed_EvtInfo_AutoCreatedDemEvent_NVM_E_WRONG_BLOCK_ID: RteEventRef=OpEventGetEventFailed_GetEventFailed_EvtInfo_AutoCreatedDemEvent_NVM_E_WRONG_BLOCK_ID
          OpEventGetEventFailed_GetEventFailed_EvtInfo_AutoCreatedDemEvent_ECUM_E_ALL_RUN_REQUESTS_KILLED: RteEventRef=OpEventGetEventFailed_GetEventFailed_EvtInfo_AutoCreatedDemEvent_ECUM_E_ALL_RUN_REQUESTS_KILLED
          OpEventGetEventExtendedDataRecordEx_GetEventExtendedDataRecordEx_EvtInfo_AutoCreatedDemEvent_NVM_E_REQ_FAILED: RteEventRef=OpEventGetEventExtendedDataRecordEx_GetEventExtendedDataRecordEx_EvtInfo_AutoCreatedDemEvent_NVM_E_REQ_FAILED
          OpEventGetEventFailed_GetEventFailed_EvtInfo_AutoCreatedDemEvent_XCP_E_INIT_FAILED: RteEventRef=OpEventGetEventFailed_GetEventFailed_EvtInfo_AutoCreatedDemEvent_XCP_E_INIT_FAILED
          OpEventGetDebouncingOfEvent_GetDebouncingOfEvent_EvtInfo_AutoCreatedDemEvent_ECUM_E_CONFIGURATION_DATA_INCONSISTENT: RteEventRef=OpEventGetDebouncingOfEvent_GetDebouncingOfEvent_EvtInfo_AutoCreatedDemEvent_ECUM_E_CONFIGURATION_DATA_INCONSISTENT
          OpEventGetFaultDetectionCounter_GetFaultDetectionCounter_EvtInfo_AutoCreatedDemEvent_ECUM_E_ALL_RUN_REQUESTS_KILLED: RteEventRef=OpEventGetFaultDetectionCounter_GetFaultDetectionCounter_EvtInfo_AutoCreatedDemEvent_ECUM_E_ALL_RUN_REQUESTS_KILLED
          OpEventGetEventExtendedDataRecordEx_GetEventExtendedDataRecordEx_EvtInfo_AutoCreatedDemEvent_FLS_E_UNEXPECTED_FLASH_ID_1: RteEventRef=OpEventGetEventExtendedDataRecordEx_GetEventExtendedDataRecordEx_EvtInfo_AutoCreatedDemEvent_FLS_E_UNEXPECTED_FLASH_ID_1
          OpEventGetEventStatus_GetEventStatus_EvtInfo_AutoCreatedDemEvent_EEP_E_COMPARE_FAILED: RteEventRef=OpEventGetEventStatus_GetEventStatus_EvtInfo_AutoCreatedDemEvent_EEP_E_COMPARE_FAILED
          OpEventGetEventEnableCondition_GetEventEnableCondition_EvtInfo_AutoCreatedDemEvent_FLS_E_READ_FAILED_1: RteEventRef=OpEventGetEventEnableCondition_GetEventEnableCondition_EvtInfo_AutoCreatedDemEvent_FLS_E_READ_FAILED_1
          OpEventGetEventUdsStatus_GetEventUdsStatus_EvtInfo_AutoCreatedDemEvent_ECUM_E_IMPROPER_CALLER: RteEventRef=OpEventGetEventUdsStatus_GetEventUdsStatus_EvtInfo_AutoCreatedDemEvent_ECUM_E_IMPROPER_CALLER
          OpEventGetMonitorStatus_GetMonitorStatus_EvtInfo_AutoCreatedDemEvent_ECUM_E_IMPROPER_CALLER: RteEventRef=OpEventGetMonitorStatus_GetMonitorStatus_EvtInfo_AutoCreatedDemEvent_ECUM_E_IMPROPER_CALLER
          OpEventGetEventUdsStatus_GetEventUdsStatus_EvtInfo_AutoCreatedDemEvent_EEP_E_WRITE_FAILED_1: RteEventRef=OpEventGetEventUdsStatus_GetEventUdsStatus_EvtInfo_AutoCreatedDemEvent_EEP_E_WRITE_FAILED_1
          OpEventGetDTCOfEvent_GetDTCOfEvent_EvtInfo_AutoCreatedDemEvent_McuModuleConfiguration_MCU_E_CLOCK_FAILURE: RteEventRef=OpEventGetDTCOfEvent_GetDTCOfEvent_EvtInfo_AutoCreatedDemEvent_McuModuleConfiguration_MCU_E_CLOCK_FAILURE
          OpEventGetDebouncingOfEvent_GetDebouncingOfEvent_EvtInfo_AutoCreatedDemEvent_FLS_E_COMPARE_FAILED_1: RteEventRef=OpEventGetDebouncingOfEvent_GetDebouncingOfEvent_EvtInfo_AutoCreatedDemEvent_FLS_E_COMPARE_FAILED_1
          OpEventGetDTCOfEvent_GetDTCOfEvent_EvtInfo_AutoCreatedDemEvent_BswMConfig_BswMReportFailToDemRef: RteEventRef=OpEventGetDTCOfEvent_GetDTCOfEvent_EvtInfo_AutoCreatedDemEvent_BswMConfig_BswMReportFailToDemRef
          OpEventGetEventFreezeFrameDataEx_GetEventFreezeFrameDataEx_EvtInfo_AutoCreatedDemEvent_FLS_E_READ_FAILED_1: RteEventRef=OpEventGetEventFreezeFrameDataEx_GetEventFreezeFrameDataEx_EvtInfo_AutoCreatedDemEvent_FLS_E_READ_FAILED_1
          OpEventGetEventTested_GetEventTested_EvtInfo_AutoCreatedDemEvent_NVM_E_QUEUE_OVERFLOW: RteEventRef=OpEventGetEventTested_GetEventTested_EvtInfo_AutoCreatedDemEvent_NVM_E_QUEUE_OVERFLOW
          OpEventGetFaultDetectionCounter_GetFaultDetectionCounter_EvtInfo_AutoCreatedDemEvent_ECUM_E_CONFIGURATION_DATA_INCONSISTENT: RteEventRef=OpEventGetFaultDetectionCounter_GetFaultDetectionCounter_EvtInfo_AutoCreatedDemEvent_ECUM_E_CONFIGURATION_DATA_INCONSISTENT
          OpEventGetEventEnableCondition_GetEventEnableCondition_EvtInfo_AutoCreatedDemEvent_EEP_E_READ_FAILED_1: RteEventRef=OpEventGetEventEnableCondition_GetEventEnableCondition_EvtInfo_AutoCreatedDemEvent_EEP_E_READ_FAILED_1
          OpEventGetMonitorStatus_GetMonitorStatus_EvtInfo_AutoCreatedDemEvent_CHNL_346f2748_CANSM_E_MODE_REQUEST_TIMEOUT: RteEventRef=OpEventGetMonitorStatus_GetMonitorStatus_EvtInfo_AutoCreatedDemEvent_CHNL_346f2748_CANSM_E_MODE_REQUEST_TIMEOUT
          OpEventGetEventExtendedDataRecordEx_GetEventExtendedDataRecordEx_EvtInfo_AutoCreatedDemEvent_McuModuleConfiguration_MCU_c1a2a5db: RteEventRef=OpEventGetEventExtendedDataRecordEx_GetEventExtendedDataRecordEx_EvtInfo_AutoCreatedDemEvent_McuModuleConfiguration_MCU_c1a2a5db
          OpEventGetDebouncingOfEvent_GetDebouncingOfEvent_EvtInfo_AutoCreatedDemEvent_MyECU_6c1a0d52_FrDemCtrlTestResultRef_1: RteEventRef=OpEventGetDebouncingOfEvent_GetDebouncingOfEvent_EvtInfo_AutoCreatedDemEvent_MyECU_6c1a0d52_FrDemCtrlTestResultRef_1
          OpEventGetDebouncingOfEvent_GetDebouncingOfEvent_EvtInfo_AutoCreatedDemEvent_FLS_E_READ_FAILED_1: RteEventRef=OpEventGetDebouncingOfEvent_GetDebouncingOfEvent_EvtInfo_AutoCreatedDemEvent_FLS_E_READ_FAILED_1
          OpEventGetDebouncingOfEvent_GetDebouncingOfEvent_EvtInfo_AutoCreatedDemEvent_EEP_E_COMPARE_FAILED: RteEventRef=OpEventGetDebouncingOfEvent_GetDebouncingOfEvent_EvtInfo_AutoCreatedDemEvent_EEP_E_COMPARE_FAILED
          OpEventGetEventEnableCondition_GetEventEnableCondition_EvtInfo_AutoCreatedDemEvent_NVM_E_WRITE_PROTECTED: RteEventRef=OpEventGetEventEnableCondition_GetEventEnableCondition_EvtInfo_AutoCreatedDemEvent_NVM_E_WRITE_PROTECTED
          OpEventGetEventStatus_GetEventStatus_EvtInfo_AutoCreatedDemEvent_XFRM_E_MALFORMED_MESSAGE_2: RteEventRef=OpEventGetEventStatus_GetEventStatus_EvtInfo_AutoCreatedDemEvent_XFRM_E_MALFORMED_MESSAGE_2
          OpEventGetDTCOfEvent_GetDTCOfEvent_EvtInfo_AutoCreatedDemEvent_EEP_E_WRITE_FAILED_1: RteEventRef=OpEventGetDTCOfEvent_GetDTCOfEvent_EvtInfo_AutoCreatedDemEvent_EEP_E_WRITE_FAILED_1
          OpEventGetDTCOfEvent_GetDTCOfEvent_EvtInfo_AutoCreatedDemEvent_CHNL_346f2748_CANSM_E_BUS_OFF: RteEventRef=OpEventGetDTCOfEvent_GetDTCOfEvent_EvtInfo_AutoCreatedDemEvent_CHNL_346f2748_CANSM_E_BUS_OFF
          OpEventGetEventTested_GetEventTested_EvtInfo_AutoCreatedDemEvent_FLS_E_ERASE_FAILED_1: RteEventRef=OpEventGetEventTested_GetEventTested_EvtInfo_AutoCreatedDemEvent_FLS_E_ERASE_FAILED_1
          OpEventGetEventEnableCondition_GetEventEnableCondition_EvtInfo_AutoCreatedDemEvent_XCP_E_INIT_FAILED: RteEventRef=OpEventGetEventEnableCondition_GetEventEnableCondition_EvtInfo_AutoCreatedDemEvent_XCP_E_INIT_FAILED
          OpEventGetMonitorStatus_GetMonitorStatus_EvtInfo_AutoCreatedDemEvent_NVM_E_VERIFY_FAILED: RteEventRef=OpEventGetMonitorStatus_GetMonitorStatus_EvtInfo_AutoCreatedDemEvent_NVM_E_VERIFY_FAILED
          OpEventGetDTCOfEvent_GetDTCOfEvent_EvtInfo_AutoCreatedDemEvent_FLS_E_READ_FAILED: RteEventRef=OpEventGetDTCOfEvent_GetDTCOfEvent_EvtInfo_AutoCreatedDemEvent_FLS_E_READ_FAILED
          OpEventGetEventEnableCondition_GetEventEnableCondition_EvtInfo_AutoCreatedDemEvent_McuModuleConfiguration_MCU_E_CLOCK_FAILURE_1: RteEventRef=OpEventGetEventEnableCondition_GetEventEnableCondition_EvtInfo_AutoCreatedDemEvent_McuModuleConfiguration_MCU_E_CLOCK_FAILURE_1
          OpEventGetEventTested_GetEventTested_EvtInfo_AutoCreatedDemEvent_EEP_E_WRITE_FAILED_1: RteEventRef=OpEventGetEventTested_GetEventTested_EvtInfo_AutoCreatedDemEvent_EEP_E_WRITE_FAILED_1
          OpEventGetFaultDetectionCounter_GetFaultDetectionCounter_EvtInfo_AutoCreatedDemEvent_FLS_E_WRITE_FAILED_1: RteEventRef=OpEventGetFaultDetectionCounter_GetFaultDetectionCounter_EvtInfo_AutoCreatedDemEvent_FLS_E_WRITE_FAILED_1
          OpEventGetDebouncingOfEvent_GetDebouncingOfEvent_EvtInfo_AutoCreatedDemEvent_EEP_E_READ_FAILED_1: RteEventRef=OpEventGetDebouncingOfEvent_GetDebouncingOfEvent_EvtInfo_AutoCreatedDemEvent_EEP_E_READ_FAILED_1
          OpEventGetEventStatus_GetEventStatus_EvtInfo_AutoCreatedDemEvent_ECUM_E_IMPROPER_CALLER: RteEventRef=OpEventGetEventStatus_GetEventStatus_EvtInfo_AutoCreatedDemEvent_ECUM_E_IMPROPER_CALLER
          OpEventGetEventFreezeFrameDataEx_GetEventFreezeFrameDataEx_EvtInfo_AutoCreatedDemEvent_EEP_E_COMPARE_FAILED_1: RteEventRef=OpEventGetEventFreezeFrameDataEx_GetEventFreezeFrameDataEx_EvtInfo_AutoCreatedDemEvent_EEP_E_COMPARE_FAILED_1
          OpEventGetEventStatus_GetEventStatus_EvtInfo_AutoCreatedDemEvent_FLS_E_ERASE_FAILED_1: RteEventRef=OpEventGetEventStatus_GetEventStatus_EvtInfo_AutoCreatedDemEvent_FLS_E_ERASE_FAILED_1
          OpEventGetEventFailed_GetEventFailed_EvtInfo_AutoCreatedDemEvent_EEP_E_WRITE_FAILED: RteEventRef=OpEventGetEventFailed_GetEventFailed_EvtInfo_AutoCreatedDemEvent_EEP_E_WRITE_FAILED
          OpEventGetDTCOfEvent_GetDTCOfEvent_EvtInfo_AutoCreatedDemEvent_EEP_E_READ_FAILED_1: RteEventRef=OpEventGetDTCOfEvent_GetDTCOfEvent_EvtInfo_AutoCreatedDemEvent_EEP_E_READ_FAILED_1
          OpEventGetEventEnableCondition_GetEventEnableCondition_EvtInfo_AutoCreatedDemEvent_MyECU_6c1a0d52_FrDemCtrlTestResultRef_1: RteEventRef=OpEventGetEventEnableCondition_GetEventEnableCondition_EvtInfo_AutoCreatedDemEvent_MyECU_6c1a0d52_FrDemCtrlTestResultRef_1
          OpEventGetEventEnableCondition_GetEventEnableCondition_EvtInfo_AutoCreatedDemEvent_MyECU_6c1a0d52_FrDemCtrlTestResultRef: RteEventRef=OpEventGetEventEnableCondition_GetEventEnableCondition_EvtInfo_AutoCreatedDemEvent_MyECU_6c1a0d52_FrDemCtrlTestResultRef
          OpEventGetFaultDetectionCounter_GetFaultDetectionCounter_EvtInfo_AutoCreatedDemEvent_NVM_E_VERIFY_FAILED: RteEventRef=OpEventGetFaultDetectionCounter_GetFaultDetectionCounter_EvtInfo_AutoCreatedDemEvent_NVM_E_VERIFY_FAILED
          OpEventGetEventTested_GetEventTested_EvtInfo_AutoCreatedDemEvent_EEP_E_COMPARE_FAILED_1: RteEventRef=OpEventGetEventTested_GetEventTested_EvtInfo_AutoCreatedDemEvent_EEP_E_COMPARE_FAILED_1
          OpEventGetEventExtendedDataRecordEx_GetEventExtendedDataRecordEx_EvtInfo_AutoCreatedDemEvent_CHNL_346f2748_CANSM_E_BUS_OFF: RteEventRef=OpEventGetEventExtendedDataRecordEx_GetEventExtendedDataRecordEx_EvtInfo_AutoCreatedDemEvent_CHNL_346f2748_CANSM_E_BUS_OFF
          OpEventGetFaultDetectionCounter_GetFaultDetectionCounter_EvtInfo_AutoCreatedDemEvent_BswMConfig_BswMReportFailToDemRef: RteEventRef=OpEventGetFaultDetectionCounter_GetFaultDetectionCounter_EvtInfo_AutoCreatedDemEvent_BswMConfig_BswMReportFailToDemRef
          OpEventGetEventExtendedDataRecordEx_GetEventExtendedDataRecordEx_EvtInfo_AutoCreatedDemEvent_XCP_E_INIT_FAILED: RteEventRef=OpEventGetEventExtendedDataRecordEx_GetEventExtendedDataRecordEx_EvtInfo_AutoCreatedDemEvent_XCP_E_INIT_FAILED
          OpEventGetDTCOfEvent_GetDTCOfEvent_EvtInfo_AutoCreatedDemEvent_CHNL_346f2748_CANSM_E_MODE_REQUEST_TIMEOUT: RteEventRef=OpEventGetDTCOfEvent_GetDTCOfEvent_EvtInfo_AutoCreatedDemEvent_CHNL_346f2748_CANSM_E_MODE_REQUEST_TIMEOUT
          OpEventGetDebouncingOfEvent_GetDebouncingOfEvent_EvtInfo_AutoCreatedDemEvent_NVM_E_QUEUE_OVERFLOW: RteEventRef=OpEventGetDebouncingOfEvent_GetDebouncingOfEvent_EvtInfo_AutoCreatedDemEvent_NVM_E_QUEUE_OVERFLOW
          OpEventGetEventStatus_GetEventStatus_EvtInfo_AutoCreatedDemEvent_FLS_E_READ_FAILED_1: RteEventRef=OpEventGetEventStatus_GetEventStatus_EvtInfo_AutoCreatedDemEvent_FLS_E_READ_FAILED_1
          OpEventGetMonitorStatus_GetMonitorStatus_EvtInfo_AutoCreatedDemEvent_NVM_E_REQ_FAILED: RteEventRef=OpEventGetMonitorStatus_GetMonitorStatus_EvtInfo_AutoCreatedDemEvent_NVM_E_REQ_FAILED
          OpEventGetFaultDetectionCounter_GetFaultDetectionCounter_EvtInfo_AutoCreatedDemEvent_ECUM_E_IMPROPER_CALLER: RteEventRef=OpEventGetFaultDetectionCounter_GetFaultDetectionCounter_EvtInfo_AutoCreatedDemEvent_ECUM_E_IMPROPER_CALLER
          OpEventGetEventFailed_GetEventFailed_EvtInfo_AutoCreatedDemEvent_LIN_E_TIMEOUT: RteEventRef=OpEventGetEventFailed_GetEventFailed_EvtInfo_AutoCreatedDemEvent_LIN_E_TIMEOUT
          OpEventGetEventFailed_GetEventFailed_EvtInfo_AutoCreatedDemEvent_FLS_E_WRITE_FAILED_1: RteEventRef=OpEventGetEventFailed_GetEventFailed_EvtInfo_AutoCreatedDemEvent_FLS_E_WRITE_FAILED_1
          OpEventGetDebouncingOfEvent_GetDebouncingOfEvent_EvtInfo_AutoCreatedDemEvent_NVM_E_REQ_FAILED: RteEventRef=OpEventGetDebouncingOfEvent_GetDebouncingOfEvent_EvtInfo_AutoCreatedDemEvent_NVM_E_REQ_FAILED
          OpEventGetEventEnableCondition_GetEventEnableCondition_EvtInfo_AutoCreatedDemEvent_BswMConfig_BswMReportFailToDemRef: RteEventRef=OpEventGetEventEnableCondition_GetEventEnableCondition_EvtInfo_AutoCreatedDemEvent_BswMConfig_BswMReportFailToDemRef
          OpEventGetEventEnableCondition_GetEventEnableCondition_EvtInfo_AutoCreatedDemEvent_LIN_E_TIMEOUT: RteEventRef=OpEventGetEventEnableCondition_GetEventEnableCondition_EvtInfo_AutoCreatedDemEvent_LIN_E_TIMEOUT
          OpEventGetDTCOfEvent_GetDTCOfEvent_EvtInfo_AutoCreatedDemEvent_EEP_E_COMPARE_FAILED_1: RteEventRef=OpEventGetDTCOfEvent_GetDTCOfEvent_EvtInfo_AutoCreatedDemEvent_EEP_E_COMPARE_FAILED_1
          OpEventGetEventTested_GetEventTested_EvtInfo_AutoCreatedDemEvent_ECUM_E_CONFIGURATION_DATA_INCONSISTENT: RteEventRef=OpEventGetEventTested_GetEventTested_EvtInfo_AutoCreatedDemEvent_ECUM_E_CONFIGURATION_DATA_INCONSISTENT
          OpEventGetFaultDetectionCounter_GetFaultDetectionCounter_EvtInfo_AutoCreatedDemEvent_EEP_E_ERASE_FAILED: RteEventRef=OpEventGetFaultDetectionCounter_GetFaultDetectionCounter_EvtInfo_AutoCreatedDemEvent_EEP_E_ERASE_FAILED
          OpEventGetEventTested_GetEventTested_EvtInfo_AutoCreatedDemEvent_EEP_E_COMPARE_FAILED: RteEventRef=OpEventGetEventTested_GetEventTested_EvtInfo_AutoCreatedDemEvent_EEP_E_COMPARE_FAILED
          OpEventGetEventUdsStatus_GetEventUdsStatus_EvtInfo_AutoCreatedDemEvent_CHNL_346f2748_CANSM_E_BUS_OFF: RteEventRef=OpEventGetEventUdsStatus_GetEventUdsStatus_EvtInfo_AutoCreatedDemEvent_CHNL_346f2748_CANSM_E_BUS_OFF
          OpEventGetEventUdsStatus_GetEventUdsStatus_EvtInfo_AutoCreatedDemEvent_NVM_E_VERIFY_FAILED: RteEventRef=OpEventGetEventUdsStatus_GetEventUdsStatus_EvtInfo_AutoCreatedDemEvent_NVM_E_VERIFY_FAILED
          OpEventGetEventUdsStatus_GetEventUdsStatus_EvtInfo_AutoCreatedDemEvent_ECUM_E_CONFIGURATION_DATA_INCONSISTENT: RteEventRef=OpEventGetEventUdsStatus_GetEventUdsStatus_EvtInfo_AutoCreatedDemEvent_ECUM_E_CONFIGURATION_DATA_INCONSISTENT
          OpEventGetEventExtendedDataRecordEx_GetEventExtendedDataRecordEx_EvtInfo_AutoCreatedDemEvent_XFRM_E_MALFORMED_MESSAGE: RteEventRef=OpEventGetEventExtendedDataRecordEx_GetEventExtendedDataRecordEx_EvtInfo_AutoCreatedDemEvent_XFRM_E_MALFORMED_MESSAGE
          OpEventGetDebouncingOfEvent_GetDebouncingOfEvent_EvtInfo_AutoCreatedDemEvent_NVM_E_VERIFY_FAILED: RteEventRef=OpEventGetDebouncingOfEvent_GetDebouncingOfEvent_EvtInfo_AutoCreatedDemEvent_NVM_E_VERIFY_FAILED
          OpEventGetEventUdsStatus_GetEventUdsStatus_EvtInfo_AutoCreatedDemEvent_XFRM_E_MALFORMED_MESSAGE: RteEventRef=OpEventGetEventUdsStatus_GetEventUdsStatus_EvtInfo_AutoCreatedDemEvent_XFRM_E_MALFORMED_MESSAGE
          OpEventGetDebouncingOfEvent_GetDebouncingOfEvent_EvtInfo_AutoCreatedDemEvent_EEP_E_ERASE_FAILED_1: RteEventRef=OpEventGetDebouncingOfEvent_GetDebouncingOfEvent_EvtInfo_AutoCreatedDemEvent_EEP_E_ERASE_FAILED_1
          OpEventGetEventEnableCondition_GetEventEnableCondition_EvtInfo_AutoCreatedDemEvent_NVM_E_VERIFY_FAILED: RteEventRef=OpEventGetEventEnableCondition_GetEventEnableCondition_EvtInfo_AutoCreatedDemEvent_NVM_E_VERIFY_FAILED
          OpEventGetEventEnableCondition_GetEventEnableCondition_EvtInfo_AutoCreatedDemEvent_FLS_E_UNEXPECTED_FLASH_ID: RteEventRef=OpEventGetEventEnableCondition_GetEventEnableCondition_EvtInfo_AutoCreatedDemEvent_FLS_E_UNEXPECTED_FLASH_ID
          OpEventGetFaultDetectionCounter_GetFaultDetectionCounter_EvtInfo_AutoCreatedDemEvent_XFRM_E_MALFORMED_MESSAGE_2: RteEventRef=OpEventGetFaultDetectionCounter_GetFaultDetectionCounter_EvtInfo_AutoCreatedDemEvent_XFRM_E_MALFORMED_MESSAGE_2
          OpEventGetDTCOfEvent_GetDTCOfEvent_EvtInfo_AutoCreatedDemEvent_XFRM_E_MALFORMED_MESSAGE: RteEventRef=OpEventGetDTCOfEvent_GetDTCOfEvent_EvtInfo_AutoCreatedDemEvent_XFRM_E_MALFORMED_MESSAGE
          OpEventGetFaultDetectionCounter_GetFaultDetectionCounter_EvtInfo_AutoCreatedDemEvent_EEP_E_COMPARE_FAILED: RteEventRef=OpEventGetFaultDetectionCounter_GetFaultDetectionCounter_EvtInfo_AutoCreatedDemEvent_EEP_E_COMPARE_FAILED
          OpEventGetDTCOfEvent_GetDTCOfEvent_EvtInfo_AutoCreatedDemEvent_NVM_E_WRONG_BLOCK_ID: RteEventRef=OpEventGetDTCOfEvent_GetDTCOfEvent_EvtInfo_AutoCreatedDemEvent_NVM_E_WRONG_BLOCK_ID
          OpEventGetEventFreezeFrameDataEx_GetEventFreezeFrameDataEx_EvtInfo_AutoCreatedDemEvent_FLS_E_UNEXPECTED_FLASH_ID_1: RteEventRef=OpEventGetEventFreezeFrameDataEx_GetEventFreezeFrameDataEx_EvtInfo_AutoCreatedDemEvent_FLS_E_UNEXPECTED_FLASH_ID_1
          OpEventGetEventFailed_GetEventFailed_EvtInfo_AutoCreatedDemEvent_McuModuleConfiguration_MCU_E_CLOCK_FAILURE: RteEventRef=OpEventGetEventFailed_GetEventFailed_EvtInfo_AutoCreatedDemEvent_McuModuleConfiguration_MCU_E_CLOCK_FAILURE
          OpEventGetEventFailed_GetEventFailed_EvtInfo_AutoCreatedDemEvent_EEP_E_ERASE_FAILED: RteEventRef=OpEventGetEventFailed_GetEventFailed_EvtInfo_AutoCreatedDemEvent_EEP_E_ERASE_FAILED
          OpEventGetEventStatus_GetEventStatus_EvtInfo_AutoCreatedDemEvent_FLS_E_WRITE_FAILED: RteEventRef=OpEventGetEventStatus_GetEventStatus_EvtInfo_AutoCreatedDemEvent_FLS_E_WRITE_FAILED
          OpEventGetEventStatus_GetEventStatus_EvtInfo_AutoCreatedDemEvent_MyECU_6c1a0d52_FrDemCtrlTestResultRef_1: RteEventRef=OpEventGetEventStatus_GetEventStatus_EvtInfo_AutoCreatedDemEvent_MyECU_6c1a0d52_FrDemCtrlTestResultRef_1
          OpEventGetMonitorStatus_GetMonitorStatus_EvtInfo_AutoCreatedDemEvent_XFRM_E_MALFORMED_MESSAGE_1: RteEventRef=OpEventGetMonitorStatus_GetMonitorStatus_EvtInfo_AutoCreatedDemEvent_XFRM_E_MALFORMED_MESSAGE_1
          OpEventGetEventFreezeFrameDataEx_GetEventFreezeFrameDataEx_EvtInfo_AutoCreatedDemEvent_XFRM_E_MALFORMED_MESSAGE: RteEventRef=OpEventGetEventFreezeFrameDataEx_GetEventFreezeFrameDataEx_EvtInfo_AutoCreatedDemEvent_XFRM_E_MALFORMED_MESSAGE
          OpEventGetEventEnableCondition_GetEventEnableCondition_EvtInfo_AutoCreatedDemEvent_NVM_E_INTEGRITY_FAILED: RteEventRef=OpEventGetEventEnableCondition_GetEventEnableCondition_EvtInfo_AutoCreatedDemEvent_NVM_E_INTEGRITY_FAILED
          OpEventGetEventStatus_GetEventStatus_EvtInfo_AutoCreatedDemEvent_NVM_E_WRONG_BLOCK_ID: RteEventRef=OpEventGetEventStatus_GetEventStatus_EvtInfo_AutoCreatedDemEvent_NVM_E_WRONG_BLOCK_ID
          OpEventGetMonitorStatus_GetMonitorStatus_EvtInfo_AutoCreatedDemEvent_FLS_E_COMPARE_FAILED_1: RteEventRef=OpEventGetMonitorStatus_GetMonitorStatus_EvtInfo_AutoCreatedDemEvent_FLS_E_COMPARE_FAILED_1
          OpEventGetEventFreezeFrameDataEx_GetEventFreezeFrameDataEx_EvtInfo_AutoCreatedDemEvent_FLS_E_COMPARE_FAILED_1: RteEventRef=OpEventGetEventFreezeFrameDataEx_GetEventFreezeFrameDataEx_EvtInfo_AutoCreatedDemEvent_FLS_E_COMPARE_FAILED_1
          OpEventGetEventEnableCondition_GetEventEnableCondition_EvtInfo_AutoCreatedDemEvent_EEP_E_COMPARE_FAILED: RteEventRef=OpEventGetEventEnableCondition_GetEventEnableCondition_EvtInfo_AutoCreatedDemEvent_EEP_E_COMPARE_FAILED
          OpEventGetMonitorStatus_GetMonitorStatus_EvtInfo_AutoCreatedDemEvent_FLS_E_READ_FAILED: RteEventRef=OpEventGetMonitorStatus_GetMonitorStatus_EvtInfo_AutoCreatedDemEvent_FLS_E_READ_FAILED
          OpEventGetFaultDetectionCounter_GetFaultDetectionCounter_EvtInfo_AutoCreatedDemEvent_ECUM_E_RAM_CHECK_FAILED: RteEventRef=OpEventGetFaultDetectionCounter_GetFaultDetectionCounter_EvtInfo_AutoCreatedDemEvent_ECUM_E_RAM_CHECK_FAILED
          OpEventGetEventStatus_GetEventStatus_EvtInfo_AutoCreatedDemEvent_XFRM_E_MALFORMED_MESSAGE: RteEventRef=OpEventGetEventStatus_GetEventStatus_EvtInfo_AutoCreatedDemEvent_XFRM_E_MALFORMED_MESSAGE
          OpEventGetMonitorStatus_GetMonitorStatus_EvtInfo_AutoCreatedDemEvent_EEP_E_COMPARE_FAILED_1: RteEventRef=OpEventGetMonitorStatus_GetMonitorStatus_EvtInfo_AutoCreatedDemEvent_EEP_E_COMPARE_FAILED_1
          OpEventGetEventUdsStatus_GetEventUdsStatus_EvtInfo_AutoCreatedDemEvent_EEP_E_WRITE_FAILED: RteEventRef=OpEventGetEventUdsStatus_GetEventUdsStatus_EvtInfo_AutoCreatedDemEvent_EEP_E_WRITE_FAILED
          OpEventGetEventTested_GetEventTested_EvtInfo_AutoCreatedDemEvent_FLS_E_ERASE_FAILED: RteEventRef=OpEventGetEventTested_GetEventTested_EvtInfo_AutoCreatedDemEvent_FLS_E_ERASE_FAILED
          OpEventGetEventUdsStatus_GetEventUdsStatus_EvtInfo_AutoCreatedDemEvent_FLS_E_ERASE_FAILED_1: RteEventRef=OpEventGetEventUdsStatus_GetEventUdsStatus_EvtInfo_AutoCreatedDemEvent_FLS_E_ERASE_FAILED_1
          OpEventGetEventTested_GetEventTested_EvtInfo_AutoCreatedDemEvent_NVM_E_VERIFY_FAILED: RteEventRef=OpEventGetEventTested_GetEventTested_EvtInfo_AutoCreatedDemEvent_NVM_E_VERIFY_FAILED
          OpEventGetDebouncingOfEvent_GetDebouncingOfEvent_EvtInfo_AutoCreatedDemEvent_FLS_E_ERASE_FAILED: RteEventRef=OpEventGetDebouncingOfEvent_GetDebouncingOfEvent_EvtInfo_AutoCreatedDemEvent_FLS_E_ERASE_FAILED
          OpEventGetMonitorStatus_GetMonitorStatus_EvtInfo_AutoCreatedDemEvent_EEP_E_WRITE_FAILED: RteEventRef=OpEventGetMonitorStatus_GetMonitorStatus_EvtInfo_AutoCreatedDemEvent_EEP_E_WRITE_FAILED
          OpEventGetDTCOfEvent_GetDTCOfEvent_EvtInfo_AutoCreatedDemEvent_FLS_E_UNEXPECTED_FLASH_ID_1: RteEventRef=OpEventGetDTCOfEvent_GetDTCOfEvent_EvtInfo_AutoCreatedDemEvent_FLS_E_UNEXPECTED_FLASH_ID_1
          OpEventGetEventStatus_GetEventStatus_EvtInfo_AutoCreatedDemEvent_EEP_E_WRITE_FAILED: RteEventRef=OpEventGetEventStatus_GetEventStatus_EvtInfo_AutoCreatedDemEvent_EEP_E_WRITE_FAILED
