AUTOSAR XML (schema 00048)
package /ActiveEcuC
  module config EthSM: implementation-config-variant=VARIANT-PRE-COMPILE, module-description=EthSM_Impl
    EthSMGeneral: EthSMDevErrorDetect=true, EthSMMainFunctionPeriod=0.02, EthSMVersionInfoApi=true, EthSMEnableEthIfApiTimeout=false, EthSMSafeBswChecks=false
      EthSMGeneration: EthSMOutOfBoundsWriteSanitizer=false, EthSMOutOfBoundsReadSanitizer=false, EthSMShortSymbols=false
    MyECU_EEI_V10_NM_53547422 (EthSMNetwork):
      EthSMConfirmationTimeout = 0.1
      EthSMMaxNumRetry = 0
      EthSMStackType = TcpIp
      EthSMComMNetworkHandleRef = MyECU_EEI_V10_NM_53547422
      EthSMEthIfControllerRef = MyECU_EEI_V10_NM_53547422
    MyECU_EEI_U_ee15deea (EthSMNetwork):
      EthSMConfirmationTimeout = 0.1
      EthSMMaxNumRetry = 0
      EthSMStackType = TcpIp
      EthSMComMNetworkHandleRef = MyECU_EEI_U_ee15deea
      EthSMEthIfControllerRef = MyECU_EEI_U_ee15deea
