AUTOSAR XML (schema 4-3-0)
package /ActiveEcuC
  module config Gpt: implementation-config-variant=VARIANT-POST-BUILD, module-description=Gpt_Impl
    GptChannelConfigSet
      GptChannel_RandomGenerator (GptChannelConfiguration):
        GptChannelId = 0
        GptAssignedHwUnit = GPT12
        GptChannelMode = GPT_CH_MODE_CONTINUOUS
        GptTimerChannelUsage = GPT_TIMER_CHANNEL_NORMAL
        GptChannelTickFrequency = 1
        GptChannelTickValueMax = 65535
        GptEnableWakeup = false
        GptNotification = Gpt_Notification
        GptChannelClkSrcRef = GptClockReferencePoint
        Gpt12TimerOutputModuleConfiguration_0 (Gpt12TimerOutputModuleConfiguration): Gpt12ChannelClockDivider=0, Gpt12TimerUsed=McuGpt12ModuleAllocationConf_0
        Gpt12TimerOutputModuleConfiguration_1 (Gpt12TimerOutputModuleConfiguration): Gpt12ChannelClockDivider=0, Gpt12TimerUsed=McuGpt12ModuleAllocationConf_1
    GptConfigurationOfOptApiServices:
      GptDeinitApi = true
      GptTimeElapsedApi = true
      GptTimeRemainingApi = true
      GptVersionInfoApi = true
      GptWakeupFunctionalityApi = false
      GptEnableDisableNotificationApi = true
    GptDriverConfiguration:
      GptDevErrorDetect = true
      GptReportWakeupSource = false
      GptMultiCoreErrorDetect = false
      GptRunTimeErrorDetect = true
      GptPredefTimer100us32bitEnable = false
      GptPredefTimer1usEnablingGrade = GPT_PREDEF_TIMER_1US_DISABLED
      GptSafetyEnable = true
      GptReadAcrossCores = false
      GptInitCheckApi = false
      GptClockReferencePoint: GptClockReference=McuClockReferencePoint_Can, GptClockReferenceConfig=McuClockReferencePointConfig
    CommonPublishedInformation:
      ArMajorVersion = 4
      ArMinorVersion = 0
      ArPatchVersion = 3
      SwMajorVersion = 2
      SwMinorVersion = 7
      SwPatchVersion = 0
      ModuleId = 100
      VendorId = 17
      Release = _TRICORE_TC397_ADAS
