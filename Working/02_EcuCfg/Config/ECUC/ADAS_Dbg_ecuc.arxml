AUTOSAR XML (schema 4-3-0)
package /ActiveEcuC
  module config Dbg: implementation-config-variant=VARIANT-PRE-COMPILE, module-description=Dbg_Impl
    DbgGeneral: DbgDevErrorDetect=true, DbgVersionInfoApi=true, DbgSamplingFunctionPeriod=0.01, DbgHeaderFileInclusion=Os.h, DbgSafeBswChecks=false
    DbgMultipleConfigurationContainer
      13 x DbgStaticDID, all with DbgAutomaticCollectionFrequency=0, DbgStaticDIDActivation=false, DbgStaticDIDBuffering=false, DbgStaticTimeStampActivation=false:
        IdleTask_OsCore0: DbgStaticDIDNameRef=IdleTask_OsCore0
          osGetStackUsage (DbgStaticDIDData)
            DbgLocalDebugData: DbgFunctionCall=Os_GetTaskStackUsage(IdleTask_OsCore0), DbgLocalDebugDataRef=uint32
        Default_Appl_Init_Task: DbgStaticDIDNameRef=Default_Appl_Init_Task
          osGetStackUsage (DbgStaticDIDData)
            DbgLocalDebugData: DbgFunctionCall=Os_GetTaskStackUsage(Default_Appl_Init_Task), DbgLocalDebugDataRef=uint32
        Default_BSW_Sync_Task: DbgStaticDIDNameRef=Default_BSW_Sync_Task
          osGetStackUsage (DbgStaticDIDData)
            DbgLocalDebugData: DbgFunctionCall=Os_GetTaskStackUsage(Default_BSW_Sync_Task), DbgLocalDebugDataRef=uint32
        Default_Init_Task: DbgStaticDIDNameRef=Default_Init_Task
          osGetStackUsage (DbgStaticDIDData)
            DbgLocalDebugData: DbgFunctionCall=Os_GetTaskStackUsage(Default_Init_Task), DbgLocalDebugDataRef=uint32
        Default_Appl_Task: DbgStaticDIDNameRef=Default_Appl_Task
          osGetStackUsage (DbgStaticDIDData)
            DbgLocalDebugData: DbgFunctionCall=Os_GetTaskStackUsage(Default_Appl_Task), DbgLocalDebugDataRef=uint32
        Default_BSW_Async_Task: DbgStaticDIDNameRef=Default_BSW_Async_Task
          osGetStackUsage (DbgStaticDIDData)
            DbgLocalDebugData: DbgFunctionCall=Os_GetTaskStackUsage(Default_BSW_Async_Task), DbgLocalDebugDataRef=uint32
        Default_RTE_Mode_switch_Task: DbgStaticDIDNameRef=Default_RTE_Mode_switch_Task
          osGetStackUsage (DbgStaticDIDData)
            DbgLocalDebugData: DbgFunctionCall=Os_GetTaskStackUsage(Default_RTE_Mode_switch_Task), DbgLocalDebugDataRef=uint32
        CounterIsr_SystemTimer: DbgStaticDIDNameRef=
          DbgStaticDIDData
            DbgLocalDebugData: DbgFunctionCall=Os_GetISRStackUsage(CounterIsr_SystemTimer_Core0), DbgLocalDebugDataRef=uint32
        StartApplication_Appl_Task: DbgStaticDIDNameRef=StartApplication_Appl_Task
          osGetStackUsage (DbgStaticDIDData)
            DbgLocalDebugData: DbgFunctionCall=Os_GetTaskStackUsage(StartApplication_Appl_Task), DbgLocalDebugDataRef=uint32
        StartApplication_Appl_Init_Task: DbgStaticDIDNameRef=StartApplication_Appl_Init_Task
          osGetStackUsage (DbgStaticDIDData)
            DbgLocalDebugData: DbgFunctionCall=Os_GetTaskStackUsage(StartApplication_Appl_Init_Task), DbgLocalDebugDataRef=uint32
        StartApplication_NoSwc_Appl_Task: DbgStaticDIDNameRef=StartApplication_NoSwc_Appl_Task
          osGetStackUsage (DbgStaticDIDData)
            DbgLocalDebugData: DbgFunctionCall=Os_GetTaskStackUsage(StartApplication_NoSwc_Appl_Task), DbgLocalDebugDataRef=uint32
        StartApplication_NoSwc_Init_Task: DbgStaticDIDNameRef=StartApplication_NoSwc_Init_Task
          osGetStackUsage (DbgStaticDIDData)
            DbgLocalDebugData: DbgFunctionCall=Os_GetTaskStackUsage(StartApplication_NoSwc_Init_Task), DbgLocalDebugDataRef=uint32
        BswBackgroundTask: DbgStaticDIDNameRef=BswBackgroundTask
          osGetStackUsage (DbgStaticDIDData)
            DbgLocalDebugData: DbgFunctionCall=Os_GetTaskStackUsage(BswBackgroundTask), DbgLocalDebugDataRef=uint32
