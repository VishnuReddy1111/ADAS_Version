AUTOSAR XML (schema 4-3-0)
package /ActiveEcuC
  module config SecOC: implementation-config-variant=VARIANT-PRE-COMPILE, module-description=SecOC_Impl
    SecOCGeneration:
      SecOCOutOfBoundsWriteProtectionStrategy = NONE
      SecOCOutOfBoundsWriteSanitizer = false
      SecOCOutOfBoundsReadSanitizer = false
      SecOCShortSymbols = false
      SecOCInterfacesForDeactivatedData = false
      SecOCReferringKeysInComments = false
    SecOCGeneral:
      SecOCDevErrorDetect = true
      SecOCEnableForcedPassOverride = false
      SecOcIgnoreVerificationResult = false
      SecOCMainFunctionPeriodRx = 0.005
      SecOCMainFunctionPeriodTx = 0.005
      SecOCMaxAlignScalarType = uint8
      SecOCQueryFreshnessValue = RTE
      SecOCVersionInfoApi = true
      SecOCMaxMessageLinkerSizeOfRxPdus = 0
      SecOCSafeBswChecks = false
      SecOCPropagateOnlyFinalVerificationStatus = false
      SecOCEnableDevelopmentMode = false
      SecOCUseGetRxFreshness = true
      SecOCUseGetRxFreshnessAuthData = true
      SecOCUseGetTxFreshness = true
      SecOCUseGetTxFreshnessTruncData = false
      SecOCUseSPduTxConfirmation = false
      SecOCEnableCustomAuthenticationAPI = false
      SecOCCanFdPadding = false
      SecOCRetryFailedTransmitRequest = true
      SecOCUseMSBAlignedTruncatedFreshnessValueInFvM = false
      SecOCEnableAsyncCSMJobTimeout = false
    OBD_HCP1_SOK_XIX_HCP5_CANFD01_499f5f1b_Rx (SecOCRxPduProcessing):
      SecOCAuthDataFreshnessLen = 0
      SecOCAuthDataFreshnessStartPosition = 0
      SecOCAuthInfoTxLength = 32
      SecOCAuthenticationBuildAttempts = 1
      SecOCAuthenticationVerifyAttempts = 4
      SecOCDataId = 864
      SecOCFreshnessValueId = 2
      SecOCFreshnessValueLength = 64
      SecOCFreshnessValueTxLength = 0
      SecOCUseAuthDataFreshness = false
      SecOCReceptionOverflowStrategy = REJECT
      SecOCVerificationStatusPropagationMode = NONE
      SecOCVerificationStatusWithSecuredPduPropagationMode = NONE
      SecOCImmediateProcessingOfCsmCallback = false
      SecOCPduProcessing = DEFERRED
      SecOCClientServerVerificationStatusPropagationMode = NONE
      SecOCRxAuthServiceConfigRef = StartApplication_MAC_Verify
      OBD_HCP1_XIX_HCP5_CANFD01_1b389b6c_Rx (SecOCRxAuthenticPduLayer): SecOCPduType=SECOC_IFPDU, SecOCRxAuthenticLayerPduRef=OBD_HCP1_XIX_HCP5_CANFD01_1b389b6c_Rx
      SecOCRxSecuredPduLayer
        OBD_HCP1_SOK_XIX_HCP5_CANFD01_499f5f1b_Rx (SecOCRxSecuredPdu): SecOCSecuredRxPduVerification=false, SecOCRxSecuredLayerPduId=1, SecOCRxSecuredLayerPduRef=OBD_HCP1_SOK_XIX_HCP5_CANFD01_499f5f1b_Rx
    SOK_Zeit_Hybrid_01_Resp_01_SOK_XIX_HCP5_CANFD01_92adacdc_Rx (SecOCRxPduProcessing):
      SecOCAuthDataFreshnessLen = 0
      SecOCAuthDataFreshnessStartPosition = 0
      SecOCAuthInfoTxLength = 64
      SecOCAuthenticationBuildAttempts = 1
      SecOCAuthenticationVerifyAttempts = 1
      SecOCDataId = 402
      SecOCFreshnessValueId = 0
      SecOCFreshnessValueLength = 64
      SecOCFreshnessValueTxLength = 0
      SecOCUseAuthDataFreshness = true
      SecOCReceptionOverflowStrategy = REJECT
      SecOCVerificationStatusPropagationMode = NONE
      SecOCVerificationStatusWithSecuredPduPropagationMode = NONE
      SecOCImmediateProcessingOfCsmCallback = false
      SecOCPduProcessing = DEFERRED
      SecOCClientServerVerificationStatusPropagationMode = NONE
      SecOCRxAuthServiceConfigRef = StartApplication_MAC_Verify
      SecOCRxSecuredPduLayer
        SOK_Zeit_Hybrid_01_Resp_01_SOK_XIX_HCP5_CANFD01_92adacdc_Rx (SecOCRxSecuredPdu):
          SecOCSecuredRxPduVerification = false
          SecOCRxSecuredLayerPduId = 2
          SecOCRxSecuredLayerPduRef = SOK_Zeit_Hybrid_01_Resp_01_SOK_XIX_HCP5_CANFD01_92adacdc_Rx
      SOK_Zeit_Hybrid_01_Resp_01_XIX_HCP5_CANFD01_c7a98a10_Rx (SecOCRxAuthenticPduLayer): SecOCPduType=SECOC_IFPDU, SecOCRxAuthenticLayerPduRef=SOK_Zeit_Hybrid_01_Resp_01_XIX_HCP5_CANFD01_c7a98a10_Rx
    4 x SecOCTxPduProcessing, all with SecOCAuthInfoTxLength=32, SecOCAuthenticationBuildAttempts=1, SecOCFreshnessValueLength=64, SecOCFreshnessValueTxLength=0, SecOCProvideTxTruncatedFreshnessValue=false, SecOCUseTxConfirmation=false, SecOCAddCANFDContainerPduPadding=false, SecOCImmediateProcessingOfCsmCallback=false, SecOCPduProcessing=DEFERRED, SecOCTxAuthServiceConfigRef=StartApplication_MAC_Generate:
      BMC_HV_08_SOK_XIX_HCP5_CANFD01_29bed328_Tx: SecOCDataId=731, SecOCFreshnessValueId=4
        BMC_HV_08_XIX_HCP5_CANFD01_fbc0b232_Tx (SecOCTxAuthenticPduLayer): SecOCPduType=SECOC_IFPDU, SecOCTxAuthenticLayerPduId=4, SecOCTxAuthenticLayerPduRef=BMC_HV_08_XIX_HCP5_CANFD01_fbc0b232_Tx
        SecOCTxSecuredPduLayer
          BMC_HV_08_SOK_XIX_HCP5_CANFD01_29bed328_Tx (SecOCTxSecuredPdu): SecOCTxSecuredLayerPduId=4, SecOCPduType=SECOC_IFPDU, SecOCTxSecuredLayerPduRef=BMC_HV_08_SOK_XIX_HCP5_CANFD01_29bed328_Tx
      BMC_HV_06_SOK_XIX_HCP5_CANFD01_e20cafa8_Tx: SecOCDataId=535, SecOCFreshnessValueId=2
        BMC_HV_06_XIX_HCP5_CANFD01_e2eda0bb_Tx (SecOCTxAuthenticPduLayer): SecOCPduType=SECOC_IFPDU, SecOCTxAuthenticLayerPduId=2, SecOCTxAuthenticLayerPduRef=BMC_HV_06_XIX_HCP5_CANFD01_e2eda0bb_Tx
        SecOCTxSecuredPduLayer
          BMC_HV_06_SOK_XIX_HCP5_CANFD01_e20cafa8_Tx (SecOCTxSecuredPdu): SecOCTxSecuredLayerPduId=2, SecOCPduType=SECOC_IFPDU, SecOCTxSecuredLayerPduRef=BMC_HV_06_SOK_XIX_HCP5_CANFD01_e20cafa8_Tx
      BMC_HV_07_SOK_XIX_HCP5_CANFD01_f524cb68_Tx: SecOCDataId=730, SecOCFreshnessValueId=3
        BMC_HV_07_XIX_HCP5_CANFD01_0dbf165a_Tx (SecOCTxAuthenticPduLayer): SecOCPduType=SECOC_IFPDU, SecOCTxAuthenticLayerPduId=3, SecOCTxAuthenticLayerPduRef=BMC_HV_07_XIX_HCP5_CANFD01_0dbf165a_Tx
        SecOCTxSecuredPduLayer
          BMC_HV_07_SOK_XIX_HCP5_CANFD01_f524cb68_Tx (SecOCTxSecuredPdu): SecOCTxSecuredLayerPduId=3, SecOCPduType=SECOC_IFPDU, SecOCTxSecuredLayerPduRef=BMC_HV_07_SOK_XIX_HCP5_CANFD01_f524cb68_Tx
      OBD_Hybrid_01_SOK_XIX_HCP5_CANFD01_86ce2f2e_Tx: SecOCDataId=865, SecOCFreshnessValueId=7
        OBD_Hybrid_01_XIX_HCP5_CANFD01_40f9dae5_Tx (SecOCTxAuthenticPduLayer): SecOCPduType=SECOC_IFPDU, SecOCTxAuthenticLayerPduId=7, SecOCTxAuthenticLayerPduRef=OBD_Hybrid_01_XIX_HCP5_CANFD01_40f9dae5_Tx
        SecOCTxSecuredPduLayer
          OBD_Hybrid_01_SOK_XIX_HCP5_CANFD01_86ce2f2e_Tx (SecOCTxSecuredPdu): SecOCTxSecuredLayerPduId=7, SecOCPduType=SECOC_IFPDU, SecOCTxSecuredLayerPduRef=OBD_Hybrid_01_SOK_XIX_HCP5_CANFD01_86ce2f2e_Tx
    HVK_03_E2E_SOK_XIX_HCP5_CANFD01_32c3c9b9_Rx (SecOCRxPduProcessing):
      SecOCAuthDataFreshnessLen = 0
      SecOCAuthDataFreshnessStartPosition = 0
      SecOCAuthInfoTxLength = 32
      SecOCAuthenticationBuildAttempts = 1
      SecOCAuthenticationVerifyAttempts = 4
      SecOCDataId = 715
      SecOCFreshnessValueId = 1
      SecOCFreshnessValueLength = 64
      SecOCFreshnessValueTxLength = 0
      SecOCUseAuthDataFreshness = true
      SecOCReceptionOverflowStrategy = REJECT
      SecOCVerificationStatusPropagationMode = NONE
      SecOCVerificationStatusWithSecuredPduPropagationMode = NONE
      SecOCImmediateProcessingOfCsmCallback = false
      SecOCPduProcessing = DEFERRED
      SecOCClientServerVerificationStatusPropagationMode = NONE
      SecOCRxAuthServiceConfigRef = StartApplication_MAC_Verify
      HVK_03_XIX_HCP5_CANFD01_E2E_8a76edcb_Rx (SecOCRxAuthenticPduLayer): SecOCPduType=SECOC_IFPDU, SecOCRxAuthenticLayerPduRef=HVK_03_XIX_HCP5_CANFD01_E2E_8a76edcb_Rx
      SecOCRxSecuredPduLayer
        HVK_03_E2E_SOK_XIX_HCP5_CANFD01_32c3c9b9_Rx (SecOCRxSecuredPdu): SecOCSecuredRxPduVerification=false, SecOCRxSecuredLayerPduId=0, SecOCRxSecuredLayerPduRef=HVK_03_E2E_SOK_XIX_HCP5_CANFD01_32c3c9b9_Rx
    4 x SecOCTxPduProcessing, all with SecOCAuthInfoTxLength=32, SecOCAuthenticationBuildAttempts=1, SecOCFreshnessValueLength=64, SecOCFreshnessValueTxLength=0, SecOCProvideTxTruncatedFreshnessValue=false, SecOCUseTxConfirmation=false, SecOCAddCANFDContainerPduPadding=false, SecOCImmediateProcessingOfCsmCallback=false, SecOCPduProcessing=DEFERRED, SecOCTxAuthServiceConfigRef=StartApplication_MAC_Generate:
      BMC_HV_01_E2E_SOK_XIX_HCP5_CANFD01_ad756307_Tx: SecOCDataId=533, SecOCFreshnessValueId=0
        BMC_HV_01_XIX_HCP5_CANFD01_E2E_fcbbcae3_Tx (SecOCTxAuthenticPduLayer): SecOCPduType=SECOC_IFPDU, SecOCTxAuthenticLayerPduId=0, SecOCTxAuthenticLayerPduRef=BMC_HV_01_XIX_HCP5_CANFD01_E2E_fcbbcae3_Tx
        SecOCTxSecuredPduLayer
          BMC_HV_01_E2E_SOK_XIX_HCP5_CANFD01_ad756307_Tx (SecOCTxSecuredPdu): SecOCTxSecuredLayerPduId=0, SecOCPduType=SECOC_IFPDU, SecOCTxSecuredLayerPduRef=BMC_HV_01_E2E_SOK_XIX_HCP5_CANFD01_ad756307_Tx
      BMC_HV_02_E2E_SOK_XIX_HCP5_CANFD01_5f228eff_Tx: SecOCDataId=534, SecOCFreshnessValueId=1
        BMC_HV_02_XIX_HCP5_CANFD01_E2E_c5c367a3_Tx (SecOCTxAuthenticPduLayer): SecOCPduType=SECOC_IFPDU, SecOCTxAuthenticLayerPduId=1, SecOCTxAuthenticLayerPduRef=BMC_HV_02_XIX_HCP5_CANFD01_E2E_c5c367a3_Tx
        SecOCTxSecuredPduLayer
          BMC_HV_02_E2E_SOK_XIX_HCP5_CANFD01_5f228eff_Tx (SecOCTxSecuredPdu): SecOCTxSecuredLayerPduId=1, SecOCPduType=SECOC_IFPDU, SecOCTxSecuredLayerPduRef=BMC_HV_02_E2E_SOK_XIX_HCP5_CANFD01_5f228eff_Tx
      BMC_HV_09_SOK_XIX_HCP5_CANFD01_3e96b7e8_Tx: SecOCDataId=810, SecOCFreshnessValueId=5
        BMC_HV_09_XIX_HCP5_CANFD01_149204d3_Tx (SecOCTxAuthenticPduLayer): SecOCPduType=SECOC_IFPDU, SecOCTxAuthenticLayerPduId=5, SecOCTxAuthenticLayerPduRef=BMC_HV_09_XIX_HCP5_CANFD01_149204d3_Tx
        SecOCTxSecuredPduLayer
          BMC_HV_09_SOK_XIX_HCP5_CANFD01_3e96b7e8_Tx (SecOCTxSecuredPdu): SecOCTxSecuredLayerPduId=5, SecOCPduType=SECOC_IFPDU, SecOCTxSecuredLayerPduRef=BMC_HV_09_SOK_XIX_HCP5_CANFD01_3e96b7e8_Tx
      BMC_HV_14_SOK_XIX_HCP5_CANFD01_572f8cfc_Tx: SecOCDataId=846, SecOCFreshnessValueId=6
        BMC_HV_14_XIX_HCP5_CANFD01_30db4b60_Tx (SecOCTxAuthenticPduLayer): SecOCPduType=SECOC_IFPDU, SecOCTxAuthenticLayerPduId=6, SecOCTxAuthenticLayerPduRef=BMC_HV_14_XIX_HCP5_CANFD01_30db4b60_Tx
        SecOCTxSecuredPduLayer
          BMC_HV_14_SOK_XIX_HCP5_CANFD01_572f8cfc_Tx (SecOCTxSecuredPdu): SecOCTxSecuredLayerPduId=6, SecOCPduType=SECOC_IFPDU, SecOCTxSecuredLayerPduRef=BMC_HV_14_SOK_XIX_HCP5_CANFD01_572f8cfc_Tx
