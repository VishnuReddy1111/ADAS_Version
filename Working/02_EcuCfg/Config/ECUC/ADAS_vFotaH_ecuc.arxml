AUTOSAR XML (schema 4-3-0)
package /ActiveEcuC
  module config vFotaH: implementation-config-variant=VARIANT-PRE-COMPILE, module-description=vFotaH_Impl
    vFotaHConfig
      vFotaHReferences: vFotaHProtocolRow=DcmDslProtocolRow_29812fbf, vFotaHNvMModuleInfoBlock=vFotaH_NvMModuleInfo
      ApplicationData_LB1 (vFotaHLogicalBlock): vFotaHLogicalBlockId=0, vFotaHModuleRef=vSwUpdMModule_LB1
      CalibrationData_LB0 (vFotaHLogicalBlock): vFotaHLogicalBlockId=1, vFotaHModuleRef=vSwUpdMModule_LB0
    vFotaHGeneral:
      vFotaHVersionInfoApi = true
      vFotaHRuntimeMeasurementSupport = false
      vFotaHSafeBswChecks = false
      vFotaHMainFunctionPeriod = 0.005
      vFotaHDevErrorDetect = true
      vFotaHFingerprintLength = 7
      vFotaHVersionInfoLength = 3
