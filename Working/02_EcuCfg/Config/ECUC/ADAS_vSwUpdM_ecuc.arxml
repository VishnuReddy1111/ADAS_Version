AUTOSAR XML (schema 4-3-0)
package /ActiveEcuC
  module config vSwUpdM: implementation-config-variant=VARIANT-PRE-COMPILE, module-description=vSwUpdM_Impl
    vSwUpdMDataProcessing: vSwUpdMMaxInputStreamSize=1024, vSwUpdMDefaultProcessingSegmentation=256, vSwUpdMRemoteProcessingSegmentation=256
      4 x vSwUpdMDataProcess:
        vSwUpdMDataProcess_CRC: vSwUpdMDataProcessId=3, vSwUpdMDataProcessType=VERIFY_MODULE, vSwUpdMDataProcessPipeRef=CRCPipe, vSwUpdMDataProcessSubScope=SegmentListWritten
          vSwUpdMInternalDataOutput: vSwUpdMInternalDataOutputId=0, vSwUpdMInternalDataOutputType=OutputResult, vSwUpdMInternalDataOutputRef=vStreamProcExitPoint_Result
          vSwUpdMInternalDataInput_Entities (vSwUpdMInternalDataInput): vSwUpdMInternalDataInputId=0, vSwUpdMInternalDataInputType=InputEntities, vSwUpdMInternalDataInputRef=vStreamProcEntryPoint_Entities
          vSwUpdMInternalDataInput_Range (vSwUpdMInternalDataInput): vSwUpdMInternalDataInputId=1, vSwUpdMInternalDataInputType=InputRange, vSwUpdMInternalDataInputRef=vStreamProcEntryPoint_Range
          vSwUpdMExternalDataInput: vSwUpdMExternalDataInputId=0, vSwUpdMExternalDataInputRef=vStreamProcEntryPoint_CRC
        CopyModule: vSwUpdMDataProcessType=NONE, vSwUpdMDataProcessId=1, vSwUpdMDataProcessPipeRef=vSwUpdMSyncModuleCopyPipe, vSwUpdMDataProcessSubScope=SegmentListSyncCopy
          3 x vSwUpdMInternalDataInput:
            CopyInputEntitiesSource: vSwUpdMInternalDataInputId=0, vSwUpdMInternalDataInputType=InputEntitiesSource, vSwUpdMInternalDataInputRef=vSwUpdMSyncModuleCopy_SourceEntities_Entry
            CopyInputEntitiesTarget: vSwUpdMInternalDataInputId=1, vSwUpdMInternalDataInputType=InputEntities, vSwUpdMInternalDataInputRef=vSwUpdMSyncModuleCopy_TargetEntities_Entry
            CopyInputRange: vSwUpdMInternalDataInputId=2, vSwUpdMInternalDataInputType=InputRange, vSwUpdMInternalDataInputRef=vSwUpdMSyncModuleCopy_Range_Entry
          CopyOutputResult (vSwUpdMInternalDataOutput): vSwUpdMInternalDataOutputId=0, vSwUpdMInternalDataOutputType=OutputResult, vSwUpdMInternalDataOutputRef=vSwUpdMSyncModuleCopy_Result_Exit
        CompareModule: vSwUpdMDataProcessType=NONE, vSwUpdMDataProcessId=0, vSwUpdMDataProcessPipeRef=vSwUpdMSyncModuleComparePipe, vSwUpdMDataProcessSubScope=SegmentListSyncCompare
          3 x vSwUpdMInternalDataInput:
            CompareInputRange: vSwUpdMInternalDataInputId=0, vSwUpdMInternalDataInputType=InputRange, vSwUpdMInternalDataInputRef=vSwUpdMSyncModuleCompare_Range_Entry
            CompareInputEntitesSource: vSwUpdMInternalDataInputId=1, vSwUpdMInternalDataInputType=InputEntitiesSource, vSwUpdMInternalDataInputRef=vSwUpdMSyncModuleCompare_SourceEntities_Entry
            CompareInputEntitesTarget: vSwUpdMInternalDataInputId=2, vSwUpdMInternalDataInputType=InputEntities, vSwUpdMInternalDataInputRef=vSwUpdMSyncModuleCompare_TargetEntities_Entry
          CompareOutputResult (vSwUpdMInternalDataOutput): vSwUpdMInternalDataOutputId=0, vSwUpdMInternalDataOutputType=OutputResult, vSwUpdMInternalDataOutputRef=vSwUpdMSyncModuleCompare_Result_Exit
        StreamData: vSwUpdMDataProcessType=STREAM_DATA_PROCESSING, vSwUpdMDataProcessId=2, vSwUpdMDataProcessPipeRef=vSwUpdMStreamDataPipe
          3 x vSwUpdMInternalDataInput:
            StreamDataInputData: vSwUpdMInternalDataInputId=0, vSwUpdMInternalDataInputRef=vSwUpdMStreamData_Data_Entry, vSwUpdMInternalDataInputType=InputData
            StreamDataInputEntities: vSwUpdMInternalDataInputId=1, vSwUpdMInternalDataInputRef=vSwUpdMStreamData_Entities_Entry, vSwUpdMInternalDataInputType=InputEntities
            StreamDataInputRange: vSwUpdMInternalDataInputId=2, vSwUpdMInternalDataInputRef=vSwUpdMStreamData_Range_Entry, vSwUpdMInternalDataInputType=InputRange
          StreamDataResultingRanges (vSwUpdMInternalDataOutput):
            vSwUpdMInternalDataOutputId = 0
            vSwUpdMInternalDataOutputRef = vSwUpdMStreamData_ResultingRanges_Exit
            vSwUpdMInternalDataOutputType = ResultingRanges
          StreamDataOutputResult (vSwUpdMInternalDataOutput): vSwUpdMInternalDataOutputId=1, vSwUpdMInternalDataOutputRef=vSwUpdMStreamData_Result_Exit, vSwUpdMInternalDataOutputType=OutputResult
          vSwUpdMModeUnprocessed (vSwUpdMExternalMode):
            vSwUpdMExternalModeId = 0
            vSwUpdMExternalModeResumeOffset = 0
            vSwUpdMExternalModeExplicitRestartHandlingRequired = false
            vSwUpdMExternalModeRef = vSwUpdMStreamDataPipe_ProcMode_Unprocessed
          vSwUpdMModeLocal (vSwUpdMInternalMode): vSwUpdMInternalModeId=0, vSwUpdMInternalModeRef=vSwUpdMStreamDataPipe_ProcMode_Local, vSwUpdMInternalModeType=Local
          vSwUpdMModeRemote (vSwUpdMInternalMode): vSwUpdMInternalModeId=1, vSwUpdMInternalModeRef=vSwUpdMStreamDataPipe_ProcMode_Remote, vSwUpdMInternalModeType=Remote
    vSwUpdMBookkeeper
      vSwUpdMPersistor
        vSwUpdMPersistorClient:
          vSwUpdMAllPersistorServerGroupRemote = vSwUpdMNodeGroupLocalInstance
          vSwUpdMGlobalOwnerGroup = vSwUpdMNodeGroupLocalInstance
          vSwUpdMAllPersistorServerGroupLocal = vSwUpdMNodeGroupLocalInstance
          vSwUpdMPartition: vSwUpdMCalcResult=vSwUpdMNodeGroupLocalInstance
            vSwUpdMPartitionStateGroup: vSwUpdMPartitionMaskGroup=vSwUpdMPartitionStateMaskAllStates, vSwUpdMCalcResult=vSwUpdMNodeGroupLocalInstance
        vSwUpdMPartitionStateMaskAllStates (vSwUpdMPartitionStateMask):
          vSwUpdMPartitionStateMaskId = 0
          vSwUpdMStateMaskMember = vSwUpdMPartitionStateActive
          vSwUpdMStateMaskMember = vSwUpdMPartitionStateInactive
          vSwUpdMStateMaskMember = vSwUpdMPartitionStateBackupTarget
          vSwUpdMStateMaskMember = vSwUpdMPartitionStateBackupSource
          vSwUpdMStateMaskMember = vSwUpdMPartitionStateActivationPending
        vSwUpdMPersistorServer: vSwUpdMGlobalClientGroup=vSwUpdMNodeGroupLocalInstance
    vSwUpdMGrid
      vSwUpdMNodeLocalInstance (vSwUpdMNode): vSwUpdMNodeActsAsMaster=false, vSwUpdMNodeId=0
        vSwUpdMNodeChannelDefinition
          vSwUpdMNodeMainChannel
          vSwUpdMNodeSuspendChannel
          vSwUpdMNodeMaintenanceChannel
          vSwUpdMNodeBookkeeperChannel
      vSwUpdMNodeGroupLocalInstance (vSwUpdMNodeGroup): vSwUpdMNodeGroupId=0, vSwUpdMNodeGroupMember=vSwUpdMNodeLocalInstance
        vSwUpdMNodeGroupChannelDefinition
          vSwUpdMNodeGroupMainChannel
          vSwUpdMNodeGroupSuspendChannel
          vSwUpdMNodeGroupMaintenanceChannel
          vSwUpdMNodeGroupBookkeeperChannel
    vSwUpdMGeneral:
      vSwUpdMDynamicNumberOfModules = 0
      vSwUpdMDynamicNumberOfPartitions = 0
      vSwUpdMDynamicNumberOfRegions = 0
      vSwUpdMVersionInfoApi = false
      vSwUpdMSafeBswChecks = false
      vSwUpdMDevErrorDetect = true
      vSwUpdMMainFunctionPeriod = 0.005
      vSwUpdMDynamicNumberOfSegments = 16
      vSwUpdMUpperLayer = VFOTAH
      vSwUpdMFillByte = 0
      vSwUpdMPipelinedProgramming = false
      vSwUpdMLocalNode = vSwUpdMNodeLocalInstance
      vSwUpdMBroadcastGroup = vSwUpdMNodeGroupLocalInstance
    vSwUpdMLayout
      Partition_B (vSwUpdMPartition): vSwUpdMPartitionId=1, vSwUpdMPartitionHandle=2, vSwUpdMAddressAreaRef=vMemAccMAddressArea_B
        vSwUpdMCheckpointAddress: vSwUpdMCheckpoint=0
        vSwUpdMPersistorServer: vSwUpdMCalcResult=vSwUpdMNodeGroupLocalInstance
          vSwUpdMPartitionStateGroup: vSwUpdMPartitionMaskGroup=vSwUpdMPartitionStateMaskAllStates, vSwUpdMCalcResult=vSwUpdMNodeGroupLocalInstance
      vSwUpdMRegion_LB0 (vSwUpdMRegion):
        vSwUpdMStartAddress = 65536
        vSwUpdMLength = 8192
        vSwUpdMRegionId = 0
        vSwUpdMModuleRef = vSwUpdMModule_LB0
        vSwUpdMRegionOwners = vSwUpdMNodeGroupLocalInstance
      vSwUpdMRegion_LB1 (vSwUpdMRegion):
        vSwUpdMStartAddress = 131072
        vSwUpdMLength = 8192
        vSwUpdMRegionId = 1
        vSwUpdMModuleRef = vSwUpdMModule_LB1
        vSwUpdMRegionOwners = vSwUpdMNodeGroupLocalInstance
      vSwUpdMModule_LB1 (vSwUpdMModule):
        vSwUpdMMaxProgAttempts = 1000
        vSwUpdMMetaDataAddress = 0
        vSwUpdMMandatory = true
        vSwUpdMModuleId = 0
        vSwUpdMModuleHandle = 1
        vSwUpdMPartitionGroupRef = vSwUpdMPartitionGroup_Swap
        vSwUpdMModuleOwners = vSwUpdMNodeGroupLocalInstance
      vSwUpdMPartitionGroup_Swap (vSwUpdMPartitionGroup): vSwUpdMPartitionRef=Partition_A, vSwUpdMPartitionRef=Partition_B
      vSwUpdMModule_LB0 (vSwUpdMModule):
        vSwUpdMMaxProgAttempts = 1000
        vSwUpdMMetaDataAddress = 0
        vSwUpdMMandatory = true
        vSwUpdMModuleId = 1
        vSwUpdMModuleHandle = 0
        vSwUpdMPartitionGroupRef = vSwUpdMPartitionGroup_Swap
        vSwUpdMModuleOwners = vSwUpdMNodeGroupLocalInstance
      Partition_A (vSwUpdMPartition): vSwUpdMPartitionId=0, vSwUpdMPartitionHandle=1, vSwUpdMAddressAreaRef=vMemAccMAddressArea_A
        vSwUpdMCheckpointAddress: vSwUpdMCheckpoint=0
        vSwUpdMPersistorServer
          vSwUpdMPartitionStateGroup: vSwUpdMPartitionMaskGroup=vSwUpdMPartitionStateMaskAllStates, vSwUpdMCalcResult=vSwUpdMNodeGroupLocalInstance
    vSwUpdMParameterization
      31 x vSwUpdMService, all with vSwUpdMServiceHookType=PRE_AND_POST:
        Start: vSwUpdMServiceId=16
        Shutdown: vSwUpdMServiceId=17
        Abort: vSwUpdMServiceId=18
        Suspend: vSwUpdMServiceId=19
        Resume: vSwUpdMServiceId=20
        OpenPartition: vSwUpdMServiceId=32
        ValidatePartition: vSwUpdMServiceId=33
        InvalidatePartition: vSwUpdMServiceId=34
        SyncPartition: vSwUpdMServiceId=35
        CheckPartitionConsistency: vSwUpdMServiceId=36
        SwapActivePartition: vSwUpdMServiceId=37
        OpenModule: vSwUpdMServiceId=48
        CloseModule: vSwUpdMServiceId=49
        EraseModule: vSwUpdMServiceId=50
        SyncModule: vSwUpdMServiceId=51
        ValidateModule: vSwUpdMServiceId=52
        InvalidateModule: vSwUpdMServiceId=53
        FinalizeModule: vSwUpdMServiceId=61
        EraseRegion: vSwUpdMServiceId=80
        OpenSegment: vSwUpdMServiceId=96
        CloseSegment: vSwUpdMServiceId=97
        FinalizeSegment: vSwUpdMServiceId=106
        EraseRange: vSwUpdMServiceId=112
        ReadRange: vSwUpdMServiceId=113
        WriteRange: vSwUpdMServiceId=114
        StartStream: vSwUpdMServiceId=128
        ProcessStreamData: vSwUpdMServiceId=129
        EndStream: vSwUpdMServiceId=130
        SwitchStreamContext: vSwUpdMServiceId=132
        ProcessModule: vSwUpdMServiceId=65
        VerifyModule: vSwUpdMServiceId=64
      3 x vSwUpdMDataInputType:
        InputData: vSwUpdMDataInputTypeId=0, vSwUpdMStreamProcDataTypeRef=uint8
        InputEntities: vSwUpdMDataInputTypeId=1, vSwUpdMStreamProcDataTypeRef=vSwUpdM_EntityIdsType
        InputRange: vSwUpdMDataInputTypeId=4, vSwUpdMStreamProcDataTypeRef=vSwUpdM_RangeInfoType
      OutputResult (vSwUpdMDataOutputType): vSwUpdMDataOutputTypeId=1, vSwUpdMStreamProcDataTypeRef=Std_ReturnType
      ResultingRanges (vSwUpdMDataOutputType): vSwUpdMDataOutputTypeId=2, vSwUpdMStreamProcDataTypeRef=vSwUpdM_RangeInfoType
      3 x vSwUpdMModeType:
        Local: vSwUpdMModeTypeId=0
        LocalAndRemote: vSwUpdMModeTypeId=1
        Remote: vSwUpdMModeTypeId=2
      InputEntitiesSource (vSwUpdMDataInputType): vSwUpdMDataInputTypeId=2, vSwUpdMStreamProcDataTypeRef=vSwUpdM_EntityIdsType
      InputOperation (vSwUpdMDataInputType): vSwUpdMDataInputTypeId=3, vSwUpdMStreamProcDataTypeRef=vSwUpdM_ProcNodeOperationType
      OutputOperation (vSwUpdMDataOutputType): vSwUpdMDataOutputTypeId=0, vSwUpdMStreamProcDataTypeRef=vSwUpdM_ProcNodeOperationType
      4 x vSwUpdMSubScope:
        SegmentListWritten: vSwUpdMSubScopeId=0
        SegmentListSyncCopy: vSwUpdMSubScopeId=1
        SegmentListSyncCompare: vSwUpdMSubScopeId=2
        SegmentListFullModule: vSwUpdMSubScopeId=3
      5 x vSwUpdMPartitionState:
        vSwUpdMPartitionStateActive: vSwUpdMBitPosition=0, vSwUpdMPartitionStateId=1
        vSwUpdMPartitionStateInactive: vSwUpdMBitPosition=1, vSwUpdMPartitionStateId=4
        vSwUpdMPartitionStateBackupTarget: vSwUpdMBitPosition=2, vSwUpdMPartitionStateId=3
        vSwUpdMPartitionStateBackupSource: vSwUpdMBitPosition=3, vSwUpdMPartitionStateId=2
        vSwUpdMPartitionStateActivationPending: vSwUpdMBitPosition=4, vSwUpdMPartitionStateId=0
