AUTOSAR XML (schema 4-3-0)
package /ActiveEcuC
  ecuc value collection ActiveEcuC: ecu-extract=SYSTEM
    ecuc-values:
      E2EXf
      Rte
      Os
      SecOC
      Xcp
      EcuC
      CanTp
      CanNm
      EcuM
      CanSM
      VTTCan
      Nm
      Com
      ComM
      Dem
      SomeIpXf
      Dcm
      CanIf
      Crypto
      Det
      PduR
      BswM
      Crc
      Fee
      vItaSip
      MemIf
      NvM
      Wdg
      WdgM
      WdgIf
      CryIf
      Csm
      EthTrcv
      Gpt
      Rtm
      Dbg
      vSet
      vSecPrim
      vFotaH
      vMemAccM
      vSwUpdM
      E2E
      vStreamProc
      vCan
      vBRS
      vBaseEnv
      Fls
      ResourceM
      Irq
      McalLib
      Port
      Mcu
      vLinkGen
      vFeeAcc
      vMem_30_Blocking
      vMem
      StartApplicationEth
      Can
      MemMap
      Dio
      VTTMemMap
      CddNpmGen2
      BAP
      ComXf
