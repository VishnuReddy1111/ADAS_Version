AUTOSAR XML (schema 4-3-0)
package /ActiveEcuC
  module config CanNm: implementation-config-variant=VARIANT-PRE-COMPILE, module-description=CanNm_Impl
    CanNmGlobalConfig:
      CanNmBusLoadReductionEnabled = false
      CanNmBusSynchronizationEnabled = false
      CanNmComControlEnabled = true
      CanNmComUserDataSupport = true
      CanNmImmediateRestartEnabled = false
      CanNmNodeIdEnabled = false
      CanNmPassiveModeEnabled = false
      CanNmPduRxIndicationEnabled = true
      CanNmPnEiraCalcEnabled = true
      CanNmPnResetTime = 0.5
      CanNmRemoteSleepIndEnabled = false
      CanNmRepeatMsgIndEnabled = false
      CanNmStateChangeIndEnabled = true
      CanNmUserDataEnabled = true
      CanNmCoordinatorSyncSupport = false
      CanNmDevErrorDetect = false
      CanNmImmediateTxconfEnabled = false
      CanNmMainFunctionPeriod = 0.01
      CanNmVersionInfoApi = true
      CanNmDisableTxErrReport = false
      CanNmApiOptimization = false
      CanNmCanIfRangeConfigDLCCheck = true
      CanNmRuntimeMeasurementSupport = true
      CanNmSafeBswChecks = false
      CanNmPnSyncShutdownErrorReactionEnabled = false
      CanNmRuntimeErrorReport = true
      CanNmPnEiraRxNSduRef = PduPnc_EIRA_CAN_Rx
      CanNmGeneration: CanNmOutOfBoundsWriteSanitizer=false, CanNmOutOfBoundsReadSanitizer=false, CanNmInterfacesForDeactivatedData=false
      NmCluster_BMC_CAN01_44a705e0 (CanNmChannelConfig):
        CanNmBusLoadReductionActive = false
        CanNmComControlEnabled = true
        CanNmImmediateNmCycleTime = 0.02
        CanNmImmediateNmTransmissions = 10
        CanNmImmediateRestartEnabled = false
        CanNmMsgCycleOffset = 0
        CanNmMsgCycleTime = 0.2
        CanNmMsgTimeoutTime = 0.1
        CanNmNodeIdEnabled = false
        CanNmPduCbvPosition = CANNM_PDU_BYTE_1
        CanNmPnEnabled = false
        CanNmPnEraCalcEnabled = false
        CanNmRemoteSleepIndTime = 0.5
        CanNmRepeatMessageTime = 4
        CanNmRepeatMsgIndEnabled = false
        CanNmTimeoutTime = 1
        CanNmUserDataLength = 6
        CanNmWaitBusSleepTime = 0.75
        CanNmCarWakeUpRxEnabled = false
        CanNmMsgReducedTime = 0.08
        CanNmNodeId = 0
        CanNmPduNidPosition = CANNM_PDU_BYTE_0
        CanNmActiveWakeupBitEnabled = false
        CanNmNodeDetectionEnabled = false
        CanNmCriBitAlwaysEnabled = false
        CanNmComMNetworkHandleRef = CN_BMC_CAN01_78a85e89
        NMH_Hybrid_01_XIX_BMC_CAN01_272f3048 (CanNmUserDataTxPdu): CanNmTxUserDataPduId=0, CanNmTxUserDataPduRef=NMH_Hybrid_01_XIX_BMC_CAN01_b22e17f1_Tx
        NMH_Hybrid_01_XIX_BMC_CAN01_30f8f2db_Tx (CanNmTxPdu): CanNmTxConfirmationPduId=0, CanNmTxPduRef=NMH_Hybrid_01_XIX_BMC_CAN01_30f8f2db_Tx
        NmCluster_BMC_CAN01_44a705e0_Rx (CanNmRxPdu): CanNmRxPduId=0, CanNmRxPduRef=NmNode_BMC_HV_XIX_BMC_CAN01_a39ed100_Rx
      NmCluster_HCP5_CANFD01_da2f6b88 (CanNmChannelConfig):
        CanNmBusLoadReductionActive = false
        CanNmComControlEnabled = true
        CanNmImmediateNmCycleTime = 0.02
        CanNmImmediateNmTransmissions = 10
        CanNmImmediateRestartEnabled = false
        CanNmMsgCycleOffset = 0
        CanNmMsgCycleTime = 0.2
        CanNmMsgTimeoutTime = 0.1
        CanNmNodeIdEnabled = false
        CanNmPduCbvPosition = CANNM_PDU_BYTE_0
        CanNmPduNidPosition = CANNM_PDU_OFF
        CanNmPnEnabled = true
        CanNmPnEraCalcEnabled = false
        CanNmRemoteSleepIndTime = 0.5
        CanNmRepeatMessageTime = 4
        CanNmRepeatMsgIndEnabled = false
        CanNmTimeoutTime = 1
        CanNmUserDataLength = 23
        CanNmWaitBusSleepTime = 0.75
        CanNmCarWakeUpRxEnabled = false
        CanNmMsgReducedTime = 0.08
        CanNmNodeId = 0
        CanNmActiveWakeupBitEnabled = false
        CanNmNodeDetectionEnabled = false
        CanNmCriBitAlwaysEnabled = false
        CanNmComMNetworkHandleRef = CN_HCP5_CANFD01_54d90215
        NmCluster_HCP5_CANFD01_da2f6b88_Rx (CanNmRxPdu): CanNmRxPduId=1, CanNmRxPduRef=NmNode_BMC_HV_XIX_HCP5_CANFD01_c8c687b4_Rx
        NM_Hybrid_01_XIX_HCP5_CANFD01_3f17aba9_Tx (CanNmTxPdu): CanNmTxConfirmationPduId=1, CanNmTxPduRef=NM_Hybrid_01_XIX_HCP5_CANFD01_3f17aba9_Tx
        NM_Hybrid_01_XIX_HCP5_CANFD01_f044f549 (CanNmUserDataTxPdu): CanNmTxUserDataPduId=1, CanNmTxUserDataPduRef=NM_Hybrid_01_XIX_HCP5_CANFD01_c84ff8a5_Tx
      CanNmPnInfo: CanNmPnInfoLength=7, CanNmPnInfoOffset=1
        7 x CanNmPnFilterMaskByte:
          CanNmPnFilterMaskByte_2: CanNmPnFilterMaskByteIndex=2, CanNmPnFilterMaskByteValue=255
          CanNmPnFilterMaskByte_3: CanNmPnFilterMaskByteIndex=3, CanNmPnFilterMaskByteValue=255
          CanNmPnFilterMaskByte_4: CanNmPnFilterMaskByteIndex=4, CanNmPnFilterMaskByteValue=159
          CanNmPnFilterMaskByte_5: CanNmPnFilterMaskByteIndex=5, CanNmPnFilterMaskByteValue=255
          CanNmPnFilterMaskByte_0: CanNmPnFilterMaskByteIndex=0, CanNmPnFilterMaskByteValue=255
          CanNmPnFilterMaskByte_1: CanNmPnFilterMaskByteIndex=1, CanNmPnFilterMaskByteValue=254
          CanNmPnFilterMaskByte_6: CanNmPnFilterMaskByteIndex=6, CanNmPnFilterMaskByteValue=208
