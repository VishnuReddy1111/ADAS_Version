AUTOSAR XML (schema 4-3-0)
package /ActiveEcuC
  module config Dem: implementation-config-variant=VARIANT-PRE-COMPILE, module-description=Dem_Impl
    DemConfigSet
      41 x DemEventParameter, all with DemEventAvailable=true, DemEventKind=DEM_EVENT_KIND_BSW, DemEventAvailableInVariant=true, DemEventLatchTestFailed=false, DemEventCreateInfoPort=true:
        AutoCreatedDemEvent_BswMConfig_BswMReportFailToDemRef: DemEventId=116
          DemEventClass: DemAgingAllowed=false, DemConsiderPtoStatus=false, DemEventPriority=2, DemFFPrestorageSupported=false, DemOperationCycleRef=PowerCycle
            DemDebounceAlgorithmClass
              DemDebounceCounterBased:
                DemDebounceBehavior = DEM_DEBOUNCE_FREEZE
                DemDebounceCounterDecrementStepSize = 1
                DemDebounceCounterFailedThreshold = 127
                DemDebounceCounterIncrementStepSize = 1
                DemDebounceCounterJumpDown = true
                DemDebounceCounterJumpDownValue = 0
                DemDebounceCounterJumpUp = true
                DemDebounceCounterJumpUpValue = 0
                DemDebounceCounterPassedThreshold = -128
                DemDebounceCounterStorage = false
                DemDebounceContinuous = false
        AutoCreatedDemEvent_CHNL_346f2748_CANSM_E_MODE_REQUEST_TIMEOUT: DemEventId=118
          DemEventClass: DemAgingAllowed=false, DemConsiderPtoStatus=false, DemEventPriority=2, DemFFPrestorageSupported=false, DemOperationCycleRef=PowerCycle
            DemDebounceAlgorithmClass
              DemDebounceCounterBased:
                DemDebounceBehavior = DEM_DEBOUNCE_FREEZE
                DemDebounceCounterDecrementStepSize = 1
                DemDebounceCounterFailedThreshold = 127
                DemDebounceCounterIncrementStepSize = 1
                DemDebounceCounterJumpDown = true
                DemDebounceCounterJumpDownValue = 0
                DemDebounceCounterJumpUp = true
                DemDebounceCounterJumpUpValue = 0
                DemDebounceCounterPassedThreshold = -128
                DemDebounceCounterStorage = false
                DemDebounceContinuous = false
        AutoCreatedDemEvent_CHNL_346f2748_CANSM_E_BUS_OFF: DemEventId=117
          DemEventClass: DemAgingAllowed=false, DemConsiderPtoStatus=false, DemEventPriority=2, DemFFPrestorageSupported=false, DemOperationCycleRef=PowerCycle
            DemDebounceAlgorithmClass
              DemDebounceCounterBased:
                DemDebounceBehavior = DEM_DEBOUNCE_FREEZE
                DemDebounceCounterDecrementStepSize = 1
                DemDebounceCounterFailedThreshold = 1
                DemDebounceCounterIncrementStepSize = 1
                DemDebounceCounterJumpDown = true
                DemDebounceCounterJumpDownValue = 0
                DemDebounceCounterJumpUp = true
                DemDebounceCounterJumpUpValue = 0
                DemDebounceCounterPassedThreshold = -127
                DemDebounceCounterStorage = false
                DemDebounceContinuous = false
        AutoCreatedDemEvent_XFRM_E_MALFORMED_MESSAGE: DemEventId=154
          DemEventClass: DemAgingAllowed=false, DemConsiderPtoStatus=false, DemEventPriority=2, DemFFPrestorageSupported=false, DemOperationCycleRef=PowerCycle
            DemDebounceAlgorithmClass
              DemDebounceCounterBased:
                DemDebounceBehavior = DEM_DEBOUNCE_FREEZE
                DemDebounceCounterDecrementStepSize = 1
                DemDebounceCounterFailedThreshold = 127
                DemDebounceCounterIncrementStepSize = 1
                DemDebounceCounterJumpDown = true
                DemDebounceCounterJumpDownValue = 0
                DemDebounceCounterJumpUp = true
                DemDebounceCounterJumpUpValue = 0
                DemDebounceCounterPassedThreshold = -128
                DemDebounceCounterStorage = false
                DemDebounceContinuous = false
        AutoCreatedDemEvent_XFRM_E_MALFORMED_MESSAGE_1: DemEventId=155
          DemEventClass: DemAgingAllowed=false, DemConsiderPtoStatus=false, DemEventPriority=2, DemFFPrestorageSupported=false, DemOperationCycleRef=PowerCycle
            DemDebounceAlgorithmClass
              DemDebounceCounterBased:
                DemDebounceBehavior = DEM_DEBOUNCE_FREEZE
                DemDebounceCounterDecrementStepSize = 1
                DemDebounceCounterFailedThreshold = 127
                DemDebounceCounterIncrementStepSize = 1
                DemDebounceCounterJumpDown = true
                DemDebounceCounterJumpDownValue = 0
                DemDebounceCounterJumpUp = true
                DemDebounceCounterJumpUpValue = 0
                DemDebounceCounterPassedThreshold = -128
                DemDebounceCounterStorage = false
                DemDebounceContinuous = false
        AutoCreatedDemEvent_ECUM_E_RAM_CHECK_FAILED: DemEventId=122
          DemEventClass: DemAgingAllowed=false, DemConsiderPtoStatus=false, DemEventPriority=2, DemFFPrestorageSupported=false, DemOperationCycleRef=PowerCycle
            DemDebounceAlgorithmClass
              DemDebounceCounterBased:
                DemDebounceBehavior = DEM_DEBOUNCE_FREEZE
                DemDebounceCounterDecrementStepSize = 1
                DemDebounceCounterFailedThreshold = 127
                DemDebounceCounterIncrementStepSize = 1
                DemDebounceCounterJumpDown = true
                DemDebounceCounterJumpDownValue = 0
                DemDebounceCounterJumpUp = true
                DemDebounceCounterJumpUpValue = 0
                DemDebounceCounterPassedThreshold = -128
                DemDebounceCounterStorage = false
                DemDebounceContinuous = false
        AutoCreatedDemEvent_ECUM_E_IMPROPER_CALLER: DemEventId=121
          DemEventClass: DemAgingAllowed=false, DemConsiderPtoStatus=false, DemEventPriority=2, DemFFPrestorageSupported=false, DemOperationCycleRef=PowerCycle
            DemDebounceAlgorithmClass
              DemDebounceCounterBased:
                DemDebounceBehavior = DEM_DEBOUNCE_FREEZE
                DemDebounceCounterDecrementStepSize = 1
                DemDebounceCounterFailedThreshold = 127
                DemDebounceCounterIncrementStepSize = 1
                DemDebounceCounterJumpDown = true
                DemDebounceCounterJumpDownValue = 0
                DemDebounceCounterJumpUp = true
                DemDebounceCounterJumpUpValue = 0
                DemDebounceCounterPassedThreshold = -128
                DemDebounceCounterStorage = false
                DemDebounceContinuous = false
        AutoCreatedDemEvent_ECUM_E_CONFIGURATION_DATA_INCONSISTENT: DemEventId=120
          DemEventClass: DemAgingAllowed=false, DemConsiderPtoStatus=false, DemEventPriority=2, DemFFPrestorageSupported=false, DemOperationCycleRef=PowerCycle
            DemDebounceAlgorithmClass
              DemDebounceCounterBased:
                DemDebounceBehavior = DEM_DEBOUNCE_FREEZE
                DemDebounceCounterDecrementStepSize = 1
                DemDebounceCounterFailedThreshold = 127
                DemDebounceCounterIncrementStepSize = 1
                DemDebounceCounterJumpDown = true
                DemDebounceCounterJumpDownValue = 0
                DemDebounceCounterJumpUp = true
                DemDebounceCounterJumpUpValue = 0
                DemDebounceCounterPassedThreshold = -128
                DemDebounceCounterStorage = false
                DemDebounceContinuous = false
        AutoCreatedDemEvent_ECUM_E_ALL_RUN_REQUESTS_KILLED: DemEventId=119
          DemEventClass: DemAgingAllowed=false, DemConsiderPtoStatus=false, DemEventPriority=2, DemFFPrestorageSupported=false, DemOperationCycleRef=PowerCycle
            DemDebounceAlgorithmClass
              DemDebounceCounterBased:
                DemDebounceBehavior = DEM_DEBOUNCE_FREEZE
                DemDebounceCounterDecrementStepSize = 1
                DemDebounceCounterFailedThreshold = 127
                DemDebounceCounterIncrementStepSize = 1
                DemDebounceCounterJumpDown = true
                DemDebounceCounterJumpDownValue = 0
                DemDebounceCounterJumpUp = true
                DemDebounceCounterJumpUpValue = 0
                DemDebounceCounterPassedThreshold = -128
                DemDebounceCounterStorage = false
                DemDebounceContinuous = false
        AutoCreatedDemEvent_EEP_E_WRITE_FAILED: DemEventId=129
          DemEventClass: DemAgingAllowed=false, DemConsiderPtoStatus=false, DemEventPriority=2, DemFFPrestorageSupported=false, DemOperationCycleRef=PowerCycle
            DemDebounceAlgorithmClass
              DemDebounceCounterBased:
                DemDebounceBehavior = DEM_DEBOUNCE_FREEZE
                DemDebounceCounterDecrementStepSize = 1
                DemDebounceCounterFailedThreshold = 127
                DemDebounceCounterIncrementStepSize = 1
                DemDebounceCounterJumpDown = true
                DemDebounceCounterJumpDownValue = 0
                DemDebounceCounterJumpUp = true
                DemDebounceCounterJumpUpValue = 0
                DemDebounceCounterPassedThreshold = -128
                DemDebounceCounterStorage = false
                DemDebounceContinuous = false
        AutoCreatedDemEvent_EEP_E_READ_FAILED: DemEventId=127
          DemEventClass: DemAgingAllowed=false, DemConsiderPtoStatus=false, DemEventPriority=2, DemFFPrestorageSupported=false, DemOperationCycleRef=PowerCycle
            DemDebounceAlgorithmClass
              DemDebounceCounterBased:
                DemDebounceBehavior = DEM_DEBOUNCE_FREEZE
                DemDebounceCounterDecrementStepSize = 1
                DemDebounceCounterFailedThreshold = 127
                DemDebounceCounterIncrementStepSize = 1
                DemDebounceCounterJumpDown = true
                DemDebounceCounterJumpDownValue = 0
                DemDebounceCounterJumpUp = true
                DemDebounceCounterJumpUpValue = 0
                DemDebounceCounterPassedThreshold = -128
                DemDebounceCounterStorage = false
                DemDebounceContinuous = false
        AutoCreatedDemEvent_EEP_E_ERASE_FAILED: DemEventId=125
          DemEventClass: DemAgingAllowed=false, DemConsiderPtoStatus=false, DemEventPriority=2, DemFFPrestorageSupported=false, DemOperationCycleRef=PowerCycle
            DemDebounceAlgorithmClass
              DemDebounceCounterBased:
                DemDebounceBehavior = DEM_DEBOUNCE_FREEZE
                DemDebounceCounterDecrementStepSize = 1
                DemDebounceCounterFailedThreshold = 127
                DemDebounceCounterIncrementStepSize = 1
                DemDebounceCounterJumpDown = true
                DemDebounceCounterJumpDownValue = 0
                DemDebounceCounterJumpUp = true
                DemDebounceCounterJumpUpValue = 0
                DemDebounceCounterPassedThreshold = -128
                DemDebounceCounterStorage = false
                DemDebounceContinuous = false
        AutoCreatedDemEvent_EEP_E_COMPARE_FAILED: DemEventId=123
          DemEventClass: DemAgingAllowed=false, DemConsiderPtoStatus=false, DemEventPriority=2, DemFFPrestorageSupported=false, DemOperationCycleRef=PowerCycle
            DemDebounceAlgorithmClass
              DemDebounceCounterBased:
                DemDebounceBehavior = DEM_DEBOUNCE_FREEZE
                DemDebounceCounterDecrementStepSize = 1
                DemDebounceCounterFailedThreshold = 127
                DemDebounceCounterIncrementStepSize = 1
                DemDebounceCounterJumpDown = true
                DemDebounceCounterJumpDownValue = 0
                DemDebounceCounterJumpUp = true
                DemDebounceCounterJumpUpValue = 0
                DemDebounceCounterPassedThreshold = -128
                DemDebounceCounterStorage = false
                DemDebounceContinuous = false
        AutoCreatedDemEvent_FLS_E_WRITE_FAILED: DemEventId=139
          DemEventClass: DemAgingAllowed=false, DemConsiderPtoStatus=false, DemEventPriority=2, DemFFPrestorageSupported=false, DemOperationCycleRef=PowerCycle
            DemDebounceAlgorithmClass
              DemDebounceCounterBased:
                DemDebounceBehavior = DEM_DEBOUNCE_FREEZE
                DemDebounceCounterDecrementStepSize = 1
                DemDebounceCounterFailedThreshold = 127
                DemDebounceCounterIncrementStepSize = 1
                DemDebounceCounterJumpDown = true
                DemDebounceCounterJumpDownValue = 0
                DemDebounceCounterJumpUp = true
                DemDebounceCounterJumpUpValue = 0
                DemDebounceCounterPassedThreshold = -128
                DemDebounceCounterStorage = false
                DemDebounceContinuous = false
        AutoCreatedDemEvent_FLS_E_UNEXPECTED_FLASH_ID: DemEventId=137
          DemEventClass: DemAgingAllowed=false, DemConsiderPtoStatus=false, DemEventPriority=2, DemFFPrestorageSupported=false, DemOperationCycleRef=PowerCycle
            DemDebounceAlgorithmClass
              DemDebounceCounterBased:
                DemDebounceBehavior = DEM_DEBOUNCE_FREEZE
                DemDebounceCounterDecrementStepSize = 1
                DemDebounceCounterFailedThreshold = 127
                DemDebounceCounterIncrementStepSize = 1
                DemDebounceCounterJumpDown = true
                DemDebounceCounterJumpDownValue = 0
                DemDebounceCounterJumpUp = true
                DemDebounceCounterJumpUpValue = 0
                DemDebounceCounterPassedThreshold = -128
                DemDebounceCounterStorage = false
                DemDebounceContinuous = false
        AutoCreatedDemEvent_FLS_E_READ_FAILED: DemEventId=135
          DemEventClass: DemAgingAllowed=false, DemConsiderPtoStatus=false, DemEventPriority=2, DemFFPrestorageSupported=false, DemOperationCycleRef=PowerCycle
            DemDebounceAlgorithmClass
              DemDebounceCounterBased:
                DemDebounceBehavior = DEM_DEBOUNCE_FREEZE
                DemDebounceCounterDecrementStepSize = 1
                DemDebounceCounterFailedThreshold = 127
                DemDebounceCounterIncrementStepSize = 1
                DemDebounceCounterJumpDown = true
                DemDebounceCounterJumpDownValue = 0
                DemDebounceCounterJumpUp = true
                DemDebounceCounterJumpUpValue = 0
                DemDebounceCounterPassedThreshold = -128
                DemDebounceCounterStorage = false
                DemDebounceContinuous = false
        AutoCreatedDemEvent_FLS_E_ERASE_FAILED: DemEventId=133
          DemEventClass: DemAgingAllowed=false, DemConsiderPtoStatus=false, DemEventPriority=2, DemFFPrestorageSupported=false, DemOperationCycleRef=PowerCycle
            DemDebounceAlgorithmClass
              DemDebounceCounterBased:
                DemDebounceBehavior = DEM_DEBOUNCE_FREEZE
                DemDebounceCounterDecrementStepSize = 1
                DemDebounceCounterFailedThreshold = 127
                DemDebounceCounterIncrementStepSize = 1
                DemDebounceCounterJumpDown = true
                DemDebounceCounterJumpDownValue = 0
                DemDebounceCounterJumpUp = true
                DemDebounceCounterJumpUpValue = 0
                DemDebounceCounterPassedThreshold = -128
                DemDebounceCounterStorage = false
                DemDebounceContinuous = false
        AutoCreatedDemEvent_FLS_E_COMPARE_FAILED: DemEventId=131
          DemEventClass: DemAgingAllowed=false, DemConsiderPtoStatus=false, DemEventPriority=2, DemFFPrestorageSupported=false, DemOperationCycleRef=PowerCycle
            DemDebounceAlgorithmClass
              DemDebounceCounterBased:
                DemDebounceBehavior = DEM_DEBOUNCE_FREEZE
                DemDebounceCounterDecrementStepSize = 1
                DemDebounceCounterFailedThreshold = 127
                DemDebounceCounterIncrementStepSize = 1
                DemDebounceCounterJumpDown = true
                DemDebounceCounterJumpDownValue = 0
                DemDebounceCounterJumpUp = true
                DemDebounceCounterJumpUpValue = 0
                DemDebounceCounterPassedThreshold = -128
                DemDebounceCounterStorage = false
                DemDebounceContinuous = false
        AutoCreatedDemEvent_MyECU_6c1a0d52_FrDemCtrlTestResultRef: DemEventId=144
          DemEventClass: DemAgingAllowed=false, DemConsiderPtoStatus=false, DemEventPriority=2, DemFFPrestorageSupported=false, DemOperationCycleRef=PowerCycle
            DemDebounceAlgorithmClass
              DemDebounceCounterBased:
                DemDebounceBehavior = DEM_DEBOUNCE_FREEZE
                DemDebounceCounterDecrementStepSize = 1
                DemDebounceCounterFailedThreshold = 127
                DemDebounceCounterIncrementStepSize = 1
                DemDebounceCounterJumpDown = true
                DemDebounceCounterJumpDownValue = 0
                DemDebounceCounterJumpUp = true
                DemDebounceCounterJumpUpValue = 0
                DemDebounceCounterPassedThreshold = -128
                DemDebounceCounterStorage = false
                DemDebounceContinuous = false
        AutoCreatedDemEvent_LIN_E_TIMEOUT: DemEventId=141
          DemEventClass: DemAgingAllowed=false, DemConsiderPtoStatus=false, DemEventPriority=2, DemFFPrestorageSupported=false, DemOperationCycleRef=PowerCycle
            DemDebounceAlgorithmClass
              DemDebounceCounterBased:
                DemDebounceBehavior = DEM_DEBOUNCE_FREEZE
                DemDebounceCounterDecrementStepSize = 1
                DemDebounceCounterFailedThreshold = 127
                DemDebounceCounterIncrementStepSize = 1
                DemDebounceCounterJumpDown = true
                DemDebounceCounterJumpDownValue = 0
                DemDebounceCounterJumpUp = true
                DemDebounceCounterJumpUpValue = 0
                DemDebounceCounterPassedThreshold = -128
                DemDebounceCounterStorage = false
                DemDebounceContinuous = false
        AutoCreatedDemEvent_McuModuleConfiguration_MCU_E_CLOCK_FAILURE: DemEventId=142
          DemEventClass: DemAgingAllowed=false, DemConsiderPtoStatus=false, DemEventPriority=2, DemFFPrestorageSupported=false, DemOperationCycleRef=PowerCycle
            DemDebounceAlgorithmClass
              DemDebounceCounterBased:
                DemDebounceBehavior = DEM_DEBOUNCE_FREEZE
                DemDebounceCounterDecrementStepSize = 1
                DemDebounceCounterFailedThreshold = 127
                DemDebounceCounterIncrementStepSize = 1
                DemDebounceCounterJumpDown = true
                DemDebounceCounterJumpDownValue = 0
                DemDebounceCounterJumpUp = true
                DemDebounceCounterJumpUpValue = 0
                DemDebounceCounterPassedThreshold = -128
                DemDebounceCounterStorage = false
                DemDebounceContinuous = false
        AutoCreatedDemEvent_NVM_E_WRONG_BLOCK_ID: DemEventId=152
          DemEventClass: DemAgingAllowed=false, DemConsiderPtoStatus=false, DemEventPriority=2, DemFFPrestorageSupported=false, DemOperationCycleRef=PowerCycle
            DemDebounceAlgorithmClass
              DemDebounceCounterBased:
                DemDebounceBehavior = DEM_DEBOUNCE_FREEZE
                DemDebounceCounterDecrementStepSize = 1
                DemDebounceCounterFailedThreshold = 127
                DemDebounceCounterIncrementStepSize = 1
                DemDebounceCounterJumpDown = true
                DemDebounceCounterJumpDownValue = 0
                DemDebounceCounterJumpUp = true
                DemDebounceCounterJumpUpValue = 0
                DemDebounceCounterPassedThreshold = -128
                DemDebounceCounterStorage = false
                DemDebounceContinuous = false
        AutoCreatedDemEvent_NVM_E_WRITE_PROTECTED: DemEventId=151
          DemEventClass: DemAgingAllowed=false, DemConsiderPtoStatus=false, DemEventPriority=2, DemFFPrestorageSupported=false, DemOperationCycleRef=PowerCycle
            DemDebounceAlgorithmClass
              DemDebounceCounterBased:
                DemDebounceBehavior = DEM_DEBOUNCE_FREEZE
                DemDebounceCounterDecrementStepSize = 1
                DemDebounceCounterFailedThreshold = 127
                DemDebounceCounterIncrementStepSize = 1
                DemDebounceCounterJumpDown = true
                DemDebounceCounterJumpDownValue = 0
                DemDebounceCounterJumpUp = true
                DemDebounceCounterJumpUpValue = 0
                DemDebounceCounterPassedThreshold = -128
                DemDebounceCounterStorage = false
                DemDebounceContinuous = false
        AutoCreatedDemEvent_NVM_E_VERIFY_FAILED: DemEventId=150
          DemEventClass: DemAgingAllowed=false, DemConsiderPtoStatus=false, DemEventPriority=2, DemFFPrestorageSupported=false, DemOperationCycleRef=PowerCycle
            DemDebounceAlgorithmClass
              DemDebounceCounterBased:
                DemDebounceBehavior = DEM_DEBOUNCE_FREEZE
                DemDebounceCounterDecrementStepSize = 1
                DemDebounceCounterFailedThreshold = 127
                DemDebounceCounterIncrementStepSize = 1
                DemDebounceCounterJumpDown = true
                DemDebounceCounterJumpDownValue = 0
                DemDebounceCounterJumpUp = true
                DemDebounceCounterJumpUpValue = 0
                DemDebounceCounterPassedThreshold = -128
                DemDebounceCounterStorage = false
                DemDebounceContinuous = false
        AutoCreatedDemEvent_NVM_E_REQ_FAILED: DemEventId=149
          DemEventClass: DemAgingAllowed=false, DemConsiderPtoStatus=false, DemEventPriority=2, DemFFPrestorageSupported=false, DemOperationCycleRef=PowerCycle
            DemDebounceAlgorithmClass
              DemDebounceCounterBased:
                DemDebounceBehavior = DEM_DEBOUNCE_FREEZE
                DemDebounceCounterDecrementStepSize = 1
                DemDebounceCounterFailedThreshold = 127
                DemDebounceCounterIncrementStepSize = 1
                DemDebounceCounterJumpDown = true
                DemDebounceCounterJumpDownValue = 0
                DemDebounceCounterJumpUp = true
                DemDebounceCounterJumpUpValue = 0
                DemDebounceCounterPassedThreshold = -128
                DemDebounceCounterStorage = false
                DemDebounceContinuous = false
        AutoCreatedDemEvent_NVM_E_QUEUE_OVERFLOW: DemEventId=148
          DemEventClass: DemAgingAllowed=false, DemConsiderPtoStatus=false, DemEventPriority=2, DemFFPrestorageSupported=false, DemOperationCycleRef=PowerCycle
            DemDebounceAlgorithmClass
              DemDebounceCounterBased:
                DemDebounceBehavior = DEM_DEBOUNCE_FREEZE
                DemDebounceCounterDecrementStepSize = 1
                DemDebounceCounterFailedThreshold = 127
                DemDebounceCounterIncrementStepSize = 1
                DemDebounceCounterJumpDown = true
                DemDebounceCounterJumpDownValue = 0
                DemDebounceCounterJumpUp = true
                DemDebounceCounterJumpUpValue = 0
                DemDebounceCounterPassedThreshold = -128
                DemDebounceCounterStorage = false
                DemDebounceContinuous = false
        AutoCreatedDemEvent_NVM_E_LOSS_OF_REDUNDANCY: DemEventId=147
          DemEventClass: DemAgingAllowed=false, DemConsiderPtoStatus=false, DemEventPriority=2, DemFFPrestorageSupported=false, DemOperationCycleRef=PowerCycle
            DemDebounceAlgorithmClass
              DemDebounceCounterBased:
                DemDebounceBehavior = DEM_DEBOUNCE_FREEZE
                DemDebounceCounterDecrementStepSize = 1
                DemDebounceCounterFailedThreshold = 127
                DemDebounceCounterIncrementStepSize = 1
                DemDebounceCounterJumpDown = true
                DemDebounceCounterJumpDownValue = 0
                DemDebounceCounterJumpUp = true
                DemDebounceCounterJumpUpValue = 0
                DemDebounceCounterPassedThreshold = -128
                DemDebounceCounterStorage = false
                DemDebounceContinuous = false
        AutoCreatedDemEvent_NVM_E_INTEGRITY_FAILED: DemEventId=146
          DemEventClass: DemAgingAllowed=false, DemConsiderPtoStatus=false, DemEventPriority=2, DemFFPrestorageSupported=false, DemOperationCycleRef=PowerCycle
            DemDebounceAlgorithmClass
              DemDebounceCounterBased:
                DemDebounceBehavior = DEM_DEBOUNCE_FREEZE
                DemDebounceCounterDecrementStepSize = 1
                DemDebounceCounterFailedThreshold = 127
                DemDebounceCounterIncrementStepSize = 1
                DemDebounceCounterJumpDown = true
                DemDebounceCounterJumpDownValue = 0
                DemDebounceCounterJumpUp = true
                DemDebounceCounterJumpUpValue = 0
                DemDebounceCounterPassedThreshold = -128
                DemDebounceCounterStorage = false
                DemDebounceContinuous = false
        AutoCreatedDemEvent_XFRM_E_MALFORMED_MESSAGE_2: DemEventId=156
          DemEventClass: DemAgingAllowed=false, DemConsiderPtoStatus=false, DemEventPriority=2, DemFFPrestorageSupported=false, DemOperationCycleRef=PowerCycle
            DemDebounceAlgorithmClass
              DemDebounceCounterBased:
                DemDebounceBehavior = DEM_DEBOUNCE_FREEZE
                DemDebounceCounterDecrementStepSize = 1
                DemDebounceCounterFailedThreshold = 127
                DemDebounceCounterIncrementStepSize = 1
                DemDebounceCounterJumpDown = true
                DemDebounceCounterJumpDownValue = 0
                DemDebounceCounterJumpUp = true
                DemDebounceCounterJumpUpValue = 0
                DemDebounceCounterPassedThreshold = -128
                DemDebounceCounterStorage = false
                DemDebounceContinuous = false
        AutoCreatedDemEvent_EEP_E_WRITE_FAILED_1: DemEventId=130
          DemEventClass: DemAgingAllowed=false, DemConsiderPtoStatus=false, DemEventPriority=2, DemFFPrestorageSupported=false, DemOperationCycleRef=PowerCycle
            DemDebounceAlgorithmClass
              DemDebounceCounterBased:
                DemDebounceBehavior = DEM_DEBOUNCE_FREEZE
                DemDebounceCounterDecrementStepSize = 1
                DemDebounceCounterFailedThreshold = 127
                DemDebounceCounterIncrementStepSize = 1
                DemDebounceCounterJumpDown = true
                DemDebounceCounterJumpDownValue = 0
                DemDebounceCounterJumpUp = true
                DemDebounceCounterJumpUpValue = 0
                DemDebounceCounterPassedThreshold = -128
                DemDebounceCounterStorage = false
                DemDebounceContinuous = false
        AutoCreatedDemEvent_EEP_E_READ_FAILED_1: DemEventId=128
          DemEventClass: DemAgingAllowed=false, DemConsiderPtoStatus=false, DemEventPriority=2, DemFFPrestorageSupported=false, DemOperationCycleRef=PowerCycle
            DemDebounceAlgorithmClass
              DemDebounceCounterBased:
                DemDebounceBehavior = DEM_DEBOUNCE_FREEZE
                DemDebounceCounterDecrementStepSize = 1
                DemDebounceCounterFailedThreshold = 127
                DemDebounceCounterIncrementStepSize = 1
                DemDebounceCounterJumpDown = true
                DemDebounceCounterJumpDownValue = 0
                DemDebounceCounterJumpUp = true
                DemDebounceCounterJumpUpValue = 0
                DemDebounceCounterPassedThreshold = -128
                DemDebounceCounterStorage = false
                DemDebounceContinuous = false
        AutoCreatedDemEvent_EEP_E_ERASE_FAILED_1: DemEventId=126
          DemEventClass: DemAgingAllowed=false, DemConsiderPtoStatus=false, DemEventPriority=2, DemFFPrestorageSupported=false, DemOperationCycleRef=PowerCycle
            DemDebounceAlgorithmClass
              DemDebounceCounterBased:
                DemDebounceBehavior = DEM_DEBOUNCE_FREEZE
                DemDebounceCounterDecrementStepSize = 1
                DemDebounceCounterFailedThreshold = 127
                DemDebounceCounterIncrementStepSize = 1
                DemDebounceCounterJumpDown = true
                DemDebounceCounterJumpDownValue = 0
                DemDebounceCounterJumpUp = true
                DemDebounceCounterJumpUpValue = 0
                DemDebounceCounterPassedThreshold = -128
                DemDebounceCounterStorage = false
                DemDebounceContinuous = false
        AutoCreatedDemEvent_EEP_E_COMPARE_FAILED_1: DemEventId=124
          DemEventClass: DemAgingAllowed=false, DemConsiderPtoStatus=false, DemEventPriority=2, DemFFPrestorageSupported=false, DemOperationCycleRef=PowerCycle
            DemDebounceAlgorithmClass
              DemDebounceCounterBased:
                DemDebounceBehavior = DEM_DEBOUNCE_FREEZE
                DemDebounceCounterDecrementStepSize = 1
                DemDebounceCounterFailedThreshold = 127
                DemDebounceCounterIncrementStepSize = 1
                DemDebounceCounterJumpDown = true
                DemDebounceCounterJumpDownValue = 0
                DemDebounceCounterJumpUp = true
                DemDebounceCounterJumpUpValue = 0
                DemDebounceCounterPassedThreshold = -128
                DemDebounceCounterStorage = false
                DemDebounceContinuous = false
        AutoCreatedDemEvent_FLS_E_WRITE_FAILED_1: DemEventId=140
          DemEventClass: DemAgingAllowed=false, DemConsiderPtoStatus=false, DemEventPriority=2, DemFFPrestorageSupported=false, DemOperationCycleRef=PowerCycle
            DemDebounceAlgorithmClass
              DemDebounceCounterBased:
                DemDebounceBehavior = DEM_DEBOUNCE_FREEZE
                DemDebounceCounterDecrementStepSize = 1
                DemDebounceCounterFailedThreshold = 127
                DemDebounceCounterIncrementStepSize = 1
                DemDebounceCounterJumpDown = true
                DemDebounceCounterJumpDownValue = 0
                DemDebounceCounterJumpUp = true
                DemDebounceCounterJumpUpValue = 0
                DemDebounceCounterPassedThreshold = -128
                DemDebounceCounterStorage = false
                DemDebounceContinuous = false
        AutoCreatedDemEvent_FLS_E_UNEXPECTED_FLASH_ID_1: DemEventId=138
          DemEventClass: DemAgingAllowed=false, DemConsiderPtoStatus=false, DemEventPriority=2, DemFFPrestorageSupported=false, DemOperationCycleRef=PowerCycle
            DemDebounceAlgorithmClass
              DemDebounceCounterBased:
                DemDebounceBehavior = DEM_DEBOUNCE_FREEZE
                DemDebounceCounterDecrementStepSize = 1
                DemDebounceCounterFailedThreshold = 127
                DemDebounceCounterIncrementStepSize = 1
                DemDebounceCounterJumpDown = true
                DemDebounceCounterJumpDownValue = 0
                DemDebounceCounterJumpUp = true
                DemDebounceCounterJumpUpValue = 0
                DemDebounceCounterPassedThreshold = -128
                DemDebounceCounterStorage = false
                DemDebounceContinuous = false
        AutoCreatedDemEvent_FLS_E_READ_FAILED_1: DemEventId=136
          DemEventClass: DemAgingAllowed=false, DemConsiderPtoStatus=false, DemEventPriority=2, DemFFPrestorageSupported=false, DemOperationCycleRef=PowerCycle
            DemDebounceAlgorithmClass
              DemDebounceCounterBased:
                DemDebounceBehavior = DEM_DEBOUNCE_FREEZE
                DemDebounceCounterDecrementStepSize = 1
                DemDebounceCounterFailedThreshold = 127
                DemDebounceCounterIncrementStepSize = 1
                DemDebounceCounterJumpDown = true
                DemDebounceCounterJumpDownValue = 0
                DemDebounceCounterJumpUp = true
                DemDebounceCounterJumpUpValue = 0
                DemDebounceCounterPassedThreshold = -128
                DemDebounceCounterStorage = false
                DemDebounceContinuous = false
        AutoCreatedDemEvent_FLS_E_ERASE_FAILED_1: DemEventId=134
          DemEventClass: DemAgingAllowed=false, DemConsiderPtoStatus=false, DemEventPriority=2, DemFFPrestorageSupported=false, DemOperationCycleRef=PowerCycle
            DemDebounceAlgorithmClass
              DemDebounceCounterBased:
                DemDebounceBehavior = DEM_DEBOUNCE_FREEZE
                DemDebounceCounterDecrementStepSize = 1
                DemDebounceCounterFailedThreshold = 127
                DemDebounceCounterIncrementStepSize = 1
                DemDebounceCounterJumpDown = true
                DemDebounceCounterJumpDownValue = 0
                DemDebounceCounterJumpUp = true
                DemDebounceCounterJumpUpValue = 0
                DemDebounceCounterPassedThreshold = -128
                DemDebounceCounterStorage = false
                DemDebounceContinuous = false
        AutoCreatedDemEvent_FLS_E_COMPARE_FAILED_1: DemEventId=132
          DemEventClass: DemAgingAllowed=false, DemConsiderPtoStatus=false, DemEventPriority=2, DemFFPrestorageSupported=false, DemOperationCycleRef=PowerCycle
            DemDebounceAlgorithmClass
              DemDebounceCounterBased:
                DemDebounceBehavior = DEM_DEBOUNCE_FREEZE
                DemDebounceCounterDecrementStepSize = 1
                DemDebounceCounterFailedThreshold = 127
                DemDebounceCounterIncrementStepSize = 1
                DemDebounceCounterJumpDown = true
                DemDebounceCounterJumpDownValue = 0
                DemDebounceCounterJumpUp = true
                DemDebounceCounterJumpUpValue = 0
                DemDebounceCounterPassedThreshold = -128
                DemDebounceCounterStorage = false
                DemDebounceContinuous = false
        AutoCreatedDemEvent_MyECU_6c1a0d52_FrDemCtrlTestResultRef_1: DemEventId=145
          DemEventClass: DemAgingAllowed=false, DemConsiderPtoStatus=false, DemEventPriority=2, DemFFPrestorageSupported=false, DemOperationCycleRef=PowerCycle
            DemDebounceAlgorithmClass
              DemDebounceCounterBased:
                DemDebounceBehavior = DEM_DEBOUNCE_FREEZE
                DemDebounceCounterDecrementStepSize = 1
                DemDebounceCounterFailedThreshold = 127
                DemDebounceCounterIncrementStepSize = 1
                DemDebounceCounterJumpDown = true
                DemDebounceCounterJumpDownValue = 0
                DemDebounceCounterJumpUp = true
                DemDebounceCounterJumpUpValue = 0
                DemDebounceCounterPassedThreshold = -128
                DemDebounceCounterStorage = false
                DemDebounceContinuous = false
        AutoCreatedDemEvent_McuModuleConfiguration_MCU_E_CLOCK_FAILURE_1: DemEventId=143
          DemEventClass: DemAgingAllowed=false, DemConsiderPtoStatus=false, DemEventPriority=2, DemFFPrestorageSupported=false, DemOperationCycleRef=PowerCycle
            DemDebounceAlgorithmClass
              DemDebounceCounterBased:
                DemDebounceBehavior = DEM_DEBOUNCE_FREEZE
                DemDebounceCounterDecrementStepSize = 1
                DemDebounceCounterFailedThreshold = 127
                DemDebounceCounterIncrementStepSize = 1
                DemDebounceCounterJumpDown = true
                DemDebounceCounterJumpDownValue = 0
                DemDebounceCounterJumpUp = true
                DemDebounceCounterJumpUpValue = 0
                DemDebounceCounterPassedThreshold = -128
                DemDebounceCounterStorage = false
                DemDebounceContinuous = false
        AutoCreatedDemEvent_XCP_E_INIT_FAILED: DemEventId=153
          DemEventClass: DemAgingAllowed=false, DemConsiderPtoStatus=false, DemEventPriority=2, DemFFPrestorageSupported=false, DemOperationCycleRef=PowerCycle
            DemDebounceAlgorithmClass
              DemDebounceCounterBased:
                DemDebounceBehavior = DEM_DEBOUNCE_FREEZE
                DemDebounceCounterDecrementStepSize = 1
                DemDebounceCounterFailedThreshold = 127
                DemDebounceCounterIncrementStepSize = 1
                DemDebounceCounterJumpDown = true
                DemDebounceCounterJumpDownValue = 0
                DemDebounceCounterJumpUp = true
                DemDebounceCounterJumpUpValue = 0
                DemDebounceCounterPassedThreshold = -128
                DemDebounceCounterStorage = false
                DemDebounceContinuous = false
      DemDTCClass_StartApplication (DemDTCClass): DemImmediateNvStorage=false, DemUdsDTC=4729855, DemDTCAttributesRef=DemDTCAttributesPrimary
      6 x DemEventParameter, all with DemEventAvailable=true, DemEventAvailableInVariant=true, DemEventLatchTestFailed=false, DemEventCreateInfoPort=true:
        DEM_EVENT_StartApplication: DemEventId=1, DemEventKind=DEM_EVENT_KIND_SWC, DemMaxNumberFreezeFrameRecords=0, DemDTCClassRef=DemDTCClass_StartApplication, DemFreezeFrameClassRef=FreezeFrame_51eb4bef, DemFreezeFrameRecNumClassRef=DemFreezeFrameRecNumClass
          DemEventClass:
            DemAgingAllowed = false
            DemConsiderPtoStatus = false
            DemEventPriority = 2
            DemFFPrestorageSupported = false
            DemOperationCycleRef = PowerCycle
            DemAgingCycleRef = PowerCycle
            DemDebounceAlgorithmClass
              DemDebounceCounterBased:
                DemDebounceBehavior = DEM_DEBOUNCE_FREEZE
                DemDebounceCounterDecrementStepSize = 1
                DemDebounceCounterFailedThreshold = 127
                DemDebounceCounterIncrementStepSize = 1
                DemDebounceCounterJumpDown = true
                DemDebounceCounterJumpDownValue = 0
                DemDebounceCounterJumpUp = true
                DemDebounceCounterJumpUpValue = 0
                DemDebounceCounterPassedThreshold = -128
                DemDebounceCounterStorage = false
                DemDebounceContinuous = false
        AutoCreatedDemEvent_WDG_E_MODE_FAILED: DemEventId=158, DemEventKind=DEM_EVENT_KIND_BSW
          DemEventClass: DemAgingAllowed=false, DemConsiderPtoStatus=false, DemEventPriority=2, DemFFPrestorageSupported=false, DemOperationCycleRef=PowerCycle
            DemDebounceAlgorithmClass
              DemDebounceCounterBased:
                DemDebounceBehavior = DEM_DEBOUNCE_FREEZE
                DemDebounceCounterDecrementStepSize = 1
                DemDebounceCounterFailedThreshold = 127
                DemDebounceCounterIncrementStepSize = 1
                DemDebounceCounterJumpDown = true
                DemDebounceCounterJumpDownValue = 0
                DemDebounceCounterJumpUp = true
                DemDebounceCounterJumpUpValue = 0
                DemDebounceCounterPassedThreshold = -128
                DemDebounceCounterStorage = false
                DemDebounceContinuous = false
        AutoCreatedDemEvent_WDG_E_DISABLE_REJECTED: DemEventId=157, DemEventKind=DEM_EVENT_KIND_BSW
          DemEventClass: DemAgingAllowed=false, DemConsiderPtoStatus=false, DemEventPriority=2, DemFFPrestorageSupported=false, DemOperationCycleRef=PowerCycle
            DemDebounceAlgorithmClass
              DemDebounceCounterBased:
                DemDebounceBehavior = DEM_DEBOUNCE_FREEZE
                DemDebounceCounterDecrementStepSize = 1
                DemDebounceCounterFailedThreshold = 127
                DemDebounceCounterIncrementStepSize = 1
                DemDebounceCounterJumpDown = true
                DemDebounceCounterJumpDownValue = 0
                DemDebounceCounterJumpUp = true
                DemDebounceCounterJumpUpValue = 0
                DemDebounceCounterPassedThreshold = -128
                DemDebounceCounterStorage = false
                DemDebounceContinuous = false
        AutoCreatedDemEvent_WdgMDemEventParameterRefs_WDGM_E_SET_MODE: DemEventId=161, DemEventKind=DEM_EVENT_KIND_BSW
          DemEventClass: DemAgingAllowed=false, DemConsiderPtoStatus=false, DemEventPriority=2, DemFFPrestorageSupported=false, DemOperationCycleRef=PowerCycle
            DemDebounceAlgorithmClass
              DemDebounceCounterBased:
                DemDebounceBehavior = DEM_DEBOUNCE_FREEZE
                DemDebounceCounterDecrementStepSize = 1
                DemDebounceCounterFailedThreshold = 127
                DemDebounceCounterIncrementStepSize = 1
                DemDebounceCounterJumpDown = true
                DemDebounceCounterJumpDownValue = 0
                DemDebounceCounterJumpUp = true
                DemDebounceCounterJumpUpValue = 0
                DemDebounceCounterPassedThreshold = -128
                DemDebounceCounterStorage = false
                DemDebounceContinuous = false
        AutoCreatedDemEvent_WdgMDemEventParameterRefs_WDGM_E_MONITORING: DemEventId=160, DemEventKind=DEM_EVENT_KIND_BSW
          DemEventClass: DemAgingAllowed=false, DemConsiderPtoStatus=false, DemEventPriority=2, DemFFPrestorageSupported=false, DemOperationCycleRef=PowerCycle
            DemDebounceAlgorithmClass
              DemDebounceCounterBased:
                DemDebounceBehavior = DEM_DEBOUNCE_FREEZE
                DemDebounceCounterDecrementStepSize = 1
                DemDebounceCounterFailedThreshold = 127
                DemDebounceCounterIncrementStepSize = 1
                DemDebounceCounterJumpDown = true
                DemDebounceCounterJumpDownValue = 0
                DemDebounceCounterJumpUp = true
                DemDebounceCounterJumpUpValue = 0
                DemDebounceCounterPassedThreshold = -128
                DemDebounceCounterStorage = false
                DemDebounceContinuous = false
        AutoCreatedDemEvent_WdgMDemEventParameterRefs_WDGM_E_IMPROPER_CALLER: DemEventId=159, DemEventKind=DEM_EVENT_KIND_BSW
          DemEventClass: DemAgingAllowed=false, DemConsiderPtoStatus=false, DemEventPriority=2, DemFFPrestorageSupported=false, DemOperationCycleRef=PowerCycle
            DemDebounceAlgorithmClass
              DemDebounceCounterBased:
                DemDebounceBehavior = DEM_DEBOUNCE_FREEZE
                DemDebounceCounterDecrementStepSize = 1
                DemDebounceCounterFailedThreshold = 127
                DemDebounceCounterIncrementStepSize = 1
                DemDebounceCounterJumpDown = true
                DemDebounceCounterJumpDownValue = 0
                DemDebounceCounterJumpUp = true
                DemDebounceCounterJumpUpValue = 0
                DemDebounceCounterPassedThreshold = -128
                DemDebounceCounterStorage = false
                DemDebounceContinuous = false
      DemDTCAttributesPrimary (DemDTCAttributes): DemMemoryDestinationRef=PrimaryMemory
      13 x DemEventParameter, all with DemEventAvailable=true, DemEventAvailableInVariant=true, DemEventLatchTestFailed=false, DemEventCreateInfoPort=true:
        AutoCreatedDemEvent_FeeDemEventParameterRefs_FEE_E_WRITE_CYCLES_EXHAUSTED: DemEventId=171, DemEventKind=DEM_EVENT_KIND_BSW
          DemEventClass: DemAgingAllowed=false, DemConsiderPtoStatus=false, DemEventPriority=2, DemFFPrestorageSupported=false, DemOperationCycleRef=PowerCycle
            DemDebounceAlgorithmClass
              DemDebounceCounterBased:
                DemDebounceBehavior = DEM_DEBOUNCE_FREEZE
                DemDebounceCounterDecrementStepSize = 1
                DemDebounceCounterFailedThreshold = 127
                DemDebounceCounterIncrementStepSize = 1
                DemDebounceCounterJumpDown = true
                DemDebounceCounterJumpDownValue = 0
                DemDebounceCounterJumpUp = true
                DemDebounceCounterJumpUpValue = 0
                DemDebounceCounterPassedThreshold = -128
                DemDebounceCounterStorage = false
                DemDebounceContinuous = false
        AutoCreatedDemEvent_FeeDemEventParameterRefs_FEE_E_WRITE: DemEventId=170, DemEventKind=DEM_EVENT_KIND_BSW
          DemEventClass: DemAgingAllowed=false, DemConsiderPtoStatus=false, DemEventPriority=2, DemFFPrestorageSupported=false, DemOperationCycleRef=PowerCycle
            DemDebounceAlgorithmClass
              DemDebounceCounterBased:
                DemDebounceBehavior = DEM_DEBOUNCE_FREEZE
                DemDebounceCounterDecrementStepSize = 1
                DemDebounceCounterFailedThreshold = 127
                DemDebounceCounterIncrementStepSize = 1
                DemDebounceCounterJumpDown = true
                DemDebounceCounterJumpDownValue = 0
                DemDebounceCounterJumpUp = true
                DemDebounceCounterJumpUpValue = 0
                DemDebounceCounterPassedThreshold = -128
                DemDebounceCounterStorage = false
                DemDebounceContinuous = false
        AutoCreatedDemEvent_FeeDemEventParameterRefs_FEE_E_UNCONFIG_BLK_EXCEEDED: DemEventId=169, DemEventKind=DEM_EVENT_KIND_BSW
          DemEventClass: DemAgingAllowed=false, DemConsiderPtoStatus=false, DemEventPriority=2, DemFFPrestorageSupported=false, DemOperationCycleRef=PowerCycle
            DemDebounceAlgorithmClass
              DemDebounceCounterBased:
                DemDebounceBehavior = DEM_DEBOUNCE_FREEZE
                DemDebounceCounterDecrementStepSize = 1
                DemDebounceCounterFailedThreshold = 127
                DemDebounceCounterIncrementStepSize = 1
                DemDebounceCounterJumpDown = true
                DemDebounceCounterJumpDownValue = 0
                DemDebounceCounterJumpUp = true
                DemDebounceCounterJumpUpValue = 0
                DemDebounceCounterPassedThreshold = -128
                DemDebounceCounterStorage = false
                DemDebounceContinuous = false
        AutoCreatedDemEvent_FeeDemEventParameterRefs_FEE_E_READ: DemEventId=168, DemEventKind=DEM_EVENT_KIND_BSW
          DemEventClass: DemAgingAllowed=false, DemConsiderPtoStatus=false, DemEventPriority=2, DemFFPrestorageSupported=false, DemOperationCycleRef=PowerCycle
            DemDebounceAlgorithmClass
              DemDebounceCounterBased:
                DemDebounceBehavior = DEM_DEBOUNCE_FREEZE
                DemDebounceCounterDecrementStepSize = 1
                DemDebounceCounterFailedThreshold = 127
                DemDebounceCounterIncrementStepSize = 1
                DemDebounceCounterJumpDown = true
                DemDebounceCounterJumpDownValue = 0
                DemDebounceCounterJumpUp = true
                DemDebounceCounterJumpUpValue = 0
                DemDebounceCounterPassedThreshold = -128
                DemDebounceCounterStorage = false
                DemDebounceContinuous = false
        AutoCreatedDemEvent_FeeDemEventParameterRefs_FEE_E_INVALIDATE: DemEventId=167, DemEventKind=DEM_EVENT_KIND_BSW
          DemEventClass: DemAgingAllowed=false, DemConsiderPtoStatus=false, DemEventPriority=2, DemFFPrestorageSupported=false, DemOperationCycleRef=PowerCycle
            DemDebounceAlgorithmClass
              DemDebounceCounterBased:
                DemDebounceBehavior = DEM_DEBOUNCE_FREEZE
                DemDebounceCounterDecrementStepSize = 1
                DemDebounceCounterFailedThreshold = 127
                DemDebounceCounterIncrementStepSize = 1
                DemDebounceCounterJumpDown = true
                DemDebounceCounterJumpDownValue = 0
                DemDebounceCounterJumpUp = true
                DemDebounceCounterJumpUpValue = 0
                DemDebounceCounterPassedThreshold = -128
                DemDebounceCounterStorage = false
                DemDebounceContinuous = false
        AutoCreatedDemEvent_FeeDemEventParameterRefs_FEE_E_GC_WRITE: DemEventId=166, DemEventKind=DEM_EVENT_KIND_BSW
          DemEventClass: DemAgingAllowed=false, DemConsiderPtoStatus=false, DemEventPriority=2, DemFFPrestorageSupported=false, DemOperationCycleRef=PowerCycle
            DemDebounceAlgorithmClass
              DemDebounceCounterBased:
                DemDebounceBehavior = DEM_DEBOUNCE_FREEZE
                DemDebounceCounterDecrementStepSize = 1
                DemDebounceCounterFailedThreshold = 127
                DemDebounceCounterIncrementStepSize = 1
                DemDebounceCounterJumpDown = true
                DemDebounceCounterJumpDownValue = 0
                DemDebounceCounterJumpUp = true
                DemDebounceCounterJumpUpValue = 0
                DemDebounceCounterPassedThreshold = -128
                DemDebounceCounterStorage = false
                DemDebounceContinuous = false
        AutoCreatedDemEvent_FeeDemEventParameterRefs_FEE_E_GC_TRIG: DemEventId=165, DemEventKind=DEM_EVENT_KIND_BSW
          DemEventClass: DemAgingAllowed=false, DemConsiderPtoStatus=false, DemEventPriority=2, DemFFPrestorageSupported=false, DemOperationCycleRef=PowerCycle
            DemDebounceAlgorithmClass
              DemDebounceCounterBased:
                DemDebounceBehavior = DEM_DEBOUNCE_FREEZE
                DemDebounceCounterDecrementStepSize = 1
                DemDebounceCounterFailedThreshold = 127
                DemDebounceCounterIncrementStepSize = 1
                DemDebounceCounterJumpDown = true
                DemDebounceCounterJumpDownValue = 0
                DemDebounceCounterJumpUp = true
                DemDebounceCounterJumpUpValue = 0
                DemDebounceCounterPassedThreshold = -128
                DemDebounceCounterStorage = false
                DemDebounceContinuous = false
        AutoCreatedDemEvent_FeeDemEventParameterRefs_FEE_E_GC_READ: DemEventId=164, DemEventKind=DEM_EVENT_KIND_BSW
          DemEventClass: DemAgingAllowed=false, DemConsiderPtoStatus=false, DemEventPriority=2, DemFFPrestorageSupported=false, DemOperationCycleRef=PowerCycle
            DemDebounceAlgorithmClass
              DemDebounceCounterBased:
                DemDebounceBehavior = DEM_DEBOUNCE_FREEZE
                DemDebounceCounterDecrementStepSize = 1
                DemDebounceCounterFailedThreshold = 127
                DemDebounceCounterIncrementStepSize = 1
                DemDebounceCounterJumpDown = true
                DemDebounceCounterJumpDownValue = 0
                DemDebounceCounterJumpUp = true
                DemDebounceCounterJumpUpValue = 0
                DemDebounceCounterPassedThreshold = -128
                DemDebounceCounterStorage = false
                DemDebounceContinuous = false
        AutoCreatedDemEvent_FeeDemEventParameterRefs_FEE_E_GC_INIT: DemEventId=163, DemEventKind=DEM_EVENT_KIND_BSW
          DemEventClass: DemAgingAllowed=false, DemConsiderPtoStatus=false, DemEventPriority=2, DemFFPrestorageSupported=false, DemOperationCycleRef=PowerCycle
            DemDebounceAlgorithmClass
              DemDebounceCounterBased:
                DemDebounceBehavior = DEM_DEBOUNCE_FREEZE
                DemDebounceCounterDecrementStepSize = 1
                DemDebounceCounterFailedThreshold = 127
                DemDebounceCounterIncrementStepSize = 1
                DemDebounceCounterJumpDown = true
                DemDebounceCounterJumpDownValue = 0
                DemDebounceCounterJumpUp = true
                DemDebounceCounterJumpUpValue = 0
                DemDebounceCounterPassedThreshold = -128
                DemDebounceCounterStorage = false
                DemDebounceContinuous = false
        AutoCreatedDemEvent_FeeDemEventParameterRefs_FEE_E_GC_ERASE: DemEventId=162, DemEventKind=DEM_EVENT_KIND_BSW
          DemEventClass: DemAgingAllowed=false, DemConsiderPtoStatus=false, DemEventPriority=2, DemFFPrestorageSupported=false, DemOperationCycleRef=PowerCycle
            DemDebounceAlgorithmClass
              DemDebounceCounterBased:
                DemDebounceBehavior = DEM_DEBOUNCE_FREEZE
                DemDebounceCounterDecrementStepSize = 1
                DemDebounceCounterFailedThreshold = 127
                DemDebounceCounterIncrementStepSize = 1
                DemDebounceCounterJumpDown = true
                DemDebounceCounterJumpDownValue = 0
                DemDebounceCounterJumpUp = true
                DemDebounceCounterJumpUpValue = 0
                DemDebounceCounterPassedThreshold = -128
                DemDebounceCounterStorage = false
                DemDebounceContinuous = false
        DTC_0x100000: DemEventKind=DEM_EVENT_KIND_SWC, DemEventId=22, DemDTCClassRef=DtcClass_DTC_0x100000, DemExtendedDataClassRef=ExtendedDataClass_4af7fffc, DemOBDFreezeFrameClassRef=FreezeFrame_51eb4bef
          DemEventClass:
            DemEventSignificance = DEM_EVENT_SIGNIFICANCE_FAULT
            DemAgingAllowed = false
            DemConsiderPtoStatus = false
            DemEventPriority = 2
            DemFFPrestorageSupported = false
            DemAgingCycleRef = PowerCycle
            DemOperationCycleRef = PowerCycle
            DemDebounceAlgorithmClass
              DemDebounceMonitorInternal
                DemCallbackGetFDC
        DTC_0x100002: DemEventKind=DEM_EVENT_KIND_SWC, DemEventId=23, DemDTCClassRef=DtcClass_DTC_0x100002, DemExtendedDataClassRef=ExtendedDataClass_4af7fffc, DemOBDFreezeFrameClassRef=FreezeFrame_51eb4bef
          DemEventClass:
            DemEventSignificance = DEM_EVENT_SIGNIFICANCE_FAULT
            DemAgingAllowed = false
            DemConsiderPtoStatus = false
            DemEventPriority = 2
            DemFFPrestorageSupported = false
            DemAgingCycleRef = PowerCycle
            DemOperationCycleRef = PowerCycle
            DemDebounceAlgorithmClass
              DemDebounceMonitorInternal
                DemCallbackGetFDC
        DTC_0x100003: DemEventKind=DEM_EVENT_KIND_SWC, DemEventId=24, DemDTCClassRef=DtcClass_DTC_0x100003, DemExtendedDataClassRef=ExtendedDataClass_4af7fffc, DemOBDFreezeFrameClassRef=FreezeFrame_51eb4bef
          DemEventClass:
            DemEventSignificance = DEM_EVENT_SIGNIFICANCE_FAULT
            DemAgingAllowed = false
            DemConsiderPtoStatus = false
            DemEventPriority = 2
            DemFFPrestorageSupported = false
            DemAgingCycleRef = PowerCycle
            DemOperationCycleRef = PowerCycle
            DemDebounceAlgorithmClass
              DemDebounceMonitorInternal
                DemCallbackGetFDC
      3 x DemDTCClass, all with DemFunctionalGroupIdentifier=51, DemImmediateNvStorage=false, DemDTCAttributesRef=DtcAttributes_41914fb7:
        DtcClass_DTC_0xd12c30: DemUdsDTC=13708336
        DtcClass_DTC_0x170600: DemUdsDTC=1508864
        DtcClass_DTC_0xd12112: DemUdsDTC=13705490
      DTC_0xc12490 (DemEventParameter):
        DemEventKind = DEM_EVENT_KIND_SWC
        DemEventAvailable = true
        DemEventId = 50
        DemEventAvailableInVariant = true
        DemEventLatchTestFailed = false
        DemEventCreateInfoPort = true
        DemDTCClassRef = DtcClass_DTC_0xc12490
        DemExtendedDataClassRef = ExtendedDataClass_4af7fffc
        DemOBDFreezeFrameClassRef = FreezeFrame_51eb4bef
        DemEventClass:
          DemEventSignificance = DEM_EVENT_SIGNIFICANCE_FAULT
          DemAgingAllowed = false
          DemConsiderPtoStatus = false
          DemEventPriority = 2
          DemFFPrestorageSupported = false
          DemAgingCycleRef = PowerCycle
          DemOperationCycleRef = PowerCycle
          DemDebounceAlgorithmClass
            DemDebounceMonitorInternal
              DemCallbackGetFDC
      DTC_0x100009 (DemEventParameter):
        DemEventKind = DEM_EVENT_KIND_SWC
        DemEventAvailable = true
        DemEventId = 25
        DemEventAvailableInVariant = true
        DemEventLatchTestFailed = false
        DemEventCreateInfoPort = true
        DemDTCClassRef = DtcClass_DTC_0x100009
        DemExtendedDataClassRef = ExtendedDataClass_4af7fffc
        DemOBDFreezeFrameClassRef = FreezeFrame_51eb4bef
        DemEventClass:
          DemEventSignificance = DEM_EVENT_SIGNIFICANCE_FAULT
          DemAgingAllowed = false
          DemConsiderPtoStatus = false
          DemEventPriority = 2
          DemFFPrestorageSupported = false
          DemAgingCycleRef = PowerCycle
          DemOperationCycleRef = PowerCycle
          DemDebounceAlgorithmClass
            DemDebounceMonitorInternal
              DemCallbackGetFDC
      16 x DemDTCClass, all with DemFunctionalGroupIdentifier=51, DemImmediateNvStorage=false, DemDTCAttributesRef=DtcAttributes_41914fb7:
        DtcClass_DTC_0xd12116: DemUdsDTC=13705494
        DtcClass_DTC_0xd12117: DemUdsDTC=13705495
        DtcClass_DTC_0xd12114: DemUdsDTC=13705492
        DtcClass_DTC_0xd12115: DemUdsDTC=13705493
        DtcClass_DTC_0x100044: DemUdsDTC=1048644
        DtcClass_DTC_0xd12118: DemUdsDTC=13705496
        DtcClass_DTC_0xd12119: DemUdsDTC=13705497
        DtcClass_DTC_0x100041: DemUdsDTC=1048641
        DtcClass_DTC_0x100042: DemUdsDTC=1048642
        DtcClass_DTC_0x100043: DemUdsDTC=1048643
        DtcClass_DTC_0xd1210b: DemUdsDTC=13705483
        DtcClass_DTC_0xd01200: DemUdsDTC=13636096
        DtcClass_DTC_0xd1210e: DemUdsDTC=13705486
        DtcClass_DTC_0xd1210f: DemUdsDTC=13705487
        DtcClass_DTC_0xd1210c: DemUdsDTC=13705484
        DtcClass_DTC_0xd1210d: DemUdsDTC=13705485
      DTC_0xd40200 (DemEventParameter):
        DemEventKind = DEM_EVENT_KIND_SWC
        DemEventAvailable = true
        DemEventId = 98
        DemEventAvailableInVariant = true
        DemEventLatchTestFailed = false
        DemEventCreateInfoPort = true
        DemDTCClassRef = DtcClass_DTC_0xd40200
        DemExtendedDataClassRef = ExtendedDataClass_4af7fffc
        DemOBDFreezeFrameClassRef = FreezeFrame_51eb4bef
        DemEventClass:
          DemEventSignificance = DEM_EVENT_SIGNIFICANCE_FAULT
          DemAgingAllowed = false
          DemConsiderPtoStatus = false
          DemEventPriority = 2
          DemFFPrestorageSupported = false
          DemAgingCycleRef = PowerCycle
          DemOperationCycleRef = PowerCycle
          DemDebounceAlgorithmClass
            DemDebounceMonitorInternal
              DemCallbackGetFDC
      4 x DemDTCClass, all with DemFunctionalGroupIdentifier=51, DemImmediateNvStorage=false, DemDTCAttributesRef=DtcAttributes_41914fb7:
        DtcClass_DTC_0x170612: DemUdsDTC=1508882
        DtcClass_DTC_0x170610: DemUdsDTC=1508880
        DtcClass_DTC_0x170611: DemUdsDTC=1508881
        DtcClass_DTC_0xd12002: DemUdsDTC=13705218
      DTC_0x00b050 (DemEventParameter):
        DemEventKind = DEM_EVENT_KIND_SWC
        DemEventAvailable = true
        DemEventId = 5
        DemEventAvailableInVariant = true
        DemEventLatchTestFailed = false
        DemEventCreateInfoPort = true
        DemDTCClassRef = DtcClass_DTC_0x00b050
        DemExtendedDataClassRef = ExtendedDataClass_4af7fffc
        DemOBDFreezeFrameClassRef = FreezeFrame_51eb4bef
        DemEventClass:
          DemEventSignificance = DEM_EVENT_SIGNIFICANCE_FAULT
          DemAgingAllowed = false
          DemConsiderPtoStatus = false
          DemEventPriority = 2
          DemFFPrestorageSupported = false
          DemAgingCycleRef = PowerCycle
          DemOperationCycleRef = PowerCycle
          DemDebounceAlgorithmClass
            DemDebounceMonitorInternal
              DemCallbackGetFDC
      9 x DemDTCClass, all with DemFunctionalGroupIdentifier=51, DemImmediateNvStorage=false, DemDTCAttributesRef=DtcAttributes_41914fb7:
        DtcClass_DTC_0xd12000: DemUdsDTC=13705216
        DtcClass_DTC_0xd12001: DemUdsDTC=13705217
        DtcClass_DTC_0xd12004: DemUdsDTC=13705220
        DtcClass_DTC_0x100033: DemUdsDTC=1048627
        DtcClass_DTC_0x100034: DemUdsDTC=1048628
        DtcClass_DTC_0x100035: DemUdsDTC=1048629
        DtcClass_DTC_0x100036: DemUdsDTC=1048630
        DtcClass_DTC_0x100031: DemUdsDTC=1048625
        DtcClass_DTC_0x100032: DemUdsDTC=1048626
      DTC_0x10000f (DemEventParameter):
        DemEventKind = DEM_EVENT_KIND_SWC
        DemEventAvailable = true
        DemEventId = 14
        DemEventAvailableInVariant = true
        DemEventLatchTestFailed = false
        DemEventCreateInfoPort = true
        DemDTCClassRef = DtcClass_DTC_0x10000f
        DemExtendedDataClassRef = ExtendedDataClass_4af7fffc
        DemOBDFreezeFrameClassRef = FreezeFrame_51eb4bef
        DemEventClass:
          DemEventSignificance = DEM_EVENT_SIGNIFICANCE_FAULT
          DemAgingAllowed = false
          DemConsiderPtoStatus = false
          DemEventPriority = 2
          DemFFPrestorageSupported = false
          DemAgingCycleRef = PowerCycle
          DemOperationCycleRef = PowerCycle
          DemDebounceAlgorithmClass
            DemDebounceMonitorInternal
              DemCallbackGetFDC
      DtcClass_DTC_0xd1211d (DemDTCClass): DemUdsDTC=13705501, DemFunctionalGroupIdentifier=51, DemImmediateNvStorage=false, DemDTCAttributesRef=DtcAttributes_41914fb7
      DTC_0x10001a (DemEventParameter):
        DemEventKind = DEM_EVENT_KIND_SWC
        DemEventAvailable = true
        DemEventId = 15
        DemEventAvailableInVariant = true
        DemEventLatchTestFailed = false
        DemEventCreateInfoPort = true
        DemDTCClassRef = DtcClass_DTC_0x10001a
        DemExtendedDataClassRef = ExtendedDataClass_4af7fffc
        DemOBDFreezeFrameClassRef = FreezeFrame_51eb4bef
        DemEventClass:
          DemEventSignificance = DEM_EVENT_SIGNIFICANCE_FAULT
          DemAgingAllowed = false
          DemConsiderPtoStatus = false
          DemEventPriority = 2
          DemFFPrestorageSupported = false
          DemAgingCycleRef = PowerCycle
          DemOperationCycleRef = PowerCycle
          DemDebounceAlgorithmClass
            DemDebounceMonitorInternal
              DemCallbackGetFDC
      DTC_0x10001c (DemEventParameter):
        DemEventKind = DEM_EVENT_KIND_SWC
        DemEventAvailable = true
        DemEventId = 16
        DemEventAvailableInVariant = true
        DemEventLatchTestFailed = false
        DemEventCreateInfoPort = true
        DemDTCClassRef = DtcClass_DTC_0x10001c
        DemExtendedDataClassRef = ExtendedDataClass_4af7fffc
        DemOBDFreezeFrameClassRef = FreezeFrame_51eb4bef
        DemEventClass:
          DemEventSignificance = DEM_EVENT_SIGNIFICANCE_FAULT
          DemAgingAllowed = false
          DemConsiderPtoStatus = false
          DemEventPriority = 2
          DemFFPrestorageSupported = false
          DemAgingCycleRef = PowerCycle
          DemOperationCycleRef = PowerCycle
          DemDebounceAlgorithmClass
            DemDebounceMonitorInternal
              DemCallbackGetFDC
      DtcClass_DTC_0xd12011 (DemDTCClass): DemUdsDTC=13705233, DemFunctionalGroupIdentifier=51, DemImmediateNvStorage=false, DemDTCAttributesRef=DtcAttributes_41914fb7
      4 x DemEventParameter, all with DemEventKind=DEM_EVENT_KIND_SWC, DemEventAvailable=true, DemEventAvailableInVariant=true, DemEventLatchTestFailed=false, DemEventCreateInfoPort=true, DemExtendedDataClassRef=ExtendedDataClass_4af7fffc, DemOBDFreezeFrameClassRef=FreezeFrame_51eb4bef:
        DTC_0x100011: DemEventId=27, DemDTCClassRef=DtcClass_DTC_0x100011
          DemEventClass:
            DemEventSignificance = DEM_EVENT_SIGNIFICANCE_FAULT
            DemAgingAllowed = false
            DemConsiderPtoStatus = false
            DemEventPriority = 2
            DemFFPrestorageSupported = false
            DemAgingCycleRef = PowerCycle
            DemOperationCycleRef = PowerCycle
            DemDebounceAlgorithmClass
              DemDebounceMonitorInternal
                DemCallbackGetFDC
        DTC_0x100012: DemEventId=28, DemDTCClassRef=DtcClass_DTC_0x100012
          DemEventClass:
            DemEventSignificance = DEM_EVENT_SIGNIFICANCE_FAULT
            DemAgingAllowed = false
            DemConsiderPtoStatus = false
            DemEventPriority = 2
            DemFFPrestorageSupported = false
            DemAgingCycleRef = PowerCycle
            DemOperationCycleRef = PowerCycle
            DemDebounceAlgorithmClass
              DemDebounceMonitorInternal
                DemCallbackGetFDC
        DTC_0x100010: DemEventId=26, DemDTCClassRef=DtcClass_DTC_0x100010
          DemEventClass:
            DemEventSignificance = DEM_EVENT_SIGNIFICANCE_FAULT
            DemAgingAllowed = false
            DemConsiderPtoStatus = false
            DemEventPriority = 2
            DemFFPrestorageSupported = false
            DemAgingCycleRef = PowerCycle
            DemOperationCycleRef = PowerCycle
            DemDebounceAlgorithmClass
              DemDebounceMonitorInternal
                DemCallbackGetFDC
        DTC_0x100013: DemEventId=29, DemDTCClassRef=DtcClass_DTC_0x100013
          DemEventClass:
            DemEventSignificance = DEM_EVENT_SIGNIFICANCE_FAULT
            DemAgingAllowed = false
            DemConsiderPtoStatus = false
            DemEventPriority = 2
            DemFFPrestorageSupported = false
            DemAgingCycleRef = PowerCycle
            DemOperationCycleRef = PowerCycle
            DemDebounceAlgorithmClass
              DemDebounceMonitorInternal
                DemCallbackGetFDC
      4 x DemDTCClass, all with DemFunctionalGroupIdentifier=51, DemImmediateNvStorage=false, DemDTCAttributesRef=DtcAttributes_41914fb7:
        DtcClass_DTC_0x10000d: DemUdsDTC=1048589
        DtcClass_DTC_0x10000e: DemUdsDTC=1048590
        DtcClass_DTC_0x10000f: DemUdsDTC=1048591
        DtcClass_DTC_0x10001a: DemUdsDTC=1048602
      DTC_0x10000a (DemEventParameter):
        DemEventKind = DEM_EVENT_KIND_SWC
        DemEventAvailable = true
        DemEventId = 10
        DemEventAvailableInVariant = true
        DemEventLatchTestFailed = false
        DemEventCreateInfoPort = true
        DemMaxNumberFreezeFrameRecords = 1
        DemDTCClassRef = DtcClass_DTC_0x10000a
        DemExtendedDataClassRef = ExtendedDataClass_4af7fffc
        DemOBDFreezeFrameClassRef = FreezeFrame_51eb4bef
        DemFreezeFrameClassRef = FreezeFrame_51eb4bef
        DemEventClass:
          DemEventSignificance = DEM_EVENT_SIGNIFICANCE_FAULT
          DemAgingAllowed = true
          DemConsiderPtoStatus = false
          DemEventPriority = 2
          DemFFPrestorageSupported = false
          DemAgingCycleCounterThreshold = 3
          DemAgingCycleRef = RT_Test_OpCycle
          DemOperationCycleRef = PowerCycle
          DemDebounceAlgorithmClass
            DemDebounceCounterBased:
              DemDebounceBehavior = DEM_DEBOUNCE_FREEZE
              DemDebounceCounterDecrementStepSize = 1
              DemDebounceCounterFailedThreshold = 5
              DemDebounceCounterIncrementStepSize = 1
              DemDebounceCounterJumpDown = true
              DemDebounceCounterJumpDownValue = 0
              DemDebounceCounterJumpUp = true
              DemDebounceCounterJumpUpValue = 0
              DemDebounceCounterPassedThreshold = -5
              DemDebounceCounterStorage = false
              DemDebounceContinuous = false
      DtcClass_DTC_0x10001c (DemDTCClass): DemUdsDTC=1048604, DemFunctionalGroupIdentifier=51, DemImmediateNvStorage=false, DemDTCAttributesRef=DtcAttributes_41914fb7
      3 x DemEventParameter, all with DemEventKind=DEM_EVENT_KIND_SWC, DemEventAvailable=true, DemEventAvailableInVariant=true, DemEventLatchTestFailed=false, DemEventCreateInfoPort=true, DemExtendedDataClassRef=ExtendedDataClass_4af7fffc, DemOBDFreezeFrameClassRef=FreezeFrame_51eb4bef:
        DTC_0x10000d: DemEventId=12, DemDTCClassRef=DtcClass_DTC_0x10000d
          DemEventClass:
            DemEventSignificance = DEM_EVENT_SIGNIFICANCE_FAULT
            DemAgingAllowed = false
            DemConsiderPtoStatus = false
            DemEventPriority = 2
            DemFFPrestorageSupported = false
            DemAgingCycleRef = PowerCycle
            DemOperationCycleRef = PowerCycle
            DemDebounceAlgorithmClass
              DemDebounceMonitorInternal
                DemCallbackGetFDC
        DTC_0x10000e: DemEventId=13, DemDTCClassRef=DtcClass_DTC_0x10000e
          DemEventClass:
            DemEventSignificance = DEM_EVENT_SIGNIFICANCE_FAULT
            DemAgingAllowed = false
            DemConsiderPtoStatus = false
            DemEventPriority = 2
            DemFFPrestorageSupported = false
            DemAgingCycleRef = PowerCycle
            DemOperationCycleRef = PowerCycle
            DemDebounceAlgorithmClass
              DemDebounceMonitorInternal
                DemCallbackGetFDC
        DTC_0x10000b: DemEventId=11, DemMaxNumberFreezeFrameRecords=6, DemDTCClassRef=DtcClass_DTC_0x10000b, DemFreezeFrameRecNumClassRef=DemFreezeFrameRecNumClass, DemFreezeFrameClassRef=FreezeFrame_51eb4bef
          DemEventClass:
            DemEventSignificance = DEM_EVENT_SIGNIFICANCE_FAULT
            DemAgingAllowed = true
            DemConsiderPtoStatus = false
            DemEventPriority = 2
            DemFFPrestorageSupported = false
            DemAgingCycleCounterThreshold = 3
            DemAgingCycleRef = RT_Test_OpCycle
            DemOperationCycleRef = PowerCycle
            DemDebounceAlgorithmClass
              DemDebounceTimeBase: DemDebounceBehavior=DEM_DEBOUNCE_FREEZE, DemDebounceTimeFailedThreshold=1, DemDebounceTimePassedThreshold=2, DemDebounceContinuous=false
      DtcClass_DTC_0xd12025 (DemDTCClass): DemUdsDTC=13705253, DemFunctionalGroupIdentifier=51, DemImmediateNvStorage=false, DemDTCAttributesRef=DtcAttributes_41914fb7
      DtcClass_DTC_0xd12026 (DemDTCClass): DemUdsDTC=13705254, DemFunctionalGroupIdentifier=51, DemImmediateNvStorage=false, DemDTCAttributesRef=DtcAttributes_41914fb7
      8 x DemEventParameter, all with DemEventKind=DEM_EVENT_KIND_SWC, DemEventAvailable=true, DemEventAvailableInVariant=true, DemEventLatchTestFailed=false, DemEventCreateInfoPort=true, DemExtendedDataClassRef=ExtendedDataClass_4af7fffc, DemOBDFreezeFrameClassRef=FreezeFrame_51eb4bef:
        DTC_0x100044: DemEventId=39, DemDTCClassRef=DtcClass_DTC_0x100044
          DemEventClass:
            DemEventSignificance = DEM_EVENT_SIGNIFICANCE_FAULT
            DemAgingAllowed = false
            DemConsiderPtoStatus = false
            DemEventPriority = 2
            DemFFPrestorageSupported = false
            DemAgingCycleRef = PowerCycle
            DemOperationCycleRef = PowerCycle
            DemDebounceAlgorithmClass
              DemDebounceMonitorInternal
                DemCallbackGetFDC
        DTC_0x100042: DemEventId=37, DemDTCClassRef=DtcClass_DTC_0x100042
          DemEventClass:
            DemEventSignificance = DEM_EVENT_SIGNIFICANCE_FAULT
            DemAgingAllowed = false
            DemConsiderPtoStatus = false
            DemEventPriority = 2
            DemFFPrestorageSupported = false
            DemAgingCycleRef = PowerCycle
            DemOperationCycleRef = PowerCycle
            DemDebounceAlgorithmClass
              DemDebounceMonitorInternal
                DemCallbackGetFDC
        DTC_0x100043: DemEventId=38, DemDTCClassRef=DtcClass_DTC_0x100043
          DemEventClass:
            DemEventSignificance = DEM_EVENT_SIGNIFICANCE_FAULT
            DemAgingAllowed = false
            DemConsiderPtoStatus = false
            DemEventPriority = 2
            DemFFPrestorageSupported = false
            DemAgingCycleRef = PowerCycle
            DemOperationCycleRef = PowerCycle
            DemDebounceAlgorithmClass
              DemDebounceMonitorInternal
                DemCallbackGetFDC
        DTC_0xd12c20: DemEventId=58, DemDTCClassRef=DtcClass_DTC_0xd12c20
          DemEventClass:
            DemEventSignificance = DEM_EVENT_SIGNIFICANCE_FAULT
            DemAgingAllowed = false
            DemConsiderPtoStatus = false
            DemEventPriority = 2
            DemFFPrestorageSupported = false
            DemAgingCycleRef = PowerCycle
            DemOperationCycleRef = PowerCycle
            DemDebounceAlgorithmClass
              DemDebounceMonitorInternal
                DemCallbackGetFDC
        DTC_0xd12c21: DemEventId=59, DemDTCClassRef=DtcClass_DTC_0xd12c21
          DemEventClass:
            DemEventSignificance = DEM_EVENT_SIGNIFICANCE_FAULT
            DemAgingAllowed = false
            DemConsiderPtoStatus = false
            DemEventPriority = 2
            DemFFPrestorageSupported = false
            DemAgingCycleRef = PowerCycle
            DemOperationCycleRef = PowerCycle
            DemDebounceAlgorithmClass
              DemDebounceMonitorInternal
                DemCallbackGetFDC
        DTC_0xd01200: DemEventId=73, DemDTCClassRef=DtcClass_DTC_0xd01200
          DemEventClass:
            DemEventSignificance = DEM_EVENT_SIGNIFICANCE_FAULT
            DemAgingAllowed = false
            DemConsiderPtoStatus = false
            DemEventPriority = 2
            DemFFPrestorageSupported = false
            DemAgingCycleRef = PowerCycle
            DemOperationCycleRef = PowerCycle
            DemDebounceAlgorithmClass
              DemDebounceMonitorInternal
                DemCallbackGetFDC
        DTC_0xd12c23: DemEventId=60, DemDTCClassRef=DtcClass_DTC_0xd12c23
          DemEventClass:
            DemEventSignificance = DEM_EVENT_SIGNIFICANCE_FAULT
            DemAgingAllowed = false
            DemConsiderPtoStatus = false
            DemEventPriority = 2
            DemFFPrestorageSupported = false
            DemAgingCycleRef = PowerCycle
            DemOperationCycleRef = PowerCycle
            DemDebounceAlgorithmClass
              DemDebounceMonitorInternal
                DemCallbackGetFDC
        DTC_0x100041: DemEventId=36, DemDTCClassRef=DtcClass_DTC_0x100041
          DemEventClass:
            DemEventSignificance = DEM_EVENT_SIGNIFICANCE_FAULT
            DemAgingAllowed = false
            DemConsiderPtoStatus = false
            DemEventPriority = 2
            DemFFPrestorageSupported = false
            DemAgingCycleRef = PowerCycle
            DemOperationCycleRef = PowerCycle
            DemDebounceAlgorithmClass
              DemDebounceMonitorInternal
                DemCallbackGetFDC
      DtcClass_DTC_0x000080 (DemDTCClass): DemUdsDTC=128, DemFunctionalGroupIdentifier=51, DemImmediateNvStorage=false, DemDTCAttributesRef=DtcAttributes_41914fb7
      DtcClass_DTC_0xd40100 (DemDTCClass): DemUdsDTC=13893888, DemFunctionalGroupIdentifier=51, DemImmediateNvStorage=false, DemDTCAttributesRef=DtcAttributes_41914fb7
      3 x DemEventParameter, all with DemEventKind=DEM_EVENT_KIND_SWC, DemEventAvailable=true, DemEventAvailableInVariant=true, DemEventLatchTestFailed=false, DemEventCreateInfoPort=true, DemMaxNumberFreezeFrameRecords=1, DemExtendedDataClassRef=ExtendedDataClass_4af7fffc, DemOBDFreezeFrameClassRef=FreezeFrame_51eb4bef, DemFreezeFrameClassRef=FreezeFrame_51eb4bef:
        DTC_0xd12101: DemEventId=83, DemDTCClassRef=DtcClass_DTC_0xd12101
          DemEventClass:
            DemEventSignificance = DEM_EVENT_SIGNIFICANCE_FAULT
            DemAgingAllowed = false
            DemConsiderPtoStatus = false
            DemEventPriority = 2
            DemFFPrestorageSupported = false
            DemAgingCycleRef = PowerCycle
            DemOperationCycleRef = PowerCycle
            DemDebounceAlgorithmClass
              DemDebounceMonitorInternal
                DemCallbackGetFDC
        DTC_0xd12102: DemEventId=84, DemDTCClassRef=DtcClass_DTC_0xd12102
          DemEventClass:
            DemEventSignificance = DEM_EVENT_SIGNIFICANCE_FAULT
            DemAgingAllowed = false
            DemConsiderPtoStatus = false
            DemEventPriority = 2
            DemFFPrestorageSupported = false
            DemAgingCycleRef = PowerCycle
            DemOperationCycleRef = PowerCycle
            DemDebounceAlgorithmClass
              DemDebounceMonitorInternal
                DemCallbackGetFDC
        DTC_0xd12103: DemEventId=85, DemDTCClassRef=DtcClass_DTC_0xd12103
          DemEventClass:
            DemEventSignificance = DEM_EVENT_SIGNIFICANCE_FAULT
            DemAgingAllowed = false
            DemConsiderPtoStatus = false
            DemEventPriority = 2
            DemFFPrestorageSupported = false
            DemAgingCycleRef = PowerCycle
            DemOperationCycleRef = PowerCycle
            DemDebounceAlgorithmClass
              DemDebounceMonitorInternal
                DemCallbackGetFDC
      DtcClass_DTC_0x00b050 (DemDTCClass): DemUdsDTC=45136, DemFunctionalGroupIdentifier=51, DemImmediateNvStorage=false, DemDTCAttributesRef=DtcAttributes_41914fb7
      7 x DemEventParameter, all with DemEventKind=DEM_EVENT_KIND_SWC, DemEventAvailable=true, DemEventAvailableInVariant=true, DemEventLatchTestFailed=false, DemEventCreateInfoPort=true, DemExtendedDataClassRef=ExtendedDataClass_4af7fffc, DemOBDFreezeFrameClassRef=FreezeFrame_51eb4bef:
        DTC_0x100033: DemEventId=32, DemDTCClassRef=DtcClass_DTC_0x100033
          DemEventClass:
            DemEventSignificance = DEM_EVENT_SIGNIFICANCE_FAULT
            DemAgingAllowed = false
            DemConsiderPtoStatus = false
            DemEventPriority = 2
            DemFFPrestorageSupported = false
            DemAgingCycleRef = PowerCycle
            DemOperationCycleRef = PowerCycle
            DemDebounceAlgorithmClass
              DemDebounceMonitorInternal
                DemCallbackGetFDC
        DTC_0x100034: DemEventId=33, DemDTCClassRef=DtcClass_DTC_0x100034
          DemEventClass:
            DemEventSignificance = DEM_EVENT_SIGNIFICANCE_FAULT
            DemAgingAllowed = false
            DemConsiderPtoStatus = false
            DemEventPriority = 2
            DemFFPrestorageSupported = false
            DemAgingCycleRef = PowerCycle
            DemOperationCycleRef = PowerCycle
            DemDebounceAlgorithmClass
              DemDebounceMonitorInternal
                DemCallbackGetFDC
        DTC_0x100031: DemEventId=30, DemDTCClassRef=DtcClass_DTC_0x100031
          DemEventClass:
            DemEventSignificance = DEM_EVENT_SIGNIFICANCE_FAULT
            DemAgingAllowed = false
            DemConsiderPtoStatus = false
            DemEventPriority = 2
            DemFFPrestorageSupported = false
            DemAgingCycleRef = PowerCycle
            DemOperationCycleRef = PowerCycle
            DemDebounceAlgorithmClass
              DemDebounceMonitorInternal
                DemCallbackGetFDC
        DTC_0x100032: DemEventId=31, DemDTCClassRef=DtcClass_DTC_0x100032
          DemEventClass:
            DemEventSignificance = DEM_EVENT_SIGNIFICANCE_FAULT
            DemAgingAllowed = false
            DemConsiderPtoStatus = false
            DemEventPriority = 2
            DemFFPrestorageSupported = false
            DemAgingCycleRef = PowerCycle
            DemOperationCycleRef = PowerCycle
            DemDebounceAlgorithmClass
              DemDebounceMonitorInternal
                DemCallbackGetFDC
        DTC_0x100035: DemEventId=34, DemDTCClassRef=DtcClass_DTC_0x100035
          DemEventClass:
            DemEventSignificance = DEM_EVENT_SIGNIFICANCE_FAULT
            DemAgingAllowed = false
            DemConsiderPtoStatus = false
            DemEventPriority = 2
            DemFFPrestorageSupported = false
            DemAgingCycleRef = PowerCycle
            DemOperationCycleRef = PowerCycle
            DemDebounceAlgorithmClass
              DemDebounceMonitorInternal
                DemCallbackGetFDC
        DTC_0xd12c30: DemEventId=61, DemDTCClassRef=DtcClass_DTC_0xd12c30
          DemEventClass:
            DemEventSignificance = DEM_EVENT_SIGNIFICANCE_FAULT
            DemAgingAllowed = false
            DemConsiderPtoStatus = false
            DemEventPriority = 2
            DemFFPrestorageSupported = false
            DemAgingCycleRef = PowerCycle
            DemOperationCycleRef = PowerCycle
            DemDebounceAlgorithmClass
              DemDebounceMonitorInternal
                DemCallbackGetFDC
        DTC_0x100036: DemEventId=35, DemDTCClassRef=DtcClass_DTC_0x100036
          DemEventClass:
            DemEventSignificance = DEM_EVENT_SIGNIFICANCE_FAULT
            DemAgingAllowed = false
            DemConsiderPtoStatus = false
            DemEventPriority = 2
            DemFFPrestorageSupported = false
            DemAgingCycleRef = PowerCycle
            DemOperationCycleRef = PowerCycle
            DemDebounceAlgorithmClass
              DemDebounceMonitorInternal
                DemCallbackGetFDC
      4 x DemDTCClass, all with DemFunctionalGroupIdentifier=51, DemImmediateNvStorage=false, DemDTCAttributesRef=DtcAttributes_41914fb7:
        DtcClass_DTC_0xd12c00: DemUdsDTC=13708288
        DtcClass_DTC_0x333000: DemUdsDTC=3354624
        DtcClass_DTC_0xd12c01: DemUdsDTC=13708289
        DtcClass_DTC_0xd12c08: DemUdsDTC=13708296
      11 x DemEventParameter, all with DemEventKind=DEM_EVENT_KIND_SWC, DemEventAvailable=true, DemEventAvailableInVariant=true, DemEventLatchTestFailed=false, DemEventCreateInfoPort=true, DemExtendedDataClassRef=ExtendedDataClass_4af7fffc, DemOBDFreezeFrameClassRef=FreezeFrame_51eb4bef:
        DTC_0x333000: DemEventId=49, DemDTCClassRef=DtcClass_DTC_0x333000
          DemEventClass:
            DemEventSignificance = DEM_EVENT_SIGNIFICANCE_FAULT
            DemAgingAllowed = false
            DemConsiderPtoStatus = false
            DemEventPriority = 2
            DemFFPrestorageSupported = false
            DemAgingCycleRef = PowerCycle
            DemOperationCycleRef = PowerCycle
            DemDebounceAlgorithmClass
              DemDebounceMonitorInternal
                DemCallbackGetFDC
        DTC_0xd12112: DemEventId=86, DemDTCClassRef=DtcClass_DTC_0xd12112
          DemEventClass:
            DemEventSignificance = DEM_EVENT_SIGNIFICANCE_FAULT
            DemAgingAllowed = false
            DemConsiderPtoStatus = false
            DemEventPriority = 2
            DemFFPrestorageSupported = false
            DemAgingCycleRef = PowerCycle
            DemOperationCycleRef = PowerCycle
            DemDebounceAlgorithmClass
              DemDebounceMonitorInternal
                DemCallbackGetFDC
        DTC_0xd12114: DemEventId=87, DemDTCClassRef=DtcClass_DTC_0xd12114
          DemEventClass:
            DemEventSignificance = DEM_EVENT_SIGNIFICANCE_FAULT
            DemAgingAllowed = false
            DemConsiderPtoStatus = false
            DemEventPriority = 2
            DemFFPrestorageSupported = false
            DemAgingCycleRef = PowerCycle
            DemOperationCycleRef = PowerCycle
            DemDebounceAlgorithmClass
              DemDebounceMonitorInternal
                DemCallbackGetFDC
        DTC_0xd12115: DemEventId=88, DemDTCClassRef=DtcClass_DTC_0xd12115
          DemEventClass:
            DemEventSignificance = DEM_EVENT_SIGNIFICANCE_FAULT
            DemAgingAllowed = false
            DemConsiderPtoStatus = false
            DemEventPriority = 2
            DemFFPrestorageSupported = false
            DemAgingCycleRef = PowerCycle
            DemOperationCycleRef = PowerCycle
            DemDebounceAlgorithmClass
              DemDebounceMonitorInternal
                DemCallbackGetFDC
        DTC_0xd12116: DemEventId=89, DemDTCClassRef=DtcClass_DTC_0xd12116
          DemEventClass:
            DemEventSignificance = DEM_EVENT_SIGNIFICANCE_FAULT
            DemAgingAllowed = false
            DemConsiderPtoStatus = false
            DemEventPriority = 2
            DemFFPrestorageSupported = false
            DemAgingCycleRef = PowerCycle
            DemOperationCycleRef = PowerCycle
            DemDebounceAlgorithmClass
              DemDebounceMonitorInternal
                DemCallbackGetFDC
        DTC_0xd12117: DemEventId=90, DemDTCClassRef=DtcClass_DTC_0xd12117
          DemEventClass:
            DemEventSignificance = DEM_EVENT_SIGNIFICANCE_FAULT
            DemAgingAllowed = false
            DemConsiderPtoStatus = false
            DemEventPriority = 2
            DemFFPrestorageSupported = false
            DemAgingCycleRef = PowerCycle
            DemOperationCycleRef = PowerCycle
            DemDebounceAlgorithmClass
              DemDebounceMonitorInternal
                DemCallbackGetFDC
        DTC_0xd12118: DemEventId=91, DemDTCClassRef=DtcClass_DTC_0xd12118
          DemEventClass:
            DemEventSignificance = DEM_EVENT_SIGNIFICANCE_FAULT
            DemAgingAllowed = false
            DemConsiderPtoStatus = false
            DemEventPriority = 2
            DemFFPrestorageSupported = false
            DemAgingCycleRef = PowerCycle
            DemOperationCycleRef = PowerCycle
            DemDebounceAlgorithmClass
              DemDebounceMonitorInternal
                DemCallbackGetFDC
        DTC_0xd12119: DemEventId=92, DemDTCClassRef=DtcClass_DTC_0xd12119
          DemEventClass:
            DemEventSignificance = DEM_EVENT_SIGNIFICANCE_FAULT
            DemAgingAllowed = false
            DemConsiderPtoStatus = false
            DemEventPriority = 2
            DemFFPrestorageSupported = false
            DemAgingCycleRef = PowerCycle
            DemOperationCycleRef = PowerCycle
            DemDebounceAlgorithmClass
              DemDebounceMonitorInternal
                DemCallbackGetFDC
        DTC_0xd01100: DemEventId=72, DemDTCClassRef=DtcClass_DTC_0xd01100
          DemEventClass:
            DemEventSignificance = DEM_EVENT_SIGNIFICANCE_FAULT
            DemAgingAllowed = false
            DemConsiderPtoStatus = false
            DemEventPriority = 2
            DemFFPrestorageSupported = false
            DemAgingCycleRef = PowerCycle
            DemOperationCycleRef = PowerCycle
            DemDebounceAlgorithmClass
              DemDebounceMonitorInternal
                DemCallbackGetFDC
        DTC_0xd12c00: DemEventId=51, DemDTCClassRef=DtcClass_DTC_0xd12c00
          DemEventClass:
            DemEventSignificance = DEM_EVENT_SIGNIFICANCE_FAULT
            DemAgingAllowed = false
            DemConsiderPtoStatus = false
            DemEventPriority = 2
            DemFFPrestorageSupported = false
            DemAgingCycleRef = PowerCycle
            DemOperationCycleRef = PowerCycle
            DemDebounceAlgorithmClass
              DemDebounceMonitorInternal
                DemCallbackGetFDC
        DTC_0xd12c01: DemEventId=52, DemDTCClassRef=DtcClass_DTC_0xd12c01
          DemEventClass:
            DemEventSignificance = DEM_EVENT_SIGNIFICANCE_FAULT
            DemAgingAllowed = false
            DemConsiderPtoStatus = false
            DemEventPriority = 2
            DemFFPrestorageSupported = false
            DemAgingCycleRef = PowerCycle
            DemOperationCycleRef = PowerCycle
            DemDebounceAlgorithmClass
              DemDebounceMonitorInternal
                DemCallbackGetFDC
      DtcClass_DTC_0xd12c14 (DemDTCClass): DemUdsDTC=13708308, DemFunctionalGroupIdentifier=51, DemImmediateNvStorage=false, DemDTCAttributesRef=DtcAttributes_41914fb7
      DtcClass_DTC_0xd12c18 (DemDTCClass): DemUdsDTC=13708312, DemFunctionalGroupIdentifier=51, DemImmediateNvStorage=false, DemDTCAttributesRef=DtcAttributes_41914fb7
      DTC_0xd12c08 (DemEventParameter):
        DemEventKind = DEM_EVENT_KIND_SWC
        DemEventAvailable = true
        DemEventId = 53
        DemEventAvailableInVariant = true
        DemEventLatchTestFailed = false
        DemEventCreateInfoPort = true
        DemDTCClassRef = DtcClass_DTC_0xd12c08
        DemExtendedDataClassRef = ExtendedDataClass_4af7fffc
        DemOBDFreezeFrameClassRef = FreezeFrame_51eb4bef
        DemEventClass:
          DemEventSignificance = DEM_EVENT_SIGNIFICANCE_FAULT
          DemAgingAllowed = false
          DemConsiderPtoStatus = false
          DemEventPriority = 2
          DemFFPrestorageSupported = false
          DemAgingCycleRef = PowerCycle
          DemOperationCycleRef = PowerCycle
          DemDebounceAlgorithmClass
            DemDebounceMonitorInternal
              DemCallbackGetFDC
      5 x DemDTCClass, all with DemFunctionalGroupIdentifier=51, DemImmediateNvStorage=false, DemDTCAttributesRef=DtcAttributes_41914fb7:
        DtcClass_DTC_0xd12c16: DemUdsDTC=13708310
        DtcClass_DTC_0xd12c17: DemUdsDTC=13708311
        DtcClass_DTC_0xd12c21: DemUdsDTC=13708321
        DtcClass_DTC_0xd01100: DemUdsDTC=13635840
        DtcClass_DTC_0xd12c20: DemUdsDTC=13708320
      DTC_0xd12c14 (DemEventParameter):
        DemEventKind = DEM_EVENT_KIND_SWC
        DemEventAvailable = true
        DemEventId = 54
        DemEventAvailableInVariant = true
        DemEventLatchTestFailed = false
        DemEventCreateInfoPort = true
        DemDTCClassRef = DtcClass_DTC_0xd12c14
        DemExtendedDataClassRef = ExtendedDataClass_4af7fffc
        DemOBDFreezeFrameClassRef = FreezeFrame_51eb4bef
        DemEventClass:
          DemEventSignificance = DEM_EVENT_SIGNIFICANCE_FAULT
          DemAgingAllowed = false
          DemConsiderPtoStatus = false
          DemEventPriority = 2
          DemFFPrestorageSupported = false
          DemAgingCycleRef = PowerCycle
          DemOperationCycleRef = PowerCycle
          DemDebounceAlgorithmClass
            DemDebounceMonitorInternal
              DemCallbackGetFDC
      DtcClass_DTC_0xd12c23 (DemDTCClass): DemUdsDTC=13708323, DemFunctionalGroupIdentifier=51, DemImmediateNvStorage=false, DemDTCAttributesRef=DtcAttributes_41914fb7
      5 x DemEventParameter, all with DemEventKind=DEM_EVENT_KIND_SWC, DemEventAvailable=true, DemEventAvailableInVariant=true, DemEventLatchTestFailed=false, DemEventCreateInfoPort=true, DemExtendedDataClassRef=ExtendedDataClass_4af7fffc, DemOBDFreezeFrameClassRef=FreezeFrame_51eb4bef:
        DTC_0xd12c17: DemEventId=56, DemDTCClassRef=DtcClass_DTC_0xd12c17
          DemEventClass:
            DemEventSignificance = DEM_EVENT_SIGNIFICANCE_FAULT
            DemAgingAllowed = false
            DemConsiderPtoStatus = false
            DemEventPriority = 2
            DemFFPrestorageSupported = false
            DemAgingCycleRef = PowerCycle
            DemOperationCycleRef = PowerCycle
            DemDebounceAlgorithmClass
              DemDebounceMonitorInternal
                DemCallbackGetFDC
        DTC_0xd12c16: DemEventId=55, DemDTCClassRef=DtcClass_DTC_0xd12c16
          DemEventClass:
            DemEventSignificance = DEM_EVENT_SIGNIFICANCE_FAULT
            DemAgingAllowed = false
            DemConsiderPtoStatus = false
            DemEventPriority = 2
            DemFFPrestorageSupported = false
            DemAgingCycleRef = PowerCycle
            DemOperationCycleRef = PowerCycle
            DemDebounceAlgorithmClass
              DemDebounceMonitorInternal
                DemCallbackGetFDC
        DTC_0xd12c18: DemEventId=57, DemDTCClassRef=DtcClass_DTC_0xd12c18
          DemEventClass:
            DemEventSignificance = DEM_EVENT_SIGNIFICANCE_FAULT
            DemAgingAllowed = false
            DemConsiderPtoStatus = false
            DemEventPriority = 2
            DemFFPrestorageSupported = false
            DemAgingCycleRef = PowerCycle
            DemOperationCycleRef = PowerCycle
            DemDebounceAlgorithmClass
              DemDebounceMonitorInternal
                DemCallbackGetFDC
        DTC_0xd40100: DemEventId=97, DemDTCClassRef=DtcClass_DTC_0xd40100
          DemEventClass:
            DemEventSignificance = DEM_EVENT_SIGNIFICANCE_FAULT
            DemAgingAllowed = false
            DemConsiderPtoStatus = false
            DemEventPriority = 2
            DemFFPrestorageSupported = false
            DemAgingCycleRef = PowerCycle
            DemOperationCycleRef = PowerCycle
            DemDebounceAlgorithmClass
              DemDebounceMonitorInternal
                DemCallbackGetFDC
        DTC_0x000080: DemEventId=21, DemDTCClassRef=DtcClass_DTC_0x000080
          DemEventClass:
            DemEventSignificance = DEM_EVENT_SIGNIFICANCE_FAULT
            DemAgingAllowed = false
            DemConsiderPtoStatus = false
            DemEventPriority = 2
            DemFFPrestorageSupported = false
            DemAgingCycleRef = PowerCycle
            DemOperationCycleRef = PowerCycle
            DemDebounceAlgorithmClass
              DemDebounceMonitorInternal
                DemCallbackGetFDC
      4 x DemDTCClass, all with DemFunctionalGroupIdentifier=51, DemImmediateNvStorage=false, DemDTCAttributesRef=DtcAttributes_41914fb7:
        DtcClass_DTC_0xd12101: DemUdsDTC=13705473
        DtcClass_DTC_0xd12102: DemUdsDTC=13705474
        DtcClass_DTC_0xc12490: DemUdsDTC=12657808
        DtcClass_DTC_0xd12103: DemUdsDTC=13705475
      6 x DemEventParameter, all with DemEventKind=DEM_EVENT_KIND_SWC, DemEventAvailable=true, DemEventAvailableInVariant=true, DemEventLatchTestFailed=false, DemEventCreateInfoPort=true, DemExtendedDataClassRef=ExtendedDataClass_4af7fffc, DemOBDFreezeFrameClassRef=FreezeFrame_51eb4bef:
        DTC_0xd12025: DemEventId=81, DemMaxNumberFreezeFrameRecords=1, DemDTCClassRef=DtcClass_DTC_0xd12025, DemFreezeFrameClassRef=FreezeFrame_51eb4bef
          DemEventClass:
            DemEventSignificance = DEM_EVENT_SIGNIFICANCE_FAULT
            DemAgingAllowed = false
            DemConsiderPtoStatus = false
            DemEventPriority = 2
            DemFFPrestorageSupported = false
            DemAgingCycleRef = PowerCycle
            DemOperationCycleRef = PowerCycle
            DemDebounceAlgorithmClass
              DemDebounceMonitorInternal
                DemCallbackGetFDC
        DTC_0xd12026: DemEventId=82, DemMaxNumberFreezeFrameRecords=1, DemDTCClassRef=DtcClass_DTC_0xd12026, DemFreezeFrameClassRef=FreezeFrame_51eb4bef
          DemEventClass:
            DemEventSignificance = DEM_EVENT_SIGNIFICANCE_FAULT
            DemAgingAllowed = false
            DemConsiderPtoStatus = false
            DemEventPriority = 2
            DemFFPrestorageSupported = false
            DemAgingCycleRef = PowerCycle
            DemOperationCycleRef = PowerCycle
            DemDebounceAlgorithmClass
              DemDebounceMonitorInternal
                DemCallbackGetFDC
        DTC_0x120022: DemEventId=42, DemDTCClassRef=DtcClass_DTC_0x120022
          DemEventClass:
            DemEventSignificance = DEM_EVENT_SIGNIFICANCE_FAULT
            DemAgingAllowed = false
            DemConsiderPtoStatus = false
            DemEventPriority = 2
            DemFFPrestorageSupported = false
            DemAgingCycleRef = PowerCycle
            DemOperationCycleRef = PowerCycle
            DemDebounceAlgorithmClass
              DemDebounceMonitorInternal
                DemCallbackGetFDC
        DTC_0x120020: DemEventId=41, DemDTCClassRef=DtcClass_DTC_0x120020
          DemEventClass:
            DemEventSignificance = DEM_EVENT_SIGNIFICANCE_FAULT
            DemAgingAllowed = false
            DemConsiderPtoStatus = false
            DemEventPriority = 2
            DemFFPrestorageSupported = false
            DemAgingCycleRef = PowerCycle
            DemOperationCycleRef = PowerCycle
            DemDebounceAlgorithmClass
              DemDebounceMonitorInternal
                DemCallbackGetFDC
        DTC_0x170400: DemEventId=43, DemDTCClassRef=DtcClass_DTC_0x170400
          DemEventClass:
            DemEventSignificance = DEM_EVENT_SIGNIFICANCE_FAULT
            DemAgingAllowed = false
            DemConsiderPtoStatus = false
            DemEventPriority = 2
            DemFFPrestorageSupported = false
            DemAgingCycleRef = PowerCycle
            DemOperationCycleRef = PowerCycle
            DemDebounceAlgorithmClass
              DemDebounceMonitorInternal
                DemCallbackGetFDC
        DTC_0xd12159: DemEventId=93, DemDTCClassRef=DtcClass_DTC_0xd12159
          DemEventClass:
            DemEventSignificance = DEM_EVENT_SIGNIFICANCE_FAULT
            DemAgingAllowed = false
            DemConsiderPtoStatus = false
            DemEventPriority = 2
            DemFFPrestorageSupported = false
            DemAgingCycleRef = PowerCycle
            DemOperationCycleRef = PowerCycle
            DemDebounceAlgorithmClass
              DemDebounceMonitorInternal
                DemCallbackGetFDC
      9 x DemDTCClass, all with DemFunctionalGroupIdentifier=51, DemImmediateNvStorage=false, DemDTCAttributesRef=DtcAttributes_41914fb7:
        DtcClass_DTC_0x100203: DemUdsDTC=1049091
        DtcClass_DTC_0xe40004: DemUdsDTC=14942212
        DtcClass_DTC_0x00a00a: DemUdsDTC=40970
        DtcClass_DTC_0xe40005: DemUdsDTC=14942213
        DtcClass_DTC_0xe40006: DemUdsDTC=14942214
        DtcClass_DTC_0xe40007: DemUdsDTC=14942215
        DtcClass_DTC_0x00a00b: DemUdsDTC=40971
        DtcClass_DTC_0xe40008: DemUdsDTC=14942216
        DtcClass_DTC_0xe40009: DemUdsDTC=14942217
      6 x DemEventParameter, all with DemEventKind=DEM_EVENT_KIND_SWC, DemEventAvailable=true, DemEventAvailableInVariant=true, DemEventLatchTestFailed=false, DemEventCreateInfoPort=true, DemExtendedDataClassRef=ExtendedDataClass_4af7fffc, DemOBDFreezeFrameClassRef=FreezeFrame_51eb4bef:
        DTC_0x00a009: DemEventId=4, DemDTCClassRef=DtcClass_DTC_0x00a009
          DemEventClass:
            DemEventSignificance = DEM_EVENT_SIGNIFICANCE_FAULT
            DemAgingAllowed = false
            DemConsiderPtoStatus = false
            DemEventPriority = 2
            DemFFPrestorageSupported = false
            DemAgingCycleRef = PowerCycle
            DemOperationCycleRef = PowerCycle
            DemDebounceAlgorithmClass
              DemDebounceMonitorInternal
                DemCallbackGetFDC
        DTC_0xd1210b: DemEventId=64, DemDTCClassRef=DtcClass_DTC_0xd1210b
          DemEventClass:
            DemEventSignificance = DEM_EVENT_SIGNIFICANCE_FAULT
            DemAgingAllowed = false
            DemConsiderPtoStatus = false
            DemEventPriority = 2
            DemFFPrestorageSupported = false
            DemAgingCycleRef = PowerCycle
            DemOperationCycleRef = PowerCycle
            DemDebounceAlgorithmClass
              DemDebounceMonitorInternal
                DemCallbackGetFDC
        DTC_0xd1210c: DemEventId=65, DemDTCClassRef=DtcClass_DTC_0xd1210c
          DemEventClass:
            DemEventSignificance = DEM_EVENT_SIGNIFICANCE_FAULT
            DemAgingAllowed = false
            DemConsiderPtoStatus = false
            DemEventPriority = 2
            DemFFPrestorageSupported = false
            DemAgingCycleRef = PowerCycle
            DemOperationCycleRef = PowerCycle
            DemDebounceAlgorithmClass
              DemDebounceMonitorInternal
                DemCallbackGetFDC
        DTC_0xd1210d: DemEventId=66, DemDTCClassRef=DtcClass_DTC_0xd1210d
          DemEventClass:
            DemEventSignificance = DEM_EVENT_SIGNIFICANCE_FAULT
            DemAgingAllowed = false
            DemConsiderPtoStatus = false
            DemEventPriority = 2
            DemFFPrestorageSupported = false
            DemAgingCycleRef = PowerCycle
            DemOperationCycleRef = PowerCycle
            DemDebounceAlgorithmClass
              DemDebounceMonitorInternal
                DemCallbackGetFDC
        DTC_0xd1210e: DemEventId=67, DemDTCClassRef=DtcClass_DTC_0xd1210e
          DemEventClass:
            DemEventSignificance = DEM_EVENT_SIGNIFICANCE_FAULT
            DemAgingAllowed = false
            DemConsiderPtoStatus = false
            DemEventPriority = 2
            DemFFPrestorageSupported = false
            DemAgingCycleRef = PowerCycle
            DemOperationCycleRef = PowerCycle
            DemDebounceAlgorithmClass
              DemDebounceMonitorInternal
                DemCallbackGetFDC
        DTC_0xd1210f: DemEventId=68, DemDTCClassRef=DtcClass_DTC_0xd1210f
          DemEventClass:
            DemEventSignificance = DEM_EVENT_SIGNIFICANCE_FAULT
            DemAgingAllowed = false
            DemConsiderPtoStatus = false
            DemEventPriority = 2
            DemFFPrestorageSupported = false
            DemAgingCycleRef = PowerCycle
            DemOperationCycleRef = PowerCycle
            DemDebounceAlgorithmClass
              DemDebounceMonitorInternal
                DemCallbackGetFDC
      DtcClass_DTC_0xd40200 (DemDTCClass): DemUdsDTC=13894144, DemFunctionalGroupIdentifier=51, DemImmediateNvStorage=false, DemDTCAttributesRef=DtcAttributes_41914fb7
      4 x DemEventParameter, all with DemEventKind=DEM_EVENT_KIND_SWC, DemEventAvailable=true, DemEventAvailableInVariant=true, DemEventLatchTestFailed=false, DemEventCreateInfoPort=true, DemExtendedDataClassRef=ExtendedDataClass_4af7fffc, DemOBDFreezeFrameClassRef=FreezeFrame_51eb4bef, DemFreezeFrameClassRef=FreezeFrame_51eb4bef:
        DTC_0xd12000: DemEventId=76, DemMaxNumberFreezeFrameRecords=1, DemDTCClassRef=DtcClass_DTC_0xd12000
          DemEventClass:
            DemEventSignificance = DEM_EVENT_SIGNIFICANCE_FAULT
            DemAgingAllowed = false
            DemConsiderPtoStatus = false
            DemEventPriority = 2
            DemFFPrestorageSupported = false
            DemAgingCycleRef = PowerCycle
            DemOperationCycleRef = PowerCycle
            DemDebounceAlgorithmClass
              DemDebounceMonitorInternal
                DemCallbackGetFDC
        DTC_0xd12001: DemEventId=77, DemMaxNumberFreezeFrameRecords=1, DemDTCClassRef=DtcClass_DTC_0xd12001
          DemEventClass:
            DemEventSignificance = DEM_EVENT_SIGNIFICANCE_FAULT
            DemAgingAllowed = false
            DemConsiderPtoStatus = false
            DemEventPriority = 2
            DemFFPrestorageSupported = false
            DemAgingCycleRef = PowerCycle
            DemOperationCycleRef = PowerCycle
            DemDebounceAlgorithmClass
              DemDebounceMonitorInternal
                DemCallbackGetFDC
        DTC_0xd12002: DemEventId=78, DemMaxNumberFreezeFrameRecords=2, DemDTCClassRef=DtcClass_DTC_0xd12002
          DemEventClass:
            DemEventSignificance = DEM_EVENT_SIGNIFICANCE_FAULT
            DemAgingAllowed = false
            DemConsiderPtoStatus = false
            DemEventPriority = 2
            DemFFPrestorageSupported = false
            DemAgingCycleRef = PowerCycle
            DemOperationCycleRef = PowerCycle
            DemDebounceAlgorithmClass
              DemDebounceMonitorInternal
                DemCallbackGetFDC
        DTC_0xd12004: DemEventId=79, DemMaxNumberFreezeFrameRecords=1, DemDTCClassRef=DtcClass_DTC_0xd12004
          DemEventClass:
            DemEventSignificance = DEM_EVENT_SIGNIFICANCE_FAULT
            DemAgingAllowed = false
            DemConsiderPtoStatus = false
            DemEventPriority = 2
            DemFFPrestorageSupported = false
            DemAgingCycleRef = PowerCycle
            DemOperationCycleRef = PowerCycle
            DemDebounceAlgorithmClass
              DemDebounceMonitorInternal
                DemCallbackGetFDC
      4 x DemDTCClass, all with DemFunctionalGroupIdentifier=51, DemImmediateNvStorage=false, DemDTCAttributesRef=DtcAttributes_41914fb7:
        DtcClass_DTC_0xe40010: DemUdsDTC=14942224
        DtcClass_DTC_0xe40011: DemUdsDTC=14942225
        DtcClass_DTC_0xe40012: DemUdsDTC=14942226
        DtcClass_DTC_0xe40013: DemUdsDTC=14942227
      10 x DemEventParameter, all with DemEventKind=DEM_EVENT_KIND_SWC, DemEventAvailable=true, DemEventAvailableInVariant=true, DemEventLatchTestFailed=false, DemEventCreateInfoPort=true, DemExtendedDataClassRef=ExtendedDataClass_4af7fffc, DemOBDFreezeFrameClassRef=FreezeFrame_51eb4bef:
        DTC_0xe40004: DemEventId=103, DemDTCClassRef=DtcClass_DTC_0xe40004
          DemEventClass:
            DemEventSignificance = DEM_EVENT_SIGNIFICANCE_FAULT
            DemAgingAllowed = false
            DemConsiderPtoStatus = false
            DemEventPriority = 2
            DemFFPrestorageSupported = false
            DemAgingCycleRef = PowerCycle
            DemOperationCycleRef = PowerCycle
            DemDebounceAlgorithmClass
              DemDebounceMonitorInternal
                DemCallbackGetFDC
        DTC_0x00a00a: DemEventId=2, DemDTCClassRef=DtcClass_DTC_0x00a00a
          DemEventClass:
            DemEventSignificance = DEM_EVENT_SIGNIFICANCE_FAULT
            DemAgingAllowed = true
            DemConsiderPtoStatus = false
            DemEventPriority = 2
            DemFFPrestorageSupported = false
            DemAgingCycleCounterThreshold = 3
            DemAgingCycleRef = RT_Test_OpCycle
            DemOperationCycleRef = PowerCycle
            DemDebounceAlgorithmClass
              DemDebounceCounterBased:
                DemDebounceBehavior = DEM_DEBOUNCE_FREEZE
                DemDebounceCounterDecrementStepSize = 1
                DemDebounceCounterFailedThreshold = 5
                DemDebounceCounterIncrementStepSize = 1
                DemDebounceCounterJumpDown = true
                DemDebounceCounterJumpDownValue = 0
                DemDebounceCounterJumpUp = true
                DemDebounceCounterJumpUpValue = 0
                DemDebounceCounterPassedThreshold = -5
                DemDebounceCounterStorage = true
                DemDebounceContinuous = false
        DTC_0xe40005: DemEventId=104, DemDTCClassRef=DtcClass_DTC_0xe40005
          DemEventClass:
            DemEventSignificance = DEM_EVENT_SIGNIFICANCE_FAULT
            DemAgingAllowed = false
            DemConsiderPtoStatus = false
            DemEventPriority = 2
            DemFFPrestorageSupported = false
            DemAgingCycleRef = PowerCycle
            DemOperationCycleRef = PowerCycle
            DemDebounceAlgorithmClass
              DemDebounceMonitorInternal
                DemCallbackGetFDC
        DTC_0xe40002: DemEventId=101, DemMaxNumberFreezeFrameRecords=2, DemDTCClassRef=DtcClass_DTC_0xe40002, DemFreezeFrameClassRef=RT_Vishnu_FreezeFrameClass
          DemEventClass:
            DemEventSignificance = DEM_EVENT_SIGNIFICANCE_FAULT
            DemAgingAllowed = false
            DemConsiderPtoStatus = false
            DemEventPriority = 2
            DemFFPrestorageSupported = false
            DemAgingCycleRef = PowerCycle
            DemOperationCycleRef = PowerCycle
            DemDebounceAlgorithmClass
              DemDebounceMonitorInternal
                DemCallbackGetFDC
        DTC_0xe40003: DemEventId=102, DemDTCClassRef=DtcClass_DTC_0xe40003
          DemEventClass:
            DemEventSignificance = DEM_EVENT_SIGNIFICANCE_FAULT
            DemAgingAllowed = false
            DemConsiderPtoStatus = false
            DemEventPriority = 2
            DemFFPrestorageSupported = false
            DemAgingCycleRef = PowerCycle
            DemOperationCycleRef = PowerCycle
            DemDebounceAlgorithmClass
              DemDebounceMonitorInternal
                DemCallbackGetFDC
        DTC_0xe40000: DemEventId=99, DemDTCClassRef=DtcClass_DTC_0xe40000
          DemEventClass:
            DemEventSignificance = DEM_EVENT_SIGNIFICANCE_FAULT
            DemAgingAllowed = false
            DemConsiderPtoStatus = false
            DemEventPriority = 2
            DemFFPrestorageSupported = false
            DemAgingCycleRef = PowerCycle
            DemOperationCycleRef = PowerCycle
            DemDebounceAlgorithmClass
              DemDebounceMonitorInternal
                DemCallbackGetFDC
        DTC_0xe40001: DemEventId=100, DemMaxNumberFreezeFrameRecords=2, DemDTCClassRef=DtcClass_DTC_0xe40001, DemFreezeFrameClassRef=RT_Vishnu_FreezeFrameClass
          DemEventClass:
            DemEventSignificance = DEM_EVENT_SIGNIFICANCE_FAULT
            DemAgingAllowed = false
            DemConsiderPtoStatus = false
            DemEventPriority = 2
            DemFFPrestorageSupported = false
            DemAgingCycleRef = PowerCycle
            DemOperationCycleRef = PowerCycle
            DemDebounceAlgorithmClass
              DemDebounceMonitorInternal
                DemCallbackGetFDC
        DTC_0x00a00b: DemEventId=3, DemMaxNumberFreezeFrameRecords=0, DemDTCClassRef=DtcClass_DTC_0x00a00b, DemFreezeFrameRecNumClassRef=DemFreezeFrameRecNumClass, DemFreezeFrameClassRef=FreezeFrame_51eb4bef
          DemEventClass:
            DemEventSignificance = DEM_EVENT_SIGNIFICANCE_FAULT
            DemAgingAllowed = true
            DemConsiderPtoStatus = false
            DemEventPriority = 2
            DemFFPrestorageSupported = false
            DemAgingCycleCounterThreshold = 3
            DemAgingCycleRef = RT_Test_OpCycle
            DemOperationCycleRef = PowerCycle
            DemDebounceAlgorithmClass
              DemDebounceTimeBase: DemDebounceBehavior=DEM_DEBOUNCE_FREEZE, DemDebounceTimeFailedThreshold=1, DemDebounceTimePassedThreshold=2, DemDebounceContinuous=false
        DTC_0xd1211d: DemEventId=69, DemDTCClassRef=DtcClass_DTC_0xd1211d
          DemEventClass:
            DemEventSignificance = DEM_EVENT_SIGNIFICANCE_FAULT
            DemAgingAllowed = false
            DemConsiderPtoStatus = false
            DemEventPriority = 2
            DemFFPrestorageSupported = false
            DemAgingCycleRef = PowerCycle
            DemOperationCycleRef = PowerCycle
            DemDebounceAlgorithmClass
              DemDebounceMonitorInternal
                DemCallbackGetFDC
        DTC_0xd12011: DemEventId=80, DemMaxNumberFreezeFrameRecords=1, DemDTCClassRef=DtcClass_DTC_0xd12011, DemFreezeFrameClassRef=FreezeFrame_51eb4bef
          DemEventClass:
            DemEventSignificance = DEM_EVENT_SIGNIFICANCE_FAULT
            DemAgingAllowed = false
            DemConsiderPtoStatus = false
            DemEventPriority = 2
            DemFFPrestorageSupported = false
            DemEventFailureCycleCounterThreshold = 2
            DemAgingCycleRef = RT_Test_OpCycle
            DemOperationCycleRef = RT_Test_OpCycle
            DemEventFailureCycleRef = RT_Test_OpCycle
            DemDebounceAlgorithmClass
              DemDebounceMonitorInternal
                DemCallbackGetFDC
      6 x DemDTCClass, all with DemFunctionalGroupIdentifier=51, DemImmediateNvStorage=false, DemDTCAttributesRef=DtcAttributes_41914fb7:
        DtcClass_DTC_0xe40000: DemUdsDTC=14942208
        DtcClass_DTC_0xe40001: DemUdsDTC=14942209
        DtcClass_DTC_0xe40002: DemUdsDTC=14942210
        DtcClass_DTC_0xe40003: DemUdsDTC=14942211
        DtcClass_DTC_0x100011: DemUdsDTC=1048593
        DtcClass_DTC_0x100012: DemUdsDTC=1048594
      DTC_0xe40013 (DemEventParameter):
        DemEventKind = DEM_EVENT_KIND_SWC
        DemEventAvailable = true
        DemEventId = 112
        DemEventAvailableInVariant = true
        DemEventLatchTestFailed = false
        DemEventCreateInfoPort = true
        DemDTCClassRef = DtcClass_DTC_0xe40013
        DemExtendedDataClassRef = ExtendedDataClass_4af7fffc
        DemOBDFreezeFrameClassRef = FreezeFrame_51eb4bef
        DemEventClass:
          DemEventSignificance = DEM_EVENT_SIGNIFICANCE_FAULT
          DemAgingAllowed = false
          DemConsiderPtoStatus = false
          DemEventPriority = 2
          DemFFPrestorageSupported = false
          DemAgingCycleRef = PowerCycle
          DemOperationCycleRef = PowerCycle
          DemDebounceAlgorithmClass
            DemDebounceMonitorInternal
              DemCallbackGetFDC
      DTC_0xd13b51 (DemEventParameter):
        DemEventKind = DEM_EVENT_KIND_SWC
        DemEventAvailable = true
        DemEventId = 63
        DemEventAvailableInVariant = true
        DemEventLatchTestFailed = false
        DemEventCreateInfoPort = true
        DemDTCClassRef = DtcClass_DTC_0xd13b51
        DemExtendedDataClassRef = ExtendedDataClass_4af7fffc
        DemOBDFreezeFrameClassRef = FreezeFrame_51eb4bef
        DemEventClass:
          DemEventSignificance = DEM_EVENT_SIGNIFICANCE_FAULT
          DemAgingAllowed = false
          DemConsiderPtoStatus = false
          DemEventPriority = 2
          DemFFPrestorageSupported = false
          DemAgingCycleRef = PowerCycle
          DemOperationCycleRef = PowerCycle
          DemDebounceAlgorithmClass
            DemDebounceMonitorInternal
              DemCallbackGetFDC
      DtcClass_DTC_0x100013 (DemDTCClass): DemUdsDTC=1048595, DemFunctionalGroupIdentifier=51, DemImmediateNvStorage=false, DemDTCAttributesRef=DtcAttributes_41914fb7
      DTC_0xd13b50 (DemEventParameter):
        DemEventKind = DEM_EVENT_KIND_SWC
        DemEventAvailable = true
        DemEventId = 62
        DemEventAvailableInVariant = true
        DemEventLatchTestFailed = false
        DemEventCreateInfoPort = true
        DemDTCClassRef = DtcClass_DTC_0xd13b50
        DemExtendedDataClassRef = ExtendedDataClass_4af7fffc
        DemOBDFreezeFrameClassRef = FreezeFrame_51eb4bef
        DemEventClass:
          DemEventSignificance = DEM_EVENT_SIGNIFICANCE_FAULT
          DemAgingAllowed = false
          DemConsiderPtoStatus = false
          DemEventPriority = 2
          DemFFPrestorageSupported = false
          DemAgingCycleRef = PowerCycle
          DemOperationCycleRef = PowerCycle
          DemDebounceAlgorithmClass
            DemDebounceMonitorInternal
              DemCallbackGetFDC
      DTC_0xe40011 (DemEventParameter):
        DemEventKind = DEM_EVENT_KIND_SWC
        DemEventAvailable = true
        DemEventId = 110
        DemEventAvailableInVariant = true
        DemEventLatchTestFailed = false
        DemEventCreateInfoPort = true
        DemDTCClassRef = DtcClass_DTC_0xe40011
        DemExtendedDataClassRef = ExtendedDataClass_4af7fffc
        DemOBDFreezeFrameClassRef = FreezeFrame_51eb4bef
        DemEventClass:
          DemEventSignificance = DEM_EVENT_SIGNIFICANCE_FAULT
          DemAgingAllowed = false
          DemConsiderPtoStatus = false
          DemEventPriority = 2
          DemFFPrestorageSupported = false
          DemAgingCycleRef = PowerCycle
          DemOperationCycleRef = PowerCycle
          DemDebounceAlgorithmClass
            DemDebounceMonitorInternal
              DemCallbackGetFDC
      DtcClass_DTC_0x120020 (DemDTCClass): DemUdsDTC=1179680, DemFunctionalGroupIdentifier=51, DemImmediateNvStorage=false, DemDTCAttributesRef=DtcAttributes_41914fb7
      DTC_0xe40012 (DemEventParameter):
        DemEventKind = DEM_EVENT_KIND_SWC
        DemEventAvailable = true
        DemEventId = 111
        DemEventAvailableInVariant = true
        DemEventLatchTestFailed = false
        DemEventCreateInfoPort = true
        DemDTCClassRef = DtcClass_DTC_0xe40012
        DemExtendedDataClassRef = ExtendedDataClass_4af7fffc
        DemOBDFreezeFrameClassRef = FreezeFrame_51eb4bef
        DemEventClass:
          DemEventSignificance = DEM_EVENT_SIGNIFICANCE_FAULT
          DemAgingAllowed = false
          DemConsiderPtoStatus = false
          DemEventPriority = 2
          DemFFPrestorageSupported = false
          DemAgingCycleRef = PowerCycle
          DemOperationCycleRef = PowerCycle
          DemDebounceAlgorithmClass
            DemDebounceMonitorInternal
              DemCallbackGetFDC
      DTC_0x100203 (DemEventParameter):
        DemEventKind = DEM_EVENT_KIND_SWC
        DemEventAvailable = true
        DemEventId = 40
        DemEventAvailableInVariant = true
        DemEventLatchTestFailed = false
        DemEventCreateInfoPort = true
        DemDTCClassRef = DtcClass_DTC_0x100203
        DemExtendedDataClassRef = ExtendedDataClass_4af7fffc
        DemOBDFreezeFrameClassRef = FreezeFrame_51eb4bef
        DemEventClass:
          DemEventSignificance = DEM_EVENT_SIGNIFICANCE_FAULT
          DemAgingAllowed = false
          DemConsiderPtoStatus = false
          DemEventPriority = 2
          DemFFPrestorageSupported = false
          DemAgingCycleRef = PowerCycle
          DemOperationCycleRef = PowerCycle
          DemDebounceAlgorithmClass
            DemDebounceMonitorInternal
              DemCallbackGetFDC
      DtcClass_DTC_0x120022 (DemDTCClass): DemUdsDTC=1179682, DemFunctionalGroupIdentifier=51, DemImmediateNvStorage=false, DemDTCAttributesRef=DtcAttributes_41914fb7
      DTC_0xe40010 (DemEventParameter):
        DemEventKind = DEM_EVENT_KIND_SWC
        DemEventAvailable = true
        DemEventId = 109
        DemEventAvailableInVariant = true
        DemEventLatchTestFailed = false
        DemEventCreateInfoPort = true
        DemDTCClassRef = DtcClass_DTC_0xe40010
        DemExtendedDataClassRef = ExtendedDataClass_4af7fffc
        DemOBDFreezeFrameClassRef = FreezeFrame_51eb4bef
        DemEventClass:
          DemEventSignificance = DEM_EVENT_SIGNIFICANCE_FAULT
          DemAgingAllowed = false
          DemConsiderPtoStatus = false
          DemEventPriority = 2
          DemFFPrestorageSupported = false
          DemAgingCycleRef = PowerCycle
          DemOperationCycleRef = PowerCycle
          DemDebounceAlgorithmClass
            DemDebounceMonitorInternal
              DemCallbackGetFDC
      DtcClass_DTC_0x100010 (DemDTCClass): DemUdsDTC=1048592, DemFunctionalGroupIdentifier=51, DemImmediateNvStorage=false, DemDTCAttributesRef=DtcAttributes_41914fb7
      DTC_0x12cb03 (DemEventParameter):
        DemEventKind = DEM_EVENT_KIND_SWC
        DemEventAvailable = true
        DemEventId = 8
        DemEventAvailableInVariant = true
        DemEventLatchTestFailed = false
        DemEventCreateInfoPort = true
        DemDTCClassRef = DtcClass_DTC_0x12cb03
        DemExtendedDataClassRef = ExtendedDataClass_4af7fffc
        DemOBDFreezeFrameClassRef = FreezeFrame_51eb4bef
        DemEventClass:
          DemEventSignificance = DEM_EVENT_SIGNIFICANCE_FAULT
          DemAgingAllowed = false
          DemConsiderPtoStatus = false
          DemEventPriority = 2
          DemFFPrestorageSupported = false
          DemAgingCycleRef = PowerCycle
          DemOperationCycleRef = PowerCycle
          DemDebounceAlgorithmClass
            DemDebounceMonitorInternal
              DemCallbackGetFDC
      DTC_0x12cb04 (DemEventParameter):
        DemEventKind = DEM_EVENT_KIND_SWC
        DemEventAvailable = true
        DemEventId = 9
        DemEventAvailableInVariant = true
        DemEventLatchTestFailed = false
        DemEventCreateInfoPort = true
        DemDTCClassRef = DtcClass_DTC_0x12cb04
        DemExtendedDataClassRef = ExtendedDataClass_4af7fffc
        DemOBDFreezeFrameClassRef = FreezeFrame_51eb4bef
        DemEventClass:
          DemEventSignificance = DEM_EVENT_SIGNIFICANCE_FAULT
          DemAgingAllowed = false
          DemConsiderPtoStatus = false
          DemEventPriority = 2
          DemFFPrestorageSupported = false
          DemAgingCycleRef = PowerCycle
          DemOperationCycleRef = PowerCycle
          DemDebounceAlgorithmClass
            DemDebounceMonitorInternal
              DemCallbackGetFDC
      DtcClass_DTC_0x10000a (DemDTCClass): DemUdsDTC=1048586, DemFunctionalGroupIdentifier=51, DemImmediateNvStorage=false, DemDTCAttributesRef=DtcAttributes_41914fb7
      DTC_0x12cb01 (DemEventParameter):
        DemEventKind = DEM_EVENT_KIND_SWC
        DemEventAvailable = true
        DemEventId = 6
        DemEventAvailableInVariant = true
        DemEventLatchTestFailed = false
        DemEventCreateInfoPort = true
        DemDTCClassRef = DtcClass_DTC_0x12cb01
        DemExtendedDataClassRef = ExtendedDataClass_4af7fffc
        DemOBDFreezeFrameClassRef = FreezeFrame_51eb4bef
        DemEventClass:
          DemEventSignificance = DEM_EVENT_SIGNIFICANCE_FAULT
          DemAgingAllowed = false
          DemConsiderPtoStatus = false
          DemEventPriority = 2
          DemFFPrestorageSupported = false
          DemAgingCycleRef = PowerCycle
          DemOperationCycleRef = PowerCycle
          DemDebounceAlgorithmClass
            DemDebounceMonitorInternal
              DemCallbackGetFDC
      DtcClass_DTC_0x10000b (DemDTCClass): DemUdsDTC=1048587, DemFunctionalGroupIdentifier=51, DemImmediateNvStorage=false, DemDTCAttributesRef=DtcAttributes_41914fb7
      DTC_0x12cb02 (DemEventParameter):
        DemEventKind = DEM_EVENT_KIND_SWC
        DemEventAvailable = true
        DemEventId = 7
        DemEventAvailableInVariant = true
        DemEventLatchTestFailed = false
        DemEventCreateInfoPort = true
        DemDTCClassRef = DtcClass_DTC_0x12cb02
        DemExtendedDataClassRef = ExtendedDataClass_4af7fffc
        DemOBDFreezeFrameClassRef = FreezeFrame_51eb4bef
        DemEventClass:
          DemEventSignificance = DEM_EVENT_SIGNIFICANCE_FAULT
          DemAgingAllowed = false
          DemConsiderPtoStatus = false
          DemEventPriority = 2
          DemFFPrestorageSupported = false
          DemAgingCycleRef = PowerCycle
          DemOperationCycleRef = PowerCycle
          DemDebounceAlgorithmClass
            DemDebounceMonitorInternal
              DemCallbackGetFDC
      DtcClass_DTC_0x170400 (DemDTCClass): DemUdsDTC=1508352, DemFunctionalGroupIdentifier=51, DemImmediateNvStorage=false, DemDTCAttributesRef=DtcAttributes_41914fb7
      4 x DemEventParameter, all with DemEventKind=DEM_EVENT_KIND_SWC, DemEventAvailable=true, DemEventAvailableInVariant=true, DemEventLatchTestFailed=false, DemEventCreateInfoPort=true, DemExtendedDataClassRef=ExtendedDataClass_4af7fffc, DemOBDFreezeFrameClassRef=FreezeFrame_51eb4bef:
        DTC_0xe40008: DemEventId=107, DemDTCClassRef=DtcClass_DTC_0xe40008
          DemEventClass:
            DemEventSignificance = DEM_EVENT_SIGNIFICANCE_FAULT
            DemAgingAllowed = false
            DemConsiderPtoStatus = false
            DemEventPriority = 2
            DemFFPrestorageSupported = false
            DemAgingCycleRef = PowerCycle
            DemOperationCycleRef = PowerCycle
            DemDebounceAlgorithmClass
              DemDebounceMonitorInternal
                DemCallbackGetFDC
        DTC_0xe40009: DemEventId=108, DemDTCClassRef=DtcClass_DTC_0xe40009
          DemEventClass:
            DemEventSignificance = DEM_EVENT_SIGNIFICANCE_FAULT
            DemAgingAllowed = false
            DemConsiderPtoStatus = false
            DemEventPriority = 2
            DemFFPrestorageSupported = false
            DemAgingCycleRef = PowerCycle
            DemOperationCycleRef = PowerCycle
            DemDebounceAlgorithmClass
              DemDebounceMonitorInternal
                DemCallbackGetFDC
        DTC_0xe40006: DemEventId=105, DemDTCClassRef=DtcClass_DTC_0xe40006
          DemEventClass:
            DemEventSignificance = DEM_EVENT_SIGNIFICANCE_FAULT
            DemAgingAllowed = false
            DemConsiderPtoStatus = false
            DemEventPriority = 2
            DemFFPrestorageSupported = false
            DemAgingCycleRef = PowerCycle
            DemOperationCycleRef = PowerCycle
            DemDebounceAlgorithmClass
              DemDebounceMonitorInternal
                DemCallbackGetFDC
        DTC_0xe40007: DemEventId=106, DemDTCClassRef=DtcClass_DTC_0xe40007
          DemEventClass:
            DemEventSignificance = DEM_EVENT_SIGNIFICANCE_FAULT
            DemAgingAllowed = false
            DemConsiderPtoStatus = false
            DemEventPriority = 2
            DemFFPrestorageSupported = false
            DemAgingCycleRef = PowerCycle
            DemOperationCycleRef = PowerCycle
            DemDebounceAlgorithmClass
              DemDebounceMonitorInternal
                DemCallbackGetFDC
      3 x DemDTCClass, all with DemFunctionalGroupIdentifier=51, DemImmediateNvStorage=false, DemDTCAttributesRef=DtcAttributes_41914fb7:
        DtcClass_DTC_0xd12159: DemUdsDTC=13705561
        DtcClass_DTC_0x100000: DemUdsDTC=1048576
        DtcClass_DTC_0x100002: DemUdsDTC=1048578
      DTC_0xd10301 (DemEventParameter):
        DemEventKind = DEM_EVENT_KIND_SWC
        DemEventAvailable = true
        DemEventId = 75
        DemEventAvailableInVariant = true
        DemEventLatchTestFailed = false
        DemEventCreateInfoPort = true
        DemDTCClassRef = DtcClass_DTC_0xd10301
        DemExtendedDataClassRef = ExtendedDataClass_4af7fffc
        DemOBDFreezeFrameClassRef = FreezeFrame_51eb4bef
        DemEventClass:
          DemEventSignificance = DEM_EVENT_SIGNIFICANCE_FAULT
          DemAgingAllowed = false
          DemConsiderPtoStatus = false
          DemEventPriority = 2
          DemFFPrestorageSupported = false
          DemAgingCycleRef = PowerCycle
          DemOperationCycleRef = PowerCycle
          DemDebounceAlgorithmClass
            DemDebounceMonitorInternal
              DemCallbackGetFDC
      DtcClass_DTC_0x100003 (DemDTCClass): DemUdsDTC=1048579, DemFunctionalGroupIdentifier=51, DemImmediateNvStorage=false, DemDTCAttributesRef=DtcAttributes_41914fb7
      DTC_0xd10300 (DemEventParameter):
        DemEventKind = DEM_EVENT_KIND_SWC
        DemEventAvailable = true
        DemEventId = 74
        DemEventAvailableInVariant = true
        DemEventLatchTestFailed = false
        DemEventCreateInfoPort = true
        DemDTCClassRef = DtcClass_DTC_0xd10300
        DemExtendedDataClassRef = ExtendedDataClass_4af7fffc
        DemOBDFreezeFrameClassRef = FreezeFrame_51eb4bef
        DemEventClass:
          DemEventSignificance = DEM_EVENT_SIGNIFICANCE_FAULT
          DemAgingAllowed = false
          DemConsiderPtoStatus = false
          DemEventPriority = 2
          DemFFPrestorageSupported = false
          DemAgingCycleRef = PowerCycle
          DemOperationCycleRef = PowerCycle
          DemDebounceAlgorithmClass
            DemDebounceMonitorInternal
              DemCallbackGetFDC
      6 x DemDTCClass, all with DemFunctionalGroupIdentifier=51, DemImmediateNvStorage=false, DemDTCAttributesRef=DtcAttributes_41914fb7:
        DtcClass_DTC_0x00a009: DemUdsDTC=40969
        DtcClass_DTC_0xd1311d: DemUdsDTC=13709597
        DtcClass_DTC_0xd1311f: DemUdsDTC=13709599
        DtcClass_DTC_0xd12160: DemUdsDTC=13705568
        DtcClass_DTC_0xd12161: DemUdsDTC=13705569
        DtcClass_DTC_0x100009: DemUdsDTC=1048585
      DTC_0x170600 (DemEventParameter):
        DemEventKind = DEM_EVENT_KIND_SWC
        DemEventAvailable = true
        DemEventId = 45
        DemEventAvailableInVariant = true
        DemEventLatchTestFailed = false
        DemEventCreateInfoPort = true
        DemDTCClassRef = DtcClass_DTC_0x170600
        DemExtendedDataClassRef = ExtendedDataClass_4af7fffc
        DemOBDFreezeFrameClassRef = FreezeFrame_51eb4bef
        DemEventClass:
          DemEventSignificance = DEM_EVENT_SIGNIFICANCE_FAULT
          DemAgingAllowed = false
          DemConsiderPtoStatus = false
          DemEventPriority = 2
          DemFFPrestorageSupported = false
          DemAgingCycleRef = PowerCycle
          DemOperationCycleRef = PowerCycle
          DemDebounceAlgorithmClass
            DemDebounceMonitorInternal
              DemCallbackGetFDC
      DtcClass_DTC_0xd10300 (DemDTCClass): DemUdsDTC=13697792, DemFunctionalGroupIdentifier=51, DemImmediateNvStorage=false, DemDTCAttributesRef=DtcAttributes_41914fb7
      DtcClass_DTC_0xd10301 (DemDTCClass): DemUdsDTC=13697793, DemFunctionalGroupIdentifier=51, DemImmediateNvStorage=false, DemDTCAttributesRef=DtcAttributes_41914fb7
      4 x DemEventParameter, all with DemEventKind=DEM_EVENT_KIND_SWC, DemEventAvailable=true, DemEventAvailableInVariant=true, DemEventLatchTestFailed=false, DemEventCreateInfoPort=true, DemExtendedDataClassRef=ExtendedDataClass_4af7fffc, DemOBDFreezeFrameClassRef=FreezeFrame_51eb4bef:
        DTC_0x000016: DemEventId=19, DemDTCClassRef=DtcClass_DTC_0x000016
          DemEventClass:
            DemEventSignificance = DEM_EVENT_SIGNIFICANCE_FAULT
            DemAgingAllowed = false
            DemConsiderPtoStatus = false
            DemEventPriority = 2
            DemFFPrestorageSupported = false
            DemAgingCycleRef = PowerCycle
            DemOperationCycleRef = PowerCycle
            DemDebounceAlgorithmClass
              DemDebounceMonitorInternal
                DemCallbackGetFDC
        DTC_0x000018: DemEventId=20, DemDTCClassRef=DtcClass_DTC_0x000018
          DemEventClass:
            DemEventSignificance = DEM_EVENT_SIGNIFICANCE_FAULT
            DemAgingAllowed = false
            DemConsiderPtoStatus = false
            DemEventPriority = 2
            DemFFPrestorageSupported = false
            DemAgingCycleRef = PowerCycle
            DemOperationCycleRef = PowerCycle
            DemDebounceAlgorithmClass
              DemDebounceMonitorInternal
                DemCallbackGetFDC
        DTC_0xd1311d: DemEventId=70, DemDTCClassRef=DtcClass_DTC_0xd1311d
          DemEventClass:
            DemEventSignificance = DEM_EVENT_SIGNIFICANCE_FAULT
            DemAgingAllowed = false
            DemConsiderPtoStatus = false
            DemEventPriority = 2
            DemFFPrestorageSupported = false
            DemAgingCycleRef = PowerCycle
            DemOperationCycleRef = PowerCycle
            DemDebounceAlgorithmClass
              DemDebounceMonitorInternal
                DemCallbackGetFDC
        DTC_0xd1311f: DemEventId=71, DemDTCClassRef=DtcClass_DTC_0xd1311f
          DemEventClass:
            DemEventSignificance = DEM_EVENT_SIGNIFICANCE_FAULT
            DemAgingAllowed = false
            DemConsiderPtoStatus = false
            DemEventPriority = 2
            DemFFPrestorageSupported = false
            DemAgingCycleRef = PowerCycle
            DemOperationCycleRef = PowerCycle
            DemDebounceAlgorithmClass
              DemDebounceMonitorInternal
                DemCallbackGetFDC
      3 x DemDTCClass, all with DemFunctionalGroupIdentifier=51, DemImmediateNvStorage=false, DemDTCAttributesRef=DtcAttributes_41914fb7:
        DtcClass_DTC_0x12cb01: DemUdsDTC=1231617
        DtcClass_DTC_0x12cb02: DemUdsDTC=1231618
        DtcClass_DTC_0x12cb03: DemUdsDTC=1231619
      DTC_0xd12160 (DemEventParameter):
        DemEventKind = DEM_EVENT_KIND_SWC
        DemEventAvailable = true
        DemEventId = 94
        DemEventAvailableInVariant = true
        DemEventLatchTestFailed = false
        DemEventCreateInfoPort = true
        DemDTCClassRef = DtcClass_DTC_0xd12160
        DemExtendedDataClassRef = ExtendedDataClass_4af7fffc
        DemOBDFreezeFrameClassRef = FreezeFrame_51eb4bef
        DemEventClass:
          DemEventSignificance = DEM_EVENT_SIGNIFICANCE_FAULT
          DemAgingAllowed = false
          DemConsiderPtoStatus = false
          DemEventPriority = 2
          DemFFPrestorageSupported = false
          DemAgingCycleRef = PowerCycle
          DemOperationCycleRef = PowerCycle
          DemDebounceAlgorithmClass
            DemDebounceMonitorInternal
              DemCallbackGetFDC
      DtcClass_DTC_0x12cb04 (DemDTCClass): DemUdsDTC=1231620, DemFunctionalGroupIdentifier=51, DemImmediateNvStorage=false, DemDTCAttributesRef=DtcAttributes_41914fb7
      DTC_0xd12161 (DemEventParameter):
        DemEventKind = DEM_EVENT_KIND_SWC
        DemEventAvailable = true
        DemEventId = 95
        DemEventAvailableInVariant = true
        DemEventLatchTestFailed = false
        DemEventCreateInfoPort = true
        DemDTCClassRef = DtcClass_DTC_0xd12161
        DemExtendedDataClassRef = ExtendedDataClass_4af7fffc
        DemOBDFreezeFrameClassRef = FreezeFrame_51eb4bef
        DemEventClass:
          DemEventSignificance = DEM_EVENT_SIGNIFICANCE_FAULT
          DemAgingAllowed = false
          DemConsiderPtoStatus = false
          DemEventPriority = 2
          DemFFPrestorageSupported = false
          DemAgingCycleRef = PowerCycle
          DemOperationCycleRef = PowerCycle
          DemDebounceAlgorithmClass
            DemDebounceMonitorInternal
              DemCallbackGetFDC
      DTC_0x170612 (DemEventParameter):
        DemEventKind = DEM_EVENT_KIND_SWC
        DemEventAvailable = true
        DemEventId = 48
        DemEventAvailableInVariant = true
        DemEventLatchTestFailed = false
        DemEventCreateInfoPort = true
        DemDTCClassRef = DtcClass_DTC_0x170612
        DemExtendedDataClassRef = ExtendedDataClass_4af7fffc
        DemOBDFreezeFrameClassRef = FreezeFrame_51eb4bef
        DemEventClass:
          DemEventSignificance = DEM_EVENT_SIGNIFICANCE_FAULT
          DemAgingAllowed = false
          DemConsiderPtoStatus = false
          DemEventPriority = 2
          DemFFPrestorageSupported = false
          DemAgingCycleRef = PowerCycle
          DemOperationCycleRef = PowerCycle
          DemDebounceAlgorithmClass
            DemDebounceMonitorInternal
              DemCallbackGetFDC
      DtcClass_DTC_0x170500 (DemDTCClass): DemUdsDTC=1508608, DemFunctionalGroupIdentifier=51, DemImmediateNvStorage=false, DemDTCAttributesRef=DtcAttributes_41914fb7
      DtcClass_DTC_0xd13026 (DemDTCClass): DemUdsDTC=13709350, DemFunctionalGroupIdentifier=51, DemImmediateNvStorage=false, DemDTCAttributesRef=DtcAttributes_41914fb7
      4 x DemEventParameter, all with DemEventKind=DEM_EVENT_KIND_SWC, DemEventAvailable=true, DemEventAvailableInVariant=true, DemEventLatchTestFailed=false, DemEventCreateInfoPort=true, DemExtendedDataClassRef=ExtendedDataClass_4af7fffc, DemOBDFreezeFrameClassRef=FreezeFrame_51eb4bef:
        DTC_0x000012: DemEventId=17, DemDTCClassRef=DtcClass_DTC_0x000012
          DemEventClass:
            DemEventSignificance = DEM_EVENT_SIGNIFICANCE_FAULT
            DemAgingAllowed = false
            DemConsiderPtoStatus = false
            DemEventPriority = 2
            DemFFPrestorageSupported = false
            DemAgingCycleRef = PowerCycle
            DemOperationCycleRef = PowerCycle
            DemDebounceAlgorithmClass
              DemDebounceMonitorInternal
                DemCallbackGetFDC
        DTC_0x170610: DemEventId=46, DemDTCClassRef=DtcClass_DTC_0x170610
          DemEventClass:
            DemEventSignificance = DEM_EVENT_SIGNIFICANCE_FAULT
            DemAgingAllowed = false
            DemConsiderPtoStatus = false
            DemEventPriority = 2
            DemFFPrestorageSupported = false
            DemAgingCycleRef = PowerCycle
            DemOperationCycleRef = PowerCycle
            DemDebounceAlgorithmClass
              DemDebounceMonitorInternal
                DemCallbackGetFDC
        DTC_0x000015: DemEventId=18, DemDTCClassRef=DtcClass_DTC_0x000015
          DemEventClass:
            DemEventSignificance = DEM_EVENT_SIGNIFICANCE_FAULT
            DemAgingAllowed = false
            DemConsiderPtoStatus = false
            DemEventPriority = 2
            DemFFPrestorageSupported = false
            DemAgingCycleRef = PowerCycle
            DemOperationCycleRef = PowerCycle
            DemDebounceAlgorithmClass
              DemDebounceMonitorInternal
                DemCallbackGetFDC
        DTC_0x170611: DemEventId=47, DemDTCClassRef=DtcClass_DTC_0x170611
          DemEventClass:
            DemEventSignificance = DEM_EVENT_SIGNIFICANCE_FAULT
            DemAgingAllowed = false
            DemConsiderPtoStatus = false
            DemEventPriority = 2
            DemFFPrestorageSupported = false
            DemAgingCycleRef = PowerCycle
            DemOperationCycleRef = PowerCycle
            DemDebounceAlgorithmClass
              DemDebounceMonitorInternal
                DemCallbackGetFDC
      5 x DemDTCClass, all with DemFunctionalGroupIdentifier=51, DemImmediateNvStorage=false, DemDTCAttributesRef=DtcAttributes_41914fb7:
        DtcClass_DTC_0x000018: DemUdsDTC=24
        DtcClass_DTC_0x000016: DemUdsDTC=22
        DtcClass_DTC_0xd13b51: DemUdsDTC=13712209
        DtcClass_DTC_0x000015: DemUdsDTC=21
        DtcClass_DTC_0xd13b50: DemUdsDTC=13712208
      DTC_0xd13026 (DemEventParameter):
        DemEventKind = DEM_EVENT_KIND_SWC
        DemEventAvailable = true
        DemEventId = 96
        DemEventAvailableInVariant = true
        DemEventLatchTestFailed = false
        DemEventCreateInfoPort = true
        DemDTCClassRef = DtcClass_DTC_0xd13026
        DemExtendedDataClassRef = ExtendedDataClass_4af7fffc
        DemOBDFreezeFrameClassRef = FreezeFrame_51eb4bef
        DemEventClass:
          DemEventSignificance = DEM_EVENT_SIGNIFICANCE_FAULT
          DemAgingAllowed = false
          DemConsiderPtoStatus = false
          DemEventPriority = 2
          DemFFPrestorageSupported = false
          DemAgingCycleRef = PowerCycle
          DemOperationCycleRef = PowerCycle
          DemDebounceAlgorithmClass
            DemDebounceMonitorInternal
              DemCallbackGetFDC
      DtcClass_DTC_0x000012 (DemDTCClass): DemUdsDTC=18, DemFunctionalGroupIdentifier=51, DemImmediateNvStorage=false, DemDTCAttributesRef=DtcAttributes_41914fb7
      DTC_0x170500 (DemEventParameter):
        DemEventKind = DEM_EVENT_KIND_SWC
        DemEventAvailable = true
        DemEventId = 44
        DemEventAvailableInVariant = true
        DemEventLatchTestFailed = false
        DemEventCreateInfoPort = true
        DemDTCClassRef = DtcClass_DTC_0x170500
        DemExtendedDataClassRef = ExtendedDataClass_4af7fffc
        DemOBDFreezeFrameClassRef = FreezeFrame_51eb4bef
        DemEventClass:
          DemEventSignificance = DEM_EVENT_SIGNIFICANCE_FAULT
          DemAgingAllowed = false
          DemConsiderPtoStatus = false
          DemEventPriority = 2
          DemFFPrestorageSupported = false
          DemAgingCycleRef = PowerCycle
          DemOperationCycleRef = PowerCycle
          DemDebounceAlgorithmClass
            DemDebounceMonitorInternal
              DemCallbackGetFDC
      DtcClass_DTC_0x184c00 (DemDTCClass): DemUdsDTC=1592320, DemFunctionalGroupIdentifier=51, DemImmediateNvStorage=false, DemDTCAttributesRef=DtcAttributes_41914fb7
      DtcClass_DTC_0x1d5af0 (DemDTCClass): DemUdsDTC=1923824, DemFunctionalGroupIdentifier=51, DemImmediateNvStorage=false, DemDTCAttributesRef=DtcAttributes_41914fb7
      DTC_0x184c00 (DemEventParameter):
        DemEventKind = DEM_EVENT_KIND_SWC
        DemEventAvailable = true
        DemEventId = 114
        DemEventAvailableInVariant = true
        DemEventLatchTestFailed = false
        DemEventCreateInfoPort = true
        DemDTCClassRef = DtcClass_DTC_0x184c00
        DemExtendedDataClassRef = ExtendedDataClass_4af7fffc
        DemOBDFreezeFrameClassRef = FreezeFrame_51eb4bef
        DemEventClass:
          DemEventSignificance = DEM_EVENT_SIGNIFICANCE_FAULT
          DemAgingAllowed = false
          DemConsiderPtoStatus = false
          DemEventPriority = 2
          DemFFPrestorageSupported = false
          DemAgingCycleRef = PowerCycle
          DemOperationCycleRef = PowerCycle
          DemDebounceAlgorithmClass
            DemDebounceMonitorInternal
              DemCallbackGetFDC
      DTC_0x1d5af0 (DemEventParameter):
        DemEventKind = DEM_EVENT_KIND_SWC
        DemEventAvailable = true
        DemEventId = 113
        DemEventAvailableInVariant = true
        DemEventLatchTestFailed = false
        DemEventCreateInfoPort = true
        DemDTCClassRef = DtcClass_DTC_0x1d5af0
        DemExtendedDataClassRef = ExtendedDataClass_4af7fffc
        DemOBDFreezeFrameClassRef = FreezeFrame_51eb4bef
        DemEventClass:
          DemEventSignificance = DEM_EVENT_SIGNIFICANCE_FAULT
          DemAgingAllowed = false
          DemConsiderPtoStatus = false
          DemEventPriority = 2
          DemFFPrestorageSupported = false
          DemAgingCycleRef = PowerCycle
          DemOperationCycleRef = PowerCycle
          DemDebounceAlgorithmClass
            DemDebounceMonitorInternal
              DemCallbackGetFDC
      DtcAttributes_41914fb7 (DemDTCAttributes): DemMemoryDestinationRef=PrimaryMemory
      Busoff_Event (DemEventParameter):
        DemEventAvailable = true
        DemEventId = 115
        DemEventKind = DEM_EVENT_KIND_BSW
        DemEventAvailableInVariant = true
        DemEventLatchTestFailed = false
        DemEventCreateInfoPort = true
        DemDTCClassRef = Busoff_DTCClass
        DemEventClass:
          DemAgingAllowed = false
          DemConsiderPtoStatus = false
          DemEventPriority = 2
          DemFFPrestorageSupported = false
          DemOperationCycleRef = PowerCycle
          DemAgingCycleRef = RT_Test_OpCycle
          DemDebounceAlgorithmClass
            DemDebounceCounterBased:
              DemDebounceBehavior = DEM_DEBOUNCE_FREEZE
              DemDebounceCounterDecrementStepSize = 1
              DemDebounceCounterFailedThreshold = 10
              DemDebounceCounterIncrementStepSize = 1
              DemDebounceCounterJumpDown = true
              DemDebounceCounterJumpDownValue = 0
              DemDebounceCounterJumpUp = true
              DemDebounceCounterJumpUpValue = 0
              DemDebounceCounterPassedThreshold = -128
              DemDebounceCounterStorage = false
              DemDebounceContinuous = false
      Busoff_DTCClass (DemDTCClass): DemImmediateNvStorage=false, DemUdsDTC=4385, DemDTCAttributesRef=DemDTCAttributesPrimary
    DemGeneral:
      DemAgingCycleCounterProcessing = DEM_PROCESS_AGINGCTR_INTERN
      DemPTOSupport = false
      DemTriggerDcmReports = true
      DemTypeOfDTCSupported = DEM_DTC_TRANSLATION_ISO14229_1
      DemSupportService19x1A = true
      DemSupportService19x56 = true
      DemDtcStatusAvailabilityMask = 255
      DemGeneralInterfaceSupport = false
      DemDataElementDefaultEndianness = LITTLE_ENDIAN
      DemAgingRequieresTestedCycle = false
      DemMaxNumberEventEntryMirror = 0
      DemTriggerMonitorInitBeforeClearOk = true
      DemExtendedDataCapture = DEM_TRIGGER_EVENT_MEMORY_STORAGE
      DemFreezeFrameCapture = DEM_TRIGGER_EVENT_MEMORY_STORAGE
      DemOperationCycleProcessing = DEM_PROCESS_OPCYC_STATE
      DemAvailabilitySupport = DEM_NO_AVAILABILITY
      DemAvailabilityStorage = false
      DemBswErrorBufferSize = 0
      DemClearDTCBehavior = DEM_CLRRESP_VOLATILE
      DemClearDTCLimitation = DEM_ALL_SUPPORTED_DTCS
      DemDebounceCounterBasedSupport = true
      DemDebounceTimeBasedSupport = true
      DemDevErrorDetect = true
      DemEnableConditionSupport = false
      DemEventCombinationSupport = DEM_EVCOMB_DISABLED
      DemEventDisplacementStrategy = DEM_DISPLACEMENT_LEGACY_403
      DemMaxNumberEventEntryOBDFreezeFrame = 0
      DemMaxNumberEventEntryPermanent = 0
      DemMaxNumberPrestoredFF = 0
      DemMaxNumberTimeSeriesSnapshots = 0
      DemOBDSupport = DEM_OBD_NO_OBD_SUPPORT
      DemOccurrenceCounterProcessing = DEM_PROCESS_OCCCTR_TF
      DemOperationCycleStatusStorage = false
      DemResetConfirmedBitOnOverflow = true
      DemStatusBitHandlingTestFailedSinceLastClear = DEM_STATUS_BIT_NORMAL
      DemStatusBitStorageTestFailed = true
      DemStorageConditionSupport = false
      DemSuppressionSupport = DEM_DTC_SUPPRESSION
      DemTaskTime = 0.01
      DemTriggerDltReports = false
      DemTriggerFiMReports = false
      DemTriggerFiMReportsExtended = false
      DemTriggerMonitorInitForEnableConditions = false
      DemVersionInfoApi = true
      DemBswApiVersion = DEM_BSW_API_4_XX_XX
      DemBswApiVersionNvM = DEM_BSW_API_4_XX_XX
      DemBswApiVersionFiM = DEM_BSW_API_4_XX_XX
      DemAgingAfterHealing = DEM_AGING_WHILE_HEALING
      DemAgingBehavior = DEM_AGING_TYPE_1
      DemAgingCounterBehavior = DEM_AGING_COUNT_ALWAYS
      DemAgingCounterReporting = DEM_AGING_NORMAL_REPORTING
      DemAgingRetainEnvironmentalData = false
      DemCompiledPostbuildCrc = 3390610262
      DemCompiledPostbuildCrcMode = DEM_POSTBUILD_CRC_AUTOMATIC
      DemEventDisplacementFallbackStrategy = DEM_FALLBACK_DISCARD_NEW_EVENT
      DemGeneralDiagnosticInfoSupport = true
      DemJ1939Support = false
      DemNvSynchronizeSupport = false
      DemPendingDtcProcessing = DEM_PROCESS_PDTC_STOREDONLY
      DemResetDebounceBehavior = DEM_RESET_DEBOUNCE_ON_DISABLE_ENABLE_CONDITIONS
      DemResetTestFailedOnOperationCycleStart = false
      DemRetryStorageSupport = false
      DemSafeBswChecks = false
      DemUseMemcopyMacros = false
      DemUseRte = true
      DemUserControlledWirBehavior = DEM_ENABLED_DURING_CONTROLDTCSETTING
      DemUserDefinedCompareAndSwap = false
      DemWarningIndicatorRequestedProcessing = DEM_PROCESS_WIR_STOREDONLY
      DemUseMultiPartitionFiM = false
      DemReportSuppressedDTCsInService19x0A = false
      DemSupportAgingForAllDTCs = false
      DemLatchTestFailedBehavior = DEM_LATCH_TF_CONFIRMED_AND_THIS_CYCLE
      DemSupportService19x04DIDLength = false
      DemClearEventsWithoutDTCEventMemoryRef = PrimaryMemory
      DemRestartCycleOnInitRef = PowerCycle
      11 x DemDataClass, all with DemDataElementStoreNonVolatile=true, DemDataElementUsePort=USE_DATA_CLIENT_SERVER_PORT, DemDataElementDataType=UINT8:
        DID_0xF404_Calculate_Load_Value: DemDataElementDataSize=1
        DID_0xF405_Engine_Coolent_temperature: DemDataElementDataSize=1
        DID_0xF40C_Engine_RPM: DemDataElementDataSize=2
        DID_0xF41F_Time_Since_Engin_Start: DemDataElementDataSize=2
        DID_0xF40D_Vehicle_Speed_Sensor: DemDataElementDataSize=1
        DID_0xF442_Controle_Module_Voltage: DemDataElementDataSize=2
        DID_0xF449_Accelerator_Pedal_Position_D: DemDataElementDataSize=1
        EDC_Standard_DTC_Information: DemDataElementDataSize=2
        EDC_Standard_Freeze_Frame: DemDataElementDataSize=10
        EDC_Monitor_Activity_numerator_Counts: DemDataElementDataSize=1
        EDC_Stored_Monitor_Activity_Ratio: DemDataElementDataSize=1
      DemPostbuild:
        DemEventAvailableDefaultSupport = true
        DemMaxSizeFreezeFrame = 10
        DemMaxNumberDtr = 0
        DemMaxSizeGlobalFreezeFrame = 0
        DemMaxSizeOBDonUDSFreezeFrame = 0
        DemMaxNumberEventsWithMonitorActivityData = 0
      DemEventMemorySet
        PrimaryMemory (DemPrimaryMemory):
          DemTypeOfFreezeFrameRecordNumeration = DEM_FF_RECNUM_CALCULATED
          DemMaxNumberEventEntryPrimary = 7
          DemEventMemoryEntryStorageTrigger = DEM_STORAGE_ON_TEST_FAILED
      PowerCycle (DemOperationCycle): DemOperationCycleType=DEM_OPCYC_POWER, DemOperationCycleAutomaticEnd=false, DemOperationCycleAutostart=false
      10 x DemNvRamBlockId:
        Dem_AdminData: DemNvRamBlockIdType=DEM_NVBLOCK_ADMIN, DemNvRamBlockIdRef=DemAdminDataBlock
        Dem_StatusData: DemNvRamBlockIdType=DEM_NVBLOCK_STATUS, DemNvRamBlockIdRef=DemStatusDataBlock
        Dem_PrimaryEntry{0..6}: DemNvRamBlockIdType=DEM_NVBLOCK_PRIMARY, DemNvRamBlockIdIndex={0..6}, DemNvRamBlockIdRef=DemPrimaryDataBlock{0..6}
        Dem_PrimaryEntry7: DemNvRamBlockIdType=DEM_NVBLOCK_DEBOUNCE, DemNvRamBlockIdRef=DemPrimaryDataBlock7
      DemDataElementClass_StartApplication (DemDataClass):
        DemDataElementDataSize = 2
        DemDataElementStoreNonVolatile = true
        DemDataElementUsePort = USE_DATA_CLIENT_SERVER_PORT
        DemDataElementDataType = UINT8_N
        DemDataElementEndianness = opaque
      DemDidClass_StartApplication (DemDidClass): DemDidIdentifier=85, DemDidDataClassRef=DemDataElementClass_StartApplication
      DemFreezeFrameClass_StartApplication (DemFreezeFrameClass): DemDidClassRef=DemDidClass_StartApplication
      DemClient_DCM (DemClient): DemClientId=0
      DemGeneralOBD:
        DemOBDPermanentForWWHOBD = true
        DemOBDCentralizedPID21Handling = false
        DemOBDCentralizedPID31Handling = false
        DemOBDDestinationOfEvents = DEM_DTC_ORIGIN_PRIMARY_MEMORY
        DemOBDEventDisplacement = true
        DemOBDCompliancy = 1
        DemDelayWarmUpCycleToDcyEnd = false
        DemOBDFreezeFrameInService19 = false
        DemOBDHideOccurrences = false
        DemOBDLegislation = DEM_OBD_LEGISLATION_OBDII
        DemOBDPermanentEraseConditionDcy = false
        DemOBDPermanentMandatoryPfcAfterClear = false
        DemOBDRestartDcyOnClearDTC = false
        DemClearPermanentDtcBehavior = DEM_CLR_PERM_DTC_TYPE_1
        DemOBDSimilarConditionsSupport = false
        DemOBDPID41ComprehensiveComponentsAlwaysComplete = false
        DemOBDSupportMajorMonitors = false
        DemReportBlinkingMilAsActive = true
        DemOBDPermanentChronologyMaxNumberEvents = 3
        DemOBDFuelSystemAlwaysComplete = false
        DemOBDCompressionMisfireAlwaysComplete = false
      DID_DiagnServi_TABROW_TimeSinceEnginStart_Read_0xf41f (DemDidClass): DemDidIdentifier=62495, DemDidDataClassRef=Data_PID_0x1f_Param_TimeSinceEnginStart
      FreezeFrame_51eb4bef (DemFreezeFrameClass):
        DemDidClassRef = DID_DiagnServi_TABROW_CalcuLOADValue_Read_0xf404
        DemDidClassRef = DID_DiagnServi_TABROW_EnginCoolaTempe_Read_0xf405
        DemDidClassRef = DID_DiagnServi_TABROW_EnginRPM_Read_0xf40c
        DemDidClassRef = DID_DiagnServi_TABROW_VehicSpeedSenso_Read_0xf40d
        DemDidClassRef = DID_DiagnServi_TABROW_TimeSinceEnginStart_Read_0xf41f
        DemDidClassRef = DID_DiagnServi_TABROW_ContrModulVolta_Read_0xf442
        DemDidClassRef = DID_DiagnServi_TABROW_AccelPedalPositD_Read_0xf449
      3 x DemDidClass:
        DID_DiagnServi_TABROW_CalcuLOADValue_Read_0xf404: DemDidIdentifier=62468, DemDidDataClassRef=Data_PID_0x4_Param_CalcuLOADValue
        DID_DiagnServi_TABROW_EnginCoolaTempe_Read_0xf405: DemDidIdentifier=62469, DemDidDataClassRef=Data_PID_0x5_Param_EnginCoolaTempe
        DID_DiagnServi_TABROW_ContrModulVolta_Read_0xf442: DemDidIdentifier=62530, DemDidDataClassRef=Data_PID_0x42_Param_ContrModulVolta
      3 x DemExtendedDataRecordClass:
        ExtendedDataRecord_SupplementalMonitorActivityData: DemExtendedDataRecordNumber=147, DemExtendedDataRecordUpdate=DEM_UPDATE_RECORD_NO, DemDataClassRef=Data_SupplementalMonitorActivityData_Param_MonitActivNumerCount, DemDataClassRef=Data_SupplementalMonitorActivityData_Param_StoreMonitActivRatio
        ExtendedDataRecord_StandardFreezeFrame1: DemExtendedDataRecordNumber=2, DemExtendedDataRecordUpdate=DEM_UPDATE_RECORD_NO, DemDataClassRef=Data_StandardFreezeFrame1_Param_AgingCount, DemDataClassRef=Data_StandardFreezeFrame1_Param_KmMilea_1, DemDataClassRef=Data_StandardFreezeFrame1_Param_Reser, DemDataClassRef=Data_StandardFreezeFrame1_Param_TimeStamp_STRUC_Bitfi
        ExtendedDataRecord_StandardDTCInformation: DemExtendedDataRecordNumber=1, DemExtendedDataRecordUpdate=DEM_UPDATE_RECORD_YES, DemDataClassRef=Data_StandardDTCInformation_Param_DTCPrior, DemDataClassRef=Data_StandardDTCInformation_Param_OccurCount
      3 x DemDidClass:
        DID_DiagnServi_TABROW_EnginRPM_Read_0xf40c: DemDidIdentifier=62476, DemDidDataClassRef=Data_PID_0xc_Param_EnginRPM
        DID_DiagnServi_TABROW_VehicSpeedSenso_Read_0xf40d: DemDidIdentifier=62477, DemDidDataClassRef=Data_PID_0xd_Param_VehicSpeedSenso
        DID_DiagnServi_TABROW_AccelPedalPositD_Read_0xf449: DemDidIdentifier=62537, DemDidDataClassRef=Data_PID_0x49_Param_AccelPedalPositD
      16 x DemDataClass, all with DemDataElementStoreNonVolatile=true:
        Data_StandardFreezeFrame1_Param_KmMilea_1: DemDataElementDataSize=3, DemDataElementDataType=UINT8_N, DemDataElementEndianness=opaque, DemDataElementUsePort=USE_DATA_CLIENT_SERVER_PORT
        Data_PID_0xd_Param_VehicSpeedSenso: DemDataElementDataSize=1, DemDataElementDataType=UINT8_N, DemDataElementEndianness=opaque, DemDataElementUsePort=USE_DATA_CLIENT_SERVER_PORT
        Data_PID_0x42_Param_ContrModulVolta: DemDataElementDataSize=2, DemDataElementDataType=UINT8_N, DemDataElementEndianness=opaque, DemDataElementUsePort=USE_DATA_CLIENT_SERVER_PORT
        Data_PID_0xc_Param_EnginRPM: DemDataElementDataSize=2, DemDataElementDataType=UINT8_N, DemDataElementEndianness=opaque, DemDataElementUsePort=USE_DATA_CLIENT_SERVER_PORT
        Data_PID_0x1f_Param_TimeSinceEnginStart: DemDataElementDataSize=2, DemDataElementDataType=UINT8_N, DemDataElementEndianness=opaque, DemDataElementUsePort=USE_DATA_CLIENT_SERVER_PORT
        Data_SupplementalMonitorActivityData_Param_StoreMonitActivRatio: DemDataElementDataSize=1, DemDataElementDataType=UINT8, DemDataElementUsePort=USE_DATA_CLIENT_SERVER_PORT
        Data_StandardFreezeFrame1_Param_Reser: DemDataElementDataSize=1, DemDataElementUsePort=USE_DATA_CLIENT_SERVER_PORT, DemDataElementDataType=UINT8
        Data_PID_0x49_Param_AccelPedalPositD: DemDataElementDataSize=1, DemDataElementDataType=UINT8_N, DemDataElementEndianness=opaque, DemDataElementUsePort=USE_DATA_CLIENT_SERVER_PORT
        Data_StandardDTCInformation_Param_OccurCount: DemDataElementDataSize=1, DemDataElementDataType=UINT8, DemDataElementUsePort=USE_DATA_INTERNAL, DemDataElementInternalData=DEM_OCCCTR
        Data_PID_0x4_Param_CalcuLOADValue: DemDataElementDataSize=1, DemDataElementDataType=UINT8_N, DemDataElementEndianness=opaque, DemDataElementUsePort=USE_DATA_CLIENT_SERVER_PORT
        Data_PID_0x5_Param_EnginCoolaTempe: DemDataElementDataSize=1, DemDataElementDataType=UINT8_N, DemDataElementEndianness=opaque, DemDataElementUsePort=USE_DATA_CLIENT_SERVER_PORT
        Data_StandardFreezeFrame1_Param_TimeStamp_STRUC_Bitfi: DemDataElementDataSize=5, DemDataElementDataType=UINT8_N, DemDataElementEndianness=opaque, DemDataElementUsePort=USE_DATA_CLIENT_SERVER_PORT
        Data_StandardFreezeFrame1_Param_AgingCount: DemDataElementDataSize=1, DemDataElementDataType=UINT8, DemDataElementUsePort=USE_DATA_CLIENT_SERVER_PORT, DemDataElementInternalData=DEM_AGINGCTR
        Data_StandardDTCInformation_Param_DTCPrior: DemDataElementDataSize=1, DemDataElementDataType=UINT8, DemDataElementUsePort=USE_DATA_CLIENT_SERVER_PORT
        Data_SupplementalMonitorActivityData_Param_MonitActivNumerCount: DemDataElementDataSize=1, DemDataElementDataType=UINT8, DemDataElementUsePort=USE_DATA_CLIENT_SERVER_PORT
        Data_Vishnu_ExtData_Param_VishnDOB: DemDataElementDataSize=1, DemDataElementDataType=UINT8, DemDataElementUsePort=USE_DATA_CLIENT_SERVER_PORT_WITH_EVENTID
      ExtendedDataRecord_Vishnu_ExtData (DemExtendedDataRecordClass):
        DemExtendedDataRecordNumber = 3
        DemExtendedDataRecordUpdate = DEM_UPDATE_RECORD_NO
        DemDataClassRef = Data_Vishnu_ExtData_Param_VishnDOB
        DemDataClassRef = Data_Vishnu_ExtData_Param_VishnRes
      ExtendedDataClass_4af7fffc (DemExtendedDataClass):
        DemExtendedDataRecordClassRef = ExtendedDataRecord_StandardDTCInformation
        DemExtendedDataRecordClassRef = ExtendedDataRecord_StandardFreezeFrame1
        DemExtendedDataRecordClassRef = ExtendedDataRecord_Vishnu_ExtData
        DemExtendedDataRecordClassRef = ExtendedDataRecord_SupplementalMonitorActivityData
      Data_Vishnu_ExtData_Param_VishnRes (DemDataClass): DemDataElementDataSize=1, DemDataElementDataType=UINT8, DemDataElementUsePort=USE_DATA_CLIENT_SERVER_PORT, DemDataElementStoreNonVolatile=true
      DemFreezeFrameRecNumClass: DemFreezeFrameRecordClassRef=FreezeFrameRecordClass
      FreezeFrameRecordClass (DemFreezeFrameRecordClass): DemFreezeFrameRecordNumber=1, DemFreezeFrameRecordTrigger=DEM_TRIGGER_ON_TEST_FAILED, DemFreezeFrameRecordUpdate=DEM_UPDATE_RECORD_NO
      RT_Test_OpCycle (DemOperationCycle): DemOperationCycleAutomaticEnd=false, DemOperationCycleAutostart=false, DemOperationCycleType=DEM_OPCYC_OTHER
      RT_Vishnu_Freezeframe_Test (DemFreezeFrameRecordClass): DemFreezeFrameRecordNumber=2, DemFreezeFrameRecordTrigger=DEM_TRIGGER_ON_TEST_FAILED, DemFreezeFrameRecordUpdate=DEM_UPDATE_RECORD_YES
      RT_Vishnu_FreezeFrameRecNumClasee (DemFreezeFrameRecNumClass): DemFreezeFrameRecordClassRef=RT_Vishnu_Freezeframe_Test
      RT_Vishnu_FreezeFrameClass (DemFreezeFrameClass): DemDidClassRef=DID_DiagnServi_TABROW_AccelPedalPositD_Read_0xf449, DemDidClassRef=DID_DiagnServi_TABROW_CalcuLOADValue_Read_0xf404
