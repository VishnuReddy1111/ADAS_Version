/**********************************************************************************************************************
* COPYRIGHT
* \verbatim
* This software is copyright protected and proprietary to Vector Informatik GmbH.
* Vector Informatik GmbH grants to you only those rights as set out in the license conditions.
* All other rights remain with Vector Informatik GmbH.
* \endverbatim
* LICENSE
* Module: Xcp
* Program: MSR_Vector_SLP4
* Customer: AUTOSAR 4 Evaluation Bundle for CANoe/VTT
* Expiry Date: 2023-03-31
* Ordered Derivat.: VTT
* License Scope : The usage is restricted to CBD1500710_D15
* FILE DESCRIPTION
* File: FrXcp_0.a2l
* Generation Time: 2022-11-21 10:57:58
* Project: Demo - Version 1.0
* Delivery: CBD1500710_D15
* Tool Version: DaVinci Configurator Classic (beta) 5.26.30 SP1
*********************************************************************************************************************/
/**********************************************************************************************************************
! BETA VERSION !
! This version of DaVinci Configurator Classic and/or the related Basic Software Package is BETA software. !
! BETA Software is basically operable, but not sufficiently tested, verified and/or qualified for use in series !
! production and/or in vehicles operating on public or non-public roads. !
! In particular, without limitation, BETA Software may cause unpredictable ECU behavior, may not provide all !
! functions necessary for use in series production and/or may not comply with quality requirements which are !
! necessary according to the state of the art. BETA Software must not be used in series production. !
**********************************************************************************************************************/
/begin XCP_ON_FLX 0x0101 /* XCP on Fr version */ 1000 "FlexRay" "0" 0 HEADER_NAX_CTR PACKET_ALIGNMENT_16
 /begin INITIAL_CMD_BUFFER 2 MAX_FLX_LEN_BUF FIXED 100
  /begin LPDU_ID FLX_SLOT_ID FIXED 100 OFFSET FIXED 0 CYCLE_REPETITION FIXED 2 CHANNEL FIXED A /end LPDU_ID
  /begin XCP_PACKET CMD FIXED RES_ERR NOT_ALLOWED EV_SERV NOT_ALLOWED DAQ NOT_ALLOWED STIM NOT_ALLOWED /end XCP_PACKET
 /end INITIAL_CMD_BUFFER
 /begin INITIAL_RES_ERR_BUFFER 1 MAX_FLX_LEN_BUF FIXED 100
  /begin LPDU_ID FLX_SLOT_ID FIXED 105 OFFSET FIXED 0 CYCLE_REPETITION FIXED 2 CHANNEL FIXED A /end LPDU_ID
  /begin XCP_PACKET CMD NOT_ALLOWED RES_ERR FIXED EV_SERV NOT_ALLOWED DAQ NOT_ALLOWED STIM NOT_ALLOWED /end XCP_PACKET
 /end INITIAL_RES_ERR_BUFFER
 /begin POOL_BUFFER 0 MAX_FLX_LEN_BUF FIXED 100
  /begin LPDU_ID FLX_SLOT_ID FIXED 106 OFFSET FIXED 0 CYCLE_REPETITION FIXED 2 CHANNEL FIXED A /end LPDU_ID
  /begin XCP_PACKET CMD NOT_ALLOWED RES_ERR NOT_ALLOWED EV_SERV NOT_ALLOWED DAQ FIXED STIM NOT_ALLOWED /end XCP_PACKET
 /end POOL_BUFFER
 /begin POOL_BUFFER 3 MAX_FLX_LEN_BUF FIXED 100
  /begin LPDU_ID FLX_SLOT_ID FIXED 101 OFFSET FIXED 0 CYCLE_REPETITION FIXED 2 CHANNEL FIXED A /end LPDU_ID
  /begin XCP_PACKET CMD NOT_ALLOWED RES_ERR NOT_ALLOWED EV_SERV NOT_ALLOWED DAQ NOT_ALLOWED STIM FIXED /end XCP_PACKET
 /end POOL_BUFFER
/end XCP_ON_FLX
