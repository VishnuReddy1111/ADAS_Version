ASAP2_VERSION 1 71
/begin PROJECT MICROSAR ""
/begin MODULE CPP ""
/begin MOD_COMMON "" BYTE_ORDER MSB_LAST ALIGNMENT_BYTE 1 ALIGNMENT_WORD 2 ALIGNMENT_LONG 4 ALIGNMENT_FLOAT16_IEEE 2 ALIGNMENT_FLOAT32_IEEE 4 ALIGNMENT_FLOAT64_IEEE 8 ALIGNMENT_INT64 8 /end MOD_COMMON
/begin MEASUREMENT Com_RxAccessInfo[76].RxSigBufferArrayBasedBufferStartIdxOfRxAccessInfo "" UBYTE Com_RxSigBufferArrayBasedBufferStartIdxOfRxAccessInfoType 0 0 0 255 ECU_ADDRESS 0x0 /end MEASUREMENT
/begin MEASUREMENT Com_RxAccessInfo[76].RxSigBufferArrayBasedShdBufferEndIdxOfRxAccessInfo "" UBYTE Com_RxSigBufferArrayBasedShdBufferEndIdxOfRxAccessInfoType 0 0 0 255 ECU_ADDRESS 0x0 /end MEASUREMENT
/begin MEASUREMENT Com_RxAccessInfo[76].RxSigBufferArrayBasedShdBufferStartIdxOfRxAccessInfo "" UBYTE Com_RxSigBufferArrayBasedShdBufferStartIdxOfRxAccessInfoType 0 0 0 255 ECU_ADDRESS 0x0 /end MEASUREMENT
/begin MEASUREMENT Com_RxAccessInfo[76].RxTOutInfoIdxOfRxAccessInfo "" UBYTE Com_RxTOutInfoIdxOfRxAccessInfoType 0 0 0 255 ECU_ADDRESS 0x0 /end MEASUREMENT
/begin MEASUREMENT Com_RxAccessInfo[76].ShdBufferIdxOfRxAccessInfo "" UWORD Com_ShdBufferIdxOfRxAccessInfoType 0 0 0 65535 ECU_ADDRESS 0x0 /end MEASUREMENT
/begin MEASUREMENT Com_RxAccessInfo[76].SignalLengthInByteOfRxAccessInfo "" UBYTE NO_COMPU_METHOD 0 0 0 255 ECU_ADDRESS 0x0 /end MEASUREMENT
/begin MEASUREMENT Com_RxAccessInfo[76].StartByteInPduPositionOfRxAccessInfo "" UBYTE NO_COMPU_METHOD 0 0 0 255 ECU_ADDRESS 0x0 /end MEASUREMENT
/begin MEASUREMENT Com_RxAccessInfo[76].TmpBufferIdxOfRxAccessInfo "" UBYTE Com_TmpBufferIdxOfRxAccessInfoType 0 0 0 255 ECU_ADDRESS 0x0 /end MEASUREMENT
/begin MEASUREMENT Com_RxAccessInfo[76].TmpBufferOfRxAccessInfo "" UBYTE Com_TmpBufferOfRxAccessInfoType 0 0 0 255 ECU_ADDRESS 0x0 /end MEASUREMENT
/begin MEASUREMENT Com_RxAccessInfo[76].TmpRxShdBufferArrayBasedTmpBufferEndIdxOfRxAccessInfo "" UBYTE Com_TmpRxShdBufferArrayBasedTmpBufferEndIdxOfRxAccessInfoType 0 0 0 255 ECU_ADDRESS 0x0 /end MEASUREMENT
/begin MEASUREMENT Com_RxAccessInfo[76].TmpRxShdBufferArrayBasedTmpBufferStartIdxOfRxAccessInfo "" UBYTE Com_TmpRxShdBufferArrayBasedTmpBufferStartIdxOfRxAccessInfoType 0 0 0 255 ECU_ADDRESS 0x0 /end MEASUREMENT
/begin MEASUREMENT Com_RxAccessInfo[77].ApplTypeOfRxAccessInfo "" UBYTE Com_ApplTypeOfRxAccessInfoType 0 0 0 255 ECU_ADDRESS 0x0 /end MEASUREMENT
/begin MEASUREMENT Com_RxAccessInfo[77].BitLengthOfRxAccessInfo "" UWORD NO_COMPU_METHOD 0 0 0 65535 ECU_ADDRESS 0x0 /end MEASUREMENT
/begin MEASUREMENT Com_RxAccessInfo[77].BitPositionOfRxAccessInfo "" UWORD NO_COMPU_METHOD 0 0 0 65535 ECU_ADDRESS 0x0 /end MEASUREMENT
/begin MEASUREMENT Com_RxAccessInfo[77].BufferIdxOfRxAccessInfo "" UWORD Com_BufferIdxOfRxAccessInfoType 0 0 0 65535 ECU_ADDRESS 0x0 /end MEASUREMENT
/begin MEASUREMENT Com_RxAccessInfo[77].BusAccOfRxAccessInfo "" UBYTE Com_BusAccOfRxAccessInfoType 0 0 0 255 ECU_ADDRESS 0x0 /end MEASUREMENT
/begin MEASUREMENT Com_RxAccessInfo[77].ByteLengthOfRxAccessInfo "" UBYTE NO_COMPU_METHOD 0 0 0 255 ECU_ADDRESS 0x0 /end MEASUREMENT
/begin MEASUREMENT Com_RxAccessInfo[77].ConstValueArrayBasedInitValueEndIdxOfRxAccessInfo "" UBYTE Com_ConstValueArrayBasedInitValueEndIdxOfRxAccessInfoType 0 0 0 255 ECU_ADDRESS 0x0 /end MEASUREMENT
/begin MEASUREMENT Com_RxAccessInfo[77].ConstValueArrayBasedInitValueStartIdxOfRxAccessInfo "" UBYTE Com_ConstValueArrayBasedInitValueStartIdxOfRxAccessInfoType 0 0 0 255 ECU_ADDRESS 0x0 /end MEASUREMENT
/begin MEASUREMENT Com_RxAccessInfo[77].DynSignalOfRxAccessInfo "" UBYTE Com_DynSignalOfRxAccessInfoType 0 0 0 1 ECU_ADDRESS 0x0 /end MEASUREMENT
/begin MEASUREMENT Com_RxAccessInfo[77].InitValueIdxOfRxAccessInfo "" UBYTE Com_InitValueIdxOfRxAccessInfoType 0 0 0 255 ECU_ADDRESS 0x0 /end MEASUREMENT
/begin MEASUREMENT Com_RxAccessInfo[77].InitValueOfRxAccessInfo "" UBYTE Com_InitValueOfRxAccessInfoType 0 0 0 255 ECU_ADDRESS 0x0 /end MEASUREMENT
/begin MEASUREMENT Com_RxAccessInfo[77].InvValueIdxOfRxAccessInfo "" UBYTE Com_InvValueIdxOfRxAccessInfoType 0 0 0 255 ECU_ADDRESS 0x0 /end MEASUREMENT
/begin MEASUREMENT Com_RxAccessInfo[77].InvValueOfRxAccessInfo "" UBYTE Com_InvValueOfRxAccessInfoType 0 0 0 255 ECU_ADDRESS 0x0 /end MEASUREMENT
/begin MEASUREMENT Com_RxAccessInfo[77].IsGroupSignalOfRxAccessInfo "" UBYTE Com_IsGroupSignalOfRxAccessInfoType 0 0 0 1 ECU_ADDRESS 0x0 /end MEASUREMENT
/begin MEASUREMENT Com_RxAccessInfo[77].RxDataTimeoutSubstitutionValueIdxOfRxAccessInfo "" UBYTE Com_RxDataTimeoutSubstitutionValueIdxOfRxAccessInfoType 0 0 0 255 ECU_ADDRESS 0x0 /end MEASUREMENT
/begin MEASUREMENT Com_RxAccessInfo[77].RxDataTimeoutSubstitutionValueOfRxAccessInfo "" UBYTE Com_RxDataTimeoutSubstitutionValueOfRxAccessInfoType 0 0 0 255 ECU_ADDRESS 0x0 /end MEASUREMENT
/begin MEASUREMENT Com_RxAccessInfo[77].RxPduInfoIdxOfRxAccessInfo "" UBYTE NO_COMPU_METHOD 0 0 0 255 ECU_ADDRESS 0x0 /end MEASUREMENT
/begin MEASUREMENT Com_RxAccessInfo[77].RxSigBufferArrayBasedBufferEndIdxOfRxAccessInfo "" UBYTE Com_RxSigBufferArrayBasedBufferEndIdxOfRxAccessInfoType 0 0 0 255 ECU_ADDRESS 0x0 /end MEASUREMENT
/begin MEASUREMENT Com_RxAccessInfo[77].RxSigBufferArrayBasedBufferStartIdxOfRxAccessInfo "" UBYTE Com_RxSigBufferArrayBasedBufferStartIdxOfRxAccessInfoType 0 0 0 255 ECU_ADDRESS 0x0 /end MEASUREMENT
/begin MEASUREMENT Com_RxAccessInfo[77].RxSigBufferArrayBasedShdBufferEndIdxOfRxAccessInfo "" UBYTE Com_RxSigBufferArrayBasedShdBufferEndIdxOfRxAccessInfoType 0 0 0 255 ECU_ADDRESS 0x0 /end MEASUREMENT
/begin MEASUREMENT Com_RxAccessInfo[77].RxSigBufferArrayBasedShdBufferStartIdxOfRxAccessInfo "" UBYTE Com_RxSigBufferArrayBasedShdBufferStartIdxOfRxAccessInfoType 0 0 0 255 ECU_ADDRESS 0x0 /end MEASUREMENT
/begin MEASUREMENT Com_RxAccessInfo[77].RxTOutInfoIdxOfRxAccessInfo "" UBYTE Com_RxTOutInfoIdxOfRxAccessInfoType 0 0 0 255 ECU_ADDRESS 0x0 /end MEASUREMENT
/begin MEASUREMENT Com_RxAccessInfo[77].ShdBufferIdxOfRxAccessInfo "" UWORD Com_ShdBufferIdxOfRxAccessInfoType 0 0 0 65535 ECU_ADDRESS 0x0 /end MEASUREMENT
/begin MEASUREMENT Com_RxAccessInfo[77].SignalLengthInByteOfRxAccessInfo "" UBYTE NO_COMPU_METHOD 0 0 0 255 ECU_ADDRESS 0x0 /end MEASUREMENT
/begin MEASUREMENT Com_RxAccessInfo[77].StartByteInPduPositionOfRxAccessInfo "" UBYTE NO_COMPU_METHOD 0 0 0 255 ECU_ADDRESS 0x0 /end MEASUREMENT
/begin MEASUREMENT Com_RxAccessInfo[77].TmpBufferIdxOfRxAccessInfo "" UBYTE Com_TmpBufferIdxOfRxAccessInfoType 0 0 0 255 ECU_ADDRESS 0x0 /end MEASUREMENT
/begin MEASUREMENT Com_RxAccessInfo[77].TmpBufferOfRxAccessInfo "" UBYTE Com_TmpBufferOfRxAccessInfoType 0 0 0 255 ECU_ADDRESS 0x0 /end MEASUREMENT
/begin MEASUREMENT Com_RxAccessInfo[77].TmpRxShdBufferArrayBasedTmpBufferEndIdxOfRxAccessInfo "" UBYTE Com_TmpRxShdBufferArrayBasedTmpBufferEndIdxOfRxAccessInfoType 0 0 0 255 ECU_ADDRESS 0x0 /end MEASUREMENT
/begin MEASUREMENT Com_RxAccessInfo[77].TmpRxShdBufferArrayBasedTmpBufferStartIdxOfRxAccessInfo "" UBYTE Com_TmpRxShdBufferArrayBasedTmpBufferStartIdxOfRxAccessInfoType 0 0 0 255 ECU_ADDRESS 0x0 /end MEASUREMENT
/begin MEASUREMENT Com_RxAccessInfo[78].ApplTypeOfRxAccessInfo "" UBYTE Com_ApplTypeOfRxAccessInfoType 0 0 0 255 ECU_ADDRESS 0x0 /end MEASUREMENT
/begin MEASUREMENT Com_RxAccessInfo[78].BitLengthOfRxAccessInfo "" UWORD NO_COMPU_METHOD 0 0 0 65535 ECU_ADDRESS 0x0 /end MEASUREMENT
/begin MEASUREMENT Com_RxAccessInfo[78].BitPositionOfRxAccessInfo "" UWORD NO_COMPU_METHOD 0 0 0 65535 ECU_ADDRESS 0x0 /end MEASUREMENT
/begin MEASUREMENT Com_RxAccessInfo[78].BufferIdxOfRxAccessInfo "" UWORD Com_BufferIdxOfRxAccessInfoType 0 0 0 65535 ECU_ADDRESS 0x0 /end MEASUREMENT
/begin MEASUREMENT Com_RxAccessInfo[78].BusAccOfRxAccessInfo "" UBYTE Com_BusAccOfRxAccessInfoType 0 0 0 255 ECU_ADDRESS 0x0 /end MEASUREMENT
/begin MEASUREMENT Com_RxAccessInfo[78].ByteLengthOfRxAccessInfo "" UBYTE NO_COMPU_METHOD 0 0 0 255 ECU_ADDRESS 0x0 /end MEASUREMENT
/begin MEASUREMENT Com_RxAccessInfo[78].ConstValueArrayBasedInitValueEndIdxOfRxAccessInfo "" UBYTE Com_ConstValueArrayBasedInitValueEndIdxOfRxAccessInfoType 0 0 0 255 ECU_ADDRESS 0x0 /end MEASUREMENT
/begin MEASUREMENT Com_RxAccessInfo[78].ConstValueArrayBasedInitValueStartIdxOfRxAccessInfo "" UBYTE Com_ConstValueArrayBasedInitValueStartIdxOfRxAccessInfoType 0 0 0 255 ECU_ADDRESS 0x0 /end MEASUREMENT
/begin MEASUREMENT Com_RxAccessInfo[78].DynSignalOfRxAccessInfo "" UBYTE Com_DynSignalOfRxAccessInfoType 0 0 0 1 ECU_ADDRESS 0x0 /end MEASUREMENT
/begin MEASUREMENT Com_RxAccessInfo[78].InitValueIdxOfRxAccessInfo "" UBYTE Com_InitValueIdxOfRxAccessInfoType 0 0 0 255 ECU_ADDRESS 0x0 /end MEASUREMENT
/begin MEASUREMENT Com_RxAccessInfo[78].InitValueOfRxAccessInfo "" UBYTE Com_InitValueOfRxAccessInfoType 0 0 0 255 ECU_ADDRESS 0x0 /end MEASUREMENT
/begin MEASUREMENT Com_RxAccessInfo[78].InvValueIdxOfRxAccessInfo "" UBYTE Com_InvValueIdxOfRxAccessInfoType 0 0 0 255 ECU_ADDRESS 0x0 /end MEASUREMENT
/begin MEASUREMENT Com_RxAccessInfo[78].InvValueOfRxAccessInfo "" UBYTE Com_InvValueOfRxAccessInfoType 0 0 0 255 ECU_ADDRESS 0x0 /end MEASUREMENT
/begin MEASUREMENT Com_RxAccessInfo[78].IsGroupSignalOfRxAccessInfo "" UBYTE Com_IsGroupSignalOfRxAccessInfoType 0 0 0 1 ECU_ADDRESS 0x0 /end MEASUREMENT
/begin MEASUREMENT Com_RxAccessInfo[78].RxDataTimeoutSubstitutionValueIdxOfRxAccessInfo "" UBYTE Com_RxDataTimeoutSubstitutionValueIdxOfRxAccessInfoType 0 0 0 255 ECU_ADDRESS 0x0 /end MEASUREMENT
/begin MEASUREMENT Com_RxAccessInfo[78].RxDataTimeoutSubstitutionValueOfRxAccessInfo "" UBYTE Com_RxDataTimeoutSubstitutionValueOfRxAccessInfoType 0 0 0 255 ECU_ADDRESS 0x0 /end MEASUREMENT
/begin MEASUREMENT Com_RxAccessInfo[78].RxPduInfoIdxOfRxAccessInfo "" UBYTE NO_COMPU_METHOD 0 0 0 255 ECU_ADDRESS 0x0 /end MEASUREMENT
/begin MEASUREMENT Com_RxAccessInfo[78].RxSigBufferArrayBasedBufferEndIdxOfRxAccessInfo "" UBYTE Com_RxSigBufferArrayBasedBufferEndIdxOfRxAccessInfoType 0 0 0 255 ECU_ADDRESS 0x0 /end MEASUREMENT
/begin MEASUREMENT Com_RxAccessInfo[78].RxSigBufferArrayBasedBufferStartIdxOfRxAccessInfo "" UBYTE Com_RxSigBufferArrayBasedBufferStartIdxOfRxAccessInfoType 0 0 0 255 ECU_ADDRESS 0x0 /end MEASUREMENT
/begin MEASUREMENT Com_RxAccessInfo[78].RxSigBufferArrayBasedShdBufferEndIdxOfRxAccessInfo "" UBYTE Com_RxSigBufferArrayBasedShdBufferEndIdxOfRxAccessInfoType 0 0 0 255 ECU_ADDRESS 0x0 /end MEASUREMENT
/begin MEASUREMENT Com_RxAccessInfo[78].RxSigBufferArrayBasedShdBufferStartIdxOfRxAccessInfo "" UBYTE Com_RxSigBufferArrayBasedShdBufferStartIdxOfRxAccessInfoType 0 0 0 255 ECU_ADDRESS 0x0 /end MEASUREMENT
/begin MEASUREMENT Com_RxAccessInfo[78].RxTOutInfoIdxOfRxAccessInfo "" UBYTE Com_RxTOutInfoIdxOfRxAccessInfoType 0 0 0 255 ECU_ADDRESS 0x0 /end MEASUREMENT
/begin MEASUREMENT Com_RxAccessInfo[78].ShdBufferIdxOfRxAccessInfo "" UWORD Com_ShdBufferIdxOfRxAccessInfoType 0 0 0 65535 ECU_ADDRESS 0x0 /end MEASUREMENT
/begin MEASUREMENT Com_RxAccessInfo[78].SignalLengthInByteOfRxAccessInfo "" UBYTE NO_COMPU_METHOD 0 0 0 255 ECU_ADDRESS 0x0 /end MEASUREMENT
/begin MEASUREMENT Com_RxAccessInfo[78].StartByteInPduPositionOfRxAccessInfo "" UBYTE NO_COMPU_METHOD 0 0 0 255 ECU_ADDRESS 0x0 /end MEASUREMENT
/begin MEASUREMENT Com_RxAccessInfo[78].TmpBufferIdxOfRxAccessInfo "" UBYTE Com_TmpBufferIdxOfRxAccessInfoType 0 0 0 255 ECU_ADDRESS 0x0 /end MEASUREMENT
/begin MEASUREMENT Com_RxAccessInfo[78].TmpBufferOfRxAccessInfo "" UBYTE Com_TmpBufferOfRxAccessInfoType 0 0 0 255 ECU_ADDRESS 0x0 /end MEASUREMENT
/begin MEASUREMENT Com_RxAccessInfo[78].TmpRxShdBufferArrayBasedTmpBufferEndIdxOfRxAccessInfo "" UBYTE Com_TmpRxShdBufferArrayBasedTmpBufferEndIdxOfRxAccessInfoType 0 0 0 255 ECU_ADDRESS 0x0 /end MEASUREMENT
/begin MEASUREMENT Com_RxAccessInfo[78].TmpRxShdBufferArrayBasedTmpBufferStartIdxOfRxAccessInfo "" UBYTE Com_TmpRxShdBufferArrayBasedTmpBufferStartIdxOfRxAccessInfoType 0 0 0 255 ECU_ADDRESS 0x0 /end MEASUREMENT
/begin MEASUREMENT Com_RxAccessInfo[79].ApplTypeOfRxAccessInfo "" UBYTE Com_ApplTypeOfRxAccessInfoType 0 0 0 255 ECU_ADDRESS 0x0 /end MEASUREMENT
/begin MEASUREMENT Com_RxAccessInfo[79].BitLengthOfRxAccessInfo "" UWORD NO_COMPU_METHOD 0 0 0 65535 ECU_ADDRESS 0x0 /end MEASUREMENT
/begin MEASUREMENT Com_RxAccessInfo[79].BitPositionOfRxAccessInfo "" UWORD NO_COMPU_METHOD 0 0 0 65535 ECU_ADDRESS 0x0 /end MEASUREMENT
/begin MEASUREMENT Com_RxAccessInfo[79].BufferIdxOfRxAccessInfo "" UWORD Com_BufferIdxOfRxAccessInfoType 0 0 0 65535 ECU_ADDRESS 0x0 /end MEASUREMENT
/begin MEASUREMENT Com_RxAccessInfo[79].BusAccOfRxAccessInfo "" UBYTE Com_BusAccOfRxAccessInfoType 0 0 0 255 ECU_ADDRESS 0x0 /end MEASUREMENT
/begin MEASUREMENT Com_RxAccessInfo[79].ByteLengthOfRxAccessInfo "" UBYTE NO_COMPU_METHOD 0 0 0 255 ECU_ADDRESS 0x0 /end MEASUREMENT
/begin MEASUREMENT Com_RxAccessInfo[79].ConstValueArrayBasedInitValueEndIdxOfRxAccessInfo "" UBYTE Com_ConstValueArrayBasedInitValueEndIdxOfRxAccessInfoType 0 0 0 255 ECU_ADDRESS 0x0 /end MEASUREMENT
/begin MEASUREMENT Com_RxAccessInfo[79].ConstValueArrayBasedInitValueStartIdxOfRxAccessInfo "" UBYTE Com_ConstValueArrayBasedInitValueStartIdxOfRxAccessInfoType 0 0 0 255 ECU_ADDRESS 0x0 /end MEASUREMENT
/begin MEASUREMENT Com_RxAccessInfo[79].DynSignalOfRxAccessInfo "" UBYTE Com_DynSignalOfRxAccessInfoType 0 0 0 1 ECU_ADDRESS 0x0 /end MEASUREMENT
/begin MEASUREMENT Com_RxAccessInfo[79].InitValueIdxOfRxAccessInfo "" UBYTE Com_InitValueIdxOfRxAccessInfoType 0 0 0 255 ECU_ADDRESS 0x0 /end MEASUREMENT
/begin MEASUREMENT Com_RxAccessInfo[79].InitValueOfRxAccessInfo "" UBYTE Com_InitValueOfRxAccessInfoType 0 0 0 255 ECU_ADDRESS 0x0 /end MEASUREMENT
/begin MEASUREMENT Com_RxAccessInfo[79].InvValueIdxOfRxAccessInfo "" UBYTE Com_InvValueIdxOfRxAccessInfoType 0 0 0 255 ECU_ADDRESS 0x0 /end MEASUREMENT
/begin MEASUREMENT Com_RxAccessInfo[79].InvValueOfRxAccessInfo "" UBYTE Com_InvValueOfRxAccessInfoType 0 0 0 255 ECU_ADDRESS 0x0 /end MEASUREMENT
/begin MEASUREMENT Com_RxAccessInfo[79].IsGroupSignalOfRxAccessInfo "" UBYTE Com_IsGroupSignalOfRxAccessInfoType 0 0 0 1 ECU_ADDRESS 0x0 /end MEASUREMENT
/begin MEASUREMENT Com_RxAccessInfo[79].RxDataTimeoutSubstitutionValueIdxOfRxAccessInfo "" UBYTE Com_RxDataTimeoutSubstitutionValueIdxOfRxAccessInfoType 0 0 0 255 ECU_ADDRESS 0x0 /end MEASUREMENT
/begin MEASUREMENT Com_RxAccessInfo[79].RxDataTimeoutSubstitutionValueOfRxAccessInfo "" UBYTE Com_RxDataTimeoutSubstitutionValueOfRxAccessInfoType 0 0 0 255 ECU_ADDRESS 0x0 /end MEASUREMENT
/begin MEASUREMENT Com_RxAccessInfo[79].RxPduInfoIdxOfRxAccessInfo "" UBYTE NO_COMPU_METHOD 0 0 0 255 ECU_ADDRESS 0x0 /end MEASUREMENT
/begin MEASUREMENT Com_RxAccessInfo[79].RxSigBufferArrayBasedBufferEndIdxOfRxAccessInfo "" UBYTE Com_RxSigBufferArrayBasedBufferEndIdxOfRxAccessInfoType 0 0 0 255 ECU_ADDRESS 0x0 /end MEASUREMENT
/begin MEASUREMENT Com_RxAccessInfo[79].RxSigBufferArrayBasedBufferStartIdxOfRxAccessInfo "" UBYTE Com_RxSigBufferArrayBasedBufferStartIdxOfRxAccessInfoType 0 0 0 255 ECU_ADDRESS 0x0 /end MEASUREMENT
/begin MEASUREMENT Com_RxAccessInfo[79].RxSigBufferArrayBasedShdBufferEndIdxOfRxAccessInfo "" UBYTE Com_RxSigBufferArrayBasedShdBufferEndIdxOfRxAccessInfoType 0 0 0 255 ECU_ADDRESS 0x0 /end MEASUREMENT
/begin MEASUREMENT Com_RxAccessInfo[79].RxSigBufferArrayBasedShdBufferStartIdxOfRxAccessInfo "" UBYTE Com_RxSigBufferArrayBasedShdBufferStartIdxOfRxAccessInfoType 0 0 0 255 ECU_ADDRESS 0x0 /end MEASUREMENT
/begin MEASUREMENT Com_RxAccessInfo[79].RxTOutInfoIdxOfRxAccessInfo "" UBYTE Com_RxTOutInfoIdxOfRxAccessInfoType 0 0 0 255 ECU_ADDRESS 0x0 /end MEASUREMENT
/begin MEASUREMENT Com_RxAccessInfo[79].ShdBufferIdxOfRxAccessInfo "" UWORD Com_ShdBufferIdxOfRxAccessInfoType 0 0 0 65535 ECU_ADDRESS 0x0 /end MEASUREMENT
/begin MEASUREMENT Com_RxAccessInfo[79].SignalLengthInByteOfRxAccessInfo "" UBYTE NO_COMPU_METHOD 0 0 0 255 ECU_ADDRESS 0x0 /end MEASUREMENT
/begin MEASUREMENT Com_RxAccessInfo[79].StartByteInPduPositionOfRxAccessInfo "" UBYTE NO_COMPU_METHOD 0 0 0 255 ECU_ADDRESS 0x0 /end MEASUREMENT
/begin MEASUREMENT Com_RxAccessInfo[79].TmpBufferIdxOfRxAccessInfo "" UBYTE Com_TmpBufferIdxOfRxAccessInfoType 0 0 0 255 ECU_ADDRESS 0x0 /end MEASUREMENT
/begin MEASUREMENT Com_RxAccessInfo[79].TmpBufferOfRxAccessInfo "" UBYTE Com_TmpBufferOfRxAccessInfoType 0 0 0 255 ECU_ADDRESS 0x0 /end MEASUREMENT
/begin MEASUREMENT Com_RxAccessInfo[79].TmpRxShdBufferArrayBasedTmpBufferEndIdxOfRxAccessInfo "" UBYTE Com_TmpRxShdBufferArrayBasedTmpBufferEndIdxOfRxAccessInfoType 0 0 0 255 ECU_ADDRESS 0x0 /end MEASUREMENT
/begin MEASUREMENT Com_RxAccessInfo[79].TmpRxShdBufferArrayBasedTmpBufferStartIdxOfRxAccessInfo "" UBYTE Com_TmpRxShdBufferArrayBasedTmpBufferStartIdxOfRxAccessInfoType 0 0 0 255 ECU_ADDRESS 0x0 /end MEASUREMENT
/begin MEASUREMENT Com_RxAccessInfo[7].ApplTypeOfRxAccessInfo "" UBYTE Com_ApplTypeOfRxAccessInfoType 0 0 0 255 ECU_ADDRESS 0x0 /end MEASUREMENT
/begin MEASUREMENT Com_RxAccessInfo[7].BitLengthOfRxAccessInfo "" UWORD NO_COMPU_METHOD 0 0 0 65535 ECU_ADDRESS 0x0 /end MEASUREMENT
/begin MEASUREMENT Com_RxAccessInfo[7].BitPositionOfRxAccessInfo "" UWORD NO_COMPU_METHOD 0 0 0 65535 ECU_ADDRESS 0x0 /end MEASUREMENT
/begin MEASUREMENT Com_RxAccessInfo[7].BufferIdxOfRxAccessInfo "" UWORD Com_BufferIdxOfRxAccessInfoType 0 0 0 65535 ECU_ADDRESS 0x0 /end MEASUREMENT
/begin MEASUREMENT Com_RxAccessInfo[7].BusAccOfRxAccessInfo "" UBYTE Com_BusAccOfRxAccessInfoType 0 0 0 255 ECU_ADDRESS 0x0 /end MEASUREMENT
/begin MEASUREMENT Com_RxAccessInfo[7].ByteLengthOfRxAccessInfo "" UBYTE NO_COMPU_METHOD 0 0 0 255 ECU_ADDRESS 0x0 /end MEASUREMENT
/begin MEASUREMENT Com_RxAccessInfo[7].ConstValueArrayBasedInitValueEndIdxOfRxAccessInfo "" UBYTE Com_ConstValueArrayBasedInitValueEndIdxOfRxAccessInfoType 0 0 0 255 ECU_ADDRESS 0x0 /end MEASUREMENT
/begin MEASUREMENT Com_RxAccessInfo[7].ConstValueArrayBasedInitValueStartIdxOfRxAccessInfo "" UBYTE Com_ConstValueArrayBasedInitValueStartIdxOfRxAccessInfoType 0 0 0 255 ECU_ADDRESS 0x0 /end MEASUREMENT
/begin MEASUREMENT Com_RxAccessInfo[7].DynSignalOfRxAccessInfo "" UBYTE Com_DynSignalOfRxAccessInfoType 0 0 0 1 ECU_ADDRESS 0x0 /end MEASUREMENT
/begin MEASUREMENT Com_RxAccessInfo[7].InitValueIdxOfRxAccessInfo "" UBYTE Com_InitValueIdxOfRxAccessInfoType 0 0 0 255 ECU_ADDRESS 0x0 /end MEASUREMENT
/begin MEASUREMENT Com_RxAccessInfo[7].InitValueOfRxAccessInfo "" UBYTE Com_InitValueOfRxAccessInfoType 0 0 0 255 ECU_ADDRESS 0x0 /end MEASUREMENT
/begin MEASUREMENT Com_RxAccessInfo[7].InvValueIdxOfRxAccessInfo "" UBYTE Com_InvValueIdxOfRxAccessInfoType 0 0 0 255 ECU_ADDRESS 0x0 /end MEASUREMENT
/begin MEASUREMENT Com_RxAccessInfo[7].InvValueOfRxAccessInfo "" UBYTE Com_InvValueOfRxAccessInfoType 0 0 0 255 ECU_ADDRESS 0x0 /end MEASUREMENT
/begin MEASUREMENT Com_RxAccessInfo[7].IsGroupSignalOfRxAccessInfo "" UBYTE Com_IsGroupSignalOfRxAccessInfoType 0 0 0 1 ECU_ADDRESS 0x0 /end MEASUREMENT
/begin MEASUREMENT Com_RxAccessInfo[7].RxDataTimeoutSubstitutionValueIdxOfRxAccessInfo "" UBYTE Com_RxDataTimeoutSubstitutionValueIdxOfRxAccessInfoType 0 0 0 255 ECU_ADDRESS 0x0 /end MEASUREMENT
/begin MEASUREMENT Com_RxAccessInfo[7].RxDataTimeoutSubstitutionValueOfRxAccessInfo "" UBYTE Com_RxDataTimeoutSubstitutionValueOfRxAccessInfoType 0 0 0 255 ECU_ADDRESS 0x0 /end MEASUREMENT
/begin MEASUREMENT Com_RxAccessInfo[7].RxPduInfoIdxOfRxAccessInfo "" UBYTE NO_COMPU_METHOD 0 0 0 255 ECU_ADDRESS 0x0 /end MEASUREMENT
/begin MEASUREMENT Com_RxAccessInfo[7].RxSigBufferArrayBasedBufferEndIdxOfRxAccessInfo "" UBYTE Com_RxSigBufferArrayBasedBufferEndIdxOfRxAccessInfoType 0 0 0 255 ECU_ADDRESS 0x0 /end MEASUREMENT
/begin MEASUREMENT Com_RxAccessInfo[7].RxSigBufferArrayBasedBufferStartIdxOfRxAccessInfo "" UBYTE Com_RxSigBufferArrayBasedBufferStartIdxOfRxAccessInfoType 0 0 0 255 ECU_ADDRESS 0x0 /end MEASUREMENT
/begin MEASUREMENT Com_RxAccessInfo[7].RxSigBufferArrayBasedShdBufferEndIdxOfRxAccessInfo "" UBYTE Com_RxSigBufferArrayBasedShdBufferEndIdxOfRxAccessInfoType 0 0 0 255 ECU_ADDRESS 0x0 /end MEASUREMENT
/begin MEASUREMENT Com_RxAccessInfo[7].RxSigBufferArrayBasedShdBufferStartIdxOfRxAccessInfo "" UBYTE Com_RxSigBufferArrayBasedShdBufferStartIdxOfRxAccessInfoType 0 0 0 255 ECU_ADDRESS 0x0 /end MEASUREMENT
/begin MEASUREMENT Com_RxAccessInfo[7].RxTOutInfoIdxOfRxAccessInfo "" UBYTE Com_RxTOutInfoIdxOfRxAccessInfoType 0 0 0 255 ECU_ADDRESS 0x0 /end MEASUREMENT
/begin MEASUREMENT Com_RxAccessInfo[7].ShdBufferIdxOfRxAccessInfo "" UWORD Com_ShdBufferIdxOfRxAccessInfoType 0 0 0 65535 ECU_ADDRESS 0x0 /end MEASUREMENT
/begin MEASUREMENT Com_RxAccessInfo[7].SignalLengthInByteOfRxAccessInfo "" UBYTE NO_COMPU_METHOD 0 0 0 255 ECU_ADDRESS 0x0 /end MEASUREMENT
/begin MEASUREMENT Com_RxAccessInfo[7].StartByteInPduPositionOfRxAccessInfo "" UBYTE NO_COMPU_METHOD 0 0 0 255 ECU_ADDRESS 0x0 /end MEASUREMENT
/begin MEASUREMENT Com_RxAccessInfo[7].TmpBufferIdxOfRxAccessInfo "" UBYTE Com_TmpBufferIdxOfRxAccessInfoType 0 0 0 255 ECU_ADDRESS 0x0 /end MEASUREMENT
/begin MEASUREMENT Com_RxAccessInfo[7].TmpBufferOfRxAccessInfo "" UBYTE Com_TmpBufferOfRxAccessInfoType 0 0 0 255 ECU_ADDRESS 0x0 /end MEASUREMENT
/begin MEASUREMENT Com_RxAccessInfo[7].TmpRxShdBufferArrayBasedTmpBufferEndIdxOfRxAccessInfo "" UBYTE Com_TmpRxShdBufferArrayBasedTmpBufferEndIdxOfRxAccessInfoType 0 0 0 255 ECU_ADDRESS 0x0 /end MEASUREMENT
/begin MEASUREMENT Com_RxAccessInfo[7].TmpRxShdBufferArrayBasedTmpBufferStartIdxOfRxAccessInfo "" UBYTE Com_TmpRxShdBufferArrayBasedTmpBufferStartIdxOfRxAccessInfoType 0 0 0 255 ECU_ADDRESS 0x0 /end MEASUREMENT
/begin MEASUREMENT Com_RxAccessInfo[80].ApplTypeOfRxAccessInfo "" UBYTE Com_ApplTypeOfRxAccessInfoType 0 0 0 255 ECU_ADDRESS 0x0 /end MEASUREMENT
/begin MEASUREMENT Com_RxAccessInfo[80].BitLengthOfRxAccessInfo "" UWORD NO_COMPU_METHOD 0 0 0 65535 ECU_ADDRESS 0x0 /end MEASUREMENT
/begin MEASUREMENT Com_RxAccessInfo[80].BitPositionOfRxAccessInfo "" UWORD NO_COMPU_METHOD 0 0 0 65535 ECU_ADDRESS 0x0 /end MEASUREMENT
/begin MEASUREMENT Com_RxAccessInfo[80].BufferIdxOfRxAccessInfo "" UWORD Com_BufferIdxOfRxAccessInfoType 0 0 0 65535 ECU_ADDRESS 0x0 /end MEASUREMENT
/begin MEASUREMENT Com_RxAccessInfo[80].BusAccOfRxAccessInfo "" UBYTE Com_BusAccOfRxAccessInfoType 0 0 0 255 ECU_ADDRESS 0x0 /end MEASUREMENT
/begin MEASUREMENT Com_RxAccessInfo[80].ByteLengthOfRxAccessInfo "" UBYTE NO_COMPU_METHOD 0 0 0 255 ECU_ADDRESS 0x0 /end MEASUREMENT
/begin MEASUREMENT Com_RxAccessInfo[80].ConstValueArrayBasedInitValueEndIdxOfRxAccessInfo "" UBYTE Com_ConstValueArrayBasedInitValueEndIdxOfRxAccessInfoType 0 0 0 255 ECU_ADDRESS 0x0 /end MEASUREMENT
/begin MEASUREMENT Com_RxAccessInfo[80].ConstValueArrayBasedInitValueStartIdxOfRxAccessInfo "" UBYTE Com_ConstValueArrayBasedInitValueStartIdxOfRxAccessInfoType 0 0 0 255 ECU_ADDRESS 0x0 /end MEASUREMENT
/begin MEASUREMENT Com_RxAccessInfo[80].DynSignalOfRxAccessInfo "" UBYTE Com_DynSignalOfRxAccessInfoType 0 0 0 1 ECU_ADDRESS 0x0 /end MEASUREMENT
/begin MEASUREMENT Com_RxAccessInfo[80].InitValueIdxOfRxAccessInfo "" UBYTE Com_InitValueIdxOfRxAccessInfoType 0 0 0 255 ECU_ADDRESS 0x0 /end MEASUREMENT
/begin MEASUREMENT Com_RxAccessInfo[80].InitValueOfRxAccessInfo "" UBYTE Com_InitValueOfRxAccessInfoType 0 0 0 255 ECU_ADDRESS 0x0 /end MEASUREMENT
/begin MEASUREMENT Com_RxAccessInfo[80].InvValueIdxOfRxAccessInfo "" UBYTE Com_InvValueIdxOfRxAccessInfoType 0 0 0 255 ECU_ADDRESS 0x0 /end MEASUREMENT
/begin MEASUREMENT Com_RxAccessInfo[80].InvValueOfRxAccessInfo "" UBYTE Com_InvValueOfRxAccessInfoType 0 0 0 255 ECU_ADDRESS 0x0 /end MEASUREMENT
/begin MEASUREMENT Com_RxAccessInfo[80].IsGroupSignalOfRxAccessInfo "" UBYTE Com_IsGroupSignalOfRxAccessInfoType 0 0 0 1 ECU_ADDRESS 0x0 /end MEASUREMENT
/begin MEASUREMENT Com_RxAccessInfo[80].RxDataTimeoutSubstitutionValueIdxOfRxAccessInfo "" UBYTE Com_RxDataTimeoutSubstitutionValueIdxOfRxAccessInfoType 0 0 0 255 ECU_ADDRESS 0x0 /end MEASUREMENT
/begin MEASUREMENT Com_RxAccessInfo[80].RxDataTimeoutSubstitutionValueOfRxAccessInfo "" UBYTE Com_RxDataTimeoutSubstitutionValueOfRxAccessInfoType 0 0 0 255 ECU_ADDRESS 0x0 /end MEASUREMENT
/begin MEASUREMENT Com_RxAccessInfo[80].RxPduInfoIdxOfRxAccessInfo "" UBYTE NO_COMPU_METHOD 0 0 0 255 ECU_ADDRESS 0x0 /end MEASUREMENT
/begin MEASUREMENT Com_RxAccessInfo[80].RxSigBufferArrayBasedBufferEndIdxOfRxAccessInfo "" UBYTE Com_RxSigBufferArrayBasedBufferEndIdxOfRxAccessInfoType 0 0 0 255 ECU_ADDRESS 0x0 /end MEASUREMENT
/begin MEASUREMENT Com_RxAccessInfo[80].RxSigBufferArrayBasedBufferStartIdxOfRxAccessInfo "" UBYTE Com_RxSigBufferArrayBasedBufferStartIdxOfRxAccessInfoType 0 0 0 255 ECU_ADDRESS 0x0 /end MEASUREMENT
/begin MEASUREMENT Com_RxAccessInfo[80].RxSigBufferArrayBasedShdBufferEndIdxOfRxAccessInfo "" UBYTE Com_RxSigBufferArrayBasedShdBufferEndIdxOfRxAccessInfoType 0 0 0 255 ECU_ADDRESS 0x0 /end MEASUREMENT
/begin MEASUREMENT Com_RxAccessInfo[80].RxSigBufferArrayBasedShdBufferStartIdxOfRxAccessInfo "" UBYTE Com_RxSigBufferArrayBasedShdBufferStartIdxOfRxAccessInfoType 0 0 0 255 ECU_ADDRESS 0x0 /end MEASUREMENT
/begin MEASUREMENT Com_RxAccessInfo[80].RxTOutInfoIdxOfRxAccessInfo "" UBYTE Com_RxTOutInfoIdxOfRxAccessInfoType 0 0 0 255 ECU_ADDRESS 0x0 /end MEASUREMENT
/begin MEASUREMENT Com_RxAccessInfo[80].ShdBufferIdxOfRxAccessInfo "" UWORD Com_ShdBufferIdxOfRxAccessInfoType 0 0 0 65535 ECU_ADDRESS 0x0 /end MEASUREMENT
/begin MEASUREMENT Com_RxAccessInfo[80].SignalLengthInByteOfRxAccessInfo "" UBYTE NO_COMPU_METHOD 0 0 0 255 ECU_ADDRESS 0x0 /end MEASUREMENT
/begin MEASUREMENT Com_RxAccessInfo[80].StartByteInPduPositionOfRxAccessInfo "" UBYTE NO_COMPU_METHOD 0 0 0 255 ECU_ADDRESS 0x0 /end MEASUREMENT
/begin MEASUREMENT Com_RxAccessInfo[80].TmpBufferIdxOfRxAccessInfo "" UBYTE Com_TmpBufferIdxOfRxAccessInfoType 0 0 0 255 ECU_ADDRESS 0x0 /end MEASUREMENT
/begin MEASUREMENT Com_RxAccessInfo[80].TmpBufferOfRxAccessInfo "" UBYTE Com_TmpBufferOfRxAccessInfoType 0 0 0 255 ECU_ADDRESS 0x0 /end MEASUREMENT
/begin MEASUREMENT Com_RxAccessInfo[80].TmpRxShdBufferArrayBasedTmpBufferEndIdxOfRxAccessInfo "" UBYTE Com_TmpRxShdBufferArrayBasedTmpBufferEndIdxOfRxAccessInfoType 0 0 0 255 ECU_ADDRESS 0x0 /end MEASUREMENT
/begin MEASUREMENT Com_RxAccessInfo[80].TmpRxShdBufferArrayBasedTmpBufferStartIdxOfRxAccessInfo "" UBYTE Com_TmpRxShdBufferArrayBasedTmpBufferStartIdxOfRxAccessInfoType 0 0 0 255 ECU_ADDRESS 0x0 /end MEASUREMENT
/begin MEASUREMENT Com_RxAccessInfo[81].ApplTypeOfRxAccessInfo "" UBYTE Com_ApplTypeOfRxAccessInfoType 0 0 0 255 ECU_ADDRESS 0x0 /end MEASUREMENT
/begin MEASUREMENT Com_RxAccessInfo[81].BitLengthOfRxAccessInfo "" UWORD NO_COMPU_METHOD 0 0 0 65535 ECU_ADDRESS 0x0 /end MEASUREMENT
/begin MEASUREMENT Com_RxAccessInfo[81].BitPositionOfRxAccessInfo "" UWORD NO_COMPU_METHOD 0 0 0 65535 ECU_ADDRESS 0x0 /end MEASUREMENT
/begin MEASUREMENT Com_RxAccessInfo[81].BufferIdxOfRxAccessInfo "" UWORD Com_BufferIdxOfRxAccessInfoType 0 0 0 65535 ECU_ADDRESS 0x0 /end MEASUREMENT
/begin MEASUREMENT Com_RxAccessInfo[81].BusAccOfRxAccessInfo "" UBYTE Com_BusAccOfRxAccessInfoType 0 0 0 255 ECU_ADDRESS 0x0 /end MEASUREMENT
/begin MEASUREMENT Com_RxAccessInfo[81].ByteLengthOfRxAccessInfo "" UBYTE NO_COMPU_METHOD 0 0 0 255 ECU_ADDRESS 0x0 /end MEASUREMENT
/begin MEASUREMENT Com_RxAccessInfo[81].ConstValueArrayBasedInitValueEndIdxOfRxAccessInfo "" UBYTE Com_ConstValueArrayBasedInitValueEndIdxOfRxAccessInfoType 0 0 0 255 ECU_ADDRESS 0x0 /end MEASUREMENT
/begin MEASUREMENT Com_RxAccessInfo[81].ConstValueArrayBasedInitValueStartIdxOfRxAccessInfo "" UBYTE Com_ConstValueArrayBasedInitValueStartIdxOfRxAccessInfoType 0 0 0 255 ECU_ADDRESS 0x0 /end MEASUREMENT
/begin MEASUREMENT Com_RxAccessInfo[81].DynSignalOfRxAccessInfo "" UBYTE Com_DynSignalOfRxAccessInfoType 0 0 0 1 ECU_ADDRESS 0x0 /end MEASUREMENT
/begin MEASUREMENT Com_RxAccessInfo[81].InitValueIdxOfRxAccessInfo "" UBYTE Com_InitValueIdxOfRxAccessInfoType 0 0 0 255 ECU_ADDRESS 0x0 /end MEASUREMENT
/begin MEASUREMENT Com_RxAccessInfo[81].InitValueOfRxAccessInfo "" UBYTE Com_InitValueOfRxAccessInfoType 0 0 0 255 ECU_ADDRESS 0x0 /end MEASUREMENT
/begin MEASUREMENT Com_RxAccessInfo[81].InvValueIdxOfRxAccessInfo "" UBYTE Com_InvValueIdxOfRxAccessInfoType 0 0 0 255 ECU_ADDRESS 0x0 /end MEASUREMENT
/begin MEASUREMENT Com_RxAccessInfo[81].InvValueOfRxAccessInfo "" UBYTE Com_InvValueOfRxAccessInfoType 0 0 0 255 ECU_ADDRESS 0x0 /end MEASUREMENT
/begin MEASUREMENT Com_RxAccessInfo[81].IsGroupSignalOfRxAccessInfo "" UBYTE Com_IsGroupSignalOfRxAccessInfoType 0 0 0 1 ECU_ADDRESS 0x0 /end MEASUREMENT
/begin MEASUREMENT Com_RxAccessInfo[81].RxDataTimeoutSubstitutionValueIdxOfRxAccessInfo "" UBYTE Com_RxDataTimeoutSubstitutionValueIdxOfRxAccessInfoType 0 0 0 255 ECU_ADDRESS 0x0 /end MEASUREMENT
/begin MEASUREMENT Com_RxAccessInfo[81].RxDataTimeoutSubstitutionValueOfRxAccessInfo "" UBYTE Com_RxDataTimeoutSubstitutionValueOfRxAccessInfoType 0 0 0 255 ECU_ADDRESS 0x0 /end MEASUREMENT
/begin MEASUREMENT Com_RxAccessInfo[81].RxPduInfoIdxOfRxAccessInfo "" UBYTE NO_COMPU_METHOD 0 0 0 255 ECU_ADDRESS 0x0 /end MEASUREMENT
/begin MEASUREMENT Com_RxAccessInfo[81].RxSigBufferArrayBasedBufferEndIdxOfRxAccessInfo "" UBYTE Com_RxSigBufferArrayBasedBufferEndIdxOfRxAccessInfoType 0 0 0 255 ECU_ADDRESS 0x0 /end MEASUREMENT
/begin MEASUREMENT Com_RxAccessInfo[81].RxSigBufferArrayBasedBufferStartIdxOfRxAccessInfo "" UBYTE Com_RxSigBufferArrayBasedBufferStartIdxOfRxAccessInfoType 0 0 0 255 ECU_ADDRESS 0x0 /end MEASUREMENT
/begin MEASUREMENT Com_RxAccessInfo[81].RxSigBufferArrayBasedShdBufferEndIdxOfRxAccessInfo "" UBYTE Com_RxSigBufferArrayBasedShdBufferEndIdxOfRxAccessInfoType 0 0 0 255 ECU_ADDRESS 0x0 /end MEASUREMENT
/begin MEASUREMENT Com_RxAccessInfo[81].RxSigBufferArrayBasedShdBufferStartIdxOfRxAccessInfo "" UBYTE Com_RxSigBufferArrayBasedShdBufferStartIdxOfRxAccessInfoType 0 0 0 255 ECU_ADDRESS 0x0 /end MEASUREMENT
/begin MEASUREMENT Com_RxAccessInfo[81].RxTOutInfoIdxOfRxAccessInfo "" UBYTE Com_RxTOutInfoIdxOfRxAccessInfoType 0 0 0 255 ECU_ADDRESS 0x0 /end MEASUREMENT
/begin MEASUREMENT Com_RxAccessInfo[81].ShdBufferIdxOfRxAccessInfo "" UWORD Com_ShdBufferIdxOfRxAccessInfoType 0 0 0 65535 ECU_ADDRESS 0x0 /end MEASUREMENT
/begin MEASUREMENT Com_RxAccessInfo[81].SignalLengthInByteOfRxAccessInfo "" UBYTE NO_COMPU_METHOD 0 0 0 255 ECU_ADDRESS 0x0 /end MEASUREMENT
/begin MEASUREMENT Com_RxAccessInfo[81].StartByteInPduPositionOfRxAccessInfo "" UBYTE NO_COMPU_METHOD 0 0 0 255 ECU_ADDRESS 0x0 /end MEASUREMENT
/begin MEASUREMENT Com_RxAccessInfo[81].TmpBufferIdxOfRxAccessInfo "" UBYTE Com_TmpBufferIdxOfRxAccessInfoType 0 0 0 255 ECU_ADDRESS 0x0 /end MEASUREMENT
/begin MEASUREMENT Com_RxAccessInfo[81].TmpBufferOfRxAccessInfo "" UBYTE Com_TmpBufferOfRxAccessInfoType 0 0 0 255 ECU_ADDRESS 0x0 /end MEASUREMENT
/begin MEASUREMENT Com_RxAccessInfo[81].TmpRxShdBufferArrayBasedTmpBufferEndIdxOfRxAccessInfo "" UBYTE Com_TmpRxShdBufferArrayBasedTmpBufferEndIdxOfRxAccessInfoType 0 0 0 255 ECU_ADDRESS 0x0 /end MEASUREMENT
/begin MEASUREMENT Com_RxAccessInfo[81].TmpRxShdBufferArrayBasedTmpBufferStartIdxOfRxAccessInfo "" UBYTE Com_TmpRxShdBufferArrayBasedTmpBufferStartIdxOfRxAccessInfoType 0 0 0 255 ECU_ADDRESS 0x0 /end MEASUREMENT
/begin MEASUREMENT Com_RxAccessInfo[82].ApplTypeOfRxAccessInfo "" UBYTE Com_ApplTypeOfRxAccessInfoType 0 0 0 255 ECU_ADDRESS 0x0 /end MEASUREMENT
/begin MEASUREMENT Com_RxAccessInfo[82].BitLengthOfRxAccessInfo "" UWORD NO_COMPU_METHOD 0 0 0 65535 ECU_ADDRESS 0x0 /end MEASUREMENT
/begin MEASUREMENT Com_RxAccessInfo[82].BitPositionOfRxAccessInfo "" UWORD NO_COMPU_METHOD 0 0 0 65535 ECU_ADDRESS 0x0 /end MEASUREMENT
/begin MEASUREMENT Com_RxAccessInfo[82].BufferIdxOfRxAccessInfo "" UWORD Com_BufferIdxOfRxAccessInfoType 0 0 0 65535 ECU_ADDRESS 0x0 /end MEASUREMENT
/begin MEASUREMENT Com_RxAccessInfo[82].BusAccOfRxAccessInfo "" UBYTE Com_BusAccOfRxAccessInfoType 0 0 0 255 ECU_ADDRESS 0x0 /end MEASUREMENT
/begin MEASUREMENT Com_RxAccessInfo[82].ByteLengthOfRxAccessInfo "" UBYTE NO_COMPU_METHOD 0 0 0 255 ECU_ADDRESS 0x0 /end MEASUREMENT
/begin MEASUREMENT Com_RxAccessInfo[82].ConstValueArrayBasedInitValueEndIdxOfRxAccessInfo "" UBYTE Com_ConstValueArrayBasedInitValueEndIdxOfRxAccessInfoType 0 0 0 255 ECU_ADDRESS 0x0 /end MEASUREMENT
/begin MEASUREMENT Com_RxAccessInfo[82].ConstValueArrayBasedInitValueStartIdxOfRxAccessInfo "" UBYTE Com_ConstValueArrayBasedInitValueStartIdxOfRxAccessInfoType 0 0 0 255 ECU_ADDRESS 0x0 /end MEASUREMENT
/begin MEASUREMENT Com_RxAccessInfo[82].DynSignalOfRxAccessInfo "" UBYTE Com_DynSignalOfRxAccessInfoType 0 0 0 1 ECU_ADDRESS 0x0 /end MEASUREMENT
/begin MEASUREMENT Com_RxAccessInfo[82].InitValueIdxOfRxAccessInfo "" UBYTE Com_InitValueIdxOfRxAccessInfoType 0 0 0 255 ECU_ADDRESS 0x0 /end MEASUREMENT
/begin MEASUREMENT Com_RxAccessInfo[82].InitValueOfRxAccessInfo "" UBYTE Com_InitValueOfRxAccessInfoType 0 0 0 255 ECU_ADDRESS 0x0 /end MEASUREMENT
/begin MEASUREMENT Com_RxAccessInfo[82].InvValueIdxOfRxAccessInfo "" UBYTE Com_InvValueIdxOfRxAccessInfoType 0 0 0 255 ECU_ADDRESS 0x0 /end MEASUREMENT
/begin MEASUREMENT Com_RxAccessInfo[82].InvValueOfRxAccessInfo "" UBYTE Com_InvValueOfRxAccessInfoType 0 0 0 255 ECU_ADDRESS 0x0 /end MEASUREMENT
/begin MEASUREMENT Com_RxAccessInfo[82].IsGroupSignalOfRxAccessInfo "" UBYTE Com_IsGroupSignalOfRxAccessInfoType 0 0 0 1 ECU_ADDRESS 0x0 /end MEASUREMENT
/begin MEASUREMENT Com_RxAccessInfo[82].RxDataTimeoutSubstitutionValueIdxOfRxAccessInfo "" UBYTE Com_RxDataTimeoutSubstitutionValueIdxOfRxAccessInfoType 0 0 0 255 ECU_ADDRESS 0x0 /end MEASUREMENT
/begin MEASUREMENT Com_RxAccessInfo[82].RxDataTimeoutSubstitutionValueOfRxAccessInfo "" UBYTE Com_RxDataTimeoutSubstitutionValueOfRxAccessInfoType 0 0 0 255 ECU_ADDRESS 0x0 /end MEASUREMENT
/begin MEASUREMENT Com_RxAccessInfo[82].RxPduInfoIdxOfRxAccessInfo "" UBYTE NO_COMPU_METHOD 0 0 0 255 ECU_ADDRESS 0x0 /end MEASUREMENT
/begin MEASUREMENT Com_RxAccessInfo[82].RxSigBufferArrayBasedBufferEndIdxOfRxAccessInfo "" UBYTE Com_RxSigBufferArrayBasedBufferEndIdxOfRxAccessInfoType 0 0 0 255 ECU_ADDRESS 0x0 /end MEASUREMENT
/begin MEASUREMENT Com_RxAccessInfo[82].RxSigBufferArrayBasedBufferStartIdxOfRxAccessInfo "" UBYTE Com_RxSigBufferArrayBasedBufferStartIdxOfRxAccessInfoType 0 0 0 255 ECU_ADDRESS 0x0 /end MEASUREMENT
/begin MEASUREMENT Com_RxAccessInfo[82].RxSigBufferArrayBasedShdBufferEndIdxOfRxAccessInfo "" UBYTE Com_RxSigBufferArrayBasedShdBufferEndIdxOfRxAccessInfoType 0 0 0 255 ECU_ADDRESS 0x0 /end MEASUREMENT
/begin MEASUREMENT Com_RxAccessInfo[82].RxSigBufferArrayBasedShdBufferStartIdxOfRxAccessInfo "" UBYTE Com_RxSigBufferArrayBasedShdBufferStartIdxOfRxAccessInfoType 0 0 0 255 ECU_ADDRESS 0x0 /end MEASUREMENT
/begin MEASUREMENT Com_RxAccessInfo[82].RxTOutInfoIdxOfRxAccessInfo "" UBYTE Com_RxTOutInfoIdxOfRxAccessInfoType 0 0 0 255 ECU_ADDRESS 0x0 /end MEASUREMENT
/begin MEASUREMENT Com_RxAccessInfo[82].ShdBufferIdxOfRxAccessInfo "" UWORD Com_ShdBufferIdxOfRxAccessInfoType 0 0 0 65535 ECU_ADDRESS 0x0 /end MEASUREMENT
/begin MEASUREMENT Com_RxAccessInfo[82].SignalLengthInByteOfRxAccessInfo "" UBYTE NO_COMPU_METHOD 0 0 0 255 ECU_ADDRESS 0x0 /end MEASUREMENT
/begin MEASUREMENT Com_RxAccessInfo[82].StartByteInPduPositionOfRxAccessInfo "" UBYTE NO_COMPU_METHOD 0 0 0 255 ECU_ADDRESS 0x0 /end MEASUREMENT
/begin MEASUREMENT Com_RxAccessInfo[82].TmpBufferIdxOfRxAccessInfo "" UBYTE Com_TmpBufferIdxOfRxAccessInfoType 0 0 0 255 ECU_ADDRESS 0x0 /end MEASUREMENT
/begin MEASUREMENT Com_RxAccessInfo[82].TmpBufferOfRxAccessInfo "" UBYTE Com_TmpBufferOfRxAccessInfoType 0 0 0 255 ECU_ADDRESS 0x0 /end MEASUREMENT
/begin MEASUREMENT Com_RxAccessInfo[82].TmpRxShdBufferArrayBasedTmpBufferEndIdxOfRxAccessInfo "" UBYTE Com_TmpRxShdBufferArrayBasedTmpBufferEndIdxOfRxAccessInfoType 0 0 0 255 ECU_ADDRESS 0x0 /end MEASUREMENT
/begin MEASUREMENT Com_RxAccessInfo[82].TmpRxShdBufferArrayBasedTmpBufferStartIdxOfRxAccessInfo "" UBYTE Com_TmpRxShdBufferArrayBasedTmpBufferStartIdxOfRxAccessInfoType 0 0 0 255 ECU_ADDRESS 0x0 /end MEASUREMENT
/begin MEASUREMENT Com_RxAccessInfo[83].ApplTypeOfRxAccessInfo "" UBYTE Com_ApplTypeOfRxAccessInfoType 0 0 0 255 ECU_ADDRESS 0x0 /end MEASUREMENT
/begin MEASUREMENT Com_RxAccessInfo[83].BitLengthOfRxAccessInfo "" UWORD NO_COMPU_METHOD 0 0 0 65535 ECU_ADDRESS 0x0 /end MEASUREMENT
/begin MEASUREMENT Com_RxAccessInfo[83].BitPositionOfRxAccessInfo "" UWORD NO_COMPU_METHOD 0 0 0 65535 ECU_ADDRESS 0x0 /end MEASUREMENT
/begin MEASUREMENT Com_RxAccessInfo[83].BufferIdxOfRxAccessInfo "" UWORD Com_BufferIdxOfRxAccessInfoType 0 0 0 65535 ECU_ADDRESS 0x0 /end MEASUREMENT
/begin MEASUREMENT Com_RxAccessInfo[83].BusAccOfRxAccessInfo "" UBYTE Com_BusAccOfRxAccessInfoType 0 0 0 255 ECU_ADDRESS 0x0 /end MEASUREMENT
/begin MEASUREMENT Com_RxAccessInfo[83].ByteLengthOfRxAccessInfo "" UBYTE NO_COMPU_METHOD 0 0 0 255 ECU_ADDRESS 0x0 /end MEASUREMENT
/begin MEASUREMENT Com_RxAccessInfo[83].ConstValueArrayBasedInitValueEndIdxOfRxAccessInfo "" UBYTE Com_ConstValueArrayBasedInitValueEndIdxOfRxAccessInfoType 0 0 0 255 ECU_ADDRESS 0x0 /end MEASUREMENT
/begin MEASUREMENT Com_RxAccessInfo[83].ConstValueArrayBasedInitValueStartIdxOfRxAccessInfo "" UBYTE Com_ConstValueArrayBasedInitValueStartIdxOfRxAccessInfoType 0 0 0 255 ECU_ADDRESS 0x0 /end MEASUREMENT
/begin MEASUREMENT Com_RxAccessInfo[83].DynSignalOfRxAccessInfo "" UBYTE Com_DynSignalOfRxAccessInfoType 0 0 0 1 ECU_ADDRESS 0x0 /end MEASUREMENT
/begin MEASUREMENT Com_RxAccessInfo[83].InitValueIdxOfRxAccessInfo "" UBYTE Com_InitValueIdxOfRxAccessInfoType 0 0 0 255 ECU_ADDRESS 0x0 /end MEASUREMENT
/begin MEASUREMENT Com_RxAccessInfo[83].InitValueOfRxAccessInfo "" UBYTE Com_InitValueOfRxAccessInfoType 0 0 0 255 ECU_ADDRESS 0x0 /end MEASUREMENT
/begin MEASUREMENT Com_RxAccessInfo[83].InvValueIdxOfRxAccessInfo "" UBYTE Com_InvValueIdxOfRxAccessInfoType 0 0 0 255 ECU_ADDRESS 0x0 /end MEASUREMENT
/begin MEASUREMENT Com_RxAccessInfo[83].InvValueOfRxAccessInfo "" UBYTE Com_InvValueOfRxAccessInfoType 0 0 0 255 ECU_ADDRESS 0x0 /end MEASUREMENT
/begin MEASUREMENT Com_RxAccessInfo[83].IsGroupSignalOfRxAccessInfo "" UBYTE Com_IsGroupSignalOfRxAccessInfoType 0 0 0 1 ECU_ADDRESS 0x0 /end MEASUREMENT
/begin MEASUREMENT Com_RxAccessInfo[83].RxDataTimeoutSubstitutionValueIdxOfRxAccessInfo "" UBYTE Com_RxDataTimeoutSubstitutionValueIdxOfRxAccessInfoType 0 0 0 255 ECU_ADDRESS 0x0 /end MEASUREMENT
/begin MEASUREMENT Com_RxAccessInfo[83].RxDataTimeoutSubstitutionValueOfRxAccessInfo "" UBYTE Com_RxDataTimeoutSubstitutionValueOfRxAccessInfoType 0 0 0 255 ECU_ADDRESS 0x0 /end MEASUREMENT
/begin MEASUREMENT Com_RxAccessInfo[83].RxPduInfoIdxOfRxAccessInfo "" UBYTE NO_COMPU_METHOD 0 0 0 255 ECU_ADDRESS 0x0 /end MEASUREMENT
/begin MEASUREMENT Com_RxAccessInfo[83].RxSigBufferArrayBasedBufferEndIdxOfRxAccessInfo "" UBYTE Com_RxSigBufferArrayBasedBufferEndIdxOfRxAccessInfoType 0 0 0 255 ECU_ADDRESS 0x0 /end MEASUREMENT
/begin MEASUREMENT Com_RxAccessInfo[83].RxSigBufferArrayBasedBufferStartIdxOfRxAccessInfo "" UBYTE Com_RxSigBufferArrayBasedBufferStartIdxOfRxAccessInfoType 0 0 0 255 ECU_ADDRESS 0x0 /end MEASUREMENT
/begin MEASUREMENT Com_RxAccessInfo[83].RxSigBufferArrayBasedShdBufferEndIdxOfRxAccessInfo "" UBYTE Com_RxSigBufferArrayBasedShdBufferEndIdxOfRxAccessInfoType 0 0 0 255 ECU_ADDRESS 0x0 /end MEASUREMENT
/begin MEASUREMENT Com_RxAccessInfo[83].RxSigBufferArrayBasedShdBufferStartIdxOfRxAccessInfo "" UBYTE Com_RxSigBufferArrayBasedShdBufferStartIdxOfRxAccessInfoType 0 0 0 255 ECU_ADDRESS 0x0 /end MEASUREMENT
/begin MEASUREMENT Com_RxAccessInfo[83].RxTOutInfoIdxOfRxAccessInfo "" UBYTE Com_RxTOutInfoIdxOfRxAccessInfoType 0 0 0 255 ECU_ADDRESS 0x0 /end MEASUREMENT
/begin MEASUREMENT Com_RxAccessInfo[83].ShdBufferIdxOfRxAccessInfo "" UWORD Com_ShdBufferIdxOfRxAccessInfoType 0 0 0 65535 ECU_ADDRESS 0x0 /end MEASUREMENT
/begin MEASUREMENT Com_RxAccessInfo[83].SignalLengthInByteOfRxAccessInfo "" UBYTE NO_COMPU_METHOD 0 0 0 255 ECU_ADDRESS 0x0 /end MEASUREMENT
/begin MEASUREMENT Com_RxAccessInfo[83].StartByteInPduPositionOfRxAccessInfo "" UBYTE NO_COMPU_METHOD 0 0 0 255 ECU_ADDRESS 0x0 /end MEASUREMENT
/begin MEASUREMENT Com_RxAccessInfo[83].TmpBufferIdxOfRxAccessInfo "" UBYTE Com_TmpBufferIdxOfRxAccessInfoType 0 0 0 255 ECU_ADDRESS 0x0 /end MEASUREMENT
/begin MEASUREMENT Com_RxAccessInfo[83].TmpBufferOfRxAccessInfo "" UBYTE Com_TmpBufferOfRxAccessInfoType 0 0 0 255 ECU_ADDRESS 0x0 /end MEASUREMENT
/begin MEASUREMENT Com_RxAccessInfo[83].TmpRxShdBufferArrayBasedTmpBufferEndIdxOfRxAccessInfo "" UBYTE Com_TmpRxShdBufferArrayBasedTmpBufferEndIdxOfRxAccessInfoType 0 0 0 255 ECU_ADDRESS 0x0 /end MEASUREMENT
/begin MEASUREMENT Com_RxAccessInfo[83].TmpRxShdBufferArrayBasedTmpBufferStartIdxOfRxAccessInfo "" UBYTE Com_TmpRxShdBufferArrayBasedTmpBufferStartIdxOfRxAccessInfoType 0 0 0 255 ECU_ADDRESS 0x0 /end MEASUREMENT
/begin MEASUREMENT Com_RxAccessInfo[84].ApplTypeOfRxAccessInfo "" UBYTE Com_ApplTypeOfRxAccessInfoType 0 0 0 255 ECU_ADDRESS 0x0 /end MEASUREMENT
/begin MEASUREMENT Com_RxAccessInfo[84].BitLengthOfRxAccessInfo "" UWORD NO_COMPU_METHOD 0 0 0 65535 ECU_ADDRESS 0x0 /end MEASUREMENT
/begin MEASUREMENT Com_RxAccessInfo[84].BitPositionOfRxAccessInfo "" UWORD NO_COMPU_METHOD 0 0 0 65535 ECU_ADDRESS 0x0 /end MEASUREMENT
/begin MEASUREMENT Com_RxAccessInfo[84].BufferIdxOfRxAccessInfo "" UWORD Com_BufferIdxOfRxAccessInfoType 0 0 0 65535 ECU_ADDRESS 0x0 /end MEASUREMENT
/begin MEASUREMENT Com_RxAccessInfo[84].BusAccOfRxAccessInfo "" UBYTE Com_BusAccOfRxAccessInfoType 0 0 0 255 ECU_ADDRESS 0x0 /end MEASUREMENT
/begin MEASUREMENT Com_RxAccessInfo[84].ByteLengthOfRxAccessInfo "" UBYTE NO_COMPU_METHOD 0 0 0 255 ECU_ADDRESS 0x0 /end MEASUREMENT
/begin MEASUREMENT Com_RxAccessInfo[84].ConstValueArrayBasedInitValueEndIdxOfRxAccessInfo "" UBYTE Com_ConstValueArrayBasedInitValueEndIdxOfRxAccessInfoType 0 0 0 255 ECU_ADDRESS 0x0 /end MEASUREMENT
/begin MEASUREMENT Com_RxAccessInfo[84].ConstValueArrayBasedInitValueStartIdxOfRxAccessInfo "" UBYTE Com_ConstValueArrayBasedInitValueStartIdxOfRxAccessInfoType 0 0 0 255 ECU_ADDRESS 0x0 /end MEASUREMENT
/begin MEASUREMENT Com_RxAccessInfo[84].DynSignalOfRxAccessInfo "" UBYTE Com_DynSignalOfRxAccessInfoType 0 0 0 1 ECU_ADDRESS 0x0 /end MEASUREMENT
/begin MEASUREMENT Com_RxAccessInfo[84].InitValueIdxOfRxAccessInfo "" UBYTE Com_InitValueIdxOfRxAccessInfoType 0 0 0 255 ECU_ADDRESS 0x0 /end MEASUREMENT
/begin MEASUREMENT Com_RxAccessInfo[84].InitValueOfRxAccessInfo "" UBYTE Com_InitValueOfRxAccessInfoType 0 0 0 255 ECU_ADDRESS 0x0 /end MEASUREMENT
/begin MEASUREMENT Com_RxAccessInfo[84].InvValueIdxOfRxAccessInfo "" UBYTE Com_InvValueIdxOfRxAccessInfoType 0 0 0 255 ECU_ADDRESS 0x0 /end MEASUREMENT
/begin MEASUREMENT Com_RxAccessInfo[84].InvValueOfRxAccessInfo "" UBYTE Com_InvValueOfRxAccessInfoType 0 0 0 255 ECU_ADDRESS 0x0 /end MEASUREMENT
/begin MEASUREMENT Com_RxAccessInfo[84].IsGroupSignalOfRxAccessInfo "" UBYTE Com_IsGroupSignalOfRxAccessInfoType 0 0 0 1 ECU_ADDRESS 0x0 /end MEASUREMENT
/begin MEASUREMENT Com_RxAccessInfo[84].RxDataTimeoutSubstitutionValueIdxOfRxAccessInfo "" UBYTE Com_RxDataTimeoutSubstitutionValueIdxOfRxAccessInfoType 0 0 0 255 ECU_ADDRESS 0x0 /end MEASUREMENT
/begin MEASUREMENT Com_RxAccessInfo[84].RxDataTimeoutSubstitutionValueOfRxAccessInfo "" UBYTE Com_RxDataTimeoutSubstitutionValueOfRxAccessInfoType 0 0 0 255 ECU_ADDRESS 0x0 /end MEASUREMENT
/begin MEASUREMENT Com_RxAccessInfo[84].RxPduInfoIdxOfRxAccessInfo "" UBYTE NO_COMPU_METHOD 0 0 0 255 ECU_ADDRESS 0x0 /end MEASUREMENT
/begin MEASUREMENT Com_RxAccessInfo[84].RxSigBufferArrayBasedBufferEndIdxOfRxAccessInfo "" UBYTE Com_RxSigBufferArrayBasedBufferEndIdxOfRxAccessInfoType 0 0 0 255 ECU_ADDRESS 0x0 /end MEASUREMENT
/begin MEASUREMENT Com_RxAccessInfo[84].RxSigBufferArrayBasedBufferStartIdxOfRxAccessInfo "" UBYTE Com_RxSigBufferArrayBasedBufferStartIdxOfRxAccessInfoType 0 0 0 255 ECU_ADDRESS 0x0 /end MEASUREMENT
/begin MEASUREMENT Com_RxAccessInfo[84].RxSigBufferArrayBasedShdBufferEndIdxOfRxAccessInfo "" UBYTE Com_RxSigBufferArrayBasedShdBufferEndIdxOfRxAccessInfoType 0 0 0 255 ECU_ADDRESS 0x0 /end MEASUREMENT
/begin MEASUREMENT Com_RxAccessInfo[84].RxSigBufferArrayBasedShdBufferStartIdxOfRxAccessInfo "" UBYTE Com_RxSigBufferArrayBasedShdBufferStartIdxOfRxAccessInfoType 0 0 0 255 ECU_ADDRESS 0x0 /end MEASUREMENT
/begin MEASUREMENT Com_RxAccessInfo[84].RxTOutInfoIdxOfRxAccessInfo "" UBYTE Com_RxTOutInfoIdxOfRxAccessInfoType 0 0 0 255 ECU_ADDRESS 0x0 /end MEASUREMENT
/begin MEASUREMENT Com_RxAccessInfo[84].ShdBufferIdxOfRxAccessInfo "" UWORD Com_ShdBufferIdxOfRxAccessInfoType 0 0 0 65535 ECU_ADDRESS 0x0 /end MEASUREMENT
/begin MEASUREMENT Com_RxAccessInfo[84].SignalLengthInByteOfRxAccessInfo "" UBYTE NO_COMPU_METHOD 0 0 0 255 ECU_ADDRESS 0x0 /end MEASUREMENT
/begin MEASUREMENT Com_RxAccessInfo[84].StartByteInPduPositionOfRxAccessInfo "" UBYTE NO_COMPU_METHOD 0 0 0 255 ECU_ADDRESS 0x0 /end MEASUREMENT
/begin MEASUREMENT Com_RxAccessInfo[84].TmpBufferIdxOfRxAccessInfo "" UBYTE Com_TmpBufferIdxOfRxAccessInfoType 0 0 0 255 ECU_ADDRESS 0x0 /end MEASUREMENT
/begin MEASUREMENT Com_RxAccessInfo[84].TmpBufferOfRxAccessInfo "" UBYTE Com_TmpBufferOfRxAccessInfoType 0 0 0 255 ECU_ADDRESS 0x0 /end MEASUREMENT
/begin MEASUREMENT Com_RxAccessInfo[84].TmpRxShdBufferArrayBasedTmpBufferEndIdxOfRxAccessInfo "" UBYTE Com_TmpRxShdBufferArrayBasedTmpBufferEndIdxOfRxAccessInfoType 0 0 0 255 ECU_ADDRESS 0x0 /end MEASUREMENT
/begin MEASUREMENT Com_RxAccessInfo[84].TmpRxShdBufferArrayBasedTmpBufferStartIdxOfRxAccessInfo "" UBYTE Com_TmpRxShdBufferArrayBasedTmpBufferStartIdxOfRxAccessInfoType 0 0 0 255 ECU_ADDRESS 0x0 /end MEASUREMENT
/begin MEASUREMENT Com_RxAccessInfo[85].ApplTypeOfRxAccessInfo "" UBYTE Com_ApplTypeOfRxAccessInfoType 0 0 0 255 ECU_ADDRESS 0x0 /end MEASUREMENT
/begin MEASUREMENT Com_RxAccessInfo[85].BitLengthOfRxAccessInfo "" UWORD NO_COMPU_METHOD 0 0 0 65535 ECU_ADDRESS 0x0 /end MEASUREMENT
/begin MEASUREMENT Com_RxAccessInfo[85].BitPositionOfRxAccessInfo "" UWORD NO_COMPU_METHOD 0 0 0 65535 ECU_ADDRESS 0x0 /end MEASUREMENT
/begin MEASUREMENT Com_RxAccessInfo[85].BufferIdxOfRxAccessInfo "" UWORD Com_BufferIdxOfRxAccessInfoType 0 0 0 65535 ECU_ADDRESS 0x0 /end MEASUREMENT
/begin MEASUREMENT Com_RxAccessInfo[85].BusAccOfRxAccessInfo "" UBYTE Com_BusAccOfRxAccessInfoType 0 0 0 255 ECU_ADDRESS 0x0 /end MEASUREMENT
/begin MEASUREMENT Com_RxAccessInfo[85].ByteLengthOfRxAccessInfo "" UBYTE NO_COMPU_METHOD 0 0 0 255 ECU_ADDRESS 0x0 /end MEASUREMENT
/begin MEASUREMENT Com_RxAccessInfo[85].ConstValueArrayBasedInitValueEndIdxOfRxAccessInfo "" UBYTE Com_ConstValueArrayBasedInitValueEndIdxOfRxAccessInfoType 0 0 0 255 ECU_ADDRESS 0x0 /end MEASUREMENT
/begin MEASUREMENT Com_RxAccessInfo[85].ConstValueArrayBasedInitValueStartIdxOfRxAccessInfo "" UBYTE Com_ConstValueArrayBasedInitValueStartIdxOfRxAccessInfoType 0 0 0 255 ECU_ADDRESS 0x0 /end MEASUREMENT
/begin MEASUREMENT Com_RxAccessInfo[85].DynSignalOfRxAccessInfo "" UBYTE Com_DynSignalOfRxAccessInfoType 0 0 0 1 ECU_ADDRESS 0x0 /end MEASUREMENT
/begin MEASUREMENT Com_RxAccessInfo[85].InitValueIdxOfRxAccessInfo "" UBYTE Com_InitValueIdxOfRxAccessInfoType 0 0 0 255 ECU_ADDRESS 0x0 /end MEASUREMENT
/begin MEASUREMENT Com_RxAccessInfo[85].InitValueOfRxAccessInfo "" UBYTE Com_InitValueOfRxAccessInfoType 0 0 0 255 ECU_ADDRESS 0x0 /end MEASUREMENT
/begin MEASUREMENT Com_RxAccessInfo[85].InvValueIdxOfRxAccessInfo "" UBYTE Com_InvValueIdxOfRxAccessInfoType 0 0 0 255 ECU_ADDRESS 0x0 /end MEASUREMENT
/begin MEASUREMENT Com_RxAccessInfo[85].InvValueOfRxAccessInfo "" UBYTE Com_InvValueOfRxAccessInfoType 0 0 0 255 ECU_ADDRESS 0x0 /end MEASUREMENT
/begin MEASUREMENT Com_RxAccessInfo[85].IsGroupSignalOfRxAccessInfo "" UBYTE Com_IsGroupSignalOfRxAccessInfoType 0 0 0 1 ECU_ADDRESS 0x0 /end MEASUREMENT
/begin MEASUREMENT Com_RxAccessInfo[85].RxDataTimeoutSubstitutionValueIdxOfRxAccessInfo "" UBYTE Com_RxDataTimeoutSubstitutionValueIdxOfRxAccessInfoType 0 0 0 255 ECU_ADDRESS 0x0 /end MEASUREMENT
/begin MEASUREMENT Com_RxAccessInfo[85].RxDataTimeoutSubstitutionValueOfRxAccessInfo "" UBYTE Com_RxDataTimeoutSubstitutionValueOfRxAccessInfoType 0 0 0 255 ECU_ADDRESS 0x0 /end MEASUREMENT
/begin MEASUREMENT Com_RxAccessInfo[85].RxPduInfoIdxOfRxAccessInfo "" UBYTE NO_COMPU_METHOD 0 0 0 255 ECU_ADDRESS 0x0 /end MEASUREMENT
/begin MEASUREMENT Com_RxAccessInfo[85].RxSigBufferArrayBasedBufferEndIdxOfRxAccessInfo "" UBYTE Com_RxSigBufferArrayBasedBufferEndIdxOfRxAccessInfoType 0 0 0 255 ECU_ADDRESS 0x0 /end MEASUREMENT
/begin MEASUREMENT Com_RxAccessInfo[85].RxSigBufferArrayBasedBufferStartIdxOfRxAccessInfo "" UBYTE Com_RxSigBufferArrayBasedBufferStartIdxOfRxAccessInfoType 0 0 0 255 ECU_ADDRESS 0x0 /end MEASUREMENT
/begin MEASUREMENT Com_RxAccessInfo[85].RxSigBufferArrayBasedShdBufferEndIdxOfRxAccessInfo "" UBYTE Com_RxSigBufferArrayBasedShdBufferEndIdxOfRxAccessInfoType 0 0 0 255 ECU_ADDRESS 0x0 /end MEASUREMENT
/begin MEASUREMENT Com_RxAccessInfo[85].RxSigBufferArrayBasedShdBufferStartIdxOfRxAccessInfo "" UBYTE Com_RxSigBufferArrayBasedShdBufferStartIdxOfRxAccessInfoType 0 0 0 255 ECU_ADDRESS 0x0 /end MEASUREMENT
/begin MEASUREMENT Com_RxAccessInfo[85].RxTOutInfoIdxOfRxAccessInfo "" UBYTE Com_RxTOutInfoIdxOfRxAccessInfoType 0 0 0 255 ECU_ADDRESS 0x0 /end MEASUREMENT
/begin MEASUREMENT Com_RxAccessInfo[85].ShdBufferIdxOfRxAccessInfo "" UWORD Com_ShdBufferIdxOfRxAccessInfoType 0 0 0 65535 ECU_ADDRESS 0x0 /end MEASUREMENT
/begin MEASUREMENT Com_RxAccessInfo[85].SignalLengthInByteOfRxAccessInfo "" UBYTE NO_COMPU_METHOD 0 0 0 255 ECU_ADDRESS 0x0 /end MEASUREMENT
/begin MEASUREMENT Com_RxAccessInfo[85].StartByteInPduPositionOfRxAccessInfo "" UBYTE NO_COMPU_METHOD 0 0 0 255 ECU_ADDRESS 0x0 /end MEASUREMENT
/begin MEASUREMENT Com_RxAccessInfo[85].TmpBufferIdxOfRxAccessInfo "" UBYTE Com_TmpBufferIdxOfRxAccessInfoType 0 0 0 255 ECU_ADDRESS 0x0 /end MEASUREMENT
/begin MEASUREMENT Com_RxAccessInfo[85].TmpBufferOfRxAccessInfo "" UBYTE Com_TmpBufferOfRxAccessInfoType 0 0 0 255 ECU_ADDRESS 0x0 /end MEASUREMENT
/begin MEASUREMENT Com_RxAccessInfo[85].TmpRxShdBufferArrayBasedTmpBufferEndIdxOfRxAccessInfo "" UBYTE Com_TmpRxShdBufferArrayBasedTmpBufferEndIdxOfRxAccessInfoType 0 0 0 255 ECU_ADDRESS 0x0 /end MEASUREMENT
/begin MEASUREMENT Com_RxAccessInfo[85].TmpRxShdBufferArrayBasedTmpBufferStartIdxOfRxAccessInfo "" UBYTE Com_TmpRxShdBufferArrayBasedTmpBufferStartIdxOfRxAccessInfoType 0 0 0 255 ECU_ADDRESS 0x0 /end MEASUREMENT
/begin MEASUREMENT Com_RxAccessInfo[86].ApplTypeOfRxAccessInfo "" UBYTE Com_ApplTypeOfRxAccessInfoType 0 0 0 255 ECU_ADDRESS 0x0 /end MEASUREMENT
/begin MEASUREMENT Com_RxAccessInfo[86].BitLengthOfRxAccessInfo "" UWORD NO_COMPU_METHOD 0 0 0 65535 ECU_ADDRESS 0x0 /end MEASUREMENT
/begin MEASUREMENT Com_RxAccessInfo[86].BitPositionOfRxAccessInfo "" UWORD NO_COMPU_METHOD 0 0 0 65535 ECU_ADDRESS 0x0 /end MEASUREMENT
/begin MEASUREMENT Com_RxAccessInfo[86].BufferIdxOfRxAccessInfo "" UWORD Com_BufferIdxOfRxAccessInfoType 0 0 0 65535 ECU_ADDRESS 0x0 /end MEASUREMENT
/begin MEASUREMENT Com_RxAccessInfo[86].BusAccOfRxAccessInfo "" UBYTE Com_BusAccOfRxAccessInfoType 0 0 0 255 ECU_ADDRESS 0x0 /end MEASUREMENT
/begin MEASUREMENT Com_RxAccessInfo[86].ByteLengthOfRxAccessInfo "" UBYTE NO_COMPU_METHOD 0 0 0 255 ECU_ADDRESS 0x0 /end MEASUREMENT
/begin MEASUREMENT Com_RxAccessInfo[86].ConstValueArrayBasedInitValueEndIdxOfRxAccessInfo "" UBYTE Com_ConstValueArrayBasedInitValueEndIdxOfRxAccessInfoType 0 0 0 255 ECU_ADDRESS 0x0 /end MEASUREMENT
/begin MEASUREMENT Com_RxAccessInfo[86].ConstValueArrayBasedInitValueStartIdxOfRxAccessInfo "" UBYTE Com_ConstValueArrayBasedInitValueStartIdxOfRxAccessInfoType 0 0 0 255 ECU_ADDRESS 0x0 /end MEASUREMENT
/begin MEASUREMENT Com_RxAccessInfo[86].DynSignalOfRxAccessInfo "" UBYTE Com_DynSignalOfRxAccessInfoType 0 0 0 1 ECU_ADDRESS 0x0 /end MEASUREMENT
/begin MEASUREMENT Com_RxAccessInfo[86].InitValueIdxOfRxAccessInfo "" UBYTE Com_InitValueIdxOfRxAccessInfoType 0 0 0 255 ECU_ADDRESS 0x0 /end MEASUREMENT
/begin MEASUREMENT Com_RxAccessInfo[86].InitValueOfRxAccessInfo "" UBYTE Com_InitValueOfRxAccessInfoType 0 0 0 255 ECU_ADDRESS 0x0 /end MEASUREMENT
/begin MEASUREMENT Com_RxAccessInfo[86].InvValueIdxOfRxAccessInfo "" UBYTE Com_InvValueIdxOfRxAccessInfoType 0 0 0 255 ECU_ADDRESS 0x0 /end MEASUREMENT
/begin MEASUREMENT Com_RxAccessInfo[86].InvValueOfRxAccessInfo "" UBYTE Com_InvValueOfRxAccessInfoType 0 0 0 255 ECU_ADDRESS 0x0 /end MEASUREMENT
/begin MEASUREMENT Com_RxAccessInfo[86].IsGroupSignalOfRxAccessInfo "" UBYTE Com_IsGroupSignalOfRxAccessInfoType 0 0 0 1 ECU_ADDRESS 0x0 /end MEASUREMENT
/begin MEASUREMENT Com_RxAccessInfo[86].RxDataTimeoutSubstitutionValueIdxOfRxAccessInfo "" UBYTE Com_RxDataTimeoutSubstitutionValueIdxOfRxAccessInfoType 0 0 0 255 ECU_ADDRESS 0x0 /end MEASUREMENT
/begin MEASUREMENT Com_RxAccessInfo[86].RxDataTimeoutSubstitutionValueOfRxAccessInfo "" UBYTE Com_RxDataTimeoutSubstitutionValueOfRxAccessInfoType 0 0 0 255 ECU_ADDRESS 0x0 /end MEASUREMENT
/begin MEASUREMENT Com_RxAccessInfo[86].RxPduInfoIdxOfRxAccessInfo "" UBYTE NO_COMPU_METHOD 0 0 0 255 ECU_ADDRESS 0x0 /end MEASUREMENT
/begin MEASUREMENT Com_RxAccessInfo[86].RxSigBufferArrayBasedBufferEndIdxOfRxAccessInfo "" UBYTE Com_RxSigBufferArrayBasedBufferEndIdxOfRxAccessInfoType 0 0 0 255 ECU_ADDRESS 0x0 /end MEASUREMENT
/begin MEASUREMENT Com_RxAccessInfo[86].RxSigBufferArrayBasedBufferStartIdxOfRxAccessInfo "" UBYTE Com_RxSigBufferArrayBasedBufferStartIdxOfRxAccessInfoType 0 0 0 255 ECU_ADDRESS 0x0 /end MEASUREMENT
/begin MEASUREMENT Com_RxAccessInfo[86].RxSigBufferArrayBasedShdBufferEndIdxOfRxAccessInfo "" UBYTE Com_RxSigBufferArrayBasedShdBufferEndIdxOfRxAccessInfoType 0 0 0 255 ECU_ADDRESS 0x0 /end MEASUREMENT
/begin MEASUREMENT Com_RxAccessInfo[86].RxSigBufferArrayBasedShdBufferStartIdxOfRxAccessInfo "" UBYTE Com_RxSigBufferArrayBasedShdBufferStartIdxOfRxAccessInfoType 0 0 0 255 ECU_ADDRESS 0x0 /end MEASUREMENT
/begin MEASUREMENT Com_RxAccessInfo[86].RxTOutInfoIdxOfRxAccessInfo "" UBYTE Com_RxTOutInfoIdxOfRxAccessInfoType 0 0 0 255 ECU_ADDRESS 0x0 /end MEASUREMENT
/begin MEASUREMENT Com_RxAccessInfo[86].ShdBufferIdxOfRxAccessInfo "" UWORD Com_ShdBufferIdxOfRxAccessInfoType 0 0 0 65535 ECU_ADDRESS 0x0 /end MEASUREMENT
/begin MEASUREMENT Com_RxAccessInfo[86].SignalLengthInByteOfRxAccessInfo "" UBYTE NO_COMPU_METHOD 0 0 0 255 ECU_ADDRESS 0x0 /end MEASUREMENT
/begin MEASUREMENT Com_RxAccessInfo[86].StartByteInPduPositionOfRxAccessInfo "" UBYTE NO_COMPU_METHOD 0 0 0 255 ECU_ADDRESS 0x0 /end MEASUREMENT
/begin MEASUREMENT Com_RxAccessInfo[86].TmpBufferIdxOfRxAccessInfo "" UBYTE Com_TmpBufferIdxOfRxAccessInfoType 0 0 0 255 ECU_ADDRESS 0x0 /end MEASUREMENT
/begin MEASUREMENT Com_RxAccessInfo[86].TmpBufferOfRxAccessInfo "" UBYTE Com_TmpBufferOfRxAccessInfoType 0 0 0 255 ECU_ADDRESS 0x0 /end MEASUREMENT
/begin MEASUREMENT Com_RxAccessInfo[86].TmpRxShdBufferArrayBasedTmpBufferEndIdxOfRxAccessInfo "" UBYTE Com_TmpRxShdBufferArrayBasedTmpBufferEndIdxOfRxAccessInfoType 0 0 0 255 ECU_ADDRESS 0x0 /end MEASUREMENT
/begin MEASUREMENT Com_RxAccessInfo[86].TmpRxShdBufferArrayBasedTmpBufferStartIdxOfRxAccessInfo "" UBYTE Com_TmpRxShdBufferArrayBasedTmpBufferStartIdxOfRxAccessInfoType 0 0 0 255 ECU_ADDRESS 0x0 /end MEASUREMENT
/begin MEASUREMENT Com_RxAccessInfo[87].ApplTypeOfRxAccessInfo "" UBYTE Com_ApplTypeOfRxAccessInfoType 0 0 0 255 ECU_ADDRESS 0x0 /end MEASUREMENT
/begin MEASUREMENT Com_RxAccessInfo[87].BitLengthOfRxAccessInfo "" UWORD NO_COMPU_METHOD 0 0 0 65535 ECU_ADDRESS 0x0 /end MEASUREMENT
/begin MEASUREMENT Com_RxAccessInfo[87].BitPositionOfRxAccessInfo "" UWORD NO_COMPU_METHOD 0 0 0 65535 ECU_ADDRESS 0x0 /end MEASUREMENT
/begin MEASUREMENT Com_RxAccessInfo[87].BufferIdxOfRxAccessInfo "" UWORD Com_BufferIdxOfRxAccessInfoType 0 0 0 65535 ECU_ADDRESS 0x0 /end MEASUREMENT
/begin MEASUREMENT Com_RxAccessInfo[87].BusAccOfRxAccessInfo "" UBYTE Com_BusAccOfRxAccessInfoType 0 0 0 255 ECU_ADDRESS 0x0 /end MEASUREMENT
/begin MEASUREMENT Com_RxAccessInfo[87].ByteLengthOfRxAccessInfo "" UBYTE NO_COMPU_METHOD 0 0 0 255 ECU_ADDRESS 0x0 /end MEASUREMENT
/begin MEASUREMENT Com_RxAccessInfo[87].ConstValueArrayBasedInitValueEndIdxOfRxAccessInfo "" UBYTE Com_ConstValueArrayBasedInitValueEndIdxOfRxAccessInfoType 0 0 0 255 ECU_ADDRESS 0x0 /end MEASUREMENT
/begin MEASUREMENT Com_RxAccessInfo[87].ConstValueArrayBasedInitValueStartIdxOfRxAccessInfo "" UBYTE Com_ConstValueArrayBasedInitValueStartIdxOfRxAccessInfoType 0 0 0 255 ECU_ADDRESS 0x0 /end MEASUREMENT
/begin MEASUREMENT Com_RxAccessInfo[87].DynSignalOfRxAccessInfo "" UBYTE Com_DynSignalOfRxAccessInfoType 0 0 0 1 ECU_ADDRESS 0x0 /end MEASUREMENT
/begin MEASUREMENT Com_RxAccessInfo[87].InitValueIdxOfRxAccessInfo "" UBYTE Com_InitValueIdxOfRxAccessInfoType 0 0 0 255 ECU_ADDRESS 0x0 /end MEASUREMENT
/begin MEASUREMENT Com_RxAccessInfo[87].InitValueOfRxAccessInfo "" UBYTE Com_InitValueOfRxAccessInfoType 0 0 0 255 ECU_ADDRESS 0x0 /end MEASUREMENT
/begin MEASUREMENT Com_RxAccessInfo[87].InvValueIdxOfRxAccessInfo "" UBYTE Com_InvValueIdxOfRxAccessInfoType 0 0 0 255 ECU_ADDRESS 0x0 /end MEASUREMENT
/begin MEASUREMENT Com_RxAccessInfo[87].InvValueOfRxAccessInfo "" UBYTE Com_InvValueOfRxAccessInfoType 0 0 0 255 ECU_ADDRESS 0x0 /end MEASUREMENT
/begin MEASUREMENT Com_RxAccessInfo[87].IsGroupSignalOfRxAccessInfo "" UBYTE Com_IsGroupSignalOfRxAccessInfoType 0 0 0 1 ECU_ADDRESS 0x0 /end MEASUREMENT
/begin MEASUREMENT Com_RxAccessInfo[87].RxDataTimeoutSubstitutionValueIdxOfRxAccessInfo "" UBYTE Com_RxDataTimeoutSubstitutionValueIdxOfRxAccessInfoType 0 0 0 255 ECU_ADDRESS 0x0 /end MEASUREMENT
/begin MEASUREMENT Com_RxAccessInfo[87].RxDataTimeoutSubstitutionValueOfRxAccessInfo "" UBYTE Com_RxDataTimeoutSubstitutionValueOfRxAccessInfoType 0 0 0 255 ECU_ADDRESS 0x0 /end MEASUREMENT
/begin MEASUREMENT Com_RxAccessInfo[87].RxPduInfoIdxOfRxAccessInfo "" UBYTE NO_COMPU_METHOD 0 0 0 255 ECU_ADDRESS 0x0 /end MEASUREMENT
/begin MEASUREMENT Com_RxAccessInfo[87].RxSigBufferArrayBasedBufferEndIdxOfRxAccessInfo "" UBYTE Com_RxSigBufferArrayBasedBufferEndIdxOfRxAccessInfoType 0 0 0 255 ECU_ADDRESS 0x0 /end MEASUREMENT
/begin MEASUREMENT Com_RxAccessInfo[87].RxSigBufferArrayBasedBufferStartIdxOfRxAccessInfo "" UBYTE Com_RxSigBufferArrayBasedBufferStartIdxOfRxAccessInfoType 0 0 0 255 ECU_ADDRESS 0x0 /end MEASUREMENT
/begin MEASUREMENT Com_RxAccessInfo[87].RxSigBufferArrayBasedShdBufferEndIdxOfRxAccessInfo "" UBYTE Com_RxSigBufferArrayBasedShdBufferEndIdxOfRxAccessInfoType 0 0 0 255 ECU_ADDRESS 0x0 /end MEASUREMENT
/begin MEASUREMENT Com_RxAccessInfo[87].RxSigBufferArrayBasedShdBufferStartIdxOfRxAccessInfo "" UBYTE Com_RxSigBufferArrayBasedShdBufferStartIdxOfRxAccessInfoType 0 0 0 255 ECU_ADDRESS 0x0 /end MEASUREMENT
/begin MEASUREMENT Com_RxAccessInfo[87].RxTOutInfoIdxOfRxAccessInfo "" UBYTE Com_RxTOutInfoIdxOfRxAccessInfoType 0 0 0 255 ECU_ADDRESS 0x0 /end MEASUREMENT
/begin MEASUREMENT Com_RxAccessInfo[87].ShdBufferIdxOfRxAccessInfo "" UWORD Com_ShdBufferIdxOfRxAccessInfoType 0 0 0 65535 ECU_ADDRESS 0x0 /end MEASUREMENT
/begin MEASUREMENT Com_RxAccessInfo[87].SignalLengthInByteOfRxAccessInfo "" UBYTE NO_COMPU_METHOD 0 0 0 255 ECU_ADDRESS 0x0 /end MEASUREMENT
/begin MEASUREMENT Com_RxAccessInfo[87].StartByteInPduPositionOfRxAccessInfo "" UBYTE NO_COMPU_METHOD 0 0 0 255 ECU_ADDRESS 0x0 /end MEASUREMENT
/begin MEASUREMENT Com_RxAccessInfo[87].TmpBufferIdxOfRxAccessInfo "" UBYTE Com_TmpBufferIdxOfRxAccessInfoType 0 0 0 255 ECU_ADDRESS 0x0 /end MEASUREMENT
/begin MEASUREMENT Com_RxAccessInfo[87].TmpBufferOfRxAccessInfo "" UBYTE Com_TmpBufferOfRxAccessInfoType 0 0 0 255 ECU_ADDRESS 0x0 /end MEASUREMENT
/begin MEASUREMENT Com_RxAccessInfo[87].TmpRxShdBufferArrayBasedTmpBufferEndIdxOfRxAccessInfo "" UBYTE Com_TmpRxShdBufferArrayBasedTmpBufferEndIdxOfRxAccessInfoType 0 0 0 255 ECU_ADDRESS 0x0 /end MEASUREMENT
/begin MEASUREMENT Com_RxAccessInfo[87].TmpRxShdBufferArrayBasedTmpBufferStartIdxOfRxAccessInfo "" UBYTE Com_TmpRxShdBufferArrayBasedTmpBufferStartIdxOfRxAccessInfoType 0 0 0 255 ECU_ADDRESS 0x0 /end MEASUREMENT
/begin MEASUREMENT Com_RxAccessInfo[88].ApplTypeOfRxAccessInfo "" UBYTE Com_ApplTypeOfRxAccessInfoType 0 0 0 255 ECU_ADDRESS 0x0 /end MEASUREMENT
/begin MEASUREMENT Com_RxAccessInfo[88].BitLengthOfRxAccessInfo "" UWORD NO_COMPU_METHOD 0 0 0 65535 ECU_ADDRESS 0x0 /end MEASUREMENT
/begin MEASUREMENT Com_RxAccessInfo[88].BitPositionOfRxAccessInfo "" UWORD NO_COMPU_METHOD 0 0 0 65535 ECU_ADDRESS 0x0 /end MEASUREMENT
/begin MEASUREMENT Com_RxAccessInfo[88].BufferIdxOfRxAccessInfo "" UWORD Com_BufferIdxOfRxAccessInfoType 0 0 0 65535 ECU_ADDRESS 0x0 /end MEASUREMENT
/begin MEASUREMENT Com_RxAccessInfo[88].BusAccOfRxAccessInfo "" UBYTE Com_BusAccOfRxAccessInfoType 0 0 0 255 ECU_ADDRESS 0x0 /end MEASUREMENT
/begin MEASUREMENT Com_RxAccessInfo[88].ByteLengthOfRxAccessInfo "" UBYTE NO_COMPU_METHOD 0 0 0 255 ECU_ADDRESS 0x0 /end MEASUREMENT
/begin MEASUREMENT Com_RxAccessInfo[88].ConstValueArrayBasedInitValueEndIdxOfRxAccessInfo "" UBYTE Com_ConstValueArrayBasedInitValueEndIdxOfRxAccessInfoType 0 0 0 255 ECU_ADDRESS 0x0 /end MEASUREMENT
/begin MEASUREMENT Com_RxAccessInfo[88].ConstValueArrayBasedInitValueStartIdxOfRxAccessInfo "" UBYTE Com_ConstValueArrayBasedInitValueStartIdxOfRxAccessInfoType 0 0 0 255 ECU_ADDRESS 0x0 /end MEASUREMENT
/begin MEASUREMENT Com_RxAccessInfo[88].DynSignalOfRxAccessInfo "" UBYTE Com_DynSignalOfRxAccessInfoType 0 0 0 1 ECU_ADDRESS 0x0 /end MEASUREMENT
/begin MEASUREMENT Com_RxAccessInfo[88].InitValueIdxOfRxAccessInfo "" UBYTE Com_InitValueIdxOfRxAccessInfoType 0 0 0 255 ECU_ADDRESS 0x0 /end MEASUREMENT
/begin MEASUREMENT Com_RxAccessInfo[88].InitValueOfRxAccessInfo "" UBYTE Com_InitValueOfRxAccessInfoType 0 0 0 255 ECU_ADDRESS 0x0 /end MEASUREMENT
/begin MEASUREMENT Com_RxAccessInfo[88].InvValueIdxOfRxAccessInfo "" UBYTE Com_InvValueIdxOfRxAccessInfoType 0 0 0 255 ECU_ADDRESS 0x0 /end MEASUREMENT
/begin MEASUREMENT Com_RxAccessInfo[88].InvValueOfRxAccessInfo "" UBYTE Com_InvValueOfRxAccessInfoType 0 0 0 255 ECU_ADDRESS 0x0 /end MEASUREMENT
/begin MEASUREMENT Com_RxAccessInfo[88].IsGroupSignalOfRxAccessInfo "" UBYTE Com_IsGroupSignalOfRxAccessInfoType 0 0 0 1 ECU_ADDRESS 0x0 /end MEASUREMENT
/begin MEASUREMENT Com_RxAccessInfo[88].RxDataTimeoutSubstitutionValueIdxOfRxAccessInfo "" UBYTE Com_RxDataTimeoutSubstitutionValueIdxOfRxAccessInfoType 0 0 0 255 ECU_ADDRESS 0x0 /end MEASUREMENT
/begin MEASUREMENT Com_RxAccessInfo[88].RxDataTimeoutSubstitutionValueOfRxAccessInfo "" UBYTE Com_RxDataTimeoutSubstitutionValueOfRxAccessInfoType 0 0 0 255 ECU_ADDRESS 0x0 /end MEASUREMENT
/begin MEASUREMENT Com_RxAccessInfo[88].RxPduInfoIdxOfRxAccessInfo "" UBYTE NO_COMPU_METHOD 0 0 0 255 ECU_ADDRESS 0x0 /end MEASUREMENT
/begin MEASUREMENT Com_RxAccessInfo[88].RxSigBufferArrayBasedBufferEndIdxOfRxAccessInfo "" UBYTE Com_RxSigBufferArrayBasedBufferEndIdxOfRxAccessInfoType 0 0 0 255 ECU_ADDRESS 0x0 /end MEASUREMENT
/begin MEASUREMENT Com_RxAccessInfo[88].RxSigBufferArrayBasedBufferStartIdxOfRxAccessInfo "" UBYTE Com_RxSigBufferArrayBasedBufferStartIdxOfRxAccessInfoType 0 0 0 255 ECU_ADDRESS 0x0 /end MEASUREMENT
/begin MEASUREMENT Com_RxAccessInfo[88].RxSigBufferArrayBasedShdBufferEndIdxOfRxAccessInfo "" UBYTE Com_RxSigBufferArrayBasedShdBufferEndIdxOfRxAccessInfoType 0 0 0 255 ECU_ADDRESS 0x0 /end MEASUREMENT
/begin MEASUREMENT Com_RxAccessInfo[88].RxSigBufferArrayBasedShdBufferStartIdxOfRxAccessInfo "" UBYTE Com_RxSigBufferArrayBasedShdBufferStartIdxOfRxAccessInfoType 0 0 0 255 ECU_ADDRESS 0x0 /end MEASUREMENT
/begin MEASUREMENT Com_RxAccessInfo[88].RxTOutInfoIdxOfRxAccessInfo "" UBYTE Com_RxTOutInfoIdxOfRxAccessInfoType 0 0 0 255 ECU_ADDRESS 0x0 /end MEASUREMENT
/begin MEASUREMENT Com_RxAccessInfo[88].ShdBufferIdxOfRxAccessInfo "" UWORD Com_ShdBufferIdxOfRxAccessInfoType 0 0 0 65535 ECU_ADDRESS 0x0 /end MEASUREMENT
/begin MEASUREMENT Com_RxAccessInfo[88].SignalLengthInByteOfRxAccessInfo "" UBYTE NO_COMPU_METHOD 0 0 0 255 ECU_ADDRESS 0x0 /end MEASUREMENT
/begin MEASUREMENT Com_RxAccessInfo[88].StartByteInPduPositionOfRxAccessInfo "" UBYTE NO_COMPU_METHOD 0 0 0 255 ECU_ADDRESS 0x0 /end MEASUREMENT
/begin MEASUREMENT Com_RxAccessInfo[88].TmpBufferIdxOfRxAccessInfo "" UBYTE Com_TmpBufferIdxOfRxAccessInfoType 0 0 0 255 ECU_ADDRESS 0x0 /end MEASUREMENT
/begin MEASUREMENT Com_RxAccessInfo[88].TmpBufferOfRxAccessInfo "" UBYTE Com_TmpBufferOfRxAccessInfoType 0 0 0 255 ECU_ADDRESS 0x0 /end MEASUREMENT
/begin MEASUREMENT Com_RxAccessInfo[88].TmpRxShdBufferArrayBasedTmpBufferEndIdxOfRxAccessInfo "" UBYTE Com_TmpRxShdBufferArrayBasedTmpBufferEndIdxOfRxAccessInfoType 0 0 0 255 ECU_ADDRESS 0x0 /end MEASUREMENT
/begin MEASUREMENT Com_RxAccessInfo[88].TmpRxShdBufferArrayBasedTmpBufferStartIdxOfRxAccessInfo "" UBYTE Com_TmpRxShdBufferArrayBasedTmpBufferStartIdxOfRxAccessInfoType 0 0 0 255 ECU_ADDRESS 0x0 /end MEASUREMENT
/begin MEASUREMENT Com_RxAccessInfo[89].ApplTypeOfRxAccessInfo "" UBYTE Com_ApplTypeOfRxAccessInfoType 0 0 0 255 ECU_ADDRESS 0x0 /end MEASUREMENT
/begin MEASUREMENT Com_RxAccessInfo[89].BitLengthOfRxAccessInfo "" UWORD NO_COMPU_METHOD 0 0 0 65535 ECU_ADDRESS 0x0 /end MEASUREMENT
/begin MEASUREMENT Com_RxAccessInfo[89].BitPositionOfRxAccessInfo "" UWORD NO_COMPU_METHOD 0 0 0 65535 ECU_ADDRESS 0x0 /end MEASUREMENT
/begin MEASUREMENT Com_RxAccessInfo[89].BufferIdxOfRxAccessInfo "" UWORD Com_BufferIdxOfRxAccessInfoType 0 0 0 65535 ECU_ADDRESS 0x0 /end MEASUREMENT
/begin MEASUREMENT Com_RxAccessInfo[89].BusAccOfRxAccessInfo "" UBYTE Com_BusAccOfRxAccessInfoType 0 0 0 255 ECU_ADDRESS 0x0 /end MEASUREMENT
/begin MEASUREMENT Com_RxAccessInfo[89].ByteLengthOfRxAccessInfo "" UBYTE NO_COMPU_METHOD 0 0 0 255 ECU_ADDRESS 0x0 /end MEASUREMENT
/begin MEASUREMENT Com_RxAccessInfo[89].ConstValueArrayBasedInitValueEndIdxOfRxAccessInfo "" UBYTE Com_ConstValueArrayBasedInitValueEndIdxOfRxAccessInfoType 0 0 0 255 ECU_ADDRESS 0x0 /end MEASUREMENT
/begin MEASUREMENT Com_RxAccessInfo[89].ConstValueArrayBasedInitValueStartIdxOfRxAccessInfo "" UBYTE Com_ConstValueArrayBasedInitValueStartIdxOfRxAccessInfoType 0 0 0 255 ECU_ADDRESS 0x0 /end MEASUREMENT
/begin MEASUREMENT Com_RxAccessInfo[89].DynSignalOfRxAccessInfo "" UBYTE Com_DynSignalOfRxAccessInfoType 0 0 0 1 ECU_ADDRESS 0x0 /end MEASUREMENT
/begin MEASUREMENT Com_RxAccessInfo[89].InitValueIdxOfRxAccessInfo "" UBYTE Com_InitValueIdxOfRxAccessInfoType 0 0 0 255 ECU_ADDRESS 0x0 /end MEASUREMENT
/begin MEASUREMENT Com_RxAccessInfo[89].InitValueOfRxAccessInfo "" UBYTE Com_InitValueOfRxAccessInfoType 0 0 0 255 ECU_ADDRESS 0x0 /end MEASUREMENT
/begin MEASUREMENT Com_RxAccessInfo[89].InvValueIdxOfRxAccessInfo "" UBYTE Com_InvValueIdxOfRxAccessInfoType 0 0 0 255 ECU_ADDRESS 0x0 /end MEASUREMENT
/begin MEASUREMENT Com_RxAccessInfo[89].InvValueOfRxAccessInfo "" UBYTE Com_InvValueOfRxAccessInfoType 0 0 0 255 ECU_ADDRESS 0x0 /end MEASUREMENT
/begin MEASUREMENT Com_RxAccessInfo[89].IsGroupSignalOfRxAccessInfo "" UBYTE Com_IsGroupSignalOfRxAccessInfoType 0 0 0 1 ECU_ADDRESS 0x0 /end MEASUREMENT
/begin MEASUREMENT Com_RxAccessInfo[89].RxDataTimeoutSubstitutionValueIdxOfRxAccessInfo "" UBYTE Com_RxDataTimeoutSubstitutionValueIdxOfRxAccessInfoType 0 0 0 255 ECU_ADDRESS 0x0 /end MEASUREMENT
/begin MEASUREMENT Com_RxAccessInfo[89].RxDataTimeoutSubstitutionValueOfRxAccessInfo "" UBYTE Com_RxDataTimeoutSubstitutionValueOfRxAccessInfoType 0 0 0 255 ECU_ADDRESS 0x0 /end MEASUREMENT
/begin MEASUREMENT Com_RxAccessInfo[89].RxPduInfoIdxOfRxAccessInfo "" UBYTE NO_COMPU_METHOD 0 0 0 255 ECU_ADDRESS 0x0 /end MEASUREMENT
/begin MEASUREMENT Com_RxAccessInfo[89].RxSigBufferArrayBasedBufferEndIdxOfRxAccessInfo "" UBYTE Com_RxSigBufferArrayBasedBufferEndIdxOfRxAccessInfoType 0 0 0 255 ECU_ADDRESS 0x0 /end MEASUREMENT
/begin MEASUREMENT Com_RxAccessInfo[89].RxSigBufferArrayBasedBufferStartIdxOfRxAccessInfo "" UBYTE Com_RxSigBufferArrayBasedBufferStartIdxOfRxAccessInfoType 0 0 0 255 ECU_ADDRESS 0x0 /end MEASUREMENT
/begin MEASUREMENT Com_RxAccessInfo[89].RxSigBufferArrayBasedShdBufferEndIdxOfRxAccessInfo "" UBYTE Com_RxSigBufferArrayBasedShdBufferEndIdxOfRxAccessInfoType 0 0 0 255 ECU_ADDRESS 0x0 /end MEASUREMENT
/begin MEASUREMENT Com_RxAccessInfo[89].RxSigBufferArrayBasedShdBufferStartIdxOfRxAccessInfo "" UBYTE Com_RxSigBufferArrayBasedShdBufferStartIdxOfRxAccessInfoType 0 0 0 255 ECU_ADDRESS 0x0 /end MEASUREMENT
/begin MEASUREMENT Com_RxAccessInfo[89].RxTOutInfoIdxOfRxAccessInfo "" UBYTE Com_RxTOutInfoIdxOfRxAccessInfoType 0 0 0 255 ECU_ADDRESS 0x0 /end MEASUREMENT
/begin MEASUREMENT Com_RxAccessInfo[89].ShdBufferIdxOfRxAccessInfo "" UWORD Com_ShdBufferIdxOfRxAccessInfoType 0 0 0 65535 ECU_ADDRESS 0x0 /end MEASUREMENT
/begin MEASUREMENT Com_RxAccessInfo[89].SignalLengthInByteOfRxAccessInfo "" UBYTE NO_COMPU_METHOD 0 0 0 255 ECU_ADDRESS 0x0 /end MEASUREMENT
/begin MEASUREMENT Com_RxAccessInfo[89].StartByteInPduPositionOfRxAccessInfo "" UBYTE NO_COMPU_METHOD 0 0 0 255 ECU_ADDRESS 0x0 /end MEASUREMENT
/begin MEASUREMENT Com_RxAccessInfo[89].TmpBufferIdxOfRxAccessInfo "" UBYTE Com_TmpBufferIdxOfRxAccessInfoType 0 0 0 255 ECU_ADDRESS 0x0 /end MEASUREMENT
/begin MEASUREMENT Com_RxAccessInfo[89].TmpBufferOfRxAccessInfo "" UBYTE Com_TmpBufferOfRxAccessInfoType 0 0 0 255 ECU_ADDRESS 0x0 /end MEASUREMENT
/begin MEASUREMENT Com_RxAccessInfo[89].TmpRxShdBufferArrayBasedTmpBufferEndIdxOfRxAccessInfo "" UBYTE Com_TmpRxShdBufferArrayBasedTmpBufferEndIdxOfRxAccessInfoType 0 0 0 255 ECU_ADDRESS 0x0 /end MEASUREMENT
/begin MEASUREMENT Com_RxAccessInfo[89].TmpRxShdBufferArrayBasedTmpBufferStartIdxOfRxAccessInfo "" UBYTE Com_TmpRxShdBufferArrayBasedTmpBufferStartIdxOfRxAccessInfoType 0 0 0 255 ECU_ADDRESS 0x0 /end MEASUREMENT
/begin MEASUREMENT Com_RxAccessInfo[8].ApplTypeOfRxAccessInfo "" UBYTE Com_ApplTypeOfRxAccessInfoType 0 0 0 255 ECU_ADDRESS 0x0 /end MEASUREMENT
/begin MEASUREMENT Com_RxAccessInfo[8].BitLengthOfRxAccessInfo "" UWORD NO_COMPU_METHOD 0 0 0 65535 ECU_ADDRESS 0x0 /end MEASUREMENT
/begin MEASUREMENT Com_RxAccessInfo[8].BitPositionOfRxAccessInfo "" UWORD NO_COMPU_METHOD 0 0 0 65535 ECU_ADDRESS 0x0 /end MEASUREMENT
/begin MEASUREMENT Com_RxAccessInfo[8].BufferIdxOfRxAccessInfo "" UWORD Com_BufferIdxOfRxAccessInfoType 0 0 0 65535 ECU_ADDRESS 0x0 /end MEASUREMENT
/begin MEASUREMENT Com_RxAccessInfo[8].BusAccOfRxAccessInfo "" UBYTE Com_BusAccOfRxAccessInfoType 0 0 0 255 ECU_ADDRESS 0x0 /end MEASUREMENT
/begin MEASUREMENT Com_RxAccessInfo[8].ByteLengthOfRxAccessInfo "" UBYTE NO_COMPU_METHOD 0 0 0 255 ECU_ADDRESS 0x0 /end MEASUREMENT
/begin MEASUREMENT Com_RxAccessInfo[8].ConstValueArrayBasedInitValueEndIdxOfRxAccessInfo "" UBYTE Com_ConstValueArrayBasedInitValueEndIdxOfRxAccessInfoType 0 0 0 255 ECU_ADDRESS 0x0 /end MEASUREMENT
/begin MEASUREMENT Com_RxAccessInfo[8].ConstValueArrayBasedInitValueStartIdxOfRxAccessInfo "" UBYTE Com_ConstValueArrayBasedInitValueStartIdxOfRxAccessInfoType 0 0 0 255 ECU_ADDRESS 0x0 /end MEASUREMENT
/begin MEASUREMENT Com_RxAccessInfo[8].DynSignalOfRxAccessInfo "" UBYTE Com_DynSignalOfRxAccessInfoType 0 0 0 1 ECU_ADDRESS 0x0 /end MEASUREMENT
/begin MEASUREMENT Com_RxAccessInfo[8].InitValueIdxOfRxAccessInfo "" UBYTE Com_InitValueIdxOfRxAccessInfoType 0 0 0 255 ECU_ADDRESS 0x0 /end MEASUREMENT
/begin MEASUREMENT Com_RxAccessInfo[8].InitValueOfRxAccessInfo "" UBYTE Com_InitValueOfRxAccessInfoType 0 0 0 255 ECU_ADDRESS 0x0 /end MEASUREMENT
/begin MEASUREMENT Com_RxAccessInfo[8].InvValueIdxOfRxAccessInfo "" UBYTE Com_InvValueIdxOfRxAccessInfoType 0 0 0 255 ECU_ADDRESS 0x0 /end MEASUREMENT
/begin MEASUREMENT Com_RxAccessInfo[8].InvValueOfRxAccessInfo "" UBYTE Com_InvValueOfRxAccessInfoType 0 0 0 255 ECU_ADDRESS 0x0 /end MEASUREMENT
/begin MEASUREMENT Com_RxAccessInfo[8].IsGroupSignalOfRxAccessInfo "" UBYTE Com_IsGroupSignalOfRxAccessInfoType 0 0 0 1 ECU_ADDRESS 0x0 /end MEASUREMENT
/begin MEASUREMENT Com_RxAccessInfo[8].RxDataTimeoutSubstitutionValueIdxOfRxAccessInfo "" UBYTE Com_RxDataTimeoutSubstitutionValueIdxOfRxAccessInfoType 0 0 0 255 ECU_ADDRESS 0x0 /end MEASUREMENT
/begin MEASUREMENT Com_RxAccessInfo[8].RxDataTimeoutSubstitutionValueOfRxAccessInfo "" UBYTE Com_RxDataTimeoutSubstitutionValueOfRxAccessInfoType 0 0 0 255 ECU_ADDRESS 0x0 /end MEASUREMENT
/begin MEASUREMENT Com_RxAccessInfo[8].RxPduInfoIdxOfRxAccessInfo "" UBYTE NO_COMPU_METHOD 0 0 0 255 ECU_ADDRESS 0x0 /end MEASUREMENT
/begin MEASUREMENT Com_RxAccessInfo[8].RxSigBufferArrayBasedBufferEndIdxOfRxAccessInfo "" UBYTE Com_RxSigBufferArrayBasedBufferEndIdxOfRxAccessInfoType 0 0 0 255 ECU_ADDRESS 0x0 /end MEASUREMENT
/begin MEASUREMENT Com_RxAccessInfo[8].RxSigBufferArrayBasedBufferStartIdxOfRxAccessInfo "" UBYTE Com_RxSigBufferArrayBasedBufferStartIdxOfRxAccessInfoType 0 0 0 255 ECU_ADDRESS 0x0 /end MEASUREMENT
/begin MEASUREMENT Com_RxAccessInfo[8].RxSigBufferArrayBasedShdBufferEndIdxOfRxAccessInfo "" UBYTE Com_RxSigBufferArrayBasedShdBufferEndIdxOfRxAccessInfoType 0 0 0 255 ECU_ADDRESS 0x0 /end MEASUREMENT
/begin MEASUREMENT Com_RxAccessInfo[8].RxSigBufferArrayBasedShdBufferStartIdxOfRxAccessInfo "" UBYTE Com_RxSigBufferArrayBasedShdBufferStartIdxOfRxAccessInfoType 0 0 0 255 ECU_ADDRESS 0x0 /end MEASUREMENT
/begin MEASUREMENT Com_RxAccessInfo[8].RxTOutInfoIdxOfRxAccessInfo "" UBYTE Com_RxTOutInfoIdxOfRxAccessInfoType 0 0 0 255 ECU_ADDRESS 0x0 /end MEASUREMENT
/begin MEASUREMENT Com_RxAccessInfo[8].ShdBufferIdxOfRxAccessInfo "" UWORD Com_ShdBufferIdxOfRxAccessInfoType 0 0 0 65535 ECU_ADDRESS 0x0 /end MEASUREMENT
/begin MEASUREMENT Com_RxAccessInfo[8].SignalLengthInByteOfRxAccessInfo "" UBYTE NO_COMPU_METHOD 0 0 0 255 ECU_ADDRESS 0x0 /end MEASUREMENT
/begin MEASUREMENT Com_RxAccessInfo[8].StartByteInPduPositionOfRxAccessInfo "" UBYTE NO_COMPU_METHOD 0 0 0 255 ECU_ADDRESS 0x0 /end MEASUREMENT
/begin MEASUREMENT Com_RxAccessInfo[8].TmpBufferIdxOfRxAccessInfo "" UBYTE Com_TmpBufferIdxOfRxAccessInfoType 0 0 0 255 ECU_ADDRESS 0x0 /end MEASUREMENT
/begin MEASUREMENT Com_RxAccessInfo[8].TmpBufferOfRxAccessInfo "" UBYTE Com_TmpBufferOfRxAccessInfoType 0 0 0 255 ECU_ADDRESS 0x0 /end MEASUREMENT
/begin MEASUREMENT Com_RxAccessInfo[8].TmpRxShdBufferArrayBasedTmpBufferEndIdxOfRxAccessInfo "" UBYTE Com_TmpRxShdBufferArrayBasedTmpBufferEndIdxOfRxAccessInfoType 0 0 0 255 ECU_ADDRESS 0x0 /end MEASUREMENT
/begin MEASUREMENT Com_RxAccessInfo[8].TmpRxShdBufferArrayBasedTmpBufferStartIdxOfRxAccessInfo "" UBYTE Com_TmpRxShdBufferArrayBasedTmpBufferStartIdxOfRxAccessInfoType 0 0 0 255 ECU_ADDRESS 0x0 /end MEASUREMENT
/begin MEASUREMENT Com_RxAccessInfo[90].ApplTypeOfRxAccessInfo "" UBYTE Com_ApplTypeOfRxAccessInfoType 0 0 0 255 ECU_ADDRESS 0x0 /end MEASUREMENT
/begin MEASUREMENT Com_RxAccessInfo[90].BitLengthOfRxAccessInfo "" UWORD NO_COMPU_METHOD 0 0 0 65535 ECU_ADDRESS 0x0 /end MEASUREMENT
/begin MEASUREMENT Com_RxAccessInfo[90].BitPositionOfRxAccessInfo "" UWORD NO_COMPU_METHOD 0 0 0 65535 ECU_ADDRESS 0x0 /end MEASUREMENT
/begin MEASUREMENT Com_RxAccessInfo[90].BufferIdxOfRxAccessInfo "" UWORD Com_BufferIdxOfRxAccessInfoType 0 0 0 65535 ECU_ADDRESS 0x0 /end MEASUREMENT
/begin MEASUREMENT Com_RxAccessInfo[90].BusAccOfRxAccessInfo "" UBYTE Com_BusAccOfRxAccessInfoType 0 0 0 255 ECU_ADDRESS 0x0 /end MEASUREMENT
/begin MEASUREMENT Com_RxAccessInfo[90].ByteLengthOfRxAccessInfo "" UBYTE NO_COMPU_METHOD 0 0 0 255 ECU_ADDRESS 0x0 /end MEASUREMENT
/begin MEASUREMENT Com_RxAccessInfo[90].ConstValueArrayBasedInitValueEndIdxOfRxAccessInfo "" UBYTE Com_ConstValueArrayBasedInitValueEndIdxOfRxAccessInfoType 0 0 0 255 ECU_ADDRESS 0x0 /end MEASUREMENT
/begin MEASUREMENT Com_RxAccessInfo[90].ConstValueArrayBasedInitValueStartIdxOfRxAccessInfo "" UBYTE Com_ConstValueArrayBasedInitValueStartIdxOfRxAccessInfoType 0 0 0 255 ECU_ADDRESS 0x0 /end MEASUREMENT
/begin MEASUREMENT Com_RxAccessInfo[90].DynSignalOfRxAccessInfo "" UBYTE Com_DynSignalOfRxAccessInfoType 0 0 0 1 ECU_ADDRESS 0x0 /end MEASUREMENT
/begin MEASUREMENT Com_RxAccessInfo[90].InitValueIdxOfRxAccessInfo "" UBYTE Com_InitValueIdxOfRxAccessInfoType 0 0 0 255 ECU_ADDRESS 0x0 /end MEASUREMENT
/begin MEASUREMENT Com_RxAccessInfo[90].InitValueOfRxAccessInfo "" UBYTE Com_InitValueOfRxAccessInfoType 0 0 0 255 ECU_ADDRESS 0x0 /end MEASUREMENT
/begin MEASUREMENT Com_RxAccessInfo[90].InvValueIdxOfRxAccessInfo "" UBYTE Com_InvValueIdxOfRxAccessInfoType 0 0 0 255 ECU_ADDRESS 0x0 /end MEASUREMENT
/begin MEASUREMENT Com_RxAccessInfo[90].InvValueOfRxAccessInfo "" UBYTE Com_InvValueOfRxAccessInfoType 0 0 0 255 ECU_ADDRESS 0x0 /end MEASUREMENT
/begin MEASUREMENT Com_RxAccessInfo[90].IsGroupSignalOfRxAccessInfo "" UBYTE Com_IsGroupSignalOfRxAccessInfoType 0 0 0 1 ECU_ADDRESS 0x0 /end MEASUREMENT
/begin MEASUREMENT Com_RxAccessInfo[90].RxDataTimeoutSubstitutionValueIdxOfRxAccessInfo "" UBYTE Com_RxDataTimeoutSubstitutionValueIdxOfRxAccessInfoType 0 0 0 255 ECU_ADDRESS 0x0 /end MEASUREMENT
/begin MEASUREMENT Com_RxAccessInfo[90].RxDataTimeoutSubstitutionValueOfRxAccessInfo "" UBYTE Com_RxDataTimeoutSubstitutionValueOfRxAccessInfoType 0 0 0 255 ECU_ADDRESS 0x0 /end MEASUREMENT
/begin MEASUREMENT Com_RxAccessInfo[90].RxPduInfoIdxOfRxAccessInfo "" UBYTE NO_COMPU_METHOD 0 0 0 255 ECU_ADDRESS 0x0 /end MEASUREMENT
/begin MEASUREMENT Com_RxAccessInfo[90].RxSigBufferArrayBasedBufferEndIdxOfRxAccessInfo "" UBYTE Com_RxSigBufferArrayBasedBufferEndIdxOfRxAccessInfoType 0 0 0 255 ECU_ADDRESS 0x0 /end MEASUREMENT
/begin MEASUREMENT Com_RxAccessInfo[90].RxSigBufferArrayBasedBufferStartIdxOfRxAccessInfo "" UBYTE Com_RxSigBufferArrayBasedBufferStartIdxOfRxAccessInfoType 0 0 0 255 ECU_ADDRESS 0x0 /end MEASUREMENT
/begin MEASUREMENT Com_RxAccessInfo[90].RxSigBufferArrayBasedShdBufferEndIdxOfRxAccessInfo "" UBYTE Com_RxSigBufferArrayBasedShdBufferEndIdxOfRxAccessInfoType 0 0 0 255 ECU_ADDRESS 0x0 /end MEASUREMENT
/begin MEASUREMENT Com_RxAccessInfo[90].RxSigBufferArrayBasedShdBufferStartIdxOfRxAccessInfo "" UBYTE Com_RxSigBufferArrayBasedShdBufferStartIdxOfRxAccessInfoType 0 0 0 255 ECU_ADDRESS 0x0 /end MEASUREMENT
/begin MEASUREMENT Com_RxAccessInfo[90].RxTOutInfoIdxOfRxAccessInfo "" UBYTE Com_RxTOutInfoIdxOfRxAccessInfoType 0 0 0 255 ECU_ADDRESS 0x0 /end MEASUREMENT
/begin MEASUREMENT Com_RxAccessInfo[90].ShdBufferIdxOfRxAccessInfo "" UWORD Com_ShdBufferIdxOfRxAccessInfoType 0 0 0 65535 ECU_ADDRESS 0x0 /end MEASUREMENT
/begin MEASUREMENT Com_RxAccessInfo[90].SignalLengthInByteOfRxAccessInfo "" UBYTE NO_COMPU_METHOD 0 0 0 255 ECU_ADDRESS 0x0 /end MEASUREMENT
/begin MEASUREMENT Com_RxAccessInfo[90].StartByteInPduPositionOfRxAccessInfo "" UBYTE NO_COMPU_METHOD 0 0 0 255 ECU_ADDRESS 0x0 /end MEASUREMENT
/begin MEASUREMENT Com_RxAccessInfo[90].TmpBufferIdxOfRxAccessInfo "" UBYTE Com_TmpBufferIdxOfRxAccessInfoType 0 0 0 255 ECU_ADDRESS 0x0 /end MEASUREMENT
/begin MEASUREMENT Com_RxAccessInfo[90].TmpBufferOfRxAccessInfo "" UBYTE Com_TmpBufferOfRxAccessInfoType 0 0 0 255 ECU_ADDRESS 0x0 /end MEASUREMENT
/begin MEASUREMENT Com_RxAccessInfo[90].TmpRxShdBufferArrayBasedTmpBufferEndIdxOfRxAccessInfo "" UBYTE Com_TmpRxShdBufferArrayBasedTmpBufferEndIdxOfRxAccessInfoType 0 0 0 255 ECU_ADDRESS 0x0 /end MEASUREMENT
/begin MEASUREMENT Com_RxAccessInfo[90].TmpRxShdBufferArrayBasedTmpBufferStartIdxOfRxAccessInfo "" UBYTE Com_TmpRxShdBufferArrayBasedTmpBufferStartIdxOfRxAccessInfoType 0 0 0 255 ECU_ADDRESS 0x0 /end MEASUREMENT
/begin MEASUREMENT Com_RxAccessInfo[91].ApplTypeOfRxAccessInfo "" UBYTE Com_ApplTypeOfRxAccessInfoType 0 0 0 255 ECU_ADDRESS 0x0 /end MEASUREMENT
/begin MEASUREMENT Com_RxAccessInfo[91].BitLengthOfRxAccessInfo "" UWORD NO_COMPU_METHOD 0 0 0 65535 ECU_ADDRESS 0x0 /end MEASUREMENT
/begin MEASUREMENT Com_RxAccessInfo[91].BitPositionOfRxAccessInfo "" UWORD NO_COMPU_METHOD 0 0 0 65535 ECU_ADDRESS 0x0 /end MEASUREMENT
/begin MEASUREMENT Com_RxAccessInfo[91].BufferIdxOfRxAccessInfo "" UWORD Com_BufferIdxOfRxAccessInfoType 0 0 0 65535 ECU_ADDRESS 0x0 /end MEASUREMENT
/begin MEASUREMENT Com_RxAccessInfo[91].BusAccOfRxAccessInfo "" UBYTE Com_BusAccOfRxAccessInfoType 0 0 0 255 ECU_ADDRESS 0x0 /end MEASUREMENT
/begin MEASUREMENT Com_RxAccessInfo[91].ByteLengthOfRxAccessInfo "" UBYTE NO_COMPU_METHOD 0 0 0 255 ECU_ADDRESS 0x0 /end MEASUREMENT
/begin MEASUREMENT Com_RxAccessInfo[91].ConstValueArrayBasedInitValueEndIdxOfRxAccessInfo "" UBYTE Com_ConstValueArrayBasedInitValueEndIdxOfRxAccessInfoType 0 0 0 255 ECU_ADDRESS 0x0 /end MEASUREMENT
/begin MEASUREMENT Com_RxAccessInfo[91].ConstValueArrayBasedInitValueStartIdxOfRxAccessInfo "" UBYTE Com_ConstValueArrayBasedInitValueStartIdxOfRxAccessInfoType 0 0 0 255 ECU_ADDRESS 0x0 /end MEASUREMENT
/begin MEASUREMENT Com_RxAccessInfo[91].DynSignalOfRxAccessInfo "" UBYTE Com_DynSignalOfRxAccessInfoType 0 0 0 1 ECU_ADDRESS 0x0 /end MEASUREMENT
/begin MEASUREMENT Com_RxAccessInfo[91].InitValueIdxOfRxAccessInfo "" UBYTE Com_InitValueIdxOfRxAccessInfoType 0 0 0 255 ECU_ADDRESS 0x0 /end MEASUREMENT
/begin MEASUREMENT Com_RxAccessInfo[91].InitValueOfRxAccessInfo "" UBYTE Com_InitValueOfRxAccessInfoType 0 0 0 255 ECU_ADDRESS 0x0 /end MEASUREMENT
/begin MEASUREMENT Com_RxAccessInfo[91].InvValueIdxOfRxAccessInfo "" UBYTE Com_InvValueIdxOfRxAccessInfoType 0 0 0 255 ECU_ADDRESS 0x0 /end MEASUREMENT
/begin MEASUREMENT Com_RxAccessInfo[91].InvValueOfRxAccessInfo "" UBYTE Com_InvValueOfRxAccessInfoType 0 0 0 255 ECU_ADDRESS 0x0 /end MEASUREMENT
/begin MEASUREMENT Com_RxAccessInfo[91].IsGroupSignalOfRxAccessInfo "" UBYTE Com_IsGroupSignalOfRxAccessInfoType 0 0 0 1 ECU_ADDRESS 0x0 /end MEASUREMENT
/begin MEASUREMENT Com_RxAccessInfo[91].RxDataTimeoutSubstitutionValueIdxOfRxAccessInfo "" UBYTE Com_RxDataTimeoutSubstitutionValueIdxOfRxAccessInfoType 0 0 0 255 ECU_ADDRESS 0x0 /end MEASUREMENT
/begin MEASUREMENT Com_RxAccessInfo[91].RxDataTimeoutSubstitutionValueOfRxAccessInfo "" UBYTE Com_RxDataTimeoutSubstitutionValueOfRxAccessInfoType 0 0 0 255 ECU_ADDRESS 0x0 /end MEASUREMENT
/begin MEASUREMENT Com_RxAccessInfo[91].RxPduInfoIdxOfRxAccessInfo "" UBYTE NO_COMPU_METHOD 0 0 0 255 ECU_ADDRESS 0x0 /end MEASUREMENT
/begin MEASUREMENT Com_RxAccessInfo[91].RxSigBufferArrayBasedBufferEndIdxOfRxAccessInfo "" UBYTE Com_RxSigBufferArrayBasedBufferEndIdxOfRxAccessInfoType 0 0 0 255 ECU_ADDRESS 0x0 /end MEASUREMENT
/begin MEASUREMENT Com_RxAccessInfo[91].RxSigBufferArrayBasedBufferStartIdxOfRxAccessInfo "" UBYTE Com_RxSigBufferArrayBasedBufferStartIdxOfRxAccessInfoType 0 0 0 255 ECU_ADDRESS 0x0 /end MEASUREMENT
/begin MEASUREMENT Com_RxAccessInfo[91].RxSigBufferArrayBasedShdBufferEndIdxOfRxAccessInfo "" UBYTE Com_RxSigBufferArrayBasedShdBufferEndIdxOfRxAccessInfoType 0 0 0 255 ECU_ADDRESS 0x0 /end MEASUREMENT
/begin MEASUREMENT Com_RxAccessInfo[91].RxSigBufferArrayBasedShdBufferStartIdxOfRxAccessInfo "" UBYTE Com_RxSigBufferArrayBasedShdBufferStartIdxOfRxAccessInfoType 0 0 0 255 ECU_ADDRESS 0x0 /end MEASUREMENT
/begin MEASUREMENT Com_RxAccessInfo[91].RxTOutInfoIdxOfRxAccessInfo "" UBYTE Com_RxTOutInfoIdxOfRxAccessInfoType 0 0 0 255 ECU_ADDRESS 0x0 /end MEASUREMENT
/begin MEASUREMENT Com_RxAccessInfo[91].ShdBufferIdxOfRxAccessInfo "" UWORD Com_ShdBufferIdxOfRxAccessInfoType 0 0 0 65535 ECU_ADDRESS 0x0 /end MEASUREMENT
/begin MEASUREMENT Com_RxAccessInfo[91].SignalLengthInByteOfRxAccessInfo "" UBYTE NO_COMPU_METHOD 0 0 0 255 ECU_ADDRESS 0x0 /end MEASUREMENT
/begin MEASUREMENT Com_RxAccessInfo[91].StartByteInPduPositionOfRxAccessInfo "" UBYTE NO_COMPU_METHOD 0 0 0 255 ECU_ADDRESS 0x0 /end MEASUREMENT
/begin MEASUREMENT Com_RxAccessInfo[91].TmpBufferIdxOfRxAccessInfo "" UBYTE Com_TmpBufferIdxOfRxAccessInfoType 0 0 0 255 ECU_ADDRESS 0x0 /end MEASUREMENT
/begin MEASUREMENT Com_RxAccessInfo[91].TmpBufferOfRxAccessInfo "" UBYTE Com_TmpBufferOfRxAccessInfoType 0 0 0 255 ECU_ADDRESS 0x0 /end MEASUREMENT
/begin MEASUREMENT Com_RxAccessInfo[91].TmpRxShdBufferArrayBasedTmpBufferEndIdxOfRxAccessInfo "" UBYTE Com_TmpRxShdBufferArrayBasedTmpBufferEndIdxOfRxAccessInfoType 0 0 0 255 ECU_ADDRESS 0x0 /end MEASUREMENT
/begin MEASUREMENT Com_RxAccessInfo[91].TmpRxShdBufferArrayBasedTmpBufferStartIdxOfRxAccessInfo "" UBYTE Com_TmpRxShdBufferArrayBasedTmpBufferStartIdxOfRxAccessInfoType 0 0 0 255 ECU_ADDRESS 0x0 /end MEASUREMENT
/begin MEASUREMENT Com_RxAccessInfo[92].ApplTypeOfRxAccessInfo "" UBYTE Com_ApplTypeOfRxAccessInfoType 0 0 0 255 ECU_ADDRESS 0x0 /end MEASUREMENT
/begin MEASUREMENT Com_RxAccessInfo[92].BitLengthOfRxAccessInfo "" UWORD NO_COMPU_METHOD 0 0 0 65535 ECU_ADDRESS 0x0 /end MEASUREMENT
/begin MEASUREMENT Com_RxAccessInfo[92].BitPositionOfRxAccessInfo "" UWORD NO_COMPU_METHOD 0 0 0 65535 ECU_ADDRESS 0x0 /end MEASUREMENT
/begin MEASUREMENT Com_RxAccessInfo[92].BufferIdxOfRxAccessInfo "" UWORD Com_BufferIdxOfRxAccessInfoType 0 0 0 65535 ECU_ADDRESS 0x0 /end MEASUREMENT
/begin MEASUREMENT Com_RxAccessInfo[92].BusAccOfRxAccessInfo "" UBYTE Com_BusAccOfRxAccessInfoType 0 0 0 255 ECU_ADDRESS 0x0 /end MEASUREMENT
/begin MEASUREMENT Com_RxAccessInfo[92].ByteLengthOfRxAccessInfo "" UBYTE NO_COMPU_METHOD 0 0 0 255 ECU_ADDRESS 0x0 /end MEASUREMENT
/begin MEASUREMENT Com_RxAccessInfo[92].ConstValueArrayBasedInitValueEndIdxOfRxAccessInfo "" UBYTE Com_ConstValueArrayBasedInitValueEndIdxOfRxAccessInfoType 0 0 0 255 ECU_ADDRESS 0x0 /end MEASUREMENT
/begin MEASUREMENT Com_RxAccessInfo[92].ConstValueArrayBasedInitValueStartIdxOfRxAccessInfo "" UBYTE Com_ConstValueArrayBasedInitValueStartIdxOfRxAccessInfoType 0 0 0 255 ECU_ADDRESS 0x0 /end MEASUREMENT
/begin MEASUREMENT Com_RxAccessInfo[92].DynSignalOfRxAccessInfo "" UBYTE Com_DynSignalOfRxAccessInfoType 0 0 0 1 ECU_ADDRESS 0x0 /end MEASUREMENT
/begin MEASUREMENT Com_RxAccessInfo[92].InitValueIdxOfRxAccessInfo "" UBYTE Com_InitValueIdxOfRxAccessInfoType 0 0 0 255 ECU_ADDRESS 0x0 /end MEASUREMENT
/begin MEASUREMENT Com_RxAccessInfo[92].InitValueOfRxAccessInfo "" UBYTE Com_InitValueOfRxAccessInfoType 0 0 0 255 ECU_ADDRESS 0x0 /end MEASUREMENT
/begin MEASUREMENT Com_RxAccessInfo[92].InvValueIdxOfRxAccessInfo "" UBYTE Com_InvValueIdxOfRxAccessInfoType 0 0 0 255 ECU_ADDRESS 0x0 /end MEASUREMENT
/begin MEASUREMENT Com_RxAccessInfo[92].InvValueOfRxAccessInfo "" UBYTE Com_InvValueOfRxAccessInfoType 0 0 0 255 ECU_ADDRESS 0x0 /end MEASUREMENT
/begin MEASUREMENT Com_RxAccessInfo[92].IsGroupSignalOfRxAccessInfo "" UBYTE Com_IsGroupSignalOfRxAccessInfoType 0 0 0 1 ECU_ADDRESS 0x0 /end MEASUREMENT
/begin MEASUREMENT Com_RxAccessInfo[92].RxDataTimeoutSubstitutionValueIdxOfRxAccessInfo "" UBYTE Com_RxDataTimeoutSubstitutionValueIdxOfRxAccessInfoType 0 0 0 255 ECU_ADDRESS 0x0 /end MEASUREMENT
/begin MEASUREMENT Com_RxAccessInfo[92].RxDataTimeoutSubstitutionValueOfRxAccessInfo "" UBYTE Com_RxDataTimeoutSubstitutionValueOfRxAccessInfoType 0 0 0 255 ECU_ADDRESS 0x0 /end MEASUREMENT
/begin MEASUREMENT Com_RxAccessInfo[92].RxPduInfoIdxOfRxAccessInfo "" UBYTE NO_COMPU_METHOD 0 0 0 255 ECU_ADDRESS 0x0 /end MEASUREMENT
/begin MEASUREMENT Com_RxAccessInfo[92].RxSigBufferArrayBasedBufferEndIdxOfRxAccessInfo "" UBYTE Com_RxSigBufferArrayBasedBufferEndIdxOfRxAccessInfoType 0 0 0 255 ECU_ADDRESS 0x0 /end MEASUREMENT
/begin MEASUREMENT Com_RxAccessInfo[92].RxSigBufferArrayBasedBufferStartIdxOfRxAccessInfo "" UBYTE Com_RxSigBufferArrayBasedBufferStartIdxOfRxAccessInfoType 0 0 0 255 ECU_ADDRESS 0x0 /end MEASUREMENT
/begin MEASUREMENT Com_RxAccessInfo[92].RxSigBufferArrayBasedShdBufferEndIdxOfRxAccessInfo "" UBYTE Com_RxSigBufferArrayBasedShdBufferEndIdxOfRxAccessInfoType 0 0 0 255 ECU_ADDRESS 0x0 /end MEASUREMENT
/begin MEASUREMENT Com_RxAccessInfo[92].RxSigBufferArrayBasedShdBufferStartIdxOfRxAccessInfo "" UBYTE Com_RxSigBufferArrayBasedShdBufferStartIdxOfRxAccessInfoType 0 0 0 255 ECU_ADDRESS 0x0 /end MEASUREMENT
/begin MEASUREMENT Com_RxAccessInfo[92].RxTOutInfoIdxOfRxAccessInfo "" UBYTE Com_RxTOutInfoIdxOfRxAccessInfoType 0 0 0 255 ECU_ADDRESS 0x0 /end MEASUREMENT
/begin MEASUREMENT Com_RxAccessInfo[92].ShdBufferIdxOfRxAccessInfo "" UWORD Com_ShdBufferIdxOfRxAccessInfoType 0 0 0 65535 ECU_ADDRESS 0x0 /end MEASUREMENT
/begin MEASUREMENT Com_RxAccessInfo[92].SignalLengthInByteOfRxAccessInfo "" UBYTE NO_COMPU_METHOD 0 0 0 255 ECU_ADDRESS 0x0 /end MEASUREMENT
/begin MEASUREMENT Com_RxAccessInfo[92].StartByteInPduPositionOfRxAccessInfo "" UBYTE NO_COMPU_METHOD 0 0 0 255 ECU_ADDRESS 0x0 /end MEASUREMENT
/begin MEASUREMENT Com_RxAccessInfo[92].TmpBufferIdxOfRxAccessInfo "" UBYTE Com_TmpBufferIdxOfRxAccessInfoType 0 0 0 255 ECU_ADDRESS 0x0 /end MEASUREMENT
/begin MEASUREMENT Com_RxAccessInfo[92].TmpBufferOfRxAccessInfo "" UBYTE Com_TmpBufferOfRxAccessInfoType 0 0 0 255 ECU_ADDRESS 0x0 /end MEASUREMENT
/begin MEASUREMENT Com_RxAccessInfo[92].TmpRxShdBufferArrayBasedTmpBufferEndIdxOfRxAccessInfo "" UBYTE Com_TmpRxShdBufferArrayBasedTmpBufferEndIdxOfRxAccessInfoType 0 0 0 255 ECU_ADDRESS 0x0 /end MEASUREMENT
/begin MEASUREMENT Com_RxAccessInfo[92].TmpRxShdBufferArrayBasedTmpBufferStartIdxOfRxAccessInfo "" UBYTE Com_TmpRxShdBufferArrayBasedTmpBufferStartIdxOfRxAccessInfoType 0 0 0 255 ECU_ADDRESS 0x0 /end MEASUREMENT
/begin MEASUREMENT Com_RxAccessInfo[93].ApplTypeOfRxAccessInfo "" UBYTE Com_ApplTypeOfRxAccessInfoType 0 0 0 255 ECU_ADDRESS 0x0 /end MEASUREMENT
/begin MEASUREMENT Com_RxAccessInfo[93].BitLengthOfRxAccessInfo "" UWORD NO_COMPU_METHOD 0 0 0 65535 ECU_ADDRESS 0x0 /end MEASUREMENT
/begin MEASUREMENT Com_RxAccessInfo[93].BitPositionOfRxAccessInfo "" UWORD NO_COMPU_METHOD 0 0 0 65535 ECU_ADDRESS 0x0 /end MEASUREMENT
/begin MEASUREMENT Com_RxAccessInfo[93].BufferIdxOfRxAccessInfo "" UWORD Com_BufferIdxOfRxAccessInfoType 0 0 0 65535 ECU_ADDRESS 0x0 /end MEASUREMENT
/begin MEASUREMENT Com_RxAccessInfo[93].BusAccOfRxAccessInfo "" UBYTE Com_BusAccOfRxAccessInfoType 0 0 0 255 ECU_ADDRESS 0x0 /end MEASUREMENT
/begin MEASUREMENT Com_RxAccessInfo[93].ByteLengthOfRxAccessInfo "" UBYTE NO_COMPU_METHOD 0 0 0 255 ECU_ADDRESS 0x0 /end MEASUREMENT
/begin MEASUREMENT Com_RxAccessInfo[93].ConstValueArrayBasedInitValueEndIdxOfRxAccessInfo "" UBYTE Com_ConstValueArrayBasedInitValueEndIdxOfRxAccessInfoType 0 0 0 255 ECU_ADDRESS 0x0 /end MEASUREMENT
/begin MEASUREMENT Com_RxAccessInfo[93].ConstValueArrayBasedInitValueStartIdxOfRxAccessInfo "" UBYTE Com_ConstValueArrayBasedInitValueStartIdxOfRxAccessInfoType 0 0 0 255 ECU_ADDRESS 0x0 /end MEASUREMENT
/begin MEASUREMENT Com_RxAccessInfo[93].DynSignalOfRxAccessInfo "" UBYTE Com_DynSignalOfRxAccessInfoType 0 0 0 1 ECU_ADDRESS 0x0 /end MEASUREMENT
/begin MEASUREMENT Com_RxAccessInfo[93].InitValueIdxOfRxAccessInfo "" UBYTE Com_InitValueIdxOfRxAccessInfoType 0 0 0 255 ECU_ADDRESS 0x0 /end MEASUREMENT
/begin MEASUREMENT Com_RxAccessInfo[93].InitValueOfRxAccessInfo "" UBYTE Com_InitValueOfRxAccessInfoType 0 0 0 255 ECU_ADDRESS 0x0 /end MEASUREMENT
/begin MEASUREMENT Com_RxAccessInfo[93].InvValueIdxOfRxAccessInfo "" UBYTE Com_InvValueIdxOfRxAccessInfoType 0 0 0 255 ECU_ADDRESS 0x0 /end MEASUREMENT
/begin MEASUREMENT Com_RxAccessInfo[93].InvValueOfRxAccessInfo "" UBYTE Com_InvValueOfRxAccessInfoType 0 0 0 255 ECU_ADDRESS 0x0 /end MEASUREMENT
/begin MEASUREMENT Com_RxAccessInfo[93].IsGroupSignalOfRxAccessInfo "" UBYTE Com_IsGroupSignalOfRxAccessInfoType 0 0 0 1 ECU_ADDRESS 0x0 /end MEASUREMENT
/begin MEASUREMENT Com_RxAccessInfo[93].RxDataTimeoutSubstitutionValueIdxOfRxAccessInfo "" UBYTE Com_RxDataTimeoutSubstitutionValueIdxOfRxAccessInfoType 0 0 0 255 ECU_ADDRESS 0x0 /end MEASUREMENT
/begin MEASUREMENT Com_RxAccessInfo[93].RxDataTimeoutSubstitutionValueOfRxAccessInfo "" UBYTE Com_RxDataTimeoutSubstitutionValueOfRxAccessInfoType 0 0 0 255 ECU_ADDRESS 0x0 /end MEASUREMENT
/begin MEASUREMENT Com_RxAccessInfo[93].RxPduInfoIdxOfRxAccessInfo "" UBYTE NO_COMPU_METHOD 0 0 0 255 ECU_ADDRESS 0x0 /end MEASUREMENT
/begin MEASUREMENT Com_RxAccessInfo[93].RxSigBufferArrayBasedBufferEndIdxOfRxAccessInfo "" UBYTE Com_RxSigBufferArrayBasedBufferEndIdxOfRxAccessInfoType 0 0 0 255 ECU_ADDRESS 0x0 /end MEASUREMENT
/begin MEASUREMENT Com_RxAccessInfo[93].RxSigBufferArrayBasedBufferStartIdxOfRxAccessInfo "" UBYTE Com_RxSigBufferArrayBasedBufferStartIdxOfRxAccessInfoType 0 0 0 255 ECU_ADDRESS 0x0 /end MEASUREMENT
/begin MEASUREMENT Com_RxAccessInfo[93].RxSigBufferArrayBasedShdBufferEndIdxOfRxAccessInfo "" UBYTE Com_RxSigBufferArrayBasedShdBufferEndIdxOfRxAccessInfoType 0 0 0 255 ECU_ADDRESS 0x0 /end MEASUREMENT
/begin MEASUREMENT Com_RxAccessInfo[93].RxSigBufferArrayBasedShdBufferStartIdxOfRxAccessInfo "" UBYTE Com_RxSigBufferArrayBasedShdBufferStartIdxOfRxAccessInfoType 0 0 0 255 ECU_ADDRESS 0x0 /end MEASUREMENT
/begin MEASUREMENT Com_RxAccessInfo[93].RxTOutInfoIdxOfRxAccessInfo "" UBYTE Com_RxTOutInfoIdxOfRxAccessInfoType 0 0 0 255 ECU_ADDRESS 0x0 /end MEASUREMENT
/begin MEASUREMENT Com_RxAccessInfo[93].ShdBufferIdxOfRxAccessInfo "" UWORD Com_ShdBufferIdxOfRxAccessInfoType 0 0 0 65535 ECU_ADDRESS 0x0 /end MEASUREMENT
/begin MEASUREMENT Com_RxAccessInfo[93].SignalLengthInByteOfRxAccessInfo "" UBYTE NO_COMPU_METHOD 0 0 0 255 ECU_ADDRESS 0x0 /end MEASUREMENT
/begin MEASUREMENT Com_RxAccessInfo[93].StartByteInPduPositionOfRxAccessInfo "" UBYTE NO_COMPU_METHOD 0 0 0 255 ECU_ADDRESS 0x0 /end MEASUREMENT
/begin MEASUREMENT Com_RxAccessInfo[93].TmpBufferIdxOfRxAccessInfo "" UBYTE Com_TmpBufferIdxOfRxAccessInfoType 0 0 0 255 ECU_ADDRESS 0x0 /end MEASUREMENT
/begin MEASUREMENT Com_RxAccessInfo[93].TmpBufferOfRxAccessInfo "" UBYTE Com_TmpBufferOfRxAccessInfoType 0 0 0 255 ECU_ADDRESS 0x0 /end MEASUREMENT
/begin MEASUREMENT Com_RxAccessInfo[93].TmpRxShdBufferArrayBasedTmpBufferEndIdxOfRxAccessInfo "" UBYTE Com_TmpRxShdBufferArrayBasedTmpBufferEndIdxOfRxAccessInfoType 0 0 0 255 ECU_ADDRESS 0x0 /end MEASUREMENT
/begin MEASUREMENT Com_RxAccessInfo[93].TmpRxShdBufferArrayBasedTmpBufferStartIdxOfRxAccessInfo "" UBYTE Com_TmpRxShdBufferArrayBasedTmpBufferStartIdxOfRxAccessInfoType 0 0 0 255 ECU_ADDRESS 0x0 /end MEASUREMENT
/begin MEASUREMENT Com_RxAccessInfo[94].ApplTypeOfRxAccessInfo "" UBYTE Com_ApplTypeOfRxAccessInfoType 0 0 0 255 ECU_ADDRESS 0x0 /end MEASUREMENT
/begin MEASUREMENT Com_RxAccessInfo[94].BitLengthOfRxAccessInfo "" UWORD NO_COMPU_METHOD 0 0 0 65535 ECU_ADDRESS 0x0 /end MEASUREMENT
/begin MEASUREMENT Com_RxAccessInfo[94].BitPositionOfRxAccessInfo "" UWORD NO_COMPU_METHOD 0 0 0 65535 ECU_ADDRESS 0x0 /end MEASUREMENT
/begin MEASUREMENT Com_RxAccessInfo[94].BufferIdxOfRxAccessInfo "" UWORD Com_BufferIdxOfRxAccessInfoType 0 0 0 65535 ECU_ADDRESS 0x0 /end MEASUREMENT
/begin MEASUREMENT Com_RxAccessInfo[94].BusAccOfRxAccessInfo "" UBYTE Com_BusAccOfRxAccessInfoType 0 0 0 255 ECU_ADDRESS 0x0 /end MEASUREMENT
/begin MEASUREMENT Com_RxAccessInfo[94].ByteLengthOfRxAccessInfo "" UBYTE NO_COMPU_METHOD 0 0 0 255 ECU_ADDRESS 0x0 /end MEASUREMENT
/begin MEASUREMENT Com_RxAccessInfo[94].ConstValueArrayBasedInitValueEndIdxOfRxAccessInfo "" UBYTE Com_ConstValueArrayBasedInitValueEndIdxOfRxAccessInfoType 0 0 0 255 ECU_ADDRESS 0x0 /end MEASUREMENT
/begin MEASUREMENT Com_RxAccessInfo[94].ConstValueArrayBasedInitValueStartIdxOfRxAccessInfo "" UBYTE Com_ConstValueArrayBasedInitValueStartIdxOfRxAccessInfoType 0 0 0 255 ECU_ADDRESS 0x0 /end MEASUREMENT
/begin MEASUREMENT Com_RxAccessInfo[94].DynSignalOfRxAccessInfo "" UBYTE Com_DynSignalOfRxAccessInfoType 0 0 0 1 ECU_ADDRESS 0x0 /end MEASUREMENT
/begin MEASUREMENT Com_RxAccessInfo[94].InitValueIdxOfRxAccessInfo "" UBYTE Com_InitValueIdxOfRxAccessInfoType 0 0 0 255 ECU_ADDRESS 0x0 /end MEASUREMENT
/begin MEASUREMENT Com_RxAccessInfo[94].InitValueOfRxAccessInfo "" UBYTE Com_InitValueOfRxAccessInfoType 0 0 0 255 ECU_ADDRESS 0x0 /end MEASUREMENT
/begin MEASUREMENT Com_RxAccessInfo[94].InvValueIdxOfRxAccessInfo "" UBYTE Com_InvValueIdxOfRxAccessInfoType 0 0 0 255 ECU_ADDRESS 0x0 /end MEASUREMENT
/begin MEASUREMENT Com_RxAccessInfo[94].InvValueOfRxAccessInfo "" UBYTE Com_InvValueOfRxAccessInfoType 0 0 0 255 ECU_ADDRESS 0x0 /end MEASUREMENT
/begin MEASUREMENT Com_RxAccessInfo[94].IsGroupSignalOfRxAccessInfo "" UBYTE Com_IsGroupSignalOfRxAccessInfoType 0 0 0 1 ECU_ADDRESS 0x0 /end MEASUREMENT
/begin MEASUREMENT Com_RxAccessInfo[94].RxDataTimeoutSubstitutionValueIdxOfRxAccessInfo "" UBYTE Com_RxDataTimeoutSubstitutionValueIdxOfRxAccessInfoType 0 0 0 255 ECU_ADDRESS 0x0 /end MEASUREMENT
/begin MEASUREMENT Com_RxAccessInfo[94].RxDataTimeoutSubstitutionValueOfRxAccessInfo "" UBYTE Com_RxDataTimeoutSubstitutionValueOfRxAccessInfoType 0 0 0 255 ECU_ADDRESS 0x0 /end MEASUREMENT
/begin MEASUREMENT Com_RxAccessInfo[94].RxPduInfoIdxOfRxAccessInfo "" UBYTE NO_COMPU_METHOD 0 0 0 255 ECU_ADDRESS 0x0 /end MEASUREMENT
/begin MEASUREMENT Com_RxAccessInfo[94].RxSigBufferArrayBasedBufferEndIdxOfRxAccessInfo "" UBYTE Com_RxSigBufferArrayBasedBufferEndIdxOfRxAccessInfoType 0 0 0 255 ECU_ADDRESS 0x0 /end MEASUREMENT
/begin MEASUREMENT Com_RxAccessInfo[94].RxSigBufferArrayBasedBufferStartIdxOfRxAccessInfo "" UBYTE Com_RxSigBufferArrayBasedBufferStartIdxOfRxAccessInfoType 0 0 0 255 ECU_ADDRESS 0x0 /end MEASUREMENT
/begin MEASUREMENT Com_RxAccessInfo[94].RxSigBufferArrayBasedShdBufferEndIdxOfRxAccessInfo "" UBYTE Com_RxSigBufferArrayBasedShdBufferEndIdxOfRxAccessInfoType 0 0 0 255 ECU_ADDRESS 0x0 /end MEASUREMENT
/begin MEASUREMENT Com_RxAccessInfo[94].RxSigBufferArrayBasedShdBufferStartIdxOfRxAccessInfo "" UBYTE Com_RxSigBufferArrayBasedShdBufferStartIdxOfRxAccessInfoType 0 0 0 255 ECU_ADDRESS 0x0 /end MEASUREMENT
/begin MEASUREMENT Com_RxAccessInfo[94].RxTOutInfoIdxOfRxAccessInfo "" UBYTE Com_RxTOutInfoIdxOfRxAccessInfoType 0 0 0 255 ECU_ADDRESS 0x0 /end MEASUREMENT
/begin MEASUREMENT Com_RxAccessInfo[94].ShdBufferIdxOfRxAccessInfo "" UWORD Com_ShdBufferIdxOfRxAccessInfoType 0 0 0 65535 ECU_ADDRESS 0x0 /end MEASUREMENT
/begin MEASUREMENT Com_RxAccessInfo[94].SignalLengthInByteOfRxAccessInfo "" UBYTE NO_COMPU_METHOD 0 0 0 255 ECU_ADDRESS 0x0 /end MEASUREMENT
/begin MEASUREMENT Com_RxAccessInfo[94].StartByteInPduPositionOfRxAccessInfo "" UBYTE NO_COMPU_METHOD 0 0 0 255 ECU_ADDRESS 0x0 /end MEASUREMENT
/begin MEASUREMENT Com_RxAccessInfo[94].TmpBufferIdxOfRxAccessInfo "" UBYTE Com_TmpBufferIdxOfRxAccessInfoType 0 0 0 255 ECU_ADDRESS 0x0 /end MEASUREMENT
/begin MEASUREMENT Com_RxAccessInfo[94].TmpBufferOfRxAccessInfo "" UBYTE Com_TmpBufferOfRxAccessInfoType 0 0 0 255 ECU_ADDRESS 0x0 /end MEASUREMENT
/begin MEASUREMENT Com_RxAccessInfo[94].TmpRxShdBufferArrayBasedTmpBufferEndIdxOfRxAccessInfo "" UBYTE Com_TmpRxShdBufferArrayBasedTmpBufferEndIdxOfRxAccessInfoType 0 0 0 255 ECU_ADDRESS 0x0 /end MEASUREMENT
/begin MEASUREMENT Com_RxAccessInfo[94].TmpRxShdBufferArrayBasedTmpBufferStartIdxOfRxAccessInfo "" UBYTE Com_TmpRxShdBufferArrayBasedTmpBufferStartIdxOfRxAccessInfoType 0 0 0 255 ECU_ADDRESS 0x0 /end MEASUREMENT
/begin MEASUREMENT Com_RxAccessInfo[95].ApplTypeOfRxAccessInfo "" UBYTE Com_ApplTypeOfRxAccessInfoType 0 0 0 255 ECU_ADDRESS 0x0 /end MEASUREMENT
/begin MEASUREMENT Com_RxAccessInfo[95].BitLengthOfRxAccessInfo "" UWORD NO_COMPU_METHOD 0 0 0 65535 ECU_ADDRESS 0x0 /end MEASUREMENT
/begin MEASUREMENT Com_RxAccessInfo[95].BitPositionOfRxAccessInfo "" UWORD NO_COMPU_METHOD 0 0 0 65535 ECU_ADDRESS 0x0 /end MEASUREMENT
/begin MEASUREMENT Com_RxAccessInfo[95].BufferIdxOfRxAccessInfo "" UWORD Com_BufferIdxOfRxAccessInfoType 0 0 0 65535 ECU_ADDRESS 0x0 /end MEASUREMENT
/begin MEASUREMENT Com_RxAccessInfo[95].BusAccOfRxAccessInfo "" UBYTE Com_BusAccOfRxAccessInfoType 0 0 0 255 ECU_ADDRESS 0x0 /end MEASUREMENT
/begin MEASUREMENT Com_RxAccessInfo[95].ByteLengthOfRxAccessInfo "" UBYTE NO_COMPU_METHOD 0 0 0 255 ECU_ADDRESS 0x0 /end MEASUREMENT
/begin MEASUREMENT Com_RxAccessInfo[95].ConstValueArrayBasedInitValueEndIdxOfRxAccessInfo "" UBYTE Com_ConstValueArrayBasedInitValueEndIdxOfRxAccessInfoType 0 0 0 255 ECU_ADDRESS 0x0 /end MEASUREMENT
/begin MEASUREMENT Com_RxAccessInfo[95].ConstValueArrayBasedInitValueStartIdxOfRxAccessInfo "" UBYTE Com_ConstValueArrayBasedInitValueStartIdxOfRxAccessInfoType 0 0 0 255 ECU_ADDRESS 0x0 /end MEASUREMENT
/begin MEASUREMENT Com_RxAccessInfo[95].DynSignalOfRxAccessInfo "" UBYTE Com_DynSignalOfRxAccessInfoType 0 0 0 1 ECU_ADDRESS 0x0 /end MEASUREMENT
/begin MEASUREMENT Com_RxAccessInfo[95].InitValueIdxOfRxAccessInfo "" UBYTE Com_InitValueIdxOfRxAccessInfoType 0 0 0 255 ECU_ADDRESS 0x0 /end MEASUREMENT
/begin MEASUREMENT Com_RxAccessInfo[95].InitValueOfRxAccessInfo "" UBYTE Com_InitValueOfRxAccessInfoType 0 0 0 255 ECU_ADDRESS 0x0 /end MEASUREMENT
/begin MEASUREMENT Com_RxAccessInfo[95].InvValueIdxOfRxAccessInfo "" UBYTE Com_InvValueIdxOfRxAccessInfoType 0 0 0 255 ECU_ADDRESS 0x0 /end MEASUREMENT
/begin MEASUREMENT Com_RxAccessInfo[95].InvValueOfRxAccessInfo "" UBYTE Com_InvValueOfRxAccessInfoType 0 0 0 255 ECU_ADDRESS 0x0 /end MEASUREMENT
/begin MEASUREMENT Com_RxAccessInfo[95].IsGroupSignalOfRxAccessInfo "" UBYTE Com_IsGroupSignalOfRxAccessInfoType 0 0 0 1 ECU_ADDRESS 0x0 /end MEASUREMENT
/begin MEASUREMENT Com_RxAccessInfo[95].RxDataTimeoutSubstitutionValueIdxOfRxAccessInfo "" UBYTE Com_RxDataTimeoutSubstitutionValueIdxOfRxAccessInfoType 0 0 0 255 ECU_ADDRESS 0x0 /end MEASUREMENT
/begin MEASUREMENT Com_RxAccessInfo[95].RxDataTimeoutSubstitutionValueOfRxAccessInfo "" UBYTE Com_RxDataTimeoutSubstitutionValueOfRxAccessInfoType 0 0 0 255 ECU_ADDRESS 0x0 /end MEASUREMENT
/begin MEASUREMENT Com_RxAccessInfo[95].RxPduInfoIdxOfRxAccessInfo "" UBYTE NO_COMPU_METHOD 0 0 0 255 ECU_ADDRESS 0x0 /end MEASUREMENT
/begin MEASUREMENT Com_RxAccessInfo[95].RxSigBufferArrayBasedBufferEndIdxOfRxAccessInfo "" UBYTE Com_RxSigBufferArrayBasedBufferEndIdxOfRxAccessInfoType 0 0 0 255 ECU_ADDRESS 0x0 /end MEASUREMENT
/begin MEASUREMENT Com_RxAccessInfo[95].RxSigBufferArrayBasedBufferStartIdxOfRxAccessInfo "" UBYTE Com_RxSigBufferArrayBasedBufferStartIdxOfRxAccessInfoType 0 0 0 255 ECU_ADDRESS 0x0 /end MEASUREMENT
/begin MEASUREMENT Com_RxAccessInfo[95].RxSigBufferArrayBasedShdBufferEndIdxOfRxAccessInfo "" UBYTE Com_RxSigBufferArrayBasedShdBufferEndIdxOfRxAccessInfoType 0 0 0 255 ECU_ADDRESS 0x0 /end MEASUREMENT
/begin MEASUREMENT Com_RxAccessInfo[95].RxSigBufferArrayBasedShdBufferStartIdxOfRxAccessInfo "" UBYTE Com_RxSigBufferArrayBasedShdBufferStartIdxOfRxAccessInfoType 0 0 0 255 ECU_ADDRESS 0x0 /end MEASUREMENT
/begin MEASUREMENT Com_RxAccessInfo[95].RxTOutInfoIdxOfRxAccessInfo "" UBYTE Com_RxTOutInfoIdxOfRxAccessInfoType 0 0 0 255 ECU_ADDRESS 0x0 /end MEASUREMENT
/begin MEASUREMENT Com_RxAccessInfo[95].ShdBufferIdxOfRxAccessInfo "" UWORD Com_ShdBufferIdxOfRxAccessInfoType 0 0 0 65535 ECU_ADDRESS 0x0 /end MEASUREMENT
/begin MEASUREMENT Com_RxAccessInfo[95].SignalLengthInByteOfRxAccessInfo "" UBYTE NO_COMPU_METHOD 0 0 0 255 ECU_ADDRESS 0x0 /end MEASUREMENT
/begin MEASUREMENT Com_RxAccessInfo[95].StartByteInPduPositionOfRxAccessInfo "" UBYTE NO_COMPU_METHOD 0 0 0 255 ECU_ADDRESS 0x0 /end MEASUREMENT
/begin MEASUREMENT Com_RxAccessInfo[95].TmpBufferIdxOfRxAccessInfo "" UBYTE Com_TmpBufferIdxOfRxAccessInfoType 0 0 0 255 ECU_ADDRESS 0x0 /end MEASUREMENT
/begin MEASUREMENT Com_RxAccessInfo[95].TmpBufferOfRxAccessInfo "" UBYTE Com_TmpBufferOfRxAccessInfoType 0 0 0 255 ECU_ADDRESS 0x0 /end MEASUREMENT
/begin MEASUREMENT Com_RxAccessInfo[95].TmpRxShdBufferArrayBasedTmpBufferEndIdxOfRxAccessInfo "" UBYTE Com_TmpRxShdBufferArrayBasedTmpBufferEndIdxOfRxAccessInfoType 0 0 0 255 ECU_ADDRESS 0x0 /end MEASUREMENT
/begin MEASUREMENT Com_RxAccessInfo[95].TmpRxShdBufferArrayBasedTmpBufferStartIdxOfRxAccessInfo "" UBYTE Com_TmpRxShdBufferArrayBasedTmpBufferStartIdxOfRxAccessInfoType 0 0 0 255 ECU_ADDRESS 0x0 /end MEASUREMENT
/begin MEASUREMENT Com_RxAccessInfo[96].ApplTypeOfRxAccessInfo "" UBYTE Com_ApplTypeOfRxAccessInfoType 0 0 0 255 ECU_ADDRESS 0x0 /end MEASUREMENT
/begin MEASUREMENT Com_RxAccessInfo[96].BitLengthOfRxAccessInfo "" UWORD NO_COMPU_METHOD 0 0 0 65535 ECU_ADDRESS 0x0 /end MEASUREMENT
/begin MEASUREMENT Com_RxAccessInfo[96].BitPositionOfRxAccessInfo "" UWORD NO_COMPU_METHOD 0 0 0 65535 ECU_ADDRESS 0x0 /end MEASUREMENT
/begin MEASUREMENT Com_RxAccessInfo[96].BufferIdxOfRxAccessInfo "" UWORD Com_BufferIdxOfRxAccessInfoType 0 0 0 65535 ECU_ADDRESS 0x0 /end MEASUREMENT
/begin MEASUREMENT Com_RxAccessInfo[96].BusAccOfRxAccessInfo "" UBYTE Com_BusAccOfRxAccessInfoType 0 0 0 255 ECU_ADDRESS 0x0 /end MEASUREMENT
/begin MEASUREMENT Com_RxAccessInfo[96].ByteLengthOfRxAccessInfo "" UBYTE NO_COMPU_METHOD 0 0 0 255 ECU_ADDRESS 0x0 /end MEASUREMENT
/begin MEASUREMENT Com_RxAccessInfo[96].ConstValueArrayBasedInitValueEndIdxOfRxAccessInfo "" UBYTE Com_ConstValueArrayBasedInitValueEndIdxOfRxAccessInfoType 0 0 0 255 ECU_ADDRESS 0x0 /end MEASUREMENT
/begin MEASUREMENT Com_RxAccessInfo[96].ConstValueArrayBasedInitValueStartIdxOfRxAccessInfo "" UBYTE Com_ConstValueArrayBasedInitValueStartIdxOfRxAccessInfoType 0 0 0 255 ECU_ADDRESS 0x0 /end MEASUREMENT
/begin MEASUREMENT Com_RxAccessInfo[96].DynSignalOfRxAccessInfo "" UBYTE Com_DynSignalOfRxAccessInfoType 0 0 0 1 ECU_ADDRESS 0x0 /end MEASUREMENT
/begin MEASUREMENT Com_RxAccessInfo[96].InitValueIdxOfRxAccessInfo "" UBYTE Com_InitValueIdxOfRxAccessInfoType 0 0 0 255 ECU_ADDRESS 0x0 /end MEASUREMENT
/begin MEASUREMENT Com_RxAccessInfo[96].InitValueOfRxAccessInfo "" UBYTE Com_InitValueOfRxAccessInfoType 0 0 0 255 ECU_ADDRESS 0x0 /end MEASUREMENT
/begin MEASUREMENT Com_RxAccessInfo[96].InvValueIdxOfRxAccessInfo "" UBYTE Com_InvValueIdxOfRxAccessInfoType 0 0 0 255 ECU_ADDRESS 0x0 /end MEASUREMENT
/begin MEASUREMENT Com_RxAccessInfo[96].InvValueOfRxAccessInfo "" UBYTE Com_InvValueOfRxAccessInfoType 0 0 0 255 ECU_ADDRESS 0x0 /end MEASUREMENT
/begin MEASUREMENT Com_RxAccessInfo[96].IsGroupSignalOfRxAccessInfo "" UBYTE Com_IsGroupSignalOfRxAccessInfoType 0 0 0 1 ECU_ADDRESS 0x0 /end MEASUREMENT
/begin MEASUREMENT Com_RxAccessInfo[96].RxDataTimeoutSubstitutionValueIdxOfRxAccessInfo "" UBYTE Com_RxDataTimeoutSubstitutionValueIdxOfRxAccessInfoType 0 0 0 255 ECU_ADDRESS 0x0 /end MEASUREMENT
/begin MEASUREMENT Com_RxAccessInfo[96].RxDataTimeoutSubstitutionValueOfRxAccessInfo "" UBYTE Com_RxDataTimeoutSubstitutionValueOfRxAccessInfoType 0 0 0 255 ECU_ADDRESS 0x0 /end MEASUREMENT
/begin MEASUREMENT Com_RxAccessInfo[96].RxPduInfoIdxOfRxAccessInfo "" UBYTE NO_COMPU_METHOD 0 0 0 255 ECU_ADDRESS 0x0 /end MEASUREMENT
/begin MEASUREMENT Com_RxAccessInfo[96].RxSigBufferArrayBasedBufferEndIdxOfRxAccessInfo "" UBYTE Com_RxSigBufferArrayBasedBufferEndIdxOfRxAccessInfoType 0 0 0 255 ECU_ADDRESS 0x0 /end MEASUREMENT
/begin MEASUREMENT Com_RxAccessInfo[96].RxSigBufferArrayBasedBufferStartIdxOfRxAccessInfo "" UBYTE Com_RxSigBufferArrayBasedBufferStartIdxOfRxAccessInfoType 0 0 0 255 ECU_ADDRESS 0x0 /end MEASUREMENT
/begin MEASUREMENT Com_RxAccessInfo[96].RxSigBufferArrayBasedShdBufferEndIdxOfRxAccessInfo "" UBYTE Com_RxSigBufferArrayBasedShdBufferEndIdxOfRxAccessInfoType 0 0 0 255 ECU_ADDRESS 0x0 /end MEASUREMENT
/begin MEASUREMENT Com_RxAccessInfo[96].RxSigBufferArrayBasedShdBufferStartIdxOfRxAccessInfo "" UBYTE Com_RxSigBufferArrayBasedShdBufferStartIdxOfRxAccessInfoType 0 0 0 255 ECU_ADDRESS 0x0 /end MEASUREMENT
/begin MEASUREMENT Com_RxAccessInfo[96].RxTOutInfoIdxOfRxAccessInfo "" UBYTE Com_RxTOutInfoIdxOfRxAccessInfoType 0 0 0 255 ECU_ADDRESS 0x0 /end MEASUREMENT
/begin MEASUREMENT Com_RxAccessInfo[96].ShdBufferIdxOfRxAccessInfo "" UWORD Com_ShdBufferIdxOfRxAccessInfoType 0 0 0 65535 ECU_ADDRESS 0x0 /end MEASUREMENT
/begin MEASUREMENT Com_RxAccessInfo[96].SignalLengthInByteOfRxAccessInfo "" UBYTE NO_COMPU_METHOD 0 0 0 255 ECU_ADDRESS 0x0 /end MEASUREMENT
/begin MEASUREMENT Com_RxAccessInfo[96].StartByteInPduPositionOfRxAccessInfo "" UBYTE NO_COMPU_METHOD 0 0 0 255 ECU_ADDRESS 0x0 /end MEASUREMENT
/begin MEASUREMENT Com_RxAccessInfo[96].TmpBufferIdxOfRxAccessInfo "" UBYTE Com_TmpBufferIdxOfRxAccessInfoType 0 0 0 255 ECU_ADDRESS 0x0 /end MEASUREMENT
/begin MEASUREMENT Com_RxAccessInfo[96].TmpBufferOfRxAccessInfo "" UBYTE Com_TmpBufferOfRxAccessInfoType 0 0 0 255 ECU_ADDRESS 0x0 /end MEASUREMENT
/begin MEASUREMENT Com_RxAccessInfo[96].TmpRxShdBufferArrayBasedTmpBufferEndIdxOfRxAccessInfo "" UBYTE Com_TmpRxShdBufferArrayBasedTmpBufferEndIdxOfRxAccessInfoType 0 0 0 255 ECU_ADDRESS 0x0 /end MEASUREMENT
/begin MEASUREMENT Com_RxAccessInfo[96].TmpRxShdBufferArrayBasedTmpBufferStartIdxOfRxAccessInfo "" UBYTE Com_TmpRxShdBufferArrayBasedTmpBufferStartIdxOfRxAccessInfoType 0 0 0 255 ECU_ADDRESS 0x0 /end MEASUREMENT
/begin MEASUREMENT Com_RxAccessInfo[97].ApplTypeOfRxAccessInfo "" UBYTE Com_ApplTypeOfRxAccessInfoType 0 0 0 255 ECU_ADDRESS 0x0 /end MEASUREMENT
/begin MEASUREMENT Com_RxAccessInfo[97].BitLengthOfRxAccessInfo "" UWORD NO_COMPU_METHOD 0 0 0 65535 ECU_ADDRESS 0x0 /end MEASUREMENT
/begin MEASUREMENT Com_RxAccessInfo[97].BitPositionOfRxAccessInfo "" UWORD NO_COMPU_METHOD 0 0 0 65535 ECU_ADDRESS 0x0 /end MEASUREMENT
/begin MEASUREMENT Com_RxAccessInfo[97].BufferIdxOfRxAccessInfo "" UWORD Com_BufferIdxOfRxAccessInfoType 0 0 0 65535 ECU_ADDRESS 0x0 /end MEASUREMENT
/begin MEASUREMENT Com_RxAccessInfo[97].BusAccOfRxAccessInfo "" UBYTE Com_BusAccOfRxAccessInfoType 0 0 0 255 ECU_ADDRESS 0x0 /end MEASUREMENT
/begin MEASUREMENT Com_RxAccessInfo[97].ByteLengthOfRxAccessInfo "" UBYTE NO_COMPU_METHOD 0 0 0 255 ECU_ADDRESS 0x0 /end MEASUREMENT
/begin MEASUREMENT Com_RxAccessInfo[97].ConstValueArrayBasedInitValueEndIdxOfRxAccessInfo "" UBYTE Com_ConstValueArrayBasedInitValueEndIdxOfRxAccessInfoType 0 0 0 255 ECU_ADDRESS 0x0 /end MEASUREMENT
/begin MEASUREMENT Com_RxAccessInfo[97].ConstValueArrayBasedInitValueStartIdxOfRxAccessInfo "" UBYTE Com_ConstValueArrayBasedInitValueStartIdxOfRxAccessInfoType 0 0 0 255 ECU_ADDRESS 0x0 /end MEASUREMENT
/begin MEASUREMENT Com_RxAccessInfo[97].DynSignalOfRxAccessInfo "" UBYTE Com_DynSignalOfRxAccessInfoType 0 0 0 1 ECU_ADDRESS 0x0 /end MEASUREMENT
/begin MEASUREMENT Com_RxAccessInfo[97].InitValueIdxOfRxAccessInfo "" UBYTE Com_InitValueIdxOfRxAccessInfoType 0 0 0 255 ECU_ADDRESS 0x0 /end MEASUREMENT
/begin MEASUREMENT Com_RxAccessInfo[97].InitValueOfRxAccessInfo "" UBYTE Com_InitValueOfRxAccessInfoType 0 0 0 255 ECU_ADDRESS 0x0 /end MEASUREMENT
/begin MEASUREMENT Com_RxAccessInfo[97].InvValueIdxOfRxAccessInfo "" UBYTE Com_InvValueIdxOfRxAccessInfoType 0 0 0 255 ECU_ADDRESS 0x0 /end MEASUREMENT
/begin MEASUREMENT Com_RxAccessInfo[97].InvValueOfRxAccessInfo "" UBYTE Com_InvValueOfRxAccessInfoType 0 0 0 255 ECU_ADDRESS 0x0 /end MEASUREMENT
/begin MEASUREMENT Com_RxAccessInfo[97].IsGroupSignalOfRxAccessInfo "" UBYTE Com_IsGroupSignalOfRxAccessInfoType 0 0 0 1 ECU_ADDRESS 0x0 /end MEASUREMENT
/begin MEASUREMENT Com_RxAccessInfo[97].RxDataTimeoutSubstitutionValueIdxOfRxAccessInfo "" UBYTE Com_RxDataTimeoutSubstitutionValueIdxOfRxAccessInfoType 0 0 0 255 ECU_ADDRESS 0x0 /end MEASUREMENT
/begin MEASUREMENT Com_RxAccessInfo[97].RxDataTimeoutSubstitutionValueOfRxAccessInfo "" UBYTE Com_RxDataTimeoutSubstitutionValueOfRxAccessInfoType 0 0 0 255 ECU_ADDRESS 0x0 /end MEASUREMENT
/begin MEASUREMENT Com_RxAccessInfo[97].RxPduInfoIdxOfRxAccessInfo "" UBYTE NO_COMPU_METHOD 0 0 0 255 ECU_ADDRESS 0x0 /end MEASUREMENT
/begin MEASUREMENT Com_RxAccessInfo[97].RxSigBufferArrayBasedBufferEndIdxOfRxAccessInfo "" UBYTE Com_RxSigBufferArrayBasedBufferEndIdxOfRxAccessInfoType 0 0 0 255 ECU_ADDRESS 0x0 /end MEASUREMENT
/begin MEASUREMENT Com_RxAccessInfo[97].RxSigBufferArrayBasedBufferStartIdxOfRxAccessInfo "" UBYTE Com_RxSigBufferArrayBasedBufferStartIdxOfRxAccessInfoType 0 0 0 255 ECU_ADDRESS 0x0 /end MEASUREMENT
/begin MEASUREMENT Com_RxAccessInfo[97].RxSigBufferArrayBasedShdBufferEndIdxOfRxAccessInfo "" UBYTE Com_RxSigBufferArrayBasedShdBufferEndIdxOfRxAccessInfoType 0 0 0 255 ECU_ADDRESS 0x0 /end MEASUREMENT
/begin MEASUREMENT Com_RxAccessInfo[97].RxSigBufferArrayBasedShdBufferStartIdxOfRxAccessInfo "" UBYTE Com_RxSigBufferArrayBasedShdBufferStartIdxOfRxAccessInfoType 0 0 0 255 ECU_ADDRESS 0x0 /end MEASUREMENT
/begin MEASUREMENT Com_RxAccessInfo[97].RxTOutInfoIdxOfRxAccessInfo "" UBYTE Com_RxTOutInfoIdxOfRxAccessInfoType 0 0 0 255 ECU_ADDRESS 0x0 /end MEASUREMENT
/begin MEASUREMENT Com_RxAccessInfo[97].ShdBufferIdxOfRxAccessInfo "" UWORD Com_ShdBufferIdxOfRxAccessInfoType 0 0 0 65535 ECU_ADDRESS 0x0 /end MEASUREMENT
/begin MEASUREMENT Com_RxAccessInfo[97].SignalLengthInByteOfRxAccessInfo "" UBYTE NO_COMPU_METHOD 0 0 0 255 ECU_ADDRESS 0x0 /end MEASUREMENT
/begin MEASUREMENT Com_RxAccessInfo[97].StartByteInPduPositionOfRxAccessInfo "" UBYTE NO_COMPU_METHOD 0 0 0 255 ECU_ADDRESS 0x0 /end MEASUREMENT
/begin MEASUREMENT Com_RxAccessInfo[97].TmpBufferIdxOfRxAccessInfo "" UBYTE Com_TmpBufferIdxOfRxAccessInfoType 0 0 0 255 ECU_ADDRESS 0x0 /end MEASUREMENT
/begin MEASUREMENT Com_RxAccessInfo[97].TmpBufferOfRxAccessInfo "" UBYTE Com_TmpBufferOfRxAccessInfoType 0 0 0 255 ECU_ADDRESS 0x0 /end MEASUREMENT
/begin MEASUREMENT Com_RxAccessInfo[97].TmpRxShdBufferArrayBasedTmpBufferEndIdxOfRxAccessInfo "" UBYTE Com_TmpRxShdBufferArrayBasedTmpBufferEndIdxOfRxAccessInfoType 0 0 0 255 ECU_ADDRESS 0x0 /end MEASUREMENT
/begin MEASUREMENT Com_RxAccessInfo[97].TmpRxShdBufferArrayBasedTmpBufferStartIdxOfRxAccessInfo "" UBYTE Com_TmpRxShdBufferArrayBasedTmpBufferStartIdxOfRxAccessInfoType 0 0 0 255 ECU_ADDRESS 0x0 /end MEASUREMENT
/begin MEASUREMENT Com_RxAccessInfo[98].ApplTypeOfRxAccessInfo "" UBYTE Com_ApplTypeOfRxAccessInfoType 0 0 0 255 ECU_ADDRESS 0x0 /end MEASUREMENT
/begin MEASUREMENT Com_RxAccessInfo[98].BitLengthOfRxAccessInfo "" UWORD NO_COMPU_METHOD 0 0 0 65535 ECU_ADDRESS 0x0 /end MEASUREMENT
/begin MEASUREMENT Com_RxAccessInfo[98].BitPositionOfRxAccessInfo "" UWORD NO_COMPU_METHOD 0 0 0 65535 ECU_ADDRESS 0x0 /end MEASUREMENT
/begin MEASUREMENT Com_RxAccessInfo[98].BufferIdxOfRxAccessInfo "" UWORD Com_BufferIdxOfRxAccessInfoType 0 0 0 65535 ECU_ADDRESS 0x0 /end MEASUREMENT
/begin MEASUREMENT Com_RxAccessInfo[98].BusAccOfRxAccessInfo "" UBYTE Com_BusAccOfRxAccessInfoType 0 0 0 255 ECU_ADDRESS 0x0 /end MEASUREMENT
/begin MEASUREMENT Com_RxAccessInfo[98].ByteLengthOfRxAccessInfo "" UBYTE NO_COMPU_METHOD 0 0 0 255 ECU_ADDRESS 0x0 /end MEASUREMENT
/begin MEASUREMENT Com_RxAccessInfo[98].ConstValueArrayBasedInitValueEndIdxOfRxAccessInfo "" UBYTE Com_ConstValueArrayBasedInitValueEndIdxOfRxAccessInfoType 0 0 0 255 ECU_ADDRESS 0x0 /end MEASUREMENT
/begin MEASUREMENT Com_RxAccessInfo[98].ConstValueArrayBasedInitValueStartIdxOfRxAccessInfo "" UBYTE Com_ConstValueArrayBasedInitValueStartIdxOfRxAccessInfoType 0 0 0 255 ECU_ADDRESS 0x0 /end MEASUREMENT
/begin MEASUREMENT Com_RxAccessInfo[98].DynSignalOfRxAccessInfo "" UBYTE Com_DynSignalOfRxAccessInfoType 0 0 0 1 ECU_ADDRESS 0x0 /end MEASUREMENT
/begin MEASUREMENT Com_RxAccessInfo[98].InitValueIdxOfRxAccessInfo "" UBYTE Com_InitValueIdxOfRxAccessInfoType 0 0 0 255 ECU_ADDRESS 0x0 /end MEASUREMENT
/begin MEASUREMENT Com_RxAccessInfo[98].InitValueOfRxAccessInfo "" UBYTE Com_InitValueOfRxAccessInfoType 0 0 0 255 ECU_ADDRESS 0x0 /end MEASUREMENT
/begin MEASUREMENT Com_RxAccessInfo[98].InvValueIdxOfRxAccessInfo "" UBYTE Com_InvValueIdxOfRxAccessInfoType 0 0 0 255 ECU_ADDRESS 0x0 /end MEASUREMENT
/begin MEASUREMENT Com_RxAccessInfo[98].InvValueOfRxAccessInfo "" UBYTE Com_InvValueOfRxAccessInfoType 0 0 0 255 ECU_ADDRESS 0x0 /end MEASUREMENT
/begin MEASUREMENT Com_RxAccessInfo[98].IsGroupSignalOfRxAccessInfo "" UBYTE Com_IsGroupSignalOfRxAccessInfoType 0 0 0 1 ECU_ADDRESS 0x0 /end MEASUREMENT
/begin MEASUREMENT Com_RxAccessInfo[98].RxDataTimeoutSubstitutionValueIdxOfRxAccessInfo "" UBYTE Com_RxDataTimeoutSubstitutionValueIdxOfRxAccessInfoType 0 0 0 255 ECU_ADDRESS 0x0 /end MEASUREMENT
/begin MEASUREMENT Com_RxAccessInfo[98].RxDataTimeoutSubstitutionValueOfRxAccessInfo "" UBYTE Com_RxDataTimeoutSubstitutionValueOfRxAccessInfoType 0 0 0 255 ECU_ADDRESS 0x0 /end MEASUREMENT
/begin MEASUREMENT Com_RxAccessInfo[98].RxPduInfoIdxOfRxAccessInfo "" UBYTE NO_COMPU_METHOD 0 0 0 255 ECU_ADDRESS 0x0 /end MEASUREMENT
/begin MEASUREMENT Com_RxAccessInfo[98].RxSigBufferArrayBasedBufferEndIdxOfRxAccessInfo "" UBYTE Com_RxSigBufferArrayBasedBufferEndIdxOfRxAccessInfoType 0 0 0 255 ECU_ADDRESS 0x0 /end MEASUREMENT
/begin MEASUREMENT Com_RxAccessInfo[98].RxSigBufferArrayBasedBufferStartIdxOfRxAccessInfo "" UBYTE Com_RxSigBufferArrayBasedBufferStartIdxOfRxAccessInfoType 0 0 0 255 ECU_ADDRESS 0x0 /end MEASUREMENT
/begin MEASUREMENT Com_RxAccessInfo[98].RxSigBufferArrayBasedShdBufferEndIdxOfRxAccessInfo "" UBYTE Com_RxSigBufferArrayBasedShdBufferEndIdxOfRxAccessInfoType 0 0 0 255 ECU_ADDRESS 0x0 /end MEASUREMENT
/begin MEASUREMENT Com_RxAccessInfo[98].RxSigBufferArrayBasedShdBufferStartIdxOfRxAccessInfo "" UBYTE Com_RxSigBufferArrayBasedShdBufferStartIdxOfRxAccessInfoType 0 0 0 255 ECU_ADDRESS 0x0 /end MEASUREMENT
/begin MEASUREMENT Com_RxAccessInfo[98].RxTOutInfoIdxOfRxAccessInfo "" UBYTE Com_RxTOutInfoIdxOfRxAccessInfoType 0 0 0 255 ECU_ADDRESS 0x0 /end MEASUREMENT
/begin MEASUREMENT Com_RxAccessInfo[98].ShdBufferIdxOfRxAccessInfo "" UWORD Com_ShdBufferIdxOfRxAccessInfoType 0 0 0 65535 ECU_ADDRESS 0x0 /end MEASUREMENT
/begin MEASUREMENT Com_RxAccessInfo[98].SignalLengthInByteOfRxAccessInfo "" UBYTE NO_COMPU_METHOD 0 0 0 255 ECU_ADDRESS 0x0 /end MEASUREMENT
/begin MEASUREMENT Com_RxAccessInfo[98].StartByteInPduPositionOfRxAccessInfo "" UBYTE NO_COMPU_METHOD 0 0 0 255 ECU_ADDRESS 0x0 /end MEASUREMENT
/begin MEASUREMENT Com_RxAccessInfo[98].TmpBufferIdxOfRxAccessInfo "" UBYTE Com_TmpBufferIdxOfRxAccessInfoType 0 0 0 255 ECU_ADDRESS 0x0 /end MEASUREMENT
/begin MEASUREMENT Com_RxAccessInfo[98].TmpBufferOfRxAccessInfo "" UBYTE Com_TmpBufferOfRxAccessInfoType 0 0 0 255 ECU_ADDRESS 0x0 /end MEASUREMENT
/begin MEASUREMENT Com_RxAccessInfo[98].TmpRxShdBufferArrayBasedTmpBufferEndIdxOfRxAccessInfo "" UBYTE Com_TmpRxShdBufferArrayBasedTmpBufferEndIdxOfRxAccessInfoType 0 0 0 255 ECU_ADDRESS 0x0 /end MEASUREMENT
/begin MEASUREMENT Com_RxAccessInfo[98].TmpRxShdBufferArrayBasedTmpBufferStartIdxOfRxAccessInfo "" UBYTE Com_TmpRxShdBufferArrayBasedTmpBufferStartIdxOfRxAccessInfoType 0 0 0 255 ECU_ADDRESS 0x0 /end MEASUREMENT
/begin MEASUREMENT Com_RxAccessInfo[99].ApplTypeOfRxAccessInfo "" UBYTE Com_ApplTypeOfRxAccessInfoType 0 0 0 255 ECU_ADDRESS 0x0 /end MEASUREMENT
/begin MEASUREMENT Com_RxAccessInfo[99].BitLengthOfRxAccessInfo "" UWORD NO_COMPU_METHOD 0 0 0 65535 ECU_ADDRESS 0x0 /end MEASUREMENT
/begin MEASUREMENT Com_RxAccessInfo[99].BitPositionOfRxAccessInfo "" UWORD NO_COMPU_METHOD 0 0 0 65535 ECU_ADDRESS 0x0 /end MEASUREMENT
/begin MEASUREMENT Com_RxAccessInfo[99].BufferIdxOfRxAccessInfo "" UWORD Com_BufferIdxOfRxAccessInfoType 0 0 0 65535 ECU_ADDRESS 0x0 /end MEASUREMENT
/begin MEASUREMENT Com_RxAccessInfo[99].BusAccOfRxAccessInfo "" UBYTE Com_BusAccOfRxAccessInfoType 0 0 0 255 ECU_ADDRESS 0x0 /end MEASUREMENT
/begin MEASUREMENT Com_RxAccessInfo[99].ByteLengthOfRxAccessInfo "" UBYTE NO_COMPU_METHOD 0 0 0 255 ECU_ADDRESS 0x0 /end MEASUREMENT
/begin MEASUREMENT Com_RxAccessInfo[99].ConstValueArrayBasedInitValueEndIdxOfRxAccessInfo "" UBYTE Com_ConstValueArrayBasedInitValueEndIdxOfRxAccessInfoType 0 0 0 255 ECU_ADDRESS 0x0 /end MEASUREMENT
/begin MEASUREMENT Com_RxAccessInfo[99].ConstValueArrayBasedInitValueStartIdxOfRxAccessInfo "" UBYTE Com_ConstValueArrayBasedInitValueStartIdxOfRxAccessInfoType 0 0 0 255 ECU_ADDRESS 0x0 /end MEASUREMENT
/begin MEASUREMENT Com_RxAccessInfo[99].DynSignalOfRxAccessInfo "" UBYTE Com_DynSignalOfRxAccessInfoType 0 0 0 1 ECU_ADDRESS 0x0 /end MEASUREMENT
/begin MEASUREMENT Com_RxAccessInfo[99].InitValueIdxOfRxAccessInfo "" UBYTE Com_InitValueIdxOfRxAccessInfoType 0 0 0 255 ECU_ADDRESS 0x0 /end MEASUREMENT
/begin MEASUREMENT Com_RxAccessInfo[99].InitValueOfRxAccessInfo "" UBYTE Com_InitValueOfRxAccessInfoType 0 0 0 255 ECU_ADDRESS 0x0 /end MEASUREMENT
/begin MEASUREMENT Com_RxAccessInfo[99].InvValueIdxOfRxAccessInfo "" UBYTE Com_InvValueIdxOfRxAccessInfoType 0 0 0 255 ECU_ADDRESS 0x0 /end MEASUREMENT
/begin MEASUREMENT Com_RxAccessInfo[99].InvValueOfRxAccessInfo "" UBYTE Com_InvValueOfRxAccessInfoType 0 0 0 255 ECU_ADDRESS 0x0 /end MEASUREMENT
/begin MEASUREMENT Com_RxAccessInfo[99].IsGroupSignalOfRxAccessInfo "" UBYTE Com_IsGroupSignalOfRxAccessInfoType 0 0 0 1 ECU_ADDRESS 0x0 /end MEASUREMENT
/begin MEASUREMENT Com_RxAccessInfo[99].RxDataTimeoutSubstitutionValueIdxOfRxAccessInfo "" UBYTE Com_RxDataTimeoutSubstitutionValueIdxOfRxAccessInfoType 0 0 0 255 ECU_ADDRESS 0x0 /end MEASUREMENT
/begin MEASUREMENT Com_RxAccessInfo[99].RxDataTimeoutSubstitutionValueOfRxAccessInfo "" UBYTE Com_RxDataTimeoutSubstitutionValueOfRxAccessInfoType 0 0 0 255 ECU_ADDRESS 0x0 /end MEASUREMENT
/begin MEASUREMENT Com_RxAccessInfo[99].RxPduInfoIdxOfRxAccessInfo "" UBYTE NO_COMPU_METHOD 0 0 0 255 ECU_ADDRESS 0x0 /end MEASUREMENT
/begin MEASUREMENT Com_RxAccessInfo[99].RxSigBufferArrayBasedBufferEndIdxOfRxAccessInfo "" UBYTE Com_RxSigBufferArrayBasedBufferEndIdxOfRxAccessInfoType 0 0 0 255 ECU_ADDRESS 0x0 /end MEASUREMENT
/begin MEASUREMENT Com_RxAccessInfo[99].RxSigBufferArrayBasedBufferStartIdxOfRxAccessInfo "" UBYTE Com_RxSigBufferArrayBasedBufferStartIdxOfRxAccessInfoType 0 0 0 255 ECU_ADDRESS 0x0 /end MEASUREMENT
/begin MEASUREMENT Com_RxAccessInfo[99].RxSigBufferArrayBasedShdBufferEndIdxOfRxAccessInfo "" UBYTE Com_RxSigBufferArrayBasedShdBufferEndIdxOfRxAccessInfoType 0 0 0 255 ECU_ADDRESS 0x0 /end MEASUREMENT
/begin MEASUREMENT Com_RxAccessInfo[99].RxSigBufferArrayBasedShdBufferStartIdxOfRxAccessInfo "" UBYTE Com_RxSigBufferArrayBasedShdBufferStartIdxOfRxAccessInfoType 0 0 0 255 ECU_ADDRESS 0x0 /end MEASUREMENT
/begin MEASUREMENT Com_RxAccessInfo[99].RxTOutInfoIdxOfRxAccessInfo "" UBYTE Com_RxTOutInfoIdxOfRxAccessInfoType 0 0 0 255 ECU_ADDRESS 0x0 /end MEASUREMENT
/begin MEASUREMENT Com_RxAccessInfo[99].ShdBufferIdxOfRxAccessInfo "" UWORD Com_ShdBufferIdxOfRxAccessInfoType 0 0 0 65535 ECU_ADDRESS 0x0 /end MEASUREMENT
/begin MEASUREMENT Com_RxAccessInfo[99].SignalLengthInByteOfRxAccessInfo "" UBYTE NO_COMPU_METHOD 0 0 0 255 ECU_ADDRESS 0x0 /end MEASUREMENT
/begin MEASUREMENT Com_RxAccessInfo[99].StartByteInPduPositionOfRxAccessInfo "" UBYTE NO_COMPU_METHOD 0 0 0 255 ECU_ADDRESS 0x0 /end MEASUREMENT
/begin MEASUREMENT Com_RxAccessInfo[99].TmpBufferIdxOfRxAccessInfo "" UBYTE Com_TmpBufferIdxOfRxAccessInfoType 0 0 0 255 ECU_ADDRESS 0x0 /end MEASUREMENT
/begin MEASUREMENT Com_RxAccessInfo[99].TmpBufferOfRxAccessInfo "" UBYTE Com_TmpBufferOfRxAccessInfoType 0 0 0 255 ECU_ADDRESS 0x0 /end MEASUREMENT
/begin MEASUREMENT Com_RxAccessInfo[99].TmpRxShdBufferArrayBasedTmpBufferEndIdxOfRxAccessInfo "" UBYTE Com_TmpRxShdBufferArrayBasedTmpBufferEndIdxOfRxAccessInfoType 0 0 0 255 ECU_ADDRESS 0x0 /end MEASUREMENT
/begin MEASUREMENT Com_RxAccessInfo[99].TmpRxShdBufferArrayBasedTmpBufferStartIdxOfRxAccessInfo "" UBYTE Com_TmpRxShdBufferArrayBasedTmpBufferStartIdxOfRxAccessInfoType 0 0 0 255 ECU_ADDRESS 0x0 /end MEASUREMENT
/begin MEASUREMENT Com_RxAccessInfo[9].ApplTypeOfRxAccessInfo "" UBYTE Com_ApplTypeOfRxAccessInfoType 0 0 0 255 ECU_ADDRESS 0x0 /end MEASUREMENT
/begin MEASUREMENT Com_RxAccessInfo[9].BitLengthOfRxAccessInfo "" UWORD NO_COMPU_METHOD 0 0 0 65535 ECU_ADDRESS 0x0 /end MEASUREMENT
/begin MEASUREMENT Com_RxAccessInfo[9].BitPositionOfRxAccessInfo "" UWORD NO_COMPU_METHOD 0 0 0 65535 ECU_ADDRESS 0x0 /end MEASUREMENT
/begin MEASUREMENT Com_RxAccessInfo[9].BufferIdxOfRxAccessInfo "" UWORD Com_BufferIdxOfRxAccessInfoType 0 0 0 65535 ECU_ADDRESS 0x0 /end MEASUREMENT
/begin MEASUREMENT Com_RxAccessInfo[9].BusAccOfRxAccessInfo "" UBYTE Com_BusAccOfRxAccessInfoType 0 0 0 255 ECU_ADDRESS 0x0 /end MEASUREMENT
/begin MEASUREMENT Com_RxAccessInfo[9].ByteLengthOfRxAccessInfo "" UBYTE NO_COMPU_METHOD 0 0 0 255 ECU_ADDRESS 0x0 /end MEASUREMENT
/begin MEASUREMENT Com_RxAccessInfo[9].ConstValueArrayBasedInitValueEndIdxOfRxAccessInfo "" UBYTE Com_ConstValueArrayBasedInitValueEndIdxOfRxAccessInfoType 0 0 0 255 ECU_ADDRESS 0x0 /end MEASUREMENT
/begin MEASUREMENT Com_RxAccessInfo[9].ConstValueArrayBasedInitValueStartIdxOfRxAccessInfo "" UBYTE Com_ConstValueArrayBasedInitValueStartIdxOfRxAccessInfoType 0 0 0 255 ECU_ADDRESS 0x0 /end MEASUREMENT
/begin MEASUREMENT Com_RxAccessInfo[9].DynSignalOfRxAccessInfo "" UBYTE Com_DynSignalOfRxAccessInfoType 0 0 0 1 ECU_ADDRESS 0x0 /end MEASUREMENT
/begin MEASUREMENT Com_RxAccessInfo[9].InitValueIdxOfRxAccessInfo "" UBYTE Com_InitValueIdxOfRxAccessInfoType 0 0 0 255 ECU_ADDRESS 0x0 /end MEASUREMENT
/begin MEASUREMENT Com_RxAccessInfo[9].InitValueOfRxAccessInfo "" UBYTE Com_InitValueOfRxAccessInfoType 0 0 0 255 ECU_ADDRESS 0x0 /end MEASUREMENT
/begin MEASUREMENT Com_RxAccessInfo[9].InvValueIdxOfRxAccessInfo "" UBYTE Com_InvValueIdxOfRxAccessInfoType 0 0 0 255 ECU_ADDRESS 0x0 /end MEASUREMENT
/begin MEASUREMENT Com_RxAccessInfo[9].InvValueOfRxAccessInfo "" UBYTE Com_InvValueOfRxAccessInfoType 0 0 0 255 ECU_ADDRESS 0x0 /end MEASUREMENT
/begin MEASUREMENT Com_RxAccessInfo[9].IsGroupSignalOfRxAccessInfo "" UBYTE Com_IsGroupSignalOfRxAccessInfoType 0 0 0 1 ECU_ADDRESS 0x0 /end MEASUREMENT
/begin MEASUREMENT Com_RxAccessInfo[9].RxDataTimeoutSubstitutionValueIdxOfRxAccessInfo "" UBYTE Com_RxDataTimeoutSubstitutionValueIdxOfRxAccessInfoType 0 0 0 255 ECU_ADDRESS 0x0 /end MEASUREMENT
/begin MEASUREMENT Com_RxAccessInfo[9].RxDataTimeoutSubstitutionValueOfRxAccessInfo "" UBYTE Com_RxDataTimeoutSubstitutionValueOfRxAccessInfoType 0 0 0 255 ECU_ADDRESS 0x0 /end MEASUREMENT
/begin MEASUREMENT Com_RxAccessInfo[9].RxPduInfoIdxOfRxAccessInfo "" UBYTE NO_COMPU_METHOD 0 0 0 255 ECU_ADDRESS 0x0 /end MEASUREMENT
/begin MEASUREMENT Com_RxAccessInfo[9].RxSigBufferArrayBasedBufferEndIdxOfRxAccessInfo "" UBYTE Com_RxSigBufferArrayBasedBufferEndIdxOfRxAccessInfoType 0 0 0 255 ECU_ADDRESS 0x0 /end MEASUREMENT
/begin MEASUREMENT Com_RxAccessInfo[9].RxSigBufferArrayBasedBufferStartIdxOfRxAccessInfo "" UBYTE Com_RxSigBufferArrayBasedBufferStartIdxOfRxAccessInfoType 0 0 0 255 ECU_ADDRESS 0x0 /end MEASUREMENT
/begin MEASUREMENT Com_RxAccessInfo[9].RxSigBufferArrayBasedShdBufferEndIdxOfRxAccessInfo "" UBYTE Com_RxSigBufferArrayBasedShdBufferEndIdxOfRxAccessInfoType 0 0 0 255 ECU_ADDRESS 0x0 /end MEASUREMENT
/begin MEASUREMENT Com_RxAccessInfo[9].RxSigBufferArrayBasedShdBufferStartIdxOfRxAccessInfo "" UBYTE Com_RxSigBufferArrayBasedShdBufferStartIdxOfRxAccessInfoType 0 0 0 255 ECU_ADDRESS 0x0 /end MEASUREMENT
/begin MEASUREMENT Com_RxAccessInfo[9].RxTOutInfoIdxOfRxAccessInfo "" UBYTE Com_RxTOutInfoIdxOfRxAccessInfoType 0 0 0 255 ECU_ADDRESS 0x0 /end MEASUREMENT
/begin MEASUREMENT Com_RxAccessInfo[9].ShdBufferIdxOfRxAccessInfo "" UWORD Com_ShdBufferIdxOfRxAccessInfoType 0 0 0 65535 ECU_ADDRESS 0x0 /end MEASUREMENT
/begin MEASUREMENT Com_RxAccessInfo[9].SignalLengthInByteOfRxAccessInfo "" UBYTE NO_COMPU_METHOD 0 0 0 255 ECU_ADDRESS 0x0 /end MEASUREMENT
/begin MEASUREMENT Com_RxAccessInfo[9].StartByteInPduPositionOfRxAccessInfo "" UBYTE NO_COMPU_METHOD 0 0 0 255 ECU_ADDRESS 0x0 /end MEASUREMENT
/begin MEASUREMENT Com_RxAccessInfo[9].TmpBufferIdxOfRxAccessInfo "" UBYTE Com_TmpBufferIdxOfRxAccessInfoType 0 0 0 255 ECU_ADDRESS 0x0 /end MEASUREMENT
/begin MEASUREMENT Com_RxAccessInfo[9].TmpBufferOfRxAccessInfo "" UBYTE Com_TmpBufferOfRxAccessInfoType 0 0 0 255 ECU_ADDRESS 0x0 /end MEASUREMENT
/begin MEASUREMENT Com_RxAccessInfo[9].TmpRxShdBufferArrayBasedTmpBufferEndIdxOfRxAccessInfo "" UBYTE Com_TmpRxShdBufferArrayBasedTmpBufferEndIdxOfRxAccessInfoType 0 0 0 255 ECU_ADDRESS 0x0 /end MEASUREMENT
/begin MEASUREMENT Com_RxAccessInfo[9].TmpRxShdBufferArrayBasedTmpBufferStartIdxOfRxAccessInfo "" UBYTE Com_TmpRxShdBufferArrayBasedTmpBufferStartIdxOfRxAccessInfoType 0 0 0 255 ECU_ADDRESS 0x0 /end MEASUREMENT
/begin MEASUREMENT Com_RxDefPduBuffer "Rx I-PDU buffer for deferred signal processing." UBYTE NO_COMPU_METHOD 0 0 0 255 ECU_ADDRESS 0x0 MATRIX_DIM 789 SYMBOL_LINK "Com_RxDefPduBuffer.raw" 0 /end MEASUREMENT
/begin MEASUREMENT Com_RxDefPduBuffer_Airbag_10_XIX_HCP5_CANFD01_7f2c77c5_Rx "The element: Airbag_10_XIX_HCP5_CANFD01_7f2c77c5_Rx of Com_RxDefPduBuffer" UBYTE NO_COMPU_METHOD 0 0 0 255 ECU_ADDRESS 0x0 MATRIX_DIM 16 SYMBOL_LINK "Com_RxDefPduBuffer.raw[0]" 0 /end MEASUREMENT
/begin MEASUREMENT Com_RxDefPduBuffer_BJB_08_XIX_BMC_CAN01_1db9ae10_Rx "The element: BJB_08_XIX_BMC_CAN01_1db9ae10_Rx of Com_RxDefPduBuffer" UBYTE NO_COMPU_METHOD 0 0 0 255 ECU_ADDRESS 0x0 MATRIX_DIM 8 SYMBOL_LINK "Com_RxDefPduBuffer.raw[16]" 0 /end MEASUREMENT
/begin MEASUREMENT Com_RxDefPduBuffer_BJB_10_XIX_BMC_CAN01_E2E_968516b3_Rx "The element: BJB_10_XIX_BMC_CAN01_E2E_968516b3_Rx of Com_RxDefPduBuffer" UBYTE NO_COMPU_METHOD 0 0 0 255 ECU_ADDRESS 0x0 MATRIX_DIM 8 SYMBOL_LINK "Com_RxDefPduBuffer.raw[24]" 0 /end MEASUREMENT
/begin MEASUREMENT Com_RxDefPduBuffer_BJB_11_XIX_BMC_CAN01_E2E_416796eb_Rx "The element: BJB_11_XIX_BMC_CAN01_E2E_416796eb_Rx of Com_RxDefPduBuffer" UBYTE NO_COMPU_METHOD 0 0 0 255 ECU_ADDRESS 0x0 MATRIX_DIM 8 SYMBOL_LINK "Com_RxDefPduBuffer.raw[32]" 0 /end MEASUREMENT
/begin MEASUREMENT Com_RxDefPduBuffer_BJB_12_XIX_BMC_CAN01_E2E_e2311042_Rx "The element: BJB_12_XIX_BMC_CAN01_E2E_e2311042_Rx of Com_RxDefPduBuffer" UBYTE NO_COMPU_METHOD 0 0 0 255 ECU_ADDRESS 0x0 MATRIX_DIM 8 SYMBOL_LINK "Com_RxDefPduBuffer.raw[40]" 0 /end MEASUREMENT
/begin MEASUREMENT Com_RxDefPduBuffer_BJB_13_XIX_BMC_CAN01_E2E_35d3901a_Rx "The element: BJB_13_XIX_BMC_CAN01_E2E_35d3901a_Rx of Com_RxDefPduBuffer" UBYTE NO_COMPU_METHOD 0 0 0 255 ECU_ADDRESS 0x0 MATRIX_DIM 8 SYMBOL_LINK "Com_RxDefPduBuffer.raw[48]" 0 /end MEASUREMENT
/begin MEASUREMENT Com_RxDefPduBuffer_BJB_CALID_01_XIX_BMC_CAN01_adee7d66_Rx "The element: BJB_CALID_01_XIX_BMC_CAN01_adee7d66_Rx of Com_RxDefPduBuffer" UBYTE NO_COMPU_METHOD 0 0 0 255 ECU_ADDRESS 0x0 MATRIX_DIM 8 SYMBOL_LINK "Com_RxDefPduBuffer.raw[56]" 0 /end MEASUREMENT
/begin MEASUREMENT Com_RxDefPduBuffer_BJB_CALID_02_XIX_BMC_CAN01_bc93171f_Rx "The element: BJB_CALID_02_XIX_BMC_CAN01_bc93171f_Rx of Com_RxDefPduBuffer" UBYTE NO_COMPU_METHOD 0 0 0 255 ECU_ADDRESS 0x0 MATRIX_DIM 8 SYMBOL_LINK "Com_RxDefPduBuffer.raw[64]" 0 /end MEASUREMENT
/begin MEASUREMENT Com_RxDefPduBuffer_BJB_CVN_01_XIX_BMC_CAN01_301c1ddb_Rx "The element: BJB_CVN_01_XIX_BMC_CAN01_301c1ddb_Rx of Com_RxDefPduBuffer" UBYTE NO_COMPU_METHOD 0 0 0 255 ECU_ADDRESS 0x0 MATRIX_DIM 8 SYMBOL_LINK "Com_RxDefPduBuffer.raw[72]" 0 /end MEASUREMENT
/begin MEASUREMENT Com_RxDefPduBuffer_Charisma_20_XIX_HCP5_CANFD01_f51eced8_Rx "The element: Charisma_20_XIX_HCP5_CANFD01_f51eced8_Rx of Com_RxDefPduBuffer" UBYTE NO_COMPU_METHOD 0 0 0 255 ECU_ADDRESS 0x0 MATRIX_DIM 20 SYMBOL_LINK "Com_RxDefPduBuffer.raw[80]" 0 /end MEASUREMENT
/begin MEASUREMENT Com_RxDefPduBuffer_ClampControl_01_XIX_HCP5_CANFD01_8c24343b_Rx "The element: ClampControl_01_XIX_HCP5_CANFD01_8c24343b_Rx of Com_RxDefPduBuffer" UBYTE NO_COMPU_METHOD 0 0 0 255 ECU_ADDRESS 0x0 MATRIX_DIM 8 SYMBOL_LINK "Com_RxDefPduBuffer.raw[100]" 0 /end MEASUREMENT
/begin MEASUREMENT Com_RxDefPduBuffer_ComIPduPnc_EIRA_CAN_Rx "The element: ComIPduPnc_EIRA_CAN_Rx of Com_RxDefPduBuffer" UBYTE NO_COMPU_METHOD 0 0 0 255 ECU_ADDRESS 0x0 MATRIX_DIM 7 SYMBOL_LINK "Com_RxDefPduBuffer.raw[108]" 0 /end MEASUREMENT
/begin MEASUREMENT Com_RxDefPduBuffer_DCDC_04_XIX_HCP5_CANFD01_8ca88b97_Rx "The element: DCDC_04_XIX_HCP5_CANFD01_8ca88b97_Rx of Com_RxDefPduBuffer" UBYTE NO_COMPU_METHOD 0 0 0 255 ECU_ADDRESS 0x0 MATRIX_DIM 8 SYMBOL_LINK "Com_RxDefPduBuffer.raw[115]" 0 /end MEASUREMENT
/begin MEASUREMENT Com_RxDefPduBuffer_DCDC_NV_CALID_XIX_HCP5_CANFD01_46b970f2_Rx "The element: DCDC_NV_CALID_XIX_HCP5_CANFD01_46b970f2_Rx of Com_RxDefPduBuffer" UBYTE NO_COMPU_METHOD 0 0 0 255 ECU_ADDRESS 0x0 MATRIX_DIM 16 SYMBOL_LINK "Com_RxDefPduBuffer.raw[123]" 0 /end MEASUREMENT
/begin MEASUREMENT Com_RxDefPduBuffer_DCDC_NV_CVN_XIX_HCP5_CANFD01_55665719_Rx "The element: DCDC_NV_CVN_XIX_HCP5_CANFD01_55665719_Rx of Com_RxDefPduBuffer" UBYTE NO_COMPU_METHOD 0 0 0 255 ECU_ADDRESS 0x0 MATRIX_DIM 8 SYMBOL_LINK "Com_RxDefPduBuffer.raw[139]" 0 /end MEASUREMENT
/begin MEASUREMENT Com_RxDefPduBuffer_DCDC_NV_Komponentenfehler_01_XIX_HCP5_CANFD01_dd687766_Rx "The element: DCDC_NV_Komponentenfehler_01_XIX_HCP5_CANFD01_dd687766_Rx of Com_RxDefPduBuffer" UBYTE NO_COMPU_METHOD 0 0 0 255 ECU_ADDRESS 0x0 MATRIX_DIM 8 SYMBOL_LINK "Com_RxDefPduBuffer.raw[147]" 0 /end MEASUREMENT
/begin MEASUREMENT Com_RxDefPduBuffer_DCDC_NV_Komponentenfehler_02_XIX_HCP5_CANFD01_37eeaa04_Rx "The element: DCDC_NV_Komponentenfehler_02_XIX_HCP5_CANFD01_37eeaa04_Rx of Com_RxDefPduBuffer" UBYTE NO_COMPU_METHOD 0 0 0 255 ECU_ADDRESS 0x0 MATRIX_DIM 8 SYMBOL_LINK "Com_RxDefPduBuffer.raw[155]" 0 /end MEASUREMENT
/begin MEASUREMENT Com_RxDefPduBuffer_DCDC_NV_Komponentenfehler_03_XIX_HCP5_CANFD01_d8bc1ce5_Rx "The element: DCDC_NV_Komponentenfehler_03_XIX_HCP5_CANFD01_d8bc1ce5_Rx of Com_RxDefPduBuffer" UBYTE NO_COMPU_METHOD 0 0 0 255 ECU_ADDRESS 0x0 MATRIX_DIM 8 SYMBOL_LINK "Com_RxDefPduBuffer.raw[163]" 0 /end MEASUREMENT
/begin MEASUREMENT Com_RxDefPduBuffer_DCDC_NV_Komponentenfehler_04_XIX_HCP5_CANFD01_39921681_Rx "The element: DCDC_NV_Komponentenfehler_04_XIX_HCP5_CANFD01_39921681_Rx of Com_RxDefPduBuffer" UBYTE NO_COMPU_METHOD 0 0 0 255 ECU_ADDRESS 0x0 MATRIX_DIM 8 SYMBOL_LINK "Com_RxDefPduBuffer.raw[171]" 0 /end MEASUREMENT
/begin MEASUREMENT Com_RxDefPduBuffer_DEV_Hybrid_01_Req_00_XIX_HCP5_CANFD01_5661b344_Rx "The element: DEV_Hybrid_01_Req_00_XIX_HCP5_CANFD01_5661b344_Rx of Com_RxDefPduBuffer" UBYTE NO_COMPU_METHOD 0 0 0 255 ECU_ADDRESS 0x0 MATRIX_DIM 64 SYMBOL_LINK "Com_RxDefPduBuffer.raw[179]" 0 /end MEASUREMENT
/begin MEASUREMENT Com_RxDefPduBuffer_Diagnose_01_XIX_HCP5_CANFD01_426f0ab5_Rx "The element: Diagnose_01_XIX_HCP5_CANFD01_426f0ab5_Rx of Com_RxDefPduBuffer" UBYTE NO_COMPU_METHOD 0 0 0 255 ECU_ADDRESS 0x0 MATRIX_DIM 8 SYMBOL_LINK "Com_RxDefPduBuffer.raw[243]" 0 /end MEASUREMENT
/begin MEASUREMENT Com_RxDefPduBuffer_ELF_06_XIX_HCP5_CANFD01_d78b945c_Rx "The element: ELF_06_XIX_HCP5_CANFD01_d78b945c_Rx of Com_RxDefPduBuffer" UBYTE NO_COMPU_METHOD 0 0 0 255 ECU_ADDRESS 0x0 MATRIX_DIM 8 SYMBOL_LINK "Com_RxDefPduBuffer.raw[251]" 0 /end MEASUREMENT
/begin MEASUREMENT Com_RxDefPduBuffer_HCP1_17_XIX_HCP5_CANFD01_3398d6b5_Rx "The element: HCP1_17_XIX_HCP5_CANFD01_3398d6b5_Rx of Com_RxDefPduBuffer" UBYTE NO_COMPU_METHOD 0 0 0 255 ECU_ADDRESS 0x0 MATRIX_DIM 8 SYMBOL_LINK "Com_RxDefPduBuffer.raw[259]" 0 /end MEASUREMENT
/begin MEASUREMENT Com_RxDefPduBuffer_HVEM_07_XIX_HCP5_CANFD01_839f516f_Rx "The element: HVEM_07_XIX_HCP5_CANFD01_839f516f_Rx of Com_RxDefPduBuffer" UBYTE NO_COMPU_METHOD 0 0 0 255 ECU_ADDRESS 0x0 MATRIX_DIM 32 SYMBOL_LINK "Com_RxDefPduBuffer.raw[267]" 0 /end MEASUREMENT
/begin MEASUREMENT Com_RxDefPduBuffer_HVK_03_XIX_HCP5_CANFD01_E2E_8a76edcb_Rx "The element: HVK_03_XIX_HCP5_CANFD01_E2E_8a76edcb_Rx of Com_RxDefPduBuffer" UBYTE NO_COMPU_METHOD 0 0 0 255 ECU_ADDRESS 0x0 MATRIX_DIM 8 SYMBOL_LINK "Com_RxDefPduBuffer.raw[299]" 0 /end MEASUREMENT
/begin MEASUREMENT Com_RxDefPduBuffer_HVLM_13_XIX_HCP5_CANFD01_f1be44f1_Rx "The element: HVLM_13_XIX_HCP5_CANFD01_f1be44f1_Rx of Com_RxDefPduBuffer" UBYTE NO_COMPU_METHOD 0 0 0 255 ECU_ADDRESS 0x0 MATRIX_DIM 32 SYMBOL_LINK "Com_RxDefPduBuffer.raw[307]" 0 /end MEASUREMENT
/begin MEASUREMENT Com_RxDefPduBuffer_HVLM_14_XIX_HCP5_CANFD01_E2E_b3d1458f_Rx "The element: HVLM_14_XIX_HCP5_CANFD01_E2E_b3d1458f_Rx of Com_RxDefPduBuffer" UBYTE NO_COMPU_METHOD 0 0 0 255 ECU_ADDRESS 0x0 MATRIX_DIM 8 SYMBOL_LINK "Com_RxDefPduBuffer.raw[339]" 0 /end MEASUREMENT
/begin MEASUREMENT Com_RxDefPduBuffer_KS_Hybrid_01_Challenge_M_XIX_HCP5_CANFD01_3e11d538_Rx "The element: KS_Hybrid_01_Challenge_M_XIX_HCP5_CANFD01_3e11d538_Rx of Com_RxDefPduBuffer" UBYTE NO_COMPU_METHOD 0 0 0 255 ECU_ADDRESS 0x0 MATRIX_DIM 12 SYMBOL_LINK "Com_RxDefPduBuffer.raw[347]" 0 /end MEASUREMENT
/begin MEASUREMENT Com_RxDefPduBuffer_KS_Hybrid_01_Response_M_XIX_HCP5_CANFD01_78a6c4aa_Rx "The element: KS_Hybrid_01_Response_M_XIX_HCP5_CANFD01_78a6c4aa_Rx of Com_RxDefPduBuffer" UBYTE NO_COMPU_METHOD 0 0 0 255 ECU_ADDRESS 0x0 MATRIX_DIM 12 SYMBOL_LINK "Com_RxDefPduBuffer.raw[359]" 0 /end MEASUREMENT
/begin MEASUREMENT Com_RxDefPduBuffer_NVEM_12_XIX_HCP5_CANFD01_00bae280_Rx "The element: NVEM_12_XIX_HCP5_CANFD01_00bae280_Rx of Com_RxDefPduBuffer" UBYTE NO_COMPU_METHOD 0 0 0 255 ECU_ADDRESS 0x0 MATRIX_DIM 12 SYMBOL_LINK "Com_RxDefPduBuffer.raw[371]" 0 /end MEASUREMENT
/begin MEASUREMENT Com_RxDefPduBuffer_OBD_03_XIX_HCP5_CANFD01_f1281889_Rx "The element: OBD_03_XIX_HCP5_CANFD01_f1281889_Rx of Com_RxDefPduBuffer" UBYTE NO_COMPU_METHOD 0 0 0 255 ECU_ADDRESS 0x0 MATRIX_DIM 8 SYMBOL_LINK "Com_RxDefPduBuffer.raw[383]" 0 /end MEASUREMENT
/begin MEASUREMENT Com_RxDefPduBuffer_OBD_04_XIX_HCP5_CANFD01_100612ed_Rx "The element: OBD_04_XIX_HCP5_CANFD01_100612ed_Rx of Com_RxDefPduBuffer" UBYTE NO_COMPU_METHOD 0 0 0 255 ECU_ADDRESS 0x0 MATRIX_DIM 8 SYMBOL_LINK "Com_RxDefPduBuffer.raw[391]" 0 /end MEASUREMENT
/begin MEASUREMENT Com_RxDefPduBuffer_OBD_HCP1_XIX_HCP5_CANFD01_1b389b6c_Rx "The element: OBD_HCP1_XIX_HCP5_CANFD01_1b389b6c_Rx of Com_RxDefPduBuffer" UBYTE NO_COMPU_METHOD 0 0 0 255 ECU_ADDRESS 0x0 MATRIX_DIM 2 SYMBOL_LINK "Com_RxDefPduBuffer.raw[399]" 0 /end MEASUREMENT
/begin MEASUREMENT Com_RxDefPduBuffer_OBG_01_XIX_HCP5_CANFD01_8fe2f1e9_Rx "The element: OBG_01_XIX_HCP5_CANFD01_8fe2f1e9_Rx of Com_RxDefPduBuffer" UBYTE NO_COMPU_METHOD 0 0 0 255 ECU_ADDRESS 0x0 MATRIX_DIM 60 SYMBOL_LINK "Com_RxDefPduBuffer.raw[401]" 0 /end MEASUREMENT
/begin MEASUREMENT Com_RxDefPduBuffer_ORU_01_XIX_HCP5_CANFD01_8935a839_Rx "The element: ORU_01_XIX_HCP5_CANFD01_8935a839_Rx of Com_RxDefPduBuffer" UBYTE NO_COMPU_METHOD 0 0 0 255 ECU_ADDRESS 0x0 MATRIX_DIM 8 SYMBOL_LINK "Com_RxDefPduBuffer.raw[461]" 0 /end MEASUREMENT
/begin MEASUREMENT Com_RxDefPduBuffer_ORU_Control_A_01_XIX_HCP5_CANFD01_E2E_3007747a_Rx "The element: ORU_Control_A_01_XIX_HCP5_CANFD01_E2E_3007747a_Rx of Com_RxDefPduBuffer" UBYTE NO_COMPU_METHOD 0 0 0 255 ECU_ADDRESS 0x0 MATRIX_DIM 8 SYMBOL_LINK "Com_RxDefPduBuffer.raw[469]" 0 /end MEASUREMENT
/begin MEASUREMENT Com_RxDefPduBuffer_ORU_Control_D_01_XIX_HCP5_CANFD01_E2E_6e31ae8f_Rx "The element: ORU_Control_D_01_XIX_HCP5_CANFD01_E2E_6e31ae8f_Rx of Com_RxDefPduBuffer" UBYTE NO_COMPU_METHOD 0 0 0 255 ECU_ADDRESS 0x0 MATRIX_DIM 8 SYMBOL_LINK "Com_RxDefPduBuffer.raw[477]" 0 /end MEASUREMENT
/begin MEASUREMENT Com_RxDefPduBuffer_OTAMC_D_01_XIX_HCP5_CANFD01_E2E_c199b3e6_Rx "The element: OTAMC_D_01_XIX_HCP5_CANFD01_E2E_c199b3e6_Rx of Com_RxDefPduBuffer" UBYTE NO_COMPU_METHOD 0 0 0 255 ECU_ADDRESS 0x0 MATRIX_DIM 4 SYMBOL_LINK "Com_RxDefPduBuffer.raw[485]" 0 /end MEASUREMENT
/begin MEASUREMENT Com_RxDefPduBuffer_OTP_01_XIX_HCP5_CANFD01_76e7759c_Rx "The element: OTP_01_XIX_HCP5_CANFD01_76e7759c_Rx of Com_RxDefPduBuffer" UBYTE NO_COMPU_METHOD 0 0 0 255 ECU_ADDRESS 0x0 MATRIX_DIM 8 SYMBOL_LINK "Com_RxDefPduBuffer.raw[489]" 0 /end MEASUREMENT
/begin MEASUREMENT Com_RxDefPduBuffer_SOK_NoAuthenticTime_01_XIX_HCP5_CANFD01_a407ae2f_Rx "The element: SOK_NoAuthenticTime_01_XIX_HCP5_CANFD01_a407ae2f_Rx of Com_RxDefPduBuffer" UBYTE NO_COMPU_METHOD 0 0 0 255 ECU_ADDRESS 0x0 MATRIX_DIM 8 SYMBOL_LINK "Com_RxDefPduBuffer.raw[497]" 0 /end MEASUREMENT
/begin MEASUREMENT Com_RxDefPduBuffer_SOK_Zeit_Hybrid_01_Resp_01_XIX_HCP5_CANFD01_c7a98a10_Rx "The element: SOK_Zeit_Hybrid_01_Resp_01_XIX_HCP5_CANFD01_c7a98a10_Rx of Com_RxDefPduBuffer" UBYTE NO_COMPU_METHOD 0 0 0 255 ECU_ADDRESS 0x0 MATRIX_DIM 8 SYMBOL_LINK "Com_RxDefPduBuffer.raw[505]" 0 /end MEASUREMENT
/begin MEASUREMENT Com_RxDefPduBuffer_Systeminfo_01_XIX_HCP5_CANFD01_fb27c5ed_Rx "The element: Systeminfo_01_XIX_HCP5_CANFD01_fb27c5ed_Rx of Com_RxDefPduBuffer" UBYTE NO_COMPU_METHOD 0 0 0 255 ECU_ADDRESS 0x0 MATRIX_DIM 8 SYMBOL_LINK "Com_RxDefPduBuffer.raw[513]" 0 /end MEASUREMENT
/begin MEASUREMENT Com_RxDefPduBuffer_Thermomanagement_01_XIX_HCP5_CANFD01_60e8cf38_Rx "The element: Thermomanagement_01_XIX_HCP5_CANFD01_60e8cf38_Rx of Com_RxDefPduBuffer" UBYTE NO_COMPU_METHOD 0 0 0 255 ECU_ADDRESS 0x0 MATRIX_DIM 64 SYMBOL_LINK "Com_RxDefPduBuffer.raw[521]" 0 /end MEASUREMENT
/begin MEASUREMENT Com_RxDefPduBuffer_UI1_01_XIX_BMC_CAN01_E2E_cec88adf_Rx "The element: UI1_01_XIX_BMC_CAN01_E2E_cec88adf_Rx of Com_RxDefPduBuffer" UBYTE NO_COMPU_METHOD 0 0 0 255 ECU_ADDRESS 0x0 MATRIX_DIM 8 SYMBOL_LINK "Com_RxDefPduBuffer.raw[585]" 0 /end MEASUREMENT
/begin MEASUREMENT Com_RxDefPduBuffer_UI1_02_XIX_BMC_CAN01_E2E_6d9e0c76_Rx "The element: UI1_02_XIX_BMC_CAN01_E2E_6d9e0c76_Rx of Com_RxDefPduBuffer" UBYTE NO_COMPU_METHOD 0 0 0 255 ECU_ADDRESS 0x0 MATRIX_DIM 8 SYMBOL_LINK "Com_RxDefPduBuffer.raw[593]" 0 /end MEASUREMENT
/begin MEASUREMENT Com_RxDefPduBuffer_UI1_03_XIX_BMC_CAN01_4277cadb_Rx "The element: UI1_03_XIX_BMC_CAN01_4277cadb_Rx of Com_RxDefPduBuffer" UBYTE NO_COMPU_METHOD 0 0 0 255 ECU_ADDRESS 0x0 MATRIX_DIM 8 SYMBOL_LINK "Com_RxDefPduBuffer.raw[601]" 0 /end MEASUREMENT
/begin MEASUREMENT Com_RxDefPduBuffer_UI1_04_XIX_BMC_CAN01_d976c5c1_Rx "The element: UI1_04_XIX_BMC_CAN01_d976c5c1_Rx of Com_RxDefPduBuffer" UBYTE NO_COMPU_METHOD 0 0 0 255 ECU_ADDRESS 0x0 MATRIX_DIM 8 SYMBOL_LINK "Com_RxDefPduBuffer.raw[609]" 0 /end MEASUREMENT
/begin MEASUREMENT Com_RxDefPduBuffer_UI1_05_XIX_BMC_CAN01_608d1e29_Rx "The element: UI1_05_XIX_BMC_CAN01_608d1e29_Rx of Com_RxDefPduBuffer" UBYTE NO_COMPU_METHOD 0 0 0 255 ECU_ADDRESS 0x0 MATRIX_DIM 8 SYMBOL_LINK "Com_RxDefPduBuffer.raw[617]" 0 /end MEASUREMENT
/begin MEASUREMENT Com_RxDefPduBuffer_UI1_Komponentenfehler_01_XIX_BMC_CAN01_08861f77_Rx "The element: UI1_Komponentenfehler_01_XIX_BMC_CAN01_08861f77_Rx of Com_RxDefPduBuffer" UBYTE NO_COMPU_METHOD 0 0 0 255 ECU_ADDRESS 0x0 MATRIX_DIM 8 SYMBOL_LINK "Com_RxDefPduBuffer.raw[625]" 0 /end MEASUREMENT
/begin MEASUREMENT Com_RxDefPduBuffer_UI1_Komponentenfehler_02_XIX_BMC_CAN01_19fb750e_Rx "The element: UI1_Komponentenfehler_02_XIX_BMC_CAN01_19fb750e_Rx of Com_RxDefPduBuffer" UBYTE NO_COMPU_METHOD 0 0 0 255 ECU_ADDRESS 0x0 MATRIX_DIM 8 SYMBOL_LINK "Com_RxDefPduBuffer.raw[633]" 0 /end MEASUREMENT
/begin MEASUREMENT Com_RxDefPduBuffer_UI2Sens01_CALID_01_XIX_BMC_CAN01_f3c92280_Rx "The element: UI2Sens01_CALID_01_XIX_BMC_CAN01_f3c92280_Rx of Com_RxDefPduBuffer" UBYTE NO_COMPU_METHOD 0 0 0 255 ECU_ADDRESS 0x0 MATRIX_DIM 8 SYMBOL_LINK "Com_RxDefPduBuffer.raw[641]" 0 /end MEASUREMENT
/begin MEASUREMENT Com_RxDefPduBuffer_UI2Sens01_CALID_02_XIX_BMC_CAN01_e2b448f9_Rx "The element: UI2Sens01_CALID_02_XIX_BMC_CAN01_e2b448f9_Rx of Com_RxDefPduBuffer" UBYTE NO_COMPU_METHOD 0 0 0 255 ECU_ADDRESS 0x0 MATRIX_DIM 8 SYMBOL_LINK "Com_RxDefPduBuffer.raw[649]" 0 /end MEASUREMENT
/begin COMPU_METHOD Com_ApplTypeOfRxAccessInfoType "" TAB_VERB "%10.1" "" COMPU_TAB_REF Com_ApplTypeOfRxAccessInfoType /end COMPU_METHOD
/begin COMPU_METHOD Com_BufferIdxOfRxAccessInfoType "" TAB_VERB "%10.1" "" COMPU_TAB_REF Com_BufferIdxOfRxAccessInfoType /end COMPU_METHOD
/begin COMPU_METHOD Com_BusAccOfRxAccessInfoType "" TAB_VERB "%10.1" "" COMPU_TAB_REF Com_BusAccOfRxAccessInfoType /end COMPU_METHOD
/begin COMPU_METHOD Com_ConstValueArrayBasedInitValueEndIdxOfRxAccessInfoType "" TAB_VERB "%10.1" "" COMPU_TAB_REF Com_ConstValueArrayBasedInitValueEndIdxOfRxAccessInfoType /end COMPU_METHOD
/begin COMPU_METHOD Com_ConstValueArrayBasedInitValueStartIdxOfRxAccessInfoType "" TAB_VERB "%10.1" "" COMPU_TAB_REF Com_ConstValueArrayBasedInitValueStartIdxOfRxAccessInfoType /end COMPU_METHOD
/begin COMPU_METHOD Com_DynSignalOfRxAccessInfoType "" TAB_VERB "%10.1" "" COMPU_TAB_REF Com_DynSignalOfRxAccessInfoType /end COMPU_METHOD
/begin COMPU_METHOD Com_InitValueIdxOfRxAccessInfoType "" TAB_VERB "%10.1" "" COMPU_TAB_REF Com_InitValueIdxOfRxAccessInfoType /end COMPU_METHOD
/begin COMPU_METHOD Com_InitValueOfRxAccessInfoType "" TAB_VERB "%10.1" "" COMPU_TAB_REF Com_InitValueOfRxAccessInfoType /end COMPU_METHOD
/begin COMPU_METHOD Com_InvValueIdxOfRxAccessInfoType "" TAB_VERB "%10.1" "" COMPU_TAB_REF Com_InvValueIdxOfRxAccessInfoType /end COMPU_METHOD
/begin COMPU_METHOD Com_InvValueOfRxAccessInfoType "" TAB_VERB "%10.1" "" COMPU_TAB_REF Com_InvValueOfRxAccessInfoType /end COMPU_METHOD
/begin COMPU_METHOD Com_IsGroupSignalOfRxAccessInfoType "" TAB_VERB "%10.1" "" COMPU_TAB_REF Com_IsGroupSignalOfRxAccessInfoType /end COMPU_METHOD
/begin COMPU_METHOD Com_RxDataTimeoutSubstitutionValueIdxOfRxAccessInfoType "" TAB_VERB "%10.1" "" COMPU_TAB_REF Com_RxDataTimeoutSubstitutionValueIdxOfRxAccessInfoType /end COMPU_METHOD
/begin COMPU_METHOD Com_RxDataTimeoutSubstitutionValueOfRxAccessInfoType "" TAB_VERB "%10.1" "" COMPU_TAB_REF Com_RxDataTimeoutSubstitutionValueOfRxAccessInfoType /end COMPU_METHOD
/begin COMPU_METHOD Com_RxSigBufferArrayBasedBufferEndIdxOfRxAccessInfoType "" TAB_VERB "%10.1" "" COMPU_TAB_REF Com_RxSigBufferArrayBasedBufferEndIdxOfRxAccessInfoType /end COMPU_METHOD
/begin COMPU_METHOD Com_RxSigBufferArrayBasedBufferStartIdxOfRxAccessInfoType "" TAB_VERB "%10.1" "" COMPU_TAB_REF Com_RxSigBufferArrayBasedBufferStartIdxOfRxAccessInfoType /end COMPU_METHOD
/begin COMPU_METHOD Com_RxSigBufferArrayBasedShdBufferEndIdxOfRxAccessInfoType "" TAB_VERB "%10.1" "" COMPU_TAB_REF Com_RxSigBufferArrayBasedShdBufferEndIdxOfRxAccessInfoType /end COMPU_METHOD
/begin COMPU_METHOD Com_RxSigBufferArrayBasedShdBufferStartIdxOfRxAccessInfoType "" TAB_VERB "%10.1" "" COMPU_TAB_REF Com_RxSigBufferArrayBasedShdBufferStartIdxOfRxAccessInfoType /end COMPU_METHOD
/begin COMPU_METHOD Com_RxTOutInfoIdxOfRxAccessInfoType "" TAB_VERB "%10.1" "" COMPU_TAB_REF Com_RxTOutInfoIdxOfRxAccessInfoType /end COMPU_METHOD
/begin COMPU_METHOD Com_ShdBufferIdxOfRxAccessInfoType "" TAB_VERB "%10.1" "" COMPU_TAB_REF Com_ShdBufferIdxOfRxAccessInfoType /end COMPU_METHOD
/begin COMPU_METHOD Com_TmpBufferIdxOfRxAccessInfoType "" TAB_VERB "%10.1" "" COMPU_TAB_REF Com_TmpBufferIdxOfRxAccessInfoType /end COMPU_METHOD
/begin COMPU_METHOD Com_TmpBufferOfRxAccessInfoType "" TAB_VERB "%10.1" "" COMPU_TAB_REF Com_TmpBufferOfRxAccessInfoType /end COMPU_METHOD
/begin COMPU_METHOD Com_TmpRxShdBufferArrayBasedTmpBufferEndIdxOfRxAccessInfoType "" TAB_VERB "%10.1" "" COMPU_TAB_REF Com_TmpRxShdBufferArrayBasedTmpBufferEndIdxOfRxAccessInfoType /end COMPU_METHOD
/begin COMPU_METHOD Com_TmpRxShdBufferArrayBasedTmpBufferStartIdxOfRxAccessInfoType "" TAB_VERB "%10.1" "" COMPU_TAB_REF Com_TmpRxShdBufferArrayBasedTmpBufferStartIdxOfRxAccessInfoType /end COMPU_METHOD
/begin COMPU_VTAB Com_ApplTypeOfRxAccessInfoType "" TAB_VERB 4 0 "COM_UINT8_APPLTYPEOFRXACCESSINFO" 2 "COM_UINT16_APPLTYPEOFRXACCESSINFO" 4 "COM_UINT32_APPLTYPEOFRXACCESSINFO" 8 "COM_UINT8_N_APPLTYPEOFRXACCESSINFO" /end COMPU_VTAB
/begin COMPU_VTAB Com_BufferIdxOfRxAccessInfoType "" TAB_VERB 1 65535 "COM_NO_BUFFERIDXOFRXACCESSINFO" /end COMPU_VTAB
/begin COMPU_VTAB Com_BusAccOfRxAccessInfoType "" TAB_VERB 5 0 "COM_NBIT_BUSACCOFRXACCESSINFO" 1 "COM_BYTE_BUSACCOFRXACCESSINFO" 2 "COM_NBYTE_BUSACCOFRXACCESSINFO" 4 "COM_NBITNBYTE_BUSACCOFRXACCESSINFO" 6 "COM_ARRAY_BASED_BUSACCOFRXACCESSINFO" /end COMPU_VTAB
/begin COMPU_VTAB Com_ConstValueArrayBasedInitValueEndIdxOfRxAccessInfoType "" TAB_VERB 1 255 "COM_NO_CONSTVALUEARRAYBASEDINITVALUEENDIDXOFRXACCESSINFO" /end COMPU_VTAB
/begin COMPU_VTAB Com_ConstValueArrayBasedInitValueStartIdxOfRxAccessInfoType "" TAB_VERB 1 255 "COM_NO_CONSTVALUEARRAYBASEDINITVALUESTARTIDXOFRXACCESSINFO" /end COMPU_VTAB
/begin COMPU_VTAB_RANGE Com_DynSignalOfRxAccessInfoType "" 2 0 0 "FALSE" 1 255 "TRUE" /end COMPU_VTAB_RANGE
/begin COMPU_VTAB Com_InitValueIdxOfRxAccessInfoType "" TAB_VERB 1 255 "COM_NO_INITVALUEIDXOFRXACCESSINFO" /end COMPU_VTAB
/begin COMPU_VTAB Com_InitValueOfRxAccessInfoType "" TAB_VERB 4 0 "COM_CONSTVALUEUINT8_INITVALUEOFRXACCESSINFO" 1 "COM_CONSTVALUEUINT16_INITVALUEOFRXACCESSINFO" 2 "COM_CONSTVALUEUINT32_INITVALUEOFRXACCESSINFO" 255 "COM_NO_INITVALUEOFRXACCESSINFO" /end COMPU_VTAB
/begin COMPU_VTAB Com_InvValueIdxOfRxAccessInfoType "" TAB_VERB 1 255 "COM_NO_INVVALUEIDXOFRXACCESSINFO" /end COMPU_VTAB
/begin COMPU_VTAB Com_InvValueOfRxAccessInfoType "" TAB_VERB 4 0 "COM_CONSTVALUEUINT8_INVVALUEOFRXACCESSINFO" 1 "COM_CONSTVALUEUINT16_INVVALUEOFRXACCESSINFO" 2 "COM_CONSTVALUEUINT32_INVVALUEOFRXACCESSINFO" 255 "COM_NO_INVVALUEOFRXACCESSINFO" /end COMPU_VTAB
/begin COMPU_VTAB_RANGE Com_IsGroupSignalOfRxAccessInfoType "" 2 0 0 "FALSE" 1 255 "TRUE" /end COMPU_VTAB_RANGE
/begin COMPU_VTAB Com_RxDataTimeoutSubstitutionValueIdxOfRxAccessInfoType "" TAB_VERB 1 255 "COM_NO_RXDATATIMEOUTSUBSTITUTIONVALUEIDXOFRXACCESSINFO" /end COMPU_VTAB
/begin COMPU_VTAB Com_RxDataTimeoutSubstitutionValueOfRxAccessInfoType "" TAB_VERB 3 0 "COM_CONSTVALUEUINT8_RXDATATIMEOUTSUBSTITUTIONVALUEOFRXACCESSINFO" 2 "COM_CONSTVALUEUINT32_RXDATATIMEOUTSUBSTITUTIONVALUEOFRXACCESSINFO" 255 "COM_NO_RXDATATIMEOUTSUBSTITUTIONVALUEOFRXACCESSINFO" /end COMPU_VTAB
/begin COMPU_VTAB Com_RxSigBufferArrayBasedBufferEndIdxOfRxAccessInfoType "" TAB_VERB 1 255 "COM_NO_RXSIGBUFFERARRAYBASEDBUFFERENDIDXOFRXACCESSINFO" /end COMPU_VTAB
/begin COMPU_VTAB Com_RxSigBufferArrayBasedBufferStartIdxOfRxAccessInfoType "" TAB_VERB 1 255 "COM_NO_RXSIGBUFFERARRAYBASEDBUFFERSTARTIDXOFRXACCESSINFO" /end COMPU_VTAB
/begin COMPU_VTAB Com_RxSigBufferArrayBasedShdBufferEndIdxOfRxAccessInfoType "" TAB_VERB 1 255 "COM_NO_RXSIGBUFFERARRAYBASEDSHDBUFFERENDIDXOFRXACCESSINFO" /end COMPU_VTAB
/begin COMPU_VTAB Com_RxSigBufferArrayBasedShdBufferStartIdxOfRxAccessInfoType "" TAB_VERB 1 255 "COM_NO_RXSIGBUFFERARRAYBASEDSHDBUFFERSTARTIDXOFRXACCESSINFO" /end COMPU_VTAB
/begin COMPU_VTAB Com_RxTOutInfoIdxOfRxAccessInfoType "" TAB_VERB 1 255 "COM_NO_RXTOUTINFOIDXOFRXACCESSINFO" /end COMPU_VTAB
/begin COMPU_VTAB Com_ShdBufferIdxOfRxAccessInfoType "" TAB_VERB 1 65535 "COM_NO_SHDBUFFERIDXOFRXACCESSINFO" /end COMPU_VTAB
/begin COMPU_VTAB Com_TmpBufferIdxOfRxAccessInfoType "" TAB_VERB 1 255 "COM_NO_TMPBUFFERIDXOFRXACCESSINFO" /end COMPU_VTAB
/begin COMPU_VTAB Com_TmpBufferOfRxAccessInfoType "" TAB_VERB 4 0 "COM_TMPRXSHDBUFFERUINT8_TMPBUFFEROFRXACCESSINFO" 1 "COM_TMPRXSHDBUFFERUINT16_TMPBUFFEROFRXACCESSINFO" 2 "COM_TMPRXSHDBUFFERUINT32_TMPBUFFEROFRXACCESSINFO" 255 "COM_NO_TMPBUFFEROFRXACCESSINFO" /end COMPU_VTAB
/begin COMPU_VTAB Com_TmpRxShdBufferArrayBasedTmpBufferEndIdxOfRxAccessInfoType "" TAB_VERB 1 255 "COM_NO_TMPRXSHDBUFFERARRAYBASEDTMPBUFFERENDIDXOFRXACCESSINFO" /end COMPU_VTAB
/begin COMPU_VTAB Com_TmpRxShdBufferArrayBasedTmpBufferStartIdxOfRxAccessInfoType "" TAB_VERB 1 255 "COM_NO_TMPRXSHDBUFFERARRAYBASEDTMPBUFFERSTARTIDXOFRXACCESSINFO" /end COMPU_VTAB
/begin GROUP Com ""
 /begin REF_MEASUREMENT Com_RxAccessInfo[76].RxSigBufferArrayBasedBufferStartIdxOfRxAccessInfo Com_RxAccessInfo[76].RxSigBufferArrayBasedShdBufferEndIdxOfRxAccessInfo Com_RxAccessInfo[76].RxSigBufferArrayBasedShdBufferStartIdxOfRxAccessInfo Com_RxAccessInfo[76].RxTOutInfoIdxOfRxAccessInfo Com_RxAccessInfo[76].ShdBufferIdxOfRxAccessInfo Com_RxAccessInfo[76].SignalLengthInByteOfRxAccessInfo Com_RxAccessInfo[76].StartByteInPduPositionOfRxAccessInfo Com_RxAccessInfo[76].TmpBufferIdxOfRxAccessInfo Com_RxAccessInfo[76].TmpBufferOfRxAccessInfo Com_RxAccessInfo[76].TmpRxShdBufferArrayBasedTmpBufferEndIdxOfRxAccessInfo Com_RxAccessInfo[76].TmpRxShdBufferArrayBasedTmpBufferStartIdxOfRxAccessInfo Com_RxAccessInfo[77].ApplTypeOfRxAccessInfo Com_RxAccessInfo[77].BitLengthOfRxAccessInfo Com_RxAccessInfo[77].BitPositionOfRxAccessInfo Com_RxAccessInfo[77].BufferIdxOfRxAccessInfo Com_RxAccessInfo[77].BusAccOfRxAccessInfo Com_RxAccessInfo[77].ByteLengthOfRxAccessInfo Com_RxAccessInfo[77].ConstValueArrayBasedInitValueEndIdxOfRxAccessInfo Com_RxAccessInfo[77].ConstValueArrayBasedInitValueStartIdxOfRxAccessInfo Com_RxAccessInfo[77].DynSignalOfRxAccessInfo Com_RxAccessInfo[77].InitValueIdxOfRxAccessInfo Com_RxAccessInfo[77].InitValueOfRxAccessInfo Com_RxAccessInfo[77].InvValueIdxOfRxAccessInfo Com_RxAccessInfo[77].InvValueOfRxAccessInfo Com_RxAccessInfo[77].IsGroupSignalOfRxAccessInfo Com_RxAccessInfo[77].RxDataTimeoutSubstitutionValueIdxOfRxAccessInfo Com_RxAccessInfo[77].RxDataTimeoutSubstitutionValueOfRxAccessInfo Com_RxAccessInfo[77].RxPduInfoIdxOfRxAccessInfo Com_RxAccessInfo[77].RxSigBufferArrayBasedBufferEndIdxOfRxAccessInfo Com_RxAccessInfo[77].RxSigBufferArrayBasedBufferStartIdxOfRxAccessInfo Com_RxAccessInfo[77].RxSigBufferArrayBasedShdBufferEndIdxOfRxAccessInfo Com_RxAccessInfo[77].RxSigBufferArrayBasedShdBufferStartIdxOfRxAccessInfo Com_RxAccessInfo[77].RxTOutInfoIdxOfRxAccessInfo Com_RxAccessInfo[77].ShdBufferIdxOfRxAccessInfo Com_RxAccessInfo[77].SignalLengthInByteOfRxAccessInfo Com_RxAccessInfo[77].StartByteInPduPositionOfRxAccessInfo Com_RxAccessInfo[77].TmpBufferIdxOfRxAccessInfo Com_RxAccessInfo[77].TmpBufferOfRxAccessInfo Com_RxAccessInfo[77].TmpRxShdBufferArrayBasedTmpBufferEndIdxOfRxAccessInfo Com_RxAccessInfo[77].TmpRxShdBufferArrayBasedTmpBufferStartIdxOfRxAccessInfo Com_RxAccessInfo[78].ApplTypeOfRxAccessInfo Com_RxAccessInfo[78].BitLengthOfRxAccessInfo Com_RxAccessInfo[78].BitPositionOfRxAccessInfo Com_RxAccessInfo[78].BufferIdxOfRxAccessInfo Com_RxAccessInfo[78].BusAccOfRxAccessInfo Com_RxAccessInfo[78].ByteLengthOfRxAccessInfo Com_RxAccessInfo[78].ConstValueArrayBasedInitValueEndIdxOfRxAccessInfo Com_RxAccessInfo[78].ConstValueArrayBasedInitValueStartIdxOfRxAccessInfo Com_RxAccessInfo[78].DynSignalOfRxAccessInfo Com_RxAccessInfo[78].InitValueIdxOfRxAccessInfo Com_RxAccessInfo[78].InitValueOfRxAccessInfo Com_RxAccessInfo[78].InvValueIdxOfRxAccessInfo Com_RxAccessInfo[78].InvValueOfRxAccessInfo Com_RxAccessInfo[78].IsGroupSignalOfRxAccessInfo Com_RxAccessInfo[78].RxDataTimeoutSubstitutionValueIdxOfRxAccessInfo Com_RxAccessInfo[78].RxDataTimeoutSubstitutionValueOfRxAccessInfo Com_RxAccessInfo[78].RxPduInfoIdxOfRxAccessInfo Com_RxAccessInfo[78].RxSigBufferArrayBasedBufferEndIdxOfRxAccessInfo Com_RxAccessInfo[78].RxSigBufferArrayBasedBufferStartIdxOfRxAccessInfo Com_RxAccessInfo[78].RxSigBufferArrayBasedShdBufferEndIdxOfRxAccessInfo Com_RxAccessInfo[78].RxSigBufferArrayBasedShdBufferStartIdxOfRxAccessInfo Com_RxAccessInfo[78].RxTOutInfoIdxOfRxAccessInfo Com_RxAccessInfo[78].ShdBufferIdxOfRxAccessInfo Com_RxAccessInfo[78].SignalLengthInByteOfRxAccessInfo Com_RxAccessInfo[78].StartByteInPduPositionOfRxAccessInfo Com_RxAccessInfo[78].TmpBufferIdxOfRxAccessInfo Com_RxAccessInfo[78].TmpBufferOfRxAccessInfo Com_RxAccessInfo[78].TmpRxShdBufferArrayBasedTmpBufferEndIdxOfRxAccessInfo Com_RxAccessInfo[78].TmpRxShdBufferArrayBasedTmpBufferStartIdxOfRxAccessInfo Com_RxAccessInfo[79].ApplTypeOfRxAccessInfo Com_RxAccessInfo[79].BitLengthOfRxAccessInfo Com_RxAccessInfo[79].BitPositionOfRxAccessInfo Com_RxAccessInfo[79].BufferIdxOfRxAccessInfo Com_RxAccessInfo[79].BusAccOfRxAccessInfo Com_RxAccessInfo[79].ByteLengthOfRxAccessInfo Com_RxAccessInfo[79].ConstValueArrayBasedInitValueEndIdxOfRxAccessInfo Com_RxAccessInfo[79].ConstValueArrayBasedInitValueStartIdxOfRxAccessInfo Com_RxAccessInfo[79].DynSignalOfRxAccessInfo Com_RxAccessInfo[79].InitValueIdxOfRxAccessInfo Com_RxAccessInfo[79].InitValueOfRxAccessInfo Com_RxAccessInfo[79].InvValueIdxOfRxAccessInfo Com_RxAccessInfo[79].InvValueOfRxAccessInfo Com_RxAccessInfo[79].IsGroupSignalOfRxAccessInfo Com_RxAccessInfo[79].RxDataTimeoutSubstitutionValueIdxOfRxAccessInfo Com_RxAccessInfo[79].RxDataTimeoutSubstitutionValueOfRxAccessInfo Com_RxAccessInfo[79].RxPduInfoIdxOfRxAccessInfo Com_RxAccessInfo[79].RxSigBufferArrayBasedBufferEndIdxOfRxAccessInfo Com_RxAccessInfo[79].RxSigBufferArrayBasedBufferStartIdxOfRxAccessInfo Com_RxAccessInfo[79].RxSigBufferArrayBasedShdBufferEndIdxOfRxAccessInfo Com_RxAccessInfo[79].RxSigBufferArrayBasedShdBufferStartIdxOfRxAccessInfo Com_RxAccessInfo[79].RxTOutInfoIdxOfRxAccessInfo Com_RxAccessInfo[79].ShdBufferIdxOfRxAccessInfo Com_RxAccessInfo[79].SignalLengthInByteOfRxAccessInfo Com_RxAccessInfo[79].StartByteInPduPositionOfRxAccessInfo Com_RxAccessInfo[79].TmpBufferIdxOfRxAccessInfo Com_RxAccessInfo[79].TmpBufferOfRxAccessInfo Com_RxAccessInfo[79].TmpRxShdBufferArrayBasedTmpBufferEndIdxOfRxAccessInfo Com_RxAccessInfo[79].TmpRxShdBufferArrayBasedTmpBufferStartIdxOfRxAccessInfo Com_RxAccessInfo[7].ApplTypeOfRxAccessInfo Com_RxAccessInfo[7].BitLengthOfRxAccessInfo Com_RxAccessInfo[7].BitPositionOfRxAccessInfo Com_RxAccessInfo[7].BufferIdxOfRxAccessInfo Com_RxAccessInfo[7].BusAccOfRxAccessInfo Com_RxAccessInfo[7].ByteLengthOfRxAccessInfo Com_RxAccessInfo[7].ConstValueArrayBasedInitValueEndIdxOfRxAccessInfo Com_RxAccessInfo[7].ConstValueArrayBasedInitValueStartIdxOfRxAccessInfo Com_RxAccessInfo[7].DynSignalOfRxAccessInfo Com_RxAccessInfo[7].InitValueIdxOfRxAccessInfo Com_RxAccessInfo[7].InitValueOfRxAccessInfo Com_RxAccessInfo[7].InvValueIdxOfRxAccessInfo Com_RxAccessInfo[7].InvValueOfRxAccessInfo Com_RxAccessInfo[7].IsGroupSignalOfRxAccessInfo Com_RxAccessInfo[7].RxDataTimeoutSubstitutionValueIdxOfRxAccessInfo Com_RxAccessInfo[7].RxDataTimeoutSubstitutionValueOfRxAccessInfo Com_RxAccessInfo[7].RxPduInfoIdxOfRxAccessInfo Com_RxAccessInfo[7].RxSigBufferArrayBasedBufferEndIdxOfRxAccessInfo Com_RxAccessInfo[7].RxSigBufferArrayBasedBufferStartIdxOfRxAccessInfo Com_RxAccessInfo[7].RxSigBufferArrayBasedShdBufferEndIdxOfRxAccessInfo Com_RxAccessInfo[7].RxSigBufferArrayBasedShdBufferStartIdxOfRxAccessInfo Com_RxAccessInfo[7].RxTOutInfoIdxOfRxAccessInfo Com_RxAccessInfo[7].ShdBufferIdxOfRxAccessInfo Com_RxAccessInfo[7].SignalLengthInByteOfRxAccessInfo Com_RxAccessInfo[7].StartByteInPduPositionOfRxAccessInfo Com_RxAccessInfo[7].TmpBufferIdxOfRxAccessInfo Com_RxAccessInfo[7].TmpBufferOfRxAccessInfo Com_RxAccessInfo[7].TmpRxShdBufferArrayBasedTmpBufferEndIdxOfRxAccessInfo Com_RxAccessInfo[7].TmpRxShdBufferArrayBasedTmpBufferStartIdxOfRxAccessInfo Com_RxAccessInfo[80].ApplTypeOfRxAccessInfo Com_RxAccessInfo[80].BitLengthOfRxAccessInfo Com_RxAccessInfo[80].BitPositionOfRxAccessInfo Com_RxAccessInfo[80].BufferIdxOfRxAccessInfo Com_RxAccessInfo[80].BusAccOfRxAccessInfo Com_RxAccessInfo[80].ByteLengthOfRxAccessInfo Com_RxAccessInfo[80].ConstValueArrayBasedInitValueEndIdxOfRxAccessInfo Com_RxAccessInfo[80].ConstValueArrayBasedInitValueStartIdxOfRxAccessInfo Com_RxAccessInfo[80].DynSignalOfRxAccessInfo Com_RxAccessInfo[80].InitValueIdxOfRxAccessInfo Com_RxAccessInfo[80].InitValueOfRxAccessInfo Com_RxAccessInfo[80].InvValueIdxOfRxAccessInfo Com_RxAccessInfo[80].InvValueOfRxAccessInfo Com_RxAccessInfo[80].IsGroupSignalOfRxAccessInfo Com_RxAccessInfo[80].RxDataTimeoutSubstitutionValueIdxOfRxAccessInfo Com_RxAccessInfo[80].RxDataTimeoutSubstitutionValueOfRxAccessInfo Com_RxAccessInfo[80].RxPduInfoIdxOfRxAccessInfo Com_RxAccessInfo[80].RxSigBufferArrayBasedBufferEndIdxOfRxAccessInfo Com_RxAccessInfo[80].RxSigBufferArrayBasedBufferStartIdxOfRxAccessInfo Com_RxAccessInfo[80].RxSigBufferArrayBasedShdBufferEndIdxOfRxAccessInfo Com_RxAccessInfo[80].RxSigBufferArrayBasedShdBufferStartIdxOfRxAccessInfo Com_RxAccessInfo[80].RxTOutInfoIdxOfRxAccessInfo Com_RxAccessInfo[80].ShdBufferIdxOfRxAccessInfo Com_RxAccessInfo[80].SignalLengthInByteOfRxAccessInfo Com_RxAccessInfo[80].StartByteInPduPositionOfRxAccessInfo Com_RxAccessInfo[80].TmpBufferIdxOfRxAccessInfo Com_RxAccessInfo[80].TmpBufferOfRxAccessInfo Com_RxAccessInfo[80].TmpRxShdBufferArrayBasedTmpBufferEndIdxOfRxAccessInfo Com_RxAccessInfo[80].TmpRxShdBufferArrayBasedTmpBufferStartIdxOfRxAccessInfo Com_RxAccessInfo[81].ApplTypeOfRxAccessInfo Com_RxAccessInfo[81].BitLengthOfRxAccessInfo Com_RxAccessInfo[81].BitPositionOfRxAccessInfo Com_RxAccessInfo[81].BufferIdxOfRxAccessInfo Com_RxAccessInfo[81].BusAccOfRxAccessInfo Com_RxAccessInfo[81].ByteLengthOfRxAccessInfo Com_RxAccessInfo[81].ConstValueArrayBasedInitValueEndIdxOfRxAccessInfo Com_RxAccessInfo[81].ConstValueArrayBasedInitValueStartIdxOfRxAccessInfo Com_RxAccessInfo[81].DynSignalOfRxAccessInfo Com_RxAccessInfo[81].InitValueIdxOfRxAccessInfo Com_RxAccessInfo[81].InitValueOfRxAccessInfo Com_RxAccessInfo[81].InvValueIdxOfRxAccessInfo Com_RxAccessInfo[81].InvValueOfRxAccessInfo Com_RxAccessInfo[81].IsGroupSignalOfRxAccessInfo Com_RxAccessInfo[81].RxDataTimeoutSubstitutionValueIdxOfRxAccessInfo Com_RxAccessInfo[81].RxDataTimeoutSubstitutionValueOfRxAccessInfo Com_RxAccessInfo[81].RxPduInfoIdxOfRxAccessInfo Com_RxAccessInfo[81].RxSigBufferArrayBasedBufferEndIdxOfRxAccessInfo Com_RxAccessInfo[81].RxSigBufferArrayBasedBufferStartIdxOfRxAccessInfo Com_RxAccessInfo[81].RxSigBufferArrayBasedShdBufferEndIdxOfRxAccessInfo Com_RxAccessInfo[81].RxSigBufferArrayBasedShdBufferStartIdxOfRxAccessInfo Com_RxAccessInfo[81].RxTOutInfoIdxOfRxAccessInfo Com_RxAccessInfo[81].ShdBufferIdxOfRxAccessInfo Com_RxAccessInfo[81].SignalLengthInByteOfRxAccessInfo Com_RxAccessInfo[81].StartByteInPduPositionOfRxAccessInfo Com_RxAccessInfo[81].TmpBufferIdxOfRxAccessInfo Com_RxAccessInfo[81].TmpBufferOfRxAccessInfo Com_RxAccessInfo[81].TmpRxShdBufferArrayBasedTmpBufferEndIdxOfRxAccessInfo Com_RxAccessInfo[81].TmpRxShdBufferArrayBasedTmpBufferStartIdxOfRxAccessInfo Com_RxAccessInfo[82].ApplTypeOfRxAccessInfo Com_RxAccessInfo[82].BitLengthOfRxAccessInfo Com_RxAccessInfo[82].BitPositionOfRxAccessInfo Com_RxAccessInfo[82].BufferIdxOfRxAccessInfo Com_RxAccessInfo[82].BusAccOfRxAccessInfo Com_RxAccessInfo[82].ByteLengthOfRxAccessInfo Com_RxAccessInfo[82].ConstValueArrayBasedInitValueEndIdxOfRxAccessInfo Com_RxAccessInfo[82].ConstValueArrayBasedInitValueStartIdxOfRxAccessInfo Com_RxAccessInfo[82].DynSignalOfRxAccessInfo Com_RxAccessInfo[82].InitValueIdxOfRxAccessInfo Com_RxAccessInfo[82].InitValueOfRxAccessInfo Com_RxAccessInfo[82].InvValueIdxOfRxAccessInfo Com_RxAccessInfo[82].InvValueOfRxAccessInfo Com_RxAccessInfo[82].IsGroupSignalOfRxAccessInfo Com_RxAccessInfo[82].RxDataTimeoutSubstitutionValueIdxOfRxAccessInfo Com_RxAccessInfo[82].RxDataTimeoutSubstitutionValueOfRxAccessInfo Com_RxAccessInfo[82].RxPduInfoIdxOfRxAccessInfo Com_RxAccessInfo[82].RxSigBufferArrayBasedBufferEndIdxOfRxAccessInfo Com_RxAccessInfo[82].RxSigBufferArrayBasedBufferStartIdxOfRxAccessInfo Com_RxAccessInfo[82].RxSigBufferArrayBasedShdBufferEndIdxOfRxAccessInfo Com_RxAccessInfo[82].RxSigBufferArrayBasedShdBufferStartIdxOfRxAccessInfo Com_RxAccessInfo[82].RxTOutInfoIdxOfRxAccessInfo Com_RxAccessInfo[82].ShdBufferIdxOfRxAccessInfo Com_RxAccessInfo[82].SignalLengthInByteOfRxAccessInfo Com_RxAccessInfo[82].StartByteInPduPositionOfRxAccessInfo Com_RxAccessInfo[82].TmpBufferIdxOfRxAccessInfo Com_RxAccessInfo[82].TmpBufferOfRxAccessInfo Com_RxAccessInfo[82].TmpRxShdBufferArrayBasedTmpBufferEndIdxOfRxAccessInfo Com_RxAccessInfo[82].TmpRxShdBufferArrayBasedTmpBufferStartIdxOfRxAccessInfo Com_RxAccessInfo[83].ApplTypeOfRxAccessInfo Com_RxAccessInfo[83].BitLengthOfRxAccessInfo Com_RxAccessInfo[83].BitPositionOfRxAccessInfo Com_RxAccessInfo[83].BufferIdxOfRxAccessInfo Com_RxAccessInfo[83].BusAccOfRxAccessInfo Com_RxAccessInfo[83].ByteLengthOfRxAccessInfo Com_RxAccessInfo[83].ConstValueArrayBasedInitValueEndIdxOfRxAccessInfo Com_RxAccessInfo[83].ConstValueArrayBasedInitValueStartIdxOfRxAccessInfo Com_RxAccessInfo[83].DynSignalOfRxAccessInfo Com_RxAccessInfo[83].InitValueIdxOfRxAccessInfo Com_RxAccessInfo[83].InitValueOfRxAccessInfo Com_RxAccessInfo[83].InvValueIdxOfRxAccessInfo Com_RxAccessInfo[83].InvValueOfRxAccessInfo Com_RxAccessInfo[83].IsGroupSignalOfRxAccessInfo Com_RxAccessInfo[83].RxDataTimeoutSubstitutionValueIdxOfRxAccessInfo Com_RxAccessInfo[83].RxDataTimeoutSubstitutionValueOfRxAccessInfo Com_RxAccessInfo[83].RxPduInfoIdxOfRxAccessInfo Com_RxAccessInfo[83].RxSigBufferArrayBasedBufferEndIdxOfRxAccessInfo Com_RxAccessInfo[83].RxSigBufferArrayBasedBufferStartIdxOfRxAccessInfo Com_RxAccessInfo[83].RxSigBufferArrayBasedShdBufferEndIdxOfRxAccessInfo Com_RxAccessInfo[83].RxSigBufferArrayBasedShdBufferStartIdxOfRxAccessInfo Com_RxAccessInfo[83].RxTOutInfoIdxOfRxAccessInfo Com_RxAccessInfo[83].ShdBufferIdxOfRxAccessInfo Com_RxAccessInfo[83].SignalLengthInByteOfRxAccessInfo Com_RxAccessInfo[83].StartByteInPduPositionOfRxAccessInfo Com_RxAccessInfo[83].TmpBufferIdxOfRxAccessInfo Com_RxAccessInfo[83].TmpBufferOfRxAccessInfo Com_RxAccessInfo[83].TmpRxShdBufferArrayBasedTmpBufferEndIdxOfRxAccessInfo Com_RxAccessInfo[83].TmpRxShdBufferArrayBasedTmpBufferStartIdxOfRxAccessInfo Com_RxAccessInfo[84].ApplTypeOfRxAccessInfo Com_RxAccessInfo[84].BitLengthOfRxAccessInfo Com_RxAccessInfo[84].BitPositionOfRxAccessInfo Com_RxAccessInfo[84].BufferIdxOfRxAccessInfo Com_RxAccessInfo[84].BusAccOfRxAccessInfo Com_RxAccessInfo[84].ByteLengthOfRxAccessInfo Com_RxAccessInfo[84].ConstValueArrayBasedInitValueEndIdxOfRxAccessInfo Com_RxAccessInfo[84].ConstValueArrayBasedInitValueStartIdxOfRxAccessInfo Com_RxAccessInfo[84].DynSignalOfRxAccessInfo Com_RxAccessInfo[84].InitValueIdxOfRxAccessInfo Com_RxAccessInfo[84].InitValueOfRxAccessInfo Com_RxAccessInfo[84].InvValueIdxOfRxAccessInfo Com_RxAccessInfo[84].InvValueOfRxAccessInfo Com_RxAccessInfo[84].IsGroupSignalOfRxAccessInfo Com_RxAccessInfo[84].RxDataTimeoutSubstitutionValueIdxOfRxAccessInfo Com_RxAccessInfo[84].RxDataTimeoutSubstitutionValueOfRxAccessInfo Com_RxAccessInfo[84].RxPduInfoIdxOfRxAccessInfo Com_RxAccessInfo[84].RxSigBufferArrayBasedBufferEndIdxOfRxAccessInfo Com_RxAccessInfo[84].RxSigBufferArrayBasedBufferStartIdxOfRxAccessInfo Com_RxAccessInfo[84].RxSigBufferArrayBasedShdBufferEndIdxOfRxAccessInfo Com_RxAccessInfo[84].RxSigBufferArrayBasedShdBufferStartIdxOfRxAccessInfo Com_RxAccessInfo[84].RxTOutInfoIdxOfRxAccessInfo Com_RxAccessInfo[84].ShdBufferIdxOfRxAccessInfo Com_RxAccessInfo[84].SignalLengthInByteOfRxAccessInfo Com_RxAccessInfo[84].StartByteInPduPositionOfRxAccessInfo Com_RxAccessInfo[84].TmpBufferIdxOfRxAccessInfo Com_RxAccessInfo[84].TmpBufferOfRxAccessInfo Com_RxAccessInfo[84].TmpRxShdBufferArrayBasedTmpBufferEndIdxOfRxAccessInfo Com_RxAccessInfo[84].TmpRxShdBufferArrayBasedTmpBufferStartIdxOfRxAccessInfo Com_RxAccessInfo[85].ApplTypeOfRxAccessInfo Com_RxAccessInfo[85].BitLengthOfRxAccessInfo Com_RxAccessInfo[85].BitPositionOfRxAccessInfo Com_RxAccessInfo[85].BufferIdxOfRxAccessInfo Com_RxAccessInfo[85].BusAccOfRxAccessInfo Com_RxAccessInfo[85].ByteLengthOfRxAccessInfo Com_RxAccessInfo[85].ConstValueArrayBasedInitValueEndIdxOfRxAccessInfo Com_RxAccessInfo[85].ConstValueArrayBasedInitValueStartIdxOfRxAccessInfo Com_RxAccessInfo[85].DynSignalOfRxAccessInfo Com_RxAccessInfo[85].InitValueIdxOfRxAccessInfo Com_RxAccessInfo[85].InitValueOfRxAccessInfo Com_RxAccessInfo[85].InvValueIdxOfRxAccessInfo Com_RxAccessInfo[85].InvValueOfRxAccessInfo Com_RxAccessInfo[85].IsGroupSignalOfRxAccessInfo Com_RxAccessInfo[85].RxDataTimeoutSubstitutionValueIdxOfRxAccessInfo Com_RxAccessInfo[85].RxDataTimeoutSubstitutionValueOfRxAccessInfo Com_RxAccessInfo[85].RxPduInfoIdxOfRxAccessInfo Com_RxAccessInfo[85].RxSigBufferArrayBasedBufferEndIdxOfRxAccessInfo Com_RxAccessInfo[85].RxSigBufferArrayBasedBufferStartIdxOfRxAccessInfo Com_RxAccessInfo[85].RxSigBufferArrayBasedShdBufferEndIdxOfRxAccessInfo Com_RxAccessInfo[85].RxSigBufferArrayBasedShdBufferStartIdxOfRxAccessInfo Com_RxAccessInfo[85].RxTOutInfoIdxOfRxAccessInfo Com_RxAccessInfo[85].ShdBufferIdxOfRxAccessInfo Com_RxAccessInfo[85].SignalLengthInByteOfRxAccessInfo Com_RxAccessInfo[85].StartByteInPduPositionOfRxAccessInfo Com_RxAccessInfo[85].TmpBufferIdxOfRxAccessInfo Com_RxAccessInfo[85].TmpBufferOfRxAccessInfo Com_RxAccessInfo[85].TmpRxShdBufferArrayBasedTmpBufferEndIdxOfRxAccessInfo Com_RxAccessInfo[85].TmpRxShdBufferArrayBasedTmpBufferStartIdxOfRxAccessInfo Com_RxAccessInfo[86].ApplTypeOfRxAccessInfo Com_RxAccessInfo[86].BitLengthOfRxAccessInfo Com_RxAccessInfo[86].BitPositionOfRxAccessInfo Com_RxAccessInfo[86].BufferIdxOfRxAccessInfo Com_RxAccessInfo[86].BusAccOfRxAccessInfo Com_RxAccessInfo[86].ByteLengthOfRxAccessInfo Com_RxAccessInfo[86].ConstValueArrayBasedInitValueEndIdxOfRxAccessInfo Com_RxAccessInfo[86].ConstValueArrayBasedInitValueStartIdxOfRxAccessInfo Com_RxAccessInfo[86].DynSignalOfRxAccessInfo Com_RxAccessInfo[86].InitValueIdxOfRxAccessInfo Com_RxAccessInfo[86].InitValueOfRxAccessInfo Com_RxAccessInfo[86].InvValueIdxOfRxAccessInfo Com_RxAccessInfo[86].InvValueOfRxAccessInfo Com_RxAccessInfo[86].IsGroupSignalOfRxAccessInfo Com_RxAccessInfo[86].RxDataTimeoutSubstitutionValueIdxOfRxAccessInfo Com_RxAccessInfo[86].RxDataTimeoutSubstitutionValueOfRxAccessInfo Com_RxAccessInfo[86].RxPduInfoIdxOfRxAccessInfo Com_RxAccessInfo[86].RxSigBufferArrayBasedBufferEndIdxOfRxAccessInfo Com_RxAccessInfo[86].RxSigBufferArrayBasedBufferStartIdxOfRxAccessInfo Com_RxAccessInfo[86].RxSigBufferArrayBasedShdBufferEndIdxOfRxAccessInfo Com_RxAccessInfo[86].RxSigBufferArrayBasedShdBufferStartIdxOfRxAccessInfo Com_RxAccessInfo[86].RxTOutInfoIdxOfRxAccessInfo Com_RxAccessInfo[86].ShdBufferIdxOfRxAccessInfo Com_RxAccessInfo[86].SignalLengthInByteOfRxAccessInfo Com_RxAccessInfo[86].StartByteInPduPositionOfRxAccessInfo Com_RxAccessInfo[86].TmpBufferIdxOfRxAccessInfo Com_RxAccessInfo[86].TmpBufferOfRxAccessInfo Com_RxAccessInfo[86].TmpRxShdBufferArrayBasedTmpBufferEndIdxOfRxAccessInfo Com_RxAccessInfo[86].TmpRxShdBufferArrayBasedTmpBufferStartIdxOfRxAccessInfo Com_RxAccessInfo[87].ApplTypeOfRxAccessInfo Com_RxAccessInfo[87].BitLengthOfRxAccessInfo Com_RxAccessInfo[87].BitPositionOfRxAccessInfo Com_RxAccessInfo[87].BufferIdxOfRxAccessInfo Com_RxAccessInfo[87].BusAccOfRxAccessInfo Com_RxAccessInfo[87].ByteLengthOfRxAccessInfo Com_RxAccessInfo[87].ConstValueArrayBasedInitValueEndIdxOfRxAccessInfo Com_RxAccessInfo[87].ConstValueArrayBasedInitValueStartIdxOfRxAccessInfo Com_RxAccessInfo[87].DynSignalOfRxAccessInfo Com_RxAccessInfo[87].InitValueIdxOfRxAccessInfo Com_RxAccessInfo[87].InitValueOfRxAccessInfo Com_RxAccessInfo[87].InvValueIdxOfRxAccessInfo Com_RxAccessInfo[87].InvValueOfRxAccessInfo Com_RxAccessInfo[87].IsGroupSignalOfRxAccessInfo Com_RxAccessInfo[87].RxDataTimeoutSubstitutionValueIdxOfRxAccessInfo Com_RxAccessInfo[87].RxDataTimeoutSubstitutionValueOfRxAccessInfo Com_RxAccessInfo[87].RxPduInfoIdxOfRxAccessInfo Com_RxAccessInfo[87].RxSigBufferArrayBasedBufferEndIdxOfRxAccessInfo Com_RxAccessInfo[87].RxSigBufferArrayBasedBufferStartIdxOfRxAccessInfo Com_RxAccessInfo[87].RxSigBufferArrayBasedShdBufferEndIdxOfRxAccessInfo Com_RxAccessInfo[87].RxSigBufferArrayBasedShdBufferStartIdxOfRxAccessInfo Com_RxAccessInfo[87].RxTOutInfoIdxOfRxAccessInfo Com_RxAccessInfo[87].ShdBufferIdxOfRxAccessInfo Com_RxAccessInfo[87].SignalLengthInByteOfRxAccessInfo Com_RxAccessInfo[87].StartByteInPduPositionOfRxAccessInfo Com_RxAccessInfo[87].TmpBufferIdxOfRxAccessInfo Com_RxAccessInfo[87].TmpBufferOfRxAccessInfo Com_RxAccessInfo[87].TmpRxShdBufferArrayBasedTmpBufferEndIdxOfRxAccessInfo Com_RxAccessInfo[87].TmpRxShdBufferArrayBasedTmpBufferStartIdxOfRxAccessInfo Com_RxAccessInfo[88].ApplTypeOfRxAccessInfo Com_RxAccessInfo[88].BitLengthOfRxAccessInfo Com_RxAccessInfo[88].BitPositionOfRxAccessInfo Com_RxAccessInfo[88].BufferIdxOfRxAccessInfo Com_RxAccessInfo[88].BusAccOfRxAccessInfo Com_RxAccessInfo[88].ByteLengthOfRxAccessInfo Com_RxAccessInfo[88].ConstValueArrayBasedInitValueEndIdxOfRxAccessInfo Com_RxAccessInfo[88].ConstValueArrayBasedInitValueStartIdxOfRxAccessInfo Com_RxAccessInfo[88].DynSignalOfRxAccessInfo Com_RxAccessInfo[88].InitValueIdxOfRxAccessInfo Com_RxAccessInfo[88].InitValueOfRxAccessInfo Com_RxAccessInfo[88].InvValueIdxOfRxAccessInfo Com_RxAccessInfo[88].InvValueOfRxAccessInfo Com_RxAccessInfo[88].IsGroupSignalOfRxAccessInfo Com_RxAccessInfo[88].RxDataTimeoutSubstitutionValueIdxOfRxAccessInfo Com_RxAccessInfo[88].RxDataTimeoutSubstitutionValueOfRxAccessInfo Com_RxAccessInfo[88].RxPduInfoIdxOfRxAccessInfo Com_RxAccessInfo[88].RxSigBufferArrayBasedBufferEndIdxOfRxAccessInfo Com_RxAccessInfo[88].RxSigBufferArrayBasedBufferStartIdxOfRxAccessInfo Com_RxAccessInfo[88].RxSigBufferArrayBasedShdBufferEndIdxOfRxAccessInfo Com_RxAccessInfo[88].RxSigBufferArrayBasedShdBufferStartIdxOfRxAccessInfo Com_RxAccessInfo[88].RxTOutInfoIdxOfRxAccessInfo Com_RxAccessInfo[88].ShdBufferIdxOfRxAccessInfo Com_RxAccessInfo[88].SignalLengthInByteOfRxAccessInfo Com_RxAccessInfo[88].StartByteInPduPositionOfRxAccessInfo Com_RxAccessInfo[88].TmpBufferIdxOfRxAccessInfo Com_RxAccessInfo[88].TmpBufferOfRxAccessInfo Com_RxAccessInfo[88].TmpRxShdBufferArrayBasedTmpBufferEndIdxOfRxAccessInfo Com_RxAccessInfo[88].TmpRxShdBufferArrayBasedTmpBufferStartIdxOfRxAccessInfo Com_RxAccessInfo[89].ApplTypeOfRxAccessInfo Com_RxAccessInfo[89].BitLengthOfRxAccessInfo Com_RxAccessInfo[89].BitPositionOfRxAccessInfo Com_RxAccessInfo[89].BufferIdxOfRxAccessInfo Com_RxAccessInfo[89].BusAccOfRxAccessInfo Com_RxAccessInfo[89].ByteLengthOfRxAccessInfo Com_RxAccessInfo[89].ConstValueArrayBasedInitValueEndIdxOfRxAccessInfo Com_RxAccessInfo[89].ConstValueArrayBasedInitValueStartIdxOfRxAccessInfo Com_RxAccessInfo[89].DynSignalOfRxAccessInfo Com_RxAccessInfo[89].InitValueIdxOfRxAccessInfo Com_RxAccessInfo[89].InitValueOfRxAccessInfo Com_RxAccessInfo[89].InvValueIdxOfRxAccessInfo Com_RxAccessInfo[89].InvValueOfRxAccessInfo Com_RxAccessInfo[89].IsGroupSignalOfRxAccessInfo Com_RxAccessInfo[89].RxDataTimeoutSubstitutionValueIdxOfRxAccessInfo Com_RxAccessInfo[89].RxDataTimeoutSubstitutionValueOfRxAccessInfo Com_RxAccessInfo[89].RxPduInfoIdxOfRxAccessInfo Com_RxAccessInfo[89].RxSigBufferArrayBasedBufferEndIdxOfRxAccessInfo Com_RxAccessInfo[89].RxSigBufferArrayBasedBufferStartIdxOfRxAccessInfo Com_RxAccessInfo[89].RxSigBufferArrayBasedShdBufferEndIdxOfRxAccessInfo Com_RxAccessInfo[89].RxSigBufferArrayBasedShdBufferStartIdxOfRxAccessInfo Com_RxAccessInfo[89].RxTOutInfoIdxOfRxAccessInfo Com_RxAccessInfo[89].ShdBufferIdxOfRxAccessInfo Com_RxAccessInfo[89].SignalLengthInByteOfRxAccessInfo Com_RxAccessInfo[89].StartByteInPduPositionOfRxAccessInfo Com_RxAccessInfo[89].TmpBufferIdxOfRxAccessInfo Com_RxAccessInfo[89].TmpBufferOfRxAccessInfo Com_RxAccessInfo[89].TmpRxShdBufferArrayBasedTmpBufferEndIdxOfRxAccessInfo Com_RxAccessInfo[89].TmpRxShdBufferArrayBasedTmpBufferStartIdxOfRxAccessInfo Com_RxAccessInfo[8].ApplTypeOfRxAccessInfo Com_RxAccessInfo[8].BitLengthOfRxAccessInfo Com_RxAccessInfo[8].BitPositionOfRxAccessInfo Com_RxAccessInfo[8].BufferIdxOfRxAccessInfo Com_RxAccessInfo[8].BusAccOfRxAccessInfo Com_RxAccessInfo[8].ByteLengthOfRxAccessInfo Com_RxAccessInfo[8].ConstValueArrayBasedInitValueEndIdxOfRxAccessInfo Com_RxAccessInfo[8].ConstValueArrayBasedInitValueStartIdxOfRxAccessInfo Com_RxAccessInfo[8].DynSignalOfRxAccessInfo Com_RxAccessInfo[8].InitValueIdxOfRxAccessInfo Com_RxAccessInfo[8].InitValueOfRxAccessInfo Com_RxAccessInfo[8].InvValueIdxOfRxAccessInfo Com_RxAccessInfo[8].InvValueOfRxAccessInfo Com_RxAccessInfo[8].IsGroupSignalOfRxAccessInfo Com_RxAccessInfo[8].RxDataTimeoutSubstitutionValueIdxOfRxAccessInfo Com_RxAccessInfo[8].RxDataTimeoutSubstitutionValueOfRxAccessInfo Com_RxAccessInfo[8].RxPduInfoIdxOfRxAccessInfo Com_RxAccessInfo[8].RxSigBufferArrayBasedBufferEndIdxOfRxAccessInfo Com_RxAccessInfo[8].RxSigBufferArrayBasedBufferStartIdxOfRxAccessInfo Com_RxAccessInfo[8].RxSigBufferArrayBasedShdBufferEndIdxOfRxAccessInfo Com_RxAccessInfo[8].RxSigBufferArrayBasedShdBufferStartIdxOfRxAccessInfo Com_RxAccessInfo[8].RxTOutInfoIdxOfRxAccessInfo Com_RxAccessInfo[8].ShdBufferIdxOfRxAccessInfo Com_RxAccessInfo[8].SignalLengthInByteOfRxAccessInfo Com_RxAccessInfo[8].StartByteInPduPositionOfRxAccessInfo Com_RxAccessInfo[8].TmpBufferIdxOfRxAccessInfo Com_RxAccessInfo[8].TmpBufferOfRxAccessInfo Com_RxAccessInfo[8].TmpRxShdBufferArrayBasedTmpBufferEndIdxOfRxAccessInfo Com_RxAccessInfo[8].TmpRxShdBufferArrayBasedTmpBufferStartIdxOfRxAccessInfo Com_RxAccessInfo[90].ApplTypeOfRxAccessInfo Com_RxAccessInfo[90].BitLengthOfRxAccessInfo Com_RxAccessInfo[90].BitPositionOfRxAccessInfo Com_RxAccessInfo[90].BufferIdxOfRxAccessInfo Com_RxAccessInfo[90].BusAccOfRxAccessInfo Com_RxAccessInfo[90].ByteLengthOfRxAccessInfo Com_RxAccessInfo[90].ConstValueArrayBasedInitValueEndIdxOfRxAccessInfo Com_RxAccessInfo[90].ConstValueArrayBasedInitValueStartIdxOfRxAccessInfo Com_RxAccessInfo[90].DynSignalOfRxAccessInfo Com_RxAccessInfo[90].InitValueIdxOfRxAccessInfo Com_RxAccessInfo[90].InitValueOfRxAccessInfo Com_RxAccessInfo[90].InvValueIdxOfRxAccessInfo Com_RxAccessInfo[90].InvValueOfRxAccessInfo Com_RxAccessInfo[90].IsGroupSignalOfRxAccessInfo Com_RxAccessInfo[90].RxDataTimeoutSubstitutionValueIdxOfRxAccessInfo Com_RxAccessInfo[90].RxDataTimeoutSubstitutionValueOfRxAccessInfo Com_RxAccessInfo[90].RxPduInfoIdxOfRxAccessInfo Com_RxAccessInfo[90].RxSigBufferArrayBasedBufferEndIdxOfRxAccessInfo Com_RxAccessInfo[90].RxSigBufferArrayBasedBufferStartIdxOfRxAccessInfo Com_RxAccessInfo[90].RxSigBufferArrayBasedShdBufferEndIdxOfRxAccessInfo Com_RxAccessInfo[90].RxSigBufferArrayBasedShdBufferStartIdxOfRxAccessInfo Com_RxAccessInfo[90].RxTOutInfoIdxOfRxAccessInfo Com_RxAccessInfo[90].ShdBufferIdxOfRxAccessInfo Com_RxAccessInfo[90].SignalLengthInByteOfRxAccessInfo Com_RxAccessInfo[90].StartByteInPduPositionOfRxAccessInfo Com_RxAccessInfo[90].TmpBufferIdxOfRxAccessInfo Com_RxAccessInfo[90].TmpBufferOfRxAccessInfo Com_RxAccessInfo[90].TmpRxShdBufferArrayBasedTmpBufferEndIdxOfRxAccessInfo Com_RxAccessInfo[90].TmpRxShdBufferArrayBasedTmpBufferStartIdxOfRxAccessInfo Com_RxAccessInfo[91].ApplTypeOfRxAccessInfo Com_RxAccessInfo[91].BitLengthOfRxAccessInfo Com_RxAccessInfo[91].BitPositionOfRxAccessInfo Com_RxAccessInfo[91].BufferIdxOfRxAccessInfo Com_RxAccessInfo[91].BusAccOfRxAccessInfo Com_RxAccessInfo[91].ByteLengthOfRxAccessInfo Com_RxAccessInfo[91].ConstValueArrayBasedInitValueEndIdxOfRxAccessInfo Com_RxAccessInfo[91].ConstValueArrayBasedInitValueStartIdxOfRxAccessInfo Com_RxAccessInfo[91].DynSignalOfRxAccessInfo Com_RxAccessInfo[91].InitValueIdxOfRxAccessInfo Com_RxAccessInfo[91].InitValueOfRxAccessInfo Com_RxAccessInfo[91].InvValueIdxOfRxAccessInfo Com_RxAccessInfo[91].InvValueOfRxAccessInfo Com_RxAccessInfo[91].IsGroupSignalOfRxAccessInfo Com_RxAccessInfo[91].RxDataTimeoutSubstitutionValueIdxOfRxAccessInfo Com_RxAccessInfo[91].RxDataTimeoutSubstitutionValueOfRxAccessInfo Com_RxAccessInfo[91].RxPduInfoIdxOfRxAccessInfo Com_RxAccessInfo[91].RxSigBufferArrayBasedBufferEndIdxOfRxAccessInfo Com_RxAccessInfo[91].RxSigBufferArrayBasedBufferStartIdxOfRxAccessInfo Com_RxAccessInfo[91].RxSigBufferArrayBasedShdBufferEndIdxOfRxAccessInfo Com_RxAccessInfo[91].RxSigBufferArrayBasedShdBufferStartIdxOfRxAccessInfo Com_RxAccessInfo[91].RxTOutInfoIdxOfRxAccessInfo Com_RxAccessInfo[91].ShdBufferIdxOfRxAccessInfo Com_RxAccessInfo[91].SignalLengthInByteOfRxAccessInfo Com_RxAccessInfo[91].StartByteInPduPositionOfRxAccessInfo Com_RxAccessInfo[91].TmpBufferIdxOfRxAccessInfo Com_RxAccessInfo[91].TmpBufferOfRxAccessInfo Com_RxAccessInfo[91].TmpRxShdBufferArrayBasedTmpBufferEndIdxOfRxAccessInfo Com_RxAccessInfo[91].TmpRxShdBufferArrayBasedTmpBufferStartIdxOfRxAccessInfo Com_RxAccessInfo[92].ApplTypeOfRxAccessInfo Com_RxAccessInfo[92].BitLengthOfRxAccessInfo Com_RxAccessInfo[92].BitPositionOfRxAccessInfo Com_RxAccessInfo[92].BufferIdxOfRxAccessInfo Com_RxAccessInfo[92].BusAccOfRxAccessInfo Com_RxAccessInfo[92].ByteLengthOfRxAccessInfo Com_RxAccessInfo[92].ConstValueArrayBasedInitValueEndIdxOfRxAccessInfo Com_RxAccessInfo[92].ConstValueArrayBasedInitValueStartIdxOfRxAccessInfo Com_RxAccessInfo[92].DynSignalOfRxAccessInfo Com_RxAccessInfo[92].InitValueIdxOfRxAccessInfo Com_RxAccessInfo[92].InitValueOfRxAccessInfo Com_RxAccessInfo[92].InvValueIdxOfRxAccessInfo Com_RxAccessInfo[92].InvValueOfRxAccessInfo Com_RxAccessInfo[92].IsGroupSignalOfRxAccessInfo Com_RxAccessInfo[92].RxDataTimeoutSubstitutionValueIdxOfRxAccessInfo Com_RxAccessInfo[92].RxDataTimeoutSubstitutionValueOfRxAccessInfo Com_RxAccessInfo[92].RxPduInfoIdxOfRxAccessInfo Com_RxAccessInfo[92].RxSigBufferArrayBasedBufferEndIdxOfRxAccessInfo Com_RxAccessInfo[92].RxSigBufferArrayBasedBufferStartIdxOfRxAccessInfo Com_RxAccessInfo[92].RxSigBufferArrayBasedShdBufferEndIdxOfRxAccessInfo Com_RxAccessInfo[92].RxSigBufferArrayBasedShdBufferStartIdxOfRxAccessInfo Com_RxAccessInfo[92].RxTOutInfoIdxOfRxAccessInfo Com_RxAccessInfo[92].ShdBufferIdxOfRxAccessInfo Com_RxAccessInfo[92].SignalLengthInByteOfRxAccessInfo Com_RxAccessInfo[92].StartByteInPduPositionOfRxAccessInfo Com_RxAccessInfo[92].TmpBufferIdxOfRxAccessInfo Com_RxAccessInfo[92].TmpBufferOfRxAccessInfo Com_RxAccessInfo[92].TmpRxShdBufferArrayBasedTmpBufferEndIdxOfRxAccessInfo Com_RxAccessInfo[92].TmpRxShdBufferArrayBasedTmpBufferStartIdxOfRxAccessInfo Com_RxAccessInfo[93].ApplTypeOfRxAccessInfo Com_RxAccessInfo[93].BitLengthOfRxAccessInfo Com_RxAccessInfo[93].BitPositionOfRxAccessInfo Com_RxAccessInfo[93].BufferIdxOfRxAccessInfo Com_RxAccessInfo[93].BusAccOfRxAccessInfo Com_RxAccessInfo[93].ByteLengthOfRxAccessInfo Com_RxAccessInfo[93].ConstValueArrayBasedInitValueEndIdxOfRxAccessInfo Com_RxAccessInfo[93].ConstValueArrayBasedInitValueStartIdxOfRxAccessInfo Com_RxAccessInfo[93].DynSignalOfRxAccessInfo Com_RxAccessInfo[93].InitValueIdxOfRxAccessInfo Com_RxAccessInfo[93].InitValueOfRxAccessInfo Com_RxAccessInfo[93].InvValueIdxOfRxAccessInfo Com_RxAccessInfo[93].InvValueOfRxAccessInfo Com_RxAccessInfo[93].IsGroupSignalOfRxAccessInfo Com_RxAccessInfo[93].RxDataTimeoutSubstitutionValueIdxOfRxAccessInfo Com_RxAccessInfo[93].RxDataTimeoutSubstitutionValueOfRxAccessInfo Com_RxAccessInfo[93].RxPduInfoIdxOfRxAccessInfo Com_RxAccessInfo[93].RxSigBufferArrayBasedBufferEndIdxOfRxAccessInfo Com_RxAccessInfo[93].RxSigBufferArrayBasedBufferStartIdxOfRxAccessInfo Com_RxAccessInfo[93].RxSigBufferArrayBasedShdBufferEndIdxOfRxAccessInfo Com_RxAccessInfo[93].RxSigBufferArrayBasedShdBufferStartIdxOfRxAccessInfo Com_RxAccessInfo[93].RxTOutInfoIdxOfRxAccessInfo Com_RxAccessInfo[93].ShdBufferIdxOfRxAccessInfo Com_RxAccessInfo[93].SignalLengthInByteOfRxAccessInfo Com_RxAccessInfo[93].StartByteInPduPositionOfRxAccessInfo Com_RxAccessInfo[93].TmpBufferIdxOfRxAccessInfo Com_RxAccessInfo[93].TmpBufferOfRxAccessInfo Com_RxAccessInfo[93].TmpRxShdBufferArrayBasedTmpBufferEndIdxOfRxAccessInfo Com_RxAccessInfo[93].TmpRxShdBufferArrayBasedTmpBufferStartIdxOfRxAccessInfo Com_RxAccessInfo[94].ApplTypeOfRxAccessInfo Com_RxAccessInfo[94].BitLengthOfRxAccessInfo Com_RxAccessInfo[94].BitPositionOfRxAccessInfo Com_RxAccessInfo[94].BufferIdxOfRxAccessInfo Com_RxAccessInfo[94].BusAccOfRxAccessInfo Com_RxAccessInfo[94].ByteLengthOfRxAccessInfo Com_RxAccessInfo[94].ConstValueArrayBasedInitValueEndIdxOfRxAccessInfo Com_RxAccessInfo[94].ConstValueArrayBasedInitValueStartIdxOfRxAccessInfo Com_RxAccessInfo[94].DynSignalOfRxAccessInfo Com_RxAccessInfo[94].InitValueIdxOfRxAccessInfo Com_RxAccessInfo[94].InitValueOfRxAccessInfo Com_RxAccessInfo[94].InvValueIdxOfRxAccessInfo Com_RxAccessInfo[94].InvValueOfRxAccessInfo Com_RxAccessInfo[94].IsGroupSignalOfRxAccessInfo Com_RxAccessInfo[94].RxDataTimeoutSubstitutionValueIdxOfRxAccessInfo Com_RxAccessInfo[94].RxDataTimeoutSubstitutionValueOfRxAccessInfo Com_RxAccessInfo[94].RxPduInfoIdxOfRxAccessInfo Com_RxAccessInfo[94].RxSigBufferArrayBasedBufferEndIdxOfRxAccessInfo Com_RxAccessInfo[94].RxSigBufferArrayBasedBufferStartIdxOfRxAccessInfo Com_RxAccessInfo[94].RxSigBufferArrayBasedShdBufferEndIdxOfRxAccessInfo Com_RxAccessInfo[94].RxSigBufferArrayBasedShdBufferStartIdxOfRxAccessInfo Com_RxAccessInfo[94].RxTOutInfoIdxOfRxAccessInfo Com_RxAccessInfo[94].ShdBufferIdxOfRxAccessInfo Com_RxAccessInfo[94].SignalLengthInByteOfRxAccessInfo Com_RxAccessInfo[94].StartByteInPduPositionOfRxAccessInfo Com_RxAccessInfo[94].TmpBufferIdxOfRxAccessInfo Com_RxAccessInfo[94].TmpBufferOfRxAccessInfo Com_RxAccessInfo[94].TmpRxShdBufferArrayBasedTmpBufferEndIdxOfRxAccessInfo Com_RxAccessInfo[94].TmpRxShdBufferArrayBasedTmpBufferStartIdxOfRxAccessInfo Com_RxAccessInfo[95].ApplTypeOfRxAccessInfo Com_RxAccessInfo[95].BitLengthOfRxAccessInfo Com_RxAccessInfo[95].BitPositionOfRxAccessInfo Com_RxAccessInfo[95].BufferIdxOfRxAccessInfo Com_RxAccessInfo[95].BusAccOfRxAccessInfo Com_RxAccessInfo[95].ByteLengthOfRxAccessInfo Com_RxAccessInfo[95].ConstValueArrayBasedInitValueEndIdxOfRxAccessInfo Com_RxAccessInfo[95].ConstValueArrayBasedInitValueStartIdxOfRxAccessInfo Com_RxAccessInfo[95].DynSignalOfRxAccessInfo Com_RxAccessInfo[95].InitValueIdxOfRxAccessInfo Com_RxAccessInfo[95].InitValueOfRxAccessInfo Com_RxAccessInfo[95].InvValueIdxOfRxAccessInfo Com_RxAccessInfo[95].InvValueOfRxAccessInfo Com_RxAccessInfo[95].IsGroupSignalOfRxAccessInfo Com_RxAccessInfo[95].RxDataTimeoutSubstitutionValueIdxOfRxAccessInfo Com_RxAccessInfo[95].RxDataTimeoutSubstitutionValueOfRxAccessInfo Com_RxAccessInfo[95].RxPduInfoIdxOfRxAccessInfo Com_RxAccessInfo[95].RxSigBufferArrayBasedBufferEndIdxOfRxAccessInfo Com_RxAccessInfo[95].RxSigBufferArrayBasedBufferStartIdxOfRxAccessInfo Com_RxAccessInfo[95].RxSigBufferArrayBasedShdBufferEndIdxOfRxAccessInfo Com_RxAccessInfo[95].RxSigBufferArrayBasedShdBufferStartIdxOfRxAccessInfo Com_RxAccessInfo[95].RxTOutInfoIdxOfRxAccessInfo Com_RxAccessInfo[95].ShdBufferIdxOfRxAccessInfo Com_RxAccessInfo[95].SignalLengthInByteOfRxAccessInfo Com_RxAccessInfo[95].StartByteInPduPositionOfRxAccessInfo Com_RxAccessInfo[95].TmpBufferIdxOfRxAccessInfo Com_RxAccessInfo[95].TmpBufferOfRxAccessInfo Com_RxAccessInfo[95].TmpRxShdBufferArrayBasedTmpBufferEndIdxOfRxAccessInfo Com_RxAccessInfo[95].TmpRxShdBufferArrayBasedTmpBufferStartIdxOfRxAccessInfo Com_RxAccessInfo[96].ApplTypeOfRxAccessInfo Com_RxAccessInfo[96].BitLengthOfRxAccessInfo Com_RxAccessInfo[96].BitPositionOfRxAccessInfo Com_RxAccessInfo[96].BufferIdxOfRxAccessInfo Com_RxAccessInfo[96].BusAccOfRxAccessInfo Com_RxAccessInfo[96].ByteLengthOfRxAccessInfo Com_RxAccessInfo[96].ConstValueArrayBasedInitValueEndIdxOfRxAccessInfo Com_RxAccessInfo[96].ConstValueArrayBasedInitValueStartIdxOfRxAccessInfo Com_RxAccessInfo[96].DynSignalOfRxAccessInfo Com_RxAccessInfo[96].InitValueIdxOfRxAccessInfo Com_RxAccessInfo[96].InitValueOfRxAccessInfo Com_RxAccessInfo[96].InvValueIdxOfRxAccessInfo Com_RxAccessInfo[96].InvValueOfRxAccessInfo Com_RxAccessInfo[96].IsGroupSignalOfRxAccessInfo Com_RxAccessInfo[96].RxDataTimeoutSubstitutionValueIdxOfRxAccessInfo Com_RxAccessInfo[96].RxDataTimeoutSubstitutionValueOfRxAccessInfo Com_RxAccessInfo[96].RxPduInfoIdxOfRxAccessInfo Com_RxAccessInfo[96].RxSigBufferArrayBasedBufferEndIdxOfRxAccessInfo Com_RxAccessInfo[96].RxSigBufferArrayBasedBufferStartIdxOfRxAccessInfo Com_RxAccessInfo[96].RxSigBufferArrayBasedShdBufferEndIdxOfRxAccessInfo Com_RxAccessInfo[96].RxSigBufferArrayBasedShdBufferStartIdxOfRxAccessInfo Com_RxAccessInfo[96].RxTOutInfoIdxOfRxAccessInfo Com_RxAccessInfo[96].ShdBufferIdxOfRxAccessInfo Com_RxAccessInfo[96].SignalLengthInByteOfRxAccessInfo Com_RxAccessInfo[96].StartByteInPduPositionOfRxAccessInfo Com_RxAccessInfo[96].TmpBufferIdxOfRxAccessInfo Com_RxAccessInfo[96].TmpBufferOfRxAccessInfo Com_RxAccessInfo[96].TmpRxShdBufferArrayBasedTmpBufferEndIdxOfRxAccessInfo Com_RxAccessInfo[96].TmpRxShdBufferArrayBasedTmpBufferStartIdxOfRxAccessInfo Com_RxAccessInfo[97].ApplTypeOfRxAccessInfo Com_RxAccessInfo[97].BitLengthOfRxAccessInfo Com_RxAccessInfo[97].BitPositionOfRxAccessInfo Com_RxAccessInfo[97].BufferIdxOfRxAccessInfo Com_RxAccessInfo[97].BusAccOfRxAccessInfo Com_RxAccessInfo[97].ByteLengthOfRxAccessInfo Com_RxAccessInfo[97].ConstValueArrayBasedInitValueEndIdxOfRxAccessInfo Com_RxAccessInfo[97].ConstValueArrayBasedInitValueStartIdxOfRxAccessInfo Com_RxAccessInfo[97].DynSignalOfRxAccessInfo Com_RxAccessInfo[97].InitValueIdxOfRxAccessInfo Com_RxAccessInfo[97].InitValueOfRxAccessInfo Com_RxAccessInfo[97].InvValueIdxOfRxAccessInfo Com_RxAccessInfo[97].InvValueOfRxAccessInfo Com_RxAccessInfo[97].IsGroupSignalOfRxAccessInfo Com_RxAccessInfo[97].RxDataTimeoutSubstitutionValueIdxOfRxAccessInfo Com_RxAccessInfo[97].RxDataTimeoutSubstitutionValueOfRxAccessInfo Com_RxAccessInfo[97].RxPduInfoIdxOfRxAccessInfo Com_RxAccessInfo[97].RxSigBufferArrayBasedBufferEndIdxOfRxAccessInfo Com_RxAccessInfo[97].RxSigBufferArrayBasedBufferStartIdxOfRxAccessInfo Com_RxAccessInfo[97].RxSigBufferArrayBasedShdBufferEndIdxOfRxAccessInfo Com_RxAccessInfo[97].RxSigBufferArrayBasedShdBufferStartIdxOfRxAccessInfo Com_RxAccessInfo[97].RxTOutInfoIdxOfRxAccessInfo Com_RxAccessInfo[97].ShdBufferIdxOfRxAccessInfo Com_RxAccessInfo[97].SignalLengthInByteOfRxAccessInfo Com_RxAccessInfo[97].StartByteInPduPositionOfRxAccessInfo Com_RxAccessInfo[97].TmpBufferIdxOfRxAccessInfo Com_RxAccessInfo[97].TmpBufferOfRxAccessInfo Com_RxAccessInfo[97].TmpRxShdBufferArrayBasedTmpBufferEndIdxOfRxAccessInfo Com_RxAccessInfo[97].TmpRxShdBufferArrayBasedTmpBufferStartIdxOfRxAccessInfo Com_RxAccessInfo[98].ApplTypeOfRxAccessInfo Com_RxAccessInfo[98].BitLengthOfRxAccessInfo Com_RxAccessInfo[98].BitPositionOfRxAccessInfo Com_RxAccessInfo[98].BufferIdxOfRxAccessInfo Com_RxAccessInfo[98].BusAccOfRxAccessInfo Com_RxAccessInfo[98].ByteLengthOfRxAccessInfo Com_RxAccessInfo[98].ConstValueArrayBasedInitValueEndIdxOfRxAccessInfo Com_RxAccessInfo[98].ConstValueArrayBasedInitValueStartIdxOfRxAccessInfo Com_RxAccessInfo[98].DynSignalOfRxAccessInfo Com_RxAccessInfo[98].InitValueIdxOfRxAccessInfo Com_RxAccessInfo[98].InitValueOfRxAccessInfo Com_RxAccessInfo[98].InvValueIdxOfRxAccessInfo Com_RxAccessInfo[98].InvValueOfRxAccessInfo Com_RxAccessInfo[98].IsGroupSignalOfRxAccessInfo Com_RxAccessInfo[98].RxDataTimeoutSubstitutionValueIdxOfRxAccessInfo Com_RxAccessInfo[98].RxDataTimeoutSubstitutionValueOfRxAccessInfo Com_RxAccessInfo[98].RxPduInfoIdxOfRxAccessInfo Com_RxAccessInfo[98].RxSigBufferArrayBasedBufferEndIdxOfRxAccessInfo Com_RxAccessInfo[98].RxSigBufferArrayBasedBufferStartIdxOfRxAccessInfo Com_RxAccessInfo[98].RxSigBufferArrayBasedShdBufferEndIdxOfRxAccessInfo Com_RxAccessInfo[98].RxSigBufferArrayBasedShdBufferStartIdxOfRxAccessInfo Com_RxAccessInfo[98].RxTOutInfoIdxOfRxAccessInfo Com_RxAccessInfo[98].ShdBufferIdxOfRxAccessInfo Com_RxAccessInfo[98].SignalLengthInByteOfRxAccessInfo Com_RxAccessInfo[98].StartByteInPduPositionOfRxAccessInfo Com_RxAccessInfo[98].TmpBufferIdxOfRxAccessInfo Com_RxAccessInfo[98].TmpBufferOfRxAccessInfo Com_RxAccessInfo[98].TmpRxShdBufferArrayBasedTmpBufferEndIdxOfRxAccessInfo Com_RxAccessInfo[98].TmpRxShdBufferArrayBasedTmpBufferStartIdxOfRxAccessInfo Com_RxAccessInfo[99].ApplTypeOfRxAccessInfo Com_RxAccessInfo[99].BitLengthOfRxAccessInfo Com_RxAccessInfo[99].BitPositionOfRxAccessInfo Com_RxAccessInfo[99].BufferIdxOfRxAccessInfo Com_RxAccessInfo[99].BusAccOfRxAccessInfo Com_RxAccessInfo[99].ByteLengthOfRxAccessInfo Com_RxAccessInfo[99].ConstValueArrayBasedInitValueEndIdxOfRxAccessInfo Com_RxAccessInfo[99].ConstValueArrayBasedInitValueStartIdxOfRxAccessInfo Com_RxAccessInfo[99].DynSignalOfRxAccessInfo Com_RxAccessInfo[99].InitValueIdxOfRxAccessInfo Com_RxAccessInfo[99].InitValueOfRxAccessInfo Com_RxAccessInfo[99].InvValueIdxOfRxAccessInfo Com_RxAccessInfo[99].InvValueOfRxAccessInfo Com_RxAccessInfo[99].IsGroupSignalOfRxAccessInfo Com_RxAccessInfo[99].RxDataTimeoutSubstitutionValueIdxOfRxAccessInfo Com_RxAccessInfo[99].RxDataTimeoutSubstitutionValueOfRxAccessInfo Com_RxAccessInfo[99].RxPduInfoIdxOfRxAccessInfo Com_RxAccessInfo[99].RxSigBufferArrayBasedBufferEndIdxOfRxAccessInfo Com_RxAccessInfo[99].RxSigBufferArrayBasedBufferStartIdxOfRxAccessInfo Com_RxAccessInfo[99].RxSigBufferArrayBasedShdBufferEndIdxOfRxAccessInfo Com_RxAccessInfo[99].RxSigBufferArrayBasedShdBufferStartIdxOfRxAccessInfo Com_RxAccessInfo[99].RxTOutInfoIdxOfRxAccessInfo Com_RxAccessInfo[99].ShdBufferIdxOfRxAccessInfo Com_RxAccessInfo[99].SignalLengthInByteOfRxAccessInfo Com_RxAccessInfo[99].StartByteInPduPositionOfRxAccessInfo Com_RxAccessInfo[99].TmpBufferIdxOfRxAccessInfo Com_RxAccessInfo[99].TmpBufferOfRxAccessInfo Com_RxAccessInfo[99].TmpRxShdBufferArrayBasedTmpBufferEndIdxOfRxAccessInfo Com_RxAccessInfo[99].TmpRxShdBufferArrayBasedTmpBufferStartIdxOfRxAccessInfo Com_RxAccessInfo[9].ApplTypeOfRxAccessInfo Com_RxAccessInfo[9].BitLengthOfRxAccessInfo Com_RxAccessInfo[9].BitPositionOfRxAccessInfo Com_RxAccessInfo[9].BufferIdxOfRxAccessInfo Com_RxAccessInfo[9].BusAccOfRxAccessInfo Com_RxAccessInfo[9].ByteLengthOfRxAccessInfo Com_RxAccessInfo[9].ConstValueArrayBasedInitValueEndIdxOfRxAccessInfo Com_RxAccessInfo[9].ConstValueArrayBasedInitValueStartIdxOfRxAccessInfo Com_RxAccessInfo[9].DynSignalOfRxAccessInfo Com_RxAccessInfo[9].InitValueIdxOfRxAccessInfo Com_RxAccessInfo[9].InitValueOfRxAccessInfo Com_RxAccessInfo[9].InvValueIdxOfRxAccessInfo Com_RxAccessInfo[9].InvValueOfRxAccessInfo Com_RxAccessInfo[9].IsGroupSignalOfRxAccessInfo Com_RxAccessInfo[9].RxDataTimeoutSubstitutionValueIdxOfRxAccessInfo Com_RxAccessInfo[9].RxDataTimeoutSubstitutionValueOfRxAccessInfo Com_RxAccessInfo[9].RxPduInfoIdxOfRxAccessInfo Com_RxAccessInfo[9].RxSigBufferArrayBasedBufferEndIdxOfRxAccessInfo Com_RxAccessInfo[9].RxSigBufferArrayBasedBufferStartIdxOfRxAccessInfo Com_RxAccessInfo[9].RxSigBufferArrayBasedShdBufferEndIdxOfRxAccessInfo Com_RxAccessInfo[9].RxSigBufferArrayBasedShdBufferStartIdxOfRxAccessInfo Com_RxAccessInfo[9].RxTOutInfoIdxOfRxAccessInfo Com_RxAccessInfo[9].ShdBufferIdxOfRxAccessInfo Com_RxAccessInfo[9].SignalLengthInByteOfRxAccessInfo Com_RxAccessInfo[9].StartByteInPduPositionOfRxAccessInfo Com_RxAccessInfo[9].TmpBufferIdxOfRxAccessInfo Com_RxAccessInfo[9].TmpBufferOfRxAccessInfo Com_RxAccessInfo[9].TmpRxShdBufferArrayBasedTmpBufferEndIdxOfRxAccessInfo Com_RxAccessInfo[9].TmpRxShdBufferArrayBasedTmpBufferStartIdxOfRxAccessInfo Com_RxDefPduBuffer Com_RxDefPduBuffer_Airbag_10_XIX_HCP5_CANFD01_7f2c77c5_Rx Com_RxDefPduBuffer_BJB_08_XIX_BMC_CAN01_1db9ae10_Rx Com_RxDefPduBuffer_BJB_10_XIX_BMC_CAN01_E2E_968516b3_Rx Com_RxDefPduBuffer_BJB_11_XIX_BMC_CAN01_E2E_416796eb_Rx Com_RxDefPduBuffer_BJB_12_XIX_BMC_CAN01_E2E_e2311042_Rx Com_RxDefPduBuffer_BJB_13_XIX_BMC_CAN01_E2E_35d3901a_Rx Com_RxDefPduBuffer_BJB_CALID_01_XIX_BMC_CAN01_adee7d66_Rx Com_RxDefPduBuffer_BJB_CALID_02_XIX_BMC_CAN01_bc93171f_Rx Com_RxDefPduBuffer_BJB_CVN_01_XIX_BMC_CAN01_301c1ddb_Rx Com_RxDefPduBuffer_Charisma_20_XIX_HCP5_CANFD01_f51eced8_Rx Com_RxDefPduBuffer_ClampControl_01_XIX_HCP5_CANFD01_8c24343b_Rx Com_RxDefPduBuffer_ComIPduPnc_EIRA_CAN_Rx Com_RxDefPduBuffer_DCDC_04_XIX_HCP5_CANFD01_8ca88b97_Rx Com_RxDefPduBuffer_DCDC_NV_CALID_XIX_HCP5_CANFD01_46b970f2_Rx Com_RxDefPduBuffer_DCDC_NV_CVN_XIX_HCP5_CANFD01_55665719_Rx Com_RxDefPduBuffer_DCDC_NV_Komponentenfehler_01_XIX_HCP5_CANFD01_dd687766_Rx Com_RxDefPduBuffer_DCDC_NV_Komponentenfehler_02_XIX_HCP5_CANFD01_37eeaa04_Rx Com_RxDefPduBuffer_DCDC_NV_Komponentenfehler_03_XIX_HCP5_CANFD01_d8bc1ce5_Rx Com_RxDefPduBuffer_DCDC_NV_Komponentenfehler_04_XIX_HCP5_CANFD01_39921681_Rx Com_RxDefPduBuffer_DEV_Hybrid_01_Req_00_XIX_HCP5_CANFD01_5661b344_Rx Com_RxDefPduBuffer_Diagnose_01_XIX_HCP5_CANFD01_426f0ab5_Rx Com_RxDefPduBuffer_ELF_06_XIX_HCP5_CANFD01_d78b945c_Rx Com_RxDefPduBuffer_HCP1_17_XIX_HCP5_CANFD01_3398d6b5_Rx Com_RxDefPduBuffer_HVEM_07_XIX_HCP5_CANFD01_839f516f_Rx Com_RxDefPduBuffer_HVK_03_XIX_HCP5_CANFD01_E2E_8a76edcb_Rx Com_RxDefPduBuffer_HVLM_13_XIX_HCP5_CANFD01_f1be44f1_Rx Com_RxDefPduBuffer_HVLM_14_XIX_HCP5_CANFD01_E2E_b3d1458f_Rx Com_RxDefPduBuffer_KS_Hybrid_01_Challenge_M_XIX_HCP5_CANFD01_3e11d538_Rx Com_RxDefPduBuffer_KS_Hybrid_01_Response_M_XIX_HCP5_CANFD01_78a6c4aa_Rx Com_RxDefPduBuffer_NVEM_12_XIX_HCP5_CANFD01_00bae280_Rx Com_RxDefPduBuffer_OBD_03_XIX_HCP5_CANFD01_f1281889_Rx Com_RxDefPduBuffer_OBD_04_XIX_HCP5_CANFD01_100612ed_Rx Com_RxDefPduBuffer_OBD_HCP1_XIX_HCP5_CANFD01_1b389b6c_Rx Com_RxDefPduBuffer_OBG_01_XIX_HCP5_CANFD01_8fe2f1e9_Rx Com_RxDefPduBuffer_ORU_01_XIX_HCP5_CANFD01_8935a839_Rx Com_RxDefPduBuffer_ORU_Control_A_01_XIX_HCP5_CANFD01_E2E_3007747a_Rx Com_RxDefPduBuffer_ORU_Control_D_01_XIX_HCP5_CANFD01_E2E_6e31ae8f_Rx Com_RxDefPduBuffer_OTAMC_D_01_XIX_HCP5_CANFD01_E2E_c199b3e6_Rx Com_RxDefPduBuffer_OTP_01_XIX_HCP5_CANFD01_76e7759c_Rx Com_RxDefPduBuffer_SOK_NoAuthenticTime_01_XIX_HCP5_CANFD01_a407ae2f_Rx Com_RxDefPduBuffer_SOK_Zeit_Hybrid_01_Resp_01_XIX_HCP5_CANFD01_c7a98a10_Rx Com_RxDefPduBuffer_Systeminfo_01_XIX_HCP5_CANFD01_fb27c5ed_Rx Com_RxDefPduBuffer_Thermomanagement_01_XIX_HCP5_CANFD01_60e8cf38_Rx Com_RxDefPduBuffer_UI1_01_XIX_BMC_CAN01_E2E_cec88adf_Rx Com_RxDefPduBuffer_UI1_02_XIX_BMC_CAN01_E2E_6d9e0c76_Rx Com_RxDefPduBuffer_UI1_03_XIX_BMC_CAN01_4277cadb_Rx Com_RxDefPduBuffer_UI1_04_XIX_BMC_CAN01_d976c5c1_Rx Com_RxDefPduBuffer_UI1_05_XIX_BMC_CAN01_608d1e29_Rx Com_RxDefPduBuffer_UI1_Komponentenfehler_01_XIX_BMC_CAN01_08861f77_Rx Com_RxDefPduBuffer_UI1_Komponentenfehler_02_XIX_BMC_CAN01_19fb750e_Rx Com_RxDefPduBuffer_UI2Sens01_CALID_01_XIX_BMC_CAN01_f3c92280_Rx Com_RxDefPduBuffer_UI2Sens01_CALID_02_XIX_BMC_CAN01_e2b448f9_Rx /end REF_MEASUREMENT
/end GROUP
/end MODULE
/end PROJECT
