ASAP2_VERSION 1 71
/begin PROJECT MICROSAR ""
/begin MODULE CPP ""
/begin MOD_COMMON "" BYTE_ORDER MSB_LAST ALIGNMENT_BYTE 1 ALIGNMENT_WORD 2 ALIGNMENT_LONG 4 ALIGNMENT_FLOAT16_IEEE 2 ALIGNMENT_FLOAT32_IEEE 4 ALIGNMENT_FLOAT64_IEEE 8 ALIGNMENT_INT64 8 /end MOD_COMMON
/begin COMPU_METHOD Dem_DTCKindType "" TAB_VERB "%10.1" "" COMPU_TAB_REF Dem_DTCKindType /end COMPU_METHOD
/begin COMPU_METHOD Dem_DTCOriginType "" TAB_VERB "%10.1" "" COMPU_TAB_REF Dem_DTCOriginType /end COMPU_METHOD
/begin COMPU_METHOD Dem_DTRControlType "" TAB_VERB "%10.1" "" COMPU_TAB_REF Dem_DTRControlType /end COMPU_METHOD
/begin COMPU_METHOD Dem_DebounceResetStatusType "" TAB_VERB "%10.1" "" COMPU_TAB_REF Dem_DebounceResetStatusType /end COMPU_METHOD
/begin COMPU_METHOD Dem_DebouncingStateType.DEM_DTR_UPDATE "" TAB_VERB "%10.1" "" COMPU_TAB_REF Dem_DebouncingStateType.DEM_DTR_UPDATE /end COMPU_METHOD
/begin COMPU_METHOD Dem_DebouncingStateType.DEM_FINALLY_DEFECTIVE "" TAB_VERB "%10.1" "" COMPU_TAB_REF Dem_DebouncingStateType.DEM_FINALLY_DEFECTIVE /end COMPU_METHOD
/begin COMPU_METHOD Dem_DebouncingStateType.DEM_TEMPORARILY_DEFECTIVE "" TAB_VERB "%10.1" "" COMPU_TAB_REF Dem_DebouncingStateType.DEM_TEMPORARILY_DEFECTIVE /end COMPU_METHOD
/begin COMPU_METHOD Dem_DebouncingStateType.DEM_TEMPORARILY_HEALED "" TAB_VERB "%10.1" "" COMPU_TAB_REF Dem_DebouncingStateType.DEM_TEMPORARILY_HEALED /end COMPU_METHOD
/begin COMPU_METHOD Dem_DebouncingStateType.DEM_TEST_COMPLETE "" TAB_VERB "%10.1" "" COMPU_TAB_REF Dem_DebouncingStateType.DEM_TEST_COMPLETE /end COMPU_METHOD
/begin COMPU_METHOD Dem_EventStatusType "" TAB_VERB "%10.1" "" COMPU_TAB_REF Dem_EventStatusType /end COMPU_METHOD
/begin COMPU_METHOD Dem_EventStatusType_Copy1 "" TAB_VERB "%10.1" "" COMPU_TAB_REF Dem_EventStatusType_Copy1 /end COMPU_METHOD
/begin COMPU_METHOD Dem_IndicatorStatusType "" TAB_VERB "%10.1" "" COMPU_TAB_REF Dem_IndicatorStatusType /end COMPU_METHOD
/begin COMPU_METHOD Dem_InitMonitorReasonType "" TAB_VERB "%10.1" "" COMPU_TAB_REF Dem_InitMonitorReasonType /end COMPU_METHOD
/begin COMPU_METHOD Dem_IumprDenomCondIdType "" TAB_VERB "%10.1" "" COMPU_TAB_REF Dem_IumprDenomCondIdType /end COMPU_METHOD
/begin COMPU_METHOD Dem_IumprDenomCondStatusType "" TAB_VERB "%10.1" "" COMPU_TAB_REF Dem_IumprDenomCondStatusType /end COMPU_METHOD
/begin COMPU_METHOD Dem_IumprReadinessGroupType "" TAB_VERB "%10.1" "" COMPU_TAB_REF Dem_IumprReadinessGroupType /end COMPU_METHOD
/begin COMPU_METHOD Dem_MonitorStatusType.DEM_MONITOR_STATUS_TF "" TAB_VERB "%10.1" "" COMPU_TAB_REF Dem_MonitorStatusType.DEM_MONITOR_STATUS_TF /end COMPU_METHOD
/begin COMPU_METHOD Dem_MonitorStatusType.DEM_MONITOR_STATUS_TNCTOC "" TAB_VERB "%10.1" "" COMPU_TAB_REF Dem_MonitorStatusType.DEM_MONITOR_STATUS_TNCTOC /end COMPU_METHOD
/begin COMPU_METHOD Dem_OperationCycleStateType "" TAB_VERB "%10.1" "" COMPU_TAB_REF Dem_OperationCycleStateType /end COMPU_METHOD
/begin COMPU_METHOD Dem_OperationCycleStateType_Copy1 "" TAB_VERB "%10.1" "" COMPU_TAB_REF Dem_OperationCycleStateType_Copy1 /end COMPU_METHOD
/begin COMPU_METHOD Dem_UdsStatusByteType.DEM_UDS_STATUS_CDTC "" TAB_VERB "%10.1" "" COMPU_TAB_REF Dem_UdsStatusByteType.DEM_UDS_STATUS_CDTC /end COMPU_METHOD
/begin COMPU_METHOD Dem_UdsStatusByteType.DEM_UDS_STATUS_PDTC "" TAB_VERB "%10.1" "" COMPU_TAB_REF Dem_UdsStatusByteType.DEM_UDS_STATUS_PDTC /end COMPU_METHOD
/begin COMPU_METHOD Dem_UdsStatusByteType.DEM_UDS_STATUS_TF "" TAB_VERB "%10.1" "" COMPU_TAB_REF Dem_UdsStatusByteType.DEM_UDS_STATUS_TF /end COMPU_METHOD
/begin COMPU_METHOD Dem_UdsStatusByteType.DEM_UDS_STATUS_TFSLC "" TAB_VERB "%10.1" "" COMPU_TAB_REF Dem_UdsStatusByteType.DEM_UDS_STATUS_TFSLC /end COMPU_METHOD
/begin COMPU_METHOD Dem_UdsStatusByteType.DEM_UDS_STATUS_TFTOC "" TAB_VERB "%10.1" "" COMPU_TAB_REF Dem_UdsStatusByteType.DEM_UDS_STATUS_TFTOC /end COMPU_METHOD
/begin COMPU_METHOD Dem_UdsStatusByteType.DEM_UDS_STATUS_TNCSLC "" TAB_VERB "%10.1" "" COMPU_TAB_REF Dem_UdsStatusByteType.DEM_UDS_STATUS_TNCSLC /end COMPU_METHOD
/begin COMPU_METHOD Dem_UdsStatusByteType.DEM_UDS_STATUS_TNCTOC "" TAB_VERB "%10.1" "" COMPU_TAB_REF Dem_UdsStatusByteType.DEM_UDS_STATUS_TNCTOC /end COMPU_METHOD
/begin COMPU_METHOD Dem_UdsStatusByteType.DEM_UDS_STATUS_WIR "" TAB_VERB "%10.1" "" COMPU_TAB_REF Dem_UdsStatusByteType.DEM_UDS_STATUS_WIR /end COMPU_METHOD
/begin COMPU_METHOD EcuM_BootTargetType "" TAB_VERB "%10.1" "" COMPU_TAB_REF EcuM_BootTargetType /end COMPU_METHOD
/begin COMPU_METHOD EcuM_ModeType "" TAB_VERB "%10.1" "" COMPU_TAB_REF EcuM_ModeType /end COMPU_METHOD
/begin COMPU_METHOD EcuM_ShutdownCauseType "" TAB_VERB "%10.1" "" COMPU_TAB_REF EcuM_ShutdownCauseType /end COMPU_METHOD
/begin COMPU_METHOD EcuM_StateType "" TAB_VERB "%10.1" "" COMPU_TAB_REF EcuM_StateType /end COMPU_METHOD
/begin COMPU_METHOD EnumActiveComponentType "" TAB_VERB "%10.1" "" COMPU_TAB_REF EnumActiveComponentType /end COMPU_METHOD
/begin COMPU_METHOD EnumMEM_BlockStateType "" TAB_VERB "%10.1" "" COMPU_TAB_REF EnumMEM_BlockStateType /end COMPU_METHOD
/begin COMPU_METHOD EnumNM_ApplStateType "" TAB_VERB "%10.1" "" COMPU_TAB_REF EnumNM_ApplStateType /end COMPU_METHOD
/begin COMPU_METHOD Ivd_RequestPostRunType "" TAB_VERB "%10.1" "" COMPU_TAB_REF Ivd_RequestPostRunType /end COMPU_METHOD
/begin COMPU_METHOD NvM_RequestResultType "" TAB_VERB "%10.1" "" COMPU_TAB_REF NvM_RequestResultType /end COMPU_METHOD
/begin COMPU_METHOD NvM_RequestResultType_Copy1 "" TAB_VERB "%10.1" "" COMPU_TAB_REF NvM_RequestResultType_Copy1 /end COMPU_METHOD
/begin COMPU_METHOD NvM_RequestResultType_Copy2 "" TAB_VERB "%10.1" "" COMPU_TAB_REF NvM_RequestResultType_Copy2 /end COMPU_METHOD
/begin COMPU_METHOD NvM_ServiceIdType "" TAB_VERB "%10.1" "" COMPU_TAB_REF NvM_ServiceIdType /end COMPU_METHOD
/begin COMPU_METHOD NvM_ServiceIdType_Copy1 "" TAB_VERB "%10.1" "" COMPU_TAB_REF NvM_ServiceIdType_Copy1 /end COMPU_METHOD
/begin COMPU_METHOD SecOC_VerificationResultType "" TAB_VERB "%10.1" "" COMPU_TAB_REF SecOC_VerificationResultType /end COMPU_METHOD
/begin COMPU_METHOD WdgM_GlobalStatusType "" TAB_VERB "%10.1" "" COMPU_TAB_REF WdgM_GlobalStatusType /end COMPU_METHOD
/begin COMPU_METHOD WdgM_LocalStatusType "" TAB_VERB "%10.1" "" COMPU_TAB_REF WdgM_LocalStatusType /end COMPU_METHOD
/begin COMPU_METHOD boolean "" TAB_VERB "%10.1" "" COMPU_TAB_REF boolean /end COMPU_METHOD
/begin COMPU_METHOD boolean_CompuMethod "" TAB_VERB "%10.1" "" COMPU_TAB_REF boolean_CompuMethod /end COMPU_METHOD
/begin COMPU_VTAB Dem_DTCKindType "" TAB_VERB 2 1 "DEM_DTC_KIND_ALL_DTCS" 2 "DEM_DTC_KIND_EMISSION_REL_DTCS" /end COMPU_VTAB
/begin COMPU_VTAB Dem_DTCOriginType "" TAB_VERB 5 1 "DEM_DTC_ORIGIN_PRIMARY_MEMORY" 2 "DEM_DTC_ORIGIN_MIRROR_MEMORY" 3 "DEM_DTC_ORIGIN_PERMANENT_MEMORY" 4 "DEM_DTC_ORIGIN_OBD_RELEVANT_MEMORY" 256 "DEM_DTC_ORIGIN_SECONDARY_MEMORY" /end COMPU_VTAB
/begin COMPU_VTAB Dem_DTCSeverityType.DTC_CLASS "" TAB_VERB 5 1 "DEM_SEVERITY_WWHOBD_CLASS_NO_CLASS" 2 "DEM_SEVERITY_WWHOBD_CLASS_A" 4 "DEM_SEVERITY_WWHOBD_CLASS_B1" 8 "DEM_SEVERITY_WWHOBD_CLASS_B2" 16 "DEM_SEVERITY_WWHOBD_CLASS_C" /end COMPU_VTAB
/begin COMPU_VTAB Dem_DTCSeverityType.DTC_NO_SEVERITY "" TAB_VERB 1 0 "DEM_SEVERITY_NO_SEVERITY" /end COMPU_VTAB
/begin COMPU_VTAB Dem_DTCSeverityType.DTC_SEVERITY "" TAB_VERB 3 1 "DEM_SEVERITY_MAINTENANCE_ONLY" 2 "DEM_SEVERITY_CHECK_AT_NEXT_HALT" 4 "DEM_SEVERITY_CHECK_IMMEDIATELY" /end COMPU_VTAB
/begin COMPU_VTAB Dem_DTRControlType "" TAB_VERB 5 0 "DEM_DTR_CTL_NORMAL" 1 "DEM_DTR_CTL_NO_MAX" 2 "DEM_DTR_CTL_NO_MIN" 3 "DEM_DTR_CTL_RESET" 4 "DEM_DTR_CTL_INVISIBLE" /end COMPU_VTAB
/begin COMPU_VTAB Dem_DebounceResetStatusType "" TAB_VERB 2 0 "DEM_DEBOUNCE_STATUS_FREEZE" 1 "DEM_DEBOUNCE_STATUS_RESET" /end COMPU_VTAB
/begin COMPU_VTAB Dem_DebouncingStateType.DEM_DTR_UPDATE "" TAB_VERB 1 1 "DEM_DTR_UPDATE" /end COMPU_VTAB
/begin COMPU_VTAB Dem_DebouncingStateType.DEM_FINALLY_DEFECTIVE "" TAB_VERB 1 1 "DEM_FINALLY_DEFECTIVE" /end COMPU_VTAB
/begin COMPU_VTAB Dem_DebouncingStateType.DEM_TEMPORARILY_DEFECTIVE "" TAB_VERB 1 1 "DEM_TEMPORARILY_DEFECTIVE" /end COMPU_VTAB
/begin COMPU_VTAB Dem_DebouncingStateType.DEM_TEMPORARILY_HEALED "" TAB_VERB 1 1 "DEM_TEMPORARILY_HEALED" /end COMPU_VTAB
/begin COMPU_VTAB Dem_DebouncingStateType.DEM_TEST_COMPLETE "" TAB_VERB 1 1 "DEM_TEST_COMPLETE" /end COMPU_VTAB
/begin COMPU_VTAB Dem_EventStatusType "" TAB_VERB 9 0 "DEM_EVENT_STATUS_PASSED" 1 "DEM_EVENT_STATUS_FAILED" 2 "DEM_EVENT_STATUS_PREPASSED" 3 "DEM_EVENT_STATUS_PREFAILED" 4 "DEM_EVENT_STATUS_FDC_THRESHOLD_REACHED" 5 "DEM_EVENT_STATUS_PASSED_CONDITIONS_NOT_FULFILLED" 6 "DEM_EVENT_STATUS_FAILED_CONDITIONS_NOT_FULFILLED" 7 "DEM_EVENT_STATUS_PREPASSED_CONDITIONS_NOT_FULFILLED" 8 "DEM_EVENT_STATUS_PREFAILED_CONDITIONS_NOT_FULFILLED" /end COMPU_VTAB
/begin COMPU_VTAB Dem_EventStatusType_Copy1 "" TAB_VERB 5 0 "DEM_EVENT_STATUS_PASSED" 1 "DEM_EVENT_STATUS_FAILED" 2 "DEM_EVENT_STATUS_PREPASSED" 3 "DEM_EVENT_STATUS_PREFAILED" 4 "DEM_EVENT_STATUS_FDC_THRESHOLD_REACHED" /end COMPU_VTAB
/begin COMPU_VTAB Dem_IndicatorStatusType "" TAB_VERB 8 0 "DEM_INDICATOR_OFF" 1 "DEM_INDICATOR_CONTINUOUS" 2 "DEM_INDICATOR_BLINKING" 3 "DEM_INDICATOR_BLINK_CONT" 4 "DEM_INDICATOR_SLOW_FLASH" 5 "DEM_INDICATOR_FAST_FLASH" 6 "DEM_INDICATOR_ON_DEMAND" 7 "DEM_INDICATOR_SHORT" /end COMPU_VTAB
/begin COMPU_VTAB Dem_InitMonitorReasonType "" TAB_VERB 4 1 "DEM_INIT_MONITOR_CLEAR" 2 "DEM_INIT_MONITOR_RESTART" 3 "DEM_INIT_MONITOR_REENABLED" 4 "DEM_INIT_MONITOR_STORAGE_REENABLED" /end COMPU_VTAB
/begin COMPU_VTAB Dem_IumprDenomCondIdType "" TAB_VERB 7 1 "DEM_IUMPR_GENERAL_DENOMINATOR" 2 "DEM_IUMPR_DEN_COND_COLDSTART" 3 "DEM_IUMPR_DEN_COND_EVAP" 4 "DEM_IUMPR_DEN_COND_500MI" 5 "DEM_IUMPR_GENERAL_INDIVIDUAL_DENOMINATOR" 6 "DEM_IUMPR_GENERAL_OBDCOND" 7 "DEM_IUMPR_DEN_COND_INDEPENDENT" /end COMPU_VTAB
/begin COMPU_VTAB Dem_IumprDenomCondStatusType "" TAB_VERB 3 0 "DEM_IUMPR_DEN_STATUS_NOT_REACHED" 1 "DEM_IUMPR_DEN_STATUS_REACHED" 2 "DEM_IUMPR_DEN_STATUS_INHIBITED" /end COMPU_VTAB
/begin COMPU_VTAB Dem_IumprReadinessGroupType "" TAB_VERB 22 0 "DEM_IUMPR_BOOSTPRS" 1 "DEM_IUMPR_CAT1" 2 "DEM_IUMPR_CAT2" 3 "DEM_IUMPR_EGR" 4 "DEM_IUMPR_EGSENSOR" 5 "DEM_IUMPR_EVAP" 6 "DEM_IUMPR_NMHCCAT" 7 "DEM_IUMPR_NOXADSORB" 8 "DEM_IUMPR_NOXCAT" 9 "DEM_IUMPR_OXS1" 10 "DEM_IUMPR_OXS2" 11 "DEM_IUMPR_PMFILTER" 12 "DEM_IUMPR_PRIVATE" 13 "DEM_IUMPR_SAIR" 14 "DEM_IUMPR_SECOXS1" 15 "DEM_IUMPR_SECOXS2" 16 "DEM_IUMPR_FLSYS" 17 "DEM_IUMPR_AFRI1" 18 "DEM_IUMPR_AFRI2" 19 "DEM_IUMPR_PF1" 20 "DEM_IUMPR_PF2" 255 "DEM_IUMPR_ALLGROUPS" /end COMPU_VTAB
/begin COMPU_VTAB Dem_MonitorStatusType.DEM_MONITOR_STATUS_TF "" TAB_VERB 1 1 "DEM_MONITOR_STATUS_TF" /end COMPU_VTAB
/begin COMPU_VTAB Dem_MonitorStatusType.DEM_MONITOR_STATUS_TNCTOC "" TAB_VERB 1 1 "DEM_MONITOR_STATUS_TNCTOC" /end COMPU_VTAB
/begin COMPU_VTAB Dem_OperationCycleStateType "" TAB_VERB 2 0 "DEM_CYCLE_STATE_START" 1 "DEM_CYCLE_STATE_END" /end COMPU_VTAB
/begin COMPU_VTAB Dem_OperationCycleStateType_Copy1 "" TAB_VERB 2 0 "DEM_CYCLE_STATE_START" 1 "DEM_CYCLE_STATE_END" /end COMPU_VTAB
/begin COMPU_VTAB Dem_UdsStatusByteType.DEM_UDS_STATUS_CDTC "" TAB_VERB 1 1 "DEM_UDS_STATUS_CDTC" /end COMPU_VTAB
/begin COMPU_VTAB Dem_UdsStatusByteType.DEM_UDS_STATUS_PDTC "" TAB_VERB 1 1 "DEM_UDS_STATUS_PDTC" /end COMPU_VTAB
/begin COMPU_VTAB Dem_UdsStatusByteType.DEM_UDS_STATUS_TF "" TAB_VERB 1 1 "DEM_UDS_STATUS_TF" /end COMPU_VTAB
/begin COMPU_VTAB Dem_UdsStatusByteType.DEM_UDS_STATUS_TFSLC "" TAB_VERB 1 1 "DEM_UDS_STATUS_TFSLC" /end COMPU_VTAB
/begin COMPU_VTAB Dem_UdsStatusByteType.DEM_UDS_STATUS_TFTOC "" TAB_VERB 1 1 "DEM_UDS_STATUS_TFTOC" /end COMPU_VTAB
/begin COMPU_VTAB Dem_UdsStatusByteType.DEM_UDS_STATUS_TNCSLC "" TAB_VERB 1 1 "DEM_UDS_STATUS_TNCSLC" /end COMPU_VTAB
/begin COMPU_VTAB Dem_UdsStatusByteType.DEM_UDS_STATUS_TNCTOC "" TAB_VERB 1 1 "DEM_UDS_STATUS_TNCTOC" /end COMPU_VTAB
/begin COMPU_VTAB Dem_UdsStatusByteType.DEM_UDS_STATUS_WIR "" TAB_VERB 1 1 "DEM_UDS_STATUS_WIR" /end COMPU_VTAB
/begin COMPU_VTAB EcuM_BootTargetType "" TAB_VERB 3 0 "ECUM_BOOT_TARGET_APP" 1 "ECUM_BOOT_TARGET_OEM_BOOTLOADER" 2 "ECUM_BOOT_TARGET_SYS_BOOTLOADER" /end COMPU_VTAB
/begin COMPU_VTAB EcuM_ModeType "" TAB_VERB 4 0 "EcuMConf_EcuMResetMode_ECUM_RESET_MCU" 1 "EcuMConf_EcuMResetMode_ECUM_RESET_WDG" 2 "EcuMConf_EcuMResetMode_ECUM_RESET_IO" 3 "EcuMConf_EcuMResetMode_ECUM_RESET_WAKEUP" /end COMPU_VTAB
/begin COMPU_VTAB EcuM_ShutdownCauseType "" TAB_VERB 4 0 "EcuMConf_EcuMShutdownCause_ECUM_CAUSE_UNKNOWN" 1 "EcuMConf_EcuMShutdownCause_ECUM_CAUSE_ECU_STATE" 2 "EcuMConf_EcuMShutdownCause_ECUM_CAUSE_WDGM" 3 "EcuMConf_EcuMShutdownCause_ECUM_CAUSE_DCM" /end COMPU_VTAB
/begin COMPU_VTAB EcuM_StateType "" TAB_VERB 3 80 "ECUM_STATE_SLEEP" 128 "ECUM_STATE_OFF" 144 "ECUM_STATE_RESET" /end COMPU_VTAB
/begin COMPU_VTAB EnumActiveComponentType "" TAB_VERB 11 0 "STARTAPPLICATION_ACTIVE_COMPONENT_COM_RXTX" 1 "STARTAPPLICATION_ACTIVE_COMPONENT_MEM" 2 "STARTAPPLICATION_ACTIVE_COMPONENT_DIAG" 3 "STARTAPPLICATION_ACTIVE_COMPONENT_COM_TXONLY" 4 "STARTAPPLICATION_ACTIVE_COMPONENT_WDG" 5 "STARTAPPLICATION_ACTIVE_COMPONENT_XCP" 7 "STARTAPPLICATION_ACTIVE_COMPONENT_MULTICORE" 9 "STARTAPPLICATION_ACTIVE_COMPONENT_NM" 11 "STARTAPPLICATION_ACTIVE_COMPONENT_ETH" 13 "STARTAPPLICATION_ACTIVE_COMPONENT_SECURITY" 255 "STARTAPPLICATION_ACTIVE_COMPONENT_INVALID" /end COMPU_VTAB
/begin COMPU_VTAB EnumMEM_BlockStateType "" TAB_VERB 7 0 "MEM_STATE_UNKNOWN" 1 "MEM_STATE_WRITE_PENDING" 2 "MEM_STATE_WRITE_FINISHED" 3 "MEM_STATE_READ_PENDING" 4 "MEM_STATE_READ_FINISHED" 5 "MEM_STATE_WRITE_FAILED" 6 "MEM_STATE_READ_FAILED" /end COMPU_VTAB
/begin COMPU_VTAB EnumNM_ApplStateType "" TAB_VERB 3 0 "NM_APPL_STATE_FULL_COMM_EXTERN" 1 "NM_APPL_STATE_FULL_COMM_INTERN" 2 "NM_APPL_STATE_NO_COMM_EXTERN" /end COMPU_VTAB
/begin COMPU_VTAB Ivd_RequestPostRunType "" TAB_VERB 2 0 "IVD_REQUESTPOSTRUN_REQUESTED" 1 "IVD_REQUESTPOSTRUN_RELEASED" /end COMPU_VTAB
/begin COMPU_VTAB NvM_RequestResultType "" TAB_VERB 9 0 "NVM_REQ_OK" 1 "NVM_REQ_NOT_OK" 2 "NVM_REQ_PENDING" 3 "NVM_REQ_INTEGRITY_FAILED" 4 "NVM_REQ_BLOCK_SKIPPED" 5 "NVM_REQ_NV_INVALIDATED" 6 "NVM_REQ_CANCELED" 7 "NVM_REQ_REDUNDANCY_FAILED" 8 "NVM_REQ_RESTORED_FROM_ROM" /end COMPU_VTAB
/begin COMPU_VTAB NvM_RequestResultType_Copy1 "" TAB_VERB 9 0 "NVM_REQ_OK" 1 "NVM_REQ_NOT_OK" 2 "NVM_REQ_PENDING" 3 "NVM_REQ_INTEGRITY_FAILED" 4 "NVM_REQ_BLOCK_SKIPPED" 5 "NVM_REQ_NV_INVALIDATED" 6 "NVM_REQ_CANCELED" 7 "NVM_REQ_REDUNDANCY_FAILED" 8 "NVM_REQ_RESTORED_FROM_ROM" /end COMPU_VTAB
/begin COMPU_VTAB NvM_RequestResultType_Copy2 "" TAB_VERB 9 0 "NVM_REQ_OK" 1 "NVM_REQ_NOT_OK" 2 "NVM_REQ_PENDING" 3 "NVM_REQ_INTEGRITY_FAILED" 4 "NVM_REQ_BLOCK_SKIPPED" 5 "NVM_REQ_NV_INVALIDATED" 6 "NVM_REQ_CANCELED" 7 "NVM_REQ_REDUNDANCY_FAILED" 8 "NVM_REQ_RESTORED_FROM_ROM" /end COMPU_VTAB
/begin COMPU_VTAB NvM_ServiceIdType "" TAB_VERB 6 6 "NVM_READ_BLOCK" 7 "NVM_WRITE_BLOCK" 8 "NVM_RESTORE_BLOCK_DEFAULTS" 9 "NVM_ERASE_BLOCK" 11 "NVM_INVALIDATE_NV_BLOCK" 12 "NVM_READ_ALL" /end COMPU_VTAB
/begin COMPU_VTAB NvM_ServiceIdType_Copy1 "" TAB_VERB 6 6 "NVM_READ_BLOCK" 7 "NVM_WRITE_BLOCK" 8 "NVM_RESTORE_BLOCK_DEFAULTS" 9 "NVM_ERASE_BLOCK" 11 "NVM_INVALIDATE_NV_BLOCK" 12 "NVM_READ_ALL" /end COMPU_VTAB
/begin COMPU_VTAB SecOC_VerificationResultType "" TAB_VERB 6 0 "SECOC_VERIFICATIONSUCCESS" 1 "SECOC_VERIFICATIONFAILURE" 2 "SECOC_FRESHNESSFAILURE" 3 "SECOC_AUTHENTICATIONBUILDFAILURE" 4 "SECOC_NO_VERIFICATION" 5 "SECOC_VERIFICATIONFAILURE_OVERWRITTEN" /end COMPU_VTAB
/begin COMPU_VTAB WdgM_GlobalStatusType "" TAB_VERB 5 0 "WDGM_GLOBAL_STATUS_OK" 1 "WDGM_GLOBAL_STATUS_FAILED" 2 "WDGM_GLOBAL_STATUS_EXPIRED" 3 "WDGM_GLOBAL_STATUS_STOPPED" 4 "WDGM_GLOBAL_STATUS_DEACTIVATED" /end COMPU_VTAB
/begin COMPU_VTAB WdgM_LocalStatusType "" TAB_VERB 4 0 "WDGM_LOCAL_STATUS_OK" 1 "WDGM_LOCAL_STATUS_FAILED" 2 "WDGM_LOCAL_STATUS_EXPIRED" 4 "WDGM_LOCAL_STATUS_DEACTIVATED" /end COMPU_VTAB
/begin COMPU_VTAB boolean "" TAB_VERB 2 0 "FALSE" 1 "TRUE" /end COMPU_VTAB
/begin COMPU_VTAB boolean_CompuMethod "" TAB_VERB 2 0 "FALSE" 1 "TRUE" /end COMPU_VTAB
/end MODULE
/end PROJECT
