ASAP2_VERSION 1 71
/begin PROJECT MICROSAR ""
/begin MODULE CPP ""
/begin MOD_COMMON "" BYTE_ORDER MSB_LAST ALIGNMENT_BYTE 1 ALIGNMENT_WORD 2 ALIGNMENT_LONG 4 ALIGNMENT_FLOAT16_IEEE 2 ALIGNMENT_FLOAT32_IEEE 4 ALIGNMENT_FLOAT64_IEEE 8 ALIGNMENT_INT64 8 /end MOD_COMMON
/begin MEASUREMENT Com_TxSigInfo[343].OnChangeIdxOfTxSigInfo "" UBYTE Com_OnChangeIdxOfTxSigInfoType 0 0 0 255 ECU_ADDRESS 0x0 /end MEASUREMENT
/begin MEASUREMENT Com_TxSigInfo[343].OnChangeOfTxSigInfo "" UBYTE Com_OnChangeOfTxSigInfoType 0 0 0 255 ECU_ADDRESS 0x0 /end MEASUREMENT
/begin MEASUREMENT Com_TxSigInfo[343].StartByteInPduPositionOfTxSigInfo "" UBYTE NO_COMPU_METHOD 0 0 0 255 ECU_ADDRESS 0x0 /end MEASUREMENT
/begin MEASUREMENT Com_TxSigInfo[343].TxAccessInfoIdxOfTxSigInfo "" UWORD NO_COMPU_METHOD 0 0 0 65535 ECU_ADDRESS 0x0 /end MEASUREMENT
/begin MEASUREMENT Com_TxSigInfo[343].TxBufferEndIdxOfTxSigInfo "" UWORD Com_TxBufferEndIdxOfTxSigInfoType 0 0 0 65535 ECU_ADDRESS 0x0 /end MEASUREMENT
/begin MEASUREMENT Com_TxSigInfo[343].TxBufferStartIdxOfTxSigInfo "" UWORD Com_TxBufferStartIdxOfTxSigInfoType 0 0 0 65535 ECU_ADDRESS 0x0 /end MEASUREMENT
/begin MEASUREMENT Com_TxSigInfo[343].TxFilterInitValueArrayBasedFilterInitValueEndIdxOfTxSigInfo "" UBYTE Com_TxFilterInitValueArrayBasedFilterInitValueEndIdxOfTxSigInfoType 0 0 0 255 ECU_ADDRESS 0x0 /end MEASUREMENT
/begin MEASUREMENT Com_TxSigInfo[343].TxFilterInitValueArrayBasedFilterInitValueStartIdxOfTxSigInfo "" UBYTE Com_TxFilterInitValueArrayBasedFilterInitValueStartIdxOfTxSigInfoType 0 0 0 255 ECU_ADDRESS 0x0 /end MEASUREMENT
/begin MEASUREMENT Com_TxSigInfo[343].TxPduInfoIdxOfTxSigInfo "" UBYTE NO_COMPU_METHOD 0 0 0 255 ECU_ADDRESS 0x0 /end MEASUREMENT
/begin MEASUREMENT Com_TxSigInfo[344].ApplTypeOfTxSigInfo "" UBYTE Com_ApplTypeOfTxSigInfoType 0 0 0 255 ECU_ADDRESS 0x0 /end MEASUREMENT
/begin MEASUREMENT Com_TxSigInfo[344].BitLengthOfTxSigInfo "" UWORD NO_COMPU_METHOD 0 0 0 65535 ECU_ADDRESS 0x0 /end MEASUREMENT
/begin MEASUREMENT Com_TxSigInfo[344].BitPositionOfTxSigInfo "" UWORD NO_COMPU_METHOD 0 0 0 65535 ECU_ADDRESS 0x0 /end MEASUREMENT
/begin MEASUREMENT Com_TxSigInfo[344].BusAccOfTxSigInfo "" UBYTE Com_BusAccOfTxSigInfoType 0 0 0 255 ECU_ADDRESS 0x0 /end MEASUREMENT
/begin MEASUREMENT Com_TxSigInfo[344].ByteLengthOfTxSigInfo "" UBYTE NO_COMPU_METHOD 0 0 0 255 ECU_ADDRESS 0x0 /end MEASUREMENT
/begin MEASUREMENT Com_TxSigInfo[344].DynSignalOfTxSigInfo "" UBYTE Com_DynSignalOfTxSigInfoType 0 0 0 1 ECU_ADDRESS 0x0 /end MEASUREMENT
/begin MEASUREMENT Com_TxSigInfo[344].FilterInitValueIdxOfTxSigInfo "" UBYTE Com_FilterInitValueIdxOfTxSigInfoType 0 0 0 255 ECU_ADDRESS 0x0 /end MEASUREMENT
/begin MEASUREMENT Com_TxSigInfo[344].FilterInitValueOfTxSigInfo "" UBYTE Com_FilterInitValueOfTxSigInfoType 0 0 0 255 ECU_ADDRESS 0x0 /end MEASUREMENT
/begin MEASUREMENT Com_TxSigInfo[344].InvValueIdxOfTxSigInfo "" UBYTE Com_InvValueIdxOfTxSigInfoType 0 0 0 255 ECU_ADDRESS 0x0 /end MEASUREMENT
/begin MEASUREMENT Com_TxSigInfo[344].InvValueOfTxSigInfo "" UBYTE Com_InvValueOfTxSigInfoType 0 0 0 255 ECU_ADDRESS 0x0 /end MEASUREMENT
/begin MEASUREMENT Com_TxSigInfo[344].OnChangeIdxOfTxSigInfo "" UBYTE Com_OnChangeIdxOfTxSigInfoType 0 0 0 255 ECU_ADDRESS 0x0 /end MEASUREMENT
/begin MEASUREMENT Com_TxSigInfo[344].OnChangeOfTxSigInfo "" UBYTE Com_OnChangeOfTxSigInfoType 0 0 0 255 ECU_ADDRESS 0x0 /end MEASUREMENT
/begin MEASUREMENT Com_TxSigInfo[344].StartByteInPduPositionOfTxSigInfo "" UBYTE NO_COMPU_METHOD 0 0 0 255 ECU_ADDRESS 0x0 /end MEASUREMENT
/begin MEASUREMENT Com_TxSigInfo[344].TxAccessInfoIdxOfTxSigInfo "" UWORD NO_COMPU_METHOD 0 0 0 65535 ECU_ADDRESS 0x0 /end MEASUREMENT
/begin MEASUREMENT Com_TxSigInfo[344].TxBufferEndIdxOfTxSigInfo "" UWORD Com_TxBufferEndIdxOfTxSigInfoType 0 0 0 65535 ECU_ADDRESS 0x0 /end MEASUREMENT
/begin MEASUREMENT Com_TxSigInfo[344].TxBufferStartIdxOfTxSigInfo "" UWORD Com_TxBufferStartIdxOfTxSigInfoType 0 0 0 65535 ECU_ADDRESS 0x0 /end MEASUREMENT
/begin MEASUREMENT Com_TxSigInfo[344].TxFilterInitValueArrayBasedFilterInitValueEndIdxOfTxSigInfo "" UBYTE Com_TxFilterInitValueArrayBasedFilterInitValueEndIdxOfTxSigInfoType 0 0 0 255 ECU_ADDRESS 0x0 /end MEASUREMENT
/begin MEASUREMENT Com_TxSigInfo[344].TxFilterInitValueArrayBasedFilterInitValueStartIdxOfTxSigInfo "" UBYTE Com_TxFilterInitValueArrayBasedFilterInitValueStartIdxOfTxSigInfoType 0 0 0 255 ECU_ADDRESS 0x0 /end MEASUREMENT
/begin MEASUREMENT Com_TxSigInfo[344].TxPduInfoIdxOfTxSigInfo "" UBYTE NO_COMPU_METHOD 0 0 0 255 ECU_ADDRESS 0x0 /end MEASUREMENT
/begin MEASUREMENT Com_TxSigInfo[345].ApplTypeOfTxSigInfo "" UBYTE Com_ApplTypeOfTxSigInfoType 0 0 0 255 ECU_ADDRESS 0x0 /end MEASUREMENT
/begin MEASUREMENT Com_TxSigInfo[345].BitLengthOfTxSigInfo "" UWORD NO_COMPU_METHOD 0 0 0 65535 ECU_ADDRESS 0x0 /end MEASUREMENT
/begin MEASUREMENT Com_TxSigInfo[345].BitPositionOfTxSigInfo "" UWORD NO_COMPU_METHOD 0 0 0 65535 ECU_ADDRESS 0x0 /end MEASUREMENT
/begin MEASUREMENT Com_TxSigInfo[345].BusAccOfTxSigInfo "" UBYTE Com_BusAccOfTxSigInfoType 0 0 0 255 ECU_ADDRESS 0x0 /end MEASUREMENT
/begin MEASUREMENT Com_TxSigInfo[345].ByteLengthOfTxSigInfo "" UBYTE NO_COMPU_METHOD 0 0 0 255 ECU_ADDRESS 0x0 /end MEASUREMENT
/begin MEASUREMENT Com_TxSigInfo[345].DynSignalOfTxSigInfo "" UBYTE Com_DynSignalOfTxSigInfoType 0 0 0 1 ECU_ADDRESS 0x0 /end MEASUREMENT
/begin MEASUREMENT Com_TxSigInfo[345].FilterInitValueIdxOfTxSigInfo "" UBYTE Com_FilterInitValueIdxOfTxSigInfoType 0 0 0 255 ECU_ADDRESS 0x0 /end MEASUREMENT
/begin MEASUREMENT Com_TxSigInfo[345].FilterInitValueOfTxSigInfo "" UBYTE Com_FilterInitValueOfTxSigInfoType 0 0 0 255 ECU_ADDRESS 0x0 /end MEASUREMENT
/begin MEASUREMENT Com_TxSigInfo[345].InvValueIdxOfTxSigInfo "" UBYTE Com_InvValueIdxOfTxSigInfoType 0 0 0 255 ECU_ADDRESS 0x0 /end MEASUREMENT
/begin MEASUREMENT Com_TxSigInfo[345].InvValueOfTxSigInfo "" UBYTE Com_InvValueOfTxSigInfoType 0 0 0 255 ECU_ADDRESS 0x0 /end MEASUREMENT
/begin MEASUREMENT Com_TxSigInfo[345].OnChangeIdxOfTxSigInfo "" UBYTE Com_OnChangeIdxOfTxSigInfoType 0 0 0 255 ECU_ADDRESS 0x0 /end MEASUREMENT
/begin MEASUREMENT Com_TxSigInfo[345].OnChangeOfTxSigInfo "" UBYTE Com_OnChangeOfTxSigInfoType 0 0 0 255 ECU_ADDRESS 0x0 /end MEASUREMENT
/begin MEASUREMENT Com_TxSigInfo[345].StartByteInPduPositionOfTxSigInfo "" UBYTE NO_COMPU_METHOD 0 0 0 255 ECU_ADDRESS 0x0 /end MEASUREMENT
/begin MEASUREMENT Com_TxSigInfo[345].TxAccessInfoIdxOfTxSigInfo "" UWORD NO_COMPU_METHOD 0 0 0 65535 ECU_ADDRESS 0x0 /end MEASUREMENT
/begin MEASUREMENT Com_TxSigInfo[345].TxBufferEndIdxOfTxSigInfo "" UWORD Com_TxBufferEndIdxOfTxSigInfoType 0 0 0 65535 ECU_ADDRESS 0x0 /end MEASUREMENT
/begin MEASUREMENT Com_TxSigInfo[345].TxBufferStartIdxOfTxSigInfo "" UWORD Com_TxBufferStartIdxOfTxSigInfoType 0 0 0 65535 ECU_ADDRESS 0x0 /end MEASUREMENT
/begin MEASUREMENT Com_TxSigInfo[345].TxFilterInitValueArrayBasedFilterInitValueEndIdxOfTxSigInfo "" UBYTE Com_TxFilterInitValueArrayBasedFilterInitValueEndIdxOfTxSigInfoType 0 0 0 255 ECU_ADDRESS 0x0 /end MEASUREMENT
/begin MEASUREMENT Com_TxSigInfo[345].TxFilterInitValueArrayBasedFilterInitValueStartIdxOfTxSigInfo "" UBYTE Com_TxFilterInitValueArrayBasedFilterInitValueStartIdxOfTxSigInfoType 0 0 0 255 ECU_ADDRESS 0x0 /end MEASUREMENT
/begin MEASUREMENT Com_TxSigInfo[345].TxPduInfoIdxOfTxSigInfo "" UBYTE NO_COMPU_METHOD 0 0 0 255 ECU_ADDRESS 0x0 /end MEASUREMENT
/begin MEASUREMENT Com_TxSigInfo[346].ApplTypeOfTxSigInfo "" UBYTE Com_ApplTypeOfTxSigInfoType 0 0 0 255 ECU_ADDRESS 0x0 /end MEASUREMENT
/begin MEASUREMENT Com_TxSigInfo[346].BitLengthOfTxSigInfo "" UWORD NO_COMPU_METHOD 0 0 0 65535 ECU_ADDRESS 0x0 /end MEASUREMENT
/begin MEASUREMENT Com_TxSigInfo[346].BitPositionOfTxSigInfo "" UWORD NO_COMPU_METHOD 0 0 0 65535 ECU_ADDRESS 0x0 /end MEASUREMENT
/begin MEASUREMENT Com_TxSigInfo[346].BusAccOfTxSigInfo "" UBYTE Com_BusAccOfTxSigInfoType 0 0 0 255 ECU_ADDRESS 0x0 /end MEASUREMENT
/begin MEASUREMENT Com_TxSigInfo[346].ByteLengthOfTxSigInfo "" UBYTE NO_COMPU_METHOD 0 0 0 255 ECU_ADDRESS 0x0 /end MEASUREMENT
/begin MEASUREMENT Com_TxSigInfo[346].DynSignalOfTxSigInfo "" UBYTE Com_DynSignalOfTxSigInfoType 0 0 0 1 ECU_ADDRESS 0x0 /end MEASUREMENT
/begin MEASUREMENT Com_TxSigInfo[346].FilterInitValueIdxOfTxSigInfo "" UBYTE Com_FilterInitValueIdxOfTxSigInfoType 0 0 0 255 ECU_ADDRESS 0x0 /end MEASUREMENT
/begin MEASUREMENT Com_TxSigInfo[346].FilterInitValueOfTxSigInfo "" UBYTE Com_FilterInitValueOfTxSigInfoType 0 0 0 255 ECU_ADDRESS 0x0 /end MEASUREMENT
/begin MEASUREMENT Com_TxSigInfo[346].InvValueIdxOfTxSigInfo "" UBYTE Com_InvValueIdxOfTxSigInfoType 0 0 0 255 ECU_ADDRESS 0x0 /end MEASUREMENT
/begin MEASUREMENT Com_TxSigInfo[346].InvValueOfTxSigInfo "" UBYTE Com_InvValueOfTxSigInfoType 0 0 0 255 ECU_ADDRESS 0x0 /end MEASUREMENT
/begin MEASUREMENT Com_TxSigInfo[346].OnChangeIdxOfTxSigInfo "" UBYTE Com_OnChangeIdxOfTxSigInfoType 0 0 0 255 ECU_ADDRESS 0x0 /end MEASUREMENT
/begin MEASUREMENT Com_TxSigInfo[346].OnChangeOfTxSigInfo "" UBYTE Com_OnChangeOfTxSigInfoType 0 0 0 255 ECU_ADDRESS 0x0 /end MEASUREMENT
/begin MEASUREMENT Com_TxSigInfo[346].StartByteInPduPositionOfTxSigInfo "" UBYTE NO_COMPU_METHOD 0 0 0 255 ECU_ADDRESS 0x0 /end MEASUREMENT
/begin MEASUREMENT Com_TxSigInfo[346].TxAccessInfoIdxOfTxSigInfo "" UWORD NO_COMPU_METHOD 0 0 0 65535 ECU_ADDRESS 0x0 /end MEASUREMENT
/begin MEASUREMENT Com_TxSigInfo[346].TxBufferEndIdxOfTxSigInfo "" UWORD Com_TxBufferEndIdxOfTxSigInfoType 0 0 0 65535 ECU_ADDRESS 0x0 /end MEASUREMENT
/begin MEASUREMENT Com_TxSigInfo[346].TxBufferStartIdxOfTxSigInfo "" UWORD Com_TxBufferStartIdxOfTxSigInfoType 0 0 0 65535 ECU_ADDRESS 0x0 /end MEASUREMENT
/begin MEASUREMENT Com_TxSigInfo[346].TxFilterInitValueArrayBasedFilterInitValueEndIdxOfTxSigInfo "" UBYTE Com_TxFilterInitValueArrayBasedFilterInitValueEndIdxOfTxSigInfoType 0 0 0 255 ECU_ADDRESS 0x0 /end MEASUREMENT
/begin MEASUREMENT Com_TxSigInfo[346].TxFilterInitValueArrayBasedFilterInitValueStartIdxOfTxSigInfo "" UBYTE Com_TxFilterInitValueArrayBasedFilterInitValueStartIdxOfTxSigInfoType 0 0 0 255 ECU_ADDRESS 0x0 /end MEASUREMENT
/begin MEASUREMENT Com_TxSigInfo[346].TxPduInfoIdxOfTxSigInfo "" UBYTE NO_COMPU_METHOD 0 0 0 255 ECU_ADDRESS 0x0 /end MEASUREMENT
/begin MEASUREMENT Com_TxSigInfo[347].ApplTypeOfTxSigInfo "" UBYTE Com_ApplTypeOfTxSigInfoType 0 0 0 255 ECU_ADDRESS 0x0 /end MEASUREMENT
/begin MEASUREMENT Com_TxSigInfo[347].BitLengthOfTxSigInfo "" UWORD NO_COMPU_METHOD 0 0 0 65535 ECU_ADDRESS 0x0 /end MEASUREMENT
/begin MEASUREMENT Com_TxSigInfo[347].BitPositionOfTxSigInfo "" UWORD NO_COMPU_METHOD 0 0 0 65535 ECU_ADDRESS 0x0 /end MEASUREMENT
/begin MEASUREMENT Com_TxSigInfo[347].BusAccOfTxSigInfo "" UBYTE Com_BusAccOfTxSigInfoType 0 0 0 255 ECU_ADDRESS 0x0 /end MEASUREMENT
/begin MEASUREMENT Com_TxSigInfo[347].ByteLengthOfTxSigInfo "" UBYTE NO_COMPU_METHOD 0 0 0 255 ECU_ADDRESS 0x0 /end MEASUREMENT
/begin MEASUREMENT Com_TxSigInfo[347].DynSignalOfTxSigInfo "" UBYTE Com_DynSignalOfTxSigInfoType 0 0 0 1 ECU_ADDRESS 0x0 /end MEASUREMENT
/begin MEASUREMENT Com_TxSigInfo[347].FilterInitValueIdxOfTxSigInfo "" UBYTE Com_FilterInitValueIdxOfTxSigInfoType 0 0 0 255 ECU_ADDRESS 0x0 /end MEASUREMENT
/begin MEASUREMENT Com_TxSigInfo[347].FilterInitValueOfTxSigInfo "" UBYTE Com_FilterInitValueOfTxSigInfoType 0 0 0 255 ECU_ADDRESS 0x0 /end MEASUREMENT
/begin MEASUREMENT Com_TxSigInfo[347].InvValueIdxOfTxSigInfo "" UBYTE Com_InvValueIdxOfTxSigInfoType 0 0 0 255 ECU_ADDRESS 0x0 /end MEASUREMENT
/begin MEASUREMENT Com_TxSigInfo[347].InvValueOfTxSigInfo "" UBYTE Com_InvValueOfTxSigInfoType 0 0 0 255 ECU_ADDRESS 0x0 /end MEASUREMENT
/begin MEASUREMENT Com_TxSigInfo[347].OnChangeIdxOfTxSigInfo "" UBYTE Com_OnChangeIdxOfTxSigInfoType 0 0 0 255 ECU_ADDRESS 0x0 /end MEASUREMENT
/begin MEASUREMENT Com_TxSigInfo[347].OnChangeOfTxSigInfo "" UBYTE Com_OnChangeOfTxSigInfoType 0 0 0 255 ECU_ADDRESS 0x0 /end MEASUREMENT
/begin MEASUREMENT Com_TxSigInfo[347].StartByteInPduPositionOfTxSigInfo "" UBYTE NO_COMPU_METHOD 0 0 0 255 ECU_ADDRESS 0x0 /end MEASUREMENT
/begin MEASUREMENT Com_TxSigInfo[347].TxAccessInfoIdxOfTxSigInfo "" UWORD NO_COMPU_METHOD 0 0 0 65535 ECU_ADDRESS 0x0 /end MEASUREMENT
/begin MEASUREMENT Com_TxSigInfo[347].TxBufferEndIdxOfTxSigInfo "" UWORD Com_TxBufferEndIdxOfTxSigInfoType 0 0 0 65535 ECU_ADDRESS 0x0 /end MEASUREMENT
/begin MEASUREMENT Com_TxSigInfo[347].TxBufferStartIdxOfTxSigInfo "" UWORD Com_TxBufferStartIdxOfTxSigInfoType 0 0 0 65535 ECU_ADDRESS 0x0 /end MEASUREMENT
/begin MEASUREMENT Com_TxSigInfo[347].TxFilterInitValueArrayBasedFilterInitValueEndIdxOfTxSigInfo "" UBYTE Com_TxFilterInitValueArrayBasedFilterInitValueEndIdxOfTxSigInfoType 0 0 0 255 ECU_ADDRESS 0x0 /end MEASUREMENT
/begin MEASUREMENT Com_TxSigInfo[347].TxFilterInitValueArrayBasedFilterInitValueStartIdxOfTxSigInfo "" UBYTE Com_TxFilterInitValueArrayBasedFilterInitValueStartIdxOfTxSigInfoType 0 0 0 255 ECU_ADDRESS 0x0 /end MEASUREMENT
/begin MEASUREMENT Com_TxSigInfo[347].TxPduInfoIdxOfTxSigInfo "" UBYTE NO_COMPU_METHOD 0 0 0 255 ECU_ADDRESS 0x0 /end MEASUREMENT
/begin MEASUREMENT Com_TxSigInfo[348].ApplTypeOfTxSigInfo "" UBYTE Com_ApplTypeOfTxSigInfoType 0 0 0 255 ECU_ADDRESS 0x0 /end MEASUREMENT
/begin MEASUREMENT Com_TxSigInfo[348].BitLengthOfTxSigInfo "" UWORD NO_COMPU_METHOD 0 0 0 65535 ECU_ADDRESS 0x0 /end MEASUREMENT
/begin MEASUREMENT Com_TxSigInfo[348].BitPositionOfTxSigInfo "" UWORD NO_COMPU_METHOD 0 0 0 65535 ECU_ADDRESS 0x0 /end MEASUREMENT
/begin MEASUREMENT Com_TxSigInfo[348].BusAccOfTxSigInfo "" UBYTE Com_BusAccOfTxSigInfoType 0 0 0 255 ECU_ADDRESS 0x0 /end MEASUREMENT
/begin MEASUREMENT Com_TxSigInfo[348].ByteLengthOfTxSigInfo "" UBYTE NO_COMPU_METHOD 0 0 0 255 ECU_ADDRESS 0x0 /end MEASUREMENT
/begin MEASUREMENT Com_TxSigInfo[348].DynSignalOfTxSigInfo "" UBYTE Com_DynSignalOfTxSigInfoType 0 0 0 1 ECU_ADDRESS 0x0 /end MEASUREMENT
/begin MEASUREMENT Com_TxSigInfo[348].FilterInitValueIdxOfTxSigInfo "" UBYTE Com_FilterInitValueIdxOfTxSigInfoType 0 0 0 255 ECU_ADDRESS 0x0 /end MEASUREMENT
/begin MEASUREMENT Com_TxSigInfo[348].FilterInitValueOfTxSigInfo "" UBYTE Com_FilterInitValueOfTxSigInfoType 0 0 0 255 ECU_ADDRESS 0x0 /end MEASUREMENT
/begin MEASUREMENT Com_TxSigInfo[348].InvValueIdxOfTxSigInfo "" UBYTE Com_InvValueIdxOfTxSigInfoType 0 0 0 255 ECU_ADDRESS 0x0 /end MEASUREMENT
/begin MEASUREMENT Com_TxSigInfo[348].InvValueOfTxSigInfo "" UBYTE Com_InvValueOfTxSigInfoType 0 0 0 255 ECU_ADDRESS 0x0 /end MEASUREMENT
/begin MEASUREMENT Com_TxSigInfo[348].OnChangeIdxOfTxSigInfo "" UBYTE Com_OnChangeIdxOfTxSigInfoType 0 0 0 255 ECU_ADDRESS 0x0 /end MEASUREMENT
/begin MEASUREMENT Com_TxSigInfo[348].OnChangeOfTxSigInfo "" UBYTE Com_OnChangeOfTxSigInfoType 0 0 0 255 ECU_ADDRESS 0x0 /end MEASUREMENT
/begin MEASUREMENT Com_TxSigInfo[348].StartByteInPduPositionOfTxSigInfo "" UBYTE NO_COMPU_METHOD 0 0 0 255 ECU_ADDRESS 0x0 /end MEASUREMENT
/begin MEASUREMENT Com_TxSigInfo[348].TxAccessInfoIdxOfTxSigInfo "" UWORD NO_COMPU_METHOD 0 0 0 65535 ECU_ADDRESS 0x0 /end MEASUREMENT
/begin MEASUREMENT Com_TxSigInfo[348].TxBufferEndIdxOfTxSigInfo "" UWORD Com_TxBufferEndIdxOfTxSigInfoType 0 0 0 65535 ECU_ADDRESS 0x0 /end MEASUREMENT
/begin MEASUREMENT Com_TxSigInfo[348].TxBufferStartIdxOfTxSigInfo "" UWORD Com_TxBufferStartIdxOfTxSigInfoType 0 0 0 65535 ECU_ADDRESS 0x0 /end MEASUREMENT
/begin MEASUREMENT Com_TxSigInfo[348].TxFilterInitValueArrayBasedFilterInitValueEndIdxOfTxSigInfo "" UBYTE Com_TxFilterInitValueArrayBasedFilterInitValueEndIdxOfTxSigInfoType 0 0 0 255 ECU_ADDRESS 0x0 /end MEASUREMENT
/begin MEASUREMENT Com_TxSigInfo[348].TxFilterInitValueArrayBasedFilterInitValueStartIdxOfTxSigInfo "" UBYTE Com_TxFilterInitValueArrayBasedFilterInitValueStartIdxOfTxSigInfoType 0 0 0 255 ECU_ADDRESS 0x0 /end MEASUREMENT
/begin MEASUREMENT Com_TxSigInfo[348].TxPduInfoIdxOfTxSigInfo "" UBYTE NO_COMPU_METHOD 0 0 0 255 ECU_ADDRESS 0x0 /end MEASUREMENT
/begin MEASUREMENT Com_TxSigInfo[349].ApplTypeOfTxSigInfo "" UBYTE Com_ApplTypeOfTxSigInfoType 0 0 0 255 ECU_ADDRESS 0x0 /end MEASUREMENT
/begin MEASUREMENT Com_TxSigInfo[349].BitLengthOfTxSigInfo "" UWORD NO_COMPU_METHOD 0 0 0 65535 ECU_ADDRESS 0x0 /end MEASUREMENT
/begin MEASUREMENT Com_TxSigInfo[349].BitPositionOfTxSigInfo "" UWORD NO_COMPU_METHOD 0 0 0 65535 ECU_ADDRESS 0x0 /end MEASUREMENT
/begin MEASUREMENT Com_TxSigInfo[349].BusAccOfTxSigInfo "" UBYTE Com_BusAccOfTxSigInfoType 0 0 0 255 ECU_ADDRESS 0x0 /end MEASUREMENT
/begin MEASUREMENT Com_TxSigInfo[349].ByteLengthOfTxSigInfo "" UBYTE NO_COMPU_METHOD 0 0 0 255 ECU_ADDRESS 0x0 /end MEASUREMENT
/begin MEASUREMENT Com_TxSigInfo[349].DynSignalOfTxSigInfo "" UBYTE Com_DynSignalOfTxSigInfoType 0 0 0 1 ECU_ADDRESS 0x0 /end MEASUREMENT
/begin MEASUREMENT Com_TxSigInfo[349].FilterInitValueIdxOfTxSigInfo "" UBYTE Com_FilterInitValueIdxOfTxSigInfoType 0 0 0 255 ECU_ADDRESS 0x0 /end MEASUREMENT
/begin MEASUREMENT Com_TxSigInfo[349].FilterInitValueOfTxSigInfo "" UBYTE Com_FilterInitValueOfTxSigInfoType 0 0 0 255 ECU_ADDRESS 0x0 /end MEASUREMENT
/begin MEASUREMENT Com_TxSigInfo[349].InvValueIdxOfTxSigInfo "" UBYTE Com_InvValueIdxOfTxSigInfoType 0 0 0 255 ECU_ADDRESS 0x0 /end MEASUREMENT
/begin MEASUREMENT Com_TxSigInfo[349].InvValueOfTxSigInfo "" UBYTE Com_InvValueOfTxSigInfoType 0 0 0 255 ECU_ADDRESS 0x0 /end MEASUREMENT
/begin MEASUREMENT Com_TxSigInfo[349].OnChangeIdxOfTxSigInfo "" UBYTE Com_OnChangeIdxOfTxSigInfoType 0 0 0 255 ECU_ADDRESS 0x0 /end MEASUREMENT
/begin MEASUREMENT Com_TxSigInfo[349].OnChangeOfTxSigInfo "" UBYTE Com_OnChangeOfTxSigInfoType 0 0 0 255 ECU_ADDRESS 0x0 /end MEASUREMENT
/begin MEASUREMENT Com_TxSigInfo[349].StartByteInPduPositionOfTxSigInfo "" UBYTE NO_COMPU_METHOD 0 0 0 255 ECU_ADDRESS 0x0 /end MEASUREMENT
/begin MEASUREMENT Com_TxSigInfo[349].TxAccessInfoIdxOfTxSigInfo "" UWORD NO_COMPU_METHOD 0 0 0 65535 ECU_ADDRESS 0x0 /end MEASUREMENT
/begin MEASUREMENT Com_TxSigInfo[349].TxBufferEndIdxOfTxSigInfo "" UWORD Com_TxBufferEndIdxOfTxSigInfoType 0 0 0 65535 ECU_ADDRESS 0x0 /end MEASUREMENT
/begin MEASUREMENT Com_TxSigInfo[349].TxBufferStartIdxOfTxSigInfo "" UWORD Com_TxBufferStartIdxOfTxSigInfoType 0 0 0 65535 ECU_ADDRESS 0x0 /end MEASUREMENT
/begin MEASUREMENT Com_TxSigInfo[349].TxFilterInitValueArrayBasedFilterInitValueEndIdxOfTxSigInfo "" UBYTE Com_TxFilterInitValueArrayBasedFilterInitValueEndIdxOfTxSigInfoType 0 0 0 255 ECU_ADDRESS 0x0 /end MEASUREMENT
/begin MEASUREMENT Com_TxSigInfo[349].TxFilterInitValueArrayBasedFilterInitValueStartIdxOfTxSigInfo "" UBYTE Com_TxFilterInitValueArrayBasedFilterInitValueStartIdxOfTxSigInfoType 0 0 0 255 ECU_ADDRESS 0x0 /end MEASUREMENT
/begin MEASUREMENT Com_TxSigInfo[349].TxPduInfoIdxOfTxSigInfo "" UBYTE NO_COMPU_METHOD 0 0 0 255 ECU_ADDRESS 0x0 /end MEASUREMENT
/begin MEASUREMENT Com_TxSigInfo[34].ApplTypeOfTxSigInfo "" UBYTE Com_ApplTypeOfTxSigInfoType 0 0 0 255 ECU_ADDRESS 0x0 /end MEASUREMENT
/begin MEASUREMENT Com_TxSigInfo[34].BitLengthOfTxSigInfo "" UWORD NO_COMPU_METHOD 0 0 0 65535 ECU_ADDRESS 0x0 /end MEASUREMENT
/begin MEASUREMENT Com_TxSigInfo[34].BitPositionOfTxSigInfo "" UWORD NO_COMPU_METHOD 0 0 0 65535 ECU_ADDRESS 0x0 /end MEASUREMENT
/begin MEASUREMENT Com_TxSigInfo[34].BusAccOfTxSigInfo "" UBYTE Com_BusAccOfTxSigInfoType 0 0 0 255 ECU_ADDRESS 0x0 /end MEASUREMENT
/begin MEASUREMENT Com_TxSigInfo[34].ByteLengthOfTxSigInfo "" UBYTE NO_COMPU_METHOD 0 0 0 255 ECU_ADDRESS 0x0 /end MEASUREMENT
/begin MEASUREMENT Com_TxSigInfo[34].DynSignalOfTxSigInfo "" UBYTE Com_DynSignalOfTxSigInfoType 0 0 0 1 ECU_ADDRESS 0x0 /end MEASUREMENT
/begin MEASUREMENT Com_TxSigInfo[34].FilterInitValueIdxOfTxSigInfo "" UBYTE Com_FilterInitValueIdxOfTxSigInfoType 0 0 0 255 ECU_ADDRESS 0x0 /end MEASUREMENT
/begin MEASUREMENT Com_TxSigInfo[34].FilterInitValueOfTxSigInfo "" UBYTE Com_FilterInitValueOfTxSigInfoType 0 0 0 255 ECU_ADDRESS 0x0 /end MEASUREMENT
/begin MEASUREMENT Com_TxSigInfo[34].InvValueIdxOfTxSigInfo "" UBYTE Com_InvValueIdxOfTxSigInfoType 0 0 0 255 ECU_ADDRESS 0x0 /end MEASUREMENT
/begin MEASUREMENT Com_TxSigInfo[34].InvValueOfTxSigInfo "" UBYTE Com_InvValueOfTxSigInfoType 0 0 0 255 ECU_ADDRESS 0x0 /end MEASUREMENT
/begin MEASUREMENT Com_TxSigInfo[34].OnChangeIdxOfTxSigInfo "" UBYTE Com_OnChangeIdxOfTxSigInfoType 0 0 0 255 ECU_ADDRESS 0x0 /end MEASUREMENT
/begin MEASUREMENT Com_TxSigInfo[34].OnChangeOfTxSigInfo "" UBYTE Com_OnChangeOfTxSigInfoType 0 0 0 255 ECU_ADDRESS 0x0 /end MEASUREMENT
/begin MEASUREMENT Com_TxSigInfo[34].StartByteInPduPositionOfTxSigInfo "" UBYTE NO_COMPU_METHOD 0 0 0 255 ECU_ADDRESS 0x0 /end MEASUREMENT
/begin MEASUREMENT Com_TxSigInfo[34].TxAccessInfoIdxOfTxSigInfo "" UWORD NO_COMPU_METHOD 0 0 0 65535 ECU_ADDRESS 0x0 /end MEASUREMENT
/begin MEASUREMENT Com_TxSigInfo[34].TxBufferEndIdxOfTxSigInfo "" UWORD Com_TxBufferEndIdxOfTxSigInfoType 0 0 0 65535 ECU_ADDRESS 0x0 /end MEASUREMENT
/begin MEASUREMENT Com_TxSigInfo[34].TxBufferStartIdxOfTxSigInfo "" UWORD Com_TxBufferStartIdxOfTxSigInfoType 0 0 0 65535 ECU_ADDRESS 0x0 /end MEASUREMENT
/begin MEASUREMENT Com_TxSigInfo[34].TxFilterInitValueArrayBasedFilterInitValueEndIdxOfTxSigInfo "" UBYTE Com_TxFilterInitValueArrayBasedFilterInitValueEndIdxOfTxSigInfoType 0 0 0 255 ECU_ADDRESS 0x0 /end MEASUREMENT
/begin MEASUREMENT Com_TxSigInfo[34].TxFilterInitValueArrayBasedFilterInitValueStartIdxOfTxSigInfo "" UBYTE Com_TxFilterInitValueArrayBasedFilterInitValueStartIdxOfTxSigInfoType 0 0 0 255 ECU_ADDRESS 0x0 /end MEASUREMENT
/begin MEASUREMENT Com_TxSigInfo[34].TxPduInfoIdxOfTxSigInfo "" UBYTE NO_COMPU_METHOD 0 0 0 255 ECU_ADDRESS 0x0 /end MEASUREMENT
/begin MEASUREMENT Com_TxSigInfo[350].ApplTypeOfTxSigInfo "" UBYTE Com_ApplTypeOfTxSigInfoType 0 0 0 255 ECU_ADDRESS 0x0 /end MEASUREMENT
/begin MEASUREMENT Com_TxSigInfo[350].BitLengthOfTxSigInfo "" UWORD NO_COMPU_METHOD 0 0 0 65535 ECU_ADDRESS 0x0 /end MEASUREMENT
/begin MEASUREMENT Com_TxSigInfo[350].BitPositionOfTxSigInfo "" UWORD NO_COMPU_METHOD 0 0 0 65535 ECU_ADDRESS 0x0 /end MEASUREMENT
/begin MEASUREMENT Com_TxSigInfo[350].BusAccOfTxSigInfo "" UBYTE Com_BusAccOfTxSigInfoType 0 0 0 255 ECU_ADDRESS 0x0 /end MEASUREMENT
/begin MEASUREMENT Com_TxSigInfo[350].ByteLengthOfTxSigInfo "" UBYTE NO_COMPU_METHOD 0 0 0 255 ECU_ADDRESS 0x0 /end MEASUREMENT
/begin MEASUREMENT Com_TxSigInfo[350].DynSignalOfTxSigInfo "" UBYTE Com_DynSignalOfTxSigInfoType 0 0 0 1 ECU_ADDRESS 0x0 /end MEASUREMENT
/begin MEASUREMENT Com_TxSigInfo[350].FilterInitValueIdxOfTxSigInfo "" UBYTE Com_FilterInitValueIdxOfTxSigInfoType 0 0 0 255 ECU_ADDRESS 0x0 /end MEASUREMENT
/begin MEASUREMENT Com_TxSigInfo[350].FilterInitValueOfTxSigInfo "" UBYTE Com_FilterInitValueOfTxSigInfoType 0 0 0 255 ECU_ADDRESS 0x0 /end MEASUREMENT
/begin MEASUREMENT Com_TxSigInfo[350].InvValueIdxOfTxSigInfo "" UBYTE Com_InvValueIdxOfTxSigInfoType 0 0 0 255 ECU_ADDRESS 0x0 /end MEASUREMENT
/begin MEASUREMENT Com_TxSigInfo[350].InvValueOfTxSigInfo "" UBYTE Com_InvValueOfTxSigInfoType 0 0 0 255 ECU_ADDRESS 0x0 /end MEASUREMENT
/begin MEASUREMENT Com_TxSigInfo[350].OnChangeIdxOfTxSigInfo "" UBYTE Com_OnChangeIdxOfTxSigInfoType 0 0 0 255 ECU_ADDRESS 0x0 /end MEASUREMENT
/begin MEASUREMENT Com_TxSigInfo[350].OnChangeOfTxSigInfo "" UBYTE Com_OnChangeOfTxSigInfoType 0 0 0 255 ECU_ADDRESS 0x0 /end MEASUREMENT
/begin MEASUREMENT Com_TxSigInfo[350].StartByteInPduPositionOfTxSigInfo "" UBYTE NO_COMPU_METHOD 0 0 0 255 ECU_ADDRESS 0x0 /end MEASUREMENT
/begin MEASUREMENT Com_TxSigInfo[350].TxAccessInfoIdxOfTxSigInfo "" UWORD NO_COMPU_METHOD 0 0 0 65535 ECU_ADDRESS 0x0 /end MEASUREMENT
/begin MEASUREMENT Com_TxSigInfo[350].TxBufferEndIdxOfTxSigInfo "" UWORD Com_TxBufferEndIdxOfTxSigInfoType 0 0 0 65535 ECU_ADDRESS 0x0 /end MEASUREMENT
/begin MEASUREMENT Com_TxSigInfo[350].TxBufferStartIdxOfTxSigInfo "" UWORD Com_TxBufferStartIdxOfTxSigInfoType 0 0 0 65535 ECU_ADDRESS 0x0 /end MEASUREMENT
/begin MEASUREMENT Com_TxSigInfo[350].TxFilterInitValueArrayBasedFilterInitValueEndIdxOfTxSigInfo "" UBYTE Com_TxFilterInitValueArrayBasedFilterInitValueEndIdxOfTxSigInfoType 0 0 0 255 ECU_ADDRESS 0x0 /end MEASUREMENT
/begin MEASUREMENT Com_TxSigInfo[350].TxFilterInitValueArrayBasedFilterInitValueStartIdxOfTxSigInfo "" UBYTE Com_TxFilterInitValueArrayBasedFilterInitValueStartIdxOfTxSigInfoType 0 0 0 255 ECU_ADDRESS 0x0 /end MEASUREMENT
/begin MEASUREMENT Com_TxSigInfo[350].TxPduInfoIdxOfTxSigInfo "" UBYTE NO_COMPU_METHOD 0 0 0 255 ECU_ADDRESS 0x0 /end MEASUREMENT
/begin MEASUREMENT Com_TxSigInfo[351].ApplTypeOfTxSigInfo "" UBYTE Com_ApplTypeOfTxSigInfoType 0 0 0 255 ECU_ADDRESS 0x0 /end MEASUREMENT
/begin MEASUREMENT Com_TxSigInfo[351].BitLengthOfTxSigInfo "" UWORD NO_COMPU_METHOD 0 0 0 65535 ECU_ADDRESS 0x0 /end MEASUREMENT
/begin MEASUREMENT Com_TxSigInfo[351].BitPositionOfTxSigInfo "" UWORD NO_COMPU_METHOD 0 0 0 65535 ECU_ADDRESS 0x0 /end MEASUREMENT
/begin MEASUREMENT Com_TxSigInfo[351].BusAccOfTxSigInfo "" UBYTE Com_BusAccOfTxSigInfoType 0 0 0 255 ECU_ADDRESS 0x0 /end MEASUREMENT
/begin MEASUREMENT Com_TxSigInfo[351].ByteLengthOfTxSigInfo "" UBYTE NO_COMPU_METHOD 0 0 0 255 ECU_ADDRESS 0x0 /end MEASUREMENT
/begin MEASUREMENT Com_TxSigInfo[351].DynSignalOfTxSigInfo "" UBYTE Com_DynSignalOfTxSigInfoType 0 0 0 1 ECU_ADDRESS 0x0 /end MEASUREMENT
/begin MEASUREMENT Com_TxSigInfo[351].FilterInitValueIdxOfTxSigInfo "" UBYTE Com_FilterInitValueIdxOfTxSigInfoType 0 0 0 255 ECU_ADDRESS 0x0 /end MEASUREMENT
/begin MEASUREMENT Com_TxSigInfo[351].FilterInitValueOfTxSigInfo "" UBYTE Com_FilterInitValueOfTxSigInfoType 0 0 0 255 ECU_ADDRESS 0x0 /end MEASUREMENT
/begin MEASUREMENT Com_TxSigInfo[351].InvValueIdxOfTxSigInfo "" UBYTE Com_InvValueIdxOfTxSigInfoType 0 0 0 255 ECU_ADDRESS 0x0 /end MEASUREMENT
/begin MEASUREMENT Com_TxSigInfo[351].InvValueOfTxSigInfo "" UBYTE Com_InvValueOfTxSigInfoType 0 0 0 255 ECU_ADDRESS 0x0 /end MEASUREMENT
/begin MEASUREMENT Com_TxSigInfo[351].OnChangeIdxOfTxSigInfo "" UBYTE Com_OnChangeIdxOfTxSigInfoType 0 0 0 255 ECU_ADDRESS 0x0 /end MEASUREMENT
/begin MEASUREMENT Com_TxSigInfo[351].OnChangeOfTxSigInfo "" UBYTE Com_OnChangeOfTxSigInfoType 0 0 0 255 ECU_ADDRESS 0x0 /end MEASUREMENT
/begin MEASUREMENT Com_TxSigInfo[351].StartByteInPduPositionOfTxSigInfo "" UBYTE NO_COMPU_METHOD 0 0 0 255 ECU_ADDRESS 0x0 /end MEASUREMENT
/begin MEASUREMENT Com_TxSigInfo[351].TxAccessInfoIdxOfTxSigInfo "" UWORD NO_COMPU_METHOD 0 0 0 65535 ECU_ADDRESS 0x0 /end MEASUREMENT
/begin MEASUREMENT Com_TxSigInfo[351].TxBufferEndIdxOfTxSigInfo "" UWORD Com_TxBufferEndIdxOfTxSigInfoType 0 0 0 65535 ECU_ADDRESS 0x0 /end MEASUREMENT
/begin MEASUREMENT Com_TxSigInfo[351].TxBufferStartIdxOfTxSigInfo "" UWORD Com_TxBufferStartIdxOfTxSigInfoType 0 0 0 65535 ECU_ADDRESS 0x0 /end MEASUREMENT
/begin MEASUREMENT Com_TxSigInfo[351].TxFilterInitValueArrayBasedFilterInitValueEndIdxOfTxSigInfo "" UBYTE Com_TxFilterInitValueArrayBasedFilterInitValueEndIdxOfTxSigInfoType 0 0 0 255 ECU_ADDRESS 0x0 /end MEASUREMENT
/begin MEASUREMENT Com_TxSigInfo[351].TxFilterInitValueArrayBasedFilterInitValueStartIdxOfTxSigInfo "" UBYTE Com_TxFilterInitValueArrayBasedFilterInitValueStartIdxOfTxSigInfoType 0 0 0 255 ECU_ADDRESS 0x0 /end MEASUREMENT
/begin MEASUREMENT Com_TxSigInfo[351].TxPduInfoIdxOfTxSigInfo "" UBYTE NO_COMPU_METHOD 0 0 0 255 ECU_ADDRESS 0x0 /end MEASUREMENT
/begin MEASUREMENT Com_TxSigInfo[352].ApplTypeOfTxSigInfo "" UBYTE Com_ApplTypeOfTxSigInfoType 0 0 0 255 ECU_ADDRESS 0x0 /end MEASUREMENT
/begin MEASUREMENT Com_TxSigInfo[352].BitLengthOfTxSigInfo "" UWORD NO_COMPU_METHOD 0 0 0 65535 ECU_ADDRESS 0x0 /end MEASUREMENT
/begin MEASUREMENT Com_TxSigInfo[352].BitPositionOfTxSigInfo "" UWORD NO_COMPU_METHOD 0 0 0 65535 ECU_ADDRESS 0x0 /end MEASUREMENT
/begin MEASUREMENT Com_TxSigInfo[352].BusAccOfTxSigInfo "" UBYTE Com_BusAccOfTxSigInfoType 0 0 0 255 ECU_ADDRESS 0x0 /end MEASUREMENT
/begin MEASUREMENT Com_TxSigInfo[352].ByteLengthOfTxSigInfo "" UBYTE NO_COMPU_METHOD 0 0 0 255 ECU_ADDRESS 0x0 /end MEASUREMENT
/begin MEASUREMENT Com_TxSigInfo[352].DynSignalOfTxSigInfo "" UBYTE Com_DynSignalOfTxSigInfoType 0 0 0 1 ECU_ADDRESS 0x0 /end MEASUREMENT
/begin MEASUREMENT Com_TxSigInfo[352].FilterInitValueIdxOfTxSigInfo "" UBYTE Com_FilterInitValueIdxOfTxSigInfoType 0 0 0 255 ECU_ADDRESS 0x0 /end MEASUREMENT
/begin MEASUREMENT Com_TxSigInfo[352].FilterInitValueOfTxSigInfo "" UBYTE Com_FilterInitValueOfTxSigInfoType 0 0 0 255 ECU_ADDRESS 0x0 /end MEASUREMENT
/begin MEASUREMENT Com_TxSigInfo[352].InvValueIdxOfTxSigInfo "" UBYTE Com_InvValueIdxOfTxSigInfoType 0 0 0 255 ECU_ADDRESS 0x0 /end MEASUREMENT
/begin MEASUREMENT Com_TxSigInfo[352].InvValueOfTxSigInfo "" UBYTE Com_InvValueOfTxSigInfoType 0 0 0 255 ECU_ADDRESS 0x0 /end MEASUREMENT
/begin MEASUREMENT Com_TxSigInfo[352].OnChangeIdxOfTxSigInfo "" UBYTE Com_OnChangeIdxOfTxSigInfoType 0 0 0 255 ECU_ADDRESS 0x0 /end MEASUREMENT
/begin MEASUREMENT Com_TxSigInfo[352].OnChangeOfTxSigInfo "" UBYTE Com_OnChangeOfTxSigInfoType 0 0 0 255 ECU_ADDRESS 0x0 /end MEASUREMENT
/begin MEASUREMENT Com_TxSigInfo[352].StartByteInPduPositionOfTxSigInfo "" UBYTE NO_COMPU_METHOD 0 0 0 255 ECU_ADDRESS 0x0 /end MEASUREMENT
/begin MEASUREMENT Com_TxSigInfo[352].TxAccessInfoIdxOfTxSigInfo "" UWORD NO_COMPU_METHOD 0 0 0 65535 ECU_ADDRESS 0x0 /end MEASUREMENT
/begin MEASUREMENT Com_TxSigInfo[352].TxBufferEndIdxOfTxSigInfo "" UWORD Com_TxBufferEndIdxOfTxSigInfoType 0 0 0 65535 ECU_ADDRESS 0x0 /end MEASUREMENT
/begin MEASUREMENT Com_TxSigInfo[352].TxBufferStartIdxOfTxSigInfo "" UWORD Com_TxBufferStartIdxOfTxSigInfoType 0 0 0 65535 ECU_ADDRESS 0x0 /end MEASUREMENT
/begin MEASUREMENT Com_TxSigInfo[352].TxFilterInitValueArrayBasedFilterInitValueEndIdxOfTxSigInfo "" UBYTE Com_TxFilterInitValueArrayBasedFilterInitValueEndIdxOfTxSigInfoType 0 0 0 255 ECU_ADDRESS 0x0 /end MEASUREMENT
/begin MEASUREMENT Com_TxSigInfo[352].TxFilterInitValueArrayBasedFilterInitValueStartIdxOfTxSigInfo "" UBYTE Com_TxFilterInitValueArrayBasedFilterInitValueStartIdxOfTxSigInfoType 0 0 0 255 ECU_ADDRESS 0x0 /end MEASUREMENT
/begin MEASUREMENT Com_TxSigInfo[352].TxPduInfoIdxOfTxSigInfo "" UBYTE NO_COMPU_METHOD 0 0 0 255 ECU_ADDRESS 0x0 /end MEASUREMENT
/begin MEASUREMENT Com_TxSigInfo[353].ApplTypeOfTxSigInfo "" UBYTE Com_ApplTypeOfTxSigInfoType 0 0 0 255 ECU_ADDRESS 0x0 /end MEASUREMENT
/begin MEASUREMENT Com_TxSigInfo[353].BitLengthOfTxSigInfo "" UWORD NO_COMPU_METHOD 0 0 0 65535 ECU_ADDRESS 0x0 /end MEASUREMENT
/begin MEASUREMENT Com_TxSigInfo[353].BitPositionOfTxSigInfo "" UWORD NO_COMPU_METHOD 0 0 0 65535 ECU_ADDRESS 0x0 /end MEASUREMENT
/begin MEASUREMENT Com_TxSigInfo[353].BusAccOfTxSigInfo "" UBYTE Com_BusAccOfTxSigInfoType 0 0 0 255 ECU_ADDRESS 0x0 /end MEASUREMENT
/begin MEASUREMENT Com_TxSigInfo[353].ByteLengthOfTxSigInfo "" UBYTE NO_COMPU_METHOD 0 0 0 255 ECU_ADDRESS 0x0 /end MEASUREMENT
/begin MEASUREMENT Com_TxSigInfo[353].DynSignalOfTxSigInfo "" UBYTE Com_DynSignalOfTxSigInfoType 0 0 0 1 ECU_ADDRESS 0x0 /end MEASUREMENT
/begin MEASUREMENT Com_TxSigInfo[353].FilterInitValueIdxOfTxSigInfo "" UBYTE Com_FilterInitValueIdxOfTxSigInfoType 0 0 0 255 ECU_ADDRESS 0x0 /end MEASUREMENT
/begin MEASUREMENT Com_TxSigInfo[353].FilterInitValueOfTxSigInfo "" UBYTE Com_FilterInitValueOfTxSigInfoType 0 0 0 255 ECU_ADDRESS 0x0 /end MEASUREMENT
/begin MEASUREMENT Com_TxSigInfo[353].InvValueIdxOfTxSigInfo "" UBYTE Com_InvValueIdxOfTxSigInfoType 0 0 0 255 ECU_ADDRESS 0x0 /end MEASUREMENT
/begin MEASUREMENT Com_TxSigInfo[353].InvValueOfTxSigInfo "" UBYTE Com_InvValueOfTxSigInfoType 0 0 0 255 ECU_ADDRESS 0x0 /end MEASUREMENT
/begin MEASUREMENT Com_TxSigInfo[353].OnChangeIdxOfTxSigInfo "" UBYTE Com_OnChangeIdxOfTxSigInfoType 0 0 0 255 ECU_ADDRESS 0x0 /end MEASUREMENT
/begin MEASUREMENT Com_TxSigInfo[353].OnChangeOfTxSigInfo "" UBYTE Com_OnChangeOfTxSigInfoType 0 0 0 255 ECU_ADDRESS 0x0 /end MEASUREMENT
/begin MEASUREMENT Com_TxSigInfo[353].StartByteInPduPositionOfTxSigInfo "" UBYTE NO_COMPU_METHOD 0 0 0 255 ECU_ADDRESS 0x0 /end MEASUREMENT
/begin MEASUREMENT Com_TxSigInfo[353].TxAccessInfoIdxOfTxSigInfo "" UWORD NO_COMPU_METHOD 0 0 0 65535 ECU_ADDRESS 0x0 /end MEASUREMENT
/begin MEASUREMENT Com_TxSigInfo[353].TxBufferEndIdxOfTxSigInfo "" UWORD Com_TxBufferEndIdxOfTxSigInfoType 0 0 0 65535 ECU_ADDRESS 0x0 /end MEASUREMENT
/begin MEASUREMENT Com_TxSigInfo[353].TxBufferStartIdxOfTxSigInfo "" UWORD Com_TxBufferStartIdxOfTxSigInfoType 0 0 0 65535 ECU_ADDRESS 0x0 /end MEASUREMENT
/begin MEASUREMENT Com_TxSigInfo[353].TxFilterInitValueArrayBasedFilterInitValueEndIdxOfTxSigInfo "" UBYTE Com_TxFilterInitValueArrayBasedFilterInitValueEndIdxOfTxSigInfoType 0 0 0 255 ECU_ADDRESS 0x0 /end MEASUREMENT
/begin MEASUREMENT Com_TxSigInfo[353].TxFilterInitValueArrayBasedFilterInitValueStartIdxOfTxSigInfo "" UBYTE Com_TxFilterInitValueArrayBasedFilterInitValueStartIdxOfTxSigInfoType 0 0 0 255 ECU_ADDRESS 0x0 /end MEASUREMENT
/begin MEASUREMENT Com_TxSigInfo[353].TxPduInfoIdxOfTxSigInfo "" UBYTE NO_COMPU_METHOD 0 0 0 255 ECU_ADDRESS 0x0 /end MEASUREMENT
/begin MEASUREMENT Com_TxSigInfo[354].ApplTypeOfTxSigInfo "" UBYTE Com_ApplTypeOfTxSigInfoType 0 0 0 255 ECU_ADDRESS 0x0 /end MEASUREMENT
/begin MEASUREMENT Com_TxSigInfo[354].BitLengthOfTxSigInfo "" UWORD NO_COMPU_METHOD 0 0 0 65535 ECU_ADDRESS 0x0 /end MEASUREMENT
/begin MEASUREMENT Com_TxSigInfo[354].BitPositionOfTxSigInfo "" UWORD NO_COMPU_METHOD 0 0 0 65535 ECU_ADDRESS 0x0 /end MEASUREMENT
/begin MEASUREMENT Com_TxSigInfo[354].BusAccOfTxSigInfo "" UBYTE Com_BusAccOfTxSigInfoType 0 0 0 255 ECU_ADDRESS 0x0 /end MEASUREMENT
/begin MEASUREMENT Com_TxSigInfo[354].ByteLengthOfTxSigInfo "" UBYTE NO_COMPU_METHOD 0 0 0 255 ECU_ADDRESS 0x0 /end MEASUREMENT
/begin MEASUREMENT Com_TxSigInfo[354].DynSignalOfTxSigInfo "" UBYTE Com_DynSignalOfTxSigInfoType 0 0 0 1 ECU_ADDRESS 0x0 /end MEASUREMENT
/begin MEASUREMENT Com_TxSigInfo[354].FilterInitValueIdxOfTxSigInfo "" UBYTE Com_FilterInitValueIdxOfTxSigInfoType 0 0 0 255 ECU_ADDRESS 0x0 /end MEASUREMENT
/begin MEASUREMENT Com_TxSigInfo[354].FilterInitValueOfTxSigInfo "" UBYTE Com_FilterInitValueOfTxSigInfoType 0 0 0 255 ECU_ADDRESS 0x0 /end MEASUREMENT
/begin MEASUREMENT Com_TxSigInfo[354].InvValueIdxOfTxSigInfo "" UBYTE Com_InvValueIdxOfTxSigInfoType 0 0 0 255 ECU_ADDRESS 0x0 /end MEASUREMENT
/begin MEASUREMENT Com_TxSigInfo[354].InvValueOfTxSigInfo "" UBYTE Com_InvValueOfTxSigInfoType 0 0 0 255 ECU_ADDRESS 0x0 /end MEASUREMENT
/begin MEASUREMENT Com_TxSigInfo[354].OnChangeIdxOfTxSigInfo "" UBYTE Com_OnChangeIdxOfTxSigInfoType 0 0 0 255 ECU_ADDRESS 0x0 /end MEASUREMENT
/begin MEASUREMENT Com_TxSigInfo[354].OnChangeOfTxSigInfo "" UBYTE Com_OnChangeOfTxSigInfoType 0 0 0 255 ECU_ADDRESS 0x0 /end MEASUREMENT
/begin MEASUREMENT Com_TxSigInfo[354].StartByteInPduPositionOfTxSigInfo "" UBYTE NO_COMPU_METHOD 0 0 0 255 ECU_ADDRESS 0x0 /end MEASUREMENT
/begin MEASUREMENT Com_TxSigInfo[354].TxAccessInfoIdxOfTxSigInfo "" UWORD NO_COMPU_METHOD 0 0 0 65535 ECU_ADDRESS 0x0 /end MEASUREMENT
/begin MEASUREMENT Com_TxSigInfo[354].TxBufferEndIdxOfTxSigInfo "" UWORD Com_TxBufferEndIdxOfTxSigInfoType 0 0 0 65535 ECU_ADDRESS 0x0 /end MEASUREMENT
/begin MEASUREMENT Com_TxSigInfo[354].TxBufferStartIdxOfTxSigInfo "" UWORD Com_TxBufferStartIdxOfTxSigInfoType 0 0 0 65535 ECU_ADDRESS 0x0 /end MEASUREMENT
/begin MEASUREMENT Com_TxSigInfo[354].TxFilterInitValueArrayBasedFilterInitValueEndIdxOfTxSigInfo "" UBYTE Com_TxFilterInitValueArrayBasedFilterInitValueEndIdxOfTxSigInfoType 0 0 0 255 ECU_ADDRESS 0x0 /end MEASUREMENT
/begin MEASUREMENT Com_TxSigInfo[354].TxFilterInitValueArrayBasedFilterInitValueStartIdxOfTxSigInfo "" UBYTE Com_TxFilterInitValueArrayBasedFilterInitValueStartIdxOfTxSigInfoType 0 0 0 255 ECU_ADDRESS 0x0 /end MEASUREMENT
/begin MEASUREMENT Com_TxSigInfo[354].TxPduInfoIdxOfTxSigInfo "" UBYTE NO_COMPU_METHOD 0 0 0 255 ECU_ADDRESS 0x0 /end MEASUREMENT
/begin MEASUREMENT Com_TxSigInfo[355].ApplTypeOfTxSigInfo "" UBYTE Com_ApplTypeOfTxSigInfoType 0 0 0 255 ECU_ADDRESS 0x0 /end MEASUREMENT
/begin MEASUREMENT Com_TxSigInfo[355].BitLengthOfTxSigInfo "" UWORD NO_COMPU_METHOD 0 0 0 65535 ECU_ADDRESS 0x0 /end MEASUREMENT
/begin MEASUREMENT Com_TxSigInfo[355].BitPositionOfTxSigInfo "" UWORD NO_COMPU_METHOD 0 0 0 65535 ECU_ADDRESS 0x0 /end MEASUREMENT
/begin MEASUREMENT Com_TxSigInfo[355].BusAccOfTxSigInfo "" UBYTE Com_BusAccOfTxSigInfoType 0 0 0 255 ECU_ADDRESS 0x0 /end MEASUREMENT
/begin MEASUREMENT Com_TxSigInfo[355].ByteLengthOfTxSigInfo "" UBYTE NO_COMPU_METHOD 0 0 0 255 ECU_ADDRESS 0x0 /end MEASUREMENT
/begin MEASUREMENT Com_TxSigInfo[355].DynSignalOfTxSigInfo "" UBYTE Com_DynSignalOfTxSigInfoType 0 0 0 1 ECU_ADDRESS 0x0 /end MEASUREMENT
/begin MEASUREMENT Com_TxSigInfo[355].FilterInitValueIdxOfTxSigInfo "" UBYTE Com_FilterInitValueIdxOfTxSigInfoType 0 0 0 255 ECU_ADDRESS 0x0 /end MEASUREMENT
/begin MEASUREMENT Com_TxSigInfo[355].FilterInitValueOfTxSigInfo "" UBYTE Com_FilterInitValueOfTxSigInfoType 0 0 0 255 ECU_ADDRESS 0x0 /end MEASUREMENT
/begin MEASUREMENT Com_TxSigInfo[355].InvValueIdxOfTxSigInfo "" UBYTE Com_InvValueIdxOfTxSigInfoType 0 0 0 255 ECU_ADDRESS 0x0 /end MEASUREMENT
/begin MEASUREMENT Com_TxSigInfo[355].InvValueOfTxSigInfo "" UBYTE Com_InvValueOfTxSigInfoType 0 0 0 255 ECU_ADDRESS 0x0 /end MEASUREMENT
/begin MEASUREMENT Com_TxSigInfo[355].OnChangeIdxOfTxSigInfo "" UBYTE Com_OnChangeIdxOfTxSigInfoType 0 0 0 255 ECU_ADDRESS 0x0 /end MEASUREMENT
/begin MEASUREMENT Com_TxSigInfo[355].OnChangeOfTxSigInfo "" UBYTE Com_OnChangeOfTxSigInfoType 0 0 0 255 ECU_ADDRESS 0x0 /end MEASUREMENT
/begin MEASUREMENT Com_TxSigInfo[355].StartByteInPduPositionOfTxSigInfo "" UBYTE NO_COMPU_METHOD 0 0 0 255 ECU_ADDRESS 0x0 /end MEASUREMENT
/begin MEASUREMENT Com_TxSigInfo[355].TxAccessInfoIdxOfTxSigInfo "" UWORD NO_COMPU_METHOD 0 0 0 65535 ECU_ADDRESS 0x0 /end MEASUREMENT
/begin MEASUREMENT Com_TxSigInfo[355].TxBufferEndIdxOfTxSigInfo "" UWORD Com_TxBufferEndIdxOfTxSigInfoType 0 0 0 65535 ECU_ADDRESS 0x0 /end MEASUREMENT
/begin MEASUREMENT Com_TxSigInfo[355].TxBufferStartIdxOfTxSigInfo "" UWORD Com_TxBufferStartIdxOfTxSigInfoType 0 0 0 65535 ECU_ADDRESS 0x0 /end MEASUREMENT
/begin MEASUREMENT Com_TxSigInfo[355].TxFilterInitValueArrayBasedFilterInitValueEndIdxOfTxSigInfo "" UBYTE Com_TxFilterInitValueArrayBasedFilterInitValueEndIdxOfTxSigInfoType 0 0 0 255 ECU_ADDRESS 0x0 /end MEASUREMENT
/begin MEASUREMENT Com_TxSigInfo[355].TxFilterInitValueArrayBasedFilterInitValueStartIdxOfTxSigInfo "" UBYTE Com_TxFilterInitValueArrayBasedFilterInitValueStartIdxOfTxSigInfoType 0 0 0 255 ECU_ADDRESS 0x0 /end MEASUREMENT
/begin MEASUREMENT Com_TxSigInfo[355].TxPduInfoIdxOfTxSigInfo "" UBYTE NO_COMPU_METHOD 0 0 0 255 ECU_ADDRESS 0x0 /end MEASUREMENT
/begin MEASUREMENT Com_TxSigInfo[356].ApplTypeOfTxSigInfo "" UBYTE Com_ApplTypeOfTxSigInfoType 0 0 0 255 ECU_ADDRESS 0x0 /end MEASUREMENT
/begin MEASUREMENT Com_TxSigInfo[356].BitLengthOfTxSigInfo "" UWORD NO_COMPU_METHOD 0 0 0 65535 ECU_ADDRESS 0x0 /end MEASUREMENT
/begin MEASUREMENT Com_TxSigInfo[356].BitPositionOfTxSigInfo "" UWORD NO_COMPU_METHOD 0 0 0 65535 ECU_ADDRESS 0x0 /end MEASUREMENT
/begin MEASUREMENT Com_TxSigInfo[356].BusAccOfTxSigInfo "" UBYTE Com_BusAccOfTxSigInfoType 0 0 0 255 ECU_ADDRESS 0x0 /end MEASUREMENT
/begin MEASUREMENT Com_TxSigInfo[356].ByteLengthOfTxSigInfo "" UBYTE NO_COMPU_METHOD 0 0 0 255 ECU_ADDRESS 0x0 /end MEASUREMENT
/begin MEASUREMENT Com_TxSigInfo[356].DynSignalOfTxSigInfo "" UBYTE Com_DynSignalOfTxSigInfoType 0 0 0 1 ECU_ADDRESS 0x0 /end MEASUREMENT
/begin MEASUREMENT Com_TxSigInfo[356].FilterInitValueIdxOfTxSigInfo "" UBYTE Com_FilterInitValueIdxOfTxSigInfoType 0 0 0 255 ECU_ADDRESS 0x0 /end MEASUREMENT
/begin MEASUREMENT Com_TxSigInfo[356].FilterInitValueOfTxSigInfo "" UBYTE Com_FilterInitValueOfTxSigInfoType 0 0 0 255 ECU_ADDRESS 0x0 /end MEASUREMENT
/begin MEASUREMENT Com_TxSigInfo[356].InvValueIdxOfTxSigInfo "" UBYTE Com_InvValueIdxOfTxSigInfoType 0 0 0 255 ECU_ADDRESS 0x0 /end MEASUREMENT
/begin MEASUREMENT Com_TxSigInfo[356].InvValueOfTxSigInfo "" UBYTE Com_InvValueOfTxSigInfoType 0 0 0 255 ECU_ADDRESS 0x0 /end MEASUREMENT
/begin MEASUREMENT Com_TxSigInfo[356].OnChangeIdxOfTxSigInfo "" UBYTE Com_OnChangeIdxOfTxSigInfoType 0 0 0 255 ECU_ADDRESS 0x0 /end MEASUREMENT
/begin MEASUREMENT Com_TxSigInfo[356].OnChangeOfTxSigInfo "" UBYTE Com_OnChangeOfTxSigInfoType 0 0 0 255 ECU_ADDRESS 0x0 /end MEASUREMENT
/begin MEASUREMENT Com_TxSigInfo[356].StartByteInPduPositionOfTxSigInfo "" UBYTE NO_COMPU_METHOD 0 0 0 255 ECU_ADDRESS 0x0 /end MEASUREMENT
/begin MEASUREMENT Com_TxSigInfo[356].TxAccessInfoIdxOfTxSigInfo "" UWORD NO_COMPU_METHOD 0 0 0 65535 ECU_ADDRESS 0x0 /end MEASUREMENT
/begin MEASUREMENT Com_TxSigInfo[356].TxBufferEndIdxOfTxSigInfo "" UWORD Com_TxBufferEndIdxOfTxSigInfoType 0 0 0 65535 ECU_ADDRESS 0x0 /end MEASUREMENT
/begin MEASUREMENT Com_TxSigInfo[356].TxBufferStartIdxOfTxSigInfo "" UWORD Com_TxBufferStartIdxOfTxSigInfoType 0 0 0 65535 ECU_ADDRESS 0x0 /end MEASUREMENT
/begin MEASUREMENT Com_TxSigInfo[356].TxFilterInitValueArrayBasedFilterInitValueEndIdxOfTxSigInfo "" UBYTE Com_TxFilterInitValueArrayBasedFilterInitValueEndIdxOfTxSigInfoType 0 0 0 255 ECU_ADDRESS 0x0 /end MEASUREMENT
/begin MEASUREMENT Com_TxSigInfo[356].TxFilterInitValueArrayBasedFilterInitValueStartIdxOfTxSigInfo "" UBYTE Com_TxFilterInitValueArrayBasedFilterInitValueStartIdxOfTxSigInfoType 0 0 0 255 ECU_ADDRESS 0x0 /end MEASUREMENT
/begin MEASUREMENT Com_TxSigInfo[356].TxPduInfoIdxOfTxSigInfo "" UBYTE NO_COMPU_METHOD 0 0 0 255 ECU_ADDRESS 0x0 /end MEASUREMENT
/begin MEASUREMENT Com_TxSigInfo[357].ApplTypeOfTxSigInfo "" UBYTE Com_ApplTypeOfTxSigInfoType 0 0 0 255 ECU_ADDRESS 0x0 /end MEASUREMENT
/begin MEASUREMENT Com_TxSigInfo[357].BitLengthOfTxSigInfo "" UWORD NO_COMPU_METHOD 0 0 0 65535 ECU_ADDRESS 0x0 /end MEASUREMENT
/begin MEASUREMENT Com_TxSigInfo[357].BitPositionOfTxSigInfo "" UWORD NO_COMPU_METHOD 0 0 0 65535 ECU_ADDRESS 0x0 /end MEASUREMENT
/begin MEASUREMENT Com_TxSigInfo[357].BusAccOfTxSigInfo "" UBYTE Com_BusAccOfTxSigInfoType 0 0 0 255 ECU_ADDRESS 0x0 /end MEASUREMENT
/begin MEASUREMENT Com_TxSigInfo[357].ByteLengthOfTxSigInfo "" UBYTE NO_COMPU_METHOD 0 0 0 255 ECU_ADDRESS 0x0 /end MEASUREMENT
/begin MEASUREMENT Com_TxSigInfo[357].DynSignalOfTxSigInfo "" UBYTE Com_DynSignalOfTxSigInfoType 0 0 0 1 ECU_ADDRESS 0x0 /end MEASUREMENT
/begin MEASUREMENT Com_TxSigInfo[357].FilterInitValueIdxOfTxSigInfo "" UBYTE Com_FilterInitValueIdxOfTxSigInfoType 0 0 0 255 ECU_ADDRESS 0x0 /end MEASUREMENT
/begin MEASUREMENT Com_TxSigInfo[357].FilterInitValueOfTxSigInfo "" UBYTE Com_FilterInitValueOfTxSigInfoType 0 0 0 255 ECU_ADDRESS 0x0 /end MEASUREMENT
/begin MEASUREMENT Com_TxSigInfo[357].InvValueIdxOfTxSigInfo "" UBYTE Com_InvValueIdxOfTxSigInfoType 0 0 0 255 ECU_ADDRESS 0x0 /end MEASUREMENT
/begin MEASUREMENT Com_TxSigInfo[357].InvValueOfTxSigInfo "" UBYTE Com_InvValueOfTxSigInfoType 0 0 0 255 ECU_ADDRESS 0x0 /end MEASUREMENT
/begin MEASUREMENT Com_TxSigInfo[357].OnChangeIdxOfTxSigInfo "" UBYTE Com_OnChangeIdxOfTxSigInfoType 0 0 0 255 ECU_ADDRESS 0x0 /end MEASUREMENT
/begin MEASUREMENT Com_TxSigInfo[357].OnChangeOfTxSigInfo "" UBYTE Com_OnChangeOfTxSigInfoType 0 0 0 255 ECU_ADDRESS 0x0 /end MEASUREMENT
/begin MEASUREMENT Com_TxSigInfo[357].StartByteInPduPositionOfTxSigInfo "" UBYTE NO_COMPU_METHOD 0 0 0 255 ECU_ADDRESS 0x0 /end MEASUREMENT
/begin MEASUREMENT Com_TxSigInfo[357].TxAccessInfoIdxOfTxSigInfo "" UWORD NO_COMPU_METHOD 0 0 0 65535 ECU_ADDRESS 0x0 /end MEASUREMENT
/begin MEASUREMENT Com_TxSigInfo[357].TxBufferEndIdxOfTxSigInfo "" UWORD Com_TxBufferEndIdxOfTxSigInfoType 0 0 0 65535 ECU_ADDRESS 0x0 /end MEASUREMENT
/begin MEASUREMENT Com_TxSigInfo[357].TxBufferStartIdxOfTxSigInfo "" UWORD Com_TxBufferStartIdxOfTxSigInfoType 0 0 0 65535 ECU_ADDRESS 0x0 /end MEASUREMENT
/begin MEASUREMENT Com_TxSigInfo[357].TxFilterInitValueArrayBasedFilterInitValueEndIdxOfTxSigInfo "" UBYTE Com_TxFilterInitValueArrayBasedFilterInitValueEndIdxOfTxSigInfoType 0 0 0 255 ECU_ADDRESS 0x0 /end MEASUREMENT
/begin MEASUREMENT Com_TxSigInfo[357].TxFilterInitValueArrayBasedFilterInitValueStartIdxOfTxSigInfo "" UBYTE Com_TxFilterInitValueArrayBasedFilterInitValueStartIdxOfTxSigInfoType 0 0 0 255 ECU_ADDRESS 0x0 /end MEASUREMENT
/begin MEASUREMENT Com_TxSigInfo[357].TxPduInfoIdxOfTxSigInfo "" UBYTE NO_COMPU_METHOD 0 0 0 255 ECU_ADDRESS 0x0 /end MEASUREMENT
/begin MEASUREMENT Com_TxSigInfo[358].ApplTypeOfTxSigInfo "" UBYTE Com_ApplTypeOfTxSigInfoType 0 0 0 255 ECU_ADDRESS 0x0 /end MEASUREMENT
/begin MEASUREMENT Com_TxSigInfo[358].BitLengthOfTxSigInfo "" UWORD NO_COMPU_METHOD 0 0 0 65535 ECU_ADDRESS 0x0 /end MEASUREMENT
/begin MEASUREMENT Com_TxSigInfo[358].BitPositionOfTxSigInfo "" UWORD NO_COMPU_METHOD 0 0 0 65535 ECU_ADDRESS 0x0 /end MEASUREMENT
/begin MEASUREMENT Com_TxSigInfo[358].BusAccOfTxSigInfo "" UBYTE Com_BusAccOfTxSigInfoType 0 0 0 255 ECU_ADDRESS 0x0 /end MEASUREMENT
/begin MEASUREMENT Com_TxSigInfo[358].ByteLengthOfTxSigInfo "" UBYTE NO_COMPU_METHOD 0 0 0 255 ECU_ADDRESS 0x0 /end MEASUREMENT
/begin MEASUREMENT Com_TxSigInfo[358].DynSignalOfTxSigInfo "" UBYTE Com_DynSignalOfTxSigInfoType 0 0 0 1 ECU_ADDRESS 0x0 /end MEASUREMENT
/begin MEASUREMENT Com_TxSigInfo[358].FilterInitValueIdxOfTxSigInfo "" UBYTE Com_FilterInitValueIdxOfTxSigInfoType 0 0 0 255 ECU_ADDRESS 0x0 /end MEASUREMENT
/begin MEASUREMENT Com_TxSigInfo[358].FilterInitValueOfTxSigInfo "" UBYTE Com_FilterInitValueOfTxSigInfoType 0 0 0 255 ECU_ADDRESS 0x0 /end MEASUREMENT
/begin MEASUREMENT Com_TxSigInfo[358].InvValueIdxOfTxSigInfo "" UBYTE Com_InvValueIdxOfTxSigInfoType 0 0 0 255 ECU_ADDRESS 0x0 /end MEASUREMENT
/begin MEASUREMENT Com_TxSigInfo[358].InvValueOfTxSigInfo "" UBYTE Com_InvValueOfTxSigInfoType 0 0 0 255 ECU_ADDRESS 0x0 /end MEASUREMENT
/begin MEASUREMENT Com_TxSigInfo[358].OnChangeIdxOfTxSigInfo "" UBYTE Com_OnChangeIdxOfTxSigInfoType 0 0 0 255 ECU_ADDRESS 0x0 /end MEASUREMENT
/begin MEASUREMENT Com_TxSigInfo[358].OnChangeOfTxSigInfo "" UBYTE Com_OnChangeOfTxSigInfoType 0 0 0 255 ECU_ADDRESS 0x0 /end MEASUREMENT
/begin MEASUREMENT Com_TxSigInfo[358].StartByteInPduPositionOfTxSigInfo "" UBYTE NO_COMPU_METHOD 0 0 0 255 ECU_ADDRESS 0x0 /end MEASUREMENT
/begin MEASUREMENT Com_TxSigInfo[358].TxAccessInfoIdxOfTxSigInfo "" UWORD NO_COMPU_METHOD 0 0 0 65535 ECU_ADDRESS 0x0 /end MEASUREMENT
/begin MEASUREMENT Com_TxSigInfo[358].TxBufferEndIdxOfTxSigInfo "" UWORD Com_TxBufferEndIdxOfTxSigInfoType 0 0 0 65535 ECU_ADDRESS 0x0 /end MEASUREMENT
/begin MEASUREMENT Com_TxSigInfo[358].TxBufferStartIdxOfTxSigInfo "" UWORD Com_TxBufferStartIdxOfTxSigInfoType 0 0 0 65535 ECU_ADDRESS 0x0 /end MEASUREMENT
/begin MEASUREMENT Com_TxSigInfo[358].TxFilterInitValueArrayBasedFilterInitValueEndIdxOfTxSigInfo "" UBYTE Com_TxFilterInitValueArrayBasedFilterInitValueEndIdxOfTxSigInfoType 0 0 0 255 ECU_ADDRESS 0x0 /end MEASUREMENT
/begin MEASUREMENT Com_TxSigInfo[358].TxFilterInitValueArrayBasedFilterInitValueStartIdxOfTxSigInfo "" UBYTE Com_TxFilterInitValueArrayBasedFilterInitValueStartIdxOfTxSigInfoType 0 0 0 255 ECU_ADDRESS 0x0 /end MEASUREMENT
/begin MEASUREMENT Com_TxSigInfo[358].TxPduInfoIdxOfTxSigInfo "" UBYTE NO_COMPU_METHOD 0 0 0 255 ECU_ADDRESS 0x0 /end MEASUREMENT
/begin MEASUREMENT Com_TxSigInfo[359].ApplTypeOfTxSigInfo "" UBYTE Com_ApplTypeOfTxSigInfoType 0 0 0 255 ECU_ADDRESS 0x0 /end MEASUREMENT
/begin MEASUREMENT Com_TxSigInfo[359].BitLengthOfTxSigInfo "" UWORD NO_COMPU_METHOD 0 0 0 65535 ECU_ADDRESS 0x0 /end MEASUREMENT
/begin MEASUREMENT Com_TxSigInfo[359].BitPositionOfTxSigInfo "" UWORD NO_COMPU_METHOD 0 0 0 65535 ECU_ADDRESS 0x0 /end MEASUREMENT
/begin MEASUREMENT Com_TxSigInfo[359].BusAccOfTxSigInfo "" UBYTE Com_BusAccOfTxSigInfoType 0 0 0 255 ECU_ADDRESS 0x0 /end MEASUREMENT
/begin MEASUREMENT Com_TxSigInfo[359].ByteLengthOfTxSigInfo "" UBYTE NO_COMPU_METHOD 0 0 0 255 ECU_ADDRESS 0x0 /end MEASUREMENT
/begin MEASUREMENT Com_TxSigInfo[359].DynSignalOfTxSigInfo "" UBYTE Com_DynSignalOfTxSigInfoType 0 0 0 1 ECU_ADDRESS 0x0 /end MEASUREMENT
/begin MEASUREMENT Com_TxSigInfo[359].FilterInitValueIdxOfTxSigInfo "" UBYTE Com_FilterInitValueIdxOfTxSigInfoType 0 0 0 255 ECU_ADDRESS 0x0 /end MEASUREMENT
/begin MEASUREMENT Com_TxSigInfo[359].FilterInitValueOfTxSigInfo "" UBYTE Com_FilterInitValueOfTxSigInfoType 0 0 0 255 ECU_ADDRESS 0x0 /end MEASUREMENT
/begin MEASUREMENT Com_TxSigInfo[359].InvValueIdxOfTxSigInfo "" UBYTE Com_InvValueIdxOfTxSigInfoType 0 0 0 255 ECU_ADDRESS 0x0 /end MEASUREMENT
/begin MEASUREMENT Com_TxSigInfo[359].InvValueOfTxSigInfo "" UBYTE Com_InvValueOfTxSigInfoType 0 0 0 255 ECU_ADDRESS 0x0 /end MEASUREMENT
/begin MEASUREMENT Com_TxSigInfo[359].OnChangeIdxOfTxSigInfo "" UBYTE Com_OnChangeIdxOfTxSigInfoType 0 0 0 255 ECU_ADDRESS 0x0 /end MEASUREMENT
/begin MEASUREMENT Com_TxSigInfo[359].OnChangeOfTxSigInfo "" UBYTE Com_OnChangeOfTxSigInfoType 0 0 0 255 ECU_ADDRESS 0x0 /end MEASUREMENT
/begin MEASUREMENT Com_TxSigInfo[359].StartByteInPduPositionOfTxSigInfo "" UBYTE NO_COMPU_METHOD 0 0 0 255 ECU_ADDRESS 0x0 /end MEASUREMENT
/begin MEASUREMENT Com_TxSigInfo[359].TxAccessInfoIdxOfTxSigInfo "" UWORD NO_COMPU_METHOD 0 0 0 65535 ECU_ADDRESS 0x0 /end MEASUREMENT
/begin MEASUREMENT Com_TxSigInfo[359].TxBufferEndIdxOfTxSigInfo "" UWORD Com_TxBufferEndIdxOfTxSigInfoType 0 0 0 65535 ECU_ADDRESS 0x0 /end MEASUREMENT
/begin MEASUREMENT Com_TxSigInfo[359].TxBufferStartIdxOfTxSigInfo "" UWORD Com_TxBufferStartIdxOfTxSigInfoType 0 0 0 65535 ECU_ADDRESS 0x0 /end MEASUREMENT
/begin MEASUREMENT Com_TxSigInfo[359].TxFilterInitValueArrayBasedFilterInitValueEndIdxOfTxSigInfo "" UBYTE Com_TxFilterInitValueArrayBasedFilterInitValueEndIdxOfTxSigInfoType 0 0 0 255 ECU_ADDRESS 0x0 /end MEASUREMENT
/begin MEASUREMENT Com_TxSigInfo[359].TxFilterInitValueArrayBasedFilterInitValueStartIdxOfTxSigInfo "" UBYTE Com_TxFilterInitValueArrayBasedFilterInitValueStartIdxOfTxSigInfoType 0 0 0 255 ECU_ADDRESS 0x0 /end MEASUREMENT
/begin MEASUREMENT Com_TxSigInfo[359].TxPduInfoIdxOfTxSigInfo "" UBYTE NO_COMPU_METHOD 0 0 0 255 ECU_ADDRESS 0x0 /end MEASUREMENT
/begin MEASUREMENT Com_TxSigInfo[35].ApplTypeOfTxSigInfo "" UBYTE Com_ApplTypeOfTxSigInfoType 0 0 0 255 ECU_ADDRESS 0x0 /end MEASUREMENT
/begin MEASUREMENT Com_TxSigInfo[35].BitLengthOfTxSigInfo "" UWORD NO_COMPU_METHOD 0 0 0 65535 ECU_ADDRESS 0x0 /end MEASUREMENT
/begin MEASUREMENT Com_TxSigInfo[35].BitPositionOfTxSigInfo "" UWORD NO_COMPU_METHOD 0 0 0 65535 ECU_ADDRESS 0x0 /end MEASUREMENT
/begin MEASUREMENT Com_TxSigInfo[35].BusAccOfTxSigInfo "" UBYTE Com_BusAccOfTxSigInfoType 0 0 0 255 ECU_ADDRESS 0x0 /end MEASUREMENT
/begin MEASUREMENT Com_TxSigInfo[35].ByteLengthOfTxSigInfo "" UBYTE NO_COMPU_METHOD 0 0 0 255 ECU_ADDRESS 0x0 /end MEASUREMENT
/begin MEASUREMENT Com_TxSigInfo[35].DynSignalOfTxSigInfo "" UBYTE Com_DynSignalOfTxSigInfoType 0 0 0 1 ECU_ADDRESS 0x0 /end MEASUREMENT
/begin MEASUREMENT Com_TxSigInfo[35].FilterInitValueIdxOfTxSigInfo "" UBYTE Com_FilterInitValueIdxOfTxSigInfoType 0 0 0 255 ECU_ADDRESS 0x0 /end MEASUREMENT
/begin MEASUREMENT Com_TxSigInfo[35].FilterInitValueOfTxSigInfo "" UBYTE Com_FilterInitValueOfTxSigInfoType 0 0 0 255 ECU_ADDRESS 0x0 /end MEASUREMENT
/begin MEASUREMENT Com_TxSigInfo[35].InvValueIdxOfTxSigInfo "" UBYTE Com_InvValueIdxOfTxSigInfoType 0 0 0 255 ECU_ADDRESS 0x0 /end MEASUREMENT
/begin MEASUREMENT Com_TxSigInfo[35].InvValueOfTxSigInfo "" UBYTE Com_InvValueOfTxSigInfoType 0 0 0 255 ECU_ADDRESS 0x0 /end MEASUREMENT
/begin MEASUREMENT Com_TxSigInfo[35].OnChangeIdxOfTxSigInfo "" UBYTE Com_OnChangeIdxOfTxSigInfoType 0 0 0 255 ECU_ADDRESS 0x0 /end MEASUREMENT
/begin MEASUREMENT Com_TxSigInfo[35].OnChangeOfTxSigInfo "" UBYTE Com_OnChangeOfTxSigInfoType 0 0 0 255 ECU_ADDRESS 0x0 /end MEASUREMENT
/begin MEASUREMENT Com_TxSigInfo[35].StartByteInPduPositionOfTxSigInfo "" UBYTE NO_COMPU_METHOD 0 0 0 255 ECU_ADDRESS 0x0 /end MEASUREMENT
/begin MEASUREMENT Com_TxSigInfo[35].TxAccessInfoIdxOfTxSigInfo "" UWORD NO_COMPU_METHOD 0 0 0 65535 ECU_ADDRESS 0x0 /end MEASUREMENT
/begin MEASUREMENT Com_TxSigInfo[35].TxBufferEndIdxOfTxSigInfo "" UWORD Com_TxBufferEndIdxOfTxSigInfoType 0 0 0 65535 ECU_ADDRESS 0x0 /end MEASUREMENT
/begin MEASUREMENT Com_TxSigInfo[35].TxBufferStartIdxOfTxSigInfo "" UWORD Com_TxBufferStartIdxOfTxSigInfoType 0 0 0 65535 ECU_ADDRESS 0x0 /end MEASUREMENT
/begin MEASUREMENT Com_TxSigInfo[35].TxFilterInitValueArrayBasedFilterInitValueEndIdxOfTxSigInfo "" UBYTE Com_TxFilterInitValueArrayBasedFilterInitValueEndIdxOfTxSigInfoType 0 0 0 255 ECU_ADDRESS 0x0 /end MEASUREMENT
/begin MEASUREMENT Com_TxSigInfo[35].TxFilterInitValueArrayBasedFilterInitValueStartIdxOfTxSigInfo "" UBYTE Com_TxFilterInitValueArrayBasedFilterInitValueStartIdxOfTxSigInfoType 0 0 0 255 ECU_ADDRESS 0x0 /end MEASUREMENT
/begin MEASUREMENT Com_TxSigInfo[35].TxPduInfoIdxOfTxSigInfo "" UBYTE NO_COMPU_METHOD 0 0 0 255 ECU_ADDRESS 0x0 /end MEASUREMENT
/begin MEASUREMENT Com_TxSigInfo[360].ApplTypeOfTxSigInfo "" UBYTE Com_ApplTypeOfTxSigInfoType 0 0 0 255 ECU_ADDRESS 0x0 /end MEASUREMENT
/begin MEASUREMENT Com_TxSigInfo[360].BitLengthOfTxSigInfo "" UWORD NO_COMPU_METHOD 0 0 0 65535 ECU_ADDRESS 0x0 /end MEASUREMENT
/begin MEASUREMENT Com_TxSigInfo[360].BitPositionOfTxSigInfo "" UWORD NO_COMPU_METHOD 0 0 0 65535 ECU_ADDRESS 0x0 /end MEASUREMENT
/begin MEASUREMENT Com_TxSigInfo[360].BusAccOfTxSigInfo "" UBYTE Com_BusAccOfTxSigInfoType 0 0 0 255 ECU_ADDRESS 0x0 /end MEASUREMENT
/begin MEASUREMENT Com_TxSigInfo[360].ByteLengthOfTxSigInfo "" UBYTE NO_COMPU_METHOD 0 0 0 255 ECU_ADDRESS 0x0 /end MEASUREMENT
/begin MEASUREMENT Com_TxSigInfo[360].DynSignalOfTxSigInfo "" UBYTE Com_DynSignalOfTxSigInfoType 0 0 0 1 ECU_ADDRESS 0x0 /end MEASUREMENT
/begin MEASUREMENT Com_TxSigInfo[360].FilterInitValueIdxOfTxSigInfo "" UBYTE Com_FilterInitValueIdxOfTxSigInfoType 0 0 0 255 ECU_ADDRESS 0x0 /end MEASUREMENT
/begin MEASUREMENT Com_TxSigInfo[360].FilterInitValueOfTxSigInfo "" UBYTE Com_FilterInitValueOfTxSigInfoType 0 0 0 255 ECU_ADDRESS 0x0 /end MEASUREMENT
/begin MEASUREMENT Com_TxSigInfo[360].InvValueIdxOfTxSigInfo "" UBYTE Com_InvValueIdxOfTxSigInfoType 0 0 0 255 ECU_ADDRESS 0x0 /end MEASUREMENT
/begin MEASUREMENT Com_TxSigInfo[360].InvValueOfTxSigInfo "" UBYTE Com_InvValueOfTxSigInfoType 0 0 0 255 ECU_ADDRESS 0x0 /end MEASUREMENT
/begin MEASUREMENT Com_TxSigInfo[360].OnChangeIdxOfTxSigInfo "" UBYTE Com_OnChangeIdxOfTxSigInfoType 0 0 0 255 ECU_ADDRESS 0x0 /end MEASUREMENT
/begin MEASUREMENT Com_TxSigInfo[360].OnChangeOfTxSigInfo "" UBYTE Com_OnChangeOfTxSigInfoType 0 0 0 255 ECU_ADDRESS 0x0 /end MEASUREMENT
/begin MEASUREMENT Com_TxSigInfo[360].StartByteInPduPositionOfTxSigInfo "" UBYTE NO_COMPU_METHOD 0 0 0 255 ECU_ADDRESS 0x0 /end MEASUREMENT
/begin MEASUREMENT Com_TxSigInfo[360].TxAccessInfoIdxOfTxSigInfo "" UWORD NO_COMPU_METHOD 0 0 0 65535 ECU_ADDRESS 0x0 /end MEASUREMENT
/begin MEASUREMENT Com_TxSigInfo[360].TxBufferEndIdxOfTxSigInfo "" UWORD Com_TxBufferEndIdxOfTxSigInfoType 0 0 0 65535 ECU_ADDRESS 0x0 /end MEASUREMENT
/begin MEASUREMENT Com_TxSigInfo[360].TxBufferStartIdxOfTxSigInfo "" UWORD Com_TxBufferStartIdxOfTxSigInfoType 0 0 0 65535 ECU_ADDRESS 0x0 /end MEASUREMENT
/begin MEASUREMENT Com_TxSigInfo[360].TxFilterInitValueArrayBasedFilterInitValueEndIdxOfTxSigInfo "" UBYTE Com_TxFilterInitValueArrayBasedFilterInitValueEndIdxOfTxSigInfoType 0 0 0 255 ECU_ADDRESS 0x0 /end MEASUREMENT
/begin MEASUREMENT Com_TxSigInfo[360].TxFilterInitValueArrayBasedFilterInitValueStartIdxOfTxSigInfo "" UBYTE Com_TxFilterInitValueArrayBasedFilterInitValueStartIdxOfTxSigInfoType 0 0 0 255 ECU_ADDRESS 0x0 /end MEASUREMENT
/begin MEASUREMENT Com_TxSigInfo[360].TxPduInfoIdxOfTxSigInfo "" UBYTE NO_COMPU_METHOD 0 0 0 255 ECU_ADDRESS 0x0 /end MEASUREMENT
/begin MEASUREMENT Com_TxSigInfo[361].ApplTypeOfTxSigInfo "" UBYTE Com_ApplTypeOfTxSigInfoType 0 0 0 255 ECU_ADDRESS 0x0 /end MEASUREMENT
/begin MEASUREMENT Com_TxSigInfo[361].BitLengthOfTxSigInfo "" UWORD NO_COMPU_METHOD 0 0 0 65535 ECU_ADDRESS 0x0 /end MEASUREMENT
/begin MEASUREMENT Com_TxSigInfo[361].BitPositionOfTxSigInfo "" UWORD NO_COMPU_METHOD 0 0 0 65535 ECU_ADDRESS 0x0 /end MEASUREMENT
/begin MEASUREMENT Com_TxSigInfo[361].BusAccOfTxSigInfo "" UBYTE Com_BusAccOfTxSigInfoType 0 0 0 255 ECU_ADDRESS 0x0 /end MEASUREMENT
/begin MEASUREMENT Com_TxSigInfo[361].ByteLengthOfTxSigInfo "" UBYTE NO_COMPU_METHOD 0 0 0 255 ECU_ADDRESS 0x0 /end MEASUREMENT
/begin MEASUREMENT Com_TxSigInfo[361].DynSignalOfTxSigInfo "" UBYTE Com_DynSignalOfTxSigInfoType 0 0 0 1 ECU_ADDRESS 0x0 /end MEASUREMENT
/begin MEASUREMENT Com_TxSigInfo[361].FilterInitValueIdxOfTxSigInfo "" UBYTE Com_FilterInitValueIdxOfTxSigInfoType 0 0 0 255 ECU_ADDRESS 0x0 /end MEASUREMENT
/begin MEASUREMENT Com_TxSigInfo[361].FilterInitValueOfTxSigInfo "" UBYTE Com_FilterInitValueOfTxSigInfoType 0 0 0 255 ECU_ADDRESS 0x0 /end MEASUREMENT
/begin MEASUREMENT Com_TxSigInfo[361].InvValueIdxOfTxSigInfo "" UBYTE Com_InvValueIdxOfTxSigInfoType 0 0 0 255 ECU_ADDRESS 0x0 /end MEASUREMENT
/begin MEASUREMENT Com_TxSigInfo[361].InvValueOfTxSigInfo "" UBYTE Com_InvValueOfTxSigInfoType 0 0 0 255 ECU_ADDRESS 0x0 /end MEASUREMENT
/begin MEASUREMENT Com_TxSigInfo[361].OnChangeIdxOfTxSigInfo "" UBYTE Com_OnChangeIdxOfTxSigInfoType 0 0 0 255 ECU_ADDRESS 0x0 /end MEASUREMENT
/begin MEASUREMENT Com_TxSigInfo[361].OnChangeOfTxSigInfo "" UBYTE Com_OnChangeOfTxSigInfoType 0 0 0 255 ECU_ADDRESS 0x0 /end MEASUREMENT
/begin MEASUREMENT Com_TxSigInfo[361].StartByteInPduPositionOfTxSigInfo "" UBYTE NO_COMPU_METHOD 0 0 0 255 ECU_ADDRESS 0x0 /end MEASUREMENT
/begin MEASUREMENT Com_TxSigInfo[361].TxAccessInfoIdxOfTxSigInfo "" UWORD NO_COMPU_METHOD 0 0 0 65535 ECU_ADDRESS 0x0 /end MEASUREMENT
/begin MEASUREMENT Com_TxSigInfo[361].TxBufferEndIdxOfTxSigInfo "" UWORD Com_TxBufferEndIdxOfTxSigInfoType 0 0 0 65535 ECU_ADDRESS 0x0 /end MEASUREMENT
/begin MEASUREMENT Com_TxSigInfo[361].TxBufferStartIdxOfTxSigInfo "" UWORD Com_TxBufferStartIdxOfTxSigInfoType 0 0 0 65535 ECU_ADDRESS 0x0 /end MEASUREMENT
/begin MEASUREMENT Com_TxSigInfo[361].TxFilterInitValueArrayBasedFilterInitValueEndIdxOfTxSigInfo "" UBYTE Com_TxFilterInitValueArrayBasedFilterInitValueEndIdxOfTxSigInfoType 0 0 0 255 ECU_ADDRESS 0x0 /end MEASUREMENT
/begin MEASUREMENT Com_TxSigInfo[361].TxFilterInitValueArrayBasedFilterInitValueStartIdxOfTxSigInfo "" UBYTE Com_TxFilterInitValueArrayBasedFilterInitValueStartIdxOfTxSigInfoType 0 0 0 255 ECU_ADDRESS 0x0 /end MEASUREMENT
/begin MEASUREMENT Com_TxSigInfo[361].TxPduInfoIdxOfTxSigInfo "" UBYTE NO_COMPU_METHOD 0 0 0 255 ECU_ADDRESS 0x0 /end MEASUREMENT
/begin MEASUREMENT Com_TxSigInfo[362].ApplTypeOfTxSigInfo "" UBYTE Com_ApplTypeOfTxSigInfoType 0 0 0 255 ECU_ADDRESS 0x0 /end MEASUREMENT
/begin MEASUREMENT Com_TxSigInfo[362].BitLengthOfTxSigInfo "" UWORD NO_COMPU_METHOD 0 0 0 65535 ECU_ADDRESS 0x0 /end MEASUREMENT
/begin MEASUREMENT Com_TxSigInfo[362].BitPositionOfTxSigInfo "" UWORD NO_COMPU_METHOD 0 0 0 65535 ECU_ADDRESS 0x0 /end MEASUREMENT
/begin MEASUREMENT Com_TxSigInfo[362].BusAccOfTxSigInfo "" UBYTE Com_BusAccOfTxSigInfoType 0 0 0 255 ECU_ADDRESS 0x0 /end MEASUREMENT
/begin MEASUREMENT Com_TxSigInfo[362].ByteLengthOfTxSigInfo "" UBYTE NO_COMPU_METHOD 0 0 0 255 ECU_ADDRESS 0x0 /end MEASUREMENT
/begin MEASUREMENT Com_TxSigInfo[362].DynSignalOfTxSigInfo "" UBYTE Com_DynSignalOfTxSigInfoType 0 0 0 1 ECU_ADDRESS 0x0 /end MEASUREMENT
/begin MEASUREMENT Com_TxSigInfo[362].FilterInitValueIdxOfTxSigInfo "" UBYTE Com_FilterInitValueIdxOfTxSigInfoType 0 0 0 255 ECU_ADDRESS 0x0 /end MEASUREMENT
/begin MEASUREMENT Com_TxSigInfo[362].FilterInitValueOfTxSigInfo "" UBYTE Com_FilterInitValueOfTxSigInfoType 0 0 0 255 ECU_ADDRESS 0x0 /end MEASUREMENT
/begin MEASUREMENT Com_TxSigInfo[362].InvValueIdxOfTxSigInfo "" UBYTE Com_InvValueIdxOfTxSigInfoType 0 0 0 255 ECU_ADDRESS 0x0 /end MEASUREMENT
/begin MEASUREMENT Com_TxSigInfo[362].InvValueOfTxSigInfo "" UBYTE Com_InvValueOfTxSigInfoType 0 0 0 255 ECU_ADDRESS 0x0 /end MEASUREMENT
/begin MEASUREMENT Com_TxSigInfo[362].OnChangeIdxOfTxSigInfo "" UBYTE Com_OnChangeIdxOfTxSigInfoType 0 0 0 255 ECU_ADDRESS 0x0 /end MEASUREMENT
/begin MEASUREMENT Com_TxSigInfo[362].OnChangeOfTxSigInfo "" UBYTE Com_OnChangeOfTxSigInfoType 0 0 0 255 ECU_ADDRESS 0x0 /end MEASUREMENT
/begin MEASUREMENT Com_TxSigInfo[362].StartByteInPduPositionOfTxSigInfo "" UBYTE NO_COMPU_METHOD 0 0 0 255 ECU_ADDRESS 0x0 /end MEASUREMENT
/begin MEASUREMENT Com_TxSigInfo[362].TxAccessInfoIdxOfTxSigInfo "" UWORD NO_COMPU_METHOD 0 0 0 65535 ECU_ADDRESS 0x0 /end MEASUREMENT
/begin MEASUREMENT Com_TxSigInfo[362].TxBufferEndIdxOfTxSigInfo "" UWORD Com_TxBufferEndIdxOfTxSigInfoType 0 0 0 65535 ECU_ADDRESS 0x0 /end MEASUREMENT
/begin MEASUREMENT Com_TxSigInfo[362].TxBufferStartIdxOfTxSigInfo "" UWORD Com_TxBufferStartIdxOfTxSigInfoType 0 0 0 65535 ECU_ADDRESS 0x0 /end MEASUREMENT
/begin MEASUREMENT Com_TxSigInfo[362].TxFilterInitValueArrayBasedFilterInitValueEndIdxOfTxSigInfo "" UBYTE Com_TxFilterInitValueArrayBasedFilterInitValueEndIdxOfTxSigInfoType 0 0 0 255 ECU_ADDRESS 0x0 /end MEASUREMENT
/begin MEASUREMENT Com_TxSigInfo[362].TxFilterInitValueArrayBasedFilterInitValueStartIdxOfTxSigInfo "" UBYTE Com_TxFilterInitValueArrayBasedFilterInitValueStartIdxOfTxSigInfoType 0 0 0 255 ECU_ADDRESS 0x0 /end MEASUREMENT
/begin MEASUREMENT Com_TxSigInfo[362].TxPduInfoIdxOfTxSigInfo "" UBYTE NO_COMPU_METHOD 0 0 0 255 ECU_ADDRESS 0x0 /end MEASUREMENT
/begin MEASUREMENT Com_TxSigInfo[363].ApplTypeOfTxSigInfo "" UBYTE Com_ApplTypeOfTxSigInfoType 0 0 0 255 ECU_ADDRESS 0x0 /end MEASUREMENT
/begin MEASUREMENT Com_TxSigInfo[363].BitLengthOfTxSigInfo "" UWORD NO_COMPU_METHOD 0 0 0 65535 ECU_ADDRESS 0x0 /end MEASUREMENT
/begin MEASUREMENT Com_TxSigInfo[363].BitPositionOfTxSigInfo "" UWORD NO_COMPU_METHOD 0 0 0 65535 ECU_ADDRESS 0x0 /end MEASUREMENT
/begin MEASUREMENT Com_TxSigInfo[363].BusAccOfTxSigInfo "" UBYTE Com_BusAccOfTxSigInfoType 0 0 0 255 ECU_ADDRESS 0x0 /end MEASUREMENT
/begin MEASUREMENT Com_TxSigInfo[363].ByteLengthOfTxSigInfo "" UBYTE NO_COMPU_METHOD 0 0 0 255 ECU_ADDRESS 0x0 /end MEASUREMENT
/begin MEASUREMENT Com_TxSigInfo[363].DynSignalOfTxSigInfo "" UBYTE Com_DynSignalOfTxSigInfoType 0 0 0 1 ECU_ADDRESS 0x0 /end MEASUREMENT
/begin MEASUREMENT Com_TxSigInfo[363].FilterInitValueIdxOfTxSigInfo "" UBYTE Com_FilterInitValueIdxOfTxSigInfoType 0 0 0 255 ECU_ADDRESS 0x0 /end MEASUREMENT
/begin MEASUREMENT Com_TxSigInfo[363].FilterInitValueOfTxSigInfo "" UBYTE Com_FilterInitValueOfTxSigInfoType 0 0 0 255 ECU_ADDRESS 0x0 /end MEASUREMENT
/begin MEASUREMENT Com_TxSigInfo[363].InvValueIdxOfTxSigInfo "" UBYTE Com_InvValueIdxOfTxSigInfoType 0 0 0 255 ECU_ADDRESS 0x0 /end MEASUREMENT
/begin MEASUREMENT Com_TxSigInfo[363].InvValueOfTxSigInfo "" UBYTE Com_InvValueOfTxSigInfoType 0 0 0 255 ECU_ADDRESS 0x0 /end MEASUREMENT
/begin MEASUREMENT Com_TxSigInfo[363].OnChangeIdxOfTxSigInfo "" UBYTE Com_OnChangeIdxOfTxSigInfoType 0 0 0 255 ECU_ADDRESS 0x0 /end MEASUREMENT
/begin MEASUREMENT Com_TxSigInfo[363].OnChangeOfTxSigInfo "" UBYTE Com_OnChangeOfTxSigInfoType 0 0 0 255 ECU_ADDRESS 0x0 /end MEASUREMENT
/begin MEASUREMENT Com_TxSigInfo[363].StartByteInPduPositionOfTxSigInfo "" UBYTE NO_COMPU_METHOD 0 0 0 255 ECU_ADDRESS 0x0 /end MEASUREMENT
/begin MEASUREMENT Com_TxSigInfo[363].TxAccessInfoIdxOfTxSigInfo "" UWORD NO_COMPU_METHOD 0 0 0 65535 ECU_ADDRESS 0x0 /end MEASUREMENT
/begin MEASUREMENT Com_TxSigInfo[363].TxBufferEndIdxOfTxSigInfo "" UWORD Com_TxBufferEndIdxOfTxSigInfoType 0 0 0 65535 ECU_ADDRESS 0x0 /end MEASUREMENT
/begin MEASUREMENT Com_TxSigInfo[363].TxBufferStartIdxOfTxSigInfo "" UWORD Com_TxBufferStartIdxOfTxSigInfoType 0 0 0 65535 ECU_ADDRESS 0x0 /end MEASUREMENT
/begin MEASUREMENT Com_TxSigInfo[363].TxFilterInitValueArrayBasedFilterInitValueEndIdxOfTxSigInfo "" UBYTE Com_TxFilterInitValueArrayBasedFilterInitValueEndIdxOfTxSigInfoType 0 0 0 255 ECU_ADDRESS 0x0 /end MEASUREMENT
/begin MEASUREMENT Com_TxSigInfo[363].TxFilterInitValueArrayBasedFilterInitValueStartIdxOfTxSigInfo "" UBYTE Com_TxFilterInitValueArrayBasedFilterInitValueStartIdxOfTxSigInfoType 0 0 0 255 ECU_ADDRESS 0x0 /end MEASUREMENT
/begin MEASUREMENT Com_TxSigInfo[363].TxPduInfoIdxOfTxSigInfo "" UBYTE NO_COMPU_METHOD 0 0 0 255 ECU_ADDRESS 0x0 /end MEASUREMENT
/begin MEASUREMENT Com_TxSigInfo[364].ApplTypeOfTxSigInfo "" UBYTE Com_ApplTypeOfTxSigInfoType 0 0 0 255 ECU_ADDRESS 0x0 /end MEASUREMENT
/begin MEASUREMENT Com_TxSigInfo[364].BitLengthOfTxSigInfo "" UWORD NO_COMPU_METHOD 0 0 0 65535 ECU_ADDRESS 0x0 /end MEASUREMENT
/begin MEASUREMENT Com_TxSigInfo[364].BitPositionOfTxSigInfo "" UWORD NO_COMPU_METHOD 0 0 0 65535 ECU_ADDRESS 0x0 /end MEASUREMENT
/begin MEASUREMENT Com_TxSigInfo[364].BusAccOfTxSigInfo "" UBYTE Com_BusAccOfTxSigInfoType 0 0 0 255 ECU_ADDRESS 0x0 /end MEASUREMENT
/begin MEASUREMENT Com_TxSigInfo[364].ByteLengthOfTxSigInfo "" UBYTE NO_COMPU_METHOD 0 0 0 255 ECU_ADDRESS 0x0 /end MEASUREMENT
/begin MEASUREMENT Com_TxSigInfo[364].DynSignalOfTxSigInfo "" UBYTE Com_DynSignalOfTxSigInfoType 0 0 0 1 ECU_ADDRESS 0x0 /end MEASUREMENT
/begin MEASUREMENT Com_TxSigInfo[364].FilterInitValueIdxOfTxSigInfo "" UBYTE Com_FilterInitValueIdxOfTxSigInfoType 0 0 0 255 ECU_ADDRESS 0x0 /end MEASUREMENT
/begin MEASUREMENT Com_TxSigInfo[364].FilterInitValueOfTxSigInfo "" UBYTE Com_FilterInitValueOfTxSigInfoType 0 0 0 255 ECU_ADDRESS 0x0 /end MEASUREMENT
/begin MEASUREMENT Com_TxSigInfo[364].InvValueIdxOfTxSigInfo "" UBYTE Com_InvValueIdxOfTxSigInfoType 0 0 0 255 ECU_ADDRESS 0x0 /end MEASUREMENT
/begin MEASUREMENT Com_TxSigInfo[364].InvValueOfTxSigInfo "" UBYTE Com_InvValueOfTxSigInfoType 0 0 0 255 ECU_ADDRESS 0x0 /end MEASUREMENT
/begin MEASUREMENT Com_TxSigInfo[364].OnChangeIdxOfTxSigInfo "" UBYTE Com_OnChangeIdxOfTxSigInfoType 0 0 0 255 ECU_ADDRESS 0x0 /end MEASUREMENT
/begin MEASUREMENT Com_TxSigInfo[364].OnChangeOfTxSigInfo "" UBYTE Com_OnChangeOfTxSigInfoType 0 0 0 255 ECU_ADDRESS 0x0 /end MEASUREMENT
/begin MEASUREMENT Com_TxSigInfo[364].StartByteInPduPositionOfTxSigInfo "" UBYTE NO_COMPU_METHOD 0 0 0 255 ECU_ADDRESS 0x0 /end MEASUREMENT
/begin MEASUREMENT Com_TxSigInfo[364].TxAccessInfoIdxOfTxSigInfo "" UWORD NO_COMPU_METHOD 0 0 0 65535 ECU_ADDRESS 0x0 /end MEASUREMENT
/begin MEASUREMENT Com_TxSigInfo[364].TxBufferEndIdxOfTxSigInfo "" UWORD Com_TxBufferEndIdxOfTxSigInfoType 0 0 0 65535 ECU_ADDRESS 0x0 /end MEASUREMENT
/begin MEASUREMENT Com_TxSigInfo[364].TxBufferStartIdxOfTxSigInfo "" UWORD Com_TxBufferStartIdxOfTxSigInfoType 0 0 0 65535 ECU_ADDRESS 0x0 /end MEASUREMENT
/begin MEASUREMENT Com_TxSigInfo[364].TxFilterInitValueArrayBasedFilterInitValueEndIdxOfTxSigInfo "" UBYTE Com_TxFilterInitValueArrayBasedFilterInitValueEndIdxOfTxSigInfoType 0 0 0 255 ECU_ADDRESS 0x0 /end MEASUREMENT
/begin MEASUREMENT Com_TxSigInfo[364].TxFilterInitValueArrayBasedFilterInitValueStartIdxOfTxSigInfo "" UBYTE Com_TxFilterInitValueArrayBasedFilterInitValueStartIdxOfTxSigInfoType 0 0 0 255 ECU_ADDRESS 0x0 /end MEASUREMENT
/begin MEASUREMENT Com_TxSigInfo[364].TxPduInfoIdxOfTxSigInfo "" UBYTE NO_COMPU_METHOD 0 0 0 255 ECU_ADDRESS 0x0 /end MEASUREMENT
/begin MEASUREMENT Com_TxSigInfo[365].ApplTypeOfTxSigInfo "" UBYTE Com_ApplTypeOfTxSigInfoType 0 0 0 255 ECU_ADDRESS 0x0 /end MEASUREMENT
/begin MEASUREMENT Com_TxSigInfo[365].BitLengthOfTxSigInfo "" UWORD NO_COMPU_METHOD 0 0 0 65535 ECU_ADDRESS 0x0 /end MEASUREMENT
/begin MEASUREMENT Com_TxSigInfo[365].BitPositionOfTxSigInfo "" UWORD NO_COMPU_METHOD 0 0 0 65535 ECU_ADDRESS 0x0 /end MEASUREMENT
/begin MEASUREMENT Com_TxSigInfo[365].BusAccOfTxSigInfo "" UBYTE Com_BusAccOfTxSigInfoType 0 0 0 255 ECU_ADDRESS 0x0 /end MEASUREMENT
/begin MEASUREMENT Com_TxSigInfo[365].ByteLengthOfTxSigInfo "" UBYTE NO_COMPU_METHOD 0 0 0 255 ECU_ADDRESS 0x0 /end MEASUREMENT
/begin MEASUREMENT Com_TxSigInfo[365].DynSignalOfTxSigInfo "" UBYTE Com_DynSignalOfTxSigInfoType 0 0 0 1 ECU_ADDRESS 0x0 /end MEASUREMENT
/begin MEASUREMENT Com_TxSigInfo[365].FilterInitValueIdxOfTxSigInfo "" UBYTE Com_FilterInitValueIdxOfTxSigInfoType 0 0 0 255 ECU_ADDRESS 0x0 /end MEASUREMENT
/begin MEASUREMENT Com_TxSigInfo[365].FilterInitValueOfTxSigInfo "" UBYTE Com_FilterInitValueOfTxSigInfoType 0 0 0 255 ECU_ADDRESS 0x0 /end MEASUREMENT
/begin MEASUREMENT Com_TxSigInfo[365].InvValueIdxOfTxSigInfo "" UBYTE Com_InvValueIdxOfTxSigInfoType 0 0 0 255 ECU_ADDRESS 0x0 /end MEASUREMENT
/begin MEASUREMENT Com_TxSigInfo[365].InvValueOfTxSigInfo "" UBYTE Com_InvValueOfTxSigInfoType 0 0 0 255 ECU_ADDRESS 0x0 /end MEASUREMENT
/begin MEASUREMENT Com_TxSigInfo[365].OnChangeIdxOfTxSigInfo "" UBYTE Com_OnChangeIdxOfTxSigInfoType 0 0 0 255 ECU_ADDRESS 0x0 /end MEASUREMENT
/begin MEASUREMENT Com_TxSigInfo[365].OnChangeOfTxSigInfo "" UBYTE Com_OnChangeOfTxSigInfoType 0 0 0 255 ECU_ADDRESS 0x0 /end MEASUREMENT
/begin MEASUREMENT Com_TxSigInfo[365].StartByteInPduPositionOfTxSigInfo "" UBYTE NO_COMPU_METHOD 0 0 0 255 ECU_ADDRESS 0x0 /end MEASUREMENT
/begin MEASUREMENT Com_TxSigInfo[365].TxAccessInfoIdxOfTxSigInfo "" UWORD NO_COMPU_METHOD 0 0 0 65535 ECU_ADDRESS 0x0 /end MEASUREMENT
/begin MEASUREMENT Com_TxSigInfo[365].TxBufferEndIdxOfTxSigInfo "" UWORD Com_TxBufferEndIdxOfTxSigInfoType 0 0 0 65535 ECU_ADDRESS 0x0 /end MEASUREMENT
/begin MEASUREMENT Com_TxSigInfo[365].TxBufferStartIdxOfTxSigInfo "" UWORD Com_TxBufferStartIdxOfTxSigInfoType 0 0 0 65535 ECU_ADDRESS 0x0 /end MEASUREMENT
/begin MEASUREMENT Com_TxSigInfo[365].TxFilterInitValueArrayBasedFilterInitValueEndIdxOfTxSigInfo "" UBYTE Com_TxFilterInitValueArrayBasedFilterInitValueEndIdxOfTxSigInfoType 0 0 0 255 ECU_ADDRESS 0x0 /end MEASUREMENT
/begin MEASUREMENT Com_TxSigInfo[365].TxFilterInitValueArrayBasedFilterInitValueStartIdxOfTxSigInfo "" UBYTE Com_TxFilterInitValueArrayBasedFilterInitValueStartIdxOfTxSigInfoType 0 0 0 255 ECU_ADDRESS 0x0 /end MEASUREMENT
/begin MEASUREMENT Com_TxSigInfo[365].TxPduInfoIdxOfTxSigInfo "" UBYTE NO_COMPU_METHOD 0 0 0 255 ECU_ADDRESS 0x0 /end MEASUREMENT
/begin MEASUREMENT Com_TxSigInfo[366].ApplTypeOfTxSigInfo "" UBYTE Com_ApplTypeOfTxSigInfoType 0 0 0 255 ECU_ADDRESS 0x0 /end MEASUREMENT
/begin MEASUREMENT Com_TxSigInfo[366].BitLengthOfTxSigInfo "" UWORD NO_COMPU_METHOD 0 0 0 65535 ECU_ADDRESS 0x0 /end MEASUREMENT
/begin MEASUREMENT Com_TxSigInfo[366].BitPositionOfTxSigInfo "" UWORD NO_COMPU_METHOD 0 0 0 65535 ECU_ADDRESS 0x0 /end MEASUREMENT
/begin MEASUREMENT Com_TxSigInfo[366].BusAccOfTxSigInfo "" UBYTE Com_BusAccOfTxSigInfoType 0 0 0 255 ECU_ADDRESS 0x0 /end MEASUREMENT
/begin MEASUREMENT Com_TxSigInfo[366].ByteLengthOfTxSigInfo "" UBYTE NO_COMPU_METHOD 0 0 0 255 ECU_ADDRESS 0x0 /end MEASUREMENT
/begin MEASUREMENT Com_TxSigInfo[366].DynSignalOfTxSigInfo "" UBYTE Com_DynSignalOfTxSigInfoType 0 0 0 1 ECU_ADDRESS 0x0 /end MEASUREMENT
/begin MEASUREMENT Com_TxSigInfo[366].FilterInitValueIdxOfTxSigInfo "" UBYTE Com_FilterInitValueIdxOfTxSigInfoType 0 0 0 255 ECU_ADDRESS 0x0 /end MEASUREMENT
/begin MEASUREMENT Com_TxSigInfo[366].FilterInitValueOfTxSigInfo "" UBYTE Com_FilterInitValueOfTxSigInfoType 0 0 0 255 ECU_ADDRESS 0x0 /end MEASUREMENT
/begin MEASUREMENT Com_TxSigInfo[366].InvValueIdxOfTxSigInfo "" UBYTE Com_InvValueIdxOfTxSigInfoType 0 0 0 255 ECU_ADDRESS 0x0 /end MEASUREMENT
/begin MEASUREMENT Com_TxSigInfo[366].InvValueOfTxSigInfo "" UBYTE Com_InvValueOfTxSigInfoType 0 0 0 255 ECU_ADDRESS 0x0 /end MEASUREMENT
/begin MEASUREMENT Com_TxSigInfo[366].OnChangeIdxOfTxSigInfo "" UBYTE Com_OnChangeIdxOfTxSigInfoType 0 0 0 255 ECU_ADDRESS 0x0 /end MEASUREMENT
/begin MEASUREMENT Com_TxSigInfo[366].OnChangeOfTxSigInfo "" UBYTE Com_OnChangeOfTxSigInfoType 0 0 0 255 ECU_ADDRESS 0x0 /end MEASUREMENT
/begin MEASUREMENT Com_TxSigInfo[366].StartByteInPduPositionOfTxSigInfo "" UBYTE NO_COMPU_METHOD 0 0 0 255 ECU_ADDRESS 0x0 /end MEASUREMENT
/begin MEASUREMENT Com_TxSigInfo[366].TxAccessInfoIdxOfTxSigInfo "" UWORD NO_COMPU_METHOD 0 0 0 65535 ECU_ADDRESS 0x0 /end MEASUREMENT
/begin MEASUREMENT Com_TxSigInfo[366].TxBufferEndIdxOfTxSigInfo "" UWORD Com_TxBufferEndIdxOfTxSigInfoType 0 0 0 65535 ECU_ADDRESS 0x0 /end MEASUREMENT
/begin MEASUREMENT Com_TxSigInfo[366].TxBufferStartIdxOfTxSigInfo "" UWORD Com_TxBufferStartIdxOfTxSigInfoType 0 0 0 65535 ECU_ADDRESS 0x0 /end MEASUREMENT
/begin MEASUREMENT Com_TxSigInfo[366].TxFilterInitValueArrayBasedFilterInitValueEndIdxOfTxSigInfo "" UBYTE Com_TxFilterInitValueArrayBasedFilterInitValueEndIdxOfTxSigInfoType 0 0 0 255 ECU_ADDRESS 0x0 /end MEASUREMENT
/begin MEASUREMENT Com_TxSigInfo[366].TxFilterInitValueArrayBasedFilterInitValueStartIdxOfTxSigInfo "" UBYTE Com_TxFilterInitValueArrayBasedFilterInitValueStartIdxOfTxSigInfoType 0 0 0 255 ECU_ADDRESS 0x0 /end MEASUREMENT
/begin MEASUREMENT Com_TxSigInfo[366].TxPduInfoIdxOfTxSigInfo "" UBYTE NO_COMPU_METHOD 0 0 0 255 ECU_ADDRESS 0x0 /end MEASUREMENT
/begin MEASUREMENT Com_TxSigInfo[367].ApplTypeOfTxSigInfo "" UBYTE Com_ApplTypeOfTxSigInfoType 0 0 0 255 ECU_ADDRESS 0x0 /end MEASUREMENT
/begin MEASUREMENT Com_TxSigInfo[367].BitLengthOfTxSigInfo "" UWORD NO_COMPU_METHOD 0 0 0 65535 ECU_ADDRESS 0x0 /end MEASUREMENT
/begin MEASUREMENT Com_TxSigInfo[367].BitPositionOfTxSigInfo "" UWORD NO_COMPU_METHOD 0 0 0 65535 ECU_ADDRESS 0x0 /end MEASUREMENT
/begin MEASUREMENT Com_TxSigInfo[367].BusAccOfTxSigInfo "" UBYTE Com_BusAccOfTxSigInfoType 0 0 0 255 ECU_ADDRESS 0x0 /end MEASUREMENT
/begin MEASUREMENT Com_TxSigInfo[367].ByteLengthOfTxSigInfo "" UBYTE NO_COMPU_METHOD 0 0 0 255 ECU_ADDRESS 0x0 /end MEASUREMENT
/begin MEASUREMENT Com_TxSigInfo[367].DynSignalOfTxSigInfo "" UBYTE Com_DynSignalOfTxSigInfoType 0 0 0 1 ECU_ADDRESS 0x0 /end MEASUREMENT
/begin MEASUREMENT Com_TxSigInfo[367].FilterInitValueIdxOfTxSigInfo "" UBYTE Com_FilterInitValueIdxOfTxSigInfoType 0 0 0 255 ECU_ADDRESS 0x0 /end MEASUREMENT
/begin MEASUREMENT Com_TxSigInfo[367].FilterInitValueOfTxSigInfo "" UBYTE Com_FilterInitValueOfTxSigInfoType 0 0 0 255 ECU_ADDRESS 0x0 /end MEASUREMENT
/begin MEASUREMENT Com_TxSigInfo[367].InvValueIdxOfTxSigInfo "" UBYTE Com_InvValueIdxOfTxSigInfoType 0 0 0 255 ECU_ADDRESS 0x0 /end MEASUREMENT
/begin MEASUREMENT Com_TxSigInfo[367].InvValueOfTxSigInfo "" UBYTE Com_InvValueOfTxSigInfoType 0 0 0 255 ECU_ADDRESS 0x0 /end MEASUREMENT
/begin MEASUREMENT Com_TxSigInfo[367].OnChangeIdxOfTxSigInfo "" UBYTE Com_OnChangeIdxOfTxSigInfoType 0 0 0 255 ECU_ADDRESS 0x0 /end MEASUREMENT
/begin MEASUREMENT Com_TxSigInfo[367].OnChangeOfTxSigInfo "" UBYTE Com_OnChangeOfTxSigInfoType 0 0 0 255 ECU_ADDRESS 0x0 /end MEASUREMENT
/begin MEASUREMENT Com_TxSigInfo[367].StartByteInPduPositionOfTxSigInfo "" UBYTE NO_COMPU_METHOD 0 0 0 255 ECU_ADDRESS 0x0 /end MEASUREMENT
/begin MEASUREMENT Com_TxSigInfo[367].TxAccessInfoIdxOfTxSigInfo "" UWORD NO_COMPU_METHOD 0 0 0 65535 ECU_ADDRESS 0x0 /end MEASUREMENT
/begin MEASUREMENT Com_TxSigInfo[367].TxBufferEndIdxOfTxSigInfo "" UWORD Com_TxBufferEndIdxOfTxSigInfoType 0 0 0 65535 ECU_ADDRESS 0x0 /end MEASUREMENT
/begin MEASUREMENT Com_TxSigInfo[367].TxBufferStartIdxOfTxSigInfo "" UWORD Com_TxBufferStartIdxOfTxSigInfoType 0 0 0 65535 ECU_ADDRESS 0x0 /end MEASUREMENT
/begin MEASUREMENT Com_TxSigInfo[367].TxFilterInitValueArrayBasedFilterInitValueEndIdxOfTxSigInfo "" UBYTE Com_TxFilterInitValueArrayBasedFilterInitValueEndIdxOfTxSigInfoType 0 0 0 255 ECU_ADDRESS 0x0 /end MEASUREMENT
/begin MEASUREMENT Com_TxSigInfo[367].TxFilterInitValueArrayBasedFilterInitValueStartIdxOfTxSigInfo "" UBYTE Com_TxFilterInitValueArrayBasedFilterInitValueStartIdxOfTxSigInfoType 0 0 0 255 ECU_ADDRESS 0x0 /end MEASUREMENT
/begin MEASUREMENT Com_TxSigInfo[367].TxPduInfoIdxOfTxSigInfo "" UBYTE NO_COMPU_METHOD 0 0 0 255 ECU_ADDRESS 0x0 /end MEASUREMENT
/begin MEASUREMENT Com_TxSigInfo[368].ApplTypeOfTxSigInfo "" UBYTE Com_ApplTypeOfTxSigInfoType 0 0 0 255 ECU_ADDRESS 0x0 /end MEASUREMENT
/begin MEASUREMENT Com_TxSigInfo[368].BitLengthOfTxSigInfo "" UWORD NO_COMPU_METHOD 0 0 0 65535 ECU_ADDRESS 0x0 /end MEASUREMENT
/begin MEASUREMENT Com_TxSigInfo[368].BitPositionOfTxSigInfo "" UWORD NO_COMPU_METHOD 0 0 0 65535 ECU_ADDRESS 0x0 /end MEASUREMENT
/begin MEASUREMENT Com_TxSigInfo[368].BusAccOfTxSigInfo "" UBYTE Com_BusAccOfTxSigInfoType 0 0 0 255 ECU_ADDRESS 0x0 /end MEASUREMENT
/begin MEASUREMENT Com_TxSigInfo[368].ByteLengthOfTxSigInfo "" UBYTE NO_COMPU_METHOD 0 0 0 255 ECU_ADDRESS 0x0 /end MEASUREMENT
/begin MEASUREMENT Com_TxSigInfo[368].DynSignalOfTxSigInfo "" UBYTE Com_DynSignalOfTxSigInfoType 0 0 0 1 ECU_ADDRESS 0x0 /end MEASUREMENT
/begin MEASUREMENT Com_TxSigInfo[368].FilterInitValueIdxOfTxSigInfo "" UBYTE Com_FilterInitValueIdxOfTxSigInfoType 0 0 0 255 ECU_ADDRESS 0x0 /end MEASUREMENT
/begin MEASUREMENT Com_TxSigInfo[368].FilterInitValueOfTxSigInfo "" UBYTE Com_FilterInitValueOfTxSigInfoType 0 0 0 255 ECU_ADDRESS 0x0 /end MEASUREMENT
/begin MEASUREMENT Com_TxSigInfo[368].InvValueIdxOfTxSigInfo "" UBYTE Com_InvValueIdxOfTxSigInfoType 0 0 0 255 ECU_ADDRESS 0x0 /end MEASUREMENT
/begin MEASUREMENT Com_TxSigInfo[368].InvValueOfTxSigInfo "" UBYTE Com_InvValueOfTxSigInfoType 0 0 0 255 ECU_ADDRESS 0x0 /end MEASUREMENT
/begin MEASUREMENT Com_TxSigInfo[368].OnChangeIdxOfTxSigInfo "" UBYTE Com_OnChangeIdxOfTxSigInfoType 0 0 0 255 ECU_ADDRESS 0x0 /end MEASUREMENT
/begin MEASUREMENT Com_TxSigInfo[368].OnChangeOfTxSigInfo "" UBYTE Com_OnChangeOfTxSigInfoType 0 0 0 255 ECU_ADDRESS 0x0 /end MEASUREMENT
/begin MEASUREMENT Com_TxSigInfo[368].StartByteInPduPositionOfTxSigInfo "" UBYTE NO_COMPU_METHOD 0 0 0 255 ECU_ADDRESS 0x0 /end MEASUREMENT
/begin MEASUREMENT Com_TxSigInfo[368].TxAccessInfoIdxOfTxSigInfo "" UWORD NO_COMPU_METHOD 0 0 0 65535 ECU_ADDRESS 0x0 /end MEASUREMENT
/begin MEASUREMENT Com_TxSigInfo[368].TxBufferEndIdxOfTxSigInfo "" UWORD Com_TxBufferEndIdxOfTxSigInfoType 0 0 0 65535 ECU_ADDRESS 0x0 /end MEASUREMENT
/begin MEASUREMENT Com_TxSigInfo[368].TxBufferStartIdxOfTxSigInfo "" UWORD Com_TxBufferStartIdxOfTxSigInfoType 0 0 0 65535 ECU_ADDRESS 0x0 /end MEASUREMENT
/begin MEASUREMENT Com_TxSigInfo[368].TxFilterInitValueArrayBasedFilterInitValueEndIdxOfTxSigInfo "" UBYTE Com_TxFilterInitValueArrayBasedFilterInitValueEndIdxOfTxSigInfoType 0 0 0 255 ECU_ADDRESS 0x0 /end MEASUREMENT
/begin MEASUREMENT Com_TxSigInfo[368].TxFilterInitValueArrayBasedFilterInitValueStartIdxOfTxSigInfo "" UBYTE Com_TxFilterInitValueArrayBasedFilterInitValueStartIdxOfTxSigInfoType 0 0 0 255 ECU_ADDRESS 0x0 /end MEASUREMENT
/begin MEASUREMENT Com_TxSigInfo[368].TxPduInfoIdxOfTxSigInfo "" UBYTE NO_COMPU_METHOD 0 0 0 255 ECU_ADDRESS 0x0 /end MEASUREMENT
/begin MEASUREMENT Com_TxSigInfo[369].ApplTypeOfTxSigInfo "" UBYTE Com_ApplTypeOfTxSigInfoType 0 0 0 255 ECU_ADDRESS 0x0 /end MEASUREMENT
/begin MEASUREMENT Com_TxSigInfo[369].BitLengthOfTxSigInfo "" UWORD NO_COMPU_METHOD 0 0 0 65535 ECU_ADDRESS 0x0 /end MEASUREMENT
/begin MEASUREMENT Com_TxSigInfo[369].BitPositionOfTxSigInfo "" UWORD NO_COMPU_METHOD 0 0 0 65535 ECU_ADDRESS 0x0 /end MEASUREMENT
/begin MEASUREMENT Com_TxSigInfo[369].BusAccOfTxSigInfo "" UBYTE Com_BusAccOfTxSigInfoType 0 0 0 255 ECU_ADDRESS 0x0 /end MEASUREMENT
/begin MEASUREMENT Com_TxSigInfo[369].ByteLengthOfTxSigInfo "" UBYTE NO_COMPU_METHOD 0 0 0 255 ECU_ADDRESS 0x0 /end MEASUREMENT
/begin MEASUREMENT Com_TxSigInfo[369].DynSignalOfTxSigInfo "" UBYTE Com_DynSignalOfTxSigInfoType 0 0 0 1 ECU_ADDRESS 0x0 /end MEASUREMENT
/begin MEASUREMENT Com_TxSigInfo[369].FilterInitValueIdxOfTxSigInfo "" UBYTE Com_FilterInitValueIdxOfTxSigInfoType 0 0 0 255 ECU_ADDRESS 0x0 /end MEASUREMENT
/begin MEASUREMENT Com_TxSigInfo[369].FilterInitValueOfTxSigInfo "" UBYTE Com_FilterInitValueOfTxSigInfoType 0 0 0 255 ECU_ADDRESS 0x0 /end MEASUREMENT
/begin MEASUREMENT Com_TxSigInfo[369].InvValueIdxOfTxSigInfo "" UBYTE Com_InvValueIdxOfTxSigInfoType 0 0 0 255 ECU_ADDRESS 0x0 /end MEASUREMENT
/begin MEASUREMENT Com_TxSigInfo[369].InvValueOfTxSigInfo "" UBYTE Com_InvValueOfTxSigInfoType 0 0 0 255 ECU_ADDRESS 0x0 /end MEASUREMENT
/begin MEASUREMENT Com_TxSigInfo[369].OnChangeIdxOfTxSigInfo "" UBYTE Com_OnChangeIdxOfTxSigInfoType 0 0 0 255 ECU_ADDRESS 0x0 /end MEASUREMENT
/begin MEASUREMENT Com_TxSigInfo[369].OnChangeOfTxSigInfo "" UBYTE Com_OnChangeOfTxSigInfoType 0 0 0 255 ECU_ADDRESS 0x0 /end MEASUREMENT
/begin MEASUREMENT Com_TxSigInfo[369].StartByteInPduPositionOfTxSigInfo "" UBYTE NO_COMPU_METHOD 0 0 0 255 ECU_ADDRESS 0x0 /end MEASUREMENT
/begin MEASUREMENT Com_TxSigInfo[369].TxAccessInfoIdxOfTxSigInfo "" UWORD NO_COMPU_METHOD 0 0 0 65535 ECU_ADDRESS 0x0 /end MEASUREMENT
/begin MEASUREMENT Com_TxSigInfo[369].TxBufferEndIdxOfTxSigInfo "" UWORD Com_TxBufferEndIdxOfTxSigInfoType 0 0 0 65535 ECU_ADDRESS 0x0 /end MEASUREMENT
/begin MEASUREMENT Com_TxSigInfo[369].TxBufferStartIdxOfTxSigInfo "" UWORD Com_TxBufferStartIdxOfTxSigInfoType 0 0 0 65535 ECU_ADDRESS 0x0 /end MEASUREMENT
/begin MEASUREMENT Com_TxSigInfo[369].TxFilterInitValueArrayBasedFilterInitValueEndIdxOfTxSigInfo "" UBYTE Com_TxFilterInitValueArrayBasedFilterInitValueEndIdxOfTxSigInfoType 0 0 0 255 ECU_ADDRESS 0x0 /end MEASUREMENT
/begin MEASUREMENT Com_TxSigInfo[369].TxFilterInitValueArrayBasedFilterInitValueStartIdxOfTxSigInfo "" UBYTE Com_TxFilterInitValueArrayBasedFilterInitValueStartIdxOfTxSigInfoType 0 0 0 255 ECU_ADDRESS 0x0 /end MEASUREMENT
/begin MEASUREMENT Com_TxSigInfo[369].TxPduInfoIdxOfTxSigInfo "" UBYTE NO_COMPU_METHOD 0 0 0 255 ECU_ADDRESS 0x0 /end MEASUREMENT
/begin MEASUREMENT Com_TxSigInfo[36].ApplTypeOfTxSigInfo "" UBYTE Com_ApplTypeOfTxSigInfoType 0 0 0 255 ECU_ADDRESS 0x0 /end MEASUREMENT
/begin MEASUREMENT Com_TxSigInfo[36].BitLengthOfTxSigInfo "" UWORD NO_COMPU_METHOD 0 0 0 65535 ECU_ADDRESS 0x0 /end MEASUREMENT
/begin MEASUREMENT Com_TxSigInfo[36].BitPositionOfTxSigInfo "" UWORD NO_COMPU_METHOD 0 0 0 65535 ECU_ADDRESS 0x0 /end MEASUREMENT
/begin MEASUREMENT Com_TxSigInfo[36].BusAccOfTxSigInfo "" UBYTE Com_BusAccOfTxSigInfoType 0 0 0 255 ECU_ADDRESS 0x0 /end MEASUREMENT
/begin MEASUREMENT Com_TxSigInfo[36].ByteLengthOfTxSigInfo "" UBYTE NO_COMPU_METHOD 0 0 0 255 ECU_ADDRESS 0x0 /end MEASUREMENT
/begin MEASUREMENT Com_TxSigInfo[36].DynSignalOfTxSigInfo "" UBYTE Com_DynSignalOfTxSigInfoType 0 0 0 1 ECU_ADDRESS 0x0 /end MEASUREMENT
/begin MEASUREMENT Com_TxSigInfo[36].FilterInitValueIdxOfTxSigInfo "" UBYTE Com_FilterInitValueIdxOfTxSigInfoType 0 0 0 255 ECU_ADDRESS 0x0 /end MEASUREMENT
/begin MEASUREMENT Com_TxSigInfo[36].FilterInitValueOfTxSigInfo "" UBYTE Com_FilterInitValueOfTxSigInfoType 0 0 0 255 ECU_ADDRESS 0x0 /end MEASUREMENT
/begin MEASUREMENT Com_TxSigInfo[36].InvValueIdxOfTxSigInfo "" UBYTE Com_InvValueIdxOfTxSigInfoType 0 0 0 255 ECU_ADDRESS 0x0 /end MEASUREMENT
/begin MEASUREMENT Com_TxSigInfo[36].InvValueOfTxSigInfo "" UBYTE Com_InvValueOfTxSigInfoType 0 0 0 255 ECU_ADDRESS 0x0 /end MEASUREMENT
/begin MEASUREMENT Com_TxSigInfo[36].OnChangeIdxOfTxSigInfo "" UBYTE Com_OnChangeIdxOfTxSigInfoType 0 0 0 255 ECU_ADDRESS 0x0 /end MEASUREMENT
/begin MEASUREMENT Com_TxSigInfo[36].OnChangeOfTxSigInfo "" UBYTE Com_OnChangeOfTxSigInfoType 0 0 0 255 ECU_ADDRESS 0x0 /end MEASUREMENT
/begin MEASUREMENT Com_TxSigInfo[36].StartByteInPduPositionOfTxSigInfo "" UBYTE NO_COMPU_METHOD 0 0 0 255 ECU_ADDRESS 0x0 /end MEASUREMENT
/begin MEASUREMENT Com_TxSigInfo[36].TxAccessInfoIdxOfTxSigInfo "" UWORD NO_COMPU_METHOD 0 0 0 65535 ECU_ADDRESS 0x0 /end MEASUREMENT
/begin MEASUREMENT Com_TxSigInfo[36].TxBufferEndIdxOfTxSigInfo "" UWORD Com_TxBufferEndIdxOfTxSigInfoType 0 0 0 65535 ECU_ADDRESS 0x0 /end MEASUREMENT
/begin MEASUREMENT Com_TxSigInfo[36].TxBufferStartIdxOfTxSigInfo "" UWORD Com_TxBufferStartIdxOfTxSigInfoType 0 0 0 65535 ECU_ADDRESS 0x0 /end MEASUREMENT
/begin MEASUREMENT Com_TxSigInfo[36].TxFilterInitValueArrayBasedFilterInitValueEndIdxOfTxSigInfo "" UBYTE Com_TxFilterInitValueArrayBasedFilterInitValueEndIdxOfTxSigInfoType 0 0 0 255 ECU_ADDRESS 0x0 /end MEASUREMENT
/begin MEASUREMENT Com_TxSigInfo[36].TxFilterInitValueArrayBasedFilterInitValueStartIdxOfTxSigInfo "" UBYTE Com_TxFilterInitValueArrayBasedFilterInitValueStartIdxOfTxSigInfoType 0 0 0 255 ECU_ADDRESS 0x0 /end MEASUREMENT
/begin MEASUREMENT Com_TxSigInfo[36].TxPduInfoIdxOfTxSigInfo "" UBYTE NO_COMPU_METHOD 0 0 0 255 ECU_ADDRESS 0x0 /end MEASUREMENT
/begin MEASUREMENT Com_TxSigInfo[370].ApplTypeOfTxSigInfo "" UBYTE Com_ApplTypeOfTxSigInfoType 0 0 0 255 ECU_ADDRESS 0x0 /end MEASUREMENT
/begin MEASUREMENT Com_TxSigInfo[370].BitLengthOfTxSigInfo "" UWORD NO_COMPU_METHOD 0 0 0 65535 ECU_ADDRESS 0x0 /end MEASUREMENT
/begin MEASUREMENT Com_TxSigInfo[370].BitPositionOfTxSigInfo "" UWORD NO_COMPU_METHOD 0 0 0 65535 ECU_ADDRESS 0x0 /end MEASUREMENT
/begin MEASUREMENT Com_TxSigInfo[370].BusAccOfTxSigInfo "" UBYTE Com_BusAccOfTxSigInfoType 0 0 0 255 ECU_ADDRESS 0x0 /end MEASUREMENT
/begin MEASUREMENT Com_TxSigInfo[370].ByteLengthOfTxSigInfo "" UBYTE NO_COMPU_METHOD 0 0 0 255 ECU_ADDRESS 0x0 /end MEASUREMENT
/begin MEASUREMENT Com_TxSigInfo[370].DynSignalOfTxSigInfo "" UBYTE Com_DynSignalOfTxSigInfoType 0 0 0 1 ECU_ADDRESS 0x0 /end MEASUREMENT
/begin MEASUREMENT Com_TxSigInfo[370].FilterInitValueIdxOfTxSigInfo "" UBYTE Com_FilterInitValueIdxOfTxSigInfoType 0 0 0 255 ECU_ADDRESS 0x0 /end MEASUREMENT
/begin MEASUREMENT Com_TxSigInfo[370].FilterInitValueOfTxSigInfo "" UBYTE Com_FilterInitValueOfTxSigInfoType 0 0 0 255 ECU_ADDRESS 0x0 /end MEASUREMENT
/begin MEASUREMENT Com_TxSigInfo[370].InvValueIdxOfTxSigInfo "" UBYTE Com_InvValueIdxOfTxSigInfoType 0 0 0 255 ECU_ADDRESS 0x0 /end MEASUREMENT
/begin MEASUREMENT Com_TxSigInfo[370].InvValueOfTxSigInfo "" UBYTE Com_InvValueOfTxSigInfoType 0 0 0 255 ECU_ADDRESS 0x0 /end MEASUREMENT
/begin MEASUREMENT Com_TxSigInfo[370].OnChangeIdxOfTxSigInfo "" UBYTE Com_OnChangeIdxOfTxSigInfoType 0 0 0 255 ECU_ADDRESS 0x0 /end MEASUREMENT
/begin MEASUREMENT Com_TxSigInfo[370].OnChangeOfTxSigInfo "" UBYTE Com_OnChangeOfTxSigInfoType 0 0 0 255 ECU_ADDRESS 0x0 /end MEASUREMENT
/begin MEASUREMENT Com_TxSigInfo[370].StartByteInPduPositionOfTxSigInfo "" UBYTE NO_COMPU_METHOD 0 0 0 255 ECU_ADDRESS 0x0 /end MEASUREMENT
/begin MEASUREMENT Com_TxSigInfo[370].TxAccessInfoIdxOfTxSigInfo "" UWORD NO_COMPU_METHOD 0 0 0 65535 ECU_ADDRESS 0x0 /end MEASUREMENT
/begin MEASUREMENT Com_TxSigInfo[370].TxBufferEndIdxOfTxSigInfo "" UWORD Com_TxBufferEndIdxOfTxSigInfoType 0 0 0 65535 ECU_ADDRESS 0x0 /end MEASUREMENT
/begin MEASUREMENT Com_TxSigInfo[370].TxBufferStartIdxOfTxSigInfo "" UWORD Com_TxBufferStartIdxOfTxSigInfoType 0 0 0 65535 ECU_ADDRESS 0x0 /end MEASUREMENT
/begin MEASUREMENT Com_TxSigInfo[370].TxFilterInitValueArrayBasedFilterInitValueEndIdxOfTxSigInfo "" UBYTE Com_TxFilterInitValueArrayBasedFilterInitValueEndIdxOfTxSigInfoType 0 0 0 255 ECU_ADDRESS 0x0 /end MEASUREMENT
/begin MEASUREMENT Com_TxSigInfo[370].TxFilterInitValueArrayBasedFilterInitValueStartIdxOfTxSigInfo "" UBYTE Com_TxFilterInitValueArrayBasedFilterInitValueStartIdxOfTxSigInfoType 0 0 0 255 ECU_ADDRESS 0x0 /end MEASUREMENT
/begin MEASUREMENT Com_TxSigInfo[370].TxPduInfoIdxOfTxSigInfo "" UBYTE NO_COMPU_METHOD 0 0 0 255 ECU_ADDRESS 0x0 /end MEASUREMENT
/begin MEASUREMENT Com_TxSigInfo[371].ApplTypeOfTxSigInfo "" UBYTE Com_ApplTypeOfTxSigInfoType 0 0 0 255 ECU_ADDRESS 0x0 /end MEASUREMENT
/begin MEASUREMENT Com_TxSigInfo[371].BitLengthOfTxSigInfo "" UWORD NO_COMPU_METHOD 0 0 0 65535 ECU_ADDRESS 0x0 /end MEASUREMENT
/begin MEASUREMENT Com_TxSigInfo[371].BitPositionOfTxSigInfo "" UWORD NO_COMPU_METHOD 0 0 0 65535 ECU_ADDRESS 0x0 /end MEASUREMENT
/begin MEASUREMENT Com_TxSigInfo[371].BusAccOfTxSigInfo "" UBYTE Com_BusAccOfTxSigInfoType 0 0 0 255 ECU_ADDRESS 0x0 /end MEASUREMENT
/begin MEASUREMENT Com_TxSigInfo[371].ByteLengthOfTxSigInfo "" UBYTE NO_COMPU_METHOD 0 0 0 255 ECU_ADDRESS 0x0 /end MEASUREMENT
/begin MEASUREMENT Com_TxSigInfo[371].DynSignalOfTxSigInfo "" UBYTE Com_DynSignalOfTxSigInfoType 0 0 0 1 ECU_ADDRESS 0x0 /end MEASUREMENT
/begin MEASUREMENT Com_TxSigInfo[371].FilterInitValueIdxOfTxSigInfo "" UBYTE Com_FilterInitValueIdxOfTxSigInfoType 0 0 0 255 ECU_ADDRESS 0x0 /end MEASUREMENT
/begin MEASUREMENT Com_TxSigInfo[371].FilterInitValueOfTxSigInfo "" UBYTE Com_FilterInitValueOfTxSigInfoType 0 0 0 255 ECU_ADDRESS 0x0 /end MEASUREMENT
/begin MEASUREMENT Com_TxSigInfo[371].InvValueIdxOfTxSigInfo "" UBYTE Com_InvValueIdxOfTxSigInfoType 0 0 0 255 ECU_ADDRESS 0x0 /end MEASUREMENT
/begin MEASUREMENT Com_TxSigInfo[371].InvValueOfTxSigInfo "" UBYTE Com_InvValueOfTxSigInfoType 0 0 0 255 ECU_ADDRESS 0x0 /end MEASUREMENT
/begin MEASUREMENT Com_TxSigInfo[371].OnChangeIdxOfTxSigInfo "" UBYTE Com_OnChangeIdxOfTxSigInfoType 0 0 0 255 ECU_ADDRESS 0x0 /end MEASUREMENT
/begin MEASUREMENT Com_TxSigInfo[371].OnChangeOfTxSigInfo "" UBYTE Com_OnChangeOfTxSigInfoType 0 0 0 255 ECU_ADDRESS 0x0 /end MEASUREMENT
/begin MEASUREMENT Com_TxSigInfo[371].StartByteInPduPositionOfTxSigInfo "" UBYTE NO_COMPU_METHOD 0 0 0 255 ECU_ADDRESS 0x0 /end MEASUREMENT
/begin MEASUREMENT Com_TxSigInfo[371].TxAccessInfoIdxOfTxSigInfo "" UWORD NO_COMPU_METHOD 0 0 0 65535 ECU_ADDRESS 0x0 /end MEASUREMENT
/begin MEASUREMENT Com_TxSigInfo[371].TxBufferEndIdxOfTxSigInfo "" UWORD Com_TxBufferEndIdxOfTxSigInfoType 0 0 0 65535 ECU_ADDRESS 0x0 /end MEASUREMENT
/begin MEASUREMENT Com_TxSigInfo[371].TxBufferStartIdxOfTxSigInfo "" UWORD Com_TxBufferStartIdxOfTxSigInfoType 0 0 0 65535 ECU_ADDRESS 0x0 /end MEASUREMENT
/begin MEASUREMENT Com_TxSigInfo[371].TxFilterInitValueArrayBasedFilterInitValueEndIdxOfTxSigInfo "" UBYTE Com_TxFilterInitValueArrayBasedFilterInitValueEndIdxOfTxSigInfoType 0 0 0 255 ECU_ADDRESS 0x0 /end MEASUREMENT
/begin MEASUREMENT Com_TxSigInfo[371].TxFilterInitValueArrayBasedFilterInitValueStartIdxOfTxSigInfo "" UBYTE Com_TxFilterInitValueArrayBasedFilterInitValueStartIdxOfTxSigInfoType 0 0 0 255 ECU_ADDRESS 0x0 /end MEASUREMENT
/begin MEASUREMENT Com_TxSigInfo[371].TxPduInfoIdxOfTxSigInfo "" UBYTE NO_COMPU_METHOD 0 0 0 255 ECU_ADDRESS 0x0 /end MEASUREMENT
/begin MEASUREMENT Com_TxSigInfo[372].ApplTypeOfTxSigInfo "" UBYTE Com_ApplTypeOfTxSigInfoType 0 0 0 255 ECU_ADDRESS 0x0 /end MEASUREMENT
/begin MEASUREMENT Com_TxSigInfo[372].BitLengthOfTxSigInfo "" UWORD NO_COMPU_METHOD 0 0 0 65535 ECU_ADDRESS 0x0 /end MEASUREMENT
/begin MEASUREMENT Com_TxSigInfo[372].BitPositionOfTxSigInfo "" UWORD NO_COMPU_METHOD 0 0 0 65535 ECU_ADDRESS 0x0 /end MEASUREMENT
/begin MEASUREMENT Com_TxSigInfo[372].BusAccOfTxSigInfo "" UBYTE Com_BusAccOfTxSigInfoType 0 0 0 255 ECU_ADDRESS 0x0 /end MEASUREMENT
/begin MEASUREMENT Com_TxSigInfo[372].ByteLengthOfTxSigInfo "" UBYTE NO_COMPU_METHOD 0 0 0 255 ECU_ADDRESS 0x0 /end MEASUREMENT
/begin MEASUREMENT Com_TxSigInfo[372].DynSignalOfTxSigInfo "" UBYTE Com_DynSignalOfTxSigInfoType 0 0 0 1 ECU_ADDRESS 0x0 /end MEASUREMENT
/begin MEASUREMENT Com_TxSigInfo[372].FilterInitValueIdxOfTxSigInfo "" UBYTE Com_FilterInitValueIdxOfTxSigInfoType 0 0 0 255 ECU_ADDRESS 0x0 /end MEASUREMENT
/begin MEASUREMENT Com_TxSigInfo[372].FilterInitValueOfTxSigInfo "" UBYTE Com_FilterInitValueOfTxSigInfoType 0 0 0 255 ECU_ADDRESS 0x0 /end MEASUREMENT
/begin MEASUREMENT Com_TxSigInfo[372].InvValueIdxOfTxSigInfo "" UBYTE Com_InvValueIdxOfTxSigInfoType 0 0 0 255 ECU_ADDRESS 0x0 /end MEASUREMENT
/begin MEASUREMENT Com_TxSigInfo[372].InvValueOfTxSigInfo "" UBYTE Com_InvValueOfTxSigInfoType 0 0 0 255 ECU_ADDRESS 0x0 /end MEASUREMENT
/begin MEASUREMENT Com_TxSigInfo[372].OnChangeIdxOfTxSigInfo "" UBYTE Com_OnChangeIdxOfTxSigInfoType 0 0 0 255 ECU_ADDRESS 0x0 /end MEASUREMENT
/begin MEASUREMENT Com_TxSigInfo[372].OnChangeOfTxSigInfo "" UBYTE Com_OnChangeOfTxSigInfoType 0 0 0 255 ECU_ADDRESS 0x0 /end MEASUREMENT
/begin MEASUREMENT Com_TxSigInfo[372].StartByteInPduPositionOfTxSigInfo "" UBYTE NO_COMPU_METHOD 0 0 0 255 ECU_ADDRESS 0x0 /end MEASUREMENT
/begin MEASUREMENT Com_TxSigInfo[372].TxAccessInfoIdxOfTxSigInfo "" UWORD NO_COMPU_METHOD 0 0 0 65535 ECU_ADDRESS 0x0 /end MEASUREMENT
/begin MEASUREMENT Com_TxSigInfo[372].TxBufferEndIdxOfTxSigInfo "" UWORD Com_TxBufferEndIdxOfTxSigInfoType 0 0 0 65535 ECU_ADDRESS 0x0 /end MEASUREMENT
/begin MEASUREMENT Com_TxSigInfo[372].TxBufferStartIdxOfTxSigInfo "" UWORD Com_TxBufferStartIdxOfTxSigInfoType 0 0 0 65535 ECU_ADDRESS 0x0 /end MEASUREMENT
/begin MEASUREMENT Com_TxSigInfo[372].TxFilterInitValueArrayBasedFilterInitValueEndIdxOfTxSigInfo "" UBYTE Com_TxFilterInitValueArrayBasedFilterInitValueEndIdxOfTxSigInfoType 0 0 0 255 ECU_ADDRESS 0x0 /end MEASUREMENT
/begin MEASUREMENT Com_TxSigInfo[372].TxFilterInitValueArrayBasedFilterInitValueStartIdxOfTxSigInfo "" UBYTE Com_TxFilterInitValueArrayBasedFilterInitValueStartIdxOfTxSigInfoType 0 0 0 255 ECU_ADDRESS 0x0 /end MEASUREMENT
/begin MEASUREMENT Com_TxSigInfo[372].TxPduInfoIdxOfTxSigInfo "" UBYTE NO_COMPU_METHOD 0 0 0 255 ECU_ADDRESS 0x0 /end MEASUREMENT
/begin MEASUREMENT Com_TxSigInfo[373].ApplTypeOfTxSigInfo "" UBYTE Com_ApplTypeOfTxSigInfoType 0 0 0 255 ECU_ADDRESS 0x0 /end MEASUREMENT
/begin MEASUREMENT Com_TxSigInfo[373].BitLengthOfTxSigInfo "" UWORD NO_COMPU_METHOD 0 0 0 65535 ECU_ADDRESS 0x0 /end MEASUREMENT
/begin MEASUREMENT Com_TxSigInfo[373].BitPositionOfTxSigInfo "" UWORD NO_COMPU_METHOD 0 0 0 65535 ECU_ADDRESS 0x0 /end MEASUREMENT
/begin MEASUREMENT Com_TxSigInfo[373].BusAccOfTxSigInfo "" UBYTE Com_BusAccOfTxSigInfoType 0 0 0 255 ECU_ADDRESS 0x0 /end MEASUREMENT
/begin MEASUREMENT Com_TxSigInfo[373].ByteLengthOfTxSigInfo "" UBYTE NO_COMPU_METHOD 0 0 0 255 ECU_ADDRESS 0x0 /end MEASUREMENT
/begin MEASUREMENT Com_TxSigInfo[373].DynSignalOfTxSigInfo "" UBYTE Com_DynSignalOfTxSigInfoType 0 0 0 1 ECU_ADDRESS 0x0 /end MEASUREMENT
/begin MEASUREMENT Com_TxSigInfo[373].FilterInitValueIdxOfTxSigInfo "" UBYTE Com_FilterInitValueIdxOfTxSigInfoType 0 0 0 255 ECU_ADDRESS 0x0 /end MEASUREMENT
/begin MEASUREMENT Com_TxSigInfo[373].FilterInitValueOfTxSigInfo "" UBYTE Com_FilterInitValueOfTxSigInfoType 0 0 0 255 ECU_ADDRESS 0x0 /end MEASUREMENT
/begin MEASUREMENT Com_TxSigInfo[373].InvValueIdxOfTxSigInfo "" UBYTE Com_InvValueIdxOfTxSigInfoType 0 0 0 255 ECU_ADDRESS 0x0 /end MEASUREMENT
/begin MEASUREMENT Com_TxSigInfo[373].InvValueOfTxSigInfo "" UBYTE Com_InvValueOfTxSigInfoType 0 0 0 255 ECU_ADDRESS 0x0 /end MEASUREMENT
/begin MEASUREMENT Com_TxSigInfo[373].OnChangeIdxOfTxSigInfo "" UBYTE Com_OnChangeIdxOfTxSigInfoType 0 0 0 255 ECU_ADDRESS 0x0 /end MEASUREMENT
/begin MEASUREMENT Com_TxSigInfo[373].OnChangeOfTxSigInfo "" UBYTE Com_OnChangeOfTxSigInfoType 0 0 0 255 ECU_ADDRESS 0x0 /end MEASUREMENT
/begin MEASUREMENT Com_TxSigInfo[373].StartByteInPduPositionOfTxSigInfo "" UBYTE NO_COMPU_METHOD 0 0 0 255 ECU_ADDRESS 0x0 /end MEASUREMENT
/begin MEASUREMENT Com_TxSigInfo[373].TxAccessInfoIdxOfTxSigInfo "" UWORD NO_COMPU_METHOD 0 0 0 65535 ECU_ADDRESS 0x0 /end MEASUREMENT
/begin MEASUREMENT Com_TxSigInfo[373].TxBufferEndIdxOfTxSigInfo "" UWORD Com_TxBufferEndIdxOfTxSigInfoType 0 0 0 65535 ECU_ADDRESS 0x0 /end MEASUREMENT
/begin MEASUREMENT Com_TxSigInfo[373].TxBufferStartIdxOfTxSigInfo "" UWORD Com_TxBufferStartIdxOfTxSigInfoType 0 0 0 65535 ECU_ADDRESS 0x0 /end MEASUREMENT
/begin MEASUREMENT Com_TxSigInfo[373].TxFilterInitValueArrayBasedFilterInitValueEndIdxOfTxSigInfo "" UBYTE Com_TxFilterInitValueArrayBasedFilterInitValueEndIdxOfTxSigInfoType 0 0 0 255 ECU_ADDRESS 0x0 /end MEASUREMENT
/begin MEASUREMENT Com_TxSigInfo[373].TxFilterInitValueArrayBasedFilterInitValueStartIdxOfTxSigInfo "" UBYTE Com_TxFilterInitValueArrayBasedFilterInitValueStartIdxOfTxSigInfoType 0 0 0 255 ECU_ADDRESS 0x0 /end MEASUREMENT
/begin MEASUREMENT Com_TxSigInfo[373].TxPduInfoIdxOfTxSigInfo "" UBYTE NO_COMPU_METHOD 0 0 0 255 ECU_ADDRESS 0x0 /end MEASUREMENT
/begin MEASUREMENT Com_TxSigInfo[374].ApplTypeOfTxSigInfo "" UBYTE Com_ApplTypeOfTxSigInfoType 0 0 0 255 ECU_ADDRESS 0x0 /end MEASUREMENT
/begin MEASUREMENT Com_TxSigInfo[374].BitLengthOfTxSigInfo "" UWORD NO_COMPU_METHOD 0 0 0 65535 ECU_ADDRESS 0x0 /end MEASUREMENT
/begin MEASUREMENT Com_TxSigInfo[374].BitPositionOfTxSigInfo "" UWORD NO_COMPU_METHOD 0 0 0 65535 ECU_ADDRESS 0x0 /end MEASUREMENT
/begin MEASUREMENT Com_TxSigInfo[374].BusAccOfTxSigInfo "" UBYTE Com_BusAccOfTxSigInfoType 0 0 0 255 ECU_ADDRESS 0x0 /end MEASUREMENT
/begin MEASUREMENT Com_TxSigInfo[374].ByteLengthOfTxSigInfo "" UBYTE NO_COMPU_METHOD 0 0 0 255 ECU_ADDRESS 0x0 /end MEASUREMENT
/begin MEASUREMENT Com_TxSigInfo[374].DynSignalOfTxSigInfo "" UBYTE Com_DynSignalOfTxSigInfoType 0 0 0 1 ECU_ADDRESS 0x0 /end MEASUREMENT
/begin MEASUREMENT Com_TxSigInfo[374].FilterInitValueIdxOfTxSigInfo "" UBYTE Com_FilterInitValueIdxOfTxSigInfoType 0 0 0 255 ECU_ADDRESS 0x0 /end MEASUREMENT
/begin MEASUREMENT Com_TxSigInfo[374].FilterInitValueOfTxSigInfo "" UBYTE Com_FilterInitValueOfTxSigInfoType 0 0 0 255 ECU_ADDRESS 0x0 /end MEASUREMENT
/begin MEASUREMENT Com_TxSigInfo[374].InvValueIdxOfTxSigInfo "" UBYTE Com_InvValueIdxOfTxSigInfoType 0 0 0 255 ECU_ADDRESS 0x0 /end MEASUREMENT
/begin MEASUREMENT Com_TxSigInfo[374].InvValueOfTxSigInfo "" UBYTE Com_InvValueOfTxSigInfoType 0 0 0 255 ECU_ADDRESS 0x0 /end MEASUREMENT
/begin MEASUREMENT Com_TxSigInfo[374].OnChangeIdxOfTxSigInfo "" UBYTE Com_OnChangeIdxOfTxSigInfoType 0 0 0 255 ECU_ADDRESS 0x0 /end MEASUREMENT
/begin MEASUREMENT Com_TxSigInfo[374].OnChangeOfTxSigInfo "" UBYTE Com_OnChangeOfTxSigInfoType 0 0 0 255 ECU_ADDRESS 0x0 /end MEASUREMENT
/begin MEASUREMENT Com_TxSigInfo[374].StartByteInPduPositionOfTxSigInfo "" UBYTE NO_COMPU_METHOD 0 0 0 255 ECU_ADDRESS 0x0 /end MEASUREMENT
/begin MEASUREMENT Com_TxSigInfo[374].TxAccessInfoIdxOfTxSigInfo "" UWORD NO_COMPU_METHOD 0 0 0 65535 ECU_ADDRESS 0x0 /end MEASUREMENT
/begin MEASUREMENT Com_TxSigInfo[374].TxBufferEndIdxOfTxSigInfo "" UWORD Com_TxBufferEndIdxOfTxSigInfoType 0 0 0 65535 ECU_ADDRESS 0x0 /end MEASUREMENT
/begin MEASUREMENT Com_TxSigInfo[374].TxBufferStartIdxOfTxSigInfo "" UWORD Com_TxBufferStartIdxOfTxSigInfoType 0 0 0 65535 ECU_ADDRESS 0x0 /end MEASUREMENT
/begin MEASUREMENT Com_TxSigInfo[374].TxFilterInitValueArrayBasedFilterInitValueEndIdxOfTxSigInfo "" UBYTE Com_TxFilterInitValueArrayBasedFilterInitValueEndIdxOfTxSigInfoType 0 0 0 255 ECU_ADDRESS 0x0 /end MEASUREMENT
/begin MEASUREMENT Com_TxSigInfo[374].TxFilterInitValueArrayBasedFilterInitValueStartIdxOfTxSigInfo "" UBYTE Com_TxFilterInitValueArrayBasedFilterInitValueStartIdxOfTxSigInfoType 0 0 0 255 ECU_ADDRESS 0x0 /end MEASUREMENT
/begin MEASUREMENT Com_TxSigInfo[374].TxPduInfoIdxOfTxSigInfo "" UBYTE NO_COMPU_METHOD 0 0 0 255 ECU_ADDRESS 0x0 /end MEASUREMENT
/begin MEASUREMENT Com_TxSigInfo[375].ApplTypeOfTxSigInfo "" UBYTE Com_ApplTypeOfTxSigInfoType 0 0 0 255 ECU_ADDRESS 0x0 /end MEASUREMENT
/begin MEASUREMENT Com_TxSigInfo[375].BitLengthOfTxSigInfo "" UWORD NO_COMPU_METHOD 0 0 0 65535 ECU_ADDRESS 0x0 /end MEASUREMENT
/begin MEASUREMENT Com_TxSigInfo[375].BitPositionOfTxSigInfo "" UWORD NO_COMPU_METHOD 0 0 0 65535 ECU_ADDRESS 0x0 /end MEASUREMENT
/begin MEASUREMENT Com_TxSigInfo[375].BusAccOfTxSigInfo "" UBYTE Com_BusAccOfTxSigInfoType 0 0 0 255 ECU_ADDRESS 0x0 /end MEASUREMENT
/begin MEASUREMENT Com_TxSigInfo[375].ByteLengthOfTxSigInfo "" UBYTE NO_COMPU_METHOD 0 0 0 255 ECU_ADDRESS 0x0 /end MEASUREMENT
/begin MEASUREMENT Com_TxSigInfo[375].DynSignalOfTxSigInfo "" UBYTE Com_DynSignalOfTxSigInfoType 0 0 0 1 ECU_ADDRESS 0x0 /end MEASUREMENT
/begin MEASUREMENT Com_TxSigInfo[375].FilterInitValueIdxOfTxSigInfo "" UBYTE Com_FilterInitValueIdxOfTxSigInfoType 0 0 0 255 ECU_ADDRESS 0x0 /end MEASUREMENT
/begin MEASUREMENT Com_TxSigInfo[375].FilterInitValueOfTxSigInfo "" UBYTE Com_FilterInitValueOfTxSigInfoType 0 0 0 255 ECU_ADDRESS 0x0 /end MEASUREMENT
/begin MEASUREMENT Com_TxSigInfo[375].InvValueIdxOfTxSigInfo "" UBYTE Com_InvValueIdxOfTxSigInfoType 0 0 0 255 ECU_ADDRESS 0x0 /end MEASUREMENT
/begin MEASUREMENT Com_TxSigInfo[375].InvValueOfTxSigInfo "" UBYTE Com_InvValueOfTxSigInfoType 0 0 0 255 ECU_ADDRESS 0x0 /end MEASUREMENT
/begin MEASUREMENT Com_TxSigInfo[375].OnChangeIdxOfTxSigInfo "" UBYTE Com_OnChangeIdxOfTxSigInfoType 0 0 0 255 ECU_ADDRESS 0x0 /end MEASUREMENT
/begin MEASUREMENT Com_TxSigInfo[375].OnChangeOfTxSigInfo "" UBYTE Com_OnChangeOfTxSigInfoType 0 0 0 255 ECU_ADDRESS 0x0 /end MEASUREMENT
/begin MEASUREMENT Com_TxSigInfo[375].StartByteInPduPositionOfTxSigInfo "" UBYTE NO_COMPU_METHOD 0 0 0 255 ECU_ADDRESS 0x0 /end MEASUREMENT
/begin MEASUREMENT Com_TxSigInfo[375].TxAccessInfoIdxOfTxSigInfo "" UWORD NO_COMPU_METHOD 0 0 0 65535 ECU_ADDRESS 0x0 /end MEASUREMENT
/begin MEASUREMENT Com_TxSigInfo[375].TxBufferEndIdxOfTxSigInfo "" UWORD Com_TxBufferEndIdxOfTxSigInfoType 0 0 0 65535 ECU_ADDRESS 0x0 /end MEASUREMENT
/begin MEASUREMENT Com_TxSigInfo[375].TxBufferStartIdxOfTxSigInfo "" UWORD Com_TxBufferStartIdxOfTxSigInfoType 0 0 0 65535 ECU_ADDRESS 0x0 /end MEASUREMENT
/begin MEASUREMENT Com_TxSigInfo[375].TxFilterInitValueArrayBasedFilterInitValueEndIdxOfTxSigInfo "" UBYTE Com_TxFilterInitValueArrayBasedFilterInitValueEndIdxOfTxSigInfoType 0 0 0 255 ECU_ADDRESS 0x0 /end MEASUREMENT
/begin MEASUREMENT Com_TxSigInfo[375].TxFilterInitValueArrayBasedFilterInitValueStartIdxOfTxSigInfo "" UBYTE Com_TxFilterInitValueArrayBasedFilterInitValueStartIdxOfTxSigInfoType 0 0 0 255 ECU_ADDRESS 0x0 /end MEASUREMENT
/begin MEASUREMENT Com_TxSigInfo[375].TxPduInfoIdxOfTxSigInfo "" UBYTE NO_COMPU_METHOD 0 0 0 255 ECU_ADDRESS 0x0 /end MEASUREMENT
/begin MEASUREMENT Com_TxSigInfo[376].ApplTypeOfTxSigInfo "" UBYTE Com_ApplTypeOfTxSigInfoType 0 0 0 255 ECU_ADDRESS 0x0 /end MEASUREMENT
/begin MEASUREMENT Com_TxSigInfo[376].BitLengthOfTxSigInfo "" UWORD NO_COMPU_METHOD 0 0 0 65535 ECU_ADDRESS 0x0 /end MEASUREMENT
/begin MEASUREMENT Com_TxSigInfo[376].BitPositionOfTxSigInfo "" UWORD NO_COMPU_METHOD 0 0 0 65535 ECU_ADDRESS 0x0 /end MEASUREMENT
/begin MEASUREMENT Com_TxSigInfo[376].BusAccOfTxSigInfo "" UBYTE Com_BusAccOfTxSigInfoType 0 0 0 255 ECU_ADDRESS 0x0 /end MEASUREMENT
/begin MEASUREMENT Com_TxSigInfo[376].ByteLengthOfTxSigInfo "" UBYTE NO_COMPU_METHOD 0 0 0 255 ECU_ADDRESS 0x0 /end MEASUREMENT
/begin MEASUREMENT Com_TxSigInfo[376].DynSignalOfTxSigInfo "" UBYTE Com_DynSignalOfTxSigInfoType 0 0 0 1 ECU_ADDRESS 0x0 /end MEASUREMENT
/begin MEASUREMENT Com_TxSigInfo[376].FilterInitValueIdxOfTxSigInfo "" UBYTE Com_FilterInitValueIdxOfTxSigInfoType 0 0 0 255 ECU_ADDRESS 0x0 /end MEASUREMENT
/begin MEASUREMENT Com_TxSigInfo[376].FilterInitValueOfTxSigInfo "" UBYTE Com_FilterInitValueOfTxSigInfoType 0 0 0 255 ECU_ADDRESS 0x0 /end MEASUREMENT
/begin MEASUREMENT Com_TxSigInfo[376].InvValueIdxOfTxSigInfo "" UBYTE Com_InvValueIdxOfTxSigInfoType 0 0 0 255 ECU_ADDRESS 0x0 /end MEASUREMENT
/begin MEASUREMENT Com_TxSigInfo[376].InvValueOfTxSigInfo "" UBYTE Com_InvValueOfTxSigInfoType 0 0 0 255 ECU_ADDRESS 0x0 /end MEASUREMENT
/begin MEASUREMENT Com_TxSigInfo[376].OnChangeIdxOfTxSigInfo "" UBYTE Com_OnChangeIdxOfTxSigInfoType 0 0 0 255 ECU_ADDRESS 0x0 /end MEASUREMENT
/begin MEASUREMENT Com_TxSigInfo[376].OnChangeOfTxSigInfo "" UBYTE Com_OnChangeOfTxSigInfoType 0 0 0 255 ECU_ADDRESS 0x0 /end MEASUREMENT
/begin MEASUREMENT Com_TxSigInfo[376].StartByteInPduPositionOfTxSigInfo "" UBYTE NO_COMPU_METHOD 0 0 0 255 ECU_ADDRESS 0x0 /end MEASUREMENT
/begin MEASUREMENT Com_TxSigInfo[376].TxAccessInfoIdxOfTxSigInfo "" UWORD NO_COMPU_METHOD 0 0 0 65535 ECU_ADDRESS 0x0 /end MEASUREMENT
/begin MEASUREMENT Com_TxSigInfo[376].TxBufferEndIdxOfTxSigInfo "" UWORD Com_TxBufferEndIdxOfTxSigInfoType 0 0 0 65535 ECU_ADDRESS 0x0 /end MEASUREMENT
/begin MEASUREMENT Com_TxSigInfo[376].TxBufferStartIdxOfTxSigInfo "" UWORD Com_TxBufferStartIdxOfTxSigInfoType 0 0 0 65535 ECU_ADDRESS 0x0 /end MEASUREMENT
/begin MEASUREMENT Com_TxSigInfo[376].TxFilterInitValueArrayBasedFilterInitValueEndIdxOfTxSigInfo "" UBYTE Com_TxFilterInitValueArrayBasedFilterInitValueEndIdxOfTxSigInfoType 0 0 0 255 ECU_ADDRESS 0x0 /end MEASUREMENT
/begin MEASUREMENT Com_TxSigInfo[376].TxFilterInitValueArrayBasedFilterInitValueStartIdxOfTxSigInfo "" UBYTE Com_TxFilterInitValueArrayBasedFilterInitValueStartIdxOfTxSigInfoType 0 0 0 255 ECU_ADDRESS 0x0 /end MEASUREMENT
/begin MEASUREMENT Com_TxSigInfo[376].TxPduInfoIdxOfTxSigInfo "" UBYTE NO_COMPU_METHOD 0 0 0 255 ECU_ADDRESS 0x0 /end MEASUREMENT
/begin MEASUREMENT Com_TxSigInfo[377].ApplTypeOfTxSigInfo "" UBYTE Com_ApplTypeOfTxSigInfoType 0 0 0 255 ECU_ADDRESS 0x0 /end MEASUREMENT
/begin MEASUREMENT Com_TxSigInfo[377].BitLengthOfTxSigInfo "" UWORD NO_COMPU_METHOD 0 0 0 65535 ECU_ADDRESS 0x0 /end MEASUREMENT
/begin MEASUREMENT Com_TxSigInfo[377].BitPositionOfTxSigInfo "" UWORD NO_COMPU_METHOD 0 0 0 65535 ECU_ADDRESS 0x0 /end MEASUREMENT
/begin MEASUREMENT Com_TxSigInfo[377].BusAccOfTxSigInfo "" UBYTE Com_BusAccOfTxSigInfoType 0 0 0 255 ECU_ADDRESS 0x0 /end MEASUREMENT
/begin MEASUREMENT Com_TxSigInfo[377].ByteLengthOfTxSigInfo "" UBYTE NO_COMPU_METHOD 0 0 0 255 ECU_ADDRESS 0x0 /end MEASUREMENT
/begin MEASUREMENT Com_TxSigInfo[377].DynSignalOfTxSigInfo "" UBYTE Com_DynSignalOfTxSigInfoType 0 0 0 1 ECU_ADDRESS 0x0 /end MEASUREMENT
/begin MEASUREMENT Com_TxSigInfo[377].FilterInitValueIdxOfTxSigInfo "" UBYTE Com_FilterInitValueIdxOfTxSigInfoType 0 0 0 255 ECU_ADDRESS 0x0 /end MEASUREMENT
/begin MEASUREMENT Com_TxSigInfo[377].FilterInitValueOfTxSigInfo "" UBYTE Com_FilterInitValueOfTxSigInfoType 0 0 0 255 ECU_ADDRESS 0x0 /end MEASUREMENT
/begin MEASUREMENT Com_TxSigInfo[377].InvValueIdxOfTxSigInfo "" UBYTE Com_InvValueIdxOfTxSigInfoType 0 0 0 255 ECU_ADDRESS 0x0 /end MEASUREMENT
/begin MEASUREMENT Com_TxSigInfo[377].InvValueOfTxSigInfo "" UBYTE Com_InvValueOfTxSigInfoType 0 0 0 255 ECU_ADDRESS 0x0 /end MEASUREMENT
/begin MEASUREMENT Com_TxSigInfo[377].OnChangeIdxOfTxSigInfo "" UBYTE Com_OnChangeIdxOfTxSigInfoType 0 0 0 255 ECU_ADDRESS 0x0 /end MEASUREMENT
/begin MEASUREMENT Com_TxSigInfo[377].OnChangeOfTxSigInfo "" UBYTE Com_OnChangeOfTxSigInfoType 0 0 0 255 ECU_ADDRESS 0x0 /end MEASUREMENT
/begin MEASUREMENT Com_TxSigInfo[377].StartByteInPduPositionOfTxSigInfo "" UBYTE NO_COMPU_METHOD 0 0 0 255 ECU_ADDRESS 0x0 /end MEASUREMENT
/begin MEASUREMENT Com_TxSigInfo[377].TxAccessInfoIdxOfTxSigInfo "" UWORD NO_COMPU_METHOD 0 0 0 65535 ECU_ADDRESS 0x0 /end MEASUREMENT
/begin MEASUREMENT Com_TxSigInfo[377].TxBufferEndIdxOfTxSigInfo "" UWORD Com_TxBufferEndIdxOfTxSigInfoType 0 0 0 65535 ECU_ADDRESS 0x0 /end MEASUREMENT
/begin MEASUREMENT Com_TxSigInfo[377].TxBufferStartIdxOfTxSigInfo "" UWORD Com_TxBufferStartIdxOfTxSigInfoType 0 0 0 65535 ECU_ADDRESS 0x0 /end MEASUREMENT
/begin MEASUREMENT Com_TxSigInfo[377].TxFilterInitValueArrayBasedFilterInitValueEndIdxOfTxSigInfo "" UBYTE Com_TxFilterInitValueArrayBasedFilterInitValueEndIdxOfTxSigInfoType 0 0 0 255 ECU_ADDRESS 0x0 /end MEASUREMENT
/begin MEASUREMENT Com_TxSigInfo[377].TxFilterInitValueArrayBasedFilterInitValueStartIdxOfTxSigInfo "" UBYTE Com_TxFilterInitValueArrayBasedFilterInitValueStartIdxOfTxSigInfoType 0 0 0 255 ECU_ADDRESS 0x0 /end MEASUREMENT
/begin MEASUREMENT Com_TxSigInfo[377].TxPduInfoIdxOfTxSigInfo "" UBYTE NO_COMPU_METHOD 0 0 0 255 ECU_ADDRESS 0x0 /end MEASUREMENT
/begin MEASUREMENT Com_TxSigInfo[378].ApplTypeOfTxSigInfo "" UBYTE Com_ApplTypeOfTxSigInfoType 0 0 0 255 ECU_ADDRESS 0x0 /end MEASUREMENT
/begin MEASUREMENT Com_TxSigInfo[378].BitLengthOfTxSigInfo "" UWORD NO_COMPU_METHOD 0 0 0 65535 ECU_ADDRESS 0x0 /end MEASUREMENT
/begin MEASUREMENT Com_TxSigInfo[378].BitPositionOfTxSigInfo "" UWORD NO_COMPU_METHOD 0 0 0 65535 ECU_ADDRESS 0x0 /end MEASUREMENT
/begin MEASUREMENT Com_TxSigInfo[378].BusAccOfTxSigInfo "" UBYTE Com_BusAccOfTxSigInfoType 0 0 0 255 ECU_ADDRESS 0x0 /end MEASUREMENT
/begin MEASUREMENT Com_TxSigInfo[378].ByteLengthOfTxSigInfo "" UBYTE NO_COMPU_METHOD 0 0 0 255 ECU_ADDRESS 0x0 /end MEASUREMENT
/begin MEASUREMENT Com_TxSigInfo[378].DynSignalOfTxSigInfo "" UBYTE Com_DynSignalOfTxSigInfoType 0 0 0 1 ECU_ADDRESS 0x0 /end MEASUREMENT
/begin MEASUREMENT Com_TxSigInfo[378].FilterInitValueIdxOfTxSigInfo "" UBYTE Com_FilterInitValueIdxOfTxSigInfoType 0 0 0 255 ECU_ADDRESS 0x0 /end MEASUREMENT
/begin MEASUREMENT Com_TxSigInfo[378].FilterInitValueOfTxSigInfo "" UBYTE Com_FilterInitValueOfTxSigInfoType 0 0 0 255 ECU_ADDRESS 0x0 /end MEASUREMENT
/begin MEASUREMENT Com_TxSigInfo[378].InvValueIdxOfTxSigInfo "" UBYTE Com_InvValueIdxOfTxSigInfoType 0 0 0 255 ECU_ADDRESS 0x0 /end MEASUREMENT
/begin MEASUREMENT Com_TxSigInfo[378].InvValueOfTxSigInfo "" UBYTE Com_InvValueOfTxSigInfoType 0 0 0 255 ECU_ADDRESS 0x0 /end MEASUREMENT
/begin MEASUREMENT Com_TxSigInfo[378].OnChangeIdxOfTxSigInfo "" UBYTE Com_OnChangeIdxOfTxSigInfoType 0 0 0 255 ECU_ADDRESS 0x0 /end MEASUREMENT
/begin MEASUREMENT Com_TxSigInfo[378].OnChangeOfTxSigInfo "" UBYTE Com_OnChangeOfTxSigInfoType 0 0 0 255 ECU_ADDRESS 0x0 /end MEASUREMENT
/begin MEASUREMENT Com_TxSigInfo[378].StartByteInPduPositionOfTxSigInfo "" UBYTE NO_COMPU_METHOD 0 0 0 255 ECU_ADDRESS 0x0 /end MEASUREMENT
/begin MEASUREMENT Com_TxSigInfo[378].TxAccessInfoIdxOfTxSigInfo "" UWORD NO_COMPU_METHOD 0 0 0 65535 ECU_ADDRESS 0x0 /end MEASUREMENT
/begin MEASUREMENT Com_TxSigInfo[378].TxBufferEndIdxOfTxSigInfo "" UWORD Com_TxBufferEndIdxOfTxSigInfoType 0 0 0 65535 ECU_ADDRESS 0x0 /end MEASUREMENT
/begin MEASUREMENT Com_TxSigInfo[378].TxBufferStartIdxOfTxSigInfo "" UWORD Com_TxBufferStartIdxOfTxSigInfoType 0 0 0 65535 ECU_ADDRESS 0x0 /end MEASUREMENT
/begin MEASUREMENT Com_TxSigInfo[378].TxFilterInitValueArrayBasedFilterInitValueEndIdxOfTxSigInfo "" UBYTE Com_TxFilterInitValueArrayBasedFilterInitValueEndIdxOfTxSigInfoType 0 0 0 255 ECU_ADDRESS 0x0 /end MEASUREMENT
/begin MEASUREMENT Com_TxSigInfo[378].TxFilterInitValueArrayBasedFilterInitValueStartIdxOfTxSigInfo "" UBYTE Com_TxFilterInitValueArrayBasedFilterInitValueStartIdxOfTxSigInfoType 0 0 0 255 ECU_ADDRESS 0x0 /end MEASUREMENT
/begin MEASUREMENT Com_TxSigInfo[378].TxPduInfoIdxOfTxSigInfo "" UBYTE NO_COMPU_METHOD 0 0 0 255 ECU_ADDRESS 0x0 /end MEASUREMENT
/begin MEASUREMENT Com_TxSigInfo[379].ApplTypeOfTxSigInfo "" UBYTE Com_ApplTypeOfTxSigInfoType 0 0 0 255 ECU_ADDRESS 0x0 /end MEASUREMENT
/begin MEASUREMENT Com_TxSigInfo[379].BitLengthOfTxSigInfo "" UWORD NO_COMPU_METHOD 0 0 0 65535 ECU_ADDRESS 0x0 /end MEASUREMENT
/begin MEASUREMENT Com_TxSigInfo[379].BitPositionOfTxSigInfo "" UWORD NO_COMPU_METHOD 0 0 0 65535 ECU_ADDRESS 0x0 /end MEASUREMENT
/begin MEASUREMENT Com_TxSigInfo[379].BusAccOfTxSigInfo "" UBYTE Com_BusAccOfTxSigInfoType 0 0 0 255 ECU_ADDRESS 0x0 /end MEASUREMENT
/begin MEASUREMENT Com_TxSigInfo[379].ByteLengthOfTxSigInfo "" UBYTE NO_COMPU_METHOD 0 0 0 255 ECU_ADDRESS 0x0 /end MEASUREMENT
/begin MEASUREMENT Com_TxSigInfo[379].DynSignalOfTxSigInfo "" UBYTE Com_DynSignalOfTxSigInfoType 0 0 0 1 ECU_ADDRESS 0x0 /end MEASUREMENT
/begin MEASUREMENT Com_TxSigInfo[379].FilterInitValueIdxOfTxSigInfo "" UBYTE Com_FilterInitValueIdxOfTxSigInfoType 0 0 0 255 ECU_ADDRESS 0x0 /end MEASUREMENT
/begin MEASUREMENT Com_TxSigInfo[379].FilterInitValueOfTxSigInfo "" UBYTE Com_FilterInitValueOfTxSigInfoType 0 0 0 255 ECU_ADDRESS 0x0 /end MEASUREMENT
/begin MEASUREMENT Com_TxSigInfo[379].InvValueIdxOfTxSigInfo "" UBYTE Com_InvValueIdxOfTxSigInfoType 0 0 0 255 ECU_ADDRESS 0x0 /end MEASUREMENT
/begin MEASUREMENT Com_TxSigInfo[379].InvValueOfTxSigInfo "" UBYTE Com_InvValueOfTxSigInfoType 0 0 0 255 ECU_ADDRESS 0x0 /end MEASUREMENT
/begin MEASUREMENT Com_TxSigInfo[379].OnChangeIdxOfTxSigInfo "" UBYTE Com_OnChangeIdxOfTxSigInfoType 0 0 0 255 ECU_ADDRESS 0x0 /end MEASUREMENT
/begin MEASUREMENT Com_TxSigInfo[379].OnChangeOfTxSigInfo "" UBYTE Com_OnChangeOfTxSigInfoType 0 0 0 255 ECU_ADDRESS 0x0 /end MEASUREMENT
/begin MEASUREMENT Com_TxSigInfo[379].StartByteInPduPositionOfTxSigInfo "" UBYTE NO_COMPU_METHOD 0 0 0 255 ECU_ADDRESS 0x0 /end MEASUREMENT
/begin MEASUREMENT Com_TxSigInfo[379].TxAccessInfoIdxOfTxSigInfo "" UWORD NO_COMPU_METHOD 0 0 0 65535 ECU_ADDRESS 0x0 /end MEASUREMENT
/begin MEASUREMENT Com_TxSigInfo[379].TxBufferEndIdxOfTxSigInfo "" UWORD Com_TxBufferEndIdxOfTxSigInfoType 0 0 0 65535 ECU_ADDRESS 0x0 /end MEASUREMENT
/begin MEASUREMENT Com_TxSigInfo[379].TxBufferStartIdxOfTxSigInfo "" UWORD Com_TxBufferStartIdxOfTxSigInfoType 0 0 0 65535 ECU_ADDRESS 0x0 /end MEASUREMENT
/begin MEASUREMENT Com_TxSigInfo[379].TxFilterInitValueArrayBasedFilterInitValueEndIdxOfTxSigInfo "" UBYTE Com_TxFilterInitValueArrayBasedFilterInitValueEndIdxOfTxSigInfoType 0 0 0 255 ECU_ADDRESS 0x0 /end MEASUREMENT
/begin MEASUREMENT Com_TxSigInfo[379].TxFilterInitValueArrayBasedFilterInitValueStartIdxOfTxSigInfo "" UBYTE Com_TxFilterInitValueArrayBasedFilterInitValueStartIdxOfTxSigInfoType 0 0 0 255 ECU_ADDRESS 0x0 /end MEASUREMENT
/begin MEASUREMENT Com_TxSigInfo[379].TxPduInfoIdxOfTxSigInfo "" UBYTE NO_COMPU_METHOD 0 0 0 255 ECU_ADDRESS 0x0 /end MEASUREMENT
/begin MEASUREMENT Com_TxSigInfo[37].ApplTypeOfTxSigInfo "" UBYTE Com_ApplTypeOfTxSigInfoType 0 0 0 255 ECU_ADDRESS 0x0 /end MEASUREMENT
/begin MEASUREMENT Com_TxSigInfo[37].BitLengthOfTxSigInfo "" UWORD NO_COMPU_METHOD 0 0 0 65535 ECU_ADDRESS 0x0 /end MEASUREMENT
/begin MEASUREMENT Com_TxSigInfo[37].BitPositionOfTxSigInfo "" UWORD NO_COMPU_METHOD 0 0 0 65535 ECU_ADDRESS 0x0 /end MEASUREMENT
/begin MEASUREMENT Com_TxSigInfo[37].BusAccOfTxSigInfo "" UBYTE Com_BusAccOfTxSigInfoType 0 0 0 255 ECU_ADDRESS 0x0 /end MEASUREMENT
/begin MEASUREMENT Com_TxSigInfo[37].ByteLengthOfTxSigInfo "" UBYTE NO_COMPU_METHOD 0 0 0 255 ECU_ADDRESS 0x0 /end MEASUREMENT
/begin MEASUREMENT Com_TxSigInfo[37].DynSignalOfTxSigInfo "" UBYTE Com_DynSignalOfTxSigInfoType 0 0 0 1 ECU_ADDRESS 0x0 /end MEASUREMENT
/begin MEASUREMENT Com_TxSigInfo[37].FilterInitValueIdxOfTxSigInfo "" UBYTE Com_FilterInitValueIdxOfTxSigInfoType 0 0 0 255 ECU_ADDRESS 0x0 /end MEASUREMENT
/begin MEASUREMENT Com_TxSigInfo[37].FilterInitValueOfTxSigInfo "" UBYTE Com_FilterInitValueOfTxSigInfoType 0 0 0 255 ECU_ADDRESS 0x0 /end MEASUREMENT
/begin MEASUREMENT Com_TxSigInfo[37].InvValueIdxOfTxSigInfo "" UBYTE Com_InvValueIdxOfTxSigInfoType 0 0 0 255 ECU_ADDRESS 0x0 /end MEASUREMENT
/begin MEASUREMENT Com_TxSigInfo[37].InvValueOfTxSigInfo "" UBYTE Com_InvValueOfTxSigInfoType 0 0 0 255 ECU_ADDRESS 0x0 /end MEASUREMENT
/begin MEASUREMENT Com_TxSigInfo[37].OnChangeIdxOfTxSigInfo "" UBYTE Com_OnChangeIdxOfTxSigInfoType 0 0 0 255 ECU_ADDRESS 0x0 /end MEASUREMENT
/begin MEASUREMENT Com_TxSigInfo[37].OnChangeOfTxSigInfo "" UBYTE Com_OnChangeOfTxSigInfoType 0 0 0 255 ECU_ADDRESS 0x0 /end MEASUREMENT
/begin MEASUREMENT Com_TxSigInfo[37].StartByteInPduPositionOfTxSigInfo "" UBYTE NO_COMPU_METHOD 0 0 0 255 ECU_ADDRESS 0x0 /end MEASUREMENT
/begin MEASUREMENT Com_TxSigInfo[37].TxAccessInfoIdxOfTxSigInfo "" UWORD NO_COMPU_METHOD 0 0 0 65535 ECU_ADDRESS 0x0 /end MEASUREMENT
/begin MEASUREMENT Com_TxSigInfo[37].TxBufferEndIdxOfTxSigInfo "" UWORD Com_TxBufferEndIdxOfTxSigInfoType 0 0 0 65535 ECU_ADDRESS 0x0 /end MEASUREMENT
/begin MEASUREMENT Com_TxSigInfo[37].TxBufferStartIdxOfTxSigInfo "" UWORD Com_TxBufferStartIdxOfTxSigInfoType 0 0 0 65535 ECU_ADDRESS 0x0 /end MEASUREMENT
/begin MEASUREMENT Com_TxSigInfo[37].TxFilterInitValueArrayBasedFilterInitValueEndIdxOfTxSigInfo "" UBYTE Com_TxFilterInitValueArrayBasedFilterInitValueEndIdxOfTxSigInfoType 0 0 0 255 ECU_ADDRESS 0x0 /end MEASUREMENT
/begin MEASUREMENT Com_TxSigInfo[37].TxFilterInitValueArrayBasedFilterInitValueStartIdxOfTxSigInfo "" UBYTE Com_TxFilterInitValueArrayBasedFilterInitValueStartIdxOfTxSigInfoType 0 0 0 255 ECU_ADDRESS 0x0 /end MEASUREMENT
/begin MEASUREMENT Com_TxSigInfo[37].TxPduInfoIdxOfTxSigInfo "" UBYTE NO_COMPU_METHOD 0 0 0 255 ECU_ADDRESS 0x0 /end MEASUREMENT
/begin MEASUREMENT Com_TxSigInfo[380].ApplTypeOfTxSigInfo "" UBYTE Com_ApplTypeOfTxSigInfoType 0 0 0 255 ECU_ADDRESS 0x0 /end MEASUREMENT
/begin MEASUREMENT Com_TxSigInfo[380].BitLengthOfTxSigInfo "" UWORD NO_COMPU_METHOD 0 0 0 65535 ECU_ADDRESS 0x0 /end MEASUREMENT
/begin MEASUREMENT Com_TxSigInfo[380].BitPositionOfTxSigInfo "" UWORD NO_COMPU_METHOD 0 0 0 65535 ECU_ADDRESS 0x0 /end MEASUREMENT
/begin MEASUREMENT Com_TxSigInfo[380].BusAccOfTxSigInfo "" UBYTE Com_BusAccOfTxSigInfoType 0 0 0 255 ECU_ADDRESS 0x0 /end MEASUREMENT
/begin MEASUREMENT Com_TxSigInfo[380].ByteLengthOfTxSigInfo "" UBYTE NO_COMPU_METHOD 0 0 0 255 ECU_ADDRESS 0x0 /end MEASUREMENT
/begin MEASUREMENT Com_TxSigInfo[380].DynSignalOfTxSigInfo "" UBYTE Com_DynSignalOfTxSigInfoType 0 0 0 1 ECU_ADDRESS 0x0 /end MEASUREMENT
/begin MEASUREMENT Com_TxSigInfo[380].FilterInitValueIdxOfTxSigInfo "" UBYTE Com_FilterInitValueIdxOfTxSigInfoType 0 0 0 255 ECU_ADDRESS 0x0 /end MEASUREMENT
/begin MEASUREMENT Com_TxSigInfo[380].FilterInitValueOfTxSigInfo "" UBYTE Com_FilterInitValueOfTxSigInfoType 0 0 0 255 ECU_ADDRESS 0x0 /end MEASUREMENT
/begin MEASUREMENT Com_TxSigInfo[380].InvValueIdxOfTxSigInfo "" UBYTE Com_InvValueIdxOfTxSigInfoType 0 0 0 255 ECU_ADDRESS 0x0 /end MEASUREMENT
/begin MEASUREMENT Com_TxSigInfo[380].InvValueOfTxSigInfo "" UBYTE Com_InvValueOfTxSigInfoType 0 0 0 255 ECU_ADDRESS 0x0 /end MEASUREMENT
/begin MEASUREMENT Com_TxSigInfo[380].OnChangeIdxOfTxSigInfo "" UBYTE Com_OnChangeIdxOfTxSigInfoType 0 0 0 255 ECU_ADDRESS 0x0 /end MEASUREMENT
/begin MEASUREMENT Com_TxSigInfo[380].OnChangeOfTxSigInfo "" UBYTE Com_OnChangeOfTxSigInfoType 0 0 0 255 ECU_ADDRESS 0x0 /end MEASUREMENT
/begin MEASUREMENT Com_TxSigInfo[380].StartByteInPduPositionOfTxSigInfo "" UBYTE NO_COMPU_METHOD 0 0 0 255 ECU_ADDRESS 0x0 /end MEASUREMENT
/begin MEASUREMENT Com_TxSigInfo[380].TxAccessInfoIdxOfTxSigInfo "" UWORD NO_COMPU_METHOD 0 0 0 65535 ECU_ADDRESS 0x0 /end MEASUREMENT
/begin MEASUREMENT Com_TxSigInfo[380].TxBufferEndIdxOfTxSigInfo "" UWORD Com_TxBufferEndIdxOfTxSigInfoType 0 0 0 65535 ECU_ADDRESS 0x0 /end MEASUREMENT
/begin MEASUREMENT Com_TxSigInfo[380].TxBufferStartIdxOfTxSigInfo "" UWORD Com_TxBufferStartIdxOfTxSigInfoType 0 0 0 65535 ECU_ADDRESS 0x0 /end MEASUREMENT
/begin MEASUREMENT Com_TxSigInfo[380].TxFilterInitValueArrayBasedFilterInitValueEndIdxOfTxSigInfo "" UBYTE Com_TxFilterInitValueArrayBasedFilterInitValueEndIdxOfTxSigInfoType 0 0 0 255 ECU_ADDRESS 0x0 /end MEASUREMENT
/begin MEASUREMENT Com_TxSigInfo[380].TxFilterInitValueArrayBasedFilterInitValueStartIdxOfTxSigInfo "" UBYTE Com_TxFilterInitValueArrayBasedFilterInitValueStartIdxOfTxSigInfoType 0 0 0 255 ECU_ADDRESS 0x0 /end MEASUREMENT
/begin MEASUREMENT Com_TxSigInfo[380].TxPduInfoIdxOfTxSigInfo "" UBYTE NO_COMPU_METHOD 0 0 0 255 ECU_ADDRESS 0x0 /end MEASUREMENT
/begin MEASUREMENT Com_TxSigInfo[381].ApplTypeOfTxSigInfo "" UBYTE Com_ApplTypeOfTxSigInfoType 0 0 0 255 ECU_ADDRESS 0x0 /end MEASUREMENT
/begin MEASUREMENT Com_TxSigInfo[381].BitLengthOfTxSigInfo "" UWORD NO_COMPU_METHOD 0 0 0 65535 ECU_ADDRESS 0x0 /end MEASUREMENT
/begin MEASUREMENT Com_TxSigInfo[381].BitPositionOfTxSigInfo "" UWORD NO_COMPU_METHOD 0 0 0 65535 ECU_ADDRESS 0x0 /end MEASUREMENT
/begin MEASUREMENT Com_TxSigInfo[381].BusAccOfTxSigInfo "" UBYTE Com_BusAccOfTxSigInfoType 0 0 0 255 ECU_ADDRESS 0x0 /end MEASUREMENT
/begin MEASUREMENT Com_TxSigInfo[381].ByteLengthOfTxSigInfo "" UBYTE NO_COMPU_METHOD 0 0 0 255 ECU_ADDRESS 0x0 /end MEASUREMENT
/begin MEASUREMENT Com_TxSigInfo[381].DynSignalOfTxSigInfo "" UBYTE Com_DynSignalOfTxSigInfoType 0 0 0 1 ECU_ADDRESS 0x0 /end MEASUREMENT
/begin MEASUREMENT Com_TxSigInfo[381].FilterInitValueIdxOfTxSigInfo "" UBYTE Com_FilterInitValueIdxOfTxSigInfoType 0 0 0 255 ECU_ADDRESS 0x0 /end MEASUREMENT
/begin MEASUREMENT Com_TxSigInfo[381].FilterInitValueOfTxSigInfo "" UBYTE Com_FilterInitValueOfTxSigInfoType 0 0 0 255 ECU_ADDRESS 0x0 /end MEASUREMENT
/begin MEASUREMENT Com_TxSigInfo[381].InvValueIdxOfTxSigInfo "" UBYTE Com_InvValueIdxOfTxSigInfoType 0 0 0 255 ECU_ADDRESS 0x0 /end MEASUREMENT
/begin MEASUREMENT Com_TxSigInfo[381].InvValueOfTxSigInfo "" UBYTE Com_InvValueOfTxSigInfoType 0 0 0 255 ECU_ADDRESS 0x0 /end MEASUREMENT
/begin MEASUREMENT Com_TxSigInfo[381].OnChangeIdxOfTxSigInfo "" UBYTE Com_OnChangeIdxOfTxSigInfoType 0 0 0 255 ECU_ADDRESS 0x0 /end MEASUREMENT
/begin MEASUREMENT Com_TxSigInfo[381].OnChangeOfTxSigInfo "" UBYTE Com_OnChangeOfTxSigInfoType 0 0 0 255 ECU_ADDRESS 0x0 /end MEASUREMENT
/begin MEASUREMENT Com_TxSigInfo[381].StartByteInPduPositionOfTxSigInfo "" UBYTE NO_COMPU_METHOD 0 0 0 255 ECU_ADDRESS 0x0 /end MEASUREMENT
/begin MEASUREMENT Com_TxSigInfo[381].TxAccessInfoIdxOfTxSigInfo "" UWORD NO_COMPU_METHOD 0 0 0 65535 ECU_ADDRESS 0x0 /end MEASUREMENT
/begin MEASUREMENT Com_TxSigInfo[381].TxBufferEndIdxOfTxSigInfo "" UWORD Com_TxBufferEndIdxOfTxSigInfoType 0 0 0 65535 ECU_ADDRESS 0x0 /end MEASUREMENT
/begin MEASUREMENT Com_TxSigInfo[381].TxBufferStartIdxOfTxSigInfo "" UWORD Com_TxBufferStartIdxOfTxSigInfoType 0 0 0 65535 ECU_ADDRESS 0x0 /end MEASUREMENT
/begin MEASUREMENT Com_TxSigInfo[381].TxFilterInitValueArrayBasedFilterInitValueEndIdxOfTxSigInfo "" UBYTE Com_TxFilterInitValueArrayBasedFilterInitValueEndIdxOfTxSigInfoType 0 0 0 255 ECU_ADDRESS 0x0 /end MEASUREMENT
/begin MEASUREMENT Com_TxSigInfo[381].TxFilterInitValueArrayBasedFilterInitValueStartIdxOfTxSigInfo "" UBYTE Com_TxFilterInitValueArrayBasedFilterInitValueStartIdxOfTxSigInfoType 0 0 0 255 ECU_ADDRESS 0x0 /end MEASUREMENT
/begin MEASUREMENT Com_TxSigInfo[381].TxPduInfoIdxOfTxSigInfo "" UBYTE NO_COMPU_METHOD 0 0 0 255 ECU_ADDRESS 0x0 /end MEASUREMENT
/begin MEASUREMENT Com_TxSigInfo[382].ApplTypeOfTxSigInfo "" UBYTE Com_ApplTypeOfTxSigInfoType 0 0 0 255 ECU_ADDRESS 0x0 /end MEASUREMENT
/begin MEASUREMENT Com_TxSigInfo[382].BitLengthOfTxSigInfo "" UWORD NO_COMPU_METHOD 0 0 0 65535 ECU_ADDRESS 0x0 /end MEASUREMENT
/begin MEASUREMENT Com_TxSigInfo[382].BitPositionOfTxSigInfo "" UWORD NO_COMPU_METHOD 0 0 0 65535 ECU_ADDRESS 0x0 /end MEASUREMENT
/begin MEASUREMENT Com_TxSigInfo[382].BusAccOfTxSigInfo "" UBYTE Com_BusAccOfTxSigInfoType 0 0 0 255 ECU_ADDRESS 0x0 /end MEASUREMENT
/begin MEASUREMENT Com_TxSigInfo[382].ByteLengthOfTxSigInfo "" UBYTE NO_COMPU_METHOD 0 0 0 255 ECU_ADDRESS 0x0 /end MEASUREMENT
/begin MEASUREMENT Com_TxSigInfo[382].DynSignalOfTxSigInfo "" UBYTE Com_DynSignalOfTxSigInfoType 0 0 0 1 ECU_ADDRESS 0x0 /end MEASUREMENT
/begin MEASUREMENT Com_TxSigInfo[382].FilterInitValueIdxOfTxSigInfo "" UBYTE Com_FilterInitValueIdxOfTxSigInfoType 0 0 0 255 ECU_ADDRESS 0x0 /end MEASUREMENT
/begin MEASUREMENT Com_TxSigInfo[382].FilterInitValueOfTxSigInfo "" UBYTE Com_FilterInitValueOfTxSigInfoType 0 0 0 255 ECU_ADDRESS 0x0 /end MEASUREMENT
/begin MEASUREMENT Com_TxSigInfo[382].InvValueIdxOfTxSigInfo "" UBYTE Com_InvValueIdxOfTxSigInfoType 0 0 0 255 ECU_ADDRESS 0x0 /end MEASUREMENT
/begin MEASUREMENT Com_TxSigInfo[382].InvValueOfTxSigInfo "" UBYTE Com_InvValueOfTxSigInfoType 0 0 0 255 ECU_ADDRESS 0x0 /end MEASUREMENT
/begin MEASUREMENT Com_TxSigInfo[382].OnChangeIdxOfTxSigInfo "" UBYTE Com_OnChangeIdxOfTxSigInfoType 0 0 0 255 ECU_ADDRESS 0x0 /end MEASUREMENT
/begin MEASUREMENT Com_TxSigInfo[382].OnChangeOfTxSigInfo "" UBYTE Com_OnChangeOfTxSigInfoType 0 0 0 255 ECU_ADDRESS 0x0 /end MEASUREMENT
/begin MEASUREMENT Com_TxSigInfo[382].StartByteInPduPositionOfTxSigInfo "" UBYTE NO_COMPU_METHOD 0 0 0 255 ECU_ADDRESS 0x0 /end MEASUREMENT
/begin MEASUREMENT Com_TxSigInfo[382].TxAccessInfoIdxOfTxSigInfo "" UWORD NO_COMPU_METHOD 0 0 0 65535 ECU_ADDRESS 0x0 /end MEASUREMENT
/begin MEASUREMENT Com_TxSigInfo[382].TxBufferEndIdxOfTxSigInfo "" UWORD Com_TxBufferEndIdxOfTxSigInfoType 0 0 0 65535 ECU_ADDRESS 0x0 /end MEASUREMENT
/begin MEASUREMENT Com_TxSigInfo[382].TxBufferStartIdxOfTxSigInfo "" UWORD Com_TxBufferStartIdxOfTxSigInfoType 0 0 0 65535 ECU_ADDRESS 0x0 /end MEASUREMENT
/begin MEASUREMENT Com_TxSigInfo[382].TxFilterInitValueArrayBasedFilterInitValueEndIdxOfTxSigInfo "" UBYTE Com_TxFilterInitValueArrayBasedFilterInitValueEndIdxOfTxSigInfoType 0 0 0 255 ECU_ADDRESS 0x0 /end MEASUREMENT
/begin MEASUREMENT Com_TxSigInfo[382].TxFilterInitValueArrayBasedFilterInitValueStartIdxOfTxSigInfo "" UBYTE Com_TxFilterInitValueArrayBasedFilterInitValueStartIdxOfTxSigInfoType 0 0 0 255 ECU_ADDRESS 0x0 /end MEASUREMENT
/begin MEASUREMENT Com_TxSigInfo[382].TxPduInfoIdxOfTxSigInfo "" UBYTE NO_COMPU_METHOD 0 0 0 255 ECU_ADDRESS 0x0 /end MEASUREMENT
/begin MEASUREMENT Com_TxSigInfo[383].ApplTypeOfTxSigInfo "" UBYTE Com_ApplTypeOfTxSigInfoType 0 0 0 255 ECU_ADDRESS 0x0 /end MEASUREMENT
/begin MEASUREMENT Com_TxSigInfo[383].BitLengthOfTxSigInfo "" UWORD NO_COMPU_METHOD 0 0 0 65535 ECU_ADDRESS 0x0 /end MEASUREMENT
/begin MEASUREMENT Com_TxSigInfo[383].BitPositionOfTxSigInfo "" UWORD NO_COMPU_METHOD 0 0 0 65535 ECU_ADDRESS 0x0 /end MEASUREMENT
/begin MEASUREMENT Com_TxSigInfo[383].BusAccOfTxSigInfo "" UBYTE Com_BusAccOfTxSigInfoType 0 0 0 255 ECU_ADDRESS 0x0 /end MEASUREMENT
/begin MEASUREMENT Com_TxSigInfo[383].ByteLengthOfTxSigInfo "" UBYTE NO_COMPU_METHOD 0 0 0 255 ECU_ADDRESS 0x0 /end MEASUREMENT
/begin MEASUREMENT Com_TxSigInfo[383].DynSignalOfTxSigInfo "" UBYTE Com_DynSignalOfTxSigInfoType 0 0 0 1 ECU_ADDRESS 0x0 /end MEASUREMENT
/begin MEASUREMENT Com_TxSigInfo[383].FilterInitValueIdxOfTxSigInfo "" UBYTE Com_FilterInitValueIdxOfTxSigInfoType 0 0 0 255 ECU_ADDRESS 0x0 /end MEASUREMENT
/begin MEASUREMENT Com_TxSigInfo[383].FilterInitValueOfTxSigInfo "" UBYTE Com_FilterInitValueOfTxSigInfoType 0 0 0 255 ECU_ADDRESS 0x0 /end MEASUREMENT
/begin MEASUREMENT Com_TxSigInfo[383].InvValueIdxOfTxSigInfo "" UBYTE Com_InvValueIdxOfTxSigInfoType 0 0 0 255 ECU_ADDRESS 0x0 /end MEASUREMENT
/begin MEASUREMENT Com_TxSigInfo[383].InvValueOfTxSigInfo "" UBYTE Com_InvValueOfTxSigInfoType 0 0 0 255 ECU_ADDRESS 0x0 /end MEASUREMENT
/begin MEASUREMENT Com_TxSigInfo[383].OnChangeIdxOfTxSigInfo "" UBYTE Com_OnChangeIdxOfTxSigInfoType 0 0 0 255 ECU_ADDRESS 0x0 /end MEASUREMENT
/begin MEASUREMENT Com_TxSigInfo[383].OnChangeOfTxSigInfo "" UBYTE Com_OnChangeOfTxSigInfoType 0 0 0 255 ECU_ADDRESS 0x0 /end MEASUREMENT
/begin MEASUREMENT Com_TxSigInfo[383].StartByteInPduPositionOfTxSigInfo "" UBYTE NO_COMPU_METHOD 0 0 0 255 ECU_ADDRESS 0x0 /end MEASUREMENT
/begin MEASUREMENT Com_TxSigInfo[383].TxAccessInfoIdxOfTxSigInfo "" UWORD NO_COMPU_METHOD 0 0 0 65535 ECU_ADDRESS 0x0 /end MEASUREMENT
/begin MEASUREMENT Com_TxSigInfo[383].TxBufferEndIdxOfTxSigInfo "" UWORD Com_TxBufferEndIdxOfTxSigInfoType 0 0 0 65535 ECU_ADDRESS 0x0 /end MEASUREMENT
/begin MEASUREMENT Com_TxSigInfo[383].TxBufferStartIdxOfTxSigInfo "" UWORD Com_TxBufferStartIdxOfTxSigInfoType 0 0 0 65535 ECU_ADDRESS 0x0 /end MEASUREMENT
/begin MEASUREMENT Com_TxSigInfo[383].TxFilterInitValueArrayBasedFilterInitValueEndIdxOfTxSigInfo "" UBYTE Com_TxFilterInitValueArrayBasedFilterInitValueEndIdxOfTxSigInfoType 0 0 0 255 ECU_ADDRESS 0x0 /end MEASUREMENT
/begin MEASUREMENT Com_TxSigInfo[383].TxFilterInitValueArrayBasedFilterInitValueStartIdxOfTxSigInfo "" UBYTE Com_TxFilterInitValueArrayBasedFilterInitValueStartIdxOfTxSigInfoType 0 0 0 255 ECU_ADDRESS 0x0 /end MEASUREMENT
/begin MEASUREMENT Com_TxSigInfo[383].TxPduInfoIdxOfTxSigInfo "" UBYTE NO_COMPU_METHOD 0 0 0 255 ECU_ADDRESS 0x0 /end MEASUREMENT
/begin MEASUREMENT Com_TxSigInfo[384].ApplTypeOfTxSigInfo "" UBYTE Com_ApplTypeOfTxSigInfoType 0 0 0 255 ECU_ADDRESS 0x0 /end MEASUREMENT
/begin MEASUREMENT Com_TxSigInfo[384].BitLengthOfTxSigInfo "" UWORD NO_COMPU_METHOD 0 0 0 65535 ECU_ADDRESS 0x0 /end MEASUREMENT
/begin MEASUREMENT Com_TxSigInfo[384].BitPositionOfTxSigInfo "" UWORD NO_COMPU_METHOD 0 0 0 65535 ECU_ADDRESS 0x0 /end MEASUREMENT
/begin MEASUREMENT Com_TxSigInfo[384].BusAccOfTxSigInfo "" UBYTE Com_BusAccOfTxSigInfoType 0 0 0 255 ECU_ADDRESS 0x0 /end MEASUREMENT
/begin MEASUREMENT Com_TxSigInfo[384].ByteLengthOfTxSigInfo "" UBYTE NO_COMPU_METHOD 0 0 0 255 ECU_ADDRESS 0x0 /end MEASUREMENT
/begin MEASUREMENT Com_TxSigInfo[384].DynSignalOfTxSigInfo "" UBYTE Com_DynSignalOfTxSigInfoType 0 0 0 1 ECU_ADDRESS 0x0 /end MEASUREMENT
/begin MEASUREMENT Com_TxSigInfo[384].FilterInitValueIdxOfTxSigInfo "" UBYTE Com_FilterInitValueIdxOfTxSigInfoType 0 0 0 255 ECU_ADDRESS 0x0 /end MEASUREMENT
/begin MEASUREMENT Com_TxSigInfo[384].FilterInitValueOfTxSigInfo "" UBYTE Com_FilterInitValueOfTxSigInfoType 0 0 0 255 ECU_ADDRESS 0x0 /end MEASUREMENT
/begin MEASUREMENT Com_TxSigInfo[384].InvValueIdxOfTxSigInfo "" UBYTE Com_InvValueIdxOfTxSigInfoType 0 0 0 255 ECU_ADDRESS 0x0 /end MEASUREMENT
/begin MEASUREMENT Com_TxSigInfo[384].InvValueOfTxSigInfo "" UBYTE Com_InvValueOfTxSigInfoType 0 0 0 255 ECU_ADDRESS 0x0 /end MEASUREMENT
/begin MEASUREMENT Com_TxSigInfo[384].OnChangeIdxOfTxSigInfo "" UBYTE Com_OnChangeIdxOfTxSigInfoType 0 0 0 255 ECU_ADDRESS 0x0 /end MEASUREMENT
/begin MEASUREMENT Com_TxSigInfo[384].OnChangeOfTxSigInfo "" UBYTE Com_OnChangeOfTxSigInfoType 0 0 0 255 ECU_ADDRESS 0x0 /end MEASUREMENT
/begin MEASUREMENT Com_TxSigInfo[384].StartByteInPduPositionOfTxSigInfo "" UBYTE NO_COMPU_METHOD 0 0 0 255 ECU_ADDRESS 0x0 /end MEASUREMENT
/begin MEASUREMENT Com_TxSigInfo[384].TxAccessInfoIdxOfTxSigInfo "" UWORD NO_COMPU_METHOD 0 0 0 65535 ECU_ADDRESS 0x0 /end MEASUREMENT
/begin MEASUREMENT Com_TxSigInfo[384].TxBufferEndIdxOfTxSigInfo "" UWORD Com_TxBufferEndIdxOfTxSigInfoType 0 0 0 65535 ECU_ADDRESS 0x0 /end MEASUREMENT
/begin MEASUREMENT Com_TxSigInfo[384].TxBufferStartIdxOfTxSigInfo "" UWORD Com_TxBufferStartIdxOfTxSigInfoType 0 0 0 65535 ECU_ADDRESS 0x0 /end MEASUREMENT
/begin MEASUREMENT Com_TxSigInfo[384].TxFilterInitValueArrayBasedFilterInitValueEndIdxOfTxSigInfo "" UBYTE Com_TxFilterInitValueArrayBasedFilterInitValueEndIdxOfTxSigInfoType 0 0 0 255 ECU_ADDRESS 0x0 /end MEASUREMENT
/begin MEASUREMENT Com_TxSigInfo[384].TxFilterInitValueArrayBasedFilterInitValueStartIdxOfTxSigInfo "" UBYTE Com_TxFilterInitValueArrayBasedFilterInitValueStartIdxOfTxSigInfoType 0 0 0 255 ECU_ADDRESS 0x0 /end MEASUREMENT
/begin MEASUREMENT Com_TxSigInfo[384].TxPduInfoIdxOfTxSigInfo "" UBYTE NO_COMPU_METHOD 0 0 0 255 ECU_ADDRESS 0x0 /end MEASUREMENT
/begin MEASUREMENT Com_TxSigInfo[385].ApplTypeOfTxSigInfo "" UBYTE Com_ApplTypeOfTxSigInfoType 0 0 0 255 ECU_ADDRESS 0x0 /end MEASUREMENT
/begin MEASUREMENT Com_TxSigInfo[385].BitLengthOfTxSigInfo "" UWORD NO_COMPU_METHOD 0 0 0 65535 ECU_ADDRESS 0x0 /end MEASUREMENT
/begin MEASUREMENT Com_TxSigInfo[385].BitPositionOfTxSigInfo "" UWORD NO_COMPU_METHOD 0 0 0 65535 ECU_ADDRESS 0x0 /end MEASUREMENT
/begin MEASUREMENT Com_TxSigInfo[385].BusAccOfTxSigInfo "" UBYTE Com_BusAccOfTxSigInfoType 0 0 0 255 ECU_ADDRESS 0x0 /end MEASUREMENT
/begin MEASUREMENT Com_TxSigInfo[385].ByteLengthOfTxSigInfo "" UBYTE NO_COMPU_METHOD 0 0 0 255 ECU_ADDRESS 0x0 /end MEASUREMENT
/begin MEASUREMENT Com_TxSigInfo[385].DynSignalOfTxSigInfo "" UBYTE Com_DynSignalOfTxSigInfoType 0 0 0 1 ECU_ADDRESS 0x0 /end MEASUREMENT
/begin MEASUREMENT Com_TxSigInfo[385].FilterInitValueIdxOfTxSigInfo "" UBYTE Com_FilterInitValueIdxOfTxSigInfoType 0 0 0 255 ECU_ADDRESS 0x0 /end MEASUREMENT
/begin MEASUREMENT Com_TxSigInfo[385].FilterInitValueOfTxSigInfo "" UBYTE Com_FilterInitValueOfTxSigInfoType 0 0 0 255 ECU_ADDRESS 0x0 /end MEASUREMENT
/begin MEASUREMENT Com_TxSigInfo[385].InvValueIdxOfTxSigInfo "" UBYTE Com_InvValueIdxOfTxSigInfoType 0 0 0 255 ECU_ADDRESS 0x0 /end MEASUREMENT
/begin MEASUREMENT Com_TxSigInfo[385].InvValueOfTxSigInfo "" UBYTE Com_InvValueOfTxSigInfoType 0 0 0 255 ECU_ADDRESS 0x0 /end MEASUREMENT
/begin MEASUREMENT Com_TxSigInfo[385].OnChangeIdxOfTxSigInfo "" UBYTE Com_OnChangeIdxOfTxSigInfoType 0 0 0 255 ECU_ADDRESS 0x0 /end MEASUREMENT
/begin MEASUREMENT Com_TxSigInfo[385].OnChangeOfTxSigInfo "" UBYTE Com_OnChangeOfTxSigInfoType 0 0 0 255 ECU_ADDRESS 0x0 /end MEASUREMENT
/begin MEASUREMENT Com_TxSigInfo[385].StartByteInPduPositionOfTxSigInfo "" UBYTE NO_COMPU_METHOD 0 0 0 255 ECU_ADDRESS 0x0 /end MEASUREMENT
/begin MEASUREMENT Com_TxSigInfo[385].TxAccessInfoIdxOfTxSigInfo "" UWORD NO_COMPU_METHOD 0 0 0 65535 ECU_ADDRESS 0x0 /end MEASUREMENT
/begin MEASUREMENT Com_TxSigInfo[385].TxBufferEndIdxOfTxSigInfo "" UWORD Com_TxBufferEndIdxOfTxSigInfoType 0 0 0 65535 ECU_ADDRESS 0x0 /end MEASUREMENT
/begin MEASUREMENT Com_TxSigInfo[385].TxBufferStartIdxOfTxSigInfo "" UWORD Com_TxBufferStartIdxOfTxSigInfoType 0 0 0 65535 ECU_ADDRESS 0x0 /end MEASUREMENT
/begin MEASUREMENT Com_TxSigInfo[385].TxFilterInitValueArrayBasedFilterInitValueEndIdxOfTxSigInfo "" UBYTE Com_TxFilterInitValueArrayBasedFilterInitValueEndIdxOfTxSigInfoType 0 0 0 255 ECU_ADDRESS 0x0 /end MEASUREMENT
/begin MEASUREMENT Com_TxSigInfo[385].TxFilterInitValueArrayBasedFilterInitValueStartIdxOfTxSigInfo "" UBYTE Com_TxFilterInitValueArrayBasedFilterInitValueStartIdxOfTxSigInfoType 0 0 0 255 ECU_ADDRESS 0x0 /end MEASUREMENT
/begin MEASUREMENT Com_TxSigInfo[385].TxPduInfoIdxOfTxSigInfo "" UBYTE NO_COMPU_METHOD 0 0 0 255 ECU_ADDRESS 0x0 /end MEASUREMENT
/begin MEASUREMENT Com_TxSigInfo[386].ApplTypeOfTxSigInfo "" UBYTE Com_ApplTypeOfTxSigInfoType 0 0 0 255 ECU_ADDRESS 0x0 /end MEASUREMENT
/begin MEASUREMENT Com_TxSigInfo[386].BitLengthOfTxSigInfo "" UWORD NO_COMPU_METHOD 0 0 0 65535 ECU_ADDRESS 0x0 /end MEASUREMENT
/begin MEASUREMENT Com_TxSigInfo[386].BitPositionOfTxSigInfo "" UWORD NO_COMPU_METHOD 0 0 0 65535 ECU_ADDRESS 0x0 /end MEASUREMENT
/begin MEASUREMENT Com_TxSigInfo[386].BusAccOfTxSigInfo "" UBYTE Com_BusAccOfTxSigInfoType 0 0 0 255 ECU_ADDRESS 0x0 /end MEASUREMENT
/begin MEASUREMENT Com_TxSigInfo[386].ByteLengthOfTxSigInfo "" UBYTE NO_COMPU_METHOD 0 0 0 255 ECU_ADDRESS 0x0 /end MEASUREMENT
/begin MEASUREMENT Com_TxSigInfo[386].DynSignalOfTxSigInfo "" UBYTE Com_DynSignalOfTxSigInfoType 0 0 0 1 ECU_ADDRESS 0x0 /end MEASUREMENT
/begin MEASUREMENT Com_TxSigInfo[386].FilterInitValueIdxOfTxSigInfo "" UBYTE Com_FilterInitValueIdxOfTxSigInfoType 0 0 0 255 ECU_ADDRESS 0x0 /end MEASUREMENT
/begin MEASUREMENT Com_TxSigInfo[386].FilterInitValueOfTxSigInfo "" UBYTE Com_FilterInitValueOfTxSigInfoType 0 0 0 255 ECU_ADDRESS 0x0 /end MEASUREMENT
/begin MEASUREMENT Com_TxSigInfo[386].InvValueIdxOfTxSigInfo "" UBYTE Com_InvValueIdxOfTxSigInfoType 0 0 0 255 ECU_ADDRESS 0x0 /end MEASUREMENT
/begin MEASUREMENT Com_TxSigInfo[386].InvValueOfTxSigInfo "" UBYTE Com_InvValueOfTxSigInfoType 0 0 0 255 ECU_ADDRESS 0x0 /end MEASUREMENT
/begin MEASUREMENT Com_TxSigInfo[386].OnChangeIdxOfTxSigInfo "" UBYTE Com_OnChangeIdxOfTxSigInfoType 0 0 0 255 ECU_ADDRESS 0x0 /end MEASUREMENT
/begin MEASUREMENT Com_TxSigInfo[386].OnChangeOfTxSigInfo "" UBYTE Com_OnChangeOfTxSigInfoType 0 0 0 255 ECU_ADDRESS 0x0 /end MEASUREMENT
/begin MEASUREMENT Com_TxSigInfo[386].StartByteInPduPositionOfTxSigInfo "" UBYTE NO_COMPU_METHOD 0 0 0 255 ECU_ADDRESS 0x0 /end MEASUREMENT
/begin MEASUREMENT Com_TxSigInfo[386].TxAccessInfoIdxOfTxSigInfo "" UWORD NO_COMPU_METHOD 0 0 0 65535 ECU_ADDRESS 0x0 /end MEASUREMENT
/begin MEASUREMENT Com_TxSigInfo[386].TxBufferEndIdxOfTxSigInfo "" UWORD Com_TxBufferEndIdxOfTxSigInfoType 0 0 0 65535 ECU_ADDRESS 0x0 /end MEASUREMENT
/begin MEASUREMENT Com_TxSigInfo[386].TxBufferStartIdxOfTxSigInfo "" UWORD Com_TxBufferStartIdxOfTxSigInfoType 0 0 0 65535 ECU_ADDRESS 0x0 /end MEASUREMENT
/begin MEASUREMENT Com_TxSigInfo[386].TxFilterInitValueArrayBasedFilterInitValueEndIdxOfTxSigInfo "" UBYTE Com_TxFilterInitValueArrayBasedFilterInitValueEndIdxOfTxSigInfoType 0 0 0 255 ECU_ADDRESS 0x0 /end MEASUREMENT
/begin MEASUREMENT Com_TxSigInfo[386].TxFilterInitValueArrayBasedFilterInitValueStartIdxOfTxSigInfo "" UBYTE Com_TxFilterInitValueArrayBasedFilterInitValueStartIdxOfTxSigInfoType 0 0 0 255 ECU_ADDRESS 0x0 /end MEASUREMENT
/begin MEASUREMENT Com_TxSigInfo[386].TxPduInfoIdxOfTxSigInfo "" UBYTE NO_COMPU_METHOD 0 0 0 255 ECU_ADDRESS 0x0 /end MEASUREMENT
/begin MEASUREMENT Com_TxSigInfo[387].ApplTypeOfTxSigInfo "" UBYTE Com_ApplTypeOfTxSigInfoType 0 0 0 255 ECU_ADDRESS 0x0 /end MEASUREMENT
/begin MEASUREMENT Com_TxSigInfo[387].BitLengthOfTxSigInfo "" UWORD NO_COMPU_METHOD 0 0 0 65535 ECU_ADDRESS 0x0 /end MEASUREMENT
/begin MEASUREMENT Com_TxSigInfo[387].BitPositionOfTxSigInfo "" UWORD NO_COMPU_METHOD 0 0 0 65535 ECU_ADDRESS 0x0 /end MEASUREMENT
/begin MEASUREMENT Com_TxSigInfo[387].BusAccOfTxSigInfo "" UBYTE Com_BusAccOfTxSigInfoType 0 0 0 255 ECU_ADDRESS 0x0 /end MEASUREMENT
/begin MEASUREMENT Com_TxSigInfo[387].ByteLengthOfTxSigInfo "" UBYTE NO_COMPU_METHOD 0 0 0 255 ECU_ADDRESS 0x0 /end MEASUREMENT
/begin MEASUREMENT Com_TxSigInfo[387].DynSignalOfTxSigInfo "" UBYTE Com_DynSignalOfTxSigInfoType 0 0 0 1 ECU_ADDRESS 0x0 /end MEASUREMENT
/begin MEASUREMENT Com_TxSigInfo[387].FilterInitValueIdxOfTxSigInfo "" UBYTE Com_FilterInitValueIdxOfTxSigInfoType 0 0 0 255 ECU_ADDRESS 0x0 /end MEASUREMENT
/begin MEASUREMENT Com_TxSigInfo[387].FilterInitValueOfTxSigInfo "" UBYTE Com_FilterInitValueOfTxSigInfoType 0 0 0 255 ECU_ADDRESS 0x0 /end MEASUREMENT
/begin MEASUREMENT Com_TxSigInfo[387].InvValueIdxOfTxSigInfo "" UBYTE Com_InvValueIdxOfTxSigInfoType 0 0 0 255 ECU_ADDRESS 0x0 /end MEASUREMENT
/begin MEASUREMENT Com_TxSigInfo[387].InvValueOfTxSigInfo "" UBYTE Com_InvValueOfTxSigInfoType 0 0 0 255 ECU_ADDRESS 0x0 /end MEASUREMENT
/begin MEASUREMENT Com_TxSigInfo[387].OnChangeIdxOfTxSigInfo "" UBYTE Com_OnChangeIdxOfTxSigInfoType 0 0 0 255 ECU_ADDRESS 0x0 /end MEASUREMENT
/begin MEASUREMENT Com_TxSigInfo[387].OnChangeOfTxSigInfo "" UBYTE Com_OnChangeOfTxSigInfoType 0 0 0 255 ECU_ADDRESS 0x0 /end MEASUREMENT
/begin MEASUREMENT Com_TxSigInfo[387].StartByteInPduPositionOfTxSigInfo "" UBYTE NO_COMPU_METHOD 0 0 0 255 ECU_ADDRESS 0x0 /end MEASUREMENT
/begin MEASUREMENT Com_TxSigInfo[387].TxAccessInfoIdxOfTxSigInfo "" UWORD NO_COMPU_METHOD 0 0 0 65535 ECU_ADDRESS 0x0 /end MEASUREMENT
/begin MEASUREMENT Com_TxSigInfo[387].TxBufferEndIdxOfTxSigInfo "" UWORD Com_TxBufferEndIdxOfTxSigInfoType 0 0 0 65535 ECU_ADDRESS 0x0 /end MEASUREMENT
/begin MEASUREMENT Com_TxSigInfo[387].TxBufferStartIdxOfTxSigInfo "" UWORD Com_TxBufferStartIdxOfTxSigInfoType 0 0 0 65535 ECU_ADDRESS 0x0 /end MEASUREMENT
/begin MEASUREMENT Com_TxSigInfo[387].TxFilterInitValueArrayBasedFilterInitValueEndIdxOfTxSigInfo "" UBYTE Com_TxFilterInitValueArrayBasedFilterInitValueEndIdxOfTxSigInfoType 0 0 0 255 ECU_ADDRESS 0x0 /end MEASUREMENT
/begin MEASUREMENT Com_TxSigInfo[387].TxFilterInitValueArrayBasedFilterInitValueStartIdxOfTxSigInfo "" UBYTE Com_TxFilterInitValueArrayBasedFilterInitValueStartIdxOfTxSigInfoType 0 0 0 255 ECU_ADDRESS 0x0 /end MEASUREMENT
/begin MEASUREMENT Com_TxSigInfo[387].TxPduInfoIdxOfTxSigInfo "" UBYTE NO_COMPU_METHOD 0 0 0 255 ECU_ADDRESS 0x0 /end MEASUREMENT
/begin MEASUREMENT Com_TxSigInfo[388].ApplTypeOfTxSigInfo "" UBYTE Com_ApplTypeOfTxSigInfoType 0 0 0 255 ECU_ADDRESS 0x0 /end MEASUREMENT
/begin MEASUREMENT Com_TxSigInfo[388].BitLengthOfTxSigInfo "" UWORD NO_COMPU_METHOD 0 0 0 65535 ECU_ADDRESS 0x0 /end MEASUREMENT
/begin MEASUREMENT Com_TxSigInfo[388].BitPositionOfTxSigInfo "" UWORD NO_COMPU_METHOD 0 0 0 65535 ECU_ADDRESS 0x0 /end MEASUREMENT
/begin MEASUREMENT Com_TxSigInfo[388].BusAccOfTxSigInfo "" UBYTE Com_BusAccOfTxSigInfoType 0 0 0 255 ECU_ADDRESS 0x0 /end MEASUREMENT
/begin MEASUREMENT Com_TxSigInfo[388].ByteLengthOfTxSigInfo "" UBYTE NO_COMPU_METHOD 0 0 0 255 ECU_ADDRESS 0x0 /end MEASUREMENT
/begin MEASUREMENT Com_TxSigInfo[388].DynSignalOfTxSigInfo "" UBYTE Com_DynSignalOfTxSigInfoType 0 0 0 1 ECU_ADDRESS 0x0 /end MEASUREMENT
/begin MEASUREMENT Com_TxSigInfo[388].FilterInitValueIdxOfTxSigInfo "" UBYTE Com_FilterInitValueIdxOfTxSigInfoType 0 0 0 255 ECU_ADDRESS 0x0 /end MEASUREMENT
/begin MEASUREMENT Com_TxSigInfo[388].FilterInitValueOfTxSigInfo "" UBYTE Com_FilterInitValueOfTxSigInfoType 0 0 0 255 ECU_ADDRESS 0x0 /end MEASUREMENT
/begin MEASUREMENT Com_TxSigInfo[388].InvValueIdxOfTxSigInfo "" UBYTE Com_InvValueIdxOfTxSigInfoType 0 0 0 255 ECU_ADDRESS 0x0 /end MEASUREMENT
/begin MEASUREMENT Com_TxSigInfo[388].InvValueOfTxSigInfo "" UBYTE Com_InvValueOfTxSigInfoType 0 0 0 255 ECU_ADDRESS 0x0 /end MEASUREMENT
/begin MEASUREMENT Com_TxSigInfo[388].OnChangeIdxOfTxSigInfo "" UBYTE Com_OnChangeIdxOfTxSigInfoType 0 0 0 255 ECU_ADDRESS 0x0 /end MEASUREMENT
/begin MEASUREMENT Com_TxSigInfo[388].OnChangeOfTxSigInfo "" UBYTE Com_OnChangeOfTxSigInfoType 0 0 0 255 ECU_ADDRESS 0x0 /end MEASUREMENT
/begin MEASUREMENT Com_TxSigInfo[388].StartByteInPduPositionOfTxSigInfo "" UBYTE NO_COMPU_METHOD 0 0 0 255 ECU_ADDRESS 0x0 /end MEASUREMENT
/begin MEASUREMENT Com_TxSigInfo[388].TxAccessInfoIdxOfTxSigInfo "" UWORD NO_COMPU_METHOD 0 0 0 65535 ECU_ADDRESS 0x0 /end MEASUREMENT
/begin MEASUREMENT Com_TxSigInfo[388].TxBufferEndIdxOfTxSigInfo "" UWORD Com_TxBufferEndIdxOfTxSigInfoType 0 0 0 65535 ECU_ADDRESS 0x0 /end MEASUREMENT
/begin MEASUREMENT Com_TxSigInfo[388].TxBufferStartIdxOfTxSigInfo "" UWORD Com_TxBufferStartIdxOfTxSigInfoType 0 0 0 65535 ECU_ADDRESS 0x0 /end MEASUREMENT
/begin MEASUREMENT Com_TxSigInfo[388].TxFilterInitValueArrayBasedFilterInitValueEndIdxOfTxSigInfo "" UBYTE Com_TxFilterInitValueArrayBasedFilterInitValueEndIdxOfTxSigInfoType 0 0 0 255 ECU_ADDRESS 0x0 /end MEASUREMENT
/begin MEASUREMENT Com_TxSigInfo[388].TxFilterInitValueArrayBasedFilterInitValueStartIdxOfTxSigInfo "" UBYTE Com_TxFilterInitValueArrayBasedFilterInitValueStartIdxOfTxSigInfoType 0 0 0 255 ECU_ADDRESS 0x0 /end MEASUREMENT
/begin MEASUREMENT Com_TxSigInfo[388].TxPduInfoIdxOfTxSigInfo "" UBYTE NO_COMPU_METHOD 0 0 0 255 ECU_ADDRESS 0x0 /end MEASUREMENT
/begin MEASUREMENT Com_TxSigInfo[389].ApplTypeOfTxSigInfo "" UBYTE Com_ApplTypeOfTxSigInfoType 0 0 0 255 ECU_ADDRESS 0x0 /end MEASUREMENT
/begin MEASUREMENT Com_TxSigInfo[389].BitLengthOfTxSigInfo "" UWORD NO_COMPU_METHOD 0 0 0 65535 ECU_ADDRESS 0x0 /end MEASUREMENT
/begin MEASUREMENT Com_TxSigInfo[389].BitPositionOfTxSigInfo "" UWORD NO_COMPU_METHOD 0 0 0 65535 ECU_ADDRESS 0x0 /end MEASUREMENT
/begin MEASUREMENT Com_TxSigInfo[389].BusAccOfTxSigInfo "" UBYTE Com_BusAccOfTxSigInfoType 0 0 0 255 ECU_ADDRESS 0x0 /end MEASUREMENT
/begin MEASUREMENT Com_TxSigInfo[389].ByteLengthOfTxSigInfo "" UBYTE NO_COMPU_METHOD 0 0 0 255 ECU_ADDRESS 0x0 /end MEASUREMENT
/begin MEASUREMENT Com_TxSigInfo[389].DynSignalOfTxSigInfo "" UBYTE Com_DynSignalOfTxSigInfoType 0 0 0 1 ECU_ADDRESS 0x0 /end MEASUREMENT
/begin MEASUREMENT Com_TxSigInfo[389].FilterInitValueIdxOfTxSigInfo "" UBYTE Com_FilterInitValueIdxOfTxSigInfoType 0 0 0 255 ECU_ADDRESS 0x0 /end MEASUREMENT
/begin MEASUREMENT Com_TxSigInfo[389].FilterInitValueOfTxSigInfo "" UBYTE Com_FilterInitValueOfTxSigInfoType 0 0 0 255 ECU_ADDRESS 0x0 /end MEASUREMENT
/begin MEASUREMENT Com_TxSigInfo[389].InvValueIdxOfTxSigInfo "" UBYTE Com_InvValueIdxOfTxSigInfoType 0 0 0 255 ECU_ADDRESS 0x0 /end MEASUREMENT
/begin MEASUREMENT Com_TxSigInfo[389].InvValueOfTxSigInfo "" UBYTE Com_InvValueOfTxSigInfoType 0 0 0 255 ECU_ADDRESS 0x0 /end MEASUREMENT
/begin MEASUREMENT Com_TxSigInfo[389].OnChangeIdxOfTxSigInfo "" UBYTE Com_OnChangeIdxOfTxSigInfoType 0 0 0 255 ECU_ADDRESS 0x0 /end MEASUREMENT
/begin MEASUREMENT Com_TxSigInfo[389].OnChangeOfTxSigInfo "" UBYTE Com_OnChangeOfTxSigInfoType 0 0 0 255 ECU_ADDRESS 0x0 /end MEASUREMENT
/begin MEASUREMENT Com_TxSigInfo[389].StartByteInPduPositionOfTxSigInfo "" UBYTE NO_COMPU_METHOD 0 0 0 255 ECU_ADDRESS 0x0 /end MEASUREMENT
/begin MEASUREMENT Com_TxSigInfo[389].TxAccessInfoIdxOfTxSigInfo "" UWORD NO_COMPU_METHOD 0 0 0 65535 ECU_ADDRESS 0x0 /end MEASUREMENT
/begin MEASUREMENT Com_TxSigInfo[389].TxBufferEndIdxOfTxSigInfo "" UWORD Com_TxBufferEndIdxOfTxSigInfoType 0 0 0 65535 ECU_ADDRESS 0x0 /end MEASUREMENT
/begin MEASUREMENT Com_TxSigInfo[389].TxBufferStartIdxOfTxSigInfo "" UWORD Com_TxBufferStartIdxOfTxSigInfoType 0 0 0 65535 ECU_ADDRESS 0x0 /end MEASUREMENT
/begin MEASUREMENT Com_TxSigInfo[389].TxFilterInitValueArrayBasedFilterInitValueEndIdxOfTxSigInfo "" UBYTE Com_TxFilterInitValueArrayBasedFilterInitValueEndIdxOfTxSigInfoType 0 0 0 255 ECU_ADDRESS 0x0 /end MEASUREMENT
/begin MEASUREMENT Com_TxSigInfo[389].TxFilterInitValueArrayBasedFilterInitValueStartIdxOfTxSigInfo "" UBYTE Com_TxFilterInitValueArrayBasedFilterInitValueStartIdxOfTxSigInfoType 0 0 0 255 ECU_ADDRESS 0x0 /end MEASUREMENT
/begin MEASUREMENT Com_TxSigInfo[389].TxPduInfoIdxOfTxSigInfo "" UBYTE NO_COMPU_METHOD 0 0 0 255 ECU_ADDRESS 0x0 /end MEASUREMENT
/begin MEASUREMENT Com_TxSigInfo[38].ApplTypeOfTxSigInfo "" UBYTE Com_ApplTypeOfTxSigInfoType 0 0 0 255 ECU_ADDRESS 0x0 /end MEASUREMENT
/begin MEASUREMENT Com_TxSigInfo[38].BitLengthOfTxSigInfo "" UWORD NO_COMPU_METHOD 0 0 0 65535 ECU_ADDRESS 0x0 /end MEASUREMENT
/begin MEASUREMENT Com_TxSigInfo[38].BitPositionOfTxSigInfo "" UWORD NO_COMPU_METHOD 0 0 0 65535 ECU_ADDRESS 0x0 /end MEASUREMENT
/begin MEASUREMENT Com_TxSigInfo[38].BusAccOfTxSigInfo "" UBYTE Com_BusAccOfTxSigInfoType 0 0 0 255 ECU_ADDRESS 0x0 /end MEASUREMENT
/begin MEASUREMENT Com_TxSigInfo[38].ByteLengthOfTxSigInfo "" UBYTE NO_COMPU_METHOD 0 0 0 255 ECU_ADDRESS 0x0 /end MEASUREMENT
/begin MEASUREMENT Com_TxSigInfo[38].DynSignalOfTxSigInfo "" UBYTE Com_DynSignalOfTxSigInfoType 0 0 0 1 ECU_ADDRESS 0x0 /end MEASUREMENT
/begin MEASUREMENT Com_TxSigInfo[38].FilterInitValueIdxOfTxSigInfo "" UBYTE Com_FilterInitValueIdxOfTxSigInfoType 0 0 0 255 ECU_ADDRESS 0x0 /end MEASUREMENT
/begin MEASUREMENT Com_TxSigInfo[38].FilterInitValueOfTxSigInfo "" UBYTE Com_FilterInitValueOfTxSigInfoType 0 0 0 255 ECU_ADDRESS 0x0 /end MEASUREMENT
/begin MEASUREMENT Com_TxSigInfo[38].InvValueIdxOfTxSigInfo "" UBYTE Com_InvValueIdxOfTxSigInfoType 0 0 0 255 ECU_ADDRESS 0x0 /end MEASUREMENT
/begin MEASUREMENT Com_TxSigInfo[38].InvValueOfTxSigInfo "" UBYTE Com_InvValueOfTxSigInfoType 0 0 0 255 ECU_ADDRESS 0x0 /end MEASUREMENT
/begin MEASUREMENT Com_TxSigInfo[38].OnChangeIdxOfTxSigInfo "" UBYTE Com_OnChangeIdxOfTxSigInfoType 0 0 0 255 ECU_ADDRESS 0x0 /end MEASUREMENT
/begin MEASUREMENT Com_TxSigInfo[38].OnChangeOfTxSigInfo "" UBYTE Com_OnChangeOfTxSigInfoType 0 0 0 255 ECU_ADDRESS 0x0 /end MEASUREMENT
/begin MEASUREMENT Com_TxSigInfo[38].StartByteInPduPositionOfTxSigInfo "" UBYTE NO_COMPU_METHOD 0 0 0 255 ECU_ADDRESS 0x0 /end MEASUREMENT
/begin MEASUREMENT Com_TxSigInfo[38].TxAccessInfoIdxOfTxSigInfo "" UWORD NO_COMPU_METHOD 0 0 0 65535 ECU_ADDRESS 0x0 /end MEASUREMENT
/begin MEASUREMENT Com_TxSigInfo[38].TxBufferEndIdxOfTxSigInfo "" UWORD Com_TxBufferEndIdxOfTxSigInfoType 0 0 0 65535 ECU_ADDRESS 0x0 /end MEASUREMENT
/begin MEASUREMENT Com_TxSigInfo[38].TxBufferStartIdxOfTxSigInfo "" UWORD Com_TxBufferStartIdxOfTxSigInfoType 0 0 0 65535 ECU_ADDRESS 0x0 /end MEASUREMENT
/begin COMPU_METHOD Com_ApplTypeOfTxSigInfoType "" TAB_VERB "%10.1" "" COMPU_TAB_REF Com_ApplTypeOfTxSigInfoType /end COMPU_METHOD
/begin COMPU_METHOD Com_BusAccOfTxSigInfoType "" TAB_VERB "%10.1" "" COMPU_TAB_REF Com_BusAccOfTxSigInfoType /end COMPU_METHOD
/begin COMPU_METHOD Com_DynSignalOfTxSigInfoType "" TAB_VERB "%10.1" "" COMPU_TAB_REF Com_DynSignalOfTxSigInfoType /end COMPU_METHOD
/begin COMPU_METHOD Com_FilterInitValueIdxOfTxSigInfoType "" TAB_VERB "%10.1" "" COMPU_TAB_REF Com_FilterInitValueIdxOfTxSigInfoType /end COMPU_METHOD
/begin COMPU_METHOD Com_FilterInitValueOfTxSigInfoType "" TAB_VERB "%10.1" "" COMPU_TAB_REF Com_FilterInitValueOfTxSigInfoType /end COMPU_METHOD
/begin COMPU_METHOD Com_InvValueIdxOfTxSigInfoType "" TAB_VERB "%10.1" "" COMPU_TAB_REF Com_InvValueIdxOfTxSigInfoType /end COMPU_METHOD
/begin COMPU_METHOD Com_InvValueOfTxSigInfoType "" TAB_VERB "%10.1" "" COMPU_TAB_REF Com_InvValueOfTxSigInfoType /end COMPU_METHOD
/begin COMPU_METHOD Com_OnChangeIdxOfTxSigInfoType "" TAB_VERB "%10.1" "" COMPU_TAB_REF Com_OnChangeIdxOfTxSigInfoType /end COMPU_METHOD
/begin COMPU_METHOD Com_OnChangeOfTxSigInfoType "" TAB_VERB "%10.1" "" COMPU_TAB_REF Com_OnChangeOfTxSigInfoType /end COMPU_METHOD
/begin COMPU_METHOD Com_TxBufferEndIdxOfTxSigInfoType "" TAB_VERB "%10.1" "" COMPU_TAB_REF Com_TxBufferEndIdxOfTxSigInfoType /end COMPU_METHOD
/begin COMPU_METHOD Com_TxBufferStartIdxOfTxSigInfoType "" TAB_VERB "%10.1" "" COMPU_TAB_REF Com_TxBufferStartIdxOfTxSigInfoType /end COMPU_METHOD
/begin COMPU_METHOD Com_TxFilterInitValueArrayBasedFilterInitValueEndIdxOfTxSigInfoType "" TAB_VERB "%10.1" "" COMPU_TAB_REF Com_TxFilterInitValueArrayBasedFilterInitValueEndIdxOfTxSigInfoType /end COMPU_METHOD
/begin COMPU_METHOD Com_TxFilterInitValueArrayBasedFilterInitValueStartIdxOfTxSigInfoType "" TAB_VERB "%10.1" "" COMPU_TAB_REF Com_TxFilterInitValueArrayBasedFilterInitValueStartIdxOfTxSigInfoType /end COMPU_METHOD
/begin COMPU_VTAB Com_ApplTypeOfTxSigInfoType "" TAB_VERB 4 0 "COM_UINT8_APPLTYPEOFTXSIGINFO" 2 "COM_UINT16_APPLTYPEOFTXSIGINFO" 4 "COM_UINT32_APPLTYPEOFTXSIGINFO" 8 "COM_UINT8_N_APPLTYPEOFTXSIGINFO" /end COMPU_VTAB
/begin COMPU_VTAB Com_BusAccOfTxSigInfoType "" TAB_VERB 5 0 "COM_NBIT_BUSACCOFTXSIGINFO" 1 "COM_BYTE_BUSACCOFTXSIGINFO" 2 "COM_NBYTE_BUSACCOFTXSIGINFO" 4 "COM_NBITNBYTE_BUSACCOFTXSIGINFO" 6 "COM_ARRAY_BASED_BUSACCOFTXSIGINFO" /end COMPU_VTAB
/begin COMPU_VTAB_RANGE Com_DynSignalOfTxSigInfoType "" 2 0 0 "FALSE" 1 255 "TRUE" /end COMPU_VTAB_RANGE
/begin COMPU_VTAB Com_FilterInitValueIdxOfTxSigInfoType "" TAB_VERB 1 255 "COM_NO_FILTERINITVALUEIDXOFTXSIGINFO" /end COMPU_VTAB
/begin COMPU_VTAB Com_FilterInitValueOfTxSigInfoType "" TAB_VERB 3 0 "COM_TXFILTERINITVALUEUINT8_FILTERINITVALUEOFTXSIGINFO" 1 "COM_TXFILTERINITVALUEUINT16_FILTERINITVALUEOFTXSIGINFO" 255 "COM_NO_FILTERINITVALUEOFTXSIGINFO" /end COMPU_VTAB
/begin COMPU_VTAB Com_InvValueIdxOfTxSigInfoType "" TAB_VERB 1 255 "COM_NO_INVVALUEIDXOFTXSIGINFO" /end COMPU_VTAB
/begin COMPU_VTAB Com_InvValueOfTxSigInfoType "" TAB_VERB 4 0 "COM_CONSTVALUEUINT8_INVVALUEOFTXSIGINFO" 1 "COM_CONSTVALUEUINT16_INVVALUEOFTXSIGINFO" 2 "COM_CONSTVALUEUINT32_INVVALUEOFTXSIGINFO" 255 "COM_NO_INVVALUEOFTXSIGINFO" /end COMPU_VTAB
/begin COMPU_VTAB Com_OnChangeIdxOfTxSigInfoType "" TAB_VERB 1 255 "COM_NO_ONCHANGEIDXOFTXSIGINFO" /end COMPU_VTAB
/begin COMPU_VTAB Com_OnChangeOfTxSigInfoType "" TAB_VERB 4 0 "COM_FILTERINFO_UINT8_ONCHANGEOFTXSIGINFO" 2 "COM_FILTERINFO_UINT16_ONCHANGEOFTXSIGINFO" 10 "COM_FILTERINFO_UINT8_N_ONCHANGEOFTXSIGINFO" 255 "COM_NO_ONCHANGEOFTXSIGINFO" /end COMPU_VTAB
/begin COMPU_VTAB Com_TxBufferEndIdxOfTxSigInfoType "" TAB_VERB 1 65535 "COM_NO_TXBUFFERENDIDXOFTXSIGINFO" /end COMPU_VTAB
/begin COMPU_VTAB Com_TxBufferStartIdxOfTxSigInfoType "" TAB_VERB 1 65535 "COM_NO_TXBUFFERSTARTIDXOFTXSIGINFO" /end COMPU_VTAB
/begin COMPU_VTAB Com_TxFilterInitValueArrayBasedFilterInitValueEndIdxOfTxSigInfoType "" TAB_VERB 1 255 "COM_NO_TXFILTERINITVALUEARRAYBASEDFILTERINITVALUEENDIDXOFTXSIGINFO" /end COMPU_VTAB
/begin COMPU_VTAB Com_TxFilterInitValueArrayBasedFilterInitValueStartIdxOfTxSigInfoType "" TAB_VERB 1 255 "COM_NO_TXFILTERINITVALUEARRAYBASEDFILTERINITVALUESTARTIDXOFTXSIGINFO" /end COMPU_VTAB
/begin GROUP Com ""
 /begin REF_MEASUREMENT Com_TxSigInfo[343].OnChangeIdxOfTxSigInfo Com_TxSigInfo[343].OnChangeOfTxSigInfo Com_TxSigInfo[343].StartByteInPduPositionOfTxSigInfo Com_TxSigInfo[343].TxAccessInfoIdxOfTxSigInfo Com_TxSigInfo[343].TxBufferEndIdxOfTxSigInfo Com_TxSigInfo[343].TxBufferStartIdxOfTxSigInfo Com_TxSigInfo[343].TxFilterInitValueArrayBasedFilterInitValueEndIdxOfTxSigInfo Com_TxSigInfo[343].TxFilterInitValueArrayBasedFilterInitValueStartIdxOfTxSigInfo Com_TxSigInfo[343].TxPduInfoIdxOfTxSigInfo Com_TxSigInfo[344].ApplTypeOfTxSigInfo Com_TxSigInfo[344].BitLengthOfTxSigInfo Com_TxSigInfo[344].BitPositionOfTxSigInfo Com_TxSigInfo[344].BusAccOfTxSigInfo Com_TxSigInfo[344].ByteLengthOfTxSigInfo Com_TxSigInfo[344].DynSignalOfTxSigInfo Com_TxSigInfo[344].FilterInitValueIdxOfTxSigInfo Com_TxSigInfo[344].FilterInitValueOfTxSigInfo Com_TxSigInfo[344].InvValueIdxOfTxSigInfo Com_TxSigInfo[344].InvValueOfTxSigInfo Com_TxSigInfo[344].OnChangeIdxOfTxSigInfo Com_TxSigInfo[344].OnChangeOfTxSigInfo Com_TxSigInfo[344].StartByteInPduPositionOfTxSigInfo Com_TxSigInfo[344].TxAccessInfoIdxOfTxSigInfo Com_TxSigInfo[344].TxBufferEndIdxOfTxSigInfo Com_TxSigInfo[344].TxBufferStartIdxOfTxSigInfo Com_TxSigInfo[344].TxFilterInitValueArrayBasedFilterInitValueEndIdxOfTxSigInfo Com_TxSigInfo[344].TxFilterInitValueArrayBasedFilterInitValueStartIdxOfTxSigInfo Com_TxSigInfo[344].TxPduInfoIdxOfTxSigInfo Com_TxSigInfo[345].ApplTypeOfTxSigInfo Com_TxSigInfo[345].BitLengthOfTxSigInfo Com_TxSigInfo[345].BitPositionOfTxSigInfo Com_TxSigInfo[345].BusAccOfTxSigInfo Com_TxSigInfo[345].ByteLengthOfTxSigInfo Com_TxSigInfo[345].DynSignalOfTxSigInfo Com_TxSigInfo[345].FilterInitValueIdxOfTxSigInfo Com_TxSigInfo[345].FilterInitValueOfTxSigInfo Com_TxSigInfo[345].InvValueIdxOfTxSigInfo Com_TxSigInfo[345].InvValueOfTxSigInfo Com_TxSigInfo[345].OnChangeIdxOfTxSigInfo Com_TxSigInfo[345].OnChangeOfTxSigInfo Com_TxSigInfo[345].StartByteInPduPositionOfTxSigInfo Com_TxSigInfo[345].TxAccessInfoIdxOfTxSigInfo Com_TxSigInfo[345].TxBufferEndIdxOfTxSigInfo Com_TxSigInfo[345].TxBufferStartIdxOfTxSigInfo Com_TxSigInfo[345].TxFilterInitValueArrayBasedFilterInitValueEndIdxOfTxSigInfo Com_TxSigInfo[345].TxFilterInitValueArrayBasedFilterInitValueStartIdxOfTxSigInfo Com_TxSigInfo[345].TxPduInfoIdxOfTxSigInfo Com_TxSigInfo[346].ApplTypeOfTxSigInfo Com_TxSigInfo[346].BitLengthOfTxSigInfo Com_TxSigInfo[346].BitPositionOfTxSigInfo Com_TxSigInfo[346].BusAccOfTxSigInfo Com_TxSigInfo[346].ByteLengthOfTxSigInfo Com_TxSigInfo[346].DynSignalOfTxSigInfo Com_TxSigInfo[346].FilterInitValueIdxOfTxSigInfo Com_TxSigInfo[346].FilterInitValueOfTxSigInfo Com_TxSigInfo[346].InvValueIdxOfTxSigInfo Com_TxSigInfo[346].InvValueOfTxSigInfo Com_TxSigInfo[346].OnChangeIdxOfTxSigInfo Com_TxSigInfo[346].OnChangeOfTxSigInfo Com_TxSigInfo[346].StartByteInPduPositionOfTxSigInfo Com_TxSigInfo[346].TxAccessInfoIdxOfTxSigInfo Com_TxSigInfo[346].TxBufferEndIdxOfTxSigInfo Com_TxSigInfo[346].TxBufferStartIdxOfTxSigInfo Com_TxSigInfo[346].TxFilterInitValueArrayBasedFilterInitValueEndIdxOfTxSigInfo Com_TxSigInfo[346].TxFilterInitValueArrayBasedFilterInitValueStartIdxOfTxSigInfo Com_TxSigInfo[346].TxPduInfoIdxOfTxSigInfo Com_TxSigInfo[347].ApplTypeOfTxSigInfo Com_TxSigInfo[347].BitLengthOfTxSigInfo Com_TxSigInfo[347].BitPositionOfTxSigInfo Com_TxSigInfo[347].BusAccOfTxSigInfo Com_TxSigInfo[347].ByteLengthOfTxSigInfo Com_TxSigInfo[347].DynSignalOfTxSigInfo Com_TxSigInfo[347].FilterInitValueIdxOfTxSigInfo Com_TxSigInfo[347].FilterInitValueOfTxSigInfo Com_TxSigInfo[347].InvValueIdxOfTxSigInfo Com_TxSigInfo[347].InvValueOfTxSigInfo Com_TxSigInfo[347].OnChangeIdxOfTxSigInfo Com_TxSigInfo[347].OnChangeOfTxSigInfo Com_TxSigInfo[347].StartByteInPduPositionOfTxSigInfo Com_TxSigInfo[347].TxAccessInfoIdxOfTxSigInfo Com_TxSigInfo[347].TxBufferEndIdxOfTxSigInfo Com_TxSigInfo[347].TxBufferStartIdxOfTxSigInfo Com_TxSigInfo[347].TxFilterInitValueArrayBasedFilterInitValueEndIdxOfTxSigInfo Com_TxSigInfo[347].TxFilterInitValueArrayBasedFilterInitValueStartIdxOfTxSigInfo Com_TxSigInfo[347].TxPduInfoIdxOfTxSigInfo Com_TxSigInfo[348].ApplTypeOfTxSigInfo Com_TxSigInfo[348].BitLengthOfTxSigInfo Com_TxSigInfo[348].BitPositionOfTxSigInfo Com_TxSigInfo[348].BusAccOfTxSigInfo Com_TxSigInfo[348].ByteLengthOfTxSigInfo Com_TxSigInfo[348].DynSignalOfTxSigInfo Com_TxSigInfo[348].FilterInitValueIdxOfTxSigInfo Com_TxSigInfo[348].FilterInitValueOfTxSigInfo Com_TxSigInfo[348].InvValueIdxOfTxSigInfo Com_TxSigInfo[348].InvValueOfTxSigInfo Com_TxSigInfo[348].OnChangeIdxOfTxSigInfo Com_TxSigInfo[348].OnChangeOfTxSigInfo Com_TxSigInfo[348].StartByteInPduPositionOfTxSigInfo Com_TxSigInfo[348].TxAccessInfoIdxOfTxSigInfo Com_TxSigInfo[348].TxBufferEndIdxOfTxSigInfo Com_TxSigInfo[348].TxBufferStartIdxOfTxSigInfo Com_TxSigInfo[348].TxFilterInitValueArrayBasedFilterInitValueEndIdxOfTxSigInfo Com_TxSigInfo[348].TxFilterInitValueArrayBasedFilterInitValueStartIdxOfTxSigInfo Com_TxSigInfo[348].TxPduInfoIdxOfTxSigInfo Com_TxSigInfo[349].ApplTypeOfTxSigInfo Com_TxSigInfo[349].BitLengthOfTxSigInfo Com_TxSigInfo[349].BitPositionOfTxSigInfo Com_TxSigInfo[349].BusAccOfTxSigInfo Com_TxSigInfo[349].ByteLengthOfTxSigInfo Com_TxSigInfo[349].DynSignalOfTxSigInfo Com_TxSigInfo[349].FilterInitValueIdxOfTxSigInfo Com_TxSigInfo[349].FilterInitValueOfTxSigInfo Com_TxSigInfo[349].InvValueIdxOfTxSigInfo Com_TxSigInfo[349].InvValueOfTxSigInfo Com_TxSigInfo[349].OnChangeIdxOfTxSigInfo Com_TxSigInfo[349].OnChangeOfTxSigInfo Com_TxSigInfo[349].StartByteInPduPositionOfTxSigInfo Com_TxSigInfo[349].TxAccessInfoIdxOfTxSigInfo Com_TxSigInfo[349].TxBufferEndIdxOfTxSigInfo Com_TxSigInfo[349].TxBufferStartIdxOfTxSigInfo Com_TxSigInfo[349].TxFilterInitValueArrayBasedFilterInitValueEndIdxOfTxSigInfo Com_TxSigInfo[349].TxFilterInitValueArrayBasedFilterInitValueStartIdxOfTxSigInfo Com_TxSigInfo[349].TxPduInfoIdxOfTxSigInfo Com_TxSigInfo[34].ApplTypeOfTxSigInfo Com_TxSigInfo[34].BitLengthOfTxSigInfo Com_TxSigInfo[34].BitPositionOfTxSigInfo Com_TxSigInfo[34].BusAccOfTxSigInfo Com_TxSigInfo[34].ByteLengthOfTxSigInfo Com_TxSigInfo[34].DynSignalOfTxSigInfo Com_TxSigInfo[34].FilterInitValueIdxOfTxSigInfo Com_TxSigInfo[34].FilterInitValueOfTxSigInfo Com_TxSigInfo[34].InvValueIdxOfTxSigInfo Com_TxSigInfo[34].InvValueOfTxSigInfo Com_TxSigInfo[34].OnChangeIdxOfTxSigInfo Com_TxSigInfo[34].OnChangeOfTxSigInfo Com_TxSigInfo[34].StartByteInPduPositionOfTxSigInfo Com_TxSigInfo[34].TxAccessInfoIdxOfTxSigInfo Com_TxSigInfo[34].TxBufferEndIdxOfTxSigInfo Com_TxSigInfo[34].TxBufferStartIdxOfTxSigInfo Com_TxSigInfo[34].TxFilterInitValueArrayBasedFilterInitValueEndIdxOfTxSigInfo Com_TxSigInfo[34].TxFilterInitValueArrayBasedFilterInitValueStartIdxOfTxSigInfo Com_TxSigInfo[34].TxPduInfoIdxOfTxSigInfo Com_TxSigInfo[350].ApplTypeOfTxSigInfo Com_TxSigInfo[350].BitLengthOfTxSigInfo Com_TxSigInfo[350].BitPositionOfTxSigInfo Com_TxSigInfo[350].BusAccOfTxSigInfo Com_TxSigInfo[350].ByteLengthOfTxSigInfo Com_TxSigInfo[350].DynSignalOfTxSigInfo Com_TxSigInfo[350].FilterInitValueIdxOfTxSigInfo Com_TxSigInfo[350].FilterInitValueOfTxSigInfo Com_TxSigInfo[350].InvValueIdxOfTxSigInfo Com_TxSigInfo[350].InvValueOfTxSigInfo Com_TxSigInfo[350].OnChangeIdxOfTxSigInfo Com_TxSigInfo[350].OnChangeOfTxSigInfo Com_TxSigInfo[350].StartByteInPduPositionOfTxSigInfo Com_TxSigInfo[350].TxAccessInfoIdxOfTxSigInfo Com_TxSigInfo[350].TxBufferEndIdxOfTxSigInfo Com_TxSigInfo[350].TxBufferStartIdxOfTxSigInfo Com_TxSigInfo[350].TxFilterInitValueArrayBasedFilterInitValueEndIdxOfTxSigInfo Com_TxSigInfo[350].TxFilterInitValueArrayBasedFilterInitValueStartIdxOfTxSigInfo Com_TxSigInfo[350].TxPduInfoIdxOfTxSigInfo Com_TxSigInfo[351].ApplTypeOfTxSigInfo Com_TxSigInfo[351].BitLengthOfTxSigInfo Com_TxSigInfo[351].BitPositionOfTxSigInfo Com_TxSigInfo[351].BusAccOfTxSigInfo Com_TxSigInfo[351].ByteLengthOfTxSigInfo Com_TxSigInfo[351].DynSignalOfTxSigInfo Com_TxSigInfo[351].FilterInitValueIdxOfTxSigInfo Com_TxSigInfo[351].FilterInitValueOfTxSigInfo Com_TxSigInfo[351].InvValueIdxOfTxSigInfo Com_TxSigInfo[351].InvValueOfTxSigInfo Com_TxSigInfo[351].OnChangeIdxOfTxSigInfo Com_TxSigInfo[351].OnChangeOfTxSigInfo Com_TxSigInfo[351].StartByteInPduPositionOfTxSigInfo Com_TxSigInfo[351].TxAccessInfoIdxOfTxSigInfo Com_TxSigInfo[351].TxBufferEndIdxOfTxSigInfo Com_TxSigInfo[351].TxBufferStartIdxOfTxSigInfo Com_TxSigInfo[351].TxFilterInitValueArrayBasedFilterInitValueEndIdxOfTxSigInfo Com_TxSigInfo[351].TxFilterInitValueArrayBasedFilterInitValueStartIdxOfTxSigInfo Com_TxSigInfo[351].TxPduInfoIdxOfTxSigInfo Com_TxSigInfo[352].ApplTypeOfTxSigInfo Com_TxSigInfo[352].BitLengthOfTxSigInfo Com_TxSigInfo[352].BitPositionOfTxSigInfo Com_TxSigInfo[352].BusAccOfTxSigInfo Com_TxSigInfo[352].ByteLengthOfTxSigInfo Com_TxSigInfo[352].DynSignalOfTxSigInfo Com_TxSigInfo[352].FilterInitValueIdxOfTxSigInfo Com_TxSigInfo[352].FilterInitValueOfTxSigInfo Com_TxSigInfo[352].InvValueIdxOfTxSigInfo Com_TxSigInfo[352].InvValueOfTxSigInfo Com_TxSigInfo[352].OnChangeIdxOfTxSigInfo Com_TxSigInfo[352].OnChangeOfTxSigInfo Com_TxSigInfo[352].StartByteInPduPositionOfTxSigInfo Com_TxSigInfo[352].TxAccessInfoIdxOfTxSigInfo Com_TxSigInfo[352].TxBufferEndIdxOfTxSigInfo Com_TxSigInfo[352].TxBufferStartIdxOfTxSigInfo Com_TxSigInfo[352].TxFilterInitValueArrayBasedFilterInitValueEndIdxOfTxSigInfo Com_TxSigInfo[352].TxFilterInitValueArrayBasedFilterInitValueStartIdxOfTxSigInfo Com_TxSigInfo[352].TxPduInfoIdxOfTxSigInfo Com_TxSigInfo[353].ApplTypeOfTxSigInfo Com_TxSigInfo[353].BitLengthOfTxSigInfo Com_TxSigInfo[353].BitPositionOfTxSigInfo Com_TxSigInfo[353].BusAccOfTxSigInfo Com_TxSigInfo[353].ByteLengthOfTxSigInfo Com_TxSigInfo[353].DynSignalOfTxSigInfo Com_TxSigInfo[353].FilterInitValueIdxOfTxSigInfo Com_TxSigInfo[353].FilterInitValueOfTxSigInfo Com_TxSigInfo[353].InvValueIdxOfTxSigInfo Com_TxSigInfo[353].InvValueOfTxSigInfo Com_TxSigInfo[353].OnChangeIdxOfTxSigInfo Com_TxSigInfo[353].OnChangeOfTxSigInfo Com_TxSigInfo[353].StartByteInPduPositionOfTxSigInfo Com_TxSigInfo[353].TxAccessInfoIdxOfTxSigInfo Com_TxSigInfo[353].TxBufferEndIdxOfTxSigInfo Com_TxSigInfo[353].TxBufferStartIdxOfTxSigInfo Com_TxSigInfo[353].TxFilterInitValueArrayBasedFilterInitValueEndIdxOfTxSigInfo Com_TxSigInfo[353].TxFilterInitValueArrayBasedFilterInitValueStartIdxOfTxSigInfo Com_TxSigInfo[353].TxPduInfoIdxOfTxSigInfo Com_TxSigInfo[354].ApplTypeOfTxSigInfo Com_TxSigInfo[354].BitLengthOfTxSigInfo Com_TxSigInfo[354].BitPositionOfTxSigInfo Com_TxSigInfo[354].BusAccOfTxSigInfo Com_TxSigInfo[354].ByteLengthOfTxSigInfo Com_TxSigInfo[354].DynSignalOfTxSigInfo Com_TxSigInfo[354].FilterInitValueIdxOfTxSigInfo Com_TxSigInfo[354].FilterInitValueOfTxSigInfo Com_TxSigInfo[354].InvValueIdxOfTxSigInfo Com_TxSigInfo[354].InvValueOfTxSigInfo Com_TxSigInfo[354].OnChangeIdxOfTxSigInfo Com_TxSigInfo[354].OnChangeOfTxSigInfo Com_TxSigInfo[354].StartByteInPduPositionOfTxSigInfo Com_TxSigInfo[354].TxAccessInfoIdxOfTxSigInfo Com_TxSigInfo[354].TxBufferEndIdxOfTxSigInfo Com_TxSigInfo[354].TxBufferStartIdxOfTxSigInfo Com_TxSigInfo[354].TxFilterInitValueArrayBasedFilterInitValueEndIdxOfTxSigInfo Com_TxSigInfo[354].TxFilterInitValueArrayBasedFilterInitValueStartIdxOfTxSigInfo Com_TxSigInfo[354].TxPduInfoIdxOfTxSigInfo Com_TxSigInfo[355].ApplTypeOfTxSigInfo Com_TxSigInfo[355].BitLengthOfTxSigInfo Com_TxSigInfo[355].BitPositionOfTxSigInfo Com_TxSigInfo[355].BusAccOfTxSigInfo Com_TxSigInfo[355].ByteLengthOfTxSigInfo Com_TxSigInfo[355].DynSignalOfTxSigInfo Com_TxSigInfo[355].FilterInitValueIdxOfTxSigInfo Com_TxSigInfo[355].FilterInitValueOfTxSigInfo Com_TxSigInfo[355].InvValueIdxOfTxSigInfo Com_TxSigInfo[355].InvValueOfTxSigInfo Com_TxSigInfo[355].OnChangeIdxOfTxSigInfo Com_TxSigInfo[355].OnChangeOfTxSigInfo Com_TxSigInfo[355].StartByteInPduPositionOfTxSigInfo Com_TxSigInfo[355].TxAccessInfoIdxOfTxSigInfo Com_TxSigInfo[355].TxBufferEndIdxOfTxSigInfo Com_TxSigInfo[355].TxBufferStartIdxOfTxSigInfo Com_TxSigInfo[355].TxFilterInitValueArrayBasedFilterInitValueEndIdxOfTxSigInfo Com_TxSigInfo[355].TxFilterInitValueArrayBasedFilterInitValueStartIdxOfTxSigInfo Com_TxSigInfo[355].TxPduInfoIdxOfTxSigInfo Com_TxSigInfo[356].ApplTypeOfTxSigInfo Com_TxSigInfo[356].BitLengthOfTxSigInfo Com_TxSigInfo[356].BitPositionOfTxSigInfo Com_TxSigInfo[356].BusAccOfTxSigInfo Com_TxSigInfo[356].ByteLengthOfTxSigInfo Com_TxSigInfo[356].DynSignalOfTxSigInfo Com_TxSigInfo[356].FilterInitValueIdxOfTxSigInfo Com_TxSigInfo[356].FilterInitValueOfTxSigInfo Com_TxSigInfo[356].InvValueIdxOfTxSigInfo Com_TxSigInfo[356].InvValueOfTxSigInfo Com_TxSigInfo[356].OnChangeIdxOfTxSigInfo Com_TxSigInfo[356].OnChangeOfTxSigInfo Com_TxSigInfo[356].StartByteInPduPositionOfTxSigInfo Com_TxSigInfo[356].TxAccessInfoIdxOfTxSigInfo Com_TxSigInfo[356].TxBufferEndIdxOfTxSigInfo Com_TxSigInfo[356].TxBufferStartIdxOfTxSigInfo Com_TxSigInfo[356].TxFilterInitValueArrayBasedFilterInitValueEndIdxOfTxSigInfo Com_TxSigInfo[356].TxFilterInitValueArrayBasedFilterInitValueStartIdxOfTxSigInfo Com_TxSigInfo[356].TxPduInfoIdxOfTxSigInfo Com_TxSigInfo[357].ApplTypeOfTxSigInfo Com_TxSigInfo[357].BitLengthOfTxSigInfo Com_TxSigInfo[357].BitPositionOfTxSigInfo Com_TxSigInfo[357].BusAccOfTxSigInfo Com_TxSigInfo[357].ByteLengthOfTxSigInfo Com_TxSigInfo[357].DynSignalOfTxSigInfo Com_TxSigInfo[357].FilterInitValueIdxOfTxSigInfo Com_TxSigInfo[357].FilterInitValueOfTxSigInfo Com_TxSigInfo[357].InvValueIdxOfTxSigInfo Com_TxSigInfo[357].InvValueOfTxSigInfo Com_TxSigInfo[357].OnChangeIdxOfTxSigInfo Com_TxSigInfo[357].OnChangeOfTxSigInfo Com_TxSigInfo[357].StartByteInPduPositionOfTxSigInfo Com_TxSigInfo[357].TxAccessInfoIdxOfTxSigInfo Com_TxSigInfo[357].TxBufferEndIdxOfTxSigInfo Com_TxSigInfo[357].TxBufferStartIdxOfTxSigInfo Com_TxSigInfo[357].TxFilterInitValueArrayBasedFilterInitValueEndIdxOfTxSigInfo Com_TxSigInfo[357].TxFilterInitValueArrayBasedFilterInitValueStartIdxOfTxSigInfo Com_TxSigInfo[357].TxPduInfoIdxOfTxSigInfo Com_TxSigInfo[358].ApplTypeOfTxSigInfo Com_TxSigInfo[358].BitLengthOfTxSigInfo Com_TxSigInfo[358].BitPositionOfTxSigInfo Com_TxSigInfo[358].BusAccOfTxSigInfo Com_TxSigInfo[358].ByteLengthOfTxSigInfo Com_TxSigInfo[358].DynSignalOfTxSigInfo Com_TxSigInfo[358].FilterInitValueIdxOfTxSigInfo Com_TxSigInfo[358].FilterInitValueOfTxSigInfo Com_TxSigInfo[358].InvValueIdxOfTxSigInfo Com_TxSigInfo[358].InvValueOfTxSigInfo Com_TxSigInfo[358].OnChangeIdxOfTxSigInfo Com_TxSigInfo[358].OnChangeOfTxSigInfo Com_TxSigInfo[358].StartByteInPduPositionOfTxSigInfo Com_TxSigInfo[358].TxAccessInfoIdxOfTxSigInfo Com_TxSigInfo[358].TxBufferEndIdxOfTxSigInfo Com_TxSigInfo[358].TxBufferStartIdxOfTxSigInfo Com_TxSigInfo[358].TxFilterInitValueArrayBasedFilterInitValueEndIdxOfTxSigInfo Com_TxSigInfo[358].TxFilterInitValueArrayBasedFilterInitValueStartIdxOfTxSigInfo Com_TxSigInfo[358].TxPduInfoIdxOfTxSigInfo Com_TxSigInfo[359].ApplTypeOfTxSigInfo Com_TxSigInfo[359].BitLengthOfTxSigInfo Com_TxSigInfo[359].BitPositionOfTxSigInfo Com_TxSigInfo[359].BusAccOfTxSigInfo Com_TxSigInfo[359].ByteLengthOfTxSigInfo Com_TxSigInfo[359].DynSignalOfTxSigInfo Com_TxSigInfo[359].FilterInitValueIdxOfTxSigInfo Com_TxSigInfo[359].FilterInitValueOfTxSigInfo Com_TxSigInfo[359].InvValueIdxOfTxSigInfo Com_TxSigInfo[359].InvValueOfTxSigInfo Com_TxSigInfo[359].OnChangeIdxOfTxSigInfo Com_TxSigInfo[359].OnChangeOfTxSigInfo Com_TxSigInfo[359].StartByteInPduPositionOfTxSigInfo Com_TxSigInfo[359].TxAccessInfoIdxOfTxSigInfo Com_TxSigInfo[359].TxBufferEndIdxOfTxSigInfo Com_TxSigInfo[359].TxBufferStartIdxOfTxSigInfo Com_TxSigInfo[359].TxFilterInitValueArrayBasedFilterInitValueEndIdxOfTxSigInfo Com_TxSigInfo[359].TxFilterInitValueArrayBasedFilterInitValueStartIdxOfTxSigInfo Com_TxSigInfo[359].TxPduInfoIdxOfTxSigInfo Com_TxSigInfo[35].ApplTypeOfTxSigInfo Com_TxSigInfo[35].BitLengthOfTxSigInfo Com_TxSigInfo[35].BitPositionOfTxSigInfo Com_TxSigInfo[35].BusAccOfTxSigInfo Com_TxSigInfo[35].ByteLengthOfTxSigInfo Com_TxSigInfo[35].DynSignalOfTxSigInfo Com_TxSigInfo[35].FilterInitValueIdxOfTxSigInfo Com_TxSigInfo[35].FilterInitValueOfTxSigInfo Com_TxSigInfo[35].InvValueIdxOfTxSigInfo Com_TxSigInfo[35].InvValueOfTxSigInfo Com_TxSigInfo[35].OnChangeIdxOfTxSigInfo Com_TxSigInfo[35].OnChangeOfTxSigInfo Com_TxSigInfo[35].StartByteInPduPositionOfTxSigInfo Com_TxSigInfo[35].TxAccessInfoIdxOfTxSigInfo Com_TxSigInfo[35].TxBufferEndIdxOfTxSigInfo Com_TxSigInfo[35].TxBufferStartIdxOfTxSigInfo Com_TxSigInfo[35].TxFilterInitValueArrayBasedFilterInitValueEndIdxOfTxSigInfo Com_TxSigInfo[35].TxFilterInitValueArrayBasedFilterInitValueStartIdxOfTxSigInfo Com_TxSigInfo[35].TxPduInfoIdxOfTxSigInfo Com_TxSigInfo[360].ApplTypeOfTxSigInfo Com_TxSigInfo[360].BitLengthOfTxSigInfo Com_TxSigInfo[360].BitPositionOfTxSigInfo Com_TxSigInfo[360].BusAccOfTxSigInfo Com_TxSigInfo[360].ByteLengthOfTxSigInfo Com_TxSigInfo[360].DynSignalOfTxSigInfo Com_TxSigInfo[360].FilterInitValueIdxOfTxSigInfo Com_TxSigInfo[360].FilterInitValueOfTxSigInfo Com_TxSigInfo[360].InvValueIdxOfTxSigInfo Com_TxSigInfo[360].InvValueOfTxSigInfo Com_TxSigInfo[360].OnChangeIdxOfTxSigInfo Com_TxSigInfo[360].OnChangeOfTxSigInfo Com_TxSigInfo[360].StartByteInPduPositionOfTxSigInfo Com_TxSigInfo[360].TxAccessInfoIdxOfTxSigInfo Com_TxSigInfo[360].TxBufferEndIdxOfTxSigInfo Com_TxSigInfo[360].TxBufferStartIdxOfTxSigInfo Com_TxSigInfo[360].TxFilterInitValueArrayBasedFilterInitValueEndIdxOfTxSigInfo Com_TxSigInfo[360].TxFilterInitValueArrayBasedFilterInitValueStartIdxOfTxSigInfo Com_TxSigInfo[360].TxPduInfoIdxOfTxSigInfo Com_TxSigInfo[361].ApplTypeOfTxSigInfo Com_TxSigInfo[361].BitLengthOfTxSigInfo Com_TxSigInfo[361].BitPositionOfTxSigInfo Com_TxSigInfo[361].BusAccOfTxSigInfo Com_TxSigInfo[361].ByteLengthOfTxSigInfo Com_TxSigInfo[361].DynSignalOfTxSigInfo Com_TxSigInfo[361].FilterInitValueIdxOfTxSigInfo Com_TxSigInfo[361].FilterInitValueOfTxSigInfo Com_TxSigInfo[361].InvValueIdxOfTxSigInfo Com_TxSigInfo[361].InvValueOfTxSigInfo Com_TxSigInfo[361].OnChangeIdxOfTxSigInfo Com_TxSigInfo[361].OnChangeOfTxSigInfo Com_TxSigInfo[361].StartByteInPduPositionOfTxSigInfo Com_TxSigInfo[361].TxAccessInfoIdxOfTxSigInfo Com_TxSigInfo[361].TxBufferEndIdxOfTxSigInfo Com_TxSigInfo[361].TxBufferStartIdxOfTxSigInfo Com_TxSigInfo[361].TxFilterInitValueArrayBasedFilterInitValueEndIdxOfTxSigInfo Com_TxSigInfo[361].TxFilterInitValueArrayBasedFilterInitValueStartIdxOfTxSigInfo Com_TxSigInfo[361].TxPduInfoIdxOfTxSigInfo Com_TxSigInfo[362].ApplTypeOfTxSigInfo Com_TxSigInfo[362].BitLengthOfTxSigInfo Com_TxSigInfo[362].BitPositionOfTxSigInfo Com_TxSigInfo[362].BusAccOfTxSigInfo Com_TxSigInfo[362].ByteLengthOfTxSigInfo Com_TxSigInfo[362].DynSignalOfTxSigInfo Com_TxSigInfo[362].FilterInitValueIdxOfTxSigInfo Com_TxSigInfo[362].FilterInitValueOfTxSigInfo Com_TxSigInfo[362].InvValueIdxOfTxSigInfo Com_TxSigInfo[362].InvValueOfTxSigInfo Com_TxSigInfo[362].OnChangeIdxOfTxSigInfo Com_TxSigInfo[362].OnChangeOfTxSigInfo Com_TxSigInfo[362].StartByteInPduPositionOfTxSigInfo Com_TxSigInfo[362].TxAccessInfoIdxOfTxSigInfo Com_TxSigInfo[362].TxBufferEndIdxOfTxSigInfo Com_TxSigInfo[362].TxBufferStartIdxOfTxSigInfo Com_TxSigInfo[362].TxFilterInitValueArrayBasedFilterInitValueEndIdxOfTxSigInfo Com_TxSigInfo[362].TxFilterInitValueArrayBasedFilterInitValueStartIdxOfTxSigInfo Com_TxSigInfo[362].TxPduInfoIdxOfTxSigInfo Com_TxSigInfo[363].ApplTypeOfTxSigInfo Com_TxSigInfo[363].BitLengthOfTxSigInfo Com_TxSigInfo[363].BitPositionOfTxSigInfo Com_TxSigInfo[363].BusAccOfTxSigInfo Com_TxSigInfo[363].ByteLengthOfTxSigInfo Com_TxSigInfo[363].DynSignalOfTxSigInfo Com_TxSigInfo[363].FilterInitValueIdxOfTxSigInfo Com_TxSigInfo[363].FilterInitValueOfTxSigInfo Com_TxSigInfo[363].InvValueIdxOfTxSigInfo Com_TxSigInfo[363].InvValueOfTxSigInfo Com_TxSigInfo[363].OnChangeIdxOfTxSigInfo Com_TxSigInfo[363].OnChangeOfTxSigInfo Com_TxSigInfo[363].StartByteInPduPositionOfTxSigInfo Com_TxSigInfo[363].TxAccessInfoIdxOfTxSigInfo Com_TxSigInfo[363].TxBufferEndIdxOfTxSigInfo Com_TxSigInfo[363].TxBufferStartIdxOfTxSigInfo Com_TxSigInfo[363].TxFilterInitValueArrayBasedFilterInitValueEndIdxOfTxSigInfo Com_TxSigInfo[363].TxFilterInitValueArrayBasedFilterInitValueStartIdxOfTxSigInfo Com_TxSigInfo[363].TxPduInfoIdxOfTxSigInfo Com_TxSigInfo[364].ApplTypeOfTxSigInfo Com_TxSigInfo[364].BitLengthOfTxSigInfo Com_TxSigInfo[364].BitPositionOfTxSigInfo Com_TxSigInfo[364].BusAccOfTxSigInfo Com_TxSigInfo[364].ByteLengthOfTxSigInfo Com_TxSigInfo[364].DynSignalOfTxSigInfo Com_TxSigInfo[364].FilterInitValueIdxOfTxSigInfo Com_TxSigInfo[364].FilterInitValueOfTxSigInfo Com_TxSigInfo[364].InvValueIdxOfTxSigInfo Com_TxSigInfo[364].InvValueOfTxSigInfo Com_TxSigInfo[364].OnChangeIdxOfTxSigInfo Com_TxSigInfo[364].OnChangeOfTxSigInfo Com_TxSigInfo[364].StartByteInPduPositionOfTxSigInfo Com_TxSigInfo[364].TxAccessInfoIdxOfTxSigInfo Com_TxSigInfo[364].TxBufferEndIdxOfTxSigInfo Com_TxSigInfo[364].TxBufferStartIdxOfTxSigInfo Com_TxSigInfo[364].TxFilterInitValueArrayBasedFilterInitValueEndIdxOfTxSigInfo Com_TxSigInfo[364].TxFilterInitValueArrayBasedFilterInitValueStartIdxOfTxSigInfo Com_TxSigInfo[364].TxPduInfoIdxOfTxSigInfo Com_TxSigInfo[365].ApplTypeOfTxSigInfo Com_TxSigInfo[365].BitLengthOfTxSigInfo Com_TxSigInfo[365].BitPositionOfTxSigInfo Com_TxSigInfo[365].BusAccOfTxSigInfo Com_TxSigInfo[365].ByteLengthOfTxSigInfo Com_TxSigInfo[365].DynSignalOfTxSigInfo Com_TxSigInfo[365].FilterInitValueIdxOfTxSigInfo Com_TxSigInfo[365].FilterInitValueOfTxSigInfo Com_TxSigInfo[365].InvValueIdxOfTxSigInfo Com_TxSigInfo[365].InvValueOfTxSigInfo Com_TxSigInfo[365].OnChangeIdxOfTxSigInfo Com_TxSigInfo[365].OnChangeOfTxSigInfo Com_TxSigInfo[365].StartByteInPduPositionOfTxSigInfo Com_TxSigInfo[365].TxAccessInfoIdxOfTxSigInfo Com_TxSigInfo[365].TxBufferEndIdxOfTxSigInfo Com_TxSigInfo[365].TxBufferStartIdxOfTxSigInfo Com_TxSigInfo[365].TxFilterInitValueArrayBasedFilterInitValueEndIdxOfTxSigInfo Com_TxSigInfo[365].TxFilterInitValueArrayBasedFilterInitValueStartIdxOfTxSigInfo Com_TxSigInfo[365].TxPduInfoIdxOfTxSigInfo Com_TxSigInfo[366].ApplTypeOfTxSigInfo Com_TxSigInfo[366].BitLengthOfTxSigInfo Com_TxSigInfo[366].BitPositionOfTxSigInfo Com_TxSigInfo[366].BusAccOfTxSigInfo Com_TxSigInfo[366].ByteLengthOfTxSigInfo Com_TxSigInfo[366].DynSignalOfTxSigInfo Com_TxSigInfo[366].FilterInitValueIdxOfTxSigInfo Com_TxSigInfo[366].FilterInitValueOfTxSigInfo Com_TxSigInfo[366].InvValueIdxOfTxSigInfo Com_TxSigInfo[366].InvValueOfTxSigInfo Com_TxSigInfo[366].OnChangeIdxOfTxSigInfo Com_TxSigInfo[366].OnChangeOfTxSigInfo Com_TxSigInfo[366].StartByteInPduPositionOfTxSigInfo Com_TxSigInfo[366].TxAccessInfoIdxOfTxSigInfo Com_TxSigInfo[366].TxBufferEndIdxOfTxSigInfo Com_TxSigInfo[366].TxBufferStartIdxOfTxSigInfo Com_TxSigInfo[366].TxFilterInitValueArrayBasedFilterInitValueEndIdxOfTxSigInfo Com_TxSigInfo[366].TxFilterInitValueArrayBasedFilterInitValueStartIdxOfTxSigInfo Com_TxSigInfo[366].TxPduInfoIdxOfTxSigInfo Com_TxSigInfo[367].ApplTypeOfTxSigInfo Com_TxSigInfo[367].BitLengthOfTxSigInfo Com_TxSigInfo[367].BitPositionOfTxSigInfo Com_TxSigInfo[367].BusAccOfTxSigInfo Com_TxSigInfo[367].ByteLengthOfTxSigInfo Com_TxSigInfo[367].DynSignalOfTxSigInfo Com_TxSigInfo[367].FilterInitValueIdxOfTxSigInfo Com_TxSigInfo[367].FilterInitValueOfTxSigInfo Com_TxSigInfo[367].InvValueIdxOfTxSigInfo Com_TxSigInfo[367].InvValueOfTxSigInfo Com_TxSigInfo[367].OnChangeIdxOfTxSigInfo Com_TxSigInfo[367].OnChangeOfTxSigInfo Com_TxSigInfo[367].StartByteInPduPositionOfTxSigInfo Com_TxSigInfo[367].TxAccessInfoIdxOfTxSigInfo Com_TxSigInfo[367].TxBufferEndIdxOfTxSigInfo Com_TxSigInfo[367].TxBufferStartIdxOfTxSigInfo Com_TxSigInfo[367].TxFilterInitValueArrayBasedFilterInitValueEndIdxOfTxSigInfo Com_TxSigInfo[367].TxFilterInitValueArrayBasedFilterInitValueStartIdxOfTxSigInfo Com_TxSigInfo[367].TxPduInfoIdxOfTxSigInfo Com_TxSigInfo[368].ApplTypeOfTxSigInfo Com_TxSigInfo[368].BitLengthOfTxSigInfo Com_TxSigInfo[368].BitPositionOfTxSigInfo Com_TxSigInfo[368].BusAccOfTxSigInfo Com_TxSigInfo[368].ByteLengthOfTxSigInfo Com_TxSigInfo[368].DynSignalOfTxSigInfo Com_TxSigInfo[368].FilterInitValueIdxOfTxSigInfo Com_TxSigInfo[368].FilterInitValueOfTxSigInfo Com_TxSigInfo[368].InvValueIdxOfTxSigInfo Com_TxSigInfo[368].InvValueOfTxSigInfo Com_TxSigInfo[368].OnChangeIdxOfTxSigInfo Com_TxSigInfo[368].OnChangeOfTxSigInfo Com_TxSigInfo[368].StartByteInPduPositionOfTxSigInfo Com_TxSigInfo[368].TxAccessInfoIdxOfTxSigInfo Com_TxSigInfo[368].TxBufferEndIdxOfTxSigInfo Com_TxSigInfo[368].TxBufferStartIdxOfTxSigInfo Com_TxSigInfo[368].TxFilterInitValueArrayBasedFilterInitValueEndIdxOfTxSigInfo Com_TxSigInfo[368].TxFilterInitValueArrayBasedFilterInitValueStartIdxOfTxSigInfo Com_TxSigInfo[368].TxPduInfoIdxOfTxSigInfo Com_TxSigInfo[369].ApplTypeOfTxSigInfo Com_TxSigInfo[369].BitLengthOfTxSigInfo Com_TxSigInfo[369].BitPositionOfTxSigInfo Com_TxSigInfo[369].BusAccOfTxSigInfo Com_TxSigInfo[369].ByteLengthOfTxSigInfo Com_TxSigInfo[369].DynSignalOfTxSigInfo Com_TxSigInfo[369].FilterInitValueIdxOfTxSigInfo Com_TxSigInfo[369].FilterInitValueOfTxSigInfo Com_TxSigInfo[369].InvValueIdxOfTxSigInfo Com_TxSigInfo[369].InvValueOfTxSigInfo Com_TxSigInfo[369].OnChangeIdxOfTxSigInfo Com_TxSigInfo[369].OnChangeOfTxSigInfo Com_TxSigInfo[369].StartByteInPduPositionOfTxSigInfo Com_TxSigInfo[369].TxAccessInfoIdxOfTxSigInfo Com_TxSigInfo[369].TxBufferEndIdxOfTxSigInfo Com_TxSigInfo[369].TxBufferStartIdxOfTxSigInfo Com_TxSigInfo[369].TxFilterInitValueArrayBasedFilterInitValueEndIdxOfTxSigInfo Com_TxSigInfo[369].TxFilterInitValueArrayBasedFilterInitValueStartIdxOfTxSigInfo Com_TxSigInfo[369].TxPduInfoIdxOfTxSigInfo Com_TxSigInfo[36].ApplTypeOfTxSigInfo Com_TxSigInfo[36].BitLengthOfTxSigInfo Com_TxSigInfo[36].BitPositionOfTxSigInfo Com_TxSigInfo[36].BusAccOfTxSigInfo Com_TxSigInfo[36].ByteLengthOfTxSigInfo Com_TxSigInfo[36].DynSignalOfTxSigInfo Com_TxSigInfo[36].FilterInitValueIdxOfTxSigInfo Com_TxSigInfo[36].FilterInitValueOfTxSigInfo Com_TxSigInfo[36].InvValueIdxOfTxSigInfo Com_TxSigInfo[36].InvValueOfTxSigInfo Com_TxSigInfo[36].OnChangeIdxOfTxSigInfo Com_TxSigInfo[36].OnChangeOfTxSigInfo Com_TxSigInfo[36].StartByteInPduPositionOfTxSigInfo Com_TxSigInfo[36].TxAccessInfoIdxOfTxSigInfo Com_TxSigInfo[36].TxBufferEndIdxOfTxSigInfo Com_TxSigInfo[36].TxBufferStartIdxOfTxSigInfo Com_TxSigInfo[36].TxFilterInitValueArrayBasedFilterInitValueEndIdxOfTxSigInfo Com_TxSigInfo[36].TxFilterInitValueArrayBasedFilterInitValueStartIdxOfTxSigInfo Com_TxSigInfo[36].TxPduInfoIdxOfTxSigInfo Com_TxSigInfo[370].ApplTypeOfTxSigInfo Com_TxSigInfo[370].BitLengthOfTxSigInfo Com_TxSigInfo[370].BitPositionOfTxSigInfo Com_TxSigInfo[370].BusAccOfTxSigInfo Com_TxSigInfo[370].ByteLengthOfTxSigInfo Com_TxSigInfo[370].DynSignalOfTxSigInfo Com_TxSigInfo[370].FilterInitValueIdxOfTxSigInfo Com_TxSigInfo[370].FilterInitValueOfTxSigInfo Com_TxSigInfo[370].InvValueIdxOfTxSigInfo Com_TxSigInfo[370].InvValueOfTxSigInfo Com_TxSigInfo[370].OnChangeIdxOfTxSigInfo Com_TxSigInfo[370].OnChangeOfTxSigInfo Com_TxSigInfo[370].StartByteInPduPositionOfTxSigInfo Com_TxSigInfo[370].TxAccessInfoIdxOfTxSigInfo Com_TxSigInfo[370].TxBufferEndIdxOfTxSigInfo Com_TxSigInfo[370].TxBufferStartIdxOfTxSigInfo Com_TxSigInfo[370].TxFilterInitValueArrayBasedFilterInitValueEndIdxOfTxSigInfo Com_TxSigInfo[370].TxFilterInitValueArrayBasedFilterInitValueStartIdxOfTxSigInfo Com_TxSigInfo[370].TxPduInfoIdxOfTxSigInfo Com_TxSigInfo[371].ApplTypeOfTxSigInfo Com_TxSigInfo[371].BitLengthOfTxSigInfo Com_TxSigInfo[371].BitPositionOfTxSigInfo Com_TxSigInfo[371].BusAccOfTxSigInfo Com_TxSigInfo[371].ByteLengthOfTxSigInfo Com_TxSigInfo[371].DynSignalOfTxSigInfo Com_TxSigInfo[371].FilterInitValueIdxOfTxSigInfo Com_TxSigInfo[371].FilterInitValueOfTxSigInfo Com_TxSigInfo[371].InvValueIdxOfTxSigInfo Com_TxSigInfo[371].InvValueOfTxSigInfo Com_TxSigInfo[371].OnChangeIdxOfTxSigInfo Com_TxSigInfo[371].OnChangeOfTxSigInfo Com_TxSigInfo[371].StartByteInPduPositionOfTxSigInfo Com_TxSigInfo[371].TxAccessInfoIdxOfTxSigInfo Com_TxSigInfo[371].TxBufferEndIdxOfTxSigInfo Com_TxSigInfo[371].TxBufferStartIdxOfTxSigInfo Com_TxSigInfo[371].TxFilterInitValueArrayBasedFilterInitValueEndIdxOfTxSigInfo Com_TxSigInfo[371].TxFilterInitValueArrayBasedFilterInitValueStartIdxOfTxSigInfo Com_TxSigInfo[371].TxPduInfoIdxOfTxSigInfo Com_TxSigInfo[372].ApplTypeOfTxSigInfo Com_TxSigInfo[372].BitLengthOfTxSigInfo Com_TxSigInfo[372].BitPositionOfTxSigInfo Com_TxSigInfo[372].BusAccOfTxSigInfo Com_TxSigInfo[372].ByteLengthOfTxSigInfo Com_TxSigInfo[372].DynSignalOfTxSigInfo Com_TxSigInfo[372].FilterInitValueIdxOfTxSigInfo Com_TxSigInfo[372].FilterInitValueOfTxSigInfo Com_TxSigInfo[372].InvValueIdxOfTxSigInfo Com_TxSigInfo[372].InvValueOfTxSigInfo Com_TxSigInfo[372].OnChangeIdxOfTxSigInfo Com_TxSigInfo[372].OnChangeOfTxSigInfo Com_TxSigInfo[372].StartByteInPduPositionOfTxSigInfo Com_TxSigInfo[372].TxAccessInfoIdxOfTxSigInfo Com_TxSigInfo[372].TxBufferEndIdxOfTxSigInfo Com_TxSigInfo[372].TxBufferStartIdxOfTxSigInfo Com_TxSigInfo[372].TxFilterInitValueArrayBasedFilterInitValueEndIdxOfTxSigInfo Com_TxSigInfo[372].TxFilterInitValueArrayBasedFilterInitValueStartIdxOfTxSigInfo Com_TxSigInfo[372].TxPduInfoIdxOfTxSigInfo Com_TxSigInfo[373].ApplTypeOfTxSigInfo Com_TxSigInfo[373].BitLengthOfTxSigInfo Com_TxSigInfo[373].BitPositionOfTxSigInfo Com_TxSigInfo[373].BusAccOfTxSigInfo Com_TxSigInfo[373].ByteLengthOfTxSigInfo Com_TxSigInfo[373].DynSignalOfTxSigInfo Com_TxSigInfo[373].FilterInitValueIdxOfTxSigInfo Com_TxSigInfo[373].FilterInitValueOfTxSigInfo Com_TxSigInfo[373].InvValueIdxOfTxSigInfo Com_TxSigInfo[373].InvValueOfTxSigInfo Com_TxSigInfo[373].OnChangeIdxOfTxSigInfo Com_TxSigInfo[373].OnChangeOfTxSigInfo Com_TxSigInfo[373].StartByteInPduPositionOfTxSigInfo Com_TxSigInfo[373].TxAccessInfoIdxOfTxSigInfo Com_TxSigInfo[373].TxBufferEndIdxOfTxSigInfo Com_TxSigInfo[373].TxBufferStartIdxOfTxSigInfo Com_TxSigInfo[373].TxFilterInitValueArrayBasedFilterInitValueEndIdxOfTxSigInfo Com_TxSigInfo[373].TxFilterInitValueArrayBasedFilterInitValueStartIdxOfTxSigInfo Com_TxSigInfo[373].TxPduInfoIdxOfTxSigInfo Com_TxSigInfo[374].ApplTypeOfTxSigInfo Com_TxSigInfo[374].BitLengthOfTxSigInfo Com_TxSigInfo[374].BitPositionOfTxSigInfo Com_TxSigInfo[374].BusAccOfTxSigInfo Com_TxSigInfo[374].ByteLengthOfTxSigInfo Com_TxSigInfo[374].DynSignalOfTxSigInfo Com_TxSigInfo[374].FilterInitValueIdxOfTxSigInfo Com_TxSigInfo[374].FilterInitValueOfTxSigInfo Com_TxSigInfo[374].InvValueIdxOfTxSigInfo Com_TxSigInfo[374].InvValueOfTxSigInfo Com_TxSigInfo[374].OnChangeIdxOfTxSigInfo Com_TxSigInfo[374].OnChangeOfTxSigInfo Com_TxSigInfo[374].StartByteInPduPositionOfTxSigInfo Com_TxSigInfo[374].TxAccessInfoIdxOfTxSigInfo Com_TxSigInfo[374].TxBufferEndIdxOfTxSigInfo Com_TxSigInfo[374].TxBufferStartIdxOfTxSigInfo Com_TxSigInfo[374].TxFilterInitValueArrayBasedFilterInitValueEndIdxOfTxSigInfo Com_TxSigInfo[374].TxFilterInitValueArrayBasedFilterInitValueStartIdxOfTxSigInfo Com_TxSigInfo[374].TxPduInfoIdxOfTxSigInfo Com_TxSigInfo[375].ApplTypeOfTxSigInfo Com_TxSigInfo[375].BitLengthOfTxSigInfo Com_TxSigInfo[375].BitPositionOfTxSigInfo Com_TxSigInfo[375].BusAccOfTxSigInfo Com_TxSigInfo[375].ByteLengthOfTxSigInfo Com_TxSigInfo[375].DynSignalOfTxSigInfo Com_TxSigInfo[375].FilterInitValueIdxOfTxSigInfo Com_TxSigInfo[375].FilterInitValueOfTxSigInfo Com_TxSigInfo[375].InvValueIdxOfTxSigInfo Com_TxSigInfo[375].InvValueOfTxSigInfo Com_TxSigInfo[375].OnChangeIdxOfTxSigInfo Com_TxSigInfo[375].OnChangeOfTxSigInfo Com_TxSigInfo[375].StartByteInPduPositionOfTxSigInfo Com_TxSigInfo[375].TxAccessInfoIdxOfTxSigInfo Com_TxSigInfo[375].TxBufferEndIdxOfTxSigInfo Com_TxSigInfo[375].TxBufferStartIdxOfTxSigInfo Com_TxSigInfo[375].TxFilterInitValueArrayBasedFilterInitValueEndIdxOfTxSigInfo Com_TxSigInfo[375].TxFilterInitValueArrayBasedFilterInitValueStartIdxOfTxSigInfo Com_TxSigInfo[375].TxPduInfoIdxOfTxSigInfo Com_TxSigInfo[376].ApplTypeOfTxSigInfo Com_TxSigInfo[376].BitLengthOfTxSigInfo Com_TxSigInfo[376].BitPositionOfTxSigInfo Com_TxSigInfo[376].BusAccOfTxSigInfo Com_TxSigInfo[376].ByteLengthOfTxSigInfo Com_TxSigInfo[376].DynSignalOfTxSigInfo Com_TxSigInfo[376].FilterInitValueIdxOfTxSigInfo Com_TxSigInfo[376].FilterInitValueOfTxSigInfo Com_TxSigInfo[376].InvValueIdxOfTxSigInfo Com_TxSigInfo[376].InvValueOfTxSigInfo Com_TxSigInfo[376].OnChangeIdxOfTxSigInfo Com_TxSigInfo[376].OnChangeOfTxSigInfo Com_TxSigInfo[376].StartByteInPduPositionOfTxSigInfo Com_TxSigInfo[376].TxAccessInfoIdxOfTxSigInfo Com_TxSigInfo[376].TxBufferEndIdxOfTxSigInfo Com_TxSigInfo[376].TxBufferStartIdxOfTxSigInfo Com_TxSigInfo[376].TxFilterInitValueArrayBasedFilterInitValueEndIdxOfTxSigInfo Com_TxSigInfo[376].TxFilterInitValueArrayBasedFilterInitValueStartIdxOfTxSigInfo Com_TxSigInfo[376].TxPduInfoIdxOfTxSigInfo Com_TxSigInfo[377].ApplTypeOfTxSigInfo Com_TxSigInfo[377].BitLengthOfTxSigInfo Com_TxSigInfo[377].BitPositionOfTxSigInfo Com_TxSigInfo[377].BusAccOfTxSigInfo Com_TxSigInfo[377].ByteLengthOfTxSigInfo Com_TxSigInfo[377].DynSignalOfTxSigInfo Com_TxSigInfo[377].FilterInitValueIdxOfTxSigInfo Com_TxSigInfo[377].FilterInitValueOfTxSigInfo Com_TxSigInfo[377].InvValueIdxOfTxSigInfo Com_TxSigInfo[377].InvValueOfTxSigInfo Com_TxSigInfo[377].OnChangeIdxOfTxSigInfo Com_TxSigInfo[377].OnChangeOfTxSigInfo Com_TxSigInfo[377].StartByteInPduPositionOfTxSigInfo Com_TxSigInfo[377].TxAccessInfoIdxOfTxSigInfo Com_TxSigInfo[377].TxBufferEndIdxOfTxSigInfo Com_TxSigInfo[377].TxBufferStartIdxOfTxSigInfo Com_TxSigInfo[377].TxFilterInitValueArrayBasedFilterInitValueEndIdxOfTxSigInfo Com_TxSigInfo[377].TxFilterInitValueArrayBasedFilterInitValueStartIdxOfTxSigInfo Com_TxSigInfo[377].TxPduInfoIdxOfTxSigInfo Com_TxSigInfo[378].ApplTypeOfTxSigInfo Com_TxSigInfo[378].BitLengthOfTxSigInfo Com_TxSigInfo[378].BitPositionOfTxSigInfo Com_TxSigInfo[378].BusAccOfTxSigInfo Com_TxSigInfo[378].ByteLengthOfTxSigInfo Com_TxSigInfo[378].DynSignalOfTxSigInfo Com_TxSigInfo[378].FilterInitValueIdxOfTxSigInfo Com_TxSigInfo[378].FilterInitValueOfTxSigInfo Com_TxSigInfo[378].InvValueIdxOfTxSigInfo Com_TxSigInfo[378].InvValueOfTxSigInfo Com_TxSigInfo[378].OnChangeIdxOfTxSigInfo Com_TxSigInfo[378].OnChangeOfTxSigInfo Com_TxSigInfo[378].StartByteInPduPositionOfTxSigInfo Com_TxSigInfo[378].TxAccessInfoIdxOfTxSigInfo Com_TxSigInfo[378].TxBufferEndIdxOfTxSigInfo Com_TxSigInfo[378].TxBufferStartIdxOfTxSigInfo Com_TxSigInfo[378].TxFilterInitValueArrayBasedFilterInitValueEndIdxOfTxSigInfo Com_TxSigInfo[378].TxFilterInitValueArrayBasedFilterInitValueStartIdxOfTxSigInfo Com_TxSigInfo[378].TxPduInfoIdxOfTxSigInfo Com_TxSigInfo[379].ApplTypeOfTxSigInfo Com_TxSigInfo[379].BitLengthOfTxSigInfo Com_TxSigInfo[379].BitPositionOfTxSigInfo Com_TxSigInfo[379].BusAccOfTxSigInfo Com_TxSigInfo[379].ByteLengthOfTxSigInfo Com_TxSigInfo[379].DynSignalOfTxSigInfo Com_TxSigInfo[379].FilterInitValueIdxOfTxSigInfo Com_TxSigInfo[379].FilterInitValueOfTxSigInfo Com_TxSigInfo[379].InvValueIdxOfTxSigInfo Com_TxSigInfo[379].InvValueOfTxSigInfo Com_TxSigInfo[379].OnChangeIdxOfTxSigInfo Com_TxSigInfo[379].OnChangeOfTxSigInfo Com_TxSigInfo[379].StartByteInPduPositionOfTxSigInfo Com_TxSigInfo[379].TxAccessInfoIdxOfTxSigInfo Com_TxSigInfo[379].TxBufferEndIdxOfTxSigInfo Com_TxSigInfo[379].TxBufferStartIdxOfTxSigInfo Com_TxSigInfo[379].TxFilterInitValueArrayBasedFilterInitValueEndIdxOfTxSigInfo Com_TxSigInfo[379].TxFilterInitValueArrayBasedFilterInitValueStartIdxOfTxSigInfo Com_TxSigInfo[379].TxPduInfoIdxOfTxSigInfo Com_TxSigInfo[37].ApplTypeOfTxSigInfo Com_TxSigInfo[37].BitLengthOfTxSigInfo Com_TxSigInfo[37].BitPositionOfTxSigInfo Com_TxSigInfo[37].BusAccOfTxSigInfo Com_TxSigInfo[37].ByteLengthOfTxSigInfo Com_TxSigInfo[37].DynSignalOfTxSigInfo Com_TxSigInfo[37].FilterInitValueIdxOfTxSigInfo Com_TxSigInfo[37].FilterInitValueOfTxSigInfo Com_TxSigInfo[37].InvValueIdxOfTxSigInfo Com_TxSigInfo[37].InvValueOfTxSigInfo Com_TxSigInfo[37].OnChangeIdxOfTxSigInfo Com_TxSigInfo[37].OnChangeOfTxSigInfo Com_TxSigInfo[37].StartByteInPduPositionOfTxSigInfo Com_TxSigInfo[37].TxAccessInfoIdxOfTxSigInfo Com_TxSigInfo[37].TxBufferEndIdxOfTxSigInfo Com_TxSigInfo[37].TxBufferStartIdxOfTxSigInfo Com_TxSigInfo[37].TxFilterInitValueArrayBasedFilterInitValueEndIdxOfTxSigInfo Com_TxSigInfo[37].TxFilterInitValueArrayBasedFilterInitValueStartIdxOfTxSigInfo Com_TxSigInfo[37].TxPduInfoIdxOfTxSigInfo Com_TxSigInfo[380].ApplTypeOfTxSigInfo Com_TxSigInfo[380].BitLengthOfTxSigInfo Com_TxSigInfo[380].BitPositionOfTxSigInfo Com_TxSigInfo[380].BusAccOfTxSigInfo Com_TxSigInfo[380].ByteLengthOfTxSigInfo Com_TxSigInfo[380].DynSignalOfTxSigInfo Com_TxSigInfo[380].FilterInitValueIdxOfTxSigInfo Com_TxSigInfo[380].FilterInitValueOfTxSigInfo Com_TxSigInfo[380].InvValueIdxOfTxSigInfo Com_TxSigInfo[380].InvValueOfTxSigInfo Com_TxSigInfo[380].OnChangeIdxOfTxSigInfo Com_TxSigInfo[380].OnChangeOfTxSigInfo Com_TxSigInfo[380].StartByteInPduPositionOfTxSigInfo Com_TxSigInfo[380].TxAccessInfoIdxOfTxSigInfo Com_TxSigInfo[380].TxBufferEndIdxOfTxSigInfo Com_TxSigInfo[380].TxBufferStartIdxOfTxSigInfo Com_TxSigInfo[380].TxFilterInitValueArrayBasedFilterInitValueEndIdxOfTxSigInfo Com_TxSigInfo[380].TxFilterInitValueArrayBasedFilterInitValueStartIdxOfTxSigInfo Com_TxSigInfo[380].TxPduInfoIdxOfTxSigInfo Com_TxSigInfo[381].ApplTypeOfTxSigInfo Com_TxSigInfo[381].BitLengthOfTxSigInfo Com_TxSigInfo[381].BitPositionOfTxSigInfo Com_TxSigInfo[381].BusAccOfTxSigInfo Com_TxSigInfo[381].ByteLengthOfTxSigInfo Com_TxSigInfo[381].DynSignalOfTxSigInfo Com_TxSigInfo[381].FilterInitValueIdxOfTxSigInfo Com_TxSigInfo[381].FilterInitValueOfTxSigInfo Com_TxSigInfo[381].InvValueIdxOfTxSigInfo Com_TxSigInfo[381].InvValueOfTxSigInfo Com_TxSigInfo[381].OnChangeIdxOfTxSigInfo Com_TxSigInfo[381].OnChangeOfTxSigInfo Com_TxSigInfo[381].StartByteInPduPositionOfTxSigInfo Com_TxSigInfo[381].TxAccessInfoIdxOfTxSigInfo Com_TxSigInfo[381].TxBufferEndIdxOfTxSigInfo Com_TxSigInfo[381].TxBufferStartIdxOfTxSigInfo Com_TxSigInfo[381].TxFilterInitValueArrayBasedFilterInitValueEndIdxOfTxSigInfo Com_TxSigInfo[381].TxFilterInitValueArrayBasedFilterInitValueStartIdxOfTxSigInfo Com_TxSigInfo[381].TxPduInfoIdxOfTxSigInfo Com_TxSigInfo[382].ApplTypeOfTxSigInfo Com_TxSigInfo[382].BitLengthOfTxSigInfo Com_TxSigInfo[382].BitPositionOfTxSigInfo Com_TxSigInfo[382].BusAccOfTxSigInfo Com_TxSigInfo[382].ByteLengthOfTxSigInfo Com_TxSigInfo[382].DynSignalOfTxSigInfo Com_TxSigInfo[382].FilterInitValueIdxOfTxSigInfo Com_TxSigInfo[382].FilterInitValueOfTxSigInfo Com_TxSigInfo[382].InvValueIdxOfTxSigInfo Com_TxSigInfo[382].InvValueOfTxSigInfo Com_TxSigInfo[382].OnChangeIdxOfTxSigInfo Com_TxSigInfo[382].OnChangeOfTxSigInfo Com_TxSigInfo[382].StartByteInPduPositionOfTxSigInfo Com_TxSigInfo[382].TxAccessInfoIdxOfTxSigInfo Com_TxSigInfo[382].TxBufferEndIdxOfTxSigInfo Com_TxSigInfo[382].TxBufferStartIdxOfTxSigInfo Com_TxSigInfo[382].TxFilterInitValueArrayBasedFilterInitValueEndIdxOfTxSigInfo Com_TxSigInfo[382].TxFilterInitValueArrayBasedFilterInitValueStartIdxOfTxSigInfo Com_TxSigInfo[382].TxPduInfoIdxOfTxSigInfo Com_TxSigInfo[383].ApplTypeOfTxSigInfo Com_TxSigInfo[383].BitLengthOfTxSigInfo Com_TxSigInfo[383].BitPositionOfTxSigInfo Com_TxSigInfo[383].BusAccOfTxSigInfo Com_TxSigInfo[383].ByteLengthOfTxSigInfo Com_TxSigInfo[383].DynSignalOfTxSigInfo Com_TxSigInfo[383].FilterInitValueIdxOfTxSigInfo Com_TxSigInfo[383].FilterInitValueOfTxSigInfo Com_TxSigInfo[383].InvValueIdxOfTxSigInfo Com_TxSigInfo[383].InvValueOfTxSigInfo Com_TxSigInfo[383].OnChangeIdxOfTxSigInfo Com_TxSigInfo[383].OnChangeOfTxSigInfo Com_TxSigInfo[383].StartByteInPduPositionOfTxSigInfo Com_TxSigInfo[383].TxAccessInfoIdxOfTxSigInfo Com_TxSigInfo[383].TxBufferEndIdxOfTxSigInfo Com_TxSigInfo[383].TxBufferStartIdxOfTxSigInfo Com_TxSigInfo[383].TxFilterInitValueArrayBasedFilterInitValueEndIdxOfTxSigInfo Com_TxSigInfo[383].TxFilterInitValueArrayBasedFilterInitValueStartIdxOfTxSigInfo Com_TxSigInfo[383].TxPduInfoIdxOfTxSigInfo Com_TxSigInfo[384].ApplTypeOfTxSigInfo Com_TxSigInfo[384].BitLengthOfTxSigInfo Com_TxSigInfo[384].BitPositionOfTxSigInfo Com_TxSigInfo[384].BusAccOfTxSigInfo Com_TxSigInfo[384].ByteLengthOfTxSigInfo Com_TxSigInfo[384].DynSignalOfTxSigInfo Com_TxSigInfo[384].FilterInitValueIdxOfTxSigInfo Com_TxSigInfo[384].FilterInitValueOfTxSigInfo Com_TxSigInfo[384].InvValueIdxOfTxSigInfo Com_TxSigInfo[384].InvValueOfTxSigInfo Com_TxSigInfo[384].OnChangeIdxOfTxSigInfo Com_TxSigInfo[384].OnChangeOfTxSigInfo Com_TxSigInfo[384].StartByteInPduPositionOfTxSigInfo Com_TxSigInfo[384].TxAccessInfoIdxOfTxSigInfo Com_TxSigInfo[384].TxBufferEndIdxOfTxSigInfo Com_TxSigInfo[384].TxBufferStartIdxOfTxSigInfo Com_TxSigInfo[384].TxFilterInitValueArrayBasedFilterInitValueEndIdxOfTxSigInfo Com_TxSigInfo[384].TxFilterInitValueArrayBasedFilterInitValueStartIdxOfTxSigInfo Com_TxSigInfo[384].TxPduInfoIdxOfTxSigInfo Com_TxSigInfo[385].ApplTypeOfTxSigInfo Com_TxSigInfo[385].BitLengthOfTxSigInfo Com_TxSigInfo[385].BitPositionOfTxSigInfo Com_TxSigInfo[385].BusAccOfTxSigInfo Com_TxSigInfo[385].ByteLengthOfTxSigInfo Com_TxSigInfo[385].DynSignalOfTxSigInfo Com_TxSigInfo[385].FilterInitValueIdxOfTxSigInfo Com_TxSigInfo[385].FilterInitValueOfTxSigInfo Com_TxSigInfo[385].InvValueIdxOfTxSigInfo Com_TxSigInfo[385].InvValueOfTxSigInfo Com_TxSigInfo[385].OnChangeIdxOfTxSigInfo Com_TxSigInfo[385].OnChangeOfTxSigInfo Com_TxSigInfo[385].StartByteInPduPositionOfTxSigInfo Com_TxSigInfo[385].TxAccessInfoIdxOfTxSigInfo Com_TxSigInfo[385].TxBufferEndIdxOfTxSigInfo Com_TxSigInfo[385].TxBufferStartIdxOfTxSigInfo Com_TxSigInfo[385].TxFilterInitValueArrayBasedFilterInitValueEndIdxOfTxSigInfo Com_TxSigInfo[385].TxFilterInitValueArrayBasedFilterInitValueStartIdxOfTxSigInfo Com_TxSigInfo[385].TxPduInfoIdxOfTxSigInfo Com_TxSigInfo[386].ApplTypeOfTxSigInfo Com_TxSigInfo[386].BitLengthOfTxSigInfo Com_TxSigInfo[386].BitPositionOfTxSigInfo Com_TxSigInfo[386].BusAccOfTxSigInfo Com_TxSigInfo[386].ByteLengthOfTxSigInfo Com_TxSigInfo[386].DynSignalOfTxSigInfo Com_TxSigInfo[386].FilterInitValueIdxOfTxSigInfo Com_TxSigInfo[386].FilterInitValueOfTxSigInfo Com_TxSigInfo[386].InvValueIdxOfTxSigInfo Com_TxSigInfo[386].InvValueOfTxSigInfo Com_TxSigInfo[386].OnChangeIdxOfTxSigInfo Com_TxSigInfo[386].OnChangeOfTxSigInfo Com_TxSigInfo[386].StartByteInPduPositionOfTxSigInfo Com_TxSigInfo[386].TxAccessInfoIdxOfTxSigInfo Com_TxSigInfo[386].TxBufferEndIdxOfTxSigInfo Com_TxSigInfo[386].TxBufferStartIdxOfTxSigInfo Com_TxSigInfo[386].TxFilterInitValueArrayBasedFilterInitValueEndIdxOfTxSigInfo Com_TxSigInfo[386].TxFilterInitValueArrayBasedFilterInitValueStartIdxOfTxSigInfo Com_TxSigInfo[386].TxPduInfoIdxOfTxSigInfo Com_TxSigInfo[387].ApplTypeOfTxSigInfo Com_TxSigInfo[387].BitLengthOfTxSigInfo Com_TxSigInfo[387].BitPositionOfTxSigInfo Com_TxSigInfo[387].BusAccOfTxSigInfo Com_TxSigInfo[387].ByteLengthOfTxSigInfo Com_TxSigInfo[387].DynSignalOfTxSigInfo Com_TxSigInfo[387].FilterInitValueIdxOfTxSigInfo Com_TxSigInfo[387].FilterInitValueOfTxSigInfo Com_TxSigInfo[387].InvValueIdxOfTxSigInfo Com_TxSigInfo[387].InvValueOfTxSigInfo Com_TxSigInfo[387].OnChangeIdxOfTxSigInfo Com_TxSigInfo[387].OnChangeOfTxSigInfo Com_TxSigInfo[387].StartByteInPduPositionOfTxSigInfo Com_TxSigInfo[387].TxAccessInfoIdxOfTxSigInfo Com_TxSigInfo[387].TxBufferEndIdxOfTxSigInfo Com_TxSigInfo[387].TxBufferStartIdxOfTxSigInfo Com_TxSigInfo[387].TxFilterInitValueArrayBasedFilterInitValueEndIdxOfTxSigInfo Com_TxSigInfo[387].TxFilterInitValueArrayBasedFilterInitValueStartIdxOfTxSigInfo Com_TxSigInfo[387].TxPduInfoIdxOfTxSigInfo Com_TxSigInfo[388].ApplTypeOfTxSigInfo Com_TxSigInfo[388].BitLengthOfTxSigInfo Com_TxSigInfo[388].BitPositionOfTxSigInfo Com_TxSigInfo[388].BusAccOfTxSigInfo Com_TxSigInfo[388].ByteLengthOfTxSigInfo Com_TxSigInfo[388].DynSignalOfTxSigInfo Com_TxSigInfo[388].FilterInitValueIdxOfTxSigInfo Com_TxSigInfo[388].FilterInitValueOfTxSigInfo Com_TxSigInfo[388].InvValueIdxOfTxSigInfo Com_TxSigInfo[388].InvValueOfTxSigInfo Com_TxSigInfo[388].OnChangeIdxOfTxSigInfo Com_TxSigInfo[388].OnChangeOfTxSigInfo Com_TxSigInfo[388].StartByteInPduPositionOfTxSigInfo Com_TxSigInfo[388].TxAccessInfoIdxOfTxSigInfo Com_TxSigInfo[388].TxBufferEndIdxOfTxSigInfo Com_TxSigInfo[388].TxBufferStartIdxOfTxSigInfo Com_TxSigInfo[388].TxFilterInitValueArrayBasedFilterInitValueEndIdxOfTxSigInfo Com_TxSigInfo[388].TxFilterInitValueArrayBasedFilterInitValueStartIdxOfTxSigInfo Com_TxSigInfo[388].TxPduInfoIdxOfTxSigInfo Com_TxSigInfo[389].ApplTypeOfTxSigInfo Com_TxSigInfo[389].BitLengthOfTxSigInfo Com_TxSigInfo[389].BitPositionOfTxSigInfo Com_TxSigInfo[389].BusAccOfTxSigInfo Com_TxSigInfo[389].ByteLengthOfTxSigInfo Com_TxSigInfo[389].DynSignalOfTxSigInfo Com_TxSigInfo[389].FilterInitValueIdxOfTxSigInfo Com_TxSigInfo[389].FilterInitValueOfTxSigInfo Com_TxSigInfo[389].InvValueIdxOfTxSigInfo Com_TxSigInfo[389].InvValueOfTxSigInfo Com_TxSigInfo[389].OnChangeIdxOfTxSigInfo Com_TxSigInfo[389].OnChangeOfTxSigInfo Com_TxSigInfo[389].StartByteInPduPositionOfTxSigInfo Com_TxSigInfo[389].TxAccessInfoIdxOfTxSigInfo Com_TxSigInfo[389].TxBufferEndIdxOfTxSigInfo Com_TxSigInfo[389].TxBufferStartIdxOfTxSigInfo Com_TxSigInfo[389].TxFilterInitValueArrayBasedFilterInitValueEndIdxOfTxSigInfo Com_TxSigInfo[389].TxFilterInitValueArrayBasedFilterInitValueStartIdxOfTxSigInfo Com_TxSigInfo[389].TxPduInfoIdxOfTxSigInfo Com_TxSigInfo[38].ApplTypeOfTxSigInfo Com_TxSigInfo[38].BitLengthOfTxSigInfo Com_TxSigInfo[38].BitPositionOfTxSigInfo Com_TxSigInfo[38].BusAccOfTxSigInfo Com_TxSigInfo[38].ByteLengthOfTxSigInfo Com_TxSigInfo[38].DynSignalOfTxSigInfo Com_TxSigInfo[38].FilterInitValueIdxOfTxSigInfo Com_TxSigInfo[38].FilterInitValueOfTxSigInfo Com_TxSigInfo[38].InvValueIdxOfTxSigInfo Com_TxSigInfo[38].InvValueOfTxSigInfo Com_TxSigInfo[38].OnChangeIdxOfTxSigInfo Com_TxSigInfo[38].OnChangeOfTxSigInfo Com_TxSigInfo[38].StartByteInPduPositionOfTxSigInfo Com_TxSigInfo[38].TxAccessInfoIdxOfTxSigInfo Com_TxSigInfo[38].TxBufferEndIdxOfTxSigInfo Com_TxSigInfo[38].TxBufferStartIdxOfTxSigInfo /end REF_MEASUREMENT
/end GROUP
/end MODULE
/end PROJECT
