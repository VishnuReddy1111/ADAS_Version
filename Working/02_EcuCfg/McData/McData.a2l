ASAP2_VERSION 1 71
/begin PROJECT MICROSAR ""
/begin MODULE CPP ""
/begin MOD_COMMON "" BYTE_ORDER MSB_LAST ALIGNMENT_BYTE 1 ALIGNMENT_WORD 2 ALIGNMENT_LONG 4 ALIGNMENT_FLOAT16_IEEE 2 ALIGNMENT_FLOAT32_IEEE 4 ALIGNMENT_FLOAT64_IEEE 8 ALIGNMENT_INT64 8 /end MOD_COMMON
/begin MEASUREMENT Com_RxAccessInfo[19].ApplTypeOfRxAccessInfo "" UBYTE Com_ApplTypeOfRxAccessInfoType 0 0 0 255 ECU_ADDRESS 0x0 /end MEASUREMENT
/begin MEASUREMENT Com_RxAccessInfo[19].BitLengthOfRxAccessInfo "" UWORD NO_COMPU_METHOD 0 0 0 65535 ECU_ADDRESS 0x0 /end MEASUREMENT
/begin MEASUREMENT Com_RxAccessInfo[19].BitPositionOfRxAccessInfo "" UWORD NO_COMPU_METHOD 0 0 0 65535 ECU_ADDRESS 0x0 /end MEASUREMENT
/begin MEASUREMENT Com_RxAccessInfo[19].BufferIdxOfRxAccessInfo "" UWORD Com_BufferIdxOfRxAccessInfoType 0 0 0 65535 ECU_ADDRESS 0x0 /end MEASUREMENT
/begin MEASUREMENT Com_RxAccessInfo[19].BusAccOfRxAccessInfo "" UBYTE Com_BusAccOfRxAccessInfoType 0 0 0 255 ECU_ADDRESS 0x0 /end MEASUREMENT
/begin MEASUREMENT Com_RxAccessInfo[19].ByteLengthOfRxAccessInfo "" UBYTE NO_COMPU_METHOD 0 0 0 255 ECU_ADDRESS 0x0 /end MEASUREMENT
/begin MEASUREMENT Com_RxAccessInfo[19].ConstValueArrayBasedInitValueEndIdxOfRxAccessInfo "" UBYTE Com_ConstValueArrayBasedInitValueEndIdxOfRxAccessInfoType 0 0 0 255 ECU_ADDRESS 0x0 /end MEASUREMENT
/begin MEASUREMENT Com_RxAccessInfo[19].ConstValueArrayBasedInitValueStartIdxOfRxAccessInfo "" UBYTE Com_ConstValueArrayBasedInitValueStartIdxOfRxAccessInfoType 0 0 0 255 ECU_ADDRESS 0x0 /end MEASUREMENT
/begin MEASUREMENT Com_RxAccessInfo[19].DynSignalOfRxAccessInfo "" UBYTE Com_DynSignalOfRxAccessInfoType 0 0 0 1 ECU_ADDRESS 0x0 /end MEASUREMENT
/begin MEASUREMENT Com_RxAccessInfo[19].InitValueIdxOfRxAccessInfo "" UBYTE Com_InitValueIdxOfRxAccessInfoType 0 0 0 255 ECU_ADDRESS 0x0 /end MEASUREMENT
/begin MEASUREMENT Com_RxAccessInfo[19].InitValueOfRxAccessInfo "" UBYTE Com_InitValueOfRxAccessInfoType 0 0 0 255 ECU_ADDRESS 0x0 /end MEASUREMENT
/begin MEASUREMENT Com_RxAccessInfo[19].InvValueIdxOfRxAccessInfo "" UBYTE Com_InvValueIdxOfRxAccessInfoType 0 0 0 255 ECU_ADDRESS 0x0 /end MEASUREMENT
/begin MEASUREMENT Com_RxAccessInfo[19].InvValueOfRxAccessInfo "" UBYTE Com_InvValueOfRxAccessInfoType 0 0 0 255 ECU_ADDRESS 0x0 /end MEASUREMENT
/begin MEASUREMENT Com_RxAccessInfo[19].IsGroupSignalOfRxAccessInfo "" UBYTE Com_IsGroupSignalOfRxAccessInfoType 0 0 0 1 ECU_ADDRESS 0x0 /end MEASUREMENT
/begin MEASUREMENT Com_RxAccessInfo[19].RxDataTimeoutSubstitutionValueIdxOfRxAccessInfo "" UBYTE Com_RxDataTimeoutSubstitutionValueIdxOfRxAccessInfoType 0 0 0 255 ECU_ADDRESS 0x0 /end MEASUREMENT
/begin MEASUREMENT Com_RxAccessInfo[19].RxDataTimeoutSubstitutionValueOfRxAccessInfo "" UBYTE Com_RxDataTimeoutSubstitutionValueOfRxAccessInfoType 0 0 0 255 ECU_ADDRESS 0x0 /end MEASUREMENT
/begin MEASUREMENT Com_RxAccessInfo[19].RxPduInfoIdxOfRxAccessInfo "" UBYTE NO_COMPU_METHOD 0 0 0 255 ECU_ADDRESS 0x0 /end MEASUREMENT
/begin MEASUREMENT Com_RxAccessInfo[19].RxSigBufferArrayBasedBufferEndIdxOfRxAccessInfo "" UBYTE Com_RxSigBufferArrayBasedBufferEndIdxOfRxAccessInfoType 0 0 0 255 ECU_ADDRESS 0x0 /end MEASUREMENT
/begin MEASUREMENT Com_RxAccessInfo[19].RxSigBufferArrayBasedBufferStartIdxOfRxAccessInfo "" UBYTE Com_RxSigBufferArrayBasedBufferStartIdxOfRxAccessInfoType 0 0 0 255 ECU_ADDRESS 0x0 /end MEASUREMENT
/begin MEASUREMENT Com_RxAccessInfo[19].RxSigBufferArrayBasedShdBufferEndIdxOfRxAccessInfo "" UBYTE Com_RxSigBufferArrayBasedShdBufferEndIdxOfRxAccessInfoType 0 0 0 255 ECU_ADDRESS 0x0 /end MEASUREMENT
/begin MEASUREMENT Com_RxAccessInfo[19].RxSigBufferArrayBasedShdBufferStartIdxOfRxAccessInfo "" UBYTE Com_RxSigBufferArrayBasedShdBufferStartIdxOfRxAccessInfoType 0 0 0 255 ECU_ADDRESS 0x0 /end MEASUREMENT
/begin MEASUREMENT Com_RxAccessInfo[19].RxTOutInfoIdxOfRxAccessInfo "" UBYTE Com_RxTOutInfoIdxOfRxAccessInfoType 0 0 0 255 ECU_ADDRESS 0x0 /end MEASUREMENT
/begin MEASUREMENT Com_RxAccessInfo[19].ShdBufferIdxOfRxAccessInfo "" UWORD Com_ShdBufferIdxOfRxAccessInfoType 0 0 0 65535 ECU_ADDRESS 0x0 /end MEASUREMENT
/begin MEASUREMENT Com_RxAccessInfo[19].SignalLengthInByteOfRxAccessInfo "" UBYTE NO_COMPU_METHOD 0 0 0 255 ECU_ADDRESS 0x0 /end MEASUREMENT
/begin MEASUREMENT Com_RxAccessInfo[19].StartByteInPduPositionOfRxAccessInfo "" UBYTE NO_COMPU_METHOD 0 0 0 255 ECU_ADDRESS 0x0 /end MEASUREMENT
/begin MEASUREMENT Com_RxAccessInfo[19].TmpBufferIdxOfRxAccessInfo "" UBYTE Com_TmpBufferIdxOfRxAccessInfoType 0 0 0 255 ECU_ADDRESS 0x0 /end MEASUREMENT
/begin MEASUREMENT Com_RxAccessInfo[19].TmpBufferOfRxAccessInfo "" UBYTE Com_TmpBufferOfRxAccessInfoType 0 0 0 255 ECU_ADDRESS 0x0 /end MEASUREMENT
/begin MEASUREMENT Com_RxAccessInfo[19].TmpRxShdBufferArrayBasedTmpBufferEndIdxOfRxAccessInfo "" UBYTE Com_TmpRxShdBufferArrayBasedTmpBufferEndIdxOfRxAccessInfoType 0 0 0 255 ECU_ADDRESS 0x0 /end MEASUREMENT
/begin MEASUREMENT Com_RxAccessInfo[19].TmpRxShdBufferArrayBasedTmpBufferStartIdxOfRxAccessInfo "" UBYTE Com_TmpRxShdBufferArrayBasedTmpBufferStartIdxOfRxAccessInfoType 0 0 0 255 ECU_ADDRESS 0x0 /end MEASUREMENT
/begin MEASUREMENT Com_RxAccessInfo[1].ApplTypeOfRxAccessInfo "" UBYTE Com_ApplTypeOfRxAccessInfoType 0 0 0 255 ECU_ADDRESS 0x0 /end MEASUREMENT
/begin MEASUREMENT Com_RxAccessInfo[1].BitLengthOfRxAccessInfo "" UWORD NO_COMPU_METHOD 0 0 0 65535 ECU_ADDRESS 0x0 /end MEASUREMENT
/begin MEASUREMENT Com_RxAccessInfo[1].BitPositionOfRxAccessInfo "" UWORD NO_COMPU_METHOD 0 0 0 65535 ECU_ADDRESS 0x0 /end MEASUREMENT
/begin MEASUREMENT Com_RxAccessInfo[1].BufferIdxOfRxAccessInfo "" UWORD Com_BufferIdxOfRxAccessInfoType 0 0 0 65535 ECU_ADDRESS 0x0 /end MEASUREMENT
/begin MEASUREMENT Com_RxAccessInfo[1].BusAccOfRxAccessInfo "" UBYTE Com_BusAccOfRxAccessInfoType 0 0 0 255 ECU_ADDRESS 0x0 /end MEASUREMENT
/begin MEASUREMENT Com_RxAccessInfo[1].ByteLengthOfRxAccessInfo "" UBYTE NO_COMPU_METHOD 0 0 0 255 ECU_ADDRESS 0x0 /end MEASUREMENT
/begin MEASUREMENT Com_RxAccessInfo[1].ConstValueArrayBasedInitValueEndIdxOfRxAccessInfo "" UBYTE Com_ConstValueArrayBasedInitValueEndIdxOfRxAccessInfoType 0 0 0 255 ECU_ADDRESS 0x0 /end MEASUREMENT
/begin MEASUREMENT Com_RxAccessInfo[1].ConstValueArrayBasedInitValueStartIdxOfRxAccessInfo "" UBYTE Com_ConstValueArrayBasedInitValueStartIdxOfRxAccessInfoType 0 0 0 255 ECU_ADDRESS 0x0 /end MEASUREMENT
/begin MEASUREMENT Com_RxAccessInfo[1].DynSignalOfRxAccessInfo "" UBYTE Com_DynSignalOfRxAccessInfoType 0 0 0 1 ECU_ADDRESS 0x0 /end MEASUREMENT
/begin MEASUREMENT Com_RxAccessInfo[1].InitValueIdxOfRxAccessInfo "" UBYTE Com_InitValueIdxOfRxAccessInfoType 0 0 0 255 ECU_ADDRESS 0x0 /end MEASUREMENT
/begin MEASUREMENT Com_RxAccessInfo[1].InitValueOfRxAccessInfo "" UBYTE Com_InitValueOfRxAccessInfoType 0 0 0 255 ECU_ADDRESS 0x0 /end MEASUREMENT
/begin MEASUREMENT Com_RxAccessInfo[1].InvValueIdxOfRxAccessInfo "" UBYTE Com_InvValueIdxOfRxAccessInfoType 0 0 0 255 ECU_ADDRESS 0x0 /end MEASUREMENT
/begin MEASUREMENT Com_RxAccessInfo[1].InvValueOfRxAccessInfo "" UBYTE Com_InvValueOfRxAccessInfoType 0 0 0 255 ECU_ADDRESS 0x0 /end MEASUREMENT
/begin MEASUREMENT Com_RxAccessInfo[1].IsGroupSignalOfRxAccessInfo "" UBYTE Com_IsGroupSignalOfRxAccessInfoType 0 0 0 1 ECU_ADDRESS 0x0 /end MEASUREMENT
/begin MEASUREMENT Com_RxAccessInfo[1].RxDataTimeoutSubstitutionValueIdxOfRxAccessInfo "" UBYTE Com_RxDataTimeoutSubstitutionValueIdxOfRxAccessInfoType 0 0 0 255 ECU_ADDRESS 0x0 /end MEASUREMENT
/begin MEASUREMENT Com_RxAccessInfo[1].RxDataTimeoutSubstitutionValueOfRxAccessInfo "" UBYTE Com_RxDataTimeoutSubstitutionValueOfRxAccessInfoType 0 0 0 255 ECU_ADDRESS 0x0 /end MEASUREMENT
/begin MEASUREMENT Com_RxAccessInfo[1].RxPduInfoIdxOfRxAccessInfo "" UBYTE NO_COMPU_METHOD 0 0 0 255 ECU_ADDRESS 0x0 /end MEASUREMENT
/begin MEASUREMENT Com_RxAccessInfo[1].RxSigBufferArrayBasedBufferEndIdxOfRxAccessInfo "" UBYTE Com_RxSigBufferArrayBasedBufferEndIdxOfRxAccessInfoType 0 0 0 255 ECU_ADDRESS 0x0 /end MEASUREMENT
/begin MEASUREMENT Com_RxAccessInfo[1].RxSigBufferArrayBasedBufferStartIdxOfRxAccessInfo "" UBYTE Com_RxSigBufferArrayBasedBufferStartIdxOfRxAccessInfoType 0 0 0 255 ECU_ADDRESS 0x0 /end MEASUREMENT
/begin MEASUREMENT Com_RxAccessInfo[1].RxSigBufferArrayBasedShdBufferEndIdxOfRxAccessInfo "" UBYTE Com_RxSigBufferArrayBasedShdBufferEndIdxOfRxAccessInfoType 0 0 0 255 ECU_ADDRESS 0x0 /end MEASUREMENT
/begin MEASUREMENT Com_RxAccessInfo[1].RxSigBufferArrayBasedShdBufferStartIdxOfRxAccessInfo "" UBYTE Com_RxSigBufferArrayBasedShdBufferStartIdxOfRxAccessInfoType 0 0 0 255 ECU_ADDRESS 0x0 /end MEASUREMENT
/begin MEASUREMENT Com_RxAccessInfo[1].RxTOutInfoIdxOfRxAccessInfo "" UBYTE Com_RxTOutInfoIdxOfRxAccessInfoType 0 0 0 255 ECU_ADDRESS 0x0 /end MEASUREMENT
/begin MEASUREMENT Com_RxAccessInfo[1].ShdBufferIdxOfRxAccessInfo "" UWORD Com_ShdBufferIdxOfRxAccessInfoType 0 0 0 65535 ECU_ADDRESS 0x0 /end MEASUREMENT
/begin MEASUREMENT Com_RxAccessInfo[1].SignalLengthInByteOfRxAccessInfo "" UBYTE NO_COMPU_METHOD 0 0 0 255 ECU_ADDRESS 0x0 /end MEASUREMENT
/begin MEASUREMENT Com_RxAccessInfo[1].StartByteInPduPositionOfRxAccessInfo "" UBYTE NO_COMPU_METHOD 0 0 0 255 ECU_ADDRESS 0x0 /end MEASUREMENT
/begin MEASUREMENT Com_RxAccessInfo[1].TmpBufferIdxOfRxAccessInfo "" UBYTE Com_TmpBufferIdxOfRxAccessInfoType 0 0 0 255 ECU_ADDRESS 0x0 /end MEASUREMENT
/begin MEASUREMENT Com_RxAccessInfo[1].TmpBufferOfRxAccessInfo "" UBYTE Com_TmpBufferOfRxAccessInfoType 0 0 0 255 ECU_ADDRESS 0x0 /end MEASUREMENT
/begin MEASUREMENT Com_RxAccessInfo[1].TmpRxShdBufferArrayBasedTmpBufferEndIdxOfRxAccessInfo "" UBYTE Com_TmpRxShdBufferArrayBasedTmpBufferEndIdxOfRxAccessInfoType 0 0 0 255 ECU_ADDRESS 0x0 /end MEASUREMENT
/begin MEASUREMENT Com_RxAccessInfo[1].TmpRxShdBufferArrayBasedTmpBufferStartIdxOfRxAccessInfo "" UBYTE Com_TmpRxShdBufferArrayBasedTmpBufferStartIdxOfRxAccessInfoType 0 0 0 255 ECU_ADDRESS 0x0 /end MEASUREMENT
/begin MEASUREMENT Com_RxAccessInfo[200].ApplTypeOfRxAccessInfo "" UBYTE Com_ApplTypeOfRxAccessInfoType 0 0 0 255 ECU_ADDRESS 0x0 /end MEASUREMENT
/begin MEASUREMENT Com_RxAccessInfo[200].BitLengthOfRxAccessInfo "" UWORD NO_COMPU_METHOD 0 0 0 65535 ECU_ADDRESS 0x0 /end MEASUREMENT
/begin MEASUREMENT Com_RxAccessInfo[200].BitPositionOfRxAccessInfo "" UWORD NO_COMPU_METHOD 0 0 0 65535 ECU_ADDRESS 0x0 /end MEASUREMENT
/begin MEASUREMENT Com_RxAccessInfo[200].BufferIdxOfRxAccessInfo "" UWORD Com_BufferIdxOfRxAccessInfoType 0 0 0 65535 ECU_ADDRESS 0x0 /end MEASUREMENT
/begin MEASUREMENT Com_RxAccessInfo[200].BusAccOfRxAccessInfo "" UBYTE Com_BusAccOfRxAccessInfoType 0 0 0 255 ECU_ADDRESS 0x0 /end MEASUREMENT
/begin MEASUREMENT Com_RxAccessInfo[200].ByteLengthOfRxAccessInfo "" UBYTE NO_COMPU_METHOD 0 0 0 255 ECU_ADDRESS 0x0 /end MEASUREMENT
/begin MEASUREMENT Com_RxAccessInfo[200].ConstValueArrayBasedInitValueEndIdxOfRxAccessInfo "" UBYTE Com_ConstValueArrayBasedInitValueEndIdxOfRxAccessInfoType 0 0 0 255 ECU_ADDRESS 0x0 /end MEASUREMENT
/begin MEASUREMENT Com_RxAccessInfo[200].ConstValueArrayBasedInitValueStartIdxOfRxAccessInfo "" UBYTE Com_ConstValueArrayBasedInitValueStartIdxOfRxAccessInfoType 0 0 0 255 ECU_ADDRESS 0x0 /end MEASUREMENT
/begin MEASUREMENT Com_RxAccessInfo[200].DynSignalOfRxAccessInfo "" UBYTE Com_DynSignalOfRxAccessInfoType 0 0 0 1 ECU_ADDRESS 0x0 /end MEASUREMENT
/begin MEASUREMENT Com_RxAccessInfo[200].InitValueIdxOfRxAccessInfo "" UBYTE Com_InitValueIdxOfRxAccessInfoType 0 0 0 255 ECU_ADDRESS 0x0 /end MEASUREMENT
/begin MEASUREMENT Com_RxAccessInfo[200].InitValueOfRxAccessInfo "" UBYTE Com_InitValueOfRxAccessInfoType 0 0 0 255 ECU_ADDRESS 0x0 /end MEASUREMENT
/begin MEASUREMENT Com_RxAccessInfo[200].InvValueIdxOfRxAccessInfo "" UBYTE Com_InvValueIdxOfRxAccessInfoType 0 0 0 255 ECU_ADDRESS 0x0 /end MEASUREMENT
/begin MEASUREMENT Com_RxAccessInfo[200].InvValueOfRxAccessInfo "" UBYTE Com_InvValueOfRxAccessInfoType 0 0 0 255 ECU_ADDRESS 0x0 /end MEASUREMENT
/begin MEASUREMENT Com_RxAccessInfo[200].IsGroupSignalOfRxAccessInfo "" UBYTE Com_IsGroupSignalOfRxAccessInfoType 0 0 0 1 ECU_ADDRESS 0x0 /end MEASUREMENT
/begin MEASUREMENT Com_RxAccessInfo[200].RxDataTimeoutSubstitutionValueIdxOfRxAccessInfo "" UBYTE Com_RxDataTimeoutSubstitutionValueIdxOfRxAccessInfoType 0 0 0 255 ECU_ADDRESS 0x0 /end MEASUREMENT
/begin MEASUREMENT Com_RxAccessInfo[200].RxDataTimeoutSubstitutionValueOfRxAccessInfo "" UBYTE Com_RxDataTimeoutSubstitutionValueOfRxAccessInfoType 0 0 0 255 ECU_ADDRESS 0x0 /end MEASUREMENT
/begin MEASUREMENT Com_RxAccessInfo[200].RxPduInfoIdxOfRxAccessInfo "" UBYTE NO_COMPU_METHOD 0 0 0 255 ECU_ADDRESS 0x0 /end MEASUREMENT
/begin MEASUREMENT Com_RxAccessInfo[200].RxSigBufferArrayBasedBufferEndIdxOfRxAccessInfo "" UBYTE Com_RxSigBufferArrayBasedBufferEndIdxOfRxAccessInfoType 0 0 0 255 ECU_ADDRESS 0x0 /end MEASUREMENT
/begin MEASUREMENT Com_RxAccessInfo[200].RxSigBufferArrayBasedBufferStartIdxOfRxAccessInfo "" UBYTE Com_RxSigBufferArrayBasedBufferStartIdxOfRxAccessInfoType 0 0 0 255 ECU_ADDRESS 0x0 /end MEASUREMENT
/begin MEASUREMENT Com_RxAccessInfo[200].RxSigBufferArrayBasedShdBufferEndIdxOfRxAccessInfo "" UBYTE Com_RxSigBufferArrayBasedShdBufferEndIdxOfRxAccessInfoType 0 0 0 255 ECU_ADDRESS 0x0 /end MEASUREMENT
/begin MEASUREMENT Com_RxAccessInfo[200].RxSigBufferArrayBasedShdBufferStartIdxOfRxAccessInfo "" UBYTE Com_RxSigBufferArrayBasedShdBufferStartIdxOfRxAccessInfoType 0 0 0 255 ECU_ADDRESS 0x0 /end MEASUREMENT
/begin MEASUREMENT Com_RxAccessInfo[200].RxTOutInfoIdxOfRxAccessInfo "" UBYTE Com_RxTOutInfoIdxOfRxAccessInfoType 0 0 0 255 ECU_ADDRESS 0x0 /end MEASUREMENT
/begin MEASUREMENT Com_RxAccessInfo[200].ShdBufferIdxOfRxAccessInfo "" UWORD Com_ShdBufferIdxOfRxAccessInfoType 0 0 0 65535 ECU_ADDRESS 0x0 /end MEASUREMENT
/begin MEASUREMENT Com_RxAccessInfo[200].SignalLengthInByteOfRxAccessInfo "" UBYTE NO_COMPU_METHOD 0 0 0 255 ECU_ADDRESS 0x0 /end MEASUREMENT
/begin MEASUREMENT Com_RxAccessInfo[200].StartByteInPduPositionOfRxAccessInfo "" UBYTE NO_COMPU_METHOD 0 0 0 255 ECU_ADDRESS 0x0 /end MEASUREMENT
/begin MEASUREMENT Com_RxAccessInfo[200].TmpBufferIdxOfRxAccessInfo "" UBYTE Com_TmpBufferIdxOfRxAccessInfoType 0 0 0 255 ECU_ADDRESS 0x0 /end MEASUREMENT
/begin MEASUREMENT Com_RxAccessInfo[200].TmpBufferOfRxAccessInfo "" UBYTE Com_TmpBufferOfRxAccessInfoType 0 0 0 255 ECU_ADDRESS 0x0 /end MEASUREMENT
/begin MEASUREMENT Com_RxAccessInfo[200].TmpRxShdBufferArrayBasedTmpBufferEndIdxOfRxAccessInfo "" UBYTE Com_TmpRxShdBufferArrayBasedTmpBufferEndIdxOfRxAccessInfoType 0 0 0 255 ECU_ADDRESS 0x0 /end MEASUREMENT
/begin MEASUREMENT Com_RxAccessInfo[200].TmpRxShdBufferArrayBasedTmpBufferStartIdxOfRxAccessInfo "" UBYTE Com_TmpRxShdBufferArrayBasedTmpBufferStartIdxOfRxAccessInfoType 0 0 0 255 ECU_ADDRESS 0x0 /end MEASUREMENT
/begin MEASUREMENT Com_RxAccessInfo[201].ApplTypeOfRxAccessInfo "" UBYTE Com_ApplTypeOfRxAccessInfoType 0 0 0 255 ECU_ADDRESS 0x0 /end MEASUREMENT
/begin MEASUREMENT Com_RxAccessInfo[201].BitLengthOfRxAccessInfo "" UWORD NO_COMPU_METHOD 0 0 0 65535 ECU_ADDRESS 0x0 /end MEASUREMENT
/begin MEASUREMENT Com_RxAccessInfo[201].BitPositionOfRxAccessInfo "" UWORD NO_COMPU_METHOD 0 0 0 65535 ECU_ADDRESS 0x0 /end MEASUREMENT
/begin MEASUREMENT Com_RxAccessInfo[201].BufferIdxOfRxAccessInfo "" UWORD Com_BufferIdxOfRxAccessInfoType 0 0 0 65535 ECU_ADDRESS 0x0 /end MEASUREMENT
/begin MEASUREMENT Com_RxAccessInfo[201].BusAccOfRxAccessInfo "" UBYTE Com_BusAccOfRxAccessInfoType 0 0 0 255 ECU_ADDRESS 0x0 /end MEASUREMENT
/begin MEASUREMENT Com_RxAccessInfo[201].ByteLengthOfRxAccessInfo "" UBYTE NO_COMPU_METHOD 0 0 0 255 ECU_ADDRESS 0x0 /end MEASUREMENT
/begin MEASUREMENT Com_RxAccessInfo[201].ConstValueArrayBasedInitValueEndIdxOfRxAccessInfo "" UBYTE Com_ConstValueArrayBasedInitValueEndIdxOfRxAccessInfoType 0 0 0 255 ECU_ADDRESS 0x0 /end MEASUREMENT
/begin MEASUREMENT Com_RxAccessInfo[201].ConstValueArrayBasedInitValueStartIdxOfRxAccessInfo "" UBYTE Com_ConstValueArrayBasedInitValueStartIdxOfRxAccessInfoType 0 0 0 255 ECU_ADDRESS 0x0 /end MEASUREMENT
/begin MEASUREMENT Com_RxAccessInfo[201].DynSignalOfRxAccessInfo "" UBYTE Com_DynSignalOfRxAccessInfoType 0 0 0 1 ECU_ADDRESS 0x0 /end MEASUREMENT
/begin MEASUREMENT Com_RxAccessInfo[201].InitValueIdxOfRxAccessInfo "" UBYTE Com_InitValueIdxOfRxAccessInfoType 0 0 0 255 ECU_ADDRESS 0x0 /end MEASUREMENT
/begin MEASUREMENT Com_RxAccessInfo[201].InitValueOfRxAccessInfo "" UBYTE Com_InitValueOfRxAccessInfoType 0 0 0 255 ECU_ADDRESS 0x0 /end MEASUREMENT
/begin MEASUREMENT Com_RxAccessInfo[201].InvValueIdxOfRxAccessInfo "" UBYTE Com_InvValueIdxOfRxAccessInfoType 0 0 0 255 ECU_ADDRESS 0x0 /end MEASUREMENT
/begin MEASUREMENT Com_RxAccessInfo[201].InvValueOfRxAccessInfo "" UBYTE Com_InvValueOfRxAccessInfoType 0 0 0 255 ECU_ADDRESS 0x0 /end MEASUREMENT
/begin MEASUREMENT Com_RxAccessInfo[201].IsGroupSignalOfRxAccessInfo "" UBYTE Com_IsGroupSignalOfRxAccessInfoType 0 0 0 1 ECU_ADDRESS 0x0 /end MEASUREMENT
/begin MEASUREMENT Com_RxAccessInfo[201].RxDataTimeoutSubstitutionValueIdxOfRxAccessInfo "" UBYTE Com_RxDataTimeoutSubstitutionValueIdxOfRxAccessInfoType 0 0 0 255 ECU_ADDRESS 0x0 /end MEASUREMENT
/begin MEASUREMENT Com_RxAccessInfo[201].RxDataTimeoutSubstitutionValueOfRxAccessInfo "" UBYTE Com_RxDataTimeoutSubstitutionValueOfRxAccessInfoType 0 0 0 255 ECU_ADDRESS 0x0 /end MEASUREMENT
/begin MEASUREMENT Com_RxAccessInfo[201].RxPduInfoIdxOfRxAccessInfo "" UBYTE NO_COMPU_METHOD 0 0 0 255 ECU_ADDRESS 0x0 /end MEASUREMENT
/begin MEASUREMENT Com_RxAccessInfo[201].RxSigBufferArrayBasedBufferEndIdxOfRxAccessInfo "" UBYTE Com_RxSigBufferArrayBasedBufferEndIdxOfRxAccessInfoType 0 0 0 255 ECU_ADDRESS 0x0 /end MEASUREMENT
/begin MEASUREMENT Com_RxAccessInfo[201].RxSigBufferArrayBasedBufferStartIdxOfRxAccessInfo "" UBYTE Com_RxSigBufferArrayBasedBufferStartIdxOfRxAccessInfoType 0 0 0 255 ECU_ADDRESS 0x0 /end MEASUREMENT
/begin MEASUREMENT Com_RxAccessInfo[201].RxSigBufferArrayBasedShdBufferEndIdxOfRxAccessInfo "" UBYTE Com_RxSigBufferArrayBasedShdBufferEndIdxOfRxAccessInfoType 0 0 0 255 ECU_ADDRESS 0x0 /end MEASUREMENT
/begin MEASUREMENT Com_RxAccessInfo[201].RxSigBufferArrayBasedShdBufferStartIdxOfRxAccessInfo "" UBYTE Com_RxSigBufferArrayBasedShdBufferStartIdxOfRxAccessInfoType 0 0 0 255 ECU_ADDRESS 0x0 /end MEASUREMENT
/begin MEASUREMENT Com_RxAccessInfo[201].RxTOutInfoIdxOfRxAccessInfo "" UBYTE Com_RxTOutInfoIdxOfRxAccessInfoType 0 0 0 255 ECU_ADDRESS 0x0 /end MEASUREMENT
/begin MEASUREMENT Com_RxAccessInfo[201].ShdBufferIdxOfRxAccessInfo "" UWORD Com_ShdBufferIdxOfRxAccessInfoType 0 0 0 65535 ECU_ADDRESS 0x0 /end MEASUREMENT
/begin MEASUREMENT Com_RxAccessInfo[201].SignalLengthInByteOfRxAccessInfo "" UBYTE NO_COMPU_METHOD 0 0 0 255 ECU_ADDRESS 0x0 /end MEASUREMENT
/begin MEASUREMENT Com_RxAccessInfo[201].StartByteInPduPositionOfRxAccessInfo "" UBYTE NO_COMPU_METHOD 0 0 0 255 ECU_ADDRESS 0x0 /end MEASUREMENT
/begin MEASUREMENT Com_RxAccessInfo[201].TmpBufferIdxOfRxAccessInfo "" UBYTE Com_TmpBufferIdxOfRxAccessInfoType 0 0 0 255 ECU_ADDRESS 0x0 /end MEASUREMENT
/begin MEASUREMENT Com_RxAccessInfo[201].TmpBufferOfRxAccessInfo "" UBYTE Com_TmpBufferOfRxAccessInfoType 0 0 0 255 ECU_ADDRESS 0x0 /end MEASUREMENT
/begin MEASUREMENT Com_RxAccessInfo[201].TmpRxShdBufferArrayBasedTmpBufferEndIdxOfRxAccessInfo "" UBYTE Com_TmpRxShdBufferArrayBasedTmpBufferEndIdxOfRxAccessInfoType 0 0 0 255 ECU_ADDRESS 0x0 /end MEASUREMENT
/begin MEASUREMENT Com_RxAccessInfo[201].TmpRxShdBufferArrayBasedTmpBufferStartIdxOfRxAccessInfo "" UBYTE Com_TmpRxShdBufferArrayBasedTmpBufferStartIdxOfRxAccessInfoType 0 0 0 255 ECU_ADDRESS 0x0 /end MEASUREMENT
/begin MEASUREMENT Com_RxAccessInfo[202].ApplTypeOfRxAccessInfo "" UBYTE Com_ApplTypeOfRxAccessInfoType 0 0 0 255 ECU_ADDRESS 0x0 /end MEASUREMENT
/begin MEASUREMENT Com_RxAccessInfo[202].BitLengthOfRxAccessInfo "" UWORD NO_COMPU_METHOD 0 0 0 65535 ECU_ADDRESS 0x0 /end MEASUREMENT
/begin MEASUREMENT Com_RxAccessInfo[202].BitPositionOfRxAccessInfo "" UWORD NO_COMPU_METHOD 0 0 0 65535 ECU_ADDRESS 0x0 /end MEASUREMENT
/begin MEASUREMENT Com_RxAccessInfo[202].BufferIdxOfRxAccessInfo "" UWORD Com_BufferIdxOfRxAccessInfoType 0 0 0 65535 ECU_ADDRESS 0x0 /end MEASUREMENT
/begin MEASUREMENT Com_RxAccessInfo[202].BusAccOfRxAccessInfo "" UBYTE Com_BusAccOfRxAccessInfoType 0 0 0 255 ECU_ADDRESS 0x0 /end MEASUREMENT
/begin MEASUREMENT Com_RxAccessInfo[202].ByteLengthOfRxAccessInfo "" UBYTE NO_COMPU_METHOD 0 0 0 255 ECU_ADDRESS 0x0 /end MEASUREMENT
/begin MEASUREMENT Com_RxAccessInfo[202].ConstValueArrayBasedInitValueEndIdxOfRxAccessInfo "" UBYTE Com_ConstValueArrayBasedInitValueEndIdxOfRxAccessInfoType 0 0 0 255 ECU_ADDRESS 0x0 /end MEASUREMENT
/begin MEASUREMENT Com_RxAccessInfo[202].ConstValueArrayBasedInitValueStartIdxOfRxAccessInfo "" UBYTE Com_ConstValueArrayBasedInitValueStartIdxOfRxAccessInfoType 0 0 0 255 ECU_ADDRESS 0x0 /end MEASUREMENT
/begin MEASUREMENT Com_RxAccessInfo[202].DynSignalOfRxAccessInfo "" UBYTE Com_DynSignalOfRxAccessInfoType 0 0 0 1 ECU_ADDRESS 0x0 /end MEASUREMENT
/begin MEASUREMENT Com_RxAccessInfo[202].InitValueIdxOfRxAccessInfo "" UBYTE Com_InitValueIdxOfRxAccessInfoType 0 0 0 255 ECU_ADDRESS 0x0 /end MEASUREMENT
/begin MEASUREMENT Com_RxAccessInfo[202].InitValueOfRxAccessInfo "" UBYTE Com_InitValueOfRxAccessInfoType 0 0 0 255 ECU_ADDRESS 0x0 /end MEASUREMENT
/begin MEASUREMENT Com_RxAccessInfo[202].InvValueIdxOfRxAccessInfo "" UBYTE Com_InvValueIdxOfRxAccessInfoType 0 0 0 255 ECU_ADDRESS 0x0 /end MEASUREMENT
/begin MEASUREMENT Com_RxAccessInfo[202].InvValueOfRxAccessInfo "" UBYTE Com_InvValueOfRxAccessInfoType 0 0 0 255 ECU_ADDRESS 0x0 /end MEASUREMENT
/begin MEASUREMENT Com_RxAccessInfo[202].IsGroupSignalOfRxAccessInfo "" UBYTE Com_IsGroupSignalOfRxAccessInfoType 0 0 0 1 ECU_ADDRESS 0x0 /end MEASUREMENT
/begin MEASUREMENT Com_RxAccessInfo[202].RxDataTimeoutSubstitutionValueIdxOfRxAccessInfo "" UBYTE Com_RxDataTimeoutSubstitutionValueIdxOfRxAccessInfoType 0 0 0 255 ECU_ADDRESS 0x0 /end MEASUREMENT
/begin MEASUREMENT Com_RxAccessInfo[202].RxDataTimeoutSubstitutionValueOfRxAccessInfo "" UBYTE Com_RxDataTimeoutSubstitutionValueOfRxAccessInfoType 0 0 0 255 ECU_ADDRESS 0x0 /end MEASUREMENT
/begin MEASUREMENT Com_RxAccessInfo[202].RxPduInfoIdxOfRxAccessInfo "" UBYTE NO_COMPU_METHOD 0 0 0 255 ECU_ADDRESS 0x0 /end MEASUREMENT
/begin MEASUREMENT Com_RxAccessInfo[202].RxSigBufferArrayBasedBufferEndIdxOfRxAccessInfo "" UBYTE Com_RxSigBufferArrayBasedBufferEndIdxOfRxAccessInfoType 0 0 0 255 ECU_ADDRESS 0x0 /end MEASUREMENT
/begin MEASUREMENT Com_RxAccessInfo[202].RxSigBufferArrayBasedBufferStartIdxOfRxAccessInfo "" UBYTE Com_RxSigBufferArrayBasedBufferStartIdxOfRxAccessInfoType 0 0 0 255 ECU_ADDRESS 0x0 /end MEASUREMENT
/begin MEASUREMENT Com_RxAccessInfo[202].RxSigBufferArrayBasedShdBufferEndIdxOfRxAccessInfo "" UBYTE Com_RxSigBufferArrayBasedShdBufferEndIdxOfRxAccessInfoType 0 0 0 255 ECU_ADDRESS 0x0 /end MEASUREMENT
/begin MEASUREMENT Com_RxAccessInfo[202].RxSigBufferArrayBasedShdBufferStartIdxOfRxAccessInfo "" UBYTE Com_RxSigBufferArrayBasedShdBufferStartIdxOfRxAccessInfoType 0 0 0 255 ECU_ADDRESS 0x0 /end MEASUREMENT
/begin MEASUREMENT Com_RxAccessInfo[202].RxTOutInfoIdxOfRxAccessInfo "" UBYTE Com_RxTOutInfoIdxOfRxAccessInfoType 0 0 0 255 ECU_ADDRESS 0x0 /end MEASUREMENT
/begin MEASUREMENT Com_RxAccessInfo[202].ShdBufferIdxOfRxAccessInfo "" UWORD Com_ShdBufferIdxOfRxAccessInfoType 0 0 0 65535 ECU_ADDRESS 0x0 /end MEASUREMENT
/begin MEASUREMENT Com_RxAccessInfo[202].SignalLengthInByteOfRxAccessInfo "" UBYTE NO_COMPU_METHOD 0 0 0 255 ECU_ADDRESS 0x0 /end MEASUREMENT
/begin MEASUREMENT Com_RxAccessInfo[202].StartByteInPduPositionOfRxAccessInfo "" UBYTE NO_COMPU_METHOD 0 0 0 255 ECU_ADDRESS 0x0 /end MEASUREMENT
/begin MEASUREMENT Com_RxAccessInfo[202].TmpBufferIdxOfRxAccessInfo "" UBYTE Com_TmpBufferIdxOfRxAccessInfoType 0 0 0 255 ECU_ADDRESS 0x0 /end MEASUREMENT
/begin MEASUREMENT Com_RxAccessInfo[202].TmpBufferOfRxAccessInfo "" UBYTE Com_TmpBufferOfRxAccessInfoType 0 0 0 255 ECU_ADDRESS 0x0 /end MEASUREMENT
/begin MEASUREMENT Com_RxAccessInfo[202].TmpRxShdBufferArrayBasedTmpBufferEndIdxOfRxAccessInfo "" UBYTE Com_TmpRxShdBufferArrayBasedTmpBufferEndIdxOfRxAccessInfoType 0 0 0 255 ECU_ADDRESS 0x0 /end MEASUREMENT
/begin MEASUREMENT Com_RxAccessInfo[202].TmpRxShdBufferArrayBasedTmpBufferStartIdxOfRxAccessInfo "" UBYTE Com_TmpRxShdBufferArrayBasedTmpBufferStartIdxOfRxAccessInfoType 0 0 0 255 ECU_ADDRESS 0x0 /end MEASUREMENT
/begin MEASUREMENT Com_RxAccessInfo[203].ApplTypeOfRxAccessInfo "" UBYTE Com_ApplTypeOfRxAccessInfoType 0 0 0 255 ECU_ADDRESS 0x0 /end MEASUREMENT
/begin MEASUREMENT Com_RxAccessInfo[203].BitLengthOfRxAccessInfo "" UWORD NO_COMPU_METHOD 0 0 0 65535 ECU_ADDRESS 0x0 /end MEASUREMENT
/begin MEASUREMENT Com_RxAccessInfo[203].BitPositionOfRxAccessInfo "" UWORD NO_COMPU_METHOD 0 0 0 65535 ECU_ADDRESS 0x0 /end MEASUREMENT
/begin MEASUREMENT Com_RxAccessInfo[203].BufferIdxOfRxAccessInfo "" UWORD Com_BufferIdxOfRxAccessInfoType 0 0 0 65535 ECU_ADDRESS 0x0 /end MEASUREMENT
/begin MEASUREMENT Com_RxAccessInfo[203].BusAccOfRxAccessInfo "" UBYTE Com_BusAccOfRxAccessInfoType 0 0 0 255 ECU_ADDRESS 0x0 /end MEASUREMENT
/begin MEASUREMENT Com_RxAccessInfo[203].ByteLengthOfRxAccessInfo "" UBYTE NO_COMPU_METHOD 0 0 0 255 ECU_ADDRESS 0x0 /end MEASUREMENT
/begin MEASUREMENT Com_RxAccessInfo[203].ConstValueArrayBasedInitValueEndIdxOfRxAccessInfo "" UBYTE Com_ConstValueArrayBasedInitValueEndIdxOfRxAccessInfoType 0 0 0 255 ECU_ADDRESS 0x0 /end MEASUREMENT
/begin MEASUREMENT Com_RxAccessInfo[203].ConstValueArrayBasedInitValueStartIdxOfRxAccessInfo "" UBYTE Com_ConstValueArrayBasedInitValueStartIdxOfRxAccessInfoType 0 0 0 255 ECU_ADDRESS 0x0 /end MEASUREMENT
/begin MEASUREMENT Com_RxAccessInfo[203].DynSignalOfRxAccessInfo "" UBYTE Com_DynSignalOfRxAccessInfoType 0 0 0 1 ECU_ADDRESS 0x0 /end MEASUREMENT
/begin MEASUREMENT Com_RxAccessInfo[203].InitValueIdxOfRxAccessInfo "" UBYTE Com_InitValueIdxOfRxAccessInfoType 0 0 0 255 ECU_ADDRESS 0x0 /end MEASUREMENT
/begin MEASUREMENT Com_RxAccessInfo[203].InitValueOfRxAccessInfo "" UBYTE Com_InitValueOfRxAccessInfoType 0 0 0 255 ECU_ADDRESS 0x0 /end MEASUREMENT
/begin MEASUREMENT Com_RxAccessInfo[203].InvValueIdxOfRxAccessInfo "" UBYTE Com_InvValueIdxOfRxAccessInfoType 0 0 0 255 ECU_ADDRESS 0x0 /end MEASUREMENT
/begin MEASUREMENT Com_RxAccessInfo[203].InvValueOfRxAccessInfo "" UBYTE Com_InvValueOfRxAccessInfoType 0 0 0 255 ECU_ADDRESS 0x0 /end MEASUREMENT
/begin MEASUREMENT Com_RxAccessInfo[203].IsGroupSignalOfRxAccessInfo "" UBYTE Com_IsGroupSignalOfRxAccessInfoType 0 0 0 1 ECU_ADDRESS 0x0 /end MEASUREMENT
/begin MEASUREMENT Com_RxAccessInfo[203].RxDataTimeoutSubstitutionValueIdxOfRxAccessInfo "" UBYTE Com_RxDataTimeoutSubstitutionValueIdxOfRxAccessInfoType 0 0 0 255 ECU_ADDRESS 0x0 /end MEASUREMENT
/begin MEASUREMENT Com_RxAccessInfo[203].RxDataTimeoutSubstitutionValueOfRxAccessInfo "" UBYTE Com_RxDataTimeoutSubstitutionValueOfRxAccessInfoType 0 0 0 255 ECU_ADDRESS 0x0 /end MEASUREMENT
/begin MEASUREMENT Com_RxAccessInfo[203].RxPduInfoIdxOfRxAccessInfo "" UBYTE NO_COMPU_METHOD 0 0 0 255 ECU_ADDRESS 0x0 /end MEASUREMENT
/begin MEASUREMENT Com_RxAccessInfo[203].RxSigBufferArrayBasedBufferEndIdxOfRxAccessInfo "" UBYTE Com_RxSigBufferArrayBasedBufferEndIdxOfRxAccessInfoType 0 0 0 255 ECU_ADDRESS 0x0 /end MEASUREMENT
/begin MEASUREMENT Com_RxAccessInfo[203].RxSigBufferArrayBasedBufferStartIdxOfRxAccessInfo "" UBYTE Com_RxSigBufferArrayBasedBufferStartIdxOfRxAccessInfoType 0 0 0 255 ECU_ADDRESS 0x0 /end MEASUREMENT
/begin MEASUREMENT Com_RxAccessInfo[203].RxSigBufferArrayBasedShdBufferEndIdxOfRxAccessInfo "" UBYTE Com_RxSigBufferArrayBasedShdBufferEndIdxOfRxAccessInfoType 0 0 0 255 ECU_ADDRESS 0x0 /end MEASUREMENT
/begin MEASUREMENT Com_RxAccessInfo[203].RxSigBufferArrayBasedShdBufferStartIdxOfRxAccessInfo "" UBYTE Com_RxSigBufferArrayBasedShdBufferStartIdxOfRxAccessInfoType 0 0 0 255 ECU_ADDRESS 0x0 /end MEASUREMENT
/begin MEASUREMENT Com_RxAccessInfo[203].RxTOutInfoIdxOfRxAccessInfo "" UBYTE Com_RxTOutInfoIdxOfRxAccessInfoType 0 0 0 255 ECU_ADDRESS 0x0 /end MEASUREMENT
/begin MEASUREMENT Com_RxAccessInfo[203].ShdBufferIdxOfRxAccessInfo "" UWORD Com_ShdBufferIdxOfRxAccessInfoType 0 0 0 65535 ECU_ADDRESS 0x0 /end MEASUREMENT
/begin MEASUREMENT Com_RxAccessInfo[203].SignalLengthInByteOfRxAccessInfo "" UBYTE NO_COMPU_METHOD 0 0 0 255 ECU_ADDRESS 0x0 /end MEASUREMENT
/begin MEASUREMENT Com_RxAccessInfo[203].StartByteInPduPositionOfRxAccessInfo "" UBYTE NO_COMPU_METHOD 0 0 0 255 ECU_ADDRESS 0x0 /end MEASUREMENT
/begin MEASUREMENT Com_RxAccessInfo[203].TmpBufferIdxOfRxAccessInfo "" UBYTE Com_TmpBufferIdxOfRxAccessInfoType 0 0 0 255 ECU_ADDRESS 0x0 /end MEASUREMENT
/begin MEASUREMENT Com_RxAccessInfo[203].TmpBufferOfRxAccessInfo "" UBYTE Com_TmpBufferOfRxAccessInfoType 0 0 0 255 ECU_ADDRESS 0x0 /end MEASUREMENT
/begin MEASUREMENT Com_RxAccessInfo[203].TmpRxShdBufferArrayBasedTmpBufferEndIdxOfRxAccessInfo "" UBYTE Com_TmpRxShdBufferArrayBasedTmpBufferEndIdxOfRxAccessInfoType 0 0 0 255 ECU_ADDRESS 0x0 /end MEASUREMENT
/begin MEASUREMENT Com_RxAccessInfo[203].TmpRxShdBufferArrayBasedTmpBufferStartIdxOfRxAccessInfo "" UBYTE Com_TmpRxShdBufferArrayBasedTmpBufferStartIdxOfRxAccessInfoType 0 0 0 255 ECU_ADDRESS 0x0 /end MEASUREMENT
/begin MEASUREMENT Com_RxAccessInfo[204].ApplTypeOfRxAccessInfo "" UBYTE Com_ApplTypeOfRxAccessInfoType 0 0 0 255 ECU_ADDRESS 0x0 /end MEASUREMENT
/begin MEASUREMENT Com_RxAccessInfo[204].BitLengthOfRxAccessInfo "" UWORD NO_COMPU_METHOD 0 0 0 65535 ECU_ADDRESS 0x0 /end MEASUREMENT
/begin MEASUREMENT Com_RxAccessInfo[204].BitPositionOfRxAccessInfo "" UWORD NO_COMPU_METHOD 0 0 0 65535 ECU_ADDRESS 0x0 /end MEASUREMENT
/begin MEASUREMENT Com_RxAccessInfo[204].BufferIdxOfRxAccessInfo "" UWORD Com_BufferIdxOfRxAccessInfoType 0 0 0 65535 ECU_ADDRESS 0x0 /end MEASUREMENT
/begin MEASUREMENT Com_RxAccessInfo[204].BusAccOfRxAccessInfo "" UBYTE Com_BusAccOfRxAccessInfoType 0 0 0 255 ECU_ADDRESS 0x0 /end MEASUREMENT
/begin MEASUREMENT Com_RxAccessInfo[204].ByteLengthOfRxAccessInfo "" UBYTE NO_COMPU_METHOD 0 0 0 255 ECU_ADDRESS 0x0 /end MEASUREMENT
/begin MEASUREMENT Com_RxAccessInfo[204].ConstValueArrayBasedInitValueEndIdxOfRxAccessInfo "" UBYTE Com_ConstValueArrayBasedInitValueEndIdxOfRxAccessInfoType 0 0 0 255 ECU_ADDRESS 0x0 /end MEASUREMENT
/begin MEASUREMENT Com_RxAccessInfo[204].ConstValueArrayBasedInitValueStartIdxOfRxAccessInfo "" UBYTE Com_ConstValueArrayBasedInitValueStartIdxOfRxAccessInfoType 0 0 0 255 ECU_ADDRESS 0x0 /end MEASUREMENT
/begin MEASUREMENT Com_RxAccessInfo[204].DynSignalOfRxAccessInfo "" UBYTE Com_DynSignalOfRxAccessInfoType 0 0 0 1 ECU_ADDRESS 0x0 /end MEASUREMENT
/begin MEASUREMENT Com_RxAccessInfo[204].InitValueIdxOfRxAccessInfo "" UBYTE Com_InitValueIdxOfRxAccessInfoType 0 0 0 255 ECU_ADDRESS 0x0 /end MEASUREMENT
/begin MEASUREMENT Com_RxAccessInfo[204].InitValueOfRxAccessInfo "" UBYTE Com_InitValueOfRxAccessInfoType 0 0 0 255 ECU_ADDRESS 0x0 /end MEASUREMENT
/begin MEASUREMENT Com_RxAccessInfo[204].InvValueIdxOfRxAccessInfo "" UBYTE Com_InvValueIdxOfRxAccessInfoType 0 0 0 255 ECU_ADDRESS 0x0 /end MEASUREMENT
/begin MEASUREMENT Com_RxAccessInfo[204].InvValueOfRxAccessInfo "" UBYTE Com_InvValueOfRxAccessInfoType 0 0 0 255 ECU_ADDRESS 0x0 /end MEASUREMENT
/begin MEASUREMENT Com_RxAccessInfo[204].IsGroupSignalOfRxAccessInfo "" UBYTE Com_IsGroupSignalOfRxAccessInfoType 0 0 0 1 ECU_ADDRESS 0x0 /end MEASUREMENT
/begin MEASUREMENT Com_RxAccessInfo[204].RxDataTimeoutSubstitutionValueIdxOfRxAccessInfo "" UBYTE Com_RxDataTimeoutSubstitutionValueIdxOfRxAccessInfoType 0 0 0 255 ECU_ADDRESS 0x0 /end MEASUREMENT
/begin MEASUREMENT Com_RxAccessInfo[204].RxDataTimeoutSubstitutionValueOfRxAccessInfo "" UBYTE Com_RxDataTimeoutSubstitutionValueOfRxAccessInfoType 0 0 0 255 ECU_ADDRESS 0x0 /end MEASUREMENT
/begin MEASUREMENT Com_RxAccessInfo[204].RxPduInfoIdxOfRxAccessInfo "" UBYTE NO_COMPU_METHOD 0 0 0 255 ECU_ADDRESS 0x0 /end MEASUREMENT
/begin MEASUREMENT Com_RxAccessInfo[204].RxSigBufferArrayBasedBufferEndIdxOfRxAccessInfo "" UBYTE Com_RxSigBufferArrayBasedBufferEndIdxOfRxAccessInfoType 0 0 0 255 ECU_ADDRESS 0x0 /end MEASUREMENT
/begin MEASUREMENT Com_RxAccessInfo[204].RxSigBufferArrayBasedBufferStartIdxOfRxAccessInfo "" UBYTE Com_RxSigBufferArrayBasedBufferStartIdxOfRxAccessInfoType 0 0 0 255 ECU_ADDRESS 0x0 /end MEASUREMENT
/begin MEASUREMENT Com_RxAccessInfo[204].RxSigBufferArrayBasedShdBufferEndIdxOfRxAccessInfo "" UBYTE Com_RxSigBufferArrayBasedShdBufferEndIdxOfRxAccessInfoType 0 0 0 255 ECU_ADDRESS 0x0 /end MEASUREMENT
/begin MEASUREMENT Com_RxAccessInfo[204].RxSigBufferArrayBasedShdBufferStartIdxOfRxAccessInfo "" UBYTE Com_RxSigBufferArrayBasedShdBufferStartIdxOfRxAccessInfoType 0 0 0 255 ECU_ADDRESS 0x0 /end MEASUREMENT
/begin MEASUREMENT Com_RxAccessInfo[204].RxTOutInfoIdxOfRxAccessInfo "" UBYTE Com_RxTOutInfoIdxOfRxAccessInfoType 0 0 0 255 ECU_ADDRESS 0x0 /end MEASUREMENT
/begin MEASUREMENT Com_RxAccessInfo[204].ShdBufferIdxOfRxAccessInfo "" UWORD Com_ShdBufferIdxOfRxAccessInfoType 0 0 0 65535 ECU_ADDRESS 0x0 /end MEASUREMENT
/begin MEASUREMENT Com_RxAccessInfo[204].SignalLengthInByteOfRxAccessInfo "" UBYTE NO_COMPU_METHOD 0 0 0 255 ECU_ADDRESS 0x0 /end MEASUREMENT
/begin MEASUREMENT Com_RxAccessInfo[204].StartByteInPduPositionOfRxAccessInfo "" UBYTE NO_COMPU_METHOD 0 0 0 255 ECU_ADDRESS 0x0 /end MEASUREMENT
/begin MEASUREMENT Com_RxAccessInfo[204].TmpBufferIdxOfRxAccessInfo "" UBYTE Com_TmpBufferIdxOfRxAccessInfoType 0 0 0 255 ECU_ADDRESS 0x0 /end MEASUREMENT
/begin MEASUREMENT Com_RxAccessInfo[204].TmpBufferOfRxAccessInfo "" UBYTE Com_TmpBufferOfRxAccessInfoType 0 0 0 255 ECU_ADDRESS 0x0 /end MEASUREMENT
/begin MEASUREMENT Com_RxAccessInfo[204].TmpRxShdBufferArrayBasedTmpBufferEndIdxOfRxAccessInfo "" UBYTE Com_TmpRxShdBufferArrayBasedTmpBufferEndIdxOfRxAccessInfoType 0 0 0 255 ECU_ADDRESS 0x0 /end MEASUREMENT
/begin MEASUREMENT Com_RxAccessInfo[204].TmpRxShdBufferArrayBasedTmpBufferStartIdxOfRxAccessInfo "" UBYTE Com_TmpRxShdBufferArrayBasedTmpBufferStartIdxOfRxAccessInfoType 0 0 0 255 ECU_ADDRESS 0x0 /end MEASUREMENT
/begin MEASUREMENT Com_RxAccessInfo[205].ApplTypeOfRxAccessInfo "" UBYTE Com_ApplTypeOfRxAccessInfoType 0 0 0 255 ECU_ADDRESS 0x0 /end MEASUREMENT
/begin MEASUREMENT Com_RxAccessInfo[205].BitLengthOfRxAccessInfo "" UWORD NO_COMPU_METHOD 0 0 0 65535 ECU_ADDRESS 0x0 /end MEASUREMENT
/begin MEASUREMENT Com_RxAccessInfo[205].BitPositionOfRxAccessInfo "" UWORD NO_COMPU_METHOD 0 0 0 65535 ECU_ADDRESS 0x0 /end MEASUREMENT
/begin MEASUREMENT Com_RxAccessInfo[205].BufferIdxOfRxAccessInfo "" UWORD Com_BufferIdxOfRxAccessInfoType 0 0 0 65535 ECU_ADDRESS 0x0 /end MEASUREMENT
/begin MEASUREMENT Com_RxAccessInfo[205].BusAccOfRxAccessInfo "" UBYTE Com_BusAccOfRxAccessInfoType 0 0 0 255 ECU_ADDRESS 0x0 /end MEASUREMENT
/begin MEASUREMENT Com_RxAccessInfo[205].ByteLengthOfRxAccessInfo "" UBYTE NO_COMPU_METHOD 0 0 0 255 ECU_ADDRESS 0x0 /end MEASUREMENT
/begin MEASUREMENT Com_RxAccessInfo[205].ConstValueArrayBasedInitValueEndIdxOfRxAccessInfo "" UBYTE Com_ConstValueArrayBasedInitValueEndIdxOfRxAccessInfoType 0 0 0 255 ECU_ADDRESS 0x0 /end MEASUREMENT
/begin MEASUREMENT Com_RxAccessInfo[205].ConstValueArrayBasedInitValueStartIdxOfRxAccessInfo "" UBYTE Com_ConstValueArrayBasedInitValueStartIdxOfRxAccessInfoType 0 0 0 255 ECU_ADDRESS 0x0 /end MEASUREMENT
/begin MEASUREMENT Com_RxAccessInfo[205].DynSignalOfRxAccessInfo "" UBYTE Com_DynSignalOfRxAccessInfoType 0 0 0 1 ECU_ADDRESS 0x0 /end MEASUREMENT
/begin MEASUREMENT Com_RxAccessInfo[205].InitValueIdxOfRxAccessInfo "" UBYTE Com_InitValueIdxOfRxAccessInfoType 0 0 0 255 ECU_ADDRESS 0x0 /end MEASUREMENT
/begin MEASUREMENT Com_RxAccessInfo[205].InitValueOfRxAccessInfo "" UBYTE Com_InitValueOfRxAccessInfoType 0 0 0 255 ECU_ADDRESS 0x0 /end MEASUREMENT
/begin MEASUREMENT Com_RxAccessInfo[205].InvValueIdxOfRxAccessInfo "" UBYTE Com_InvValueIdxOfRxAccessInfoType 0 0 0 255 ECU_ADDRESS 0x0 /end MEASUREMENT
/begin MEASUREMENT Com_RxAccessInfo[205].InvValueOfRxAccessInfo "" UBYTE Com_InvValueOfRxAccessInfoType 0 0 0 255 ECU_ADDRESS 0x0 /end MEASUREMENT
/begin MEASUREMENT Com_RxAccessInfo[205].IsGroupSignalOfRxAccessInfo "" UBYTE Com_IsGroupSignalOfRxAccessInfoType 0 0 0 1 ECU_ADDRESS 0x0 /end MEASUREMENT
/begin MEASUREMENT Com_RxAccessInfo[205].RxDataTimeoutSubstitutionValueIdxOfRxAccessInfo "" UBYTE Com_RxDataTimeoutSubstitutionValueIdxOfRxAccessInfoType 0 0 0 255 ECU_ADDRESS 0x0 /end MEASUREMENT
/begin MEASUREMENT Com_RxAccessInfo[205].RxDataTimeoutSubstitutionValueOfRxAccessInfo "" UBYTE Com_RxDataTimeoutSubstitutionValueOfRxAccessInfoType 0 0 0 255 ECU_ADDRESS 0x0 /end MEASUREMENT
/begin MEASUREMENT Com_RxAccessInfo[205].RxPduInfoIdxOfRxAccessInfo "" UBYTE NO_COMPU_METHOD 0 0 0 255 ECU_ADDRESS 0x0 /end MEASUREMENT
/begin MEASUREMENT Com_RxAccessInfo[205].RxSigBufferArrayBasedBufferEndIdxOfRxAccessInfo "" UBYTE Com_RxSigBufferArrayBasedBufferEndIdxOfRxAccessInfoType 0 0 0 255 ECU_ADDRESS 0x0 /end MEASUREMENT
/begin MEASUREMENT Com_RxAccessInfo[205].RxSigBufferArrayBasedBufferStartIdxOfRxAccessInfo "" UBYTE Com_RxSigBufferArrayBasedBufferStartIdxOfRxAccessInfoType 0 0 0 255 ECU_ADDRESS 0x0 /end MEASUREMENT
/begin MEASUREMENT Com_RxAccessInfo[205].RxSigBufferArrayBasedShdBufferEndIdxOfRxAccessInfo "" UBYTE Com_RxSigBufferArrayBasedShdBufferEndIdxOfRxAccessInfoType 0 0 0 255 ECU_ADDRESS 0x0 /end MEASUREMENT
/begin MEASUREMENT Com_RxAccessInfo[205].RxSigBufferArrayBasedShdBufferStartIdxOfRxAccessInfo "" UBYTE Com_RxSigBufferArrayBasedShdBufferStartIdxOfRxAccessInfoType 0 0 0 255 ECU_ADDRESS 0x0 /end MEASUREMENT
/begin MEASUREMENT Com_RxAccessInfo[205].RxTOutInfoIdxOfRxAccessInfo "" UBYTE Com_RxTOutInfoIdxOfRxAccessInfoType 0 0 0 255 ECU_ADDRESS 0x0 /end MEASUREMENT
/begin MEASUREMENT Com_RxAccessInfo[205].ShdBufferIdxOfRxAccessInfo "" UWORD Com_ShdBufferIdxOfRxAccessInfoType 0 0 0 65535 ECU_ADDRESS 0x0 /end MEASUREMENT
/begin MEASUREMENT Com_RxAccessInfo[205].SignalLengthInByteOfRxAccessInfo "" UBYTE NO_COMPU_METHOD 0 0 0 255 ECU_ADDRESS 0x0 /end MEASUREMENT
/begin MEASUREMENT Com_RxAccessInfo[205].StartByteInPduPositionOfRxAccessInfo "" UBYTE NO_COMPU_METHOD 0 0 0 255 ECU_ADDRESS 0x0 /end MEASUREMENT
/begin MEASUREMENT Com_RxAccessInfo[205].TmpBufferIdxOfRxAccessInfo "" UBYTE Com_TmpBufferIdxOfRxAccessInfoType 0 0 0 255 ECU_ADDRESS 0x0 /end MEASUREMENT
/begin MEASUREMENT Com_RxAccessInfo[205].TmpBufferOfRxAccessInfo "" UBYTE Com_TmpBufferOfRxAccessInfoType 0 0 0 255 ECU_ADDRESS 0x0 /end MEASUREMENT
/begin MEASUREMENT Com_RxAccessInfo[205].TmpRxShdBufferArrayBasedTmpBufferEndIdxOfRxAccessInfo "" UBYTE Com_TmpRxShdBufferArrayBasedTmpBufferEndIdxOfRxAccessInfoType 0 0 0 255 ECU_ADDRESS 0x0 /end MEASUREMENT
/begin MEASUREMENT Com_RxAccessInfo[205].TmpRxShdBufferArrayBasedTmpBufferStartIdxOfRxAccessInfo "" UBYTE Com_TmpRxShdBufferArrayBasedTmpBufferStartIdxOfRxAccessInfoType 0 0 0 255 ECU_ADDRESS 0x0 /end MEASUREMENT
/begin MEASUREMENT Com_RxAccessInfo[206].ApplTypeOfRxAccessInfo "" UBYTE Com_ApplTypeOfRxAccessInfoType 0 0 0 255 ECU_ADDRESS 0x0 /end MEASUREMENT
/begin MEASUREMENT Com_RxAccessInfo[206].BitLengthOfRxAccessInfo "" UWORD NO_COMPU_METHOD 0 0 0 65535 ECU_ADDRESS 0x0 /end MEASUREMENT
/begin MEASUREMENT Com_RxAccessInfo[206].BitPositionOfRxAccessInfo "" UWORD NO_COMPU_METHOD 0 0 0 65535 ECU_ADDRESS 0x0 /end MEASUREMENT
/begin MEASUREMENT Com_RxAccessInfo[206].BufferIdxOfRxAccessInfo "" UWORD Com_BufferIdxOfRxAccessInfoType 0 0 0 65535 ECU_ADDRESS 0x0 /end MEASUREMENT
/begin MEASUREMENT Com_RxAccessInfo[206].BusAccOfRxAccessInfo "" UBYTE Com_BusAccOfRxAccessInfoType 0 0 0 255 ECU_ADDRESS 0x0 /end MEASUREMENT
/begin MEASUREMENT Com_RxAccessInfo[206].ByteLengthOfRxAccessInfo "" UBYTE NO_COMPU_METHOD 0 0 0 255 ECU_ADDRESS 0x0 /end MEASUREMENT
/begin MEASUREMENT Com_RxAccessInfo[206].ConstValueArrayBasedInitValueEndIdxOfRxAccessInfo "" UBYTE Com_ConstValueArrayBasedInitValueEndIdxOfRxAccessInfoType 0 0 0 255 ECU_ADDRESS 0x0 /end MEASUREMENT
/begin MEASUREMENT Com_RxAccessInfo[206].ConstValueArrayBasedInitValueStartIdxOfRxAccessInfo "" UBYTE Com_ConstValueArrayBasedInitValueStartIdxOfRxAccessInfoType 0 0 0 255 ECU_ADDRESS 0x0 /end MEASUREMENT
/begin MEASUREMENT Com_RxAccessInfo[206].DynSignalOfRxAccessInfo "" UBYTE Com_DynSignalOfRxAccessInfoType 0 0 0 1 ECU_ADDRESS 0x0 /end MEASUREMENT
/begin MEASUREMENT Com_RxAccessInfo[206].InitValueIdxOfRxAccessInfo "" UBYTE Com_InitValueIdxOfRxAccessInfoType 0 0 0 255 ECU_ADDRESS 0x0 /end MEASUREMENT
/begin MEASUREMENT Com_RxAccessInfo[206].InitValueOfRxAccessInfo "" UBYTE Com_InitValueOfRxAccessInfoType 0 0 0 255 ECU_ADDRESS 0x0 /end MEASUREMENT
/begin MEASUREMENT Com_RxAccessInfo[206].InvValueIdxOfRxAccessInfo "" UBYTE Com_InvValueIdxOfRxAccessInfoType 0 0 0 255 ECU_ADDRESS 0x0 /end MEASUREMENT
/begin MEASUREMENT Com_RxAccessInfo[206].InvValueOfRxAccessInfo "" UBYTE Com_InvValueOfRxAccessInfoType 0 0 0 255 ECU_ADDRESS 0x0 /end MEASUREMENT
/begin MEASUREMENT Com_RxAccessInfo[206].IsGroupSignalOfRxAccessInfo "" UBYTE Com_IsGroupSignalOfRxAccessInfoType 0 0 0 1 ECU_ADDRESS 0x0 /end MEASUREMENT
/begin MEASUREMENT Com_RxAccessInfo[206].RxDataTimeoutSubstitutionValueIdxOfRxAccessInfo "" UBYTE Com_RxDataTimeoutSubstitutionValueIdxOfRxAccessInfoType 0 0 0 255 ECU_ADDRESS 0x0 /end MEASUREMENT
/begin MEASUREMENT Com_RxAccessInfo[206].RxDataTimeoutSubstitutionValueOfRxAccessInfo "" UBYTE Com_RxDataTimeoutSubstitutionValueOfRxAccessInfoType 0 0 0 255 ECU_ADDRESS 0x0 /end MEASUREMENT
/begin MEASUREMENT Com_RxAccessInfo[206].RxPduInfoIdxOfRxAccessInfo "" UBYTE NO_COMPU_METHOD 0 0 0 255 ECU_ADDRESS 0x0 /end MEASUREMENT
/begin MEASUREMENT Com_RxAccessInfo[206].RxSigBufferArrayBasedBufferEndIdxOfRxAccessInfo "" UBYTE Com_RxSigBufferArrayBasedBufferEndIdxOfRxAccessInfoType 0 0 0 255 ECU_ADDRESS 0x0 /end MEASUREMENT
/begin MEASUREMENT Com_RxAccessInfo[206].RxSigBufferArrayBasedBufferStartIdxOfRxAccessInfo "" UBYTE Com_RxSigBufferArrayBasedBufferStartIdxOfRxAccessInfoType 0 0 0 255 ECU_ADDRESS 0x0 /end MEASUREMENT
/begin MEASUREMENT Com_RxAccessInfo[206].RxSigBufferArrayBasedShdBufferEndIdxOfRxAccessInfo "" UBYTE Com_RxSigBufferArrayBasedShdBufferEndIdxOfRxAccessInfoType 0 0 0 255 ECU_ADDRESS 0x0 /end MEASUREMENT
/begin MEASUREMENT Com_RxAccessInfo[206].RxSigBufferArrayBasedShdBufferStartIdxOfRxAccessInfo "" UBYTE Com_RxSigBufferArrayBasedShdBufferStartIdxOfRxAccessInfoType 0 0 0 255 ECU_ADDRESS 0x0 /end MEASUREMENT
/begin MEASUREMENT Com_RxAccessInfo[206].RxTOutInfoIdxOfRxAccessInfo "" UBYTE Com_RxTOutInfoIdxOfRxAccessInfoType 0 0 0 255 ECU_ADDRESS 0x0 /end MEASUREMENT
/begin MEASUREMENT Com_RxAccessInfo[206].ShdBufferIdxOfRxAccessInfo "" UWORD Com_ShdBufferIdxOfRxAccessInfoType 0 0 0 65535 ECU_ADDRESS 0x0 /end MEASUREMENT
/begin MEASUREMENT Com_RxAccessInfo[206].SignalLengthInByteOfRxAccessInfo "" UBYTE NO_COMPU_METHOD 0 0 0 255 ECU_ADDRESS 0x0 /end MEASUREMENT
/begin MEASUREMENT Com_RxAccessInfo[206].StartByteInPduPositionOfRxAccessInfo "" UBYTE NO_COMPU_METHOD 0 0 0 255 ECU_ADDRESS 0x0 /end MEASUREMENT
/begin MEASUREMENT Com_RxAccessInfo[206].TmpBufferIdxOfRxAccessInfo "" UBYTE Com_TmpBufferIdxOfRxAccessInfoType 0 0 0 255 ECU_ADDRESS 0x0 /end MEASUREMENT
/begin MEASUREMENT Com_RxAccessInfo[206].TmpBufferOfRxAccessInfo "" UBYTE Com_TmpBufferOfRxAccessInfoType 0 0 0 255 ECU_ADDRESS 0x0 /end MEASUREMENT
/begin MEASUREMENT Com_RxAccessInfo[206].TmpRxShdBufferArrayBasedTmpBufferEndIdxOfRxAccessInfo "" UBYTE Com_TmpRxShdBufferArrayBasedTmpBufferEndIdxOfRxAccessInfoType 0 0 0 255 ECU_ADDRESS 0x0 /end MEASUREMENT
/begin MEASUREMENT Com_RxAccessInfo[206].TmpRxShdBufferArrayBasedTmpBufferStartIdxOfRxAccessInfo "" UBYTE Com_TmpRxShdBufferArrayBasedTmpBufferStartIdxOfRxAccessInfoType 0 0 0 255 ECU_ADDRESS 0x0 /end MEASUREMENT
/begin MEASUREMENT Com_RxAccessInfo[207].ApplTypeOfRxAccessInfo "" UBYTE Com_ApplTypeOfRxAccessInfoType 0 0 0 255 ECU_ADDRESS 0x0 /end MEASUREMENT
/begin MEASUREMENT Com_RxAccessInfo[207].BitLengthOfRxAccessInfo "" UWORD NO_COMPU_METHOD 0 0 0 65535 ECU_ADDRESS 0x0 /end MEASUREMENT
/begin MEASUREMENT Com_RxAccessInfo[207].BitPositionOfRxAccessInfo "" UWORD NO_COMPU_METHOD 0 0 0 65535 ECU_ADDRESS 0x0 /end MEASUREMENT
/begin MEASUREMENT Com_RxAccessInfo[207].BufferIdxOfRxAccessInfo "" UWORD Com_BufferIdxOfRxAccessInfoType 0 0 0 65535 ECU_ADDRESS 0x0 /end MEASUREMENT
/begin MEASUREMENT Com_RxAccessInfo[207].BusAccOfRxAccessInfo "" UBYTE Com_BusAccOfRxAccessInfoType 0 0 0 255 ECU_ADDRESS 0x0 /end MEASUREMENT
/begin MEASUREMENT Com_RxAccessInfo[207].ByteLengthOfRxAccessInfo "" UBYTE NO_COMPU_METHOD 0 0 0 255 ECU_ADDRESS 0x0 /end MEASUREMENT
/begin MEASUREMENT Com_RxAccessInfo[207].ConstValueArrayBasedInitValueEndIdxOfRxAccessInfo "" UBYTE Com_ConstValueArrayBasedInitValueEndIdxOfRxAccessInfoType 0 0 0 255 ECU_ADDRESS 0x0 /end MEASUREMENT
/begin MEASUREMENT Com_RxAccessInfo[207].ConstValueArrayBasedInitValueStartIdxOfRxAccessInfo "" UBYTE Com_ConstValueArrayBasedInitValueStartIdxOfRxAccessInfoType 0 0 0 255 ECU_ADDRESS 0x0 /end MEASUREMENT
/begin MEASUREMENT Com_RxAccessInfo[207].DynSignalOfRxAccessInfo "" UBYTE Com_DynSignalOfRxAccessInfoType 0 0 0 1 ECU_ADDRESS 0x0 /end MEASUREMENT
/begin MEASUREMENT Com_RxAccessInfo[207].InitValueIdxOfRxAccessInfo "" UBYTE Com_InitValueIdxOfRxAccessInfoType 0 0 0 255 ECU_ADDRESS 0x0 /end MEASUREMENT
/begin MEASUREMENT Com_RxAccessInfo[207].InitValueOfRxAccessInfo "" UBYTE Com_InitValueOfRxAccessInfoType 0 0 0 255 ECU_ADDRESS 0x0 /end MEASUREMENT
/begin MEASUREMENT Com_RxAccessInfo[207].InvValueIdxOfRxAccessInfo "" UBYTE Com_InvValueIdxOfRxAccessInfoType 0 0 0 255 ECU_ADDRESS 0x0 /end MEASUREMENT
/begin MEASUREMENT Com_RxAccessInfo[207].InvValueOfRxAccessInfo "" UBYTE Com_InvValueOfRxAccessInfoType 0 0 0 255 ECU_ADDRESS 0x0 /end MEASUREMENT
/begin MEASUREMENT Com_RxAccessInfo[207].IsGroupSignalOfRxAccessInfo "" UBYTE Com_IsGroupSignalOfRxAccessInfoType 0 0 0 1 ECU_ADDRESS 0x0 /end MEASUREMENT
/begin MEASUREMENT Com_RxAccessInfo[207].RxDataTimeoutSubstitutionValueIdxOfRxAccessInfo "" UBYTE Com_RxDataTimeoutSubstitutionValueIdxOfRxAccessInfoType 0 0 0 255 ECU_ADDRESS 0x0 /end MEASUREMENT
/begin MEASUREMENT Com_RxAccessInfo[207].RxDataTimeoutSubstitutionValueOfRxAccessInfo "" UBYTE Com_RxDataTimeoutSubstitutionValueOfRxAccessInfoType 0 0 0 255 ECU_ADDRESS 0x0 /end MEASUREMENT
/begin MEASUREMENT Com_RxAccessInfo[207].RxPduInfoIdxOfRxAccessInfo "" UBYTE NO_COMPU_METHOD 0 0 0 255 ECU_ADDRESS 0x0 /end MEASUREMENT
/begin MEASUREMENT Com_RxAccessInfo[207].RxSigBufferArrayBasedBufferEndIdxOfRxAccessInfo "" UBYTE Com_RxSigBufferArrayBasedBufferEndIdxOfRxAccessInfoType 0 0 0 255 ECU_ADDRESS 0x0 /end MEASUREMENT
/begin MEASUREMENT Com_RxAccessInfo[207].RxSigBufferArrayBasedBufferStartIdxOfRxAccessInfo "" UBYTE Com_RxSigBufferArrayBasedBufferStartIdxOfRxAccessInfoType 0 0 0 255 ECU_ADDRESS 0x0 /end MEASUREMENT
/begin MEASUREMENT Com_RxAccessInfo[207].RxSigBufferArrayBasedShdBufferEndIdxOfRxAccessInfo "" UBYTE Com_RxSigBufferArrayBasedShdBufferEndIdxOfRxAccessInfoType 0 0 0 255 ECU_ADDRESS 0x0 /end MEASUREMENT
/begin MEASUREMENT Com_RxAccessInfo[207].RxSigBufferArrayBasedShdBufferStartIdxOfRxAccessInfo "" UBYTE Com_RxSigBufferArrayBasedShdBufferStartIdxOfRxAccessInfoType 0 0 0 255 ECU_ADDRESS 0x0 /end MEASUREMENT
/begin MEASUREMENT Com_RxAccessInfo[207].RxTOutInfoIdxOfRxAccessInfo "" UBYTE Com_RxTOutInfoIdxOfRxAccessInfoType 0 0 0 255 ECU_ADDRESS 0x0 /end MEASUREMENT
/begin MEASUREMENT Com_RxAccessInfo[207].ShdBufferIdxOfRxAccessInfo "" UWORD Com_ShdBufferIdxOfRxAccessInfoType 0 0 0 65535 ECU_ADDRESS 0x0 /end MEASUREMENT
/begin MEASUREMENT Com_RxAccessInfo[207].SignalLengthInByteOfRxAccessInfo "" UBYTE NO_COMPU_METHOD 0 0 0 255 ECU_ADDRESS 0x0 /end MEASUREMENT
/begin MEASUREMENT Com_RxAccessInfo[207].StartByteInPduPositionOfRxAccessInfo "" UBYTE NO_COMPU_METHOD 0 0 0 255 ECU_ADDRESS 0x0 /end MEASUREMENT
/begin MEASUREMENT Com_RxAccessInfo[207].TmpBufferIdxOfRxAccessInfo "" UBYTE Com_TmpBufferIdxOfRxAccessInfoType 0 0 0 255 ECU_ADDRESS 0x0 /end MEASUREMENT
/begin MEASUREMENT Com_RxAccessInfo[207].TmpBufferOfRxAccessInfo "" UBYTE Com_TmpBufferOfRxAccessInfoType 0 0 0 255 ECU_ADDRESS 0x0 /end MEASUREMENT
/begin MEASUREMENT Com_RxAccessInfo[207].TmpRxShdBufferArrayBasedTmpBufferEndIdxOfRxAccessInfo "" UBYTE Com_TmpRxShdBufferArrayBasedTmpBufferEndIdxOfRxAccessInfoType 0 0 0 255 ECU_ADDRESS 0x0 /end MEASUREMENT
/begin MEASUREMENT Com_RxAccessInfo[207].TmpRxShdBufferArrayBasedTmpBufferStartIdxOfRxAccessInfo "" UBYTE Com_TmpRxShdBufferArrayBasedTmpBufferStartIdxOfRxAccessInfoType 0 0 0 255 ECU_ADDRESS 0x0 /end MEASUREMENT
/begin MEASUREMENT Com_RxAccessInfo[208].ApplTypeOfRxAccessInfo "" UBYTE Com_ApplTypeOfRxAccessInfoType 0 0 0 255 ECU_ADDRESS 0x0 /end MEASUREMENT
/begin MEASUREMENT Com_RxAccessInfo[208].BitLengthOfRxAccessInfo "" UWORD NO_COMPU_METHOD 0 0 0 65535 ECU_ADDRESS 0x0 /end MEASUREMENT
/begin MEASUREMENT Com_RxAccessInfo[208].BitPositionOfRxAccessInfo "" UWORD NO_COMPU_METHOD 0 0 0 65535 ECU_ADDRESS 0x0 /end MEASUREMENT
/begin MEASUREMENT Com_RxAccessInfo[208].BufferIdxOfRxAccessInfo "" UWORD Com_BufferIdxOfRxAccessInfoType 0 0 0 65535 ECU_ADDRESS 0x0 /end MEASUREMENT
/begin MEASUREMENT Com_RxAccessInfo[208].BusAccOfRxAccessInfo "" UBYTE Com_BusAccOfRxAccessInfoType 0 0 0 255 ECU_ADDRESS 0x0 /end MEASUREMENT
/begin MEASUREMENT Com_RxAccessInfo[208].ByteLengthOfRxAccessInfo "" UBYTE NO_COMPU_METHOD 0 0 0 255 ECU_ADDRESS 0x0 /end MEASUREMENT
/begin MEASUREMENT Com_RxAccessInfo[208].ConstValueArrayBasedInitValueEndIdxOfRxAccessInfo "" UBYTE Com_ConstValueArrayBasedInitValueEndIdxOfRxAccessInfoType 0 0 0 255 ECU_ADDRESS 0x0 /end MEASUREMENT
/begin MEASUREMENT Com_RxAccessInfo[208].ConstValueArrayBasedInitValueStartIdxOfRxAccessInfo "" UBYTE Com_ConstValueArrayBasedInitValueStartIdxOfRxAccessInfoType 0 0 0 255 ECU_ADDRESS 0x0 /end MEASUREMENT
/begin MEASUREMENT Com_RxAccessInfo[208].DynSignalOfRxAccessInfo "" UBYTE Com_DynSignalOfRxAccessInfoType 0 0 0 1 ECU_ADDRESS 0x0 /end MEASUREMENT
/begin MEASUREMENT Com_RxAccessInfo[208].InitValueIdxOfRxAccessInfo "" UBYTE Com_InitValueIdxOfRxAccessInfoType 0 0 0 255 ECU_ADDRESS 0x0 /end MEASUREMENT
/begin MEASUREMENT Com_RxAccessInfo[208].InitValueOfRxAccessInfo "" UBYTE Com_InitValueOfRxAccessInfoType 0 0 0 255 ECU_ADDRESS 0x0 /end MEASUREMENT
/begin MEASUREMENT Com_RxAccessInfo[208].InvValueIdxOfRxAccessInfo "" UBYTE Com_InvValueIdxOfRxAccessInfoType 0 0 0 255 ECU_ADDRESS 0x0 /end MEASUREMENT
/begin MEASUREMENT Com_RxAccessInfo[208].InvValueOfRxAccessInfo "" UBYTE Com_InvValueOfRxAccessInfoType 0 0 0 255 ECU_ADDRESS 0x0 /end MEASUREMENT
/begin MEASUREMENT Com_RxAccessInfo[208].IsGroupSignalOfRxAccessInfo "" UBYTE Com_IsGroupSignalOfRxAccessInfoType 0 0 0 1 ECU_ADDRESS 0x0 /end MEASUREMENT
/begin MEASUREMENT Com_RxAccessInfo[208].RxDataTimeoutSubstitutionValueIdxOfRxAccessInfo "" UBYTE Com_RxDataTimeoutSubstitutionValueIdxOfRxAccessInfoType 0 0 0 255 ECU_ADDRESS 0x0 /end MEASUREMENT
/begin MEASUREMENT Com_RxAccessInfo[208].RxDataTimeoutSubstitutionValueOfRxAccessInfo "" UBYTE Com_RxDataTimeoutSubstitutionValueOfRxAccessInfoType 0 0 0 255 ECU_ADDRESS 0x0 /end MEASUREMENT
/begin MEASUREMENT Com_RxAccessInfo[208].RxPduInfoIdxOfRxAccessInfo "" UBYTE NO_COMPU_METHOD 0 0 0 255 ECU_ADDRESS 0x0 /end MEASUREMENT
/begin MEASUREMENT Com_RxAccessInfo[208].RxSigBufferArrayBasedBufferEndIdxOfRxAccessInfo "" UBYTE Com_RxSigBufferArrayBasedBufferEndIdxOfRxAccessInfoType 0 0 0 255 ECU_ADDRESS 0x0 /end MEASUREMENT
/begin MEASUREMENT Com_RxAccessInfo[208].RxSigBufferArrayBasedBufferStartIdxOfRxAccessInfo "" UBYTE Com_RxSigBufferArrayBasedBufferStartIdxOfRxAccessInfoType 0 0 0 255 ECU_ADDRESS 0x0 /end MEASUREMENT
/begin MEASUREMENT Com_RxAccessInfo[208].RxSigBufferArrayBasedShdBufferEndIdxOfRxAccessInfo "" UBYTE Com_RxSigBufferArrayBasedShdBufferEndIdxOfRxAccessInfoType 0 0 0 255 ECU_ADDRESS 0x0 /end MEASUREMENT
/begin MEASUREMENT Com_RxAccessInfo[208].RxSigBufferArrayBasedShdBufferStartIdxOfRxAccessInfo "" UBYTE Com_RxSigBufferArrayBasedShdBufferStartIdxOfRxAccessInfoType 0 0 0 255 ECU_ADDRESS 0x0 /end MEASUREMENT
/begin MEASUREMENT Com_RxAccessInfo[208].RxTOutInfoIdxOfRxAccessInfo "" UBYTE Com_RxTOutInfoIdxOfRxAccessInfoType 0 0 0 255 ECU_ADDRESS 0x0 /end MEASUREMENT
/begin MEASUREMENT Com_RxAccessInfo[208].ShdBufferIdxOfRxAccessInfo "" UWORD Com_ShdBufferIdxOfRxAccessInfoType 0 0 0 65535 ECU_ADDRESS 0x0 /end MEASUREMENT
/begin MEASUREMENT Com_RxAccessInfo[208].SignalLengthInByteOfRxAccessInfo "" UBYTE NO_COMPU_METHOD 0 0 0 255 ECU_ADDRESS 0x0 /end MEASUREMENT
/begin MEASUREMENT Com_RxAccessInfo[208].StartByteInPduPositionOfRxAccessInfo "" UBYTE NO_COMPU_METHOD 0 0 0 255 ECU_ADDRESS 0x0 /end MEASUREMENT
/begin MEASUREMENT Com_RxAccessInfo[208].TmpBufferIdxOfRxAccessInfo "" UBYTE Com_TmpBufferIdxOfRxAccessInfoType 0 0 0 255 ECU_ADDRESS 0x0 /end MEASUREMENT
/begin MEASUREMENT Com_RxAccessInfo[208].TmpBufferOfRxAccessInfo "" UBYTE Com_TmpBufferOfRxAccessInfoType 0 0 0 255 ECU_ADDRESS 0x0 /end MEASUREMENT
/begin MEASUREMENT Com_RxAccessInfo[208].TmpRxShdBufferArrayBasedTmpBufferEndIdxOfRxAccessInfo "" UBYTE Com_TmpRxShdBufferArrayBasedTmpBufferEndIdxOfRxAccessInfoType 0 0 0 255 ECU_ADDRESS 0x0 /end MEASUREMENT
/begin MEASUREMENT Com_RxAccessInfo[208].TmpRxShdBufferArrayBasedTmpBufferStartIdxOfRxAccessInfo "" UBYTE Com_TmpRxShdBufferArrayBasedTmpBufferStartIdxOfRxAccessInfoType 0 0 0 255 ECU_ADDRESS 0x0 /end MEASUREMENT
/begin MEASUREMENT Com_RxAccessInfo[209].ApplTypeOfRxAccessInfo "" UBYTE Com_ApplTypeOfRxAccessInfoType 0 0 0 255 ECU_ADDRESS 0x0 /end MEASUREMENT
/begin MEASUREMENT Com_RxAccessInfo[209].BitLengthOfRxAccessInfo "" UWORD NO_COMPU_METHOD 0 0 0 65535 ECU_ADDRESS 0x0 /end MEASUREMENT
/begin MEASUREMENT Com_RxAccessInfo[209].BitPositionOfRxAccessInfo "" UWORD NO_COMPU_METHOD 0 0 0 65535 ECU_ADDRESS 0x0 /end MEASUREMENT
/begin MEASUREMENT Com_RxAccessInfo[209].BufferIdxOfRxAccessInfo "" UWORD Com_BufferIdxOfRxAccessInfoType 0 0 0 65535 ECU_ADDRESS 0x0 /end MEASUREMENT
/begin MEASUREMENT Com_RxAccessInfo[209].BusAccOfRxAccessInfo "" UBYTE Com_BusAccOfRxAccessInfoType 0 0 0 255 ECU_ADDRESS 0x0 /end MEASUREMENT
/begin MEASUREMENT Com_RxAccessInfo[209].ByteLengthOfRxAccessInfo "" UBYTE NO_COMPU_METHOD 0 0 0 255 ECU_ADDRESS 0x0 /end MEASUREMENT
/begin MEASUREMENT Com_RxAccessInfo[209].ConstValueArrayBasedInitValueEndIdxOfRxAccessInfo "" UBYTE Com_ConstValueArrayBasedInitValueEndIdxOfRxAccessInfoType 0 0 0 255 ECU_ADDRESS 0x0 /end MEASUREMENT
/begin MEASUREMENT Com_RxAccessInfo[209].ConstValueArrayBasedInitValueStartIdxOfRxAccessInfo "" UBYTE Com_ConstValueArrayBasedInitValueStartIdxOfRxAccessInfoType 0 0 0 255 ECU_ADDRESS 0x0 /end MEASUREMENT
/begin MEASUREMENT Com_RxAccessInfo[209].DynSignalOfRxAccessInfo "" UBYTE Com_DynSignalOfRxAccessInfoType 0 0 0 1 ECU_ADDRESS 0x0 /end MEASUREMENT
/begin MEASUREMENT Com_RxAccessInfo[209].InitValueIdxOfRxAccessInfo "" UBYTE Com_InitValueIdxOfRxAccessInfoType 0 0 0 255 ECU_ADDRESS 0x0 /end MEASUREMENT
/begin MEASUREMENT Com_RxAccessInfo[209].InitValueOfRxAccessInfo "" UBYTE Com_InitValueOfRxAccessInfoType 0 0 0 255 ECU_ADDRESS 0x0 /end MEASUREMENT
/begin MEASUREMENT Com_RxAccessInfo[209].InvValueIdxOfRxAccessInfo "" UBYTE Com_InvValueIdxOfRxAccessInfoType 0 0 0 255 ECU_ADDRESS 0x0 /end MEASUREMENT
/begin MEASUREMENT Com_RxAccessInfo[209].InvValueOfRxAccessInfo "" UBYTE Com_InvValueOfRxAccessInfoType 0 0 0 255 ECU_ADDRESS 0x0 /end MEASUREMENT
/begin MEASUREMENT Com_RxAccessInfo[209].IsGroupSignalOfRxAccessInfo "" UBYTE Com_IsGroupSignalOfRxAccessInfoType 0 0 0 1 ECU_ADDRESS 0x0 /end MEASUREMENT
/begin MEASUREMENT Com_RxAccessInfo[209].RxDataTimeoutSubstitutionValueIdxOfRxAccessInfo "" UBYTE Com_RxDataTimeoutSubstitutionValueIdxOfRxAccessInfoType 0 0 0 255 ECU_ADDRESS 0x0 /end MEASUREMENT
/begin MEASUREMENT Com_RxAccessInfo[209].RxDataTimeoutSubstitutionValueOfRxAccessInfo "" UBYTE Com_RxDataTimeoutSubstitutionValueOfRxAccessInfoType 0 0 0 255 ECU_ADDRESS 0x0 /end MEASUREMENT
/begin MEASUREMENT Com_RxAccessInfo[209].RxPduInfoIdxOfRxAccessInfo "" UBYTE NO_COMPU_METHOD 0 0 0 255 ECU_ADDRESS 0x0 /end MEASUREMENT
/begin MEASUREMENT Com_RxAccessInfo[209].RxSigBufferArrayBasedBufferEndIdxOfRxAccessInfo "" UBYTE Com_RxSigBufferArrayBasedBufferEndIdxOfRxAccessInfoType 0 0 0 255 ECU_ADDRESS 0x0 /end MEASUREMENT
/begin MEASUREMENT Com_RxAccessInfo[209].RxSigBufferArrayBasedBufferStartIdxOfRxAccessInfo "" UBYTE Com_RxSigBufferArrayBasedBufferStartIdxOfRxAccessInfoType 0 0 0 255 ECU_ADDRESS 0x0 /end MEASUREMENT
/begin MEASUREMENT Com_RxAccessInfo[209].RxSigBufferArrayBasedShdBufferEndIdxOfRxAccessInfo "" UBYTE Com_RxSigBufferArrayBasedShdBufferEndIdxOfRxAccessInfoType 0 0 0 255 ECU_ADDRESS 0x0 /end MEASUREMENT
/begin MEASUREMENT Com_RxAccessInfo[209].RxSigBufferArrayBasedShdBufferStartIdxOfRxAccessInfo "" UBYTE Com_RxSigBufferArrayBasedShdBufferStartIdxOfRxAccessInfoType 0 0 0 255 ECU_ADDRESS 0x0 /end MEASUREMENT
/begin MEASUREMENT Com_RxAccessInfo[209].RxTOutInfoIdxOfRxAccessInfo "" UBYTE Com_RxTOutInfoIdxOfRxAccessInfoType 0 0 0 255 ECU_ADDRESS 0x0 /end MEASUREMENT
/begin MEASUREMENT Com_RxAccessInfo[209].ShdBufferIdxOfRxAccessInfo "" UWORD Com_ShdBufferIdxOfRxAccessInfoType 0 0 0 65535 ECU_ADDRESS 0x0 /end MEASUREMENT
/begin MEASUREMENT Com_RxAccessInfo[209].SignalLengthInByteOfRxAccessInfo "" UBYTE NO_COMPU_METHOD 0 0 0 255 ECU_ADDRESS 0x0 /end MEASUREMENT
/begin MEASUREMENT Com_RxAccessInfo[209].StartByteInPduPositionOfRxAccessInfo "" UBYTE NO_COMPU_METHOD 0 0 0 255 ECU_ADDRESS 0x0 /end MEASUREMENT
/begin MEASUREMENT Com_RxAccessInfo[209].TmpBufferIdxOfRxAccessInfo "" UBYTE Com_TmpBufferIdxOfRxAccessInfoType 0 0 0 255 ECU_ADDRESS 0x0 /end MEASUREMENT
/begin MEASUREMENT Com_RxAccessInfo[209].TmpBufferOfRxAccessInfo "" UBYTE Com_TmpBufferOfRxAccessInfoType 0 0 0 255 ECU_ADDRESS 0x0 /end MEASUREMENT
/begin MEASUREMENT Com_RxAccessInfo[209].TmpRxShdBufferArrayBasedTmpBufferEndIdxOfRxAccessInfo "" UBYTE Com_TmpRxShdBufferArrayBasedTmpBufferEndIdxOfRxAccessInfoType 0 0 0 255 ECU_ADDRESS 0x0 /end MEASUREMENT
/begin MEASUREMENT Com_RxAccessInfo[209].TmpRxShdBufferArrayBasedTmpBufferStartIdxOfRxAccessInfo "" UBYTE Com_TmpRxShdBufferArrayBasedTmpBufferStartIdxOfRxAccessInfoType 0 0 0 255 ECU_ADDRESS 0x0 /end MEASUREMENT
/begin MEASUREMENT Com_RxAccessInfo[20].ApplTypeOfRxAccessInfo "" UBYTE Com_ApplTypeOfRxAccessInfoType 0 0 0 255 ECU_ADDRESS 0x0 /end MEASUREMENT
/begin MEASUREMENT Com_RxAccessInfo[20].BitLengthOfRxAccessInfo "" UWORD NO_COMPU_METHOD 0 0 0 65535 ECU_ADDRESS 0x0 /end MEASUREMENT
/begin MEASUREMENT Com_RxAccessInfo[20].BitPositionOfRxAccessInfo "" UWORD NO_COMPU_METHOD 0 0 0 65535 ECU_ADDRESS 0x0 /end MEASUREMENT
/begin MEASUREMENT Com_RxAccessInfo[20].BufferIdxOfRxAccessInfo "" UWORD Com_BufferIdxOfRxAccessInfoType 0 0 0 65535 ECU_ADDRESS 0x0 /end MEASUREMENT
/begin MEASUREMENT Com_RxAccessInfo[20].BusAccOfRxAccessInfo "" UBYTE Com_BusAccOfRxAccessInfoType 0 0 0 255 ECU_ADDRESS 0x0 /end MEASUREMENT
/begin MEASUREMENT Com_RxAccessInfo[20].ByteLengthOfRxAccessInfo "" UBYTE NO_COMPU_METHOD 0 0 0 255 ECU_ADDRESS 0x0 /end MEASUREMENT
/begin MEASUREMENT Com_RxAccessInfo[20].ConstValueArrayBasedInitValueEndIdxOfRxAccessInfo "" UBYTE Com_ConstValueArrayBasedInitValueEndIdxOfRxAccessInfoType 0 0 0 255 ECU_ADDRESS 0x0 /end MEASUREMENT
/begin MEASUREMENT Com_RxAccessInfo[20].ConstValueArrayBasedInitValueStartIdxOfRxAccessInfo "" UBYTE Com_ConstValueArrayBasedInitValueStartIdxOfRxAccessInfoType 0 0 0 255 ECU_ADDRESS 0x0 /end MEASUREMENT
/begin MEASUREMENT Com_RxAccessInfo[20].DynSignalOfRxAccessInfo "" UBYTE Com_DynSignalOfRxAccessInfoType 0 0 0 1 ECU_ADDRESS 0x0 /end MEASUREMENT
/begin MEASUREMENT Com_RxAccessInfo[20].InitValueIdxOfRxAccessInfo "" UBYTE Com_InitValueIdxOfRxAccessInfoType 0 0 0 255 ECU_ADDRESS 0x0 /end MEASUREMENT
/begin MEASUREMENT Com_RxAccessInfo[20].InitValueOfRxAccessInfo "" UBYTE Com_InitValueOfRxAccessInfoType 0 0 0 255 ECU_ADDRESS 0x0 /end MEASUREMENT
/begin MEASUREMENT Com_RxAccessInfo[20].InvValueIdxOfRxAccessInfo "" UBYTE Com_InvValueIdxOfRxAccessInfoType 0 0 0 255 ECU_ADDRESS 0x0 /end MEASUREMENT
/begin MEASUREMENT Com_RxAccessInfo[20].InvValueOfRxAccessInfo "" UBYTE Com_InvValueOfRxAccessInfoType 0 0 0 255 ECU_ADDRESS 0x0 /end MEASUREMENT
/begin MEASUREMENT Com_RxAccessInfo[20].IsGroupSignalOfRxAccessInfo "" UBYTE Com_IsGroupSignalOfRxAccessInfoType 0 0 0 1 ECU_ADDRESS 0x0 /end MEASUREMENT
/begin MEASUREMENT Com_RxAccessInfo[20].RxDataTimeoutSubstitutionValueIdxOfRxAccessInfo "" UBYTE Com_RxDataTimeoutSubstitutionValueIdxOfRxAccessInfoType 0 0 0 255 ECU_ADDRESS 0x0 /end MEASUREMENT
/begin MEASUREMENT Com_RxAccessInfo[20].RxDataTimeoutSubstitutionValueOfRxAccessInfo "" UBYTE Com_RxDataTimeoutSubstitutionValueOfRxAccessInfoType 0 0 0 255 ECU_ADDRESS 0x0 /end MEASUREMENT
/begin MEASUREMENT Com_RxAccessInfo[20].RxPduInfoIdxOfRxAccessInfo "" UBYTE NO_COMPU_METHOD 0 0 0 255 ECU_ADDRESS 0x0 /end MEASUREMENT
/begin MEASUREMENT Com_RxAccessInfo[20].RxSigBufferArrayBasedBufferEndIdxOfRxAccessInfo "" UBYTE Com_RxSigBufferArrayBasedBufferEndIdxOfRxAccessInfoType 0 0 0 255 ECU_ADDRESS 0x0 /end MEASUREMENT
/begin MEASUREMENT Com_RxAccessInfo[20].RxSigBufferArrayBasedBufferStartIdxOfRxAccessInfo "" UBYTE Com_RxSigBufferArrayBasedBufferStartIdxOfRxAccessInfoType 0 0 0 255 ECU_ADDRESS 0x0 /end MEASUREMENT
/begin MEASUREMENT Com_RxAccessInfo[20].RxSigBufferArrayBasedShdBufferEndIdxOfRxAccessInfo "" UBYTE Com_RxSigBufferArrayBasedShdBufferEndIdxOfRxAccessInfoType 0 0 0 255 ECU_ADDRESS 0x0 /end MEASUREMENT
/begin MEASUREMENT Com_RxAccessInfo[20].RxSigBufferArrayBasedShdBufferStartIdxOfRxAccessInfo "" UBYTE Com_RxSigBufferArrayBasedShdBufferStartIdxOfRxAccessInfoType 0 0 0 255 ECU_ADDRESS 0x0 /end MEASUREMENT
/begin MEASUREMENT Com_RxAccessInfo[20].RxTOutInfoIdxOfRxAccessInfo "" UBYTE Com_RxTOutInfoIdxOfRxAccessInfoType 0 0 0 255 ECU_ADDRESS 0x0 /end MEASUREMENT
/begin MEASUREMENT Com_RxAccessInfo[20].ShdBufferIdxOfRxAccessInfo "" UWORD Com_ShdBufferIdxOfRxAccessInfoType 0 0 0 65535 ECU_ADDRESS 0x0 /end MEASUREMENT
/begin MEASUREMENT Com_RxAccessInfo[20].SignalLengthInByteOfRxAccessInfo "" UBYTE NO_COMPU_METHOD 0 0 0 255 ECU_ADDRESS 0x0 /end MEASUREMENT
/begin MEASUREMENT Com_RxAccessInfo[20].StartByteInPduPositionOfRxAccessInfo "" UBYTE NO_COMPU_METHOD 0 0 0 255 ECU_ADDRESS 0x0 /end MEASUREMENT
/begin MEASUREMENT Com_RxAccessInfo[20].TmpBufferIdxOfRxAccessInfo "" UBYTE Com_TmpBufferIdxOfRxAccessInfoType 0 0 0 255 ECU_ADDRESS 0x0 /end MEASUREMENT
/begin MEASUREMENT Com_RxAccessInfo[20].TmpBufferOfRxAccessInfo "" UBYTE Com_TmpBufferOfRxAccessInfoType 0 0 0 255 ECU_ADDRESS 0x0 /end MEASUREMENT
/begin MEASUREMENT Com_RxAccessInfo[20].TmpRxShdBufferArrayBasedTmpBufferEndIdxOfRxAccessInfo "" UBYTE Com_TmpRxShdBufferArrayBasedTmpBufferEndIdxOfRxAccessInfoType 0 0 0 255 ECU_ADDRESS 0x0 /end MEASUREMENT
/begin MEASUREMENT Com_RxAccessInfo[20].TmpRxShdBufferArrayBasedTmpBufferStartIdxOfRxAccessInfo "" UBYTE Com_TmpRxShdBufferArrayBasedTmpBufferStartIdxOfRxAccessInfoType 0 0 0 255 ECU_ADDRESS 0x0 /end MEASUREMENT
/begin MEASUREMENT Com_RxAccessInfo[210].ApplTypeOfRxAccessInfo "" UBYTE Com_ApplTypeOfRxAccessInfoType 0 0 0 255 ECU_ADDRESS 0x0 /end MEASUREMENT
/begin MEASUREMENT Com_RxAccessInfo[210].BitLengthOfRxAccessInfo "" UWORD NO_COMPU_METHOD 0 0 0 65535 ECU_ADDRESS 0x0 /end MEASUREMENT
/begin MEASUREMENT Com_RxAccessInfo[210].BitPositionOfRxAccessInfo "" UWORD NO_COMPU_METHOD 0 0 0 65535 ECU_ADDRESS 0x0 /end MEASUREMENT
/begin MEASUREMENT Com_RxAccessInfo[210].BufferIdxOfRxAccessInfo "" UWORD Com_BufferIdxOfRxAccessInfoType 0 0 0 65535 ECU_ADDRESS 0x0 /end MEASUREMENT
/begin MEASUREMENT Com_RxAccessInfo[210].BusAccOfRxAccessInfo "" UBYTE Com_BusAccOfRxAccessInfoType 0 0 0 255 ECU_ADDRESS 0x0 /end MEASUREMENT
/begin MEASUREMENT Com_RxAccessInfo[210].ByteLengthOfRxAccessInfo "" UBYTE NO_COMPU_METHOD 0 0 0 255 ECU_ADDRESS 0x0 /end MEASUREMENT
/begin MEASUREMENT Com_RxAccessInfo[210].ConstValueArrayBasedInitValueEndIdxOfRxAccessInfo "" UBYTE Com_ConstValueArrayBasedInitValueEndIdxOfRxAccessInfoType 0 0 0 255 ECU_ADDRESS 0x0 /end MEASUREMENT
/begin MEASUREMENT Com_RxAccessInfo[210].ConstValueArrayBasedInitValueStartIdxOfRxAccessInfo "" UBYTE Com_ConstValueArrayBasedInitValueStartIdxOfRxAccessInfoType 0 0 0 255 ECU_ADDRESS 0x0 /end MEASUREMENT
/begin MEASUREMENT Com_RxAccessInfo[210].DynSignalOfRxAccessInfo "" UBYTE Com_DynSignalOfRxAccessInfoType 0 0 0 1 ECU_ADDRESS 0x0 /end MEASUREMENT
/begin MEASUREMENT Com_RxAccessInfo[210].InitValueIdxOfRxAccessInfo "" UBYTE Com_InitValueIdxOfRxAccessInfoType 0 0 0 255 ECU_ADDRESS 0x0 /end MEASUREMENT
/begin MEASUREMENT Com_RxAccessInfo[210].InitValueOfRxAccessInfo "" UBYTE Com_InitValueOfRxAccessInfoType 0 0 0 255 ECU_ADDRESS 0x0 /end MEASUREMENT
/begin MEASUREMENT Com_RxAccessInfo[210].InvValueIdxOfRxAccessInfo "" UBYTE Com_InvValueIdxOfRxAccessInfoType 0 0 0 255 ECU_ADDRESS 0x0 /end MEASUREMENT
/begin MEASUREMENT Com_RxAccessInfo[210].InvValueOfRxAccessInfo "" UBYTE Com_InvValueOfRxAccessInfoType 0 0 0 255 ECU_ADDRESS 0x0 /end MEASUREMENT
/begin MEASUREMENT Com_RxAccessInfo[210].IsGroupSignalOfRxAccessInfo "" UBYTE Com_IsGroupSignalOfRxAccessInfoType 0 0 0 1 ECU_ADDRESS 0x0 /end MEASUREMENT
/begin MEASUREMENT Com_RxAccessInfo[210].RxDataTimeoutSubstitutionValueIdxOfRxAccessInfo "" UBYTE Com_RxDataTimeoutSubstitutionValueIdxOfRxAccessInfoType 0 0 0 255 ECU_ADDRESS 0x0 /end MEASUREMENT
/begin MEASUREMENT Com_RxAccessInfo[210].RxDataTimeoutSubstitutionValueOfRxAccessInfo "" UBYTE Com_RxDataTimeoutSubstitutionValueOfRxAccessInfoType 0 0 0 255 ECU_ADDRESS 0x0 /end MEASUREMENT
/begin MEASUREMENT Com_RxAccessInfo[210].RxPduInfoIdxOfRxAccessInfo "" UBYTE NO_COMPU_METHOD 0 0 0 255 ECU_ADDRESS 0x0 /end MEASUREMENT
/begin MEASUREMENT Com_RxAccessInfo[210].RxSigBufferArrayBasedBufferEndIdxOfRxAccessInfo "" UBYTE Com_RxSigBufferArrayBasedBufferEndIdxOfRxAccessInfoType 0 0 0 255 ECU_ADDRESS 0x0 /end MEASUREMENT
/begin MEASUREMENT Com_RxAccessInfo[210].RxSigBufferArrayBasedBufferStartIdxOfRxAccessInfo "" UBYTE Com_RxSigBufferArrayBasedBufferStartIdxOfRxAccessInfoType 0 0 0 255 ECU_ADDRESS 0x0 /end MEASUREMENT
/begin MEASUREMENT Com_RxAccessInfo[210].RxSigBufferArrayBasedShdBufferEndIdxOfRxAccessInfo "" UBYTE Com_RxSigBufferArrayBasedShdBufferEndIdxOfRxAccessInfoType 0 0 0 255 ECU_ADDRESS 0x0 /end MEASUREMENT
/begin MEASUREMENT Com_RxAccessInfo[210].RxSigBufferArrayBasedShdBufferStartIdxOfRxAccessInfo "" UBYTE Com_RxSigBufferArrayBasedShdBufferStartIdxOfRxAccessInfoType 0 0 0 255 ECU_ADDRESS 0x0 /end MEASUREMENT
/begin MEASUREMENT Com_RxAccessInfo[210].RxTOutInfoIdxOfRxAccessInfo "" UBYTE Com_RxTOutInfoIdxOfRxAccessInfoType 0 0 0 255 ECU_ADDRESS 0x0 /end MEASUREMENT
/begin MEASUREMENT Com_RxAccessInfo[210].ShdBufferIdxOfRxAccessInfo "" UWORD Com_ShdBufferIdxOfRxAccessInfoType 0 0 0 65535 ECU_ADDRESS 0x0 /end MEASUREMENT
/begin MEASUREMENT Com_RxAccessInfo[210].SignalLengthInByteOfRxAccessInfo "" UBYTE NO_COMPU_METHOD 0 0 0 255 ECU_ADDRESS 0x0 /end MEASUREMENT
/begin MEASUREMENT Com_RxAccessInfo[210].StartByteInPduPositionOfRxAccessInfo "" UBYTE NO_COMPU_METHOD 0 0 0 255 ECU_ADDRESS 0x0 /end MEASUREMENT
/begin MEASUREMENT Com_RxAccessInfo[210].TmpBufferIdxOfRxAccessInfo "" UBYTE Com_TmpBufferIdxOfRxAccessInfoType 0 0 0 255 ECU_ADDRESS 0x0 /end MEASUREMENT
/begin MEASUREMENT Com_RxAccessInfo[210].TmpBufferOfRxAccessInfo "" UBYTE Com_TmpBufferOfRxAccessInfoType 0 0 0 255 ECU_ADDRESS 0x0 /end MEASUREMENT
/begin MEASUREMENT Com_RxAccessInfo[210].TmpRxShdBufferArrayBasedTmpBufferEndIdxOfRxAccessInfo "" UBYTE Com_TmpRxShdBufferArrayBasedTmpBufferEndIdxOfRxAccessInfoType 0 0 0 255 ECU_ADDRESS 0x0 /end MEASUREMENT
/begin MEASUREMENT Com_RxAccessInfo[210].TmpRxShdBufferArrayBasedTmpBufferStartIdxOfRxAccessInfo "" UBYTE Com_TmpRxShdBufferArrayBasedTmpBufferStartIdxOfRxAccessInfoType 0 0 0 255 ECU_ADDRESS 0x0 /end MEASUREMENT
/begin MEASUREMENT Com_RxAccessInfo[211].ApplTypeOfRxAccessInfo "" UBYTE Com_ApplTypeOfRxAccessInfoType 0 0 0 255 ECU_ADDRESS 0x0 /end MEASUREMENT
/begin MEASUREMENT Com_RxAccessInfo[211].BitLengthOfRxAccessInfo "" UWORD NO_COMPU_METHOD 0 0 0 65535 ECU_ADDRESS 0x0 /end MEASUREMENT
/begin MEASUREMENT Com_RxAccessInfo[211].BitPositionOfRxAccessInfo "" UWORD NO_COMPU_METHOD 0 0 0 65535 ECU_ADDRESS 0x0 /end MEASUREMENT
/begin MEASUREMENT Com_RxAccessInfo[211].BufferIdxOfRxAccessInfo "" UWORD Com_BufferIdxOfRxAccessInfoType 0 0 0 65535 ECU_ADDRESS 0x0 /end MEASUREMENT
/begin MEASUREMENT Com_RxAccessInfo[211].BusAccOfRxAccessInfo "" UBYTE Com_BusAccOfRxAccessInfoType 0 0 0 255 ECU_ADDRESS 0x0 /end MEASUREMENT
/begin MEASUREMENT Com_RxAccessInfo[211].ByteLengthOfRxAccessInfo "" UBYTE NO_COMPU_METHOD 0 0 0 255 ECU_ADDRESS 0x0 /end MEASUREMENT
/begin MEASUREMENT Com_RxAccessInfo[211].ConstValueArrayBasedInitValueEndIdxOfRxAccessInfo "" UBYTE Com_ConstValueArrayBasedInitValueEndIdxOfRxAccessInfoType 0 0 0 255 ECU_ADDRESS 0x0 /end MEASUREMENT
/begin MEASUREMENT Com_RxAccessInfo[211].ConstValueArrayBasedInitValueStartIdxOfRxAccessInfo "" UBYTE Com_ConstValueArrayBasedInitValueStartIdxOfRxAccessInfoType 0 0 0 255 ECU_ADDRESS 0x0 /end MEASUREMENT
/begin MEASUREMENT Com_RxAccessInfo[211].DynSignalOfRxAccessInfo "" UBYTE Com_DynSignalOfRxAccessInfoType 0 0 0 1 ECU_ADDRESS 0x0 /end MEASUREMENT
/begin MEASUREMENT Com_RxAccessInfo[211].InitValueIdxOfRxAccessInfo "" UBYTE Com_InitValueIdxOfRxAccessInfoType 0 0 0 255 ECU_ADDRESS 0x0 /end MEASUREMENT
/begin MEASUREMENT Com_RxAccessInfo[211].InitValueOfRxAccessInfo "" UBYTE Com_InitValueOfRxAccessInfoType 0 0 0 255 ECU_ADDRESS 0x0 /end MEASUREMENT
/begin MEASUREMENT Com_RxAccessInfo[211].InvValueIdxOfRxAccessInfo "" UBYTE Com_InvValueIdxOfRxAccessInfoType 0 0 0 255 ECU_ADDRESS 0x0 /end MEASUREMENT
/begin MEASUREMENT Com_RxAccessInfo[211].InvValueOfRxAccessInfo "" UBYTE Com_InvValueOfRxAccessInfoType 0 0 0 255 ECU_ADDRESS 0x0 /end MEASUREMENT
/begin MEASUREMENT Com_RxAccessInfo[211].IsGroupSignalOfRxAccessInfo "" UBYTE Com_IsGroupSignalOfRxAccessInfoType 0 0 0 1 ECU_ADDRESS 0x0 /end MEASUREMENT
/begin MEASUREMENT Com_RxAccessInfo[211].RxDataTimeoutSubstitutionValueIdxOfRxAccessInfo "" UBYTE Com_RxDataTimeoutSubstitutionValueIdxOfRxAccessInfoType 0 0 0 255 ECU_ADDRESS 0x0 /end MEASUREMENT
/begin MEASUREMENT Com_RxAccessInfo[211].RxDataTimeoutSubstitutionValueOfRxAccessInfo "" UBYTE Com_RxDataTimeoutSubstitutionValueOfRxAccessInfoType 0 0 0 255 ECU_ADDRESS 0x0 /end MEASUREMENT
/begin MEASUREMENT Com_RxAccessInfo[211].RxPduInfoIdxOfRxAccessInfo "" UBYTE NO_COMPU_METHOD 0 0 0 255 ECU_ADDRESS 0x0 /end MEASUREMENT
/begin MEASUREMENT Com_RxAccessInfo[211].RxSigBufferArrayBasedBufferEndIdxOfRxAccessInfo "" UBYTE Com_RxSigBufferArrayBasedBufferEndIdxOfRxAccessInfoType 0 0 0 255 ECU_ADDRESS 0x0 /end MEASUREMENT
/begin MEASUREMENT Com_RxAccessInfo[211].RxSigBufferArrayBasedBufferStartIdxOfRxAccessInfo "" UBYTE Com_RxSigBufferArrayBasedBufferStartIdxOfRxAccessInfoType 0 0 0 255 ECU_ADDRESS 0x0 /end MEASUREMENT
/begin MEASUREMENT Com_RxAccessInfo[211].RxSigBufferArrayBasedShdBufferEndIdxOfRxAccessInfo "" UBYTE Com_RxSigBufferArrayBasedShdBufferEndIdxOfRxAccessInfoType 0 0 0 255 ECU_ADDRESS 0x0 /end MEASUREMENT
/begin MEASUREMENT Com_RxAccessInfo[211].RxSigBufferArrayBasedShdBufferStartIdxOfRxAccessInfo "" UBYTE Com_RxSigBufferArrayBasedShdBufferStartIdxOfRxAccessInfoType 0 0 0 255 ECU_ADDRESS 0x0 /end MEASUREMENT
/begin MEASUREMENT Com_RxAccessInfo[211].RxTOutInfoIdxOfRxAccessInfo "" UBYTE Com_RxTOutInfoIdxOfRxAccessInfoType 0 0 0 255 ECU_ADDRESS 0x0 /end MEASUREMENT
/begin MEASUREMENT Com_RxAccessInfo[211].ShdBufferIdxOfRxAccessInfo "" UWORD Com_ShdBufferIdxOfRxAccessInfoType 0 0 0 65535 ECU_ADDRESS 0x0 /end MEASUREMENT
/begin MEASUREMENT Com_RxAccessInfo[211].SignalLengthInByteOfRxAccessInfo "" UBYTE NO_COMPU_METHOD 0 0 0 255 ECU_ADDRESS 0x0 /end MEASUREMENT
/begin MEASUREMENT Com_RxAccessInfo[211].StartByteInPduPositionOfRxAccessInfo "" UBYTE NO_COMPU_METHOD 0 0 0 255 ECU_ADDRESS 0x0 /end MEASUREMENT
/begin MEASUREMENT Com_RxAccessInfo[211].TmpBufferIdxOfRxAccessInfo "" UBYTE Com_TmpBufferIdxOfRxAccessInfoType 0 0 0 255 ECU_ADDRESS 0x0 /end MEASUREMENT
/begin MEASUREMENT Com_RxAccessInfo[211].TmpBufferOfRxAccessInfo "" UBYTE Com_TmpBufferOfRxAccessInfoType 0 0 0 255 ECU_ADDRESS 0x0 /end MEASUREMENT
/begin MEASUREMENT Com_RxAccessInfo[211].TmpRxShdBufferArrayBasedTmpBufferEndIdxOfRxAccessInfo "" UBYTE Com_TmpRxShdBufferArrayBasedTmpBufferEndIdxOfRxAccessInfoType 0 0 0 255 ECU_ADDRESS 0x0 /end MEASUREMENT
/begin MEASUREMENT Com_RxAccessInfo[211].TmpRxShdBufferArrayBasedTmpBufferStartIdxOfRxAccessInfo "" UBYTE Com_TmpRxShdBufferArrayBasedTmpBufferStartIdxOfRxAccessInfoType 0 0 0 255 ECU_ADDRESS 0x0 /end MEASUREMENT
/begin MEASUREMENT Com_RxAccessInfo[212].ApplTypeOfRxAccessInfo "" UBYTE Com_ApplTypeOfRxAccessInfoType 0 0 0 255 ECU_ADDRESS 0x0 /end MEASUREMENT
/begin MEASUREMENT Com_RxAccessInfo[212].BitLengthOfRxAccessInfo "" UWORD NO_COMPU_METHOD 0 0 0 65535 ECU_ADDRESS 0x0 /end MEASUREMENT
/begin MEASUREMENT Com_RxAccessInfo[212].BitPositionOfRxAccessInfo "" UWORD NO_COMPU_METHOD 0 0 0 65535 ECU_ADDRESS 0x0 /end MEASUREMENT
/begin MEASUREMENT Com_RxAccessInfo[212].BufferIdxOfRxAccessInfo "" UWORD Com_BufferIdxOfRxAccessInfoType 0 0 0 65535 ECU_ADDRESS 0x0 /end MEASUREMENT
/begin MEASUREMENT Com_RxAccessInfo[212].BusAccOfRxAccessInfo "" UBYTE Com_BusAccOfRxAccessInfoType 0 0 0 255 ECU_ADDRESS 0x0 /end MEASUREMENT
/begin MEASUREMENT Com_RxAccessInfo[212].ByteLengthOfRxAccessInfo "" UBYTE NO_COMPU_METHOD 0 0 0 255 ECU_ADDRESS 0x0 /end MEASUREMENT
/begin MEASUREMENT Com_RxAccessInfo[212].ConstValueArrayBasedInitValueEndIdxOfRxAccessInfo "" UBYTE Com_ConstValueArrayBasedInitValueEndIdxOfRxAccessInfoType 0 0 0 255 ECU_ADDRESS 0x0 /end MEASUREMENT
/begin MEASUREMENT Com_RxAccessInfo[212].ConstValueArrayBasedInitValueStartIdxOfRxAccessInfo "" UBYTE Com_ConstValueArrayBasedInitValueStartIdxOfRxAccessInfoType 0 0 0 255 ECU_ADDRESS 0x0 /end MEASUREMENT
/begin MEASUREMENT Com_RxAccessInfo[212].DynSignalOfRxAccessInfo "" UBYTE Com_DynSignalOfRxAccessInfoType 0 0 0 1 ECU_ADDRESS 0x0 /end MEASUREMENT
/begin MEASUREMENT Com_RxAccessInfo[212].InitValueIdxOfRxAccessInfo "" UBYTE Com_InitValueIdxOfRxAccessInfoType 0 0 0 255 ECU_ADDRESS 0x0 /end MEASUREMENT
/begin MEASUREMENT Com_RxAccessInfo[212].InitValueOfRxAccessInfo "" UBYTE Com_InitValueOfRxAccessInfoType 0 0 0 255 ECU_ADDRESS 0x0 /end MEASUREMENT
/begin MEASUREMENT Com_RxAccessInfo[212].InvValueIdxOfRxAccessInfo "" UBYTE Com_InvValueIdxOfRxAccessInfoType 0 0 0 255 ECU_ADDRESS 0x0 /end MEASUREMENT
/begin MEASUREMENT Com_RxAccessInfo[212].InvValueOfRxAccessInfo "" UBYTE Com_InvValueOfRxAccessInfoType 0 0 0 255 ECU_ADDRESS 0x0 /end MEASUREMENT
/begin MEASUREMENT Com_RxAccessInfo[212].IsGroupSignalOfRxAccessInfo "" UBYTE Com_IsGroupSignalOfRxAccessInfoType 0 0 0 1 ECU_ADDRESS 0x0 /end MEASUREMENT
/begin MEASUREMENT Com_RxAccessInfo[212].RxDataTimeoutSubstitutionValueIdxOfRxAccessInfo "" UBYTE Com_RxDataTimeoutSubstitutionValueIdxOfRxAccessInfoType 0 0 0 255 ECU_ADDRESS 0x0 /end MEASUREMENT
/begin MEASUREMENT Com_RxAccessInfo[212].RxDataTimeoutSubstitutionValueOfRxAccessInfo "" UBYTE Com_RxDataTimeoutSubstitutionValueOfRxAccessInfoType 0 0 0 255 ECU_ADDRESS 0x0 /end MEASUREMENT
/begin MEASUREMENT Com_RxAccessInfo[212].RxPduInfoIdxOfRxAccessInfo "" UBYTE NO_COMPU_METHOD 0 0 0 255 ECU_ADDRESS 0x0 /end MEASUREMENT
/begin MEASUREMENT Com_RxAccessInfo[212].RxSigBufferArrayBasedBufferEndIdxOfRxAccessInfo "" UBYTE Com_RxSigBufferArrayBasedBufferEndIdxOfRxAccessInfoType 0 0 0 255 ECU_ADDRESS 0x0 /end MEASUREMENT
/begin MEASUREMENT Com_RxAccessInfo[212].RxSigBufferArrayBasedBufferStartIdxOfRxAccessInfo "" UBYTE Com_RxSigBufferArrayBasedBufferStartIdxOfRxAccessInfoType 0 0 0 255 ECU_ADDRESS 0x0 /end MEASUREMENT
/begin MEASUREMENT Com_RxAccessInfo[212].RxSigBufferArrayBasedShdBufferEndIdxOfRxAccessInfo "" UBYTE Com_RxSigBufferArrayBasedShdBufferEndIdxOfRxAccessInfoType 0 0 0 255 ECU_ADDRESS 0x0 /end MEASUREMENT
/begin MEASUREMENT Com_RxAccessInfo[212].RxSigBufferArrayBasedShdBufferStartIdxOfRxAccessInfo "" UBYTE Com_RxSigBufferArrayBasedShdBufferStartIdxOfRxAccessInfoType 0 0 0 255 ECU_ADDRESS 0x0 /end MEASUREMENT
/begin MEASUREMENT Com_RxAccessInfo[212].RxTOutInfoIdxOfRxAccessInfo "" UBYTE Com_RxTOutInfoIdxOfRxAccessInfoType 0 0 0 255 ECU_ADDRESS 0x0 /end MEASUREMENT
/begin MEASUREMENT Com_RxAccessInfo[212].ShdBufferIdxOfRxAccessInfo "" UWORD Com_ShdBufferIdxOfRxAccessInfoType 0 0 0 65535 ECU_ADDRESS 0x0 /end MEASUREMENT
/begin MEASUREMENT Com_RxAccessInfo[212].SignalLengthInByteOfRxAccessInfo "" UBYTE NO_COMPU_METHOD 0 0 0 255 ECU_ADDRESS 0x0 /end MEASUREMENT
/begin MEASUREMENT Com_RxAccessInfo[212].StartByteInPduPositionOfRxAccessInfo "" UBYTE NO_COMPU_METHOD 0 0 0 255 ECU_ADDRESS 0x0 /end MEASUREMENT
/begin MEASUREMENT Com_RxAccessInfo[212].TmpBufferIdxOfRxAccessInfo "" UBYTE Com_TmpBufferIdxOfRxAccessInfoType 0 0 0 255 ECU_ADDRESS 0x0 /end MEASUREMENT
/begin MEASUREMENT Com_RxAccessInfo[212].TmpBufferOfRxAccessInfo "" UBYTE Com_TmpBufferOfRxAccessInfoType 0 0 0 255 ECU_ADDRESS 0x0 /end MEASUREMENT
/begin MEASUREMENT Com_RxAccessInfo[212].TmpRxShdBufferArrayBasedTmpBufferEndIdxOfRxAccessInfo "" UBYTE Com_TmpRxShdBufferArrayBasedTmpBufferEndIdxOfRxAccessInfoType 0 0 0 255 ECU_ADDRESS 0x0 /end MEASUREMENT
/begin MEASUREMENT Com_RxAccessInfo[212].TmpRxShdBufferArrayBasedTmpBufferStartIdxOfRxAccessInfo "" UBYTE Com_TmpRxShdBufferArrayBasedTmpBufferStartIdxOfRxAccessInfoType 0 0 0 255 ECU_ADDRESS 0x0 /end MEASUREMENT
/begin MEASUREMENT Com_RxAccessInfo[213].ApplTypeOfRxAccessInfo "" UBYTE Com_ApplTypeOfRxAccessInfoType 0 0 0 255 ECU_ADDRESS 0x0 /end MEASUREMENT
/begin MEASUREMENT Com_RxAccessInfo[213].BitLengthOfRxAccessInfo "" UWORD NO_COMPU_METHOD 0 0 0 65535 ECU_ADDRESS 0x0 /end MEASUREMENT
/begin MEASUREMENT Com_RxAccessInfo[213].BitPositionOfRxAccessInfo "" UWORD NO_COMPU_METHOD 0 0 0 65535 ECU_ADDRESS 0x0 /end MEASUREMENT
/begin MEASUREMENT Com_RxAccessInfo[213].BufferIdxOfRxAccessInfo "" UWORD Com_BufferIdxOfRxAccessInfoType 0 0 0 65535 ECU_ADDRESS 0x0 /end MEASUREMENT
/begin MEASUREMENT Com_RxAccessInfo[213].BusAccOfRxAccessInfo "" UBYTE Com_BusAccOfRxAccessInfoType 0 0 0 255 ECU_ADDRESS 0x0 /end MEASUREMENT
/begin MEASUREMENT Com_RxAccessInfo[213].ByteLengthOfRxAccessInfo "" UBYTE NO_COMPU_METHOD 0 0 0 255 ECU_ADDRESS 0x0 /end MEASUREMENT
/begin MEASUREMENT Com_RxAccessInfo[213].ConstValueArrayBasedInitValueEndIdxOfRxAccessInfo "" UBYTE Com_ConstValueArrayBasedInitValueEndIdxOfRxAccessInfoType 0 0 0 255 ECU_ADDRESS 0x0 /end MEASUREMENT
/begin MEASUREMENT Com_RxAccessInfo[213].ConstValueArrayBasedInitValueStartIdxOfRxAccessInfo "" UBYTE Com_ConstValueArrayBasedInitValueStartIdxOfRxAccessInfoType 0 0 0 255 ECU_ADDRESS 0x0 /end MEASUREMENT
/begin MEASUREMENT Com_RxAccessInfo[213].DynSignalOfRxAccessInfo "" UBYTE Com_DynSignalOfRxAccessInfoType 0 0 0 1 ECU_ADDRESS 0x0 /end MEASUREMENT
/begin MEASUREMENT Com_RxAccessInfo[213].InitValueIdxOfRxAccessInfo "" UBYTE Com_InitValueIdxOfRxAccessInfoType 0 0 0 255 ECU_ADDRESS 0x0 /end MEASUREMENT
/begin MEASUREMENT Com_RxAccessInfo[213].InitValueOfRxAccessInfo "" UBYTE Com_InitValueOfRxAccessInfoType 0 0 0 255 ECU_ADDRESS 0x0 /end MEASUREMENT
/begin MEASUREMENT Com_RxAccessInfo[213].InvValueIdxOfRxAccessInfo "" UBYTE Com_InvValueIdxOfRxAccessInfoType 0 0 0 255 ECU_ADDRESS 0x0 /end MEASUREMENT
/begin MEASUREMENT Com_RxAccessInfo[213].InvValueOfRxAccessInfo "" UBYTE Com_InvValueOfRxAccessInfoType 0 0 0 255 ECU_ADDRESS 0x0 /end MEASUREMENT
/begin MEASUREMENT Com_RxAccessInfo[213].IsGroupSignalOfRxAccessInfo "" UBYTE Com_IsGroupSignalOfRxAccessInfoType 0 0 0 1 ECU_ADDRESS 0x0 /end MEASUREMENT
/begin MEASUREMENT Com_RxAccessInfo[213].RxDataTimeoutSubstitutionValueIdxOfRxAccessInfo "" UBYTE Com_RxDataTimeoutSubstitutionValueIdxOfRxAccessInfoType 0 0 0 255 ECU_ADDRESS 0x0 /end MEASUREMENT
/begin MEASUREMENT Com_RxAccessInfo[213].RxDataTimeoutSubstitutionValueOfRxAccessInfo "" UBYTE Com_RxDataTimeoutSubstitutionValueOfRxAccessInfoType 0 0 0 255 ECU_ADDRESS 0x0 /end MEASUREMENT
/begin MEASUREMENT Com_RxAccessInfo[213].RxPduInfoIdxOfRxAccessInfo "" UBYTE NO_COMPU_METHOD 0 0 0 255 ECU_ADDRESS 0x0 /end MEASUREMENT
/begin MEASUREMENT Com_RxAccessInfo[213].RxSigBufferArrayBasedBufferEndIdxOfRxAccessInfo "" UBYTE Com_RxSigBufferArrayBasedBufferEndIdxOfRxAccessInfoType 0 0 0 255 ECU_ADDRESS 0x0 /end MEASUREMENT
/begin MEASUREMENT Com_RxAccessInfo[213].RxSigBufferArrayBasedBufferStartIdxOfRxAccessInfo "" UBYTE Com_RxSigBufferArrayBasedBufferStartIdxOfRxAccessInfoType 0 0 0 255 ECU_ADDRESS 0x0 /end MEASUREMENT
/begin MEASUREMENT Com_RxAccessInfo[213].RxSigBufferArrayBasedShdBufferEndIdxOfRxAccessInfo "" UBYTE Com_RxSigBufferArrayBasedShdBufferEndIdxOfRxAccessInfoType 0 0 0 255 ECU_ADDRESS 0x0 /end MEASUREMENT
/begin MEASUREMENT Com_RxAccessInfo[213].RxSigBufferArrayBasedShdBufferStartIdxOfRxAccessInfo "" UBYTE Com_RxSigBufferArrayBasedShdBufferStartIdxOfRxAccessInfoType 0 0 0 255 ECU_ADDRESS 0x0 /end MEASUREMENT
/begin MEASUREMENT Com_RxAccessInfo[213].RxTOutInfoIdxOfRxAccessInfo "" UBYTE Com_RxTOutInfoIdxOfRxAccessInfoType 0 0 0 255 ECU_ADDRESS 0x0 /end MEASUREMENT
/begin MEASUREMENT Com_RxAccessInfo[213].ShdBufferIdxOfRxAccessInfo "" UWORD Com_ShdBufferIdxOfRxAccessInfoType 0 0 0 65535 ECU_ADDRESS 0x0 /end MEASUREMENT
/begin MEASUREMENT Com_RxAccessInfo[213].SignalLengthInByteOfRxAccessInfo "" UBYTE NO_COMPU_METHOD 0 0 0 255 ECU_ADDRESS 0x0 /end MEASUREMENT
/begin MEASUREMENT Com_RxAccessInfo[213].StartByteInPduPositionOfRxAccessInfo "" UBYTE NO_COMPU_METHOD 0 0 0 255 ECU_ADDRESS 0x0 /end MEASUREMENT
/begin MEASUREMENT Com_RxAccessInfo[213].TmpBufferIdxOfRxAccessInfo "" UBYTE Com_TmpBufferIdxOfRxAccessInfoType 0 0 0 255 ECU_ADDRESS 0x0 /end MEASUREMENT
/begin MEASUREMENT Com_RxAccessInfo[213].TmpBufferOfRxAccessInfo "" UBYTE Com_TmpBufferOfRxAccessInfoType 0 0 0 255 ECU_ADDRESS 0x0 /end MEASUREMENT
/begin MEASUREMENT Com_RxAccessInfo[213].TmpRxShdBufferArrayBasedTmpBufferEndIdxOfRxAccessInfo "" UBYTE Com_TmpRxShdBufferArrayBasedTmpBufferEndIdxOfRxAccessInfoType 0 0 0 255 ECU_ADDRESS 0x0 /end MEASUREMENT
/begin MEASUREMENT Com_RxAccessInfo[213].TmpRxShdBufferArrayBasedTmpBufferStartIdxOfRxAccessInfo "" UBYTE Com_TmpRxShdBufferArrayBasedTmpBufferStartIdxOfRxAccessInfoType 0 0 0 255 ECU_ADDRESS 0x0 /end MEASUREMENT
/begin MEASUREMENT Com_RxAccessInfo[214].ApplTypeOfRxAccessInfo "" UBYTE Com_ApplTypeOfRxAccessInfoType 0 0 0 255 ECU_ADDRESS 0x0 /end MEASUREMENT
/begin MEASUREMENT Com_RxAccessInfo[214].BitLengthOfRxAccessInfo "" UWORD NO_COMPU_METHOD 0 0 0 65535 ECU_ADDRESS 0x0 /end MEASUREMENT
/begin MEASUREMENT Com_RxAccessInfo[214].BitPositionOfRxAccessInfo "" UWORD NO_COMPU_METHOD 0 0 0 65535 ECU_ADDRESS 0x0 /end MEASUREMENT
/begin MEASUREMENT Com_RxAccessInfo[214].BufferIdxOfRxAccessInfo "" UWORD Com_BufferIdxOfRxAccessInfoType 0 0 0 65535 ECU_ADDRESS 0x0 /end MEASUREMENT
/begin MEASUREMENT Com_RxAccessInfo[214].BusAccOfRxAccessInfo "" UBYTE Com_BusAccOfRxAccessInfoType 0 0 0 255 ECU_ADDRESS 0x0 /end MEASUREMENT
/begin MEASUREMENT Com_RxAccessInfo[214].ByteLengthOfRxAccessInfo "" UBYTE NO_COMPU_METHOD 0 0 0 255 ECU_ADDRESS 0x0 /end MEASUREMENT
/begin MEASUREMENT Com_RxAccessInfo[214].ConstValueArrayBasedInitValueEndIdxOfRxAccessInfo "" UBYTE Com_ConstValueArrayBasedInitValueEndIdxOfRxAccessInfoType 0 0 0 255 ECU_ADDRESS 0x0 /end MEASUREMENT
/begin MEASUREMENT Com_RxAccessInfo[214].ConstValueArrayBasedInitValueStartIdxOfRxAccessInfo "" UBYTE Com_ConstValueArrayBasedInitValueStartIdxOfRxAccessInfoType 0 0 0 255 ECU_ADDRESS 0x0 /end MEASUREMENT
/begin MEASUREMENT Com_RxAccessInfo[214].DynSignalOfRxAccessInfo "" UBYTE Com_DynSignalOfRxAccessInfoType 0 0 0 1 ECU_ADDRESS 0x0 /end MEASUREMENT
/begin MEASUREMENT Com_RxAccessInfo[214].InitValueIdxOfRxAccessInfo "" UBYTE Com_InitValueIdxOfRxAccessInfoType 0 0 0 255 ECU_ADDRESS 0x0 /end MEASUREMENT
/begin MEASUREMENT Com_RxAccessInfo[214].InitValueOfRxAccessInfo "" UBYTE Com_InitValueOfRxAccessInfoType 0 0 0 255 ECU_ADDRESS 0x0 /end MEASUREMENT
/begin MEASUREMENT Com_RxAccessInfo[214].InvValueIdxOfRxAccessInfo "" UBYTE Com_InvValueIdxOfRxAccessInfoType 0 0 0 255 ECU_ADDRESS 0x0 /end MEASUREMENT
/begin MEASUREMENT Com_RxAccessInfo[214].InvValueOfRxAccessInfo "" UBYTE Com_InvValueOfRxAccessInfoType 0 0 0 255 ECU_ADDRESS 0x0 /end MEASUREMENT
/begin MEASUREMENT Com_RxAccessInfo[214].IsGroupSignalOfRxAccessInfo "" UBYTE Com_IsGroupSignalOfRxAccessInfoType 0 0 0 1 ECU_ADDRESS 0x0 /end MEASUREMENT
/begin MEASUREMENT Com_RxAccessInfo[214].RxDataTimeoutSubstitutionValueIdxOfRxAccessInfo "" UBYTE Com_RxDataTimeoutSubstitutionValueIdxOfRxAccessInfoType 0 0 0 255 ECU_ADDRESS 0x0 /end MEASUREMENT
/begin MEASUREMENT Com_RxAccessInfo[214].RxDataTimeoutSubstitutionValueOfRxAccessInfo "" UBYTE Com_RxDataTimeoutSubstitutionValueOfRxAccessInfoType 0 0 0 255 ECU_ADDRESS 0x0 /end MEASUREMENT
/begin MEASUREMENT Com_RxAccessInfo[214].RxPduInfoIdxOfRxAccessInfo "" UBYTE NO_COMPU_METHOD 0 0 0 255 ECU_ADDRESS 0x0 /end MEASUREMENT
/begin MEASUREMENT Com_RxAccessInfo[214].RxSigBufferArrayBasedBufferEndIdxOfRxAccessInfo "" UBYTE Com_RxSigBufferArrayBasedBufferEndIdxOfRxAccessInfoType 0 0 0 255 ECU_ADDRESS 0x0 /end MEASUREMENT
/begin MEASUREMENT Com_RxAccessInfo[214].RxSigBufferArrayBasedBufferStartIdxOfRxAccessInfo "" UBYTE Com_RxSigBufferArrayBasedBufferStartIdxOfRxAccessInfoType 0 0 0 255 ECU_ADDRESS 0x0 /end MEASUREMENT
/begin MEASUREMENT Com_RxAccessInfo[214].RxSigBufferArrayBasedShdBufferEndIdxOfRxAccessInfo "" UBYTE Com_RxSigBufferArrayBasedShdBufferEndIdxOfRxAccessInfoType 0 0 0 255 ECU_ADDRESS 0x0 /end MEASUREMENT
/begin MEASUREMENT Com_RxAccessInfo[214].RxSigBufferArrayBasedShdBufferStartIdxOfRxAccessInfo "" UBYTE Com_RxSigBufferArrayBasedShdBufferStartIdxOfRxAccessInfoType 0 0 0 255 ECU_ADDRESS 0x0 /end MEASUREMENT
/begin MEASUREMENT Com_RxAccessInfo[214].RxTOutInfoIdxOfRxAccessInfo "" UBYTE Com_RxTOutInfoIdxOfRxAccessInfoType 0 0 0 255 ECU_ADDRESS 0x0 /end MEASUREMENT
/begin MEASUREMENT Com_RxAccessInfo[214].ShdBufferIdxOfRxAccessInfo "" UWORD Com_ShdBufferIdxOfRxAccessInfoType 0 0 0 65535 ECU_ADDRESS 0x0 /end MEASUREMENT
/begin MEASUREMENT Com_RxAccessInfo[214].SignalLengthInByteOfRxAccessInfo "" UBYTE NO_COMPU_METHOD 0 0 0 255 ECU_ADDRESS 0x0 /end MEASUREMENT
/begin MEASUREMENT Com_RxAccessInfo[214].StartByteInPduPositionOfRxAccessInfo "" UBYTE NO_COMPU_METHOD 0 0 0 255 ECU_ADDRESS 0x0 /end MEASUREMENT
/begin MEASUREMENT Com_RxAccessInfo[214].TmpBufferIdxOfRxAccessInfo "" UBYTE Com_TmpBufferIdxOfRxAccessInfoType 0 0 0 255 ECU_ADDRESS 0x0 /end MEASUREMENT
/begin MEASUREMENT Com_RxAccessInfo[214].TmpBufferOfRxAccessInfo "" UBYTE Com_TmpBufferOfRxAccessInfoType 0 0 0 255 ECU_ADDRESS 0x0 /end MEASUREMENT
/begin MEASUREMENT Com_RxAccessInfo[214].TmpRxShdBufferArrayBasedTmpBufferEndIdxOfRxAccessInfo "" UBYTE Com_TmpRxShdBufferArrayBasedTmpBufferEndIdxOfRxAccessInfoType 0 0 0 255 ECU_ADDRESS 0x0 /end MEASUREMENT
/begin MEASUREMENT Com_RxAccessInfo[214].TmpRxShdBufferArrayBasedTmpBufferStartIdxOfRxAccessInfo "" UBYTE Com_TmpRxShdBufferArrayBasedTmpBufferStartIdxOfRxAccessInfoType 0 0 0 255 ECU_ADDRESS 0x0 /end MEASUREMENT
/begin MEASUREMENT Com_RxAccessInfo[215].ApplTypeOfRxAccessInfo "" UBYTE Com_ApplTypeOfRxAccessInfoType 0 0 0 255 ECU_ADDRESS 0x0 /end MEASUREMENT
/begin MEASUREMENT Com_RxAccessInfo[215].BitLengthOfRxAccessInfo "" UWORD NO_COMPU_METHOD 0 0 0 65535 ECU_ADDRESS 0x0 /end MEASUREMENT
/begin MEASUREMENT Com_RxAccessInfo[215].BitPositionOfRxAccessInfo "" UWORD NO_COMPU_METHOD 0 0 0 65535 ECU_ADDRESS 0x0 /end MEASUREMENT
/begin MEASUREMENT Com_RxAccessInfo[215].BufferIdxOfRxAccessInfo "" UWORD Com_BufferIdxOfRxAccessInfoType 0 0 0 65535 ECU_ADDRESS 0x0 /end MEASUREMENT
/begin MEASUREMENT Com_RxAccessInfo[215].BusAccOfRxAccessInfo "" UBYTE Com_BusAccOfRxAccessInfoType 0 0 0 255 ECU_ADDRESS 0x0 /end MEASUREMENT
/begin MEASUREMENT Com_RxAccessInfo[215].ByteLengthOfRxAccessInfo "" UBYTE NO_COMPU_METHOD 0 0 0 255 ECU_ADDRESS 0x0 /end MEASUREMENT
/begin MEASUREMENT Com_RxAccessInfo[215].ConstValueArrayBasedInitValueEndIdxOfRxAccessInfo "" UBYTE Com_ConstValueArrayBasedInitValueEndIdxOfRxAccessInfoType 0 0 0 255 ECU_ADDRESS 0x0 /end MEASUREMENT
/begin MEASUREMENT Com_RxAccessInfo[215].ConstValueArrayBasedInitValueStartIdxOfRxAccessInfo "" UBYTE Com_ConstValueArrayBasedInitValueStartIdxOfRxAccessInfoType 0 0 0 255 ECU_ADDRESS 0x0 /end MEASUREMENT
/begin MEASUREMENT Com_RxAccessInfo[215].DynSignalOfRxAccessInfo "" UBYTE Com_DynSignalOfRxAccessInfoType 0 0 0 1 ECU_ADDRESS 0x0 /end MEASUREMENT
/begin MEASUREMENT Com_RxAccessInfo[215].InitValueIdxOfRxAccessInfo "" UBYTE Com_InitValueIdxOfRxAccessInfoType 0 0 0 255 ECU_ADDRESS 0x0 /end MEASUREMENT
/begin MEASUREMENT Com_RxAccessInfo[215].InitValueOfRxAccessInfo "" UBYTE Com_InitValueOfRxAccessInfoType 0 0 0 255 ECU_ADDRESS 0x0 /end MEASUREMENT
/begin MEASUREMENT Com_RxAccessInfo[215].InvValueIdxOfRxAccessInfo "" UBYTE Com_InvValueIdxOfRxAccessInfoType 0 0 0 255 ECU_ADDRESS 0x0 /end MEASUREMENT
/begin MEASUREMENT Com_RxAccessInfo[215].InvValueOfRxAccessInfo "" UBYTE Com_InvValueOfRxAccessInfoType 0 0 0 255 ECU_ADDRESS 0x0 /end MEASUREMENT
/begin MEASUREMENT Com_RxAccessInfo[215].IsGroupSignalOfRxAccessInfo "" UBYTE Com_IsGroupSignalOfRxAccessInfoType 0 0 0 1 ECU_ADDRESS 0x0 /end MEASUREMENT
/begin MEASUREMENT Com_RxAccessInfo[215].RxDataTimeoutSubstitutionValueIdxOfRxAccessInfo "" UBYTE Com_RxDataTimeoutSubstitutionValueIdxOfRxAccessInfoType 0 0 0 255 ECU_ADDRESS 0x0 /end MEASUREMENT
/begin MEASUREMENT Com_RxAccessInfo[215].RxDataTimeoutSubstitutionValueOfRxAccessInfo "" UBYTE Com_RxDataTimeoutSubstitutionValueOfRxAccessInfoType 0 0 0 255 ECU_ADDRESS 0x0 /end MEASUREMENT
/begin MEASUREMENT Com_RxAccessInfo[215].RxPduInfoIdxOfRxAccessInfo "" UBYTE NO_COMPU_METHOD 0 0 0 255 ECU_ADDRESS 0x0 /end MEASUREMENT
/begin MEASUREMENT Com_RxAccessInfo[215].RxSigBufferArrayBasedBufferEndIdxOfRxAccessInfo "" UBYTE Com_RxSigBufferArrayBasedBufferEndIdxOfRxAccessInfoType 0 0 0 255 ECU_ADDRESS 0x0 /end MEASUREMENT
/begin MEASUREMENT Com_RxAccessInfo[215].RxSigBufferArrayBasedBufferStartIdxOfRxAccessInfo "" UBYTE Com_RxSigBufferArrayBasedBufferStartIdxOfRxAccessInfoType 0 0 0 255 ECU_ADDRESS 0x0 /end MEASUREMENT
/begin MEASUREMENT Com_RxAccessInfo[215].RxSigBufferArrayBasedShdBufferEndIdxOfRxAccessInfo "" UBYTE Com_RxSigBufferArrayBasedShdBufferEndIdxOfRxAccessInfoType 0 0 0 255 ECU_ADDRESS 0x0 /end MEASUREMENT
/begin MEASUREMENT Com_RxAccessInfo[215].RxSigBufferArrayBasedShdBufferStartIdxOfRxAccessInfo "" UBYTE Com_RxSigBufferArrayBasedShdBufferStartIdxOfRxAccessInfoType 0 0 0 255 ECU_ADDRESS 0x0 /end MEASUREMENT
/begin MEASUREMENT Com_RxAccessInfo[215].RxTOutInfoIdxOfRxAccessInfo "" UBYTE Com_RxTOutInfoIdxOfRxAccessInfoType 0 0 0 255 ECU_ADDRESS 0x0 /end MEASUREMENT
/begin MEASUREMENT Com_RxAccessInfo[215].ShdBufferIdxOfRxAccessInfo "" UWORD Com_ShdBufferIdxOfRxAccessInfoType 0 0 0 65535 ECU_ADDRESS 0x0 /end MEASUREMENT
/begin MEASUREMENT Com_RxAccessInfo[215].SignalLengthInByteOfRxAccessInfo "" UBYTE NO_COMPU_METHOD 0 0 0 255 ECU_ADDRESS 0x0 /end MEASUREMENT
/begin MEASUREMENT Com_RxAccessInfo[215].StartByteInPduPositionOfRxAccessInfo "" UBYTE NO_COMPU_METHOD 0 0 0 255 ECU_ADDRESS 0x0 /end MEASUREMENT
/begin MEASUREMENT Com_RxAccessInfo[215].TmpBufferIdxOfRxAccessInfo "" UBYTE Com_TmpBufferIdxOfRxAccessInfoType 0 0 0 255 ECU_ADDRESS 0x0 /end MEASUREMENT
/begin MEASUREMENT Com_RxAccessInfo[215].TmpBufferOfRxAccessInfo "" UBYTE Com_TmpBufferOfRxAccessInfoType 0 0 0 255 ECU_ADDRESS 0x0 /end MEASUREMENT
/begin MEASUREMENT Com_RxAccessInfo[215].TmpRxShdBufferArrayBasedTmpBufferEndIdxOfRxAccessInfo "" UBYTE Com_TmpRxShdBufferArrayBasedTmpBufferEndIdxOfRxAccessInfoType 0 0 0 255 ECU_ADDRESS 0x0 /end MEASUREMENT
/begin MEASUREMENT Com_RxAccessInfo[215].TmpRxShdBufferArrayBasedTmpBufferStartIdxOfRxAccessInfo "" UBYTE Com_TmpRxShdBufferArrayBasedTmpBufferStartIdxOfRxAccessInfoType 0 0 0 255 ECU_ADDRESS 0x0 /end MEASUREMENT
/begin MEASUREMENT Com_RxAccessInfo[216].ApplTypeOfRxAccessInfo "" UBYTE Com_ApplTypeOfRxAccessInfoType 0 0 0 255 ECU_ADDRESS 0x0 /end MEASUREMENT
/begin MEASUREMENT Com_RxAccessInfo[216].BitLengthOfRxAccessInfo "" UWORD NO_COMPU_METHOD 0 0 0 65535 ECU_ADDRESS 0x0 /end MEASUREMENT
/begin MEASUREMENT Com_RxAccessInfo[216].BitPositionOfRxAccessInfo "" UWORD NO_COMPU_METHOD 0 0 0 65535 ECU_ADDRESS 0x0 /end MEASUREMENT
/begin MEASUREMENT Com_RxAccessInfo[216].BufferIdxOfRxAccessInfo "" UWORD Com_BufferIdxOfRxAccessInfoType 0 0 0 65535 ECU_ADDRESS 0x0 /end MEASUREMENT
/begin MEASUREMENT Com_RxAccessInfo[216].BusAccOfRxAccessInfo "" UBYTE Com_BusAccOfRxAccessInfoType 0 0 0 255 ECU_ADDRESS 0x0 /end MEASUREMENT
/begin MEASUREMENT Com_RxAccessInfo[216].ByteLengthOfRxAccessInfo "" UBYTE NO_COMPU_METHOD 0 0 0 255 ECU_ADDRESS 0x0 /end MEASUREMENT
/begin MEASUREMENT Com_RxAccessInfo[216].ConstValueArrayBasedInitValueEndIdxOfRxAccessInfo "" UBYTE Com_ConstValueArrayBasedInitValueEndIdxOfRxAccessInfoType 0 0 0 255 ECU_ADDRESS 0x0 /end MEASUREMENT
/begin MEASUREMENT Com_RxAccessInfo[216].ConstValueArrayBasedInitValueStartIdxOfRxAccessInfo "" UBYTE Com_ConstValueArrayBasedInitValueStartIdxOfRxAccessInfoType 0 0 0 255 ECU_ADDRESS 0x0 /end MEASUREMENT
/begin MEASUREMENT Com_RxAccessInfo[216].DynSignalOfRxAccessInfo "" UBYTE Com_DynSignalOfRxAccessInfoType 0 0 0 1 ECU_ADDRESS 0x0 /end MEASUREMENT
/begin MEASUREMENT Com_RxAccessInfo[216].InitValueIdxOfRxAccessInfo "" UBYTE Com_InitValueIdxOfRxAccessInfoType 0 0 0 255 ECU_ADDRESS 0x0 /end MEASUREMENT
/begin MEASUREMENT Com_RxAccessInfo[216].InitValueOfRxAccessInfo "" UBYTE Com_InitValueOfRxAccessInfoType 0 0 0 255 ECU_ADDRESS 0x0 /end MEASUREMENT
/begin MEASUREMENT Com_RxAccessInfo[216].InvValueIdxOfRxAccessInfo "" UBYTE Com_InvValueIdxOfRxAccessInfoType 0 0 0 255 ECU_ADDRESS 0x0 /end MEASUREMENT
/begin MEASUREMENT Com_RxAccessInfo[216].InvValueOfRxAccessInfo "" UBYTE Com_InvValueOfRxAccessInfoType 0 0 0 255 ECU_ADDRESS 0x0 /end MEASUREMENT
/begin MEASUREMENT Com_RxAccessInfo[216].IsGroupSignalOfRxAccessInfo "" UBYTE Com_IsGroupSignalOfRxAccessInfoType 0 0 0 1 ECU_ADDRESS 0x0 /end MEASUREMENT
/begin MEASUREMENT Com_RxAccessInfo[216].RxDataTimeoutSubstitutionValueIdxOfRxAccessInfo "" UBYTE Com_RxDataTimeoutSubstitutionValueIdxOfRxAccessInfoType 0 0 0 255 ECU_ADDRESS 0x0 /end MEASUREMENT
/begin MEASUREMENT Com_RxAccessInfo[216].RxDataTimeoutSubstitutionValueOfRxAccessInfo "" UBYTE Com_RxDataTimeoutSubstitutionValueOfRxAccessInfoType 0 0 0 255 ECU_ADDRESS 0x0 /end MEASUREMENT
/begin MEASUREMENT Com_RxAccessInfo[216].RxPduInfoIdxOfRxAccessInfo "" UBYTE NO_COMPU_METHOD 0 0 0 255 ECU_ADDRESS 0x0 /end MEASUREMENT
/begin MEASUREMENT Com_RxAccessInfo[216].RxSigBufferArrayBasedBufferEndIdxOfRxAccessInfo "" UBYTE Com_RxSigBufferArrayBasedBufferEndIdxOfRxAccessInfoType 0 0 0 255 ECU_ADDRESS 0x0 /end MEASUREMENT
/begin MEASUREMENT Com_RxAccessInfo[216].RxSigBufferArrayBasedBufferStartIdxOfRxAccessInfo "" UBYTE Com_RxSigBufferArrayBasedBufferStartIdxOfRxAccessInfoType 0 0 0 255 ECU_ADDRESS 0x0 /end MEASUREMENT
/begin MEASUREMENT Com_RxAccessInfo[216].RxSigBufferArrayBasedShdBufferEndIdxOfRxAccessInfo "" UBYTE Com_RxSigBufferArrayBasedShdBufferEndIdxOfRxAccessInfoType 0 0 0 255 ECU_ADDRESS 0x0 /end MEASUREMENT
/begin MEASUREMENT Com_RxAccessInfo[216].RxSigBufferArrayBasedShdBufferStartIdxOfRxAccessInfo "" UBYTE Com_RxSigBufferArrayBasedShdBufferStartIdxOfRxAccessInfoType 0 0 0 255 ECU_ADDRESS 0x0 /end MEASUREMENT
/begin MEASUREMENT Com_RxAccessInfo[216].RxTOutInfoIdxOfRxAccessInfo "" UBYTE Com_RxTOutInfoIdxOfRxAccessInfoType 0 0 0 255 ECU_ADDRESS 0x0 /end MEASUREMENT
/begin MEASUREMENT Com_RxAccessInfo[216].ShdBufferIdxOfRxAccessInfo "" UWORD Com_ShdBufferIdxOfRxAccessInfoType 0 0 0 65535 ECU_ADDRESS 0x0 /end MEASUREMENT
/begin MEASUREMENT Com_RxAccessInfo[216].SignalLengthInByteOfRxAccessInfo "" UBYTE NO_COMPU_METHOD 0 0 0 255 ECU_ADDRESS 0x0 /end MEASUREMENT
/begin MEASUREMENT Com_RxAccessInfo[216].StartByteInPduPositionOfRxAccessInfo "" UBYTE NO_COMPU_METHOD 0 0 0 255 ECU_ADDRESS 0x0 /end MEASUREMENT
/begin MEASUREMENT Com_RxAccessInfo[216].TmpBufferIdxOfRxAccessInfo "" UBYTE Com_TmpBufferIdxOfRxAccessInfoType 0 0 0 255 ECU_ADDRESS 0x0 /end MEASUREMENT
/begin MEASUREMENT Com_RxAccessInfo[216].TmpBufferOfRxAccessInfo "" UBYTE Com_TmpBufferOfRxAccessInfoType 0 0 0 255 ECU_ADDRESS 0x0 /end MEASUREMENT
/begin MEASUREMENT Com_RxAccessInfo[216].TmpRxShdBufferArrayBasedTmpBufferEndIdxOfRxAccessInfo "" UBYTE Com_TmpRxShdBufferArrayBasedTmpBufferEndIdxOfRxAccessInfoType 0 0 0 255 ECU_ADDRESS 0x0 /end MEASUREMENT
/begin MEASUREMENT Com_RxAccessInfo[216].TmpRxShdBufferArrayBasedTmpBufferStartIdxOfRxAccessInfo "" UBYTE Com_TmpRxShdBufferArrayBasedTmpBufferStartIdxOfRxAccessInfoType 0 0 0 255 ECU_ADDRESS 0x0 /end MEASUREMENT
/begin MEASUREMENT Com_RxAccessInfo[217].ApplTypeOfRxAccessInfo "" UBYTE Com_ApplTypeOfRxAccessInfoType 0 0 0 255 ECU_ADDRESS 0x0 /end MEASUREMENT
/begin MEASUREMENT Com_RxAccessInfo[217].BitLengthOfRxAccessInfo "" UWORD NO_COMPU_METHOD 0 0 0 65535 ECU_ADDRESS 0x0 /end MEASUREMENT
/begin MEASUREMENT Com_RxAccessInfo[217].BitPositionOfRxAccessInfo "" UWORD NO_COMPU_METHOD 0 0 0 65535 ECU_ADDRESS 0x0 /end MEASUREMENT
/begin MEASUREMENT Com_RxAccessInfo[217].BufferIdxOfRxAccessInfo "" UWORD Com_BufferIdxOfRxAccessInfoType 0 0 0 65535 ECU_ADDRESS 0x0 /end MEASUREMENT
/begin MEASUREMENT Com_RxAccessInfo[217].BusAccOfRxAccessInfo "" UBYTE Com_BusAccOfRxAccessInfoType 0 0 0 255 ECU_ADDRESS 0x0 /end MEASUREMENT
/begin MEASUREMENT Com_RxAccessInfo[217].ByteLengthOfRxAccessInfo "" UBYTE NO_COMPU_METHOD 0 0 0 255 ECU_ADDRESS 0x0 /end MEASUREMENT
/begin MEASUREMENT Com_RxAccessInfo[217].ConstValueArrayBasedInitValueEndIdxOfRxAccessInfo "" UBYTE Com_ConstValueArrayBasedInitValueEndIdxOfRxAccessInfoType 0 0 0 255 ECU_ADDRESS 0x0 /end MEASUREMENT
/begin MEASUREMENT Com_RxAccessInfo[217].ConstValueArrayBasedInitValueStartIdxOfRxAccessInfo "" UBYTE Com_ConstValueArrayBasedInitValueStartIdxOfRxAccessInfoType 0 0 0 255 ECU_ADDRESS 0x0 /end MEASUREMENT
/begin MEASUREMENT Com_RxAccessInfo[217].DynSignalOfRxAccessInfo "" UBYTE Com_DynSignalOfRxAccessInfoType 0 0 0 1 ECU_ADDRESS 0x0 /end MEASUREMENT
/begin MEASUREMENT Com_RxAccessInfo[217].InitValueIdxOfRxAccessInfo "" UBYTE Com_InitValueIdxOfRxAccessInfoType 0 0 0 255 ECU_ADDRESS 0x0 /end MEASUREMENT
/begin MEASUREMENT Com_RxAccessInfo[217].InitValueOfRxAccessInfo "" UBYTE Com_InitValueOfRxAccessInfoType 0 0 0 255 ECU_ADDRESS 0x0 /end MEASUREMENT
/begin MEASUREMENT Com_RxAccessInfo[217].InvValueIdxOfRxAccessInfo "" UBYTE Com_InvValueIdxOfRxAccessInfoType 0 0 0 255 ECU_ADDRESS 0x0 /end MEASUREMENT
/begin MEASUREMENT Com_RxAccessInfo[217].InvValueOfRxAccessInfo "" UBYTE Com_InvValueOfRxAccessInfoType 0 0 0 255 ECU_ADDRESS 0x0 /end MEASUREMENT
/begin MEASUREMENT Com_RxAccessInfo[217].IsGroupSignalOfRxAccessInfo "" UBYTE Com_IsGroupSignalOfRxAccessInfoType 0 0 0 1 ECU_ADDRESS 0x0 /end MEASUREMENT
/begin MEASUREMENT Com_RxAccessInfo[217].RxDataTimeoutSubstitutionValueIdxOfRxAccessInfo "" UBYTE Com_RxDataTimeoutSubstitutionValueIdxOfRxAccessInfoType 0 0 0 255 ECU_ADDRESS 0x0 /end MEASUREMENT
/begin MEASUREMENT Com_RxAccessInfo[217].RxDataTimeoutSubstitutionValueOfRxAccessInfo "" UBYTE Com_RxDataTimeoutSubstitutionValueOfRxAccessInfoType 0 0 0 255 ECU_ADDRESS 0x0 /end MEASUREMENT
/begin MEASUREMENT Com_RxAccessInfo[217].RxPduInfoIdxOfRxAccessInfo "" UBYTE NO_COMPU_METHOD 0 0 0 255 ECU_ADDRESS 0x0 /end MEASUREMENT
/begin MEASUREMENT Com_RxAccessInfo[217].RxSigBufferArrayBasedBufferEndIdxOfRxAccessInfo "" UBYTE Com_RxSigBufferArrayBasedBufferEndIdxOfRxAccessInfoType 0 0 0 255 ECU_ADDRESS 0x0 /end MEASUREMENT
/begin MEASUREMENT Com_RxAccessInfo[217].RxSigBufferArrayBasedBufferStartIdxOfRxAccessInfo "" UBYTE Com_RxSigBufferArrayBasedBufferStartIdxOfRxAccessInfoType 0 0 0 255 ECU_ADDRESS 0x0 /end MEASUREMENT
/begin MEASUREMENT Com_RxAccessInfo[217].RxSigBufferArrayBasedShdBufferEndIdxOfRxAccessInfo "" UBYTE Com_RxSigBufferArrayBasedShdBufferEndIdxOfRxAccessInfoType 0 0 0 255 ECU_ADDRESS 0x0 /end MEASUREMENT
/begin MEASUREMENT Com_RxAccessInfo[217].RxSigBufferArrayBasedShdBufferStartIdxOfRxAccessInfo "" UBYTE Com_RxSigBufferArrayBasedShdBufferStartIdxOfRxAccessInfoType 0 0 0 255 ECU_ADDRESS 0x0 /end MEASUREMENT
/begin MEASUREMENT Com_RxAccessInfo[217].RxTOutInfoIdxOfRxAccessInfo "" UBYTE Com_RxTOutInfoIdxOfRxAccessInfoType 0 0 0 255 ECU_ADDRESS 0x0 /end MEASUREMENT
/begin MEASUREMENT Com_RxAccessInfo[217].ShdBufferIdxOfRxAccessInfo "" UWORD Com_ShdBufferIdxOfRxAccessInfoType 0 0 0 65535 ECU_ADDRESS 0x0 /end MEASUREMENT
/begin MEASUREMENT Com_RxAccessInfo[217].SignalLengthInByteOfRxAccessInfo "" UBYTE NO_COMPU_METHOD 0 0 0 255 ECU_ADDRESS 0x0 /end MEASUREMENT
/begin MEASUREMENT Com_RxAccessInfo[217].StartByteInPduPositionOfRxAccessInfo "" UBYTE NO_COMPU_METHOD 0 0 0 255 ECU_ADDRESS 0x0 /end MEASUREMENT
/begin MEASUREMENT Com_RxAccessInfo[217].TmpBufferIdxOfRxAccessInfo "" UBYTE Com_TmpBufferIdxOfRxAccessInfoType 0 0 0 255 ECU_ADDRESS 0x0 /end MEASUREMENT
/begin MEASUREMENT Com_RxAccessInfo[217].TmpBufferOfRxAccessInfo "" UBYTE Com_TmpBufferOfRxAccessInfoType 0 0 0 255 ECU_ADDRESS 0x0 /end MEASUREMENT
/begin MEASUREMENT Com_RxAccessInfo[217].TmpRxShdBufferArrayBasedTmpBufferEndIdxOfRxAccessInfo "" UBYTE Com_TmpRxShdBufferArrayBasedTmpBufferEndIdxOfRxAccessInfoType 0 0 0 255 ECU_ADDRESS 0x0 /end MEASUREMENT
/begin MEASUREMENT Com_RxAccessInfo[217].TmpRxShdBufferArrayBasedTmpBufferStartIdxOfRxAccessInfo "" UBYTE Com_TmpRxShdBufferArrayBasedTmpBufferStartIdxOfRxAccessInfoType 0 0 0 255 ECU_ADDRESS 0x0 /end MEASUREMENT
/begin MEASUREMENT Com_RxAccessInfo[218].ApplTypeOfRxAccessInfo "" UBYTE Com_ApplTypeOfRxAccessInfoType 0 0 0 255 ECU_ADDRESS 0x0 /end MEASUREMENT
/begin MEASUREMENT Com_RxAccessInfo[218].BitLengthOfRxAccessInfo "" UWORD NO_COMPU_METHOD 0 0 0 65535 ECU_ADDRESS 0x0 /end MEASUREMENT
/begin MEASUREMENT Com_RxAccessInfo[218].BitPositionOfRxAccessInfo "" UWORD NO_COMPU_METHOD 0 0 0 65535 ECU_ADDRESS 0x0 /end MEASUREMENT
/begin MEASUREMENT Com_RxAccessInfo[218].BufferIdxOfRxAccessInfo "" UWORD Com_BufferIdxOfRxAccessInfoType 0 0 0 65535 ECU_ADDRESS 0x0 /end MEASUREMENT
/begin MEASUREMENT Com_RxAccessInfo[218].BusAccOfRxAccessInfo "" UBYTE Com_BusAccOfRxAccessInfoType 0 0 0 255 ECU_ADDRESS 0x0 /end MEASUREMENT
/begin MEASUREMENT Com_RxAccessInfo[218].ByteLengthOfRxAccessInfo "" UBYTE NO_COMPU_METHOD 0 0 0 255 ECU_ADDRESS 0x0 /end MEASUREMENT
/begin MEASUREMENT Com_RxAccessInfo[218].ConstValueArrayBasedInitValueEndIdxOfRxAccessInfo "" UBYTE Com_ConstValueArrayBasedInitValueEndIdxOfRxAccessInfoType 0 0 0 255 ECU_ADDRESS 0x0 /end MEASUREMENT
/begin MEASUREMENT Com_RxAccessInfo[218].ConstValueArrayBasedInitValueStartIdxOfRxAccessInfo "" UBYTE Com_ConstValueArrayBasedInitValueStartIdxOfRxAccessInfoType 0 0 0 255 ECU_ADDRESS 0x0 /end MEASUREMENT
/begin MEASUREMENT Com_RxAccessInfo[218].DynSignalOfRxAccessInfo "" UBYTE Com_DynSignalOfRxAccessInfoType 0 0 0 1 ECU_ADDRESS 0x0 /end MEASUREMENT
/begin MEASUREMENT Com_RxAccessInfo[218].InitValueIdxOfRxAccessInfo "" UBYTE Com_InitValueIdxOfRxAccessInfoType 0 0 0 255 ECU_ADDRESS 0x0 /end MEASUREMENT
/begin MEASUREMENT Com_RxAccessInfo[218].InitValueOfRxAccessInfo "" UBYTE Com_InitValueOfRxAccessInfoType 0 0 0 255 ECU_ADDRESS 0x0 /end MEASUREMENT
/begin MEASUREMENT Com_RxAccessInfo[218].InvValueIdxOfRxAccessInfo "" UBYTE Com_InvValueIdxOfRxAccessInfoType 0 0 0 255 ECU_ADDRESS 0x0 /end MEASUREMENT
/begin MEASUREMENT Com_RxAccessInfo[218].InvValueOfRxAccessInfo "" UBYTE Com_InvValueOfRxAccessInfoType 0 0 0 255 ECU_ADDRESS 0x0 /end MEASUREMENT
/begin MEASUREMENT Com_RxAccessInfo[218].IsGroupSignalOfRxAccessInfo "" UBYTE Com_IsGroupSignalOfRxAccessInfoType 0 0 0 1 ECU_ADDRESS 0x0 /end MEASUREMENT
/begin MEASUREMENT Com_RxAccessInfo[218].RxDataTimeoutSubstitutionValueIdxOfRxAccessInfo "" UBYTE Com_RxDataTimeoutSubstitutionValueIdxOfRxAccessInfoType 0 0 0 255 ECU_ADDRESS 0x0 /end MEASUREMENT
/begin MEASUREMENT Com_RxAccessInfo[218].RxDataTimeoutSubstitutionValueOfRxAccessInfo "" UBYTE Com_RxDataTimeoutSubstitutionValueOfRxAccessInfoType 0 0 0 255 ECU_ADDRESS 0x0 /end MEASUREMENT
/begin MEASUREMENT Com_RxAccessInfo[218].RxPduInfoIdxOfRxAccessInfo "" UBYTE NO_COMPU_METHOD 0 0 0 255 ECU_ADDRESS 0x0 /end MEASUREMENT
/begin MEASUREMENT Com_RxAccessInfo[218].RxSigBufferArrayBasedBufferEndIdxOfRxAccessInfo "" UBYTE Com_RxSigBufferArrayBasedBufferEndIdxOfRxAccessInfoType 0 0 0 255 ECU_ADDRESS 0x0 /end MEASUREMENT
/begin MEASUREMENT Com_RxAccessInfo[218].RxSigBufferArrayBasedBufferStartIdxOfRxAccessInfo "" UBYTE Com_RxSigBufferArrayBasedBufferStartIdxOfRxAccessInfoType 0 0 0 255 ECU_ADDRESS 0x0 /end MEASUREMENT
/begin MEASUREMENT Com_RxAccessInfo[218].RxSigBufferArrayBasedShdBufferEndIdxOfRxAccessInfo "" UBYTE Com_RxSigBufferArrayBasedShdBufferEndIdxOfRxAccessInfoType 0 0 0 255 ECU_ADDRESS 0x0 /end MEASUREMENT
/begin MEASUREMENT Com_RxAccessInfo[218].RxSigBufferArrayBasedShdBufferStartIdxOfRxAccessInfo "" UBYTE Com_RxSigBufferArrayBasedShdBufferStartIdxOfRxAccessInfoType 0 0 0 255 ECU_ADDRESS 0x0 /end MEASUREMENT
/begin MEASUREMENT Com_RxAccessInfo[218].RxTOutInfoIdxOfRxAccessInfo "" UBYTE Com_RxTOutInfoIdxOfRxAccessInfoType 0 0 0 255 ECU_ADDRESS 0x0 /end MEASUREMENT
/begin MEASUREMENT Com_RxAccessInfo[218].ShdBufferIdxOfRxAccessInfo "" UWORD Com_ShdBufferIdxOfRxAccessInfoType 0 0 0 65535 ECU_ADDRESS 0x0 /end MEASUREMENT
/begin MEASUREMENT Com_RxAccessInfo[218].SignalLengthInByteOfRxAccessInfo "" UBYTE NO_COMPU_METHOD 0 0 0 255 ECU_ADDRESS 0x0 /end MEASUREMENT
/begin MEASUREMENT Com_RxAccessInfo[218].StartByteInPduPositionOfRxAccessInfo "" UBYTE NO_COMPU_METHOD 0 0 0 255 ECU_ADDRESS 0x0 /end MEASUREMENT
/begin MEASUREMENT Com_RxAccessInfo[218].TmpBufferIdxOfRxAccessInfo "" UBYTE Com_TmpBufferIdxOfRxAccessInfoType 0 0 0 255 ECU_ADDRESS 0x0 /end MEASUREMENT
/begin MEASUREMENT Com_RxAccessInfo[218].TmpBufferOfRxAccessInfo "" UBYTE Com_TmpBufferOfRxAccessInfoType 0 0 0 255 ECU_ADDRESS 0x0 /end MEASUREMENT
/begin MEASUREMENT Com_RxAccessInfo[218].TmpRxShdBufferArrayBasedTmpBufferEndIdxOfRxAccessInfo "" UBYTE Com_TmpRxShdBufferArrayBasedTmpBufferEndIdxOfRxAccessInfoType 0 0 0 255 ECU_ADDRESS 0x0 /end MEASUREMENT
/begin MEASUREMENT Com_RxAccessInfo[218].TmpRxShdBufferArrayBasedTmpBufferStartIdxOfRxAccessInfo "" UBYTE Com_TmpRxShdBufferArrayBasedTmpBufferStartIdxOfRxAccessInfoType 0 0 0 255 ECU_ADDRESS 0x0 /end MEASUREMENT
/begin MEASUREMENT Com_RxAccessInfo[219].ApplTypeOfRxAccessInfo "" UBYTE Com_ApplTypeOfRxAccessInfoType 0 0 0 255 ECU_ADDRESS 0x0 /end MEASUREMENT
/begin MEASUREMENT Com_RxAccessInfo[219].BitLengthOfRxAccessInfo "" UWORD NO_COMPU_METHOD 0 0 0 65535 ECU_ADDRESS 0x0 /end MEASUREMENT
/begin MEASUREMENT Com_RxAccessInfo[219].BitPositionOfRxAccessInfo "" UWORD NO_COMPU_METHOD 0 0 0 65535 ECU_ADDRESS 0x0 /end MEASUREMENT
/begin MEASUREMENT Com_RxAccessInfo[219].BufferIdxOfRxAccessInfo "" UWORD Com_BufferIdxOfRxAccessInfoType 0 0 0 65535 ECU_ADDRESS 0x0 /end MEASUREMENT
/begin MEASUREMENT Com_RxAccessInfo[219].BusAccOfRxAccessInfo "" UBYTE Com_BusAccOfRxAccessInfoType 0 0 0 255 ECU_ADDRESS 0x0 /end MEASUREMENT
/begin MEASUREMENT Com_RxAccessInfo[219].ByteLengthOfRxAccessInfo "" UBYTE NO_COMPU_METHOD 0 0 0 255 ECU_ADDRESS 0x0 /end MEASUREMENT
/begin MEASUREMENT Com_RxAccessInfo[219].ConstValueArrayBasedInitValueEndIdxOfRxAccessInfo "" UBYTE Com_ConstValueArrayBasedInitValueEndIdxOfRxAccessInfoType 0 0 0 255 ECU_ADDRESS 0x0 /end MEASUREMENT
/begin MEASUREMENT Com_RxAccessInfo[219].ConstValueArrayBasedInitValueStartIdxOfRxAccessInfo "" UBYTE Com_ConstValueArrayBasedInitValueStartIdxOfRxAccessInfoType 0 0 0 255 ECU_ADDRESS 0x0 /end MEASUREMENT
/begin MEASUREMENT Com_RxAccessInfo[219].DynSignalOfRxAccessInfo "" UBYTE Com_DynSignalOfRxAccessInfoType 0 0 0 1 ECU_ADDRESS 0x0 /end MEASUREMENT
/begin MEASUREMENT Com_RxAccessInfo[219].InitValueIdxOfRxAccessInfo "" UBYTE Com_InitValueIdxOfRxAccessInfoType 0 0 0 255 ECU_ADDRESS 0x0 /end MEASUREMENT
/begin MEASUREMENT Com_RxAccessInfo[219].InitValueOfRxAccessInfo "" UBYTE Com_InitValueOfRxAccessInfoType 0 0 0 255 ECU_ADDRESS 0x0 /end MEASUREMENT
/begin MEASUREMENT Com_RxAccessInfo[219].InvValueIdxOfRxAccessInfo "" UBYTE Com_InvValueIdxOfRxAccessInfoType 0 0 0 255 ECU_ADDRESS 0x0 /end MEASUREMENT
/begin MEASUREMENT Com_RxAccessInfo[219].InvValueOfRxAccessInfo "" UBYTE Com_InvValueOfRxAccessInfoType 0 0 0 255 ECU_ADDRESS 0x0 /end MEASUREMENT
/begin MEASUREMENT Com_RxAccessInfo[219].IsGroupSignalOfRxAccessInfo "" UBYTE Com_IsGroupSignalOfRxAccessInfoType 0 0 0 1 ECU_ADDRESS 0x0 /end MEASUREMENT
/begin MEASUREMENT Com_RxAccessInfo[219].RxDataTimeoutSubstitutionValueIdxOfRxAccessInfo "" UBYTE Com_RxDataTimeoutSubstitutionValueIdxOfRxAccessInfoType 0 0 0 255 ECU_ADDRESS 0x0 /end MEASUREMENT
/begin MEASUREMENT Com_RxAccessInfo[219].RxDataTimeoutSubstitutionValueOfRxAccessInfo "" UBYTE Com_RxDataTimeoutSubstitutionValueOfRxAccessInfoType 0 0 0 255 ECU_ADDRESS 0x0 /end MEASUREMENT
/begin MEASUREMENT Com_RxAccessInfo[219].RxPduInfoIdxOfRxAccessInfo "" UBYTE NO_COMPU_METHOD 0 0 0 255 ECU_ADDRESS 0x0 /end MEASUREMENT
/begin MEASUREMENT Com_RxAccessInfo[219].RxSigBufferArrayBasedBufferEndIdxOfRxAccessInfo "" UBYTE Com_RxSigBufferArrayBasedBufferEndIdxOfRxAccessInfoType 0 0 0 255 ECU_ADDRESS 0x0 /end MEASUREMENT
/begin MEASUREMENT Com_RxAccessInfo[219].RxSigBufferArrayBasedBufferStartIdxOfRxAccessInfo "" UBYTE Com_RxSigBufferArrayBasedBufferStartIdxOfRxAccessInfoType 0 0 0 255 ECU_ADDRESS 0x0 /end MEASUREMENT
/begin MEASUREMENT Com_RxAccessInfo[219].RxSigBufferArrayBasedShdBufferEndIdxOfRxAccessInfo "" UBYTE Com_RxSigBufferArrayBasedShdBufferEndIdxOfRxAccessInfoType 0 0 0 255 ECU_ADDRESS 0x0 /end MEASUREMENT
/begin MEASUREMENT Com_RxAccessInfo[219].RxSigBufferArrayBasedShdBufferStartIdxOfRxAccessInfo "" UBYTE Com_RxSigBufferArrayBasedShdBufferStartIdxOfRxAccessInfoType 0 0 0 255 ECU_ADDRESS 0x0 /end MEASUREMENT
/begin MEASUREMENT Com_RxAccessInfo[219].RxTOutInfoIdxOfRxAccessInfo "" UBYTE Com_RxTOutInfoIdxOfRxAccessInfoType 0 0 0 255 ECU_ADDRESS 0x0 /end MEASUREMENT
/begin MEASUREMENT Com_RxAccessInfo[219].ShdBufferIdxOfRxAccessInfo "" UWORD Com_ShdBufferIdxOfRxAccessInfoType 0 0 0 65535 ECU_ADDRESS 0x0 /end MEASUREMENT
/begin MEASUREMENT Com_RxAccessInfo[219].SignalLengthInByteOfRxAccessInfo "" UBYTE NO_COMPU_METHOD 0 0 0 255 ECU_ADDRESS 0x0 /end MEASUREMENT
/begin MEASUREMENT Com_RxAccessInfo[219].StartByteInPduPositionOfRxAccessInfo "" UBYTE NO_COMPU_METHOD 0 0 0 255 ECU_ADDRESS 0x0 /end MEASUREMENT
/begin MEASUREMENT Com_RxAccessInfo[219].TmpBufferIdxOfRxAccessInfo "" UBYTE Com_TmpBufferIdxOfRxAccessInfoType 0 0 0 255 ECU_ADDRESS 0x0 /end MEASUREMENT
/begin MEASUREMENT Com_RxAccessInfo[219].TmpBufferOfRxAccessInfo "" UBYTE Com_TmpBufferOfRxAccessInfoType 0 0 0 255 ECU_ADDRESS 0x0 /end MEASUREMENT
/begin MEASUREMENT Com_RxAccessInfo[219].TmpRxShdBufferArrayBasedTmpBufferEndIdxOfRxAccessInfo "" UBYTE Com_TmpRxShdBufferArrayBasedTmpBufferEndIdxOfRxAccessInfoType 0 0 0 255 ECU_ADDRESS 0x0 /end MEASUREMENT
/begin MEASUREMENT Com_RxAccessInfo[219].TmpRxShdBufferArrayBasedTmpBufferStartIdxOfRxAccessInfo "" UBYTE Com_TmpRxShdBufferArrayBasedTmpBufferStartIdxOfRxAccessInfoType 0 0 0 255 ECU_ADDRESS 0x0 /end MEASUREMENT
/begin MEASUREMENT Com_RxAccessInfo[21].ApplTypeOfRxAccessInfo "" UBYTE Com_ApplTypeOfRxAccessInfoType 0 0 0 255 ECU_ADDRESS 0x0 /end MEASUREMENT
/begin MEASUREMENT Com_RxAccessInfo[21].BitLengthOfRxAccessInfo "" UWORD NO_COMPU_METHOD 0 0 0 65535 ECU_ADDRESS 0x0 /end MEASUREMENT
/begin MEASUREMENT Com_RxAccessInfo[21].BitPositionOfRxAccessInfo "" UWORD NO_COMPU_METHOD 0 0 0 65535 ECU_ADDRESS 0x0 /end MEASUREMENT
/begin MEASUREMENT Com_RxAccessInfo[21].BufferIdxOfRxAccessInfo "" UWORD Com_BufferIdxOfRxAccessInfoType 0 0 0 65535 ECU_ADDRESS 0x0 /end MEASUREMENT
/begin MEASUREMENT Com_RxAccessInfo[21].BusAccOfRxAccessInfo "" UBYTE Com_BusAccOfRxAccessInfoType 0 0 0 255 ECU_ADDRESS 0x0 /end MEASUREMENT
/begin MEASUREMENT Com_RxAccessInfo[21].ByteLengthOfRxAccessInfo "" UBYTE NO_COMPU_METHOD 0 0 0 255 ECU_ADDRESS 0x0 /end MEASUREMENT
/begin MEASUREMENT Com_RxAccessInfo[21].ConstValueArrayBasedInitValueEndIdxOfRxAccessInfo "" UBYTE Com_ConstValueArrayBasedInitValueEndIdxOfRxAccessInfoType 0 0 0 255 ECU_ADDRESS 0x0 /end MEASUREMENT
/begin MEASUREMENT Com_RxAccessInfo[21].ConstValueArrayBasedInitValueStartIdxOfRxAccessInfo "" UBYTE Com_ConstValueArrayBasedInitValueStartIdxOfRxAccessInfoType 0 0 0 255 ECU_ADDRESS 0x0 /end MEASUREMENT
/begin MEASUREMENT Com_RxAccessInfo[21].DynSignalOfRxAccessInfo "" UBYTE Com_DynSignalOfRxAccessInfoType 0 0 0 1 ECU_ADDRESS 0x0 /end MEASUREMENT
/begin MEASUREMENT Com_RxAccessInfo[21].InitValueIdxOfRxAccessInfo "" UBYTE Com_InitValueIdxOfRxAccessInfoType 0 0 0 255 ECU_ADDRESS 0x0 /end MEASUREMENT
/begin MEASUREMENT Com_RxAccessInfo[21].InitValueOfRxAccessInfo "" UBYTE Com_InitValueOfRxAccessInfoType 0 0 0 255 ECU_ADDRESS 0x0 /end MEASUREMENT
/begin MEASUREMENT Com_RxAccessInfo[21].InvValueIdxOfRxAccessInfo "" UBYTE Com_InvValueIdxOfRxAccessInfoType 0 0 0 255 ECU_ADDRESS 0x0 /end MEASUREMENT
/begin MEASUREMENT Com_RxAccessInfo[21].InvValueOfRxAccessInfo "" UBYTE Com_InvValueOfRxAccessInfoType 0 0 0 255 ECU_ADDRESS 0x0 /end MEASUREMENT
/begin MEASUREMENT Com_RxAccessInfo[21].IsGroupSignalOfRxAccessInfo "" UBYTE Com_IsGroupSignalOfRxAccessInfoType 0 0 0 1 ECU_ADDRESS 0x0 /end MEASUREMENT
/begin MEASUREMENT Com_RxAccessInfo[21].RxDataTimeoutSubstitutionValueIdxOfRxAccessInfo "" UBYTE Com_RxDataTimeoutSubstitutionValueIdxOfRxAccessInfoType 0 0 0 255 ECU_ADDRESS 0x0 /end MEASUREMENT
/begin MEASUREMENT Com_RxAccessInfo[21].RxDataTimeoutSubstitutionValueOfRxAccessInfo "" UBYTE Com_RxDataTimeoutSubstitutionValueOfRxAccessInfoType 0 0 0 255 ECU_ADDRESS 0x0 /end MEASUREMENT
/begin MEASUREMENT Com_RxAccessInfo[21].RxPduInfoIdxOfRxAccessInfo "" UBYTE NO_COMPU_METHOD 0 0 0 255 ECU_ADDRESS 0x0 /end MEASUREMENT
/begin MEASUREMENT Com_RxAccessInfo[21].RxSigBufferArrayBasedBufferEndIdxOfRxAccessInfo "" UBYTE Com_RxSigBufferArrayBasedBufferEndIdxOfRxAccessInfoType 0 0 0 255 ECU_ADDRESS 0x0 /end MEASUREMENT
/begin MEASUREMENT Com_RxAccessInfo[21].RxSigBufferArrayBasedBufferStartIdxOfRxAccessInfo "" UBYTE Com_RxSigBufferArrayBasedBufferStartIdxOfRxAccessInfoType 0 0 0 255 ECU_ADDRESS 0x0 /end MEASUREMENT
/begin MEASUREMENT Com_RxAccessInfo[21].RxSigBufferArrayBasedShdBufferEndIdxOfRxAccessInfo "" UBYTE Com_RxSigBufferArrayBasedShdBufferEndIdxOfRxAccessInfoType 0 0 0 255 ECU_ADDRESS 0x0 /end MEASUREMENT
/begin MEASUREMENT Com_RxAccessInfo[21].RxSigBufferArrayBasedShdBufferStartIdxOfRxAccessInfo "" UBYTE Com_RxSigBufferArrayBasedShdBufferStartIdxOfRxAccessInfoType 0 0 0 255 ECU_ADDRESS 0x0 /end MEASUREMENT
/begin MEASUREMENT Com_RxAccessInfo[21].RxTOutInfoIdxOfRxAccessInfo "" UBYTE Com_RxTOutInfoIdxOfRxAccessInfoType 0 0 0 255 ECU_ADDRESS 0x0 /end MEASUREMENT
/begin MEASUREMENT Com_RxAccessInfo[21].ShdBufferIdxOfRxAccessInfo "" UWORD Com_ShdBufferIdxOfRxAccessInfoType 0 0 0 65535 ECU_ADDRESS 0x0 /end MEASUREMENT
/begin MEASUREMENT Com_RxAccessInfo[21].SignalLengthInByteOfRxAccessInfo "" UBYTE NO_COMPU_METHOD 0 0 0 255 ECU_ADDRESS 0x0 /end MEASUREMENT
/begin MEASUREMENT Com_RxAccessInfo[21].StartByteInPduPositionOfRxAccessInfo "" UBYTE NO_COMPU_METHOD 0 0 0 255 ECU_ADDRESS 0x0 /end MEASUREMENT
/begin MEASUREMENT Com_RxAccessInfo[21].TmpBufferIdxOfRxAccessInfo "" UBYTE Com_TmpBufferIdxOfRxAccessInfoType 0 0 0 255 ECU_ADDRESS 0x0 /end MEASUREMENT
/begin MEASUREMENT Com_RxAccessInfo[21].TmpBufferOfRxAccessInfo "" UBYTE Com_TmpBufferOfRxAccessInfoType 0 0 0 255 ECU_ADDRESS 0x0 /end MEASUREMENT
/begin MEASUREMENT Com_RxAccessInfo[21].TmpRxShdBufferArrayBasedTmpBufferEndIdxOfRxAccessInfo "" UBYTE Com_TmpRxShdBufferArrayBasedTmpBufferEndIdxOfRxAccessInfoType 0 0 0 255 ECU_ADDRESS 0x0 /end MEASUREMENT
/begin MEASUREMENT Com_RxAccessInfo[21].TmpRxShdBufferArrayBasedTmpBufferStartIdxOfRxAccessInfo "" UBYTE Com_TmpRxShdBufferArrayBasedTmpBufferStartIdxOfRxAccessInfoType 0 0 0 255 ECU_ADDRESS 0x0 /end MEASUREMENT
/begin MEASUREMENT Com_RxAccessInfo[220].ApplTypeOfRxAccessInfo "" UBYTE Com_ApplTypeOfRxAccessInfoType 0 0 0 255 ECU_ADDRESS 0x0 /end MEASUREMENT
/begin MEASUREMENT Com_RxAccessInfo[220].BitLengthOfRxAccessInfo "" UWORD NO_COMPU_METHOD 0 0 0 65535 ECU_ADDRESS 0x0 /end MEASUREMENT
/begin MEASUREMENT Com_RxAccessInfo[220].BitPositionOfRxAccessInfo "" UWORD NO_COMPU_METHOD 0 0 0 65535 ECU_ADDRESS 0x0 /end MEASUREMENT
/begin MEASUREMENT Com_RxAccessInfo[220].BufferIdxOfRxAccessInfo "" UWORD Com_BufferIdxOfRxAccessInfoType 0 0 0 65535 ECU_ADDRESS 0x0 /end MEASUREMENT
/begin MEASUREMENT Com_RxAccessInfo[220].BusAccOfRxAccessInfo "" UBYTE Com_BusAccOfRxAccessInfoType 0 0 0 255 ECU_ADDRESS 0x0 /end MEASUREMENT
/begin MEASUREMENT Com_RxAccessInfo[220].ByteLengthOfRxAccessInfo "" UBYTE NO_COMPU_METHOD 0 0 0 255 ECU_ADDRESS 0x0 /end MEASUREMENT
/begin MEASUREMENT Com_RxAccessInfo[220].ConstValueArrayBasedInitValueEndIdxOfRxAccessInfo "" UBYTE Com_ConstValueArrayBasedInitValueEndIdxOfRxAccessInfoType 0 0 0 255 ECU_ADDRESS 0x0 /end MEASUREMENT
/begin MEASUREMENT Com_RxAccessInfo[220].ConstValueArrayBasedInitValueStartIdxOfRxAccessInfo "" UBYTE Com_ConstValueArrayBasedInitValueStartIdxOfRxAccessInfoType 0 0 0 255 ECU_ADDRESS 0x0 /end MEASUREMENT
/begin MEASUREMENT Com_RxAccessInfo[220].DynSignalOfRxAccessInfo "" UBYTE Com_DynSignalOfRxAccessInfoType 0 0 0 1 ECU_ADDRESS 0x0 /end MEASUREMENT
/begin MEASUREMENT Com_RxAccessInfo[220].InitValueIdxOfRxAccessInfo "" UBYTE Com_InitValueIdxOfRxAccessInfoType 0 0 0 255 ECU_ADDRESS 0x0 /end MEASUREMENT
/begin MEASUREMENT Com_RxAccessInfo[220].InitValueOfRxAccessInfo "" UBYTE Com_InitValueOfRxAccessInfoType 0 0 0 255 ECU_ADDRESS 0x0 /end MEASUREMENT
/begin MEASUREMENT Com_RxAccessInfo[220].InvValueIdxOfRxAccessInfo "" UBYTE Com_InvValueIdxOfRxAccessInfoType 0 0 0 255 ECU_ADDRESS 0x0 /end MEASUREMENT
/begin MEASUREMENT Com_RxAccessInfo[220].InvValueOfRxAccessInfo "" UBYTE Com_InvValueOfRxAccessInfoType 0 0 0 255 ECU_ADDRESS 0x0 /end MEASUREMENT
/begin MEASUREMENT Com_RxAccessInfo[220].IsGroupSignalOfRxAccessInfo "" UBYTE Com_IsGroupSignalOfRxAccessInfoType 0 0 0 1 ECU_ADDRESS 0x0 /end MEASUREMENT
/begin MEASUREMENT Com_RxAccessInfo[220].RxDataTimeoutSubstitutionValueIdxOfRxAccessInfo "" UBYTE Com_RxDataTimeoutSubstitutionValueIdxOfRxAccessInfoType 0 0 0 255 ECU_ADDRESS 0x0 /end MEASUREMENT
/begin MEASUREMENT Com_RxAccessInfo[220].RxDataTimeoutSubstitutionValueOfRxAccessInfo "" UBYTE Com_RxDataTimeoutSubstitutionValueOfRxAccessInfoType 0 0 0 255 ECU_ADDRESS 0x0 /end MEASUREMENT
/begin MEASUREMENT Com_RxAccessInfo[220].RxPduInfoIdxOfRxAccessInfo "" UBYTE NO_COMPU_METHOD 0 0 0 255 ECU_ADDRESS 0x0 /end MEASUREMENT
/begin MEASUREMENT Com_RxAccessInfo[220].RxSigBufferArrayBasedBufferEndIdxOfRxAccessInfo "" UBYTE Com_RxSigBufferArrayBasedBufferEndIdxOfRxAccessInfoType 0 0 0 255 ECU_ADDRESS 0x0 /end MEASUREMENT
/begin MEASUREMENT Com_RxAccessInfo[220].RxSigBufferArrayBasedBufferStartIdxOfRxAccessInfo "" UBYTE Com_RxSigBufferArrayBasedBufferStartIdxOfRxAccessInfoType 0 0 0 255 ECU_ADDRESS 0x0 /end MEASUREMENT
/begin MEASUREMENT Com_RxAccessInfo[220].RxSigBufferArrayBasedShdBufferEndIdxOfRxAccessInfo "" UBYTE Com_RxSigBufferArrayBasedShdBufferEndIdxOfRxAccessInfoType 0 0 0 255 ECU_ADDRESS 0x0 /end MEASUREMENT
/begin MEASUREMENT Com_RxAccessInfo[220].RxSigBufferArrayBasedShdBufferStartIdxOfRxAccessInfo "" UBYTE Com_RxSigBufferArrayBasedShdBufferStartIdxOfRxAccessInfoType 0 0 0 255 ECU_ADDRESS 0x0 /end MEASUREMENT
/begin MEASUREMENT Com_RxAccessInfo[220].RxTOutInfoIdxOfRxAccessInfo "" UBYTE Com_RxTOutInfoIdxOfRxAccessInfoType 0 0 0 255 ECU_ADDRESS 0x0 /end MEASUREMENT
/begin MEASUREMENT Com_RxAccessInfo[220].ShdBufferIdxOfRxAccessInfo "" UWORD Com_ShdBufferIdxOfRxAccessInfoType 0 0 0 65535 ECU_ADDRESS 0x0 /end MEASUREMENT
/begin MEASUREMENT Com_RxAccessInfo[220].SignalLengthInByteOfRxAccessInfo "" UBYTE NO_COMPU_METHOD 0 0 0 255 ECU_ADDRESS 0x0 /end MEASUREMENT
/begin MEASUREMENT Com_RxAccessInfo[220].StartByteInPduPositionOfRxAccessInfo "" UBYTE NO_COMPU_METHOD 0 0 0 255 ECU_ADDRESS 0x0 /end MEASUREMENT
/begin MEASUREMENT Com_RxAccessInfo[220].TmpBufferIdxOfRxAccessInfo "" UBYTE Com_TmpBufferIdxOfRxAccessInfoType 0 0 0 255 ECU_ADDRESS 0x0 /end MEASUREMENT
/begin MEASUREMENT Com_RxAccessInfo[220].TmpBufferOfRxAccessInfo "" UBYTE Com_TmpBufferOfRxAccessInfoType 0 0 0 255 ECU_ADDRESS 0x0 /end MEASUREMENT
/begin MEASUREMENT Com_RxAccessInfo[220].TmpRxShdBufferArrayBasedTmpBufferEndIdxOfRxAccessInfo "" UBYTE Com_TmpRxShdBufferArrayBasedTmpBufferEndIdxOfRxAccessInfoType 0 0 0 255 ECU_ADDRESS 0x0 /end MEASUREMENT
/begin MEASUREMENT Com_RxAccessInfo[220].TmpRxShdBufferArrayBasedTmpBufferStartIdxOfRxAccessInfo "" UBYTE Com_TmpRxShdBufferArrayBasedTmpBufferStartIdxOfRxAccessInfoType 0 0 0 255 ECU_ADDRESS 0x0 /end MEASUREMENT
/begin MEASUREMENT Com_RxAccessInfo[221].ApplTypeOfRxAccessInfo "" UBYTE Com_ApplTypeOfRxAccessInfoType 0 0 0 255 ECU_ADDRESS 0x0 /end MEASUREMENT
/begin MEASUREMENT Com_RxAccessInfo[221].BitLengthOfRxAccessInfo "" UWORD NO_COMPU_METHOD 0 0 0 65535 ECU_ADDRESS 0x0 /end MEASUREMENT
/begin MEASUREMENT Com_RxAccessInfo[221].BitPositionOfRxAccessInfo "" UWORD NO_COMPU_METHOD 0 0 0 65535 ECU_ADDRESS 0x0 /end MEASUREMENT
/begin MEASUREMENT Com_RxAccessInfo[221].BufferIdxOfRxAccessInfo "" UWORD Com_BufferIdxOfRxAccessInfoType 0 0 0 65535 ECU_ADDRESS 0x0 /end MEASUREMENT
/begin MEASUREMENT Com_RxAccessInfo[221].BusAccOfRxAccessInfo "" UBYTE Com_BusAccOfRxAccessInfoType 0 0 0 255 ECU_ADDRESS 0x0 /end MEASUREMENT
/begin MEASUREMENT Com_RxAccessInfo[221].ByteLengthOfRxAccessInfo "" UBYTE NO_COMPU_METHOD 0 0 0 255 ECU_ADDRESS 0x0 /end MEASUREMENT
/begin MEASUREMENT Com_RxAccessInfo[221].ConstValueArrayBasedInitValueEndIdxOfRxAccessInfo "" UBYTE Com_ConstValueArrayBasedInitValueEndIdxOfRxAccessInfoType 0 0 0 255 ECU_ADDRESS 0x0 /end MEASUREMENT
/begin MEASUREMENT Com_RxAccessInfo[221].ConstValueArrayBasedInitValueStartIdxOfRxAccessInfo "" UBYTE Com_ConstValueArrayBasedInitValueStartIdxOfRxAccessInfoType 0 0 0 255 ECU_ADDRESS 0x0 /end MEASUREMENT
/begin MEASUREMENT Com_RxAccessInfo[221].DynSignalOfRxAccessInfo "" UBYTE Com_DynSignalOfRxAccessInfoType 0 0 0 1 ECU_ADDRESS 0x0 /end MEASUREMENT
/begin MEASUREMENT Com_RxAccessInfo[221].InitValueIdxOfRxAccessInfo "" UBYTE Com_InitValueIdxOfRxAccessInfoType 0 0 0 255 ECU_ADDRESS 0x0 /end MEASUREMENT
/begin MEASUREMENT Com_RxAccessInfo[221].InitValueOfRxAccessInfo "" UBYTE Com_InitValueOfRxAccessInfoType 0 0 0 255 ECU_ADDRESS 0x0 /end MEASUREMENT
/begin MEASUREMENT Com_RxAccessInfo[221].InvValueIdxOfRxAccessInfo "" UBYTE Com_InvValueIdxOfRxAccessInfoType 0 0 0 255 ECU_ADDRESS 0x0 /end MEASUREMENT
/begin MEASUREMENT Com_RxAccessInfo[221].InvValueOfRxAccessInfo "" UBYTE Com_InvValueOfRxAccessInfoType 0 0 0 255 ECU_ADDRESS 0x0 /end MEASUREMENT
/begin MEASUREMENT Com_RxAccessInfo[221].IsGroupSignalOfRxAccessInfo "" UBYTE Com_IsGroupSignalOfRxAccessInfoType 0 0 0 1 ECU_ADDRESS 0x0 /end MEASUREMENT
/begin MEASUREMENT Com_RxAccessInfo[221].RxDataTimeoutSubstitutionValueIdxOfRxAccessInfo "" UBYTE Com_RxDataTimeoutSubstitutionValueIdxOfRxAccessInfoType 0 0 0 255 ECU_ADDRESS 0x0 /end MEASUREMENT
/begin MEASUREMENT Com_RxAccessInfo[221].RxDataTimeoutSubstitutionValueOfRxAccessInfo "" UBYTE Com_RxDataTimeoutSubstitutionValueOfRxAccessInfoType 0 0 0 255 ECU_ADDRESS 0x0 /end MEASUREMENT
/begin MEASUREMENT Com_RxAccessInfo[221].RxPduInfoIdxOfRxAccessInfo "" UBYTE NO_COMPU_METHOD 0 0 0 255 ECU_ADDRESS 0x0 /end MEASUREMENT
/begin MEASUREMENT Com_RxAccessInfo[221].RxSigBufferArrayBasedBufferEndIdxOfRxAccessInfo "" UBYTE Com_RxSigBufferArrayBasedBufferEndIdxOfRxAccessInfoType 0 0 0 255 ECU_ADDRESS 0x0 /end MEASUREMENT
/begin MEASUREMENT Com_RxAccessInfo[221].RxSigBufferArrayBasedBufferStartIdxOfRxAccessInfo "" UBYTE Com_RxSigBufferArrayBasedBufferStartIdxOfRxAccessInfoType 0 0 0 255 ECU_ADDRESS 0x0 /end MEASUREMENT
/begin MEASUREMENT Com_RxAccessInfo[221].RxSigBufferArrayBasedShdBufferEndIdxOfRxAccessInfo "" UBYTE Com_RxSigBufferArrayBasedShdBufferEndIdxOfRxAccessInfoType 0 0 0 255 ECU_ADDRESS 0x0 /end MEASUREMENT
/begin MEASUREMENT Com_RxAccessInfo[221].RxSigBufferArrayBasedShdBufferStartIdxOfRxAccessInfo "" UBYTE Com_RxSigBufferArrayBasedShdBufferStartIdxOfRxAccessInfoType 0 0 0 255 ECU_ADDRESS 0x0 /end MEASUREMENT
/begin MEASUREMENT Com_RxAccessInfo[221].RxTOutInfoIdxOfRxAccessInfo "" UBYTE Com_RxTOutInfoIdxOfRxAccessInfoType 0 0 0 255 ECU_ADDRESS 0x0 /end MEASUREMENT
/begin MEASUREMENT Com_RxAccessInfo[221].ShdBufferIdxOfRxAccessInfo "" UWORD Com_ShdBufferIdxOfRxAccessInfoType 0 0 0 65535 ECU_ADDRESS 0x0 /end MEASUREMENT
/begin MEASUREMENT Com_RxAccessInfo[221].SignalLengthInByteOfRxAccessInfo "" UBYTE NO_COMPU_METHOD 0 0 0 255 ECU_ADDRESS 0x0 /end MEASUREMENT
/begin MEASUREMENT Com_RxAccessInfo[221].StartByteInPduPositionOfRxAccessInfo "" UBYTE NO_COMPU_METHOD 0 0 0 255 ECU_ADDRESS 0x0 /end MEASUREMENT
/begin MEASUREMENT Com_RxAccessInfo[221].TmpBufferIdxOfRxAccessInfo "" UBYTE Com_TmpBufferIdxOfRxAccessInfoType 0 0 0 255 ECU_ADDRESS 0x0 /end MEASUREMENT
/begin MEASUREMENT Com_RxAccessInfo[221].TmpBufferOfRxAccessInfo "" UBYTE Com_TmpBufferOfRxAccessInfoType 0 0 0 255 ECU_ADDRESS 0x0 /end MEASUREMENT
/begin MEASUREMENT Com_RxAccessInfo[221].TmpRxShdBufferArrayBasedTmpBufferEndIdxOfRxAccessInfo "" UBYTE Com_TmpRxShdBufferArrayBasedTmpBufferEndIdxOfRxAccessInfoType 0 0 0 255 ECU_ADDRESS 0x0 /end MEASUREMENT
/begin MEASUREMENT Com_RxAccessInfo[221].TmpRxShdBufferArrayBasedTmpBufferStartIdxOfRxAccessInfo "" UBYTE Com_TmpRxShdBufferArrayBasedTmpBufferStartIdxOfRxAccessInfoType 0 0 0 255 ECU_ADDRESS 0x0 /end MEASUREMENT
/begin MEASUREMENT Com_RxAccessInfo[222].ApplTypeOfRxAccessInfo "" UBYTE Com_ApplTypeOfRxAccessInfoType 0 0 0 255 ECU_ADDRESS 0x0 /end MEASUREMENT
/begin MEASUREMENT Com_RxAccessInfo[222].BitLengthOfRxAccessInfo "" UWORD NO_COMPU_METHOD 0 0 0 65535 ECU_ADDRESS 0x0 /end MEASUREMENT
/begin MEASUREMENT Com_RxAccessInfo[222].BitPositionOfRxAccessInfo "" UWORD NO_COMPU_METHOD 0 0 0 65535 ECU_ADDRESS 0x0 /end MEASUREMENT
/begin MEASUREMENT Com_RxAccessInfo[222].BufferIdxOfRxAccessInfo "" UWORD Com_BufferIdxOfRxAccessInfoType 0 0 0 65535 ECU_ADDRESS 0x0 /end MEASUREMENT
/begin MEASUREMENT Com_RxAccessInfo[222].BusAccOfRxAccessInfo "" UBYTE Com_BusAccOfRxAccessInfoType 0 0 0 255 ECU_ADDRESS 0x0 /end MEASUREMENT
/begin MEASUREMENT Com_RxAccessInfo[222].ByteLengthOfRxAccessInfo "" UBYTE NO_COMPU_METHOD 0 0 0 255 ECU_ADDRESS 0x0 /end MEASUREMENT
/begin MEASUREMENT Com_RxAccessInfo[222].ConstValueArrayBasedInitValueEndIdxOfRxAccessInfo "" UBYTE Com_ConstValueArrayBasedInitValueEndIdxOfRxAccessInfoType 0 0 0 255 ECU_ADDRESS 0x0 /end MEASUREMENT
/begin MEASUREMENT Com_RxAccessInfo[222].ConstValueArrayBasedInitValueStartIdxOfRxAccessInfo "" UBYTE Com_ConstValueArrayBasedInitValueStartIdxOfRxAccessInfoType 0 0 0 255 ECU_ADDRESS 0x0 /end MEASUREMENT
/begin MEASUREMENT Com_RxAccessInfo[222].DynSignalOfRxAccessInfo "" UBYTE Com_DynSignalOfRxAccessInfoType 0 0 0 1 ECU_ADDRESS 0x0 /end MEASUREMENT
/begin MEASUREMENT Com_RxAccessInfo[222].InitValueIdxOfRxAccessInfo "" UBYTE Com_InitValueIdxOfRxAccessInfoType 0 0 0 255 ECU_ADDRESS 0x0 /end MEASUREMENT
/begin MEASUREMENT Com_RxAccessInfo[222].InitValueOfRxAccessInfo "" UBYTE Com_InitValueOfRxAccessInfoType 0 0 0 255 ECU_ADDRESS 0x0 /end MEASUREMENT
/begin MEASUREMENT Com_RxAccessInfo[222].InvValueIdxOfRxAccessInfo "" UBYTE Com_InvValueIdxOfRxAccessInfoType 0 0 0 255 ECU_ADDRESS 0x0 /end MEASUREMENT
/begin MEASUREMENT Com_RxAccessInfo[222].InvValueOfRxAccessInfo "" UBYTE Com_InvValueOfRxAccessInfoType 0 0 0 255 ECU_ADDRESS 0x0 /end MEASUREMENT
/begin MEASUREMENT Com_RxAccessInfo[222].IsGroupSignalOfRxAccessInfo "" UBYTE Com_IsGroupSignalOfRxAccessInfoType 0 0 0 1 ECU_ADDRESS 0x0 /end MEASUREMENT
/begin MEASUREMENT Com_RxAccessInfo[222].RxDataTimeoutSubstitutionValueIdxOfRxAccessInfo "" UBYTE Com_RxDataTimeoutSubstitutionValueIdxOfRxAccessInfoType 0 0 0 255 ECU_ADDRESS 0x0 /end MEASUREMENT
/begin MEASUREMENT Com_RxAccessInfo[222].RxDataTimeoutSubstitutionValueOfRxAccessInfo "" UBYTE Com_RxDataTimeoutSubstitutionValueOfRxAccessInfoType 0 0 0 255 ECU_ADDRESS 0x0 /end MEASUREMENT
/begin MEASUREMENT Com_RxAccessInfo[222].RxPduInfoIdxOfRxAccessInfo "" UBYTE NO_COMPU_METHOD 0 0 0 255 ECU_ADDRESS 0x0 /end MEASUREMENT
/begin MEASUREMENT Com_RxAccessInfo[222].RxSigBufferArrayBasedBufferEndIdxOfRxAccessInfo "" UBYTE Com_RxSigBufferArrayBasedBufferEndIdxOfRxAccessInfoType 0 0 0 255 ECU_ADDRESS 0x0 /end MEASUREMENT
/begin MEASUREMENT Com_RxAccessInfo[222].RxSigBufferArrayBasedBufferStartIdxOfRxAccessInfo "" UBYTE Com_RxSigBufferArrayBasedBufferStartIdxOfRxAccessInfoType 0 0 0 255 ECU_ADDRESS 0x0 /end MEASUREMENT
/begin MEASUREMENT Com_RxAccessInfo[222].RxSigBufferArrayBasedShdBufferEndIdxOfRxAccessInfo "" UBYTE Com_RxSigBufferArrayBasedShdBufferEndIdxOfRxAccessInfoType 0 0 0 255 ECU_ADDRESS 0x0 /end MEASUREMENT
/begin MEASUREMENT Com_RxAccessInfo[222].RxSigBufferArrayBasedShdBufferStartIdxOfRxAccessInfo "" UBYTE Com_RxSigBufferArrayBasedShdBufferStartIdxOfRxAccessInfoType 0 0 0 255 ECU_ADDRESS 0x0 /end MEASUREMENT
/begin MEASUREMENT Com_RxAccessInfo[222].RxTOutInfoIdxOfRxAccessInfo "" UBYTE Com_RxTOutInfoIdxOfRxAccessInfoType 0 0 0 255 ECU_ADDRESS 0x0 /end MEASUREMENT
/begin MEASUREMENT Com_RxAccessInfo[222].ShdBufferIdxOfRxAccessInfo "" UWORD Com_ShdBufferIdxOfRxAccessInfoType 0 0 0 65535 ECU_ADDRESS 0x0 /end MEASUREMENT
/begin MEASUREMENT Com_RxAccessInfo[222].SignalLengthInByteOfRxAccessInfo "" UBYTE NO_COMPU_METHOD 0 0 0 255 ECU_ADDRESS 0x0 /end MEASUREMENT
/begin MEASUREMENT Com_RxAccessInfo[222].StartByteInPduPositionOfRxAccessInfo "" UBYTE NO_COMPU_METHOD 0 0 0 255 ECU_ADDRESS 0x0 /end MEASUREMENT
/begin MEASUREMENT Com_RxAccessInfo[222].TmpBufferIdxOfRxAccessInfo "" UBYTE Com_TmpBufferIdxOfRxAccessInfoType 0 0 0 255 ECU_ADDRESS 0x0 /end MEASUREMENT
/begin MEASUREMENT Com_RxAccessInfo[222].TmpBufferOfRxAccessInfo "" UBYTE Com_TmpBufferOfRxAccessInfoType 0 0 0 255 ECU_ADDRESS 0x0 /end MEASUREMENT
/begin MEASUREMENT Com_RxAccessInfo[222].TmpRxShdBufferArrayBasedTmpBufferEndIdxOfRxAccessInfo "" UBYTE Com_TmpRxShdBufferArrayBasedTmpBufferEndIdxOfRxAccessInfoType 0 0 0 255 ECU_ADDRESS 0x0 /end MEASUREMENT
/begin MEASUREMENT Com_RxAccessInfo[222].TmpRxShdBufferArrayBasedTmpBufferStartIdxOfRxAccessInfo "" UBYTE Com_TmpRxShdBufferArrayBasedTmpBufferStartIdxOfRxAccessInfoType 0 0 0 255 ECU_ADDRESS 0x0 /end MEASUREMENT
/begin MEASUREMENT Com_RxAccessInfo[223].ApplTypeOfRxAccessInfo "" UBYTE Com_ApplTypeOfRxAccessInfoType 0 0 0 255 ECU_ADDRESS 0x0 /end MEASUREMENT
/begin MEASUREMENT Com_RxAccessInfo[223].BitLengthOfRxAccessInfo "" UWORD NO_COMPU_METHOD 0 0 0 65535 ECU_ADDRESS 0x0 /end MEASUREMENT
/begin MEASUREMENT Com_RxAccessInfo[223].BitPositionOfRxAccessInfo "" UWORD NO_COMPU_METHOD 0 0 0 65535 ECU_ADDRESS 0x0 /end MEASUREMENT
/begin MEASUREMENT Com_RxAccessInfo[223].BufferIdxOfRxAccessInfo "" UWORD Com_BufferIdxOfRxAccessInfoType 0 0 0 65535 ECU_ADDRESS 0x0 /end MEASUREMENT
/begin MEASUREMENT Com_RxAccessInfo[223].BusAccOfRxAccessInfo "" UBYTE Com_BusAccOfRxAccessInfoType 0 0 0 255 ECU_ADDRESS 0x0 /end MEASUREMENT
/begin MEASUREMENT Com_RxAccessInfo[223].ByteLengthOfRxAccessInfo "" UBYTE NO_COMPU_METHOD 0 0 0 255 ECU_ADDRESS 0x0 /end MEASUREMENT
/begin MEASUREMENT Com_RxAccessInfo[223].ConstValueArrayBasedInitValueEndIdxOfRxAccessInfo "" UBYTE Com_ConstValueArrayBasedInitValueEndIdxOfRxAccessInfoType 0 0 0 255 ECU_ADDRESS 0x0 /end MEASUREMENT
/begin MEASUREMENT Com_RxAccessInfo[223].ConstValueArrayBasedInitValueStartIdxOfRxAccessInfo "" UBYTE Com_ConstValueArrayBasedInitValueStartIdxOfRxAccessInfoType 0 0 0 255 ECU_ADDRESS 0x0 /end MEASUREMENT
/begin MEASUREMENT Com_RxAccessInfo[223].DynSignalOfRxAccessInfo "" UBYTE Com_DynSignalOfRxAccessInfoType 0 0 0 1 ECU_ADDRESS 0x0 /end MEASUREMENT
/begin MEASUREMENT Com_RxAccessInfo[223].InitValueIdxOfRxAccessInfo "" UBYTE Com_InitValueIdxOfRxAccessInfoType 0 0 0 255 ECU_ADDRESS 0x0 /end MEASUREMENT
/begin MEASUREMENT Com_RxAccessInfo[223].InitValueOfRxAccessInfo "" UBYTE Com_InitValueOfRxAccessInfoType 0 0 0 255 ECU_ADDRESS 0x0 /end MEASUREMENT
/begin MEASUREMENT Com_RxAccessInfo[223].InvValueIdxOfRxAccessInfo "" UBYTE Com_InvValueIdxOfRxAccessInfoType 0 0 0 255 ECU_ADDRESS 0x0 /end MEASUREMENT
/begin MEASUREMENT Com_RxAccessInfo[223].InvValueOfRxAccessInfo "" UBYTE Com_InvValueOfRxAccessInfoType 0 0 0 255 ECU_ADDRESS 0x0 /end MEASUREMENT
/begin MEASUREMENT Com_RxAccessInfo[223].IsGroupSignalOfRxAccessInfo "" UBYTE Com_IsGroupSignalOfRxAccessInfoType 0 0 0 1 ECU_ADDRESS 0x0 /end MEASUREMENT
/begin MEASUREMENT Com_RxAccessInfo[223].RxDataTimeoutSubstitutionValueIdxOfRxAccessInfo "" UBYTE Com_RxDataTimeoutSubstitutionValueIdxOfRxAccessInfoType 0 0 0 255 ECU_ADDRESS 0x0 /end MEASUREMENT
/begin MEASUREMENT Com_RxAccessInfo[223].RxDataTimeoutSubstitutionValueOfRxAccessInfo "" UBYTE Com_RxDataTimeoutSubstitutionValueOfRxAccessInfoType 0 0 0 255 ECU_ADDRESS 0x0 /end MEASUREMENT
/begin MEASUREMENT Com_RxAccessInfo[223].RxPduInfoIdxOfRxAccessInfo "" UBYTE NO_COMPU_METHOD 0 0 0 255 ECU_ADDRESS 0x0 /end MEASUREMENT
/begin MEASUREMENT Com_RxAccessInfo[223].RxSigBufferArrayBasedBufferEndIdxOfRxAccessInfo "" UBYTE Com_RxSigBufferArrayBasedBufferEndIdxOfRxAccessInfoType 0 0 0 255 ECU_ADDRESS 0x0 /end MEASUREMENT
/begin MEASUREMENT Com_RxAccessInfo[223].RxSigBufferArrayBasedBufferStartIdxOfRxAccessInfo "" UBYTE Com_RxSigBufferArrayBasedBufferStartIdxOfRxAccessInfoType 0 0 0 255 ECU_ADDRESS 0x0 /end MEASUREMENT
/begin MEASUREMENT Com_RxAccessInfo[223].RxSigBufferArrayBasedShdBufferEndIdxOfRxAccessInfo "" UBYTE Com_RxSigBufferArrayBasedShdBufferEndIdxOfRxAccessInfoType 0 0 0 255 ECU_ADDRESS 0x0 /end MEASUREMENT
/begin MEASUREMENT Com_RxAccessInfo[223].RxSigBufferArrayBasedShdBufferStartIdxOfRxAccessInfo "" UBYTE Com_RxSigBufferArrayBasedShdBufferStartIdxOfRxAccessInfoType 0 0 0 255 ECU_ADDRESS 0x0 /end MEASUREMENT
/begin MEASUREMENT Com_RxAccessInfo[223].RxTOutInfoIdxOfRxAccessInfo "" UBYTE Com_RxTOutInfoIdxOfRxAccessInfoType 0 0 0 255 ECU_ADDRESS 0x0 /end MEASUREMENT
/begin MEASUREMENT Com_RxAccessInfo[223].ShdBufferIdxOfRxAccessInfo "" UWORD Com_ShdBufferIdxOfRxAccessInfoType 0 0 0 65535 ECU_ADDRESS 0x0 /end MEASUREMENT
/begin MEASUREMENT Com_RxAccessInfo[223].SignalLengthInByteOfRxAccessInfo "" UBYTE NO_COMPU_METHOD 0 0 0 255 ECU_ADDRESS 0x0 /end MEASUREMENT
/begin MEASUREMENT Com_RxAccessInfo[223].StartByteInPduPositionOfRxAccessInfo "" UBYTE NO_COMPU_METHOD 0 0 0 255 ECU_ADDRESS 0x0 /end MEASUREMENT
/begin MEASUREMENT Com_RxAccessInfo[223].TmpBufferIdxOfRxAccessInfo "" UBYTE Com_TmpBufferIdxOfRxAccessInfoType 0 0 0 255 ECU_ADDRESS 0x0 /end MEASUREMENT
/begin MEASUREMENT Com_RxAccessInfo[223].TmpBufferOfRxAccessInfo "" UBYTE Com_TmpBufferOfRxAccessInfoType 0 0 0 255 ECU_ADDRESS 0x0 /end MEASUREMENT
/begin MEASUREMENT Com_RxAccessInfo[223].TmpRxShdBufferArrayBasedTmpBufferEndIdxOfRxAccessInfo "" UBYTE Com_TmpRxShdBufferArrayBasedTmpBufferEndIdxOfRxAccessInfoType 0 0 0 255 ECU_ADDRESS 0x0 /end MEASUREMENT
/begin MEASUREMENT Com_RxAccessInfo[223].TmpRxShdBufferArrayBasedTmpBufferStartIdxOfRxAccessInfo "" UBYTE Com_TmpRxShdBufferArrayBasedTmpBufferStartIdxOfRxAccessInfoType 0 0 0 255 ECU_ADDRESS 0x0 /end MEASUREMENT
/begin MEASUREMENT Com_RxAccessInfo[224].ApplTypeOfRxAccessInfo "" UBYTE Com_ApplTypeOfRxAccessInfoType 0 0 0 255 ECU_ADDRESS 0x0 /end MEASUREMENT
/begin MEASUREMENT Com_RxAccessInfo[224].BitLengthOfRxAccessInfo "" UWORD NO_COMPU_METHOD 0 0 0 65535 ECU_ADDRESS 0x0 /end MEASUREMENT
/begin MEASUREMENT Com_RxAccessInfo[224].BitPositionOfRxAccessInfo "" UWORD NO_COMPU_METHOD 0 0 0 65535 ECU_ADDRESS 0x0 /end MEASUREMENT
/begin MEASUREMENT Com_RxAccessInfo[224].BufferIdxOfRxAccessInfo "" UWORD Com_BufferIdxOfRxAccessInfoType 0 0 0 65535 ECU_ADDRESS 0x0 /end MEASUREMENT
/begin MEASUREMENT Com_RxAccessInfo[224].BusAccOfRxAccessInfo "" UBYTE Com_BusAccOfRxAccessInfoType 0 0 0 255 ECU_ADDRESS 0x0 /end MEASUREMENT
/begin MEASUREMENT Com_RxAccessInfo[224].ByteLengthOfRxAccessInfo "" UBYTE NO_COMPU_METHOD 0 0 0 255 ECU_ADDRESS 0x0 /end MEASUREMENT
/begin MEASUREMENT Com_RxAccessInfo[224].ConstValueArrayBasedInitValueEndIdxOfRxAccessInfo "" UBYTE Com_ConstValueArrayBasedInitValueEndIdxOfRxAccessInfoType 0 0 0 255 ECU_ADDRESS 0x0 /end MEASUREMENT
/begin MEASUREMENT Com_RxAccessInfo[224].ConstValueArrayBasedInitValueStartIdxOfRxAccessInfo "" UBYTE Com_ConstValueArrayBasedInitValueStartIdxOfRxAccessInfoType 0 0 0 255 ECU_ADDRESS 0x0 /end MEASUREMENT
/begin MEASUREMENT Com_RxAccessInfo[224].DynSignalOfRxAccessInfo "" UBYTE Com_DynSignalOfRxAccessInfoType 0 0 0 1 ECU_ADDRESS 0x0 /end MEASUREMENT
/begin MEASUREMENT Com_RxAccessInfo[224].InitValueIdxOfRxAccessInfo "" UBYTE Com_InitValueIdxOfRxAccessInfoType 0 0 0 255 ECU_ADDRESS 0x0 /end MEASUREMENT
/begin MEASUREMENT Com_RxAccessInfo[224].InitValueOfRxAccessInfo "" UBYTE Com_InitValueOfRxAccessInfoType 0 0 0 255 ECU_ADDRESS 0x0 /end MEASUREMENT
/begin MEASUREMENT Com_RxAccessInfo[224].InvValueIdxOfRxAccessInfo "" UBYTE Com_InvValueIdxOfRxAccessInfoType 0 0 0 255 ECU_ADDRESS 0x0 /end MEASUREMENT
/begin MEASUREMENT Com_RxAccessInfo[224].InvValueOfRxAccessInfo "" UBYTE Com_InvValueOfRxAccessInfoType 0 0 0 255 ECU_ADDRESS 0x0 /end MEASUREMENT
/begin MEASUREMENT Com_RxAccessInfo[224].IsGroupSignalOfRxAccessInfo "" UBYTE Com_IsGroupSignalOfRxAccessInfoType 0 0 0 1 ECU_ADDRESS 0x0 /end MEASUREMENT
/begin MEASUREMENT Com_RxAccessInfo[224].RxDataTimeoutSubstitutionValueIdxOfRxAccessInfo "" UBYTE Com_RxDataTimeoutSubstitutionValueIdxOfRxAccessInfoType 0 0 0 255 ECU_ADDRESS 0x0 /end MEASUREMENT
/begin MEASUREMENT Com_RxAccessInfo[224].RxDataTimeoutSubstitutionValueOfRxAccessInfo "" UBYTE Com_RxDataTimeoutSubstitutionValueOfRxAccessInfoType 0 0 0 255 ECU_ADDRESS 0x0 /end MEASUREMENT
/begin MEASUREMENT Com_RxAccessInfo[224].RxPduInfoIdxOfRxAccessInfo "" UBYTE NO_COMPU_METHOD 0 0 0 255 ECU_ADDRESS 0x0 /end MEASUREMENT
/begin MEASUREMENT Com_RxAccessInfo[224].RxSigBufferArrayBasedBufferEndIdxOfRxAccessInfo "" UBYTE Com_RxSigBufferArrayBasedBufferEndIdxOfRxAccessInfoType 0 0 0 255 ECU_ADDRESS 0x0 /end MEASUREMENT
/begin MEASUREMENT Com_RxAccessInfo[224].RxSigBufferArrayBasedBufferStartIdxOfRxAccessInfo "" UBYTE Com_RxSigBufferArrayBasedBufferStartIdxOfRxAccessInfoType 0 0 0 255 ECU_ADDRESS 0x0 /end MEASUREMENT
/begin MEASUREMENT Com_RxAccessInfo[224].RxSigBufferArrayBasedShdBufferEndIdxOfRxAccessInfo "" UBYTE Com_RxSigBufferArrayBasedShdBufferEndIdxOfRxAccessInfoType 0 0 0 255 ECU_ADDRESS 0x0 /end MEASUREMENT
/begin MEASUREMENT Com_RxAccessInfo[224].RxSigBufferArrayBasedShdBufferStartIdxOfRxAccessInfo "" UBYTE Com_RxSigBufferArrayBasedShdBufferStartIdxOfRxAccessInfoType 0 0 0 255 ECU_ADDRESS 0x0 /end MEASUREMENT
/begin MEASUREMENT Com_RxAccessInfo[224].RxTOutInfoIdxOfRxAccessInfo "" UBYTE Com_RxTOutInfoIdxOfRxAccessInfoType 0 0 0 255 ECU_ADDRESS 0x0 /end MEASUREMENT
/begin MEASUREMENT Com_RxAccessInfo[224].ShdBufferIdxOfRxAccessInfo "" UWORD Com_ShdBufferIdxOfRxAccessInfoType 0 0 0 65535 ECU_ADDRESS 0x0 /end MEASUREMENT
/begin MEASUREMENT Com_RxAccessInfo[224].SignalLengthInByteOfRxAccessInfo "" UBYTE NO_COMPU_METHOD 0 0 0 255 ECU_ADDRESS 0x0 /end MEASUREMENT
/begin MEASUREMENT Com_RxAccessInfo[224].StartByteInPduPositionOfRxAccessInfo "" UBYTE NO_COMPU_METHOD 0 0 0 255 ECU_ADDRESS 0x0 /end MEASUREMENT
/begin MEASUREMENT Com_RxAccessInfo[224].TmpBufferIdxOfRxAccessInfo "" UBYTE Com_TmpBufferIdxOfRxAccessInfoType 0 0 0 255 ECU_ADDRESS 0x0 /end MEASUREMENT
/begin MEASUREMENT Com_RxAccessInfo[224].TmpBufferOfRxAccessInfo "" UBYTE Com_TmpBufferOfRxAccessInfoType 0 0 0 255 ECU_ADDRESS 0x0 /end MEASUREMENT
/begin MEASUREMENT Com_RxAccessInfo[224].TmpRxShdBufferArrayBasedTmpBufferEndIdxOfRxAccessInfo "" UBYTE Com_TmpRxShdBufferArrayBasedTmpBufferEndIdxOfRxAccessInfoType 0 0 0 255 ECU_ADDRESS 0x0 /end MEASUREMENT
/begin COMPU_METHOD Com_ApplTypeOfRxAccessInfoType "" TAB_VERB "%10.1" "" COMPU_TAB_REF Com_ApplTypeOfRxAccessInfoType /end COMPU_METHOD
/begin COMPU_METHOD Com_BufferIdxOfRxAccessInfoType "" TAB_VERB "%10.1" "" COMPU_TAB_REF Com_BufferIdxOfRxAccessInfoType /end COMPU_METHOD
/begin COMPU_METHOD Com_BusAccOfRxAccessInfoType "" TAB_VERB "%10.1" "" COMPU_TAB_REF Com_BusAccOfRxAccessInfoType /end COMPU_METHOD
/begin COMPU_METHOD Com_ConstValueArrayBasedInitValueEndIdxOfRxAccessInfoType "" TAB_VERB "%10.1" "" COMPU_TAB_REF Com_ConstValueArrayBasedInitValueEndIdxOfRxAccessInfoType /end COMPU_METHOD
/begin COMPU_METHOD Com_ConstValueArrayBasedInitValueStartIdxOfRxAccessInfoType "" TAB_VERB "%10.1" "" COMPU_TAB_REF Com_ConstValueArrayBasedInitValueStartIdxOfRxAccessInfoType /end COMPU_METHOD
/begin COMPU_METHOD Com_DynSignalOfRxAccessInfoType "" TAB_VERB "%10.1" "" COMPU_TAB_REF Com_DynSignalOfRxAccessInfoType /end COMPU_METHOD
/begin COMPU_METHOD Com_InitValueIdxOfRxAccessInfoType "" TAB_VERB "%10.1" "" COMPU_TAB_REF Com_InitValueIdxOfRxAccessInfoType /end COMPU_METHOD
/begin COMPU_METHOD Com_InitValueOfRxAccessInfoType "" TAB_VERB "%10.1" "" COMPU_TAB_REF Com_InitValueOfRxAccessInfoType /end COMPU_METHOD
/begin COMPU_METHOD Com_InvValueIdxOfRxAccessInfoType "" TAB_VERB "%10.1" "" COMPU_TAB_REF Com_InvValueIdxOfRxAccessInfoType /end COMPU_METHOD
/begin COMPU_METHOD Com_InvValueOfRxAccessInfoType "" TAB_VERB "%10.1" "" COMPU_TAB_REF Com_InvValueOfRxAccessInfoType /end COMPU_METHOD
/begin COMPU_METHOD Com_IsGroupSignalOfRxAccessInfoType "" TAB_VERB "%10.1" "" COMPU_TAB_REF Com_IsGroupSignalOfRxAccessInfoType /end COMPU_METHOD
/begin COMPU_METHOD Com_RxDataTimeoutSubstitutionValueIdxOfRxAccessInfoType "" TAB_VERB "%10.1" "" COMPU_TAB_REF Com_RxDataTimeoutSubstitutionValueIdxOfRxAccessInfoType /end COMPU_METHOD
/begin COMPU_METHOD Com_RxDataTimeoutSubstitutionValueOfRxAccessInfoType "" TAB_VERB "%10.1" "" COMPU_TAB_REF Com_RxDataTimeoutSubstitutionValueOfRxAccessInfoType /end COMPU_METHOD
/begin COMPU_METHOD Com_RxSigBufferArrayBasedBufferEndIdxOfRxAccessInfoType "" TAB_VERB "%10.1" "" COMPU_TAB_REF Com_RxSigBufferArrayBasedBufferEndIdxOfRxAccessInfoType /end COMPU_METHOD
/begin COMPU_METHOD Com_RxSigBufferArrayBasedBufferStartIdxOfRxAccessInfoType "" TAB_VERB "%10.1" "" COMPU_TAB_REF Com_RxSigBufferArrayBasedBufferStartIdxOfRxAccessInfoType /end COMPU_METHOD
/begin COMPU_METHOD Com_RxSigBufferArrayBasedShdBufferEndIdxOfRxAccessInfoType "" TAB_VERB "%10.1" "" COMPU_TAB_REF Com_RxSigBufferArrayBasedShdBufferEndIdxOfRxAccessInfoType /end COMPU_METHOD
/begin COMPU_METHOD Com_RxSigBufferArrayBasedShdBufferStartIdxOfRxAccessInfoType "" TAB_VERB "%10.1" "" COMPU_TAB_REF Com_RxSigBufferArrayBasedShdBufferStartIdxOfRxAccessInfoType /end COMPU_METHOD
/begin COMPU_METHOD Com_RxTOutInfoIdxOfRxAccessInfoType "" TAB_VERB "%10.1" "" COMPU_TAB_REF Com_RxTOutInfoIdxOfRxAccessInfoType /end COMPU_METHOD
/begin COMPU_METHOD Com_ShdBufferIdxOfRxAccessInfoType "" TAB_VERB "%10.1" "" COMPU_TAB_REF Com_ShdBufferIdxOfRxAccessInfoType /end COMPU_METHOD
/begin COMPU_METHOD Com_TmpBufferIdxOfRxAccessInfoType "" TAB_VERB "%10.1" "" COMPU_TAB_REF Com_TmpBufferIdxOfRxAccessInfoType /end COMPU_METHOD
/begin COMPU_METHOD Com_TmpBufferOfRxAccessInfoType "" TAB_VERB "%10.1" "" COMPU_TAB_REF Com_TmpBufferOfRxAccessInfoType /end COMPU_METHOD
/begin COMPU_METHOD Com_TmpRxShdBufferArrayBasedTmpBufferEndIdxOfRxAccessInfoType "" TAB_VERB "%10.1" "" COMPU_TAB_REF Com_TmpRxShdBufferArrayBasedTmpBufferEndIdxOfRxAccessInfoType /end COMPU_METHOD
/begin COMPU_METHOD Com_TmpRxShdBufferArrayBasedTmpBufferStartIdxOfRxAccessInfoType "" TAB_VERB "%10.1" "" COMPU_TAB_REF Com_TmpRxShdBufferArrayBasedTmpBufferStartIdxOfRxAccessInfoType /end COMPU_METHOD
/begin COMPU_VTAB Com_ApplTypeOfRxAccessInfoType "" TAB_VERB 4 0 "COM_UINT8_APPLTYPEOFRXACCESSINFO" 2 "COM_UINT16_APPLTYPEOFRXACCESSINFO" 4 "COM_UINT32_APPLTYPEOFRXACCESSINFO" 8 "COM_UINT8_N_APPLTYPEOFRXACCESSINFO" /end COMPU_VTAB
/begin COMPU_VTAB Com_BufferIdxOfRxAccessInfoType "" TAB_VERB 1 65535 "COM_NO_BUFFERIDXOFRXACCESSINFO" /end COMPU_VTAB
/begin COMPU_VTAB Com_BusAccOfRxAccessInfoType "" TAB_VERB 5 0 "COM_NBIT_BUSACCOFRXACCESSINFO" 1 "COM_BYTE_BUSACCOFRXACCESSINFO" 2 "COM_NBYTE_BUSACCOFRXACCESSINFO" 4 "COM_NBITNBYTE_BUSACCOFRXACCESSINFO" 6 "COM_ARRAY_BASED_BUSACCOFRXACCESSINFO" /end COMPU_VTAB
/begin COMPU_VTAB Com_ConstValueArrayBasedInitValueEndIdxOfRxAccessInfoType "" TAB_VERB 1 255 "COM_NO_CONSTVALUEARRAYBASEDINITVALUEENDIDXOFRXACCESSINFO" /end COMPU_VTAB
/begin COMPU_VTAB Com_ConstValueArrayBasedInitValueStartIdxOfRxAccessInfoType "" TAB_VERB 1 255 "COM_NO_CONSTVALUEARRAYBASEDINITVALUESTARTIDXOFRXACCESSINFO" /end COMPU_VTAB
/begin COMPU_VTAB_RANGE Com_DynSignalOfRxAccessInfoType "" 2 0 0 "FALSE" 1 255 "TRUE" /end COMPU_VTAB_RANGE
/begin COMPU_VTAB Com_InitValueIdxOfRxAccessInfoType "" TAB_VERB 1 255 "COM_NO_INITVALUEIDXOFRXACCESSINFO" /end COMPU_VTAB
/begin COMPU_VTAB Com_InitValueOfRxAccessInfoType "" TAB_VERB 4 0 "COM_CONSTVALUEUINT8_INITVALUEOFRXACCESSINFO" 1 "COM_CONSTVALUEUINT16_INITVALUEOFRXACCESSINFO" 2 "COM_CONSTVALUEUINT32_INITVALUEOFRXACCESSINFO" 255 "COM_NO_INITVALUEOFRXACCESSINFO" /end COMPU_VTAB
/begin COMPU_VTAB Com_InvValueIdxOfRxAccessInfoType "" TAB_VERB 1 255 "COM_NO_INVVALUEIDXOFRXACCESSINFO" /end COMPU_VTAB
/begin COMPU_VTAB Com_InvValueOfRxAccessInfoType "" TAB_VERB 4 0 "COM_CONSTVALUEUINT8_INVVALUEOFRXACCESSINFO" 1 "COM_CONSTVALUEUINT16_INVVALUEOFRXACCESSINFO" 2 "COM_CONSTVALUEUINT32_INVVALUEOFRXACCESSINFO" 255 "COM_NO_INVVALUEOFRXACCESSINFO" /end COMPU_VTAB
/begin COMPU_VTAB_RANGE Com_IsGroupSignalOfRxAccessInfoType "" 2 0 0 "FALSE" 1 255 "TRUE" /end COMPU_VTAB_RANGE
/begin COMPU_VTAB Com_RxDataTimeoutSubstitutionValueIdxOfRxAccessInfoType "" TAB_VERB 1 255 "COM_NO_RXDATATIMEOUTSUBSTITUTIONVALUEIDXOFRXACCESSINFO" /end COMPU_VTAB
/begin COMPU_VTAB Com_RxDataTimeoutSubstitutionValueOfRxAccessInfoType "" TAB_VERB 3 0 "COM_CONSTVALUEUINT8_RXDATATIMEOUTSUBSTITUTIONVALUEOFRXACCESSINFO" 2 "COM_CONSTVALUEUINT32_RXDATATIMEOUTSUBSTITUTIONVALUEOFRXACCESSINFO" 255 "COM_NO_RXDATATIMEOUTSUBSTITUTIONVALUEOFRXACCESSINFO" /end COMPU_VTAB
/begin COMPU_VTAB Com_RxSigBufferArrayBasedBufferEndIdxOfRxAccessInfoType "" TAB_VERB 1 255 "COM_NO_RXSIGBUFFERARRAYBASEDBUFFERENDIDXOFRXACCESSINFO" /end COMPU_VTAB
/begin COMPU_VTAB Com_RxSigBufferArrayBasedBufferStartIdxOfRxAccessInfoType "" TAB_VERB 1 255 "COM_NO_RXSIGBUFFERARRAYBASEDBUFFERSTARTIDXOFRXACCESSINFO" /end COMPU_VTAB
/begin COMPU_VTAB Com_RxSigBufferArrayBasedShdBufferEndIdxOfRxAccessInfoType "" TAB_VERB 1 255 "COM_NO_RXSIGBUFFERARRAYBASEDSHDBUFFERENDIDXOFRXACCESSINFO" /end COMPU_VTAB
/begin COMPU_VTAB Com_RxSigBufferArrayBasedShdBufferStartIdxOfRxAccessInfoType "" TAB_VERB 1 255 "COM_NO_RXSIGBUFFERARRAYBASEDSHDBUFFERSTARTIDXOFRXACCESSINFO" /end COMPU_VTAB
/begin COMPU_VTAB Com_RxTOutInfoIdxOfRxAccessInfoType "" TAB_VERB 1 255 "COM_NO_RXTOUTINFOIDXOFRXACCESSINFO" /end COMPU_VTAB
/begin COMPU_VTAB Com_ShdBufferIdxOfRxAccessInfoType "" TAB_VERB 1 65535 "COM_NO_SHDBUFFERIDXOFRXACCESSINFO" /end COMPU_VTAB
/begin COMPU_VTAB Com_TmpBufferIdxOfRxAccessInfoType "" TAB_VERB 1 255 "COM_NO_TMPBUFFERIDXOFRXACCESSINFO" /end COMPU_VTAB
/begin COMPU_VTAB Com_TmpBufferOfRxAccessInfoType "" TAB_VERB 4 0 "COM_TMPRXSHDBUFFERUINT8_TMPBUFFEROFRXACCESSINFO" 1 "COM_TMPRXSHDBUFFERUINT16_TMPBUFFEROFRXACCESSINFO" 2 "COM_TMPRXSHDBUFFERUINT32_TMPBUFFEROFRXACCESSINFO" 255 "COM_NO_TMPBUFFEROFRXACCESSINFO" /end COMPU_VTAB
/begin COMPU_VTAB Com_TmpRxShdBufferArrayBasedTmpBufferEndIdxOfRxAccessInfoType "" TAB_VERB 1 255 "COM_NO_TMPRXSHDBUFFERARRAYBASEDTMPBUFFERENDIDXOFRXACCESSINFO" /end COMPU_VTAB
/begin COMPU_VTAB Com_TmpRxShdBufferArrayBasedTmpBufferStartIdxOfRxAccessInfoType "" TAB_VERB 1 255 "COM_NO_TMPRXSHDBUFFERARRAYBASEDTMPBUFFERSTARTIDXOFRXACCESSINFO" /end COMPU_VTAB
/begin GROUP Com ""
 /begin REF_MEASUREMENT Com_RxAccessInfo[19].ApplTypeOfRxAccessInfo Com_RxAccessInfo[19].BitLengthOfRxAccessInfo Com_RxAccessInfo[19].BitPositionOfRxAccessInfo Com_RxAccessInfo[19].BufferIdxOfRxAccessInfo Com_RxAccessInfo[19].BusAccOfRxAccessInfo Com_RxAccessInfo[19].ByteLengthOfRxAccessInfo Com_RxAccessInfo[19].ConstValueArrayBasedInitValueEndIdxOfRxAccessInfo Com_RxAccessInfo[19].ConstValueArrayBasedInitValueStartIdxOfRxAccessInfo Com_RxAccessInfo[19].DynSignalOfRxAccessInfo Com_RxAccessInfo[19].InitValueIdxOfRxAccessInfo Com_RxAccessInfo[19].InitValueOfRxAccessInfo Com_RxAccessInfo[19].InvValueIdxOfRxAccessInfo Com_RxAccessInfo[19].InvValueOfRxAccessInfo Com_RxAccessInfo[19].IsGroupSignalOfRxAccessInfo Com_RxAccessInfo[19].RxDataTimeoutSubstitutionValueIdxOfRxAccessInfo Com_RxAccessInfo[19].RxDataTimeoutSubstitutionValueOfRxAccessInfo Com_RxAccessInfo[19].RxPduInfoIdxOfRxAccessInfo Com_RxAccessInfo[19].RxSigBufferArrayBasedBufferEndIdxOfRxAccessInfo Com_RxAccessInfo[19].RxSigBufferArrayBasedBufferStartIdxOfRxAccessInfo Com_RxAccessInfo[19].RxSigBufferArrayBasedShdBufferEndIdxOfRxAccessInfo Com_RxAccessInfo[19].RxSigBufferArrayBasedShdBufferStartIdxOfRxAccessInfo Com_RxAccessInfo[19].RxTOutInfoIdxOfRxAccessInfo Com_RxAccessInfo[19].ShdBufferIdxOfRxAccessInfo Com_RxAccessInfo[19].SignalLengthInByteOfRxAccessInfo Com_RxAccessInfo[19].StartByteInPduPositionOfRxAccessInfo Com_RxAccessInfo[19].TmpBufferIdxOfRxAccessInfo Com_RxAccessInfo[19].TmpBufferOfRxAccessInfo Com_RxAccessInfo[19].TmpRxShdBufferArrayBasedTmpBufferEndIdxOfRxAccessInfo Com_RxAccessInfo[19].TmpRxShdBufferArrayBasedTmpBufferStartIdxOfRxAccessInfo Com_RxAccessInfo[1].ApplTypeOfRxAccessInfo Com_RxAccessInfo[1].BitLengthOfRxAccessInfo Com_RxAccessInfo[1].BitPositionOfRxAccessInfo Com_RxAccessInfo[1].BufferIdxOfRxAccessInfo Com_RxAccessInfo[1].BusAccOfRxAccessInfo Com_RxAccessInfo[1].ByteLengthOfRxAccessInfo Com_RxAccessInfo[1].ConstValueArrayBasedInitValueEndIdxOfRxAccessInfo Com_RxAccessInfo[1].ConstValueArrayBasedInitValueStartIdxOfRxAccessInfo Com_RxAccessInfo[1].DynSignalOfRxAccessInfo Com_RxAccessInfo[1].InitValueIdxOfRxAccessInfo Com_RxAccessInfo[1].InitValueOfRxAccessInfo Com_RxAccessInfo[1].InvValueIdxOfRxAccessInfo Com_RxAccessInfo[1].InvValueOfRxAccessInfo Com_RxAccessInfo[1].IsGroupSignalOfRxAccessInfo Com_RxAccessInfo[1].RxDataTimeoutSubstitutionValueIdxOfRxAccessInfo Com_RxAccessInfo[1].RxDataTimeoutSubstitutionValueOfRxAccessInfo Com_RxAccessInfo[1].RxPduInfoIdxOfRxAccessInfo Com_RxAccessInfo[1].RxSigBufferArrayBasedBufferEndIdxOfRxAccessInfo Com_RxAccessInfo[1].RxSigBufferArrayBasedBufferStartIdxOfRxAccessInfo Com_RxAccessInfo[1].RxSigBufferArrayBasedShdBufferEndIdxOfRxAccessInfo Com_RxAccessInfo[1].RxSigBufferArrayBasedShdBufferStartIdxOfRxAccessInfo Com_RxAccessInfo[1].RxTOutInfoIdxOfRxAccessInfo Com_RxAccessInfo[1].ShdBufferIdxOfRxAccessInfo Com_RxAccessInfo[1].SignalLengthInByteOfRxAccessInfo Com_RxAccessInfo[1].StartByteInPduPositionOfRxAccessInfo Com_RxAccessInfo[1].TmpBufferIdxOfRxAccessInfo Com_RxAccessInfo[1].TmpBufferOfRxAccessInfo Com_RxAccessInfo[1].TmpRxShdBufferArrayBasedTmpBufferEndIdxOfRxAccessInfo Com_RxAccessInfo[1].TmpRxShdBufferArrayBasedTmpBufferStartIdxOfRxAccessInfo Com_RxAccessInfo[200].ApplTypeOfRxAccessInfo Com_RxAccessInfo[200].BitLengthOfRxAccessInfo Com_RxAccessInfo[200].BitPositionOfRxAccessInfo Com_RxAccessInfo[200].BufferIdxOfRxAccessInfo Com_RxAccessInfo[200].BusAccOfRxAccessInfo Com_RxAccessInfo[200].ByteLengthOfRxAccessInfo Com_RxAccessInfo[200].ConstValueArrayBasedInitValueEndIdxOfRxAccessInfo Com_RxAccessInfo[200].ConstValueArrayBasedInitValueStartIdxOfRxAccessInfo Com_RxAccessInfo[200].DynSignalOfRxAccessInfo Com_RxAccessInfo[200].InitValueIdxOfRxAccessInfo Com_RxAccessInfo[200].InitValueOfRxAccessInfo Com_RxAccessInfo[200].InvValueIdxOfRxAccessInfo Com_RxAccessInfo[200].InvValueOfRxAccessInfo Com_RxAccessInfo[200].IsGroupSignalOfRxAccessInfo Com_RxAccessInfo[200].RxDataTimeoutSubstitutionValueIdxOfRxAccessInfo Com_RxAccessInfo[200].RxDataTimeoutSubstitutionValueOfRxAccessInfo Com_RxAccessInfo[200].RxPduInfoIdxOfRxAccessInfo Com_RxAccessInfo[200].RxSigBufferArrayBasedBufferEndIdxOfRxAccessInfo Com_RxAccessInfo[200].RxSigBufferArrayBasedBufferStartIdxOfRxAccessInfo Com_RxAccessInfo[200].RxSigBufferArrayBasedShdBufferEndIdxOfRxAccessInfo Com_RxAccessInfo[200].RxSigBufferArrayBasedShdBufferStartIdxOfRxAccessInfo Com_RxAccessInfo[200].RxTOutInfoIdxOfRxAccessInfo Com_RxAccessInfo[200].ShdBufferIdxOfRxAccessInfo Com_RxAccessInfo[200].SignalLengthInByteOfRxAccessInfo Com_RxAccessInfo[200].StartByteInPduPositionOfRxAccessInfo Com_RxAccessInfo[200].TmpBufferIdxOfRxAccessInfo Com_RxAccessInfo[200].TmpBufferOfRxAccessInfo Com_RxAccessInfo[200].TmpRxShdBufferArrayBasedTmpBufferEndIdxOfRxAccessInfo Com_RxAccessInfo[200].TmpRxShdBufferArrayBasedTmpBufferStartIdxOfRxAccessInfo Com_RxAccessInfo[201].ApplTypeOfRxAccessInfo Com_RxAccessInfo[201].BitLengthOfRxAccessInfo Com_RxAccessInfo[201].BitPositionOfRxAccessInfo Com_RxAccessInfo[201].BufferIdxOfRxAccessInfo Com_RxAccessInfo[201].BusAccOfRxAccessInfo Com_RxAccessInfo[201].ByteLengthOfRxAccessInfo Com_RxAccessInfo[201].ConstValueArrayBasedInitValueEndIdxOfRxAccessInfo Com_RxAccessInfo[201].ConstValueArrayBasedInitValueStartIdxOfRxAccessInfo Com_RxAccessInfo[201].DynSignalOfRxAccessInfo Com_RxAccessInfo[201].InitValueIdxOfRxAccessInfo Com_RxAccessInfo[201].InitValueOfRxAccessInfo Com_RxAccessInfo[201].InvValueIdxOfRxAccessInfo Com_RxAccessInfo[201].InvValueOfRxAccessInfo Com_RxAccessInfo[201].IsGroupSignalOfRxAccessInfo Com_RxAccessInfo[201].RxDataTimeoutSubstitutionValueIdxOfRxAccessInfo Com_RxAccessInfo[201].RxDataTimeoutSubstitutionValueOfRxAccessInfo Com_RxAccessInfo[201].RxPduInfoIdxOfRxAccessInfo Com_RxAccessInfo[201].RxSigBufferArrayBasedBufferEndIdxOfRxAccessInfo Com_RxAccessInfo[201].RxSigBufferArrayBasedBufferStartIdxOfRxAccessInfo Com_RxAccessInfo[201].RxSigBufferArrayBasedShdBufferEndIdxOfRxAccessInfo Com_RxAccessInfo[201].RxSigBufferArrayBasedShdBufferStartIdxOfRxAccessInfo Com_RxAccessInfo[201].RxTOutInfoIdxOfRxAccessInfo Com_RxAccessInfo[201].ShdBufferIdxOfRxAccessInfo Com_RxAccessInfo[201].SignalLengthInByteOfRxAccessInfo Com_RxAccessInfo[201].StartByteInPduPositionOfRxAccessInfo Com_RxAccessInfo[201].TmpBufferIdxOfRxAccessInfo Com_RxAccessInfo[201].TmpBufferOfRxAccessInfo Com_RxAccessInfo[201].TmpRxShdBufferArrayBasedTmpBufferEndIdxOfRxAccessInfo Com_RxAccessInfo[201].TmpRxShdBufferArrayBasedTmpBufferStartIdxOfRxAccessInfo Com_RxAccessInfo[202].ApplTypeOfRxAccessInfo Com_RxAccessInfo[202].BitLengthOfRxAccessInfo Com_RxAccessInfo[202].BitPositionOfRxAccessInfo Com_RxAccessInfo[202].BufferIdxOfRxAccessInfo Com_RxAccessInfo[202].BusAccOfRxAccessInfo Com_RxAccessInfo[202].ByteLengthOfRxAccessInfo Com_RxAccessInfo[202].ConstValueArrayBasedInitValueEndIdxOfRxAccessInfo Com_RxAccessInfo[202].ConstValueArrayBasedInitValueStartIdxOfRxAccessInfo Com_RxAccessInfo[202].DynSignalOfRxAccessInfo Com_RxAccessInfo[202].InitValueIdxOfRxAccessInfo Com_RxAccessInfo[202].InitValueOfRxAccessInfo Com_RxAccessInfo[202].InvValueIdxOfRxAccessInfo Com_RxAccessInfo[202].InvValueOfRxAccessInfo Com_RxAccessInfo[202].IsGroupSignalOfRxAccessInfo Com_RxAccessInfo[202].RxDataTimeoutSubstitutionValueIdxOfRxAccessInfo Com_RxAccessInfo[202].RxDataTimeoutSubstitutionValueOfRxAccessInfo Com_RxAccessInfo[202].RxPduInfoIdxOfRxAccessInfo Com_RxAccessInfo[202].RxSigBufferArrayBasedBufferEndIdxOfRxAccessInfo Com_RxAccessInfo[202].RxSigBufferArrayBasedBufferStartIdxOfRxAccessInfo Com_RxAccessInfo[202].RxSigBufferArrayBasedShdBufferEndIdxOfRxAccessInfo Com_RxAccessInfo[202].RxSigBufferArrayBasedShdBufferStartIdxOfRxAccessInfo Com_RxAccessInfo[202].RxTOutInfoIdxOfRxAccessInfo Com_RxAccessInfo[202].ShdBufferIdxOfRxAccessInfo Com_RxAccessInfo[202].SignalLengthInByteOfRxAccessInfo Com_RxAccessInfo[202].StartByteInPduPositionOfRxAccessInfo Com_RxAccessInfo[202].TmpBufferIdxOfRxAccessInfo Com_RxAccessInfo[202].TmpBufferOfRxAccessInfo Com_RxAccessInfo[202].TmpRxShdBufferArrayBasedTmpBufferEndIdxOfRxAccessInfo Com_RxAccessInfo[202].TmpRxShdBufferArrayBasedTmpBufferStartIdxOfRxAccessInfo Com_RxAccessInfo[203].ApplTypeOfRxAccessInfo Com_RxAccessInfo[203].BitLengthOfRxAccessInfo Com_RxAccessInfo[203].BitPositionOfRxAccessInfo Com_RxAccessInfo[203].BufferIdxOfRxAccessInfo Com_RxAccessInfo[203].BusAccOfRxAccessInfo Com_RxAccessInfo[203].ByteLengthOfRxAccessInfo Com_RxAccessInfo[203].ConstValueArrayBasedInitValueEndIdxOfRxAccessInfo Com_RxAccessInfo[203].ConstValueArrayBasedInitValueStartIdxOfRxAccessInfo Com_RxAccessInfo[203].DynSignalOfRxAccessInfo Com_RxAccessInfo[203].InitValueIdxOfRxAccessInfo Com_RxAccessInfo[203].InitValueOfRxAccessInfo Com_RxAccessInfo[203].InvValueIdxOfRxAccessInfo Com_RxAccessInfo[203].InvValueOfRxAccessInfo Com_RxAccessInfo[203].IsGroupSignalOfRxAccessInfo Com_RxAccessInfo[203].RxDataTimeoutSubstitutionValueIdxOfRxAccessInfo Com_RxAccessInfo[203].RxDataTimeoutSubstitutionValueOfRxAccessInfo Com_RxAccessInfo[203].RxPduInfoIdxOfRxAccessInfo Com_RxAccessInfo[203].RxSigBufferArrayBasedBufferEndIdxOfRxAccessInfo Com_RxAccessInfo[203].RxSigBufferArrayBasedBufferStartIdxOfRxAccessInfo Com_RxAccessInfo[203].RxSigBufferArrayBasedShdBufferEndIdxOfRxAccessInfo Com_RxAccessInfo[203].RxSigBufferArrayBasedShdBufferStartIdxOfRxAccessInfo Com_RxAccessInfo[203].RxTOutInfoIdxOfRxAccessInfo Com_RxAccessInfo[203].ShdBufferIdxOfRxAccessInfo Com_RxAccessInfo[203].SignalLengthInByteOfRxAccessInfo Com_RxAccessInfo[203].StartByteInPduPositionOfRxAccessInfo Com_RxAccessInfo[203].TmpBufferIdxOfRxAccessInfo Com_RxAccessInfo[203].TmpBufferOfRxAccessInfo Com_RxAccessInfo[203].TmpRxShdBufferArrayBasedTmpBufferEndIdxOfRxAccessInfo Com_RxAccessInfo[203].TmpRxShdBufferArrayBasedTmpBufferStartIdxOfRxAccessInfo Com_RxAccessInfo[204].ApplTypeOfRxAccessInfo Com_RxAccessInfo[204].BitLengthOfRxAccessInfo Com_RxAccessInfo[204].BitPositionOfRxAccessInfo Com_RxAccessInfo[204].BufferIdxOfRxAccessInfo Com_RxAccessInfo[204].BusAccOfRxAccessInfo Com_RxAccessInfo[204].ByteLengthOfRxAccessInfo Com_RxAccessInfo[204].ConstValueArrayBasedInitValueEndIdxOfRxAccessInfo Com_RxAccessInfo[204].ConstValueArrayBasedInitValueStartIdxOfRxAccessInfo Com_RxAccessInfo[204].DynSignalOfRxAccessInfo Com_RxAccessInfo[204].InitValueIdxOfRxAccessInfo Com_RxAccessInfo[204].InitValueOfRxAccessInfo Com_RxAccessInfo[204].InvValueIdxOfRxAccessInfo Com_RxAccessInfo[204].InvValueOfRxAccessInfo Com_RxAccessInfo[204].IsGroupSignalOfRxAccessInfo Com_RxAccessInfo[204].RxDataTimeoutSubstitutionValueIdxOfRxAccessInfo Com_RxAccessInfo[204].RxDataTimeoutSubstitutionValueOfRxAccessInfo Com_RxAccessInfo[204].RxPduInfoIdxOfRxAccessInfo Com_RxAccessInfo[204].RxSigBufferArrayBasedBufferEndIdxOfRxAccessInfo Com_RxAccessInfo[204].RxSigBufferArrayBasedBufferStartIdxOfRxAccessInfo Com_RxAccessInfo[204].RxSigBufferArrayBasedShdBufferEndIdxOfRxAccessInfo Com_RxAccessInfo[204].RxSigBufferArrayBasedShdBufferStartIdxOfRxAccessInfo Com_RxAccessInfo[204].RxTOutInfoIdxOfRxAccessInfo Com_RxAccessInfo[204].ShdBufferIdxOfRxAccessInfo Com_RxAccessInfo[204].SignalLengthInByteOfRxAccessInfo Com_RxAccessInfo[204].StartByteInPduPositionOfRxAccessInfo Com_RxAccessInfo[204].TmpBufferIdxOfRxAccessInfo Com_RxAccessInfo[204].TmpBufferOfRxAccessInfo Com_RxAccessInfo[204].TmpRxShdBufferArrayBasedTmpBufferEndIdxOfRxAccessInfo Com_RxAccessInfo[204].TmpRxShdBufferArrayBasedTmpBufferStartIdxOfRxAccessInfo Com_RxAccessInfo[205].ApplTypeOfRxAccessInfo Com_RxAccessInfo[205].BitLengthOfRxAccessInfo Com_RxAccessInfo[205].BitPositionOfRxAccessInfo Com_RxAccessInfo[205].BufferIdxOfRxAccessInfo Com_RxAccessInfo[205].BusAccOfRxAccessInfo Com_RxAccessInfo[205].ByteLengthOfRxAccessInfo Com_RxAccessInfo[205].ConstValueArrayBasedInitValueEndIdxOfRxAccessInfo Com_RxAccessInfo[205].ConstValueArrayBasedInitValueStartIdxOfRxAccessInfo Com_RxAccessInfo[205].DynSignalOfRxAccessInfo Com_RxAccessInfo[205].InitValueIdxOfRxAccessInfo Com_RxAccessInfo[205].InitValueOfRxAccessInfo Com_RxAccessInfo[205].InvValueIdxOfRxAccessInfo Com_RxAccessInfo[205].InvValueOfRxAccessInfo Com_RxAccessInfo[205].IsGroupSignalOfRxAccessInfo Com_RxAccessInfo[205].RxDataTimeoutSubstitutionValueIdxOfRxAccessInfo Com_RxAccessInfo[205].RxDataTimeoutSubstitutionValueOfRxAccessInfo Com_RxAccessInfo[205].RxPduInfoIdxOfRxAccessInfo Com_RxAccessInfo[205].RxSigBufferArrayBasedBufferEndIdxOfRxAccessInfo Com_RxAccessInfo[205].RxSigBufferArrayBasedBufferStartIdxOfRxAccessInfo Com_RxAccessInfo[205].RxSigBufferArrayBasedShdBufferEndIdxOfRxAccessInfo Com_RxAccessInfo[205].RxSigBufferArrayBasedShdBufferStartIdxOfRxAccessInfo Com_RxAccessInfo[205].RxTOutInfoIdxOfRxAccessInfo Com_RxAccessInfo[205].ShdBufferIdxOfRxAccessInfo Com_RxAccessInfo[205].SignalLengthInByteOfRxAccessInfo Com_RxAccessInfo[205].StartByteInPduPositionOfRxAccessInfo Com_RxAccessInfo[205].TmpBufferIdxOfRxAccessInfo Com_RxAccessInfo[205].TmpBufferOfRxAccessInfo Com_RxAccessInfo[205].TmpRxShdBufferArrayBasedTmpBufferEndIdxOfRxAccessInfo Com_RxAccessInfo[205].TmpRxShdBufferArrayBasedTmpBufferStartIdxOfRxAccessInfo Com_RxAccessInfo[206].ApplTypeOfRxAccessInfo Com_RxAccessInfo[206].BitLengthOfRxAccessInfo Com_RxAccessInfo[206].BitPositionOfRxAccessInfo Com_RxAccessInfo[206].BufferIdxOfRxAccessInfo Com_RxAccessInfo[206].BusAccOfRxAccessInfo Com_RxAccessInfo[206].ByteLengthOfRxAccessInfo Com_RxAccessInfo[206].ConstValueArrayBasedInitValueEndIdxOfRxAccessInfo Com_RxAccessInfo[206].ConstValueArrayBasedInitValueStartIdxOfRxAccessInfo Com_RxAccessInfo[206].DynSignalOfRxAccessInfo Com_RxAccessInfo[206].InitValueIdxOfRxAccessInfo Com_RxAccessInfo[206].InitValueOfRxAccessInfo Com_RxAccessInfo[206].InvValueIdxOfRxAccessInfo Com_RxAccessInfo[206].InvValueOfRxAccessInfo Com_RxAccessInfo[206].IsGroupSignalOfRxAccessInfo Com_RxAccessInfo[206].RxDataTimeoutSubstitutionValueIdxOfRxAccessInfo Com_RxAccessInfo[206].RxDataTimeoutSubstitutionValueOfRxAccessInfo Com_RxAccessInfo[206].RxPduInfoIdxOfRxAccessInfo Com_RxAccessInfo[206].RxSigBufferArrayBasedBufferEndIdxOfRxAccessInfo Com_RxAccessInfo[206].RxSigBufferArrayBasedBufferStartIdxOfRxAccessInfo Com_RxAccessInfo[206].RxSigBufferArrayBasedShdBufferEndIdxOfRxAccessInfo Com_RxAccessInfo[206].RxSigBufferArrayBasedShdBufferStartIdxOfRxAccessInfo Com_RxAccessInfo[206].RxTOutInfoIdxOfRxAccessInfo Com_RxAccessInfo[206].ShdBufferIdxOfRxAccessInfo Com_RxAccessInfo[206].SignalLengthInByteOfRxAccessInfo Com_RxAccessInfo[206].StartByteInPduPositionOfRxAccessInfo Com_RxAccessInfo[206].TmpBufferIdxOfRxAccessInfo Com_RxAccessInfo[206].TmpBufferOfRxAccessInfo Com_RxAccessInfo[206].TmpRxShdBufferArrayBasedTmpBufferEndIdxOfRxAccessInfo Com_RxAccessInfo[206].TmpRxShdBufferArrayBasedTmpBufferStartIdxOfRxAccessInfo Com_RxAccessInfo[207].ApplTypeOfRxAccessInfo Com_RxAccessInfo[207].BitLengthOfRxAccessInfo Com_RxAccessInfo[207].BitPositionOfRxAccessInfo Com_RxAccessInfo[207].BufferIdxOfRxAccessInfo Com_RxAccessInfo[207].BusAccOfRxAccessInfo Com_RxAccessInfo[207].ByteLengthOfRxAccessInfo Com_RxAccessInfo[207].ConstValueArrayBasedInitValueEndIdxOfRxAccessInfo Com_RxAccessInfo[207].ConstValueArrayBasedInitValueStartIdxOfRxAccessInfo Com_RxAccessInfo[207].DynSignalOfRxAccessInfo Com_RxAccessInfo[207].InitValueIdxOfRxAccessInfo Com_RxAccessInfo[207].InitValueOfRxAccessInfo Com_RxAccessInfo[207].InvValueIdxOfRxAccessInfo Com_RxAccessInfo[207].InvValueOfRxAccessInfo Com_RxAccessInfo[207].IsGroupSignalOfRxAccessInfo Com_RxAccessInfo[207].RxDataTimeoutSubstitutionValueIdxOfRxAccessInfo Com_RxAccessInfo[207].RxDataTimeoutSubstitutionValueOfRxAccessInfo Com_RxAccessInfo[207].RxPduInfoIdxOfRxAccessInfo Com_RxAccessInfo[207].RxSigBufferArrayBasedBufferEndIdxOfRxAccessInfo Com_RxAccessInfo[207].RxSigBufferArrayBasedBufferStartIdxOfRxAccessInfo Com_RxAccessInfo[207].RxSigBufferArrayBasedShdBufferEndIdxOfRxAccessInfo Com_RxAccessInfo[207].RxSigBufferArrayBasedShdBufferStartIdxOfRxAccessInfo Com_RxAccessInfo[207].RxTOutInfoIdxOfRxAccessInfo Com_RxAccessInfo[207].ShdBufferIdxOfRxAccessInfo Com_RxAccessInfo[207].SignalLengthInByteOfRxAccessInfo Com_RxAccessInfo[207].StartByteInPduPositionOfRxAccessInfo Com_RxAccessInfo[207].TmpBufferIdxOfRxAccessInfo Com_RxAccessInfo[207].TmpBufferOfRxAccessInfo Com_RxAccessInfo[207].TmpRxShdBufferArrayBasedTmpBufferEndIdxOfRxAccessInfo Com_RxAccessInfo[207].TmpRxShdBufferArrayBasedTmpBufferStartIdxOfRxAccessInfo Com_RxAccessInfo[208].ApplTypeOfRxAccessInfo Com_RxAccessInfo[208].BitLengthOfRxAccessInfo Com_RxAccessInfo[208].BitPositionOfRxAccessInfo Com_RxAccessInfo[208].BufferIdxOfRxAccessInfo Com_RxAccessInfo[208].BusAccOfRxAccessInfo Com_RxAccessInfo[208].ByteLengthOfRxAccessInfo Com_RxAccessInfo[208].ConstValueArrayBasedInitValueEndIdxOfRxAccessInfo Com_RxAccessInfo[208].ConstValueArrayBasedInitValueStartIdxOfRxAccessInfo Com_RxAccessInfo[208].DynSignalOfRxAccessInfo Com_RxAccessInfo[208].InitValueIdxOfRxAccessInfo Com_RxAccessInfo[208].InitValueOfRxAccessInfo Com_RxAccessInfo[208].InvValueIdxOfRxAccessInfo Com_RxAccessInfo[208].InvValueOfRxAccessInfo Com_RxAccessInfo[208].IsGroupSignalOfRxAccessInfo Com_RxAccessInfo[208].RxDataTimeoutSubstitutionValueIdxOfRxAccessInfo Com_RxAccessInfo[208].RxDataTimeoutSubstitutionValueOfRxAccessInfo Com_RxAccessInfo[208].RxPduInfoIdxOfRxAccessInfo Com_RxAccessInfo[208].RxSigBufferArrayBasedBufferEndIdxOfRxAccessInfo Com_RxAccessInfo[208].RxSigBufferArrayBasedBufferStartIdxOfRxAccessInfo Com_RxAccessInfo[208].RxSigBufferArrayBasedShdBufferEndIdxOfRxAccessInfo Com_RxAccessInfo[208].RxSigBufferArrayBasedShdBufferStartIdxOfRxAccessInfo Com_RxAccessInfo[208].RxTOutInfoIdxOfRxAccessInfo Com_RxAccessInfo[208].ShdBufferIdxOfRxAccessInfo Com_RxAccessInfo[208].SignalLengthInByteOfRxAccessInfo Com_RxAccessInfo[208].StartByteInPduPositionOfRxAccessInfo Com_RxAccessInfo[208].TmpBufferIdxOfRxAccessInfo Com_RxAccessInfo[208].TmpBufferOfRxAccessInfo Com_RxAccessInfo[208].TmpRxShdBufferArrayBasedTmpBufferEndIdxOfRxAccessInfo Com_RxAccessInfo[208].TmpRxShdBufferArrayBasedTmpBufferStartIdxOfRxAccessInfo Com_RxAccessInfo[209].ApplTypeOfRxAccessInfo Com_RxAccessInfo[209].BitLengthOfRxAccessInfo Com_RxAccessInfo[209].BitPositionOfRxAccessInfo Com_RxAccessInfo[209].BufferIdxOfRxAccessInfo Com_RxAccessInfo[209].BusAccOfRxAccessInfo Com_RxAccessInfo[209].ByteLengthOfRxAccessInfo Com_RxAccessInfo[209].ConstValueArrayBasedInitValueEndIdxOfRxAccessInfo Com_RxAccessInfo[209].ConstValueArrayBasedInitValueStartIdxOfRxAccessInfo Com_RxAccessInfo[209].DynSignalOfRxAccessInfo Com_RxAccessInfo[209].InitValueIdxOfRxAccessInfo Com_RxAccessInfo[209].InitValueOfRxAccessInfo Com_RxAccessInfo[209].InvValueIdxOfRxAccessInfo Com_RxAccessInfo[209].InvValueOfRxAccessInfo Com_RxAccessInfo[209].IsGroupSignalOfRxAccessInfo Com_RxAccessInfo[209].RxDataTimeoutSubstitutionValueIdxOfRxAccessInfo Com_RxAccessInfo[209].RxDataTimeoutSubstitutionValueOfRxAccessInfo Com_RxAccessInfo[209].RxPduInfoIdxOfRxAccessInfo Com_RxAccessInfo[209].RxSigBufferArrayBasedBufferEndIdxOfRxAccessInfo Com_RxAccessInfo[209].RxSigBufferArrayBasedBufferStartIdxOfRxAccessInfo Com_RxAccessInfo[209].RxSigBufferArrayBasedShdBufferEndIdxOfRxAccessInfo Com_RxAccessInfo[209].RxSigBufferArrayBasedShdBufferStartIdxOfRxAccessInfo Com_RxAccessInfo[209].RxTOutInfoIdxOfRxAccessInfo Com_RxAccessInfo[209].ShdBufferIdxOfRxAccessInfo Com_RxAccessInfo[209].SignalLengthInByteOfRxAccessInfo Com_RxAccessInfo[209].StartByteInPduPositionOfRxAccessInfo Com_RxAccessInfo[209].TmpBufferIdxOfRxAccessInfo Com_RxAccessInfo[209].TmpBufferOfRxAccessInfo Com_RxAccessInfo[209].TmpRxShdBufferArrayBasedTmpBufferEndIdxOfRxAccessInfo Com_RxAccessInfo[209].TmpRxShdBufferArrayBasedTmpBufferStartIdxOfRxAccessInfo Com_RxAccessInfo[20].ApplTypeOfRxAccessInfo Com_RxAccessInfo[20].BitLengthOfRxAccessInfo Com_RxAccessInfo[20].BitPositionOfRxAccessInfo Com_RxAccessInfo[20].BufferIdxOfRxAccessInfo Com_RxAccessInfo[20].BusAccOfRxAccessInfo Com_RxAccessInfo[20].ByteLengthOfRxAccessInfo Com_RxAccessInfo[20].ConstValueArrayBasedInitValueEndIdxOfRxAccessInfo Com_RxAccessInfo[20].ConstValueArrayBasedInitValueStartIdxOfRxAccessInfo Com_RxAccessInfo[20].DynSignalOfRxAccessInfo Com_RxAccessInfo[20].InitValueIdxOfRxAccessInfo Com_RxAccessInfo[20].InitValueOfRxAccessInfo Com_RxAccessInfo[20].InvValueIdxOfRxAccessInfo Com_RxAccessInfo[20].InvValueOfRxAccessInfo Com_RxAccessInfo[20].IsGroupSignalOfRxAccessInfo Com_RxAccessInfo[20].RxDataTimeoutSubstitutionValueIdxOfRxAccessInfo Com_RxAccessInfo[20].RxDataTimeoutSubstitutionValueOfRxAccessInfo Com_RxAccessInfo[20].RxPduInfoIdxOfRxAccessInfo Com_RxAccessInfo[20].RxSigBufferArrayBasedBufferEndIdxOfRxAccessInfo Com_RxAccessInfo[20].RxSigBufferArrayBasedBufferStartIdxOfRxAccessInfo Com_RxAccessInfo[20].RxSigBufferArrayBasedShdBufferEndIdxOfRxAccessInfo Com_RxAccessInfo[20].RxSigBufferArrayBasedShdBufferStartIdxOfRxAccessInfo Com_RxAccessInfo[20].RxTOutInfoIdxOfRxAccessInfo Com_RxAccessInfo[20].ShdBufferIdxOfRxAccessInfo Com_RxAccessInfo[20].SignalLengthInByteOfRxAccessInfo Com_RxAccessInfo[20].StartByteInPduPositionOfRxAccessInfo Com_RxAccessInfo[20].TmpBufferIdxOfRxAccessInfo Com_RxAccessInfo[20].TmpBufferOfRxAccessInfo Com_RxAccessInfo[20].TmpRxShdBufferArrayBasedTmpBufferEndIdxOfRxAccessInfo Com_RxAccessInfo[20].TmpRxShdBufferArrayBasedTmpBufferStartIdxOfRxAccessInfo Com_RxAccessInfo[210].ApplTypeOfRxAccessInfo Com_RxAccessInfo[210].BitLengthOfRxAccessInfo Com_RxAccessInfo[210].BitPositionOfRxAccessInfo Com_RxAccessInfo[210].BufferIdxOfRxAccessInfo Com_RxAccessInfo[210].BusAccOfRxAccessInfo Com_RxAccessInfo[210].ByteLengthOfRxAccessInfo Com_RxAccessInfo[210].ConstValueArrayBasedInitValueEndIdxOfRxAccessInfo Com_RxAccessInfo[210].ConstValueArrayBasedInitValueStartIdxOfRxAccessInfo Com_RxAccessInfo[210].DynSignalOfRxAccessInfo Com_RxAccessInfo[210].InitValueIdxOfRxAccessInfo Com_RxAccessInfo[210].InitValueOfRxAccessInfo Com_RxAccessInfo[210].InvValueIdxOfRxAccessInfo Com_RxAccessInfo[210].InvValueOfRxAccessInfo Com_RxAccessInfo[210].IsGroupSignalOfRxAccessInfo Com_RxAccessInfo[210].RxDataTimeoutSubstitutionValueIdxOfRxAccessInfo Com_RxAccessInfo[210].RxDataTimeoutSubstitutionValueOfRxAccessInfo Com_RxAccessInfo[210].RxPduInfoIdxOfRxAccessInfo Com_RxAccessInfo[210].RxSigBufferArrayBasedBufferEndIdxOfRxAccessInfo Com_RxAccessInfo[210].RxSigBufferArrayBasedBufferStartIdxOfRxAccessInfo Com_RxAccessInfo[210].RxSigBufferArrayBasedShdBufferEndIdxOfRxAccessInfo Com_RxAccessInfo[210].RxSigBufferArrayBasedShdBufferStartIdxOfRxAccessInfo Com_RxAccessInfo[210].RxTOutInfoIdxOfRxAccessInfo Com_RxAccessInfo[210].ShdBufferIdxOfRxAccessInfo Com_RxAccessInfo[210].SignalLengthInByteOfRxAccessInfo Com_RxAccessInfo[210].StartByteInPduPositionOfRxAccessInfo Com_RxAccessInfo[210].TmpBufferIdxOfRxAccessInfo Com_RxAccessInfo[210].TmpBufferOfRxAccessInfo Com_RxAccessInfo[210].TmpRxShdBufferArrayBasedTmpBufferEndIdxOfRxAccessInfo Com_RxAccessInfo[210].TmpRxShdBufferArrayBasedTmpBufferStartIdxOfRxAccessInfo Com_RxAccessInfo[211].ApplTypeOfRxAccessInfo Com_RxAccessInfo[211].BitLengthOfRxAccessInfo Com_RxAccessInfo[211].BitPositionOfRxAccessInfo Com_RxAccessInfo[211].BufferIdxOfRxAccessInfo Com_RxAccessInfo[211].BusAccOfRxAccessInfo Com_RxAccessInfo[211].ByteLengthOfRxAccessInfo Com_RxAccessInfo[211].ConstValueArrayBasedInitValueEndIdxOfRxAccessInfo Com_RxAccessInfo[211].ConstValueArrayBasedInitValueStartIdxOfRxAccessInfo Com_RxAccessInfo[211].DynSignalOfRxAccessInfo Com_RxAccessInfo[211].InitValueIdxOfRxAccessInfo Com_RxAccessInfo[211].InitValueOfRxAccessInfo Com_RxAccessInfo[211].InvValueIdxOfRxAccessInfo Com_RxAccessInfo[211].InvValueOfRxAccessInfo Com_RxAccessInfo[211].IsGroupSignalOfRxAccessInfo Com_RxAccessInfo[211].RxDataTimeoutSubstitutionValueIdxOfRxAccessInfo Com_RxAccessInfo[211].RxDataTimeoutSubstitutionValueOfRxAccessInfo Com_RxAccessInfo[211].RxPduInfoIdxOfRxAccessInfo Com_RxAccessInfo[211].RxSigBufferArrayBasedBufferEndIdxOfRxAccessInfo Com_RxAccessInfo[211].RxSigBufferArrayBasedBufferStartIdxOfRxAccessInfo Com_RxAccessInfo[211].RxSigBufferArrayBasedShdBufferEndIdxOfRxAccessInfo Com_RxAccessInfo[211].RxSigBufferArrayBasedShdBufferStartIdxOfRxAccessInfo Com_RxAccessInfo[211].RxTOutInfoIdxOfRxAccessInfo Com_RxAccessInfo[211].ShdBufferIdxOfRxAccessInfo Com_RxAccessInfo[211].SignalLengthInByteOfRxAccessInfo Com_RxAccessInfo[211].StartByteInPduPositionOfRxAccessInfo Com_RxAccessInfo[211].TmpBufferIdxOfRxAccessInfo Com_RxAccessInfo[211].TmpBufferOfRxAccessInfo Com_RxAccessInfo[211].TmpRxShdBufferArrayBasedTmpBufferEndIdxOfRxAccessInfo Com_RxAccessInfo[211].TmpRxShdBufferArrayBasedTmpBufferStartIdxOfRxAccessInfo Com_RxAccessInfo[212].ApplTypeOfRxAccessInfo Com_RxAccessInfo[212].BitLengthOfRxAccessInfo Com_RxAccessInfo[212].BitPositionOfRxAccessInfo Com_RxAccessInfo[212].BufferIdxOfRxAccessInfo Com_RxAccessInfo[212].BusAccOfRxAccessInfo Com_RxAccessInfo[212].ByteLengthOfRxAccessInfo Com_RxAccessInfo[212].ConstValueArrayBasedInitValueEndIdxOfRxAccessInfo Com_RxAccessInfo[212].ConstValueArrayBasedInitValueStartIdxOfRxAccessInfo Com_RxAccessInfo[212].DynSignalOfRxAccessInfo Com_RxAccessInfo[212].InitValueIdxOfRxAccessInfo Com_RxAccessInfo[212].InitValueOfRxAccessInfo Com_RxAccessInfo[212].InvValueIdxOfRxAccessInfo Com_RxAccessInfo[212].InvValueOfRxAccessInfo Com_RxAccessInfo[212].IsGroupSignalOfRxAccessInfo Com_RxAccessInfo[212].RxDataTimeoutSubstitutionValueIdxOfRxAccessInfo Com_RxAccessInfo[212].RxDataTimeoutSubstitutionValueOfRxAccessInfo Com_RxAccessInfo[212].RxPduInfoIdxOfRxAccessInfo Com_RxAccessInfo[212].RxSigBufferArrayBasedBufferEndIdxOfRxAccessInfo Com_RxAccessInfo[212].RxSigBufferArrayBasedBufferStartIdxOfRxAccessInfo Com_RxAccessInfo[212].RxSigBufferArrayBasedShdBufferEndIdxOfRxAccessInfo Com_RxAccessInfo[212].RxSigBufferArrayBasedShdBufferStartIdxOfRxAccessInfo Com_RxAccessInfo[212].RxTOutInfoIdxOfRxAccessInfo Com_RxAccessInfo[212].ShdBufferIdxOfRxAccessInfo Com_RxAccessInfo[212].SignalLengthInByteOfRxAccessInfo Com_RxAccessInfo[212].StartByteInPduPositionOfRxAccessInfo Com_RxAccessInfo[212].TmpBufferIdxOfRxAccessInfo Com_RxAccessInfo[212].TmpBufferOfRxAccessInfo Com_RxAccessInfo[212].TmpRxShdBufferArrayBasedTmpBufferEndIdxOfRxAccessInfo Com_RxAccessInfo[212].TmpRxShdBufferArrayBasedTmpBufferStartIdxOfRxAccessInfo Com_RxAccessInfo[213].ApplTypeOfRxAccessInfo Com_RxAccessInfo[213].BitLengthOfRxAccessInfo Com_RxAccessInfo[213].BitPositionOfRxAccessInfo Com_RxAccessInfo[213].BufferIdxOfRxAccessInfo Com_RxAccessInfo[213].BusAccOfRxAccessInfo Com_RxAccessInfo[213].ByteLengthOfRxAccessInfo Com_RxAccessInfo[213].ConstValueArrayBasedInitValueEndIdxOfRxAccessInfo Com_RxAccessInfo[213].ConstValueArrayBasedInitValueStartIdxOfRxAccessInfo Com_RxAccessInfo[213].DynSignalOfRxAccessInfo Com_RxAccessInfo[213].InitValueIdxOfRxAccessInfo Com_RxAccessInfo[213].InitValueOfRxAccessInfo Com_RxAccessInfo[213].InvValueIdxOfRxAccessInfo Com_RxAccessInfo[213].InvValueOfRxAccessInfo Com_RxAccessInfo[213].IsGroupSignalOfRxAccessInfo Com_RxAccessInfo[213].RxDataTimeoutSubstitutionValueIdxOfRxAccessInfo Com_RxAccessInfo[213].RxDataTimeoutSubstitutionValueOfRxAccessInfo Com_RxAccessInfo[213].RxPduInfoIdxOfRxAccessInfo Com_RxAccessInfo[213].RxSigBufferArrayBasedBufferEndIdxOfRxAccessInfo Com_RxAccessInfo[213].RxSigBufferArrayBasedBufferStartIdxOfRxAccessInfo Com_RxAccessInfo[213].RxSigBufferArrayBasedShdBufferEndIdxOfRxAccessInfo Com_RxAccessInfo[213].RxSigBufferArrayBasedShdBufferStartIdxOfRxAccessInfo Com_RxAccessInfo[213].RxTOutInfoIdxOfRxAccessInfo Com_RxAccessInfo[213].ShdBufferIdxOfRxAccessInfo Com_RxAccessInfo[213].SignalLengthInByteOfRxAccessInfo Com_RxAccessInfo[213].StartByteInPduPositionOfRxAccessInfo Com_RxAccessInfo[213].TmpBufferIdxOfRxAccessInfo Com_RxAccessInfo[213].TmpBufferOfRxAccessInfo Com_RxAccessInfo[213].TmpRxShdBufferArrayBasedTmpBufferEndIdxOfRxAccessInfo Com_RxAccessInfo[213].TmpRxShdBufferArrayBasedTmpBufferStartIdxOfRxAccessInfo Com_RxAccessInfo[214].ApplTypeOfRxAccessInfo Com_RxAccessInfo[214].BitLengthOfRxAccessInfo Com_RxAccessInfo[214].BitPositionOfRxAccessInfo Com_RxAccessInfo[214].BufferIdxOfRxAccessInfo Com_RxAccessInfo[214].BusAccOfRxAccessInfo Com_RxAccessInfo[214].ByteLengthOfRxAccessInfo Com_RxAccessInfo[214].ConstValueArrayBasedInitValueEndIdxOfRxAccessInfo Com_RxAccessInfo[214].ConstValueArrayBasedInitValueStartIdxOfRxAccessInfo Com_RxAccessInfo[214].DynSignalOfRxAccessInfo Com_RxAccessInfo[214].InitValueIdxOfRxAccessInfo Com_RxAccessInfo[214].InitValueOfRxAccessInfo Com_RxAccessInfo[214].InvValueIdxOfRxAccessInfo Com_RxAccessInfo[214].InvValueOfRxAccessInfo Com_RxAccessInfo[214].IsGroupSignalOfRxAccessInfo Com_RxAccessInfo[214].RxDataTimeoutSubstitutionValueIdxOfRxAccessInfo Com_RxAccessInfo[214].RxDataTimeoutSubstitutionValueOfRxAccessInfo Com_RxAccessInfo[214].RxPduInfoIdxOfRxAccessInfo Com_RxAccessInfo[214].RxSigBufferArrayBasedBufferEndIdxOfRxAccessInfo Com_RxAccessInfo[214].RxSigBufferArrayBasedBufferStartIdxOfRxAccessInfo Com_RxAccessInfo[214].RxSigBufferArrayBasedShdBufferEndIdxOfRxAccessInfo Com_RxAccessInfo[214].RxSigBufferArrayBasedShdBufferStartIdxOfRxAccessInfo Com_RxAccessInfo[214].RxTOutInfoIdxOfRxAccessInfo Com_RxAccessInfo[214].ShdBufferIdxOfRxAccessInfo Com_RxAccessInfo[214].SignalLengthInByteOfRxAccessInfo Com_RxAccessInfo[214].StartByteInPduPositionOfRxAccessInfo Com_RxAccessInfo[214].TmpBufferIdxOfRxAccessInfo Com_RxAccessInfo[214].TmpBufferOfRxAccessInfo Com_RxAccessInfo[214].TmpRxShdBufferArrayBasedTmpBufferEndIdxOfRxAccessInfo Com_RxAccessInfo[214].TmpRxShdBufferArrayBasedTmpBufferStartIdxOfRxAccessInfo Com_RxAccessInfo[215].ApplTypeOfRxAccessInfo Com_RxAccessInfo[215].BitLengthOfRxAccessInfo Com_RxAccessInfo[215].BitPositionOfRxAccessInfo Com_RxAccessInfo[215].BufferIdxOfRxAccessInfo Com_RxAccessInfo[215].BusAccOfRxAccessInfo Com_RxAccessInfo[215].ByteLengthOfRxAccessInfo Com_RxAccessInfo[215].ConstValueArrayBasedInitValueEndIdxOfRxAccessInfo Com_RxAccessInfo[215].ConstValueArrayBasedInitValueStartIdxOfRxAccessInfo Com_RxAccessInfo[215].DynSignalOfRxAccessInfo Com_RxAccessInfo[215].InitValueIdxOfRxAccessInfo Com_RxAccessInfo[215].InitValueOfRxAccessInfo Com_RxAccessInfo[215].InvValueIdxOfRxAccessInfo Com_RxAccessInfo[215].InvValueOfRxAccessInfo Com_RxAccessInfo[215].IsGroupSignalOfRxAccessInfo Com_RxAccessInfo[215].RxDataTimeoutSubstitutionValueIdxOfRxAccessInfo Com_RxAccessInfo[215].RxDataTimeoutSubstitutionValueOfRxAccessInfo Com_RxAccessInfo[215].RxPduInfoIdxOfRxAccessInfo Com_RxAccessInfo[215].RxSigBufferArrayBasedBufferEndIdxOfRxAccessInfo Com_RxAccessInfo[215].RxSigBufferArrayBasedBufferStartIdxOfRxAccessInfo Com_RxAccessInfo[215].RxSigBufferArrayBasedShdBufferEndIdxOfRxAccessInfo Com_RxAccessInfo[215].RxSigBufferArrayBasedShdBufferStartIdxOfRxAccessInfo Com_RxAccessInfo[215].RxTOutInfoIdxOfRxAccessInfo Com_RxAccessInfo[215].ShdBufferIdxOfRxAccessInfo Com_RxAccessInfo[215].SignalLengthInByteOfRxAccessInfo Com_RxAccessInfo[215].StartByteInPduPositionOfRxAccessInfo Com_RxAccessInfo[215].TmpBufferIdxOfRxAccessInfo Com_RxAccessInfo[215].TmpBufferOfRxAccessInfo Com_RxAccessInfo[215].TmpRxShdBufferArrayBasedTmpBufferEndIdxOfRxAccessInfo Com_RxAccessInfo[215].TmpRxShdBufferArrayBasedTmpBufferStartIdxOfRxAccessInfo Com_RxAccessInfo[216].ApplTypeOfRxAccessInfo Com_RxAccessInfo[216].BitLengthOfRxAccessInfo Com_RxAccessInfo[216].BitPositionOfRxAccessInfo Com_RxAccessInfo[216].BufferIdxOfRxAccessInfo Com_RxAccessInfo[216].BusAccOfRxAccessInfo Com_RxAccessInfo[216].ByteLengthOfRxAccessInfo Com_RxAccessInfo[216].ConstValueArrayBasedInitValueEndIdxOfRxAccessInfo Com_RxAccessInfo[216].ConstValueArrayBasedInitValueStartIdxOfRxAccessInfo Com_RxAccessInfo[216].DynSignalOfRxAccessInfo Com_RxAccessInfo[216].InitValueIdxOfRxAccessInfo Com_RxAccessInfo[216].InitValueOfRxAccessInfo Com_RxAccessInfo[216].InvValueIdxOfRxAccessInfo Com_RxAccessInfo[216].InvValueOfRxAccessInfo Com_RxAccessInfo[216].IsGroupSignalOfRxAccessInfo Com_RxAccessInfo[216].RxDataTimeoutSubstitutionValueIdxOfRxAccessInfo Com_RxAccessInfo[216].RxDataTimeoutSubstitutionValueOfRxAccessInfo Com_RxAccessInfo[216].RxPduInfoIdxOfRxAccessInfo Com_RxAccessInfo[216].RxSigBufferArrayBasedBufferEndIdxOfRxAccessInfo Com_RxAccessInfo[216].RxSigBufferArrayBasedBufferStartIdxOfRxAccessInfo Com_RxAccessInfo[216].RxSigBufferArrayBasedShdBufferEndIdxOfRxAccessInfo Com_RxAccessInfo[216].RxSigBufferArrayBasedShdBufferStartIdxOfRxAccessInfo Com_RxAccessInfo[216].RxTOutInfoIdxOfRxAccessInfo Com_RxAccessInfo[216].ShdBufferIdxOfRxAccessInfo Com_RxAccessInfo[216].SignalLengthInByteOfRxAccessInfo Com_RxAccessInfo[216].StartByteInPduPositionOfRxAccessInfo Com_RxAccessInfo[216].TmpBufferIdxOfRxAccessInfo Com_RxAccessInfo[216].TmpBufferOfRxAccessInfo Com_RxAccessInfo[216].TmpRxShdBufferArrayBasedTmpBufferEndIdxOfRxAccessInfo Com_RxAccessInfo[216].TmpRxShdBufferArrayBasedTmpBufferStartIdxOfRxAccessInfo Com_RxAccessInfo[217].ApplTypeOfRxAccessInfo Com_RxAccessInfo[217].BitLengthOfRxAccessInfo Com_RxAccessInfo[217].BitPositionOfRxAccessInfo Com_RxAccessInfo[217].BufferIdxOfRxAccessInfo Com_RxAccessInfo[217].BusAccOfRxAccessInfo Com_RxAccessInfo[217].ByteLengthOfRxAccessInfo Com_RxAccessInfo[217].ConstValueArrayBasedInitValueEndIdxOfRxAccessInfo Com_RxAccessInfo[217].ConstValueArrayBasedInitValueStartIdxOfRxAccessInfo Com_RxAccessInfo[217].DynSignalOfRxAccessInfo Com_RxAccessInfo[217].InitValueIdxOfRxAccessInfo Com_RxAccessInfo[217].InitValueOfRxAccessInfo Com_RxAccessInfo[217].InvValueIdxOfRxAccessInfo Com_RxAccessInfo[217].InvValueOfRxAccessInfo Com_RxAccessInfo[217].IsGroupSignalOfRxAccessInfo Com_RxAccessInfo[217].RxDataTimeoutSubstitutionValueIdxOfRxAccessInfo Com_RxAccessInfo[217].RxDataTimeoutSubstitutionValueOfRxAccessInfo Com_RxAccessInfo[217].RxPduInfoIdxOfRxAccessInfo Com_RxAccessInfo[217].RxSigBufferArrayBasedBufferEndIdxOfRxAccessInfo Com_RxAccessInfo[217].RxSigBufferArrayBasedBufferStartIdxOfRxAccessInfo Com_RxAccessInfo[217].RxSigBufferArrayBasedShdBufferEndIdxOfRxAccessInfo Com_RxAccessInfo[217].RxSigBufferArrayBasedShdBufferStartIdxOfRxAccessInfo Com_RxAccessInfo[217].RxTOutInfoIdxOfRxAccessInfo Com_RxAccessInfo[217].ShdBufferIdxOfRxAccessInfo Com_RxAccessInfo[217].SignalLengthInByteOfRxAccessInfo Com_RxAccessInfo[217].StartByteInPduPositionOfRxAccessInfo Com_RxAccessInfo[217].TmpBufferIdxOfRxAccessInfo Com_RxAccessInfo[217].TmpBufferOfRxAccessInfo Com_RxAccessInfo[217].TmpRxShdBufferArrayBasedTmpBufferEndIdxOfRxAccessInfo Com_RxAccessInfo[217].TmpRxShdBufferArrayBasedTmpBufferStartIdxOfRxAccessInfo Com_RxAccessInfo[218].ApplTypeOfRxAccessInfo Com_RxAccessInfo[218].BitLengthOfRxAccessInfo Com_RxAccessInfo[218].BitPositionOfRxAccessInfo Com_RxAccessInfo[218].BufferIdxOfRxAccessInfo Com_RxAccessInfo[218].BusAccOfRxAccessInfo Com_RxAccessInfo[218].ByteLengthOfRxAccessInfo Com_RxAccessInfo[218].ConstValueArrayBasedInitValueEndIdxOfRxAccessInfo Com_RxAccessInfo[218].ConstValueArrayBasedInitValueStartIdxOfRxAccessInfo Com_RxAccessInfo[218].DynSignalOfRxAccessInfo Com_RxAccessInfo[218].InitValueIdxOfRxAccessInfo Com_RxAccessInfo[218].InitValueOfRxAccessInfo Com_RxAccessInfo[218].InvValueIdxOfRxAccessInfo Com_RxAccessInfo[218].InvValueOfRxAccessInfo Com_RxAccessInfo[218].IsGroupSignalOfRxAccessInfo Com_RxAccessInfo[218].RxDataTimeoutSubstitutionValueIdxOfRxAccessInfo Com_RxAccessInfo[218].RxDataTimeoutSubstitutionValueOfRxAccessInfo Com_RxAccessInfo[218].RxPduInfoIdxOfRxAccessInfo Com_RxAccessInfo[218].RxSigBufferArrayBasedBufferEndIdxOfRxAccessInfo Com_RxAccessInfo[218].RxSigBufferArrayBasedBufferStartIdxOfRxAccessInfo Com_RxAccessInfo[218].RxSigBufferArrayBasedShdBufferEndIdxOfRxAccessInfo Com_RxAccessInfo[218].RxSigBufferArrayBasedShdBufferStartIdxOfRxAccessInfo Com_RxAccessInfo[218].RxTOutInfoIdxOfRxAccessInfo Com_RxAccessInfo[218].ShdBufferIdxOfRxAccessInfo Com_RxAccessInfo[218].SignalLengthInByteOfRxAccessInfo Com_RxAccessInfo[218].StartByteInPduPositionOfRxAccessInfo Com_RxAccessInfo[218].TmpBufferIdxOfRxAccessInfo Com_RxAccessInfo[218].TmpBufferOfRxAccessInfo Com_RxAccessInfo[218].TmpRxShdBufferArrayBasedTmpBufferEndIdxOfRxAccessInfo Com_RxAccessInfo[218].TmpRxShdBufferArrayBasedTmpBufferStartIdxOfRxAccessInfo Com_RxAccessInfo[219].ApplTypeOfRxAccessInfo Com_RxAccessInfo[219].BitLengthOfRxAccessInfo Com_RxAccessInfo[219].BitPositionOfRxAccessInfo Com_RxAccessInfo[219].BufferIdxOfRxAccessInfo Com_RxAccessInfo[219].BusAccOfRxAccessInfo Com_RxAccessInfo[219].ByteLengthOfRxAccessInfo Com_RxAccessInfo[219].ConstValueArrayBasedInitValueEndIdxOfRxAccessInfo Com_RxAccessInfo[219].ConstValueArrayBasedInitValueStartIdxOfRxAccessInfo Com_RxAccessInfo[219].DynSignalOfRxAccessInfo Com_RxAccessInfo[219].InitValueIdxOfRxAccessInfo Com_RxAccessInfo[219].InitValueOfRxAccessInfo Com_RxAccessInfo[219].InvValueIdxOfRxAccessInfo Com_RxAccessInfo[219].InvValueOfRxAccessInfo Com_RxAccessInfo[219].IsGroupSignalOfRxAccessInfo Com_RxAccessInfo[219].RxDataTimeoutSubstitutionValueIdxOfRxAccessInfo Com_RxAccessInfo[219].RxDataTimeoutSubstitutionValueOfRxAccessInfo Com_RxAccessInfo[219].RxPduInfoIdxOfRxAccessInfo Com_RxAccessInfo[219].RxSigBufferArrayBasedBufferEndIdxOfRxAccessInfo Com_RxAccessInfo[219].RxSigBufferArrayBasedBufferStartIdxOfRxAccessInfo Com_RxAccessInfo[219].RxSigBufferArrayBasedShdBufferEndIdxOfRxAccessInfo Com_RxAccessInfo[219].RxSigBufferArrayBasedShdBufferStartIdxOfRxAccessInfo Com_RxAccessInfo[219].RxTOutInfoIdxOfRxAccessInfo Com_RxAccessInfo[219].ShdBufferIdxOfRxAccessInfo Com_RxAccessInfo[219].SignalLengthInByteOfRxAccessInfo Com_RxAccessInfo[219].StartByteInPduPositionOfRxAccessInfo Com_RxAccessInfo[219].TmpBufferIdxOfRxAccessInfo Com_RxAccessInfo[219].TmpBufferOfRxAccessInfo Com_RxAccessInfo[219].TmpRxShdBufferArrayBasedTmpBufferEndIdxOfRxAccessInfo Com_RxAccessInfo[219].TmpRxShdBufferArrayBasedTmpBufferStartIdxOfRxAccessInfo Com_RxAccessInfo[21].ApplTypeOfRxAccessInfo Com_RxAccessInfo[21].BitLengthOfRxAccessInfo Com_RxAccessInfo[21].BitPositionOfRxAccessInfo Com_RxAccessInfo[21].BufferIdxOfRxAccessInfo Com_RxAccessInfo[21].BusAccOfRxAccessInfo Com_RxAccessInfo[21].ByteLengthOfRxAccessInfo Com_RxAccessInfo[21].ConstValueArrayBasedInitValueEndIdxOfRxAccessInfo Com_RxAccessInfo[21].ConstValueArrayBasedInitValueStartIdxOfRxAccessInfo Com_RxAccessInfo[21].DynSignalOfRxAccessInfo Com_RxAccessInfo[21].InitValueIdxOfRxAccessInfo Com_RxAccessInfo[21].InitValueOfRxAccessInfo Com_RxAccessInfo[21].InvValueIdxOfRxAccessInfo Com_RxAccessInfo[21].InvValueOfRxAccessInfo Com_RxAccessInfo[21].IsGroupSignalOfRxAccessInfo Com_RxAccessInfo[21].RxDataTimeoutSubstitutionValueIdxOfRxAccessInfo Com_RxAccessInfo[21].RxDataTimeoutSubstitutionValueOfRxAccessInfo Com_RxAccessInfo[21].RxPduInfoIdxOfRxAccessInfo Com_RxAccessInfo[21].RxSigBufferArrayBasedBufferEndIdxOfRxAccessInfo Com_RxAccessInfo[21].RxSigBufferArrayBasedBufferStartIdxOfRxAccessInfo Com_RxAccessInfo[21].RxSigBufferArrayBasedShdBufferEndIdxOfRxAccessInfo Com_RxAccessInfo[21].RxSigBufferArrayBasedShdBufferStartIdxOfRxAccessInfo Com_RxAccessInfo[21].RxTOutInfoIdxOfRxAccessInfo Com_RxAccessInfo[21].ShdBufferIdxOfRxAccessInfo Com_RxAccessInfo[21].SignalLengthInByteOfRxAccessInfo Com_RxAccessInfo[21].StartByteInPduPositionOfRxAccessInfo Com_RxAccessInfo[21].TmpBufferIdxOfRxAccessInfo Com_RxAccessInfo[21].TmpBufferOfRxAccessInfo Com_RxAccessInfo[21].TmpRxShdBufferArrayBasedTmpBufferEndIdxOfRxAccessInfo Com_RxAccessInfo[21].TmpRxShdBufferArrayBasedTmpBufferStartIdxOfRxAccessInfo Com_RxAccessInfo[220].ApplTypeOfRxAccessInfo Com_RxAccessInfo[220].BitLengthOfRxAccessInfo Com_RxAccessInfo[220].BitPositionOfRxAccessInfo Com_RxAccessInfo[220].BufferIdxOfRxAccessInfo Com_RxAccessInfo[220].BusAccOfRxAccessInfo Com_RxAccessInfo[220].ByteLengthOfRxAccessInfo Com_RxAccessInfo[220].ConstValueArrayBasedInitValueEndIdxOfRxAccessInfo Com_RxAccessInfo[220].ConstValueArrayBasedInitValueStartIdxOfRxAccessInfo Com_RxAccessInfo[220].DynSignalOfRxAccessInfo Com_RxAccessInfo[220].InitValueIdxOfRxAccessInfo Com_RxAccessInfo[220].InitValueOfRxAccessInfo Com_RxAccessInfo[220].InvValueIdxOfRxAccessInfo Com_RxAccessInfo[220].InvValueOfRxAccessInfo Com_RxAccessInfo[220].IsGroupSignalOfRxAccessInfo Com_RxAccessInfo[220].RxDataTimeoutSubstitutionValueIdxOfRxAccessInfo Com_RxAccessInfo[220].RxDataTimeoutSubstitutionValueOfRxAccessInfo Com_RxAccessInfo[220].RxPduInfoIdxOfRxAccessInfo Com_RxAccessInfo[220].RxSigBufferArrayBasedBufferEndIdxOfRxAccessInfo Com_RxAccessInfo[220].RxSigBufferArrayBasedBufferStartIdxOfRxAccessInfo Com_RxAccessInfo[220].RxSigBufferArrayBasedShdBufferEndIdxOfRxAccessInfo Com_RxAccessInfo[220].RxSigBufferArrayBasedShdBufferStartIdxOfRxAccessInfo Com_RxAccessInfo[220].RxTOutInfoIdxOfRxAccessInfo Com_RxAccessInfo[220].ShdBufferIdxOfRxAccessInfo Com_RxAccessInfo[220].SignalLengthInByteOfRxAccessInfo Com_RxAccessInfo[220].StartByteInPduPositionOfRxAccessInfo Com_RxAccessInfo[220].TmpBufferIdxOfRxAccessInfo Com_RxAccessInfo[220].TmpBufferOfRxAccessInfo Com_RxAccessInfo[220].TmpRxShdBufferArrayBasedTmpBufferEndIdxOfRxAccessInfo Com_RxAccessInfo[220].TmpRxShdBufferArrayBasedTmpBufferStartIdxOfRxAccessInfo Com_RxAccessInfo[221].ApplTypeOfRxAccessInfo Com_RxAccessInfo[221].BitLengthOfRxAccessInfo Com_RxAccessInfo[221].BitPositionOfRxAccessInfo Com_RxAccessInfo[221].BufferIdxOfRxAccessInfo Com_RxAccessInfo[221].BusAccOfRxAccessInfo Com_RxAccessInfo[221].ByteLengthOfRxAccessInfo Com_RxAccessInfo[221].ConstValueArrayBasedInitValueEndIdxOfRxAccessInfo Com_RxAccessInfo[221].ConstValueArrayBasedInitValueStartIdxOfRxAccessInfo Com_RxAccessInfo[221].DynSignalOfRxAccessInfo Com_RxAccessInfo[221].InitValueIdxOfRxAccessInfo Com_RxAccessInfo[221].InitValueOfRxAccessInfo Com_RxAccessInfo[221].InvValueIdxOfRxAccessInfo Com_RxAccessInfo[221].InvValueOfRxAccessInfo Com_RxAccessInfo[221].IsGroupSignalOfRxAccessInfo Com_RxAccessInfo[221].RxDataTimeoutSubstitutionValueIdxOfRxAccessInfo Com_RxAccessInfo[221].RxDataTimeoutSubstitutionValueOfRxAccessInfo Com_RxAccessInfo[221].RxPduInfoIdxOfRxAccessInfo Com_RxAccessInfo[221].RxSigBufferArrayBasedBufferEndIdxOfRxAccessInfo Com_RxAccessInfo[221].RxSigBufferArrayBasedBufferStartIdxOfRxAccessInfo Com_RxAccessInfo[221].RxSigBufferArrayBasedShdBufferEndIdxOfRxAccessInfo Com_RxAccessInfo[221].RxSigBufferArrayBasedShdBufferStartIdxOfRxAccessInfo Com_RxAccessInfo[221].RxTOutInfoIdxOfRxAccessInfo Com_RxAccessInfo[221].ShdBufferIdxOfRxAccessInfo Com_RxAccessInfo[221].SignalLengthInByteOfRxAccessInfo Com_RxAccessInfo[221].StartByteInPduPositionOfRxAccessInfo Com_RxAccessInfo[221].TmpBufferIdxOfRxAccessInfo Com_RxAccessInfo[221].TmpBufferOfRxAccessInfo Com_RxAccessInfo[221].TmpRxShdBufferArrayBasedTmpBufferEndIdxOfRxAccessInfo Com_RxAccessInfo[221].TmpRxShdBufferArrayBasedTmpBufferStartIdxOfRxAccessInfo Com_RxAccessInfo[222].ApplTypeOfRxAccessInfo Com_RxAccessInfo[222].BitLengthOfRxAccessInfo Com_RxAccessInfo[222].BitPositionOfRxAccessInfo Com_RxAccessInfo[222].BufferIdxOfRxAccessInfo Com_RxAccessInfo[222].BusAccOfRxAccessInfo Com_RxAccessInfo[222].ByteLengthOfRxAccessInfo Com_RxAccessInfo[222].ConstValueArrayBasedInitValueEndIdxOfRxAccessInfo Com_RxAccessInfo[222].ConstValueArrayBasedInitValueStartIdxOfRxAccessInfo Com_RxAccessInfo[222].DynSignalOfRxAccessInfo Com_RxAccessInfo[222].InitValueIdxOfRxAccessInfo Com_RxAccessInfo[222].InitValueOfRxAccessInfo Com_RxAccessInfo[222].InvValueIdxOfRxAccessInfo Com_RxAccessInfo[222].InvValueOfRxAccessInfo Com_RxAccessInfo[222].IsGroupSignalOfRxAccessInfo Com_RxAccessInfo[222].RxDataTimeoutSubstitutionValueIdxOfRxAccessInfo Com_RxAccessInfo[222].RxDataTimeoutSubstitutionValueOfRxAccessInfo Com_RxAccessInfo[222].RxPduInfoIdxOfRxAccessInfo Com_RxAccessInfo[222].RxSigBufferArrayBasedBufferEndIdxOfRxAccessInfo Com_RxAccessInfo[222].RxSigBufferArrayBasedBufferStartIdxOfRxAccessInfo Com_RxAccessInfo[222].RxSigBufferArrayBasedShdBufferEndIdxOfRxAccessInfo Com_RxAccessInfo[222].RxSigBufferArrayBasedShdBufferStartIdxOfRxAccessInfo Com_RxAccessInfo[222].RxTOutInfoIdxOfRxAccessInfo Com_RxAccessInfo[222].ShdBufferIdxOfRxAccessInfo Com_RxAccessInfo[222].SignalLengthInByteOfRxAccessInfo Com_RxAccessInfo[222].StartByteInPduPositionOfRxAccessInfo Com_RxAccessInfo[222].TmpBufferIdxOfRxAccessInfo Com_RxAccessInfo[222].TmpBufferOfRxAccessInfo Com_RxAccessInfo[222].TmpRxShdBufferArrayBasedTmpBufferEndIdxOfRxAccessInfo Com_RxAccessInfo[222].TmpRxShdBufferArrayBasedTmpBufferStartIdxOfRxAccessInfo Com_RxAccessInfo[223].ApplTypeOfRxAccessInfo Com_RxAccessInfo[223].BitLengthOfRxAccessInfo Com_RxAccessInfo[223].BitPositionOfRxAccessInfo Com_RxAccessInfo[223].BufferIdxOfRxAccessInfo Com_RxAccessInfo[223].BusAccOfRxAccessInfo Com_RxAccessInfo[223].ByteLengthOfRxAccessInfo Com_RxAccessInfo[223].ConstValueArrayBasedInitValueEndIdxOfRxAccessInfo Com_RxAccessInfo[223].ConstValueArrayBasedInitValueStartIdxOfRxAccessInfo Com_RxAccessInfo[223].DynSignalOfRxAccessInfo Com_RxAccessInfo[223].InitValueIdxOfRxAccessInfo Com_RxAccessInfo[223].InitValueOfRxAccessInfo Com_RxAccessInfo[223].InvValueIdxOfRxAccessInfo Com_RxAccessInfo[223].InvValueOfRxAccessInfo Com_RxAccessInfo[223].IsGroupSignalOfRxAccessInfo Com_RxAccessInfo[223].RxDataTimeoutSubstitutionValueIdxOfRxAccessInfo Com_RxAccessInfo[223].RxDataTimeoutSubstitutionValueOfRxAccessInfo Com_RxAccessInfo[223].RxPduInfoIdxOfRxAccessInfo Com_RxAccessInfo[223].RxSigBufferArrayBasedBufferEndIdxOfRxAccessInfo Com_RxAccessInfo[223].RxSigBufferArrayBasedBufferStartIdxOfRxAccessInfo Com_RxAccessInfo[223].RxSigBufferArrayBasedShdBufferEndIdxOfRxAccessInfo Com_RxAccessInfo[223].RxSigBufferArrayBasedShdBufferStartIdxOfRxAccessInfo Com_RxAccessInfo[223].RxTOutInfoIdxOfRxAccessInfo Com_RxAccessInfo[223].ShdBufferIdxOfRxAccessInfo Com_RxAccessInfo[223].SignalLengthInByteOfRxAccessInfo Com_RxAccessInfo[223].StartByteInPduPositionOfRxAccessInfo Com_RxAccessInfo[223].TmpBufferIdxOfRxAccessInfo Com_RxAccessInfo[223].TmpBufferOfRxAccessInfo Com_RxAccessInfo[223].TmpRxShdBufferArrayBasedTmpBufferEndIdxOfRxAccessInfo Com_RxAccessInfo[223].TmpRxShdBufferArrayBasedTmpBufferStartIdxOfRxAccessInfo Com_RxAccessInfo[224].ApplTypeOfRxAccessInfo Com_RxAccessInfo[224].BitLengthOfRxAccessInfo Com_RxAccessInfo[224].BitPositionOfRxAccessInfo Com_RxAccessInfo[224].BufferIdxOfRxAccessInfo Com_RxAccessInfo[224].BusAccOfRxAccessInfo Com_RxAccessInfo[224].ByteLengthOfRxAccessInfo Com_RxAccessInfo[224].ConstValueArrayBasedInitValueEndIdxOfRxAccessInfo Com_RxAccessInfo[224].ConstValueArrayBasedInitValueStartIdxOfRxAccessInfo Com_RxAccessInfo[224].DynSignalOfRxAccessInfo Com_RxAccessInfo[224].InitValueIdxOfRxAccessInfo Com_RxAccessInfo[224].InitValueOfRxAccessInfo Com_RxAccessInfo[224].InvValueIdxOfRxAccessInfo Com_RxAccessInfo[224].InvValueOfRxAccessInfo Com_RxAccessInfo[224].IsGroupSignalOfRxAccessInfo Com_RxAccessInfo[224].RxDataTimeoutSubstitutionValueIdxOfRxAccessInfo Com_RxAccessInfo[224].RxDataTimeoutSubstitutionValueOfRxAccessInfo Com_RxAccessInfo[224].RxPduInfoIdxOfRxAccessInfo Com_RxAccessInfo[224].RxSigBufferArrayBasedBufferEndIdxOfRxAccessInfo Com_RxAccessInfo[224].RxSigBufferArrayBasedBufferStartIdxOfRxAccessInfo Com_RxAccessInfo[224].RxSigBufferArrayBasedShdBufferEndIdxOfRxAccessInfo Com_RxAccessInfo[224].RxSigBufferArrayBasedShdBufferStartIdxOfRxAccessInfo Com_RxAccessInfo[224].RxTOutInfoIdxOfRxAccessInfo Com_RxAccessInfo[224].ShdBufferIdxOfRxAccessInfo Com_RxAccessInfo[224].SignalLengthInByteOfRxAccessInfo Com_RxAccessInfo[224].StartByteInPduPositionOfRxAccessInfo Com_RxAccessInfo[224].TmpBufferIdxOfRxAccessInfo Com_RxAccessInfo[224].TmpBufferOfRxAccessInfo Com_RxAccessInfo[224].TmpRxShdBufferArrayBasedTmpBufferEndIdxOfRxAccessInfo /end REF_MEASUREMENT
/end GROUP
/end MODULE
/end PROJECT
