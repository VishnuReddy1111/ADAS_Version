ASAP2_VERSION 1 71
/begin PROJECT MICROSAR ""
/begin MODULE CPP ""
/begin MOD_COMMON "" BYTE_ORDER MSB_LAST ALIGNMENT_BYTE 1 ALIGNMENT_WORD 2 ALIGNMENT_LONG 4 ALIGNMENT_FLOAT16_IEEE 2 ALIGNMENT_FLOAT32_IEEE 4 ALIGNMENT_FLOAT64_IEEE 8 ALIGNMENT_INT64 8 /end MOD_COMMON
/begin MEASUREMENT Com_TxSigInfo[298].BusAccOfTxSigInfo "" UBYTE Com_BusAccOfTxSigInfoType 0 0 0 255 ECU_ADDRESS 0x0 /end MEASUREMENT
/begin MEASUREMENT Com_TxSigInfo[298].ByteLengthOfTxSigInfo "" UBYTE NO_COMPU_METHOD 0 0 0 255 ECU_ADDRESS 0x0 /end MEASUREMENT
/begin MEASUREMENT Com_TxSigInfo[298].DynSignalOfTxSigInfo "" UBYTE Com_DynSignalOfTxSigInfoType 0 0 0 1 ECU_ADDRESS 0x0 /end MEASUREMENT
/begin MEASUREMENT Com_TxSigInfo[298].FilterInitValueIdxOfTxSigInfo "" UBYTE Com_FilterInitValueIdxOfTxSigInfoType 0 0 0 255 ECU_ADDRESS 0x0 /end MEASUREMENT
/begin MEASUREMENT Com_TxSigInfo[298].FilterInitValueOfTxSigInfo "" UBYTE Com_FilterInitValueOfTxSigInfoType 0 0 0 255 ECU_ADDRESS 0x0 /end MEASUREMENT
/begin MEASUREMENT Com_TxSigInfo[298].InvValueIdxOfTxSigInfo "" UBYTE Com_InvValueIdxOfTxSigInfoType 0 0 0 255 ECU_ADDRESS 0x0 /end MEASUREMENT
/begin MEASUREMENT Com_TxSigInfo[298].InvValueOfTxSigInfo "" UBYTE Com_InvValueOfTxSigInfoType 0 0 0 255 ECU_ADDRESS 0x0 /end MEASUREMENT
/begin MEASUREMENT Com_TxSigInfo[298].OnChangeIdxOfTxSigInfo "" UBYTE Com_OnChangeIdxOfTxSigInfoType 0 0 0 255 ECU_ADDRESS 0x0 /end MEASUREMENT
/begin MEASUREMENT Com_TxSigInfo[298].OnChangeOfTxSigInfo "" UBYTE Com_OnChangeOfTxSigInfoType 0 0 0 255 ECU_ADDRESS 0x0 /end MEASUREMENT
/begin MEASUREMENT Com_TxSigInfo[298].StartByteInPduPositionOfTxSigInfo "" UBYTE NO_COMPU_METHOD 0 0 0 255 ECU_ADDRESS 0x0 /end MEASUREMENT
/begin MEASUREMENT Com_TxSigInfo[298].TxAccessInfoIdxOfTxSigInfo "" UWORD NO_COMPU_METHOD 0 0 0 65535 ECU_ADDRESS 0x0 /end MEASUREMENT
/begin MEASUREMENT Com_TxSigInfo[298].TxBufferEndIdxOfTxSigInfo "" UWORD Com_TxBufferEndIdxOfTxSigInfoType 0 0 0 65535 ECU_ADDRESS 0x0 /end MEASUREMENT
/begin MEASUREMENT Com_TxSigInfo[298].TxBufferStartIdxOfTxSigInfo "" UWORD Com_TxBufferStartIdxOfTxSigInfoType 0 0 0 65535 ECU_ADDRESS 0x0 /end MEASUREMENT
/begin MEASUREMENT Com_TxSigInfo[298].TxFilterInitValueArrayBasedFilterInitValueEndIdxOfTxSigInfo "" UBYTE Com_TxFilterInitValueArrayBasedFilterInitValueEndIdxOfTxSigInfoType 0 0 0 255 ECU_ADDRESS 0x0 /end MEASUREMENT
/begin MEASUREMENT Com_TxSigInfo[298].TxFilterInitValueArrayBasedFilterInitValueStartIdxOfTxSigInfo "" UBYTE Com_TxFilterInitValueArrayBasedFilterInitValueStartIdxOfTxSigInfoType 0 0 0 255 ECU_ADDRESS 0x0 /end MEASUREMENT
/begin MEASUREMENT Com_TxSigInfo[298].TxPduInfoIdxOfTxSigInfo "" UBYTE NO_COMPU_METHOD 0 0 0 255 ECU_ADDRESS 0x0 /end MEASUREMENT
/begin MEASUREMENT Com_TxSigInfo[299].ApplTypeOfTxSigInfo "" UBYTE Com_ApplTypeOfTxSigInfoType 0 0 0 255 ECU_ADDRESS 0x0 /end MEASUREMENT
/begin MEASUREMENT Com_TxSigInfo[299].BitLengthOfTxSigInfo "" UWORD NO_COMPU_METHOD 0 0 0 65535 ECU_ADDRESS 0x0 /end MEASUREMENT
/begin MEASUREMENT Com_TxSigInfo[299].BitPositionOfTxSigInfo "" UWORD NO_COMPU_METHOD 0 0 0 65535 ECU_ADDRESS 0x0 /end MEASUREMENT
/begin MEASUREMENT Com_TxSigInfo[299].BusAccOfTxSigInfo "" UBYTE Com_BusAccOfTxSigInfoType 0 0 0 255 ECU_ADDRESS 0x0 /end MEASUREMENT
/begin MEASUREMENT Com_TxSigInfo[299].ByteLengthOfTxSigInfo "" UBYTE NO_COMPU_METHOD 0 0 0 255 ECU_ADDRESS 0x0 /end MEASUREMENT
/begin MEASUREMENT Com_TxSigInfo[299].DynSignalOfTxSigInfo "" UBYTE Com_DynSignalOfTxSigInfoType 0 0 0 1 ECU_ADDRESS 0x0 /end MEASUREMENT
/begin MEASUREMENT Com_TxSigInfo[299].FilterInitValueIdxOfTxSigInfo "" UBYTE Com_FilterInitValueIdxOfTxSigInfoType 0 0 0 255 ECU_ADDRESS 0x0 /end MEASUREMENT
/begin MEASUREMENT Com_TxSigInfo[299].FilterInitValueOfTxSigInfo "" UBYTE Com_FilterInitValueOfTxSigInfoType 0 0 0 255 ECU_ADDRESS 0x0 /end MEASUREMENT
/begin MEASUREMENT Com_TxSigInfo[299].InvValueIdxOfTxSigInfo "" UBYTE Com_InvValueIdxOfTxSigInfoType 0 0 0 255 ECU_ADDRESS 0x0 /end MEASUREMENT
/begin MEASUREMENT Com_TxSigInfo[299].InvValueOfTxSigInfo "" UBYTE Com_InvValueOfTxSigInfoType 0 0 0 255 ECU_ADDRESS 0x0 /end MEASUREMENT
/begin MEASUREMENT Com_TxSigInfo[299].OnChangeIdxOfTxSigInfo "" UBYTE Com_OnChangeIdxOfTxSigInfoType 0 0 0 255 ECU_ADDRESS 0x0 /end MEASUREMENT
/begin MEASUREMENT Com_TxSigInfo[299].OnChangeOfTxSigInfo "" UBYTE Com_OnChangeOfTxSigInfoType 0 0 0 255 ECU_ADDRESS 0x0 /end MEASUREMENT
/begin MEASUREMENT Com_TxSigInfo[299].StartByteInPduPositionOfTxSigInfo "" UBYTE NO_COMPU_METHOD 0 0 0 255 ECU_ADDRESS 0x0 /end MEASUREMENT
/begin MEASUREMENT Com_TxSigInfo[299].TxAccessInfoIdxOfTxSigInfo "" UWORD NO_COMPU_METHOD 0 0 0 65535 ECU_ADDRESS 0x0 /end MEASUREMENT
/begin MEASUREMENT Com_TxSigInfo[299].TxBufferEndIdxOfTxSigInfo "" UWORD Com_TxBufferEndIdxOfTxSigInfoType 0 0 0 65535 ECU_ADDRESS 0x0 /end MEASUREMENT
/begin MEASUREMENT Com_TxSigInfo[299].TxBufferStartIdxOfTxSigInfo "" UWORD Com_TxBufferStartIdxOfTxSigInfoType 0 0 0 65535 ECU_ADDRESS 0x0 /end MEASUREMENT
/begin MEASUREMENT Com_TxSigInfo[299].TxFilterInitValueArrayBasedFilterInitValueEndIdxOfTxSigInfo "" UBYTE Com_TxFilterInitValueArrayBasedFilterInitValueEndIdxOfTxSigInfoType 0 0 0 255 ECU_ADDRESS 0x0 /end MEASUREMENT
/begin MEASUREMENT Com_TxSigInfo[299].TxFilterInitValueArrayBasedFilterInitValueStartIdxOfTxSigInfo "" UBYTE Com_TxFilterInitValueArrayBasedFilterInitValueStartIdxOfTxSigInfoType 0 0 0 255 ECU_ADDRESS 0x0 /end MEASUREMENT
/begin MEASUREMENT Com_TxSigInfo[299].TxPduInfoIdxOfTxSigInfo "" UBYTE NO_COMPU_METHOD 0 0 0 255 ECU_ADDRESS 0x0 /end MEASUREMENT
/begin MEASUREMENT Com_TxSigInfo[29].ApplTypeOfTxSigInfo "" UBYTE Com_ApplTypeOfTxSigInfoType 0 0 0 255 ECU_ADDRESS 0x0 /end MEASUREMENT
/begin MEASUREMENT Com_TxSigInfo[29].BitLengthOfTxSigInfo "" UWORD NO_COMPU_METHOD 0 0 0 65535 ECU_ADDRESS 0x0 /end MEASUREMENT
/begin MEASUREMENT Com_TxSigInfo[29].BitPositionOfTxSigInfo "" UWORD NO_COMPU_METHOD 0 0 0 65535 ECU_ADDRESS 0x0 /end MEASUREMENT
/begin MEASUREMENT Com_TxSigInfo[29].BusAccOfTxSigInfo "" UBYTE Com_BusAccOfTxSigInfoType 0 0 0 255 ECU_ADDRESS 0x0 /end MEASUREMENT
/begin MEASUREMENT Com_TxSigInfo[29].ByteLengthOfTxSigInfo "" UBYTE NO_COMPU_METHOD 0 0 0 255 ECU_ADDRESS 0x0 /end MEASUREMENT
/begin MEASUREMENT Com_TxSigInfo[29].DynSignalOfTxSigInfo "" UBYTE Com_DynSignalOfTxSigInfoType 0 0 0 1 ECU_ADDRESS 0x0 /end MEASUREMENT
/begin MEASUREMENT Com_TxSigInfo[29].FilterInitValueIdxOfTxSigInfo "" UBYTE Com_FilterInitValueIdxOfTxSigInfoType 0 0 0 255 ECU_ADDRESS 0x0 /end MEASUREMENT
/begin MEASUREMENT Com_TxSigInfo[29].FilterInitValueOfTxSigInfo "" UBYTE Com_FilterInitValueOfTxSigInfoType 0 0 0 255 ECU_ADDRESS 0x0 /end MEASUREMENT
/begin MEASUREMENT Com_TxSigInfo[29].InvValueIdxOfTxSigInfo "" UBYTE Com_InvValueIdxOfTxSigInfoType 0 0 0 255 ECU_ADDRESS 0x0 /end MEASUREMENT
/begin MEASUREMENT Com_TxSigInfo[29].InvValueOfTxSigInfo "" UBYTE Com_InvValueOfTxSigInfoType 0 0 0 255 ECU_ADDRESS 0x0 /end MEASUREMENT
/begin MEASUREMENT Com_TxSigInfo[29].OnChangeIdxOfTxSigInfo "" UBYTE Com_OnChangeIdxOfTxSigInfoType 0 0 0 255 ECU_ADDRESS 0x0 /end MEASUREMENT
/begin MEASUREMENT Com_TxSigInfo[29].OnChangeOfTxSigInfo "" UBYTE Com_OnChangeOfTxSigInfoType 0 0 0 255 ECU_ADDRESS 0x0 /end MEASUREMENT
/begin MEASUREMENT Com_TxSigInfo[29].StartByteInPduPositionOfTxSigInfo "" UBYTE NO_COMPU_METHOD 0 0 0 255 ECU_ADDRESS 0x0 /end MEASUREMENT
/begin MEASUREMENT Com_TxSigInfo[29].TxAccessInfoIdxOfTxSigInfo "" UWORD NO_COMPU_METHOD 0 0 0 65535 ECU_ADDRESS 0x0 /end MEASUREMENT
/begin MEASUREMENT Com_TxSigInfo[29].TxBufferEndIdxOfTxSigInfo "" UWORD Com_TxBufferEndIdxOfTxSigInfoType 0 0 0 65535 ECU_ADDRESS 0x0 /end MEASUREMENT
/begin MEASUREMENT Com_TxSigInfo[29].TxBufferStartIdxOfTxSigInfo "" UWORD Com_TxBufferStartIdxOfTxSigInfoType 0 0 0 65535 ECU_ADDRESS 0x0 /end MEASUREMENT
/begin MEASUREMENT Com_TxSigInfo[29].TxFilterInitValueArrayBasedFilterInitValueEndIdxOfTxSigInfo "" UBYTE Com_TxFilterInitValueArrayBasedFilterInitValueEndIdxOfTxSigInfoType 0 0 0 255 ECU_ADDRESS 0x0 /end MEASUREMENT
/begin MEASUREMENT Com_TxSigInfo[29].TxFilterInitValueArrayBasedFilterInitValueStartIdxOfTxSigInfo "" UBYTE Com_TxFilterInitValueArrayBasedFilterInitValueStartIdxOfTxSigInfoType 0 0 0 255 ECU_ADDRESS 0x0 /end MEASUREMENT
/begin MEASUREMENT Com_TxSigInfo[29].TxPduInfoIdxOfTxSigInfo "" UBYTE NO_COMPU_METHOD 0 0 0 255 ECU_ADDRESS 0x0 /end MEASUREMENT
/begin MEASUREMENT Com_TxSigInfo[2].ApplTypeOfTxSigInfo "" UBYTE Com_ApplTypeOfTxSigInfoType 0 0 0 255 ECU_ADDRESS 0x0 /end MEASUREMENT
/begin MEASUREMENT Com_TxSigInfo[2].BitLengthOfTxSigInfo "" UWORD NO_COMPU_METHOD 0 0 0 65535 ECU_ADDRESS 0x0 /end MEASUREMENT
/begin MEASUREMENT Com_TxSigInfo[2].BitPositionOfTxSigInfo "" UWORD NO_COMPU_METHOD 0 0 0 65535 ECU_ADDRESS 0x0 /end MEASUREMENT
/begin MEASUREMENT Com_TxSigInfo[2].BusAccOfTxSigInfo "" UBYTE Com_BusAccOfTxSigInfoType 0 0 0 255 ECU_ADDRESS 0x0 /end MEASUREMENT
/begin MEASUREMENT Com_TxSigInfo[2].ByteLengthOfTxSigInfo "" UBYTE NO_COMPU_METHOD 0 0 0 255 ECU_ADDRESS 0x0 /end MEASUREMENT
/begin MEASUREMENT Com_TxSigInfo[2].DynSignalOfTxSigInfo "" UBYTE Com_DynSignalOfTxSigInfoType 0 0 0 1 ECU_ADDRESS 0x0 /end MEASUREMENT
/begin MEASUREMENT Com_TxSigInfo[2].FilterInitValueIdxOfTxSigInfo "" UBYTE Com_FilterInitValueIdxOfTxSigInfoType 0 0 0 255 ECU_ADDRESS 0x0 /end MEASUREMENT
/begin MEASUREMENT Com_TxSigInfo[2].FilterInitValueOfTxSigInfo "" UBYTE Com_FilterInitValueOfTxSigInfoType 0 0 0 255 ECU_ADDRESS 0x0 /end MEASUREMENT
/begin MEASUREMENT Com_TxSigInfo[2].InvValueIdxOfTxSigInfo "" UBYTE Com_InvValueIdxOfTxSigInfoType 0 0 0 255 ECU_ADDRESS 0x0 /end MEASUREMENT
/begin MEASUREMENT Com_TxSigInfo[2].InvValueOfTxSigInfo "" UBYTE Com_InvValueOfTxSigInfoType 0 0 0 255 ECU_ADDRESS 0x0 /end MEASUREMENT
/begin MEASUREMENT Com_TxSigInfo[2].OnChangeIdxOfTxSigInfo "" UBYTE Com_OnChangeIdxOfTxSigInfoType 0 0 0 255 ECU_ADDRESS 0x0 /end MEASUREMENT
/begin MEASUREMENT Com_TxSigInfo[2].OnChangeOfTxSigInfo "" UBYTE Com_OnChangeOfTxSigInfoType 0 0 0 255 ECU_ADDRESS 0x0 /end MEASUREMENT
/begin MEASUREMENT Com_TxSigInfo[2].StartByteInPduPositionOfTxSigInfo "" UBYTE NO_COMPU_METHOD 0 0 0 255 ECU_ADDRESS 0x0 /end MEASUREMENT
/begin MEASUREMENT Com_TxSigInfo[2].TxAccessInfoIdxOfTxSigInfo "" UWORD NO_COMPU_METHOD 0 0 0 65535 ECU_ADDRESS 0x0 /end MEASUREMENT
/begin MEASUREMENT Com_TxSigInfo[2].TxBufferEndIdxOfTxSigInfo "" UWORD Com_TxBufferEndIdxOfTxSigInfoType 0 0 0 65535 ECU_ADDRESS 0x0 /end MEASUREMENT
/begin MEASUREMENT Com_TxSigInfo[2].TxBufferStartIdxOfTxSigInfo "" UWORD Com_TxBufferStartIdxOfTxSigInfoType 0 0 0 65535 ECU_ADDRESS 0x0 /end MEASUREMENT
/begin MEASUREMENT Com_TxSigInfo[2].TxFilterInitValueArrayBasedFilterInitValueEndIdxOfTxSigInfo "" UBYTE Com_TxFilterInitValueArrayBasedFilterInitValueEndIdxOfTxSigInfoType 0 0 0 255 ECU_ADDRESS 0x0 /end MEASUREMENT
/begin MEASUREMENT Com_TxSigInfo[2].TxFilterInitValueArrayBasedFilterInitValueStartIdxOfTxSigInfo "" UBYTE Com_TxFilterInitValueArrayBasedFilterInitValueStartIdxOfTxSigInfoType 0 0 0 255 ECU_ADDRESS 0x0 /end MEASUREMENT
/begin MEASUREMENT Com_TxSigInfo[2].TxPduInfoIdxOfTxSigInfo "" UBYTE NO_COMPU_METHOD 0 0 0 255 ECU_ADDRESS 0x0 /end MEASUREMENT
/begin MEASUREMENT Com_TxSigInfo[300].ApplTypeOfTxSigInfo "" UBYTE Com_ApplTypeOfTxSigInfoType 0 0 0 255 ECU_ADDRESS 0x0 /end MEASUREMENT
/begin MEASUREMENT Com_TxSigInfo[300].BitLengthOfTxSigInfo "" UWORD NO_COMPU_METHOD 0 0 0 65535 ECU_ADDRESS 0x0 /end MEASUREMENT
/begin MEASUREMENT Com_TxSigInfo[300].BitPositionOfTxSigInfo "" UWORD NO_COMPU_METHOD 0 0 0 65535 ECU_ADDRESS 0x0 /end MEASUREMENT
/begin MEASUREMENT Com_TxSigInfo[300].BusAccOfTxSigInfo "" UBYTE Com_BusAccOfTxSigInfoType 0 0 0 255 ECU_ADDRESS 0x0 /end MEASUREMENT
/begin MEASUREMENT Com_TxSigInfo[300].ByteLengthOfTxSigInfo "" UBYTE NO_COMPU_METHOD 0 0 0 255 ECU_ADDRESS 0x0 /end MEASUREMENT
/begin MEASUREMENT Com_TxSigInfo[300].DynSignalOfTxSigInfo "" UBYTE Com_DynSignalOfTxSigInfoType 0 0 0 1 ECU_ADDRESS 0x0 /end MEASUREMENT
/begin MEASUREMENT Com_TxSigInfo[300].FilterInitValueIdxOfTxSigInfo "" UBYTE Com_FilterInitValueIdxOfTxSigInfoType 0 0 0 255 ECU_ADDRESS 0x0 /end MEASUREMENT
/begin MEASUREMENT Com_TxSigInfo[300].FilterInitValueOfTxSigInfo "" UBYTE Com_FilterInitValueOfTxSigInfoType 0 0 0 255 ECU_ADDRESS 0x0 /end MEASUREMENT
/begin MEASUREMENT Com_TxSigInfo[300].InvValueIdxOfTxSigInfo "" UBYTE Com_InvValueIdxOfTxSigInfoType 0 0 0 255 ECU_ADDRESS 0x0 /end MEASUREMENT
/begin MEASUREMENT Com_TxSigInfo[300].InvValueOfTxSigInfo "" UBYTE Com_InvValueOfTxSigInfoType 0 0 0 255 ECU_ADDRESS 0x0 /end MEASUREMENT
/begin MEASUREMENT Com_TxSigInfo[300].OnChangeIdxOfTxSigInfo "" UBYTE Com_OnChangeIdxOfTxSigInfoType 0 0 0 255 ECU_ADDRESS 0x0 /end MEASUREMENT
/begin MEASUREMENT Com_TxSigInfo[300].OnChangeOfTxSigInfo "" UBYTE Com_OnChangeOfTxSigInfoType 0 0 0 255 ECU_ADDRESS 0x0 /end MEASUREMENT
/begin MEASUREMENT Com_TxSigInfo[300].StartByteInPduPositionOfTxSigInfo "" UBYTE NO_COMPU_METHOD 0 0 0 255 ECU_ADDRESS 0x0 /end MEASUREMENT
/begin MEASUREMENT Com_TxSigInfo[300].TxAccessInfoIdxOfTxSigInfo "" UWORD NO_COMPU_METHOD 0 0 0 65535 ECU_ADDRESS 0x0 /end MEASUREMENT
/begin MEASUREMENT Com_TxSigInfo[300].TxBufferEndIdxOfTxSigInfo "" UWORD Com_TxBufferEndIdxOfTxSigInfoType 0 0 0 65535 ECU_ADDRESS 0x0 /end MEASUREMENT
/begin MEASUREMENT Com_TxSigInfo[300].TxBufferStartIdxOfTxSigInfo "" UWORD Com_TxBufferStartIdxOfTxSigInfoType 0 0 0 65535 ECU_ADDRESS 0x0 /end MEASUREMENT
/begin MEASUREMENT Com_TxSigInfo[300].TxFilterInitValueArrayBasedFilterInitValueEndIdxOfTxSigInfo "" UBYTE Com_TxFilterInitValueArrayBasedFilterInitValueEndIdxOfTxSigInfoType 0 0 0 255 ECU_ADDRESS 0x0 /end MEASUREMENT
/begin MEASUREMENT Com_TxSigInfo[300].TxFilterInitValueArrayBasedFilterInitValueStartIdxOfTxSigInfo "" UBYTE Com_TxFilterInitValueArrayBasedFilterInitValueStartIdxOfTxSigInfoType 0 0 0 255 ECU_ADDRESS 0x0 /end MEASUREMENT
/begin MEASUREMENT Com_TxSigInfo[300].TxPduInfoIdxOfTxSigInfo "" UBYTE NO_COMPU_METHOD 0 0 0 255 ECU_ADDRESS 0x0 /end MEASUREMENT
/begin MEASUREMENT Com_TxSigInfo[301].ApplTypeOfTxSigInfo "" UBYTE Com_ApplTypeOfTxSigInfoType 0 0 0 255 ECU_ADDRESS 0x0 /end MEASUREMENT
/begin MEASUREMENT Com_TxSigInfo[301].BitLengthOfTxSigInfo "" UWORD NO_COMPU_METHOD 0 0 0 65535 ECU_ADDRESS 0x0 /end MEASUREMENT
/begin MEASUREMENT Com_TxSigInfo[301].BitPositionOfTxSigInfo "" UWORD NO_COMPU_METHOD 0 0 0 65535 ECU_ADDRESS 0x0 /end MEASUREMENT
/begin MEASUREMENT Com_TxSigInfo[301].BusAccOfTxSigInfo "" UBYTE Com_BusAccOfTxSigInfoType 0 0 0 255 ECU_ADDRESS 0x0 /end MEASUREMENT
/begin MEASUREMENT Com_TxSigInfo[301].ByteLengthOfTxSigInfo "" UBYTE NO_COMPU_METHOD 0 0 0 255 ECU_ADDRESS 0x0 /end MEASUREMENT
/begin MEASUREMENT Com_TxSigInfo[301].DynSignalOfTxSigInfo "" UBYTE Com_DynSignalOfTxSigInfoType 0 0 0 1 ECU_ADDRESS 0x0 /end MEASUREMENT
/begin MEASUREMENT Com_TxSigInfo[301].FilterInitValueIdxOfTxSigInfo "" UBYTE Com_FilterInitValueIdxOfTxSigInfoType 0 0 0 255 ECU_ADDRESS 0x0 /end MEASUREMENT
/begin MEASUREMENT Com_TxSigInfo[301].FilterInitValueOfTxSigInfo "" UBYTE Com_FilterInitValueOfTxSigInfoType 0 0 0 255 ECU_ADDRESS 0x0 /end MEASUREMENT
/begin MEASUREMENT Com_TxSigInfo[301].InvValueIdxOfTxSigInfo "" UBYTE Com_InvValueIdxOfTxSigInfoType 0 0 0 255 ECU_ADDRESS 0x0 /end MEASUREMENT
/begin MEASUREMENT Com_TxSigInfo[301].InvValueOfTxSigInfo "" UBYTE Com_InvValueOfTxSigInfoType 0 0 0 255 ECU_ADDRESS 0x0 /end MEASUREMENT
/begin MEASUREMENT Com_TxSigInfo[301].OnChangeIdxOfTxSigInfo "" UBYTE Com_OnChangeIdxOfTxSigInfoType 0 0 0 255 ECU_ADDRESS 0x0 /end MEASUREMENT
/begin MEASUREMENT Com_TxSigInfo[301].OnChangeOfTxSigInfo "" UBYTE Com_OnChangeOfTxSigInfoType 0 0 0 255 ECU_ADDRESS 0x0 /end MEASUREMENT
/begin MEASUREMENT Com_TxSigInfo[301].StartByteInPduPositionOfTxSigInfo "" UBYTE NO_COMPU_METHOD 0 0 0 255 ECU_ADDRESS 0x0 /end MEASUREMENT
/begin MEASUREMENT Com_TxSigInfo[301].TxAccessInfoIdxOfTxSigInfo "" UWORD NO_COMPU_METHOD 0 0 0 65535 ECU_ADDRESS 0x0 /end MEASUREMENT
/begin MEASUREMENT Com_TxSigInfo[301].TxBufferEndIdxOfTxSigInfo "" UWORD Com_TxBufferEndIdxOfTxSigInfoType 0 0 0 65535 ECU_ADDRESS 0x0 /end MEASUREMENT
/begin MEASUREMENT Com_TxSigInfo[301].TxBufferStartIdxOfTxSigInfo "" UWORD Com_TxBufferStartIdxOfTxSigInfoType 0 0 0 65535 ECU_ADDRESS 0x0 /end MEASUREMENT
/begin MEASUREMENT Com_TxSigInfo[301].TxFilterInitValueArrayBasedFilterInitValueEndIdxOfTxSigInfo "" UBYTE Com_TxFilterInitValueArrayBasedFilterInitValueEndIdxOfTxSigInfoType 0 0 0 255 ECU_ADDRESS 0x0 /end MEASUREMENT
/begin MEASUREMENT Com_TxSigInfo[301].TxFilterInitValueArrayBasedFilterInitValueStartIdxOfTxSigInfo "" UBYTE Com_TxFilterInitValueArrayBasedFilterInitValueStartIdxOfTxSigInfoType 0 0 0 255 ECU_ADDRESS 0x0 /end MEASUREMENT
/begin MEASUREMENT Com_TxSigInfo[301].TxPduInfoIdxOfTxSigInfo "" UBYTE NO_COMPU_METHOD 0 0 0 255 ECU_ADDRESS 0x0 /end MEASUREMENT
/begin MEASUREMENT Com_TxSigInfo[302].ApplTypeOfTxSigInfo "" UBYTE Com_ApplTypeOfTxSigInfoType 0 0 0 255 ECU_ADDRESS 0x0 /end MEASUREMENT
/begin MEASUREMENT Com_TxSigInfo[302].BitLengthOfTxSigInfo "" UWORD NO_COMPU_METHOD 0 0 0 65535 ECU_ADDRESS 0x0 /end MEASUREMENT
/begin MEASUREMENT Com_TxSigInfo[302].BitPositionOfTxSigInfo "" UWORD NO_COMPU_METHOD 0 0 0 65535 ECU_ADDRESS 0x0 /end MEASUREMENT
/begin MEASUREMENT Com_TxSigInfo[302].BusAccOfTxSigInfo "" UBYTE Com_BusAccOfTxSigInfoType 0 0 0 255 ECU_ADDRESS 0x0 /end MEASUREMENT
/begin MEASUREMENT Com_TxSigInfo[302].ByteLengthOfTxSigInfo "" UBYTE NO_COMPU_METHOD 0 0 0 255 ECU_ADDRESS 0x0 /end MEASUREMENT
/begin MEASUREMENT Com_TxSigInfo[302].DynSignalOfTxSigInfo "" UBYTE Com_DynSignalOfTxSigInfoType 0 0 0 1 ECU_ADDRESS 0x0 /end MEASUREMENT
/begin MEASUREMENT Com_TxSigInfo[302].FilterInitValueIdxOfTxSigInfo "" UBYTE Com_FilterInitValueIdxOfTxSigInfoType 0 0 0 255 ECU_ADDRESS 0x0 /end MEASUREMENT
/begin MEASUREMENT Com_TxSigInfo[302].FilterInitValueOfTxSigInfo "" UBYTE Com_FilterInitValueOfTxSigInfoType 0 0 0 255 ECU_ADDRESS 0x0 /end MEASUREMENT
/begin MEASUREMENT Com_TxSigInfo[302].InvValueIdxOfTxSigInfo "" UBYTE Com_InvValueIdxOfTxSigInfoType 0 0 0 255 ECU_ADDRESS 0x0 /end MEASUREMENT
/begin MEASUREMENT Com_TxSigInfo[302].InvValueOfTxSigInfo "" UBYTE Com_InvValueOfTxSigInfoType 0 0 0 255 ECU_ADDRESS 0x0 /end MEASUREMENT
/begin MEASUREMENT Com_TxSigInfo[302].OnChangeIdxOfTxSigInfo "" UBYTE Com_OnChangeIdxOfTxSigInfoType 0 0 0 255 ECU_ADDRESS 0x0 /end MEASUREMENT
/begin MEASUREMENT Com_TxSigInfo[302].OnChangeOfTxSigInfo "" UBYTE Com_OnChangeOfTxSigInfoType 0 0 0 255 ECU_ADDRESS 0x0 /end MEASUREMENT
/begin MEASUREMENT Com_TxSigInfo[302].StartByteInPduPositionOfTxSigInfo "" UBYTE NO_COMPU_METHOD 0 0 0 255 ECU_ADDRESS 0x0 /end MEASUREMENT
/begin MEASUREMENT Com_TxSigInfo[302].TxAccessInfoIdxOfTxSigInfo "" UWORD NO_COMPU_METHOD 0 0 0 65535 ECU_ADDRESS 0x0 /end MEASUREMENT
/begin MEASUREMENT Com_TxSigInfo[302].TxBufferEndIdxOfTxSigInfo "" UWORD Com_TxBufferEndIdxOfTxSigInfoType 0 0 0 65535 ECU_ADDRESS 0x0 /end MEASUREMENT
/begin MEASUREMENT Com_TxSigInfo[302].TxBufferStartIdxOfTxSigInfo "" UWORD Com_TxBufferStartIdxOfTxSigInfoType 0 0 0 65535 ECU_ADDRESS 0x0 /end MEASUREMENT
/begin MEASUREMENT Com_TxSigInfo[302].TxFilterInitValueArrayBasedFilterInitValueEndIdxOfTxSigInfo "" UBYTE Com_TxFilterInitValueArrayBasedFilterInitValueEndIdxOfTxSigInfoType 0 0 0 255 ECU_ADDRESS 0x0 /end MEASUREMENT
/begin MEASUREMENT Com_TxSigInfo[302].TxFilterInitValueArrayBasedFilterInitValueStartIdxOfTxSigInfo "" UBYTE Com_TxFilterInitValueArrayBasedFilterInitValueStartIdxOfTxSigInfoType 0 0 0 255 ECU_ADDRESS 0x0 /end MEASUREMENT
/begin MEASUREMENT Com_TxSigInfo[302].TxPduInfoIdxOfTxSigInfo "" UBYTE NO_COMPU_METHOD 0 0 0 255 ECU_ADDRESS 0x0 /end MEASUREMENT
/begin MEASUREMENT Com_TxSigInfo[303].ApplTypeOfTxSigInfo "" UBYTE Com_ApplTypeOfTxSigInfoType 0 0 0 255 ECU_ADDRESS 0x0 /end MEASUREMENT
/begin MEASUREMENT Com_TxSigInfo[303].BitLengthOfTxSigInfo "" UWORD NO_COMPU_METHOD 0 0 0 65535 ECU_ADDRESS 0x0 /end MEASUREMENT
/begin MEASUREMENT Com_TxSigInfo[303].BitPositionOfTxSigInfo "" UWORD NO_COMPU_METHOD 0 0 0 65535 ECU_ADDRESS 0x0 /end MEASUREMENT
/begin MEASUREMENT Com_TxSigInfo[303].BusAccOfTxSigInfo "" UBYTE Com_BusAccOfTxSigInfoType 0 0 0 255 ECU_ADDRESS 0x0 /end MEASUREMENT
/begin MEASUREMENT Com_TxSigInfo[303].ByteLengthOfTxSigInfo "" UBYTE NO_COMPU_METHOD 0 0 0 255 ECU_ADDRESS 0x0 /end MEASUREMENT
/begin MEASUREMENT Com_TxSigInfo[303].DynSignalOfTxSigInfo "" UBYTE Com_DynSignalOfTxSigInfoType 0 0 0 1 ECU_ADDRESS 0x0 /end MEASUREMENT
/begin MEASUREMENT Com_TxSigInfo[303].FilterInitValueIdxOfTxSigInfo "" UBYTE Com_FilterInitValueIdxOfTxSigInfoType 0 0 0 255 ECU_ADDRESS 0x0 /end MEASUREMENT
/begin MEASUREMENT Com_TxSigInfo[303].FilterInitValueOfTxSigInfo "" UBYTE Com_FilterInitValueOfTxSigInfoType 0 0 0 255 ECU_ADDRESS 0x0 /end MEASUREMENT
/begin MEASUREMENT Com_TxSigInfo[303].InvValueIdxOfTxSigInfo "" UBYTE Com_InvValueIdxOfTxSigInfoType 0 0 0 255 ECU_ADDRESS 0x0 /end MEASUREMENT
/begin MEASUREMENT Com_TxSigInfo[303].InvValueOfTxSigInfo "" UBYTE Com_InvValueOfTxSigInfoType 0 0 0 255 ECU_ADDRESS 0x0 /end MEASUREMENT
/begin MEASUREMENT Com_TxSigInfo[303].OnChangeIdxOfTxSigInfo "" UBYTE Com_OnChangeIdxOfTxSigInfoType 0 0 0 255 ECU_ADDRESS 0x0 /end MEASUREMENT
/begin MEASUREMENT Com_TxSigInfo[303].OnChangeOfTxSigInfo "" UBYTE Com_OnChangeOfTxSigInfoType 0 0 0 255 ECU_ADDRESS 0x0 /end MEASUREMENT
/begin MEASUREMENT Com_TxSigInfo[303].StartByteInPduPositionOfTxSigInfo "" UBYTE NO_COMPU_METHOD 0 0 0 255 ECU_ADDRESS 0x0 /end MEASUREMENT
/begin MEASUREMENT Com_TxSigInfo[303].TxAccessInfoIdxOfTxSigInfo "" UWORD NO_COMPU_METHOD 0 0 0 65535 ECU_ADDRESS 0x0 /end MEASUREMENT
/begin MEASUREMENT Com_TxSigInfo[303].TxBufferEndIdxOfTxSigInfo "" UWORD Com_TxBufferEndIdxOfTxSigInfoType 0 0 0 65535 ECU_ADDRESS 0x0 /end MEASUREMENT
/begin MEASUREMENT Com_TxSigInfo[303].TxBufferStartIdxOfTxSigInfo "" UWORD Com_TxBufferStartIdxOfTxSigInfoType 0 0 0 65535 ECU_ADDRESS 0x0 /end MEASUREMENT
/begin MEASUREMENT Com_TxSigInfo[303].TxFilterInitValueArrayBasedFilterInitValueEndIdxOfTxSigInfo "" UBYTE Com_TxFilterInitValueArrayBasedFilterInitValueEndIdxOfTxSigInfoType 0 0 0 255 ECU_ADDRESS 0x0 /end MEASUREMENT
/begin MEASUREMENT Com_TxSigInfo[303].TxFilterInitValueArrayBasedFilterInitValueStartIdxOfTxSigInfo "" UBYTE Com_TxFilterInitValueArrayBasedFilterInitValueStartIdxOfTxSigInfoType 0 0 0 255 ECU_ADDRESS 0x0 /end MEASUREMENT
/begin MEASUREMENT Com_TxSigInfo[303].TxPduInfoIdxOfTxSigInfo "" UBYTE NO_COMPU_METHOD 0 0 0 255 ECU_ADDRESS 0x0 /end MEASUREMENT
/begin MEASUREMENT Com_TxSigInfo[304].ApplTypeOfTxSigInfo "" UBYTE Com_ApplTypeOfTxSigInfoType 0 0 0 255 ECU_ADDRESS 0x0 /end MEASUREMENT
/begin MEASUREMENT Com_TxSigInfo[304].BitLengthOfTxSigInfo "" UWORD NO_COMPU_METHOD 0 0 0 65535 ECU_ADDRESS 0x0 /end MEASUREMENT
/begin MEASUREMENT Com_TxSigInfo[304].BitPositionOfTxSigInfo "" UWORD NO_COMPU_METHOD 0 0 0 65535 ECU_ADDRESS 0x0 /end MEASUREMENT
/begin MEASUREMENT Com_TxSigInfo[304].BusAccOfTxSigInfo "" UBYTE Com_BusAccOfTxSigInfoType 0 0 0 255 ECU_ADDRESS 0x0 /end MEASUREMENT
/begin MEASUREMENT Com_TxSigInfo[304].ByteLengthOfTxSigInfo "" UBYTE NO_COMPU_METHOD 0 0 0 255 ECU_ADDRESS 0x0 /end MEASUREMENT
/begin MEASUREMENT Com_TxSigInfo[304].DynSignalOfTxSigInfo "" UBYTE Com_DynSignalOfTxSigInfoType 0 0 0 1 ECU_ADDRESS 0x0 /end MEASUREMENT
/begin MEASUREMENT Com_TxSigInfo[304].FilterInitValueIdxOfTxSigInfo "" UBYTE Com_FilterInitValueIdxOfTxSigInfoType 0 0 0 255 ECU_ADDRESS 0x0 /end MEASUREMENT
/begin MEASUREMENT Com_TxSigInfo[304].FilterInitValueOfTxSigInfo "" UBYTE Com_FilterInitValueOfTxSigInfoType 0 0 0 255 ECU_ADDRESS 0x0 /end MEASUREMENT
/begin MEASUREMENT Com_TxSigInfo[304].InvValueIdxOfTxSigInfo "" UBYTE Com_InvValueIdxOfTxSigInfoType 0 0 0 255 ECU_ADDRESS 0x0 /end MEASUREMENT
/begin MEASUREMENT Com_TxSigInfo[304].InvValueOfTxSigInfo "" UBYTE Com_InvValueOfTxSigInfoType 0 0 0 255 ECU_ADDRESS 0x0 /end MEASUREMENT
/begin MEASUREMENT Com_TxSigInfo[304].OnChangeIdxOfTxSigInfo "" UBYTE Com_OnChangeIdxOfTxSigInfoType 0 0 0 255 ECU_ADDRESS 0x0 /end MEASUREMENT
/begin MEASUREMENT Com_TxSigInfo[304].OnChangeOfTxSigInfo "" UBYTE Com_OnChangeOfTxSigInfoType 0 0 0 255 ECU_ADDRESS 0x0 /end MEASUREMENT
/begin MEASUREMENT Com_TxSigInfo[304].StartByteInPduPositionOfTxSigInfo "" UBYTE NO_COMPU_METHOD 0 0 0 255 ECU_ADDRESS 0x0 /end MEASUREMENT
/begin MEASUREMENT Com_TxSigInfo[304].TxAccessInfoIdxOfTxSigInfo "" UWORD NO_COMPU_METHOD 0 0 0 65535 ECU_ADDRESS 0x0 /end MEASUREMENT
/begin MEASUREMENT Com_TxSigInfo[304].TxBufferEndIdxOfTxSigInfo "" UWORD Com_TxBufferEndIdxOfTxSigInfoType 0 0 0 65535 ECU_ADDRESS 0x0 /end MEASUREMENT
/begin MEASUREMENT Com_TxSigInfo[304].TxBufferStartIdxOfTxSigInfo "" UWORD Com_TxBufferStartIdxOfTxSigInfoType 0 0 0 65535 ECU_ADDRESS 0x0 /end MEASUREMENT
/begin MEASUREMENT Com_TxSigInfo[304].TxFilterInitValueArrayBasedFilterInitValueEndIdxOfTxSigInfo "" UBYTE Com_TxFilterInitValueArrayBasedFilterInitValueEndIdxOfTxSigInfoType 0 0 0 255 ECU_ADDRESS 0x0 /end MEASUREMENT
/begin MEASUREMENT Com_TxSigInfo[304].TxFilterInitValueArrayBasedFilterInitValueStartIdxOfTxSigInfo "" UBYTE Com_TxFilterInitValueArrayBasedFilterInitValueStartIdxOfTxSigInfoType 0 0 0 255 ECU_ADDRESS 0x0 /end MEASUREMENT
/begin MEASUREMENT Com_TxSigInfo[304].TxPduInfoIdxOfTxSigInfo "" UBYTE NO_COMPU_METHOD 0 0 0 255 ECU_ADDRESS 0x0 /end MEASUREMENT
/begin MEASUREMENT Com_TxSigInfo[305].ApplTypeOfTxSigInfo "" UBYTE Com_ApplTypeOfTxSigInfoType 0 0 0 255 ECU_ADDRESS 0x0 /end MEASUREMENT
/begin MEASUREMENT Com_TxSigInfo[305].BitLengthOfTxSigInfo "" UWORD NO_COMPU_METHOD 0 0 0 65535 ECU_ADDRESS 0x0 /end MEASUREMENT
/begin MEASUREMENT Com_TxSigInfo[305].BitPositionOfTxSigInfo "" UWORD NO_COMPU_METHOD 0 0 0 65535 ECU_ADDRESS 0x0 /end MEASUREMENT
/begin MEASUREMENT Com_TxSigInfo[305].BusAccOfTxSigInfo "" UBYTE Com_BusAccOfTxSigInfoType 0 0 0 255 ECU_ADDRESS 0x0 /end MEASUREMENT
/begin MEASUREMENT Com_TxSigInfo[305].ByteLengthOfTxSigInfo "" UBYTE NO_COMPU_METHOD 0 0 0 255 ECU_ADDRESS 0x0 /end MEASUREMENT
/begin MEASUREMENT Com_TxSigInfo[305].DynSignalOfTxSigInfo "" UBYTE Com_DynSignalOfTxSigInfoType 0 0 0 1 ECU_ADDRESS 0x0 /end MEASUREMENT
/begin MEASUREMENT Com_TxSigInfo[305].FilterInitValueIdxOfTxSigInfo "" UBYTE Com_FilterInitValueIdxOfTxSigInfoType 0 0 0 255 ECU_ADDRESS 0x0 /end MEASUREMENT
/begin MEASUREMENT Com_TxSigInfo[305].FilterInitValueOfTxSigInfo "" UBYTE Com_FilterInitValueOfTxSigInfoType 0 0 0 255 ECU_ADDRESS 0x0 /end MEASUREMENT
/begin MEASUREMENT Com_TxSigInfo[305].InvValueIdxOfTxSigInfo "" UBYTE Com_InvValueIdxOfTxSigInfoType 0 0 0 255 ECU_ADDRESS 0x0 /end MEASUREMENT
/begin MEASUREMENT Com_TxSigInfo[305].InvValueOfTxSigInfo "" UBYTE Com_InvValueOfTxSigInfoType 0 0 0 255 ECU_ADDRESS 0x0 /end MEASUREMENT
/begin MEASUREMENT Com_TxSigInfo[305].OnChangeIdxOfTxSigInfo "" UBYTE Com_OnChangeIdxOfTxSigInfoType 0 0 0 255 ECU_ADDRESS 0x0 /end MEASUREMENT
/begin MEASUREMENT Com_TxSigInfo[305].OnChangeOfTxSigInfo "" UBYTE Com_OnChangeOfTxSigInfoType 0 0 0 255 ECU_ADDRESS 0x0 /end MEASUREMENT
/begin MEASUREMENT Com_TxSigInfo[305].StartByteInPduPositionOfTxSigInfo "" UBYTE NO_COMPU_METHOD 0 0 0 255 ECU_ADDRESS 0x0 /end MEASUREMENT
/begin MEASUREMENT Com_TxSigInfo[305].TxAccessInfoIdxOfTxSigInfo "" UWORD NO_COMPU_METHOD 0 0 0 65535 ECU_ADDRESS 0x0 /end MEASUREMENT
/begin MEASUREMENT Com_TxSigInfo[305].TxBufferEndIdxOfTxSigInfo "" UWORD Com_TxBufferEndIdxOfTxSigInfoType 0 0 0 65535 ECU_ADDRESS 0x0 /end MEASUREMENT
/begin MEASUREMENT Com_TxSigInfo[305].TxBufferStartIdxOfTxSigInfo "" UWORD Com_TxBufferStartIdxOfTxSigInfoType 0 0 0 65535 ECU_ADDRESS 0x0 /end MEASUREMENT
/begin MEASUREMENT Com_TxSigInfo[305].TxFilterInitValueArrayBasedFilterInitValueEndIdxOfTxSigInfo "" UBYTE Com_TxFilterInitValueArrayBasedFilterInitValueEndIdxOfTxSigInfoType 0 0 0 255 ECU_ADDRESS 0x0 /end MEASUREMENT
/begin MEASUREMENT Com_TxSigInfo[305].TxFilterInitValueArrayBasedFilterInitValueStartIdxOfTxSigInfo "" UBYTE Com_TxFilterInitValueArrayBasedFilterInitValueStartIdxOfTxSigInfoType 0 0 0 255 ECU_ADDRESS 0x0 /end MEASUREMENT
/begin MEASUREMENT Com_TxSigInfo[305].TxPduInfoIdxOfTxSigInfo "" UBYTE NO_COMPU_METHOD 0 0 0 255 ECU_ADDRESS 0x0 /end MEASUREMENT
/begin MEASUREMENT Com_TxSigInfo[306].ApplTypeOfTxSigInfo "" UBYTE Com_ApplTypeOfTxSigInfoType 0 0 0 255 ECU_ADDRESS 0x0 /end MEASUREMENT
/begin MEASUREMENT Com_TxSigInfo[306].BitLengthOfTxSigInfo "" UWORD NO_COMPU_METHOD 0 0 0 65535 ECU_ADDRESS 0x0 /end MEASUREMENT
/begin MEASUREMENT Com_TxSigInfo[306].BitPositionOfTxSigInfo "" UWORD NO_COMPU_METHOD 0 0 0 65535 ECU_ADDRESS 0x0 /end MEASUREMENT
/begin MEASUREMENT Com_TxSigInfo[306].BusAccOfTxSigInfo "" UBYTE Com_BusAccOfTxSigInfoType 0 0 0 255 ECU_ADDRESS 0x0 /end MEASUREMENT
/begin MEASUREMENT Com_TxSigInfo[306].ByteLengthOfTxSigInfo "" UBYTE NO_COMPU_METHOD 0 0 0 255 ECU_ADDRESS 0x0 /end MEASUREMENT
/begin MEASUREMENT Com_TxSigInfo[306].DynSignalOfTxSigInfo "" UBYTE Com_DynSignalOfTxSigInfoType 0 0 0 1 ECU_ADDRESS 0x0 /end MEASUREMENT
/begin MEASUREMENT Com_TxSigInfo[306].FilterInitValueIdxOfTxSigInfo "" UBYTE Com_FilterInitValueIdxOfTxSigInfoType 0 0 0 255 ECU_ADDRESS 0x0 /end MEASUREMENT
/begin MEASUREMENT Com_TxSigInfo[306].FilterInitValueOfTxSigInfo "" UBYTE Com_FilterInitValueOfTxSigInfoType 0 0 0 255 ECU_ADDRESS 0x0 /end MEASUREMENT
/begin MEASUREMENT Com_TxSigInfo[306].InvValueIdxOfTxSigInfo "" UBYTE Com_InvValueIdxOfTxSigInfoType 0 0 0 255 ECU_ADDRESS 0x0 /end MEASUREMENT
/begin MEASUREMENT Com_TxSigInfo[306].InvValueOfTxSigInfo "" UBYTE Com_InvValueOfTxSigInfoType 0 0 0 255 ECU_ADDRESS 0x0 /end MEASUREMENT
/begin MEASUREMENT Com_TxSigInfo[306].OnChangeIdxOfTxSigInfo "" UBYTE Com_OnChangeIdxOfTxSigInfoType 0 0 0 255 ECU_ADDRESS 0x0 /end MEASUREMENT
/begin MEASUREMENT Com_TxSigInfo[306].OnChangeOfTxSigInfo "" UBYTE Com_OnChangeOfTxSigInfoType 0 0 0 255 ECU_ADDRESS 0x0 /end MEASUREMENT
/begin MEASUREMENT Com_TxSigInfo[306].StartByteInPduPositionOfTxSigInfo "" UBYTE NO_COMPU_METHOD 0 0 0 255 ECU_ADDRESS 0x0 /end MEASUREMENT
/begin MEASUREMENT Com_TxSigInfo[306].TxAccessInfoIdxOfTxSigInfo "" UWORD NO_COMPU_METHOD 0 0 0 65535 ECU_ADDRESS 0x0 /end MEASUREMENT
/begin MEASUREMENT Com_TxSigInfo[306].TxBufferEndIdxOfTxSigInfo "" UWORD Com_TxBufferEndIdxOfTxSigInfoType 0 0 0 65535 ECU_ADDRESS 0x0 /end MEASUREMENT
/begin MEASUREMENT Com_TxSigInfo[306].TxBufferStartIdxOfTxSigInfo "" UWORD Com_TxBufferStartIdxOfTxSigInfoType 0 0 0 65535 ECU_ADDRESS 0x0 /end MEASUREMENT
/begin MEASUREMENT Com_TxSigInfo[306].TxFilterInitValueArrayBasedFilterInitValueEndIdxOfTxSigInfo "" UBYTE Com_TxFilterInitValueArrayBasedFilterInitValueEndIdxOfTxSigInfoType 0 0 0 255 ECU_ADDRESS 0x0 /end MEASUREMENT
/begin MEASUREMENT Com_TxSigInfo[306].TxFilterInitValueArrayBasedFilterInitValueStartIdxOfTxSigInfo "" UBYTE Com_TxFilterInitValueArrayBasedFilterInitValueStartIdxOfTxSigInfoType 0 0 0 255 ECU_ADDRESS 0x0 /end MEASUREMENT
/begin MEASUREMENT Com_TxSigInfo[306].TxPduInfoIdxOfTxSigInfo "" UBYTE NO_COMPU_METHOD 0 0 0 255 ECU_ADDRESS 0x0 /end MEASUREMENT
/begin MEASUREMENT Com_TxSigInfo[307].ApplTypeOfTxSigInfo "" UBYTE Com_ApplTypeOfTxSigInfoType 0 0 0 255 ECU_ADDRESS 0x0 /end MEASUREMENT
/begin MEASUREMENT Com_TxSigInfo[307].BitLengthOfTxSigInfo "" UWORD NO_COMPU_METHOD 0 0 0 65535 ECU_ADDRESS 0x0 /end MEASUREMENT
/begin MEASUREMENT Com_TxSigInfo[307].BitPositionOfTxSigInfo "" UWORD NO_COMPU_METHOD 0 0 0 65535 ECU_ADDRESS 0x0 /end MEASUREMENT
/begin MEASUREMENT Com_TxSigInfo[307].BusAccOfTxSigInfo "" UBYTE Com_BusAccOfTxSigInfoType 0 0 0 255 ECU_ADDRESS 0x0 /end MEASUREMENT
/begin MEASUREMENT Com_TxSigInfo[307].ByteLengthOfTxSigInfo "" UBYTE NO_COMPU_METHOD 0 0 0 255 ECU_ADDRESS 0x0 /end MEASUREMENT
/begin MEASUREMENT Com_TxSigInfo[307].DynSignalOfTxSigInfo "" UBYTE Com_DynSignalOfTxSigInfoType 0 0 0 1 ECU_ADDRESS 0x0 /end MEASUREMENT
/begin MEASUREMENT Com_TxSigInfo[307].FilterInitValueIdxOfTxSigInfo "" UBYTE Com_FilterInitValueIdxOfTxSigInfoType 0 0 0 255 ECU_ADDRESS 0x0 /end MEASUREMENT
/begin MEASUREMENT Com_TxSigInfo[307].FilterInitValueOfTxSigInfo "" UBYTE Com_FilterInitValueOfTxSigInfoType 0 0 0 255 ECU_ADDRESS 0x0 /end MEASUREMENT
/begin MEASUREMENT Com_TxSigInfo[307].InvValueIdxOfTxSigInfo "" UBYTE Com_InvValueIdxOfTxSigInfoType 0 0 0 255 ECU_ADDRESS 0x0 /end MEASUREMENT
/begin MEASUREMENT Com_TxSigInfo[307].InvValueOfTxSigInfo "" UBYTE Com_InvValueOfTxSigInfoType 0 0 0 255 ECU_ADDRESS 0x0 /end MEASUREMENT
/begin MEASUREMENT Com_TxSigInfo[307].OnChangeIdxOfTxSigInfo "" UBYTE Com_OnChangeIdxOfTxSigInfoType 0 0 0 255 ECU_ADDRESS 0x0 /end MEASUREMENT
/begin MEASUREMENT Com_TxSigInfo[307].OnChangeOfTxSigInfo "" UBYTE Com_OnChangeOfTxSigInfoType 0 0 0 255 ECU_ADDRESS 0x0 /end MEASUREMENT
/begin MEASUREMENT Com_TxSigInfo[307].StartByteInPduPositionOfTxSigInfo "" UBYTE NO_COMPU_METHOD 0 0 0 255 ECU_ADDRESS 0x0 /end MEASUREMENT
/begin MEASUREMENT Com_TxSigInfo[307].TxAccessInfoIdxOfTxSigInfo "" UWORD NO_COMPU_METHOD 0 0 0 65535 ECU_ADDRESS 0x0 /end MEASUREMENT
/begin MEASUREMENT Com_TxSigInfo[307].TxBufferEndIdxOfTxSigInfo "" UWORD Com_TxBufferEndIdxOfTxSigInfoType 0 0 0 65535 ECU_ADDRESS 0x0 /end MEASUREMENT
/begin MEASUREMENT Com_TxSigInfo[307].TxBufferStartIdxOfTxSigInfo "" UWORD Com_TxBufferStartIdxOfTxSigInfoType 0 0 0 65535 ECU_ADDRESS 0x0 /end MEASUREMENT
/begin MEASUREMENT Com_TxSigInfo[307].TxFilterInitValueArrayBasedFilterInitValueEndIdxOfTxSigInfo "" UBYTE Com_TxFilterInitValueArrayBasedFilterInitValueEndIdxOfTxSigInfoType 0 0 0 255 ECU_ADDRESS 0x0 /end MEASUREMENT
/begin MEASUREMENT Com_TxSigInfo[307].TxFilterInitValueArrayBasedFilterInitValueStartIdxOfTxSigInfo "" UBYTE Com_TxFilterInitValueArrayBasedFilterInitValueStartIdxOfTxSigInfoType 0 0 0 255 ECU_ADDRESS 0x0 /end MEASUREMENT
/begin MEASUREMENT Com_TxSigInfo[307].TxPduInfoIdxOfTxSigInfo "" UBYTE NO_COMPU_METHOD 0 0 0 255 ECU_ADDRESS 0x0 /end MEASUREMENT
/begin MEASUREMENT Com_TxSigInfo[308].ApplTypeOfTxSigInfo "" UBYTE Com_ApplTypeOfTxSigInfoType 0 0 0 255 ECU_ADDRESS 0x0 /end MEASUREMENT
/begin MEASUREMENT Com_TxSigInfo[308].BitLengthOfTxSigInfo "" UWORD NO_COMPU_METHOD 0 0 0 65535 ECU_ADDRESS 0x0 /end MEASUREMENT
/begin MEASUREMENT Com_TxSigInfo[308].BitPositionOfTxSigInfo "" UWORD NO_COMPU_METHOD 0 0 0 65535 ECU_ADDRESS 0x0 /end MEASUREMENT
/begin MEASUREMENT Com_TxSigInfo[308].BusAccOfTxSigInfo "" UBYTE Com_BusAccOfTxSigInfoType 0 0 0 255 ECU_ADDRESS 0x0 /end MEASUREMENT
/begin MEASUREMENT Com_TxSigInfo[308].ByteLengthOfTxSigInfo "" UBYTE NO_COMPU_METHOD 0 0 0 255 ECU_ADDRESS 0x0 /end MEASUREMENT
/begin MEASUREMENT Com_TxSigInfo[308].DynSignalOfTxSigInfo "" UBYTE Com_DynSignalOfTxSigInfoType 0 0 0 1 ECU_ADDRESS 0x0 /end MEASUREMENT
/begin MEASUREMENT Com_TxSigInfo[308].FilterInitValueIdxOfTxSigInfo "" UBYTE Com_FilterInitValueIdxOfTxSigInfoType 0 0 0 255 ECU_ADDRESS 0x0 /end MEASUREMENT
/begin MEASUREMENT Com_TxSigInfo[308].FilterInitValueOfTxSigInfo "" UBYTE Com_FilterInitValueOfTxSigInfoType 0 0 0 255 ECU_ADDRESS 0x0 /end MEASUREMENT
/begin MEASUREMENT Com_TxSigInfo[308].InvValueIdxOfTxSigInfo "" UBYTE Com_InvValueIdxOfTxSigInfoType 0 0 0 255 ECU_ADDRESS 0x0 /end MEASUREMENT
/begin MEASUREMENT Com_TxSigInfo[308].InvValueOfTxSigInfo "" UBYTE Com_InvValueOfTxSigInfoType 0 0 0 255 ECU_ADDRESS 0x0 /end MEASUREMENT
/begin MEASUREMENT Com_TxSigInfo[308].OnChangeIdxOfTxSigInfo "" UBYTE Com_OnChangeIdxOfTxSigInfoType 0 0 0 255 ECU_ADDRESS 0x0 /end MEASUREMENT
/begin MEASUREMENT Com_TxSigInfo[308].OnChangeOfTxSigInfo "" UBYTE Com_OnChangeOfTxSigInfoType 0 0 0 255 ECU_ADDRESS 0x0 /end MEASUREMENT
/begin MEASUREMENT Com_TxSigInfo[308].StartByteInPduPositionOfTxSigInfo "" UBYTE NO_COMPU_METHOD 0 0 0 255 ECU_ADDRESS 0x0 /end MEASUREMENT
/begin MEASUREMENT Com_TxSigInfo[308].TxAccessInfoIdxOfTxSigInfo "" UWORD NO_COMPU_METHOD 0 0 0 65535 ECU_ADDRESS 0x0 /end MEASUREMENT
/begin MEASUREMENT Com_TxSigInfo[308].TxBufferEndIdxOfTxSigInfo "" UWORD Com_TxBufferEndIdxOfTxSigInfoType 0 0 0 65535 ECU_ADDRESS 0x0 /end MEASUREMENT
/begin MEASUREMENT Com_TxSigInfo[308].TxBufferStartIdxOfTxSigInfo "" UWORD Com_TxBufferStartIdxOfTxSigInfoType 0 0 0 65535 ECU_ADDRESS 0x0 /end MEASUREMENT
/begin MEASUREMENT Com_TxSigInfo[308].TxFilterInitValueArrayBasedFilterInitValueEndIdxOfTxSigInfo "" UBYTE Com_TxFilterInitValueArrayBasedFilterInitValueEndIdxOfTxSigInfoType 0 0 0 255 ECU_ADDRESS 0x0 /end MEASUREMENT
/begin MEASUREMENT Com_TxSigInfo[308].TxFilterInitValueArrayBasedFilterInitValueStartIdxOfTxSigInfo "" UBYTE Com_TxFilterInitValueArrayBasedFilterInitValueStartIdxOfTxSigInfoType 0 0 0 255 ECU_ADDRESS 0x0 /end MEASUREMENT
/begin MEASUREMENT Com_TxSigInfo[308].TxPduInfoIdxOfTxSigInfo "" UBYTE NO_COMPU_METHOD 0 0 0 255 ECU_ADDRESS 0x0 /end MEASUREMENT
/begin MEASUREMENT Com_TxSigInfo[309].ApplTypeOfTxSigInfo "" UBYTE Com_ApplTypeOfTxSigInfoType 0 0 0 255 ECU_ADDRESS 0x0 /end MEASUREMENT
/begin MEASUREMENT Com_TxSigInfo[309].BitLengthOfTxSigInfo "" UWORD NO_COMPU_METHOD 0 0 0 65535 ECU_ADDRESS 0x0 /end MEASUREMENT
/begin MEASUREMENT Com_TxSigInfo[309].BitPositionOfTxSigInfo "" UWORD NO_COMPU_METHOD 0 0 0 65535 ECU_ADDRESS 0x0 /end MEASUREMENT
/begin MEASUREMENT Com_TxSigInfo[309].BusAccOfTxSigInfo "" UBYTE Com_BusAccOfTxSigInfoType 0 0 0 255 ECU_ADDRESS 0x0 /end MEASUREMENT
/begin MEASUREMENT Com_TxSigInfo[309].ByteLengthOfTxSigInfo "" UBYTE NO_COMPU_METHOD 0 0 0 255 ECU_ADDRESS 0x0 /end MEASUREMENT
/begin MEASUREMENT Com_TxSigInfo[309].DynSignalOfTxSigInfo "" UBYTE Com_DynSignalOfTxSigInfoType 0 0 0 1 ECU_ADDRESS 0x0 /end MEASUREMENT
/begin MEASUREMENT Com_TxSigInfo[309].FilterInitValueIdxOfTxSigInfo "" UBYTE Com_FilterInitValueIdxOfTxSigInfoType 0 0 0 255 ECU_ADDRESS 0x0 /end MEASUREMENT
/begin MEASUREMENT Com_TxSigInfo[309].FilterInitValueOfTxSigInfo "" UBYTE Com_FilterInitValueOfTxSigInfoType 0 0 0 255 ECU_ADDRESS 0x0 /end MEASUREMENT
/begin MEASUREMENT Com_TxSigInfo[309].InvValueIdxOfTxSigInfo "" UBYTE Com_InvValueIdxOfTxSigInfoType 0 0 0 255 ECU_ADDRESS 0x0 /end MEASUREMENT
/begin MEASUREMENT Com_TxSigInfo[309].InvValueOfTxSigInfo "" UBYTE Com_InvValueOfTxSigInfoType 0 0 0 255 ECU_ADDRESS 0x0 /end MEASUREMENT
/begin MEASUREMENT Com_TxSigInfo[309].OnChangeIdxOfTxSigInfo "" UBYTE Com_OnChangeIdxOfTxSigInfoType 0 0 0 255 ECU_ADDRESS 0x0 /end MEASUREMENT
/begin MEASUREMENT Com_TxSigInfo[309].OnChangeOfTxSigInfo "" UBYTE Com_OnChangeOfTxSigInfoType 0 0 0 255 ECU_ADDRESS 0x0 /end MEASUREMENT
/begin MEASUREMENT Com_TxSigInfo[309].StartByteInPduPositionOfTxSigInfo "" UBYTE NO_COMPU_METHOD 0 0 0 255 ECU_ADDRESS 0x0 /end MEASUREMENT
/begin MEASUREMENT Com_TxSigInfo[309].TxAccessInfoIdxOfTxSigInfo "" UWORD NO_COMPU_METHOD 0 0 0 65535 ECU_ADDRESS 0x0 /end MEASUREMENT
/begin MEASUREMENT Com_TxSigInfo[309].TxBufferEndIdxOfTxSigInfo "" UWORD Com_TxBufferEndIdxOfTxSigInfoType 0 0 0 65535 ECU_ADDRESS 0x0 /end MEASUREMENT
/begin MEASUREMENT Com_TxSigInfo[309].TxBufferStartIdxOfTxSigInfo "" UWORD Com_TxBufferStartIdxOfTxSigInfoType 0 0 0 65535 ECU_ADDRESS 0x0 /end MEASUREMENT
/begin MEASUREMENT Com_TxSigInfo[309].TxFilterInitValueArrayBasedFilterInitValueEndIdxOfTxSigInfo "" UBYTE Com_TxFilterInitValueArrayBasedFilterInitValueEndIdxOfTxSigInfoType 0 0 0 255 ECU_ADDRESS 0x0 /end MEASUREMENT
/begin MEASUREMENT Com_TxSigInfo[309].TxFilterInitValueArrayBasedFilterInitValueStartIdxOfTxSigInfo "" UBYTE Com_TxFilterInitValueArrayBasedFilterInitValueStartIdxOfTxSigInfoType 0 0 0 255 ECU_ADDRESS 0x0 /end MEASUREMENT
/begin MEASUREMENT Com_TxSigInfo[309].TxPduInfoIdxOfTxSigInfo "" UBYTE NO_COMPU_METHOD 0 0 0 255 ECU_ADDRESS 0x0 /end MEASUREMENT
/begin MEASUREMENT Com_TxSigInfo[30].ApplTypeOfTxSigInfo "" UBYTE Com_ApplTypeOfTxSigInfoType 0 0 0 255 ECU_ADDRESS 0x0 /end MEASUREMENT
/begin MEASUREMENT Com_TxSigInfo[30].BitLengthOfTxSigInfo "" UWORD NO_COMPU_METHOD 0 0 0 65535 ECU_ADDRESS 0x0 /end MEASUREMENT
/begin MEASUREMENT Com_TxSigInfo[30].BitPositionOfTxSigInfo "" UWORD NO_COMPU_METHOD 0 0 0 65535 ECU_ADDRESS 0x0 /end MEASUREMENT
/begin MEASUREMENT Com_TxSigInfo[30].BusAccOfTxSigInfo "" UBYTE Com_BusAccOfTxSigInfoType 0 0 0 255 ECU_ADDRESS 0x0 /end MEASUREMENT
/begin MEASUREMENT Com_TxSigInfo[30].ByteLengthOfTxSigInfo "" UBYTE NO_COMPU_METHOD 0 0 0 255 ECU_ADDRESS 0x0 /end MEASUREMENT
/begin MEASUREMENT Com_TxSigInfo[30].DynSignalOfTxSigInfo "" UBYTE Com_DynSignalOfTxSigInfoType 0 0 0 1 ECU_ADDRESS 0x0 /end MEASUREMENT
/begin MEASUREMENT Com_TxSigInfo[30].FilterInitValueIdxOfTxSigInfo "" UBYTE Com_FilterInitValueIdxOfTxSigInfoType 0 0 0 255 ECU_ADDRESS 0x0 /end MEASUREMENT
/begin MEASUREMENT Com_TxSigInfo[30].FilterInitValueOfTxSigInfo "" UBYTE Com_FilterInitValueOfTxSigInfoType 0 0 0 255 ECU_ADDRESS 0x0 /end MEASUREMENT
/begin MEASUREMENT Com_TxSigInfo[30].InvValueIdxOfTxSigInfo "" UBYTE Com_InvValueIdxOfTxSigInfoType 0 0 0 255 ECU_ADDRESS 0x0 /end MEASUREMENT
/begin MEASUREMENT Com_TxSigInfo[30].InvValueOfTxSigInfo "" UBYTE Com_InvValueOfTxSigInfoType 0 0 0 255 ECU_ADDRESS 0x0 /end MEASUREMENT
/begin MEASUREMENT Com_TxSigInfo[30].OnChangeIdxOfTxSigInfo "" UBYTE Com_OnChangeIdxOfTxSigInfoType 0 0 0 255 ECU_ADDRESS 0x0 /end MEASUREMENT
/begin MEASUREMENT Com_TxSigInfo[30].OnChangeOfTxSigInfo "" UBYTE Com_OnChangeOfTxSigInfoType 0 0 0 255 ECU_ADDRESS 0x0 /end MEASUREMENT
/begin MEASUREMENT Com_TxSigInfo[30].StartByteInPduPositionOfTxSigInfo "" UBYTE NO_COMPU_METHOD 0 0 0 255 ECU_ADDRESS 0x0 /end MEASUREMENT
/begin MEASUREMENT Com_TxSigInfo[30].TxAccessInfoIdxOfTxSigInfo "" UWORD NO_COMPU_METHOD 0 0 0 65535 ECU_ADDRESS 0x0 /end MEASUREMENT
/begin MEASUREMENT Com_TxSigInfo[30].TxBufferEndIdxOfTxSigInfo "" UWORD Com_TxBufferEndIdxOfTxSigInfoType 0 0 0 65535 ECU_ADDRESS 0x0 /end MEASUREMENT
/begin MEASUREMENT Com_TxSigInfo[30].TxBufferStartIdxOfTxSigInfo "" UWORD Com_TxBufferStartIdxOfTxSigInfoType 0 0 0 65535 ECU_ADDRESS 0x0 /end MEASUREMENT
/begin MEASUREMENT Com_TxSigInfo[30].TxFilterInitValueArrayBasedFilterInitValueEndIdxOfTxSigInfo "" UBYTE Com_TxFilterInitValueArrayBasedFilterInitValueEndIdxOfTxSigInfoType 0 0 0 255 ECU_ADDRESS 0x0 /end MEASUREMENT
/begin MEASUREMENT Com_TxSigInfo[30].TxFilterInitValueArrayBasedFilterInitValueStartIdxOfTxSigInfo "" UBYTE Com_TxFilterInitValueArrayBasedFilterInitValueStartIdxOfTxSigInfoType 0 0 0 255 ECU_ADDRESS 0x0 /end MEASUREMENT
/begin MEASUREMENT Com_TxSigInfo[30].TxPduInfoIdxOfTxSigInfo "" UBYTE NO_COMPU_METHOD 0 0 0 255 ECU_ADDRESS 0x0 /end MEASUREMENT
/begin MEASUREMENT Com_TxSigInfo[310].ApplTypeOfTxSigInfo "" UBYTE Com_ApplTypeOfTxSigInfoType 0 0 0 255 ECU_ADDRESS 0x0 /end MEASUREMENT
/begin MEASUREMENT Com_TxSigInfo[310].BitLengthOfTxSigInfo "" UWORD NO_COMPU_METHOD 0 0 0 65535 ECU_ADDRESS 0x0 /end MEASUREMENT
/begin MEASUREMENT Com_TxSigInfo[310].BitPositionOfTxSigInfo "" UWORD NO_COMPU_METHOD 0 0 0 65535 ECU_ADDRESS 0x0 /end MEASUREMENT
/begin MEASUREMENT Com_TxSigInfo[310].BusAccOfTxSigInfo "" UBYTE Com_BusAccOfTxSigInfoType 0 0 0 255 ECU_ADDRESS 0x0 /end MEASUREMENT
/begin MEASUREMENT Com_TxSigInfo[310].ByteLengthOfTxSigInfo "" UBYTE NO_COMPU_METHOD 0 0 0 255 ECU_ADDRESS 0x0 /end MEASUREMENT
/begin MEASUREMENT Com_TxSigInfo[310].DynSignalOfTxSigInfo "" UBYTE Com_DynSignalOfTxSigInfoType 0 0 0 1 ECU_ADDRESS 0x0 /end MEASUREMENT
/begin MEASUREMENT Com_TxSigInfo[310].FilterInitValueIdxOfTxSigInfo "" UBYTE Com_FilterInitValueIdxOfTxSigInfoType 0 0 0 255 ECU_ADDRESS 0x0 /end MEASUREMENT
/begin MEASUREMENT Com_TxSigInfo[310].FilterInitValueOfTxSigInfo "" UBYTE Com_FilterInitValueOfTxSigInfoType 0 0 0 255 ECU_ADDRESS 0x0 /end MEASUREMENT
/begin MEASUREMENT Com_TxSigInfo[310].InvValueIdxOfTxSigInfo "" UBYTE Com_InvValueIdxOfTxSigInfoType 0 0 0 255 ECU_ADDRESS 0x0 /end MEASUREMENT
/begin MEASUREMENT Com_TxSigInfo[310].InvValueOfTxSigInfo "" UBYTE Com_InvValueOfTxSigInfoType 0 0 0 255 ECU_ADDRESS 0x0 /end MEASUREMENT
/begin MEASUREMENT Com_TxSigInfo[310].OnChangeIdxOfTxSigInfo "" UBYTE Com_OnChangeIdxOfTxSigInfoType 0 0 0 255 ECU_ADDRESS 0x0 /end MEASUREMENT
/begin MEASUREMENT Com_TxSigInfo[310].OnChangeOfTxSigInfo "" UBYTE Com_OnChangeOfTxSigInfoType 0 0 0 255 ECU_ADDRESS 0x0 /end MEASUREMENT
/begin MEASUREMENT Com_TxSigInfo[310].StartByteInPduPositionOfTxSigInfo "" UBYTE NO_COMPU_METHOD 0 0 0 255 ECU_ADDRESS 0x0 /end MEASUREMENT
/begin MEASUREMENT Com_TxSigInfo[310].TxAccessInfoIdxOfTxSigInfo "" UWORD NO_COMPU_METHOD 0 0 0 65535 ECU_ADDRESS 0x0 /end MEASUREMENT
/begin MEASUREMENT Com_TxSigInfo[310].TxBufferEndIdxOfTxSigInfo "" UWORD Com_TxBufferEndIdxOfTxSigInfoType 0 0 0 65535 ECU_ADDRESS 0x0 /end MEASUREMENT
/begin MEASUREMENT Com_TxSigInfo[310].TxBufferStartIdxOfTxSigInfo "" UWORD Com_TxBufferStartIdxOfTxSigInfoType 0 0 0 65535 ECU_ADDRESS 0x0 /end MEASUREMENT
/begin MEASUREMENT Com_TxSigInfo[310].TxFilterInitValueArrayBasedFilterInitValueEndIdxOfTxSigInfo "" UBYTE Com_TxFilterInitValueArrayBasedFilterInitValueEndIdxOfTxSigInfoType 0 0 0 255 ECU_ADDRESS 0x0 /end MEASUREMENT
/begin MEASUREMENT Com_TxSigInfo[310].TxFilterInitValueArrayBasedFilterInitValueStartIdxOfTxSigInfo "" UBYTE Com_TxFilterInitValueArrayBasedFilterInitValueStartIdxOfTxSigInfoType 0 0 0 255 ECU_ADDRESS 0x0 /end MEASUREMENT
/begin MEASUREMENT Com_TxSigInfo[310].TxPduInfoIdxOfTxSigInfo "" UBYTE NO_COMPU_METHOD 0 0 0 255 ECU_ADDRESS 0x0 /end MEASUREMENT
/begin MEASUREMENT Com_TxSigInfo[311].ApplTypeOfTxSigInfo "" UBYTE Com_ApplTypeOfTxSigInfoType 0 0 0 255 ECU_ADDRESS 0x0 /end MEASUREMENT
/begin MEASUREMENT Com_TxSigInfo[311].BitLengthOfTxSigInfo "" UWORD NO_COMPU_METHOD 0 0 0 65535 ECU_ADDRESS 0x0 /end MEASUREMENT
/begin MEASUREMENT Com_TxSigInfo[311].BitPositionOfTxSigInfo "" UWORD NO_COMPU_METHOD 0 0 0 65535 ECU_ADDRESS 0x0 /end MEASUREMENT
/begin MEASUREMENT Com_TxSigInfo[311].BusAccOfTxSigInfo "" UBYTE Com_BusAccOfTxSigInfoType 0 0 0 255 ECU_ADDRESS 0x0 /end MEASUREMENT
/begin MEASUREMENT Com_TxSigInfo[311].ByteLengthOfTxSigInfo "" UBYTE NO_COMPU_METHOD 0 0 0 255 ECU_ADDRESS 0x0 /end MEASUREMENT
/begin MEASUREMENT Com_TxSigInfo[311].DynSignalOfTxSigInfo "" UBYTE Com_DynSignalOfTxSigInfoType 0 0 0 1 ECU_ADDRESS 0x0 /end MEASUREMENT
/begin MEASUREMENT Com_TxSigInfo[311].FilterInitValueIdxOfTxSigInfo "" UBYTE Com_FilterInitValueIdxOfTxSigInfoType 0 0 0 255 ECU_ADDRESS 0x0 /end MEASUREMENT
/begin MEASUREMENT Com_TxSigInfo[311].FilterInitValueOfTxSigInfo "" UBYTE Com_FilterInitValueOfTxSigInfoType 0 0 0 255 ECU_ADDRESS 0x0 /end MEASUREMENT
/begin MEASUREMENT Com_TxSigInfo[311].InvValueIdxOfTxSigInfo "" UBYTE Com_InvValueIdxOfTxSigInfoType 0 0 0 255 ECU_ADDRESS 0x0 /end MEASUREMENT
/begin MEASUREMENT Com_TxSigInfo[311].InvValueOfTxSigInfo "" UBYTE Com_InvValueOfTxSigInfoType 0 0 0 255 ECU_ADDRESS 0x0 /end MEASUREMENT
/begin MEASUREMENT Com_TxSigInfo[311].OnChangeIdxOfTxSigInfo "" UBYTE Com_OnChangeIdxOfTxSigInfoType 0 0 0 255 ECU_ADDRESS 0x0 /end MEASUREMENT
/begin MEASUREMENT Com_TxSigInfo[311].OnChangeOfTxSigInfo "" UBYTE Com_OnChangeOfTxSigInfoType 0 0 0 255 ECU_ADDRESS 0x0 /end MEASUREMENT
/begin MEASUREMENT Com_TxSigInfo[311].StartByteInPduPositionOfTxSigInfo "" UBYTE NO_COMPU_METHOD 0 0 0 255 ECU_ADDRESS 0x0 /end MEASUREMENT
/begin MEASUREMENT Com_TxSigInfo[311].TxAccessInfoIdxOfTxSigInfo "" UWORD NO_COMPU_METHOD 0 0 0 65535 ECU_ADDRESS 0x0 /end MEASUREMENT
/begin MEASUREMENT Com_TxSigInfo[311].TxBufferEndIdxOfTxSigInfo "" UWORD Com_TxBufferEndIdxOfTxSigInfoType 0 0 0 65535 ECU_ADDRESS 0x0 /end MEASUREMENT
/begin MEASUREMENT Com_TxSigInfo[311].TxBufferStartIdxOfTxSigInfo "" UWORD Com_TxBufferStartIdxOfTxSigInfoType 0 0 0 65535 ECU_ADDRESS 0x0 /end MEASUREMENT
/begin MEASUREMENT Com_TxSigInfo[311].TxFilterInitValueArrayBasedFilterInitValueEndIdxOfTxSigInfo "" UBYTE Com_TxFilterInitValueArrayBasedFilterInitValueEndIdxOfTxSigInfoType 0 0 0 255 ECU_ADDRESS 0x0 /end MEASUREMENT
/begin MEASUREMENT Com_TxSigInfo[311].TxFilterInitValueArrayBasedFilterInitValueStartIdxOfTxSigInfo "" UBYTE Com_TxFilterInitValueArrayBasedFilterInitValueStartIdxOfTxSigInfoType 0 0 0 255 ECU_ADDRESS 0x0 /end MEASUREMENT
/begin MEASUREMENT Com_TxSigInfo[311].TxPduInfoIdxOfTxSigInfo "" UBYTE NO_COMPU_METHOD 0 0 0 255 ECU_ADDRESS 0x0 /end MEASUREMENT
/begin MEASUREMENT Com_TxSigInfo[312].ApplTypeOfTxSigInfo "" UBYTE Com_ApplTypeOfTxSigInfoType 0 0 0 255 ECU_ADDRESS 0x0 /end MEASUREMENT
/begin MEASUREMENT Com_TxSigInfo[312].BitLengthOfTxSigInfo "" UWORD NO_COMPU_METHOD 0 0 0 65535 ECU_ADDRESS 0x0 /end MEASUREMENT
/begin MEASUREMENT Com_TxSigInfo[312].BitPositionOfTxSigInfo "" UWORD NO_COMPU_METHOD 0 0 0 65535 ECU_ADDRESS 0x0 /end MEASUREMENT
/begin MEASUREMENT Com_TxSigInfo[312].BusAccOfTxSigInfo "" UBYTE Com_BusAccOfTxSigInfoType 0 0 0 255 ECU_ADDRESS 0x0 /end MEASUREMENT
/begin MEASUREMENT Com_TxSigInfo[312].ByteLengthOfTxSigInfo "" UBYTE NO_COMPU_METHOD 0 0 0 255 ECU_ADDRESS 0x0 /end MEASUREMENT
/begin MEASUREMENT Com_TxSigInfo[312].DynSignalOfTxSigInfo "" UBYTE Com_DynSignalOfTxSigInfoType 0 0 0 1 ECU_ADDRESS 0x0 /end MEASUREMENT
/begin MEASUREMENT Com_TxSigInfo[312].FilterInitValueIdxOfTxSigInfo "" UBYTE Com_FilterInitValueIdxOfTxSigInfoType 0 0 0 255 ECU_ADDRESS 0x0 /end MEASUREMENT
/begin MEASUREMENT Com_TxSigInfo[312].FilterInitValueOfTxSigInfo "" UBYTE Com_FilterInitValueOfTxSigInfoType 0 0 0 255 ECU_ADDRESS 0x0 /end MEASUREMENT
/begin MEASUREMENT Com_TxSigInfo[312].InvValueIdxOfTxSigInfo "" UBYTE Com_InvValueIdxOfTxSigInfoType 0 0 0 255 ECU_ADDRESS 0x0 /end MEASUREMENT
/begin MEASUREMENT Com_TxSigInfo[312].InvValueOfTxSigInfo "" UBYTE Com_InvValueOfTxSigInfoType 0 0 0 255 ECU_ADDRESS 0x0 /end MEASUREMENT
/begin MEASUREMENT Com_TxSigInfo[312].OnChangeIdxOfTxSigInfo "" UBYTE Com_OnChangeIdxOfTxSigInfoType 0 0 0 255 ECU_ADDRESS 0x0 /end MEASUREMENT
/begin MEASUREMENT Com_TxSigInfo[312].OnChangeOfTxSigInfo "" UBYTE Com_OnChangeOfTxSigInfoType 0 0 0 255 ECU_ADDRESS 0x0 /end MEASUREMENT
/begin MEASUREMENT Com_TxSigInfo[312].StartByteInPduPositionOfTxSigInfo "" UBYTE NO_COMPU_METHOD 0 0 0 255 ECU_ADDRESS 0x0 /end MEASUREMENT
/begin MEASUREMENT Com_TxSigInfo[312].TxAccessInfoIdxOfTxSigInfo "" UWORD NO_COMPU_METHOD 0 0 0 65535 ECU_ADDRESS 0x0 /end MEASUREMENT
/begin MEASUREMENT Com_TxSigInfo[312].TxBufferEndIdxOfTxSigInfo "" UWORD Com_TxBufferEndIdxOfTxSigInfoType 0 0 0 65535 ECU_ADDRESS 0x0 /end MEASUREMENT
/begin MEASUREMENT Com_TxSigInfo[312].TxBufferStartIdxOfTxSigInfo "" UWORD Com_TxBufferStartIdxOfTxSigInfoType 0 0 0 65535 ECU_ADDRESS 0x0 /end MEASUREMENT
/begin MEASUREMENT Com_TxSigInfo[312].TxFilterInitValueArrayBasedFilterInitValueEndIdxOfTxSigInfo "" UBYTE Com_TxFilterInitValueArrayBasedFilterInitValueEndIdxOfTxSigInfoType 0 0 0 255 ECU_ADDRESS 0x0 /end MEASUREMENT
/begin MEASUREMENT Com_TxSigInfo[312].TxFilterInitValueArrayBasedFilterInitValueStartIdxOfTxSigInfo "" UBYTE Com_TxFilterInitValueArrayBasedFilterInitValueStartIdxOfTxSigInfoType 0 0 0 255 ECU_ADDRESS 0x0 /end MEASUREMENT
/begin MEASUREMENT Com_TxSigInfo[312].TxPduInfoIdxOfTxSigInfo "" UBYTE NO_COMPU_METHOD 0 0 0 255 ECU_ADDRESS 0x0 /end MEASUREMENT
/begin MEASUREMENT Com_TxSigInfo[313].ApplTypeOfTxSigInfo "" UBYTE Com_ApplTypeOfTxSigInfoType 0 0 0 255 ECU_ADDRESS 0x0 /end MEASUREMENT
/begin MEASUREMENT Com_TxSigInfo[313].BitLengthOfTxSigInfo "" UWORD NO_COMPU_METHOD 0 0 0 65535 ECU_ADDRESS 0x0 /end MEASUREMENT
/begin MEASUREMENT Com_TxSigInfo[313].BitPositionOfTxSigInfo "" UWORD NO_COMPU_METHOD 0 0 0 65535 ECU_ADDRESS 0x0 /end MEASUREMENT
/begin MEASUREMENT Com_TxSigInfo[313].BusAccOfTxSigInfo "" UBYTE Com_BusAccOfTxSigInfoType 0 0 0 255 ECU_ADDRESS 0x0 /end MEASUREMENT
/begin MEASUREMENT Com_TxSigInfo[313].ByteLengthOfTxSigInfo "" UBYTE NO_COMPU_METHOD 0 0 0 255 ECU_ADDRESS 0x0 /end MEASUREMENT
/begin MEASUREMENT Com_TxSigInfo[313].DynSignalOfTxSigInfo "" UBYTE Com_DynSignalOfTxSigInfoType 0 0 0 1 ECU_ADDRESS 0x0 /end MEASUREMENT
/begin MEASUREMENT Com_TxSigInfo[313].FilterInitValueIdxOfTxSigInfo "" UBYTE Com_FilterInitValueIdxOfTxSigInfoType 0 0 0 255 ECU_ADDRESS 0x0 /end MEASUREMENT
/begin MEASUREMENT Com_TxSigInfo[313].FilterInitValueOfTxSigInfo "" UBYTE Com_FilterInitValueOfTxSigInfoType 0 0 0 255 ECU_ADDRESS 0x0 /end MEASUREMENT
/begin MEASUREMENT Com_TxSigInfo[313].InvValueIdxOfTxSigInfo "" UBYTE Com_InvValueIdxOfTxSigInfoType 0 0 0 255 ECU_ADDRESS 0x0 /end MEASUREMENT
/begin MEASUREMENT Com_TxSigInfo[313].InvValueOfTxSigInfo "" UBYTE Com_InvValueOfTxSigInfoType 0 0 0 255 ECU_ADDRESS 0x0 /end MEASUREMENT
/begin MEASUREMENT Com_TxSigInfo[313].OnChangeIdxOfTxSigInfo "" UBYTE Com_OnChangeIdxOfTxSigInfoType 0 0 0 255 ECU_ADDRESS 0x0 /end MEASUREMENT
/begin MEASUREMENT Com_TxSigInfo[313].OnChangeOfTxSigInfo "" UBYTE Com_OnChangeOfTxSigInfoType 0 0 0 255 ECU_ADDRESS 0x0 /end MEASUREMENT
/begin MEASUREMENT Com_TxSigInfo[313].StartByteInPduPositionOfTxSigInfo "" UBYTE NO_COMPU_METHOD 0 0 0 255 ECU_ADDRESS 0x0 /end MEASUREMENT
/begin MEASUREMENT Com_TxSigInfo[313].TxAccessInfoIdxOfTxSigInfo "" UWORD NO_COMPU_METHOD 0 0 0 65535 ECU_ADDRESS 0x0 /end MEASUREMENT
/begin MEASUREMENT Com_TxSigInfo[313].TxBufferEndIdxOfTxSigInfo "" UWORD Com_TxBufferEndIdxOfTxSigInfoType 0 0 0 65535 ECU_ADDRESS 0x0 /end MEASUREMENT
/begin MEASUREMENT Com_TxSigInfo[313].TxBufferStartIdxOfTxSigInfo "" UWORD Com_TxBufferStartIdxOfTxSigInfoType 0 0 0 65535 ECU_ADDRESS 0x0 /end MEASUREMENT
/begin MEASUREMENT Com_TxSigInfo[313].TxFilterInitValueArrayBasedFilterInitValueEndIdxOfTxSigInfo "" UBYTE Com_TxFilterInitValueArrayBasedFilterInitValueEndIdxOfTxSigInfoType 0 0 0 255 ECU_ADDRESS 0x0 /end MEASUREMENT
/begin MEASUREMENT Com_TxSigInfo[313].TxFilterInitValueArrayBasedFilterInitValueStartIdxOfTxSigInfo "" UBYTE Com_TxFilterInitValueArrayBasedFilterInitValueStartIdxOfTxSigInfoType 0 0 0 255 ECU_ADDRESS 0x0 /end MEASUREMENT
/begin MEASUREMENT Com_TxSigInfo[313].TxPduInfoIdxOfTxSigInfo "" UBYTE NO_COMPU_METHOD 0 0 0 255 ECU_ADDRESS 0x0 /end MEASUREMENT
/begin MEASUREMENT Com_TxSigInfo[314].ApplTypeOfTxSigInfo "" UBYTE Com_ApplTypeOfTxSigInfoType 0 0 0 255 ECU_ADDRESS 0x0 /end MEASUREMENT
/begin MEASUREMENT Com_TxSigInfo[314].BitLengthOfTxSigInfo "" UWORD NO_COMPU_METHOD 0 0 0 65535 ECU_ADDRESS 0x0 /end MEASUREMENT
/begin MEASUREMENT Com_TxSigInfo[314].BitPositionOfTxSigInfo "" UWORD NO_COMPU_METHOD 0 0 0 65535 ECU_ADDRESS 0x0 /end MEASUREMENT
/begin MEASUREMENT Com_TxSigInfo[314].BusAccOfTxSigInfo "" UBYTE Com_BusAccOfTxSigInfoType 0 0 0 255 ECU_ADDRESS 0x0 /end MEASUREMENT
/begin MEASUREMENT Com_TxSigInfo[314].ByteLengthOfTxSigInfo "" UBYTE NO_COMPU_METHOD 0 0 0 255 ECU_ADDRESS 0x0 /end MEASUREMENT
/begin MEASUREMENT Com_TxSigInfo[314].DynSignalOfTxSigInfo "" UBYTE Com_DynSignalOfTxSigInfoType 0 0 0 1 ECU_ADDRESS 0x0 /end MEASUREMENT
/begin MEASUREMENT Com_TxSigInfo[314].FilterInitValueIdxOfTxSigInfo "" UBYTE Com_FilterInitValueIdxOfTxSigInfoType 0 0 0 255 ECU_ADDRESS 0x0 /end MEASUREMENT
/begin MEASUREMENT Com_TxSigInfo[314].FilterInitValueOfTxSigInfo "" UBYTE Com_FilterInitValueOfTxSigInfoType 0 0 0 255 ECU_ADDRESS 0x0 /end MEASUREMENT
/begin MEASUREMENT Com_TxSigInfo[314].InvValueIdxOfTxSigInfo "" UBYTE Com_InvValueIdxOfTxSigInfoType 0 0 0 255 ECU_ADDRESS 0x0 /end MEASUREMENT
/begin MEASUREMENT Com_TxSigInfo[314].InvValueOfTxSigInfo "" UBYTE Com_InvValueOfTxSigInfoType 0 0 0 255 ECU_ADDRESS 0x0 /end MEASUREMENT
/begin MEASUREMENT Com_TxSigInfo[314].OnChangeIdxOfTxSigInfo "" UBYTE Com_OnChangeIdxOfTxSigInfoType 0 0 0 255 ECU_ADDRESS 0x0 /end MEASUREMENT
/begin MEASUREMENT Com_TxSigInfo[314].OnChangeOfTxSigInfo "" UBYTE Com_OnChangeOfTxSigInfoType 0 0 0 255 ECU_ADDRESS 0x0 /end MEASUREMENT
/begin MEASUREMENT Com_TxSigInfo[314].StartByteInPduPositionOfTxSigInfo "" UBYTE NO_COMPU_METHOD 0 0 0 255 ECU_ADDRESS 0x0 /end MEASUREMENT
/begin MEASUREMENT Com_TxSigInfo[314].TxAccessInfoIdxOfTxSigInfo "" UWORD NO_COMPU_METHOD 0 0 0 65535 ECU_ADDRESS 0x0 /end MEASUREMENT
/begin MEASUREMENT Com_TxSigInfo[314].TxBufferEndIdxOfTxSigInfo "" UWORD Com_TxBufferEndIdxOfTxSigInfoType 0 0 0 65535 ECU_ADDRESS 0x0 /end MEASUREMENT
/begin MEASUREMENT Com_TxSigInfo[314].TxBufferStartIdxOfTxSigInfo "" UWORD Com_TxBufferStartIdxOfTxSigInfoType 0 0 0 65535 ECU_ADDRESS 0x0 /end MEASUREMENT
/begin MEASUREMENT Com_TxSigInfo[314].TxFilterInitValueArrayBasedFilterInitValueEndIdxOfTxSigInfo "" UBYTE Com_TxFilterInitValueArrayBasedFilterInitValueEndIdxOfTxSigInfoType 0 0 0 255 ECU_ADDRESS 0x0 /end MEASUREMENT
/begin MEASUREMENT Com_TxSigInfo[314].TxFilterInitValueArrayBasedFilterInitValueStartIdxOfTxSigInfo "" UBYTE Com_TxFilterInitValueArrayBasedFilterInitValueStartIdxOfTxSigInfoType 0 0 0 255 ECU_ADDRESS 0x0 /end MEASUREMENT
/begin MEASUREMENT Com_TxSigInfo[314].TxPduInfoIdxOfTxSigInfo "" UBYTE NO_COMPU_METHOD 0 0 0 255 ECU_ADDRESS 0x0 /end MEASUREMENT
/begin MEASUREMENT Com_TxSigInfo[315].ApplTypeOfTxSigInfo "" UBYTE Com_ApplTypeOfTxSigInfoType 0 0 0 255 ECU_ADDRESS 0x0 /end MEASUREMENT
/begin MEASUREMENT Com_TxSigInfo[315].BitLengthOfTxSigInfo "" UWORD NO_COMPU_METHOD 0 0 0 65535 ECU_ADDRESS 0x0 /end MEASUREMENT
/begin MEASUREMENT Com_TxSigInfo[315].BitPositionOfTxSigInfo "" UWORD NO_COMPU_METHOD 0 0 0 65535 ECU_ADDRESS 0x0 /end MEASUREMENT
/begin MEASUREMENT Com_TxSigInfo[315].BusAccOfTxSigInfo "" UBYTE Com_BusAccOfTxSigInfoType 0 0 0 255 ECU_ADDRESS 0x0 /end MEASUREMENT
/begin MEASUREMENT Com_TxSigInfo[315].ByteLengthOfTxSigInfo "" UBYTE NO_COMPU_METHOD 0 0 0 255 ECU_ADDRESS 0x0 /end MEASUREMENT
/begin MEASUREMENT Com_TxSigInfo[315].DynSignalOfTxSigInfo "" UBYTE Com_DynSignalOfTxSigInfoType 0 0 0 1 ECU_ADDRESS 0x0 /end MEASUREMENT
/begin MEASUREMENT Com_TxSigInfo[315].FilterInitValueIdxOfTxSigInfo "" UBYTE Com_FilterInitValueIdxOfTxSigInfoType 0 0 0 255 ECU_ADDRESS 0x0 /end MEASUREMENT
/begin MEASUREMENT Com_TxSigInfo[315].FilterInitValueOfTxSigInfo "" UBYTE Com_FilterInitValueOfTxSigInfoType 0 0 0 255 ECU_ADDRESS 0x0 /end MEASUREMENT
/begin MEASUREMENT Com_TxSigInfo[315].InvValueIdxOfTxSigInfo "" UBYTE Com_InvValueIdxOfTxSigInfoType 0 0 0 255 ECU_ADDRESS 0x0 /end MEASUREMENT
/begin MEASUREMENT Com_TxSigInfo[315].InvValueOfTxSigInfo "" UBYTE Com_InvValueOfTxSigInfoType 0 0 0 255 ECU_ADDRESS 0x0 /end MEASUREMENT
/begin MEASUREMENT Com_TxSigInfo[315].OnChangeIdxOfTxSigInfo "" UBYTE Com_OnChangeIdxOfTxSigInfoType 0 0 0 255 ECU_ADDRESS 0x0 /end MEASUREMENT
/begin MEASUREMENT Com_TxSigInfo[315].OnChangeOfTxSigInfo "" UBYTE Com_OnChangeOfTxSigInfoType 0 0 0 255 ECU_ADDRESS 0x0 /end MEASUREMENT
/begin MEASUREMENT Com_TxSigInfo[315].StartByteInPduPositionOfTxSigInfo "" UBYTE NO_COMPU_METHOD 0 0 0 255 ECU_ADDRESS 0x0 /end MEASUREMENT
/begin MEASUREMENT Com_TxSigInfo[315].TxAccessInfoIdxOfTxSigInfo "" UWORD NO_COMPU_METHOD 0 0 0 65535 ECU_ADDRESS 0x0 /end MEASUREMENT
/begin MEASUREMENT Com_TxSigInfo[315].TxBufferEndIdxOfTxSigInfo "" UWORD Com_TxBufferEndIdxOfTxSigInfoType 0 0 0 65535 ECU_ADDRESS 0x0 /end MEASUREMENT
/begin MEASUREMENT Com_TxSigInfo[315].TxBufferStartIdxOfTxSigInfo "" UWORD Com_TxBufferStartIdxOfTxSigInfoType 0 0 0 65535 ECU_ADDRESS 0x0 /end MEASUREMENT
/begin MEASUREMENT Com_TxSigInfo[315].TxFilterInitValueArrayBasedFilterInitValueEndIdxOfTxSigInfo "" UBYTE Com_TxFilterInitValueArrayBasedFilterInitValueEndIdxOfTxSigInfoType 0 0 0 255 ECU_ADDRESS 0x0 /end MEASUREMENT
/begin MEASUREMENT Com_TxSigInfo[315].TxFilterInitValueArrayBasedFilterInitValueStartIdxOfTxSigInfo "" UBYTE Com_TxFilterInitValueArrayBasedFilterInitValueStartIdxOfTxSigInfoType 0 0 0 255 ECU_ADDRESS 0x0 /end MEASUREMENT
/begin MEASUREMENT Com_TxSigInfo[315].TxPduInfoIdxOfTxSigInfo "" UBYTE NO_COMPU_METHOD 0 0 0 255 ECU_ADDRESS 0x0 /end MEASUREMENT
/begin MEASUREMENT Com_TxSigInfo[316].ApplTypeOfTxSigInfo "" UBYTE Com_ApplTypeOfTxSigInfoType 0 0 0 255 ECU_ADDRESS 0x0 /end MEASUREMENT
/begin MEASUREMENT Com_TxSigInfo[316].BitLengthOfTxSigInfo "" UWORD NO_COMPU_METHOD 0 0 0 65535 ECU_ADDRESS 0x0 /end MEASUREMENT
/begin MEASUREMENT Com_TxSigInfo[316].BitPositionOfTxSigInfo "" UWORD NO_COMPU_METHOD 0 0 0 65535 ECU_ADDRESS 0x0 /end MEASUREMENT
/begin MEASUREMENT Com_TxSigInfo[316].BusAccOfTxSigInfo "" UBYTE Com_BusAccOfTxSigInfoType 0 0 0 255 ECU_ADDRESS 0x0 /end MEASUREMENT
/begin MEASUREMENT Com_TxSigInfo[316].ByteLengthOfTxSigInfo "" UBYTE NO_COMPU_METHOD 0 0 0 255 ECU_ADDRESS 0x0 /end MEASUREMENT
/begin MEASUREMENT Com_TxSigInfo[316].DynSignalOfTxSigInfo "" UBYTE Com_DynSignalOfTxSigInfoType 0 0 0 1 ECU_ADDRESS 0x0 /end MEASUREMENT
/begin MEASUREMENT Com_TxSigInfo[316].FilterInitValueIdxOfTxSigInfo "" UBYTE Com_FilterInitValueIdxOfTxSigInfoType 0 0 0 255 ECU_ADDRESS 0x0 /end MEASUREMENT
/begin MEASUREMENT Com_TxSigInfo[316].FilterInitValueOfTxSigInfo "" UBYTE Com_FilterInitValueOfTxSigInfoType 0 0 0 255 ECU_ADDRESS 0x0 /end MEASUREMENT
/begin MEASUREMENT Com_TxSigInfo[316].InvValueIdxOfTxSigInfo "" UBYTE Com_InvValueIdxOfTxSigInfoType 0 0 0 255 ECU_ADDRESS 0x0 /end MEASUREMENT
/begin MEASUREMENT Com_TxSigInfo[316].InvValueOfTxSigInfo "" UBYTE Com_InvValueOfTxSigInfoType 0 0 0 255 ECU_ADDRESS 0x0 /end MEASUREMENT
/begin MEASUREMENT Com_TxSigInfo[316].OnChangeIdxOfTxSigInfo "" UBYTE Com_OnChangeIdxOfTxSigInfoType 0 0 0 255 ECU_ADDRESS 0x0 /end MEASUREMENT
/begin MEASUREMENT Com_TxSigInfo[316].OnChangeOfTxSigInfo "" UBYTE Com_OnChangeOfTxSigInfoType 0 0 0 255 ECU_ADDRESS 0x0 /end MEASUREMENT
/begin MEASUREMENT Com_TxSigInfo[316].StartByteInPduPositionOfTxSigInfo "" UBYTE NO_COMPU_METHOD 0 0 0 255 ECU_ADDRESS 0x0 /end MEASUREMENT
/begin MEASUREMENT Com_TxSigInfo[316].TxAccessInfoIdxOfTxSigInfo "" UWORD NO_COMPU_METHOD 0 0 0 65535 ECU_ADDRESS 0x0 /end MEASUREMENT
/begin MEASUREMENT Com_TxSigInfo[316].TxBufferEndIdxOfTxSigInfo "" UWORD Com_TxBufferEndIdxOfTxSigInfoType 0 0 0 65535 ECU_ADDRESS 0x0 /end MEASUREMENT
/begin MEASUREMENT Com_TxSigInfo[316].TxBufferStartIdxOfTxSigInfo "" UWORD Com_TxBufferStartIdxOfTxSigInfoType 0 0 0 65535 ECU_ADDRESS 0x0 /end MEASUREMENT
/begin MEASUREMENT Com_TxSigInfo[316].TxFilterInitValueArrayBasedFilterInitValueEndIdxOfTxSigInfo "" UBYTE Com_TxFilterInitValueArrayBasedFilterInitValueEndIdxOfTxSigInfoType 0 0 0 255 ECU_ADDRESS 0x0 /end MEASUREMENT
/begin MEASUREMENT Com_TxSigInfo[316].TxFilterInitValueArrayBasedFilterInitValueStartIdxOfTxSigInfo "" UBYTE Com_TxFilterInitValueArrayBasedFilterInitValueStartIdxOfTxSigInfoType 0 0 0 255 ECU_ADDRESS 0x0 /end MEASUREMENT
/begin MEASUREMENT Com_TxSigInfo[316].TxPduInfoIdxOfTxSigInfo "" UBYTE NO_COMPU_METHOD 0 0 0 255 ECU_ADDRESS 0x0 /end MEASUREMENT
/begin MEASUREMENT Com_TxSigInfo[317].ApplTypeOfTxSigInfo "" UBYTE Com_ApplTypeOfTxSigInfoType 0 0 0 255 ECU_ADDRESS 0x0 /end MEASUREMENT
/begin MEASUREMENT Com_TxSigInfo[317].BitLengthOfTxSigInfo "" UWORD NO_COMPU_METHOD 0 0 0 65535 ECU_ADDRESS 0x0 /end MEASUREMENT
/begin MEASUREMENT Com_TxSigInfo[317].BitPositionOfTxSigInfo "" UWORD NO_COMPU_METHOD 0 0 0 65535 ECU_ADDRESS 0x0 /end MEASUREMENT
/begin MEASUREMENT Com_TxSigInfo[317].BusAccOfTxSigInfo "" UBYTE Com_BusAccOfTxSigInfoType 0 0 0 255 ECU_ADDRESS 0x0 /end MEASUREMENT
/begin MEASUREMENT Com_TxSigInfo[317].ByteLengthOfTxSigInfo "" UBYTE NO_COMPU_METHOD 0 0 0 255 ECU_ADDRESS 0x0 /end MEASUREMENT
/begin MEASUREMENT Com_TxSigInfo[317].DynSignalOfTxSigInfo "" UBYTE Com_DynSignalOfTxSigInfoType 0 0 0 1 ECU_ADDRESS 0x0 /end MEASUREMENT
/begin MEASUREMENT Com_TxSigInfo[317].FilterInitValueIdxOfTxSigInfo "" UBYTE Com_FilterInitValueIdxOfTxSigInfoType 0 0 0 255 ECU_ADDRESS 0x0 /end MEASUREMENT
/begin MEASUREMENT Com_TxSigInfo[317].FilterInitValueOfTxSigInfo "" UBYTE Com_FilterInitValueOfTxSigInfoType 0 0 0 255 ECU_ADDRESS 0x0 /end MEASUREMENT
/begin MEASUREMENT Com_TxSigInfo[317].InvValueIdxOfTxSigInfo "" UBYTE Com_InvValueIdxOfTxSigInfoType 0 0 0 255 ECU_ADDRESS 0x0 /end MEASUREMENT
/begin MEASUREMENT Com_TxSigInfo[317].InvValueOfTxSigInfo "" UBYTE Com_InvValueOfTxSigInfoType 0 0 0 255 ECU_ADDRESS 0x0 /end MEASUREMENT
/begin MEASUREMENT Com_TxSigInfo[317].OnChangeIdxOfTxSigInfo "" UBYTE Com_OnChangeIdxOfTxSigInfoType 0 0 0 255 ECU_ADDRESS 0x0 /end MEASUREMENT
/begin MEASUREMENT Com_TxSigInfo[317].OnChangeOfTxSigInfo "" UBYTE Com_OnChangeOfTxSigInfoType 0 0 0 255 ECU_ADDRESS 0x0 /end MEASUREMENT
/begin MEASUREMENT Com_TxSigInfo[317].StartByteInPduPositionOfTxSigInfo "" UBYTE NO_COMPU_METHOD 0 0 0 255 ECU_ADDRESS 0x0 /end MEASUREMENT
/begin MEASUREMENT Com_TxSigInfo[317].TxAccessInfoIdxOfTxSigInfo "" UWORD NO_COMPU_METHOD 0 0 0 65535 ECU_ADDRESS 0x0 /end MEASUREMENT
/begin MEASUREMENT Com_TxSigInfo[317].TxBufferEndIdxOfTxSigInfo "" UWORD Com_TxBufferEndIdxOfTxSigInfoType 0 0 0 65535 ECU_ADDRESS 0x0 /end MEASUREMENT
/begin MEASUREMENT Com_TxSigInfo[317].TxBufferStartIdxOfTxSigInfo "" UWORD Com_TxBufferStartIdxOfTxSigInfoType 0 0 0 65535 ECU_ADDRESS 0x0 /end MEASUREMENT
/begin MEASUREMENT Com_TxSigInfo[317].TxFilterInitValueArrayBasedFilterInitValueEndIdxOfTxSigInfo "" UBYTE Com_TxFilterInitValueArrayBasedFilterInitValueEndIdxOfTxSigInfoType 0 0 0 255 ECU_ADDRESS 0x0 /end MEASUREMENT
/begin MEASUREMENT Com_TxSigInfo[317].TxFilterInitValueArrayBasedFilterInitValueStartIdxOfTxSigInfo "" UBYTE Com_TxFilterInitValueArrayBasedFilterInitValueStartIdxOfTxSigInfoType 0 0 0 255 ECU_ADDRESS 0x0 /end MEASUREMENT
/begin MEASUREMENT Com_TxSigInfo[317].TxPduInfoIdxOfTxSigInfo "" UBYTE NO_COMPU_METHOD 0 0 0 255 ECU_ADDRESS 0x0 /end MEASUREMENT
/begin MEASUREMENT Com_TxSigInfo[318].ApplTypeOfTxSigInfo "" UBYTE Com_ApplTypeOfTxSigInfoType 0 0 0 255 ECU_ADDRESS 0x0 /end MEASUREMENT
/begin MEASUREMENT Com_TxSigInfo[318].BitLengthOfTxSigInfo "" UWORD NO_COMPU_METHOD 0 0 0 65535 ECU_ADDRESS 0x0 /end MEASUREMENT
/begin MEASUREMENT Com_TxSigInfo[318].BitPositionOfTxSigInfo "" UWORD NO_COMPU_METHOD 0 0 0 65535 ECU_ADDRESS 0x0 /end MEASUREMENT
/begin MEASUREMENT Com_TxSigInfo[318].BusAccOfTxSigInfo "" UBYTE Com_BusAccOfTxSigInfoType 0 0 0 255 ECU_ADDRESS 0x0 /end MEASUREMENT
/begin MEASUREMENT Com_TxSigInfo[318].ByteLengthOfTxSigInfo "" UBYTE NO_COMPU_METHOD 0 0 0 255 ECU_ADDRESS 0x0 /end MEASUREMENT
/begin MEASUREMENT Com_TxSigInfo[318].DynSignalOfTxSigInfo "" UBYTE Com_DynSignalOfTxSigInfoType 0 0 0 1 ECU_ADDRESS 0x0 /end MEASUREMENT
/begin MEASUREMENT Com_TxSigInfo[318].FilterInitValueIdxOfTxSigInfo "" UBYTE Com_FilterInitValueIdxOfTxSigInfoType 0 0 0 255 ECU_ADDRESS 0x0 /end MEASUREMENT
/begin MEASUREMENT Com_TxSigInfo[318].FilterInitValueOfTxSigInfo "" UBYTE Com_FilterInitValueOfTxSigInfoType 0 0 0 255 ECU_ADDRESS 0x0 /end MEASUREMENT
/begin MEASUREMENT Com_TxSigInfo[318].InvValueIdxOfTxSigInfo "" UBYTE Com_InvValueIdxOfTxSigInfoType 0 0 0 255 ECU_ADDRESS 0x0 /end MEASUREMENT
/begin MEASUREMENT Com_TxSigInfo[318].InvValueOfTxSigInfo "" UBYTE Com_InvValueOfTxSigInfoType 0 0 0 255 ECU_ADDRESS 0x0 /end MEASUREMENT
/begin MEASUREMENT Com_TxSigInfo[318].OnChangeIdxOfTxSigInfo "" UBYTE Com_OnChangeIdxOfTxSigInfoType 0 0 0 255 ECU_ADDRESS 0x0 /end MEASUREMENT
/begin MEASUREMENT Com_TxSigInfo[318].OnChangeOfTxSigInfo "" UBYTE Com_OnChangeOfTxSigInfoType 0 0 0 255 ECU_ADDRESS 0x0 /end MEASUREMENT
/begin MEASUREMENT Com_TxSigInfo[318].StartByteInPduPositionOfTxSigInfo "" UBYTE NO_COMPU_METHOD 0 0 0 255 ECU_ADDRESS 0x0 /end MEASUREMENT
/begin MEASUREMENT Com_TxSigInfo[318].TxAccessInfoIdxOfTxSigInfo "" UWORD NO_COMPU_METHOD 0 0 0 65535 ECU_ADDRESS 0x0 /end MEASUREMENT
/begin MEASUREMENT Com_TxSigInfo[318].TxBufferEndIdxOfTxSigInfo "" UWORD Com_TxBufferEndIdxOfTxSigInfoType 0 0 0 65535 ECU_ADDRESS 0x0 /end MEASUREMENT
/begin MEASUREMENT Com_TxSigInfo[318].TxBufferStartIdxOfTxSigInfo "" UWORD Com_TxBufferStartIdxOfTxSigInfoType 0 0 0 65535 ECU_ADDRESS 0x0 /end MEASUREMENT
/begin MEASUREMENT Com_TxSigInfo[318].TxFilterInitValueArrayBasedFilterInitValueEndIdxOfTxSigInfo "" UBYTE Com_TxFilterInitValueArrayBasedFilterInitValueEndIdxOfTxSigInfoType 0 0 0 255 ECU_ADDRESS 0x0 /end MEASUREMENT
/begin MEASUREMENT Com_TxSigInfo[318].TxFilterInitValueArrayBasedFilterInitValueStartIdxOfTxSigInfo "" UBYTE Com_TxFilterInitValueArrayBasedFilterInitValueStartIdxOfTxSigInfoType 0 0 0 255 ECU_ADDRESS 0x0 /end MEASUREMENT
/begin MEASUREMENT Com_TxSigInfo[318].TxPduInfoIdxOfTxSigInfo "" UBYTE NO_COMPU_METHOD 0 0 0 255 ECU_ADDRESS 0x0 /end MEASUREMENT
/begin MEASUREMENT Com_TxSigInfo[319].ApplTypeOfTxSigInfo "" UBYTE Com_ApplTypeOfTxSigInfoType 0 0 0 255 ECU_ADDRESS 0x0 /end MEASUREMENT
/begin MEASUREMENT Com_TxSigInfo[319].BitLengthOfTxSigInfo "" UWORD NO_COMPU_METHOD 0 0 0 65535 ECU_ADDRESS 0x0 /end MEASUREMENT
/begin MEASUREMENT Com_TxSigInfo[319].BitPositionOfTxSigInfo "" UWORD NO_COMPU_METHOD 0 0 0 65535 ECU_ADDRESS 0x0 /end MEASUREMENT
/begin MEASUREMENT Com_TxSigInfo[319].BusAccOfTxSigInfo "" UBYTE Com_BusAccOfTxSigInfoType 0 0 0 255 ECU_ADDRESS 0x0 /end MEASUREMENT
/begin MEASUREMENT Com_TxSigInfo[319].ByteLengthOfTxSigInfo "" UBYTE NO_COMPU_METHOD 0 0 0 255 ECU_ADDRESS 0x0 /end MEASUREMENT
/begin MEASUREMENT Com_TxSigInfo[319].DynSignalOfTxSigInfo "" UBYTE Com_DynSignalOfTxSigInfoType 0 0 0 1 ECU_ADDRESS 0x0 /end MEASUREMENT
/begin MEASUREMENT Com_TxSigInfo[319].FilterInitValueIdxOfTxSigInfo "" UBYTE Com_FilterInitValueIdxOfTxSigInfoType 0 0 0 255 ECU_ADDRESS 0x0 /end MEASUREMENT
/begin MEASUREMENT Com_TxSigInfo[319].FilterInitValueOfTxSigInfo "" UBYTE Com_FilterInitValueOfTxSigInfoType 0 0 0 255 ECU_ADDRESS 0x0 /end MEASUREMENT
/begin MEASUREMENT Com_TxSigInfo[319].InvValueIdxOfTxSigInfo "" UBYTE Com_InvValueIdxOfTxSigInfoType 0 0 0 255 ECU_ADDRESS 0x0 /end MEASUREMENT
/begin MEASUREMENT Com_TxSigInfo[319].InvValueOfTxSigInfo "" UBYTE Com_InvValueOfTxSigInfoType 0 0 0 255 ECU_ADDRESS 0x0 /end MEASUREMENT
/begin MEASUREMENT Com_TxSigInfo[319].OnChangeIdxOfTxSigInfo "" UBYTE Com_OnChangeIdxOfTxSigInfoType 0 0 0 255 ECU_ADDRESS 0x0 /end MEASUREMENT
/begin MEASUREMENT Com_TxSigInfo[319].OnChangeOfTxSigInfo "" UBYTE Com_OnChangeOfTxSigInfoType 0 0 0 255 ECU_ADDRESS 0x0 /end MEASUREMENT
/begin MEASUREMENT Com_TxSigInfo[319].StartByteInPduPositionOfTxSigInfo "" UBYTE NO_COMPU_METHOD 0 0 0 255 ECU_ADDRESS 0x0 /end MEASUREMENT
/begin MEASUREMENT Com_TxSigInfo[319].TxAccessInfoIdxOfTxSigInfo "" UWORD NO_COMPU_METHOD 0 0 0 65535 ECU_ADDRESS 0x0 /end MEASUREMENT
/begin MEASUREMENT Com_TxSigInfo[319].TxBufferEndIdxOfTxSigInfo "" UWORD Com_TxBufferEndIdxOfTxSigInfoType 0 0 0 65535 ECU_ADDRESS 0x0 /end MEASUREMENT
/begin MEASUREMENT Com_TxSigInfo[319].TxBufferStartIdxOfTxSigInfo "" UWORD Com_TxBufferStartIdxOfTxSigInfoType 0 0 0 65535 ECU_ADDRESS 0x0 /end MEASUREMENT
/begin MEASUREMENT Com_TxSigInfo[319].TxFilterInitValueArrayBasedFilterInitValueEndIdxOfTxSigInfo "" UBYTE Com_TxFilterInitValueArrayBasedFilterInitValueEndIdxOfTxSigInfoType 0 0 0 255 ECU_ADDRESS 0x0 /end MEASUREMENT
/begin MEASUREMENT Com_TxSigInfo[319].TxFilterInitValueArrayBasedFilterInitValueStartIdxOfTxSigInfo "" UBYTE Com_TxFilterInitValueArrayBasedFilterInitValueStartIdxOfTxSigInfoType 0 0 0 255 ECU_ADDRESS 0x0 /end MEASUREMENT
/begin MEASUREMENT Com_TxSigInfo[319].TxPduInfoIdxOfTxSigInfo "" UBYTE NO_COMPU_METHOD 0 0 0 255 ECU_ADDRESS 0x0 /end MEASUREMENT
/begin MEASUREMENT Com_TxSigInfo[31].ApplTypeOfTxSigInfo "" UBYTE Com_ApplTypeOfTxSigInfoType 0 0 0 255 ECU_ADDRESS 0x0 /end MEASUREMENT
/begin MEASUREMENT Com_TxSigInfo[31].BitLengthOfTxSigInfo "" UWORD NO_COMPU_METHOD 0 0 0 65535 ECU_ADDRESS 0x0 /end MEASUREMENT
/begin MEASUREMENT Com_TxSigInfo[31].BitPositionOfTxSigInfo "" UWORD NO_COMPU_METHOD 0 0 0 65535 ECU_ADDRESS 0x0 /end MEASUREMENT
/begin MEASUREMENT Com_TxSigInfo[31].BusAccOfTxSigInfo "" UBYTE Com_BusAccOfTxSigInfoType 0 0 0 255 ECU_ADDRESS 0x0 /end MEASUREMENT
/begin MEASUREMENT Com_TxSigInfo[31].ByteLengthOfTxSigInfo "" UBYTE NO_COMPU_METHOD 0 0 0 255 ECU_ADDRESS 0x0 /end MEASUREMENT
/begin MEASUREMENT Com_TxSigInfo[31].DynSignalOfTxSigInfo "" UBYTE Com_DynSignalOfTxSigInfoType 0 0 0 1 ECU_ADDRESS 0x0 /end MEASUREMENT
/begin MEASUREMENT Com_TxSigInfo[31].FilterInitValueIdxOfTxSigInfo "" UBYTE Com_FilterInitValueIdxOfTxSigInfoType 0 0 0 255 ECU_ADDRESS 0x0 /end MEASUREMENT
/begin MEASUREMENT Com_TxSigInfo[31].FilterInitValueOfTxSigInfo "" UBYTE Com_FilterInitValueOfTxSigInfoType 0 0 0 255 ECU_ADDRESS 0x0 /end MEASUREMENT
/begin MEASUREMENT Com_TxSigInfo[31].InvValueIdxOfTxSigInfo "" UBYTE Com_InvValueIdxOfTxSigInfoType 0 0 0 255 ECU_ADDRESS 0x0 /end MEASUREMENT
/begin MEASUREMENT Com_TxSigInfo[31].InvValueOfTxSigInfo "" UBYTE Com_InvValueOfTxSigInfoType 0 0 0 255 ECU_ADDRESS 0x0 /end MEASUREMENT
/begin MEASUREMENT Com_TxSigInfo[31].OnChangeIdxOfTxSigInfo "" UBYTE Com_OnChangeIdxOfTxSigInfoType 0 0 0 255 ECU_ADDRESS 0x0 /end MEASUREMENT
/begin MEASUREMENT Com_TxSigInfo[31].OnChangeOfTxSigInfo "" UBYTE Com_OnChangeOfTxSigInfoType 0 0 0 255 ECU_ADDRESS 0x0 /end MEASUREMENT
/begin MEASUREMENT Com_TxSigInfo[31].StartByteInPduPositionOfTxSigInfo "" UBYTE NO_COMPU_METHOD 0 0 0 255 ECU_ADDRESS 0x0 /end MEASUREMENT
/begin MEASUREMENT Com_TxSigInfo[31].TxAccessInfoIdxOfTxSigInfo "" UWORD NO_COMPU_METHOD 0 0 0 65535 ECU_ADDRESS 0x0 /end MEASUREMENT
/begin MEASUREMENT Com_TxSigInfo[31].TxBufferEndIdxOfTxSigInfo "" UWORD Com_TxBufferEndIdxOfTxSigInfoType 0 0 0 65535 ECU_ADDRESS 0x0 /end MEASUREMENT
/begin MEASUREMENT Com_TxSigInfo[31].TxBufferStartIdxOfTxSigInfo "" UWORD Com_TxBufferStartIdxOfTxSigInfoType 0 0 0 65535 ECU_ADDRESS 0x0 /end MEASUREMENT
/begin MEASUREMENT Com_TxSigInfo[31].TxFilterInitValueArrayBasedFilterInitValueEndIdxOfTxSigInfo "" UBYTE Com_TxFilterInitValueArrayBasedFilterInitValueEndIdxOfTxSigInfoType 0 0 0 255 ECU_ADDRESS 0x0 /end MEASUREMENT
/begin MEASUREMENT Com_TxSigInfo[31].TxFilterInitValueArrayBasedFilterInitValueStartIdxOfTxSigInfo "" UBYTE Com_TxFilterInitValueArrayBasedFilterInitValueStartIdxOfTxSigInfoType 0 0 0 255 ECU_ADDRESS 0x0 /end MEASUREMENT
/begin MEASUREMENT Com_TxSigInfo[31].TxPduInfoIdxOfTxSigInfo "" UBYTE NO_COMPU_METHOD 0 0 0 255 ECU_ADDRESS 0x0 /end MEASUREMENT
/begin MEASUREMENT Com_TxSigInfo[320].ApplTypeOfTxSigInfo "" UBYTE Com_ApplTypeOfTxSigInfoType 0 0 0 255 ECU_ADDRESS 0x0 /end MEASUREMENT
/begin MEASUREMENT Com_TxSigInfo[320].BitLengthOfTxSigInfo "" UWORD NO_COMPU_METHOD 0 0 0 65535 ECU_ADDRESS 0x0 /end MEASUREMENT
/begin MEASUREMENT Com_TxSigInfo[320].BitPositionOfTxSigInfo "" UWORD NO_COMPU_METHOD 0 0 0 65535 ECU_ADDRESS 0x0 /end MEASUREMENT
/begin MEASUREMENT Com_TxSigInfo[320].BusAccOfTxSigInfo "" UBYTE Com_BusAccOfTxSigInfoType 0 0 0 255 ECU_ADDRESS 0x0 /end MEASUREMENT
/begin MEASUREMENT Com_TxSigInfo[320].ByteLengthOfTxSigInfo "" UBYTE NO_COMPU_METHOD 0 0 0 255 ECU_ADDRESS 0x0 /end MEASUREMENT
/begin MEASUREMENT Com_TxSigInfo[320].DynSignalOfTxSigInfo "" UBYTE Com_DynSignalOfTxSigInfoType 0 0 0 1 ECU_ADDRESS 0x0 /end MEASUREMENT
/begin MEASUREMENT Com_TxSigInfo[320].FilterInitValueIdxOfTxSigInfo "" UBYTE Com_FilterInitValueIdxOfTxSigInfoType 0 0 0 255 ECU_ADDRESS 0x0 /end MEASUREMENT
/begin MEASUREMENT Com_TxSigInfo[320].FilterInitValueOfTxSigInfo "" UBYTE Com_FilterInitValueOfTxSigInfoType 0 0 0 255 ECU_ADDRESS 0x0 /end MEASUREMENT
/begin MEASUREMENT Com_TxSigInfo[320].InvValueIdxOfTxSigInfo "" UBYTE Com_InvValueIdxOfTxSigInfoType 0 0 0 255 ECU_ADDRESS 0x0 /end MEASUREMENT
/begin MEASUREMENT Com_TxSigInfo[320].InvValueOfTxSigInfo "" UBYTE Com_InvValueOfTxSigInfoType 0 0 0 255 ECU_ADDRESS 0x0 /end MEASUREMENT
/begin MEASUREMENT Com_TxSigInfo[320].OnChangeIdxOfTxSigInfo "" UBYTE Com_OnChangeIdxOfTxSigInfoType 0 0 0 255 ECU_ADDRESS 0x0 /end MEASUREMENT
/begin MEASUREMENT Com_TxSigInfo[320].OnChangeOfTxSigInfo "" UBYTE Com_OnChangeOfTxSigInfoType 0 0 0 255 ECU_ADDRESS 0x0 /end MEASUREMENT
/begin MEASUREMENT Com_TxSigInfo[320].StartByteInPduPositionOfTxSigInfo "" UBYTE NO_COMPU_METHOD 0 0 0 255 ECU_ADDRESS 0x0 /end MEASUREMENT
/begin MEASUREMENT Com_TxSigInfo[320].TxAccessInfoIdxOfTxSigInfo "" UWORD NO_COMPU_METHOD 0 0 0 65535 ECU_ADDRESS 0x0 /end MEASUREMENT
/begin MEASUREMENT Com_TxSigInfo[320].TxBufferEndIdxOfTxSigInfo "" UWORD Com_TxBufferEndIdxOfTxSigInfoType 0 0 0 65535 ECU_ADDRESS 0x0 /end MEASUREMENT
/begin MEASUREMENT Com_TxSigInfo[320].TxBufferStartIdxOfTxSigInfo "" UWORD Com_TxBufferStartIdxOfTxSigInfoType 0 0 0 65535 ECU_ADDRESS 0x0 /end MEASUREMENT
/begin MEASUREMENT Com_TxSigInfo[320].TxFilterInitValueArrayBasedFilterInitValueEndIdxOfTxSigInfo "" UBYTE Com_TxFilterInitValueArrayBasedFilterInitValueEndIdxOfTxSigInfoType 0 0 0 255 ECU_ADDRESS 0x0 /end MEASUREMENT
/begin MEASUREMENT Com_TxSigInfo[320].TxFilterInitValueArrayBasedFilterInitValueStartIdxOfTxSigInfo "" UBYTE Com_TxFilterInitValueArrayBasedFilterInitValueStartIdxOfTxSigInfoType 0 0 0 255 ECU_ADDRESS 0x0 /end MEASUREMENT
/begin MEASUREMENT Com_TxSigInfo[320].TxPduInfoIdxOfTxSigInfo "" UBYTE NO_COMPU_METHOD 0 0 0 255 ECU_ADDRESS 0x0 /end MEASUREMENT
/begin MEASUREMENT Com_TxSigInfo[321].ApplTypeOfTxSigInfo "" UBYTE Com_ApplTypeOfTxSigInfoType 0 0 0 255 ECU_ADDRESS 0x0 /end MEASUREMENT
/begin MEASUREMENT Com_TxSigInfo[321].BitLengthOfTxSigInfo "" UWORD NO_COMPU_METHOD 0 0 0 65535 ECU_ADDRESS 0x0 /end MEASUREMENT
/begin MEASUREMENT Com_TxSigInfo[321].BitPositionOfTxSigInfo "" UWORD NO_COMPU_METHOD 0 0 0 65535 ECU_ADDRESS 0x0 /end MEASUREMENT
/begin MEASUREMENT Com_TxSigInfo[321].BusAccOfTxSigInfo "" UBYTE Com_BusAccOfTxSigInfoType 0 0 0 255 ECU_ADDRESS 0x0 /end MEASUREMENT
/begin MEASUREMENT Com_TxSigInfo[321].ByteLengthOfTxSigInfo "" UBYTE NO_COMPU_METHOD 0 0 0 255 ECU_ADDRESS 0x0 /end MEASUREMENT
/begin MEASUREMENT Com_TxSigInfo[321].DynSignalOfTxSigInfo "" UBYTE Com_DynSignalOfTxSigInfoType 0 0 0 1 ECU_ADDRESS 0x0 /end MEASUREMENT
/begin MEASUREMENT Com_TxSigInfo[321].FilterInitValueIdxOfTxSigInfo "" UBYTE Com_FilterInitValueIdxOfTxSigInfoType 0 0 0 255 ECU_ADDRESS 0x0 /end MEASUREMENT
/begin MEASUREMENT Com_TxSigInfo[321].FilterInitValueOfTxSigInfo "" UBYTE Com_FilterInitValueOfTxSigInfoType 0 0 0 255 ECU_ADDRESS 0x0 /end MEASUREMENT
/begin MEASUREMENT Com_TxSigInfo[321].InvValueIdxOfTxSigInfo "" UBYTE Com_InvValueIdxOfTxSigInfoType 0 0 0 255 ECU_ADDRESS 0x0 /end MEASUREMENT
/begin MEASUREMENT Com_TxSigInfo[321].InvValueOfTxSigInfo "" UBYTE Com_InvValueOfTxSigInfoType 0 0 0 255 ECU_ADDRESS 0x0 /end MEASUREMENT
/begin MEASUREMENT Com_TxSigInfo[321].OnChangeIdxOfTxSigInfo "" UBYTE Com_OnChangeIdxOfTxSigInfoType 0 0 0 255 ECU_ADDRESS 0x0 /end MEASUREMENT
/begin MEASUREMENT Com_TxSigInfo[321].OnChangeOfTxSigInfo "" UBYTE Com_OnChangeOfTxSigInfoType 0 0 0 255 ECU_ADDRESS 0x0 /end MEASUREMENT
/begin MEASUREMENT Com_TxSigInfo[321].StartByteInPduPositionOfTxSigInfo "" UBYTE NO_COMPU_METHOD 0 0 0 255 ECU_ADDRESS 0x0 /end MEASUREMENT
/begin MEASUREMENT Com_TxSigInfo[321].TxAccessInfoIdxOfTxSigInfo "" UWORD NO_COMPU_METHOD 0 0 0 65535 ECU_ADDRESS 0x0 /end MEASUREMENT
/begin MEASUREMENT Com_TxSigInfo[321].TxBufferEndIdxOfTxSigInfo "" UWORD Com_TxBufferEndIdxOfTxSigInfoType 0 0 0 65535 ECU_ADDRESS 0x0 /end MEASUREMENT
/begin MEASUREMENT Com_TxSigInfo[321].TxBufferStartIdxOfTxSigInfo "" UWORD Com_TxBufferStartIdxOfTxSigInfoType 0 0 0 65535 ECU_ADDRESS 0x0 /end MEASUREMENT
/begin MEASUREMENT Com_TxSigInfo[321].TxFilterInitValueArrayBasedFilterInitValueEndIdxOfTxSigInfo "" UBYTE Com_TxFilterInitValueArrayBasedFilterInitValueEndIdxOfTxSigInfoType 0 0 0 255 ECU_ADDRESS 0x0 /end MEASUREMENT
/begin MEASUREMENT Com_TxSigInfo[321].TxFilterInitValueArrayBasedFilterInitValueStartIdxOfTxSigInfo "" UBYTE Com_TxFilterInitValueArrayBasedFilterInitValueStartIdxOfTxSigInfoType 0 0 0 255 ECU_ADDRESS 0x0 /end MEASUREMENT
/begin MEASUREMENT Com_TxSigInfo[321].TxPduInfoIdxOfTxSigInfo "" UBYTE NO_COMPU_METHOD 0 0 0 255 ECU_ADDRESS 0x0 /end MEASUREMENT
/begin MEASUREMENT Com_TxSigInfo[322].ApplTypeOfTxSigInfo "" UBYTE Com_ApplTypeOfTxSigInfoType 0 0 0 255 ECU_ADDRESS 0x0 /end MEASUREMENT
/begin MEASUREMENT Com_TxSigInfo[322].BitLengthOfTxSigInfo "" UWORD NO_COMPU_METHOD 0 0 0 65535 ECU_ADDRESS 0x0 /end MEASUREMENT
/begin MEASUREMENT Com_TxSigInfo[322].BitPositionOfTxSigInfo "" UWORD NO_COMPU_METHOD 0 0 0 65535 ECU_ADDRESS 0x0 /end MEASUREMENT
/begin MEASUREMENT Com_TxSigInfo[322].BusAccOfTxSigInfo "" UBYTE Com_BusAccOfTxSigInfoType 0 0 0 255 ECU_ADDRESS 0x0 /end MEASUREMENT
/begin MEASUREMENT Com_TxSigInfo[322].ByteLengthOfTxSigInfo "" UBYTE NO_COMPU_METHOD 0 0 0 255 ECU_ADDRESS 0x0 /end MEASUREMENT
/begin MEASUREMENT Com_TxSigInfo[322].DynSignalOfTxSigInfo "" UBYTE Com_DynSignalOfTxSigInfoType 0 0 0 1 ECU_ADDRESS 0x0 /end MEASUREMENT
/begin MEASUREMENT Com_TxSigInfo[322].FilterInitValueIdxOfTxSigInfo "" UBYTE Com_FilterInitValueIdxOfTxSigInfoType 0 0 0 255 ECU_ADDRESS 0x0 /end MEASUREMENT
/begin MEASUREMENT Com_TxSigInfo[322].FilterInitValueOfTxSigInfo "" UBYTE Com_FilterInitValueOfTxSigInfoType 0 0 0 255 ECU_ADDRESS 0x0 /end MEASUREMENT
/begin MEASUREMENT Com_TxSigInfo[322].InvValueIdxOfTxSigInfo "" UBYTE Com_InvValueIdxOfTxSigInfoType 0 0 0 255 ECU_ADDRESS 0x0 /end MEASUREMENT
/begin MEASUREMENT Com_TxSigInfo[322].InvValueOfTxSigInfo "" UBYTE Com_InvValueOfTxSigInfoType 0 0 0 255 ECU_ADDRESS 0x0 /end MEASUREMENT
/begin MEASUREMENT Com_TxSigInfo[322].OnChangeIdxOfTxSigInfo "" UBYTE Com_OnChangeIdxOfTxSigInfoType 0 0 0 255 ECU_ADDRESS 0x0 /end MEASUREMENT
/begin MEASUREMENT Com_TxSigInfo[322].OnChangeOfTxSigInfo "" UBYTE Com_OnChangeOfTxSigInfoType 0 0 0 255 ECU_ADDRESS 0x0 /end MEASUREMENT
/begin MEASUREMENT Com_TxSigInfo[322].StartByteInPduPositionOfTxSigInfo "" UBYTE NO_COMPU_METHOD 0 0 0 255 ECU_ADDRESS 0x0 /end MEASUREMENT
/begin MEASUREMENT Com_TxSigInfo[322].TxAccessInfoIdxOfTxSigInfo "" UWORD NO_COMPU_METHOD 0 0 0 65535 ECU_ADDRESS 0x0 /end MEASUREMENT
/begin MEASUREMENT Com_TxSigInfo[322].TxBufferEndIdxOfTxSigInfo "" UWORD Com_TxBufferEndIdxOfTxSigInfoType 0 0 0 65535 ECU_ADDRESS 0x0 /end MEASUREMENT
/begin MEASUREMENT Com_TxSigInfo[322].TxBufferStartIdxOfTxSigInfo "" UWORD Com_TxBufferStartIdxOfTxSigInfoType 0 0 0 65535 ECU_ADDRESS 0x0 /end MEASUREMENT
/begin MEASUREMENT Com_TxSigInfo[322].TxFilterInitValueArrayBasedFilterInitValueEndIdxOfTxSigInfo "" UBYTE Com_TxFilterInitValueArrayBasedFilterInitValueEndIdxOfTxSigInfoType 0 0 0 255 ECU_ADDRESS 0x0 /end MEASUREMENT
/begin MEASUREMENT Com_TxSigInfo[322].TxFilterInitValueArrayBasedFilterInitValueStartIdxOfTxSigInfo "" UBYTE Com_TxFilterInitValueArrayBasedFilterInitValueStartIdxOfTxSigInfoType 0 0 0 255 ECU_ADDRESS 0x0 /end MEASUREMENT
/begin MEASUREMENT Com_TxSigInfo[322].TxPduInfoIdxOfTxSigInfo "" UBYTE NO_COMPU_METHOD 0 0 0 255 ECU_ADDRESS 0x0 /end MEASUREMENT
/begin MEASUREMENT Com_TxSigInfo[323].ApplTypeOfTxSigInfo "" UBYTE Com_ApplTypeOfTxSigInfoType 0 0 0 255 ECU_ADDRESS 0x0 /end MEASUREMENT
/begin MEASUREMENT Com_TxSigInfo[323].BitLengthOfTxSigInfo "" UWORD NO_COMPU_METHOD 0 0 0 65535 ECU_ADDRESS 0x0 /end MEASUREMENT
/begin MEASUREMENT Com_TxSigInfo[323].BitPositionOfTxSigInfo "" UWORD NO_COMPU_METHOD 0 0 0 65535 ECU_ADDRESS 0x0 /end MEASUREMENT
/begin MEASUREMENT Com_TxSigInfo[323].BusAccOfTxSigInfo "" UBYTE Com_BusAccOfTxSigInfoType 0 0 0 255 ECU_ADDRESS 0x0 /end MEASUREMENT
/begin MEASUREMENT Com_TxSigInfo[323].ByteLengthOfTxSigInfo "" UBYTE NO_COMPU_METHOD 0 0 0 255 ECU_ADDRESS 0x0 /end MEASUREMENT
/begin MEASUREMENT Com_TxSigInfo[323].DynSignalOfTxSigInfo "" UBYTE Com_DynSignalOfTxSigInfoType 0 0 0 1 ECU_ADDRESS 0x0 /end MEASUREMENT
/begin MEASUREMENT Com_TxSigInfo[323].FilterInitValueIdxOfTxSigInfo "" UBYTE Com_FilterInitValueIdxOfTxSigInfoType 0 0 0 255 ECU_ADDRESS 0x0 /end MEASUREMENT
/begin MEASUREMENT Com_TxSigInfo[323].FilterInitValueOfTxSigInfo "" UBYTE Com_FilterInitValueOfTxSigInfoType 0 0 0 255 ECU_ADDRESS 0x0 /end MEASUREMENT
/begin MEASUREMENT Com_TxSigInfo[323].InvValueIdxOfTxSigInfo "" UBYTE Com_InvValueIdxOfTxSigInfoType 0 0 0 255 ECU_ADDRESS 0x0 /end MEASUREMENT
/begin MEASUREMENT Com_TxSigInfo[323].InvValueOfTxSigInfo "" UBYTE Com_InvValueOfTxSigInfoType 0 0 0 255 ECU_ADDRESS 0x0 /end MEASUREMENT
/begin MEASUREMENT Com_TxSigInfo[323].OnChangeIdxOfTxSigInfo "" UBYTE Com_OnChangeIdxOfTxSigInfoType 0 0 0 255 ECU_ADDRESS 0x0 /end MEASUREMENT
/begin MEASUREMENT Com_TxSigInfo[323].OnChangeOfTxSigInfo "" UBYTE Com_OnChangeOfTxSigInfoType 0 0 0 255 ECU_ADDRESS 0x0 /end MEASUREMENT
/begin MEASUREMENT Com_TxSigInfo[323].StartByteInPduPositionOfTxSigInfo "" UBYTE NO_COMPU_METHOD 0 0 0 255 ECU_ADDRESS 0x0 /end MEASUREMENT
/begin MEASUREMENT Com_TxSigInfo[323].TxAccessInfoIdxOfTxSigInfo "" UWORD NO_COMPU_METHOD 0 0 0 65535 ECU_ADDRESS 0x0 /end MEASUREMENT
/begin MEASUREMENT Com_TxSigInfo[323].TxBufferEndIdxOfTxSigInfo "" UWORD Com_TxBufferEndIdxOfTxSigInfoType 0 0 0 65535 ECU_ADDRESS 0x0 /end MEASUREMENT
/begin MEASUREMENT Com_TxSigInfo[323].TxBufferStartIdxOfTxSigInfo "" UWORD Com_TxBufferStartIdxOfTxSigInfoType 0 0 0 65535 ECU_ADDRESS 0x0 /end MEASUREMENT
/begin MEASUREMENT Com_TxSigInfo[323].TxFilterInitValueArrayBasedFilterInitValueEndIdxOfTxSigInfo "" UBYTE Com_TxFilterInitValueArrayBasedFilterInitValueEndIdxOfTxSigInfoType 0 0 0 255 ECU_ADDRESS 0x0 /end MEASUREMENT
/begin MEASUREMENT Com_TxSigInfo[323].TxFilterInitValueArrayBasedFilterInitValueStartIdxOfTxSigInfo "" UBYTE Com_TxFilterInitValueArrayBasedFilterInitValueStartIdxOfTxSigInfoType 0 0 0 255 ECU_ADDRESS 0x0 /end MEASUREMENT
/begin MEASUREMENT Com_TxSigInfo[323].TxPduInfoIdxOfTxSigInfo "" UBYTE NO_COMPU_METHOD 0 0 0 255 ECU_ADDRESS 0x0 /end MEASUREMENT
/begin MEASUREMENT Com_TxSigInfo[324].ApplTypeOfTxSigInfo "" UBYTE Com_ApplTypeOfTxSigInfoType 0 0 0 255 ECU_ADDRESS 0x0 /end MEASUREMENT
/begin MEASUREMENT Com_TxSigInfo[324].BitLengthOfTxSigInfo "" UWORD NO_COMPU_METHOD 0 0 0 65535 ECU_ADDRESS 0x0 /end MEASUREMENT
/begin MEASUREMENT Com_TxSigInfo[324].BitPositionOfTxSigInfo "" UWORD NO_COMPU_METHOD 0 0 0 65535 ECU_ADDRESS 0x0 /end MEASUREMENT
/begin MEASUREMENT Com_TxSigInfo[324].BusAccOfTxSigInfo "" UBYTE Com_BusAccOfTxSigInfoType 0 0 0 255 ECU_ADDRESS 0x0 /end MEASUREMENT
/begin MEASUREMENT Com_TxSigInfo[324].ByteLengthOfTxSigInfo "" UBYTE NO_COMPU_METHOD 0 0 0 255 ECU_ADDRESS 0x0 /end MEASUREMENT
/begin MEASUREMENT Com_TxSigInfo[324].DynSignalOfTxSigInfo "" UBYTE Com_DynSignalOfTxSigInfoType 0 0 0 1 ECU_ADDRESS 0x0 /end MEASUREMENT
/begin MEASUREMENT Com_TxSigInfo[324].FilterInitValueIdxOfTxSigInfo "" UBYTE Com_FilterInitValueIdxOfTxSigInfoType 0 0 0 255 ECU_ADDRESS 0x0 /end MEASUREMENT
/begin MEASUREMENT Com_TxSigInfo[324].FilterInitValueOfTxSigInfo "" UBYTE Com_FilterInitValueOfTxSigInfoType 0 0 0 255 ECU_ADDRESS 0x0 /end MEASUREMENT
/begin MEASUREMENT Com_TxSigInfo[324].InvValueIdxOfTxSigInfo "" UBYTE Com_InvValueIdxOfTxSigInfoType 0 0 0 255 ECU_ADDRESS 0x0 /end MEASUREMENT
/begin MEASUREMENT Com_TxSigInfo[324].InvValueOfTxSigInfo "" UBYTE Com_InvValueOfTxSigInfoType 0 0 0 255 ECU_ADDRESS 0x0 /end MEASUREMENT
/begin MEASUREMENT Com_TxSigInfo[324].OnChangeIdxOfTxSigInfo "" UBYTE Com_OnChangeIdxOfTxSigInfoType 0 0 0 255 ECU_ADDRESS 0x0 /end MEASUREMENT
/begin MEASUREMENT Com_TxSigInfo[324].OnChangeOfTxSigInfo "" UBYTE Com_OnChangeOfTxSigInfoType 0 0 0 255 ECU_ADDRESS 0x0 /end MEASUREMENT
/begin MEASUREMENT Com_TxSigInfo[324].StartByteInPduPositionOfTxSigInfo "" UBYTE NO_COMPU_METHOD 0 0 0 255 ECU_ADDRESS 0x0 /end MEASUREMENT
/begin MEASUREMENT Com_TxSigInfo[324].TxAccessInfoIdxOfTxSigInfo "" UWORD NO_COMPU_METHOD 0 0 0 65535 ECU_ADDRESS 0x0 /end MEASUREMENT
/begin MEASUREMENT Com_TxSigInfo[324].TxBufferEndIdxOfTxSigInfo "" UWORD Com_TxBufferEndIdxOfTxSigInfoType 0 0 0 65535 ECU_ADDRESS 0x0 /end MEASUREMENT
/begin MEASUREMENT Com_TxSigInfo[324].TxBufferStartIdxOfTxSigInfo "" UWORD Com_TxBufferStartIdxOfTxSigInfoType 0 0 0 65535 ECU_ADDRESS 0x0 /end MEASUREMENT
/begin MEASUREMENT Com_TxSigInfo[324].TxFilterInitValueArrayBasedFilterInitValueEndIdxOfTxSigInfo "" UBYTE Com_TxFilterInitValueArrayBasedFilterInitValueEndIdxOfTxSigInfoType 0 0 0 255 ECU_ADDRESS 0x0 /end MEASUREMENT
/begin MEASUREMENT Com_TxSigInfo[324].TxFilterInitValueArrayBasedFilterInitValueStartIdxOfTxSigInfo "" UBYTE Com_TxFilterInitValueArrayBasedFilterInitValueStartIdxOfTxSigInfoType 0 0 0 255 ECU_ADDRESS 0x0 /end MEASUREMENT
/begin MEASUREMENT Com_TxSigInfo[324].TxPduInfoIdxOfTxSigInfo "" UBYTE NO_COMPU_METHOD 0 0 0 255 ECU_ADDRESS 0x0 /end MEASUREMENT
/begin MEASUREMENT Com_TxSigInfo[325].ApplTypeOfTxSigInfo "" UBYTE Com_ApplTypeOfTxSigInfoType 0 0 0 255 ECU_ADDRESS 0x0 /end MEASUREMENT
/begin MEASUREMENT Com_TxSigInfo[325].BitLengthOfTxSigInfo "" UWORD NO_COMPU_METHOD 0 0 0 65535 ECU_ADDRESS 0x0 /end MEASUREMENT
/begin MEASUREMENT Com_TxSigInfo[325].BitPositionOfTxSigInfo "" UWORD NO_COMPU_METHOD 0 0 0 65535 ECU_ADDRESS 0x0 /end MEASUREMENT
/begin MEASUREMENT Com_TxSigInfo[325].BusAccOfTxSigInfo "" UBYTE Com_BusAccOfTxSigInfoType 0 0 0 255 ECU_ADDRESS 0x0 /end MEASUREMENT
/begin MEASUREMENT Com_TxSigInfo[325].ByteLengthOfTxSigInfo "" UBYTE NO_COMPU_METHOD 0 0 0 255 ECU_ADDRESS 0x0 /end MEASUREMENT
/begin MEASUREMENT Com_TxSigInfo[325].DynSignalOfTxSigInfo "" UBYTE Com_DynSignalOfTxSigInfoType 0 0 0 1 ECU_ADDRESS 0x0 /end MEASUREMENT
/begin MEASUREMENT Com_TxSigInfo[325].FilterInitValueIdxOfTxSigInfo "" UBYTE Com_FilterInitValueIdxOfTxSigInfoType 0 0 0 255 ECU_ADDRESS 0x0 /end MEASUREMENT
/begin MEASUREMENT Com_TxSigInfo[325].FilterInitValueOfTxSigInfo "" UBYTE Com_FilterInitValueOfTxSigInfoType 0 0 0 255 ECU_ADDRESS 0x0 /end MEASUREMENT
/begin MEASUREMENT Com_TxSigInfo[325].InvValueIdxOfTxSigInfo "" UBYTE Com_InvValueIdxOfTxSigInfoType 0 0 0 255 ECU_ADDRESS 0x0 /end MEASUREMENT
/begin MEASUREMENT Com_TxSigInfo[325].InvValueOfTxSigInfo "" UBYTE Com_InvValueOfTxSigInfoType 0 0 0 255 ECU_ADDRESS 0x0 /end MEASUREMENT
/begin MEASUREMENT Com_TxSigInfo[325].OnChangeIdxOfTxSigInfo "" UBYTE Com_OnChangeIdxOfTxSigInfoType 0 0 0 255 ECU_ADDRESS 0x0 /end MEASUREMENT
/begin MEASUREMENT Com_TxSigInfo[325].OnChangeOfTxSigInfo "" UBYTE Com_OnChangeOfTxSigInfoType 0 0 0 255 ECU_ADDRESS 0x0 /end MEASUREMENT
/begin MEASUREMENT Com_TxSigInfo[325].StartByteInPduPositionOfTxSigInfo "" UBYTE NO_COMPU_METHOD 0 0 0 255 ECU_ADDRESS 0x0 /end MEASUREMENT
/begin MEASUREMENT Com_TxSigInfo[325].TxAccessInfoIdxOfTxSigInfo "" UWORD NO_COMPU_METHOD 0 0 0 65535 ECU_ADDRESS 0x0 /end MEASUREMENT
/begin MEASUREMENT Com_TxSigInfo[325].TxBufferEndIdxOfTxSigInfo "" UWORD Com_TxBufferEndIdxOfTxSigInfoType 0 0 0 65535 ECU_ADDRESS 0x0 /end MEASUREMENT
/begin MEASUREMENT Com_TxSigInfo[325].TxBufferStartIdxOfTxSigInfo "" UWORD Com_TxBufferStartIdxOfTxSigInfoType 0 0 0 65535 ECU_ADDRESS 0x0 /end MEASUREMENT
/begin MEASUREMENT Com_TxSigInfo[325].TxFilterInitValueArrayBasedFilterInitValueEndIdxOfTxSigInfo "" UBYTE Com_TxFilterInitValueArrayBasedFilterInitValueEndIdxOfTxSigInfoType 0 0 0 255 ECU_ADDRESS 0x0 /end MEASUREMENT
/begin MEASUREMENT Com_TxSigInfo[325].TxFilterInitValueArrayBasedFilterInitValueStartIdxOfTxSigInfo "" UBYTE Com_TxFilterInitValueArrayBasedFilterInitValueStartIdxOfTxSigInfoType 0 0 0 255 ECU_ADDRESS 0x0 /end MEASUREMENT
/begin MEASUREMENT Com_TxSigInfo[325].TxPduInfoIdxOfTxSigInfo "" UBYTE NO_COMPU_METHOD 0 0 0 255 ECU_ADDRESS 0x0 /end MEASUREMENT
/begin MEASUREMENT Com_TxSigInfo[326].ApplTypeOfTxSigInfo "" UBYTE Com_ApplTypeOfTxSigInfoType 0 0 0 255 ECU_ADDRESS 0x0 /end MEASUREMENT
/begin MEASUREMENT Com_TxSigInfo[326].BitLengthOfTxSigInfo "" UWORD NO_COMPU_METHOD 0 0 0 65535 ECU_ADDRESS 0x0 /end MEASUREMENT
/begin MEASUREMENT Com_TxSigInfo[326].BitPositionOfTxSigInfo "" UWORD NO_COMPU_METHOD 0 0 0 65535 ECU_ADDRESS 0x0 /end MEASUREMENT
/begin MEASUREMENT Com_TxSigInfo[326].BusAccOfTxSigInfo "" UBYTE Com_BusAccOfTxSigInfoType 0 0 0 255 ECU_ADDRESS 0x0 /end MEASUREMENT
/begin MEASUREMENT Com_TxSigInfo[326].ByteLengthOfTxSigInfo "" UBYTE NO_COMPU_METHOD 0 0 0 255 ECU_ADDRESS 0x0 /end MEASUREMENT
/begin MEASUREMENT Com_TxSigInfo[326].DynSignalOfTxSigInfo "" UBYTE Com_DynSignalOfTxSigInfoType 0 0 0 1 ECU_ADDRESS 0x0 /end MEASUREMENT
/begin MEASUREMENT Com_TxSigInfo[326].FilterInitValueIdxOfTxSigInfo "" UBYTE Com_FilterInitValueIdxOfTxSigInfoType 0 0 0 255 ECU_ADDRESS 0x0 /end MEASUREMENT
/begin MEASUREMENT Com_TxSigInfo[326].FilterInitValueOfTxSigInfo "" UBYTE Com_FilterInitValueOfTxSigInfoType 0 0 0 255 ECU_ADDRESS 0x0 /end MEASUREMENT
/begin MEASUREMENT Com_TxSigInfo[326].InvValueIdxOfTxSigInfo "" UBYTE Com_InvValueIdxOfTxSigInfoType 0 0 0 255 ECU_ADDRESS 0x0 /end MEASUREMENT
/begin MEASUREMENT Com_TxSigInfo[326].InvValueOfTxSigInfo "" UBYTE Com_InvValueOfTxSigInfoType 0 0 0 255 ECU_ADDRESS 0x0 /end MEASUREMENT
/begin MEASUREMENT Com_TxSigInfo[326].OnChangeIdxOfTxSigInfo "" UBYTE Com_OnChangeIdxOfTxSigInfoType 0 0 0 255 ECU_ADDRESS 0x0 /end MEASUREMENT
/begin MEASUREMENT Com_TxSigInfo[326].OnChangeOfTxSigInfo "" UBYTE Com_OnChangeOfTxSigInfoType 0 0 0 255 ECU_ADDRESS 0x0 /end MEASUREMENT
/begin MEASUREMENT Com_TxSigInfo[326].StartByteInPduPositionOfTxSigInfo "" UBYTE NO_COMPU_METHOD 0 0 0 255 ECU_ADDRESS 0x0 /end MEASUREMENT
/begin MEASUREMENT Com_TxSigInfo[326].TxAccessInfoIdxOfTxSigInfo "" UWORD NO_COMPU_METHOD 0 0 0 65535 ECU_ADDRESS 0x0 /end MEASUREMENT
/begin MEASUREMENT Com_TxSigInfo[326].TxBufferEndIdxOfTxSigInfo "" UWORD Com_TxBufferEndIdxOfTxSigInfoType 0 0 0 65535 ECU_ADDRESS 0x0 /end MEASUREMENT
/begin MEASUREMENT Com_TxSigInfo[326].TxBufferStartIdxOfTxSigInfo "" UWORD Com_TxBufferStartIdxOfTxSigInfoType 0 0 0 65535 ECU_ADDRESS 0x0 /end MEASUREMENT
/begin MEASUREMENT Com_TxSigInfo[326].TxFilterInitValueArrayBasedFilterInitValueEndIdxOfTxSigInfo "" UBYTE Com_TxFilterInitValueArrayBasedFilterInitValueEndIdxOfTxSigInfoType 0 0 0 255 ECU_ADDRESS 0x0 /end MEASUREMENT
/begin MEASUREMENT Com_TxSigInfo[326].TxFilterInitValueArrayBasedFilterInitValueStartIdxOfTxSigInfo "" UBYTE Com_TxFilterInitValueArrayBasedFilterInitValueStartIdxOfTxSigInfoType 0 0 0 255 ECU_ADDRESS 0x0 /end MEASUREMENT
/begin MEASUREMENT Com_TxSigInfo[326].TxPduInfoIdxOfTxSigInfo "" UBYTE NO_COMPU_METHOD 0 0 0 255 ECU_ADDRESS 0x0 /end MEASUREMENT
/begin MEASUREMENT Com_TxSigInfo[327].ApplTypeOfTxSigInfo "" UBYTE Com_ApplTypeOfTxSigInfoType 0 0 0 255 ECU_ADDRESS 0x0 /end MEASUREMENT
/begin MEASUREMENT Com_TxSigInfo[327].BitLengthOfTxSigInfo "" UWORD NO_COMPU_METHOD 0 0 0 65535 ECU_ADDRESS 0x0 /end MEASUREMENT
/begin MEASUREMENT Com_TxSigInfo[327].BitPositionOfTxSigInfo "" UWORD NO_COMPU_METHOD 0 0 0 65535 ECU_ADDRESS 0x0 /end MEASUREMENT
/begin MEASUREMENT Com_TxSigInfo[327].BusAccOfTxSigInfo "" UBYTE Com_BusAccOfTxSigInfoType 0 0 0 255 ECU_ADDRESS 0x0 /end MEASUREMENT
/begin MEASUREMENT Com_TxSigInfo[327].ByteLengthOfTxSigInfo "" UBYTE NO_COMPU_METHOD 0 0 0 255 ECU_ADDRESS 0x0 /end MEASUREMENT
/begin MEASUREMENT Com_TxSigInfo[327].DynSignalOfTxSigInfo "" UBYTE Com_DynSignalOfTxSigInfoType 0 0 0 1 ECU_ADDRESS 0x0 /end MEASUREMENT
/begin MEASUREMENT Com_TxSigInfo[327].FilterInitValueIdxOfTxSigInfo "" UBYTE Com_FilterInitValueIdxOfTxSigInfoType 0 0 0 255 ECU_ADDRESS 0x0 /end MEASUREMENT
/begin MEASUREMENT Com_TxSigInfo[327].FilterInitValueOfTxSigInfo "" UBYTE Com_FilterInitValueOfTxSigInfoType 0 0 0 255 ECU_ADDRESS 0x0 /end MEASUREMENT
/begin MEASUREMENT Com_TxSigInfo[327].InvValueIdxOfTxSigInfo "" UBYTE Com_InvValueIdxOfTxSigInfoType 0 0 0 255 ECU_ADDRESS 0x0 /end MEASUREMENT
/begin MEASUREMENT Com_TxSigInfo[327].InvValueOfTxSigInfo "" UBYTE Com_InvValueOfTxSigInfoType 0 0 0 255 ECU_ADDRESS 0x0 /end MEASUREMENT
/begin MEASUREMENT Com_TxSigInfo[327].OnChangeIdxOfTxSigInfo "" UBYTE Com_OnChangeIdxOfTxSigInfoType 0 0 0 255 ECU_ADDRESS 0x0 /end MEASUREMENT
/begin MEASUREMENT Com_TxSigInfo[327].OnChangeOfTxSigInfo "" UBYTE Com_OnChangeOfTxSigInfoType 0 0 0 255 ECU_ADDRESS 0x0 /end MEASUREMENT
/begin MEASUREMENT Com_TxSigInfo[327].StartByteInPduPositionOfTxSigInfo "" UBYTE NO_COMPU_METHOD 0 0 0 255 ECU_ADDRESS 0x0 /end MEASUREMENT
/begin MEASUREMENT Com_TxSigInfo[327].TxAccessInfoIdxOfTxSigInfo "" UWORD NO_COMPU_METHOD 0 0 0 65535 ECU_ADDRESS 0x0 /end MEASUREMENT
/begin MEASUREMENT Com_TxSigInfo[327].TxBufferEndIdxOfTxSigInfo "" UWORD Com_TxBufferEndIdxOfTxSigInfoType 0 0 0 65535 ECU_ADDRESS 0x0 /end MEASUREMENT
/begin MEASUREMENT Com_TxSigInfo[327].TxBufferStartIdxOfTxSigInfo "" UWORD Com_TxBufferStartIdxOfTxSigInfoType 0 0 0 65535 ECU_ADDRESS 0x0 /end MEASUREMENT
/begin MEASUREMENT Com_TxSigInfo[327].TxFilterInitValueArrayBasedFilterInitValueEndIdxOfTxSigInfo "" UBYTE Com_TxFilterInitValueArrayBasedFilterInitValueEndIdxOfTxSigInfoType 0 0 0 255 ECU_ADDRESS 0x0 /end MEASUREMENT
/begin MEASUREMENT Com_TxSigInfo[327].TxFilterInitValueArrayBasedFilterInitValueStartIdxOfTxSigInfo "" UBYTE Com_TxFilterInitValueArrayBasedFilterInitValueStartIdxOfTxSigInfoType 0 0 0 255 ECU_ADDRESS 0x0 /end MEASUREMENT
/begin MEASUREMENT Com_TxSigInfo[327].TxPduInfoIdxOfTxSigInfo "" UBYTE NO_COMPU_METHOD 0 0 0 255 ECU_ADDRESS 0x0 /end MEASUREMENT
/begin MEASUREMENT Com_TxSigInfo[328].ApplTypeOfTxSigInfo "" UBYTE Com_ApplTypeOfTxSigInfoType 0 0 0 255 ECU_ADDRESS 0x0 /end MEASUREMENT
/begin MEASUREMENT Com_TxSigInfo[328].BitLengthOfTxSigInfo "" UWORD NO_COMPU_METHOD 0 0 0 65535 ECU_ADDRESS 0x0 /end MEASUREMENT
/begin MEASUREMENT Com_TxSigInfo[328].BitPositionOfTxSigInfo "" UWORD NO_COMPU_METHOD 0 0 0 65535 ECU_ADDRESS 0x0 /end MEASUREMENT
/begin MEASUREMENT Com_TxSigInfo[328].BusAccOfTxSigInfo "" UBYTE Com_BusAccOfTxSigInfoType 0 0 0 255 ECU_ADDRESS 0x0 /end MEASUREMENT
/begin MEASUREMENT Com_TxSigInfo[328].ByteLengthOfTxSigInfo "" UBYTE NO_COMPU_METHOD 0 0 0 255 ECU_ADDRESS 0x0 /end MEASUREMENT
/begin MEASUREMENT Com_TxSigInfo[328].DynSignalOfTxSigInfo "" UBYTE Com_DynSignalOfTxSigInfoType 0 0 0 1 ECU_ADDRESS 0x0 /end MEASUREMENT
/begin MEASUREMENT Com_TxSigInfo[328].FilterInitValueIdxOfTxSigInfo "" UBYTE Com_FilterInitValueIdxOfTxSigInfoType 0 0 0 255 ECU_ADDRESS 0x0 /end MEASUREMENT
/begin MEASUREMENT Com_TxSigInfo[328].FilterInitValueOfTxSigInfo "" UBYTE Com_FilterInitValueOfTxSigInfoType 0 0 0 255 ECU_ADDRESS 0x0 /end MEASUREMENT
/begin MEASUREMENT Com_TxSigInfo[328].InvValueIdxOfTxSigInfo "" UBYTE Com_InvValueIdxOfTxSigInfoType 0 0 0 255 ECU_ADDRESS 0x0 /end MEASUREMENT
/begin MEASUREMENT Com_TxSigInfo[328].InvValueOfTxSigInfo "" UBYTE Com_InvValueOfTxSigInfoType 0 0 0 255 ECU_ADDRESS 0x0 /end MEASUREMENT
/begin MEASUREMENT Com_TxSigInfo[328].OnChangeIdxOfTxSigInfo "" UBYTE Com_OnChangeIdxOfTxSigInfoType 0 0 0 255 ECU_ADDRESS 0x0 /end MEASUREMENT
/begin MEASUREMENT Com_TxSigInfo[328].OnChangeOfTxSigInfo "" UBYTE Com_OnChangeOfTxSigInfoType 0 0 0 255 ECU_ADDRESS 0x0 /end MEASUREMENT
/begin MEASUREMENT Com_TxSigInfo[328].StartByteInPduPositionOfTxSigInfo "" UBYTE NO_COMPU_METHOD 0 0 0 255 ECU_ADDRESS 0x0 /end MEASUREMENT
/begin MEASUREMENT Com_TxSigInfo[328].TxAccessInfoIdxOfTxSigInfo "" UWORD NO_COMPU_METHOD 0 0 0 65535 ECU_ADDRESS 0x0 /end MEASUREMENT
/begin MEASUREMENT Com_TxSigInfo[328].TxBufferEndIdxOfTxSigInfo "" UWORD Com_TxBufferEndIdxOfTxSigInfoType 0 0 0 65535 ECU_ADDRESS 0x0 /end MEASUREMENT
/begin MEASUREMENT Com_TxSigInfo[328].TxBufferStartIdxOfTxSigInfo "" UWORD Com_TxBufferStartIdxOfTxSigInfoType 0 0 0 65535 ECU_ADDRESS 0x0 /end MEASUREMENT
/begin MEASUREMENT Com_TxSigInfo[328].TxFilterInitValueArrayBasedFilterInitValueEndIdxOfTxSigInfo "" UBYTE Com_TxFilterInitValueArrayBasedFilterInitValueEndIdxOfTxSigInfoType 0 0 0 255 ECU_ADDRESS 0x0 /end MEASUREMENT
/begin MEASUREMENT Com_TxSigInfo[328].TxFilterInitValueArrayBasedFilterInitValueStartIdxOfTxSigInfo "" UBYTE Com_TxFilterInitValueArrayBasedFilterInitValueStartIdxOfTxSigInfoType 0 0 0 255 ECU_ADDRESS 0x0 /end MEASUREMENT
/begin MEASUREMENT Com_TxSigInfo[328].TxPduInfoIdxOfTxSigInfo "" UBYTE NO_COMPU_METHOD 0 0 0 255 ECU_ADDRESS 0x0 /end MEASUREMENT
/begin MEASUREMENT Com_TxSigInfo[329].ApplTypeOfTxSigInfo "" UBYTE Com_ApplTypeOfTxSigInfoType 0 0 0 255 ECU_ADDRESS 0x0 /end MEASUREMENT
/begin MEASUREMENT Com_TxSigInfo[329].BitLengthOfTxSigInfo "" UWORD NO_COMPU_METHOD 0 0 0 65535 ECU_ADDRESS 0x0 /end MEASUREMENT
/begin MEASUREMENT Com_TxSigInfo[329].BitPositionOfTxSigInfo "" UWORD NO_COMPU_METHOD 0 0 0 65535 ECU_ADDRESS 0x0 /end MEASUREMENT
/begin MEASUREMENT Com_TxSigInfo[329].BusAccOfTxSigInfo "" UBYTE Com_BusAccOfTxSigInfoType 0 0 0 255 ECU_ADDRESS 0x0 /end MEASUREMENT
/begin MEASUREMENT Com_TxSigInfo[329].ByteLengthOfTxSigInfo "" UBYTE NO_COMPU_METHOD 0 0 0 255 ECU_ADDRESS 0x0 /end MEASUREMENT
/begin MEASUREMENT Com_TxSigInfo[329].DynSignalOfTxSigInfo "" UBYTE Com_DynSignalOfTxSigInfoType 0 0 0 1 ECU_ADDRESS 0x0 /end MEASUREMENT
/begin MEASUREMENT Com_TxSigInfo[329].FilterInitValueIdxOfTxSigInfo "" UBYTE Com_FilterInitValueIdxOfTxSigInfoType 0 0 0 255 ECU_ADDRESS 0x0 /end MEASUREMENT
/begin MEASUREMENT Com_TxSigInfo[329].FilterInitValueOfTxSigInfo "" UBYTE Com_FilterInitValueOfTxSigInfoType 0 0 0 255 ECU_ADDRESS 0x0 /end MEASUREMENT
/begin MEASUREMENT Com_TxSigInfo[329].InvValueIdxOfTxSigInfo "" UBYTE Com_InvValueIdxOfTxSigInfoType 0 0 0 255 ECU_ADDRESS 0x0 /end MEASUREMENT
/begin MEASUREMENT Com_TxSigInfo[329].InvValueOfTxSigInfo "" UBYTE Com_InvValueOfTxSigInfoType 0 0 0 255 ECU_ADDRESS 0x0 /end MEASUREMENT
/begin MEASUREMENT Com_TxSigInfo[329].OnChangeIdxOfTxSigInfo "" UBYTE Com_OnChangeIdxOfTxSigInfoType 0 0 0 255 ECU_ADDRESS 0x0 /end MEASUREMENT
/begin MEASUREMENT Com_TxSigInfo[329].OnChangeOfTxSigInfo "" UBYTE Com_OnChangeOfTxSigInfoType 0 0 0 255 ECU_ADDRESS 0x0 /end MEASUREMENT
/begin MEASUREMENT Com_TxSigInfo[329].StartByteInPduPositionOfTxSigInfo "" UBYTE NO_COMPU_METHOD 0 0 0 255 ECU_ADDRESS 0x0 /end MEASUREMENT
/begin MEASUREMENT Com_TxSigInfo[329].TxAccessInfoIdxOfTxSigInfo "" UWORD NO_COMPU_METHOD 0 0 0 65535 ECU_ADDRESS 0x0 /end MEASUREMENT
/begin MEASUREMENT Com_TxSigInfo[329].TxBufferEndIdxOfTxSigInfo "" UWORD Com_TxBufferEndIdxOfTxSigInfoType 0 0 0 65535 ECU_ADDRESS 0x0 /end MEASUREMENT
/begin MEASUREMENT Com_TxSigInfo[329].TxBufferStartIdxOfTxSigInfo "" UWORD Com_TxBufferStartIdxOfTxSigInfoType 0 0 0 65535 ECU_ADDRESS 0x0 /end MEASUREMENT
/begin MEASUREMENT Com_TxSigInfo[329].TxFilterInitValueArrayBasedFilterInitValueEndIdxOfTxSigInfo "" UBYTE Com_TxFilterInitValueArrayBasedFilterInitValueEndIdxOfTxSigInfoType 0 0 0 255 ECU_ADDRESS 0x0 /end MEASUREMENT
/begin MEASUREMENT Com_TxSigInfo[329].TxFilterInitValueArrayBasedFilterInitValueStartIdxOfTxSigInfo "" UBYTE Com_TxFilterInitValueArrayBasedFilterInitValueStartIdxOfTxSigInfoType 0 0 0 255 ECU_ADDRESS 0x0 /end MEASUREMENT
/begin MEASUREMENT Com_TxSigInfo[329].TxPduInfoIdxOfTxSigInfo "" UBYTE NO_COMPU_METHOD 0 0 0 255 ECU_ADDRESS 0x0 /end MEASUREMENT
/begin MEASUREMENT Com_TxSigInfo[32].ApplTypeOfTxSigInfo "" UBYTE Com_ApplTypeOfTxSigInfoType 0 0 0 255 ECU_ADDRESS 0x0 /end MEASUREMENT
/begin MEASUREMENT Com_TxSigInfo[32].BitLengthOfTxSigInfo "" UWORD NO_COMPU_METHOD 0 0 0 65535 ECU_ADDRESS 0x0 /end MEASUREMENT
/begin MEASUREMENT Com_TxSigInfo[32].BitPositionOfTxSigInfo "" UWORD NO_COMPU_METHOD 0 0 0 65535 ECU_ADDRESS 0x0 /end MEASUREMENT
/begin MEASUREMENT Com_TxSigInfo[32].BusAccOfTxSigInfo "" UBYTE Com_BusAccOfTxSigInfoType 0 0 0 255 ECU_ADDRESS 0x0 /end MEASUREMENT
/begin MEASUREMENT Com_TxSigInfo[32].ByteLengthOfTxSigInfo "" UBYTE NO_COMPU_METHOD 0 0 0 255 ECU_ADDRESS 0x0 /end MEASUREMENT
/begin MEASUREMENT Com_TxSigInfo[32].DynSignalOfTxSigInfo "" UBYTE Com_DynSignalOfTxSigInfoType 0 0 0 1 ECU_ADDRESS 0x0 /end MEASUREMENT
/begin MEASUREMENT Com_TxSigInfo[32].FilterInitValueIdxOfTxSigInfo "" UBYTE Com_FilterInitValueIdxOfTxSigInfoType 0 0 0 255 ECU_ADDRESS 0x0 /end MEASUREMENT
/begin MEASUREMENT Com_TxSigInfo[32].FilterInitValueOfTxSigInfo "" UBYTE Com_FilterInitValueOfTxSigInfoType 0 0 0 255 ECU_ADDRESS 0x0 /end MEASUREMENT
/begin MEASUREMENT Com_TxSigInfo[32].InvValueIdxOfTxSigInfo "" UBYTE Com_InvValueIdxOfTxSigInfoType 0 0 0 255 ECU_ADDRESS 0x0 /end MEASUREMENT
/begin MEASUREMENT Com_TxSigInfo[32].InvValueOfTxSigInfo "" UBYTE Com_InvValueOfTxSigInfoType 0 0 0 255 ECU_ADDRESS 0x0 /end MEASUREMENT
/begin MEASUREMENT Com_TxSigInfo[32].OnChangeIdxOfTxSigInfo "" UBYTE Com_OnChangeIdxOfTxSigInfoType 0 0 0 255 ECU_ADDRESS 0x0 /end MEASUREMENT
/begin MEASUREMENT Com_TxSigInfo[32].OnChangeOfTxSigInfo "" UBYTE Com_OnChangeOfTxSigInfoType 0 0 0 255 ECU_ADDRESS 0x0 /end MEASUREMENT
/begin MEASUREMENT Com_TxSigInfo[32].StartByteInPduPositionOfTxSigInfo "" UBYTE NO_COMPU_METHOD 0 0 0 255 ECU_ADDRESS 0x0 /end MEASUREMENT
/begin MEASUREMENT Com_TxSigInfo[32].TxAccessInfoIdxOfTxSigInfo "" UWORD NO_COMPU_METHOD 0 0 0 65535 ECU_ADDRESS 0x0 /end MEASUREMENT
/begin MEASUREMENT Com_TxSigInfo[32].TxBufferEndIdxOfTxSigInfo "" UWORD Com_TxBufferEndIdxOfTxSigInfoType 0 0 0 65535 ECU_ADDRESS 0x0 /end MEASUREMENT
/begin MEASUREMENT Com_TxSigInfo[32].TxBufferStartIdxOfTxSigInfo "" UWORD Com_TxBufferStartIdxOfTxSigInfoType 0 0 0 65535 ECU_ADDRESS 0x0 /end MEASUREMENT
/begin MEASUREMENT Com_TxSigInfo[32].TxFilterInitValueArrayBasedFilterInitValueEndIdxOfTxSigInfo "" UBYTE Com_TxFilterInitValueArrayBasedFilterInitValueEndIdxOfTxSigInfoType 0 0 0 255 ECU_ADDRESS 0x0 /end MEASUREMENT
/begin MEASUREMENT Com_TxSigInfo[32].TxFilterInitValueArrayBasedFilterInitValueStartIdxOfTxSigInfo "" UBYTE Com_TxFilterInitValueArrayBasedFilterInitValueStartIdxOfTxSigInfoType 0 0 0 255 ECU_ADDRESS 0x0 /end MEASUREMENT
/begin MEASUREMENT Com_TxSigInfo[32].TxPduInfoIdxOfTxSigInfo "" UBYTE NO_COMPU_METHOD 0 0 0 255 ECU_ADDRESS 0x0 /end MEASUREMENT
/begin MEASUREMENT Com_TxSigInfo[330].ApplTypeOfTxSigInfo "" UBYTE Com_ApplTypeOfTxSigInfoType 0 0 0 255 ECU_ADDRESS 0x0 /end MEASUREMENT
/begin MEASUREMENT Com_TxSigInfo[330].BitLengthOfTxSigInfo "" UWORD NO_COMPU_METHOD 0 0 0 65535 ECU_ADDRESS 0x0 /end MEASUREMENT
/begin MEASUREMENT Com_TxSigInfo[330].BitPositionOfTxSigInfo "" UWORD NO_COMPU_METHOD 0 0 0 65535 ECU_ADDRESS 0x0 /end MEASUREMENT
/begin MEASUREMENT Com_TxSigInfo[330].BusAccOfTxSigInfo "" UBYTE Com_BusAccOfTxSigInfoType 0 0 0 255 ECU_ADDRESS 0x0 /end MEASUREMENT
/begin MEASUREMENT Com_TxSigInfo[330].ByteLengthOfTxSigInfo "" UBYTE NO_COMPU_METHOD 0 0 0 255 ECU_ADDRESS 0x0 /end MEASUREMENT
/begin MEASUREMENT Com_TxSigInfo[330].DynSignalOfTxSigInfo "" UBYTE Com_DynSignalOfTxSigInfoType 0 0 0 1 ECU_ADDRESS 0x0 /end MEASUREMENT
/begin MEASUREMENT Com_TxSigInfo[330].FilterInitValueIdxOfTxSigInfo "" UBYTE Com_FilterInitValueIdxOfTxSigInfoType 0 0 0 255 ECU_ADDRESS 0x0 /end MEASUREMENT
/begin MEASUREMENT Com_TxSigInfo[330].FilterInitValueOfTxSigInfo "" UBYTE Com_FilterInitValueOfTxSigInfoType 0 0 0 255 ECU_ADDRESS 0x0 /end MEASUREMENT
/begin MEASUREMENT Com_TxSigInfo[330].InvValueIdxOfTxSigInfo "" UBYTE Com_InvValueIdxOfTxSigInfoType 0 0 0 255 ECU_ADDRESS 0x0 /end MEASUREMENT
/begin MEASUREMENT Com_TxSigInfo[330].InvValueOfTxSigInfo "" UBYTE Com_InvValueOfTxSigInfoType 0 0 0 255 ECU_ADDRESS 0x0 /end MEASUREMENT
/begin MEASUREMENT Com_TxSigInfo[330].OnChangeIdxOfTxSigInfo "" UBYTE Com_OnChangeIdxOfTxSigInfoType 0 0 0 255 ECU_ADDRESS 0x0 /end MEASUREMENT
/begin MEASUREMENT Com_TxSigInfo[330].OnChangeOfTxSigInfo "" UBYTE Com_OnChangeOfTxSigInfoType 0 0 0 255 ECU_ADDRESS 0x0 /end MEASUREMENT
/begin MEASUREMENT Com_TxSigInfo[330].StartByteInPduPositionOfTxSigInfo "" UBYTE NO_COMPU_METHOD 0 0 0 255 ECU_ADDRESS 0x0 /end MEASUREMENT
/begin MEASUREMENT Com_TxSigInfo[330].TxAccessInfoIdxOfTxSigInfo "" UWORD NO_COMPU_METHOD 0 0 0 65535 ECU_ADDRESS 0x0 /end MEASUREMENT
/begin MEASUREMENT Com_TxSigInfo[330].TxBufferEndIdxOfTxSigInfo "" UWORD Com_TxBufferEndIdxOfTxSigInfoType 0 0 0 65535 ECU_ADDRESS 0x0 /end MEASUREMENT
/begin MEASUREMENT Com_TxSigInfo[330].TxBufferStartIdxOfTxSigInfo "" UWORD Com_TxBufferStartIdxOfTxSigInfoType 0 0 0 65535 ECU_ADDRESS 0x0 /end MEASUREMENT
/begin MEASUREMENT Com_TxSigInfo[330].TxFilterInitValueArrayBasedFilterInitValueEndIdxOfTxSigInfo "" UBYTE Com_TxFilterInitValueArrayBasedFilterInitValueEndIdxOfTxSigInfoType 0 0 0 255 ECU_ADDRESS 0x0 /end MEASUREMENT
/begin MEASUREMENT Com_TxSigInfo[330].TxFilterInitValueArrayBasedFilterInitValueStartIdxOfTxSigInfo "" UBYTE Com_TxFilterInitValueArrayBasedFilterInitValueStartIdxOfTxSigInfoType 0 0 0 255 ECU_ADDRESS 0x0 /end MEASUREMENT
/begin MEASUREMENT Com_TxSigInfo[330].TxPduInfoIdxOfTxSigInfo "" UBYTE NO_COMPU_METHOD 0 0 0 255 ECU_ADDRESS 0x0 /end MEASUREMENT
/begin MEASUREMENT Com_TxSigInfo[331].ApplTypeOfTxSigInfo "" UBYTE Com_ApplTypeOfTxSigInfoType 0 0 0 255 ECU_ADDRESS 0x0 /end MEASUREMENT
/begin MEASUREMENT Com_TxSigInfo[331].BitLengthOfTxSigInfo "" UWORD NO_COMPU_METHOD 0 0 0 65535 ECU_ADDRESS 0x0 /end MEASUREMENT
/begin MEASUREMENT Com_TxSigInfo[331].BitPositionOfTxSigInfo "" UWORD NO_COMPU_METHOD 0 0 0 65535 ECU_ADDRESS 0x0 /end MEASUREMENT
/begin MEASUREMENT Com_TxSigInfo[331].BusAccOfTxSigInfo "" UBYTE Com_BusAccOfTxSigInfoType 0 0 0 255 ECU_ADDRESS 0x0 /end MEASUREMENT
/begin MEASUREMENT Com_TxSigInfo[331].ByteLengthOfTxSigInfo "" UBYTE NO_COMPU_METHOD 0 0 0 255 ECU_ADDRESS 0x0 /end MEASUREMENT
/begin MEASUREMENT Com_TxSigInfo[331].DynSignalOfTxSigInfo "" UBYTE Com_DynSignalOfTxSigInfoType 0 0 0 1 ECU_ADDRESS 0x0 /end MEASUREMENT
/begin MEASUREMENT Com_TxSigInfo[331].FilterInitValueIdxOfTxSigInfo "" UBYTE Com_FilterInitValueIdxOfTxSigInfoType 0 0 0 255 ECU_ADDRESS 0x0 /end MEASUREMENT
/begin MEASUREMENT Com_TxSigInfo[331].FilterInitValueOfTxSigInfo "" UBYTE Com_FilterInitValueOfTxSigInfoType 0 0 0 255 ECU_ADDRESS 0x0 /end MEASUREMENT
/begin MEASUREMENT Com_TxSigInfo[331].InvValueIdxOfTxSigInfo "" UBYTE Com_InvValueIdxOfTxSigInfoType 0 0 0 255 ECU_ADDRESS 0x0 /end MEASUREMENT
/begin MEASUREMENT Com_TxSigInfo[331].InvValueOfTxSigInfo "" UBYTE Com_InvValueOfTxSigInfoType 0 0 0 255 ECU_ADDRESS 0x0 /end MEASUREMENT
/begin MEASUREMENT Com_TxSigInfo[331].OnChangeIdxOfTxSigInfo "" UBYTE Com_OnChangeIdxOfTxSigInfoType 0 0 0 255 ECU_ADDRESS 0x0 /end MEASUREMENT
/begin MEASUREMENT Com_TxSigInfo[331].OnChangeOfTxSigInfo "" UBYTE Com_OnChangeOfTxSigInfoType 0 0 0 255 ECU_ADDRESS 0x0 /end MEASUREMENT
/begin MEASUREMENT Com_TxSigInfo[331].StartByteInPduPositionOfTxSigInfo "" UBYTE NO_COMPU_METHOD 0 0 0 255 ECU_ADDRESS 0x0 /end MEASUREMENT
/begin MEASUREMENT Com_TxSigInfo[331].TxAccessInfoIdxOfTxSigInfo "" UWORD NO_COMPU_METHOD 0 0 0 65535 ECU_ADDRESS 0x0 /end MEASUREMENT
/begin MEASUREMENT Com_TxSigInfo[331].TxBufferEndIdxOfTxSigInfo "" UWORD Com_TxBufferEndIdxOfTxSigInfoType 0 0 0 65535 ECU_ADDRESS 0x0 /end MEASUREMENT
/begin MEASUREMENT Com_TxSigInfo[331].TxBufferStartIdxOfTxSigInfo "" UWORD Com_TxBufferStartIdxOfTxSigInfoType 0 0 0 65535 ECU_ADDRESS 0x0 /end MEASUREMENT
/begin MEASUREMENT Com_TxSigInfo[331].TxFilterInitValueArrayBasedFilterInitValueEndIdxOfTxSigInfo "" UBYTE Com_TxFilterInitValueArrayBasedFilterInitValueEndIdxOfTxSigInfoType 0 0 0 255 ECU_ADDRESS 0x0 /end MEASUREMENT
/begin MEASUREMENT Com_TxSigInfo[331].TxFilterInitValueArrayBasedFilterInitValueStartIdxOfTxSigInfo "" UBYTE Com_TxFilterInitValueArrayBasedFilterInitValueStartIdxOfTxSigInfoType 0 0 0 255 ECU_ADDRESS 0x0 /end MEASUREMENT
/begin MEASUREMENT Com_TxSigInfo[331].TxPduInfoIdxOfTxSigInfo "" UBYTE NO_COMPU_METHOD 0 0 0 255 ECU_ADDRESS 0x0 /end MEASUREMENT
/begin MEASUREMENT Com_TxSigInfo[332].ApplTypeOfTxSigInfo "" UBYTE Com_ApplTypeOfTxSigInfoType 0 0 0 255 ECU_ADDRESS 0x0 /end MEASUREMENT
/begin MEASUREMENT Com_TxSigInfo[332].BitLengthOfTxSigInfo "" UWORD NO_COMPU_METHOD 0 0 0 65535 ECU_ADDRESS 0x0 /end MEASUREMENT
/begin MEASUREMENT Com_TxSigInfo[332].BitPositionOfTxSigInfo "" UWORD NO_COMPU_METHOD 0 0 0 65535 ECU_ADDRESS 0x0 /end MEASUREMENT
/begin MEASUREMENT Com_TxSigInfo[332].BusAccOfTxSigInfo "" UBYTE Com_BusAccOfTxSigInfoType 0 0 0 255 ECU_ADDRESS 0x0 /end MEASUREMENT
/begin MEASUREMENT Com_TxSigInfo[332].ByteLengthOfTxSigInfo "" UBYTE NO_COMPU_METHOD 0 0 0 255 ECU_ADDRESS 0x0 /end MEASUREMENT
/begin MEASUREMENT Com_TxSigInfo[332].DynSignalOfTxSigInfo "" UBYTE Com_DynSignalOfTxSigInfoType 0 0 0 1 ECU_ADDRESS 0x0 /end MEASUREMENT
/begin MEASUREMENT Com_TxSigInfo[332].FilterInitValueIdxOfTxSigInfo "" UBYTE Com_FilterInitValueIdxOfTxSigInfoType 0 0 0 255 ECU_ADDRESS 0x0 /end MEASUREMENT
/begin MEASUREMENT Com_TxSigInfo[332].FilterInitValueOfTxSigInfo "" UBYTE Com_FilterInitValueOfTxSigInfoType 0 0 0 255 ECU_ADDRESS 0x0 /end MEASUREMENT
/begin MEASUREMENT Com_TxSigInfo[332].InvValueIdxOfTxSigInfo "" UBYTE Com_InvValueIdxOfTxSigInfoType 0 0 0 255 ECU_ADDRESS 0x0 /end MEASUREMENT
/begin MEASUREMENT Com_TxSigInfo[332].InvValueOfTxSigInfo "" UBYTE Com_InvValueOfTxSigInfoType 0 0 0 255 ECU_ADDRESS 0x0 /end MEASUREMENT
/begin MEASUREMENT Com_TxSigInfo[332].OnChangeIdxOfTxSigInfo "" UBYTE Com_OnChangeIdxOfTxSigInfoType 0 0 0 255 ECU_ADDRESS 0x0 /end MEASUREMENT
/begin MEASUREMENT Com_TxSigInfo[332].OnChangeOfTxSigInfo "" UBYTE Com_OnChangeOfTxSigInfoType 0 0 0 255 ECU_ADDRESS 0x0 /end MEASUREMENT
/begin MEASUREMENT Com_TxSigInfo[332].StartByteInPduPositionOfTxSigInfo "" UBYTE NO_COMPU_METHOD 0 0 0 255 ECU_ADDRESS 0x0 /end MEASUREMENT
/begin MEASUREMENT Com_TxSigInfo[332].TxAccessInfoIdxOfTxSigInfo "" UWORD NO_COMPU_METHOD 0 0 0 65535 ECU_ADDRESS 0x0 /end MEASUREMENT
/begin MEASUREMENT Com_TxSigInfo[332].TxBufferEndIdxOfTxSigInfo "" UWORD Com_TxBufferEndIdxOfTxSigInfoType 0 0 0 65535 ECU_ADDRESS 0x0 /end MEASUREMENT
/begin MEASUREMENT Com_TxSigInfo[332].TxBufferStartIdxOfTxSigInfo "" UWORD Com_TxBufferStartIdxOfTxSigInfoType 0 0 0 65535 ECU_ADDRESS 0x0 /end MEASUREMENT
/begin MEASUREMENT Com_TxSigInfo[332].TxFilterInitValueArrayBasedFilterInitValueEndIdxOfTxSigInfo "" UBYTE Com_TxFilterInitValueArrayBasedFilterInitValueEndIdxOfTxSigInfoType 0 0 0 255 ECU_ADDRESS 0x0 /end MEASUREMENT
/begin MEASUREMENT Com_TxSigInfo[332].TxFilterInitValueArrayBasedFilterInitValueStartIdxOfTxSigInfo "" UBYTE Com_TxFilterInitValueArrayBasedFilterInitValueStartIdxOfTxSigInfoType 0 0 0 255 ECU_ADDRESS 0x0 /end MEASUREMENT
/begin MEASUREMENT Com_TxSigInfo[332].TxPduInfoIdxOfTxSigInfo "" UBYTE NO_COMPU_METHOD 0 0 0 255 ECU_ADDRESS 0x0 /end MEASUREMENT
/begin MEASUREMENT Com_TxSigInfo[333].ApplTypeOfTxSigInfo "" UBYTE Com_ApplTypeOfTxSigInfoType 0 0 0 255 ECU_ADDRESS 0x0 /end MEASUREMENT
/begin MEASUREMENT Com_TxSigInfo[333].BitLengthOfTxSigInfo "" UWORD NO_COMPU_METHOD 0 0 0 65535 ECU_ADDRESS 0x0 /end MEASUREMENT
/begin MEASUREMENT Com_TxSigInfo[333].BitPositionOfTxSigInfo "" UWORD NO_COMPU_METHOD 0 0 0 65535 ECU_ADDRESS 0x0 /end MEASUREMENT
/begin MEASUREMENT Com_TxSigInfo[333].BusAccOfTxSigInfo "" UBYTE Com_BusAccOfTxSigInfoType 0 0 0 255 ECU_ADDRESS 0x0 /end MEASUREMENT
/begin MEASUREMENT Com_TxSigInfo[333].ByteLengthOfTxSigInfo "" UBYTE NO_COMPU_METHOD 0 0 0 255 ECU_ADDRESS 0x0 /end MEASUREMENT
/begin MEASUREMENT Com_TxSigInfo[333].DynSignalOfTxSigInfo "" UBYTE Com_DynSignalOfTxSigInfoType 0 0 0 1 ECU_ADDRESS 0x0 /end MEASUREMENT
/begin MEASUREMENT Com_TxSigInfo[333].FilterInitValueIdxOfTxSigInfo "" UBYTE Com_FilterInitValueIdxOfTxSigInfoType 0 0 0 255 ECU_ADDRESS 0x0 /end MEASUREMENT
/begin MEASUREMENT Com_TxSigInfo[333].FilterInitValueOfTxSigInfo "" UBYTE Com_FilterInitValueOfTxSigInfoType 0 0 0 255 ECU_ADDRESS 0x0 /end MEASUREMENT
/begin MEASUREMENT Com_TxSigInfo[333].InvValueIdxOfTxSigInfo "" UBYTE Com_InvValueIdxOfTxSigInfoType 0 0 0 255 ECU_ADDRESS 0x0 /end MEASUREMENT
/begin MEASUREMENT Com_TxSigInfo[333].InvValueOfTxSigInfo "" UBYTE Com_InvValueOfTxSigInfoType 0 0 0 255 ECU_ADDRESS 0x0 /end MEASUREMENT
/begin MEASUREMENT Com_TxSigInfo[333].OnChangeIdxOfTxSigInfo "" UBYTE Com_OnChangeIdxOfTxSigInfoType 0 0 0 255 ECU_ADDRESS 0x0 /end MEASUREMENT
/begin MEASUREMENT Com_TxSigInfo[333].OnChangeOfTxSigInfo "" UBYTE Com_OnChangeOfTxSigInfoType 0 0 0 255 ECU_ADDRESS 0x0 /end MEASUREMENT
/begin MEASUREMENT Com_TxSigInfo[333].StartByteInPduPositionOfTxSigInfo "" UBYTE NO_COMPU_METHOD 0 0 0 255 ECU_ADDRESS 0x0 /end MEASUREMENT
/begin MEASUREMENT Com_TxSigInfo[333].TxAccessInfoIdxOfTxSigInfo "" UWORD NO_COMPU_METHOD 0 0 0 65535 ECU_ADDRESS 0x0 /end MEASUREMENT
/begin MEASUREMENT Com_TxSigInfo[333].TxBufferEndIdxOfTxSigInfo "" UWORD Com_TxBufferEndIdxOfTxSigInfoType 0 0 0 65535 ECU_ADDRESS 0x0 /end MEASUREMENT
/begin MEASUREMENT Com_TxSigInfo[333].TxBufferStartIdxOfTxSigInfo "" UWORD Com_TxBufferStartIdxOfTxSigInfoType 0 0 0 65535 ECU_ADDRESS 0x0 /end MEASUREMENT
/begin MEASUREMENT Com_TxSigInfo[333].TxFilterInitValueArrayBasedFilterInitValueEndIdxOfTxSigInfo "" UBYTE Com_TxFilterInitValueArrayBasedFilterInitValueEndIdxOfTxSigInfoType 0 0 0 255 ECU_ADDRESS 0x0 /end MEASUREMENT
/begin MEASUREMENT Com_TxSigInfo[333].TxFilterInitValueArrayBasedFilterInitValueStartIdxOfTxSigInfo "" UBYTE Com_TxFilterInitValueArrayBasedFilterInitValueStartIdxOfTxSigInfoType 0 0 0 255 ECU_ADDRESS 0x0 /end MEASUREMENT
/begin MEASUREMENT Com_TxSigInfo[333].TxPduInfoIdxOfTxSigInfo "" UBYTE NO_COMPU_METHOD 0 0 0 255 ECU_ADDRESS 0x0 /end MEASUREMENT
/begin MEASUREMENT Com_TxSigInfo[334].ApplTypeOfTxSigInfo "" UBYTE Com_ApplTypeOfTxSigInfoType 0 0 0 255 ECU_ADDRESS 0x0 /end MEASUREMENT
/begin MEASUREMENT Com_TxSigInfo[334].BitLengthOfTxSigInfo "" UWORD NO_COMPU_METHOD 0 0 0 65535 ECU_ADDRESS 0x0 /end MEASUREMENT
/begin MEASUREMENT Com_TxSigInfo[334].BitPositionOfTxSigInfo "" UWORD NO_COMPU_METHOD 0 0 0 65535 ECU_ADDRESS 0x0 /end MEASUREMENT
/begin MEASUREMENT Com_TxSigInfo[334].BusAccOfTxSigInfo "" UBYTE Com_BusAccOfTxSigInfoType 0 0 0 255 ECU_ADDRESS 0x0 /end MEASUREMENT
/begin MEASUREMENT Com_TxSigInfo[334].ByteLengthOfTxSigInfo "" UBYTE NO_COMPU_METHOD 0 0 0 255 ECU_ADDRESS 0x0 /end MEASUREMENT
/begin MEASUREMENT Com_TxSigInfo[334].DynSignalOfTxSigInfo "" UBYTE Com_DynSignalOfTxSigInfoType 0 0 0 1 ECU_ADDRESS 0x0 /end MEASUREMENT
/begin MEASUREMENT Com_TxSigInfo[334].FilterInitValueIdxOfTxSigInfo "" UBYTE Com_FilterInitValueIdxOfTxSigInfoType 0 0 0 255 ECU_ADDRESS 0x0 /end MEASUREMENT
/begin MEASUREMENT Com_TxSigInfo[334].FilterInitValueOfTxSigInfo "" UBYTE Com_FilterInitValueOfTxSigInfoType 0 0 0 255 ECU_ADDRESS 0x0 /end MEASUREMENT
/begin MEASUREMENT Com_TxSigInfo[334].InvValueIdxOfTxSigInfo "" UBYTE Com_InvValueIdxOfTxSigInfoType 0 0 0 255 ECU_ADDRESS 0x0 /end MEASUREMENT
/begin MEASUREMENT Com_TxSigInfo[334].InvValueOfTxSigInfo "" UBYTE Com_InvValueOfTxSigInfoType 0 0 0 255 ECU_ADDRESS 0x0 /end MEASUREMENT
/begin MEASUREMENT Com_TxSigInfo[334].OnChangeIdxOfTxSigInfo "" UBYTE Com_OnChangeIdxOfTxSigInfoType 0 0 0 255 ECU_ADDRESS 0x0 /end MEASUREMENT
/begin MEASUREMENT Com_TxSigInfo[334].OnChangeOfTxSigInfo "" UBYTE Com_OnChangeOfTxSigInfoType 0 0 0 255 ECU_ADDRESS 0x0 /end MEASUREMENT
/begin MEASUREMENT Com_TxSigInfo[334].StartByteInPduPositionOfTxSigInfo "" UBYTE NO_COMPU_METHOD 0 0 0 255 ECU_ADDRESS 0x0 /end MEASUREMENT
/begin MEASUREMENT Com_TxSigInfo[334].TxAccessInfoIdxOfTxSigInfo "" UWORD NO_COMPU_METHOD 0 0 0 65535 ECU_ADDRESS 0x0 /end MEASUREMENT
/begin MEASUREMENT Com_TxSigInfo[334].TxBufferEndIdxOfTxSigInfo "" UWORD Com_TxBufferEndIdxOfTxSigInfoType 0 0 0 65535 ECU_ADDRESS 0x0 /end MEASUREMENT
/begin MEASUREMENT Com_TxSigInfo[334].TxBufferStartIdxOfTxSigInfo "" UWORD Com_TxBufferStartIdxOfTxSigInfoType 0 0 0 65535 ECU_ADDRESS 0x0 /end MEASUREMENT
/begin MEASUREMENT Com_TxSigInfo[334].TxFilterInitValueArrayBasedFilterInitValueEndIdxOfTxSigInfo "" UBYTE Com_TxFilterInitValueArrayBasedFilterInitValueEndIdxOfTxSigInfoType 0 0 0 255 ECU_ADDRESS 0x0 /end MEASUREMENT
/begin MEASUREMENT Com_TxSigInfo[334].TxFilterInitValueArrayBasedFilterInitValueStartIdxOfTxSigInfo "" UBYTE Com_TxFilterInitValueArrayBasedFilterInitValueStartIdxOfTxSigInfoType 0 0 0 255 ECU_ADDRESS 0x0 /end MEASUREMENT
/begin MEASUREMENT Com_TxSigInfo[334].TxPduInfoIdxOfTxSigInfo "" UBYTE NO_COMPU_METHOD 0 0 0 255 ECU_ADDRESS 0x0 /end MEASUREMENT
/begin MEASUREMENT Com_TxSigInfo[335].ApplTypeOfTxSigInfo "" UBYTE Com_ApplTypeOfTxSigInfoType 0 0 0 255 ECU_ADDRESS 0x0 /end MEASUREMENT
/begin MEASUREMENT Com_TxSigInfo[335].BitLengthOfTxSigInfo "" UWORD NO_COMPU_METHOD 0 0 0 65535 ECU_ADDRESS 0x0 /end MEASUREMENT
/begin MEASUREMENT Com_TxSigInfo[335].BitPositionOfTxSigInfo "" UWORD NO_COMPU_METHOD 0 0 0 65535 ECU_ADDRESS 0x0 /end MEASUREMENT
/begin MEASUREMENT Com_TxSigInfo[335].BusAccOfTxSigInfo "" UBYTE Com_BusAccOfTxSigInfoType 0 0 0 255 ECU_ADDRESS 0x0 /end MEASUREMENT
/begin MEASUREMENT Com_TxSigInfo[335].ByteLengthOfTxSigInfo "" UBYTE NO_COMPU_METHOD 0 0 0 255 ECU_ADDRESS 0x0 /end MEASUREMENT
/begin MEASUREMENT Com_TxSigInfo[335].DynSignalOfTxSigInfo "" UBYTE Com_DynSignalOfTxSigInfoType 0 0 0 1 ECU_ADDRESS 0x0 /end MEASUREMENT
/begin MEASUREMENT Com_TxSigInfo[335].FilterInitValueIdxOfTxSigInfo "" UBYTE Com_FilterInitValueIdxOfTxSigInfoType 0 0 0 255 ECU_ADDRESS 0x0 /end MEASUREMENT
/begin MEASUREMENT Com_TxSigInfo[335].FilterInitValueOfTxSigInfo "" UBYTE Com_FilterInitValueOfTxSigInfoType 0 0 0 255 ECU_ADDRESS 0x0 /end MEASUREMENT
/begin MEASUREMENT Com_TxSigInfo[335].InvValueIdxOfTxSigInfo "" UBYTE Com_InvValueIdxOfTxSigInfoType 0 0 0 255 ECU_ADDRESS 0x0 /end MEASUREMENT
/begin MEASUREMENT Com_TxSigInfo[335].InvValueOfTxSigInfo "" UBYTE Com_InvValueOfTxSigInfoType 0 0 0 255 ECU_ADDRESS 0x0 /end MEASUREMENT
/begin MEASUREMENT Com_TxSigInfo[335].OnChangeIdxOfTxSigInfo "" UBYTE Com_OnChangeIdxOfTxSigInfoType 0 0 0 255 ECU_ADDRESS 0x0 /end MEASUREMENT
/begin MEASUREMENT Com_TxSigInfo[335].OnChangeOfTxSigInfo "" UBYTE Com_OnChangeOfTxSigInfoType 0 0 0 255 ECU_ADDRESS 0x0 /end MEASUREMENT
/begin MEASUREMENT Com_TxSigInfo[335].StartByteInPduPositionOfTxSigInfo "" UBYTE NO_COMPU_METHOD 0 0 0 255 ECU_ADDRESS 0x0 /end MEASUREMENT
/begin MEASUREMENT Com_TxSigInfo[335].TxAccessInfoIdxOfTxSigInfo "" UWORD NO_COMPU_METHOD 0 0 0 65535 ECU_ADDRESS 0x0 /end MEASUREMENT
/begin MEASUREMENT Com_TxSigInfo[335].TxBufferEndIdxOfTxSigInfo "" UWORD Com_TxBufferEndIdxOfTxSigInfoType 0 0 0 65535 ECU_ADDRESS 0x0 /end MEASUREMENT
/begin MEASUREMENT Com_TxSigInfo[335].TxBufferStartIdxOfTxSigInfo "" UWORD Com_TxBufferStartIdxOfTxSigInfoType 0 0 0 65535 ECU_ADDRESS 0x0 /end MEASUREMENT
/begin MEASUREMENT Com_TxSigInfo[335].TxFilterInitValueArrayBasedFilterInitValueEndIdxOfTxSigInfo "" UBYTE Com_TxFilterInitValueArrayBasedFilterInitValueEndIdxOfTxSigInfoType 0 0 0 255 ECU_ADDRESS 0x0 /end MEASUREMENT
/begin MEASUREMENT Com_TxSigInfo[335].TxFilterInitValueArrayBasedFilterInitValueStartIdxOfTxSigInfo "" UBYTE Com_TxFilterInitValueArrayBasedFilterInitValueStartIdxOfTxSigInfoType 0 0 0 255 ECU_ADDRESS 0x0 /end MEASUREMENT
/begin MEASUREMENT Com_TxSigInfo[335].TxPduInfoIdxOfTxSigInfo "" UBYTE NO_COMPU_METHOD 0 0 0 255 ECU_ADDRESS 0x0 /end MEASUREMENT
/begin MEASUREMENT Com_TxSigInfo[336].ApplTypeOfTxSigInfo "" UBYTE Com_ApplTypeOfTxSigInfoType 0 0 0 255 ECU_ADDRESS 0x0 /end MEASUREMENT
/begin MEASUREMENT Com_TxSigInfo[336].BitLengthOfTxSigInfo "" UWORD NO_COMPU_METHOD 0 0 0 65535 ECU_ADDRESS 0x0 /end MEASUREMENT
/begin MEASUREMENT Com_TxSigInfo[336].BitPositionOfTxSigInfo "" UWORD NO_COMPU_METHOD 0 0 0 65535 ECU_ADDRESS 0x0 /end MEASUREMENT
/begin MEASUREMENT Com_TxSigInfo[336].BusAccOfTxSigInfo "" UBYTE Com_BusAccOfTxSigInfoType 0 0 0 255 ECU_ADDRESS 0x0 /end MEASUREMENT
/begin MEASUREMENT Com_TxSigInfo[336].ByteLengthOfTxSigInfo "" UBYTE NO_COMPU_METHOD 0 0 0 255 ECU_ADDRESS 0x0 /end MEASUREMENT
/begin MEASUREMENT Com_TxSigInfo[336].DynSignalOfTxSigInfo "" UBYTE Com_DynSignalOfTxSigInfoType 0 0 0 1 ECU_ADDRESS 0x0 /end MEASUREMENT
/begin MEASUREMENT Com_TxSigInfo[336].FilterInitValueIdxOfTxSigInfo "" UBYTE Com_FilterInitValueIdxOfTxSigInfoType 0 0 0 255 ECU_ADDRESS 0x0 /end MEASUREMENT
/begin MEASUREMENT Com_TxSigInfo[336].FilterInitValueOfTxSigInfo "" UBYTE Com_FilterInitValueOfTxSigInfoType 0 0 0 255 ECU_ADDRESS 0x0 /end MEASUREMENT
/begin MEASUREMENT Com_TxSigInfo[336].InvValueIdxOfTxSigInfo "" UBYTE Com_InvValueIdxOfTxSigInfoType 0 0 0 255 ECU_ADDRESS 0x0 /end MEASUREMENT
/begin MEASUREMENT Com_TxSigInfo[336].InvValueOfTxSigInfo "" UBYTE Com_InvValueOfTxSigInfoType 0 0 0 255 ECU_ADDRESS 0x0 /end MEASUREMENT
/begin MEASUREMENT Com_TxSigInfo[336].OnChangeIdxOfTxSigInfo "" UBYTE Com_OnChangeIdxOfTxSigInfoType 0 0 0 255 ECU_ADDRESS 0x0 /end MEASUREMENT
/begin MEASUREMENT Com_TxSigInfo[336].OnChangeOfTxSigInfo "" UBYTE Com_OnChangeOfTxSigInfoType 0 0 0 255 ECU_ADDRESS 0x0 /end MEASUREMENT
/begin MEASUREMENT Com_TxSigInfo[336].StartByteInPduPositionOfTxSigInfo "" UBYTE NO_COMPU_METHOD 0 0 0 255 ECU_ADDRESS 0x0 /end MEASUREMENT
/begin MEASUREMENT Com_TxSigInfo[336].TxAccessInfoIdxOfTxSigInfo "" UWORD NO_COMPU_METHOD 0 0 0 65535 ECU_ADDRESS 0x0 /end MEASUREMENT
/begin MEASUREMENT Com_TxSigInfo[336].TxBufferEndIdxOfTxSigInfo "" UWORD Com_TxBufferEndIdxOfTxSigInfoType 0 0 0 65535 ECU_ADDRESS 0x0 /end MEASUREMENT
/begin MEASUREMENT Com_TxSigInfo[336].TxBufferStartIdxOfTxSigInfo "" UWORD Com_TxBufferStartIdxOfTxSigInfoType 0 0 0 65535 ECU_ADDRESS 0x0 /end MEASUREMENT
/begin MEASUREMENT Com_TxSigInfo[336].TxFilterInitValueArrayBasedFilterInitValueEndIdxOfTxSigInfo "" UBYTE Com_TxFilterInitValueArrayBasedFilterInitValueEndIdxOfTxSigInfoType 0 0 0 255 ECU_ADDRESS 0x0 /end MEASUREMENT
/begin MEASUREMENT Com_TxSigInfo[336].TxFilterInitValueArrayBasedFilterInitValueStartIdxOfTxSigInfo "" UBYTE Com_TxFilterInitValueArrayBasedFilterInitValueStartIdxOfTxSigInfoType 0 0 0 255 ECU_ADDRESS 0x0 /end MEASUREMENT
/begin MEASUREMENT Com_TxSigInfo[336].TxPduInfoIdxOfTxSigInfo "" UBYTE NO_COMPU_METHOD 0 0 0 255 ECU_ADDRESS 0x0 /end MEASUREMENT
/begin MEASUREMENT Com_TxSigInfo[337].ApplTypeOfTxSigInfo "" UBYTE Com_ApplTypeOfTxSigInfoType 0 0 0 255 ECU_ADDRESS 0x0 /end MEASUREMENT
/begin MEASUREMENT Com_TxSigInfo[337].BitLengthOfTxSigInfo "" UWORD NO_COMPU_METHOD 0 0 0 65535 ECU_ADDRESS 0x0 /end MEASUREMENT
/begin MEASUREMENT Com_TxSigInfo[337].BitPositionOfTxSigInfo "" UWORD NO_COMPU_METHOD 0 0 0 65535 ECU_ADDRESS 0x0 /end MEASUREMENT
/begin MEASUREMENT Com_TxSigInfo[337].BusAccOfTxSigInfo "" UBYTE Com_BusAccOfTxSigInfoType 0 0 0 255 ECU_ADDRESS 0x0 /end MEASUREMENT
/begin MEASUREMENT Com_TxSigInfo[337].ByteLengthOfTxSigInfo "" UBYTE NO_COMPU_METHOD 0 0 0 255 ECU_ADDRESS 0x0 /end MEASUREMENT
/begin MEASUREMENT Com_TxSigInfo[337].DynSignalOfTxSigInfo "" UBYTE Com_DynSignalOfTxSigInfoType 0 0 0 1 ECU_ADDRESS 0x0 /end MEASUREMENT
/begin MEASUREMENT Com_TxSigInfo[337].FilterInitValueIdxOfTxSigInfo "" UBYTE Com_FilterInitValueIdxOfTxSigInfoType 0 0 0 255 ECU_ADDRESS 0x0 /end MEASUREMENT
/begin MEASUREMENT Com_TxSigInfo[337].FilterInitValueOfTxSigInfo "" UBYTE Com_FilterInitValueOfTxSigInfoType 0 0 0 255 ECU_ADDRESS 0x0 /end MEASUREMENT
/begin MEASUREMENT Com_TxSigInfo[337].InvValueIdxOfTxSigInfo "" UBYTE Com_InvValueIdxOfTxSigInfoType 0 0 0 255 ECU_ADDRESS 0x0 /end MEASUREMENT
/begin MEASUREMENT Com_TxSigInfo[337].InvValueOfTxSigInfo "" UBYTE Com_InvValueOfTxSigInfoType 0 0 0 255 ECU_ADDRESS 0x0 /end MEASUREMENT
/begin MEASUREMENT Com_TxSigInfo[337].OnChangeIdxOfTxSigInfo "" UBYTE Com_OnChangeIdxOfTxSigInfoType 0 0 0 255 ECU_ADDRESS 0x0 /end MEASUREMENT
/begin MEASUREMENT Com_TxSigInfo[337].OnChangeOfTxSigInfo "" UBYTE Com_OnChangeOfTxSigInfoType 0 0 0 255 ECU_ADDRESS 0x0 /end MEASUREMENT
/begin MEASUREMENT Com_TxSigInfo[337].StartByteInPduPositionOfTxSigInfo "" UBYTE NO_COMPU_METHOD 0 0 0 255 ECU_ADDRESS 0x0 /end MEASUREMENT
/begin MEASUREMENT Com_TxSigInfo[337].TxAccessInfoIdxOfTxSigInfo "" UWORD NO_COMPU_METHOD 0 0 0 65535 ECU_ADDRESS 0x0 /end MEASUREMENT
/begin MEASUREMENT Com_TxSigInfo[337].TxBufferEndIdxOfTxSigInfo "" UWORD Com_TxBufferEndIdxOfTxSigInfoType 0 0 0 65535 ECU_ADDRESS 0x0 /end MEASUREMENT
/begin MEASUREMENT Com_TxSigInfo[337].TxBufferStartIdxOfTxSigInfo "" UWORD Com_TxBufferStartIdxOfTxSigInfoType 0 0 0 65535 ECU_ADDRESS 0x0 /end MEASUREMENT
/begin MEASUREMENT Com_TxSigInfo[337].TxFilterInitValueArrayBasedFilterInitValueEndIdxOfTxSigInfo "" UBYTE Com_TxFilterInitValueArrayBasedFilterInitValueEndIdxOfTxSigInfoType 0 0 0 255 ECU_ADDRESS 0x0 /end MEASUREMENT
/begin MEASUREMENT Com_TxSigInfo[337].TxFilterInitValueArrayBasedFilterInitValueStartIdxOfTxSigInfo "" UBYTE Com_TxFilterInitValueArrayBasedFilterInitValueStartIdxOfTxSigInfoType 0 0 0 255 ECU_ADDRESS 0x0 /end MEASUREMENT
/begin MEASUREMENT Com_TxSigInfo[337].TxPduInfoIdxOfTxSigInfo "" UBYTE NO_COMPU_METHOD 0 0 0 255 ECU_ADDRESS 0x0 /end MEASUREMENT
/begin MEASUREMENT Com_TxSigInfo[338].ApplTypeOfTxSigInfo "" UBYTE Com_ApplTypeOfTxSigInfoType 0 0 0 255 ECU_ADDRESS 0x0 /end MEASUREMENT
/begin MEASUREMENT Com_TxSigInfo[338].BitLengthOfTxSigInfo "" UWORD NO_COMPU_METHOD 0 0 0 65535 ECU_ADDRESS 0x0 /end MEASUREMENT
/begin MEASUREMENT Com_TxSigInfo[338].BitPositionOfTxSigInfo "" UWORD NO_COMPU_METHOD 0 0 0 65535 ECU_ADDRESS 0x0 /end MEASUREMENT
/begin MEASUREMENT Com_TxSigInfo[338].BusAccOfTxSigInfo "" UBYTE Com_BusAccOfTxSigInfoType 0 0 0 255 ECU_ADDRESS 0x0 /end MEASUREMENT
/begin MEASUREMENT Com_TxSigInfo[338].ByteLengthOfTxSigInfo "" UBYTE NO_COMPU_METHOD 0 0 0 255 ECU_ADDRESS 0x0 /end MEASUREMENT
/begin MEASUREMENT Com_TxSigInfo[338].DynSignalOfTxSigInfo "" UBYTE Com_DynSignalOfTxSigInfoType 0 0 0 1 ECU_ADDRESS 0x0 /end MEASUREMENT
/begin MEASUREMENT Com_TxSigInfo[338].FilterInitValueIdxOfTxSigInfo "" UBYTE Com_FilterInitValueIdxOfTxSigInfoType 0 0 0 255 ECU_ADDRESS 0x0 /end MEASUREMENT
/begin MEASUREMENT Com_TxSigInfo[338].FilterInitValueOfTxSigInfo "" UBYTE Com_FilterInitValueOfTxSigInfoType 0 0 0 255 ECU_ADDRESS 0x0 /end MEASUREMENT
/begin MEASUREMENT Com_TxSigInfo[338].InvValueIdxOfTxSigInfo "" UBYTE Com_InvValueIdxOfTxSigInfoType 0 0 0 255 ECU_ADDRESS 0x0 /end MEASUREMENT
/begin MEASUREMENT Com_TxSigInfo[338].InvValueOfTxSigInfo "" UBYTE Com_InvValueOfTxSigInfoType 0 0 0 255 ECU_ADDRESS 0x0 /end MEASUREMENT
/begin MEASUREMENT Com_TxSigInfo[338].OnChangeIdxOfTxSigInfo "" UBYTE Com_OnChangeIdxOfTxSigInfoType 0 0 0 255 ECU_ADDRESS 0x0 /end MEASUREMENT
/begin MEASUREMENT Com_TxSigInfo[338].OnChangeOfTxSigInfo "" UBYTE Com_OnChangeOfTxSigInfoType 0 0 0 255 ECU_ADDRESS 0x0 /end MEASUREMENT
/begin MEASUREMENT Com_TxSigInfo[338].StartByteInPduPositionOfTxSigInfo "" UBYTE NO_COMPU_METHOD 0 0 0 255 ECU_ADDRESS 0x0 /end MEASUREMENT
/begin MEASUREMENT Com_TxSigInfo[338].TxAccessInfoIdxOfTxSigInfo "" UWORD NO_COMPU_METHOD 0 0 0 65535 ECU_ADDRESS 0x0 /end MEASUREMENT
/begin MEASUREMENT Com_TxSigInfo[338].TxBufferEndIdxOfTxSigInfo "" UWORD Com_TxBufferEndIdxOfTxSigInfoType 0 0 0 65535 ECU_ADDRESS 0x0 /end MEASUREMENT
/begin MEASUREMENT Com_TxSigInfo[338].TxBufferStartIdxOfTxSigInfo "" UWORD Com_TxBufferStartIdxOfTxSigInfoType 0 0 0 65535 ECU_ADDRESS 0x0 /end MEASUREMENT
/begin MEASUREMENT Com_TxSigInfo[338].TxFilterInitValueArrayBasedFilterInitValueEndIdxOfTxSigInfo "" UBYTE Com_TxFilterInitValueArrayBasedFilterInitValueEndIdxOfTxSigInfoType 0 0 0 255 ECU_ADDRESS 0x0 /end MEASUREMENT
/begin MEASUREMENT Com_TxSigInfo[338].TxFilterInitValueArrayBasedFilterInitValueStartIdxOfTxSigInfo "" UBYTE Com_TxFilterInitValueArrayBasedFilterInitValueStartIdxOfTxSigInfoType 0 0 0 255 ECU_ADDRESS 0x0 /end MEASUREMENT
/begin MEASUREMENT Com_TxSigInfo[338].TxPduInfoIdxOfTxSigInfo "" UBYTE NO_COMPU_METHOD 0 0 0 255 ECU_ADDRESS 0x0 /end MEASUREMENT
/begin MEASUREMENT Com_TxSigInfo[339].ApplTypeOfTxSigInfo "" UBYTE Com_ApplTypeOfTxSigInfoType 0 0 0 255 ECU_ADDRESS 0x0 /end MEASUREMENT
/begin MEASUREMENT Com_TxSigInfo[339].BitLengthOfTxSigInfo "" UWORD NO_COMPU_METHOD 0 0 0 65535 ECU_ADDRESS 0x0 /end MEASUREMENT
/begin MEASUREMENT Com_TxSigInfo[339].BitPositionOfTxSigInfo "" UWORD NO_COMPU_METHOD 0 0 0 65535 ECU_ADDRESS 0x0 /end MEASUREMENT
/begin MEASUREMENT Com_TxSigInfo[339].BusAccOfTxSigInfo "" UBYTE Com_BusAccOfTxSigInfoType 0 0 0 255 ECU_ADDRESS 0x0 /end MEASUREMENT
/begin MEASUREMENT Com_TxSigInfo[339].ByteLengthOfTxSigInfo "" UBYTE NO_COMPU_METHOD 0 0 0 255 ECU_ADDRESS 0x0 /end MEASUREMENT
/begin MEASUREMENT Com_TxSigInfo[339].DynSignalOfTxSigInfo "" UBYTE Com_DynSignalOfTxSigInfoType 0 0 0 1 ECU_ADDRESS 0x0 /end MEASUREMENT
/begin MEASUREMENT Com_TxSigInfo[339].FilterInitValueIdxOfTxSigInfo "" UBYTE Com_FilterInitValueIdxOfTxSigInfoType 0 0 0 255 ECU_ADDRESS 0x0 /end MEASUREMENT
/begin MEASUREMENT Com_TxSigInfo[339].FilterInitValueOfTxSigInfo "" UBYTE Com_FilterInitValueOfTxSigInfoType 0 0 0 255 ECU_ADDRESS 0x0 /end MEASUREMENT
/begin MEASUREMENT Com_TxSigInfo[339].InvValueIdxOfTxSigInfo "" UBYTE Com_InvValueIdxOfTxSigInfoType 0 0 0 255 ECU_ADDRESS 0x0 /end MEASUREMENT
/begin MEASUREMENT Com_TxSigInfo[339].InvValueOfTxSigInfo "" UBYTE Com_InvValueOfTxSigInfoType 0 0 0 255 ECU_ADDRESS 0x0 /end MEASUREMENT
/begin MEASUREMENT Com_TxSigInfo[339].OnChangeIdxOfTxSigInfo "" UBYTE Com_OnChangeIdxOfTxSigInfoType 0 0 0 255 ECU_ADDRESS 0x0 /end MEASUREMENT
/begin MEASUREMENT Com_TxSigInfo[339].OnChangeOfTxSigInfo "" UBYTE Com_OnChangeOfTxSigInfoType 0 0 0 255 ECU_ADDRESS 0x0 /end MEASUREMENT
/begin MEASUREMENT Com_TxSigInfo[339].StartByteInPduPositionOfTxSigInfo "" UBYTE NO_COMPU_METHOD 0 0 0 255 ECU_ADDRESS 0x0 /end MEASUREMENT
/begin MEASUREMENT Com_TxSigInfo[339].TxAccessInfoIdxOfTxSigInfo "" UWORD NO_COMPU_METHOD 0 0 0 65535 ECU_ADDRESS 0x0 /end MEASUREMENT
/begin MEASUREMENT Com_TxSigInfo[339].TxBufferEndIdxOfTxSigInfo "" UWORD Com_TxBufferEndIdxOfTxSigInfoType 0 0 0 65535 ECU_ADDRESS 0x0 /end MEASUREMENT
/begin MEASUREMENT Com_TxSigInfo[339].TxBufferStartIdxOfTxSigInfo "" UWORD Com_TxBufferStartIdxOfTxSigInfoType 0 0 0 65535 ECU_ADDRESS 0x0 /end MEASUREMENT
/begin MEASUREMENT Com_TxSigInfo[339].TxFilterInitValueArrayBasedFilterInitValueEndIdxOfTxSigInfo "" UBYTE Com_TxFilterInitValueArrayBasedFilterInitValueEndIdxOfTxSigInfoType 0 0 0 255 ECU_ADDRESS 0x0 /end MEASUREMENT
/begin MEASUREMENT Com_TxSigInfo[339].TxFilterInitValueArrayBasedFilterInitValueStartIdxOfTxSigInfo "" UBYTE Com_TxFilterInitValueArrayBasedFilterInitValueStartIdxOfTxSigInfoType 0 0 0 255 ECU_ADDRESS 0x0 /end MEASUREMENT
/begin MEASUREMENT Com_TxSigInfo[339].TxPduInfoIdxOfTxSigInfo "" UBYTE NO_COMPU_METHOD 0 0 0 255 ECU_ADDRESS 0x0 /end MEASUREMENT
/begin MEASUREMENT Com_TxSigInfo[33].ApplTypeOfTxSigInfo "" UBYTE Com_ApplTypeOfTxSigInfoType 0 0 0 255 ECU_ADDRESS 0x0 /end MEASUREMENT
/begin MEASUREMENT Com_TxSigInfo[33].BitLengthOfTxSigInfo "" UWORD NO_COMPU_METHOD 0 0 0 65535 ECU_ADDRESS 0x0 /end MEASUREMENT
/begin MEASUREMENT Com_TxSigInfo[33].BitPositionOfTxSigInfo "" UWORD NO_COMPU_METHOD 0 0 0 65535 ECU_ADDRESS 0x0 /end MEASUREMENT
/begin MEASUREMENT Com_TxSigInfo[33].BusAccOfTxSigInfo "" UBYTE Com_BusAccOfTxSigInfoType 0 0 0 255 ECU_ADDRESS 0x0 /end MEASUREMENT
/begin MEASUREMENT Com_TxSigInfo[33].ByteLengthOfTxSigInfo "" UBYTE NO_COMPU_METHOD 0 0 0 255 ECU_ADDRESS 0x0 /end MEASUREMENT
/begin MEASUREMENT Com_TxSigInfo[33].DynSignalOfTxSigInfo "" UBYTE Com_DynSignalOfTxSigInfoType 0 0 0 1 ECU_ADDRESS 0x0 /end MEASUREMENT
/begin MEASUREMENT Com_TxSigInfo[33].FilterInitValueIdxOfTxSigInfo "" UBYTE Com_FilterInitValueIdxOfTxSigInfoType 0 0 0 255 ECU_ADDRESS 0x0 /end MEASUREMENT
/begin MEASUREMENT Com_TxSigInfo[33].FilterInitValueOfTxSigInfo "" UBYTE Com_FilterInitValueOfTxSigInfoType 0 0 0 255 ECU_ADDRESS 0x0 /end MEASUREMENT
/begin MEASUREMENT Com_TxSigInfo[33].InvValueIdxOfTxSigInfo "" UBYTE Com_InvValueIdxOfTxSigInfoType 0 0 0 255 ECU_ADDRESS 0x0 /end MEASUREMENT
/begin MEASUREMENT Com_TxSigInfo[33].InvValueOfTxSigInfo "" UBYTE Com_InvValueOfTxSigInfoType 0 0 0 255 ECU_ADDRESS 0x0 /end MEASUREMENT
/begin MEASUREMENT Com_TxSigInfo[33].OnChangeIdxOfTxSigInfo "" UBYTE Com_OnChangeIdxOfTxSigInfoType 0 0 0 255 ECU_ADDRESS 0x0 /end MEASUREMENT
/begin MEASUREMENT Com_TxSigInfo[33].OnChangeOfTxSigInfo "" UBYTE Com_OnChangeOfTxSigInfoType 0 0 0 255 ECU_ADDRESS 0x0 /end MEASUREMENT
/begin MEASUREMENT Com_TxSigInfo[33].StartByteInPduPositionOfTxSigInfo "" UBYTE NO_COMPU_METHOD 0 0 0 255 ECU_ADDRESS 0x0 /end MEASUREMENT
/begin MEASUREMENT Com_TxSigInfo[33].TxAccessInfoIdxOfTxSigInfo "" UWORD NO_COMPU_METHOD 0 0 0 65535 ECU_ADDRESS 0x0 /end MEASUREMENT
/begin MEASUREMENT Com_TxSigInfo[33].TxBufferEndIdxOfTxSigInfo "" UWORD Com_TxBufferEndIdxOfTxSigInfoType 0 0 0 65535 ECU_ADDRESS 0x0 /end MEASUREMENT
/begin MEASUREMENT Com_TxSigInfo[33].TxBufferStartIdxOfTxSigInfo "" UWORD Com_TxBufferStartIdxOfTxSigInfoType 0 0 0 65535 ECU_ADDRESS 0x0 /end MEASUREMENT
/begin MEASUREMENT Com_TxSigInfo[33].TxFilterInitValueArrayBasedFilterInitValueEndIdxOfTxSigInfo "" UBYTE Com_TxFilterInitValueArrayBasedFilterInitValueEndIdxOfTxSigInfoType 0 0 0 255 ECU_ADDRESS 0x0 /end MEASUREMENT
/begin MEASUREMENT Com_TxSigInfo[33].TxFilterInitValueArrayBasedFilterInitValueStartIdxOfTxSigInfo "" UBYTE Com_TxFilterInitValueArrayBasedFilterInitValueStartIdxOfTxSigInfoType 0 0 0 255 ECU_ADDRESS 0x0 /end MEASUREMENT
/begin MEASUREMENT Com_TxSigInfo[33].TxPduInfoIdxOfTxSigInfo "" UBYTE NO_COMPU_METHOD 0 0 0 255 ECU_ADDRESS 0x0 /end MEASUREMENT
/begin MEASUREMENT Com_TxSigInfo[340].ApplTypeOfTxSigInfo "" UBYTE Com_ApplTypeOfTxSigInfoType 0 0 0 255 ECU_ADDRESS 0x0 /end MEASUREMENT
/begin MEASUREMENT Com_TxSigInfo[340].BitLengthOfTxSigInfo "" UWORD NO_COMPU_METHOD 0 0 0 65535 ECU_ADDRESS 0x0 /end MEASUREMENT
/begin MEASUREMENT Com_TxSigInfo[340].BitPositionOfTxSigInfo "" UWORD NO_COMPU_METHOD 0 0 0 65535 ECU_ADDRESS 0x0 /end MEASUREMENT
/begin MEASUREMENT Com_TxSigInfo[340].BusAccOfTxSigInfo "" UBYTE Com_BusAccOfTxSigInfoType 0 0 0 255 ECU_ADDRESS 0x0 /end MEASUREMENT
/begin MEASUREMENT Com_TxSigInfo[340].ByteLengthOfTxSigInfo "" UBYTE NO_COMPU_METHOD 0 0 0 255 ECU_ADDRESS 0x0 /end MEASUREMENT
/begin MEASUREMENT Com_TxSigInfo[340].DynSignalOfTxSigInfo "" UBYTE Com_DynSignalOfTxSigInfoType 0 0 0 1 ECU_ADDRESS 0x0 /end MEASUREMENT
/begin MEASUREMENT Com_TxSigInfo[340].FilterInitValueIdxOfTxSigInfo "" UBYTE Com_FilterInitValueIdxOfTxSigInfoType 0 0 0 255 ECU_ADDRESS 0x0 /end MEASUREMENT
/begin MEASUREMENT Com_TxSigInfo[340].FilterInitValueOfTxSigInfo "" UBYTE Com_FilterInitValueOfTxSigInfoType 0 0 0 255 ECU_ADDRESS 0x0 /end MEASUREMENT
/begin MEASUREMENT Com_TxSigInfo[340].InvValueIdxOfTxSigInfo "" UBYTE Com_InvValueIdxOfTxSigInfoType 0 0 0 255 ECU_ADDRESS 0x0 /end MEASUREMENT
/begin MEASUREMENT Com_TxSigInfo[340].InvValueOfTxSigInfo "" UBYTE Com_InvValueOfTxSigInfoType 0 0 0 255 ECU_ADDRESS 0x0 /end MEASUREMENT
/begin MEASUREMENT Com_TxSigInfo[340].OnChangeIdxOfTxSigInfo "" UBYTE Com_OnChangeIdxOfTxSigInfoType 0 0 0 255 ECU_ADDRESS 0x0 /end MEASUREMENT
/begin MEASUREMENT Com_TxSigInfo[340].OnChangeOfTxSigInfo "" UBYTE Com_OnChangeOfTxSigInfoType 0 0 0 255 ECU_ADDRESS 0x0 /end MEASUREMENT
/begin MEASUREMENT Com_TxSigInfo[340].StartByteInPduPositionOfTxSigInfo "" UBYTE NO_COMPU_METHOD 0 0 0 255 ECU_ADDRESS 0x0 /end MEASUREMENT
/begin MEASUREMENT Com_TxSigInfo[340].TxAccessInfoIdxOfTxSigInfo "" UWORD NO_COMPU_METHOD 0 0 0 65535 ECU_ADDRESS 0x0 /end MEASUREMENT
/begin MEASUREMENT Com_TxSigInfo[340].TxBufferEndIdxOfTxSigInfo "" UWORD Com_TxBufferEndIdxOfTxSigInfoType 0 0 0 65535 ECU_ADDRESS 0x0 /end MEASUREMENT
/begin MEASUREMENT Com_TxSigInfo[340].TxBufferStartIdxOfTxSigInfo "" UWORD Com_TxBufferStartIdxOfTxSigInfoType 0 0 0 65535 ECU_ADDRESS 0x0 /end MEASUREMENT
/begin MEASUREMENT Com_TxSigInfo[340].TxFilterInitValueArrayBasedFilterInitValueEndIdxOfTxSigInfo "" UBYTE Com_TxFilterInitValueArrayBasedFilterInitValueEndIdxOfTxSigInfoType 0 0 0 255 ECU_ADDRESS 0x0 /end MEASUREMENT
/begin MEASUREMENT Com_TxSigInfo[340].TxFilterInitValueArrayBasedFilterInitValueStartIdxOfTxSigInfo "" UBYTE Com_TxFilterInitValueArrayBasedFilterInitValueStartIdxOfTxSigInfoType 0 0 0 255 ECU_ADDRESS 0x0 /end MEASUREMENT
/begin MEASUREMENT Com_TxSigInfo[340].TxPduInfoIdxOfTxSigInfo "" UBYTE NO_COMPU_METHOD 0 0 0 255 ECU_ADDRESS 0x0 /end MEASUREMENT
/begin MEASUREMENT Com_TxSigInfo[341].ApplTypeOfTxSigInfo "" UBYTE Com_ApplTypeOfTxSigInfoType 0 0 0 255 ECU_ADDRESS 0x0 /end MEASUREMENT
/begin MEASUREMENT Com_TxSigInfo[341].BitLengthOfTxSigInfo "" UWORD NO_COMPU_METHOD 0 0 0 65535 ECU_ADDRESS 0x0 /end MEASUREMENT
/begin MEASUREMENT Com_TxSigInfo[341].BitPositionOfTxSigInfo "" UWORD NO_COMPU_METHOD 0 0 0 65535 ECU_ADDRESS 0x0 /end MEASUREMENT
/begin MEASUREMENT Com_TxSigInfo[341].BusAccOfTxSigInfo "" UBYTE Com_BusAccOfTxSigInfoType 0 0 0 255 ECU_ADDRESS 0x0 /end MEASUREMENT
/begin MEASUREMENT Com_TxSigInfo[341].ByteLengthOfTxSigInfo "" UBYTE NO_COMPU_METHOD 0 0 0 255 ECU_ADDRESS 0x0 /end MEASUREMENT
/begin MEASUREMENT Com_TxSigInfo[341].DynSignalOfTxSigInfo "" UBYTE Com_DynSignalOfTxSigInfoType 0 0 0 1 ECU_ADDRESS 0x0 /end MEASUREMENT
/begin MEASUREMENT Com_TxSigInfo[341].FilterInitValueIdxOfTxSigInfo "" UBYTE Com_FilterInitValueIdxOfTxSigInfoType 0 0 0 255 ECU_ADDRESS 0x0 /end MEASUREMENT
/begin MEASUREMENT Com_TxSigInfo[341].FilterInitValueOfTxSigInfo "" UBYTE Com_FilterInitValueOfTxSigInfoType 0 0 0 255 ECU_ADDRESS 0x0 /end MEASUREMENT
/begin MEASUREMENT Com_TxSigInfo[341].InvValueIdxOfTxSigInfo "" UBYTE Com_InvValueIdxOfTxSigInfoType 0 0 0 255 ECU_ADDRESS 0x0 /end MEASUREMENT
/begin MEASUREMENT Com_TxSigInfo[341].InvValueOfTxSigInfo "" UBYTE Com_InvValueOfTxSigInfoType 0 0 0 255 ECU_ADDRESS 0x0 /end MEASUREMENT
/begin MEASUREMENT Com_TxSigInfo[341].OnChangeIdxOfTxSigInfo "" UBYTE Com_OnChangeIdxOfTxSigInfoType 0 0 0 255 ECU_ADDRESS 0x0 /end MEASUREMENT
/begin MEASUREMENT Com_TxSigInfo[341].OnChangeOfTxSigInfo "" UBYTE Com_OnChangeOfTxSigInfoType 0 0 0 255 ECU_ADDRESS 0x0 /end MEASUREMENT
/begin MEASUREMENT Com_TxSigInfo[341].StartByteInPduPositionOfTxSigInfo "" UBYTE NO_COMPU_METHOD 0 0 0 255 ECU_ADDRESS 0x0 /end MEASUREMENT
/begin MEASUREMENT Com_TxSigInfo[341].TxAccessInfoIdxOfTxSigInfo "" UWORD NO_COMPU_METHOD 0 0 0 65535 ECU_ADDRESS 0x0 /end MEASUREMENT
/begin MEASUREMENT Com_TxSigInfo[341].TxBufferEndIdxOfTxSigInfo "" UWORD Com_TxBufferEndIdxOfTxSigInfoType 0 0 0 65535 ECU_ADDRESS 0x0 /end MEASUREMENT
/begin MEASUREMENT Com_TxSigInfo[341].TxBufferStartIdxOfTxSigInfo "" UWORD Com_TxBufferStartIdxOfTxSigInfoType 0 0 0 65535 ECU_ADDRESS 0x0 /end MEASUREMENT
/begin MEASUREMENT Com_TxSigInfo[341].TxFilterInitValueArrayBasedFilterInitValueEndIdxOfTxSigInfo "" UBYTE Com_TxFilterInitValueArrayBasedFilterInitValueEndIdxOfTxSigInfoType 0 0 0 255 ECU_ADDRESS 0x0 /end MEASUREMENT
/begin MEASUREMENT Com_TxSigInfo[341].TxFilterInitValueArrayBasedFilterInitValueStartIdxOfTxSigInfo "" UBYTE Com_TxFilterInitValueArrayBasedFilterInitValueStartIdxOfTxSigInfoType 0 0 0 255 ECU_ADDRESS 0x0 /end MEASUREMENT
/begin MEASUREMENT Com_TxSigInfo[341].TxPduInfoIdxOfTxSigInfo "" UBYTE NO_COMPU_METHOD 0 0 0 255 ECU_ADDRESS 0x0 /end MEASUREMENT
/begin MEASUREMENT Com_TxSigInfo[342].ApplTypeOfTxSigInfo "" UBYTE Com_ApplTypeOfTxSigInfoType 0 0 0 255 ECU_ADDRESS 0x0 /end MEASUREMENT
/begin MEASUREMENT Com_TxSigInfo[342].BitLengthOfTxSigInfo "" UWORD NO_COMPU_METHOD 0 0 0 65535 ECU_ADDRESS 0x0 /end MEASUREMENT
/begin MEASUREMENT Com_TxSigInfo[342].BitPositionOfTxSigInfo "" UWORD NO_COMPU_METHOD 0 0 0 65535 ECU_ADDRESS 0x0 /end MEASUREMENT
/begin MEASUREMENT Com_TxSigInfo[342].BusAccOfTxSigInfo "" UBYTE Com_BusAccOfTxSigInfoType 0 0 0 255 ECU_ADDRESS 0x0 /end MEASUREMENT
/begin MEASUREMENT Com_TxSigInfo[342].ByteLengthOfTxSigInfo "" UBYTE NO_COMPU_METHOD 0 0 0 255 ECU_ADDRESS 0x0 /end MEASUREMENT
/begin MEASUREMENT Com_TxSigInfo[342].DynSignalOfTxSigInfo "" UBYTE Com_DynSignalOfTxSigInfoType 0 0 0 1 ECU_ADDRESS 0x0 /end MEASUREMENT
/begin MEASUREMENT Com_TxSigInfo[342].FilterInitValueIdxOfTxSigInfo "" UBYTE Com_FilterInitValueIdxOfTxSigInfoType 0 0 0 255 ECU_ADDRESS 0x0 /end MEASUREMENT
/begin MEASUREMENT Com_TxSigInfo[342].FilterInitValueOfTxSigInfo "" UBYTE Com_FilterInitValueOfTxSigInfoType 0 0 0 255 ECU_ADDRESS 0x0 /end MEASUREMENT
/begin MEASUREMENT Com_TxSigInfo[342].InvValueIdxOfTxSigInfo "" UBYTE Com_InvValueIdxOfTxSigInfoType 0 0 0 255 ECU_ADDRESS 0x0 /end MEASUREMENT
/begin MEASUREMENT Com_TxSigInfo[342].InvValueOfTxSigInfo "" UBYTE Com_InvValueOfTxSigInfoType 0 0 0 255 ECU_ADDRESS 0x0 /end MEASUREMENT
/begin MEASUREMENT Com_TxSigInfo[342].OnChangeIdxOfTxSigInfo "" UBYTE Com_OnChangeIdxOfTxSigInfoType 0 0 0 255 ECU_ADDRESS 0x0 /end MEASUREMENT
/begin MEASUREMENT Com_TxSigInfo[342].OnChangeOfTxSigInfo "" UBYTE Com_OnChangeOfTxSigInfoType 0 0 0 255 ECU_ADDRESS 0x0 /end MEASUREMENT
/begin MEASUREMENT Com_TxSigInfo[342].StartByteInPduPositionOfTxSigInfo "" UBYTE NO_COMPU_METHOD 0 0 0 255 ECU_ADDRESS 0x0 /end MEASUREMENT
/begin MEASUREMENT Com_TxSigInfo[342].TxAccessInfoIdxOfTxSigInfo "" UWORD NO_COMPU_METHOD 0 0 0 65535 ECU_ADDRESS 0x0 /end MEASUREMENT
/begin MEASUREMENT Com_TxSigInfo[342].TxBufferEndIdxOfTxSigInfo "" UWORD Com_TxBufferEndIdxOfTxSigInfoType 0 0 0 65535 ECU_ADDRESS 0x0 /end MEASUREMENT
/begin MEASUREMENT Com_TxSigInfo[342].TxBufferStartIdxOfTxSigInfo "" UWORD Com_TxBufferStartIdxOfTxSigInfoType 0 0 0 65535 ECU_ADDRESS 0x0 /end MEASUREMENT
/begin MEASUREMENT Com_TxSigInfo[342].TxFilterInitValueArrayBasedFilterInitValueEndIdxOfTxSigInfo "" UBYTE Com_TxFilterInitValueArrayBasedFilterInitValueEndIdxOfTxSigInfoType 0 0 0 255 ECU_ADDRESS 0x0 /end MEASUREMENT
/begin MEASUREMENT Com_TxSigInfo[342].TxFilterInitValueArrayBasedFilterInitValueStartIdxOfTxSigInfo "" UBYTE Com_TxFilterInitValueArrayBasedFilterInitValueStartIdxOfTxSigInfoType 0 0 0 255 ECU_ADDRESS 0x0 /end MEASUREMENT
/begin MEASUREMENT Com_TxSigInfo[342].TxPduInfoIdxOfTxSigInfo "" UBYTE NO_COMPU_METHOD 0 0 0 255 ECU_ADDRESS 0x0 /end MEASUREMENT
/begin MEASUREMENT Com_TxSigInfo[343].ApplTypeOfTxSigInfo "" UBYTE Com_ApplTypeOfTxSigInfoType 0 0 0 255 ECU_ADDRESS 0x0 /end MEASUREMENT
/begin MEASUREMENT Com_TxSigInfo[343].BitLengthOfTxSigInfo "" UWORD NO_COMPU_METHOD 0 0 0 65535 ECU_ADDRESS 0x0 /end MEASUREMENT
/begin MEASUREMENT Com_TxSigInfo[343].BitPositionOfTxSigInfo "" UWORD NO_COMPU_METHOD 0 0 0 65535 ECU_ADDRESS 0x0 /end MEASUREMENT
/begin MEASUREMENT Com_TxSigInfo[343].BusAccOfTxSigInfo "" UBYTE Com_BusAccOfTxSigInfoType 0 0 0 255 ECU_ADDRESS 0x0 /end MEASUREMENT
/begin MEASUREMENT Com_TxSigInfo[343].ByteLengthOfTxSigInfo "" UBYTE NO_COMPU_METHOD 0 0 0 255 ECU_ADDRESS 0x0 /end MEASUREMENT
/begin MEASUREMENT Com_TxSigInfo[343].DynSignalOfTxSigInfo "" UBYTE Com_DynSignalOfTxSigInfoType 0 0 0 1 ECU_ADDRESS 0x0 /end MEASUREMENT
/begin MEASUREMENT Com_TxSigInfo[343].FilterInitValueIdxOfTxSigInfo "" UBYTE Com_FilterInitValueIdxOfTxSigInfoType 0 0 0 255 ECU_ADDRESS 0x0 /end MEASUREMENT
/begin MEASUREMENT Com_TxSigInfo[343].FilterInitValueOfTxSigInfo "" UBYTE Com_FilterInitValueOfTxSigInfoType 0 0 0 255 ECU_ADDRESS 0x0 /end MEASUREMENT
/begin MEASUREMENT Com_TxSigInfo[343].InvValueIdxOfTxSigInfo "" UBYTE Com_InvValueIdxOfTxSigInfoType 0 0 0 255 ECU_ADDRESS 0x0 /end MEASUREMENT
/begin MEASUREMENT Com_TxSigInfo[343].InvValueOfTxSigInfo "" UBYTE Com_InvValueOfTxSigInfoType 0 0 0 255 ECU_ADDRESS 0x0 /end MEASUREMENT
/begin COMPU_METHOD Com_ApplTypeOfTxSigInfoType "" TAB_VERB "%10.1" "" COMPU_TAB_REF Com_ApplTypeOfTxSigInfoType /end COMPU_METHOD
/begin COMPU_METHOD Com_BusAccOfTxSigInfoType "" TAB_VERB "%10.1" "" COMPU_TAB_REF Com_BusAccOfTxSigInfoType /end COMPU_METHOD
/begin COMPU_METHOD Com_DynSignalOfTxSigInfoType "" TAB_VERB "%10.1" "" COMPU_TAB_REF Com_DynSignalOfTxSigInfoType /end COMPU_METHOD
/begin COMPU_METHOD Com_FilterInitValueIdxOfTxSigInfoType "" TAB_VERB "%10.1" "" COMPU_TAB_REF Com_FilterInitValueIdxOfTxSigInfoType /end COMPU_METHOD
/begin COMPU_METHOD Com_FilterInitValueOfTxSigInfoType "" TAB_VERB "%10.1" "" COMPU_TAB_REF Com_FilterInitValueOfTxSigInfoType /end COMPU_METHOD
/begin COMPU_METHOD Com_InvValueIdxOfTxSigInfoType "" TAB_VERB "%10.1" "" COMPU_TAB_REF Com_InvValueIdxOfTxSigInfoType /end COMPU_METHOD
/begin COMPU_METHOD Com_InvValueOfTxSigInfoType "" TAB_VERB "%10.1" "" COMPU_TAB_REF Com_InvValueOfTxSigInfoType /end COMPU_METHOD
/begin COMPU_METHOD Com_OnChangeIdxOfTxSigInfoType "" TAB_VERB "%10.1" "" COMPU_TAB_REF Com_OnChangeIdxOfTxSigInfoType /end COMPU_METHOD
/begin COMPU_METHOD Com_OnChangeOfTxSigInfoType "" TAB_VERB "%10.1" "" COMPU_TAB_REF Com_OnChangeOfTxSigInfoType /end COMPU_METHOD
/begin COMPU_METHOD Com_TxBufferEndIdxOfTxSigInfoType "" TAB_VERB "%10.1" "" COMPU_TAB_REF Com_TxBufferEndIdxOfTxSigInfoType /end COMPU_METHOD
/begin COMPU_METHOD Com_TxBufferStartIdxOfTxSigInfoType "" TAB_VERB "%10.1" "" COMPU_TAB_REF Com_TxBufferStartIdxOfTxSigInfoType /end COMPU_METHOD
/begin COMPU_METHOD Com_TxFilterInitValueArrayBasedFilterInitValueEndIdxOfTxSigInfoType "" TAB_VERB "%10.1" "" COMPU_TAB_REF Com_TxFilterInitValueArrayBasedFilterInitValueEndIdxOfTxSigInfoType /end COMPU_METHOD
/begin COMPU_METHOD Com_TxFilterInitValueArrayBasedFilterInitValueStartIdxOfTxSigInfoType "" TAB_VERB "%10.1" "" COMPU_TAB_REF Com_TxFilterInitValueArrayBasedFilterInitValueStartIdxOfTxSigInfoType /end COMPU_METHOD
/begin COMPU_VTAB Com_ApplTypeOfTxSigInfoType "" TAB_VERB 4 0 "COM_UINT8_APPLTYPEOFTXSIGINFO" 2 "COM_UINT16_APPLTYPEOFTXSIGINFO" 4 "COM_UINT32_APPLTYPEOFTXSIGINFO" 8 "COM_UINT8_N_APPLTYPEOFTXSIGINFO" /end COMPU_VTAB
/begin COMPU_VTAB Com_BusAccOfTxSigInfoType "" TAB_VERB 5 0 "COM_NBIT_BUSACCOFTXSIGINFO" 1 "COM_BYTE_BUSACCOFTXSIGINFO" 2 "COM_NBYTE_BUSACCOFTXSIGINFO" 4 "COM_NBITNBYTE_BUSACCOFTXSIGINFO" 6 "COM_ARRAY_BASED_BUSACCOFTXSIGINFO" /end COMPU_VTAB
/begin COMPU_VTAB_RANGE Com_DynSignalOfTxSigInfoType "" 2 0 0 "FALSE" 1 255 "TRUE" /end COMPU_VTAB_RANGE
/begin COMPU_VTAB Com_FilterInitValueIdxOfTxSigInfoType "" TAB_VERB 1 255 "COM_NO_FILTERINITVALUEIDXOFTXSIGINFO" /end COMPU_VTAB
/begin COMPU_VTAB Com_FilterInitValueOfTxSigInfoType "" TAB_VERB 3 0 "COM_TXFILTERINITVALUEUINT8_FILTERINITVALUEOFTXSIGINFO" 1 "COM_TXFILTERINITVALUEUINT16_FILTERINITVALUEOFTXSIGINFO" 255 "COM_NO_FILTERINITVALUEOFTXSIGINFO" /end COMPU_VTAB
/begin COMPU_VTAB Com_InvValueIdxOfTxSigInfoType "" TAB_VERB 1 255 "COM_NO_INVVALUEIDXOFTXSIGINFO" /end COMPU_VTAB
/begin COMPU_VTAB Com_InvValueOfTxSigInfoType "" TAB_VERB 4 0 "COM_CONSTVALUEUINT8_INVVALUEOFTXSIGINFO" 1 "COM_CONSTVALUEUINT16_INVVALUEOFTXSIGINFO" 2 "COM_CONSTVALUEUINT32_INVVALUEOFTXSIGINFO" 255 "COM_NO_INVVALUEOFTXSIGINFO" /end COMPU_VTAB
/begin COMPU_VTAB Com_OnChangeIdxOfTxSigInfoType "" TAB_VERB 1 255 "COM_NO_ONCHANGEIDXOFTXSIGINFO" /end COMPU_VTAB
/begin COMPU_VTAB Com_OnChangeOfTxSigInfoType "" TAB_VERB 4 0 "COM_FILTERINFO_UINT8_ONCHANGEOFTXSIGINFO" 2 "COM_FILTERINFO_UINT16_ONCHANGEOFTXSIGINFO" 10 "COM_FILTERINFO_UINT8_N_ONCHANGEOFTXSIGINFO" 255 "COM_NO_ONCHANGEOFTXSIGINFO" /end COMPU_VTAB
/begin COMPU_VTAB Com_TxBufferEndIdxOfTxSigInfoType "" TAB_VERB 1 65535 "COM_NO_TXBUFFERENDIDXOFTXSIGINFO" /end COMPU_VTAB
/begin COMPU_VTAB Com_TxBufferStartIdxOfTxSigInfoType "" TAB_VERB 1 65535 "COM_NO_TXBUFFERSTARTIDXOFTXSIGINFO" /end COMPU_VTAB
/begin COMPU_VTAB Com_TxFilterInitValueArrayBasedFilterInitValueEndIdxOfTxSigInfoType "" TAB_VERB 1 255 "COM_NO_TXFILTERINITVALUEARRAYBASEDFILTERINITVALUEENDIDXOFTXSIGINFO" /end COMPU_VTAB
/begin COMPU_VTAB Com_TxFilterInitValueArrayBasedFilterInitValueStartIdxOfTxSigInfoType "" TAB_VERB 1 255 "COM_NO_TXFILTERINITVALUEARRAYBASEDFILTERINITVALUESTARTIDXOFTXSIGINFO" /end COMPU_VTAB
/begin GROUP Com ""
 /begin REF_MEASUREMENT Com_TxSigInfo[298].BusAccOfTxSigInfo Com_TxSigInfo[298].ByteLengthOfTxSigInfo Com_TxSigInfo[298].DynSignalOfTxSigInfo Com_TxSigInfo[298].FilterInitValueIdxOfTxSigInfo Com_TxSigInfo[298].FilterInitValueOfTxSigInfo Com_TxSigInfo[298].InvValueIdxOfTxSigInfo Com_TxSigInfo[298].InvValueOfTxSigInfo Com_TxSigInfo[298].OnChangeIdxOfTxSigInfo Com_TxSigInfo[298].OnChangeOfTxSigInfo Com_TxSigInfo[298].StartByteInPduPositionOfTxSigInfo Com_TxSigInfo[298].TxAccessInfoIdxOfTxSigInfo Com_TxSigInfo[298].TxBufferEndIdxOfTxSigInfo Com_TxSigInfo[298].TxBufferStartIdxOfTxSigInfo Com_TxSigInfo[298].TxFilterInitValueArrayBasedFilterInitValueEndIdxOfTxSigInfo Com_TxSigInfo[298].TxFilterInitValueArrayBasedFilterInitValueStartIdxOfTxSigInfo Com_TxSigInfo[298].TxPduInfoIdxOfTxSigInfo Com_TxSigInfo[299].ApplTypeOfTxSigInfo Com_TxSigInfo[299].BitLengthOfTxSigInfo Com_TxSigInfo[299].BitPositionOfTxSigInfo Com_TxSigInfo[299].BusAccOfTxSigInfo Com_TxSigInfo[299].ByteLengthOfTxSigInfo Com_TxSigInfo[299].DynSignalOfTxSigInfo Com_TxSigInfo[299].FilterInitValueIdxOfTxSigInfo Com_TxSigInfo[299].FilterInitValueOfTxSigInfo Com_TxSigInfo[299].InvValueIdxOfTxSigInfo Com_TxSigInfo[299].InvValueOfTxSigInfo Com_TxSigInfo[299].OnChangeIdxOfTxSigInfo Com_TxSigInfo[299].OnChangeOfTxSigInfo Com_TxSigInfo[299].StartByteInPduPositionOfTxSigInfo Com_TxSigInfo[299].TxAccessInfoIdxOfTxSigInfo Com_TxSigInfo[299].TxBufferEndIdxOfTxSigInfo Com_TxSigInfo[299].TxBufferStartIdxOfTxSigInfo Com_TxSigInfo[299].TxFilterInitValueArrayBasedFilterInitValueEndIdxOfTxSigInfo Com_TxSigInfo[299].TxFilterInitValueArrayBasedFilterInitValueStartIdxOfTxSigInfo Com_TxSigInfo[299].TxPduInfoIdxOfTxSigInfo Com_TxSigInfo[29].ApplTypeOfTxSigInfo Com_TxSigInfo[29].BitLengthOfTxSigInfo Com_TxSigInfo[29].BitPositionOfTxSigInfo Com_TxSigInfo[29].BusAccOfTxSigInfo Com_TxSigInfo[29].ByteLengthOfTxSigInfo Com_TxSigInfo[29].DynSignalOfTxSigInfo Com_TxSigInfo[29].FilterInitValueIdxOfTxSigInfo Com_TxSigInfo[29].FilterInitValueOfTxSigInfo Com_TxSigInfo[29].InvValueIdxOfTxSigInfo Com_TxSigInfo[29].InvValueOfTxSigInfo Com_TxSigInfo[29].OnChangeIdxOfTxSigInfo Com_TxSigInfo[29].OnChangeOfTxSigInfo Com_TxSigInfo[29].StartByteInPduPositionOfTxSigInfo Com_TxSigInfo[29].TxAccessInfoIdxOfTxSigInfo Com_TxSigInfo[29].TxBufferEndIdxOfTxSigInfo Com_TxSigInfo[29].TxBufferStartIdxOfTxSigInfo Com_TxSigInfo[29].TxFilterInitValueArrayBasedFilterInitValueEndIdxOfTxSigInfo Com_TxSigInfo[29].TxFilterInitValueArrayBasedFilterInitValueStartIdxOfTxSigInfo Com_TxSigInfo[29].TxPduInfoIdxOfTxSigInfo Com_TxSigInfo[2].ApplTypeOfTxSigInfo Com_TxSigInfo[2].BitLengthOfTxSigInfo Com_TxSigInfo[2].BitPositionOfTxSigInfo Com_TxSigInfo[2].BusAccOfTxSigInfo Com_TxSigInfo[2].ByteLengthOfTxSigInfo Com_TxSigInfo[2].DynSignalOfTxSigInfo Com_TxSigInfo[2].FilterInitValueIdxOfTxSigInfo Com_TxSigInfo[2].FilterInitValueOfTxSigInfo Com_TxSigInfo[2].InvValueIdxOfTxSigInfo Com_TxSigInfo[2].InvValueOfTxSigInfo Com_TxSigInfo[2].OnChangeIdxOfTxSigInfo Com_TxSigInfo[2].OnChangeOfTxSigInfo Com_TxSigInfo[2].StartByteInPduPositionOfTxSigInfo Com_TxSigInfo[2].TxAccessInfoIdxOfTxSigInfo Com_TxSigInfo[2].TxBufferEndIdxOfTxSigInfo Com_TxSigInfo[2].TxBufferStartIdxOfTxSigInfo Com_TxSigInfo[2].TxFilterInitValueArrayBasedFilterInitValueEndIdxOfTxSigInfo Com_TxSigInfo[2].TxFilterInitValueArrayBasedFilterInitValueStartIdxOfTxSigInfo Com_TxSigInfo[2].TxPduInfoIdxOfTxSigInfo Com_TxSigInfo[300].ApplTypeOfTxSigInfo Com_TxSigInfo[300].BitLengthOfTxSigInfo Com_TxSigInfo[300].BitPositionOfTxSigInfo Com_TxSigInfo[300].BusAccOfTxSigInfo Com_TxSigInfo[300].ByteLengthOfTxSigInfo Com_TxSigInfo[300].DynSignalOfTxSigInfo Com_TxSigInfo[300].FilterInitValueIdxOfTxSigInfo Com_TxSigInfo[300].FilterInitValueOfTxSigInfo Com_TxSigInfo[300].InvValueIdxOfTxSigInfo Com_TxSigInfo[300].InvValueOfTxSigInfo Com_TxSigInfo[300].OnChangeIdxOfTxSigInfo Com_TxSigInfo[300].OnChangeOfTxSigInfo Com_TxSigInfo[300].StartByteInPduPositionOfTxSigInfo Com_TxSigInfo[300].TxAccessInfoIdxOfTxSigInfo Com_TxSigInfo[300].TxBufferEndIdxOfTxSigInfo Com_TxSigInfo[300].TxBufferStartIdxOfTxSigInfo Com_TxSigInfo[300].TxFilterInitValueArrayBasedFilterInitValueEndIdxOfTxSigInfo Com_TxSigInfo[300].TxFilterInitValueArrayBasedFilterInitValueStartIdxOfTxSigInfo Com_TxSigInfo[300].TxPduInfoIdxOfTxSigInfo Com_TxSigInfo[301].ApplTypeOfTxSigInfo Com_TxSigInfo[301].BitLengthOfTxSigInfo Com_TxSigInfo[301].BitPositionOfTxSigInfo Com_TxSigInfo[301].BusAccOfTxSigInfo Com_TxSigInfo[301].ByteLengthOfTxSigInfo Com_TxSigInfo[301].DynSignalOfTxSigInfo Com_TxSigInfo[301].FilterInitValueIdxOfTxSigInfo Com_TxSigInfo[301].FilterInitValueOfTxSigInfo Com_TxSigInfo[301].InvValueIdxOfTxSigInfo Com_TxSigInfo[301].InvValueOfTxSigInfo Com_TxSigInfo[301].OnChangeIdxOfTxSigInfo Com_TxSigInfo[301].OnChangeOfTxSigInfo Com_TxSigInfo[301].StartByteInPduPositionOfTxSigInfo Com_TxSigInfo[301].TxAccessInfoIdxOfTxSigInfo Com_TxSigInfo[301].TxBufferEndIdxOfTxSigInfo Com_TxSigInfo[301].TxBufferStartIdxOfTxSigInfo Com_TxSigInfo[301].TxFilterInitValueArrayBasedFilterInitValueEndIdxOfTxSigInfo Com_TxSigInfo[301].TxFilterInitValueArrayBasedFilterInitValueStartIdxOfTxSigInfo Com_TxSigInfo[301].TxPduInfoIdxOfTxSigInfo Com_TxSigInfo[302].ApplTypeOfTxSigInfo Com_TxSigInfo[302].BitLengthOfTxSigInfo Com_TxSigInfo[302].BitPositionOfTxSigInfo Com_TxSigInfo[302].BusAccOfTxSigInfo Com_TxSigInfo[302].ByteLengthOfTxSigInfo Com_TxSigInfo[302].DynSignalOfTxSigInfo Com_TxSigInfo[302].FilterInitValueIdxOfTxSigInfo Com_TxSigInfo[302].FilterInitValueOfTxSigInfo Com_TxSigInfo[302].InvValueIdxOfTxSigInfo Com_TxSigInfo[302].InvValueOfTxSigInfo Com_TxSigInfo[302].OnChangeIdxOfTxSigInfo Com_TxSigInfo[302].OnChangeOfTxSigInfo Com_TxSigInfo[302].StartByteInPduPositionOfTxSigInfo Com_TxSigInfo[302].TxAccessInfoIdxOfTxSigInfo Com_TxSigInfo[302].TxBufferEndIdxOfTxSigInfo Com_TxSigInfo[302].TxBufferStartIdxOfTxSigInfo Com_TxSigInfo[302].TxFilterInitValueArrayBasedFilterInitValueEndIdxOfTxSigInfo Com_TxSigInfo[302].TxFilterInitValueArrayBasedFilterInitValueStartIdxOfTxSigInfo Com_TxSigInfo[302].TxPduInfoIdxOfTxSigInfo Com_TxSigInfo[303].ApplTypeOfTxSigInfo Com_TxSigInfo[303].BitLengthOfTxSigInfo Com_TxSigInfo[303].BitPositionOfTxSigInfo Com_TxSigInfo[303].BusAccOfTxSigInfo Com_TxSigInfo[303].ByteLengthOfTxSigInfo Com_TxSigInfo[303].DynSignalOfTxSigInfo Com_TxSigInfo[303].FilterInitValueIdxOfTxSigInfo Com_TxSigInfo[303].FilterInitValueOfTxSigInfo Com_TxSigInfo[303].InvValueIdxOfTxSigInfo Com_TxSigInfo[303].InvValueOfTxSigInfo Com_TxSigInfo[303].OnChangeIdxOfTxSigInfo Com_TxSigInfo[303].OnChangeOfTxSigInfo Com_TxSigInfo[303].StartByteInPduPositionOfTxSigInfo Com_TxSigInfo[303].TxAccessInfoIdxOfTxSigInfo Com_TxSigInfo[303].TxBufferEndIdxOfTxSigInfo Com_TxSigInfo[303].TxBufferStartIdxOfTxSigInfo Com_TxSigInfo[303].TxFilterInitValueArrayBasedFilterInitValueEndIdxOfTxSigInfo Com_TxSigInfo[303].TxFilterInitValueArrayBasedFilterInitValueStartIdxOfTxSigInfo Com_TxSigInfo[303].TxPduInfoIdxOfTxSigInfo Com_TxSigInfo[304].ApplTypeOfTxSigInfo Com_TxSigInfo[304].BitLengthOfTxSigInfo Com_TxSigInfo[304].BitPositionOfTxSigInfo Com_TxSigInfo[304].BusAccOfTxSigInfo Com_TxSigInfo[304].ByteLengthOfTxSigInfo Com_TxSigInfo[304].DynSignalOfTxSigInfo Com_TxSigInfo[304].FilterInitValueIdxOfTxSigInfo Com_TxSigInfo[304].FilterInitValueOfTxSigInfo Com_TxSigInfo[304].InvValueIdxOfTxSigInfo Com_TxSigInfo[304].InvValueOfTxSigInfo Com_TxSigInfo[304].OnChangeIdxOfTxSigInfo Com_TxSigInfo[304].OnChangeOfTxSigInfo Com_TxSigInfo[304].StartByteInPduPositionOfTxSigInfo Com_TxSigInfo[304].TxAccessInfoIdxOfTxSigInfo Com_TxSigInfo[304].TxBufferEndIdxOfTxSigInfo Com_TxSigInfo[304].TxBufferStartIdxOfTxSigInfo Com_TxSigInfo[304].TxFilterInitValueArrayBasedFilterInitValueEndIdxOfTxSigInfo Com_TxSigInfo[304].TxFilterInitValueArrayBasedFilterInitValueStartIdxOfTxSigInfo Com_TxSigInfo[304].TxPduInfoIdxOfTxSigInfo Com_TxSigInfo[305].ApplTypeOfTxSigInfo Com_TxSigInfo[305].BitLengthOfTxSigInfo Com_TxSigInfo[305].BitPositionOfTxSigInfo Com_TxSigInfo[305].BusAccOfTxSigInfo Com_TxSigInfo[305].ByteLengthOfTxSigInfo Com_TxSigInfo[305].DynSignalOfTxSigInfo Com_TxSigInfo[305].FilterInitValueIdxOfTxSigInfo Com_TxSigInfo[305].FilterInitValueOfTxSigInfo Com_TxSigInfo[305].InvValueIdxOfTxSigInfo Com_TxSigInfo[305].InvValueOfTxSigInfo Com_TxSigInfo[305].OnChangeIdxOfTxSigInfo Com_TxSigInfo[305].OnChangeOfTxSigInfo Com_TxSigInfo[305].StartByteInPduPositionOfTxSigInfo Com_TxSigInfo[305].TxAccessInfoIdxOfTxSigInfo Com_TxSigInfo[305].TxBufferEndIdxOfTxSigInfo Com_TxSigInfo[305].TxBufferStartIdxOfTxSigInfo Com_TxSigInfo[305].TxFilterInitValueArrayBasedFilterInitValueEndIdxOfTxSigInfo Com_TxSigInfo[305].TxFilterInitValueArrayBasedFilterInitValueStartIdxOfTxSigInfo Com_TxSigInfo[305].TxPduInfoIdxOfTxSigInfo Com_TxSigInfo[306].ApplTypeOfTxSigInfo Com_TxSigInfo[306].BitLengthOfTxSigInfo Com_TxSigInfo[306].BitPositionOfTxSigInfo Com_TxSigInfo[306].BusAccOfTxSigInfo Com_TxSigInfo[306].ByteLengthOfTxSigInfo Com_TxSigInfo[306].DynSignalOfTxSigInfo Com_TxSigInfo[306].FilterInitValueIdxOfTxSigInfo Com_TxSigInfo[306].FilterInitValueOfTxSigInfo Com_TxSigInfo[306].InvValueIdxOfTxSigInfo Com_TxSigInfo[306].InvValueOfTxSigInfo Com_TxSigInfo[306].OnChangeIdxOfTxSigInfo Com_TxSigInfo[306].OnChangeOfTxSigInfo Com_TxSigInfo[306].StartByteInPduPositionOfTxSigInfo Com_TxSigInfo[306].TxAccessInfoIdxOfTxSigInfo Com_TxSigInfo[306].TxBufferEndIdxOfTxSigInfo Com_TxSigInfo[306].TxBufferStartIdxOfTxSigInfo Com_TxSigInfo[306].TxFilterInitValueArrayBasedFilterInitValueEndIdxOfTxSigInfo Com_TxSigInfo[306].TxFilterInitValueArrayBasedFilterInitValueStartIdxOfTxSigInfo Com_TxSigInfo[306].TxPduInfoIdxOfTxSigInfo Com_TxSigInfo[307].ApplTypeOfTxSigInfo Com_TxSigInfo[307].BitLengthOfTxSigInfo Com_TxSigInfo[307].BitPositionOfTxSigInfo Com_TxSigInfo[307].BusAccOfTxSigInfo Com_TxSigInfo[307].ByteLengthOfTxSigInfo Com_TxSigInfo[307].DynSignalOfTxSigInfo Com_TxSigInfo[307].FilterInitValueIdxOfTxSigInfo Com_TxSigInfo[307].FilterInitValueOfTxSigInfo Com_TxSigInfo[307].InvValueIdxOfTxSigInfo Com_TxSigInfo[307].InvValueOfTxSigInfo Com_TxSigInfo[307].OnChangeIdxOfTxSigInfo Com_TxSigInfo[307].OnChangeOfTxSigInfo Com_TxSigInfo[307].StartByteInPduPositionOfTxSigInfo Com_TxSigInfo[307].TxAccessInfoIdxOfTxSigInfo Com_TxSigInfo[307].TxBufferEndIdxOfTxSigInfo Com_TxSigInfo[307].TxBufferStartIdxOfTxSigInfo Com_TxSigInfo[307].TxFilterInitValueArrayBasedFilterInitValueEndIdxOfTxSigInfo Com_TxSigInfo[307].TxFilterInitValueArrayBasedFilterInitValueStartIdxOfTxSigInfo Com_TxSigInfo[307].TxPduInfoIdxOfTxSigInfo Com_TxSigInfo[308].ApplTypeOfTxSigInfo Com_TxSigInfo[308].BitLengthOfTxSigInfo Com_TxSigInfo[308].BitPositionOfTxSigInfo Com_TxSigInfo[308].BusAccOfTxSigInfo Com_TxSigInfo[308].ByteLengthOfTxSigInfo Com_TxSigInfo[308].DynSignalOfTxSigInfo Com_TxSigInfo[308].FilterInitValueIdxOfTxSigInfo Com_TxSigInfo[308].FilterInitValueOfTxSigInfo Com_TxSigInfo[308].InvValueIdxOfTxSigInfo Com_TxSigInfo[308].InvValueOfTxSigInfo Com_TxSigInfo[308].OnChangeIdxOfTxSigInfo Com_TxSigInfo[308].OnChangeOfTxSigInfo Com_TxSigInfo[308].StartByteInPduPositionOfTxSigInfo Com_TxSigInfo[308].TxAccessInfoIdxOfTxSigInfo Com_TxSigInfo[308].TxBufferEndIdxOfTxSigInfo Com_TxSigInfo[308].TxBufferStartIdxOfTxSigInfo Com_TxSigInfo[308].TxFilterInitValueArrayBasedFilterInitValueEndIdxOfTxSigInfo Com_TxSigInfo[308].TxFilterInitValueArrayBasedFilterInitValueStartIdxOfTxSigInfo Com_TxSigInfo[308].TxPduInfoIdxOfTxSigInfo Com_TxSigInfo[309].ApplTypeOfTxSigInfo Com_TxSigInfo[309].BitLengthOfTxSigInfo Com_TxSigInfo[309].BitPositionOfTxSigInfo Com_TxSigInfo[309].BusAccOfTxSigInfo Com_TxSigInfo[309].ByteLengthOfTxSigInfo Com_TxSigInfo[309].DynSignalOfTxSigInfo Com_TxSigInfo[309].FilterInitValueIdxOfTxSigInfo Com_TxSigInfo[309].FilterInitValueOfTxSigInfo Com_TxSigInfo[309].InvValueIdxOfTxSigInfo Com_TxSigInfo[309].InvValueOfTxSigInfo Com_TxSigInfo[309].OnChangeIdxOfTxSigInfo Com_TxSigInfo[309].OnChangeOfTxSigInfo Com_TxSigInfo[309].StartByteInPduPositionOfTxSigInfo Com_TxSigInfo[309].TxAccessInfoIdxOfTxSigInfo Com_TxSigInfo[309].TxBufferEndIdxOfTxSigInfo Com_TxSigInfo[309].TxBufferStartIdxOfTxSigInfo Com_TxSigInfo[309].TxFilterInitValueArrayBasedFilterInitValueEndIdxOfTxSigInfo Com_TxSigInfo[309].TxFilterInitValueArrayBasedFilterInitValueStartIdxOfTxSigInfo Com_TxSigInfo[309].TxPduInfoIdxOfTxSigInfo Com_TxSigInfo[30].ApplTypeOfTxSigInfo Com_TxSigInfo[30].BitLengthOfTxSigInfo Com_TxSigInfo[30].BitPositionOfTxSigInfo Com_TxSigInfo[30].BusAccOfTxSigInfo Com_TxSigInfo[30].ByteLengthOfTxSigInfo Com_TxSigInfo[30].DynSignalOfTxSigInfo Com_TxSigInfo[30].FilterInitValueIdxOfTxSigInfo Com_TxSigInfo[30].FilterInitValueOfTxSigInfo Com_TxSigInfo[30].InvValueIdxOfTxSigInfo Com_TxSigInfo[30].InvValueOfTxSigInfo Com_TxSigInfo[30].OnChangeIdxOfTxSigInfo Com_TxSigInfo[30].OnChangeOfTxSigInfo Com_TxSigInfo[30].StartByteInPduPositionOfTxSigInfo Com_TxSigInfo[30].TxAccessInfoIdxOfTxSigInfo Com_TxSigInfo[30].TxBufferEndIdxOfTxSigInfo Com_TxSigInfo[30].TxBufferStartIdxOfTxSigInfo Com_TxSigInfo[30].TxFilterInitValueArrayBasedFilterInitValueEndIdxOfTxSigInfo Com_TxSigInfo[30].TxFilterInitValueArrayBasedFilterInitValueStartIdxOfTxSigInfo Com_TxSigInfo[30].TxPduInfoIdxOfTxSigInfo Com_TxSigInfo[310].ApplTypeOfTxSigInfo Com_TxSigInfo[310].BitLengthOfTxSigInfo Com_TxSigInfo[310].BitPositionOfTxSigInfo Com_TxSigInfo[310].BusAccOfTxSigInfo Com_TxSigInfo[310].ByteLengthOfTxSigInfo Com_TxSigInfo[310].DynSignalOfTxSigInfo Com_TxSigInfo[310].FilterInitValueIdxOfTxSigInfo Com_TxSigInfo[310].FilterInitValueOfTxSigInfo Com_TxSigInfo[310].InvValueIdxOfTxSigInfo Com_TxSigInfo[310].InvValueOfTxSigInfo Com_TxSigInfo[310].OnChangeIdxOfTxSigInfo Com_TxSigInfo[310].OnChangeOfTxSigInfo Com_TxSigInfo[310].StartByteInPduPositionOfTxSigInfo Com_TxSigInfo[310].TxAccessInfoIdxOfTxSigInfo Com_TxSigInfo[310].TxBufferEndIdxOfTxSigInfo Com_TxSigInfo[310].TxBufferStartIdxOfTxSigInfo Com_TxSigInfo[310].TxFilterInitValueArrayBasedFilterInitValueEndIdxOfTxSigInfo Com_TxSigInfo[310].TxFilterInitValueArrayBasedFilterInitValueStartIdxOfTxSigInfo Com_TxSigInfo[310].TxPduInfoIdxOfTxSigInfo Com_TxSigInfo[311].ApplTypeOfTxSigInfo Com_TxSigInfo[311].BitLengthOfTxSigInfo Com_TxSigInfo[311].BitPositionOfTxSigInfo Com_TxSigInfo[311].BusAccOfTxSigInfo Com_TxSigInfo[311].ByteLengthOfTxSigInfo Com_TxSigInfo[311].DynSignalOfTxSigInfo Com_TxSigInfo[311].FilterInitValueIdxOfTxSigInfo Com_TxSigInfo[311].FilterInitValueOfTxSigInfo Com_TxSigInfo[311].InvValueIdxOfTxSigInfo Com_TxSigInfo[311].InvValueOfTxSigInfo Com_TxSigInfo[311].OnChangeIdxOfTxSigInfo Com_TxSigInfo[311].OnChangeOfTxSigInfo Com_TxSigInfo[311].StartByteInPduPositionOfTxSigInfo Com_TxSigInfo[311].TxAccessInfoIdxOfTxSigInfo Com_TxSigInfo[311].TxBufferEndIdxOfTxSigInfo Com_TxSigInfo[311].TxBufferStartIdxOfTxSigInfo Com_TxSigInfo[311].TxFilterInitValueArrayBasedFilterInitValueEndIdxOfTxSigInfo Com_TxSigInfo[311].TxFilterInitValueArrayBasedFilterInitValueStartIdxOfTxSigInfo Com_TxSigInfo[311].TxPduInfoIdxOfTxSigInfo Com_TxSigInfo[312].ApplTypeOfTxSigInfo Com_TxSigInfo[312].BitLengthOfTxSigInfo Com_TxSigInfo[312].BitPositionOfTxSigInfo Com_TxSigInfo[312].BusAccOfTxSigInfo Com_TxSigInfo[312].ByteLengthOfTxSigInfo Com_TxSigInfo[312].DynSignalOfTxSigInfo Com_TxSigInfo[312].FilterInitValueIdxOfTxSigInfo Com_TxSigInfo[312].FilterInitValueOfTxSigInfo Com_TxSigInfo[312].InvValueIdxOfTxSigInfo Com_TxSigInfo[312].InvValueOfTxSigInfo Com_TxSigInfo[312].OnChangeIdxOfTxSigInfo Com_TxSigInfo[312].OnChangeOfTxSigInfo Com_TxSigInfo[312].StartByteInPduPositionOfTxSigInfo Com_TxSigInfo[312].TxAccessInfoIdxOfTxSigInfo Com_TxSigInfo[312].TxBufferEndIdxOfTxSigInfo Com_TxSigInfo[312].TxBufferStartIdxOfTxSigInfo Com_TxSigInfo[312].TxFilterInitValueArrayBasedFilterInitValueEndIdxOfTxSigInfo Com_TxSigInfo[312].TxFilterInitValueArrayBasedFilterInitValueStartIdxOfTxSigInfo Com_TxSigInfo[312].TxPduInfoIdxOfTxSigInfo Com_TxSigInfo[313].ApplTypeOfTxSigInfo Com_TxSigInfo[313].BitLengthOfTxSigInfo Com_TxSigInfo[313].BitPositionOfTxSigInfo Com_TxSigInfo[313].BusAccOfTxSigInfo Com_TxSigInfo[313].ByteLengthOfTxSigInfo Com_TxSigInfo[313].DynSignalOfTxSigInfo Com_TxSigInfo[313].FilterInitValueIdxOfTxSigInfo Com_TxSigInfo[313].FilterInitValueOfTxSigInfo Com_TxSigInfo[313].InvValueIdxOfTxSigInfo Com_TxSigInfo[313].InvValueOfTxSigInfo Com_TxSigInfo[313].OnChangeIdxOfTxSigInfo Com_TxSigInfo[313].OnChangeOfTxSigInfo Com_TxSigInfo[313].StartByteInPduPositionOfTxSigInfo Com_TxSigInfo[313].TxAccessInfoIdxOfTxSigInfo Com_TxSigInfo[313].TxBufferEndIdxOfTxSigInfo Com_TxSigInfo[313].TxBufferStartIdxOfTxSigInfo Com_TxSigInfo[313].TxFilterInitValueArrayBasedFilterInitValueEndIdxOfTxSigInfo Com_TxSigInfo[313].TxFilterInitValueArrayBasedFilterInitValueStartIdxOfTxSigInfo Com_TxSigInfo[313].TxPduInfoIdxOfTxSigInfo Com_TxSigInfo[314].ApplTypeOfTxSigInfo Com_TxSigInfo[314].BitLengthOfTxSigInfo Com_TxSigInfo[314].BitPositionOfTxSigInfo Com_TxSigInfo[314].BusAccOfTxSigInfo Com_TxSigInfo[314].ByteLengthOfTxSigInfo Com_TxSigInfo[314].DynSignalOfTxSigInfo Com_TxSigInfo[314].FilterInitValueIdxOfTxSigInfo Com_TxSigInfo[314].FilterInitValueOfTxSigInfo Com_TxSigInfo[314].InvValueIdxOfTxSigInfo Com_TxSigInfo[314].InvValueOfTxSigInfo Com_TxSigInfo[314].OnChangeIdxOfTxSigInfo Com_TxSigInfo[314].OnChangeOfTxSigInfo Com_TxSigInfo[314].StartByteInPduPositionOfTxSigInfo Com_TxSigInfo[314].TxAccessInfoIdxOfTxSigInfo Com_TxSigInfo[314].TxBufferEndIdxOfTxSigInfo Com_TxSigInfo[314].TxBufferStartIdxOfTxSigInfo Com_TxSigInfo[314].TxFilterInitValueArrayBasedFilterInitValueEndIdxOfTxSigInfo Com_TxSigInfo[314].TxFilterInitValueArrayBasedFilterInitValueStartIdxOfTxSigInfo Com_TxSigInfo[314].TxPduInfoIdxOfTxSigInfo Com_TxSigInfo[315].ApplTypeOfTxSigInfo Com_TxSigInfo[315].BitLengthOfTxSigInfo Com_TxSigInfo[315].BitPositionOfTxSigInfo Com_TxSigInfo[315].BusAccOfTxSigInfo Com_TxSigInfo[315].ByteLengthOfTxSigInfo Com_TxSigInfo[315].DynSignalOfTxSigInfo Com_TxSigInfo[315].FilterInitValueIdxOfTxSigInfo Com_TxSigInfo[315].FilterInitValueOfTxSigInfo Com_TxSigInfo[315].InvValueIdxOfTxSigInfo Com_TxSigInfo[315].InvValueOfTxSigInfo Com_TxSigInfo[315].OnChangeIdxOfTxSigInfo Com_TxSigInfo[315].OnChangeOfTxSigInfo Com_TxSigInfo[315].StartByteInPduPositionOfTxSigInfo Com_TxSigInfo[315].TxAccessInfoIdxOfTxSigInfo Com_TxSigInfo[315].TxBufferEndIdxOfTxSigInfo Com_TxSigInfo[315].TxBufferStartIdxOfTxSigInfo Com_TxSigInfo[315].TxFilterInitValueArrayBasedFilterInitValueEndIdxOfTxSigInfo Com_TxSigInfo[315].TxFilterInitValueArrayBasedFilterInitValueStartIdxOfTxSigInfo Com_TxSigInfo[315].TxPduInfoIdxOfTxSigInfo Com_TxSigInfo[316].ApplTypeOfTxSigInfo Com_TxSigInfo[316].BitLengthOfTxSigInfo Com_TxSigInfo[316].BitPositionOfTxSigInfo Com_TxSigInfo[316].BusAccOfTxSigInfo Com_TxSigInfo[316].ByteLengthOfTxSigInfo Com_TxSigInfo[316].DynSignalOfTxSigInfo Com_TxSigInfo[316].FilterInitValueIdxOfTxSigInfo Com_TxSigInfo[316].FilterInitValueOfTxSigInfo Com_TxSigInfo[316].InvValueIdxOfTxSigInfo Com_TxSigInfo[316].InvValueOfTxSigInfo Com_TxSigInfo[316].OnChangeIdxOfTxSigInfo Com_TxSigInfo[316].OnChangeOfTxSigInfo Com_TxSigInfo[316].StartByteInPduPositionOfTxSigInfo Com_TxSigInfo[316].TxAccessInfoIdxOfTxSigInfo Com_TxSigInfo[316].TxBufferEndIdxOfTxSigInfo Com_TxSigInfo[316].TxBufferStartIdxOfTxSigInfo Com_TxSigInfo[316].TxFilterInitValueArrayBasedFilterInitValueEndIdxOfTxSigInfo Com_TxSigInfo[316].TxFilterInitValueArrayBasedFilterInitValueStartIdxOfTxSigInfo Com_TxSigInfo[316].TxPduInfoIdxOfTxSigInfo Com_TxSigInfo[317].ApplTypeOfTxSigInfo Com_TxSigInfo[317].BitLengthOfTxSigInfo Com_TxSigInfo[317].BitPositionOfTxSigInfo Com_TxSigInfo[317].BusAccOfTxSigInfo Com_TxSigInfo[317].ByteLengthOfTxSigInfo Com_TxSigInfo[317].DynSignalOfTxSigInfo Com_TxSigInfo[317].FilterInitValueIdxOfTxSigInfo Com_TxSigInfo[317].FilterInitValueOfTxSigInfo Com_TxSigInfo[317].InvValueIdxOfTxSigInfo Com_TxSigInfo[317].InvValueOfTxSigInfo Com_TxSigInfo[317].OnChangeIdxOfTxSigInfo Com_TxSigInfo[317].OnChangeOfTxSigInfo Com_TxSigInfo[317].StartByteInPduPositionOfTxSigInfo Com_TxSigInfo[317].TxAccessInfoIdxOfTxSigInfo Com_TxSigInfo[317].TxBufferEndIdxOfTxSigInfo Com_TxSigInfo[317].TxBufferStartIdxOfTxSigInfo Com_TxSigInfo[317].TxFilterInitValueArrayBasedFilterInitValueEndIdxOfTxSigInfo Com_TxSigInfo[317].TxFilterInitValueArrayBasedFilterInitValueStartIdxOfTxSigInfo Com_TxSigInfo[317].TxPduInfoIdxOfTxSigInfo Com_TxSigInfo[318].ApplTypeOfTxSigInfo Com_TxSigInfo[318].BitLengthOfTxSigInfo Com_TxSigInfo[318].BitPositionOfTxSigInfo Com_TxSigInfo[318].BusAccOfTxSigInfo Com_TxSigInfo[318].ByteLengthOfTxSigInfo Com_TxSigInfo[318].DynSignalOfTxSigInfo Com_TxSigInfo[318].FilterInitValueIdxOfTxSigInfo Com_TxSigInfo[318].FilterInitValueOfTxSigInfo Com_TxSigInfo[318].InvValueIdxOfTxSigInfo Com_TxSigInfo[318].InvValueOfTxSigInfo Com_TxSigInfo[318].OnChangeIdxOfTxSigInfo Com_TxSigInfo[318].OnChangeOfTxSigInfo Com_TxSigInfo[318].StartByteInPduPositionOfTxSigInfo Com_TxSigInfo[318].TxAccessInfoIdxOfTxSigInfo Com_TxSigInfo[318].TxBufferEndIdxOfTxSigInfo Com_TxSigInfo[318].TxBufferStartIdxOfTxSigInfo Com_TxSigInfo[318].TxFilterInitValueArrayBasedFilterInitValueEndIdxOfTxSigInfo Com_TxSigInfo[318].TxFilterInitValueArrayBasedFilterInitValueStartIdxOfTxSigInfo Com_TxSigInfo[318].TxPduInfoIdxOfTxSigInfo Com_TxSigInfo[319].ApplTypeOfTxSigInfo Com_TxSigInfo[319].BitLengthOfTxSigInfo Com_TxSigInfo[319].BitPositionOfTxSigInfo Com_TxSigInfo[319].BusAccOfTxSigInfo Com_TxSigInfo[319].ByteLengthOfTxSigInfo Com_TxSigInfo[319].DynSignalOfTxSigInfo Com_TxSigInfo[319].FilterInitValueIdxOfTxSigInfo Com_TxSigInfo[319].FilterInitValueOfTxSigInfo Com_TxSigInfo[319].InvValueIdxOfTxSigInfo Com_TxSigInfo[319].InvValueOfTxSigInfo Com_TxSigInfo[319].OnChangeIdxOfTxSigInfo Com_TxSigInfo[319].OnChangeOfTxSigInfo Com_TxSigInfo[319].StartByteInPduPositionOfTxSigInfo Com_TxSigInfo[319].TxAccessInfoIdxOfTxSigInfo Com_TxSigInfo[319].TxBufferEndIdxOfTxSigInfo Com_TxSigInfo[319].TxBufferStartIdxOfTxSigInfo Com_TxSigInfo[319].TxFilterInitValueArrayBasedFilterInitValueEndIdxOfTxSigInfo Com_TxSigInfo[319].TxFilterInitValueArrayBasedFilterInitValueStartIdxOfTxSigInfo Com_TxSigInfo[319].TxPduInfoIdxOfTxSigInfo Com_TxSigInfo[31].ApplTypeOfTxSigInfo Com_TxSigInfo[31].BitLengthOfTxSigInfo Com_TxSigInfo[31].BitPositionOfTxSigInfo Com_TxSigInfo[31].BusAccOfTxSigInfo Com_TxSigInfo[31].ByteLengthOfTxSigInfo Com_TxSigInfo[31].DynSignalOfTxSigInfo Com_TxSigInfo[31].FilterInitValueIdxOfTxSigInfo Com_TxSigInfo[31].FilterInitValueOfTxSigInfo Com_TxSigInfo[31].InvValueIdxOfTxSigInfo Com_TxSigInfo[31].InvValueOfTxSigInfo Com_TxSigInfo[31].OnChangeIdxOfTxSigInfo Com_TxSigInfo[31].OnChangeOfTxSigInfo Com_TxSigInfo[31].StartByteInPduPositionOfTxSigInfo Com_TxSigInfo[31].TxAccessInfoIdxOfTxSigInfo Com_TxSigInfo[31].TxBufferEndIdxOfTxSigInfo Com_TxSigInfo[31].TxBufferStartIdxOfTxSigInfo Com_TxSigInfo[31].TxFilterInitValueArrayBasedFilterInitValueEndIdxOfTxSigInfo Com_TxSigInfo[31].TxFilterInitValueArrayBasedFilterInitValueStartIdxOfTxSigInfo Com_TxSigInfo[31].TxPduInfoIdxOfTxSigInfo Com_TxSigInfo[320].ApplTypeOfTxSigInfo Com_TxSigInfo[320].BitLengthOfTxSigInfo Com_TxSigInfo[320].BitPositionOfTxSigInfo Com_TxSigInfo[320].BusAccOfTxSigInfo Com_TxSigInfo[320].ByteLengthOfTxSigInfo Com_TxSigInfo[320].DynSignalOfTxSigInfo Com_TxSigInfo[320].FilterInitValueIdxOfTxSigInfo Com_TxSigInfo[320].FilterInitValueOfTxSigInfo Com_TxSigInfo[320].InvValueIdxOfTxSigInfo Com_TxSigInfo[320].InvValueOfTxSigInfo Com_TxSigInfo[320].OnChangeIdxOfTxSigInfo Com_TxSigInfo[320].OnChangeOfTxSigInfo Com_TxSigInfo[320].StartByteInPduPositionOfTxSigInfo Com_TxSigInfo[320].TxAccessInfoIdxOfTxSigInfo Com_TxSigInfo[320].TxBufferEndIdxOfTxSigInfo Com_TxSigInfo[320].TxBufferStartIdxOfTxSigInfo Com_TxSigInfo[320].TxFilterInitValueArrayBasedFilterInitValueEndIdxOfTxSigInfo Com_TxSigInfo[320].TxFilterInitValueArrayBasedFilterInitValueStartIdxOfTxSigInfo Com_TxSigInfo[320].TxPduInfoIdxOfTxSigInfo Com_TxSigInfo[321].ApplTypeOfTxSigInfo Com_TxSigInfo[321].BitLengthOfTxSigInfo Com_TxSigInfo[321].BitPositionOfTxSigInfo Com_TxSigInfo[321].BusAccOfTxSigInfo Com_TxSigInfo[321].ByteLengthOfTxSigInfo Com_TxSigInfo[321].DynSignalOfTxSigInfo Com_TxSigInfo[321].FilterInitValueIdxOfTxSigInfo Com_TxSigInfo[321].FilterInitValueOfTxSigInfo Com_TxSigInfo[321].InvValueIdxOfTxSigInfo Com_TxSigInfo[321].InvValueOfTxSigInfo Com_TxSigInfo[321].OnChangeIdxOfTxSigInfo Com_TxSigInfo[321].OnChangeOfTxSigInfo Com_TxSigInfo[321].StartByteInPduPositionOfTxSigInfo Com_TxSigInfo[321].TxAccessInfoIdxOfTxSigInfo Com_TxSigInfo[321].TxBufferEndIdxOfTxSigInfo Com_TxSigInfo[321].TxBufferStartIdxOfTxSigInfo Com_TxSigInfo[321].TxFilterInitValueArrayBasedFilterInitValueEndIdxOfTxSigInfo Com_TxSigInfo[321].TxFilterInitValueArrayBasedFilterInitValueStartIdxOfTxSigInfo Com_TxSigInfo[321].TxPduInfoIdxOfTxSigInfo Com_TxSigInfo[322].ApplTypeOfTxSigInfo Com_TxSigInfo[322].BitLengthOfTxSigInfo Com_TxSigInfo[322].BitPositionOfTxSigInfo Com_TxSigInfo[322].BusAccOfTxSigInfo Com_TxSigInfo[322].ByteLengthOfTxSigInfo Com_TxSigInfo[322].DynSignalOfTxSigInfo Com_TxSigInfo[322].FilterInitValueIdxOfTxSigInfo Com_TxSigInfo[322].FilterInitValueOfTxSigInfo Com_TxSigInfo[322].InvValueIdxOfTxSigInfo Com_TxSigInfo[322].InvValueOfTxSigInfo Com_TxSigInfo[322].OnChangeIdxOfTxSigInfo Com_TxSigInfo[322].OnChangeOfTxSigInfo Com_TxSigInfo[322].StartByteInPduPositionOfTxSigInfo Com_TxSigInfo[322].TxAccessInfoIdxOfTxSigInfo Com_TxSigInfo[322].TxBufferEndIdxOfTxSigInfo Com_TxSigInfo[322].TxBufferStartIdxOfTxSigInfo Com_TxSigInfo[322].TxFilterInitValueArrayBasedFilterInitValueEndIdxOfTxSigInfo Com_TxSigInfo[322].TxFilterInitValueArrayBasedFilterInitValueStartIdxOfTxSigInfo Com_TxSigInfo[322].TxPduInfoIdxOfTxSigInfo Com_TxSigInfo[323].ApplTypeOfTxSigInfo Com_TxSigInfo[323].BitLengthOfTxSigInfo Com_TxSigInfo[323].BitPositionOfTxSigInfo Com_TxSigInfo[323].BusAccOfTxSigInfo Com_TxSigInfo[323].ByteLengthOfTxSigInfo Com_TxSigInfo[323].DynSignalOfTxSigInfo Com_TxSigInfo[323].FilterInitValueIdxOfTxSigInfo Com_TxSigInfo[323].FilterInitValueOfTxSigInfo Com_TxSigInfo[323].InvValueIdxOfTxSigInfo Com_TxSigInfo[323].InvValueOfTxSigInfo Com_TxSigInfo[323].OnChangeIdxOfTxSigInfo Com_TxSigInfo[323].OnChangeOfTxSigInfo Com_TxSigInfo[323].StartByteInPduPositionOfTxSigInfo Com_TxSigInfo[323].TxAccessInfoIdxOfTxSigInfo Com_TxSigInfo[323].TxBufferEndIdxOfTxSigInfo Com_TxSigInfo[323].TxBufferStartIdxOfTxSigInfo Com_TxSigInfo[323].TxFilterInitValueArrayBasedFilterInitValueEndIdxOfTxSigInfo Com_TxSigInfo[323].TxFilterInitValueArrayBasedFilterInitValueStartIdxOfTxSigInfo Com_TxSigInfo[323].TxPduInfoIdxOfTxSigInfo Com_TxSigInfo[324].ApplTypeOfTxSigInfo Com_TxSigInfo[324].BitLengthOfTxSigInfo Com_TxSigInfo[324].BitPositionOfTxSigInfo Com_TxSigInfo[324].BusAccOfTxSigInfo Com_TxSigInfo[324].ByteLengthOfTxSigInfo Com_TxSigInfo[324].DynSignalOfTxSigInfo Com_TxSigInfo[324].FilterInitValueIdxOfTxSigInfo Com_TxSigInfo[324].FilterInitValueOfTxSigInfo Com_TxSigInfo[324].InvValueIdxOfTxSigInfo Com_TxSigInfo[324].InvValueOfTxSigInfo Com_TxSigInfo[324].OnChangeIdxOfTxSigInfo Com_TxSigInfo[324].OnChangeOfTxSigInfo Com_TxSigInfo[324].StartByteInPduPositionOfTxSigInfo Com_TxSigInfo[324].TxAccessInfoIdxOfTxSigInfo Com_TxSigInfo[324].TxBufferEndIdxOfTxSigInfo Com_TxSigInfo[324].TxBufferStartIdxOfTxSigInfo Com_TxSigInfo[324].TxFilterInitValueArrayBasedFilterInitValueEndIdxOfTxSigInfo Com_TxSigInfo[324].TxFilterInitValueArrayBasedFilterInitValueStartIdxOfTxSigInfo Com_TxSigInfo[324].TxPduInfoIdxOfTxSigInfo Com_TxSigInfo[325].ApplTypeOfTxSigInfo Com_TxSigInfo[325].BitLengthOfTxSigInfo Com_TxSigInfo[325].BitPositionOfTxSigInfo Com_TxSigInfo[325].BusAccOfTxSigInfo Com_TxSigInfo[325].ByteLengthOfTxSigInfo Com_TxSigInfo[325].DynSignalOfTxSigInfo Com_TxSigInfo[325].FilterInitValueIdxOfTxSigInfo Com_TxSigInfo[325].FilterInitValueOfTxSigInfo Com_TxSigInfo[325].InvValueIdxOfTxSigInfo Com_TxSigInfo[325].InvValueOfTxSigInfo Com_TxSigInfo[325].OnChangeIdxOfTxSigInfo Com_TxSigInfo[325].OnChangeOfTxSigInfo Com_TxSigInfo[325].StartByteInPduPositionOfTxSigInfo Com_TxSigInfo[325].TxAccessInfoIdxOfTxSigInfo Com_TxSigInfo[325].TxBufferEndIdxOfTxSigInfo Com_TxSigInfo[325].TxBufferStartIdxOfTxSigInfo Com_TxSigInfo[325].TxFilterInitValueArrayBasedFilterInitValueEndIdxOfTxSigInfo Com_TxSigInfo[325].TxFilterInitValueArrayBasedFilterInitValueStartIdxOfTxSigInfo Com_TxSigInfo[325].TxPduInfoIdxOfTxSigInfo Com_TxSigInfo[326].ApplTypeOfTxSigInfo Com_TxSigInfo[326].BitLengthOfTxSigInfo Com_TxSigInfo[326].BitPositionOfTxSigInfo Com_TxSigInfo[326].BusAccOfTxSigInfo Com_TxSigInfo[326].ByteLengthOfTxSigInfo Com_TxSigInfo[326].DynSignalOfTxSigInfo Com_TxSigInfo[326].FilterInitValueIdxOfTxSigInfo Com_TxSigInfo[326].FilterInitValueOfTxSigInfo Com_TxSigInfo[326].InvValueIdxOfTxSigInfo Com_TxSigInfo[326].InvValueOfTxSigInfo Com_TxSigInfo[326].OnChangeIdxOfTxSigInfo Com_TxSigInfo[326].OnChangeOfTxSigInfo Com_TxSigInfo[326].StartByteInPduPositionOfTxSigInfo Com_TxSigInfo[326].TxAccessInfoIdxOfTxSigInfo Com_TxSigInfo[326].TxBufferEndIdxOfTxSigInfo Com_TxSigInfo[326].TxBufferStartIdxOfTxSigInfo Com_TxSigInfo[326].TxFilterInitValueArrayBasedFilterInitValueEndIdxOfTxSigInfo Com_TxSigInfo[326].TxFilterInitValueArrayBasedFilterInitValueStartIdxOfTxSigInfo Com_TxSigInfo[326].TxPduInfoIdxOfTxSigInfo Com_TxSigInfo[327].ApplTypeOfTxSigInfo Com_TxSigInfo[327].BitLengthOfTxSigInfo Com_TxSigInfo[327].BitPositionOfTxSigInfo Com_TxSigInfo[327].BusAccOfTxSigInfo Com_TxSigInfo[327].ByteLengthOfTxSigInfo Com_TxSigInfo[327].DynSignalOfTxSigInfo Com_TxSigInfo[327].FilterInitValueIdxOfTxSigInfo Com_TxSigInfo[327].FilterInitValueOfTxSigInfo Com_TxSigInfo[327].InvValueIdxOfTxSigInfo Com_TxSigInfo[327].InvValueOfTxSigInfo Com_TxSigInfo[327].OnChangeIdxOfTxSigInfo Com_TxSigInfo[327].OnChangeOfTxSigInfo Com_TxSigInfo[327].StartByteInPduPositionOfTxSigInfo Com_TxSigInfo[327].TxAccessInfoIdxOfTxSigInfo Com_TxSigInfo[327].TxBufferEndIdxOfTxSigInfo Com_TxSigInfo[327].TxBufferStartIdxOfTxSigInfo Com_TxSigInfo[327].TxFilterInitValueArrayBasedFilterInitValueEndIdxOfTxSigInfo Com_TxSigInfo[327].TxFilterInitValueArrayBasedFilterInitValueStartIdxOfTxSigInfo Com_TxSigInfo[327].TxPduInfoIdxOfTxSigInfo Com_TxSigInfo[328].ApplTypeOfTxSigInfo Com_TxSigInfo[328].BitLengthOfTxSigInfo Com_TxSigInfo[328].BitPositionOfTxSigInfo Com_TxSigInfo[328].BusAccOfTxSigInfo Com_TxSigInfo[328].ByteLengthOfTxSigInfo Com_TxSigInfo[328].DynSignalOfTxSigInfo Com_TxSigInfo[328].FilterInitValueIdxOfTxSigInfo Com_TxSigInfo[328].FilterInitValueOfTxSigInfo Com_TxSigInfo[328].InvValueIdxOfTxSigInfo Com_TxSigInfo[328].InvValueOfTxSigInfo Com_TxSigInfo[328].OnChangeIdxOfTxSigInfo Com_TxSigInfo[328].OnChangeOfTxSigInfo Com_TxSigInfo[328].StartByteInPduPositionOfTxSigInfo Com_TxSigInfo[328].TxAccessInfoIdxOfTxSigInfo Com_TxSigInfo[328].TxBufferEndIdxOfTxSigInfo Com_TxSigInfo[328].TxBufferStartIdxOfTxSigInfo Com_TxSigInfo[328].TxFilterInitValueArrayBasedFilterInitValueEndIdxOfTxSigInfo Com_TxSigInfo[328].TxFilterInitValueArrayBasedFilterInitValueStartIdxOfTxSigInfo Com_TxSigInfo[328].TxPduInfoIdxOfTxSigInfo Com_TxSigInfo[329].ApplTypeOfTxSigInfo Com_TxSigInfo[329].BitLengthOfTxSigInfo Com_TxSigInfo[329].BitPositionOfTxSigInfo Com_TxSigInfo[329].BusAccOfTxSigInfo Com_TxSigInfo[329].ByteLengthOfTxSigInfo Com_TxSigInfo[329].DynSignalOfTxSigInfo Com_TxSigInfo[329].FilterInitValueIdxOfTxSigInfo Com_TxSigInfo[329].FilterInitValueOfTxSigInfo Com_TxSigInfo[329].InvValueIdxOfTxSigInfo Com_TxSigInfo[329].InvValueOfTxSigInfo Com_TxSigInfo[329].OnChangeIdxOfTxSigInfo Com_TxSigInfo[329].OnChangeOfTxSigInfo Com_TxSigInfo[329].StartByteInPduPositionOfTxSigInfo Com_TxSigInfo[329].TxAccessInfoIdxOfTxSigInfo Com_TxSigInfo[329].TxBufferEndIdxOfTxSigInfo Com_TxSigInfo[329].TxBufferStartIdxOfTxSigInfo Com_TxSigInfo[329].TxFilterInitValueArrayBasedFilterInitValueEndIdxOfTxSigInfo Com_TxSigInfo[329].TxFilterInitValueArrayBasedFilterInitValueStartIdxOfTxSigInfo Com_TxSigInfo[329].TxPduInfoIdxOfTxSigInfo Com_TxSigInfo[32].ApplTypeOfTxSigInfo Com_TxSigInfo[32].BitLengthOfTxSigInfo Com_TxSigInfo[32].BitPositionOfTxSigInfo Com_TxSigInfo[32].BusAccOfTxSigInfo Com_TxSigInfo[32].ByteLengthOfTxSigInfo Com_TxSigInfo[32].DynSignalOfTxSigInfo Com_TxSigInfo[32].FilterInitValueIdxOfTxSigInfo Com_TxSigInfo[32].FilterInitValueOfTxSigInfo Com_TxSigInfo[32].InvValueIdxOfTxSigInfo Com_TxSigInfo[32].InvValueOfTxSigInfo Com_TxSigInfo[32].OnChangeIdxOfTxSigInfo Com_TxSigInfo[32].OnChangeOfTxSigInfo Com_TxSigInfo[32].StartByteInPduPositionOfTxSigInfo Com_TxSigInfo[32].TxAccessInfoIdxOfTxSigInfo Com_TxSigInfo[32].TxBufferEndIdxOfTxSigInfo Com_TxSigInfo[32].TxBufferStartIdxOfTxSigInfo Com_TxSigInfo[32].TxFilterInitValueArrayBasedFilterInitValueEndIdxOfTxSigInfo Com_TxSigInfo[32].TxFilterInitValueArrayBasedFilterInitValueStartIdxOfTxSigInfo Com_TxSigInfo[32].TxPduInfoIdxOfTxSigInfo Com_TxSigInfo[330].ApplTypeOfTxSigInfo Com_TxSigInfo[330].BitLengthOfTxSigInfo Com_TxSigInfo[330].BitPositionOfTxSigInfo Com_TxSigInfo[330].BusAccOfTxSigInfo Com_TxSigInfo[330].ByteLengthOfTxSigInfo Com_TxSigInfo[330].DynSignalOfTxSigInfo Com_TxSigInfo[330].FilterInitValueIdxOfTxSigInfo Com_TxSigInfo[330].FilterInitValueOfTxSigInfo Com_TxSigInfo[330].InvValueIdxOfTxSigInfo Com_TxSigInfo[330].InvValueOfTxSigInfo Com_TxSigInfo[330].OnChangeIdxOfTxSigInfo Com_TxSigInfo[330].OnChangeOfTxSigInfo Com_TxSigInfo[330].StartByteInPduPositionOfTxSigInfo Com_TxSigInfo[330].TxAccessInfoIdxOfTxSigInfo Com_TxSigInfo[330].TxBufferEndIdxOfTxSigInfo Com_TxSigInfo[330].TxBufferStartIdxOfTxSigInfo Com_TxSigInfo[330].TxFilterInitValueArrayBasedFilterInitValueEndIdxOfTxSigInfo Com_TxSigInfo[330].TxFilterInitValueArrayBasedFilterInitValueStartIdxOfTxSigInfo Com_TxSigInfo[330].TxPduInfoIdxOfTxSigInfo Com_TxSigInfo[331].ApplTypeOfTxSigInfo Com_TxSigInfo[331].BitLengthOfTxSigInfo Com_TxSigInfo[331].BitPositionOfTxSigInfo Com_TxSigInfo[331].BusAccOfTxSigInfo Com_TxSigInfo[331].ByteLengthOfTxSigInfo Com_TxSigInfo[331].DynSignalOfTxSigInfo Com_TxSigInfo[331].FilterInitValueIdxOfTxSigInfo Com_TxSigInfo[331].FilterInitValueOfTxSigInfo Com_TxSigInfo[331].InvValueIdxOfTxSigInfo Com_TxSigInfo[331].InvValueOfTxSigInfo Com_TxSigInfo[331].OnChangeIdxOfTxSigInfo Com_TxSigInfo[331].OnChangeOfTxSigInfo Com_TxSigInfo[331].StartByteInPduPositionOfTxSigInfo Com_TxSigInfo[331].TxAccessInfoIdxOfTxSigInfo Com_TxSigInfo[331].TxBufferEndIdxOfTxSigInfo Com_TxSigInfo[331].TxBufferStartIdxOfTxSigInfo Com_TxSigInfo[331].TxFilterInitValueArrayBasedFilterInitValueEndIdxOfTxSigInfo Com_TxSigInfo[331].TxFilterInitValueArrayBasedFilterInitValueStartIdxOfTxSigInfo Com_TxSigInfo[331].TxPduInfoIdxOfTxSigInfo Com_TxSigInfo[332].ApplTypeOfTxSigInfo Com_TxSigInfo[332].BitLengthOfTxSigInfo Com_TxSigInfo[332].BitPositionOfTxSigInfo Com_TxSigInfo[332].BusAccOfTxSigInfo Com_TxSigInfo[332].ByteLengthOfTxSigInfo Com_TxSigInfo[332].DynSignalOfTxSigInfo Com_TxSigInfo[332].FilterInitValueIdxOfTxSigInfo Com_TxSigInfo[332].FilterInitValueOfTxSigInfo Com_TxSigInfo[332].InvValueIdxOfTxSigInfo Com_TxSigInfo[332].InvValueOfTxSigInfo Com_TxSigInfo[332].OnChangeIdxOfTxSigInfo Com_TxSigInfo[332].OnChangeOfTxSigInfo Com_TxSigInfo[332].StartByteInPduPositionOfTxSigInfo Com_TxSigInfo[332].TxAccessInfoIdxOfTxSigInfo Com_TxSigInfo[332].TxBufferEndIdxOfTxSigInfo Com_TxSigInfo[332].TxBufferStartIdxOfTxSigInfo Com_TxSigInfo[332].TxFilterInitValueArrayBasedFilterInitValueEndIdxOfTxSigInfo Com_TxSigInfo[332].TxFilterInitValueArrayBasedFilterInitValueStartIdxOfTxSigInfo Com_TxSigInfo[332].TxPduInfoIdxOfTxSigInfo Com_TxSigInfo[333].ApplTypeOfTxSigInfo Com_TxSigInfo[333].BitLengthOfTxSigInfo Com_TxSigInfo[333].BitPositionOfTxSigInfo Com_TxSigInfo[333].BusAccOfTxSigInfo Com_TxSigInfo[333].ByteLengthOfTxSigInfo Com_TxSigInfo[333].DynSignalOfTxSigInfo Com_TxSigInfo[333].FilterInitValueIdxOfTxSigInfo Com_TxSigInfo[333].FilterInitValueOfTxSigInfo Com_TxSigInfo[333].InvValueIdxOfTxSigInfo Com_TxSigInfo[333].InvValueOfTxSigInfo Com_TxSigInfo[333].OnChangeIdxOfTxSigInfo Com_TxSigInfo[333].OnChangeOfTxSigInfo Com_TxSigInfo[333].StartByteInPduPositionOfTxSigInfo Com_TxSigInfo[333].TxAccessInfoIdxOfTxSigInfo Com_TxSigInfo[333].TxBufferEndIdxOfTxSigInfo Com_TxSigInfo[333].TxBufferStartIdxOfTxSigInfo Com_TxSigInfo[333].TxFilterInitValueArrayBasedFilterInitValueEndIdxOfTxSigInfo Com_TxSigInfo[333].TxFilterInitValueArrayBasedFilterInitValueStartIdxOfTxSigInfo Com_TxSigInfo[333].TxPduInfoIdxOfTxSigInfo Com_TxSigInfo[334].ApplTypeOfTxSigInfo Com_TxSigInfo[334].BitLengthOfTxSigInfo Com_TxSigInfo[334].BitPositionOfTxSigInfo Com_TxSigInfo[334].BusAccOfTxSigInfo Com_TxSigInfo[334].ByteLengthOfTxSigInfo Com_TxSigInfo[334].DynSignalOfTxSigInfo Com_TxSigInfo[334].FilterInitValueIdxOfTxSigInfo Com_TxSigInfo[334].FilterInitValueOfTxSigInfo Com_TxSigInfo[334].InvValueIdxOfTxSigInfo Com_TxSigInfo[334].InvValueOfTxSigInfo Com_TxSigInfo[334].OnChangeIdxOfTxSigInfo Com_TxSigInfo[334].OnChangeOfTxSigInfo Com_TxSigInfo[334].StartByteInPduPositionOfTxSigInfo Com_TxSigInfo[334].TxAccessInfoIdxOfTxSigInfo Com_TxSigInfo[334].TxBufferEndIdxOfTxSigInfo Com_TxSigInfo[334].TxBufferStartIdxOfTxSigInfo Com_TxSigInfo[334].TxFilterInitValueArrayBasedFilterInitValueEndIdxOfTxSigInfo Com_TxSigInfo[334].TxFilterInitValueArrayBasedFilterInitValueStartIdxOfTxSigInfo Com_TxSigInfo[334].TxPduInfoIdxOfTxSigInfo Com_TxSigInfo[335].ApplTypeOfTxSigInfo Com_TxSigInfo[335].BitLengthOfTxSigInfo Com_TxSigInfo[335].BitPositionOfTxSigInfo Com_TxSigInfo[335].BusAccOfTxSigInfo Com_TxSigInfo[335].ByteLengthOfTxSigInfo Com_TxSigInfo[335].DynSignalOfTxSigInfo Com_TxSigInfo[335].FilterInitValueIdxOfTxSigInfo Com_TxSigInfo[335].FilterInitValueOfTxSigInfo Com_TxSigInfo[335].InvValueIdxOfTxSigInfo Com_TxSigInfo[335].InvValueOfTxSigInfo Com_TxSigInfo[335].OnChangeIdxOfTxSigInfo Com_TxSigInfo[335].OnChangeOfTxSigInfo Com_TxSigInfo[335].StartByteInPduPositionOfTxSigInfo Com_TxSigInfo[335].TxAccessInfoIdxOfTxSigInfo Com_TxSigInfo[335].TxBufferEndIdxOfTxSigInfo Com_TxSigInfo[335].TxBufferStartIdxOfTxSigInfo Com_TxSigInfo[335].TxFilterInitValueArrayBasedFilterInitValueEndIdxOfTxSigInfo Com_TxSigInfo[335].TxFilterInitValueArrayBasedFilterInitValueStartIdxOfTxSigInfo Com_TxSigInfo[335].TxPduInfoIdxOfTxSigInfo Com_TxSigInfo[336].ApplTypeOfTxSigInfo Com_TxSigInfo[336].BitLengthOfTxSigInfo Com_TxSigInfo[336].BitPositionOfTxSigInfo Com_TxSigInfo[336].BusAccOfTxSigInfo Com_TxSigInfo[336].ByteLengthOfTxSigInfo Com_TxSigInfo[336].DynSignalOfTxSigInfo Com_TxSigInfo[336].FilterInitValueIdxOfTxSigInfo Com_TxSigInfo[336].FilterInitValueOfTxSigInfo Com_TxSigInfo[336].InvValueIdxOfTxSigInfo Com_TxSigInfo[336].InvValueOfTxSigInfo Com_TxSigInfo[336].OnChangeIdxOfTxSigInfo Com_TxSigInfo[336].OnChangeOfTxSigInfo Com_TxSigInfo[336].StartByteInPduPositionOfTxSigInfo Com_TxSigInfo[336].TxAccessInfoIdxOfTxSigInfo Com_TxSigInfo[336].TxBufferEndIdxOfTxSigInfo Com_TxSigInfo[336].TxBufferStartIdxOfTxSigInfo Com_TxSigInfo[336].TxFilterInitValueArrayBasedFilterInitValueEndIdxOfTxSigInfo Com_TxSigInfo[336].TxFilterInitValueArrayBasedFilterInitValueStartIdxOfTxSigInfo Com_TxSigInfo[336].TxPduInfoIdxOfTxSigInfo Com_TxSigInfo[337].ApplTypeOfTxSigInfo Com_TxSigInfo[337].BitLengthOfTxSigInfo Com_TxSigInfo[337].BitPositionOfTxSigInfo Com_TxSigInfo[337].BusAccOfTxSigInfo Com_TxSigInfo[337].ByteLengthOfTxSigInfo Com_TxSigInfo[337].DynSignalOfTxSigInfo Com_TxSigInfo[337].FilterInitValueIdxOfTxSigInfo Com_TxSigInfo[337].FilterInitValueOfTxSigInfo Com_TxSigInfo[337].InvValueIdxOfTxSigInfo Com_TxSigInfo[337].InvValueOfTxSigInfo Com_TxSigInfo[337].OnChangeIdxOfTxSigInfo Com_TxSigInfo[337].OnChangeOfTxSigInfo Com_TxSigInfo[337].StartByteInPduPositionOfTxSigInfo Com_TxSigInfo[337].TxAccessInfoIdxOfTxSigInfo Com_TxSigInfo[337].TxBufferEndIdxOfTxSigInfo Com_TxSigInfo[337].TxBufferStartIdxOfTxSigInfo Com_TxSigInfo[337].TxFilterInitValueArrayBasedFilterInitValueEndIdxOfTxSigInfo Com_TxSigInfo[337].TxFilterInitValueArrayBasedFilterInitValueStartIdxOfTxSigInfo Com_TxSigInfo[337].TxPduInfoIdxOfTxSigInfo Com_TxSigInfo[338].ApplTypeOfTxSigInfo Com_TxSigInfo[338].BitLengthOfTxSigInfo Com_TxSigInfo[338].BitPositionOfTxSigInfo Com_TxSigInfo[338].BusAccOfTxSigInfo Com_TxSigInfo[338].ByteLengthOfTxSigInfo Com_TxSigInfo[338].DynSignalOfTxSigInfo Com_TxSigInfo[338].FilterInitValueIdxOfTxSigInfo Com_TxSigInfo[338].FilterInitValueOfTxSigInfo Com_TxSigInfo[338].InvValueIdxOfTxSigInfo Com_TxSigInfo[338].InvValueOfTxSigInfo Com_TxSigInfo[338].OnChangeIdxOfTxSigInfo Com_TxSigInfo[338].OnChangeOfTxSigInfo Com_TxSigInfo[338].StartByteInPduPositionOfTxSigInfo Com_TxSigInfo[338].TxAccessInfoIdxOfTxSigInfo Com_TxSigInfo[338].TxBufferEndIdxOfTxSigInfo Com_TxSigInfo[338].TxBufferStartIdxOfTxSigInfo Com_TxSigInfo[338].TxFilterInitValueArrayBasedFilterInitValueEndIdxOfTxSigInfo Com_TxSigInfo[338].TxFilterInitValueArrayBasedFilterInitValueStartIdxOfTxSigInfo Com_TxSigInfo[338].TxPduInfoIdxOfTxSigInfo Com_TxSigInfo[339].ApplTypeOfTxSigInfo Com_TxSigInfo[339].BitLengthOfTxSigInfo Com_TxSigInfo[339].BitPositionOfTxSigInfo Com_TxSigInfo[339].BusAccOfTxSigInfo Com_TxSigInfo[339].ByteLengthOfTxSigInfo Com_TxSigInfo[339].DynSignalOfTxSigInfo Com_TxSigInfo[339].FilterInitValueIdxOfTxSigInfo Com_TxSigInfo[339].FilterInitValueOfTxSigInfo Com_TxSigInfo[339].InvValueIdxOfTxSigInfo Com_TxSigInfo[339].InvValueOfTxSigInfo Com_TxSigInfo[339].OnChangeIdxOfTxSigInfo Com_TxSigInfo[339].OnChangeOfTxSigInfo Com_TxSigInfo[339].StartByteInPduPositionOfTxSigInfo Com_TxSigInfo[339].TxAccessInfoIdxOfTxSigInfo Com_TxSigInfo[339].TxBufferEndIdxOfTxSigInfo Com_TxSigInfo[339].TxBufferStartIdxOfTxSigInfo Com_TxSigInfo[339].TxFilterInitValueArrayBasedFilterInitValueEndIdxOfTxSigInfo Com_TxSigInfo[339].TxFilterInitValueArrayBasedFilterInitValueStartIdxOfTxSigInfo Com_TxSigInfo[339].TxPduInfoIdxOfTxSigInfo Com_TxSigInfo[33].ApplTypeOfTxSigInfo Com_TxSigInfo[33].BitLengthOfTxSigInfo Com_TxSigInfo[33].BitPositionOfTxSigInfo Com_TxSigInfo[33].BusAccOfTxSigInfo Com_TxSigInfo[33].ByteLengthOfTxSigInfo Com_TxSigInfo[33].DynSignalOfTxSigInfo Com_TxSigInfo[33].FilterInitValueIdxOfTxSigInfo Com_TxSigInfo[33].FilterInitValueOfTxSigInfo Com_TxSigInfo[33].InvValueIdxOfTxSigInfo Com_TxSigInfo[33].InvValueOfTxSigInfo Com_TxSigInfo[33].OnChangeIdxOfTxSigInfo Com_TxSigInfo[33].OnChangeOfTxSigInfo Com_TxSigInfo[33].StartByteInPduPositionOfTxSigInfo Com_TxSigInfo[33].TxAccessInfoIdxOfTxSigInfo Com_TxSigInfo[33].TxBufferEndIdxOfTxSigInfo Com_TxSigInfo[33].TxBufferStartIdxOfTxSigInfo Com_TxSigInfo[33].TxFilterInitValueArrayBasedFilterInitValueEndIdxOfTxSigInfo Com_TxSigInfo[33].TxFilterInitValueArrayBasedFilterInitValueStartIdxOfTxSigInfo Com_TxSigInfo[33].TxPduInfoIdxOfTxSigInfo Com_TxSigInfo[340].ApplTypeOfTxSigInfo Com_TxSigInfo[340].BitLengthOfTxSigInfo Com_TxSigInfo[340].BitPositionOfTxSigInfo Com_TxSigInfo[340].BusAccOfTxSigInfo Com_TxSigInfo[340].ByteLengthOfTxSigInfo Com_TxSigInfo[340].DynSignalOfTxSigInfo Com_TxSigInfo[340].FilterInitValueIdxOfTxSigInfo Com_TxSigInfo[340].FilterInitValueOfTxSigInfo Com_TxSigInfo[340].InvValueIdxOfTxSigInfo Com_TxSigInfo[340].InvValueOfTxSigInfo Com_TxSigInfo[340].OnChangeIdxOfTxSigInfo Com_TxSigInfo[340].OnChangeOfTxSigInfo Com_TxSigInfo[340].StartByteInPduPositionOfTxSigInfo Com_TxSigInfo[340].TxAccessInfoIdxOfTxSigInfo Com_TxSigInfo[340].TxBufferEndIdxOfTxSigInfo Com_TxSigInfo[340].TxBufferStartIdxOfTxSigInfo Com_TxSigInfo[340].TxFilterInitValueArrayBasedFilterInitValueEndIdxOfTxSigInfo Com_TxSigInfo[340].TxFilterInitValueArrayBasedFilterInitValueStartIdxOfTxSigInfo Com_TxSigInfo[340].TxPduInfoIdxOfTxSigInfo Com_TxSigInfo[341].ApplTypeOfTxSigInfo Com_TxSigInfo[341].BitLengthOfTxSigInfo Com_TxSigInfo[341].BitPositionOfTxSigInfo Com_TxSigInfo[341].BusAccOfTxSigInfo Com_TxSigInfo[341].ByteLengthOfTxSigInfo Com_TxSigInfo[341].DynSignalOfTxSigInfo Com_TxSigInfo[341].FilterInitValueIdxOfTxSigInfo Com_TxSigInfo[341].FilterInitValueOfTxSigInfo Com_TxSigInfo[341].InvValueIdxOfTxSigInfo Com_TxSigInfo[341].InvValueOfTxSigInfo Com_TxSigInfo[341].OnChangeIdxOfTxSigInfo Com_TxSigInfo[341].OnChangeOfTxSigInfo Com_TxSigInfo[341].StartByteInPduPositionOfTxSigInfo Com_TxSigInfo[341].TxAccessInfoIdxOfTxSigInfo Com_TxSigInfo[341].TxBufferEndIdxOfTxSigInfo Com_TxSigInfo[341].TxBufferStartIdxOfTxSigInfo Com_TxSigInfo[341].TxFilterInitValueArrayBasedFilterInitValueEndIdxOfTxSigInfo Com_TxSigInfo[341].TxFilterInitValueArrayBasedFilterInitValueStartIdxOfTxSigInfo Com_TxSigInfo[341].TxPduInfoIdxOfTxSigInfo Com_TxSigInfo[342].ApplTypeOfTxSigInfo Com_TxSigInfo[342].BitLengthOfTxSigInfo Com_TxSigInfo[342].BitPositionOfTxSigInfo Com_TxSigInfo[342].BusAccOfTxSigInfo Com_TxSigInfo[342].ByteLengthOfTxSigInfo Com_TxSigInfo[342].DynSignalOfTxSigInfo Com_TxSigInfo[342].FilterInitValueIdxOfTxSigInfo Com_TxSigInfo[342].FilterInitValueOfTxSigInfo Com_TxSigInfo[342].InvValueIdxOfTxSigInfo Com_TxSigInfo[342].InvValueOfTxSigInfo Com_TxSigInfo[342].OnChangeIdxOfTxSigInfo Com_TxSigInfo[342].OnChangeOfTxSigInfo Com_TxSigInfo[342].StartByteInPduPositionOfTxSigInfo Com_TxSigInfo[342].TxAccessInfoIdxOfTxSigInfo Com_TxSigInfo[342].TxBufferEndIdxOfTxSigInfo Com_TxSigInfo[342].TxBufferStartIdxOfTxSigInfo Com_TxSigInfo[342].TxFilterInitValueArrayBasedFilterInitValueEndIdxOfTxSigInfo Com_TxSigInfo[342].TxFilterInitValueArrayBasedFilterInitValueStartIdxOfTxSigInfo Com_TxSigInfo[342].TxPduInfoIdxOfTxSigInfo Com_TxSigInfo[343].ApplTypeOfTxSigInfo Com_TxSigInfo[343].BitLengthOfTxSigInfo Com_TxSigInfo[343].BitPositionOfTxSigInfo Com_TxSigInfo[343].BusAccOfTxSigInfo Com_TxSigInfo[343].ByteLengthOfTxSigInfo Com_TxSigInfo[343].DynSignalOfTxSigInfo Com_TxSigInfo[343].FilterInitValueIdxOfTxSigInfo Com_TxSigInfo[343].FilterInitValueOfTxSigInfo Com_TxSigInfo[343].InvValueIdxOfTxSigInfo Com_TxSigInfo[343].InvValueOfTxSigInfo /end REF_MEASUREMENT
/end GROUP
/end MODULE
/end PROJECT
