ASAP2_VERSION 1 71
/begin PROJECT MICROSAR ""
/begin MODULE CPP ""
/begin MOD_COMMON "" BYTE_ORDER MSB_LAST ALIGNMENT_BYTE 1 ALIGNMENT_WORD 2 ALIGNMENT_LONG 4 ALIGNMENT_FLOAT16_IEEE 2 ALIGNMENT_FLOAT32_IEEE 4 ALIGNMENT_FLOAT64_IEEE 8 ALIGNMENT_INT64 8 /end MOD_COMMON
/begin MEASUREMENT SecOC_AuthenticPduDataContainer "" UBYTE NO_COMPU_METHOD 0 0 0 255 ECU_ADDRESS 0x0 MATRIX_DIM 296 /end MEASUREMENT
/begin MEASUREMENT SecOC_AuthenticatorCache "" UBYTE NO_COMPU_METHOD 0 0 0 255 ECU_ADDRESS 0x0 MATRIX_DIM 48 SYMBOL_LINK "SecOC_AuthenticatorCache.raw" 0 /end MEASUREMENT
/begin MEASUREMENT SecOC_AuthenticatorCache_OBD_HCP1_SOK_XIX_HCP5_CANFD01_499f5f1b_RxOBD_HCP1_SOK_XIX_HCP5_CANFD01_499f5f1b_RxAuthenticatorCache "The element: OBD_HCP1_SOK_XIX_HCP5_CANFD01_499f5f1b_RxOBD_HCP1_SOK_XIX_HCP5_CANFD01_499f5f1b_RxAuthenticatorCache of SecOC_AuthenticatorCache" UBYTE NO_COMPU_METHOD 0 0 0 255 ECU_ADDRESS 0x0 MATRIX_DIM 4 SYMBOL_LINK "SecOC_AuthenticatorCache.raw[4]" 0 /end MEASUREMENT
/begin MEASUREMENT SecOC_Initialized "Initialization state of SecOC. TRUE, if SecOC_Init() has been called, else FALSE." UBYTE SecOC_InitializedType 0 0 0 1 ECU_ADDRESS 0x0 /end MEASUREMENT
/begin MEASUREMENT SecOC_NumberOfMessagesToOverride "" UBYTE NO_COMPU_METHOD 0 0 0 255 ECU_ADDRESS 0x0 MATRIX_DIM 3 SYMBOL_LINK "SecOC_NumberOfMessagesToOverride.raw" 0 /end MEASUREMENT
/begin MEASUREMENT SecOC_NumberOfMessagesToOverride_HVK_03_E2E_SOK_XIX_HCP5_CANFD01_32c3c9b9_Rx "The element: HVK_03_E2E_SOK_XIX_HCP5_CANFD01_32c3c9b9_Rx of SecOC_NumberOfMessagesToOverride" UBYTE NO_COMPU_METHOD 0 0 0 255 ECU_ADDRESS 0x0 SYMBOL_LINK "SecOC_NumberOfMessagesToOverride.raw[1]" 0 /end MEASUREMENT
/begin MEASUREMENT SecOC_NumberOfMessagesToOverride_OBD_HCP1_SOK_XIX_HCP5_CANFD01_499f5f1b_Rx "The element: OBD_HCP1_SOK_XIX_HCP5_CANFD01_499f5f1b_Rx of SecOC_NumberOfMessagesToOverride" UBYTE NO_COMPU_METHOD 0 0 0 255 ECU_ADDRESS 0x0 SYMBOL_LINK "SecOC_NumberOfMessagesToOverride.raw[2]" 0 /end MEASUREMENT
/begin MEASUREMENT SecOC_NumberOfMessagesToOverride_SOK_Zeit_Hybrid_01_Resp_01_SOK_XIX_HCP5_CANFD01_92adacdc_Rx "The element: SOK_Zeit_Hybrid_01_Resp_01_SOK_XIX_HCP5_CANFD01_92adacdc_Rx of SecOC_NumberOfMessagesToOverride" UBYTE NO_COMPU_METHOD 0 0 0 255 ECU_ADDRESS 0x0 SYMBOL_LINK "SecOC_NumberOfMessagesToOverride.raw[0]" 0 /end MEASUREMENT
/begin MEASUREMENT SecOC_RxAuthenticPduSizeOffset "" UWORD NO_COMPU_METHOD 0 0 0 65535 ECU_ADDRESS 0x0 MATRIX_DIM 3 SYMBOL_LINK "SecOC_RxAuthenticPduSizeOffset.raw" 0 /end MEASUREMENT
/begin MEASUREMENT SecOC_RxAuthenticPduSizeOffset_HVK_03_E2E_SOK_XIX_HCP5_CANFD01_32c3c9b9_Rx "The element: HVK_03_E2E_SOK_XIX_HCP5_CANFD01_32c3c9b9_Rx of SecOC_RxAuthenticPduSizeOffset" UWORD NO_COMPU_METHOD 0 0 0 65535 ECU_ADDRESS 0x0 SYMBOL_LINK "SecOC_RxAuthenticPduSizeOffset.raw[0]" 0 /end MEASUREMENT
/begin MEASUREMENT SecOC_RxAuthenticPduSizeOffset_OBD_HCP1_SOK_XIX_HCP5_CANFD01_499f5f1b_Rx "The element: OBD_HCP1_SOK_XIX_HCP5_CANFD01_499f5f1b_Rx of SecOC_RxAuthenticPduSizeOffset" UWORD NO_COMPU_METHOD 0 0 0 65535 ECU_ADDRESS 0x0 SYMBOL_LINK "SecOC_RxAuthenticPduSizeOffset.raw[1]" 0 /end MEASUREMENT
/begin MEASUREMENT SecOC_RxAuthenticPduSizeOffset_SOK_Zeit_Hybrid_01_Resp_01_SOK_XIX_HCP5_CANFD01_92adacdc_Rx "The element: SOK_Zeit_Hybrid_01_Resp_01_SOK_XIX_HCP5_CANFD01_92adacdc_Rx of SecOC_RxAuthenticPduSizeOffset" UWORD NO_COMPU_METHOD 0 0 0 65535 ECU_ADDRESS 0x0 SYMBOL_LINK "SecOC_RxAuthenticPduSizeOffset.raw[2]" 0 /end MEASUREMENT
/begin MEASUREMENT SecOC_RxBuildAttemptsCounter "" UWORD NO_COMPU_METHOD 0 0 0 65535 ECU_ADDRESS 0x0 MATRIX_DIM 3 SYMBOL_LINK "SecOC_RxBuildAttemptsCounter.raw" 0 /end MEASUREMENT
/begin MEASUREMENT SecOC_RxBuildAttemptsCounter_HVK_03_E2E_SOK_XIX_HCP5_CANFD01_32c3c9b9_Rx "The element: HVK_03_E2E_SOK_XIX_HCP5_CANFD01_32c3c9b9_Rx of SecOC_RxBuildAttemptsCounter" UWORD NO_COMPU_METHOD 0 0 0 65535 ECU_ADDRESS 0x0 SYMBOL_LINK "SecOC_RxBuildAttemptsCounter.raw[0]" 0 /end MEASUREMENT
/begin MEASUREMENT SecOC_RxBuildAttemptsCounter_OBD_HCP1_SOK_XIX_HCP5_CANFD01_499f5f1b_Rx "The element: OBD_HCP1_SOK_XIX_HCP5_CANFD01_499f5f1b_Rx of SecOC_RxBuildAttemptsCounter" UWORD NO_COMPU_METHOD 0 0 0 65535 ECU_ADDRESS 0x0 SYMBOL_LINK "SecOC_RxBuildAttemptsCounter.raw[1]" 0 /end MEASUREMENT
/begin MEASUREMENT SecOC_RxBuildAttemptsCounter_SOK_Zeit_Hybrid_01_Resp_01_SOK_XIX_HCP5_CANFD01_92adacdc_Rx "The element: SOK_Zeit_Hybrid_01_Resp_01_SOK_XIX_HCP5_CANFD01_92adacdc_Rx of SecOC_RxBuildAttemptsCounter" UWORD NO_COMPU_METHOD 0 0 0 65535 ECU_ADDRESS 0x0 SYMBOL_LINK "SecOC_RxBuildAttemptsCounter.raw[2]" 0 /end MEASUREMENT
/begin MEASUREMENT SecOC_RxPduInfo[0].AuthDataFreshnessLenOfRxPduInfo "" UBYTE NO_COMPU_METHOD 0 0 0 255 ECU_ADDRESS 0x0 /end MEASUREMENT
/begin MEASUREMENT SecOC_RxPduInfo[0].AuthDataFreshnessOfRxPduInfo "" UBYTE SecOC_AuthDataFreshnessOfRxPduInfoType 0 0 0 255 ECU_ADDRESS 0x0 /end MEASUREMENT
/begin MEASUREMENT SecOC_RxPduInfo[0].AuthDataFreshnessStartBytePositionOfRxPduInfo "" UBYTE NO_COMPU_METHOD 0 0 0 255 ECU_ADDRESS 0x0 /end MEASUREMENT
/begin MEASUREMENT SecOC_RxPduInfo[0].AuthenticExternalIdOfRxPduInfo "" UBYTE SecOC_AuthenticExternalIdOfRxPduInfoType 0 0 0 255 ECU_ADDRESS 0x0 /end MEASUREMENT
/begin MEASUREMENT SecOC_RxPduInfo[0].AuthenticPduDataContainerAuthenticPduEndIdxOfRxPduInfo "" UBYTE SecOC_AuthenticPduDataContainerAuthenticPduEndIdxOfRxPduInfoType 0 0 0 255 ECU_ADDRESS 0x0 /end MEASUREMENT
/begin MEASUREMENT SecOC_RxPduInfo[0].AuthenticPduDataContainerAuthenticPduLengthOfRxPduInfo "" UBYTE NO_COMPU_METHOD 0 0 0 255 ECU_ADDRESS 0x0 /end MEASUREMENT
/begin MEASUREMENT SecOC_RxPduInfo[0].AuthenticPduDataContainerAuthenticPduStartIdxOfRxPduInfo "" UBYTE SecOC_AuthenticPduDataContainerAuthenticPduStartIdxOfRxPduInfoType 0 0 0 255 ECU_ADDRESS 0x0 /end MEASUREMENT
/begin MEASUREMENT SecOC_RxPduInfo[0].AuthenticPduDataContainerDataToAuthenticateEndIdxOfRxPduInfo "" UBYTE NO_COMPU_METHOD 0 0 0 255 ECU_ADDRESS 0x0 /end MEASUREMENT
/begin MEASUREMENT SecOC_RxPduInfo[0].AuthenticPduDataContainerDataToAuthenticateLengthOfRxPduInfo "" UBYTE NO_COMPU_METHOD 0 0 0 255 ECU_ADDRESS 0x0 /end MEASUREMENT
/begin MEASUREMENT SecOC_RxPduInfo[0].AuthenticPduDataContainerDataToAuthenticateStartIdxOfRxPduInfo "" UBYTE NO_COMPU_METHOD 0 0 0 255 ECU_ADDRESS 0x0 /end MEASUREMENT
/begin MEASUREMENT SecOC_RxPduInfo[0].AuthenticPduDataContainerFreshnessVerifyValueEndIdxOfRxPduInfo "" UBYTE SecOC_AuthenticPduDataContainerFreshnessVerifyValueEndIdxOfRxPduInfoType 0 0 0 255 ECU_ADDRESS 0x0 /end MEASUREMENT
/begin MEASUREMENT SecOC_RxPduInfo[0].AuthenticPduDataContainerFreshnessVerifyValueLengthOfRxPduInfo "" UBYTE NO_COMPU_METHOD 0 0 0 255 ECU_ADDRESS 0x0 /end MEASUREMENT
/begin MEASUREMENT SecOC_RxPduInfo[0].AuthenticPduDataContainerFreshnessVerifyValueStartIdxOfRxPduInfo "" UBYTE SecOC_AuthenticPduDataContainerFreshnessVerifyValueStartIdxOfRxPduInfoType 0 0 0 255 ECU_ADDRESS 0x0 /end MEASUREMENT
/begin MEASUREMENT SecOC_RxPduInfo[0].AuthenticationLayerIdOfRxPduInfo "" UWORD NO_COMPU_METHOD 0 0 0 65535 ECU_ADDRESS 0x0 /end MEASUREMENT
/begin MEASUREMENT SecOC_RxPduInfo[0].AuthenticatorCacheEndIdxOfRxPduInfo "" UBYTE NO_COMPU_METHOD 0 0 0 255 ECU_ADDRESS 0x0 /end MEASUREMENT
/begin MEASUREMENT SecOC_RxPduInfo[0].AuthenticatorCacheLengthOfRxPduInfo "" UBYTE NO_COMPU_METHOD 0 0 0 255 ECU_ADDRESS 0x0 /end MEASUREMENT
/begin MEASUREMENT SecOC_RxPduInfo[0].AuthenticatorCacheStartIdxOfRxPduInfo "" UBYTE NO_COMPU_METHOD 0 0 0 255 ECU_ADDRESS 0x0 /end MEASUREMENT
/begin MEASUREMENT SecOC_RxPduInfo[0].BuildAttemptsOfRxPduInfo "" UBYTE NO_COMPU_METHOD 0 0 0 255 ECU_ADDRESS 0x0 /end MEASUREMENT
/begin MEASUREMENT SecOC_RxPduInfo[0].ClientServerVerificationStatusPropagationModeOfRxPduInfo "" UBYTE SecOC_ClientServerVerificationStatusPropagationModeOfRxPduInfoType 0 0 0 255 ECU_ADDRESS 0x0 /end MEASUREMENT
/begin MEASUREMENT SecOC_RxPduInfo[0].DataIdFirstByteOfRxPduInfo "" UBYTE NO_COMPU_METHOD 0 0 0 255 ECU_ADDRESS 0x0 /end MEASUREMENT
/begin MEASUREMENT SecOC_RxPduInfo[0].DataIdOfRxPduInfo "" UWORD NO_COMPU_METHOD 0 0 0 65535 ECU_ADDRESS 0x0 /end MEASUREMENT
/begin MEASUREMENT SecOC_RxPduInfo[0].DataIdSecondByteOfRxPduInfo "" UBYTE NO_COMPU_METHOD 0 0 0 255 ECU_ADDRESS 0x0 /end MEASUREMENT
/begin MEASUREMENT SecOC_RxPduInfo[0].ExternalFreshnessIdOfRxPduInfo "" UBYTE NO_COMPU_METHOD 0 0 0 255 ECU_ADDRESS 0x0 /end MEASUREMENT
/begin MEASUREMENT SecOC_RxPduInfo[0].NumberOfMessagesToOverrideIdxOfRxPduInfo "" UBYTE NO_COMPU_METHOD 0 0 0 255 ECU_ADDRESS 0x0 /end MEASUREMENT
/begin MEASUREMENT SecOC_RxPduInfo[0].PduProcessingOfRxPduInfo "" UBYTE SecOC_PduProcessingOfRxPduInfoType 0 0 0 255 ECU_ADDRESS 0x0 /end MEASUREMENT
/begin MEASUREMENT SecOC_RxPduInfo[0].PduTypeOfRxPduInfo "" UBYTE SecOC_PduTypeOfRxPduInfoType 0 0 0 255 ECU_ADDRESS 0x0 /end MEASUREMENT
/begin MEASUREMENT SecOC_RxPduInfo[0].RxSecuredPduInfoIdxOfRxPduInfo "" UBYTE NO_COMPU_METHOD 0 0 0 255 ECU_ADDRESS 0x0 /end MEASUREMENT
/begin MEASUREMENT SecOC_RxPduInfo[0].SecuredPduDataContainerAuthenticPduEndIdxOfRxPduInfo "" UBYTE SecOC_SecuredPduDataContainerAuthenticPduEndIdxOfRxPduInfoType 0 0 0 255 ECU_ADDRESS 0x0 /end MEASUREMENT
/begin MEASUREMENT SecOC_RxPduInfo[0].SecuredPduDataContainerAuthenticPduLengthOfRxPduInfo "" UBYTE NO_COMPU_METHOD 0 0 0 255 ECU_ADDRESS 0x0 /end MEASUREMENT
/begin MEASUREMENT SecOC_RxPduInfo[0].SecuredPduDataContainerAuthenticPduStartIdxOfRxPduInfo "" UBYTE SecOC_SecuredPduDataContainerAuthenticPduStartIdxOfRxPduInfoType 0 0 0 255 ECU_ADDRESS 0x0 /end MEASUREMENT
/begin MEASUREMENT SecOC_RxPduInfo[0].SecuredPduDataContainerSecuredPduEndIdxOfRxPduInfo "" UBYTE SecOC_SecuredPduDataContainerSecuredPduEndIdxOfRxPduInfoType 0 0 0 255 ECU_ADDRESS 0x0 /end MEASUREMENT
/begin MEASUREMENT SecOC_RxPduInfo[0].SecuredPduDataContainerSecuredPduLengthOfRxPduInfo "" UBYTE NO_COMPU_METHOD 0 0 0 255 ECU_ADDRESS 0x0 /end MEASUREMENT
/begin MEASUREMENT SecOC_RxPduInfo[0].SecuredPduDataContainerSecuredPduStartIdxOfRxPduInfo "" UBYTE SecOC_SecuredPduDataContainerSecuredPduStartIdxOfRxPduInfoType 0 0 0 255 ECU_ADDRESS 0x0 /end MEASUREMENT
/begin MEASUREMENT SecOC_RxPduInfo[0].SecuredPduDataContainerTpSecuredPduEndIdxOfRxPduInfo "" UBYTE SecOC_SecuredPduDataContainerTpSecuredPduEndIdxOfRxPduInfoType 0 0 0 255 ECU_ADDRESS 0x0 /end MEASUREMENT
/begin MEASUREMENT SecOC_RxPduInfo[0].SecuredPduDataContainerTpSecuredPduLengthOfRxPduInfo "" UBYTE NO_COMPU_METHOD 0 0 0 255 ECU_ADDRESS 0x0 /end MEASUREMENT
/begin MEASUREMENT SecOC_RxPduInfo[0].SecuredPduDataContainerTpSecuredPduStartIdxOfRxPduInfo "" UBYTE SecOC_SecuredPduDataContainerTpSecuredPduStartIdxOfRxPduInfoType 0 0 0 255 ECU_ADDRESS 0x0 /end MEASUREMENT
/begin MEASUREMENT SecOC_RxPduInfo[0].SecuredPduDataContainerTruncatedAuthenticatorEndIdxOfRxPduInfo "" UBYTE SecOC_SecuredPduDataContainerTruncatedAuthenticatorEndIdxOfRxPduInfoType 0 0 0 255 ECU_ADDRESS 0x0 /end MEASUREMENT
/begin MEASUREMENT SecOC_RxPduInfo[0].SecuredPduDataContainerTruncatedAuthenticatorLengthOfRxPduInfo "" UBYTE NO_COMPU_METHOD 0 0 0 255 ECU_ADDRESS 0x0 /end MEASUREMENT
/begin MEASUREMENT SecOC_RxPduInfo[0].SecuredPduDataContainerTruncatedAuthenticatorStartIdxOfRxPduInfo "" UBYTE SecOC_SecuredPduDataContainerTruncatedAuthenticatorStartIdxOfRxPduInfoType 0 0 0 255 ECU_ADDRESS 0x0 /end MEASUREMENT
/begin MEASUREMENT SecOC_RxPduInfo[0].TruncAuthStartBitInByteOfRxPduInfo "" UBYTE NO_COMPU_METHOD 0 0 0 255 ECU_ADDRESS 0x0 /end MEASUREMENT
/begin MEASUREMENT SecOC_RxPduInfo[0].TruncFreshnessValueFirstByteShiftOfRxPduInfo "" UBYTE NO_COMPU_METHOD 0 0 0 255 ECU_ADDRESS 0x0 /end MEASUREMENT
/begin MEASUREMENT SecOC_RxPduInfo[0].TruncFreshnessValueSecondByteShiftOfRxPduInfo "" UBYTE NO_COMPU_METHOD 0 0 0 255 ECU_ADDRESS 0x0 /end MEASUREMENT
/begin MEASUREMENT SecOC_RxPduInfo[0].VerificationStatusPropagationModeOfRxPduInfo "" UBYTE SecOC_VerificationStatusPropagationModeOfRxPduInfoType 0 0 0 255 ECU_ADDRESS 0x0 /end MEASUREMENT
/begin MEASUREMENT SecOC_RxPduInfo[0].VerificationStatusWithSecuredPduPropagationModeOfRxPduInfo "" UBYTE SecOC_VerificationStatusWithSecuredPduPropagationModeOfRxPduInfoType 0 0 0 255 ECU_ADDRESS 0x0 /end MEASUREMENT
/begin MEASUREMENT SecOC_RxPduInfo[0].VerifyAttemptsOfRxPduInfo "" UBYTE NO_COMPU_METHOD 0 0 0 255 ECU_ADDRESS 0x0 /end MEASUREMENT
/begin MEASUREMENT SecOC_RxPduInfo[0].VerifyOverrideStatusIdxOfRxPduInfo "" UBYTE NO_COMPU_METHOD 0 0 0 255 ECU_ADDRESS 0x0 /end MEASUREMENT
/begin MEASUREMENT SecOC_RxPduInfo[0].VerifyResultIdxOfRxPduInfo "" UBYTE NO_COMPU_METHOD 0 0 0 255 ECU_ADDRESS 0x0 /end MEASUREMENT
/begin MEASUREMENT SecOC_RxPduInfo[0].truncatedAuthenticationLengthOfRxPduInfo "" UBYTE NO_COMPU_METHOD 0 0 0 255 ECU_ADDRESS 0x0 /end MEASUREMENT
/begin MEASUREMENT SecOC_RxPduInfo[0].truncatedFreshnessValueLengthOfRxPduInfo "" UBYTE NO_COMPU_METHOD 0 0 0 255 ECU_ADDRESS 0x0 /end MEASUREMENT
/begin MEASUREMENT SecOC_RxPduInfo[1].AuthDataFreshnessLenOfRxPduInfo "" UBYTE NO_COMPU_METHOD 0 0 0 255 ECU_ADDRESS 0x0 /end MEASUREMENT
/begin MEASUREMENT SecOC_RxPduInfo[1].AuthDataFreshnessOfRxPduInfo "" UBYTE SecOC_AuthDataFreshnessOfRxPduInfoType 0 0 0 255 ECU_ADDRESS 0x0 /end MEASUREMENT
/begin MEASUREMENT SecOC_RxPduInfo[1].AuthDataFreshnessStartBytePositionOfRxPduInfo "" UBYTE NO_COMPU_METHOD 0 0 0 255 ECU_ADDRESS 0x0 /end MEASUREMENT
/begin MEASUREMENT SecOC_RxPduInfo[1].AuthenticExternalIdOfRxPduInfo "" UBYTE SecOC_AuthenticExternalIdOfRxPduInfoType 0 0 0 255 ECU_ADDRESS 0x0 /end MEASUREMENT
/begin MEASUREMENT SecOC_RxPduInfo[1].AuthenticPduDataContainerAuthenticPduEndIdxOfRxPduInfo "" UBYTE SecOC_AuthenticPduDataContainerAuthenticPduEndIdxOfRxPduInfoType 0 0 0 255 ECU_ADDRESS 0x0 /end MEASUREMENT
/begin MEASUREMENT SecOC_RxPduInfo[1].AuthenticPduDataContainerAuthenticPduLengthOfRxPduInfo "" UBYTE NO_COMPU_METHOD 0 0 0 255 ECU_ADDRESS 0x0 /end MEASUREMENT
/begin MEASUREMENT SecOC_RxPduInfo[1].AuthenticPduDataContainerAuthenticPduStartIdxOfRxPduInfo "" UBYTE SecOC_AuthenticPduDataContainerAuthenticPduStartIdxOfRxPduInfoType 0 0 0 255 ECU_ADDRESS 0x0 /end MEASUREMENT
/begin MEASUREMENT SecOC_RxPduInfo[1].AuthenticPduDataContainerDataToAuthenticateEndIdxOfRxPduInfo "" UBYTE NO_COMPU_METHOD 0 0 0 255 ECU_ADDRESS 0x0 /end MEASUREMENT
/begin MEASUREMENT SecOC_RxPduInfo[1].AuthenticPduDataContainerDataToAuthenticateLengthOfRxPduInfo "" UBYTE NO_COMPU_METHOD 0 0 0 255 ECU_ADDRESS 0x0 /end MEASUREMENT
/begin MEASUREMENT SecOC_RxPduInfo[1].AuthenticPduDataContainerDataToAuthenticateStartIdxOfRxPduInfo "" UBYTE NO_COMPU_METHOD 0 0 0 255 ECU_ADDRESS 0x0 /end MEASUREMENT
/begin MEASUREMENT SecOC_RxPduInfo[1].AuthenticPduDataContainerFreshnessVerifyValueEndIdxOfRxPduInfo "" UBYTE SecOC_AuthenticPduDataContainerFreshnessVerifyValueEndIdxOfRxPduInfoType 0 0 0 255 ECU_ADDRESS 0x0 /end MEASUREMENT
/begin MEASUREMENT SecOC_RxPduInfo[1].AuthenticPduDataContainerFreshnessVerifyValueLengthOfRxPduInfo "" UBYTE NO_COMPU_METHOD 0 0 0 255 ECU_ADDRESS 0x0 /end MEASUREMENT
/begin MEASUREMENT SecOC_RxPduInfo[1].AuthenticPduDataContainerFreshnessVerifyValueStartIdxOfRxPduInfo "" UBYTE SecOC_AuthenticPduDataContainerFreshnessVerifyValueStartIdxOfRxPduInfoType 0 0 0 255 ECU_ADDRESS 0x0 /end MEASUREMENT
/begin MEASUREMENT SecOC_RxPduInfo[1].AuthenticationLayerIdOfRxPduInfo "" UWORD NO_COMPU_METHOD 0 0 0 65535 ECU_ADDRESS 0x0 /end MEASUREMENT
/begin MEASUREMENT SecOC_RxPduInfo[1].AuthenticatorCacheEndIdxOfRxPduInfo "" UBYTE NO_COMPU_METHOD 0 0 0 255 ECU_ADDRESS 0x0 /end MEASUREMENT
/begin MEASUREMENT SecOC_RxPduInfo[1].AuthenticatorCacheLengthOfRxPduInfo "" UBYTE NO_COMPU_METHOD 0 0 0 255 ECU_ADDRESS 0x0 /end MEASUREMENT
/begin MEASUREMENT SecOC_RxPduInfo[1].AuthenticatorCacheStartIdxOfRxPduInfo "" UBYTE NO_COMPU_METHOD 0 0 0 255 ECU_ADDRESS 0x0 /end MEASUREMENT
/begin MEASUREMENT SecOC_RxPduInfo[1].BuildAttemptsOfRxPduInfo "" UBYTE NO_COMPU_METHOD 0 0 0 255 ECU_ADDRESS 0x0 /end MEASUREMENT
/begin MEASUREMENT SecOC_RxPduInfo[1].ClientServerVerificationStatusPropagationModeOfRxPduInfo "" UBYTE SecOC_ClientServerVerificationStatusPropagationModeOfRxPduInfoType 0 0 0 255 ECU_ADDRESS 0x0 /end MEASUREMENT
/begin MEASUREMENT SecOC_RxPduInfo[1].DataIdFirstByteOfRxPduInfo "" UBYTE NO_COMPU_METHOD 0 0 0 255 ECU_ADDRESS 0x0 /end MEASUREMENT
/begin MEASUREMENT SecOC_RxPduInfo[1].DataIdOfRxPduInfo "" UWORD NO_COMPU_METHOD 0 0 0 65535 ECU_ADDRESS 0x0 /end MEASUREMENT
/begin MEASUREMENT SecOC_RxPduInfo[1].DataIdSecondByteOfRxPduInfo "" UBYTE NO_COMPU_METHOD 0 0 0 255 ECU_ADDRESS 0x0 /end MEASUREMENT
/begin MEASUREMENT SecOC_RxPduInfo[1].ExternalFreshnessIdOfRxPduInfo "" UBYTE NO_COMPU_METHOD 0 0 0 255 ECU_ADDRESS 0x0 /end MEASUREMENT
/begin MEASUREMENT SecOC_RxPduInfo[1].NumberOfMessagesToOverrideIdxOfRxPduInfo "" UBYTE NO_COMPU_METHOD 0 0 0 255 ECU_ADDRESS 0x0 /end MEASUREMENT
/begin MEASUREMENT SecOC_RxPduInfo[1].PduProcessingOfRxPduInfo "" UBYTE SecOC_PduProcessingOfRxPduInfoType 0 0 0 255 ECU_ADDRESS 0x0 /end MEASUREMENT
/begin MEASUREMENT SecOC_RxPduInfo[1].PduTypeOfRxPduInfo "" UBYTE SecOC_PduTypeOfRxPduInfoType 0 0 0 255 ECU_ADDRESS 0x0 /end MEASUREMENT
/begin MEASUREMENT SecOC_RxPduInfo[1].RxSecuredPduInfoIdxOfRxPduInfo "" UBYTE NO_COMPU_METHOD 0 0 0 255 ECU_ADDRESS 0x0 /end MEASUREMENT
/begin MEASUREMENT SecOC_RxPduInfo[1].SecuredPduDataContainerAuthenticPduEndIdxOfRxPduInfo "" UBYTE SecOC_SecuredPduDataContainerAuthenticPduEndIdxOfRxPduInfoType 0 0 0 255 ECU_ADDRESS 0x0 /end MEASUREMENT
/begin MEASUREMENT SecOC_RxPduInfo[1].SecuredPduDataContainerAuthenticPduLengthOfRxPduInfo "" UBYTE NO_COMPU_METHOD 0 0 0 255 ECU_ADDRESS 0x0 /end MEASUREMENT
/begin MEASUREMENT SecOC_RxPduInfo[1].SecuredPduDataContainerAuthenticPduStartIdxOfRxPduInfo "" UBYTE SecOC_SecuredPduDataContainerAuthenticPduStartIdxOfRxPduInfoType 0 0 0 255 ECU_ADDRESS 0x0 /end MEASUREMENT
/begin MEASUREMENT SecOC_RxPduInfo[1].SecuredPduDataContainerSecuredPduEndIdxOfRxPduInfo "" UBYTE SecOC_SecuredPduDataContainerSecuredPduEndIdxOfRxPduInfoType 0 0 0 255 ECU_ADDRESS 0x0 /end MEASUREMENT
/begin MEASUREMENT SecOC_RxPduInfo[1].SecuredPduDataContainerSecuredPduLengthOfRxPduInfo "" UBYTE NO_COMPU_METHOD 0 0 0 255 ECU_ADDRESS 0x0 /end MEASUREMENT
/begin MEASUREMENT SecOC_RxPduInfo[1].SecuredPduDataContainerSecuredPduStartIdxOfRxPduInfo "" UBYTE SecOC_SecuredPduDataContainerSecuredPduStartIdxOfRxPduInfoType 0 0 0 255 ECU_ADDRESS 0x0 /end MEASUREMENT
/begin MEASUREMENT SecOC_RxPduInfo[1].SecuredPduDataContainerTpSecuredPduEndIdxOfRxPduInfo "" UBYTE SecOC_SecuredPduDataContainerTpSecuredPduEndIdxOfRxPduInfoType 0 0 0 255 ECU_ADDRESS 0x0 /end MEASUREMENT
/begin MEASUREMENT SecOC_RxPduInfo[1].SecuredPduDataContainerTpSecuredPduLengthOfRxPduInfo "" UBYTE NO_COMPU_METHOD 0 0 0 255 ECU_ADDRESS 0x0 /end MEASUREMENT
/begin MEASUREMENT SecOC_RxPduInfo[1].SecuredPduDataContainerTpSecuredPduStartIdxOfRxPduInfo "" UBYTE SecOC_SecuredPduDataContainerTpSecuredPduStartIdxOfRxPduInfoType 0 0 0 255 ECU_ADDRESS 0x0 /end MEASUREMENT
/begin MEASUREMENT SecOC_RxPduInfo[1].SecuredPduDataContainerTruncatedAuthenticatorEndIdxOfRxPduInfo "" UBYTE SecOC_SecuredPduDataContainerTruncatedAuthenticatorEndIdxOfRxPduInfoType 0 0 0 255 ECU_ADDRESS 0x0 /end MEASUREMENT
/begin MEASUREMENT SecOC_RxPduInfo[1].SecuredPduDataContainerTruncatedAuthenticatorLengthOfRxPduInfo "" UBYTE NO_COMPU_METHOD 0 0 0 255 ECU_ADDRESS 0x0 /end MEASUREMENT
/begin MEASUREMENT SecOC_RxPduInfo[1].SecuredPduDataContainerTruncatedAuthenticatorStartIdxOfRxPduInfo "" UBYTE SecOC_SecuredPduDataContainerTruncatedAuthenticatorStartIdxOfRxPduInfoType 0 0 0 255 ECU_ADDRESS 0x0 /end MEASUREMENT
/begin MEASUREMENT SecOC_RxPduInfo[1].TruncAuthStartBitInByteOfRxPduInfo "" UBYTE NO_COMPU_METHOD 0 0 0 255 ECU_ADDRESS 0x0 /end MEASUREMENT
/begin MEASUREMENT SecOC_RxPduInfo[1].TruncFreshnessValueFirstByteShiftOfRxPduInfo "" UBYTE NO_COMPU_METHOD 0 0 0 255 ECU_ADDRESS 0x0 /end MEASUREMENT
/begin MEASUREMENT SecOC_RxPduInfo[1].TruncFreshnessValueSecondByteShiftOfRxPduInfo "" UBYTE NO_COMPU_METHOD 0 0 0 255 ECU_ADDRESS 0x0 /end MEASUREMENT
/begin MEASUREMENT SecOC_RxPduInfo[1].VerificationStatusPropagationModeOfRxPduInfo "" UBYTE SecOC_VerificationStatusPropagationModeOfRxPduInfoType 0 0 0 255 ECU_ADDRESS 0x0 /end MEASUREMENT
/begin MEASUREMENT SecOC_RxPduInfo[1].VerificationStatusWithSecuredPduPropagationModeOfRxPduInfo "" UBYTE SecOC_VerificationStatusWithSecuredPduPropagationModeOfRxPduInfoType 0 0 0 255 ECU_ADDRESS 0x0 /end MEASUREMENT
/begin MEASUREMENT SecOC_RxPduInfo[1].VerifyAttemptsOfRxPduInfo "" UBYTE NO_COMPU_METHOD 0 0 0 255 ECU_ADDRESS 0x0 /end MEASUREMENT
/begin MEASUREMENT SecOC_RxPduInfo[1].VerifyOverrideStatusIdxOfRxPduInfo "" UBYTE NO_COMPU_METHOD 0 0 0 255 ECU_ADDRESS 0x0 /end MEASUREMENT
/begin MEASUREMENT SecOC_RxPduInfo[1].VerifyResultIdxOfRxPduInfo "" UBYTE NO_COMPU_METHOD 0 0 0 255 ECU_ADDRESS 0x0 /end MEASUREMENT
/begin MEASUREMENT SecOC_RxPduInfo[1].truncatedAuthenticationLengthOfRxPduInfo "" UBYTE NO_COMPU_METHOD 0 0 0 255 ECU_ADDRESS 0x0 /end MEASUREMENT
/begin MEASUREMENT SecOC_RxPduInfo[1].truncatedFreshnessValueLengthOfRxPduInfo "" UBYTE NO_COMPU_METHOD 0 0 0 255 ECU_ADDRESS 0x0 /end MEASUREMENT
/begin MEASUREMENT SecOC_RxPduInfo[2].AuthDataFreshnessLenOfRxPduInfo "" UBYTE NO_COMPU_METHOD 0 0 0 255 ECU_ADDRESS 0x0 /end MEASUREMENT
/begin MEASUREMENT SecOC_RxPduInfo[2].AuthDataFreshnessOfRxPduInfo "" UBYTE SecOC_AuthDataFreshnessOfRxPduInfoType 0 0 0 255 ECU_ADDRESS 0x0 /end MEASUREMENT
/begin MEASUREMENT SecOC_RxPduInfo[2].AuthDataFreshnessStartBytePositionOfRxPduInfo "" UBYTE NO_COMPU_METHOD 0 0 0 255 ECU_ADDRESS 0x0 /end MEASUREMENT
/begin MEASUREMENT SecOC_RxPduInfo[2].AuthenticExternalIdOfRxPduInfo "" UBYTE SecOC_AuthenticExternalIdOfRxPduInfoType 0 0 0 255 ECU_ADDRESS 0x0 /end MEASUREMENT
/begin MEASUREMENT SecOC_RxPduInfo[2].AuthenticPduDataContainerAuthenticPduEndIdxOfRxPduInfo "" UBYTE SecOC_AuthenticPduDataContainerAuthenticPduEndIdxOfRxPduInfoType 0 0 0 255 ECU_ADDRESS 0x0 /end MEASUREMENT
/begin MEASUREMENT SecOC_RxPduInfo[2].AuthenticPduDataContainerAuthenticPduLengthOfRxPduInfo "" UBYTE NO_COMPU_METHOD 0 0 0 255 ECU_ADDRESS 0x0 /end MEASUREMENT
/begin MEASUREMENT SecOC_RxPduInfo[2].AuthenticPduDataContainerAuthenticPduStartIdxOfRxPduInfo "" UBYTE SecOC_AuthenticPduDataContainerAuthenticPduStartIdxOfRxPduInfoType 0 0 0 255 ECU_ADDRESS 0x0 /end MEASUREMENT
/begin MEASUREMENT SecOC_RxPduInfo[2].AuthenticPduDataContainerDataToAuthenticateEndIdxOfRxPduInfo "" UBYTE NO_COMPU_METHOD 0 0 0 255 ECU_ADDRESS 0x0 /end MEASUREMENT
/begin MEASUREMENT SecOC_RxPduInfo[2].AuthenticPduDataContainerDataToAuthenticateLengthOfRxPduInfo "" UBYTE NO_COMPU_METHOD 0 0 0 255 ECU_ADDRESS 0x0 /end MEASUREMENT
/begin MEASUREMENT SecOC_RxPduInfo[2].AuthenticPduDataContainerDataToAuthenticateStartIdxOfRxPduInfo "" UBYTE NO_COMPU_METHOD 0 0 0 255 ECU_ADDRESS 0x0 /end MEASUREMENT
/begin MEASUREMENT SecOC_RxPduInfo[2].AuthenticPduDataContainerFreshnessVerifyValueEndIdxOfRxPduInfo "" UBYTE SecOC_AuthenticPduDataContainerFreshnessVerifyValueEndIdxOfRxPduInfoType 0 0 0 255 ECU_ADDRESS 0x0 /end MEASUREMENT
/begin MEASUREMENT SecOC_RxPduInfo[2].AuthenticPduDataContainerFreshnessVerifyValueLengthOfRxPduInfo "" UBYTE NO_COMPU_METHOD 0 0 0 255 ECU_ADDRESS 0x0 /end MEASUREMENT
/begin MEASUREMENT SecOC_RxPduInfo[2].AuthenticPduDataContainerFreshnessVerifyValueStartIdxOfRxPduInfo "" UBYTE SecOC_AuthenticPduDataContainerFreshnessVerifyValueStartIdxOfRxPduInfoType 0 0 0 255 ECU_ADDRESS 0x0 /end MEASUREMENT
/begin MEASUREMENT SecOC_RxPduInfo[2].AuthenticationLayerIdOfRxPduInfo "" UWORD NO_COMPU_METHOD 0 0 0 65535 ECU_ADDRESS 0x0 /end MEASUREMENT
/begin MEASUREMENT SecOC_RxPduInfo[2].AuthenticatorCacheEndIdxOfRxPduInfo "" UBYTE NO_COMPU_METHOD 0 0 0 255 ECU_ADDRESS 0x0 /end MEASUREMENT
/begin MEASUREMENT SecOC_RxPduInfo[2].AuthenticatorCacheLengthOfRxPduInfo "" UBYTE NO_COMPU_METHOD 0 0 0 255 ECU_ADDRESS 0x0 /end MEASUREMENT
/begin MEASUREMENT SecOC_RxPduInfo[2].AuthenticatorCacheStartIdxOfRxPduInfo "" UBYTE NO_COMPU_METHOD 0 0 0 255 ECU_ADDRESS 0x0 /end MEASUREMENT
/begin MEASUREMENT SecOC_RxPduInfo[2].BuildAttemptsOfRxPduInfo "" UBYTE NO_COMPU_METHOD 0 0 0 255 ECU_ADDRESS 0x0 /end MEASUREMENT
/begin MEASUREMENT SecOC_RxPduInfo[2].ClientServerVerificationStatusPropagationModeOfRxPduInfo "" UBYTE SecOC_ClientServerVerificationStatusPropagationModeOfRxPduInfoType 0 0 0 255 ECU_ADDRESS 0x0 /end MEASUREMENT
/begin MEASUREMENT SecOC_RxPduInfo[2].DataIdFirstByteOfRxPduInfo "" UBYTE NO_COMPU_METHOD 0 0 0 255 ECU_ADDRESS 0x0 /end MEASUREMENT
/begin MEASUREMENT SecOC_RxPduInfo[2].DataIdOfRxPduInfo "" UWORD NO_COMPU_METHOD 0 0 0 65535 ECU_ADDRESS 0x0 /end MEASUREMENT
/begin MEASUREMENT SecOC_RxPduInfo[2].DataIdSecondByteOfRxPduInfo "" UBYTE NO_COMPU_METHOD 0 0 0 255 ECU_ADDRESS 0x0 /end MEASUREMENT
/begin MEASUREMENT SecOC_RxPduInfo[2].ExternalFreshnessIdOfRxPduInfo "" UBYTE NO_COMPU_METHOD 0 0 0 255 ECU_ADDRESS 0x0 /end MEASUREMENT
/begin MEASUREMENT SecOC_RxPduInfo[2].NumberOfMessagesToOverrideIdxOfRxPduInfo "" UBYTE NO_COMPU_METHOD 0 0 0 255 ECU_ADDRESS 0x0 /end MEASUREMENT
/begin MEASUREMENT SecOC_RxPduInfo[2].PduProcessingOfRxPduInfo "" UBYTE SecOC_PduProcessingOfRxPduInfoType 0 0 0 255 ECU_ADDRESS 0x0 /end MEASUREMENT
/begin MEASUREMENT SecOC_RxPduInfo[2].PduTypeOfRxPduInfo "" UBYTE SecOC_PduTypeOfRxPduInfoType 0 0 0 255 ECU_ADDRESS 0x0 /end MEASUREMENT
/begin MEASUREMENT SecOC_RxPduInfo[2].RxSecuredPduInfoIdxOfRxPduInfo "" UBYTE NO_COMPU_METHOD 0 0 0 255 ECU_ADDRESS 0x0 /end MEASUREMENT
/begin MEASUREMENT SecOC_RxPduInfo[2].SecuredPduDataContainerAuthenticPduEndIdxOfRxPduInfo "" UBYTE SecOC_SecuredPduDataContainerAuthenticPduEndIdxOfRxPduInfoType 0 0 0 255 ECU_ADDRESS 0x0 /end MEASUREMENT
/begin MEASUREMENT SecOC_RxPduInfo[2].SecuredPduDataContainerAuthenticPduLengthOfRxPduInfo "" UBYTE NO_COMPU_METHOD 0 0 0 255 ECU_ADDRESS 0x0 /end MEASUREMENT
/begin MEASUREMENT SecOC_RxPduInfo[2].SecuredPduDataContainerAuthenticPduStartIdxOfRxPduInfo "" UBYTE SecOC_SecuredPduDataContainerAuthenticPduStartIdxOfRxPduInfoType 0 0 0 255 ECU_ADDRESS 0x0 /end MEASUREMENT
/begin MEASUREMENT SecOC_RxPduInfo[2].SecuredPduDataContainerSecuredPduEndIdxOfRxPduInfo "" UBYTE SecOC_SecuredPduDataContainerSecuredPduEndIdxOfRxPduInfoType 0 0 0 255 ECU_ADDRESS 0x0 /end MEASUREMENT
/begin MEASUREMENT SecOC_RxPduInfo[2].SecuredPduDataContainerSecuredPduLengthOfRxPduInfo "" UBYTE NO_COMPU_METHOD 0 0 0 255 ECU_ADDRESS 0x0 /end MEASUREMENT
/begin MEASUREMENT SecOC_RxPduInfo[2].SecuredPduDataContainerSecuredPduStartIdxOfRxPduInfo "" UBYTE SecOC_SecuredPduDataContainerSecuredPduStartIdxOfRxPduInfoType 0 0 0 255 ECU_ADDRESS 0x0 /end MEASUREMENT
/begin MEASUREMENT SecOC_RxPduInfo[2].SecuredPduDataContainerTpSecuredPduEndIdxOfRxPduInfo "" UBYTE SecOC_SecuredPduDataContainerTpSecuredPduEndIdxOfRxPduInfoType 0 0 0 255 ECU_ADDRESS 0x0 /end MEASUREMENT
/begin MEASUREMENT SecOC_RxPduInfo[2].SecuredPduDataContainerTpSecuredPduLengthOfRxPduInfo "" UBYTE NO_COMPU_METHOD 0 0 0 255 ECU_ADDRESS 0x0 /end MEASUREMENT
/begin MEASUREMENT SecOC_RxPduInfo[2].SecuredPduDataContainerTpSecuredPduStartIdxOfRxPduInfo "" UBYTE SecOC_SecuredPduDataContainerTpSecuredPduStartIdxOfRxPduInfoType 0 0 0 255 ECU_ADDRESS 0x0 /end MEASUREMENT
/begin MEASUREMENT SecOC_RxPduInfo[2].SecuredPduDataContainerTruncatedAuthenticatorEndIdxOfRxPduInfo "" UBYTE SecOC_SecuredPduDataContainerTruncatedAuthenticatorEndIdxOfRxPduInfoType 0 0 0 255 ECU_ADDRESS 0x0 /end MEASUREMENT
/begin MEASUREMENT SecOC_RxPduInfo[2].SecuredPduDataContainerTruncatedAuthenticatorLengthOfRxPduInfo "" UBYTE NO_COMPU_METHOD 0 0 0 255 ECU_ADDRESS 0x0 /end MEASUREMENT
/begin MEASUREMENT SecOC_RxPduInfo[2].SecuredPduDataContainerTruncatedAuthenticatorStartIdxOfRxPduInfo "" UBYTE SecOC_SecuredPduDataContainerTruncatedAuthenticatorStartIdxOfRxPduInfoType 0 0 0 255 ECU_ADDRESS 0x0 /end MEASUREMENT
/begin MEASUREMENT SecOC_RxPduInfo[2].TruncAuthStartBitInByteOfRxPduInfo "" UBYTE NO_COMPU_METHOD 0 0 0 255 ECU_ADDRESS 0x0 /end MEASUREMENT
/begin MEASUREMENT SecOC_RxPduInfo[2].TruncFreshnessValueFirstByteShiftOfRxPduInfo "" UBYTE NO_COMPU_METHOD 0 0 0 255 ECU_ADDRESS 0x0 /end MEASUREMENT
/begin MEASUREMENT SecOC_RxPduInfo[2].TruncFreshnessValueSecondByteShiftOfRxPduInfo "" UBYTE NO_COMPU_METHOD 0 0 0 255 ECU_ADDRESS 0x0 /end MEASUREMENT
/begin MEASUREMENT SecOC_RxPduInfo[2].VerificationStatusPropagationModeOfRxPduInfo "" UBYTE SecOC_VerificationStatusPropagationModeOfRxPduInfoType 0 0 0 255 ECU_ADDRESS 0x0 /end MEASUREMENT
/begin MEASUREMENT SecOC_RxPduInfo[2].VerificationStatusWithSecuredPduPropagationModeOfRxPduInfo "" UBYTE SecOC_VerificationStatusWithSecuredPduPropagationModeOfRxPduInfoType 0 0 0 255 ECU_ADDRESS 0x0 /end MEASUREMENT
/begin MEASUREMENT SecOC_RxPduInfo[2].VerifyAttemptsOfRxPduInfo "" UBYTE NO_COMPU_METHOD 0 0 0 255 ECU_ADDRESS 0x0 /end MEASUREMENT
/begin MEASUREMENT SecOC_RxPduInfo[2].VerifyOverrideStatusIdxOfRxPduInfo "" UBYTE NO_COMPU_METHOD 0 0 0 255 ECU_ADDRESS 0x0 /end MEASUREMENT
/begin MEASUREMENT SecOC_RxPduInfo[2].VerifyResultIdxOfRxPduInfo "" UBYTE NO_COMPU_METHOD 0 0 0 255 ECU_ADDRESS 0x0 /end MEASUREMENT
/begin MEASUREMENT SecOC_RxPduInfo[2].truncatedAuthenticationLengthOfRxPduInfo "" UBYTE NO_COMPU_METHOD 0 0 0 255 ECU_ADDRESS 0x0 /end MEASUREMENT
/begin MEASUREMENT SecOC_RxPduInfo[2].truncatedFreshnessValueLengthOfRxPduInfo "" UBYTE NO_COMPU_METHOD 0 0 0 255 ECU_ADDRESS 0x0 /end MEASUREMENT
/begin MEASUREMENT SecOC_RxPduState "The state variable is volatile because it is used to ensure data consistency" UBYTE SecOC_RxPduStateType 0 0 0 255 ECU_ADDRESS 0x0 MATRIX_DIM 3 SYMBOL_LINK "SecOC_RxPduState.raw" 0 /end MEASUREMENT
/begin MEASUREMENT SecOC_RxPduState_HVK_03_E2E_SOK_XIX_HCP5_CANFD01_32c3c9b9_Rx "The element: HVK_03_E2E_SOK_XIX_HCP5_CANFD01_32c3c9b9_Rx of SecOC_RxPduState" UBYTE SecOC_RxPduStateType 0 0 0 255 ECU_ADDRESS 0x0 SYMBOL_LINK "SecOC_RxPduState.raw[0]" 0 /end MEASUREMENT
/begin MEASUREMENT SecOC_RxPduState_OBD_HCP1_SOK_XIX_HCP5_CANFD01_499f5f1b_Rx "The element: OBD_HCP1_SOK_XIX_HCP5_CANFD01_499f5f1b_Rx of SecOC_RxPduState" UBYTE SecOC_RxPduStateType 0 0 0 255 ECU_ADDRESS 0x0 SYMBOL_LINK "SecOC_RxPduState.raw[1]" 0 /end MEASUREMENT
/begin MEASUREMENT SecOC_RxPduState_SOK_Zeit_Hybrid_01_Resp_01_SOK_XIX_HCP5_CANFD01_92adacdc_Rx "The element: SOK_Zeit_Hybrid_01_Resp_01_SOK_XIX_HCP5_CANFD01_92adacdc_Rx of SecOC_RxPduState" UBYTE SecOC_RxPduStateType 0 0 0 255 ECU_ADDRESS 0x0 SYMBOL_LINK "SecOC_RxPduState.raw[2]" 0 /end MEASUREMENT
/begin MEASUREMENT SecOC_RxSecuredPduInfo[0].MessageLinkLenOfRxSecuredPduInfo "" UBYTE NO_COMPU_METHOD 0 0 0 255 ECU_ADDRESS 0x0 /end MEASUREMENT
/begin MEASUREMENT SecOC_RxSecuredPduInfo[0].MessageLinkPosOfRxSecuredPduInfo "" UBYTE NO_COMPU_METHOD 0 0 0 255 ECU_ADDRESS 0x0 /end MEASUREMENT
/begin MEASUREMENT SecOC_RxSecuredPduInfo[0].MessageLinkerStartByteInCryptoPduOfRxSecuredPduInfo "" UBYTE NO_COMPU_METHOD 0 0 0 255 ECU_ADDRESS 0x0 /end MEASUREMENT
/begin MEASUREMENT SecOC_RxSecuredPduInfo[0].MessageTypeOfRxSecuredPduInfo "" UBYTE SecOC_MessageTypeOfRxSecuredPduInfoType 0 0 0 255 ECU_ADDRESS 0x0 /end MEASUREMENT
/begin MEASUREMENT SecOC_RxSecuredPduInfo[0].MessagesLinkCryptoPduSrcBitOffsetOfRxSecuredPduInfo "" UBYTE NO_COMPU_METHOD 0 0 0 255 ECU_ADDRESS 0x0 /end MEASUREMENT
/begin MEASUREMENT SecOC_RxSecuredPduInfo[0].MinimumPduLengthOfRxSecuredPduInfo "" UBYTE NO_COMPU_METHOD 0 0 0 255 ECU_ADDRESS 0x0 /end MEASUREMENT
/begin MEASUREMENT SecOC_RxSecuredPduInfo[0].PduFixLengthOfRxSecuredPduInfo "" UBYTE NO_COMPU_METHOD 0 0 0 255 ECU_ADDRESS 0x0 /end MEASUREMENT
/begin MEASUREMENT SecOC_RxSecuredPduInfo[0].RxPduInfoIdxOfRxSecuredPduInfo "" UBYTE NO_COMPU_METHOD 0 0 0 255 ECU_ADDRESS 0x0 /end MEASUREMENT
/begin MEASUREMENT SecOC_RxSecuredPduInfo[0].SecuredPduDataContainerEndIdxOfRxSecuredPduInfo "" UBYTE NO_COMPU_METHOD 0 0 0 255 ECU_ADDRESS 0x0 /end MEASUREMENT
/begin MEASUREMENT SecOC_RxSecuredPduInfo[0].SecuredPduDataContainerLengthOfRxSecuredPduInfo "" UBYTE NO_COMPU_METHOD 0 0 0 255 ECU_ADDRESS 0x0 /end MEASUREMENT
/begin MEASUREMENT SecOC_RxSecuredPduInfo[0].SecuredPduDataContainerStartIdxOfRxSecuredPduInfo "" UBYTE NO_COMPU_METHOD 0 0 0 255 ECU_ADDRESS 0x0 /end MEASUREMENT
/begin MEASUREMENT SecOC_RxSecuredPduInfo[1].MessageLinkLenOfRxSecuredPduInfo "" UBYTE NO_COMPU_METHOD 0 0 0 255 ECU_ADDRESS 0x0 /end MEASUREMENT
/begin MEASUREMENT SecOC_RxSecuredPduInfo[1].MessageLinkPosOfRxSecuredPduInfo "" UBYTE NO_COMPU_METHOD 0 0 0 255 ECU_ADDRESS 0x0 /end MEASUREMENT
/begin MEASUREMENT SecOC_RxSecuredPduInfo[1].MessageLinkerStartByteInCryptoPduOfRxSecuredPduInfo "" UBYTE NO_COMPU_METHOD 0 0 0 255 ECU_ADDRESS 0x0 /end MEASUREMENT
/begin MEASUREMENT SecOC_RxSecuredPduInfo[1].MessageTypeOfRxSecuredPduInfo "" UBYTE SecOC_MessageTypeOfRxSecuredPduInfoType 0 0 0 255 ECU_ADDRESS 0x0 /end MEASUREMENT
/begin MEASUREMENT SecOC_RxSecuredPduInfo[1].MessagesLinkCryptoPduSrcBitOffsetOfRxSecuredPduInfo "" UBYTE NO_COMPU_METHOD 0 0 0 255 ECU_ADDRESS 0x0 /end MEASUREMENT
/begin MEASUREMENT SecOC_RxSecuredPduInfo[1].MinimumPduLengthOfRxSecuredPduInfo "" UBYTE NO_COMPU_METHOD 0 0 0 255 ECU_ADDRESS 0x0 /end MEASUREMENT
/begin MEASUREMENT SecOC_RxSecuredPduInfo[1].PduFixLengthOfRxSecuredPduInfo "" UBYTE NO_COMPU_METHOD 0 0 0 255 ECU_ADDRESS 0x0 /end MEASUREMENT
/begin MEASUREMENT SecOC_RxSecuredPduInfo[1].RxPduInfoIdxOfRxSecuredPduInfo "" UBYTE NO_COMPU_METHOD 0 0 0 255 ECU_ADDRESS 0x0 /end MEASUREMENT
/begin MEASUREMENT SecOC_RxSecuredPduInfo[1].SecuredPduDataContainerEndIdxOfRxSecuredPduInfo "" UBYTE NO_COMPU_METHOD 0 0 0 255 ECU_ADDRESS 0x0 /end MEASUREMENT
/begin MEASUREMENT SecOC_RxSecuredPduInfo[1].SecuredPduDataContainerLengthOfRxSecuredPduInfo "" UBYTE NO_COMPU_METHOD 0 0 0 255 ECU_ADDRESS 0x0 /end MEASUREMENT
/begin MEASUREMENT SecOC_RxSecuredPduInfo[1].SecuredPduDataContainerStartIdxOfRxSecuredPduInfo "" UBYTE NO_COMPU_METHOD 0 0 0 255 ECU_ADDRESS 0x0 /end MEASUREMENT
/begin MEASUREMENT SecOC_RxSecuredPduInfo[2].MessageLinkLenOfRxSecuredPduInfo "" UBYTE NO_COMPU_METHOD 0 0 0 255 ECU_ADDRESS 0x0 /end MEASUREMENT
/begin MEASUREMENT SecOC_RxSecuredPduInfo[2].MessageLinkPosOfRxSecuredPduInfo "" UBYTE NO_COMPU_METHOD 0 0 0 255 ECU_ADDRESS 0x0 /end MEASUREMENT
/begin MEASUREMENT SecOC_RxSecuredPduInfo[2].MessageLinkerStartByteInCryptoPduOfRxSecuredPduInfo "" UBYTE NO_COMPU_METHOD 0 0 0 255 ECU_ADDRESS 0x0 /end MEASUREMENT
/begin MEASUREMENT SecOC_RxSecuredPduInfo[2].MessageTypeOfRxSecuredPduInfo "" UBYTE SecOC_MessageTypeOfRxSecuredPduInfoType 0 0 0 255 ECU_ADDRESS 0x0 /end MEASUREMENT
/begin MEASUREMENT SecOC_RxSecuredPduInfo[2].MessagesLinkCryptoPduSrcBitOffsetOfRxSecuredPduInfo "" UBYTE NO_COMPU_METHOD 0 0 0 255 ECU_ADDRESS 0x0 /end MEASUREMENT
/begin MEASUREMENT SecOC_RxSecuredPduInfo[2].MinimumPduLengthOfRxSecuredPduInfo "" UBYTE NO_COMPU_METHOD 0 0 0 255 ECU_ADDRESS 0x0 /end MEASUREMENT
/begin MEASUREMENT SecOC_RxSecuredPduInfo[2].PduFixLengthOfRxSecuredPduInfo "" UBYTE NO_COMPU_METHOD 0 0 0 255 ECU_ADDRESS 0x0 /end MEASUREMENT
/begin MEASUREMENT SecOC_RxSecuredPduInfo[2].RxPduInfoIdxOfRxSecuredPduInfo "" UBYTE NO_COMPU_METHOD 0 0 0 255 ECU_ADDRESS 0x0 /end MEASUREMENT
/begin MEASUREMENT SecOC_RxSecuredPduInfo[2].SecuredPduDataContainerEndIdxOfRxSecuredPduInfo "" UBYTE NO_COMPU_METHOD 0 0 0 255 ECU_ADDRESS 0x0 /end MEASUREMENT
/begin MEASUREMENT SecOC_RxSecuredPduInfo[2].SecuredPduDataContainerLengthOfRxSecuredPduInfo "" UBYTE NO_COMPU_METHOD 0 0 0 255 ECU_ADDRESS 0x0 /end MEASUREMENT
/begin MEASUREMENT SecOC_RxSecuredPduInfo[2].SecuredPduDataContainerStartIdxOfRxSecuredPduInfo "" UBYTE NO_COMPU_METHOD 0 0 0 255 ECU_ADDRESS 0x0 /end MEASUREMENT
/begin MEASUREMENT SecOC_RxTpWrittenBytesCounter "" UWORD NO_COMPU_METHOD 0 0 0 65535 ECU_ADDRESS 0x0 MATRIX_DIM 3 SYMBOL_LINK "SecOC_RxTpWrittenBytesCounter.raw" 0 /end MEASUREMENT
/begin MEASUREMENT SecOC_RxTpWrittenBytesCounter_HVK_03_E2E_SOK_XIX_HCP5_CANFD01_32c3c9b9_Rx "The element: HVK_03_E2E_SOK_XIX_HCP5_CANFD01_32c3c9b9_Rx of SecOC_RxTpWrittenBytesCounter" UWORD NO_COMPU_METHOD 0 0 0 65535 ECU_ADDRESS 0x0 SYMBOL_LINK "SecOC_RxTpWrittenBytesCounter.raw[0]" 0 /end MEASUREMENT
/begin MEASUREMENT SecOC_RxTpWrittenBytesCounter_OBD_HCP1_SOK_XIX_HCP5_CANFD01_499f5f1b_Rx "The element: OBD_HCP1_SOK_XIX_HCP5_CANFD01_499f5f1b_Rx of SecOC_RxTpWrittenBytesCounter" UWORD NO_COMPU_METHOD 0 0 0 65535 ECU_ADDRESS 0x0 SYMBOL_LINK "SecOC_RxTpWrittenBytesCounter.raw[1]" 0 /end MEASUREMENT
/begin MEASUREMENT SecOC_RxTpWrittenBytesCounter_SOK_Zeit_Hybrid_01_Resp_01_SOK_XIX_HCP5_CANFD01_92adacdc_Rx "The element: SOK_Zeit_Hybrid_01_Resp_01_SOK_XIX_HCP5_CANFD01_92adacdc_Rx of SecOC_RxTpWrittenBytesCounter" UWORD NO_COMPU_METHOD 0 0 0 65535 ECU_ADDRESS 0x0 SYMBOL_LINK "SecOC_RxTpWrittenBytesCounter.raw[2]" 0 /end MEASUREMENT
/begin MEASUREMENT SecOC_SecuredPduDataContainer "" UBYTE NO_COMPU_METHOD 0 0 0 255 ECU_ADDRESS 0x0 MATRIX_DIM 216 /end MEASUREMENT
/begin MEASUREMENT SecOC_TransmitRequest "" UBYTE SecOC_TransmitRequestType 0 0 0 255 ECU_ADDRESS 0x0 MATRIX_DIM 8 SYMBOL_LINK "SecOC_TransmitRequest.raw" 0 /end MEASUREMENT
/begin MEASUREMENT SecOC_TransmitRequest_BMC_HV_01_E2E_SOK_XIX_HCP5_CANFD01_ad756307_Tx "The element: BMC_HV_01_E2E_SOK_XIX_HCP5_CANFD01_ad756307_Tx of SecOC_TransmitRequest" UBYTE SecOC_TransmitRequestType 0 0 0 255 ECU_ADDRESS 0x0 SYMBOL_LINK "SecOC_TransmitRequest.raw[0]" 0 /end MEASUREMENT
/begin MEASUREMENT SecOC_TransmitRequest_BMC_HV_02_E2E_SOK_XIX_HCP5_CANFD01_5f228eff_Tx "The element: BMC_HV_02_E2E_SOK_XIX_HCP5_CANFD01_5f228eff_Tx of SecOC_TransmitRequest" UBYTE SecOC_TransmitRequestType 0 0 0 255 ECU_ADDRESS 0x0 SYMBOL_LINK "SecOC_TransmitRequest.raw[1]" 0 /end MEASUREMENT
/begin MEASUREMENT SecOC_TransmitRequest_BMC_HV_06_SOK_XIX_HCP5_CANFD01_e20cafa8_Tx "The element: BMC_HV_06_SOK_XIX_HCP5_CANFD01_e20cafa8_Tx of SecOC_TransmitRequest" UBYTE SecOC_TransmitRequestType 0 0 0 255 ECU_ADDRESS 0x0 SYMBOL_LINK "SecOC_TransmitRequest.raw[2]" 0 /end MEASUREMENT
/begin MEASUREMENT SecOC_TransmitRequest_BMC_HV_07_SOK_XIX_HCP5_CANFD01_f524cb68_Tx "The element: BMC_HV_07_SOK_XIX_HCP5_CANFD01_f524cb68_Tx of SecOC_TransmitRequest" UBYTE SecOC_TransmitRequestType 0 0 0 255 ECU_ADDRESS 0x0 SYMBOL_LINK "SecOC_TransmitRequest.raw[3]" 0 /end MEASUREMENT
/begin MEASUREMENT SecOC_TransmitRequest_BMC_HV_08_SOK_XIX_HCP5_CANFD01_29bed328_Tx "The element: BMC_HV_08_SOK_XIX_HCP5_CANFD01_29bed328_Tx of SecOC_TransmitRequest" UBYTE SecOC_TransmitRequestType 0 0 0 255 ECU_ADDRESS 0x0 SYMBOL_LINK "SecOC_TransmitRequest.raw[4]" 0 /end MEASUREMENT
/begin MEASUREMENT SecOC_TransmitRequest_BMC_HV_09_SOK_XIX_HCP5_CANFD01_3e96b7e8_Tx "The element: BMC_HV_09_SOK_XIX_HCP5_CANFD01_3e96b7e8_Tx of SecOC_TransmitRequest" UBYTE SecOC_TransmitRequestType 0 0 0 255 ECU_ADDRESS 0x0 SYMBOL_LINK "SecOC_TransmitRequest.raw[5]" 0 /end MEASUREMENT
/begin MEASUREMENT SecOC_TransmitRequest_BMC_HV_14_SOK_XIX_HCP5_CANFD01_572f8cfc_Tx "The element: BMC_HV_14_SOK_XIX_HCP5_CANFD01_572f8cfc_Tx of SecOC_TransmitRequest" UBYTE SecOC_TransmitRequestType 0 0 0 255 ECU_ADDRESS 0x0 SYMBOL_LINK "SecOC_TransmitRequest.raw[6]" 0 /end MEASUREMENT
/begin MEASUREMENT SecOC_TransmitRequest_OBD_Hybrid_01_SOK_XIX_HCP5_CANFD01_86ce2f2e_Tx "The element: OBD_Hybrid_01_SOK_XIX_HCP5_CANFD01_86ce2f2e_Tx of SecOC_TransmitRequest" UBYTE SecOC_TransmitRequestType 0 0 0 255 ECU_ADDRESS 0x0 SYMBOL_LINK "SecOC_TransmitRequest.raw[7]" 0 /end MEASUREMENT
/begin MEASUREMENT SecOC_TxAuthenticPduInfo[0].MinimumPduLengthOfTxAuthenticPduInfo "" UBYTE NO_COMPU_METHOD 0 0 0 255 ECU_ADDRESS 0x0 /end MEASUREMENT
/begin MEASUREMENT SecOC_TxAuthenticPduInfo[0].TxPduInfoIdxOfTxAuthenticPduInfo "" UBYTE NO_COMPU_METHOD 0 0 0 255 ECU_ADDRESS 0x0 /end MEASUREMENT
/begin MEASUREMENT SecOC_TxAuthenticPduInfo[1].MinimumPduLengthOfTxAuthenticPduInfo "" UBYTE NO_COMPU_METHOD 0 0 0 255 ECU_ADDRESS 0x0 /end MEASUREMENT
/begin MEASUREMENT SecOC_TxAuthenticPduInfo[1].TxPduInfoIdxOfTxAuthenticPduInfo "" UBYTE NO_COMPU_METHOD 0 0 0 255 ECU_ADDRESS 0x0 /end MEASUREMENT
/begin MEASUREMENT SecOC_TxAuthenticPduInfo[2].MinimumPduLengthOfTxAuthenticPduInfo "" UBYTE NO_COMPU_METHOD 0 0 0 255 ECU_ADDRESS 0x0 /end MEASUREMENT
/begin MEASUREMENT SecOC_TxAuthenticPduInfo[2].TxPduInfoIdxOfTxAuthenticPduInfo "" UBYTE NO_COMPU_METHOD 0 0 0 255 ECU_ADDRESS 0x0 /end MEASUREMENT
/begin MEASUREMENT SecOC_TxAuthenticPduInfo[3].MinimumPduLengthOfTxAuthenticPduInfo "" UBYTE NO_COMPU_METHOD 0 0 0 255 ECU_ADDRESS 0x0 /end MEASUREMENT
/begin MEASUREMENT SecOC_TxAuthenticPduInfo[3].TxPduInfoIdxOfTxAuthenticPduInfo "" UBYTE NO_COMPU_METHOD 0 0 0 255 ECU_ADDRESS 0x0 /end MEASUREMENT
/begin MEASUREMENT SecOC_TxAuthenticPduInfo[4].MinimumPduLengthOfTxAuthenticPduInfo "" UBYTE NO_COMPU_METHOD 0 0 0 255 ECU_ADDRESS 0x0 /end MEASUREMENT
/begin MEASUREMENT SecOC_TxAuthenticPduInfo[4].TxPduInfoIdxOfTxAuthenticPduInfo "" UBYTE NO_COMPU_METHOD 0 0 0 255 ECU_ADDRESS 0x0 /end MEASUREMENT
/begin MEASUREMENT SecOC_TxAuthenticPduInfo[5].MinimumPduLengthOfTxAuthenticPduInfo "" UBYTE NO_COMPU_METHOD 0 0 0 255 ECU_ADDRESS 0x0 /end MEASUREMENT
/begin MEASUREMENT SecOC_TxAuthenticPduInfo[5].TxPduInfoIdxOfTxAuthenticPduInfo "" UBYTE NO_COMPU_METHOD 0 0 0 255 ECU_ADDRESS 0x0 /end MEASUREMENT
/begin MEASUREMENT SecOC_TxAuthenticPduInfo[6].MinimumPduLengthOfTxAuthenticPduInfo "" UBYTE NO_COMPU_METHOD 0 0 0 255 ECU_ADDRESS 0x0 /end MEASUREMENT
/begin MEASUREMENT SecOC_TxAuthenticPduInfo[6].TxPduInfoIdxOfTxAuthenticPduInfo "" UBYTE NO_COMPU_METHOD 0 0 0 255 ECU_ADDRESS 0x0 /end MEASUREMENT
/begin MEASUREMENT SecOC_TxAuthenticPduInfo[7].MinimumPduLengthOfTxAuthenticPduInfo "" UBYTE NO_COMPU_METHOD 0 0 0 255 ECU_ADDRESS 0x0 /end MEASUREMENT
/begin MEASUREMENT SecOC_TxAuthenticPduInfo[7].TxPduInfoIdxOfTxAuthenticPduInfo "" UBYTE NO_COMPU_METHOD 0 0 0 255 ECU_ADDRESS 0x0 /end MEASUREMENT
/begin MEASUREMENT SecOC_TxAuthenticPduSizeOffset "" UWORD NO_COMPU_METHOD 0 0 0 65535 ECU_ADDRESS 0x0 MATRIX_DIM 8 SYMBOL_LINK "SecOC_TxAuthenticPduSizeOffset.raw" 0 /end MEASUREMENT
/begin MEASUREMENT SecOC_TxAuthenticPduSizeOffset_BMC_HV_01_E2E_SOK_XIX_HCP5_CANFD01_ad756307_Tx "The element: BMC_HV_01_E2E_SOK_XIX_HCP5_CANFD01_ad756307_Tx of SecOC_TxAuthenticPduSizeOffset" UWORD NO_COMPU_METHOD 0 0 0 65535 ECU_ADDRESS 0x0 SYMBOL_LINK "SecOC_TxAuthenticPduSizeOffset.raw[0]" 0 /end MEASUREMENT
/begin MEASUREMENT SecOC_TxAuthenticPduSizeOffset_BMC_HV_02_E2E_SOK_XIX_HCP5_CANFD01_5f228eff_Tx "The element: BMC_HV_02_E2E_SOK_XIX_HCP5_CANFD01_5f228eff_Tx of SecOC_TxAuthenticPduSizeOffset" UWORD NO_COMPU_METHOD 0 0 0 65535 ECU_ADDRESS 0x0 SYMBOL_LINK "SecOC_TxAuthenticPduSizeOffset.raw[1]" 0 /end MEASUREMENT
/begin MEASUREMENT SecOC_TxAuthenticPduSizeOffset_BMC_HV_06_SOK_XIX_HCP5_CANFD01_e20cafa8_Tx "The element: BMC_HV_06_SOK_XIX_HCP5_CANFD01_e20cafa8_Tx of SecOC_TxAuthenticPduSizeOffset" UWORD NO_COMPU_METHOD 0 0 0 65535 ECU_ADDRESS 0x0 SYMBOL_LINK "SecOC_TxAuthenticPduSizeOffset.raw[2]" 0 /end MEASUREMENT
/begin MEASUREMENT SecOC_TxAuthenticPduSizeOffset_BMC_HV_07_SOK_XIX_HCP5_CANFD01_f524cb68_Tx "The element: BMC_HV_07_SOK_XIX_HCP5_CANFD01_f524cb68_Tx of SecOC_TxAuthenticPduSizeOffset" UWORD NO_COMPU_METHOD 0 0 0 65535 ECU_ADDRESS 0x0 SYMBOL_LINK "SecOC_TxAuthenticPduSizeOffset.raw[3]" 0 /end MEASUREMENT
/begin MEASUREMENT SecOC_TxAuthenticPduSizeOffset_BMC_HV_08_SOK_XIX_HCP5_CANFD01_29bed328_Tx "The element: BMC_HV_08_SOK_XIX_HCP5_CANFD01_29bed328_Tx of SecOC_TxAuthenticPduSizeOffset" UWORD NO_COMPU_METHOD 0 0 0 65535 ECU_ADDRESS 0x0 SYMBOL_LINK "SecOC_TxAuthenticPduSizeOffset.raw[4]" 0 /end MEASUREMENT
/begin MEASUREMENT SecOC_TxAuthenticPduSizeOffset_BMC_HV_09_SOK_XIX_HCP5_CANFD01_3e96b7e8_Tx "The element: BMC_HV_09_SOK_XIX_HCP5_CANFD01_3e96b7e8_Tx of SecOC_TxAuthenticPduSizeOffset" UWORD NO_COMPU_METHOD 0 0 0 65535 ECU_ADDRESS 0x0 SYMBOL_LINK "SecOC_TxAuthenticPduSizeOffset.raw[5]" 0 /end MEASUREMENT
/begin MEASUREMENT SecOC_TxAuthenticPduSizeOffset_BMC_HV_14_SOK_XIX_HCP5_CANFD01_572f8cfc_Tx "The element: BMC_HV_14_SOK_XIX_HCP5_CANFD01_572f8cfc_Tx of SecOC_TxAuthenticPduSizeOffset" UWORD NO_COMPU_METHOD 0 0 0 65535 ECU_ADDRESS 0x0 SYMBOL_LINK "SecOC_TxAuthenticPduSizeOffset.raw[6]" 0 /end MEASUREMENT
/begin MEASUREMENT SecOC_TxAuthenticPduSizeOffset_OBD_Hybrid_01_SOK_XIX_HCP5_CANFD01_86ce2f2e_Tx "The element: OBD_Hybrid_01_SOK_XIX_HCP5_CANFD01_86ce2f2e_Tx of SecOC_TxAuthenticPduSizeOffset" UWORD NO_COMPU_METHOD 0 0 0 65535 ECU_ADDRESS 0x0 SYMBOL_LINK "SecOC_TxAuthenticPduSizeOffset.raw[7]" 0 /end MEASUREMENT
/begin MEASUREMENT SecOC_TxBuildAttemptsCounter "" UWORD NO_COMPU_METHOD 0 0 0 65535 ECU_ADDRESS 0x0 MATRIX_DIM 8 SYMBOL_LINK "SecOC_TxBuildAttemptsCounter.raw" 0 /end MEASUREMENT
/begin MEASUREMENT SecOC_TxBuildAttemptsCounter_BMC_HV_01_E2E_SOK_XIX_HCP5_CANFD01_ad756307_Tx "The element: BMC_HV_01_E2E_SOK_XIX_HCP5_CANFD01_ad756307_Tx of SecOC_TxBuildAttemptsCounter" UWORD NO_COMPU_METHOD 0 0 0 65535 ECU_ADDRESS 0x0 SYMBOL_LINK "SecOC_TxBuildAttemptsCounter.raw[0]" 0 /end MEASUREMENT
/begin MEASUREMENT SecOC_TxBuildAttemptsCounter_BMC_HV_02_E2E_SOK_XIX_HCP5_CANFD01_5f228eff_Tx "The element: BMC_HV_02_E2E_SOK_XIX_HCP5_CANFD01_5f228eff_Tx of SecOC_TxBuildAttemptsCounter" UWORD NO_COMPU_METHOD 0 0 0 65535 ECU_ADDRESS 0x0 SYMBOL_LINK "SecOC_TxBuildAttemptsCounter.raw[1]" 0 /end MEASUREMENT
/begin MEASUREMENT SecOC_TxBuildAttemptsCounter_BMC_HV_06_SOK_XIX_HCP5_CANFD01_e20cafa8_Tx "The element: BMC_HV_06_SOK_XIX_HCP5_CANFD01_e20cafa8_Tx of SecOC_TxBuildAttemptsCounter" UWORD NO_COMPU_METHOD 0 0 0 65535 ECU_ADDRESS 0x0 SYMBOL_LINK "SecOC_TxBuildAttemptsCounter.raw[2]" 0 /end MEASUREMENT
/begin MEASUREMENT SecOC_TxBuildAttemptsCounter_BMC_HV_07_SOK_XIX_HCP5_CANFD01_f524cb68_Tx "The element: BMC_HV_07_SOK_XIX_HCP5_CANFD01_f524cb68_Tx of SecOC_TxBuildAttemptsCounter" UWORD NO_COMPU_METHOD 0 0 0 65535 ECU_ADDRESS 0x0 SYMBOL_LINK "SecOC_TxBuildAttemptsCounter.raw[3]" 0 /end MEASUREMENT
/begin MEASUREMENT SecOC_TxBuildAttemptsCounter_BMC_HV_08_SOK_XIX_HCP5_CANFD01_29bed328_Tx "The element: BMC_HV_08_SOK_XIX_HCP5_CANFD01_29bed328_Tx of SecOC_TxBuildAttemptsCounter" UWORD NO_COMPU_METHOD 0 0 0 65535 ECU_ADDRESS 0x0 SYMBOL_LINK "SecOC_TxBuildAttemptsCounter.raw[4]" 0 /end MEASUREMENT
/begin MEASUREMENT SecOC_TxBuildAttemptsCounter_BMC_HV_09_SOK_XIX_HCP5_CANFD01_3e96b7e8_Tx "The element: BMC_HV_09_SOK_XIX_HCP5_CANFD01_3e96b7e8_Tx of SecOC_TxBuildAttemptsCounter" UWORD NO_COMPU_METHOD 0 0 0 65535 ECU_ADDRESS 0x0 SYMBOL_LINK "SecOC_TxBuildAttemptsCounter.raw[5]" 0 /end MEASUREMENT
/begin MEASUREMENT SecOC_TxBuildAttemptsCounter_BMC_HV_14_SOK_XIX_HCP5_CANFD01_572f8cfc_Tx "The element: BMC_HV_14_SOK_XIX_HCP5_CANFD01_572f8cfc_Tx of SecOC_TxBuildAttemptsCounter" UWORD NO_COMPU_METHOD 0 0 0 65535 ECU_ADDRESS 0x0 SYMBOL_LINK "SecOC_TxBuildAttemptsCounter.raw[6]" 0 /end MEASUREMENT
/begin MEASUREMENT SecOC_TxBuildAttemptsCounter_OBD_Hybrid_01_SOK_XIX_HCP5_CANFD01_86ce2f2e_Tx "The element: OBD_Hybrid_01_SOK_XIX_HCP5_CANFD01_86ce2f2e_Tx of SecOC_TxBuildAttemptsCounter" UWORD NO_COMPU_METHOD 0 0 0 65535 ECU_ADDRESS 0x0 SYMBOL_LINK "SecOC_TxBuildAttemptsCounter.raw[7]" 0 /end MEASUREMENT
/begin MEASUREMENT SecOC_TxPduInfo[0].AuthenticExternalIdOfTxPduInfo "" UBYTE SecOC_AuthenticExternalIdOfTxPduInfoType 0 0 0 255 ECU_ADDRESS 0x0 /end MEASUREMENT
/begin MEASUREMENT SecOC_TxPduInfo[0].AuthenticPduDataContainerAuthenticPduEndIdxOfTxPduInfo "" UWORD SecOC_AuthenticPduDataContainerAuthenticPduEndIdxOfTxPduInfoType 0 0 0 65535 ECU_ADDRESS 0x0 /end MEASUREMENT
/begin MEASUREMENT SecOC_TxPduInfo[0].AuthenticPduDataContainerAuthenticPduLengthOfTxPduInfo "" UBYTE NO_COMPU_METHOD 0 0 0 255 ECU_ADDRESS 0x0 /end MEASUREMENT
/begin MEASUREMENT SecOC_TxPduInfo[0].AuthenticPduDataContainerAuthenticPduStartIdxOfTxPduInfo "" UWORD SecOC_AuthenticPduDataContainerAuthenticPduStartIdxOfTxPduInfoType 0 0 0 65535 ECU_ADDRESS 0x0 /end MEASUREMENT
/begin MEASUREMENT SecOC_TxPduInfo[0].AuthenticPduDataContainerDataToAuthenticateEndIdxOfTxPduInfo "" UWORD NO_COMPU_METHOD 0 0 0 65535 ECU_ADDRESS 0x0 /end MEASUREMENT
/begin MEASUREMENT SecOC_TxPduInfo[0].AuthenticPduDataContainerDataToAuthenticateLengthOfTxPduInfo "" UBYTE NO_COMPU_METHOD 0 0 0 255 ECU_ADDRESS 0x0 /end MEASUREMENT
/begin MEASUREMENT SecOC_TxPduInfo[0].AuthenticPduDataContainerDataToAuthenticateStartIdxOfTxPduInfo "" UWORD NO_COMPU_METHOD 0 0 0 65535 ECU_ADDRESS 0x0 /end MEASUREMENT
/begin MEASUREMENT SecOC_TxPduInfo[0].AuthenticPduDataContainerFreshnessVerifyValueEndIdxOfTxPduInfo "" UWORD SecOC_AuthenticPduDataContainerFreshnessVerifyValueEndIdxOfTxPduInfoType 0 0 0 65535 ECU_ADDRESS 0x0 /end MEASUREMENT
/begin MEASUREMENT SecOC_TxPduInfo[0].AuthenticPduDataContainerFreshnessVerifyValueLengthOfTxPduInfo "" UBYTE NO_COMPU_METHOD 0 0 0 255 ECU_ADDRESS 0x0 /end MEASUREMENT
/begin MEASUREMENT SecOC_TxPduInfo[0].AuthenticPduDataContainerFreshnessVerifyValueStartIdxOfTxPduInfo "" UWORD SecOC_AuthenticPduDataContainerFreshnessVerifyValueStartIdxOfTxPduInfoType 0 0 0 65535 ECU_ADDRESS 0x0 /end MEASUREMENT
/begin MEASUREMENT SecOC_TxPduInfo[0].AuthenticPduDataContainerFullAuthenticPduEndIdxOfTxPduInfo "" UWORD SecOC_AuthenticPduDataContainerFullAuthenticPduEndIdxOfTxPduInfoType 0 0 0 65535 ECU_ADDRESS 0x0 /end MEASUREMENT
/begin MEASUREMENT SecOC_TxPduInfo[0].AuthenticPduDataContainerFullAuthenticPduLengthOfTxPduInfo "" UBYTE NO_COMPU_METHOD 0 0 0 255 ECU_ADDRESS 0x0 /end MEASUREMENT
/begin MEASUREMENT SecOC_TxPduInfo[0].AuthenticPduDataContainerFullAuthenticPduStartIdxOfTxPduInfo "" UWORD SecOC_AuthenticPduDataContainerFullAuthenticPduStartIdxOfTxPduInfoType 0 0 0 65535 ECU_ADDRESS 0x0 /end MEASUREMENT
/begin MEASUREMENT SecOC_TxPduInfo[0].AuthenticationLayerIdOfTxPduInfo "" UWORD NO_COMPU_METHOD 0 0 0 65535 ECU_ADDRESS 0x0 /end MEASUREMENT
/begin MEASUREMENT SecOC_TxPduInfo[0].AuthenticatorCacheEndIdxOfTxPduInfo "" UBYTE NO_COMPU_METHOD 0 0 0 255 ECU_ADDRESS 0x0 /end MEASUREMENT
/begin MEASUREMENT SecOC_TxPduInfo[0].AuthenticatorCacheLengthOfTxPduInfo "" UBYTE NO_COMPU_METHOD 0 0 0 255 ECU_ADDRESS 0x0 /end MEASUREMENT
/begin MEASUREMENT SecOC_TxPduInfo[0].AuthenticatorCacheStartIdxOfTxPduInfo "" UBYTE NO_COMPU_METHOD 0 0 0 255 ECU_ADDRESS 0x0 /end MEASUREMENT
/begin MEASUREMENT SecOC_TxPduInfo[0].BuildAttemptsOfTxPduInfo "" UBYTE NO_COMPU_METHOD 0 0 0 255 ECU_ADDRESS 0x0 /end MEASUREMENT
/begin MEASUREMENT SecOC_TxPduInfo[0].ConfirmationNeededOfTxPduInfo "" UBYTE SecOC_ConfirmationNeededOfTxPduInfoType 0 0 0 1 ECU_ADDRESS 0x0 /end MEASUREMENT
/begin MEASUREMENT SecOC_TxPduInfo[0].DataIdFirstByteOfTxPduInfo "" UBYTE NO_COMPU_METHOD 0 0 0 255 ECU_ADDRESS 0x0 /end MEASUREMENT
/begin MEASUREMENT SecOC_TxPduInfo[0].DataIdSecondByteOfTxPduInfo "" UBYTE NO_COMPU_METHOD 0 0 0 255 ECU_ADDRESS 0x0 /end MEASUREMENT
/begin MEASUREMENT SecOC_TxPduInfo[0].ExternalFreshnessIdOfTxPduInfo "" UBYTE NO_COMPU_METHOD 0 0 0 255 ECU_ADDRESS 0x0 /end MEASUREMENT
/begin MEASUREMENT SecOC_TxPduInfo[0].LowerLayerPduTypeOfTxPduInfo "" UBYTE SecOC_LowerLayerPduTypeOfTxPduInfoType 0 0 0 255 ECU_ADDRESS 0x0 /end MEASUREMENT
/begin MEASUREMENT SecOC_TxPduInfo[0].PduProcessingOfTxPduInfo "" UBYTE SecOC_PduProcessingOfTxPduInfoType 0 0 0 255 ECU_ADDRESS 0x0 /end MEASUREMENT
/begin MEASUREMENT SecOC_TxPduInfo[0].PduTypeOfTxPduInfo "" UBYTE SecOC_PduTypeOfTxPduInfoType 0 0 0 255 ECU_ADDRESS 0x0 /end MEASUREMENT
/begin MEASUREMENT SecOC_TxPduInfo[0].ProvideTruncTxFreshnessOfTxPduInfo "" UBYTE SecOC_ProvideTruncTxFreshnessOfTxPduInfoType 0 0 0 255 ECU_ADDRESS 0x0 /end MEASUREMENT
/begin MEASUREMENT SecOC_TxPduInfo[0].SecuredExternalIdOfTxPduInfo "" UBYTE SecOC_SecuredExternalIdOfTxPduInfoType 0 0 0 255 ECU_ADDRESS 0x0 /end MEASUREMENT
/begin MEASUREMENT SecOC_TxPduInfo[0].SecuredPduDataContainerAuthInfoDataEndIdxOfTxPduInfo "" UBYTE SecOC_SecuredPduDataContainerAuthInfoDataEndIdxOfTxPduInfoType 0 0 0 255 ECU_ADDRESS 0x0 /end MEASUREMENT
/begin MEASUREMENT SecOC_TxPduInfo[0].SecuredPduDataContainerAuthInfoDataLengthOfTxPduInfo "" UBYTE NO_COMPU_METHOD 0 0 0 255 ECU_ADDRESS 0x0 /end MEASUREMENT
/begin MEASUREMENT SecOC_TxPduInfo[0].SecuredPduDataContainerAuthInfoDataStartIdxOfTxPduInfo "" UBYTE SecOC_SecuredPduDataContainerAuthInfoDataStartIdxOfTxPduInfoType 0 0 0 255 ECU_ADDRESS 0x0 /end MEASUREMENT
/begin MEASUREMENT SecOC_TxPduInfo[0].SecuredPduDataContainerAuthenticPduEndIdxOfTxPduInfo "" UBYTE SecOC_SecuredPduDataContainerAuthenticPduEndIdxOfTxPduInfoType 0 0 0 255 ECU_ADDRESS 0x0 /end MEASUREMENT
/begin MEASUREMENT SecOC_TxPduInfo[0].SecuredPduDataContainerAuthenticPduLengthOfTxPduInfo "" UBYTE NO_COMPU_METHOD 0 0 0 255 ECU_ADDRESS 0x0 /end MEASUREMENT
/begin MEASUREMENT SecOC_TxPduInfo[0].SecuredPduDataContainerAuthenticPduStartIdxOfTxPduInfo "" UBYTE SecOC_SecuredPduDataContainerAuthenticPduStartIdxOfTxPduInfoType 0 0 0 255 ECU_ADDRESS 0x0 /end MEASUREMENT
/begin MEASUREMENT SecOC_TxPduInfo[0].SecuredPduDataContainerSecuredPduEndIdxOfTxPduInfo "" UBYTE SecOC_SecuredPduDataContainerSecuredPduEndIdxOfTxPduInfoType 0 0 0 255 ECU_ADDRESS 0x0 /end MEASUREMENT
/begin MEASUREMENT SecOC_TxPduInfo[0].SecuredPduDataContainerSecuredPduLengthOfTxPduInfo "" UBYTE NO_COMPU_METHOD 0 0 0 255 ECU_ADDRESS 0x0 /end MEASUREMENT
/begin MEASUREMENT SecOC_TxPduInfo[0].SecuredPduDataContainerSecuredPduStartIdxOfTxPduInfo "" UBYTE SecOC_SecuredPduDataContainerSecuredPduStartIdxOfTxPduInfoType 0 0 0 255 ECU_ADDRESS 0x0 /end MEASUREMENT
/begin MEASUREMENT SecOC_TxPduInfo[0].SecuredPduDataContainerTruncatedAuthenticatorEndIdxOfTxPduInfo "" UBYTE SecOC_SecuredPduDataContainerTruncatedAuthenticatorEndIdxOfTxPduInfoType 0 0 0 255 ECU_ADDRESS 0x0 /end MEASUREMENT
/begin MEASUREMENT SecOC_TxPduInfo[0].SecuredPduDataContainerTruncatedAuthenticatorLengthOfTxPduInfo "" UBYTE NO_COMPU_METHOD 0 0 0 255 ECU_ADDRESS 0x0 /end MEASUREMENT
/begin MEASUREMENT SecOC_TxPduInfo[0].SecuredPduDataContainerTruncatedAuthenticatorStartIdxOfTxPduInfo "" UBYTE SecOC_SecuredPduDataContainerTruncatedAuthenticatorStartIdxOfTxPduInfoType 0 0 0 255 ECU_ADDRESS 0x0 /end MEASUREMENT
/begin MEASUREMENT SecOC_TxPduInfo[0].TruncAuthStartBitInByteOfTxPduInfo "" UBYTE NO_COMPU_METHOD 0 0 0 255 ECU_ADDRESS 0x0 /end MEASUREMENT
/begin MEASUREMENT SecOC_TxPduInfo[0].TruncFreshnessValueFirstByteShiftOfTxPduInfo "" UBYTE NO_COMPU_METHOD 0 0 0 255 ECU_ADDRESS 0x0 /end MEASUREMENT
/begin MEASUREMENT SecOC_TxPduInfo[0].TruncFreshnessValueSecondByteShiftOfTxPduInfo "" UBYTE NO_COMPU_METHOD 0 0 0 255 ECU_ADDRESS 0x0 /end MEASUREMENT
/begin MEASUREMENT SecOC_TxPduInfo[0].truncatedAuthenticationLengthOfTxPduInfo "" UBYTE NO_COMPU_METHOD 0 0 0 255 ECU_ADDRESS 0x0 /end MEASUREMENT
/begin MEASUREMENT SecOC_TxPduInfo[0].truncatedFreshnessValueLengthOfTxPduInfo "" UBYTE NO_COMPU_METHOD 0 0 0 255 ECU_ADDRESS 0x0 /end MEASUREMENT
/begin MEASUREMENT SecOC_TxPduInfo[1].AuthenticExternalIdOfTxPduInfo "" UBYTE SecOC_AuthenticExternalIdOfTxPduInfoType 0 0 0 255 ECU_ADDRESS 0x0 /end MEASUREMENT
/begin MEASUREMENT SecOC_TxPduInfo[1].AuthenticPduDataContainerAuthenticPduEndIdxOfTxPduInfo "" UWORD SecOC_AuthenticPduDataContainerAuthenticPduEndIdxOfTxPduInfoType 0 0 0 65535 ECU_ADDRESS 0x0 /end MEASUREMENT
/begin MEASUREMENT SecOC_TxPduInfo[1].AuthenticPduDataContainerAuthenticPduLengthOfTxPduInfo "" UBYTE NO_COMPU_METHOD 0 0 0 255 ECU_ADDRESS 0x0 /end MEASUREMENT
/begin MEASUREMENT SecOC_TxPduInfo[1].AuthenticPduDataContainerAuthenticPduStartIdxOfTxPduInfo "" UWORD SecOC_AuthenticPduDataContainerAuthenticPduStartIdxOfTxPduInfoType 0 0 0 65535 ECU_ADDRESS 0x0 /end MEASUREMENT
/begin MEASUREMENT SecOC_TxPduInfo[1].AuthenticPduDataContainerDataToAuthenticateEndIdxOfTxPduInfo "" UWORD NO_COMPU_METHOD 0 0 0 65535 ECU_ADDRESS 0x0 /end MEASUREMENT
/begin MEASUREMENT SecOC_TxPduInfo[1].AuthenticPduDataContainerDataToAuthenticateLengthOfTxPduInfo "" UBYTE NO_COMPU_METHOD 0 0 0 255 ECU_ADDRESS 0x0 /end MEASUREMENT
/begin MEASUREMENT SecOC_TxPduInfo[1].AuthenticPduDataContainerDataToAuthenticateStartIdxOfTxPduInfo "" UWORD NO_COMPU_METHOD 0 0 0 65535 ECU_ADDRESS 0x0 /end MEASUREMENT
/begin MEASUREMENT SecOC_TxPduInfo[1].AuthenticPduDataContainerFreshnessVerifyValueEndIdxOfTxPduInfo "" UWORD SecOC_AuthenticPduDataContainerFreshnessVerifyValueEndIdxOfTxPduInfoType 0 0 0 65535 ECU_ADDRESS 0x0 /end MEASUREMENT
/begin MEASUREMENT SecOC_TxPduInfo[1].AuthenticPduDataContainerFreshnessVerifyValueLengthOfTxPduInfo "" UBYTE NO_COMPU_METHOD 0 0 0 255 ECU_ADDRESS 0x0 /end MEASUREMENT
/begin MEASUREMENT SecOC_TxPduInfo[1].AuthenticPduDataContainerFreshnessVerifyValueStartIdxOfTxPduInfo "" UWORD SecOC_AuthenticPduDataContainerFreshnessVerifyValueStartIdxOfTxPduInfoType 0 0 0 65535 ECU_ADDRESS 0x0 /end MEASUREMENT
/begin MEASUREMENT SecOC_TxPduInfo[1].AuthenticPduDataContainerFullAuthenticPduEndIdxOfTxPduInfo "" UWORD SecOC_AuthenticPduDataContainerFullAuthenticPduEndIdxOfTxPduInfoType 0 0 0 65535 ECU_ADDRESS 0x0 /end MEASUREMENT
/begin MEASUREMENT SecOC_TxPduInfo[1].AuthenticPduDataContainerFullAuthenticPduLengthOfTxPduInfo "" UBYTE NO_COMPU_METHOD 0 0 0 255 ECU_ADDRESS 0x0 /end MEASUREMENT
/begin MEASUREMENT SecOC_TxPduInfo[1].AuthenticPduDataContainerFullAuthenticPduStartIdxOfTxPduInfo "" UWORD SecOC_AuthenticPduDataContainerFullAuthenticPduStartIdxOfTxPduInfoType 0 0 0 65535 ECU_ADDRESS 0x0 /end MEASUREMENT
/begin MEASUREMENT SecOC_TxPduInfo[1].AuthenticationLayerIdOfTxPduInfo "" UWORD NO_COMPU_METHOD 0 0 0 65535 ECU_ADDRESS 0x0 /end MEASUREMENT
/begin MEASUREMENT SecOC_TxPduInfo[1].AuthenticatorCacheEndIdxOfTxPduInfo "" UBYTE NO_COMPU_METHOD 0 0 0 255 ECU_ADDRESS 0x0 /end MEASUREMENT
/begin MEASUREMENT SecOC_TxPduInfo[1].AuthenticatorCacheLengthOfTxPduInfo "" UBYTE NO_COMPU_METHOD 0 0 0 255 ECU_ADDRESS 0x0 /end MEASUREMENT
/begin MEASUREMENT SecOC_TxPduInfo[1].AuthenticatorCacheStartIdxOfTxPduInfo "" UBYTE NO_COMPU_METHOD 0 0 0 255 ECU_ADDRESS 0x0 /end MEASUREMENT
/begin MEASUREMENT SecOC_TxPduInfo[1].BuildAttemptsOfTxPduInfo "" UBYTE NO_COMPU_METHOD 0 0 0 255 ECU_ADDRESS 0x0 /end MEASUREMENT
/begin MEASUREMENT SecOC_TxPduInfo[1].ConfirmationNeededOfTxPduInfo "" UBYTE SecOC_ConfirmationNeededOfTxPduInfoType 0 0 0 1 ECU_ADDRESS 0x0 /end MEASUREMENT
/begin MEASUREMENT SecOC_TxPduInfo[1].DataIdFirstByteOfTxPduInfo "" UBYTE NO_COMPU_METHOD 0 0 0 255 ECU_ADDRESS 0x0 /end MEASUREMENT
/begin MEASUREMENT SecOC_TxPduInfo[1].DataIdSecondByteOfTxPduInfo "" UBYTE NO_COMPU_METHOD 0 0 0 255 ECU_ADDRESS 0x0 /end MEASUREMENT
/begin MEASUREMENT SecOC_TxPduInfo[1].ExternalFreshnessIdOfTxPduInfo "" UBYTE NO_COMPU_METHOD 0 0 0 255 ECU_ADDRESS 0x0 /end MEASUREMENT
/begin MEASUREMENT SecOC_TxPduInfo[1].LowerLayerPduTypeOfTxPduInfo "" UBYTE SecOC_LowerLayerPduTypeOfTxPduInfoType 0 0 0 255 ECU_ADDRESS 0x0 /end MEASUREMENT
/begin MEASUREMENT SecOC_TxPduInfo[1].PduProcessingOfTxPduInfo "" UBYTE SecOC_PduProcessingOfTxPduInfoType 0 0 0 255 ECU_ADDRESS 0x0 /end MEASUREMENT
/begin MEASUREMENT SecOC_TxPduInfo[1].PduTypeOfTxPduInfo "" UBYTE SecOC_PduTypeOfTxPduInfoType 0 0 0 255 ECU_ADDRESS 0x0 /end MEASUREMENT
/begin MEASUREMENT SecOC_TxPduInfo[1].ProvideTruncTxFreshnessOfTxPduInfo "" UBYTE SecOC_ProvideTruncTxFreshnessOfTxPduInfoType 0 0 0 255 ECU_ADDRESS 0x0 /end MEASUREMENT
/begin MEASUREMENT SecOC_TxPduInfo[1].SecuredExternalIdOfTxPduInfo "" UBYTE SecOC_SecuredExternalIdOfTxPduInfoType 0 0 0 255 ECU_ADDRESS 0x0 /end MEASUREMENT
/begin MEASUREMENT SecOC_TxPduInfo[1].SecuredPduDataContainerAuthInfoDataEndIdxOfTxPduInfo "" UBYTE SecOC_SecuredPduDataContainerAuthInfoDataEndIdxOfTxPduInfoType 0 0 0 255 ECU_ADDRESS 0x0 /end MEASUREMENT
/begin MEASUREMENT SecOC_TxPduInfo[1].SecuredPduDataContainerAuthInfoDataLengthOfTxPduInfo "" UBYTE NO_COMPU_METHOD 0 0 0 255 ECU_ADDRESS 0x0 /end MEASUREMENT
/begin MEASUREMENT SecOC_TxPduInfo[1].SecuredPduDataContainerAuthInfoDataStartIdxOfTxPduInfo "" UBYTE SecOC_SecuredPduDataContainerAuthInfoDataStartIdxOfTxPduInfoType 0 0 0 255 ECU_ADDRESS 0x0 /end MEASUREMENT
/begin MEASUREMENT SecOC_TxPduInfo[1].SecuredPduDataContainerAuthenticPduEndIdxOfTxPduInfo "" UBYTE SecOC_SecuredPduDataContainerAuthenticPduEndIdxOfTxPduInfoType 0 0 0 255 ECU_ADDRESS 0x0 /end MEASUREMENT
/begin MEASUREMENT SecOC_TxPduInfo[1].SecuredPduDataContainerAuthenticPduLengthOfTxPduInfo "" UBYTE NO_COMPU_METHOD 0 0 0 255 ECU_ADDRESS 0x0 /end MEASUREMENT
/begin MEASUREMENT SecOC_TxPduInfo[1].SecuredPduDataContainerAuthenticPduStartIdxOfTxPduInfo "" UBYTE SecOC_SecuredPduDataContainerAuthenticPduStartIdxOfTxPduInfoType 0 0 0 255 ECU_ADDRESS 0x0 /end MEASUREMENT
/begin MEASUREMENT SecOC_TxPduInfo[1].SecuredPduDataContainerSecuredPduEndIdxOfTxPduInfo "" UBYTE SecOC_SecuredPduDataContainerSecuredPduEndIdxOfTxPduInfoType 0 0 0 255 ECU_ADDRESS 0x0 /end MEASUREMENT
/begin MEASUREMENT SecOC_TxPduInfo[1].SecuredPduDataContainerSecuredPduLengthOfTxPduInfo "" UBYTE NO_COMPU_METHOD 0 0 0 255 ECU_ADDRESS 0x0 /end MEASUREMENT
/begin MEASUREMENT SecOC_TxPduInfo[1].SecuredPduDataContainerSecuredPduStartIdxOfTxPduInfo "" UBYTE SecOC_SecuredPduDataContainerSecuredPduStartIdxOfTxPduInfoType 0 0 0 255 ECU_ADDRESS 0x0 /end MEASUREMENT
/begin MEASUREMENT SecOC_TxPduInfo[1].SecuredPduDataContainerTruncatedAuthenticatorEndIdxOfTxPduInfo "" UBYTE SecOC_SecuredPduDataContainerTruncatedAuthenticatorEndIdxOfTxPduInfoType 0 0 0 255 ECU_ADDRESS 0x0 /end MEASUREMENT
/begin MEASUREMENT SecOC_TxPduInfo[1].SecuredPduDataContainerTruncatedAuthenticatorLengthOfTxPduInfo "" UBYTE NO_COMPU_METHOD 0 0 0 255 ECU_ADDRESS 0x0 /end MEASUREMENT
/begin MEASUREMENT SecOC_TxPduInfo[1].SecuredPduDataContainerTruncatedAuthenticatorStartIdxOfTxPduInfo "" UBYTE SecOC_SecuredPduDataContainerTruncatedAuthenticatorStartIdxOfTxPduInfoType 0 0 0 255 ECU_ADDRESS 0x0 /end MEASUREMENT
/begin MEASUREMENT SecOC_TxPduInfo[1].TruncAuthStartBitInByteOfTxPduInfo "" UBYTE NO_COMPU_METHOD 0 0 0 255 ECU_ADDRESS 0x0 /end MEASUREMENT
/begin MEASUREMENT SecOC_TxPduInfo[1].TruncFreshnessValueFirstByteShiftOfTxPduInfo "" UBYTE NO_COMPU_METHOD 0 0 0 255 ECU_ADDRESS 0x0 /end MEASUREMENT
/begin MEASUREMENT SecOC_TxPduInfo[1].TruncFreshnessValueSecondByteShiftOfTxPduInfo "" UBYTE NO_COMPU_METHOD 0 0 0 255 ECU_ADDRESS 0x0 /end MEASUREMENT
/begin MEASUREMENT SecOC_TxPduInfo[1].truncatedAuthenticationLengthOfTxPduInfo "" UBYTE NO_COMPU_METHOD 0 0 0 255 ECU_ADDRESS 0x0 /end MEASUREMENT
/begin MEASUREMENT SecOC_TxPduInfo[1].truncatedFreshnessValueLengthOfTxPduInfo "" UBYTE NO_COMPU_METHOD 0 0 0 255 ECU_ADDRESS 0x0 /end MEASUREMENT
/begin MEASUREMENT SecOC_TxPduInfo[2].AuthenticExternalIdOfTxPduInfo "" UBYTE SecOC_AuthenticExternalIdOfTxPduInfoType 0 0 0 255 ECU_ADDRESS 0x0 /end MEASUREMENT
/begin MEASUREMENT SecOC_TxPduInfo[2].AuthenticPduDataContainerAuthenticPduEndIdxOfTxPduInfo "" UWORD SecOC_AuthenticPduDataContainerAuthenticPduEndIdxOfTxPduInfoType 0 0 0 65535 ECU_ADDRESS 0x0 /end MEASUREMENT
/begin MEASUREMENT SecOC_TxPduInfo[2].AuthenticPduDataContainerAuthenticPduLengthOfTxPduInfo "" UBYTE NO_COMPU_METHOD 0 0 0 255 ECU_ADDRESS 0x0 /end MEASUREMENT
/begin MEASUREMENT SecOC_TxPduInfo[2].AuthenticPduDataContainerAuthenticPduStartIdxOfTxPduInfo "" UWORD SecOC_AuthenticPduDataContainerAuthenticPduStartIdxOfTxPduInfoType 0 0 0 65535 ECU_ADDRESS 0x0 /end MEASUREMENT
/begin MEASUREMENT SecOC_TxPduInfo[2].AuthenticPduDataContainerDataToAuthenticateEndIdxOfTxPduInfo "" UWORD NO_COMPU_METHOD 0 0 0 65535 ECU_ADDRESS 0x0 /end MEASUREMENT
/begin MEASUREMENT SecOC_TxPduInfo[2].AuthenticPduDataContainerDataToAuthenticateLengthOfTxPduInfo "" UBYTE NO_COMPU_METHOD 0 0 0 255 ECU_ADDRESS 0x0 /end MEASUREMENT
/begin MEASUREMENT SecOC_TxPduInfo[2].AuthenticPduDataContainerDataToAuthenticateStartIdxOfTxPduInfo "" UWORD NO_COMPU_METHOD 0 0 0 65535 ECU_ADDRESS 0x0 /end MEASUREMENT
/begin MEASUREMENT SecOC_TxPduInfo[2].AuthenticPduDataContainerFreshnessVerifyValueEndIdxOfTxPduInfo "" UWORD SecOC_AuthenticPduDataContainerFreshnessVerifyValueEndIdxOfTxPduInfoType 0 0 0 65535 ECU_ADDRESS 0x0 /end MEASUREMENT
/begin MEASUREMENT SecOC_TxPduInfo[2].AuthenticPduDataContainerFreshnessVerifyValueLengthOfTxPduInfo "" UBYTE NO_COMPU_METHOD 0 0 0 255 ECU_ADDRESS 0x0 /end MEASUREMENT
/begin MEASUREMENT SecOC_TxPduInfo[2].AuthenticPduDataContainerFreshnessVerifyValueStartIdxOfTxPduInfo "" UWORD SecOC_AuthenticPduDataContainerFreshnessVerifyValueStartIdxOfTxPduInfoType 0 0 0 65535 ECU_ADDRESS 0x0 /end MEASUREMENT
/begin MEASUREMENT SecOC_TxPduInfo[2].AuthenticPduDataContainerFullAuthenticPduEndIdxOfTxPduInfo "" UWORD SecOC_AuthenticPduDataContainerFullAuthenticPduEndIdxOfTxPduInfoType 0 0 0 65535 ECU_ADDRESS 0x0 /end MEASUREMENT
/begin MEASUREMENT SecOC_TxPduInfo[2].AuthenticPduDataContainerFullAuthenticPduLengthOfTxPduInfo "" UBYTE NO_COMPU_METHOD 0 0 0 255 ECU_ADDRESS 0x0 /end MEASUREMENT
/begin MEASUREMENT SecOC_TxPduInfo[2].AuthenticPduDataContainerFullAuthenticPduStartIdxOfTxPduInfo "" UWORD SecOC_AuthenticPduDataContainerFullAuthenticPduStartIdxOfTxPduInfoType 0 0 0 65535 ECU_ADDRESS 0x0 /end MEASUREMENT
/begin MEASUREMENT SecOC_TxPduInfo[2].AuthenticationLayerIdOfTxPduInfo "" UWORD NO_COMPU_METHOD 0 0 0 65535 ECU_ADDRESS 0x0 /end MEASUREMENT
/begin MEASUREMENT SecOC_TxPduInfo[2].AuthenticatorCacheEndIdxOfTxPduInfo "" UBYTE NO_COMPU_METHOD 0 0 0 255 ECU_ADDRESS 0x0 /end MEASUREMENT
/begin MEASUREMENT SecOC_TxPduInfo[2].AuthenticatorCacheLengthOfTxPduInfo "" UBYTE NO_COMPU_METHOD 0 0 0 255 ECU_ADDRESS 0x0 /end MEASUREMENT
/begin MEASUREMENT SecOC_TxPduInfo[2].AuthenticatorCacheStartIdxOfTxPduInfo "" UBYTE NO_COMPU_METHOD 0 0 0 255 ECU_ADDRESS 0x0 /end MEASUREMENT
/begin MEASUREMENT SecOC_TxPduInfo[2].BuildAttemptsOfTxPduInfo "" UBYTE NO_COMPU_METHOD 0 0 0 255 ECU_ADDRESS 0x0 /end MEASUREMENT
/begin MEASUREMENT SecOC_TxPduInfo[2].ConfirmationNeededOfTxPduInfo "" UBYTE SecOC_ConfirmationNeededOfTxPduInfoType 0 0 0 1 ECU_ADDRESS 0x0 /end MEASUREMENT
/begin MEASUREMENT SecOC_TxPduInfo[2].DataIdFirstByteOfTxPduInfo "" UBYTE NO_COMPU_METHOD 0 0 0 255 ECU_ADDRESS 0x0 /end MEASUREMENT
/begin MEASUREMENT SecOC_TxPduInfo[2].DataIdSecondByteOfTxPduInfo "" UBYTE NO_COMPU_METHOD 0 0 0 255 ECU_ADDRESS 0x0 /end MEASUREMENT
/begin MEASUREMENT SecOC_TxPduInfo[2].ExternalFreshnessIdOfTxPduInfo "" UBYTE NO_COMPU_METHOD 0 0 0 255 ECU_ADDRESS 0x0 /end MEASUREMENT
/begin MEASUREMENT SecOC_TxPduInfo[2].LowerLayerPduTypeOfTxPduInfo "" UBYTE SecOC_LowerLayerPduTypeOfTxPduInfoType 0 0 0 255 ECU_ADDRESS 0x0 /end MEASUREMENT
/begin MEASUREMENT SecOC_TxPduInfo[2].PduProcessingOfTxPduInfo "" UBYTE SecOC_PduProcessingOfTxPduInfoType 0 0 0 255 ECU_ADDRESS 0x0 /end MEASUREMENT
/begin MEASUREMENT SecOC_TxPduInfo[2].PduTypeOfTxPduInfo "" UBYTE SecOC_PduTypeOfTxPduInfoType 0 0 0 255 ECU_ADDRESS 0x0 /end MEASUREMENT
/begin MEASUREMENT SecOC_TxPduInfo[2].ProvideTruncTxFreshnessOfTxPduInfo "" UBYTE SecOC_ProvideTruncTxFreshnessOfTxPduInfoType 0 0 0 255 ECU_ADDRESS 0x0 /end MEASUREMENT
/begin MEASUREMENT SecOC_TxPduInfo[2].SecuredExternalIdOfTxPduInfo "" UBYTE SecOC_SecuredExternalIdOfTxPduInfoType 0 0 0 255 ECU_ADDRESS 0x0 /end MEASUREMENT
/begin MEASUREMENT SecOC_TxPduInfo[2].SecuredPduDataContainerAuthInfoDataEndIdxOfTxPduInfo "" UBYTE SecOC_SecuredPduDataContainerAuthInfoDataEndIdxOfTxPduInfoType 0 0 0 255 ECU_ADDRESS 0x0 /end MEASUREMENT
/begin MEASUREMENT SecOC_TxPduInfo[2].SecuredPduDataContainerAuthInfoDataLengthOfTxPduInfo "" UBYTE NO_COMPU_METHOD 0 0 0 255 ECU_ADDRESS 0x0 /end MEASUREMENT
/begin MEASUREMENT SecOC_TxPduInfo[2].SecuredPduDataContainerAuthInfoDataStartIdxOfTxPduInfo "" UBYTE SecOC_SecuredPduDataContainerAuthInfoDataStartIdxOfTxPduInfoType 0 0 0 255 ECU_ADDRESS 0x0 /end MEASUREMENT
/begin MEASUREMENT SecOC_TxPduInfo[2].SecuredPduDataContainerAuthenticPduEndIdxOfTxPduInfo "" UBYTE SecOC_SecuredPduDataContainerAuthenticPduEndIdxOfTxPduInfoType 0 0 0 255 ECU_ADDRESS 0x0 /end MEASUREMENT
/begin MEASUREMENT SecOC_TxPduInfo[2].SecuredPduDataContainerAuthenticPduLengthOfTxPduInfo "" UBYTE NO_COMPU_METHOD 0 0 0 255 ECU_ADDRESS 0x0 /end MEASUREMENT
/begin MEASUREMENT SecOC_TxPduInfo[2].SecuredPduDataContainerAuthenticPduStartIdxOfTxPduInfo "" UBYTE SecOC_SecuredPduDataContainerAuthenticPduStartIdxOfTxPduInfoType 0 0 0 255 ECU_ADDRESS 0x0 /end MEASUREMENT
/begin MEASUREMENT SecOC_TxPduInfo[2].SecuredPduDataContainerSecuredPduEndIdxOfTxPduInfo "" UBYTE SecOC_SecuredPduDataContainerSecuredPduEndIdxOfTxPduInfoType 0 0 0 255 ECU_ADDRESS 0x0 /end MEASUREMENT
/begin MEASUREMENT SecOC_TxPduInfo[2].SecuredPduDataContainerSecuredPduLengthOfTxPduInfo "" UBYTE NO_COMPU_METHOD 0 0 0 255 ECU_ADDRESS 0x0 /end MEASUREMENT
/begin MEASUREMENT SecOC_TxPduInfo[2].SecuredPduDataContainerSecuredPduStartIdxOfTxPduInfo "" UBYTE SecOC_SecuredPduDataContainerSecuredPduStartIdxOfTxPduInfoType 0 0 0 255 ECU_ADDRESS 0x0 /end MEASUREMENT
/begin MEASUREMENT SecOC_TxPduInfo[2].SecuredPduDataContainerTruncatedAuthenticatorEndIdxOfTxPduInfo "" UBYTE SecOC_SecuredPduDataContainerTruncatedAuthenticatorEndIdxOfTxPduInfoType 0 0 0 255 ECU_ADDRESS 0x0 /end MEASUREMENT
/begin MEASUREMENT SecOC_TxPduInfo[2].SecuredPduDataContainerTruncatedAuthenticatorLengthOfTxPduInfo "" UBYTE NO_COMPU_METHOD 0 0 0 255 ECU_ADDRESS 0x0 /end MEASUREMENT
/begin MEASUREMENT SecOC_TxPduInfo[2].SecuredPduDataContainerTruncatedAuthenticatorStartIdxOfTxPduInfo "" UBYTE SecOC_SecuredPduDataContainerTruncatedAuthenticatorStartIdxOfTxPduInfoType 0 0 0 255 ECU_ADDRESS 0x0 /end MEASUREMENT
/begin MEASUREMENT SecOC_TxPduInfo[2].TruncAuthStartBitInByteOfTxPduInfo "" UBYTE NO_COMPU_METHOD 0 0 0 255 ECU_ADDRESS 0x0 /end MEASUREMENT
/begin MEASUREMENT SecOC_TxPduInfo[2].TruncFreshnessValueFirstByteShiftOfTxPduInfo "" UBYTE NO_COMPU_METHOD 0 0 0 255 ECU_ADDRESS 0x0 /end MEASUREMENT
/begin MEASUREMENT SecOC_TxPduInfo[2].TruncFreshnessValueSecondByteShiftOfTxPduInfo "" UBYTE NO_COMPU_METHOD 0 0 0 255 ECU_ADDRESS 0x0 /end MEASUREMENT
/begin MEASUREMENT SecOC_TxPduInfo[2].truncatedAuthenticationLengthOfTxPduInfo "" UBYTE NO_COMPU_METHOD 0 0 0 255 ECU_ADDRESS 0x0 /end MEASUREMENT
/begin MEASUREMENT SecOC_TxPduInfo[2].truncatedFreshnessValueLengthOfTxPduInfo "" UBYTE NO_COMPU_METHOD 0 0 0 255 ECU_ADDRESS 0x0 /end MEASUREMENT
/begin MEASUREMENT SecOC_TxPduInfo[3].AuthenticExternalIdOfTxPduInfo "" UBYTE SecOC_AuthenticExternalIdOfTxPduInfoType 0 0 0 255 ECU_ADDRESS 0x0 /end MEASUREMENT
/begin MEASUREMENT SecOC_TxPduInfo[3].AuthenticPduDataContainerAuthenticPduEndIdxOfTxPduInfo "" UWORD SecOC_AuthenticPduDataContainerAuthenticPduEndIdxOfTxPduInfoType 0 0 0 65535 ECU_ADDRESS 0x0 /end MEASUREMENT
/begin MEASUREMENT SecOC_TxPduInfo[3].AuthenticPduDataContainerAuthenticPduLengthOfTxPduInfo "" UBYTE NO_COMPU_METHOD 0 0 0 255 ECU_ADDRESS 0x0 /end MEASUREMENT
/begin MEASUREMENT SecOC_TxPduInfo[3].AuthenticPduDataContainerAuthenticPduStartIdxOfTxPduInfo "" UWORD SecOC_AuthenticPduDataContainerAuthenticPduStartIdxOfTxPduInfoType 0 0 0 65535 ECU_ADDRESS 0x0 /end MEASUREMENT
/begin MEASUREMENT SecOC_TxPduInfo[3].AuthenticPduDataContainerDataToAuthenticateEndIdxOfTxPduInfo "" UWORD NO_COMPU_METHOD 0 0 0 65535 ECU_ADDRESS 0x0 /end MEASUREMENT
/begin MEASUREMENT SecOC_TxPduInfo[3].AuthenticPduDataContainerDataToAuthenticateLengthOfTxPduInfo "" UBYTE NO_COMPU_METHOD 0 0 0 255 ECU_ADDRESS 0x0 /end MEASUREMENT
/begin MEASUREMENT SecOC_TxPduInfo[3].AuthenticPduDataContainerDataToAuthenticateStartIdxOfTxPduInfo "" UWORD NO_COMPU_METHOD 0 0 0 65535 ECU_ADDRESS 0x0 /end MEASUREMENT
/begin MEASUREMENT SecOC_TxPduInfo[3].AuthenticPduDataContainerFreshnessVerifyValueEndIdxOfTxPduInfo "" UWORD SecOC_AuthenticPduDataContainerFreshnessVerifyValueEndIdxOfTxPduInfoType 0 0 0 65535 ECU_ADDRESS 0x0 /end MEASUREMENT
/begin MEASUREMENT SecOC_TxPduInfo[3].AuthenticPduDataContainerFreshnessVerifyValueLengthOfTxPduInfo "" UBYTE NO_COMPU_METHOD 0 0 0 255 ECU_ADDRESS 0x0 /end MEASUREMENT
/begin MEASUREMENT SecOC_TxPduInfo[3].AuthenticPduDataContainerFreshnessVerifyValueStartIdxOfTxPduInfo "" UWORD SecOC_AuthenticPduDataContainerFreshnessVerifyValueStartIdxOfTxPduInfoType 0 0 0 65535 ECU_ADDRESS 0x0 /end MEASUREMENT
/begin MEASUREMENT SecOC_TxPduInfo[3].AuthenticPduDataContainerFullAuthenticPduEndIdxOfTxPduInfo "" UWORD SecOC_AuthenticPduDataContainerFullAuthenticPduEndIdxOfTxPduInfoType 0 0 0 65535 ECU_ADDRESS 0x0 /end MEASUREMENT
/begin MEASUREMENT SecOC_TxPduInfo[3].AuthenticPduDataContainerFullAuthenticPduLengthOfTxPduInfo "" UBYTE NO_COMPU_METHOD 0 0 0 255 ECU_ADDRESS 0x0 /end MEASUREMENT
/begin MEASUREMENT SecOC_TxPduInfo[3].AuthenticPduDataContainerFullAuthenticPduStartIdxOfTxPduInfo "" UWORD SecOC_AuthenticPduDataContainerFullAuthenticPduStartIdxOfTxPduInfoType 0 0 0 65535 ECU_ADDRESS 0x0 /end MEASUREMENT
/begin MEASUREMENT SecOC_TxPduInfo[3].AuthenticationLayerIdOfTxPduInfo "" UWORD NO_COMPU_METHOD 0 0 0 65535 ECU_ADDRESS 0x0 /end MEASUREMENT
/begin MEASUREMENT SecOC_TxPduInfo[3].AuthenticatorCacheEndIdxOfTxPduInfo "" UBYTE NO_COMPU_METHOD 0 0 0 255 ECU_ADDRESS 0x0 /end MEASUREMENT
/begin MEASUREMENT SecOC_TxPduInfo[3].AuthenticatorCacheLengthOfTxPduInfo "" UBYTE NO_COMPU_METHOD 0 0 0 255 ECU_ADDRESS 0x0 /end MEASUREMENT
/begin MEASUREMENT SecOC_TxPduInfo[3].AuthenticatorCacheStartIdxOfTxPduInfo "" UBYTE NO_COMPU_METHOD 0 0 0 255 ECU_ADDRESS 0x0 /end MEASUREMENT
/begin MEASUREMENT SecOC_TxPduInfo[3].BuildAttemptsOfTxPduInfo "" UBYTE NO_COMPU_METHOD 0 0 0 255 ECU_ADDRESS 0x0 /end MEASUREMENT
/begin MEASUREMENT SecOC_TxPduInfo[3].ConfirmationNeededOfTxPduInfo "" UBYTE SecOC_ConfirmationNeededOfTxPduInfoType 0 0 0 1 ECU_ADDRESS 0x0 /end MEASUREMENT
/begin MEASUREMENT SecOC_TxPduInfo[3].DataIdFirstByteOfTxPduInfo "" UBYTE NO_COMPU_METHOD 0 0 0 255 ECU_ADDRESS 0x0 /end MEASUREMENT
/begin MEASUREMENT SecOC_TxPduInfo[3].DataIdSecondByteOfTxPduInfo "" UBYTE NO_COMPU_METHOD 0 0 0 255 ECU_ADDRESS 0x0 /end MEASUREMENT
/begin MEASUREMENT SecOC_TxPduInfo[3].ExternalFreshnessIdOfTxPduInfo "" UBYTE NO_COMPU_METHOD 0 0 0 255 ECU_ADDRESS 0x0 /end MEASUREMENT
/begin MEASUREMENT SecOC_TxPduInfo[3].LowerLayerPduTypeOfTxPduInfo "" UBYTE SecOC_LowerLayerPduTypeOfTxPduInfoType 0 0 0 255 ECU_ADDRESS 0x0 /end MEASUREMENT
/begin MEASUREMENT SecOC_TxPduInfo[3].PduProcessingOfTxPduInfo "" UBYTE SecOC_PduProcessingOfTxPduInfoType 0 0 0 255 ECU_ADDRESS 0x0 /end MEASUREMENT
/begin MEASUREMENT SecOC_TxPduInfo[3].PduTypeOfTxPduInfo "" UBYTE SecOC_PduTypeOfTxPduInfoType 0 0 0 255 ECU_ADDRESS 0x0 /end MEASUREMENT
/begin MEASUREMENT SecOC_TxPduInfo[3].ProvideTruncTxFreshnessOfTxPduInfo "" UBYTE SecOC_ProvideTruncTxFreshnessOfTxPduInfoType 0 0 0 255 ECU_ADDRESS 0x0 /end MEASUREMENT
/begin MEASUREMENT SecOC_TxPduInfo[3].SecuredExternalIdOfTxPduInfo "" UBYTE SecOC_SecuredExternalIdOfTxPduInfoType 0 0 0 255 ECU_ADDRESS 0x0 /end MEASUREMENT
/begin MEASUREMENT SecOC_TxPduInfo[3].SecuredPduDataContainerAuthInfoDataEndIdxOfTxPduInfo "" UBYTE SecOC_SecuredPduDataContainerAuthInfoDataEndIdxOfTxPduInfoType 0 0 0 255 ECU_ADDRESS 0x0 /end MEASUREMENT
/begin MEASUREMENT SecOC_TxPduInfo[3].SecuredPduDataContainerAuthInfoDataLengthOfTxPduInfo "" UBYTE NO_COMPU_METHOD 0 0 0 255 ECU_ADDRESS 0x0 /end MEASUREMENT
/begin MEASUREMENT SecOC_TxPduInfo[3].SecuredPduDataContainerAuthInfoDataStartIdxOfTxPduInfo "" UBYTE SecOC_SecuredPduDataContainerAuthInfoDataStartIdxOfTxPduInfoType 0 0 0 255 ECU_ADDRESS 0x0 /end MEASUREMENT
/begin MEASUREMENT SecOC_TxPduInfo[3].SecuredPduDataContainerAuthenticPduEndIdxOfTxPduInfo "" UBYTE SecOC_SecuredPduDataContainerAuthenticPduEndIdxOfTxPduInfoType 0 0 0 255 ECU_ADDRESS 0x0 /end MEASUREMENT
/begin MEASUREMENT SecOC_TxPduInfo[3].SecuredPduDataContainerAuthenticPduLengthOfTxPduInfo "" UBYTE NO_COMPU_METHOD 0 0 0 255 ECU_ADDRESS 0x0 /end MEASUREMENT
/begin MEASUREMENT SecOC_TxPduInfo[3].SecuredPduDataContainerAuthenticPduStartIdxOfTxPduInfo "" UBYTE SecOC_SecuredPduDataContainerAuthenticPduStartIdxOfTxPduInfoType 0 0 0 255 ECU_ADDRESS 0x0 /end MEASUREMENT
/begin MEASUREMENT SecOC_TxPduInfo[3].SecuredPduDataContainerSecuredPduEndIdxOfTxPduInfo "" UBYTE SecOC_SecuredPduDataContainerSecuredPduEndIdxOfTxPduInfoType 0 0 0 255 ECU_ADDRESS 0x0 /end MEASUREMENT
/begin MEASUREMENT SecOC_TxPduInfo[3].SecuredPduDataContainerSecuredPduLengthOfTxPduInfo "" UBYTE NO_COMPU_METHOD 0 0 0 255 ECU_ADDRESS 0x0 /end MEASUREMENT
/begin MEASUREMENT SecOC_TxPduInfo[3].SecuredPduDataContainerSecuredPduStartIdxOfTxPduInfo "" UBYTE SecOC_SecuredPduDataContainerSecuredPduStartIdxOfTxPduInfoType 0 0 0 255 ECU_ADDRESS 0x0 /end MEASUREMENT
/begin MEASUREMENT SecOC_TxPduInfo[3].SecuredPduDataContainerTruncatedAuthenticatorEndIdxOfTxPduInfo "" UBYTE SecOC_SecuredPduDataContainerTruncatedAuthenticatorEndIdxOfTxPduInfoType 0 0 0 255 ECU_ADDRESS 0x0 /end MEASUREMENT
/begin MEASUREMENT SecOC_TxPduInfo[3].SecuredPduDataContainerTruncatedAuthenticatorLengthOfTxPduInfo "" UBYTE NO_COMPU_METHOD 0 0 0 255 ECU_ADDRESS 0x0 /end MEASUREMENT
/begin MEASUREMENT SecOC_TxPduInfo[3].SecuredPduDataContainerTruncatedAuthenticatorStartIdxOfTxPduInfo "" UBYTE SecOC_SecuredPduDataContainerTruncatedAuthenticatorStartIdxOfTxPduInfoType 0 0 0 255 ECU_ADDRESS 0x0 /end MEASUREMENT
/begin MEASUREMENT SecOC_TxPduInfo[3].TruncAuthStartBitInByteOfTxPduInfo "" UBYTE NO_COMPU_METHOD 0 0 0 255 ECU_ADDRESS 0x0 /end MEASUREMENT
/begin MEASUREMENT SecOC_TxPduInfo[3].TruncFreshnessValueFirstByteShiftOfTxPduInfo "" UBYTE NO_COMPU_METHOD 0 0 0 255 ECU_ADDRESS 0x0 /end MEASUREMENT
/begin MEASUREMENT SecOC_TxPduInfo[3].TruncFreshnessValueSecondByteShiftOfTxPduInfo "" UBYTE NO_COMPU_METHOD 0 0 0 255 ECU_ADDRESS 0x0 /end MEASUREMENT
/begin MEASUREMENT SecOC_TxPduInfo[3].truncatedAuthenticationLengthOfTxPduInfo "" UBYTE NO_COMPU_METHOD 0 0 0 255 ECU_ADDRESS 0x0 /end MEASUREMENT
/begin MEASUREMENT SecOC_TxPduInfo[3].truncatedFreshnessValueLengthOfTxPduInfo "" UBYTE NO_COMPU_METHOD 0 0 0 255 ECU_ADDRESS 0x0 /end MEASUREMENT
/begin MEASUREMENT SecOC_TxPduInfo[4].AuthenticExternalIdOfTxPduInfo "" UBYTE SecOC_AuthenticExternalIdOfTxPduInfoType 0 0 0 255 ECU_ADDRESS 0x0 /end MEASUREMENT
/begin MEASUREMENT SecOC_TxPduInfo[4].AuthenticPduDataContainerAuthenticPduEndIdxOfTxPduInfo "" UWORD SecOC_AuthenticPduDataContainerAuthenticPduEndIdxOfTxPduInfoType 0 0 0 65535 ECU_ADDRESS 0x0 /end MEASUREMENT
/begin MEASUREMENT SecOC_TxPduInfo[4].AuthenticPduDataContainerAuthenticPduLengthOfTxPduInfo "" UBYTE NO_COMPU_METHOD 0 0 0 255 ECU_ADDRESS 0x0 /end MEASUREMENT
/begin MEASUREMENT SecOC_TxPduInfo[4].AuthenticPduDataContainerAuthenticPduStartIdxOfTxPduInfo "" UWORD SecOC_AuthenticPduDataContainerAuthenticPduStartIdxOfTxPduInfoType 0 0 0 65535 ECU_ADDRESS 0x0 /end MEASUREMENT
/begin MEASUREMENT SecOC_TxPduInfo[4].AuthenticPduDataContainerDataToAuthenticateEndIdxOfTxPduInfo "" UWORD NO_COMPU_METHOD 0 0 0 65535 ECU_ADDRESS 0x0 /end MEASUREMENT
/begin MEASUREMENT SecOC_TxPduInfo[4].AuthenticPduDataContainerDataToAuthenticateLengthOfTxPduInfo "" UBYTE NO_COMPU_METHOD 0 0 0 255 ECU_ADDRESS 0x0 /end MEASUREMENT
/begin MEASUREMENT SecOC_TxPduInfo[4].AuthenticPduDataContainerDataToAuthenticateStartIdxOfTxPduInfo "" UWORD NO_COMPU_METHOD 0 0 0 65535 ECU_ADDRESS 0x0 /end MEASUREMENT
/begin MEASUREMENT SecOC_TxPduInfo[4].AuthenticPduDataContainerFreshnessVerifyValueEndIdxOfTxPduInfo "" UWORD SecOC_AuthenticPduDataContainerFreshnessVerifyValueEndIdxOfTxPduInfoType 0 0 0 65535 ECU_ADDRESS 0x0 /end MEASUREMENT
/begin MEASUREMENT SecOC_TxPduInfo[4].AuthenticPduDataContainerFreshnessVerifyValueLengthOfTxPduInfo "" UBYTE NO_COMPU_METHOD 0 0 0 255 ECU_ADDRESS 0x0 /end MEASUREMENT
/begin MEASUREMENT SecOC_TxPduInfo[4].AuthenticPduDataContainerFreshnessVerifyValueStartIdxOfTxPduInfo "" UWORD SecOC_AuthenticPduDataContainerFreshnessVerifyValueStartIdxOfTxPduInfoType 0 0 0 65535 ECU_ADDRESS 0x0 /end MEASUREMENT
/begin MEASUREMENT SecOC_TxPduInfo[4].AuthenticPduDataContainerFullAuthenticPduEndIdxOfTxPduInfo "" UWORD SecOC_AuthenticPduDataContainerFullAuthenticPduEndIdxOfTxPduInfoType 0 0 0 65535 ECU_ADDRESS 0x0 /end MEASUREMENT
/begin MEASUREMENT SecOC_TxPduInfo[4].AuthenticPduDataContainerFullAuthenticPduLengthOfTxPduInfo "" UBYTE NO_COMPU_METHOD 0 0 0 255 ECU_ADDRESS 0x0 /end MEASUREMENT
/begin MEASUREMENT SecOC_TxPduInfo[4].AuthenticPduDataContainerFullAuthenticPduStartIdxOfTxPduInfo "" UWORD SecOC_AuthenticPduDataContainerFullAuthenticPduStartIdxOfTxPduInfoType 0 0 0 65535 ECU_ADDRESS 0x0 /end MEASUREMENT
/begin MEASUREMENT SecOC_TxPduInfo[4].AuthenticationLayerIdOfTxPduInfo "" UWORD NO_COMPU_METHOD 0 0 0 65535 ECU_ADDRESS 0x0 /end MEASUREMENT
/begin MEASUREMENT SecOC_TxPduInfo[4].AuthenticatorCacheEndIdxOfTxPduInfo "" UBYTE NO_COMPU_METHOD 0 0 0 255 ECU_ADDRESS 0x0 /end MEASUREMENT
/begin MEASUREMENT SecOC_TxPduInfo[4].AuthenticatorCacheLengthOfTxPduInfo "" UBYTE NO_COMPU_METHOD 0 0 0 255 ECU_ADDRESS 0x0 /end MEASUREMENT
/begin MEASUREMENT SecOC_TxPduInfo[4].AuthenticatorCacheStartIdxOfTxPduInfo "" UBYTE NO_COMPU_METHOD 0 0 0 255 ECU_ADDRESS 0x0 /end MEASUREMENT
/begin MEASUREMENT SecOC_TxPduInfo[4].BuildAttemptsOfTxPduInfo "" UBYTE NO_COMPU_METHOD 0 0 0 255 ECU_ADDRESS 0x0 /end MEASUREMENT
/begin MEASUREMENT SecOC_TxPduInfo[4].ConfirmationNeededOfTxPduInfo "" UBYTE SecOC_ConfirmationNeededOfTxPduInfoType 0 0 0 1 ECU_ADDRESS 0x0 /end MEASUREMENT
/begin MEASUREMENT SecOC_TxPduInfo[4].DataIdFirstByteOfTxPduInfo "" UBYTE NO_COMPU_METHOD 0 0 0 255 ECU_ADDRESS 0x0 /end MEASUREMENT
/begin MEASUREMENT SecOC_TxPduInfo[4].DataIdSecondByteOfTxPduInfo "" UBYTE NO_COMPU_METHOD 0 0 0 255 ECU_ADDRESS 0x0 /end MEASUREMENT
/begin MEASUREMENT SecOC_TxPduInfo[4].ExternalFreshnessIdOfTxPduInfo "" UBYTE NO_COMPU_METHOD 0 0 0 255 ECU_ADDRESS 0x0 /end MEASUREMENT
/begin MEASUREMENT SecOC_TxPduInfo[4].LowerLayerPduTypeOfTxPduInfo "" UBYTE SecOC_LowerLayerPduTypeOfTxPduInfoType 0 0 0 255 ECU_ADDRESS 0x0 /end MEASUREMENT
/begin MEASUREMENT SecOC_TxPduInfo[4].PduProcessingOfTxPduInfo "" UBYTE SecOC_PduProcessingOfTxPduInfoType 0 0 0 255 ECU_ADDRESS 0x0 /end MEASUREMENT
/begin MEASUREMENT SecOC_TxPduInfo[4].PduTypeOfTxPduInfo "" UBYTE SecOC_PduTypeOfTxPduInfoType 0 0 0 255 ECU_ADDRESS 0x0 /end MEASUREMENT
/begin MEASUREMENT SecOC_TxPduInfo[4].ProvideTruncTxFreshnessOfTxPduInfo "" UBYTE SecOC_ProvideTruncTxFreshnessOfTxPduInfoType 0 0 0 255 ECU_ADDRESS 0x0 /end MEASUREMENT
/begin MEASUREMENT SecOC_TxPduInfo[4].SecuredExternalIdOfTxPduInfo "" UBYTE SecOC_SecuredExternalIdOfTxPduInfoType 0 0 0 255 ECU_ADDRESS 0x0 /end MEASUREMENT
/begin MEASUREMENT SecOC_TxPduInfo[4].SecuredPduDataContainerAuthInfoDataEndIdxOfTxPduInfo "" UBYTE SecOC_SecuredPduDataContainerAuthInfoDataEndIdxOfTxPduInfoType 0 0 0 255 ECU_ADDRESS 0x0 /end MEASUREMENT
/begin MEASUREMENT SecOC_TxPduInfo[4].SecuredPduDataContainerAuthInfoDataLengthOfTxPduInfo "" UBYTE NO_COMPU_METHOD 0 0 0 255 ECU_ADDRESS 0x0 /end MEASUREMENT
/begin MEASUREMENT SecOC_TxPduInfo[4].SecuredPduDataContainerAuthInfoDataStartIdxOfTxPduInfo "" UBYTE SecOC_SecuredPduDataContainerAuthInfoDataStartIdxOfTxPduInfoType 0 0 0 255 ECU_ADDRESS 0x0 /end MEASUREMENT
/begin MEASUREMENT SecOC_TxPduInfo[4].SecuredPduDataContainerAuthenticPduEndIdxOfTxPduInfo "" UBYTE SecOC_SecuredPduDataContainerAuthenticPduEndIdxOfTxPduInfoType 0 0 0 255 ECU_ADDRESS 0x0 /end MEASUREMENT
/begin MEASUREMENT SecOC_TxPduInfo[4].SecuredPduDataContainerAuthenticPduLengthOfTxPduInfo "" UBYTE NO_COMPU_METHOD 0 0 0 255 ECU_ADDRESS 0x0 /end MEASUREMENT
/begin MEASUREMENT SecOC_TxPduInfo[4].SecuredPduDataContainerAuthenticPduStartIdxOfTxPduInfo "" UBYTE SecOC_SecuredPduDataContainerAuthenticPduStartIdxOfTxPduInfoType 0 0 0 255 ECU_ADDRESS 0x0 /end MEASUREMENT
/begin MEASUREMENT SecOC_TxPduInfo[4].SecuredPduDataContainerSecuredPduEndIdxOfTxPduInfo "" UBYTE SecOC_SecuredPduDataContainerSecuredPduEndIdxOfTxPduInfoType 0 0 0 255 ECU_ADDRESS 0x0 /end MEASUREMENT
/begin MEASUREMENT SecOC_TxPduInfo[4].SecuredPduDataContainerSecuredPduLengthOfTxPduInfo "" UBYTE NO_COMPU_METHOD 0 0 0 255 ECU_ADDRESS 0x0 /end MEASUREMENT
/begin MEASUREMENT SecOC_TxPduInfo[4].SecuredPduDataContainerSecuredPduStartIdxOfTxPduInfo "" UBYTE SecOC_SecuredPduDataContainerSecuredPduStartIdxOfTxPduInfoType 0 0 0 255 ECU_ADDRESS 0x0 /end MEASUREMENT
/begin MEASUREMENT SecOC_TxPduInfo[4].SecuredPduDataContainerTruncatedAuthenticatorEndIdxOfTxPduInfo "" UBYTE SecOC_SecuredPduDataContainerTruncatedAuthenticatorEndIdxOfTxPduInfoType 0 0 0 255 ECU_ADDRESS 0x0 /end MEASUREMENT
/begin MEASUREMENT SecOC_TxPduInfo[4].SecuredPduDataContainerTruncatedAuthenticatorLengthOfTxPduInfo "" UBYTE NO_COMPU_METHOD 0 0 0 255 ECU_ADDRESS 0x0 /end MEASUREMENT
/begin MEASUREMENT SecOC_TxPduInfo[4].SecuredPduDataContainerTruncatedAuthenticatorStartIdxOfTxPduInfo "" UBYTE SecOC_SecuredPduDataContainerTruncatedAuthenticatorStartIdxOfTxPduInfoType 0 0 0 255 ECU_ADDRESS 0x0 /end MEASUREMENT
/begin MEASUREMENT SecOC_TxPduInfo[4].TruncAuthStartBitInByteOfTxPduInfo "" UBYTE NO_COMPU_METHOD 0 0 0 255 ECU_ADDRESS 0x0 /end MEASUREMENT
/begin MEASUREMENT SecOC_TxPduInfo[4].TruncFreshnessValueFirstByteShiftOfTxPduInfo "" UBYTE NO_COMPU_METHOD 0 0 0 255 ECU_ADDRESS 0x0 /end MEASUREMENT
/begin MEASUREMENT SecOC_TxPduInfo[4].TruncFreshnessValueSecondByteShiftOfTxPduInfo "" UBYTE NO_COMPU_METHOD 0 0 0 255 ECU_ADDRESS 0x0 /end MEASUREMENT
/begin MEASUREMENT SecOC_TxPduInfo[4].truncatedAuthenticationLengthOfTxPduInfo "" UBYTE NO_COMPU_METHOD 0 0 0 255 ECU_ADDRESS 0x0 /end MEASUREMENT
/begin MEASUREMENT SecOC_TxPduInfo[4].truncatedFreshnessValueLengthOfTxPduInfo "" UBYTE NO_COMPU_METHOD 0 0 0 255 ECU_ADDRESS 0x0 /end MEASUREMENT
/begin MEASUREMENT SecOC_TxPduInfo[5].AuthenticExternalIdOfTxPduInfo "" UBYTE SecOC_AuthenticExternalIdOfTxPduInfoType 0 0 0 255 ECU_ADDRESS 0x0 /end MEASUREMENT
/begin MEASUREMENT SecOC_TxPduInfo[5].AuthenticPduDataContainerAuthenticPduEndIdxOfTxPduInfo "" UWORD SecOC_AuthenticPduDataContainerAuthenticPduEndIdxOfTxPduInfoType 0 0 0 65535 ECU_ADDRESS 0x0 /end MEASUREMENT
/begin MEASUREMENT SecOC_TxPduInfo[5].AuthenticPduDataContainerAuthenticPduLengthOfTxPduInfo "" UBYTE NO_COMPU_METHOD 0 0 0 255 ECU_ADDRESS 0x0 /end MEASUREMENT
/begin MEASUREMENT SecOC_TxPduInfo[5].AuthenticPduDataContainerAuthenticPduStartIdxOfTxPduInfo "" UWORD SecOC_AuthenticPduDataContainerAuthenticPduStartIdxOfTxPduInfoType 0 0 0 65535 ECU_ADDRESS 0x0 /end MEASUREMENT
/begin MEASUREMENT SecOC_TxPduInfo[5].AuthenticPduDataContainerDataToAuthenticateEndIdxOfTxPduInfo "" UWORD NO_COMPU_METHOD 0 0 0 65535 ECU_ADDRESS 0x0 /end MEASUREMENT
/begin MEASUREMENT SecOC_TxPduInfo[5].AuthenticPduDataContainerDataToAuthenticateLengthOfTxPduInfo "" UBYTE NO_COMPU_METHOD 0 0 0 255 ECU_ADDRESS 0x0 /end MEASUREMENT
/begin MEASUREMENT SecOC_TxPduInfo[5].AuthenticPduDataContainerDataToAuthenticateStartIdxOfTxPduInfo "" UWORD NO_COMPU_METHOD 0 0 0 65535 ECU_ADDRESS 0x0 /end MEASUREMENT
/begin MEASUREMENT SecOC_TxPduInfo[5].AuthenticPduDataContainerFreshnessVerifyValueEndIdxOfTxPduInfo "" UWORD SecOC_AuthenticPduDataContainerFreshnessVerifyValueEndIdxOfTxPduInfoType 0 0 0 65535 ECU_ADDRESS 0x0 /end MEASUREMENT
/begin MEASUREMENT SecOC_TxPduInfo[5].AuthenticPduDataContainerFreshnessVerifyValueLengthOfTxPduInfo "" UBYTE NO_COMPU_METHOD 0 0 0 255 ECU_ADDRESS 0x0 /end MEASUREMENT
/begin MEASUREMENT SecOC_TxPduInfo[5].AuthenticPduDataContainerFreshnessVerifyValueStartIdxOfTxPduInfo "" UWORD SecOC_AuthenticPduDataContainerFreshnessVerifyValueStartIdxOfTxPduInfoType 0 0 0 65535 ECU_ADDRESS 0x0 /end MEASUREMENT
/begin MEASUREMENT SecOC_TxPduInfo[5].AuthenticPduDataContainerFullAuthenticPduEndIdxOfTxPduInfo "" UWORD SecOC_AuthenticPduDataContainerFullAuthenticPduEndIdxOfTxPduInfoType 0 0 0 65535 ECU_ADDRESS 0x0 /end MEASUREMENT
/begin MEASUREMENT SecOC_TxPduInfo[5].AuthenticPduDataContainerFullAuthenticPduLengthOfTxPduInfo "" UBYTE NO_COMPU_METHOD 0 0 0 255 ECU_ADDRESS 0x0 /end MEASUREMENT
/begin MEASUREMENT SecOC_TxPduInfo[5].AuthenticPduDataContainerFullAuthenticPduStartIdxOfTxPduInfo "" UWORD SecOC_AuthenticPduDataContainerFullAuthenticPduStartIdxOfTxPduInfoType 0 0 0 65535 ECU_ADDRESS 0x0 /end MEASUREMENT
/begin MEASUREMENT SecOC_TxPduInfo[5].AuthenticationLayerIdOfTxPduInfo "" UWORD NO_COMPU_METHOD 0 0 0 65535 ECU_ADDRESS 0x0 /end MEASUREMENT
/begin MEASUREMENT SecOC_TxPduInfo[5].AuthenticatorCacheEndIdxOfTxPduInfo "" UBYTE NO_COMPU_METHOD 0 0 0 255 ECU_ADDRESS 0x0 /end MEASUREMENT
/begin MEASUREMENT SecOC_TxPduInfo[5].AuthenticatorCacheLengthOfTxPduInfo "" UBYTE NO_COMPU_METHOD 0 0 0 255 ECU_ADDRESS 0x0 /end MEASUREMENT
/begin MEASUREMENT SecOC_TxPduInfo[5].AuthenticatorCacheStartIdxOfTxPduInfo "" UBYTE NO_COMPU_METHOD 0 0 0 255 ECU_ADDRESS 0x0 /end MEASUREMENT
/begin MEASUREMENT SecOC_TxPduInfo[5].BuildAttemptsOfTxPduInfo "" UBYTE NO_COMPU_METHOD 0 0 0 255 ECU_ADDRESS 0x0 /end MEASUREMENT
/begin MEASUREMENT SecOC_TxPduInfo[5].ConfirmationNeededOfTxPduInfo "" UBYTE SecOC_ConfirmationNeededOfTxPduInfoType 0 0 0 1 ECU_ADDRESS 0x0 /end MEASUREMENT
/begin MEASUREMENT SecOC_TxPduInfo[5].DataIdFirstByteOfTxPduInfo "" UBYTE NO_COMPU_METHOD 0 0 0 255 ECU_ADDRESS 0x0 /end MEASUREMENT
/begin MEASUREMENT SecOC_TxPduInfo[5].DataIdSecondByteOfTxPduInfo "" UBYTE NO_COMPU_METHOD 0 0 0 255 ECU_ADDRESS 0x0 /end MEASUREMENT
/begin MEASUREMENT SecOC_TxPduInfo[5].ExternalFreshnessIdOfTxPduInfo "" UBYTE NO_COMPU_METHOD 0 0 0 255 ECU_ADDRESS 0x0 /end MEASUREMENT
/begin MEASUREMENT SecOC_TxPduInfo[5].LowerLayerPduTypeOfTxPduInfo "" UBYTE SecOC_LowerLayerPduTypeOfTxPduInfoType 0 0 0 255 ECU_ADDRESS 0x0 /end MEASUREMENT
/begin MEASUREMENT SecOC_TxPduInfo[5].PduProcessingOfTxPduInfo "" UBYTE SecOC_PduProcessingOfTxPduInfoType 0 0 0 255 ECU_ADDRESS 0x0 /end MEASUREMENT
/begin MEASUREMENT SecOC_TxPduInfo[5].PduTypeOfTxPduInfo "" UBYTE SecOC_PduTypeOfTxPduInfoType 0 0 0 255 ECU_ADDRESS 0x0 /end MEASUREMENT
/begin MEASUREMENT SecOC_TxPduInfo[5].ProvideTruncTxFreshnessOfTxPduInfo "" UBYTE SecOC_ProvideTruncTxFreshnessOfTxPduInfoType 0 0 0 255 ECU_ADDRESS 0x0 /end MEASUREMENT
/begin MEASUREMENT SecOC_TxPduInfo[5].SecuredExternalIdOfTxPduInfo "" UBYTE SecOC_SecuredExternalIdOfTxPduInfoType 0 0 0 255 ECU_ADDRESS 0x0 /end MEASUREMENT
/begin MEASUREMENT SecOC_TxPduInfo[5].SecuredPduDataContainerAuthInfoDataEndIdxOfTxPduInfo "" UBYTE SecOC_SecuredPduDataContainerAuthInfoDataEndIdxOfTxPduInfoType 0 0 0 255 ECU_ADDRESS 0x0 /end MEASUREMENT
/begin MEASUREMENT SecOC_TxPduInfo[5].SecuredPduDataContainerAuthInfoDataLengthOfTxPduInfo "" UBYTE NO_COMPU_METHOD 0 0 0 255 ECU_ADDRESS 0x0 /end MEASUREMENT
/begin MEASUREMENT SecOC_TxPduInfo[5].SecuredPduDataContainerAuthInfoDataStartIdxOfTxPduInfo "" UBYTE SecOC_SecuredPduDataContainerAuthInfoDataStartIdxOfTxPduInfoType 0 0 0 255 ECU_ADDRESS 0x0 /end MEASUREMENT
/begin MEASUREMENT SecOC_TxPduInfo[5].SecuredPduDataContainerAuthenticPduEndIdxOfTxPduInfo "" UBYTE SecOC_SecuredPduDataContainerAuthenticPduEndIdxOfTxPduInfoType 0 0 0 255 ECU_ADDRESS 0x0 /end MEASUREMENT
/begin MEASUREMENT SecOC_TxPduInfo[5].SecuredPduDataContainerAuthenticPduLengthOfTxPduInfo "" UBYTE NO_COMPU_METHOD 0 0 0 255 ECU_ADDRESS 0x0 /end MEASUREMENT
/begin MEASUREMENT SecOC_TxPduInfo[5].SecuredPduDataContainerAuthenticPduStartIdxOfTxPduInfo "" UBYTE SecOC_SecuredPduDataContainerAuthenticPduStartIdxOfTxPduInfoType 0 0 0 255 ECU_ADDRESS 0x0 /end MEASUREMENT
/begin MEASUREMENT SecOC_TxPduInfo[5].SecuredPduDataContainerSecuredPduEndIdxOfTxPduInfo "" UBYTE SecOC_SecuredPduDataContainerSecuredPduEndIdxOfTxPduInfoType 0 0 0 255 ECU_ADDRESS 0x0 /end MEASUREMENT
/begin MEASUREMENT SecOC_TxPduInfo[5].SecuredPduDataContainerSecuredPduLengthOfTxPduInfo "" UBYTE NO_COMPU_METHOD 0 0 0 255 ECU_ADDRESS 0x0 /end MEASUREMENT
/begin MEASUREMENT SecOC_TxPduInfo[5].SecuredPduDataContainerSecuredPduStartIdxOfTxPduInfo "" UBYTE SecOC_SecuredPduDataContainerSecuredPduStartIdxOfTxPduInfoType 0 0 0 255 ECU_ADDRESS 0x0 /end MEASUREMENT
/begin MEASUREMENT SecOC_TxPduInfo[5].SecuredPduDataContainerTruncatedAuthenticatorEndIdxOfTxPduInfo "" UBYTE SecOC_SecuredPduDataContainerTruncatedAuthenticatorEndIdxOfTxPduInfoType 0 0 0 255 ECU_ADDRESS 0x0 /end MEASUREMENT
/begin MEASUREMENT SecOC_TxPduInfo[5].SecuredPduDataContainerTruncatedAuthenticatorLengthOfTxPduInfo "" UBYTE NO_COMPU_METHOD 0 0 0 255 ECU_ADDRESS 0x0 /end MEASUREMENT
/begin MEASUREMENT SecOC_TxPduInfo[5].SecuredPduDataContainerTruncatedAuthenticatorStartIdxOfTxPduInfo "" UBYTE SecOC_SecuredPduDataContainerTruncatedAuthenticatorStartIdxOfTxPduInfoType 0 0 0 255 ECU_ADDRESS 0x0 /end MEASUREMENT
/begin MEASUREMENT SecOC_TxPduInfo[5].TruncAuthStartBitInByteOfTxPduInfo "" UBYTE NO_COMPU_METHOD 0 0 0 255 ECU_ADDRESS 0x0 /end MEASUREMENT
/begin MEASUREMENT SecOC_TxPduInfo[5].TruncFreshnessValueFirstByteShiftOfTxPduInfo "" UBYTE NO_COMPU_METHOD 0 0 0 255 ECU_ADDRESS 0x0 /end MEASUREMENT
/begin MEASUREMENT SecOC_TxPduInfo[5].TruncFreshnessValueSecondByteShiftOfTxPduInfo "" UBYTE NO_COMPU_METHOD 0 0 0 255 ECU_ADDRESS 0x0 /end MEASUREMENT
/begin MEASUREMENT SecOC_TxPduInfo[5].truncatedAuthenticationLengthOfTxPduInfo "" UBYTE NO_COMPU_METHOD 0 0 0 255 ECU_ADDRESS 0x0 /end MEASUREMENT
/begin MEASUREMENT SecOC_TxPduInfo[5].truncatedFreshnessValueLengthOfTxPduInfo "" UBYTE NO_COMPU_METHOD 0 0 0 255 ECU_ADDRESS 0x0 /end MEASUREMENT
/begin MEASUREMENT SecOC_TxPduInfo[6].AuthenticExternalIdOfTxPduInfo "" UBYTE SecOC_AuthenticExternalIdOfTxPduInfoType 0 0 0 255 ECU_ADDRESS 0x0 /end MEASUREMENT
/begin MEASUREMENT SecOC_TxPduInfo[6].AuthenticPduDataContainerAuthenticPduEndIdxOfTxPduInfo "" UWORD SecOC_AuthenticPduDataContainerAuthenticPduEndIdxOfTxPduInfoType 0 0 0 65535 ECU_ADDRESS 0x0 /end MEASUREMENT
/begin MEASUREMENT SecOC_TxPduInfo[6].AuthenticPduDataContainerAuthenticPduLengthOfTxPduInfo "" UBYTE NO_COMPU_METHOD 0 0 0 255 ECU_ADDRESS 0x0 /end MEASUREMENT
/begin MEASUREMENT SecOC_TxPduInfo[6].AuthenticPduDataContainerAuthenticPduStartIdxOfTxPduInfo "" UWORD SecOC_AuthenticPduDataContainerAuthenticPduStartIdxOfTxPduInfoType 0 0 0 65535 ECU_ADDRESS 0x0 /end MEASUREMENT
/begin MEASUREMENT SecOC_TxPduInfo[6].AuthenticPduDataContainerDataToAuthenticateEndIdxOfTxPduInfo "" UWORD NO_COMPU_METHOD 0 0 0 65535 ECU_ADDRESS 0x0 /end MEASUREMENT
/begin MEASUREMENT SecOC_TxPduInfo[6].AuthenticPduDataContainerDataToAuthenticateLengthOfTxPduInfo "" UBYTE NO_COMPU_METHOD 0 0 0 255 ECU_ADDRESS 0x0 /end MEASUREMENT
/begin MEASUREMENT SecOC_TxPduInfo[6].AuthenticPduDataContainerDataToAuthenticateStartIdxOfTxPduInfo "" UWORD NO_COMPU_METHOD 0 0 0 65535 ECU_ADDRESS 0x0 /end MEASUREMENT
/begin MEASUREMENT SecOC_TxPduInfo[6].AuthenticPduDataContainerFreshnessVerifyValueEndIdxOfTxPduInfo "" UWORD SecOC_AuthenticPduDataContainerFreshnessVerifyValueEndIdxOfTxPduInfoType 0 0 0 65535 ECU_ADDRESS 0x0 /end MEASUREMENT
/begin MEASUREMENT SecOC_TxPduInfo[6].AuthenticPduDataContainerFreshnessVerifyValueLengthOfTxPduInfo "" UBYTE NO_COMPU_METHOD 0 0 0 255 ECU_ADDRESS 0x0 /end MEASUREMENT
/begin MEASUREMENT SecOC_TxPduInfo[6].AuthenticPduDataContainerFreshnessVerifyValueStartIdxOfTxPduInfo "" UWORD SecOC_AuthenticPduDataContainerFreshnessVerifyValueStartIdxOfTxPduInfoType 0 0 0 65535 ECU_ADDRESS 0x0 /end MEASUREMENT
/begin MEASUREMENT SecOC_TxPduInfo[6].AuthenticPduDataContainerFullAuthenticPduEndIdxOfTxPduInfo "" UWORD SecOC_AuthenticPduDataContainerFullAuthenticPduEndIdxOfTxPduInfoType 0 0 0 65535 ECU_ADDRESS 0x0 /end MEASUREMENT
/begin MEASUREMENT SecOC_TxPduInfo[6].AuthenticPduDataContainerFullAuthenticPduLengthOfTxPduInfo "" UBYTE NO_COMPU_METHOD 0 0 0 255 ECU_ADDRESS 0x0 /end MEASUREMENT
/begin MEASUREMENT SecOC_TxPduInfo[6].AuthenticPduDataContainerFullAuthenticPduStartIdxOfTxPduInfo "" UWORD SecOC_AuthenticPduDataContainerFullAuthenticPduStartIdxOfTxPduInfoType 0 0 0 65535 ECU_ADDRESS 0x0 /end MEASUREMENT
/begin MEASUREMENT SecOC_TxPduInfo[6].AuthenticationLayerIdOfTxPduInfo "" UWORD NO_COMPU_METHOD 0 0 0 65535 ECU_ADDRESS 0x0 /end MEASUREMENT
/begin MEASUREMENT SecOC_TxPduInfo[6].AuthenticatorCacheEndIdxOfTxPduInfo "" UBYTE NO_COMPU_METHOD 0 0 0 255 ECU_ADDRESS 0x0 /end MEASUREMENT
/begin MEASUREMENT SecOC_TxPduInfo[6].AuthenticatorCacheLengthOfTxPduInfo "" UBYTE NO_COMPU_METHOD 0 0 0 255 ECU_ADDRESS 0x0 /end MEASUREMENT
/begin MEASUREMENT SecOC_TxPduInfo[6].AuthenticatorCacheStartIdxOfTxPduInfo "" UBYTE NO_COMPU_METHOD 0 0 0 255 ECU_ADDRESS 0x0 /end MEASUREMENT
/begin MEASUREMENT SecOC_TxPduInfo[6].BuildAttemptsOfTxPduInfo "" UBYTE NO_COMPU_METHOD 0 0 0 255 ECU_ADDRESS 0x0 /end MEASUREMENT
/begin MEASUREMENT SecOC_TxPduInfo[6].ConfirmationNeededOfTxPduInfo "" UBYTE SecOC_ConfirmationNeededOfTxPduInfoType 0 0 0 1 ECU_ADDRESS 0x0 /end MEASUREMENT
/begin MEASUREMENT SecOC_TxPduInfo[6].DataIdFirstByteOfTxPduInfo "" UBYTE NO_COMPU_METHOD 0 0 0 255 ECU_ADDRESS 0x0 /end MEASUREMENT
/begin MEASUREMENT SecOC_TxPduInfo[6].DataIdSecondByteOfTxPduInfo "" UBYTE NO_COMPU_METHOD 0 0 0 255 ECU_ADDRESS 0x0 /end MEASUREMENT
/begin MEASUREMENT SecOC_TxPduInfo[6].ExternalFreshnessIdOfTxPduInfo "" UBYTE NO_COMPU_METHOD 0 0 0 255 ECU_ADDRESS 0x0 /end MEASUREMENT
/begin MEASUREMENT SecOC_TxPduInfo[6].LowerLayerPduTypeOfTxPduInfo "" UBYTE SecOC_LowerLayerPduTypeOfTxPduInfoType 0 0 0 255 ECU_ADDRESS 0x0 /end MEASUREMENT
/begin MEASUREMENT SecOC_TxPduInfo[6].PduProcessingOfTxPduInfo "" UBYTE SecOC_PduProcessingOfTxPduInfoType 0 0 0 255 ECU_ADDRESS 0x0 /end MEASUREMENT
/begin MEASUREMENT SecOC_TxPduInfo[6].PduTypeOfTxPduInfo "" UBYTE SecOC_PduTypeOfTxPduInfoType 0 0 0 255 ECU_ADDRESS 0x0 /end MEASUREMENT
/begin MEASUREMENT SecOC_TxPduInfo[6].ProvideTruncTxFreshnessOfTxPduInfo "" UBYTE SecOC_ProvideTruncTxFreshnessOfTxPduInfoType 0 0 0 255 ECU_ADDRESS 0x0 /end MEASUREMENT
/begin MEASUREMENT SecOC_TxPduInfo[6].SecuredExternalIdOfTxPduInfo "" UBYTE SecOC_SecuredExternalIdOfTxPduInfoType 0 0 0 255 ECU_ADDRESS 0x0 /end MEASUREMENT
/begin MEASUREMENT SecOC_TxPduInfo[6].SecuredPduDataContainerAuthInfoDataEndIdxOfTxPduInfo "" UBYTE SecOC_SecuredPduDataContainerAuthInfoDataEndIdxOfTxPduInfoType 0 0 0 255 ECU_ADDRESS 0x0 /end MEASUREMENT
/begin MEASUREMENT SecOC_TxPduInfo[6].SecuredPduDataContainerAuthInfoDataLengthOfTxPduInfo "" UBYTE NO_COMPU_METHOD 0 0 0 255 ECU_ADDRESS 0x0 /end MEASUREMENT
/begin MEASUREMENT SecOC_TxPduInfo[6].SecuredPduDataContainerAuthInfoDataStartIdxOfTxPduInfo "" UBYTE SecOC_SecuredPduDataContainerAuthInfoDataStartIdxOfTxPduInfoType 0 0 0 255 ECU_ADDRESS 0x0 /end MEASUREMENT
/begin MEASUREMENT SecOC_TxPduInfo[6].SecuredPduDataContainerAuthenticPduEndIdxOfTxPduInfo "" UBYTE SecOC_SecuredPduDataContainerAuthenticPduEndIdxOfTxPduInfoType 0 0 0 255 ECU_ADDRESS 0x0 /end MEASUREMENT
/begin MEASUREMENT SecOC_TxPduInfo[6].SecuredPduDataContainerAuthenticPduLengthOfTxPduInfo "" UBYTE NO_COMPU_METHOD 0 0 0 255 ECU_ADDRESS 0x0 /end MEASUREMENT
/begin MEASUREMENT SecOC_TxPduInfo[6].SecuredPduDataContainerAuthenticPduStartIdxOfTxPduInfo "" UBYTE SecOC_SecuredPduDataContainerAuthenticPduStartIdxOfTxPduInfoType 0 0 0 255 ECU_ADDRESS 0x0 /end MEASUREMENT
/begin MEASUREMENT SecOC_TxPduInfo[6].SecuredPduDataContainerSecuredPduEndIdxOfTxPduInfo "" UBYTE SecOC_SecuredPduDataContainerSecuredPduEndIdxOfTxPduInfoType 0 0 0 255 ECU_ADDRESS 0x0 /end MEASUREMENT
/begin MEASUREMENT SecOC_TxPduInfo[6].SecuredPduDataContainerSecuredPduLengthOfTxPduInfo "" UBYTE NO_COMPU_METHOD 0 0 0 255 ECU_ADDRESS 0x0 /end MEASUREMENT
/begin MEASUREMENT SecOC_TxPduInfo[6].SecuredPduDataContainerSecuredPduStartIdxOfTxPduInfo "" UBYTE SecOC_SecuredPduDataContainerSecuredPduStartIdxOfTxPduInfoType 0 0 0 255 ECU_ADDRESS 0x0 /end MEASUREMENT
/begin MEASUREMENT SecOC_TxPduInfo[6].SecuredPduDataContainerTruncatedAuthenticatorEndIdxOfTxPduInfo "" UBYTE SecOC_SecuredPduDataContainerTruncatedAuthenticatorEndIdxOfTxPduInfoType 0 0 0 255 ECU_ADDRESS 0x0 /end MEASUREMENT
/begin MEASUREMENT SecOC_TxPduInfo[6].SecuredPduDataContainerTruncatedAuthenticatorLengthOfTxPduInfo "" UBYTE NO_COMPU_METHOD 0 0 0 255 ECU_ADDRESS 0x0 /end MEASUREMENT
/begin MEASUREMENT SecOC_TxPduInfo[6].SecuredPduDataContainerTruncatedAuthenticatorStartIdxOfTxPduInfo "" UBYTE SecOC_SecuredPduDataContainerTruncatedAuthenticatorStartIdxOfTxPduInfoType 0 0 0 255 ECU_ADDRESS 0x0 /end MEASUREMENT
/begin MEASUREMENT SecOC_TxPduInfo[6].TruncAuthStartBitInByteOfTxPduInfo "" UBYTE NO_COMPU_METHOD 0 0 0 255 ECU_ADDRESS 0x0 /end MEASUREMENT
/begin MEASUREMENT SecOC_TxPduInfo[6].TruncFreshnessValueFirstByteShiftOfTxPduInfo "" UBYTE NO_COMPU_METHOD 0 0 0 255 ECU_ADDRESS 0x0 /end MEASUREMENT
/begin MEASUREMENT SecOC_TxPduInfo[6].TruncFreshnessValueSecondByteShiftOfTxPduInfo "" UBYTE NO_COMPU_METHOD 0 0 0 255 ECU_ADDRESS 0x0 /end MEASUREMENT
/begin MEASUREMENT SecOC_TxPduInfo[6].truncatedAuthenticationLengthOfTxPduInfo "" UBYTE NO_COMPU_METHOD 0 0 0 255 ECU_ADDRESS 0x0 /end MEASUREMENT
/begin MEASUREMENT SecOC_TxPduInfo[6].truncatedFreshnessValueLengthOfTxPduInfo "" UBYTE NO_COMPU_METHOD 0 0 0 255 ECU_ADDRESS 0x0 /end MEASUREMENT
/begin MEASUREMENT SecOC_TxPduInfo[7].AuthenticExternalIdOfTxPduInfo "" UBYTE SecOC_AuthenticExternalIdOfTxPduInfoType 0 0 0 255 ECU_ADDRESS 0x0 /end MEASUREMENT
/begin MEASUREMENT SecOC_TxPduInfo[7].AuthenticPduDataContainerAuthenticPduEndIdxOfTxPduInfo "" UWORD SecOC_AuthenticPduDataContainerAuthenticPduEndIdxOfTxPduInfoType 0 0 0 65535 ECU_ADDRESS 0x0 /end MEASUREMENT
/begin MEASUREMENT SecOC_TxPduInfo[7].AuthenticPduDataContainerAuthenticPduLengthOfTxPduInfo "" UBYTE NO_COMPU_METHOD 0 0 0 255 ECU_ADDRESS 0x0 /end MEASUREMENT
/begin MEASUREMENT SecOC_TxPduInfo[7].AuthenticPduDataContainerAuthenticPduStartIdxOfTxPduInfo "" UWORD SecOC_AuthenticPduDataContainerAuthenticPduStartIdxOfTxPduInfoType 0 0 0 65535 ECU_ADDRESS 0x0 /end MEASUREMENT
/begin MEASUREMENT SecOC_TxPduInfo[7].AuthenticPduDataContainerDataToAuthenticateEndIdxOfTxPduInfo "" UWORD NO_COMPU_METHOD 0 0 0 65535 ECU_ADDRESS 0x0 /end MEASUREMENT
/begin MEASUREMENT SecOC_TxPduInfo[7].AuthenticPduDataContainerDataToAuthenticateLengthOfTxPduInfo "" UBYTE NO_COMPU_METHOD 0 0 0 255 ECU_ADDRESS 0x0 /end MEASUREMENT
/begin MEASUREMENT SecOC_TxPduInfo[7].AuthenticPduDataContainerDataToAuthenticateStartIdxOfTxPduInfo "" UWORD NO_COMPU_METHOD 0 0 0 65535 ECU_ADDRESS 0x0 /end MEASUREMENT
/begin MEASUREMENT SecOC_TxPduInfo[7].AuthenticPduDataContainerFreshnessVerifyValueEndIdxOfTxPduInfo "" UWORD SecOC_AuthenticPduDataContainerFreshnessVerifyValueEndIdxOfTxPduInfoType 0 0 0 65535 ECU_ADDRESS 0x0 /end MEASUREMENT
/begin MEASUREMENT SecOC_TxPduInfo[7].AuthenticPduDataContainerFreshnessVerifyValueLengthOfTxPduInfo "" UBYTE NO_COMPU_METHOD 0 0 0 255 ECU_ADDRESS 0x0 /end MEASUREMENT
/begin MEASUREMENT SecOC_TxPduInfo[7].AuthenticPduDataContainerFreshnessVerifyValueStartIdxOfTxPduInfo "" UWORD SecOC_AuthenticPduDataContainerFreshnessVerifyValueStartIdxOfTxPduInfoType 0 0 0 65535 ECU_ADDRESS 0x0 /end MEASUREMENT
/begin MEASUREMENT SecOC_TxPduInfo[7].AuthenticPduDataContainerFullAuthenticPduEndIdxOfTxPduInfo "" UWORD SecOC_AuthenticPduDataContainerFullAuthenticPduEndIdxOfTxPduInfoType 0 0 0 65535 ECU_ADDRESS 0x0 /end MEASUREMENT
/begin MEASUREMENT SecOC_TxPduInfo[7].AuthenticPduDataContainerFullAuthenticPduLengthOfTxPduInfo "" UBYTE NO_COMPU_METHOD 0 0 0 255 ECU_ADDRESS 0x0 /end MEASUREMENT
/begin MEASUREMENT SecOC_TxPduInfo[7].AuthenticPduDataContainerFullAuthenticPduStartIdxOfTxPduInfo "" UWORD SecOC_AuthenticPduDataContainerFullAuthenticPduStartIdxOfTxPduInfoType 0 0 0 65535 ECU_ADDRESS 0x0 /end MEASUREMENT
/begin MEASUREMENT SecOC_TxPduInfo[7].AuthenticationLayerIdOfTxPduInfo "" UWORD NO_COMPU_METHOD 0 0 0 65535 ECU_ADDRESS 0x0 /end MEASUREMENT
/begin MEASUREMENT SecOC_TxPduInfo[7].AuthenticatorCacheEndIdxOfTxPduInfo "" UBYTE NO_COMPU_METHOD 0 0 0 255 ECU_ADDRESS 0x0 /end MEASUREMENT
/begin MEASUREMENT SecOC_TxPduInfo[7].AuthenticatorCacheLengthOfTxPduInfo "" UBYTE NO_COMPU_METHOD 0 0 0 255 ECU_ADDRESS 0x0 /end MEASUREMENT
/begin MEASUREMENT SecOC_TxPduInfo[7].AuthenticatorCacheStartIdxOfTxPduInfo "" UBYTE NO_COMPU_METHOD 0 0 0 255 ECU_ADDRESS 0x0 /end MEASUREMENT
/begin MEASUREMENT SecOC_TxPduInfo[7].BuildAttemptsOfTxPduInfo "" UBYTE NO_COMPU_METHOD 0 0 0 255 ECU_ADDRESS 0x0 /end MEASUREMENT
/begin MEASUREMENT SecOC_TxPduInfo[7].ConfirmationNeededOfTxPduInfo "" UBYTE SecOC_ConfirmationNeededOfTxPduInfoType 0 0 0 1 ECU_ADDRESS 0x0 /end MEASUREMENT
/begin MEASUREMENT SecOC_TxPduInfo[7].DataIdFirstByteOfTxPduInfo "" UBYTE NO_COMPU_METHOD 0 0 0 255 ECU_ADDRESS 0x0 /end MEASUREMENT
/begin MEASUREMENT SecOC_TxPduInfo[7].DataIdSecondByteOfTxPduInfo "" UBYTE NO_COMPU_METHOD 0 0 0 255 ECU_ADDRESS 0x0 /end MEASUREMENT
/begin MEASUREMENT SecOC_TxPduInfo[7].ExternalFreshnessIdOfTxPduInfo "" UBYTE NO_COMPU_METHOD 0 0 0 255 ECU_ADDRESS 0x0 /end MEASUREMENT
/begin MEASUREMENT SecOC_TxPduInfo[7].LowerLayerPduTypeOfTxPduInfo "" UBYTE SecOC_LowerLayerPduTypeOfTxPduInfoType 0 0 0 255 ECU_ADDRESS 0x0 /end MEASUREMENT
/begin MEASUREMENT SecOC_TxPduInfo[7].PduProcessingOfTxPduInfo "" UBYTE SecOC_PduProcessingOfTxPduInfoType 0 0 0 255 ECU_ADDRESS 0x0 /end MEASUREMENT
/begin MEASUREMENT SecOC_TxPduInfo[7].PduTypeOfTxPduInfo "" UBYTE SecOC_PduTypeOfTxPduInfoType 0 0 0 255 ECU_ADDRESS 0x0 /end MEASUREMENT
/begin MEASUREMENT SecOC_TxPduInfo[7].ProvideTruncTxFreshnessOfTxPduInfo "" UBYTE SecOC_ProvideTruncTxFreshnessOfTxPduInfoType 0 0 0 255 ECU_ADDRESS 0x0 /end MEASUREMENT
/begin MEASUREMENT SecOC_TxPduInfo[7].SecuredExternalIdOfTxPduInfo "" UBYTE SecOC_SecuredExternalIdOfTxPduInfoType 0 0 0 255 ECU_ADDRESS 0x0 /end MEASUREMENT
/begin MEASUREMENT SecOC_TxPduInfo[7].SecuredPduDataContainerAuthInfoDataEndIdxOfTxPduInfo "" UBYTE SecOC_SecuredPduDataContainerAuthInfoDataEndIdxOfTxPduInfoType 0 0 0 255 ECU_ADDRESS 0x0 /end MEASUREMENT
/begin MEASUREMENT SecOC_TxPduInfo[7].SecuredPduDataContainerAuthInfoDataLengthOfTxPduInfo "" UBYTE NO_COMPU_METHOD 0 0 0 255 ECU_ADDRESS 0x0 /end MEASUREMENT
/begin MEASUREMENT SecOC_TxPduInfo[7].SecuredPduDataContainerAuthInfoDataStartIdxOfTxPduInfo "" UBYTE SecOC_SecuredPduDataContainerAuthInfoDataStartIdxOfTxPduInfoType 0 0 0 255 ECU_ADDRESS 0x0 /end MEASUREMENT
/begin MEASUREMENT SecOC_TxPduInfo[7].SecuredPduDataContainerAuthenticPduEndIdxOfTxPduInfo "" UBYTE SecOC_SecuredPduDataContainerAuthenticPduEndIdxOfTxPduInfoType 0 0 0 255 ECU_ADDRESS 0x0 /end MEASUREMENT
/begin MEASUREMENT SecOC_TxPduInfo[7].SecuredPduDataContainerAuthenticPduLengthOfTxPduInfo "" UBYTE NO_COMPU_METHOD 0 0 0 255 ECU_ADDRESS 0x0 /end MEASUREMENT
/begin MEASUREMENT SecOC_TxPduInfo[7].SecuredPduDataContainerAuthenticPduStartIdxOfTxPduInfo "" UBYTE SecOC_SecuredPduDataContainerAuthenticPduStartIdxOfTxPduInfoType 0 0 0 255 ECU_ADDRESS 0x0 /end MEASUREMENT
/begin MEASUREMENT SecOC_TxPduInfo[7].SecuredPduDataContainerSecuredPduEndIdxOfTxPduInfo "" UBYTE SecOC_SecuredPduDataContainerSecuredPduEndIdxOfTxPduInfoType 0 0 0 255 ECU_ADDRESS 0x0 /end MEASUREMENT
/begin MEASUREMENT SecOC_TxPduInfo[7].SecuredPduDataContainerSecuredPduLengthOfTxPduInfo "" UBYTE NO_COMPU_METHOD 0 0 0 255 ECU_ADDRESS 0x0 /end MEASUREMENT
/begin MEASUREMENT SecOC_TxPduInfo[7].SecuredPduDataContainerSecuredPduStartIdxOfTxPduInfo "" UBYTE SecOC_SecuredPduDataContainerSecuredPduStartIdxOfTxPduInfoType 0 0 0 255 ECU_ADDRESS 0x0 /end MEASUREMENT
/begin MEASUREMENT SecOC_TxPduInfo[7].SecuredPduDataContainerTruncatedAuthenticatorEndIdxOfTxPduInfo "" UBYTE SecOC_SecuredPduDataContainerTruncatedAuthenticatorEndIdxOfTxPduInfoType 0 0 0 255 ECU_ADDRESS 0x0 /end MEASUREMENT
/begin MEASUREMENT SecOC_TxPduInfo[7].SecuredPduDataContainerTruncatedAuthenticatorLengthOfTxPduInfo "" UBYTE NO_COMPU_METHOD 0 0 0 255 ECU_ADDRESS 0x0 /end MEASUREMENT
/begin MEASUREMENT SecOC_TxPduInfo[7].SecuredPduDataContainerTruncatedAuthenticatorStartIdxOfTxPduInfo "" UBYTE SecOC_SecuredPduDataContainerTruncatedAuthenticatorStartIdxOfTxPduInfoType 0 0 0 255 ECU_ADDRESS 0x0 /end MEASUREMENT
/begin MEASUREMENT SecOC_TxPduInfo[7].TruncAuthStartBitInByteOfTxPduInfo "" UBYTE NO_COMPU_METHOD 0 0 0 255 ECU_ADDRESS 0x0 /end MEASUREMENT
/begin MEASUREMENT SecOC_TxPduInfo[7].TruncFreshnessValueFirstByteShiftOfTxPduInfo "" UBYTE NO_COMPU_METHOD 0 0 0 255 ECU_ADDRESS 0x0 /end MEASUREMENT
/begin MEASUREMENT SecOC_TxPduInfo[7].TruncFreshnessValueSecondByteShiftOfTxPduInfo "" UBYTE NO_COMPU_METHOD 0 0 0 255 ECU_ADDRESS 0x0 /end MEASUREMENT
/begin MEASUREMENT SecOC_TxPduInfo[7].truncatedAuthenticationLengthOfTxPduInfo "" UBYTE NO_COMPU_METHOD 0 0 0 255 ECU_ADDRESS 0x0 /end MEASUREMENT
/begin MEASUREMENT SecOC_TxPduInfo[7].truncatedFreshnessValueLengthOfTxPduInfo "" UBYTE NO_COMPU_METHOD 0 0 0 255 ECU_ADDRESS 0x0 /end MEASUREMENT
/begin MEASUREMENT SecOC_TxPduState "The state variable is volatile because it is used to ensure data consistency" UBYTE SecOC_TxPduStateType 0 0 0 255 ECU_ADDRESS 0x0 MATRIX_DIM 8 SYMBOL_LINK "SecOC_TxPduState.raw" 0 /end MEASUREMENT
/begin MEASUREMENT SecOC_TxPduState_BMC_HV_01_E2E_SOK_XIX_HCP5_CANFD01_ad756307_Tx "The element: BMC_HV_01_E2E_SOK_XIX_HCP5_CANFD01_ad756307_Tx of SecOC_TxPduState" UBYTE SecOC_TxPduStateType 0 0 0 255 ECU_ADDRESS 0x0 SYMBOL_LINK "SecOC_TxPduState.raw[0]" 0 /end MEASUREMENT
/begin MEASUREMENT SecOC_TxPduState_BMC_HV_02_E2E_SOK_XIX_HCP5_CANFD01_5f228eff_Tx "The element: BMC_HV_02_E2E_SOK_XIX_HCP5_CANFD01_5f228eff_Tx of SecOC_TxPduState" UBYTE SecOC_TxPduStateType 0 0 0 255 ECU_ADDRESS 0x0 SYMBOL_LINK "SecOC_TxPduState.raw[1]" 0 /end MEASUREMENT
/begin MEASUREMENT SecOC_TxPduState_BMC_HV_06_SOK_XIX_HCP5_CANFD01_e20cafa8_Tx "The element: BMC_HV_06_SOK_XIX_HCP5_CANFD01_e20cafa8_Tx of SecOC_TxPduState" UBYTE SecOC_TxPduStateType 0 0 0 255 ECU_ADDRESS 0x0 SYMBOL_LINK "SecOC_TxPduState.raw[2]" 0 /end MEASUREMENT
/begin MEASUREMENT SecOC_TxPduState_BMC_HV_07_SOK_XIX_HCP5_CANFD01_f524cb68_Tx "The element: BMC_HV_07_SOK_XIX_HCP5_CANFD01_f524cb68_Tx of SecOC_TxPduState" UBYTE SecOC_TxPduStateType 0 0 0 255 ECU_ADDRESS 0x0 SYMBOL_LINK "SecOC_TxPduState.raw[3]" 0 /end MEASUREMENT
/begin MEASUREMENT SecOC_TxPduState_BMC_HV_08_SOK_XIX_HCP5_CANFD01_29bed328_Tx "The element: BMC_HV_08_SOK_XIX_HCP5_CANFD01_29bed328_Tx of SecOC_TxPduState" UBYTE SecOC_TxPduStateType 0 0 0 255 ECU_ADDRESS 0x0 SYMBOL_LINK "SecOC_TxPduState.raw[4]" 0 /end MEASUREMENT
/begin MEASUREMENT SecOC_TxPduState_BMC_HV_09_SOK_XIX_HCP5_CANFD01_3e96b7e8_Tx "The element: BMC_HV_09_SOK_XIX_HCP5_CANFD01_3e96b7e8_Tx of SecOC_TxPduState" UBYTE SecOC_TxPduStateType 0 0 0 255 ECU_ADDRESS 0x0 SYMBOL_LINK "SecOC_TxPduState.raw[5]" 0 /end MEASUREMENT
/begin MEASUREMENT SecOC_TxPduState_BMC_HV_14_SOK_XIX_HCP5_CANFD01_572f8cfc_Tx "The element: BMC_HV_14_SOK_XIX_HCP5_CANFD01_572f8cfc_Tx of SecOC_TxPduState" UBYTE SecOC_TxPduStateType 0 0 0 255 ECU_ADDRESS 0x0 SYMBOL_LINK "SecOC_TxPduState.raw[6]" 0 /end MEASUREMENT
/begin MEASUREMENT SecOC_TxPduState_OBD_Hybrid_01_SOK_XIX_HCP5_CANFD01_86ce2f2e_Tx "The element: OBD_Hybrid_01_SOK_XIX_HCP5_CANFD01_86ce2f2e_Tx of SecOC_TxPduState" UBYTE SecOC_TxPduStateType 0 0 0 255 ECU_ADDRESS 0x0 SYMBOL_LINK "SecOC_TxPduState.raw[7]" 0 /end MEASUREMENT
/begin MEASUREMENT SecOC_TxResultLength "" ULONG NO_COMPU_METHOD 0 0 0 4294967295 ECU_ADDRESS 0x0 MATRIX_DIM 8 SYMBOL_LINK "SecOC_TxResultLength.raw" 0 /end MEASUREMENT
/begin MEASUREMENT SecOC_TxResultLength_BMC_HV_01_E2E_SOK_XIX_HCP5_CANFD01_ad756307_Tx "The element: BMC_HV_01_E2E_SOK_XIX_HCP5_CANFD01_ad756307_Tx of SecOC_TxResultLength" ULONG NO_COMPU_METHOD 0 0 0 4294967295 ECU_ADDRESS 0x0 SYMBOL_LINK "SecOC_TxResultLength.raw[0]" 0 /end MEASUREMENT
/begin MEASUREMENT SecOC_TxResultLength_BMC_HV_02_E2E_SOK_XIX_HCP5_CANFD01_5f228eff_Tx "The element: BMC_HV_02_E2E_SOK_XIX_HCP5_CANFD01_5f228eff_Tx of SecOC_TxResultLength" ULONG NO_COMPU_METHOD 0 0 0 4294967295 ECU_ADDRESS 0x0 SYMBOL_LINK "SecOC_TxResultLength.raw[1]" 0 /end MEASUREMENT
/begin MEASUREMENT SecOC_TxResultLength_BMC_HV_06_SOK_XIX_HCP5_CANFD01_e20cafa8_Tx "The element: BMC_HV_06_SOK_XIX_HCP5_CANFD01_e20cafa8_Tx of SecOC_TxResultLength" ULONG NO_COMPU_METHOD 0 0 0 4294967295 ECU_ADDRESS 0x0 SYMBOL_LINK "SecOC_TxResultLength.raw[2]" 0 /end MEASUREMENT
/begin MEASUREMENT SecOC_TxResultLength_BMC_HV_07_SOK_XIX_HCP5_CANFD01_f524cb68_Tx "The element: BMC_HV_07_SOK_XIX_HCP5_CANFD01_f524cb68_Tx of SecOC_TxResultLength" ULONG NO_COMPU_METHOD 0 0 0 4294967295 ECU_ADDRESS 0x0 SYMBOL_LINK "SecOC_TxResultLength.raw[3]" 0 /end MEASUREMENT
/begin MEASUREMENT SecOC_TxResultLength_BMC_HV_08_SOK_XIX_HCP5_CANFD01_29bed328_Tx "The element: BMC_HV_08_SOK_XIX_HCP5_CANFD01_29bed328_Tx of SecOC_TxResultLength" ULONG NO_COMPU_METHOD 0 0 0 4294967295 ECU_ADDRESS 0x0 SYMBOL_LINK "SecOC_TxResultLength.raw[4]" 0 /end MEASUREMENT
/begin MEASUREMENT SecOC_TxResultLength_BMC_HV_09_SOK_XIX_HCP5_CANFD01_3e96b7e8_Tx "The element: BMC_HV_09_SOK_XIX_HCP5_CANFD01_3e96b7e8_Tx of SecOC_TxResultLength" ULONG NO_COMPU_METHOD 0 0 0 4294967295 ECU_ADDRESS 0x0 SYMBOL_LINK "SecOC_TxResultLength.raw[5]" 0 /end MEASUREMENT
/begin MEASUREMENT SecOC_TxResultLength_BMC_HV_14_SOK_XIX_HCP5_CANFD01_572f8cfc_Tx "The element: BMC_HV_14_SOK_XIX_HCP5_CANFD01_572f8cfc_Tx of SecOC_TxResultLength" ULONG NO_COMPU_METHOD 0 0 0 4294967295 ECU_ADDRESS 0x0 SYMBOL_LINK "SecOC_TxResultLength.raw[6]" 0 /end MEASUREMENT
/begin MEASUREMENT SecOC_TxResultLength_OBD_Hybrid_01_SOK_XIX_HCP5_CANFD01_86ce2f2e_Tx "The element: OBD_Hybrid_01_SOK_XIX_HCP5_CANFD01_86ce2f2e_Tx of SecOC_TxResultLength" ULONG NO_COMPU_METHOD 0 0 0 4294967295 ECU_ADDRESS 0x0 SYMBOL_LINK "SecOC_TxResultLength.raw[7]" 0 /end MEASUREMENT
/begin MEASUREMENT SecOC_TxSecuredPduInfo[0].TxPduInfoIdxOfTxSecuredPduInfo "" UBYTE NO_COMPU_METHOD 0 0 0 255 ECU_ADDRESS 0x0 /end MEASUREMENT
/begin MEASUREMENT SecOC_TxSecuredPduInfo[0].TxSecuredPduTypeOfTxSecuredPduInfo "" UBYTE SecOC_TxSecuredPduTypeOfTxSecuredPduInfoType 0 0 0 255 ECU_ADDRESS 0x0 /end MEASUREMENT
/begin MEASUREMENT SecOC_TxSecuredPduInfo[1].TxPduInfoIdxOfTxSecuredPduInfo "" UBYTE NO_COMPU_METHOD 0 0 0 255 ECU_ADDRESS 0x0 /end MEASUREMENT
/begin MEASUREMENT SecOC_TxSecuredPduInfo[1].TxSecuredPduTypeOfTxSecuredPduInfo "" UBYTE SecOC_TxSecuredPduTypeOfTxSecuredPduInfoType 0 0 0 255 ECU_ADDRESS 0x0 /end MEASUREMENT
/begin MEASUREMENT SecOC_TxSecuredPduInfo[2].TxPduInfoIdxOfTxSecuredPduInfo "" UBYTE NO_COMPU_METHOD 0 0 0 255 ECU_ADDRESS 0x0 /end MEASUREMENT
/begin MEASUREMENT SecOC_TxSecuredPduInfo[2].TxSecuredPduTypeOfTxSecuredPduInfo "" UBYTE SecOC_TxSecuredPduTypeOfTxSecuredPduInfoType 0 0 0 255 ECU_ADDRESS 0x0 /end MEASUREMENT
/begin MEASUREMENT SecOC_TxSecuredPduInfo[3].TxPduInfoIdxOfTxSecuredPduInfo "" UBYTE NO_COMPU_METHOD 0 0 0 255 ECU_ADDRESS 0x0 /end MEASUREMENT
/begin MEASUREMENT SecOC_TxSecuredPduInfo[3].TxSecuredPduTypeOfTxSecuredPduInfo "" UBYTE SecOC_TxSecuredPduTypeOfTxSecuredPduInfoType 0 0 0 255 ECU_ADDRESS 0x0 /end MEASUREMENT
/begin MEASUREMENT SecOC_TxSecuredPduInfo[4].TxPduInfoIdxOfTxSecuredPduInfo "" UBYTE NO_COMPU_METHOD 0 0 0 255 ECU_ADDRESS 0x0 /end MEASUREMENT
/begin MEASUREMENT SecOC_TxSecuredPduInfo[4].TxSecuredPduTypeOfTxSecuredPduInfo "" UBYTE SecOC_TxSecuredPduTypeOfTxSecuredPduInfoType 0 0 0 255 ECU_ADDRESS 0x0 /end MEASUREMENT
/begin MEASUREMENT SecOC_TxSecuredPduInfo[5].TxPduInfoIdxOfTxSecuredPduInfo "" UBYTE NO_COMPU_METHOD 0 0 0 255 ECU_ADDRESS 0x0 /end MEASUREMENT
/begin MEASUREMENT SecOC_TxSecuredPduInfo[5].TxSecuredPduTypeOfTxSecuredPduInfo "" UBYTE SecOC_TxSecuredPduTypeOfTxSecuredPduInfoType 0 0 0 255 ECU_ADDRESS 0x0 /end MEASUREMENT
/begin MEASUREMENT SecOC_TxSecuredPduInfo[6].TxPduInfoIdxOfTxSecuredPduInfo "" UBYTE NO_COMPU_METHOD 0 0 0 255 ECU_ADDRESS 0x0 /end MEASUREMENT
/begin MEASUREMENT SecOC_TxSecuredPduInfo[6].TxSecuredPduTypeOfTxSecuredPduInfo "" UBYTE SecOC_TxSecuredPduTypeOfTxSecuredPduInfoType 0 0 0 255 ECU_ADDRESS 0x0 /end MEASUREMENT
/begin MEASUREMENT SecOC_TxSecuredPduInfo[7].TxPduInfoIdxOfTxSecuredPduInfo "" UBYTE NO_COMPU_METHOD 0 0 0 255 ECU_ADDRESS 0x0 /end MEASUREMENT
/begin MEASUREMENT SecOC_TxSecuredPduInfo[7].TxSecuredPduTypeOfTxSecuredPduInfo "" UBYTE SecOC_TxSecuredPduTypeOfTxSecuredPduInfoType 0 0 0 255 ECU_ADDRESS 0x0 /end MEASUREMENT
/begin MEASUREMENT SecOC_TxTpWrittenBytesCounter "" UWORD NO_COMPU_METHOD 0 0 0 65535 ECU_ADDRESS 0x0 MATRIX_DIM 8 SYMBOL_LINK "SecOC_TxTpWrittenBytesCounter.raw" 0 /end MEASUREMENT
/begin MEASUREMENT SecOC_TxTpWrittenBytesCounter_BMC_HV_01_E2E_SOK_XIX_HCP5_CANFD01_ad756307_Tx "The element: BMC_HV_01_E2E_SOK_XIX_HCP5_CANFD01_ad756307_Tx of SecOC_TxTpWrittenBytesCounter" UWORD NO_COMPU_METHOD 0 0 0 65535 ECU_ADDRESS 0x0 SYMBOL_LINK "SecOC_TxTpWrittenBytesCounter.raw[0]" 0 /end MEASUREMENT
/begin MEASUREMENT SecOC_TxTpWrittenBytesCounter_BMC_HV_02_E2E_SOK_XIX_HCP5_CANFD01_5f228eff_Tx "The element: BMC_HV_02_E2E_SOK_XIX_HCP5_CANFD01_5f228eff_Tx of SecOC_TxTpWrittenBytesCounter" UWORD NO_COMPU_METHOD 0 0 0 65535 ECU_ADDRESS 0x0 SYMBOL_LINK "SecOC_TxTpWrittenBytesCounter.raw[1]" 0 /end MEASUREMENT
/begin MEASUREMENT SecOC_TxTpWrittenBytesCounter_BMC_HV_06_SOK_XIX_HCP5_CANFD01_e20cafa8_Tx "The element: BMC_HV_06_SOK_XIX_HCP5_CANFD01_e20cafa8_Tx of SecOC_TxTpWrittenBytesCounter" UWORD NO_COMPU_METHOD 0 0 0 65535 ECU_ADDRESS 0x0 SYMBOL_LINK "SecOC_TxTpWrittenBytesCounter.raw[2]" 0 /end MEASUREMENT
/begin MEASUREMENT SecOC_TxTpWrittenBytesCounter_BMC_HV_07_SOK_XIX_HCP5_CANFD01_f524cb68_Tx "The element: BMC_HV_07_SOK_XIX_HCP5_CANFD01_f524cb68_Tx of SecOC_TxTpWrittenBytesCounter" UWORD NO_COMPU_METHOD 0 0 0 65535 ECU_ADDRESS 0x0 SYMBOL_LINK "SecOC_TxTpWrittenBytesCounter.raw[3]" 0 /end MEASUREMENT
/begin MEASUREMENT SecOC_TxTpWrittenBytesCounter_BMC_HV_08_SOK_XIX_HCP5_CANFD01_29bed328_Tx "The element: BMC_HV_08_SOK_XIX_HCP5_CANFD01_29bed328_Tx of SecOC_TxTpWrittenBytesCounter" UWORD NO_COMPU_METHOD 0 0 0 65535 ECU_ADDRESS 0x0 SYMBOL_LINK "SecOC_TxTpWrittenBytesCounter.raw[4]" 0 /end MEASUREMENT
/begin MEASUREMENT SecOC_TxTpWrittenBytesCounter_BMC_HV_09_SOK_XIX_HCP5_CANFD01_3e96b7e8_Tx "The element: BMC_HV_09_SOK_XIX_HCP5_CANFD01_3e96b7e8_Tx of SecOC_TxTpWrittenBytesCounter" UWORD NO_COMPU_METHOD 0 0 0 65535 ECU_ADDRESS 0x0 SYMBOL_LINK "SecOC_TxTpWrittenBytesCounter.raw[5]" 0 /end MEASUREMENT
/begin MEASUREMENT SecOC_TxTpWrittenBytesCounter_BMC_HV_14_SOK_XIX_HCP5_CANFD01_572f8cfc_Tx "The element: BMC_HV_14_SOK_XIX_HCP5_CANFD01_572f8cfc_Tx of SecOC_TxTpWrittenBytesCounter" UWORD NO_COMPU_METHOD 0 0 0 65535 ECU_ADDRESS 0x0 SYMBOL_LINK "SecOC_TxTpWrittenBytesCounter.raw[6]" 0 /end MEASUREMENT
/begin MEASUREMENT SecOC_TxTpWrittenBytesCounter_OBD_Hybrid_01_SOK_XIX_HCP5_CANFD01_86ce2f2e_Tx "The element: OBD_Hybrid_01_SOK_XIX_HCP5_CANFD01_86ce2f2e_Tx of SecOC_TxTpWrittenBytesCounter" UWORD NO_COMPU_METHOD 0 0 0 65535 ECU_ADDRESS 0x0 SYMBOL_LINK "SecOC_TxTpWrittenBytesCounter.raw[7]" 0 /end MEASUREMENT
/begin MEASUREMENT SecOC_VerifyAttemptsCounter "" UWORD NO_COMPU_METHOD 0 0 0 65535 ECU_ADDRESS 0x0 MATRIX_DIM 3 SYMBOL_LINK "SecOC_VerifyAttemptsCounter.raw" 0 /end MEASUREMENT
/begin MEASUREMENT SecOC_VerifyAttemptsCounter_HVK_03_E2E_SOK_XIX_HCP5_CANFD01_32c3c9b9_Rx "The element: HVK_03_E2E_SOK_XIX_HCP5_CANFD01_32c3c9b9_Rx of SecOC_VerifyAttemptsCounter" UWORD NO_COMPU_METHOD 0 0 0 65535 ECU_ADDRESS 0x0 SYMBOL_LINK "SecOC_VerifyAttemptsCounter.raw[0]" 0 /end MEASUREMENT
/begin MEASUREMENT SecOC_VerifyAttemptsCounter_OBD_HCP1_SOK_XIX_HCP5_CANFD01_499f5f1b_Rx "The element: OBD_HCP1_SOK_XIX_HCP5_CANFD01_499f5f1b_Rx of SecOC_VerifyAttemptsCounter" UWORD NO_COMPU_METHOD 0 0 0 65535 ECU_ADDRESS 0x0 SYMBOL_LINK "SecOC_VerifyAttemptsCounter.raw[1]" 0 /end MEASUREMENT
/begin MEASUREMENT SecOC_VerifyAttemptsCounter_SOK_Zeit_Hybrid_01_Resp_01_SOK_XIX_HCP5_CANFD01_92adacdc_Rx "The element: SOK_Zeit_Hybrid_01_Resp_01_SOK_XIX_HCP5_CANFD01_92adacdc_Rx of SecOC_VerifyAttemptsCounter" UWORD NO_COMPU_METHOD 0 0 0 65535 ECU_ADDRESS 0x0 SYMBOL_LINK "SecOC_VerifyAttemptsCounter.raw[2]" 0 /end MEASUREMENT
/begin MEASUREMENT SecOC_VerifyOverrideStatus "" UBYTE SecOC_VerifyOverrideStatusType 0 0 0 255 ECU_ADDRESS 0x0 MATRIX_DIM 3 SYMBOL_LINK "SecOC_VerifyOverrideStatus.raw" 0 /end MEASUREMENT
/begin MEASUREMENT SecOC_VerifyOverrideStatus_HVK_03_E2E_SOK_XIX_HCP5_CANFD01_32c3c9b9_Rx "The element: HVK_03_E2E_SOK_XIX_HCP5_CANFD01_32c3c9b9_Rx of SecOC_VerifyOverrideStatus" UBYTE SecOC_VerifyOverrideStatusType 0 0 0 255 ECU_ADDRESS 0x0 SYMBOL_LINK "SecOC_VerifyOverrideStatus.raw[1]" 0 /end MEASUREMENT
/begin MEASUREMENT SecOC_VerifyOverrideStatus_OBD_HCP1_SOK_XIX_HCP5_CANFD01_499f5f1b_Rx "The element: OBD_HCP1_SOK_XIX_HCP5_CANFD01_499f5f1b_Rx of SecOC_VerifyOverrideStatus" UBYTE SecOC_VerifyOverrideStatusType 0 0 0 255 ECU_ADDRESS 0x0 SYMBOL_LINK "SecOC_VerifyOverrideStatus.raw[2]" 0 /end MEASUREMENT
/begin MEASUREMENT SecOC_VerifyOverrideStatus_SOK_Zeit_Hybrid_01_Resp_01_SOK_XIX_HCP5_CANFD01_92adacdc_Rx "The element: SOK_Zeit_Hybrid_01_Resp_01_SOK_XIX_HCP5_CANFD01_92adacdc_Rx of SecOC_VerifyOverrideStatus" UBYTE SecOC_VerifyOverrideStatusType 0 0 0 255 ECU_ADDRESS 0x0 SYMBOL_LINK "SecOC_VerifyOverrideStatus.raw[0]" 0 /end MEASUREMENT
/begin COMPU_METHOD CM_ZM_HV_Auszeit "" TAB_INTP "%10.1" "Unit_Minut" COMPU_TAB_REF CM_ZM_HV_Auszeit STATUS_STRING_REF CM_ZM_HV_Auszeit.StatusText /end COMPU_METHOD
/begin COMPU_METHOD CM_ZM_HV_Auszeit_HiRes "" TAB_INTP "%10.1" "Unit_Minut" COMPU_TAB_REF CM_ZM_HV_Auszeit_HiRes STATUS_STRING_REF CM_ZM_HV_Auszeit_HiRes.StatusText /end COMPU_METHOD
/begin COMPU_METHOD CM_ZM_HV_Auszeit_Status "" TAB_VERB "%10.1" "" COMPU_TAB_REF CM_ZM_HV_Auszeit_Status /end COMPU_METHOD
/begin COMPU_METHOD ComM_ModeType "" TAB_VERB "%10.1" "" COMPU_TAB_REF ComM_ModeType /end COMPU_METHOD
/begin COMPU_METHOD ComM_ModeType_Copy1 "" TAB_VERB "%10.1" "" COMPU_TAB_REF ComM_ModeType_Copy1 /end COMPU_METHOD
/begin COMPU_METHOD CompuMethod_boolean "" TAB_VERB "%10.1" "" COMPU_TAB_REF CompuMethod_boolean /end COMPU_METHOD
/begin COMPU_METHOD Crypto_OperationModeType "" TAB_VERB "%10.1" "" COMPU_TAB_REF Crypto_OperationModeType /end COMPU_METHOD
/begin COMPU_METHOD Crypto_ResultType "" TAB_VERB "%10.1" "" COMPU_TAB_REF Crypto_ResultType /end COMPU_METHOD
/begin COMPU_METHOD Crypto_VerifyResultType "" TAB_VERB "%10.1" "" COMPU_TAB_REF Crypto_VerifyResultType /end COMPU_METHOD
/begin COMPU_METHOD Crypto_VerifyResultType_Copy1 "" TAB_VERB "%10.1" "" COMPU_TAB_REF Crypto_VerifyResultType_Copy1 /end COMPU_METHOD
/begin COMPU_METHOD Csm_KeyElementEnumType "" TAB_VERB "%10.1" "" COMPU_TAB_REF Csm_KeyElementEnumType /end COMPU_METHOD
/begin COMPU_METHOD Csm_ResultType "" TAB_VERB "%10.1" "" COMPU_TAB_REF Csm_ResultType /end COMPU_METHOD
/begin COMPU_METHOD Csm_VerifyResultType "" TAB_VERB "%10.1" "" COMPU_TAB_REF Csm_VerifyResultType /end COMPU_METHOD
/begin COMPU_METHOD Dcm_CommunicationModeType "" TAB_VERB "%10.1" "" COMPU_TAB_REF Dcm_CommunicationModeType /end COMPU_METHOD
/begin COMPU_METHOD Dcm_ConfirmationStatusType "" TAB_VERB "%10.1" "" COMPU_TAB_REF Dcm_ConfirmationStatusType /end COMPU_METHOD
/begin COMPU_METHOD Dcm_ControlDtcSettingType "" TAB_VERB "%10.1" "" COMPU_TAB_REF Dcm_ControlDtcSettingType /end COMPU_METHOD
/begin COMPU_METHOD Dcm_DiagnosticSessionControlType "" TAB_VERB "%10.1" "" COMPU_TAB_REF Dcm_DiagnosticSessionControlType /end COMPU_METHOD
/begin COMPU_METHOD Dcm_EcuResetType "" TAB_VERB "%10.1" "" COMPU_TAB_REF Dcm_EcuResetType /end COMPU_METHOD
/begin COMPU_METHOD Dcm_NegativeResponseCodeType "" TAB_VERB "%10.1" "" COMPU_TAB_REF Dcm_NegativeResponseCodeType /end COMPU_METHOD
/begin COMPU_METHOD Dcm_NegativeResponseCodeType_Copy1 "" TAB_VERB "%10.1" "" COMPU_TAB_REF Dcm_NegativeResponseCodeType_Copy1 /end COMPU_METHOD
/begin COMPU_METHOD Dcm_NegativeResponseCodeType_Copy2 "" TAB_VERB "%10.1" "" COMPU_TAB_REF Dcm_NegativeResponseCodeType_Copy2 /end COMPU_METHOD
/begin COMPU_METHOD Dcm_OpStatusType "" TAB_VERB "%10.1" "" COMPU_TAB_REF Dcm_OpStatusType /end COMPU_METHOD
/begin COMPU_METHOD Dcm_OpStatusType_Copy1 "" TAB_VERB "%10.1" "" COMPU_TAB_REF Dcm_OpStatusType_Copy1 /end COMPU_METHOD
/begin COMPU_METHOD Dcm_ProtocolType "" TAB_VERB "%10.1" "" COMPU_TAB_REF Dcm_ProtocolType /end COMPU_METHOD
/begin COMPU_METHOD Dcm_RequestKindType "" TAB_VERB "%10.1" "" COMPU_TAB_REF Dcm_RequestKindType /end COMPU_METHOD
/begin COMPU_METHOD Dcm_SecLevelType "" TAB_VERB "%10.1" "" COMPU_TAB_REF Dcm_SecLevelType /end COMPU_METHOD
/begin COMPU_METHOD Dcm_SesCtrlType "" TAB_VERB "%10.1" "" COMPU_TAB_REF Dcm_SesCtrlType /end COMPU_METHOD
/begin COMPU_METHOD Dem_DTCFormatType "" TAB_VERB "%10.1" "" COMPU_TAB_REF Dem_DTCFormatType /end COMPU_METHOD
/begin COMPU_METHOD SecOC_AuthDataFreshnessOfRxPduInfoType "" TAB_VERB "%10.1" "" COMPU_TAB_REF SecOC_AuthDataFreshnessOfRxPduInfoType /end COMPU_METHOD
/begin COMPU_METHOD SecOC_AuthenticExternalIdOfRxPduInfoType "" TAB_VERB "%10.1" "" COMPU_TAB_REF SecOC_AuthenticExternalIdOfRxPduInfoType /end COMPU_METHOD
/begin COMPU_METHOD SecOC_AuthenticExternalIdOfTxPduInfoType "" TAB_VERB "%10.1" "" COMPU_TAB_REF SecOC_AuthenticExternalIdOfTxPduInfoType /end COMPU_METHOD
/begin COMPU_METHOD SecOC_AuthenticPduDataContainerAuthenticPduEndIdxOfRxPduInfoType "" TAB_VERB "%10.1" "" COMPU_TAB_REF SecOC_AuthenticPduDataContainerAuthenticPduEndIdxOfRxPduInfoType /end COMPU_METHOD
/begin COMPU_METHOD SecOC_AuthenticPduDataContainerAuthenticPduEndIdxOfTxPduInfoType "" TAB_VERB "%10.1" "" COMPU_TAB_REF SecOC_AuthenticPduDataContainerAuthenticPduEndIdxOfTxPduInfoType /end COMPU_METHOD
/begin COMPU_METHOD SecOC_AuthenticPduDataContainerAuthenticPduStartIdxOfRxPduInfoType "" TAB_VERB "%10.1" "" COMPU_TAB_REF SecOC_AuthenticPduDataContainerAuthenticPduStartIdxOfRxPduInfoType /end COMPU_METHOD
/begin COMPU_METHOD SecOC_AuthenticPduDataContainerAuthenticPduStartIdxOfTxPduInfoType "" TAB_VERB "%10.1" "" COMPU_TAB_REF SecOC_AuthenticPduDataContainerAuthenticPduStartIdxOfTxPduInfoType /end COMPU_METHOD
/begin COMPU_METHOD SecOC_AuthenticPduDataContainerFreshnessVerifyValueEndIdxOfRxPduInfoType "" TAB_VERB "%10.1" "" COMPU_TAB_REF SecOC_AuthenticPduDataContainerFreshnessVerifyValueEndIdxOfRxPduInfoType /end COMPU_METHOD
/begin COMPU_METHOD SecOC_AuthenticPduDataContainerFreshnessVerifyValueEndIdxOfTxPduInfoType "" TAB_VERB "%10.1" "" COMPU_TAB_REF SecOC_AuthenticPduDataContainerFreshnessVerifyValueEndIdxOfTxPduInfoType /end COMPU_METHOD
/begin COMPU_METHOD SecOC_AuthenticPduDataContainerFreshnessVerifyValueStartIdxOfRxPduInfoType "" TAB_VERB "%10.1" "" COMPU_TAB_REF SecOC_AuthenticPduDataContainerFreshnessVerifyValueStartIdxOfRxPduInfoType /end COMPU_METHOD
/begin COMPU_METHOD SecOC_AuthenticPduDataContainerFreshnessVerifyValueStartIdxOfTxPduInfoType "" TAB_VERB "%10.1" "" COMPU_TAB_REF SecOC_AuthenticPduDataContainerFreshnessVerifyValueStartIdxOfTxPduInfoType /end COMPU_METHOD
/begin COMPU_METHOD SecOC_AuthenticPduDataContainerFullAuthenticPduEndIdxOfTxPduInfoType "" TAB_VERB "%10.1" "" COMPU_TAB_REF SecOC_AuthenticPduDataContainerFullAuthenticPduEndIdxOfTxPduInfoType /end COMPU_METHOD
/begin COMPU_METHOD SecOC_AuthenticPduDataContainerFullAuthenticPduStartIdxOfTxPduInfoType "" TAB_VERB "%10.1" "" COMPU_TAB_REF SecOC_AuthenticPduDataContainerFullAuthenticPduStartIdxOfTxPduInfoType /end COMPU_METHOD
/begin COMPU_METHOD SecOC_ClientServerVerificationStatusPropagationModeOfRxPduInfoType "" TAB_VERB "%10.1" "" COMPU_TAB_REF SecOC_ClientServerVerificationStatusPropagationModeOfRxPduInfoType /end COMPU_METHOD
/begin COMPU_METHOD SecOC_ConfirmationNeededOfTxPduInfoType "" TAB_VERB "%10.1" "" COMPU_TAB_REF SecOC_ConfirmationNeededOfTxPduInfoType /end COMPU_METHOD
/begin COMPU_METHOD SecOC_InitializedType "" TAB_VERB "%10.1" "" COMPU_TAB_REF SecOC_InitializedType /end COMPU_METHOD
/begin COMPU_METHOD SecOC_LowerLayerPduTypeOfTxPduInfoType "" TAB_VERB "%10.1" "" COMPU_TAB_REF SecOC_LowerLayerPduTypeOfTxPduInfoType /end COMPU_METHOD
/begin COMPU_METHOD SecOC_MessageTypeOfRxSecuredPduInfoType "" TAB_VERB "%10.1" "" COMPU_TAB_REF SecOC_MessageTypeOfRxSecuredPduInfoType /end COMPU_METHOD
/begin COMPU_METHOD SecOC_PduProcessingOfRxPduInfoType "" TAB_VERB "%10.1" "" COMPU_TAB_REF SecOC_PduProcessingOfRxPduInfoType /end COMPU_METHOD
/begin COMPU_METHOD SecOC_PduProcessingOfTxPduInfoType "" TAB_VERB "%10.1" "" COMPU_TAB_REF SecOC_PduProcessingOfTxPduInfoType /end COMPU_METHOD
/begin COMPU_METHOD SecOC_PduTypeOfRxPduInfoType "" TAB_VERB "%10.1" "" COMPU_TAB_REF SecOC_PduTypeOfRxPduInfoType /end COMPU_METHOD
/begin COMPU_METHOD SecOC_PduTypeOfTxPduInfoType "" TAB_VERB "%10.1" "" COMPU_TAB_REF SecOC_PduTypeOfTxPduInfoType /end COMPU_METHOD
/begin COMPU_METHOD SecOC_ProvideTruncTxFreshnessOfTxPduInfoType "" TAB_VERB "%10.1" "" COMPU_TAB_REF SecOC_ProvideTruncTxFreshnessOfTxPduInfoType /end COMPU_METHOD
/begin COMPU_METHOD SecOC_RxPduStateType "" TAB_VERB "%10.1" "" COMPU_TAB_REF SecOC_RxPduStateType /end COMPU_METHOD
/begin COMPU_METHOD SecOC_SecuredExternalIdOfTxPduInfoType "" TAB_VERB "%10.1" "" COMPU_TAB_REF SecOC_SecuredExternalIdOfTxPduInfoType /end COMPU_METHOD
/begin COMPU_METHOD SecOC_SecuredPduDataContainerAuthInfoDataEndIdxOfTxPduInfoType "" TAB_VERB "%10.1" "" COMPU_TAB_REF SecOC_SecuredPduDataContainerAuthInfoDataEndIdxOfTxPduInfoType /end COMPU_METHOD
/begin COMPU_METHOD SecOC_SecuredPduDataContainerAuthInfoDataStartIdxOfTxPduInfoType "" TAB_VERB "%10.1" "" COMPU_TAB_REF SecOC_SecuredPduDataContainerAuthInfoDataStartIdxOfTxPduInfoType /end COMPU_METHOD
/begin COMPU_METHOD SecOC_SecuredPduDataContainerAuthenticPduEndIdxOfRxPduInfoType "" TAB_VERB "%10.1" "" COMPU_TAB_REF SecOC_SecuredPduDataContainerAuthenticPduEndIdxOfRxPduInfoType /end COMPU_METHOD
/begin COMPU_METHOD SecOC_SecuredPduDataContainerAuthenticPduEndIdxOfTxPduInfoType "" TAB_VERB "%10.1" "" COMPU_TAB_REF SecOC_SecuredPduDataContainerAuthenticPduEndIdxOfTxPduInfoType /end COMPU_METHOD
/begin COMPU_METHOD SecOC_SecuredPduDataContainerAuthenticPduStartIdxOfRxPduInfoType "" TAB_VERB "%10.1" "" COMPU_TAB_REF SecOC_SecuredPduDataContainerAuthenticPduStartIdxOfRxPduInfoType /end COMPU_METHOD
/begin COMPU_METHOD SecOC_SecuredPduDataContainerAuthenticPduStartIdxOfTxPduInfoType "" TAB_VERB "%10.1" "" COMPU_TAB_REF SecOC_SecuredPduDataContainerAuthenticPduStartIdxOfTxPduInfoType /end COMPU_METHOD
/begin COMPU_METHOD SecOC_SecuredPduDataContainerSecuredPduEndIdxOfRxPduInfoType "" TAB_VERB "%10.1" "" COMPU_TAB_REF SecOC_SecuredPduDataContainerSecuredPduEndIdxOfRxPduInfoType /end COMPU_METHOD
/begin COMPU_METHOD SecOC_SecuredPduDataContainerSecuredPduEndIdxOfTxPduInfoType "" TAB_VERB "%10.1" "" COMPU_TAB_REF SecOC_SecuredPduDataContainerSecuredPduEndIdxOfTxPduInfoType /end COMPU_METHOD
/begin COMPU_METHOD SecOC_SecuredPduDataContainerSecuredPduStartIdxOfRxPduInfoType "" TAB_VERB "%10.1" "" COMPU_TAB_REF SecOC_SecuredPduDataContainerSecuredPduStartIdxOfRxPduInfoType /end COMPU_METHOD
/begin COMPU_METHOD SecOC_SecuredPduDataContainerSecuredPduStartIdxOfTxPduInfoType "" TAB_VERB "%10.1" "" COMPU_TAB_REF SecOC_SecuredPduDataContainerSecuredPduStartIdxOfTxPduInfoType /end COMPU_METHOD
/begin COMPU_METHOD SecOC_SecuredPduDataContainerTpSecuredPduEndIdxOfRxPduInfoType "" TAB_VERB "%10.1" "" COMPU_TAB_REF SecOC_SecuredPduDataContainerTpSecuredPduEndIdxOfRxPduInfoType /end COMPU_METHOD
/begin COMPU_METHOD SecOC_SecuredPduDataContainerTpSecuredPduStartIdxOfRxPduInfoType "" TAB_VERB "%10.1" "" COMPU_TAB_REF SecOC_SecuredPduDataContainerTpSecuredPduStartIdxOfRxPduInfoType /end COMPU_METHOD
/begin COMPU_METHOD SecOC_SecuredPduDataContainerTruncatedAuthenticatorEndIdxOfRxPduInfoType "" TAB_VERB "%10.1" "" COMPU_TAB_REF SecOC_SecuredPduDataContainerTruncatedAuthenticatorEndIdxOfRxPduInfoType /end COMPU_METHOD
/begin COMPU_METHOD SecOC_SecuredPduDataContainerTruncatedAuthenticatorEndIdxOfTxPduInfoType "" TAB_VERB "%10.1" "" COMPU_TAB_REF SecOC_SecuredPduDataContainerTruncatedAuthenticatorEndIdxOfTxPduInfoType /end COMPU_METHOD
/begin COMPU_METHOD SecOC_SecuredPduDataContainerTruncatedAuthenticatorStartIdxOfRxPduInfoType "" TAB_VERB "%10.1" "" COMPU_TAB_REF SecOC_SecuredPduDataContainerTruncatedAuthenticatorStartIdxOfRxPduInfoType /end COMPU_METHOD
/begin COMPU_METHOD SecOC_SecuredPduDataContainerTruncatedAuthenticatorStartIdxOfTxPduInfoType "" TAB_VERB "%10.1" "" COMPU_TAB_REF SecOC_SecuredPduDataContainerTruncatedAuthenticatorStartIdxOfTxPduInfoType /end COMPU_METHOD
/begin COMPU_METHOD SecOC_TransmitRequestType "" TAB_VERB "%10.1" "" COMPU_TAB_REF SecOC_TransmitRequestType /end COMPU_METHOD
/begin COMPU_METHOD SecOC_TxPduStateType "" TAB_VERB "%10.1" "" COMPU_TAB_REF SecOC_TxPduStateType /end COMPU_METHOD
/begin COMPU_METHOD SecOC_TxSecuredPduTypeOfTxSecuredPduInfoType "" TAB_VERB "%10.1" "" COMPU_TAB_REF SecOC_TxSecuredPduTypeOfTxSecuredPduInfoType /end COMPU_METHOD
/begin COMPU_METHOD SecOC_VerificationStatusPropagationModeOfRxPduInfoType "" TAB_VERB "%10.1" "" COMPU_TAB_REF SecOC_VerificationStatusPropagationModeOfRxPduInfoType /end COMPU_METHOD
/begin COMPU_METHOD SecOC_VerificationStatusWithSecuredPduPropagationModeOfRxPduInfoType "" TAB_VERB "%10.1" "" COMPU_TAB_REF SecOC_VerificationStatusWithSecuredPduPropagationModeOfRxPduInfoType /end COMPU_METHOD
/begin COMPU_METHOD SecOC_VerifyOverrideStatusType "" TAB_VERB "%10.1" "" COMPU_TAB_REF SecOC_VerifyOverrideStatusType /end COMPU_METHOD
/begin COMPU_TAB CM_ZM_HV_Auszeit "" TAB_INTP 2 0 0 4093 16372 /end COMPU_TAB
/begin COMPU_VTAB CM_ZM_HV_Auszeit.StatusText "" TAB_VERB 2 4094 "CM_ZM_HV_Auszeit_Cxffe_Init" 4095 "CM_ZM_HV_Auszeit_Cxfff_Fehler" /end COMPU_VTAB
/begin COMPU_TAB CM_ZM_HV_Auszeit_HiRes "" TAB_INTP 2 0 0 65533 32766.5 /end COMPU_TAB
/begin COMPU_VTAB CM_ZM_HV_Auszeit_HiRes.StatusText "" TAB_VERB 2 65534 "CM_ZM_HV_Auszeit_HiRes_Cxfffe_Init" 65535 "CM_ZM_HV_Auszeit_HiRes_Cxffff_Fehler" /end COMPU_VTAB
/begin COMPU_VTAB CM_ZM_HV_Auszeit_Status "" TAB_VERB 4 0 "CM_ZM_HV_Auszeit_Status_Cx0_nicht_berechnet" 1 "CM_ZM_HV_Auszeit_Status_Cx1_berechnet" 2 "CM_ZM_HV_Auszeit_Status_Cx2_Minimalwert" 3 "CM_ZM_HV_Auszeit_Status_Cx3_ungueltig" /end COMPU_VTAB
/begin COMPU_VTAB ComM_ModeType "" TAB_VERB 3 0 "COMM_NO_COMMUNICATION" 1 "COMM_SILENT_COMMUNICATION" 2 "COMM_FULL_COMMUNICATION" /end COMPU_VTAB
/begin COMPU_VTAB ComM_ModeType_Copy1 "" TAB_VERB 3 0 "COMM_NO_COMMUNICATION" 1 "COMM_SILENT_COMMUNICATION" 2 "COMM_FULL_COMMUNICATION" /end COMPU_VTAB
/begin COMPU_VTAB CompuMethod_boolean "" TAB_VERB 2 0 "CompuMethod_boolean_false" 1 "CompuMethod_boolean_true" /end COMPU_VTAB
/begin COMPU_VTAB Crypto_OperationModeType "" TAB_VERB 5 1 "CRYPTO_OPERATIONMODE_START" 2 "CRYPTO_OPERATIONMODE_UPDATE" 3 "CRYPTO_OPERATIONMODE_STREAMSTART" 4 "CRYPTO_OPERATIONMODE_FINISH" 7 "CRYPTO_OPERATIONMODE_SINGLECALL" /end COMPU_VTAB
/begin COMPU_VTAB Crypto_ResultType "" TAB_VERB 10 1 "E_NOT_OK" 2 "CRYPTO_E_BUSY" 4 "CRYPTO_E_ENTROPY_EXHAUSTED" 6 "CRYPTO_E_KEY_READ_FAIL" 7 "CRYPTO_E_KEY_WRITE_FAIL" 8 "CRYPTO_E_KEY_NOT_AVAILABLE" 9 "CRYPTO_E_KEY_NOT_VALID" 10 "CRYPTO_E_KEY_SIZE_MISMATCH" 12 "CRYPTO_E_JOB_CANCELED" 13 "CRYPTO_E_KEY_EMPTY" /end COMPU_VTAB
/begin COMPU_VTAB Crypto_VerifyResultType "" TAB_VERB 2 0 "CRYPTO_E_VER_OK" 1 "CRYPTO_E_VER_NOT_OK" /end COMPU_VTAB
/begin COMPU_VTAB Crypto_VerifyResultType_Copy1 "" TAB_VERB 2 0 "CRYPTO_E_VER_OK" 1 "CRYPTO_E_VER_NOT_OK" /end COMPU_VTAB
/begin COMPU_VTAB Csm_KeyElementEnumType "" TAB_VERB 39 0 "CRYPTO_KE_CERTIFICATE_DATA" 1 "CRYPTO_KE_MAC_KEY" 1 "CRYPTO_KE_SIGNATURE_KEY" 1 "CRYPTO_KE_CIPHER_KEY" 1 "CRYPTO_KE_KEYEXCHANGE_SHAREDVALUE" 1 "CYRPTO_KE_KEYEXCHANGE_SHAREDVALUE" 1 "CRYPTO_KE_KEYDERIVATION_PASSWORD" 1 "CRYPTO_KE_KEYGENERATE_KEY" 1 "CRYPTO_KE_CERTIFICATE_SUBJECT_PUBLIC_KEY" 2 "CRYPTO_KE_MAC_PROOF" 3 "CRYPTO_KE_RANDOM_SEED_STATE" 4 "CRYPTO_KE_RANDOM_ALGORITHM" 5 "CRYPTO_KE_CIPHER_IV" 6 "CRYPTO_KE_CIPHER_PROOF" 7 "CRYPTO_KE_CIPHER_2NDKEY" 8 "CRYPTO_KE_KEYEXCHANGE_BASE" 9 "CRYPTO_KE_KEYEXCHANGE_PRIVKEY" 10 "CRYPTO_KE_KEYEXCHANGE_OWNPUBKEY" 12 "CRYPTO_KE_KEYEXCHANGE_ALGORITHM" 13 "CRYPTO_KE_KEYDERIVATION_SALT" 14 "CRYPTO_KE_KEYDERIVATION_ITERATIONS" 15 "CRYPTO_KE_KEYDERIVATION_ALGORITHM" 16 "CRYPTO_KE_KEYGENERATE_SEED" 17 "CRYPTO_KE_KEYGENERATE_ALGORITHM" 18 "CRYPTO_KE_CERTIFICATE_PARSING_FORMAT" 19 "CRYPTO_KE_CERTIFICATE_CURRENT_TIME" 20 "CRYPTO_KE_CERTIFICATE_VERSION" 21 "CRYPTO_KE_CERTIFICATE_SERIALNUMBER" 22 "CRYPTO_KE_CERTIFICATE_SIGNATURE_ALGORITHM" 23 "CRYPTO_KE_CERTIFICATE_ISSUER" 24 "CRYPTO_KE_CERTIFICATE_VALIDITY_NOT_BEFORE" 25 "CRYPTO_KE_CERTIFICATE_VALIDITY_NOT_AFTER" 26 "CRYPTO_KE_CERTIFICATE_SUBJECT" 27 "CRYPTO_KE_CERTIFICATE_EXTENSIONS" 28 "CRYPTO_KE_CERTIFICATE_SIGNATURE" 29 "CRYPTO_KE_SIGNATURE_CURVETYPE" 29 "CRYPTO_KE_KEYEXCHANGE_CURVETYPE" 29 "CRYPTO_KE_KEYDERIVATION_CURVETYPE" 29 "CRYPTO_KE_KEYGENERATE_CURVETYPE" /end COMPU_VTAB
/begin COMPU_VTAB Csm_ResultType "" TAB_VERB 7 1 "E_NOT_OK" 2 "E_SMALL_BUFFER" 3 "E_ENTROPY_EXHAUSTION" 4 "E_KEY_READ_FAIL" 5 "E_KEY_NOT_AVAILABLE" 6 "E_KEY_NOT_VALID" 7 "E_JOB_CANCELED" /end COMPU_VTAB
/begin COMPU_VTAB Csm_VerifyResultType "" TAB_VERB 2 0 "CRYPTO_E_VER_OK" 1 "CRYPTO_E_VER_NOT_OK" /end COMPU_VTAB
/begin COMPU_VTAB Dcm_CommunicationModeType "" TAB_VERB 12 0 "DCM_ENABLE_RX_TX_NORM" 1 "DCM_ENABLE_RX_DISABLE_TX_NORM" 2 "DCM_DISABLE_RX_ENABLE_TX_NORM" 3 "DCM_DISABLE_RX_TX_NORMAL" 4 "DCM_ENABLE_RX_TX_NM" 5 "DCM_ENABLE_RX_DISABLE_TX_NM" 6 "DCM_DISABLE_RX_ENABLE_TX_NM" 7 "DCM_DISABLE_RX_TX_NM" 8 "DCM_ENABLE_RX_TX_NORM_NM" 9 "DCM_ENABLE_RX_DISABLE_TX_NORM_NM" 10 "DCM_DISABLE_RX_ENABLE_TX_NORM_NM" 11 "DCM_DISABLE_RX_TX_NORM_NM" /end COMPU_VTAB
/begin COMPU_VTAB Dcm_ConfirmationStatusType "" TAB_VERB 4 0 "DCM_RES_POS_OK" 1 "DCM_RES_POS_NOT_OK" 2 "DCM_RES_NEG_OK" 3 "DCM_RES_NEG_NOT_OK" /end COMPU_VTAB
/begin COMPU_VTAB Dcm_ControlDtcSettingType "" TAB_VERB 2 0 "DCM_ENUM_ENABLEDTCSETTING" 1 "DCM_ENUM_DISABLEDTCSETTING" /end COMPU_VTAB
/begin COMPU_VTAB Dcm_DiagnosticSessionControlType "" TAB_VERB 3 1 "DCM_ENUM_DEFAULT_SESSION" 2 "DCM_ENUM_PROGRAMMING_SESSION" 3 "DCM_ENUM_EXTENDED_SESSION" /end COMPU_VTAB
/begin COMPU_VTAB Dcm_EcuResetType "" TAB_VERB 7 0 "DCM_ENUM_NONE" 1 "DCM_ENUM_HARD" 2 "DCM_ENUM_KEYONOFF" 3 "DCM_ENUM_SOFT" 4 "DCM_ENUM_JUMPTOBOOTLOADER" 5 "DCM_ENUM_JUMPTOSYSSUPPLIERBOOTLOADER" 6 "DCM_ENUM_EXECUTE" /end COMPU_VTAB
/begin COMPU_VTAB Dcm_NegativeResponseCodeType "" TAB_VERB 67 0 "DCM_E_POSITIVERESPONSE" 16 "DCM_E_GENERALREJECT" 17 "DCM_E_SERVICENOTSUPPORTED" 18 "DCM_E_SUBFUNCTIONNOTSUPPORTED" 19 "DCM_E_INCORRECTMESSAGELENGTHORINVALIDFORMAT" 20 "DCM_E_RESPONSETOOLONG" 33 "DCM_E_BUSYREPEATREQUEST" 34 "DCM_E_CONDITIONSNOTCORRECT" 36 "DCM_E_REQUESTSEQUENCEERROR" 37 "DCM_E_NORESPONSEFROMSUBNETCOMPONENT" 38 "DCM_E_FAILUREPREVENTSEXECUTIONOFREQUESTEDACTION" 49 "DCM_E_REQUESTOUTOFRANGE" 51 "DCM_E_SECURITYACCESSDENIED" 52 "DCM_E_AUTHENTICATIONREQUIRED" 53 "DCM_E_INVALIDKEY" 54 "DCM_E_EXCEEDNUMBEROFATTEMPTS" 55 "DCM_E_REQUIREDTIMEDELAYNOTEXPIRED" 80 "DCM_E_CVF_INVALIDTIMEPERIOD" 81 "DCM_E_CVF_INVALIDSIGNATURE" 82 "DCM_E_CVF_INVALIDCHAINOFTRUST" 83 "DCM_E_CVF_INVALIDTYPE" 84 "DCM_E_CVF_INVALIDFORMAT" 85 "DCM_E_CVF_INVALIDCONTENT" 86 "DCM_E_CVF_INVALIDSCOPE" 87 "DCM_E_CVF_INVALIDCERTIFICATEREVOKED" 88 "DCM_E_OWNERSHIPVERIFICATIONFAILED" 89 "DCM_E_CHALLENGECALCULATIONFAILED" 112 "DCM_E_UPLOADDOWNLOADNOTACCEPTED" 113 "DCM_E_TRANSFERDATASUSPENDED" 114 "DCM_E_GENERALPROGRAMMINGFAILURE" 115 "DCM_E_WRONGBLOCKSEQUENCECOUNTER" 120 "DCM_E_REQUESTCORRECTLYRECEIVEDRESPONSEPENDING" 126 "DCM_E_SUBFUNCTIONNOTSUPPORTEDINACTIVESESSION" 127 "DCM_E_SERVICENOTSUPPORTEDINACTIVESESSION" 129 "DCM_E_RPMTOOHIGH" 130 "DCM_E_RPMTOOLOW" 131 "DCM_E_ENGINEISRUNNING" 132 "DCM_E_ENGINEISNOTRUNNING" 133 "DCM_E_ENGINERUNTIMETOOLOW" 134 "DCM_E_TEMPERATURETOOHIGH" 135 "DCM_E_TEMPERATURETOOLOW" 136 "DCM_E_VEHICLESPEEDTOOHIGH" 137 "DCM_E_VEHICLESPEEDTOOLOW" 138 "DCM_E_THROTTLE_PEDALTOOHIGH" 139 "DCM_E_THROTTLE_PEDALTOOLOW" 140 "DCM_E_TRANSMISSIONRANGENOTINNEUTRAL" 141 "DCM_E_TRANSMISSIONRANGENOTINGEAR" 143 "DCM_E_BRAKESWITCH_NOTCLOSED" 144 "DCM_E_SHIFTERLEVERNOTINPARK" 145 "DCM_E_TORQUECONVERTERCLUTCHLOCKED" 146 "DCM_E_VOLTAGETOOHIGH" 147 "DCM_E_VOLTAGETOOLOW" 240 "DCM_E_VMSCNC_0" 241 "DCM_E_VMSCNC_1" 242 "DCM_E_VMSCNC_2" 243 "DCM_E_VMSCNC_3" 244 "DCM_E_VMSCNC_4" 245 "DCM_E_VMSCNC_5" 246 "DCM_E_VMSCNC_6" 247 "DCM_E_VMSCNC_7" 248 "DCM_E_VMSCNC_8" 249 "DCM_E_VMSCNC_9" 250 "DCM_E_VMSCNC_A" 251 "DCM_E_VMSCNC_B" 252 "DCM_E_VMSCNC_C" 253 "DCM_E_VMSCNC_D" 254 "DCM_E_VMSCNC_E" /end COMPU_VTAB
/begin COMPU_VTAB Dcm_NegativeResponseCodeType_Copy1 "" TAB_VERB 41 0 "DCM_E_POSITIVERESPONSE" 16 "DCM_E_GENERALREJECT" 17 "DCM_E_SERVICENOTSUPPORTED" 18 "DCM_E_SUBFUNCTIONNOTSUPPORTED" 19 "DCM_E_INCORRECTMESSAGELENGTHORINVALIDFORMAT" 20 "DCM_E_RESPONSETOOLONG" 33 "DCM_E_BUSYREPEATREQUEST" 34 "DCM_E_CONDITIONSNOTCORRECT" 36 "DCM_E_REQUESTSEQUENCEERROR" 37 "DCM_E_NORESPONSEFROMSUBNETCOMPONENT" 38 "DCM_E_FAILUREPREVENTSEXECUTIONOFREQUESTEDACTION" 49 "DCM_E_REQUESTOUTOFRANGE" 51 "DCM_E_SECURITYACCESSDENIED" 53 "DCM_E_INVALIDKEY" 54 "DCM_E_EXCEEDNUMBEROFATTEMPTS" 55 "DCM_E_REQUIREDTIMEDELAYNOTEXPIRED" 112 "DCM_E_UPLOADDOWNLOADNOTACCEPTED" 113 "DCM_E_TRANSFERDATASUSPENDED" 114 "DCM_E_GENERALPROGRAMMINGFAILURE" 115 "DCM_E_WRONGBLOCKSEQUENCECOUNTER" 120 "DCM_E_REQUESTCORRECTLYRECEIVEDRESPONSEPENDING" 126 "DCM_E_SUBFUNCTIONNOTSUPPORTEDINACTIVESESSION" 127 "DCM_E_SERVICENOTSUPPORTEDINACTIVESESSION" 129 "DCM_E_RPMTOOHIGH" 130 "DCM_E_RPMTOOLOW" 131 "DCM_E_ENGINEISRUNNING" 132 "DCM_E_ENGINEISNOTRUNNING" 133 "DCM_E_ENGINERUNTIMETOOLOW" 134 "DCM_E_TEMPERATURETOOHIGH" 135 "DCM_E_TEMPERATURETOOLOW" 136 "DCM_E_VEHICLESPEEDTOOHIGH" 137 "DCM_E_VEHICLESPEEDTOOLOW" 138 "DCM_E_THROTTLE_PEDALTOOHIGH" 139 "DCM_E_THROTTLE_PEDALTOOLOW" 140 "DCM_E_TRANSMISSIONRANGENOTINNEUTRAL" 141 "DCM_E_TRANSMISSIONRANGENOTINGEAR" 143 "DCM_E_BRAKESWITCH_NOTCLOSED" 144 "DCM_E_SHIFTERLEVERNOTINPARK" 145 "DCM_E_TORQUECONVERTERCLUTCHLOCKED" 146 "DCM_E_VOLTAGETOOHIGH" 147 "DCM_E_VOLTAGETOOLOW" /end COMPU_VTAB
/begin COMPU_VTAB Dcm_NegativeResponseCodeType_Copy2 "" TAB_VERB 56 0 "DCM_E_POSITIVERESPONSE" 16 "DCM_E_GENERALREJECT" 17 "DCM_E_SERVICENOTSUPPORTED" 18 "DCM_E_SUBFUNCTIONNOTSUPPORTED" 19 "DCM_E_INCORRECTMESSAGELENGTHORINVALIDFORMAT" 20 "DCM_E_RESPONSETOOLONG" 33 "DCM_E_BUSYREPEATREQUEST" 34 "DCM_E_CONDITIONSNOTCORRECT" 36 "DCM_E_REQUESTSEQUENCEERROR" 37 "DCM_E_NORESPONSEFROMSUBNETCOMPONENT" 38 "DCM_E_FAILUREPREVENTSEXECUTIONOFREQUESTEDACTION" 49 "DCM_E_REQUESTOUTOFRANGE" 51 "DCM_E_SECURITYACCESSDENIED" 53 "DCM_E_INVALIDKEY" 54 "DCM_E_EXCEEDNUMBEROFATTEMPTS" 55 "DCM_E_REQUIREDTIMEDELAYNOTEXPIRED" 112 "DCM_E_UPLOADDOWNLOADNOTACCEPTED" 113 "DCM_E_TRANSFERDATASUSPENDED" 114 "DCM_E_GENERALPROGRAMMINGFAILURE" 115 "DCM_E_WRONGBLOCKSEQUENCECOUNTER" 120 "DCM_E_REQUESTCORRECTLYRECEIVEDRESPONSEPENDING" 126 "DCM_E_SUBFUNCTIONNOTSUPPORTEDINACTIVESESSION" 127 "DCM_E_SERVICENOTSUPPORTEDINACTIVESESSION" 129 "DCM_E_RPMTOOHIGH" 130 "DCM_E_RPMTOOLOW" 131 "DCM_E_ENGINEISRUNNING" 132 "DCM_E_ENGINEISNOTRUNNING" 133 "DCM_E_ENGINERUNTIMETOOLOW" 134 "DCM_E_TEMPERATURETOOHIGH" 135 "DCM_E_TEMPERATURETOOLOW" 136 "DCM_E_VEHICLESPEEDTOOHIGH" 137 "DCM_E_VEHICLESPEEDTOOLOW" 138 "DCM_E_THROTTLE_PEDALTOOHIGH" 139 "DCM_E_THROTTLE_PEDALTOOLOW" 140 "DCM_E_TRANSMISSIONRANGENOTINNEUTRAL" 141 "DCM_E_TRANSMISSIONRANGENOTINGEAR" 143 "DCM_E_BRAKESWITCH_NOTCLOSED" 144 "DCM_E_SHIFTERLEVERNOTINPARK" 145 "DCM_E_TORQUECONVERTERCLUTCHLOCKED" 146 "DCM_E_VOLTAGETOOHIGH" 147 "DCM_E_VOLTAGETOOLOW" 240 "DCM_E_VMSCNC_0" 241 "DCM_E_VMSCNC_1" 242 "DCM_E_VMSCNC_2" 243 "DCM_E_VMSCNC_3" 244 "DCM_E_VMSCNC_4" 245 "DCM_E_VMSCNC_5" 246 "DCM_E_VMSCNC_6" 247 "DCM_E_VMSCNC_7" 248 "DCM_E_VMSCNC_8" 249 "DCM_E_VMSCNC_9" 250 "DCM_E_VMSCNC_A" 251 "DCM_E_VMSCNC_B" 252 "DCM_E_VMSCNC_C" 253 "DCM_E_VMSCNC_D" 254 "DCM_E_VMSCNC_E" /end COMPU_VTAB
/begin COMPU_VTAB Dcm_OpStatusType "" TAB_VERB 5 0 "DCM_INITIAL" 1 "DCM_PENDING" 2 "DCM_CANCEL" 3 "DCM_FORCE_RCRRP_OK" 64 "DCM_FORCE_RCRRP_NOT_OK" /end COMPU_VTAB
/begin COMPU_VTAB Dcm_OpStatusType_Copy1 "" TAB_VERB 5 0 "DCM_INITIAL" 1 "DCM_PENDING" 2 "DCM_CANCEL" 3 "DCM_FORCE_RCRRP_OK" 64 "DCM_FORCE_RCRRP_NOT_OK" /end COMPU_VTAB
/begin COMPU_VTAB Dcm_ProtocolType "" TAB_VERB 22 0 "DCM_OBD_ON_CAN" 1 "DCM_OBD_ON_FLEXRAY" 2 "DCM_OBD_ON_IP" 3 "DCM_UDS_ON_CAN" 4 "DCM_UDS_ON_FLEXRAY" 5 "DCM_UDS_ON_IP" 12 "DCM_NO_ACTIVE_PROTOCOL" 240 "DCM_SUPPLIER_1" 241 "DCM_SUPPLIER_2" 242 "DCM_SUPPLIER_3" 243 "DCM_SUPPLIER_4" 244 "DCM_SUPPLIER_5" 245 "DCM_SUPPLIER_6" 246 "DCM_SUPPLIER_7" 247 "DCM_SUPPLIER_8" 248 "DCM_SUPPLIER_9" 249 "DCM_SUPPLIER_10" 250 "DCM_SUPPLIER_11" 251 "DCM_SUPPLIER_12" 252 "DCM_SUPPLIER_13" 253 "DCM_SUPPLIER_14" 254 "DCM_SUPPLIER_15" /end COMPU_VTAB
/begin COMPU_VTAB Dcm_RequestKindType "" TAB_VERB 3 0 "DCM_REQ_KIND_NONE" 1 "DCM_REQ_KIND_EXTERNAL" 2 "DCM_REQ_KIND_ROE" /end COMPU_VTAB
/begin COMPU_VTAB Dcm_SecLevelType "" TAB_VERB 2 0 "DCM_SEC_LEV_LOCKED" 1 "DCM_SEC_LEV_L1" /end COMPU_VTAB
/begin COMPU_VTAB Dcm_SesCtrlType "" TAB_VERB 3 1 "DCM_DEFAULT_SESSION" 2 "DCM_PROGRAMMING_SESSION" 3 "DCM_EXTENDED_DIAGNOSTIC_SESSION" /end COMPU_VTAB
/begin COMPU_VTAB Dem_DTCFormatType "" TAB_VERB 3 0 "DEM_DTC_FORMAT_OBD" 1 "DEM_DTC_FORMAT_UDS" 2 "DEM_DTC_FORMAT_J1939" /end COMPU_VTAB
/begin COMPU_VTAB SecOC_AuthDataFreshnessOfRxPduInfoType "" TAB_VERB 2 0 "SECOC_USE_AUTHDATAFRESHNESSOFRXPDUINFO" 1 "SECOC_DONT_USE_AUTHDATAFRESHNESSOFRXPDUINFO" /end COMPU_VTAB
/begin COMPU_VTAB SecOC_AuthenticExternalIdOfRxPduInfoType "" TAB_VERB 1 255 "SECOC_NO_AUTHENTICEXTERNALIDOFRXPDUINFO" /end COMPU_VTAB
/begin COMPU_VTAB SecOC_AuthenticExternalIdOfTxPduInfoType "" TAB_VERB 1 255 "SECOC_NO_AUTHENTICEXTERNALIDOFTXPDUINFO" /end COMPU_VTAB
/begin COMPU_VTAB SecOC_AuthenticPduDataContainerAuthenticPduEndIdxOfRxPduInfoType "" TAB_VERB 1 255 "SECOC_NO_AUTHENTICPDUDATACONTAINERAUTHENTICPDUENDIDXOFRXPDUINFO" /end COMPU_VTAB
/begin COMPU_VTAB SecOC_AuthenticPduDataContainerAuthenticPduEndIdxOfTxPduInfoType "" TAB_VERB 1 65535 "SECOC_NO_AUTHENTICPDUDATACONTAINERAUTHENTICPDUENDIDXOFTXPDUINFO" /end COMPU_VTAB
/begin COMPU_VTAB SecOC_AuthenticPduDataContainerAuthenticPduStartIdxOfRxPduInfoType "" TAB_VERB 1 255 "SECOC_NO_AUTHENTICPDUDATACONTAINERAUTHENTICPDUSTARTIDXOFRXPDUINFO" /end COMPU_VTAB
/begin COMPU_VTAB SecOC_AuthenticPduDataContainerAuthenticPduStartIdxOfTxPduInfoType "" TAB_VERB 1 65535 "SECOC_NO_AUTHENTICPDUDATACONTAINERAUTHENTICPDUSTARTIDXOFTXPDUINFO" /end COMPU_VTAB
/begin COMPU_VTAB SecOC_AuthenticPduDataContainerFreshnessVerifyValueEndIdxOfRxPduInfoType "" TAB_VERB 1 255 "SECOC_NO_AUTHENTICPDUDATACONTAINERFRESHNESSVERIFYVALUEENDIDXOFRXPDUINFO" /end COMPU_VTAB
/begin COMPU_VTAB SecOC_AuthenticPduDataContainerFreshnessVerifyValueEndIdxOfTxPduInfoType "" TAB_VERB 1 65535 "SECOC_NO_AUTHENTICPDUDATACONTAINERFRESHNESSVERIFYVALUEENDIDXOFTXPDUINFO" /end COMPU_VTAB
/begin COMPU_VTAB SecOC_AuthenticPduDataContainerFreshnessVerifyValueStartIdxOfRxPduInfoType "" TAB_VERB 1 255 "SECOC_NO_AUTHENTICPDUDATACONTAINERFRESHNESSVERIFYVALUESTARTIDXOFRXPDUINFO" /end COMPU_VTAB
/begin COMPU_VTAB SecOC_AuthenticPduDataContainerFreshnessVerifyValueStartIdxOfTxPduInfoType "" TAB_VERB 1 65535 "SECOC_NO_AUTHENTICPDUDATACONTAINERFRESHNESSVERIFYVALUESTARTIDXOFTXPDUINFO" /end COMPU_VTAB
/begin COMPU_VTAB SecOC_AuthenticPduDataContainerFullAuthenticPduEndIdxOfTxPduInfoType "" TAB_VERB 1 65535 "SECOC_NO_AUTHENTICPDUDATACONTAINERFULLAUTHENTICPDUENDIDXOFTXPDUINFO" /end COMPU_VTAB
/begin COMPU_VTAB SecOC_AuthenticPduDataContainerFullAuthenticPduStartIdxOfTxPduInfoType "" TAB_VERB 1 65535 "SECOC_NO_AUTHENTICPDUDATACONTAINERFULLAUTHENTICPDUSTARTIDXOFTXPDUINFO" /end COMPU_VTAB
/begin COMPU_VTAB SecOC_ClientServerVerificationStatusPropagationModeOfRxPduInfoType "" TAB_VERB 1 2 "SECOC_NONE_CLIENTSERVERVERIFICATIONSTATUSPROPAGATIONMODEOFRXPDUINFO" /end COMPU_VTAB
/begin COMPU_VTAB_RANGE SecOC_ConfirmationNeededOfTxPduInfoType "" 2 0 0 "FALSE" 1 255 "TRUE" /end COMPU_VTAB_RANGE
/begin COMPU_VTAB_RANGE SecOC_InitializedType "" 2 0 0 "FALSE" 1 255 "TRUE" /end COMPU_VTAB_RANGE
/begin COMPU_VTAB SecOC_LowerLayerPduTypeOfTxPduInfoType "" TAB_VERB 1 0 "SECOC_IFPDU_LOWERLAYERPDUTYPEOFTXPDUINFO" /end COMPU_VTAB
/begin COMPU_VTAB SecOC_MessageTypeOfRxSecuredPduInfoType "" TAB_VERB 1 0 "SECOC_NORMAL_MESSAGETYPEOFRXSECUREDPDUINFO" /end COMPU_VTAB
/begin COMPU_VTAB SecOC_PduProcessingOfRxPduInfoType "" TAB_VERB 1 1 "SECOC_DEFERRED_PDUPROCESSINGOFRXPDUINFO" /end COMPU_VTAB
/begin COMPU_VTAB SecOC_PduProcessingOfTxPduInfoType "" TAB_VERB 1 1 "SECOC_DEFERRED_PDUPROCESSINGOFTXPDUINFO" /end COMPU_VTAB
/begin COMPU_VTAB SecOC_PduTypeOfRxPduInfoType "" TAB_VERB 1 0 "SECOC_IFPDU_PDUTYPEOFRXPDUINFO" /end COMPU_VTAB
/begin COMPU_VTAB SecOC_PduTypeOfTxPduInfoType "" TAB_VERB 1 0 "SECOC_IFPDU_PDUTYPEOFTXPDUINFO" /end COMPU_VTAB
/begin COMPU_VTAB SecOC_ProvideTruncTxFreshnessOfTxPduInfoType "" TAB_VERB 1 1 "SECOC_DONT_PROVIDE_PROVIDETRUNCTXFRESHNESSOFTXPDUINFO" /end COMPU_VTAB
/begin COMPU_VTAB SecOC_RxPduStateType "" TAB_VERB 12 0 "SECOC_IDLE_RXPDUSTATE" 1 "SECOC_COPYING_RXPDUSTATE" 2 "SECOC_VERIFIED_RXPDUSTATE" 3 "SECOC_COPY_AUTHENTIC_PDU_TO_DATA_TO_AUTHENTICATE_RXPDUSTATE" 4 "SECOC_FRESHNESS_VALUE_NEEDED_RXPDUSTATE" 5 "SECOC_ABORTED_RXPDUSTATE" 6 "SECOC_PRE_VERIFY_START_RXPDUSTATE" 7 "SECOC_UNVERIFIED_VERIFICATION_FINISHED_WAIT_FOR_CALLBACK_RXPDUSTATE" 16 "SECOC_UNVERIFIED_RXPDUSTATE" 16 "SECOC_UNVERIFIED_VERIFICATION_TO_BE_STARTED_RXPDUSTATE" 22 "SECOC_UNVERIFIED_VERIFICATION_FINISHED_VERIFICATION_RESULT_READY_RXPDUSTATE" 23 "SECOC_UNVERIFIED_VERIFICATION_FINISHED_RXPDUSTATE" /end COMPU_VTAB
/begin COMPU_VTAB SecOC_SecuredExternalIdOfTxPduInfoType "" TAB_VERB 1 255 "SECOC_NO_SECUREDEXTERNALIDOFTXPDUINFO" /end COMPU_VTAB
/begin COMPU_VTAB SecOC_SecuredPduDataContainerAuthInfoDataEndIdxOfTxPduInfoType "" TAB_VERB 1 255 "SECOC_NO_SECUREDPDUDATACONTAINERAUTHINFODATAENDIDXOFTXPDUINFO" /end COMPU_VTAB
/begin COMPU_VTAB SecOC_SecuredPduDataContainerAuthInfoDataStartIdxOfTxPduInfoType "" TAB_VERB 1 255 "SECOC_NO_SECUREDPDUDATACONTAINERAUTHINFODATASTARTIDXOFTXPDUINFO" /end COMPU_VTAB
/begin COMPU_VTAB SecOC_SecuredPduDataContainerAuthenticPduEndIdxOfRxPduInfoType "" TAB_VERB 1 255 "SECOC_NO_SECUREDPDUDATACONTAINERAUTHENTICPDUENDIDXOFRXPDUINFO" /end COMPU_VTAB
/begin COMPU_VTAB SecOC_SecuredPduDataContainerAuthenticPduEndIdxOfTxPduInfoType "" TAB_VERB 1 255 "SECOC_NO_SECUREDPDUDATACONTAINERAUTHENTICPDUENDIDXOFTXPDUINFO" /end COMPU_VTAB
/begin COMPU_VTAB SecOC_SecuredPduDataContainerAuthenticPduStartIdxOfRxPduInfoType "" TAB_VERB 1 255 "SECOC_NO_SECUREDPDUDATACONTAINERAUTHENTICPDUSTARTIDXOFRXPDUINFO" /end COMPU_VTAB
/begin COMPU_VTAB SecOC_SecuredPduDataContainerAuthenticPduStartIdxOfTxPduInfoType "" TAB_VERB 1 255 "SECOC_NO_SECUREDPDUDATACONTAINERAUTHENTICPDUSTARTIDXOFTXPDUINFO" /end COMPU_VTAB
/begin COMPU_VTAB SecOC_SecuredPduDataContainerSecuredPduEndIdxOfRxPduInfoType "" TAB_VERB 1 255 "SECOC_NO_SECUREDPDUDATACONTAINERSECUREDPDUENDIDXOFRXPDUINFO" /end COMPU_VTAB
/begin COMPU_VTAB SecOC_SecuredPduDataContainerSecuredPduEndIdxOfTxPduInfoType "" TAB_VERB 1 255 "SECOC_NO_SECUREDPDUDATACONTAINERSECUREDPDUENDIDXOFTXPDUINFO" /end COMPU_VTAB
/begin COMPU_VTAB SecOC_SecuredPduDataContainerSecuredPduStartIdxOfRxPduInfoType "" TAB_VERB 1 255 "SECOC_NO_SECUREDPDUDATACONTAINERSECUREDPDUSTARTIDXOFRXPDUINFO" /end COMPU_VTAB
/begin COMPU_VTAB SecOC_SecuredPduDataContainerSecuredPduStartIdxOfTxPduInfoType "" TAB_VERB 1 255 "SECOC_NO_SECUREDPDUDATACONTAINERSECUREDPDUSTARTIDXOFTXPDUINFO" /end COMPU_VTAB
/begin COMPU_VTAB SecOC_SecuredPduDataContainerTpSecuredPduEndIdxOfRxPduInfoType "" TAB_VERB 1 255 "SECOC_NO_SECUREDPDUDATACONTAINERTPSECUREDPDUENDIDXOFRXPDUINFO" /end COMPU_VTAB
/begin COMPU_VTAB SecOC_SecuredPduDataContainerTpSecuredPduStartIdxOfRxPduInfoType "" TAB_VERB 1 255 "SECOC_NO_SECUREDPDUDATACONTAINERTPSECUREDPDUSTARTIDXOFRXPDUINFO" /end COMPU_VTAB
/begin COMPU_VTAB SecOC_SecuredPduDataContainerTruncatedAuthenticatorEndIdxOfRxPduInfoType "" TAB_VERB 1 255 "SECOC_NO_SECUREDPDUDATACONTAINERTRUNCATEDAUTHENTICATORENDIDXOFRXPDUINFO" /end COMPU_VTAB
/begin COMPU_VTAB SecOC_SecuredPduDataContainerTruncatedAuthenticatorEndIdxOfTxPduInfoType "" TAB_VERB 1 255 "SECOC_NO_SECUREDPDUDATACONTAINERTRUNCATEDAUTHENTICATORENDIDXOFTXPDUINFO" /end COMPU_VTAB
/begin COMPU_VTAB SecOC_SecuredPduDataContainerTruncatedAuthenticatorStartIdxOfRxPduInfoType "" TAB_VERB 1 255 "SECOC_NO_SECUREDPDUDATACONTAINERTRUNCATEDAUTHENTICATORSTARTIDXOFRXPDUINFO" /end COMPU_VTAB
/begin COMPU_VTAB SecOC_SecuredPduDataContainerTruncatedAuthenticatorStartIdxOfTxPduInfoType "" TAB_VERB 1 255 "SECOC_NO_SECUREDPDUDATACONTAINERTRUNCATEDAUTHENTICATORSTARTIDXOFTXPDUINFO" /end COMPU_VTAB
/begin COMPU_VTAB SecOC_TransmitRequestType "" TAB_VERB 2 0 "SECOC_IDLE_TRANSMITREQUEST" 1 "SECOC_TRANSMIT_TRANSMITREQUEST" /end COMPU_VTAB
/begin COMPU_VTAB SecOC_TxPduStateType "" TAB_VERB 12 0 "SECOC_INVALID_SECURED_PDU_TXPDUSTATE" 1 "SECOC_REAUTHENTICATION_NEEDED_TXPDUSTATE" 2 "SECOC_AUTHENTICATED_TXPDUSTATE" 3 "SECOC_TRANSMISSION_INITIATED_TXPDUSTATE" 4 "SECOC_COPYING_TXPDUSTATE" 6 "SECOC_GET_DATA_TXPDUSTATE" 7 "SECOC_DEVMODE_AUTHENTICATION_PATTERN_NEEDED_TXPDUSTATE" 8 "SECOC_PRE_REAUTHENTICATION_NEEDED_TXPDUSTATE" 16 "SECOC_UNAUTHENTICATED_TXPDUSTATE" 16 "SECOC_UNAUTHENTICATED_TO_BE_STARTED_TXPDUSTATE" 21 "SECOC_UNAUTHENTICATED_FINISHED_WAIT_FOR_CALLBACK_TXPDUSTATE" 22 "SECOC_UNAUTHENTICATED_FINISHED_TXPDUSTATE" /end COMPU_VTAB
/begin COMPU_VTAB SecOC_TxSecuredPduTypeOfTxSecuredPduInfoType "" TAB_VERB 1 4 "SECOC_NORMAL_TXSECUREDPDUTYPEOFTXSECUREDPDUINFO" /end COMPU_VTAB
/begin COMPU_VTAB SecOC_VerificationStatusPropagationModeOfRxPduInfoType "" TAB_VERB 1 2 "SECOC_NONE_VERIFICATIONSTATUSPROPAGATIONMODEOFRXPDUINFO" /end COMPU_VTAB
/begin COMPU_VTAB SecOC_VerificationStatusWithSecuredPduPropagationModeOfRxPduInfoType "" TAB_VERB 1 2 "SECOC_NONE_VERIFICATIONSTATUSWITHSECUREDPDUPROPAGATIONMODEOFRXPDUINFO" /end COMPU_VTAB
/begin COMPU_VTAB SecOC_VerifyOverrideStatusType "" TAB_VERB 3 0 "SECOC_FAIL_INFINETE_VERIFYOVERRIDESTATUS" 1 "SECOC_FAIL_N_TIMES_VERIFYOVERRIDESTATUS" 2 "SECOC_CANCEL_VERIFYOVERRIDESTATUS" /end COMPU_VTAB
/begin GROUP SecOC ""
 /begin REF_MEASUREMENT SecOC_AuthenticPduDataContainer SecOC_AuthenticatorCache SecOC_AuthenticatorCache_OBD_HCP1_SOK_XIX_HCP5_CANFD01_499f5f1b_RxOBD_HCP1_SOK_XIX_HCP5_CANFD01_499f5f1b_RxAuthenticatorCache SecOC_Initialized SecOC_NumberOfMessagesToOverride SecOC_NumberOfMessagesToOverride_HVK_03_E2E_SOK_XIX_HCP5_CANFD01_32c3c9b9_Rx SecOC_NumberOfMessagesToOverride_OBD_HCP1_SOK_XIX_HCP5_CANFD01_499f5f1b_Rx SecOC_NumberOfMessagesToOverride_SOK_Zeit_Hybrid_01_Resp_01_SOK_XIX_HCP5_CANFD01_92adacdc_Rx SecOC_RxAuthenticPduSizeOffset SecOC_RxAuthenticPduSizeOffset_HVK_03_E2E_SOK_XIX_HCP5_CANFD01_32c3c9b9_Rx SecOC_RxAuthenticPduSizeOffset_OBD_HCP1_SOK_XIX_HCP5_CANFD01_499f5f1b_Rx SecOC_RxAuthenticPduSizeOffset_SOK_Zeit_Hybrid_01_Resp_01_SOK_XIX_HCP5_CANFD01_92adacdc_Rx SecOC_RxBuildAttemptsCounter SecOC_RxBuildAttemptsCounter_HVK_03_E2E_SOK_XIX_HCP5_CANFD01_32c3c9b9_Rx SecOC_RxBuildAttemptsCounter_OBD_HCP1_SOK_XIX_HCP5_CANFD01_499f5f1b_Rx SecOC_RxBuildAttemptsCounter_SOK_Zeit_Hybrid_01_Resp_01_SOK_XIX_HCP5_CANFD01_92adacdc_Rx SecOC_RxPduInfo[0].AuthDataFreshnessLenOfRxPduInfo SecOC_RxPduInfo[0].AuthDataFreshnessOfRxPduInfo SecOC_RxPduInfo[0].AuthDataFreshnessStartBytePositionOfRxPduInfo SecOC_RxPduInfo[0].AuthenticExternalIdOfRxPduInfo SecOC_RxPduInfo[0].AuthenticPduDataContainerAuthenticPduEndIdxOfRxPduInfo SecOC_RxPduInfo[0].AuthenticPduDataContainerAuthenticPduLengthOfRxPduInfo SecOC_RxPduInfo[0].AuthenticPduDataContainerAuthenticPduStartIdxOfRxPduInfo SecOC_RxPduInfo[0].AuthenticPduDataContainerDataToAuthenticateEndIdxOfRxPduInfo SecOC_RxPduInfo[0].AuthenticPduDataContainerDataToAuthenticateLengthOfRxPduInfo SecOC_RxPduInfo[0].AuthenticPduDataContainerDataToAuthenticateStartIdxOfRxPduInfo SecOC_RxPduInfo[0].AuthenticPduDataContainerFreshnessVerifyValueEndIdxOfRxPduInfo SecOC_RxPduInfo[0].AuthenticPduDataContainerFreshnessVerifyValueLengthOfRxPduInfo SecOC_RxPduInfo[0].AuthenticPduDataContainerFreshnessVerifyValueStartIdxOfRxPduInfo SecOC_RxPduInfo[0].AuthenticationLayerIdOfRxPduInfo SecOC_RxPduInfo[0].AuthenticatorCacheEndIdxOfRxPduInfo SecOC_RxPduInfo[0].AuthenticatorCacheLengthOfRxPduInfo SecOC_RxPduInfo[0].AuthenticatorCacheStartIdxOfRxPduInfo SecOC_RxPduInfo[0].BuildAttemptsOfRxPduInfo SecOC_RxPduInfo[0].ClientServerVerificationStatusPropagationModeOfRxPduInfo SecOC_RxPduInfo[0].DataIdFirstByteOfRxPduInfo SecOC_RxPduInfo[0].DataIdOfRxPduInfo SecOC_RxPduInfo[0].DataIdSecondByteOfRxPduInfo SecOC_RxPduInfo[0].ExternalFreshnessIdOfRxPduInfo SecOC_RxPduInfo[0].NumberOfMessagesToOverrideIdxOfRxPduInfo SecOC_RxPduInfo[0].PduProcessingOfRxPduInfo SecOC_RxPduInfo[0].PduTypeOfRxPduInfo SecOC_RxPduInfo[0].RxSecuredPduInfoIdxOfRxPduInfo SecOC_RxPduInfo[0].SecuredPduDataContainerAuthenticPduEndIdxOfRxPduInfo SecOC_RxPduInfo[0].SecuredPduDataContainerAuthenticPduLengthOfRxPduInfo SecOC_RxPduInfo[0].SecuredPduDataContainerAuthenticPduStartIdxOfRxPduInfo SecOC_RxPduInfo[0].SecuredPduDataContainerSecuredPduEndIdxOfRxPduInfo SecOC_RxPduInfo[0].SecuredPduDataContainerSecuredPduLengthOfRxPduInfo SecOC_RxPduInfo[0].SecuredPduDataContainerSecuredPduStartIdxOfRxPduInfo SecOC_RxPduInfo[0].SecuredPduDataContainerTpSecuredPduEndIdxOfRxPduInfo SecOC_RxPduInfo[0].SecuredPduDataContainerTpSecuredPduLengthOfRxPduInfo SecOC_RxPduInfo[0].SecuredPduDataContainerTpSecuredPduStartIdxOfRxPduInfo SecOC_RxPduInfo[0].SecuredPduDataContainerTruncatedAuthenticatorEndIdxOfRxPduInfo SecOC_RxPduInfo[0].SecuredPduDataContainerTruncatedAuthenticatorLengthOfRxPduInfo SecOC_RxPduInfo[0].SecuredPduDataContainerTruncatedAuthenticatorStartIdxOfRxPduInfo SecOC_RxPduInfo[0].TruncAuthStartBitInByteOfRxPduInfo SecOC_RxPduInfo[0].TruncFreshnessValueFirstByteShiftOfRxPduInfo SecOC_RxPduInfo[0].TruncFreshnessValueSecondByteShiftOfRxPduInfo SecOC_RxPduInfo[0].VerificationStatusPropagationModeOfRxPduInfo SecOC_RxPduInfo[0].VerificationStatusWithSecuredPduPropagationModeOfRxPduInfo SecOC_RxPduInfo[0].VerifyAttemptsOfRxPduInfo SecOC_RxPduInfo[0].VerifyOverrideStatusIdxOfRxPduInfo SecOC_RxPduInfo[0].VerifyResultIdxOfRxPduInfo SecOC_RxPduInfo[0].truncatedAuthenticationLengthOfRxPduInfo SecOC_RxPduInfo[0].truncatedFreshnessValueLengthOfRxPduInfo SecOC_RxPduInfo[1].AuthDataFreshnessLenOfRxPduInfo SecOC_RxPduInfo[1].AuthDataFreshnessOfRxPduInfo SecOC_RxPduInfo[1].AuthDataFreshnessStartBytePositionOfRxPduInfo SecOC_RxPduInfo[1].AuthenticExternalIdOfRxPduInfo SecOC_RxPduInfo[1].AuthenticPduDataContainerAuthenticPduEndIdxOfRxPduInfo SecOC_RxPduInfo[1].AuthenticPduDataContainerAuthenticPduLengthOfRxPduInfo SecOC_RxPduInfo[1].AuthenticPduDataContainerAuthenticPduStartIdxOfRxPduInfo SecOC_RxPduInfo[1].AuthenticPduDataContainerDataToAuthenticateEndIdxOfRxPduInfo SecOC_RxPduInfo[1].AuthenticPduDataContainerDataToAuthenticateLengthOfRxPduInfo SecOC_RxPduInfo[1].AuthenticPduDataContainerDataToAuthenticateStartIdxOfRxPduInfo SecOC_RxPduInfo[1].AuthenticPduDataContainerFreshnessVerifyValueEndIdxOfRxPduInfo SecOC_RxPduInfo[1].AuthenticPduDataContainerFreshnessVerifyValueLengthOfRxPduInfo SecOC_RxPduInfo[1].AuthenticPduDataContainerFreshnessVerifyValueStartIdxOfRxPduInfo SecOC_RxPduInfo[1].AuthenticationLayerIdOfRxPduInfo SecOC_RxPduInfo[1].AuthenticatorCacheEndIdxOfRxPduInfo SecOC_RxPduInfo[1].AuthenticatorCacheLengthOfRxPduInfo SecOC_RxPduInfo[1].AuthenticatorCacheStartIdxOfRxPduInfo SecOC_RxPduInfo[1].BuildAttemptsOfRxPduInfo SecOC_RxPduInfo[1].ClientServerVerificationStatusPropagationModeOfRxPduInfo SecOC_RxPduInfo[1].DataIdFirstByteOfRxPduInfo SecOC_RxPduInfo[1].DataIdOfRxPduInfo SecOC_RxPduInfo[1].DataIdSecondByteOfRxPduInfo SecOC_RxPduInfo[1].ExternalFreshnessIdOfRxPduInfo SecOC_RxPduInfo[1].NumberOfMessagesToOverrideIdxOfRxPduInfo SecOC_RxPduInfo[1].PduProcessingOfRxPduInfo SecOC_RxPduInfo[1].PduTypeOfRxPduInfo SecOC_RxPduInfo[1].RxSecuredPduInfoIdxOfRxPduInfo SecOC_RxPduInfo[1].SecuredPduDataContainerAuthenticPduEndIdxOfRxPduInfo SecOC_RxPduInfo[1].SecuredPduDataContainerAuthenticPduLengthOfRxPduInfo SecOC_RxPduInfo[1].SecuredPduDataContainerAuthenticPduStartIdxOfRxPduInfo SecOC_RxPduInfo[1].SecuredPduDataContainerSecuredPduEndIdxOfRxPduInfo SecOC_RxPduInfo[1].SecuredPduDataContainerSecuredPduLengthOfRxPduInfo SecOC_RxPduInfo[1].SecuredPduDataContainerSecuredPduStartIdxOfRxPduInfo SecOC_RxPduInfo[1].SecuredPduDataContainerTpSecuredPduEndIdxOfRxPduInfo SecOC_RxPduInfo[1].SecuredPduDataContainerTpSecuredPduLengthOfRxPduInfo SecOC_RxPduInfo[1].SecuredPduDataContainerTpSecuredPduStartIdxOfRxPduInfo SecOC_RxPduInfo[1].SecuredPduDataContainerTruncatedAuthenticatorEndIdxOfRxPduInfo SecOC_RxPduInfo[1].SecuredPduDataContainerTruncatedAuthenticatorLengthOfRxPduInfo SecOC_RxPduInfo[1].SecuredPduDataContainerTruncatedAuthenticatorStartIdxOfRxPduInfo SecOC_RxPduInfo[1].TruncAuthStartBitInByteOfRxPduInfo SecOC_RxPduInfo[1].TruncFreshnessValueFirstByteShiftOfRxPduInfo SecOC_RxPduInfo[1].TruncFreshnessValueSecondByteShiftOfRxPduInfo SecOC_RxPduInfo[1].VerificationStatusPropagationModeOfRxPduInfo SecOC_RxPduInfo[1].VerificationStatusWithSecuredPduPropagationModeOfRxPduInfo SecOC_RxPduInfo[1].VerifyAttemptsOfRxPduInfo SecOC_RxPduInfo[1].VerifyOverrideStatusIdxOfRxPduInfo SecOC_RxPduInfo[1].VerifyResultIdxOfRxPduInfo SecOC_RxPduInfo[1].truncatedAuthenticationLengthOfRxPduInfo SecOC_RxPduInfo[1].truncatedFreshnessValueLengthOfRxPduInfo SecOC_RxPduInfo[2].AuthDataFreshnessLenOfRxPduInfo SecOC_RxPduInfo[2].AuthDataFreshnessOfRxPduInfo SecOC_RxPduInfo[2].AuthDataFreshnessStartBytePositionOfRxPduInfo SecOC_RxPduInfo[2].AuthenticExternalIdOfRxPduInfo SecOC_RxPduInfo[2].AuthenticPduDataContainerAuthenticPduEndIdxOfRxPduInfo SecOC_RxPduInfo[2].AuthenticPduDataContainerAuthenticPduLengthOfRxPduInfo SecOC_RxPduInfo[2].AuthenticPduDataContainerAuthenticPduStartIdxOfRxPduInfo SecOC_RxPduInfo[2].AuthenticPduDataContainerDataToAuthenticateEndIdxOfRxPduInfo SecOC_RxPduInfo[2].AuthenticPduDataContainerDataToAuthenticateLengthOfRxPduInfo SecOC_RxPduInfo[2].AuthenticPduDataContainerDataToAuthenticateStartIdxOfRxPduInfo SecOC_RxPduInfo[2].AuthenticPduDataContainerFreshnessVerifyValueEndIdxOfRxPduInfo SecOC_RxPduInfo[2].AuthenticPduDataContainerFreshnessVerifyValueLengthOfRxPduInfo SecOC_RxPduInfo[2].AuthenticPduDataContainerFreshnessVerifyValueStartIdxOfRxPduInfo SecOC_RxPduInfo[2].AuthenticationLayerIdOfRxPduInfo SecOC_RxPduInfo[2].AuthenticatorCacheEndIdxOfRxPduInfo SecOC_RxPduInfo[2].AuthenticatorCacheLengthOfRxPduInfo SecOC_RxPduInfo[2].AuthenticatorCacheStartIdxOfRxPduInfo SecOC_RxPduInfo[2].BuildAttemptsOfRxPduInfo SecOC_RxPduInfo[2].ClientServerVerificationStatusPropagationModeOfRxPduInfo SecOC_RxPduInfo[2].DataIdFirstByteOfRxPduInfo SecOC_RxPduInfo[2].DataIdOfRxPduInfo SecOC_RxPduInfo[2].DataIdSecondByteOfRxPduInfo SecOC_RxPduInfo[2].ExternalFreshnessIdOfRxPduInfo SecOC_RxPduInfo[2].NumberOfMessagesToOverrideIdxOfRxPduInfo SecOC_RxPduInfo[2].PduProcessingOfRxPduInfo SecOC_RxPduInfo[2].PduTypeOfRxPduInfo SecOC_RxPduInfo[2].RxSecuredPduInfoIdxOfRxPduInfo SecOC_RxPduInfo[2].SecuredPduDataContainerAuthenticPduEndIdxOfRxPduInfo SecOC_RxPduInfo[2].SecuredPduDataContainerAuthenticPduLengthOfRxPduInfo SecOC_RxPduInfo[2].SecuredPduDataContainerAuthenticPduStartIdxOfRxPduInfo SecOC_RxPduInfo[2].SecuredPduDataContainerSecuredPduEndIdxOfRxPduInfo SecOC_RxPduInfo[2].SecuredPduDataContainerSecuredPduLengthOfRxPduInfo SecOC_RxPduInfo[2].SecuredPduDataContainerSecuredPduStartIdxOfRxPduInfo SecOC_RxPduInfo[2].SecuredPduDataContainerTpSecuredPduEndIdxOfRxPduInfo SecOC_RxPduInfo[2].SecuredPduDataContainerTpSecuredPduLengthOfRxPduInfo SecOC_RxPduInfo[2].SecuredPduDataContainerTpSecuredPduStartIdxOfRxPduInfo SecOC_RxPduInfo[2].SecuredPduDataContainerTruncatedAuthenticatorEndIdxOfRxPduInfo SecOC_RxPduInfo[2].SecuredPduDataContainerTruncatedAuthenticatorLengthOfRxPduInfo SecOC_RxPduInfo[2].SecuredPduDataContainerTruncatedAuthenticatorStartIdxOfRxPduInfo SecOC_RxPduInfo[2].TruncAuthStartBitInByteOfRxPduInfo SecOC_RxPduInfo[2].TruncFreshnessValueFirstByteShiftOfRxPduInfo SecOC_RxPduInfo[2].TruncFreshnessValueSecondByteShiftOfRxPduInfo SecOC_RxPduInfo[2].VerificationStatusPropagationModeOfRxPduInfo SecOC_RxPduInfo[2].VerificationStatusWithSecuredPduPropagationModeOfRxPduInfo SecOC_RxPduInfo[2].VerifyAttemptsOfRxPduInfo SecOC_RxPduInfo[2].VerifyOverrideStatusIdxOfRxPduInfo SecOC_RxPduInfo[2].VerifyResultIdxOfRxPduInfo SecOC_RxPduInfo[2].truncatedAuthenticationLengthOfRxPduInfo SecOC_RxPduInfo[2].truncatedFreshnessValueLengthOfRxPduInfo SecOC_RxPduState SecOC_RxPduState_HVK_03_E2E_SOK_XIX_HCP5_CANFD01_32c3c9b9_Rx SecOC_RxPduState_OBD_HCP1_SOK_XIX_HCP5_CANFD01_499f5f1b_Rx SecOC_RxPduState_SOK_Zeit_Hybrid_01_Resp_01_SOK_XIX_HCP5_CANFD01_92adacdc_Rx SecOC_RxSecuredPduInfo[0].MessageLinkLenOfRxSecuredPduInfo SecOC_RxSecuredPduInfo[0].MessageLinkPosOfRxSecuredPduInfo SecOC_RxSecuredPduInfo[0].MessageLinkerStartByteInCryptoPduOfRxSecuredPduInfo SecOC_RxSecuredPduInfo[0].MessageTypeOfRxSecuredPduInfo SecOC_RxSecuredPduInfo[0].MessagesLinkCryptoPduSrcBitOffsetOfRxSecuredPduInfo SecOC_RxSecuredPduInfo[0].MinimumPduLengthOfRxSecuredPduInfo SecOC_RxSecuredPduInfo[0].PduFixLengthOfRxSecuredPduInfo SecOC_RxSecuredPduInfo[0].RxPduInfoIdxOfRxSecuredPduInfo SecOC_RxSecuredPduInfo[0].SecuredPduDataContainerEndIdxOfRxSecuredPduInfo SecOC_RxSecuredPduInfo[0].SecuredPduDataContainerLengthOfRxSecuredPduInfo SecOC_RxSecuredPduInfo[0].SecuredPduDataContainerStartIdxOfRxSecuredPduInfo SecOC_RxSecuredPduInfo[1].MessageLinkLenOfRxSecuredPduInfo SecOC_RxSecuredPduInfo[1].MessageLinkPosOfRxSecuredPduInfo SecOC_RxSecuredPduInfo[1].MessageLinkerStartByteInCryptoPduOfRxSecuredPduInfo SecOC_RxSecuredPduInfo[1].MessageTypeOfRxSecuredPduInfo SecOC_RxSecuredPduInfo[1].MessagesLinkCryptoPduSrcBitOffsetOfRxSecuredPduInfo SecOC_RxSecuredPduInfo[1].MinimumPduLengthOfRxSecuredPduInfo SecOC_RxSecuredPduInfo[1].PduFixLengthOfRxSecuredPduInfo SecOC_RxSecuredPduInfo[1].RxPduInfoIdxOfRxSecuredPduInfo SecOC_RxSecuredPduInfo[1].SecuredPduDataContainerEndIdxOfRxSecuredPduInfo SecOC_RxSecuredPduInfo[1].SecuredPduDataContainerLengthOfRxSecuredPduInfo SecOC_RxSecuredPduInfo[1].SecuredPduDataContainerStartIdxOfRxSecuredPduInfo SecOC_RxSecuredPduInfo[2].MessageLinkLenOfRxSecuredPduInfo SecOC_RxSecuredPduInfo[2].MessageLinkPosOfRxSecuredPduInfo SecOC_RxSecuredPduInfo[2].MessageLinkerStartByteInCryptoPduOfRxSecuredPduInfo SecOC_RxSecuredPduInfo[2].MessageTypeOfRxSecuredPduInfo SecOC_RxSecuredPduInfo[2].MessagesLinkCryptoPduSrcBitOffsetOfRxSecuredPduInfo SecOC_RxSecuredPduInfo[2].MinimumPduLengthOfRxSecuredPduInfo SecOC_RxSecuredPduInfo[2].PduFixLengthOfRxSecuredPduInfo SecOC_RxSecuredPduInfo[2].RxPduInfoIdxOfRxSecuredPduInfo SecOC_RxSecuredPduInfo[2].SecuredPduDataContainerEndIdxOfRxSecuredPduInfo SecOC_RxSecuredPduInfo[2].SecuredPduDataContainerLengthOfRxSecuredPduInfo SecOC_RxSecuredPduInfo[2].SecuredPduDataContainerStartIdxOfRxSecuredPduInfo SecOC_RxTpWrittenBytesCounter SecOC_RxTpWrittenBytesCounter_HVK_03_E2E_SOK_XIX_HCP5_CANFD01_32c3c9b9_Rx SecOC_RxTpWrittenBytesCounter_OBD_HCP1_SOK_XIX_HCP5_CANFD01_499f5f1b_Rx SecOC_RxTpWrittenBytesCounter_SOK_Zeit_Hybrid_01_Resp_01_SOK_XIX_HCP5_CANFD01_92adacdc_Rx SecOC_SecuredPduDataContainer SecOC_TransmitRequest SecOC_TransmitRequest_BMC_HV_01_E2E_SOK_XIX_HCP5_CANFD01_ad756307_Tx SecOC_TransmitRequest_BMC_HV_02_E2E_SOK_XIX_HCP5_CANFD01_5f228eff_Tx SecOC_TransmitRequest_BMC_HV_06_SOK_XIX_HCP5_CANFD01_e20cafa8_Tx SecOC_TransmitRequest_BMC_HV_07_SOK_XIX_HCP5_CANFD01_f524cb68_Tx SecOC_TransmitRequest_BMC_HV_08_SOK_XIX_HCP5_CANFD01_29bed328_Tx SecOC_TransmitRequest_BMC_HV_09_SOK_XIX_HCP5_CANFD01_3e96b7e8_Tx SecOC_TransmitRequest_BMC_HV_14_SOK_XIX_HCP5_CANFD01_572f8cfc_Tx SecOC_TransmitRequest_OBD_Hybrid_01_SOK_XIX_HCP5_CANFD01_86ce2f2e_Tx SecOC_TxAuthenticPduInfo[0].MinimumPduLengthOfTxAuthenticPduInfo SecOC_TxAuthenticPduInfo[0].TxPduInfoIdxOfTxAuthenticPduInfo SecOC_TxAuthenticPduInfo[1].MinimumPduLengthOfTxAuthenticPduInfo SecOC_TxAuthenticPduInfo[1].TxPduInfoIdxOfTxAuthenticPduInfo SecOC_TxAuthenticPduInfo[2].MinimumPduLengthOfTxAuthenticPduInfo SecOC_TxAuthenticPduInfo[2].TxPduInfoIdxOfTxAuthenticPduInfo SecOC_TxAuthenticPduInfo[3].MinimumPduLengthOfTxAuthenticPduInfo SecOC_TxAuthenticPduInfo[3].TxPduInfoIdxOfTxAuthenticPduInfo SecOC_TxAuthenticPduInfo[4].MinimumPduLengthOfTxAuthenticPduInfo SecOC_TxAuthenticPduInfo[4].TxPduInfoIdxOfTxAuthenticPduInfo SecOC_TxAuthenticPduInfo[5].MinimumPduLengthOfTxAuthenticPduInfo SecOC_TxAuthenticPduInfo[5].TxPduInfoIdxOfTxAuthenticPduInfo SecOC_TxAuthenticPduInfo[6].MinimumPduLengthOfTxAuthenticPduInfo SecOC_TxAuthenticPduInfo[6].TxPduInfoIdxOfTxAuthenticPduInfo SecOC_TxAuthenticPduInfo[7].MinimumPduLengthOfTxAuthenticPduInfo SecOC_TxAuthenticPduInfo[7].TxPduInfoIdxOfTxAuthenticPduInfo SecOC_TxAuthenticPduSizeOffset SecOC_TxAuthenticPduSizeOffset_BMC_HV_01_E2E_SOK_XIX_HCP5_CANFD01_ad756307_Tx SecOC_TxAuthenticPduSizeOffset_BMC_HV_02_E2E_SOK_XIX_HCP5_CANFD01_5f228eff_Tx SecOC_TxAuthenticPduSizeOffset_BMC_HV_06_SOK_XIX_HCP5_CANFD01_e20cafa8_Tx SecOC_TxAuthenticPduSizeOffset_BMC_HV_07_SOK_XIX_HCP5_CANFD01_f524cb68_Tx SecOC_TxAuthenticPduSizeOffset_BMC_HV_08_SOK_XIX_HCP5_CANFD01_29bed328_Tx SecOC_TxAuthenticPduSizeOffset_BMC_HV_09_SOK_XIX_HCP5_CANFD01_3e96b7e8_Tx SecOC_TxAuthenticPduSizeOffset_BMC_HV_14_SOK_XIX_HCP5_CANFD01_572f8cfc_Tx SecOC_TxAuthenticPduSizeOffset_OBD_Hybrid_01_SOK_XIX_HCP5_CANFD01_86ce2f2e_Tx SecOC_TxBuildAttemptsCounter SecOC_TxBuildAttemptsCounter_BMC_HV_01_E2E_SOK_XIX_HCP5_CANFD01_ad756307_Tx SecOC_TxBuildAttemptsCounter_BMC_HV_02_E2E_SOK_XIX_HCP5_CANFD01_5f228eff_Tx SecOC_TxBuildAttemptsCounter_BMC_HV_06_SOK_XIX_HCP5_CANFD01_e20cafa8_Tx SecOC_TxBuildAttemptsCounter_BMC_HV_07_SOK_XIX_HCP5_CANFD01_f524cb68_Tx SecOC_TxBuildAttemptsCounter_BMC_HV_08_SOK_XIX_HCP5_CANFD01_29bed328_Tx SecOC_TxBuildAttemptsCounter_BMC_HV_09_SOK_XIX_HCP5_CANFD01_3e96b7e8_Tx SecOC_TxBuildAttemptsCounter_BMC_HV_14_SOK_XIX_HCP5_CANFD01_572f8cfc_Tx SecOC_TxBuildAttemptsCounter_OBD_Hybrid_01_SOK_XIX_HCP5_CANFD01_86ce2f2e_Tx SecOC_TxPduInfo[0].AuthenticExternalIdOfTxPduInfo SecOC_TxPduInfo[0].AuthenticPduDataContainerAuthenticPduEndIdxOfTxPduInfo SecOC_TxPduInfo[0].AuthenticPduDataContainerAuthenticPduLengthOfTxPduInfo SecOC_TxPduInfo[0].AuthenticPduDataContainerAuthenticPduStartIdxOfTxPduInfo SecOC_TxPduInfo[0].AuthenticPduDataContainerDataToAuthenticateEndIdxOfTxPduInfo SecOC_TxPduInfo[0].AuthenticPduDataContainerDataToAuthenticateLengthOfTxPduInfo SecOC_TxPduInfo[0].AuthenticPduDataContainerDataToAuthenticateStartIdxOfTxPduInfo SecOC_TxPduInfo[0].AuthenticPduDataContainerFreshnessVerifyValueEndIdxOfTxPduInfo SecOC_TxPduInfo[0].AuthenticPduDataContainerFreshnessVerifyValueLengthOfTxPduInfo SecOC_TxPduInfo[0].AuthenticPduDataContainerFreshnessVerifyValueStartIdxOfTxPduInfo SecOC_TxPduInfo[0].AuthenticPduDataContainerFullAuthenticPduEndIdxOfTxPduInfo SecOC_TxPduInfo[0].AuthenticPduDataContainerFullAuthenticPduLengthOfTxPduInfo SecOC_TxPduInfo[0].AuthenticPduDataContainerFullAuthenticPduStartIdxOfTxPduInfo SecOC_TxPduInfo[0].AuthenticationLayerIdOfTxPduInfo SecOC_TxPduInfo[0].AuthenticatorCacheEndIdxOfTxPduInfo SecOC_TxPduInfo[0].AuthenticatorCacheLengthOfTxPduInfo SecOC_TxPduInfo[0].AuthenticatorCacheStartIdxOfTxPduInfo SecOC_TxPduInfo[0].BuildAttemptsOfTxPduInfo SecOC_TxPduInfo[0].ConfirmationNeededOfTxPduInfo SecOC_TxPduInfo[0].DataIdFirstByteOfTxPduInfo SecOC_TxPduInfo[0].DataIdSecondByteOfTxPduInfo SecOC_TxPduInfo[0].ExternalFreshnessIdOfTxPduInfo SecOC_TxPduInfo[0].LowerLayerPduTypeOfTxPduInfo SecOC_TxPduInfo[0].PduProcessingOfTxPduInfo SecOC_TxPduInfo[0].PduTypeOfTxPduInfo SecOC_TxPduInfo[0].ProvideTruncTxFreshnessOfTxPduInfo SecOC_TxPduInfo[0].SecuredExternalIdOfTxPduInfo SecOC_TxPduInfo[0].SecuredPduDataContainerAuthInfoDataEndIdxOfTxPduInfo SecOC_TxPduInfo[0].SecuredPduDataContainerAuthInfoDataLengthOfTxPduInfo SecOC_TxPduInfo[0].SecuredPduDataContainerAuthInfoDataStartIdxOfTxPduInfo SecOC_TxPduInfo[0].SecuredPduDataContainerAuthenticPduEndIdxOfTxPduInfo SecOC_TxPduInfo[0].SecuredPduDataContainerAuthenticPduLengthOfTxPduInfo SecOC_TxPduInfo[0].SecuredPduDataContainerAuthenticPduStartIdxOfTxPduInfo SecOC_TxPduInfo[0].SecuredPduDataContainerSecuredPduEndIdxOfTxPduInfo SecOC_TxPduInfo[0].SecuredPduDataContainerSecuredPduLengthOfTxPduInfo SecOC_TxPduInfo[0].SecuredPduDataContainerSecuredPduStartIdxOfTxPduInfo SecOC_TxPduInfo[0].SecuredPduDataContainerTruncatedAuthenticatorEndIdxOfTxPduInfo SecOC_TxPduInfo[0].SecuredPduDataContainerTruncatedAuthenticatorLengthOfTxPduInfo SecOC_TxPduInfo[0].SecuredPduDataContainerTruncatedAuthenticatorStartIdxOfTxPduInfo SecOC_TxPduInfo[0].TruncAuthStartBitInByteOfTxPduInfo SecOC_TxPduInfo[0].TruncFreshnessValueFirstByteShiftOfTxPduInfo SecOC_TxPduInfo[0].TruncFreshnessValueSecondByteShiftOfTxPduInfo SecOC_TxPduInfo[0].truncatedAuthenticationLengthOfTxPduInfo SecOC_TxPduInfo[0].truncatedFreshnessValueLengthOfTxPduInfo SecOC_TxPduInfo[1].AuthenticExternalIdOfTxPduInfo SecOC_TxPduInfo[1].AuthenticPduDataContainerAuthenticPduEndIdxOfTxPduInfo SecOC_TxPduInfo[1].AuthenticPduDataContainerAuthenticPduLengthOfTxPduInfo SecOC_TxPduInfo[1].AuthenticPduDataContainerAuthenticPduStartIdxOfTxPduInfo SecOC_TxPduInfo[1].AuthenticPduDataContainerDataToAuthenticateEndIdxOfTxPduInfo SecOC_TxPduInfo[1].AuthenticPduDataContainerDataToAuthenticateLengthOfTxPduInfo SecOC_TxPduInfo[1].AuthenticPduDataContainerDataToAuthenticateStartIdxOfTxPduInfo SecOC_TxPduInfo[1].AuthenticPduDataContainerFreshnessVerifyValueEndIdxOfTxPduInfo SecOC_TxPduInfo[1].AuthenticPduDataContainerFreshnessVerifyValueLengthOfTxPduInfo SecOC_TxPduInfo[1].AuthenticPduDataContainerFreshnessVerifyValueStartIdxOfTxPduInfo SecOC_TxPduInfo[1].AuthenticPduDataContainerFullAuthenticPduEndIdxOfTxPduInfo SecOC_TxPduInfo[1].AuthenticPduDataContainerFullAuthenticPduLengthOfTxPduInfo SecOC_TxPduInfo[1].AuthenticPduDataContainerFullAuthenticPduStartIdxOfTxPduInfo SecOC_TxPduInfo[1].AuthenticationLayerIdOfTxPduInfo SecOC_TxPduInfo[1].AuthenticatorCacheEndIdxOfTxPduInfo SecOC_TxPduInfo[1].AuthenticatorCacheLengthOfTxPduInfo SecOC_TxPduInfo[1].AuthenticatorCacheStartIdxOfTxPduInfo SecOC_TxPduInfo[1].BuildAttemptsOfTxPduInfo SecOC_TxPduInfo[1].ConfirmationNeededOfTxPduInfo SecOC_TxPduInfo[1].DataIdFirstByteOfTxPduInfo SecOC_TxPduInfo[1].DataIdSecondByteOfTxPduInfo SecOC_TxPduInfo[1].ExternalFreshnessIdOfTxPduInfo SecOC_TxPduInfo[1].LowerLayerPduTypeOfTxPduInfo SecOC_TxPduInfo[1].PduProcessingOfTxPduInfo SecOC_TxPduInfo[1].PduTypeOfTxPduInfo SecOC_TxPduInfo[1].ProvideTruncTxFreshnessOfTxPduInfo SecOC_TxPduInfo[1].SecuredExternalIdOfTxPduInfo SecOC_TxPduInfo[1].SecuredPduDataContainerAuthInfoDataEndIdxOfTxPduInfo SecOC_TxPduInfo[1].SecuredPduDataContainerAuthInfoDataLengthOfTxPduInfo SecOC_TxPduInfo[1].SecuredPduDataContainerAuthInfoDataStartIdxOfTxPduInfo SecOC_TxPduInfo[1].SecuredPduDataContainerAuthenticPduEndIdxOfTxPduInfo SecOC_TxPduInfo[1].SecuredPduDataContainerAuthenticPduLengthOfTxPduInfo SecOC_TxPduInfo[1].SecuredPduDataContainerAuthenticPduStartIdxOfTxPduInfo SecOC_TxPduInfo[1].SecuredPduDataContainerSecuredPduEndIdxOfTxPduInfo SecOC_TxPduInfo[1].SecuredPduDataContainerSecuredPduLengthOfTxPduInfo SecOC_TxPduInfo[1].SecuredPduDataContainerSecuredPduStartIdxOfTxPduInfo SecOC_TxPduInfo[1].SecuredPduDataContainerTruncatedAuthenticatorEndIdxOfTxPduInfo SecOC_TxPduInfo[1].SecuredPduDataContainerTruncatedAuthenticatorLengthOfTxPduInfo SecOC_TxPduInfo[1].SecuredPduDataContainerTruncatedAuthenticatorStartIdxOfTxPduInfo SecOC_TxPduInfo[1].TruncAuthStartBitInByteOfTxPduInfo SecOC_TxPduInfo[1].TruncFreshnessValueFirstByteShiftOfTxPduInfo SecOC_TxPduInfo[1].TruncFreshnessValueSecondByteShiftOfTxPduInfo SecOC_TxPduInfo[1].truncatedAuthenticationLengthOfTxPduInfo SecOC_TxPduInfo[1].truncatedFreshnessValueLengthOfTxPduInfo SecOC_TxPduInfo[2].AuthenticExternalIdOfTxPduInfo SecOC_TxPduInfo[2].AuthenticPduDataContainerAuthenticPduEndIdxOfTxPduInfo SecOC_TxPduInfo[2].AuthenticPduDataContainerAuthenticPduLengthOfTxPduInfo SecOC_TxPduInfo[2].AuthenticPduDataContainerAuthenticPduStartIdxOfTxPduInfo SecOC_TxPduInfo[2].AuthenticPduDataContainerDataToAuthenticateEndIdxOfTxPduInfo SecOC_TxPduInfo[2].AuthenticPduDataContainerDataToAuthenticateLengthOfTxPduInfo SecOC_TxPduInfo[2].AuthenticPduDataContainerDataToAuthenticateStartIdxOfTxPduInfo SecOC_TxPduInfo[2].AuthenticPduDataContainerFreshnessVerifyValueEndIdxOfTxPduInfo SecOC_TxPduInfo[2].AuthenticPduDataContainerFreshnessVerifyValueLengthOfTxPduInfo SecOC_TxPduInfo[2].AuthenticPduDataContainerFreshnessVerifyValueStartIdxOfTxPduInfo SecOC_TxPduInfo[2].AuthenticPduDataContainerFullAuthenticPduEndIdxOfTxPduInfo SecOC_TxPduInfo[2].AuthenticPduDataContainerFullAuthenticPduLengthOfTxPduInfo SecOC_TxPduInfo[2].AuthenticPduDataContainerFullAuthenticPduStartIdxOfTxPduInfo SecOC_TxPduInfo[2].AuthenticationLayerIdOfTxPduInfo SecOC_TxPduInfo[2].AuthenticatorCacheEndIdxOfTxPduInfo SecOC_TxPduInfo[2].AuthenticatorCacheLengthOfTxPduInfo SecOC_TxPduInfo[2].AuthenticatorCacheStartIdxOfTxPduInfo SecOC_TxPduInfo[2].BuildAttemptsOfTxPduInfo SecOC_TxPduInfo[2].ConfirmationNeededOfTxPduInfo SecOC_TxPduInfo[2].DataIdFirstByteOfTxPduInfo SecOC_TxPduInfo[2].DataIdSecondByteOfTxPduInfo SecOC_TxPduInfo[2].ExternalFreshnessIdOfTxPduInfo SecOC_TxPduInfo[2].LowerLayerPduTypeOfTxPduInfo SecOC_TxPduInfo[2].PduProcessingOfTxPduInfo SecOC_TxPduInfo[2].PduTypeOfTxPduInfo SecOC_TxPduInfo[2].ProvideTruncTxFreshnessOfTxPduInfo SecOC_TxPduInfo[2].SecuredExternalIdOfTxPduInfo SecOC_TxPduInfo[2].SecuredPduDataContainerAuthInfoDataEndIdxOfTxPduInfo SecOC_TxPduInfo[2].SecuredPduDataContainerAuthInfoDataLengthOfTxPduInfo SecOC_TxPduInfo[2].SecuredPduDataContainerAuthInfoDataStartIdxOfTxPduInfo SecOC_TxPduInfo[2].SecuredPduDataContainerAuthenticPduEndIdxOfTxPduInfo SecOC_TxPduInfo[2].SecuredPduDataContainerAuthenticPduLengthOfTxPduInfo SecOC_TxPduInfo[2].SecuredPduDataContainerAuthenticPduStartIdxOfTxPduInfo SecOC_TxPduInfo[2].SecuredPduDataContainerSecuredPduEndIdxOfTxPduInfo SecOC_TxPduInfo[2].SecuredPduDataContainerSecuredPduLengthOfTxPduInfo SecOC_TxPduInfo[2].SecuredPduDataContainerSecuredPduStartIdxOfTxPduInfo SecOC_TxPduInfo[2].SecuredPduDataContainerTruncatedAuthenticatorEndIdxOfTxPduInfo SecOC_TxPduInfo[2].SecuredPduDataContainerTruncatedAuthenticatorLengthOfTxPduInfo SecOC_TxPduInfo[2].SecuredPduDataContainerTruncatedAuthenticatorStartIdxOfTxPduInfo SecOC_TxPduInfo[2].TruncAuthStartBitInByteOfTxPduInfo SecOC_TxPduInfo[2].TruncFreshnessValueFirstByteShiftOfTxPduInfo SecOC_TxPduInfo[2].TruncFreshnessValueSecondByteShiftOfTxPduInfo SecOC_TxPduInfo[2].truncatedAuthenticationLengthOfTxPduInfo SecOC_TxPduInfo[2].truncatedFreshnessValueLengthOfTxPduInfo SecOC_TxPduInfo[3].AuthenticExternalIdOfTxPduInfo SecOC_TxPduInfo[3].AuthenticPduDataContainerAuthenticPduEndIdxOfTxPduInfo SecOC_TxPduInfo[3].AuthenticPduDataContainerAuthenticPduLengthOfTxPduInfo SecOC_TxPduInfo[3].AuthenticPduDataContainerAuthenticPduStartIdxOfTxPduInfo SecOC_TxPduInfo[3].AuthenticPduDataContainerDataToAuthenticateEndIdxOfTxPduInfo SecOC_TxPduInfo[3].AuthenticPduDataContainerDataToAuthenticateLengthOfTxPduInfo SecOC_TxPduInfo[3].AuthenticPduDataContainerDataToAuthenticateStartIdxOfTxPduInfo SecOC_TxPduInfo[3].AuthenticPduDataContainerFreshnessVerifyValueEndIdxOfTxPduInfo SecOC_TxPduInfo[3].AuthenticPduDataContainerFreshnessVerifyValueLengthOfTxPduInfo SecOC_TxPduInfo[3].AuthenticPduDataContainerFreshnessVerifyValueStartIdxOfTxPduInfo SecOC_TxPduInfo[3].AuthenticPduDataContainerFullAuthenticPduEndIdxOfTxPduInfo SecOC_TxPduInfo[3].AuthenticPduDataContainerFullAuthenticPduLengthOfTxPduInfo SecOC_TxPduInfo[3].AuthenticPduDataContainerFullAuthenticPduStartIdxOfTxPduInfo SecOC_TxPduInfo[3].AuthenticationLayerIdOfTxPduInfo SecOC_TxPduInfo[3].AuthenticatorCacheEndIdxOfTxPduInfo SecOC_TxPduInfo[3].AuthenticatorCacheLengthOfTxPduInfo SecOC_TxPduInfo[3].AuthenticatorCacheStartIdxOfTxPduInfo SecOC_TxPduInfo[3].BuildAttemptsOfTxPduInfo SecOC_TxPduInfo[3].ConfirmationNeededOfTxPduInfo SecOC_TxPduInfo[3].DataIdFirstByteOfTxPduInfo SecOC_TxPduInfo[3].DataIdSecondByteOfTxPduInfo SecOC_TxPduInfo[3].ExternalFreshnessIdOfTxPduInfo SecOC_TxPduInfo[3].LowerLayerPduTypeOfTxPduInfo SecOC_TxPduInfo[3].PduProcessingOfTxPduInfo SecOC_TxPduInfo[3].PduTypeOfTxPduInfo SecOC_TxPduInfo[3].ProvideTruncTxFreshnessOfTxPduInfo SecOC_TxPduInfo[3].SecuredExternalIdOfTxPduInfo SecOC_TxPduInfo[3].SecuredPduDataContainerAuthInfoDataEndIdxOfTxPduInfo SecOC_TxPduInfo[3].SecuredPduDataContainerAuthInfoDataLengthOfTxPduInfo SecOC_TxPduInfo[3].SecuredPduDataContainerAuthInfoDataStartIdxOfTxPduInfo SecOC_TxPduInfo[3].SecuredPduDataContainerAuthenticPduEndIdxOfTxPduInfo SecOC_TxPduInfo[3].SecuredPduDataContainerAuthenticPduLengthOfTxPduInfo SecOC_TxPduInfo[3].SecuredPduDataContainerAuthenticPduStartIdxOfTxPduInfo SecOC_TxPduInfo[3].SecuredPduDataContainerSecuredPduEndIdxOfTxPduInfo SecOC_TxPduInfo[3].SecuredPduDataContainerSecuredPduLengthOfTxPduInfo SecOC_TxPduInfo[3].SecuredPduDataContainerSecuredPduStartIdxOfTxPduInfo SecOC_TxPduInfo[3].SecuredPduDataContainerTruncatedAuthenticatorEndIdxOfTxPduInfo SecOC_TxPduInfo[3].SecuredPduDataContainerTruncatedAuthenticatorLengthOfTxPduInfo SecOC_TxPduInfo[3].SecuredPduDataContainerTruncatedAuthenticatorStartIdxOfTxPduInfo SecOC_TxPduInfo[3].TruncAuthStartBitInByteOfTxPduInfo SecOC_TxPduInfo[3].TruncFreshnessValueFirstByteShiftOfTxPduInfo SecOC_TxPduInfo[3].TruncFreshnessValueSecondByteShiftOfTxPduInfo SecOC_TxPduInfo[3].truncatedAuthenticationLengthOfTxPduInfo SecOC_TxPduInfo[3].truncatedFreshnessValueLengthOfTxPduInfo SecOC_TxPduInfo[4].AuthenticExternalIdOfTxPduInfo SecOC_TxPduInfo[4].AuthenticPduDataContainerAuthenticPduEndIdxOfTxPduInfo SecOC_TxPduInfo[4].AuthenticPduDataContainerAuthenticPduLengthOfTxPduInfo SecOC_TxPduInfo[4].AuthenticPduDataContainerAuthenticPduStartIdxOfTxPduInfo SecOC_TxPduInfo[4].AuthenticPduDataContainerDataToAuthenticateEndIdxOfTxPduInfo SecOC_TxPduInfo[4].AuthenticPduDataContainerDataToAuthenticateLengthOfTxPduInfo SecOC_TxPduInfo[4].AuthenticPduDataContainerDataToAuthenticateStartIdxOfTxPduInfo SecOC_TxPduInfo[4].AuthenticPduDataContainerFreshnessVerifyValueEndIdxOfTxPduInfo SecOC_TxPduInfo[4].AuthenticPduDataContainerFreshnessVerifyValueLengthOfTxPduInfo SecOC_TxPduInfo[4].AuthenticPduDataContainerFreshnessVerifyValueStartIdxOfTxPduInfo SecOC_TxPduInfo[4].AuthenticPduDataContainerFullAuthenticPduEndIdxOfTxPduInfo SecOC_TxPduInfo[4].AuthenticPduDataContainerFullAuthenticPduLengthOfTxPduInfo SecOC_TxPduInfo[4].AuthenticPduDataContainerFullAuthenticPduStartIdxOfTxPduInfo SecOC_TxPduInfo[4].AuthenticationLayerIdOfTxPduInfo SecOC_TxPduInfo[4].AuthenticatorCacheEndIdxOfTxPduInfo SecOC_TxPduInfo[4].AuthenticatorCacheLengthOfTxPduInfo SecOC_TxPduInfo[4].AuthenticatorCacheStartIdxOfTxPduInfo SecOC_TxPduInfo[4].BuildAttemptsOfTxPduInfo SecOC_TxPduInfo[4].ConfirmationNeededOfTxPduInfo SecOC_TxPduInfo[4].DataIdFirstByteOfTxPduInfo SecOC_TxPduInfo[4].DataIdSecondByteOfTxPduInfo SecOC_TxPduInfo[4].ExternalFreshnessIdOfTxPduInfo SecOC_TxPduInfo[4].LowerLayerPduTypeOfTxPduInfo SecOC_TxPduInfo[4].PduProcessingOfTxPduInfo SecOC_TxPduInfo[4].PduTypeOfTxPduInfo SecOC_TxPduInfo[4].ProvideTruncTxFreshnessOfTxPduInfo SecOC_TxPduInfo[4].SecuredExternalIdOfTxPduInfo SecOC_TxPduInfo[4].SecuredPduDataContainerAuthInfoDataEndIdxOfTxPduInfo SecOC_TxPduInfo[4].SecuredPduDataContainerAuthInfoDataLengthOfTxPduInfo SecOC_TxPduInfo[4].SecuredPduDataContainerAuthInfoDataStartIdxOfTxPduInfo SecOC_TxPduInfo[4].SecuredPduDataContainerAuthenticPduEndIdxOfTxPduInfo SecOC_TxPduInfo[4].SecuredPduDataContainerAuthenticPduLengthOfTxPduInfo SecOC_TxPduInfo[4].SecuredPduDataContainerAuthenticPduStartIdxOfTxPduInfo SecOC_TxPduInfo[4].SecuredPduDataContainerSecuredPduEndIdxOfTxPduInfo SecOC_TxPduInfo[4].SecuredPduDataContainerSecuredPduLengthOfTxPduInfo SecOC_TxPduInfo[4].SecuredPduDataContainerSecuredPduStartIdxOfTxPduInfo SecOC_TxPduInfo[4].SecuredPduDataContainerTruncatedAuthenticatorEndIdxOfTxPduInfo SecOC_TxPduInfo[4].SecuredPduDataContainerTruncatedAuthenticatorLengthOfTxPduInfo SecOC_TxPduInfo[4].SecuredPduDataContainerTruncatedAuthenticatorStartIdxOfTxPduInfo SecOC_TxPduInfo[4].TruncAuthStartBitInByteOfTxPduInfo SecOC_TxPduInfo[4].TruncFreshnessValueFirstByteShiftOfTxPduInfo SecOC_TxPduInfo[4].TruncFreshnessValueSecondByteShiftOfTxPduInfo SecOC_TxPduInfo[4].truncatedAuthenticationLengthOfTxPduInfo SecOC_TxPduInfo[4].truncatedFreshnessValueLengthOfTxPduInfo SecOC_TxPduInfo[5].AuthenticExternalIdOfTxPduInfo SecOC_TxPduInfo[5].AuthenticPduDataContainerAuthenticPduEndIdxOfTxPduInfo SecOC_TxPduInfo[5].AuthenticPduDataContainerAuthenticPduLengthOfTxPduInfo SecOC_TxPduInfo[5].AuthenticPduDataContainerAuthenticPduStartIdxOfTxPduInfo SecOC_TxPduInfo[5].AuthenticPduDataContainerDataToAuthenticateEndIdxOfTxPduInfo SecOC_TxPduInfo[5].AuthenticPduDataContainerDataToAuthenticateLengthOfTxPduInfo SecOC_TxPduInfo[5].AuthenticPduDataContainerDataToAuthenticateStartIdxOfTxPduInfo SecOC_TxPduInfo[5].AuthenticPduDataContainerFreshnessVerifyValueEndIdxOfTxPduInfo SecOC_TxPduInfo[5].AuthenticPduDataContainerFreshnessVerifyValueLengthOfTxPduInfo SecOC_TxPduInfo[5].AuthenticPduDataContainerFreshnessVerifyValueStartIdxOfTxPduInfo SecOC_TxPduInfo[5].AuthenticPduDataContainerFullAuthenticPduEndIdxOfTxPduInfo SecOC_TxPduInfo[5].AuthenticPduDataContainerFullAuthenticPduLengthOfTxPduInfo SecOC_TxPduInfo[5].AuthenticPduDataContainerFullAuthenticPduStartIdxOfTxPduInfo SecOC_TxPduInfo[5].AuthenticationLayerIdOfTxPduInfo SecOC_TxPduInfo[5].AuthenticatorCacheEndIdxOfTxPduInfo SecOC_TxPduInfo[5].AuthenticatorCacheLengthOfTxPduInfo SecOC_TxPduInfo[5].AuthenticatorCacheStartIdxOfTxPduInfo SecOC_TxPduInfo[5].BuildAttemptsOfTxPduInfo SecOC_TxPduInfo[5].ConfirmationNeededOfTxPduInfo SecOC_TxPduInfo[5].DataIdFirstByteOfTxPduInfo SecOC_TxPduInfo[5].DataIdSecondByteOfTxPduInfo SecOC_TxPduInfo[5].ExternalFreshnessIdOfTxPduInfo SecOC_TxPduInfo[5].LowerLayerPduTypeOfTxPduInfo SecOC_TxPduInfo[5].PduProcessingOfTxPduInfo SecOC_TxPduInfo[5].PduTypeOfTxPduInfo SecOC_TxPduInfo[5].ProvideTruncTxFreshnessOfTxPduInfo SecOC_TxPduInfo[5].SecuredExternalIdOfTxPduInfo SecOC_TxPduInfo[5].SecuredPduDataContainerAuthInfoDataEndIdxOfTxPduInfo SecOC_TxPduInfo[5].SecuredPduDataContainerAuthInfoDataLengthOfTxPduInfo SecOC_TxPduInfo[5].SecuredPduDataContainerAuthInfoDataStartIdxOfTxPduInfo SecOC_TxPduInfo[5].SecuredPduDataContainerAuthenticPduEndIdxOfTxPduInfo SecOC_TxPduInfo[5].SecuredPduDataContainerAuthenticPduLengthOfTxPduInfo SecOC_TxPduInfo[5].SecuredPduDataContainerAuthenticPduStartIdxOfTxPduInfo SecOC_TxPduInfo[5].SecuredPduDataContainerSecuredPduEndIdxOfTxPduInfo SecOC_TxPduInfo[5].SecuredPduDataContainerSecuredPduLengthOfTxPduInfo SecOC_TxPduInfo[5].SecuredPduDataContainerSecuredPduStartIdxOfTxPduInfo SecOC_TxPduInfo[5].SecuredPduDataContainerTruncatedAuthenticatorEndIdxOfTxPduInfo SecOC_TxPduInfo[5].SecuredPduDataContainerTruncatedAuthenticatorLengthOfTxPduInfo SecOC_TxPduInfo[5].SecuredPduDataContainerTruncatedAuthenticatorStartIdxOfTxPduInfo SecOC_TxPduInfo[5].TruncAuthStartBitInByteOfTxPduInfo SecOC_TxPduInfo[5].TruncFreshnessValueFirstByteShiftOfTxPduInfo SecOC_TxPduInfo[5].TruncFreshnessValueSecondByteShiftOfTxPduInfo SecOC_TxPduInfo[5].truncatedAuthenticationLengthOfTxPduInfo SecOC_TxPduInfo[5].truncatedFreshnessValueLengthOfTxPduInfo SecOC_TxPduInfo[6].AuthenticExternalIdOfTxPduInfo SecOC_TxPduInfo[6].AuthenticPduDataContainerAuthenticPduEndIdxOfTxPduInfo SecOC_TxPduInfo[6].AuthenticPduDataContainerAuthenticPduLengthOfTxPduInfo SecOC_TxPduInfo[6].AuthenticPduDataContainerAuthenticPduStartIdxOfTxPduInfo SecOC_TxPduInfo[6].AuthenticPduDataContainerDataToAuthenticateEndIdxOfTxPduInfo SecOC_TxPduInfo[6].AuthenticPduDataContainerDataToAuthenticateLengthOfTxPduInfo SecOC_TxPduInfo[6].AuthenticPduDataContainerDataToAuthenticateStartIdxOfTxPduInfo SecOC_TxPduInfo[6].AuthenticPduDataContainerFreshnessVerifyValueEndIdxOfTxPduInfo SecOC_TxPduInfo[6].AuthenticPduDataContainerFreshnessVerifyValueLengthOfTxPduInfo SecOC_TxPduInfo[6].AuthenticPduDataContainerFreshnessVerifyValueStartIdxOfTxPduInfo SecOC_TxPduInfo[6].AuthenticPduDataContainerFullAuthenticPduEndIdxOfTxPduInfo SecOC_TxPduInfo[6].AuthenticPduDataContainerFullAuthenticPduLengthOfTxPduInfo SecOC_TxPduInfo[6].AuthenticPduDataContainerFullAuthenticPduStartIdxOfTxPduInfo SecOC_TxPduInfo[6].AuthenticationLayerIdOfTxPduInfo SecOC_TxPduInfo[6].AuthenticatorCacheEndIdxOfTxPduInfo SecOC_TxPduInfo[6].AuthenticatorCacheLengthOfTxPduInfo SecOC_TxPduInfo[6].AuthenticatorCacheStartIdxOfTxPduInfo SecOC_TxPduInfo[6].BuildAttemptsOfTxPduInfo SecOC_TxPduInfo[6].ConfirmationNeededOfTxPduInfo SecOC_TxPduInfo[6].DataIdFirstByteOfTxPduInfo SecOC_TxPduInfo[6].DataIdSecondByteOfTxPduInfo SecOC_TxPduInfo[6].ExternalFreshnessIdOfTxPduInfo SecOC_TxPduInfo[6].LowerLayerPduTypeOfTxPduInfo SecOC_TxPduInfo[6].PduProcessingOfTxPduInfo SecOC_TxPduInfo[6].PduTypeOfTxPduInfo SecOC_TxPduInfo[6].ProvideTruncTxFreshnessOfTxPduInfo SecOC_TxPduInfo[6].SecuredExternalIdOfTxPduInfo SecOC_TxPduInfo[6].SecuredPduDataContainerAuthInfoDataEndIdxOfTxPduInfo SecOC_TxPduInfo[6].SecuredPduDataContainerAuthInfoDataLengthOfTxPduInfo SecOC_TxPduInfo[6].SecuredPduDataContainerAuthInfoDataStartIdxOfTxPduInfo SecOC_TxPduInfo[6].SecuredPduDataContainerAuthenticPduEndIdxOfTxPduInfo SecOC_TxPduInfo[6].SecuredPduDataContainerAuthenticPduLengthOfTxPduInfo SecOC_TxPduInfo[6].SecuredPduDataContainerAuthenticPduStartIdxOfTxPduInfo SecOC_TxPduInfo[6].SecuredPduDataContainerSecuredPduEndIdxOfTxPduInfo SecOC_TxPduInfo[6].SecuredPduDataContainerSecuredPduLengthOfTxPduInfo SecOC_TxPduInfo[6].SecuredPduDataContainerSecuredPduStartIdxOfTxPduInfo SecOC_TxPduInfo[6].SecuredPduDataContainerTruncatedAuthenticatorEndIdxOfTxPduInfo SecOC_TxPduInfo[6].SecuredPduDataContainerTruncatedAuthenticatorLengthOfTxPduInfo SecOC_TxPduInfo[6].SecuredPduDataContainerTruncatedAuthenticatorStartIdxOfTxPduInfo SecOC_TxPduInfo[6].TruncAuthStartBitInByteOfTxPduInfo SecOC_TxPduInfo[6].TruncFreshnessValueFirstByteShiftOfTxPduInfo SecOC_TxPduInfo[6].TruncFreshnessValueSecondByteShiftOfTxPduInfo SecOC_TxPduInfo[6].truncatedAuthenticationLengthOfTxPduInfo SecOC_TxPduInfo[6].truncatedFreshnessValueLengthOfTxPduInfo SecOC_TxPduInfo[7].AuthenticExternalIdOfTxPduInfo SecOC_TxPduInfo[7].AuthenticPduDataContainerAuthenticPduEndIdxOfTxPduInfo SecOC_TxPduInfo[7].AuthenticPduDataContainerAuthenticPduLengthOfTxPduInfo SecOC_TxPduInfo[7].AuthenticPduDataContainerAuthenticPduStartIdxOfTxPduInfo SecOC_TxPduInfo[7].AuthenticPduDataContainerDataToAuthenticateEndIdxOfTxPduInfo SecOC_TxPduInfo[7].AuthenticPduDataContainerDataToAuthenticateLengthOfTxPduInfo SecOC_TxPduInfo[7].AuthenticPduDataContainerDataToAuthenticateStartIdxOfTxPduInfo SecOC_TxPduInfo[7].AuthenticPduDataContainerFreshnessVerifyValueEndIdxOfTxPduInfo SecOC_TxPduInfo[7].AuthenticPduDataContainerFreshnessVerifyValueLengthOfTxPduInfo SecOC_TxPduInfo[7].AuthenticPduDataContainerFreshnessVerifyValueStartIdxOfTxPduInfo SecOC_TxPduInfo[7].AuthenticPduDataContainerFullAuthenticPduEndIdxOfTxPduInfo SecOC_TxPduInfo[7].AuthenticPduDataContainerFullAuthenticPduLengthOfTxPduInfo SecOC_TxPduInfo[7].AuthenticPduDataContainerFullAuthenticPduStartIdxOfTxPduInfo SecOC_TxPduInfo[7].AuthenticationLayerIdOfTxPduInfo SecOC_TxPduInfo[7].AuthenticatorCacheEndIdxOfTxPduInfo SecOC_TxPduInfo[7].AuthenticatorCacheLengthOfTxPduInfo SecOC_TxPduInfo[7].AuthenticatorCacheStartIdxOfTxPduInfo SecOC_TxPduInfo[7].BuildAttemptsOfTxPduInfo SecOC_TxPduInfo[7].ConfirmationNeededOfTxPduInfo SecOC_TxPduInfo[7].DataIdFirstByteOfTxPduInfo SecOC_TxPduInfo[7].DataIdSecondByteOfTxPduInfo SecOC_TxPduInfo[7].ExternalFreshnessIdOfTxPduInfo SecOC_TxPduInfo[7].LowerLayerPduTypeOfTxPduInfo SecOC_TxPduInfo[7].PduProcessingOfTxPduInfo SecOC_TxPduInfo[7].PduTypeOfTxPduInfo SecOC_TxPduInfo[7].ProvideTruncTxFreshnessOfTxPduInfo SecOC_TxPduInfo[7].SecuredExternalIdOfTxPduInfo SecOC_TxPduInfo[7].SecuredPduDataContainerAuthInfoDataEndIdxOfTxPduInfo SecOC_TxPduInfo[7].SecuredPduDataContainerAuthInfoDataLengthOfTxPduInfo SecOC_TxPduInfo[7].SecuredPduDataContainerAuthInfoDataStartIdxOfTxPduInfo SecOC_TxPduInfo[7].SecuredPduDataContainerAuthenticPduEndIdxOfTxPduInfo SecOC_TxPduInfo[7].SecuredPduDataContainerAuthenticPduLengthOfTxPduInfo SecOC_TxPduInfo[7].SecuredPduDataContainerAuthenticPduStartIdxOfTxPduInfo SecOC_TxPduInfo[7].SecuredPduDataContainerSecuredPduEndIdxOfTxPduInfo SecOC_TxPduInfo[7].SecuredPduDataContainerSecuredPduLengthOfTxPduInfo SecOC_TxPduInfo[7].SecuredPduDataContainerSecuredPduStartIdxOfTxPduInfo SecOC_TxPduInfo[7].SecuredPduDataContainerTruncatedAuthenticatorEndIdxOfTxPduInfo SecOC_TxPduInfo[7].SecuredPduDataContainerTruncatedAuthenticatorLengthOfTxPduInfo SecOC_TxPduInfo[7].SecuredPduDataContainerTruncatedAuthenticatorStartIdxOfTxPduInfo SecOC_TxPduInfo[7].TruncAuthStartBitInByteOfTxPduInfo SecOC_TxPduInfo[7].TruncFreshnessValueFirstByteShiftOfTxPduInfo SecOC_TxPduInfo[7].TruncFreshnessValueSecondByteShiftOfTxPduInfo SecOC_TxPduInfo[7].truncatedAuthenticationLengthOfTxPduInfo SecOC_TxPduInfo[7].truncatedFreshnessValueLengthOfTxPduInfo SecOC_TxPduState SecOC_TxPduState_BMC_HV_01_E2E_SOK_XIX_HCP5_CANFD01_ad756307_Tx SecOC_TxPduState_BMC_HV_02_E2E_SOK_XIX_HCP5_CANFD01_5f228eff_Tx SecOC_TxPduState_BMC_HV_06_SOK_XIX_HCP5_CANFD01_e20cafa8_Tx SecOC_TxPduState_BMC_HV_07_SOK_XIX_HCP5_CANFD01_f524cb68_Tx SecOC_TxPduState_BMC_HV_08_SOK_XIX_HCP5_CANFD01_29bed328_Tx SecOC_TxPduState_BMC_HV_09_SOK_XIX_HCP5_CANFD01_3e96b7e8_Tx SecOC_TxPduState_BMC_HV_14_SOK_XIX_HCP5_CANFD01_572f8cfc_Tx SecOC_TxPduState_OBD_Hybrid_01_SOK_XIX_HCP5_CANFD01_86ce2f2e_Tx SecOC_TxResultLength SecOC_TxResultLength_BMC_HV_01_E2E_SOK_XIX_HCP5_CANFD01_ad756307_Tx SecOC_TxResultLength_BMC_HV_02_E2E_SOK_XIX_HCP5_CANFD01_5f228eff_Tx SecOC_TxResultLength_BMC_HV_06_SOK_XIX_HCP5_CANFD01_e20cafa8_Tx SecOC_TxResultLength_BMC_HV_07_SOK_XIX_HCP5_CANFD01_f524cb68_Tx SecOC_TxResultLength_BMC_HV_08_SOK_XIX_HCP5_CANFD01_29bed328_Tx SecOC_TxResultLength_BMC_HV_09_SOK_XIX_HCP5_CANFD01_3e96b7e8_Tx SecOC_TxResultLength_BMC_HV_14_SOK_XIX_HCP5_CANFD01_572f8cfc_Tx SecOC_TxResultLength_OBD_Hybrid_01_SOK_XIX_HCP5_CANFD01_86ce2f2e_Tx SecOC_TxSecuredPduInfo[0].TxPduInfoIdxOfTxSecuredPduInfo SecOC_TxSecuredPduInfo[0].TxSecuredPduTypeOfTxSecuredPduInfo SecOC_TxSecuredPduInfo[1].TxPduInfoIdxOfTxSecuredPduInfo SecOC_TxSecuredPduInfo[1].TxSecuredPduTypeOfTxSecuredPduInfo SecOC_TxSecuredPduInfo[2].TxPduInfoIdxOfTxSecuredPduInfo SecOC_TxSecuredPduInfo[2].TxSecuredPduTypeOfTxSecuredPduInfo SecOC_TxSecuredPduInfo[3].TxPduInfoIdxOfTxSecuredPduInfo SecOC_TxSecuredPduInfo[3].TxSecuredPduTypeOfTxSecuredPduInfo SecOC_TxSecuredPduInfo[4].TxPduInfoIdxOfTxSecuredPduInfo SecOC_TxSecuredPduInfo[4].TxSecuredPduTypeOfTxSecuredPduInfo SecOC_TxSecuredPduInfo[5].TxPduInfoIdxOfTxSecuredPduInfo SecOC_TxSecuredPduInfo[5].TxSecuredPduTypeOfTxSecuredPduInfo SecOC_TxSecuredPduInfo[6].TxPduInfoIdxOfTxSecuredPduInfo SecOC_TxSecuredPduInfo[6].TxSecuredPduTypeOfTxSecuredPduInfo SecOC_TxSecuredPduInfo[7].TxPduInfoIdxOfTxSecuredPduInfo SecOC_TxSecuredPduInfo[7].TxSecuredPduTypeOfTxSecuredPduInfo SecOC_TxTpWrittenBytesCounter SecOC_TxTpWrittenBytesCounter_BMC_HV_01_E2E_SOK_XIX_HCP5_CANFD01_ad756307_Tx SecOC_TxTpWrittenBytesCounter_BMC_HV_02_E2E_SOK_XIX_HCP5_CANFD01_5f228eff_Tx SecOC_TxTpWrittenBytesCounter_BMC_HV_06_SOK_XIX_HCP5_CANFD01_e20cafa8_Tx SecOC_TxTpWrittenBytesCounter_BMC_HV_07_SOK_XIX_HCP5_CANFD01_f524cb68_Tx SecOC_TxTpWrittenBytesCounter_BMC_HV_08_SOK_XIX_HCP5_CANFD01_29bed328_Tx SecOC_TxTpWrittenBytesCounter_BMC_HV_09_SOK_XIX_HCP5_CANFD01_3e96b7e8_Tx SecOC_TxTpWrittenBytesCounter_BMC_HV_14_SOK_XIX_HCP5_CANFD01_572f8cfc_Tx SecOC_TxTpWrittenBytesCounter_OBD_Hybrid_01_SOK_XIX_HCP5_CANFD01_86ce2f2e_Tx SecOC_VerifyAttemptsCounter SecOC_VerifyAttemptsCounter_HVK_03_E2E_SOK_XIX_HCP5_CANFD01_32c3c9b9_Rx SecOC_VerifyAttemptsCounter_OBD_HCP1_SOK_XIX_HCP5_CANFD01_499f5f1b_Rx SecOC_VerifyAttemptsCounter_SOK_Zeit_Hybrid_01_Resp_01_SOK_XIX_HCP5_CANFD01_92adacdc_Rx SecOC_VerifyOverrideStatus SecOC_VerifyOverrideStatus_HVK_03_E2E_SOK_XIX_HCP5_CANFD01_32c3c9b9_Rx SecOC_VerifyOverrideStatus_OBD_HCP1_SOK_XIX_HCP5_CANFD01_499f5f1b_Rx SecOC_VerifyOverrideStatus_SOK_Zeit_Hybrid_01_Resp_01_SOK_XIX_HCP5_CANFD01_92adacdc_Rx /end REF_MEASUREMENT
/end GROUP
/end MODULE
/end PROJECT
