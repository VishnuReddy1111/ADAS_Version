ASAP2_VERSION 1 71
/begin PROJECT MICROSAR ""
/begin MODULE CPP ""
/begin MOD_COMMON "" BYTE_ORDER MSB_LAST ALIGNMENT_BYTE 1 ALIGNMENT_WORD 2 ALIGNMENT_LONG 4 ALIGNMENT_FLOAT16_IEEE 2 ALIGNMENT_FLOAT32_IEEE 4 ALIGNMENT_FLOAT64_IEEE 8 ALIGNMENT_INT64 8 /end MOD_COMMON
/begin MEASUREMENT Com_RxSigInfo[230].RxCbkFuncPtrAckIdxOfRxSigInfo "" UBYTE Com_RxCbkFuncPtrAckIdxOfRxSigInfoType 0 0 0 255 ECU_ADDRESS 0x0 /end MEASUREMENT
/begin MEASUREMENT Com_RxSigInfo[230].SignalProcessingOfRxSigInfo "" UBYTE Com_SignalProcessingOfRxSigInfoType 0 0 0 255 ECU_ADDRESS 0x0 /end MEASUREMENT
/begin MEASUREMENT Com_RxSigInfo[230].ValidDlcOfRxSigInfo "" UBYTE NO_COMPU_METHOD 0 0 0 255 ECU_ADDRESS 0x0 /end MEASUREMENT
/begin MEASUREMENT Com_RxSigInfo[231].RxAccessInfoIdxOfRxSigInfo "" UWORD NO_COMPU_METHOD 0 0 0 65535 ECU_ADDRESS 0x0 /end MEASUREMENT
/begin MEASUREMENT Com_RxSigInfo[231].RxCbkFuncPtrAckIdxOfRxSigInfo "" UBYTE Com_RxCbkFuncPtrAckIdxOfRxSigInfoType 0 0 0 255 ECU_ADDRESS 0x0 /end MEASUREMENT
/begin MEASUREMENT Com_RxSigInfo[231].SignalProcessingOfRxSigInfo "" UBYTE Com_SignalProcessingOfRxSigInfoType 0 0 0 255 ECU_ADDRESS 0x0 /end MEASUREMENT
/begin MEASUREMENT Com_RxSigInfo[231].ValidDlcOfRxSigInfo "" UBYTE NO_COMPU_METHOD 0 0 0 255 ECU_ADDRESS 0x0 /end MEASUREMENT
/begin MEASUREMENT Com_RxSigInfo[232].RxAccessInfoIdxOfRxSigInfo "" UWORD NO_COMPU_METHOD 0 0 0 65535 ECU_ADDRESS 0x0 /end MEASUREMENT
/begin MEASUREMENT Com_RxSigInfo[232].RxCbkFuncPtrAckIdxOfRxSigInfo "" UBYTE Com_RxCbkFuncPtrAckIdxOfRxSigInfoType 0 0 0 255 ECU_ADDRESS 0x0 /end MEASUREMENT
/begin MEASUREMENT Com_RxSigInfo[232].SignalProcessingOfRxSigInfo "" UBYTE Com_SignalProcessingOfRxSigInfoType 0 0 0 255 ECU_ADDRESS 0x0 /end MEASUREMENT
/begin MEASUREMENT Com_RxSigInfo[232].ValidDlcOfRxSigInfo "" UBYTE NO_COMPU_METHOD 0 0 0 255 ECU_ADDRESS 0x0 /end MEASUREMENT
/begin MEASUREMENT Com_RxSigInfo[233].RxAccessInfoIdxOfRxSigInfo "" UWORD NO_COMPU_METHOD 0 0 0 65535 ECU_ADDRESS 0x0 /end MEASUREMENT
/begin MEASUREMENT Com_RxSigInfo[233].RxCbkFuncPtrAckIdxOfRxSigInfo "" UBYTE Com_RxCbkFuncPtrAckIdxOfRxSigInfoType 0 0 0 255 ECU_ADDRESS 0x0 /end MEASUREMENT
/begin MEASUREMENT Com_RxSigInfo[233].SignalProcessingOfRxSigInfo "" UBYTE Com_SignalProcessingOfRxSigInfoType 0 0 0 255 ECU_ADDRESS 0x0 /end MEASUREMENT
/begin MEASUREMENT Com_RxSigInfo[233].ValidDlcOfRxSigInfo "" UBYTE NO_COMPU_METHOD 0 0 0 255 ECU_ADDRESS 0x0 /end MEASUREMENT
/begin MEASUREMENT Com_RxSigInfo[234].RxAccessInfoIdxOfRxSigInfo "" UWORD NO_COMPU_METHOD 0 0 0 65535 ECU_ADDRESS 0x0 /end MEASUREMENT
/begin MEASUREMENT Com_RxSigInfo[234].RxCbkFuncPtrAckIdxOfRxSigInfo "" UBYTE Com_RxCbkFuncPtrAckIdxOfRxSigInfoType 0 0 0 255 ECU_ADDRESS 0x0 /end MEASUREMENT
/begin MEASUREMENT Com_RxSigInfo[234].SignalProcessingOfRxSigInfo "" UBYTE Com_SignalProcessingOfRxSigInfoType 0 0 0 255 ECU_ADDRESS 0x0 /end MEASUREMENT
/begin MEASUREMENT Com_RxSigInfo[234].ValidDlcOfRxSigInfo "" UBYTE NO_COMPU_METHOD 0 0 0 255 ECU_ADDRESS 0x0 /end MEASUREMENT
/begin MEASUREMENT Com_RxSigInfo[235].RxAccessInfoIdxOfRxSigInfo "" UWORD NO_COMPU_METHOD 0 0 0 65535 ECU_ADDRESS 0x0 /end MEASUREMENT
/begin MEASUREMENT Com_RxSigInfo[235].RxCbkFuncPtrAckIdxOfRxSigInfo "" UBYTE Com_RxCbkFuncPtrAckIdxOfRxSigInfoType 0 0 0 255 ECU_ADDRESS 0x0 /end MEASUREMENT
/begin MEASUREMENT Com_RxSigInfo[235].SignalProcessingOfRxSigInfo "" UBYTE Com_SignalProcessingOfRxSigInfoType 0 0 0 255 ECU_ADDRESS 0x0 /end MEASUREMENT
/begin MEASUREMENT Com_RxSigInfo[235].ValidDlcOfRxSigInfo "" UBYTE NO_COMPU_METHOD 0 0 0 255 ECU_ADDRESS 0x0 /end MEASUREMENT
/begin MEASUREMENT Com_RxSigInfo[236].RxAccessInfoIdxOfRxSigInfo "" UWORD NO_COMPU_METHOD 0 0 0 65535 ECU_ADDRESS 0x0 /end MEASUREMENT
/begin MEASUREMENT Com_RxSigInfo[236].RxCbkFuncPtrAckIdxOfRxSigInfo "" UBYTE Com_RxCbkFuncPtrAckIdxOfRxSigInfoType 0 0 0 255 ECU_ADDRESS 0x0 /end MEASUREMENT
/begin MEASUREMENT Com_RxSigInfo[236].SignalProcessingOfRxSigInfo "" UBYTE Com_SignalProcessingOfRxSigInfoType 0 0 0 255 ECU_ADDRESS 0x0 /end MEASUREMENT
/begin MEASUREMENT Com_RxSigInfo[236].ValidDlcOfRxSigInfo "" UBYTE NO_COMPU_METHOD 0 0 0 255 ECU_ADDRESS 0x0 /end MEASUREMENT
/begin MEASUREMENT Com_RxSigInfo[237].RxAccessInfoIdxOfRxSigInfo "" UWORD NO_COMPU_METHOD 0 0 0 65535 ECU_ADDRESS 0x0 /end MEASUREMENT
/begin MEASUREMENT Com_RxSigInfo[237].RxCbkFuncPtrAckIdxOfRxSigInfo "" UBYTE Com_RxCbkFuncPtrAckIdxOfRxSigInfoType 0 0 0 255 ECU_ADDRESS 0x0 /end MEASUREMENT
/begin MEASUREMENT Com_RxSigInfo[237].SignalProcessingOfRxSigInfo "" UBYTE Com_SignalProcessingOfRxSigInfoType 0 0 0 255 ECU_ADDRESS 0x0 /end MEASUREMENT
/begin MEASUREMENT Com_RxSigInfo[237].ValidDlcOfRxSigInfo "" UBYTE NO_COMPU_METHOD 0 0 0 255 ECU_ADDRESS 0x0 /end MEASUREMENT
/begin MEASUREMENT Com_RxSigInfo[238].RxAccessInfoIdxOfRxSigInfo "" UWORD NO_COMPU_METHOD 0 0 0 65535 ECU_ADDRESS 0x0 /end MEASUREMENT
/begin MEASUREMENT Com_RxSigInfo[238].RxCbkFuncPtrAckIdxOfRxSigInfo "" UBYTE Com_RxCbkFuncPtrAckIdxOfRxSigInfoType 0 0 0 255 ECU_ADDRESS 0x0 /end MEASUREMENT
/begin MEASUREMENT Com_RxSigInfo[238].SignalProcessingOfRxSigInfo "" UBYTE Com_SignalProcessingOfRxSigInfoType 0 0 0 255 ECU_ADDRESS 0x0 /end MEASUREMENT
/begin MEASUREMENT Com_RxSigInfo[238].ValidDlcOfRxSigInfo "" UBYTE NO_COMPU_METHOD 0 0 0 255 ECU_ADDRESS 0x0 /end MEASUREMENT
/begin MEASUREMENT Com_RxSigInfo[239].RxAccessInfoIdxOfRxSigInfo "" UWORD NO_COMPU_METHOD 0 0 0 65535 ECU_ADDRESS 0x0 /end MEASUREMENT
/begin MEASUREMENT Com_RxSigInfo[239].RxCbkFuncPtrAckIdxOfRxSigInfo "" UBYTE Com_RxCbkFuncPtrAckIdxOfRxSigInfoType 0 0 0 255 ECU_ADDRESS 0x0 /end MEASUREMENT
/begin MEASUREMENT Com_RxSigInfo[239].SignalProcessingOfRxSigInfo "" UBYTE Com_SignalProcessingOfRxSigInfoType 0 0 0 255 ECU_ADDRESS 0x0 /end MEASUREMENT
/begin MEASUREMENT Com_RxSigInfo[239].ValidDlcOfRxSigInfo "" UBYTE NO_COMPU_METHOD 0 0 0 255 ECU_ADDRESS 0x0 /end MEASUREMENT
/begin MEASUREMENT Com_RxSigInfo[23].RxAccessInfoIdxOfRxSigInfo "" UWORD NO_COMPU_METHOD 0 0 0 65535 ECU_ADDRESS 0x0 /end MEASUREMENT
/begin MEASUREMENT Com_RxSigInfo[23].RxCbkFuncPtrAckIdxOfRxSigInfo "" UBYTE Com_RxCbkFuncPtrAckIdxOfRxSigInfoType 0 0 0 255 ECU_ADDRESS 0x0 /end MEASUREMENT
/begin MEASUREMENT Com_RxSigInfo[23].SignalProcessingOfRxSigInfo "" UBYTE Com_SignalProcessingOfRxSigInfoType 0 0 0 255 ECU_ADDRESS 0x0 /end MEASUREMENT
/begin MEASUREMENT Com_RxSigInfo[23].ValidDlcOfRxSigInfo "" UBYTE NO_COMPU_METHOD 0 0 0 255 ECU_ADDRESS 0x0 /end MEASUREMENT
/begin MEASUREMENT Com_RxSigInfo[240].RxAccessInfoIdxOfRxSigInfo "" UWORD NO_COMPU_METHOD 0 0 0 65535 ECU_ADDRESS 0x0 /end MEASUREMENT
/begin MEASUREMENT Com_RxSigInfo[240].RxCbkFuncPtrAckIdxOfRxSigInfo "" UBYTE Com_RxCbkFuncPtrAckIdxOfRxSigInfoType 0 0 0 255 ECU_ADDRESS 0x0 /end MEASUREMENT
/begin MEASUREMENT Com_RxSigInfo[240].SignalProcessingOfRxSigInfo "" UBYTE Com_SignalProcessingOfRxSigInfoType 0 0 0 255 ECU_ADDRESS 0x0 /end MEASUREMENT
/begin MEASUREMENT Com_RxSigInfo[240].ValidDlcOfRxSigInfo "" UBYTE NO_COMPU_METHOD 0 0 0 255 ECU_ADDRESS 0x0 /end MEASUREMENT
/begin MEASUREMENT Com_RxSigInfo[241].RxAccessInfoIdxOfRxSigInfo "" UWORD NO_COMPU_METHOD 0 0 0 65535 ECU_ADDRESS 0x0 /end MEASUREMENT
/begin MEASUREMENT Com_RxSigInfo[241].RxCbkFuncPtrAckIdxOfRxSigInfo "" UBYTE Com_RxCbkFuncPtrAckIdxOfRxSigInfoType 0 0 0 255 ECU_ADDRESS 0x0 /end MEASUREMENT
/begin MEASUREMENT Com_RxSigInfo[241].SignalProcessingOfRxSigInfo "" UBYTE Com_SignalProcessingOfRxSigInfoType 0 0 0 255 ECU_ADDRESS 0x0 /end MEASUREMENT
/begin MEASUREMENT Com_RxSigInfo[241].ValidDlcOfRxSigInfo "" UBYTE NO_COMPU_METHOD 0 0 0 255 ECU_ADDRESS 0x0 /end MEASUREMENT
/begin MEASUREMENT Com_RxSigInfo[242].RxAccessInfoIdxOfRxSigInfo "" UWORD NO_COMPU_METHOD 0 0 0 65535 ECU_ADDRESS 0x0 /end MEASUREMENT
/begin MEASUREMENT Com_RxSigInfo[242].RxCbkFuncPtrAckIdxOfRxSigInfo "" UBYTE Com_RxCbkFuncPtrAckIdxOfRxSigInfoType 0 0 0 255 ECU_ADDRESS 0x0 /end MEASUREMENT
/begin MEASUREMENT Com_RxSigInfo[242].SignalProcessingOfRxSigInfo "" UBYTE Com_SignalProcessingOfRxSigInfoType 0 0 0 255 ECU_ADDRESS 0x0 /end MEASUREMENT
/begin MEASUREMENT Com_RxSigInfo[242].ValidDlcOfRxSigInfo "" UBYTE NO_COMPU_METHOD 0 0 0 255 ECU_ADDRESS 0x0 /end MEASUREMENT
/begin MEASUREMENT Com_RxSigInfo[243].RxAccessInfoIdxOfRxSigInfo "" UWORD NO_COMPU_METHOD 0 0 0 65535 ECU_ADDRESS 0x0 /end MEASUREMENT
/begin MEASUREMENT Com_RxSigInfo[243].RxCbkFuncPtrAckIdxOfRxSigInfo "" UBYTE Com_RxCbkFuncPtrAckIdxOfRxSigInfoType 0 0 0 255 ECU_ADDRESS 0x0 /end MEASUREMENT
/begin MEASUREMENT Com_RxSigInfo[243].SignalProcessingOfRxSigInfo "" UBYTE Com_SignalProcessingOfRxSigInfoType 0 0 0 255 ECU_ADDRESS 0x0 /end MEASUREMENT
/begin MEASUREMENT Com_RxSigInfo[243].ValidDlcOfRxSigInfo "" UBYTE NO_COMPU_METHOD 0 0 0 255 ECU_ADDRESS 0x0 /end MEASUREMENT
/begin MEASUREMENT Com_RxSigInfo[244].RxAccessInfoIdxOfRxSigInfo "" UWORD NO_COMPU_METHOD 0 0 0 65535 ECU_ADDRESS 0x0 /end MEASUREMENT
/begin MEASUREMENT Com_RxSigInfo[244].RxCbkFuncPtrAckIdxOfRxSigInfo "" UBYTE Com_RxCbkFuncPtrAckIdxOfRxSigInfoType 0 0 0 255 ECU_ADDRESS 0x0 /end MEASUREMENT
/begin MEASUREMENT Com_RxSigInfo[244].SignalProcessingOfRxSigInfo "" UBYTE Com_SignalProcessingOfRxSigInfoType 0 0 0 255 ECU_ADDRESS 0x0 /end MEASUREMENT
/begin MEASUREMENT Com_RxSigInfo[244].ValidDlcOfRxSigInfo "" UBYTE NO_COMPU_METHOD 0 0 0 255 ECU_ADDRESS 0x0 /end MEASUREMENT
/begin MEASUREMENT Com_RxSigInfo[245].RxAccessInfoIdxOfRxSigInfo "" UWORD NO_COMPU_METHOD 0 0 0 65535 ECU_ADDRESS 0x0 /end MEASUREMENT
/begin MEASUREMENT Com_RxSigInfo[245].RxCbkFuncPtrAckIdxOfRxSigInfo "" UBYTE Com_RxCbkFuncPtrAckIdxOfRxSigInfoType 0 0 0 255 ECU_ADDRESS 0x0 /end MEASUREMENT
/begin MEASUREMENT Com_RxSigInfo[245].SignalProcessingOfRxSigInfo "" UBYTE Com_SignalProcessingOfRxSigInfoType 0 0 0 255 ECU_ADDRESS 0x0 /end MEASUREMENT
/begin MEASUREMENT Com_RxSigInfo[245].ValidDlcOfRxSigInfo "" UBYTE NO_COMPU_METHOD 0 0 0 255 ECU_ADDRESS 0x0 /end MEASUREMENT
/begin MEASUREMENT Com_RxSigInfo[246].RxAccessInfoIdxOfRxSigInfo "" UWORD NO_COMPU_METHOD 0 0 0 65535 ECU_ADDRESS 0x0 /end MEASUREMENT
/begin MEASUREMENT Com_RxSigInfo[246].RxCbkFuncPtrAckIdxOfRxSigInfo "" UBYTE Com_RxCbkFuncPtrAckIdxOfRxSigInfoType 0 0 0 255 ECU_ADDRESS 0x0 /end MEASUREMENT
/begin MEASUREMENT Com_RxSigInfo[246].SignalProcessingOfRxSigInfo "" UBYTE Com_SignalProcessingOfRxSigInfoType 0 0 0 255 ECU_ADDRESS 0x0 /end MEASUREMENT
/begin MEASUREMENT Com_RxSigInfo[246].ValidDlcOfRxSigInfo "" UBYTE NO_COMPU_METHOD 0 0 0 255 ECU_ADDRESS 0x0 /end MEASUREMENT
/begin MEASUREMENT Com_RxSigInfo[247].RxAccessInfoIdxOfRxSigInfo "" UWORD NO_COMPU_METHOD 0 0 0 65535 ECU_ADDRESS 0x0 /end MEASUREMENT
/begin MEASUREMENT Com_RxSigInfo[247].RxCbkFuncPtrAckIdxOfRxSigInfo "" UBYTE Com_RxCbkFuncPtrAckIdxOfRxSigInfoType 0 0 0 255 ECU_ADDRESS 0x0 /end MEASUREMENT
/begin MEASUREMENT Com_RxSigInfo[247].SignalProcessingOfRxSigInfo "" UBYTE Com_SignalProcessingOfRxSigInfoType 0 0 0 255 ECU_ADDRESS 0x0 /end MEASUREMENT
/begin MEASUREMENT Com_RxSigInfo[247].ValidDlcOfRxSigInfo "" UBYTE NO_COMPU_METHOD 0 0 0 255 ECU_ADDRESS 0x0 /end MEASUREMENT
/begin MEASUREMENT Com_RxSigInfo[248].RxAccessInfoIdxOfRxSigInfo "" UWORD NO_COMPU_METHOD 0 0 0 65535 ECU_ADDRESS 0x0 /end MEASUREMENT
/begin MEASUREMENT Com_RxSigInfo[248].RxCbkFuncPtrAckIdxOfRxSigInfo "" UBYTE Com_RxCbkFuncPtrAckIdxOfRxSigInfoType 0 0 0 255 ECU_ADDRESS 0x0 /end MEASUREMENT
/begin MEASUREMENT Com_RxSigInfo[248].SignalProcessingOfRxSigInfo "" UBYTE Com_SignalProcessingOfRxSigInfoType 0 0 0 255 ECU_ADDRESS 0x0 /end MEASUREMENT
/begin MEASUREMENT Com_RxSigInfo[248].ValidDlcOfRxSigInfo "" UBYTE NO_COMPU_METHOD 0 0 0 255 ECU_ADDRESS 0x0 /end MEASUREMENT
/begin MEASUREMENT Com_RxSigInfo[249].RxAccessInfoIdxOfRxSigInfo "" UWORD NO_COMPU_METHOD 0 0 0 65535 ECU_ADDRESS 0x0 /end MEASUREMENT
/begin MEASUREMENT Com_RxSigInfo[249].RxCbkFuncPtrAckIdxOfRxSigInfo "" UBYTE Com_RxCbkFuncPtrAckIdxOfRxSigInfoType 0 0 0 255 ECU_ADDRESS 0x0 /end MEASUREMENT
/begin MEASUREMENT Com_RxSigInfo[249].SignalProcessingOfRxSigInfo "" UBYTE Com_SignalProcessingOfRxSigInfoType 0 0 0 255 ECU_ADDRESS 0x0 /end MEASUREMENT
/begin MEASUREMENT Com_RxSigInfo[249].ValidDlcOfRxSigInfo "" UBYTE NO_COMPU_METHOD 0 0 0 255 ECU_ADDRESS 0x0 /end MEASUREMENT
/begin MEASUREMENT Com_RxSigInfo[24].RxAccessInfoIdxOfRxSigInfo "" UWORD NO_COMPU_METHOD 0 0 0 65535 ECU_ADDRESS 0x0 /end MEASUREMENT
/begin MEASUREMENT Com_RxSigInfo[24].RxCbkFuncPtrAckIdxOfRxSigInfo "" UBYTE Com_RxCbkFuncPtrAckIdxOfRxSigInfoType 0 0 0 255 ECU_ADDRESS 0x0 /end MEASUREMENT
/begin MEASUREMENT Com_RxSigInfo[24].SignalProcessingOfRxSigInfo "" UBYTE Com_SignalProcessingOfRxSigInfoType 0 0 0 255 ECU_ADDRESS 0x0 /end MEASUREMENT
/begin MEASUREMENT Com_RxSigInfo[24].ValidDlcOfRxSigInfo "" UBYTE NO_COMPU_METHOD 0 0 0 255 ECU_ADDRESS 0x0 /end MEASUREMENT
/begin MEASUREMENT Com_RxSigInfo[250].RxAccessInfoIdxOfRxSigInfo "" UWORD NO_COMPU_METHOD 0 0 0 65535 ECU_ADDRESS 0x0 /end MEASUREMENT
/begin MEASUREMENT Com_RxSigInfo[250].RxCbkFuncPtrAckIdxOfRxSigInfo "" UBYTE Com_RxCbkFuncPtrAckIdxOfRxSigInfoType 0 0 0 255 ECU_ADDRESS 0x0 /end MEASUREMENT
/begin MEASUREMENT Com_RxSigInfo[250].SignalProcessingOfRxSigInfo "" UBYTE Com_SignalProcessingOfRxSigInfoType 0 0 0 255 ECU_ADDRESS 0x0 /end MEASUREMENT
/begin MEASUREMENT Com_RxSigInfo[250].ValidDlcOfRxSigInfo "" UBYTE NO_COMPU_METHOD 0 0 0 255 ECU_ADDRESS 0x0 /end MEASUREMENT
/begin MEASUREMENT Com_RxSigInfo[251].RxAccessInfoIdxOfRxSigInfo "" UWORD NO_COMPU_METHOD 0 0 0 65535 ECU_ADDRESS 0x0 /end MEASUREMENT
/begin MEASUREMENT Com_RxSigInfo[251].RxCbkFuncPtrAckIdxOfRxSigInfo "" UBYTE Com_RxCbkFuncPtrAckIdxOfRxSigInfoType 0 0 0 255 ECU_ADDRESS 0x0 /end MEASUREMENT
/begin MEASUREMENT Com_RxSigInfo[251].SignalProcessingOfRxSigInfo "" UBYTE Com_SignalProcessingOfRxSigInfoType 0 0 0 255 ECU_ADDRESS 0x0 /end MEASUREMENT
/begin MEASUREMENT Com_RxSigInfo[251].ValidDlcOfRxSigInfo "" UBYTE NO_COMPU_METHOD 0 0 0 255 ECU_ADDRESS 0x0 /end MEASUREMENT
/begin MEASUREMENT Com_RxSigInfo[252].RxAccessInfoIdxOfRxSigInfo "" UWORD NO_COMPU_METHOD 0 0 0 65535 ECU_ADDRESS 0x0 /end MEASUREMENT
/begin MEASUREMENT Com_RxSigInfo[252].RxCbkFuncPtrAckIdxOfRxSigInfo "" UBYTE Com_RxCbkFuncPtrAckIdxOfRxSigInfoType 0 0 0 255 ECU_ADDRESS 0x0 /end MEASUREMENT
/begin MEASUREMENT Com_RxSigInfo[252].SignalProcessingOfRxSigInfo "" UBYTE Com_SignalProcessingOfRxSigInfoType 0 0 0 255 ECU_ADDRESS 0x0 /end MEASUREMENT
/begin MEASUREMENT Com_RxSigInfo[252].ValidDlcOfRxSigInfo "" UBYTE NO_COMPU_METHOD 0 0 0 255 ECU_ADDRESS 0x0 /end MEASUREMENT
/begin MEASUREMENT Com_RxSigInfo[253].RxAccessInfoIdxOfRxSigInfo "" UWORD NO_COMPU_METHOD 0 0 0 65535 ECU_ADDRESS 0x0 /end MEASUREMENT
/begin MEASUREMENT Com_RxSigInfo[253].RxCbkFuncPtrAckIdxOfRxSigInfo "" UBYTE Com_RxCbkFuncPtrAckIdxOfRxSigInfoType 0 0 0 255 ECU_ADDRESS 0x0 /end MEASUREMENT
/begin MEASUREMENT Com_RxSigInfo[253].SignalProcessingOfRxSigInfo "" UBYTE Com_SignalProcessingOfRxSigInfoType 0 0 0 255 ECU_ADDRESS 0x0 /end MEASUREMENT
/begin MEASUREMENT Com_RxSigInfo[253].ValidDlcOfRxSigInfo "" UBYTE NO_COMPU_METHOD 0 0 0 255 ECU_ADDRESS 0x0 /end MEASUREMENT
/begin MEASUREMENT Com_RxSigInfo[254].RxAccessInfoIdxOfRxSigInfo "" UWORD NO_COMPU_METHOD 0 0 0 65535 ECU_ADDRESS 0x0 /end MEASUREMENT
/begin MEASUREMENT Com_RxSigInfo[254].RxCbkFuncPtrAckIdxOfRxSigInfo "" UBYTE Com_RxCbkFuncPtrAckIdxOfRxSigInfoType 0 0 0 255 ECU_ADDRESS 0x0 /end MEASUREMENT
/begin MEASUREMENT Com_RxSigInfo[254].SignalProcessingOfRxSigInfo "" UBYTE Com_SignalProcessingOfRxSigInfoType 0 0 0 255 ECU_ADDRESS 0x0 /end MEASUREMENT
/begin MEASUREMENT Com_RxSigInfo[254].ValidDlcOfRxSigInfo "" UBYTE NO_COMPU_METHOD 0 0 0 255 ECU_ADDRESS 0x0 /end MEASUREMENT
/begin MEASUREMENT Com_RxSigInfo[255].RxAccessInfoIdxOfRxSigInfo "" UWORD NO_COMPU_METHOD 0 0 0 65535 ECU_ADDRESS 0x0 /end MEASUREMENT
/begin MEASUREMENT Com_RxSigInfo[255].RxCbkFuncPtrAckIdxOfRxSigInfo "" UBYTE Com_RxCbkFuncPtrAckIdxOfRxSigInfoType 0 0 0 255 ECU_ADDRESS 0x0 /end MEASUREMENT
/begin MEASUREMENT Com_RxSigInfo[255].SignalProcessingOfRxSigInfo "" UBYTE Com_SignalProcessingOfRxSigInfoType 0 0 0 255 ECU_ADDRESS 0x0 /end MEASUREMENT
/begin MEASUREMENT Com_RxSigInfo[255].ValidDlcOfRxSigInfo "" UBYTE NO_COMPU_METHOD 0 0 0 255 ECU_ADDRESS 0x0 /end MEASUREMENT
/begin MEASUREMENT Com_RxSigInfo[256].RxAccessInfoIdxOfRxSigInfo "" UWORD NO_COMPU_METHOD 0 0 0 65535 ECU_ADDRESS 0x0 /end MEASUREMENT
/begin MEASUREMENT Com_RxSigInfo[256].RxCbkFuncPtrAckIdxOfRxSigInfo "" UBYTE Com_RxCbkFuncPtrAckIdxOfRxSigInfoType 0 0 0 255 ECU_ADDRESS 0x0 /end MEASUREMENT
/begin MEASUREMENT Com_RxSigInfo[256].SignalProcessingOfRxSigInfo "" UBYTE Com_SignalProcessingOfRxSigInfoType 0 0 0 255 ECU_ADDRESS 0x0 /end MEASUREMENT
/begin MEASUREMENT Com_RxSigInfo[256].ValidDlcOfRxSigInfo "" UBYTE NO_COMPU_METHOD 0 0 0 255 ECU_ADDRESS 0x0 /end MEASUREMENT
/begin MEASUREMENT Com_RxSigInfo[257].RxAccessInfoIdxOfRxSigInfo "" UWORD NO_COMPU_METHOD 0 0 0 65535 ECU_ADDRESS 0x0 /end MEASUREMENT
/begin MEASUREMENT Com_RxSigInfo[257].RxCbkFuncPtrAckIdxOfRxSigInfo "" UBYTE Com_RxCbkFuncPtrAckIdxOfRxSigInfoType 0 0 0 255 ECU_ADDRESS 0x0 /end MEASUREMENT
/begin MEASUREMENT Com_RxSigInfo[257].SignalProcessingOfRxSigInfo "" UBYTE Com_SignalProcessingOfRxSigInfoType 0 0 0 255 ECU_ADDRESS 0x0 /end MEASUREMENT
/begin MEASUREMENT Com_RxSigInfo[257].ValidDlcOfRxSigInfo "" UBYTE NO_COMPU_METHOD 0 0 0 255 ECU_ADDRESS 0x0 /end MEASUREMENT
/begin MEASUREMENT Com_RxSigInfo[258].RxAccessInfoIdxOfRxSigInfo "" UWORD NO_COMPU_METHOD 0 0 0 65535 ECU_ADDRESS 0x0 /end MEASUREMENT
/begin MEASUREMENT Com_RxSigInfo[258].RxCbkFuncPtrAckIdxOfRxSigInfo "" UBYTE Com_RxCbkFuncPtrAckIdxOfRxSigInfoType 0 0 0 255 ECU_ADDRESS 0x0 /end MEASUREMENT
/begin MEASUREMENT Com_RxSigInfo[258].SignalProcessingOfRxSigInfo "" UBYTE Com_SignalProcessingOfRxSigInfoType 0 0 0 255 ECU_ADDRESS 0x0 /end MEASUREMENT
/begin MEASUREMENT Com_RxSigInfo[258].ValidDlcOfRxSigInfo "" UBYTE NO_COMPU_METHOD 0 0 0 255 ECU_ADDRESS 0x0 /end MEASUREMENT
/begin MEASUREMENT Com_RxSigInfo[259].RxAccessInfoIdxOfRxSigInfo "" UWORD NO_COMPU_METHOD 0 0 0 65535 ECU_ADDRESS 0x0 /end MEASUREMENT
/begin MEASUREMENT Com_RxSigInfo[259].RxCbkFuncPtrAckIdxOfRxSigInfo "" UBYTE Com_RxCbkFuncPtrAckIdxOfRxSigInfoType 0 0 0 255 ECU_ADDRESS 0x0 /end MEASUREMENT
/begin MEASUREMENT Com_RxSigInfo[259].SignalProcessingOfRxSigInfo "" UBYTE Com_SignalProcessingOfRxSigInfoType 0 0 0 255 ECU_ADDRESS 0x0 /end MEASUREMENT
/begin MEASUREMENT Com_RxSigInfo[259].ValidDlcOfRxSigInfo "" UBYTE NO_COMPU_METHOD 0 0 0 255 ECU_ADDRESS 0x0 /end MEASUREMENT
/begin MEASUREMENT Com_RxSigInfo[25].RxAccessInfoIdxOfRxSigInfo "" UWORD NO_COMPU_METHOD 0 0 0 65535 ECU_ADDRESS 0x0 /end MEASUREMENT
/begin MEASUREMENT Com_RxSigInfo[25].RxCbkFuncPtrAckIdxOfRxSigInfo "" UBYTE Com_RxCbkFuncPtrAckIdxOfRxSigInfoType 0 0 0 255 ECU_ADDRESS 0x0 /end MEASUREMENT
/begin MEASUREMENT Com_RxSigInfo[25].SignalProcessingOfRxSigInfo "" UBYTE Com_SignalProcessingOfRxSigInfoType 0 0 0 255 ECU_ADDRESS 0x0 /end MEASUREMENT
/begin MEASUREMENT Com_RxSigInfo[25].ValidDlcOfRxSigInfo "" UBYTE NO_COMPU_METHOD 0 0 0 255 ECU_ADDRESS 0x0 /end MEASUREMENT
/begin MEASUREMENT Com_RxSigInfo[260].RxAccessInfoIdxOfRxSigInfo "" UWORD NO_COMPU_METHOD 0 0 0 65535 ECU_ADDRESS 0x0 /end MEASUREMENT
/begin MEASUREMENT Com_RxSigInfo[260].RxCbkFuncPtrAckIdxOfRxSigInfo "" UBYTE Com_RxCbkFuncPtrAckIdxOfRxSigInfoType 0 0 0 255 ECU_ADDRESS 0x0 /end MEASUREMENT
/begin MEASUREMENT Com_RxSigInfo[260].SignalProcessingOfRxSigInfo "" UBYTE Com_SignalProcessingOfRxSigInfoType 0 0 0 255 ECU_ADDRESS 0x0 /end MEASUREMENT
/begin MEASUREMENT Com_RxSigInfo[260].ValidDlcOfRxSigInfo "" UBYTE NO_COMPU_METHOD 0 0 0 255 ECU_ADDRESS 0x0 /end MEASUREMENT
/begin MEASUREMENT Com_RxSigInfo[261].RxAccessInfoIdxOfRxSigInfo "" UWORD NO_COMPU_METHOD 0 0 0 65535 ECU_ADDRESS 0x0 /end MEASUREMENT
/begin MEASUREMENT Com_RxSigInfo[261].RxCbkFuncPtrAckIdxOfRxSigInfo "" UBYTE Com_RxCbkFuncPtrAckIdxOfRxSigInfoType 0 0 0 255 ECU_ADDRESS 0x0 /end MEASUREMENT
/begin MEASUREMENT Com_RxSigInfo[261].SignalProcessingOfRxSigInfo "" UBYTE Com_SignalProcessingOfRxSigInfoType 0 0 0 255 ECU_ADDRESS 0x0 /end MEASUREMENT
/begin MEASUREMENT Com_RxSigInfo[261].ValidDlcOfRxSigInfo "" UBYTE NO_COMPU_METHOD 0 0 0 255 ECU_ADDRESS 0x0 /end MEASUREMENT
/begin MEASUREMENT Com_RxSigInfo[262].RxAccessInfoIdxOfRxSigInfo "" UWORD NO_COMPU_METHOD 0 0 0 65535 ECU_ADDRESS 0x0 /end MEASUREMENT
/begin MEASUREMENT Com_RxSigInfo[262].RxCbkFuncPtrAckIdxOfRxSigInfo "" UBYTE Com_RxCbkFuncPtrAckIdxOfRxSigInfoType 0 0 0 255 ECU_ADDRESS 0x0 /end MEASUREMENT
/begin MEASUREMENT Com_RxSigInfo[262].SignalProcessingOfRxSigInfo "" UBYTE Com_SignalProcessingOfRxSigInfoType 0 0 0 255 ECU_ADDRESS 0x0 /end MEASUREMENT
/begin MEASUREMENT Com_RxSigInfo[262].ValidDlcOfRxSigInfo "" UBYTE NO_COMPU_METHOD 0 0 0 255 ECU_ADDRESS 0x0 /end MEASUREMENT
/begin MEASUREMENT Com_RxSigInfo[263].RxAccessInfoIdxOfRxSigInfo "" UWORD NO_COMPU_METHOD 0 0 0 65535 ECU_ADDRESS 0x0 /end MEASUREMENT
/begin MEASUREMENT Com_RxSigInfo[263].RxCbkFuncPtrAckIdxOfRxSigInfo "" UBYTE Com_RxCbkFuncPtrAckIdxOfRxSigInfoType 0 0 0 255 ECU_ADDRESS 0x0 /end MEASUREMENT
/begin MEASUREMENT Com_RxSigInfo[263].SignalProcessingOfRxSigInfo "" UBYTE Com_SignalProcessingOfRxSigInfoType 0 0 0 255 ECU_ADDRESS 0x0 /end MEASUREMENT
/begin MEASUREMENT Com_RxSigInfo[263].ValidDlcOfRxSigInfo "" UBYTE NO_COMPU_METHOD 0 0 0 255 ECU_ADDRESS 0x0 /end MEASUREMENT
/begin MEASUREMENT Com_RxSigInfo[264].RxAccessInfoIdxOfRxSigInfo "" UWORD NO_COMPU_METHOD 0 0 0 65535 ECU_ADDRESS 0x0 /end MEASUREMENT
/begin MEASUREMENT Com_RxSigInfo[264].RxCbkFuncPtrAckIdxOfRxSigInfo "" UBYTE Com_RxCbkFuncPtrAckIdxOfRxSigInfoType 0 0 0 255 ECU_ADDRESS 0x0 /end MEASUREMENT
/begin MEASUREMENT Com_RxSigInfo[264].SignalProcessingOfRxSigInfo "" UBYTE Com_SignalProcessingOfRxSigInfoType 0 0 0 255 ECU_ADDRESS 0x0 /end MEASUREMENT
/begin MEASUREMENT Com_RxSigInfo[264].ValidDlcOfRxSigInfo "" UBYTE NO_COMPU_METHOD 0 0 0 255 ECU_ADDRESS 0x0 /end MEASUREMENT
/begin MEASUREMENT Com_RxSigInfo[265].RxAccessInfoIdxOfRxSigInfo "" UWORD NO_COMPU_METHOD 0 0 0 65535 ECU_ADDRESS 0x0 /end MEASUREMENT
/begin MEASUREMENT Com_RxSigInfo[265].RxCbkFuncPtrAckIdxOfRxSigInfo "" UBYTE Com_RxCbkFuncPtrAckIdxOfRxSigInfoType 0 0 0 255 ECU_ADDRESS 0x0 /end MEASUREMENT
/begin MEASUREMENT Com_RxSigInfo[265].SignalProcessingOfRxSigInfo "" UBYTE Com_SignalProcessingOfRxSigInfoType 0 0 0 255 ECU_ADDRESS 0x0 /end MEASUREMENT
/begin MEASUREMENT Com_RxSigInfo[265].ValidDlcOfRxSigInfo "" UBYTE NO_COMPU_METHOD 0 0 0 255 ECU_ADDRESS 0x0 /end MEASUREMENT
/begin MEASUREMENT Com_RxSigInfo[266].RxAccessInfoIdxOfRxSigInfo "" UWORD NO_COMPU_METHOD 0 0 0 65535 ECU_ADDRESS 0x0 /end MEASUREMENT
/begin MEASUREMENT Com_RxSigInfo[266].RxCbkFuncPtrAckIdxOfRxSigInfo "" UBYTE Com_RxCbkFuncPtrAckIdxOfRxSigInfoType 0 0 0 255 ECU_ADDRESS 0x0 /end MEASUREMENT
/begin MEASUREMENT Com_RxSigInfo[266].SignalProcessingOfRxSigInfo "" UBYTE Com_SignalProcessingOfRxSigInfoType 0 0 0 255 ECU_ADDRESS 0x0 /end MEASUREMENT
/begin MEASUREMENT Com_RxSigInfo[266].ValidDlcOfRxSigInfo "" UBYTE NO_COMPU_METHOD 0 0 0 255 ECU_ADDRESS 0x0 /end MEASUREMENT
/begin MEASUREMENT Com_RxSigInfo[267].RxAccessInfoIdxOfRxSigInfo "" UWORD NO_COMPU_METHOD 0 0 0 65535 ECU_ADDRESS 0x0 /end MEASUREMENT
/begin MEASUREMENT Com_RxSigInfo[267].RxCbkFuncPtrAckIdxOfRxSigInfo "" UBYTE Com_RxCbkFuncPtrAckIdxOfRxSigInfoType 0 0 0 255 ECU_ADDRESS 0x0 /end MEASUREMENT
/begin MEASUREMENT Com_RxSigInfo[267].SignalProcessingOfRxSigInfo "" UBYTE Com_SignalProcessingOfRxSigInfoType 0 0 0 255 ECU_ADDRESS 0x0 /end MEASUREMENT
/begin MEASUREMENT Com_RxSigInfo[267].ValidDlcOfRxSigInfo "" UBYTE NO_COMPU_METHOD 0 0 0 255 ECU_ADDRESS 0x0 /end MEASUREMENT
/begin MEASUREMENT Com_RxSigInfo[268].RxAccessInfoIdxOfRxSigInfo "" UWORD NO_COMPU_METHOD 0 0 0 65535 ECU_ADDRESS 0x0 /end MEASUREMENT
/begin MEASUREMENT Com_RxSigInfo[268].RxCbkFuncPtrAckIdxOfRxSigInfo "" UBYTE Com_RxCbkFuncPtrAckIdxOfRxSigInfoType 0 0 0 255 ECU_ADDRESS 0x0 /end MEASUREMENT
/begin MEASUREMENT Com_RxSigInfo[268].SignalProcessingOfRxSigInfo "" UBYTE Com_SignalProcessingOfRxSigInfoType 0 0 0 255 ECU_ADDRESS 0x0 /end MEASUREMENT
/begin MEASUREMENT Com_RxSigInfo[268].ValidDlcOfRxSigInfo "" UBYTE NO_COMPU_METHOD 0 0 0 255 ECU_ADDRESS 0x0 /end MEASUREMENT
/begin MEASUREMENT Com_RxSigInfo[269].RxAccessInfoIdxOfRxSigInfo "" UWORD NO_COMPU_METHOD 0 0 0 65535 ECU_ADDRESS 0x0 /end MEASUREMENT
/begin MEASUREMENT Com_RxSigInfo[269].RxCbkFuncPtrAckIdxOfRxSigInfo "" UBYTE Com_RxCbkFuncPtrAckIdxOfRxSigInfoType 0 0 0 255 ECU_ADDRESS 0x0 /end MEASUREMENT
/begin MEASUREMENT Com_RxSigInfo[269].SignalProcessingOfRxSigInfo "" UBYTE Com_SignalProcessingOfRxSigInfoType 0 0 0 255 ECU_ADDRESS 0x0 /end MEASUREMENT
/begin MEASUREMENT Com_RxSigInfo[269].ValidDlcOfRxSigInfo "" UBYTE NO_COMPU_METHOD 0 0 0 255 ECU_ADDRESS 0x0 /end MEASUREMENT
/begin MEASUREMENT Com_RxSigInfo[26].RxAccessInfoIdxOfRxSigInfo "" UWORD NO_COMPU_METHOD 0 0 0 65535 ECU_ADDRESS 0x0 /end MEASUREMENT
/begin MEASUREMENT Com_RxSigInfo[26].RxCbkFuncPtrAckIdxOfRxSigInfo "" UBYTE Com_RxCbkFuncPtrAckIdxOfRxSigInfoType 0 0 0 255 ECU_ADDRESS 0x0 /end MEASUREMENT
/begin MEASUREMENT Com_RxSigInfo[26].SignalProcessingOfRxSigInfo "" UBYTE Com_SignalProcessingOfRxSigInfoType 0 0 0 255 ECU_ADDRESS 0x0 /end MEASUREMENT
/begin MEASUREMENT Com_RxSigInfo[26].ValidDlcOfRxSigInfo "" UBYTE NO_COMPU_METHOD 0 0 0 255 ECU_ADDRESS 0x0 /end MEASUREMENT
/begin MEASUREMENT Com_RxSigInfo[270].RxAccessInfoIdxOfRxSigInfo "" UWORD NO_COMPU_METHOD 0 0 0 65535 ECU_ADDRESS 0x0 /end MEASUREMENT
/begin MEASUREMENT Com_RxSigInfo[270].RxCbkFuncPtrAckIdxOfRxSigInfo "" UBYTE Com_RxCbkFuncPtrAckIdxOfRxSigInfoType 0 0 0 255 ECU_ADDRESS 0x0 /end MEASUREMENT
/begin MEASUREMENT Com_RxSigInfo[270].SignalProcessingOfRxSigInfo "" UBYTE Com_SignalProcessingOfRxSigInfoType 0 0 0 255 ECU_ADDRESS 0x0 /end MEASUREMENT
/begin MEASUREMENT Com_RxSigInfo[270].ValidDlcOfRxSigInfo "" UBYTE NO_COMPU_METHOD 0 0 0 255 ECU_ADDRESS 0x0 /end MEASUREMENT
/begin MEASUREMENT Com_RxSigInfo[271].RxAccessInfoIdxOfRxSigInfo "" UWORD NO_COMPU_METHOD 0 0 0 65535 ECU_ADDRESS 0x0 /end MEASUREMENT
/begin MEASUREMENT Com_RxSigInfo[271].RxCbkFuncPtrAckIdxOfRxSigInfo "" UBYTE Com_RxCbkFuncPtrAckIdxOfRxSigInfoType 0 0 0 255 ECU_ADDRESS 0x0 /end MEASUREMENT
/begin MEASUREMENT Com_RxSigInfo[271].SignalProcessingOfRxSigInfo "" UBYTE Com_SignalProcessingOfRxSigInfoType 0 0 0 255 ECU_ADDRESS 0x0 /end MEASUREMENT
/begin MEASUREMENT Com_RxSigInfo[271].ValidDlcOfRxSigInfo "" UBYTE NO_COMPU_METHOD 0 0 0 255 ECU_ADDRESS 0x0 /end MEASUREMENT
/begin MEASUREMENT Com_RxSigInfo[272].RxAccessInfoIdxOfRxSigInfo "" UWORD NO_COMPU_METHOD 0 0 0 65535 ECU_ADDRESS 0x0 /end MEASUREMENT
/begin MEASUREMENT Com_RxSigInfo[272].RxCbkFuncPtrAckIdxOfRxSigInfo "" UBYTE Com_RxCbkFuncPtrAckIdxOfRxSigInfoType 0 0 0 255 ECU_ADDRESS 0x0 /end MEASUREMENT
/begin MEASUREMENT Com_RxSigInfo[272].SignalProcessingOfRxSigInfo "" UBYTE Com_SignalProcessingOfRxSigInfoType 0 0 0 255 ECU_ADDRESS 0x0 /end MEASUREMENT
/begin MEASUREMENT Com_RxSigInfo[272].ValidDlcOfRxSigInfo "" UBYTE NO_COMPU_METHOD 0 0 0 255 ECU_ADDRESS 0x0 /end MEASUREMENT
/begin MEASUREMENT Com_RxSigInfo[273].RxAccessInfoIdxOfRxSigInfo "" UWORD NO_COMPU_METHOD 0 0 0 65535 ECU_ADDRESS 0x0 /end MEASUREMENT
/begin MEASUREMENT Com_RxSigInfo[273].RxCbkFuncPtrAckIdxOfRxSigInfo "" UBYTE Com_RxCbkFuncPtrAckIdxOfRxSigInfoType 0 0 0 255 ECU_ADDRESS 0x0 /end MEASUREMENT
/begin MEASUREMENT Com_RxSigInfo[273].SignalProcessingOfRxSigInfo "" UBYTE Com_SignalProcessingOfRxSigInfoType 0 0 0 255 ECU_ADDRESS 0x0 /end MEASUREMENT
/begin MEASUREMENT Com_RxSigInfo[273].ValidDlcOfRxSigInfo "" UBYTE NO_COMPU_METHOD 0 0 0 255 ECU_ADDRESS 0x0 /end MEASUREMENT
/begin MEASUREMENT Com_RxSigInfo[274].RxAccessInfoIdxOfRxSigInfo "" UWORD NO_COMPU_METHOD 0 0 0 65535 ECU_ADDRESS 0x0 /end MEASUREMENT
/begin MEASUREMENT Com_RxSigInfo[274].RxCbkFuncPtrAckIdxOfRxSigInfo "" UBYTE Com_RxCbkFuncPtrAckIdxOfRxSigInfoType 0 0 0 255 ECU_ADDRESS 0x0 /end MEASUREMENT
/begin MEASUREMENT Com_RxSigInfo[274].SignalProcessingOfRxSigInfo "" UBYTE Com_SignalProcessingOfRxSigInfoType 0 0 0 255 ECU_ADDRESS 0x0 /end MEASUREMENT
/begin MEASUREMENT Com_RxSigInfo[274].ValidDlcOfRxSigInfo "" UBYTE NO_COMPU_METHOD 0 0 0 255 ECU_ADDRESS 0x0 /end MEASUREMENT
/begin MEASUREMENT Com_RxSigInfo[275].RxAccessInfoIdxOfRxSigInfo "" UWORD NO_COMPU_METHOD 0 0 0 65535 ECU_ADDRESS 0x0 /end MEASUREMENT
/begin MEASUREMENT Com_RxSigInfo[275].RxCbkFuncPtrAckIdxOfRxSigInfo "" UBYTE Com_RxCbkFuncPtrAckIdxOfRxSigInfoType 0 0 0 255 ECU_ADDRESS 0x0 /end MEASUREMENT
/begin MEASUREMENT Com_RxSigInfo[275].SignalProcessingOfRxSigInfo "" UBYTE Com_SignalProcessingOfRxSigInfoType 0 0 0 255 ECU_ADDRESS 0x0 /end MEASUREMENT
/begin MEASUREMENT Com_RxSigInfo[275].ValidDlcOfRxSigInfo "" UBYTE NO_COMPU_METHOD 0 0 0 255 ECU_ADDRESS 0x0 /end MEASUREMENT
/begin MEASUREMENT Com_RxSigInfo[276].RxAccessInfoIdxOfRxSigInfo "" UWORD NO_COMPU_METHOD 0 0 0 65535 ECU_ADDRESS 0x0 /end MEASUREMENT
/begin MEASUREMENT Com_RxSigInfo[276].RxCbkFuncPtrAckIdxOfRxSigInfo "" UBYTE Com_RxCbkFuncPtrAckIdxOfRxSigInfoType 0 0 0 255 ECU_ADDRESS 0x0 /end MEASUREMENT
/begin MEASUREMENT Com_RxSigInfo[276].SignalProcessingOfRxSigInfo "" UBYTE Com_SignalProcessingOfRxSigInfoType 0 0 0 255 ECU_ADDRESS 0x0 /end MEASUREMENT
/begin MEASUREMENT Com_RxSigInfo[276].ValidDlcOfRxSigInfo "" UBYTE NO_COMPU_METHOD 0 0 0 255 ECU_ADDRESS 0x0 /end MEASUREMENT
/begin MEASUREMENT Com_RxSigInfo[277].RxAccessInfoIdxOfRxSigInfo "" UWORD NO_COMPU_METHOD 0 0 0 65535 ECU_ADDRESS 0x0 /end MEASUREMENT
/begin MEASUREMENT Com_RxSigInfo[277].RxCbkFuncPtrAckIdxOfRxSigInfo "" UBYTE Com_RxCbkFuncPtrAckIdxOfRxSigInfoType 0 0 0 255 ECU_ADDRESS 0x0 /end MEASUREMENT
/begin MEASUREMENT Com_RxSigInfo[277].SignalProcessingOfRxSigInfo "" UBYTE Com_SignalProcessingOfRxSigInfoType 0 0 0 255 ECU_ADDRESS 0x0 /end MEASUREMENT
/begin MEASUREMENT Com_RxSigInfo[277].ValidDlcOfRxSigInfo "" UBYTE NO_COMPU_METHOD 0 0 0 255 ECU_ADDRESS 0x0 /end MEASUREMENT
/begin MEASUREMENT Com_RxSigInfo[278].RxAccessInfoIdxOfRxSigInfo "" UWORD NO_COMPU_METHOD 0 0 0 65535 ECU_ADDRESS 0x0 /end MEASUREMENT
/begin MEASUREMENT Com_RxSigInfo[278].RxCbkFuncPtrAckIdxOfRxSigInfo "" UBYTE Com_RxCbkFuncPtrAckIdxOfRxSigInfoType 0 0 0 255 ECU_ADDRESS 0x0 /end MEASUREMENT
/begin MEASUREMENT Com_RxSigInfo[278].SignalProcessingOfRxSigInfo "" UBYTE Com_SignalProcessingOfRxSigInfoType 0 0 0 255 ECU_ADDRESS 0x0 /end MEASUREMENT
/begin MEASUREMENT Com_RxSigInfo[278].ValidDlcOfRxSigInfo "" UBYTE NO_COMPU_METHOD 0 0 0 255 ECU_ADDRESS 0x0 /end MEASUREMENT
/begin MEASUREMENT Com_RxSigInfo[279].RxAccessInfoIdxOfRxSigInfo "" UWORD NO_COMPU_METHOD 0 0 0 65535 ECU_ADDRESS 0x0 /end MEASUREMENT
/begin MEASUREMENT Com_RxSigInfo[279].RxCbkFuncPtrAckIdxOfRxSigInfo "" UBYTE Com_RxCbkFuncPtrAckIdxOfRxSigInfoType 0 0 0 255 ECU_ADDRESS 0x0 /end MEASUREMENT
/begin MEASUREMENT Com_RxSigInfo[279].SignalProcessingOfRxSigInfo "" UBYTE Com_SignalProcessingOfRxSigInfoType 0 0 0 255 ECU_ADDRESS 0x0 /end MEASUREMENT
/begin MEASUREMENT Com_RxSigInfo[279].ValidDlcOfRxSigInfo "" UBYTE NO_COMPU_METHOD 0 0 0 255 ECU_ADDRESS 0x0 /end MEASUREMENT
/begin MEASUREMENT Com_RxSigInfo[27].RxAccessInfoIdxOfRxSigInfo "" UWORD NO_COMPU_METHOD 0 0 0 65535 ECU_ADDRESS 0x0 /end MEASUREMENT
/begin MEASUREMENT Com_RxSigInfo[27].RxCbkFuncPtrAckIdxOfRxSigInfo "" UBYTE Com_RxCbkFuncPtrAckIdxOfRxSigInfoType 0 0 0 255 ECU_ADDRESS 0x0 /end MEASUREMENT
/begin MEASUREMENT Com_RxSigInfo[27].SignalProcessingOfRxSigInfo "" UBYTE Com_SignalProcessingOfRxSigInfoType 0 0 0 255 ECU_ADDRESS 0x0 /end MEASUREMENT
/begin MEASUREMENT Com_RxSigInfo[27].ValidDlcOfRxSigInfo "" UBYTE NO_COMPU_METHOD 0 0 0 255 ECU_ADDRESS 0x0 /end MEASUREMENT
/begin MEASUREMENT Com_RxSigInfo[280].RxAccessInfoIdxOfRxSigInfo "" UWORD NO_COMPU_METHOD 0 0 0 65535 ECU_ADDRESS 0x0 /end MEASUREMENT
/begin MEASUREMENT Com_RxSigInfo[280].RxCbkFuncPtrAckIdxOfRxSigInfo "" UBYTE Com_RxCbkFuncPtrAckIdxOfRxSigInfoType 0 0 0 255 ECU_ADDRESS 0x0 /end MEASUREMENT
/begin MEASUREMENT Com_RxSigInfo[280].SignalProcessingOfRxSigInfo "" UBYTE Com_SignalProcessingOfRxSigInfoType 0 0 0 255 ECU_ADDRESS 0x0 /end MEASUREMENT
/begin MEASUREMENT Com_RxSigInfo[280].ValidDlcOfRxSigInfo "" UBYTE NO_COMPU_METHOD 0 0 0 255 ECU_ADDRESS 0x0 /end MEASUREMENT
/begin MEASUREMENT Com_RxSigInfo[281].RxAccessInfoIdxOfRxSigInfo "" UWORD NO_COMPU_METHOD 0 0 0 65535 ECU_ADDRESS 0x0 /end MEASUREMENT
/begin MEASUREMENT Com_RxSigInfo[281].RxCbkFuncPtrAckIdxOfRxSigInfo "" UBYTE Com_RxCbkFuncPtrAckIdxOfRxSigInfoType 0 0 0 255 ECU_ADDRESS 0x0 /end MEASUREMENT
/begin MEASUREMENT Com_RxSigInfo[281].SignalProcessingOfRxSigInfo "" UBYTE Com_SignalProcessingOfRxSigInfoType 0 0 0 255 ECU_ADDRESS 0x0 /end MEASUREMENT
/begin MEASUREMENT Com_RxSigInfo[281].ValidDlcOfRxSigInfo "" UBYTE NO_COMPU_METHOD 0 0 0 255 ECU_ADDRESS 0x0 /end MEASUREMENT
/begin MEASUREMENT Com_RxSigInfo[282].RxAccessInfoIdxOfRxSigInfo "" UWORD NO_COMPU_METHOD 0 0 0 65535 ECU_ADDRESS 0x0 /end MEASUREMENT
/begin MEASUREMENT Com_RxSigInfo[282].RxCbkFuncPtrAckIdxOfRxSigInfo "" UBYTE Com_RxCbkFuncPtrAckIdxOfRxSigInfoType 0 0 0 255 ECU_ADDRESS 0x0 /end MEASUREMENT
/begin MEASUREMENT Com_RxSigInfo[282].SignalProcessingOfRxSigInfo "" UBYTE Com_SignalProcessingOfRxSigInfoType 0 0 0 255 ECU_ADDRESS 0x0 /end MEASUREMENT
/begin MEASUREMENT Com_RxSigInfo[282].ValidDlcOfRxSigInfo "" UBYTE NO_COMPU_METHOD 0 0 0 255 ECU_ADDRESS 0x0 /end MEASUREMENT
/begin MEASUREMENT Com_RxSigInfo[283].RxAccessInfoIdxOfRxSigInfo "" UWORD NO_COMPU_METHOD 0 0 0 65535 ECU_ADDRESS 0x0 /end MEASUREMENT
/begin MEASUREMENT Com_RxSigInfo[283].RxCbkFuncPtrAckIdxOfRxSigInfo "" UBYTE Com_RxCbkFuncPtrAckIdxOfRxSigInfoType 0 0 0 255 ECU_ADDRESS 0x0 /end MEASUREMENT
/begin MEASUREMENT Com_RxSigInfo[283].SignalProcessingOfRxSigInfo "" UBYTE Com_SignalProcessingOfRxSigInfoType 0 0 0 255 ECU_ADDRESS 0x0 /end MEASUREMENT
/begin MEASUREMENT Com_RxSigInfo[283].ValidDlcOfRxSigInfo "" UBYTE NO_COMPU_METHOD 0 0 0 255 ECU_ADDRESS 0x0 /end MEASUREMENT
/begin MEASUREMENT Com_RxSigInfo[284].RxAccessInfoIdxOfRxSigInfo "" UWORD NO_COMPU_METHOD 0 0 0 65535 ECU_ADDRESS 0x0 /end MEASUREMENT
/begin MEASUREMENT Com_RxSigInfo[284].RxCbkFuncPtrAckIdxOfRxSigInfo "" UBYTE Com_RxCbkFuncPtrAckIdxOfRxSigInfoType 0 0 0 255 ECU_ADDRESS 0x0 /end MEASUREMENT
/begin MEASUREMENT Com_RxSigInfo[284].SignalProcessingOfRxSigInfo "" UBYTE Com_SignalProcessingOfRxSigInfoType 0 0 0 255 ECU_ADDRESS 0x0 /end MEASUREMENT
/begin MEASUREMENT Com_RxSigInfo[284].ValidDlcOfRxSigInfo "" UBYTE NO_COMPU_METHOD 0 0 0 255 ECU_ADDRESS 0x0 /end MEASUREMENT
/begin MEASUREMENT Com_RxSigInfo[285].RxAccessInfoIdxOfRxSigInfo "" UWORD NO_COMPU_METHOD 0 0 0 65535 ECU_ADDRESS 0x0 /end MEASUREMENT
/begin MEASUREMENT Com_RxSigInfo[285].RxCbkFuncPtrAckIdxOfRxSigInfo "" UBYTE Com_RxCbkFuncPtrAckIdxOfRxSigInfoType 0 0 0 255 ECU_ADDRESS 0x0 /end MEASUREMENT
/begin MEASUREMENT Com_RxSigInfo[285].SignalProcessingOfRxSigInfo "" UBYTE Com_SignalProcessingOfRxSigInfoType 0 0 0 255 ECU_ADDRESS 0x0 /end MEASUREMENT
/begin MEASUREMENT Com_RxSigInfo[285].ValidDlcOfRxSigInfo "" UBYTE NO_COMPU_METHOD 0 0 0 255 ECU_ADDRESS 0x0 /end MEASUREMENT
/begin MEASUREMENT Com_RxSigInfo[286].RxAccessInfoIdxOfRxSigInfo "" UWORD NO_COMPU_METHOD 0 0 0 65535 ECU_ADDRESS 0x0 /end MEASUREMENT
/begin MEASUREMENT Com_RxSigInfo[286].RxCbkFuncPtrAckIdxOfRxSigInfo "" UBYTE Com_RxCbkFuncPtrAckIdxOfRxSigInfoType 0 0 0 255 ECU_ADDRESS 0x0 /end MEASUREMENT
/begin MEASUREMENT Com_RxSigInfo[286].SignalProcessingOfRxSigInfo "" UBYTE Com_SignalProcessingOfRxSigInfoType 0 0 0 255 ECU_ADDRESS 0x0 /end MEASUREMENT
/begin MEASUREMENT Com_RxSigInfo[286].ValidDlcOfRxSigInfo "" UBYTE NO_COMPU_METHOD 0 0 0 255 ECU_ADDRESS 0x0 /end MEASUREMENT
/begin MEASUREMENT Com_RxSigInfo[287].RxAccessInfoIdxOfRxSigInfo "" UWORD NO_COMPU_METHOD 0 0 0 65535 ECU_ADDRESS 0x0 /end MEASUREMENT
/begin MEASUREMENT Com_RxSigInfo[287].RxCbkFuncPtrAckIdxOfRxSigInfo "" UBYTE Com_RxCbkFuncPtrAckIdxOfRxSigInfoType 0 0 0 255 ECU_ADDRESS 0x0 /end MEASUREMENT
/begin MEASUREMENT Com_RxSigInfo[287].SignalProcessingOfRxSigInfo "" UBYTE Com_SignalProcessingOfRxSigInfoType 0 0 0 255 ECU_ADDRESS 0x0 /end MEASUREMENT
/begin MEASUREMENT Com_RxSigInfo[287].ValidDlcOfRxSigInfo "" UBYTE NO_COMPU_METHOD 0 0 0 255 ECU_ADDRESS 0x0 /end MEASUREMENT
/begin MEASUREMENT Com_RxSigInfo[288].RxAccessInfoIdxOfRxSigInfo "" UWORD NO_COMPU_METHOD 0 0 0 65535 ECU_ADDRESS 0x0 /end MEASUREMENT
/begin MEASUREMENT Com_RxSigInfo[288].RxCbkFuncPtrAckIdxOfRxSigInfo "" UBYTE Com_RxCbkFuncPtrAckIdxOfRxSigInfoType 0 0 0 255 ECU_ADDRESS 0x0 /end MEASUREMENT
/begin MEASUREMENT Com_RxSigInfo[288].SignalProcessingOfRxSigInfo "" UBYTE Com_SignalProcessingOfRxSigInfoType 0 0 0 255 ECU_ADDRESS 0x0 /end MEASUREMENT
/begin MEASUREMENT Com_RxSigInfo[288].ValidDlcOfRxSigInfo "" UBYTE NO_COMPU_METHOD 0 0 0 255 ECU_ADDRESS 0x0 /end MEASUREMENT
/begin MEASUREMENT Com_RxSigInfo[289].RxAccessInfoIdxOfRxSigInfo "" UWORD NO_COMPU_METHOD 0 0 0 65535 ECU_ADDRESS 0x0 /end MEASUREMENT
/begin MEASUREMENT Com_RxSigInfo[289].RxCbkFuncPtrAckIdxOfRxSigInfo "" UBYTE Com_RxCbkFuncPtrAckIdxOfRxSigInfoType 0 0 0 255 ECU_ADDRESS 0x0 /end MEASUREMENT
/begin MEASUREMENT Com_RxSigInfo[289].SignalProcessingOfRxSigInfo "" UBYTE Com_SignalProcessingOfRxSigInfoType 0 0 0 255 ECU_ADDRESS 0x0 /end MEASUREMENT
/begin MEASUREMENT Com_RxSigInfo[289].ValidDlcOfRxSigInfo "" UBYTE NO_COMPU_METHOD 0 0 0 255 ECU_ADDRESS 0x0 /end MEASUREMENT
/begin MEASUREMENT Com_RxSigInfo[28].RxAccessInfoIdxOfRxSigInfo "" UWORD NO_COMPU_METHOD 0 0 0 65535 ECU_ADDRESS 0x0 /end MEASUREMENT
/begin MEASUREMENT Com_RxSigInfo[28].RxCbkFuncPtrAckIdxOfRxSigInfo "" UBYTE Com_RxCbkFuncPtrAckIdxOfRxSigInfoType 0 0 0 255 ECU_ADDRESS 0x0 /end MEASUREMENT
/begin MEASUREMENT Com_RxSigInfo[28].SignalProcessingOfRxSigInfo "" UBYTE Com_SignalProcessingOfRxSigInfoType 0 0 0 255 ECU_ADDRESS 0x0 /end MEASUREMENT
/begin MEASUREMENT Com_RxSigInfo[28].ValidDlcOfRxSigInfo "" UBYTE NO_COMPU_METHOD 0 0 0 255 ECU_ADDRESS 0x0 /end MEASUREMENT
/begin MEASUREMENT Com_RxSigInfo[290].RxAccessInfoIdxOfRxSigInfo "" UWORD NO_COMPU_METHOD 0 0 0 65535 ECU_ADDRESS 0x0 /end MEASUREMENT
/begin MEASUREMENT Com_RxSigInfo[290].RxCbkFuncPtrAckIdxOfRxSigInfo "" UBYTE Com_RxCbkFuncPtrAckIdxOfRxSigInfoType 0 0 0 255 ECU_ADDRESS 0x0 /end MEASUREMENT
/begin MEASUREMENT Com_RxSigInfo[290].SignalProcessingOfRxSigInfo "" UBYTE Com_SignalProcessingOfRxSigInfoType 0 0 0 255 ECU_ADDRESS 0x0 /end MEASUREMENT
/begin MEASUREMENT Com_RxSigInfo[290].ValidDlcOfRxSigInfo "" UBYTE NO_COMPU_METHOD 0 0 0 255 ECU_ADDRESS 0x0 /end MEASUREMENT
/begin MEASUREMENT Com_RxSigInfo[291].RxAccessInfoIdxOfRxSigInfo "" UWORD NO_COMPU_METHOD 0 0 0 65535 ECU_ADDRESS 0x0 /end MEASUREMENT
/begin MEASUREMENT Com_RxSigInfo[291].RxCbkFuncPtrAckIdxOfRxSigInfo "" UBYTE Com_RxCbkFuncPtrAckIdxOfRxSigInfoType 0 0 0 255 ECU_ADDRESS 0x0 /end MEASUREMENT
/begin MEASUREMENT Com_RxSigInfo[291].SignalProcessingOfRxSigInfo "" UBYTE Com_SignalProcessingOfRxSigInfoType 0 0 0 255 ECU_ADDRESS 0x0 /end MEASUREMENT
/begin MEASUREMENT Com_RxSigInfo[291].ValidDlcOfRxSigInfo "" UBYTE NO_COMPU_METHOD 0 0 0 255 ECU_ADDRESS 0x0 /end MEASUREMENT
/begin MEASUREMENT Com_RxSigInfo[292].RxAccessInfoIdxOfRxSigInfo "" UWORD NO_COMPU_METHOD 0 0 0 65535 ECU_ADDRESS 0x0 /end MEASUREMENT
/begin MEASUREMENT Com_RxSigInfo[292].RxCbkFuncPtrAckIdxOfRxSigInfo "" UBYTE Com_RxCbkFuncPtrAckIdxOfRxSigInfoType 0 0 0 255 ECU_ADDRESS 0x0 /end MEASUREMENT
/begin MEASUREMENT Com_RxSigInfo[292].SignalProcessingOfRxSigInfo "" UBYTE Com_SignalProcessingOfRxSigInfoType 0 0 0 255 ECU_ADDRESS 0x0 /end MEASUREMENT
/begin MEASUREMENT Com_RxSigInfo[292].ValidDlcOfRxSigInfo "" UBYTE NO_COMPU_METHOD 0 0 0 255 ECU_ADDRESS 0x0 /end MEASUREMENT
/begin MEASUREMENT Com_RxSigInfo[293].RxAccessInfoIdxOfRxSigInfo "" UWORD NO_COMPU_METHOD 0 0 0 65535 ECU_ADDRESS 0x0 /end MEASUREMENT
/begin MEASUREMENT Com_RxSigInfo[293].RxCbkFuncPtrAckIdxOfRxSigInfo "" UBYTE Com_RxCbkFuncPtrAckIdxOfRxSigInfoType 0 0 0 255 ECU_ADDRESS 0x0 /end MEASUREMENT
/begin MEASUREMENT Com_RxSigInfo[293].SignalProcessingOfRxSigInfo "" UBYTE Com_SignalProcessingOfRxSigInfoType 0 0 0 255 ECU_ADDRESS 0x0 /end MEASUREMENT
/begin MEASUREMENT Com_RxSigInfo[293].ValidDlcOfRxSigInfo "" UBYTE NO_COMPU_METHOD 0 0 0 255 ECU_ADDRESS 0x0 /end MEASUREMENT
/begin MEASUREMENT Com_RxSigInfo[294].RxAccessInfoIdxOfRxSigInfo "" UWORD NO_COMPU_METHOD 0 0 0 65535 ECU_ADDRESS 0x0 /end MEASUREMENT
/begin MEASUREMENT Com_RxSigInfo[294].RxCbkFuncPtrAckIdxOfRxSigInfo "" UBYTE Com_RxCbkFuncPtrAckIdxOfRxSigInfoType 0 0 0 255 ECU_ADDRESS 0x0 /end MEASUREMENT
/begin MEASUREMENT Com_RxSigInfo[294].SignalProcessingOfRxSigInfo "" UBYTE Com_SignalProcessingOfRxSigInfoType 0 0 0 255 ECU_ADDRESS 0x0 /end MEASUREMENT
/begin MEASUREMENT Com_RxSigInfo[294].ValidDlcOfRxSigInfo "" UBYTE NO_COMPU_METHOD 0 0 0 255 ECU_ADDRESS 0x0 /end MEASUREMENT
/begin MEASUREMENT Com_RxSigInfo[295].RxAccessInfoIdxOfRxSigInfo "" UWORD NO_COMPU_METHOD 0 0 0 65535 ECU_ADDRESS 0x0 /end MEASUREMENT
/begin MEASUREMENT Com_RxSigInfo[295].RxCbkFuncPtrAckIdxOfRxSigInfo "" UBYTE Com_RxCbkFuncPtrAckIdxOfRxSigInfoType 0 0 0 255 ECU_ADDRESS 0x0 /end MEASUREMENT
/begin MEASUREMENT Com_RxSigInfo[295].SignalProcessingOfRxSigInfo "" UBYTE Com_SignalProcessingOfRxSigInfoType 0 0 0 255 ECU_ADDRESS 0x0 /end MEASUREMENT
/begin MEASUREMENT Com_RxSigInfo[295].ValidDlcOfRxSigInfo "" UBYTE NO_COMPU_METHOD 0 0 0 255 ECU_ADDRESS 0x0 /end MEASUREMENT
/begin MEASUREMENT Com_RxSigInfo[296].RxAccessInfoIdxOfRxSigInfo "" UWORD NO_COMPU_METHOD 0 0 0 65535 ECU_ADDRESS 0x0 /end MEASUREMENT
/begin MEASUREMENT Com_RxSigInfo[296].RxCbkFuncPtrAckIdxOfRxSigInfo "" UBYTE Com_RxCbkFuncPtrAckIdxOfRxSigInfoType 0 0 0 255 ECU_ADDRESS 0x0 /end MEASUREMENT
/begin MEASUREMENT Com_RxSigInfo[296].SignalProcessingOfRxSigInfo "" UBYTE Com_SignalProcessingOfRxSigInfoType 0 0 0 255 ECU_ADDRESS 0x0 /end MEASUREMENT
/begin MEASUREMENT Com_RxSigInfo[296].ValidDlcOfRxSigInfo "" UBYTE NO_COMPU_METHOD 0 0 0 255 ECU_ADDRESS 0x0 /end MEASUREMENT
/begin MEASUREMENT Com_RxSigInfo[297].RxAccessInfoIdxOfRxSigInfo "" UWORD NO_COMPU_METHOD 0 0 0 65535 ECU_ADDRESS 0x0 /end MEASUREMENT
/begin MEASUREMENT Com_RxSigInfo[297].RxCbkFuncPtrAckIdxOfRxSigInfo "" UBYTE Com_RxCbkFuncPtrAckIdxOfRxSigInfoType 0 0 0 255 ECU_ADDRESS 0x0 /end MEASUREMENT
/begin MEASUREMENT Com_RxSigInfo[297].SignalProcessingOfRxSigInfo "" UBYTE Com_SignalProcessingOfRxSigInfoType 0 0 0 255 ECU_ADDRESS 0x0 /end MEASUREMENT
/begin MEASUREMENT Com_RxSigInfo[297].ValidDlcOfRxSigInfo "" UBYTE NO_COMPU_METHOD 0 0 0 255 ECU_ADDRESS 0x0 /end MEASUREMENT
/begin MEASUREMENT Com_RxSigInfo[298].RxAccessInfoIdxOfRxSigInfo "" UWORD NO_COMPU_METHOD 0 0 0 65535 ECU_ADDRESS 0x0 /end MEASUREMENT
/begin MEASUREMENT Com_RxSigInfo[298].RxCbkFuncPtrAckIdxOfRxSigInfo "" UBYTE Com_RxCbkFuncPtrAckIdxOfRxSigInfoType 0 0 0 255 ECU_ADDRESS 0x0 /end MEASUREMENT
/begin MEASUREMENT Com_RxSigInfo[298].SignalProcessingOfRxSigInfo "" UBYTE Com_SignalProcessingOfRxSigInfoType 0 0 0 255 ECU_ADDRESS 0x0 /end MEASUREMENT
/begin MEASUREMENT Com_RxSigInfo[298].ValidDlcOfRxSigInfo "" UBYTE NO_COMPU_METHOD 0 0 0 255 ECU_ADDRESS 0x0 /end MEASUREMENT
/begin MEASUREMENT Com_RxSigInfo[299].RxAccessInfoIdxOfRxSigInfo "" UWORD NO_COMPU_METHOD 0 0 0 65535 ECU_ADDRESS 0x0 /end MEASUREMENT
/begin MEASUREMENT Com_RxSigInfo[299].RxCbkFuncPtrAckIdxOfRxSigInfo "" UBYTE Com_RxCbkFuncPtrAckIdxOfRxSigInfoType 0 0 0 255 ECU_ADDRESS 0x0 /end MEASUREMENT
/begin MEASUREMENT Com_RxSigInfo[299].SignalProcessingOfRxSigInfo "" UBYTE Com_SignalProcessingOfRxSigInfoType 0 0 0 255 ECU_ADDRESS 0x0 /end MEASUREMENT
/begin MEASUREMENT Com_RxSigInfo[299].ValidDlcOfRxSigInfo "" UBYTE NO_COMPU_METHOD 0 0 0 255 ECU_ADDRESS 0x0 /end MEASUREMENT
/begin MEASUREMENT Com_RxSigInfo[29].RxAccessInfoIdxOfRxSigInfo "" UWORD NO_COMPU_METHOD 0 0 0 65535 ECU_ADDRESS 0x0 /end MEASUREMENT
/begin MEASUREMENT Com_RxSigInfo[29].RxCbkFuncPtrAckIdxOfRxSigInfo "" UBYTE Com_RxCbkFuncPtrAckIdxOfRxSigInfoType 0 0 0 255 ECU_ADDRESS 0x0 /end MEASUREMENT
/begin MEASUREMENT Com_RxSigInfo[29].SignalProcessingOfRxSigInfo "" UBYTE Com_SignalProcessingOfRxSigInfoType 0 0 0 255 ECU_ADDRESS 0x0 /end MEASUREMENT
/begin MEASUREMENT Com_RxSigInfo[29].ValidDlcOfRxSigInfo "" UBYTE NO_COMPU_METHOD 0 0 0 255 ECU_ADDRESS 0x0 /end MEASUREMENT
/begin MEASUREMENT Com_RxSigInfo[2].RxAccessInfoIdxOfRxSigInfo "" UWORD NO_COMPU_METHOD 0 0 0 65535 ECU_ADDRESS 0x0 /end MEASUREMENT
/begin MEASUREMENT Com_RxSigInfo[2].RxCbkFuncPtrAckIdxOfRxSigInfo "" UBYTE Com_RxCbkFuncPtrAckIdxOfRxSigInfoType 0 0 0 255 ECU_ADDRESS 0x0 /end MEASUREMENT
/begin MEASUREMENT Com_RxSigInfo[2].SignalProcessingOfRxSigInfo "" UBYTE Com_SignalProcessingOfRxSigInfoType 0 0 0 255 ECU_ADDRESS 0x0 /end MEASUREMENT
/begin MEASUREMENT Com_RxSigInfo[2].ValidDlcOfRxSigInfo "" UBYTE NO_COMPU_METHOD 0 0 0 255 ECU_ADDRESS 0x0 /end MEASUREMENT
/begin MEASUREMENT Com_RxSigInfo[300].RxAccessInfoIdxOfRxSigInfo "" UWORD NO_COMPU_METHOD 0 0 0 65535 ECU_ADDRESS 0x0 /end MEASUREMENT
/begin MEASUREMENT Com_RxSigInfo[300].RxCbkFuncPtrAckIdxOfRxSigInfo "" UBYTE Com_RxCbkFuncPtrAckIdxOfRxSigInfoType 0 0 0 255 ECU_ADDRESS 0x0 /end MEASUREMENT
/begin MEASUREMENT Com_RxSigInfo[300].SignalProcessingOfRxSigInfo "" UBYTE Com_SignalProcessingOfRxSigInfoType 0 0 0 255 ECU_ADDRESS 0x0 /end MEASUREMENT
/begin MEASUREMENT Com_RxSigInfo[300].ValidDlcOfRxSigInfo "" UBYTE NO_COMPU_METHOD 0 0 0 255 ECU_ADDRESS 0x0 /end MEASUREMENT
/begin MEASUREMENT Com_RxSigInfo[301].RxAccessInfoIdxOfRxSigInfo "" UWORD NO_COMPU_METHOD 0 0 0 65535 ECU_ADDRESS 0x0 /end MEASUREMENT
/begin MEASUREMENT Com_RxSigInfo[301].RxCbkFuncPtrAckIdxOfRxSigInfo "" UBYTE Com_RxCbkFuncPtrAckIdxOfRxSigInfoType 0 0 0 255 ECU_ADDRESS 0x0 /end MEASUREMENT
/begin MEASUREMENT Com_RxSigInfo[301].SignalProcessingOfRxSigInfo "" UBYTE Com_SignalProcessingOfRxSigInfoType 0 0 0 255 ECU_ADDRESS 0x0 /end MEASUREMENT
/begin MEASUREMENT Com_RxSigInfo[301].ValidDlcOfRxSigInfo "" UBYTE NO_COMPU_METHOD 0 0 0 255 ECU_ADDRESS 0x0 /end MEASUREMENT
/begin MEASUREMENT Com_RxSigInfo[302].RxAccessInfoIdxOfRxSigInfo "" UWORD NO_COMPU_METHOD 0 0 0 65535 ECU_ADDRESS 0x0 /end MEASUREMENT
/begin MEASUREMENT Com_RxSigInfo[302].RxCbkFuncPtrAckIdxOfRxSigInfo "" UBYTE Com_RxCbkFuncPtrAckIdxOfRxSigInfoType 0 0 0 255 ECU_ADDRESS 0x0 /end MEASUREMENT
/begin MEASUREMENT Com_RxSigInfo[302].SignalProcessingOfRxSigInfo "" UBYTE Com_SignalProcessingOfRxSigInfoType 0 0 0 255 ECU_ADDRESS 0x0 /end MEASUREMENT
/begin MEASUREMENT Com_RxSigInfo[302].ValidDlcOfRxSigInfo "" UBYTE NO_COMPU_METHOD 0 0 0 255 ECU_ADDRESS 0x0 /end MEASUREMENT
/begin MEASUREMENT Com_RxSigInfo[303].RxAccessInfoIdxOfRxSigInfo "" UWORD NO_COMPU_METHOD 0 0 0 65535 ECU_ADDRESS 0x0 /end MEASUREMENT
/begin MEASUREMENT Com_RxSigInfo[303].RxCbkFuncPtrAckIdxOfRxSigInfo "" UBYTE Com_RxCbkFuncPtrAckIdxOfRxSigInfoType 0 0 0 255 ECU_ADDRESS 0x0 /end MEASUREMENT
/begin MEASUREMENT Com_RxSigInfo[303].SignalProcessingOfRxSigInfo "" UBYTE Com_SignalProcessingOfRxSigInfoType 0 0 0 255 ECU_ADDRESS 0x0 /end MEASUREMENT
/begin MEASUREMENT Com_RxSigInfo[303].ValidDlcOfRxSigInfo "" UBYTE NO_COMPU_METHOD 0 0 0 255 ECU_ADDRESS 0x0 /end MEASUREMENT
/begin MEASUREMENT Com_RxSigInfo[304].RxAccessInfoIdxOfRxSigInfo "" UWORD NO_COMPU_METHOD 0 0 0 65535 ECU_ADDRESS 0x0 /end MEASUREMENT
/begin MEASUREMENT Com_RxSigInfo[304].RxCbkFuncPtrAckIdxOfRxSigInfo "" UBYTE Com_RxCbkFuncPtrAckIdxOfRxSigInfoType 0 0 0 255 ECU_ADDRESS 0x0 /end MEASUREMENT
/begin MEASUREMENT Com_RxSigInfo[304].SignalProcessingOfRxSigInfo "" UBYTE Com_SignalProcessingOfRxSigInfoType 0 0 0 255 ECU_ADDRESS 0x0 /end MEASUREMENT
/begin MEASUREMENT Com_RxSigInfo[304].ValidDlcOfRxSigInfo "" UBYTE NO_COMPU_METHOD 0 0 0 255 ECU_ADDRESS 0x0 /end MEASUREMENT
/begin MEASUREMENT Com_RxSigInfo[305].RxAccessInfoIdxOfRxSigInfo "" UWORD NO_COMPU_METHOD 0 0 0 65535 ECU_ADDRESS 0x0 /end MEASUREMENT
/begin MEASUREMENT Com_RxSigInfo[305].RxCbkFuncPtrAckIdxOfRxSigInfo "" UBYTE Com_RxCbkFuncPtrAckIdxOfRxSigInfoType 0 0 0 255 ECU_ADDRESS 0x0 /end MEASUREMENT
/begin MEASUREMENT Com_RxSigInfo[305].SignalProcessingOfRxSigInfo "" UBYTE Com_SignalProcessingOfRxSigInfoType 0 0 0 255 ECU_ADDRESS 0x0 /end MEASUREMENT
/begin MEASUREMENT Com_RxSigInfo[305].ValidDlcOfRxSigInfo "" UBYTE NO_COMPU_METHOD 0 0 0 255 ECU_ADDRESS 0x0 /end MEASUREMENT
/begin MEASUREMENT Com_RxSigInfo[306].RxAccessInfoIdxOfRxSigInfo "" UWORD NO_COMPU_METHOD 0 0 0 65535 ECU_ADDRESS 0x0 /end MEASUREMENT
/begin MEASUREMENT Com_RxSigInfo[306].RxCbkFuncPtrAckIdxOfRxSigInfo "" UBYTE Com_RxCbkFuncPtrAckIdxOfRxSigInfoType 0 0 0 255 ECU_ADDRESS 0x0 /end MEASUREMENT
/begin MEASUREMENT Com_RxSigInfo[306].SignalProcessingOfRxSigInfo "" UBYTE Com_SignalProcessingOfRxSigInfoType 0 0 0 255 ECU_ADDRESS 0x0 /end MEASUREMENT
/begin MEASUREMENT Com_RxSigInfo[306].ValidDlcOfRxSigInfo "" UBYTE NO_COMPU_METHOD 0 0 0 255 ECU_ADDRESS 0x0 /end MEASUREMENT
/begin MEASUREMENT Com_RxSigInfo[307].RxAccessInfoIdxOfRxSigInfo "" UWORD NO_COMPU_METHOD 0 0 0 65535 ECU_ADDRESS 0x0 /end MEASUREMENT
/begin MEASUREMENT Com_RxSigInfo[307].RxCbkFuncPtrAckIdxOfRxSigInfo "" UBYTE Com_RxCbkFuncPtrAckIdxOfRxSigInfoType 0 0 0 255 ECU_ADDRESS 0x0 /end MEASUREMENT
/begin MEASUREMENT Com_RxSigInfo[307].SignalProcessingOfRxSigInfo "" UBYTE Com_SignalProcessingOfRxSigInfoType 0 0 0 255 ECU_ADDRESS 0x0 /end MEASUREMENT
/begin MEASUREMENT Com_RxSigInfo[307].ValidDlcOfRxSigInfo "" UBYTE NO_COMPU_METHOD 0 0 0 255 ECU_ADDRESS 0x0 /end MEASUREMENT
/begin MEASUREMENT Com_RxSigInfo[308].RxAccessInfoIdxOfRxSigInfo "" UWORD NO_COMPU_METHOD 0 0 0 65535 ECU_ADDRESS 0x0 /end MEASUREMENT
/begin MEASUREMENT Com_RxSigInfo[308].RxCbkFuncPtrAckIdxOfRxSigInfo "" UBYTE Com_RxCbkFuncPtrAckIdxOfRxSigInfoType 0 0 0 255 ECU_ADDRESS 0x0 /end MEASUREMENT
/begin MEASUREMENT Com_RxSigInfo[308].SignalProcessingOfRxSigInfo "" UBYTE Com_SignalProcessingOfRxSigInfoType 0 0 0 255 ECU_ADDRESS 0x0 /end MEASUREMENT
/begin MEASUREMENT Com_RxSigInfo[308].ValidDlcOfRxSigInfo "" UBYTE NO_COMPU_METHOD 0 0 0 255 ECU_ADDRESS 0x0 /end MEASUREMENT
/begin MEASUREMENT Com_RxSigInfo[309].RxAccessInfoIdxOfRxSigInfo "" UWORD NO_COMPU_METHOD 0 0 0 65535 ECU_ADDRESS 0x0 /end MEASUREMENT
/begin MEASUREMENT Com_RxSigInfo[309].RxCbkFuncPtrAckIdxOfRxSigInfo "" UBYTE Com_RxCbkFuncPtrAckIdxOfRxSigInfoType 0 0 0 255 ECU_ADDRESS 0x0 /end MEASUREMENT
/begin MEASUREMENT Com_RxSigInfo[309].SignalProcessingOfRxSigInfo "" UBYTE Com_SignalProcessingOfRxSigInfoType 0 0 0 255 ECU_ADDRESS 0x0 /end MEASUREMENT
/begin MEASUREMENT Com_RxSigInfo[309].ValidDlcOfRxSigInfo "" UBYTE NO_COMPU_METHOD 0 0 0 255 ECU_ADDRESS 0x0 /end MEASUREMENT
/begin MEASUREMENT Com_RxSigInfo[30].RxAccessInfoIdxOfRxSigInfo "" UWORD NO_COMPU_METHOD 0 0 0 65535 ECU_ADDRESS 0x0 /end MEASUREMENT
/begin MEASUREMENT Com_RxSigInfo[30].RxCbkFuncPtrAckIdxOfRxSigInfo "" UBYTE Com_RxCbkFuncPtrAckIdxOfRxSigInfoType 0 0 0 255 ECU_ADDRESS 0x0 /end MEASUREMENT
/begin MEASUREMENT Com_RxSigInfo[30].SignalProcessingOfRxSigInfo "" UBYTE Com_SignalProcessingOfRxSigInfoType 0 0 0 255 ECU_ADDRESS 0x0 /end MEASUREMENT
/begin MEASUREMENT Com_RxSigInfo[30].ValidDlcOfRxSigInfo "" UBYTE NO_COMPU_METHOD 0 0 0 255 ECU_ADDRESS 0x0 /end MEASUREMENT
/begin MEASUREMENT Com_RxSigInfo[310].RxAccessInfoIdxOfRxSigInfo "" UWORD NO_COMPU_METHOD 0 0 0 65535 ECU_ADDRESS 0x0 /end MEASUREMENT
/begin MEASUREMENT Com_RxSigInfo[310].RxCbkFuncPtrAckIdxOfRxSigInfo "" UBYTE Com_RxCbkFuncPtrAckIdxOfRxSigInfoType 0 0 0 255 ECU_ADDRESS 0x0 /end MEASUREMENT
/begin MEASUREMENT Com_RxSigInfo[310].SignalProcessingOfRxSigInfo "" UBYTE Com_SignalProcessingOfRxSigInfoType 0 0 0 255 ECU_ADDRESS 0x0 /end MEASUREMENT
/begin MEASUREMENT Com_RxSigInfo[310].ValidDlcOfRxSigInfo "" UBYTE NO_COMPU_METHOD 0 0 0 255 ECU_ADDRESS 0x0 /end MEASUREMENT
/begin MEASUREMENT Com_RxSigInfo[311].RxAccessInfoIdxOfRxSigInfo "" UWORD NO_COMPU_METHOD 0 0 0 65535 ECU_ADDRESS 0x0 /end MEASUREMENT
/begin MEASUREMENT Com_RxSigInfo[311].RxCbkFuncPtrAckIdxOfRxSigInfo "" UBYTE Com_RxCbkFuncPtrAckIdxOfRxSigInfoType 0 0 0 255 ECU_ADDRESS 0x0 /end MEASUREMENT
/begin MEASUREMENT Com_RxSigInfo[311].SignalProcessingOfRxSigInfo "" UBYTE Com_SignalProcessingOfRxSigInfoType 0 0 0 255 ECU_ADDRESS 0x0 /end MEASUREMENT
/begin MEASUREMENT Com_RxSigInfo[311].ValidDlcOfRxSigInfo "" UBYTE NO_COMPU_METHOD 0 0 0 255 ECU_ADDRESS 0x0 /end MEASUREMENT
/begin MEASUREMENT Com_RxSigInfo[312].RxAccessInfoIdxOfRxSigInfo "" UWORD NO_COMPU_METHOD 0 0 0 65535 ECU_ADDRESS 0x0 /end MEASUREMENT
/begin MEASUREMENT Com_RxSigInfo[312].RxCbkFuncPtrAckIdxOfRxSigInfo "" UBYTE Com_RxCbkFuncPtrAckIdxOfRxSigInfoType 0 0 0 255 ECU_ADDRESS 0x0 /end MEASUREMENT
/begin MEASUREMENT Com_RxSigInfo[312].SignalProcessingOfRxSigInfo "" UBYTE Com_SignalProcessingOfRxSigInfoType 0 0 0 255 ECU_ADDRESS 0x0 /end MEASUREMENT
/begin MEASUREMENT Com_RxSigInfo[312].ValidDlcOfRxSigInfo "" UBYTE NO_COMPU_METHOD 0 0 0 255 ECU_ADDRESS 0x0 /end MEASUREMENT
/begin MEASUREMENT Com_RxSigInfo[313].RxAccessInfoIdxOfRxSigInfo "" UWORD NO_COMPU_METHOD 0 0 0 65535 ECU_ADDRESS 0x0 /end MEASUREMENT
/begin MEASUREMENT Com_RxSigInfo[313].RxCbkFuncPtrAckIdxOfRxSigInfo "" UBYTE Com_RxCbkFuncPtrAckIdxOfRxSigInfoType 0 0 0 255 ECU_ADDRESS 0x0 /end MEASUREMENT
/begin MEASUREMENT Com_RxSigInfo[313].SignalProcessingOfRxSigInfo "" UBYTE Com_SignalProcessingOfRxSigInfoType 0 0 0 255 ECU_ADDRESS 0x0 /end MEASUREMENT
/begin MEASUREMENT Com_RxSigInfo[313].ValidDlcOfRxSigInfo "" UBYTE NO_COMPU_METHOD 0 0 0 255 ECU_ADDRESS 0x0 /end MEASUREMENT
/begin MEASUREMENT Com_RxSigInfo[314].RxAccessInfoIdxOfRxSigInfo "" UWORD NO_COMPU_METHOD 0 0 0 65535 ECU_ADDRESS 0x0 /end MEASUREMENT
/begin MEASUREMENT Com_RxSigInfo[314].RxCbkFuncPtrAckIdxOfRxSigInfo "" UBYTE Com_RxCbkFuncPtrAckIdxOfRxSigInfoType 0 0 0 255 ECU_ADDRESS 0x0 /end MEASUREMENT
/begin MEASUREMENT Com_RxSigInfo[314].SignalProcessingOfRxSigInfo "" UBYTE Com_SignalProcessingOfRxSigInfoType 0 0 0 255 ECU_ADDRESS 0x0 /end MEASUREMENT
/begin MEASUREMENT Com_RxSigInfo[314].ValidDlcOfRxSigInfo "" UBYTE NO_COMPU_METHOD 0 0 0 255 ECU_ADDRESS 0x0 /end MEASUREMENT
/begin MEASUREMENT Com_RxSigInfo[315].RxAccessInfoIdxOfRxSigInfo "" UWORD NO_COMPU_METHOD 0 0 0 65535 ECU_ADDRESS 0x0 /end MEASUREMENT
/begin MEASUREMENT Com_RxSigInfo[315].RxCbkFuncPtrAckIdxOfRxSigInfo "" UBYTE Com_RxCbkFuncPtrAckIdxOfRxSigInfoType 0 0 0 255 ECU_ADDRESS 0x0 /end MEASUREMENT
/begin MEASUREMENT Com_RxSigInfo[315].SignalProcessingOfRxSigInfo "" UBYTE Com_SignalProcessingOfRxSigInfoType 0 0 0 255 ECU_ADDRESS 0x0 /end MEASUREMENT
/begin MEASUREMENT Com_RxSigInfo[315].ValidDlcOfRxSigInfo "" UBYTE NO_COMPU_METHOD 0 0 0 255 ECU_ADDRESS 0x0 /end MEASUREMENT
/begin MEASUREMENT Com_RxSigInfo[316].RxAccessInfoIdxOfRxSigInfo "" UWORD NO_COMPU_METHOD 0 0 0 65535 ECU_ADDRESS 0x0 /end MEASUREMENT
/begin MEASUREMENT Com_RxSigInfo[316].RxCbkFuncPtrAckIdxOfRxSigInfo "" UBYTE Com_RxCbkFuncPtrAckIdxOfRxSigInfoType 0 0 0 255 ECU_ADDRESS 0x0 /end MEASUREMENT
/begin MEASUREMENT Com_RxSigInfo[316].SignalProcessingOfRxSigInfo "" UBYTE Com_SignalProcessingOfRxSigInfoType 0 0 0 255 ECU_ADDRESS 0x0 /end MEASUREMENT
/begin MEASUREMENT Com_RxSigInfo[316].ValidDlcOfRxSigInfo "" UBYTE NO_COMPU_METHOD 0 0 0 255 ECU_ADDRESS 0x0 /end MEASUREMENT
/begin MEASUREMENT Com_RxSigInfo[317].RxAccessInfoIdxOfRxSigInfo "" UWORD NO_COMPU_METHOD 0 0 0 65535 ECU_ADDRESS 0x0 /end MEASUREMENT
/begin MEASUREMENT Com_RxSigInfo[317].RxCbkFuncPtrAckIdxOfRxSigInfo "" UBYTE Com_RxCbkFuncPtrAckIdxOfRxSigInfoType 0 0 0 255 ECU_ADDRESS 0x0 /end MEASUREMENT
/begin MEASUREMENT Com_RxSigInfo[317].SignalProcessingOfRxSigInfo "" UBYTE Com_SignalProcessingOfRxSigInfoType 0 0 0 255 ECU_ADDRESS 0x0 /end MEASUREMENT
/begin MEASUREMENT Com_RxSigInfo[317].ValidDlcOfRxSigInfo "" UBYTE NO_COMPU_METHOD 0 0 0 255 ECU_ADDRESS 0x0 /end MEASUREMENT
/begin MEASUREMENT Com_RxSigInfo[318].RxAccessInfoIdxOfRxSigInfo "" UWORD NO_COMPU_METHOD 0 0 0 65535 ECU_ADDRESS 0x0 /end MEASUREMENT
/begin MEASUREMENT Com_RxSigInfo[318].RxCbkFuncPtrAckIdxOfRxSigInfo "" UBYTE Com_RxCbkFuncPtrAckIdxOfRxSigInfoType 0 0 0 255 ECU_ADDRESS 0x0 /end MEASUREMENT
/begin MEASUREMENT Com_RxSigInfo[318].SignalProcessingOfRxSigInfo "" UBYTE Com_SignalProcessingOfRxSigInfoType 0 0 0 255 ECU_ADDRESS 0x0 /end MEASUREMENT
/begin MEASUREMENT Com_RxSigInfo[318].ValidDlcOfRxSigInfo "" UBYTE NO_COMPU_METHOD 0 0 0 255 ECU_ADDRESS 0x0 /end MEASUREMENT
/begin MEASUREMENT Com_RxSigInfo[319].RxAccessInfoIdxOfRxSigInfo "" UWORD NO_COMPU_METHOD 0 0 0 65535 ECU_ADDRESS 0x0 /end MEASUREMENT
/begin MEASUREMENT Com_RxSigInfo[319].RxCbkFuncPtrAckIdxOfRxSigInfo "" UBYTE Com_RxCbkFuncPtrAckIdxOfRxSigInfoType 0 0 0 255 ECU_ADDRESS 0x0 /end MEASUREMENT
/begin MEASUREMENT Com_RxSigInfo[319].SignalProcessingOfRxSigInfo "" UBYTE Com_SignalProcessingOfRxSigInfoType 0 0 0 255 ECU_ADDRESS 0x0 /end MEASUREMENT
/begin MEASUREMENT Com_RxSigInfo[319].ValidDlcOfRxSigInfo "" UBYTE NO_COMPU_METHOD 0 0 0 255 ECU_ADDRESS 0x0 /end MEASUREMENT
/begin MEASUREMENT Com_RxSigInfo[31].RxAccessInfoIdxOfRxSigInfo "" UWORD NO_COMPU_METHOD 0 0 0 65535 ECU_ADDRESS 0x0 /end MEASUREMENT
/begin MEASUREMENT Com_RxSigInfo[31].RxCbkFuncPtrAckIdxOfRxSigInfo "" UBYTE Com_RxCbkFuncPtrAckIdxOfRxSigInfoType 0 0 0 255 ECU_ADDRESS 0x0 /end MEASUREMENT
/begin MEASUREMENT Com_RxSigInfo[31].SignalProcessingOfRxSigInfo "" UBYTE Com_SignalProcessingOfRxSigInfoType 0 0 0 255 ECU_ADDRESS 0x0 /end MEASUREMENT
/begin MEASUREMENT Com_RxSigInfo[31].ValidDlcOfRxSigInfo "" UBYTE NO_COMPU_METHOD 0 0 0 255 ECU_ADDRESS 0x0 /end MEASUREMENT
/begin MEASUREMENT Com_RxSigInfo[320].RxAccessInfoIdxOfRxSigInfo "" UWORD NO_COMPU_METHOD 0 0 0 65535 ECU_ADDRESS 0x0 /end MEASUREMENT
/begin MEASUREMENT Com_RxSigInfo[320].RxCbkFuncPtrAckIdxOfRxSigInfo "" UBYTE Com_RxCbkFuncPtrAckIdxOfRxSigInfoType 0 0 0 255 ECU_ADDRESS 0x0 /end MEASUREMENT
/begin MEASUREMENT Com_RxSigInfo[320].SignalProcessingOfRxSigInfo "" UBYTE Com_SignalProcessingOfRxSigInfoType 0 0 0 255 ECU_ADDRESS 0x0 /end MEASUREMENT
/begin MEASUREMENT Com_RxSigInfo[320].ValidDlcOfRxSigInfo "" UBYTE NO_COMPU_METHOD 0 0 0 255 ECU_ADDRESS 0x0 /end MEASUREMENT
/begin MEASUREMENT Com_RxSigInfo[321].RxAccessInfoIdxOfRxSigInfo "" UWORD NO_COMPU_METHOD 0 0 0 65535 ECU_ADDRESS 0x0 /end MEASUREMENT
/begin MEASUREMENT Com_RxSigInfo[321].RxCbkFuncPtrAckIdxOfRxSigInfo "" UBYTE Com_RxCbkFuncPtrAckIdxOfRxSigInfoType 0 0 0 255 ECU_ADDRESS 0x0 /end MEASUREMENT
/begin MEASUREMENT Com_RxSigInfo[321].SignalProcessingOfRxSigInfo "" UBYTE Com_SignalProcessingOfRxSigInfoType 0 0 0 255 ECU_ADDRESS 0x0 /end MEASUREMENT
/begin MEASUREMENT Com_RxSigInfo[321].ValidDlcOfRxSigInfo "" UBYTE NO_COMPU_METHOD 0 0 0 255 ECU_ADDRESS 0x0 /end MEASUREMENT
/begin MEASUREMENT Com_RxSigInfo[322].RxAccessInfoIdxOfRxSigInfo "" UWORD NO_COMPU_METHOD 0 0 0 65535 ECU_ADDRESS 0x0 /end MEASUREMENT
/begin MEASUREMENT Com_RxSigInfo[322].RxCbkFuncPtrAckIdxOfRxSigInfo "" UBYTE Com_RxCbkFuncPtrAckIdxOfRxSigInfoType 0 0 0 255 ECU_ADDRESS 0x0 /end MEASUREMENT
/begin MEASUREMENT Com_RxSigInfo[322].SignalProcessingOfRxSigInfo "" UBYTE Com_SignalProcessingOfRxSigInfoType 0 0 0 255 ECU_ADDRESS 0x0 /end MEASUREMENT
/begin MEASUREMENT Com_RxSigInfo[322].ValidDlcOfRxSigInfo "" UBYTE NO_COMPU_METHOD 0 0 0 255 ECU_ADDRESS 0x0 /end MEASUREMENT
/begin MEASUREMENT Com_RxSigInfo[323].RxAccessInfoIdxOfRxSigInfo "" UWORD NO_COMPU_METHOD 0 0 0 65535 ECU_ADDRESS 0x0 /end MEASUREMENT
/begin MEASUREMENT Com_RxSigInfo[323].RxCbkFuncPtrAckIdxOfRxSigInfo "" UBYTE Com_RxCbkFuncPtrAckIdxOfRxSigInfoType 0 0 0 255 ECU_ADDRESS 0x0 /end MEASUREMENT
/begin MEASUREMENT Com_RxSigInfo[323].SignalProcessingOfRxSigInfo "" UBYTE Com_SignalProcessingOfRxSigInfoType 0 0 0 255 ECU_ADDRESS 0x0 /end MEASUREMENT
/begin MEASUREMENT Com_RxSigInfo[323].ValidDlcOfRxSigInfo "" UBYTE NO_COMPU_METHOD 0 0 0 255 ECU_ADDRESS 0x0 /end MEASUREMENT
/begin MEASUREMENT Com_RxSigInfo[324].RxAccessInfoIdxOfRxSigInfo "" UWORD NO_COMPU_METHOD 0 0 0 65535 ECU_ADDRESS 0x0 /end MEASUREMENT
/begin MEASUREMENT Com_RxSigInfo[324].RxCbkFuncPtrAckIdxOfRxSigInfo "" UBYTE Com_RxCbkFuncPtrAckIdxOfRxSigInfoType 0 0 0 255 ECU_ADDRESS 0x0 /end MEASUREMENT
/begin MEASUREMENT Com_RxSigInfo[324].SignalProcessingOfRxSigInfo "" UBYTE Com_SignalProcessingOfRxSigInfoType 0 0 0 255 ECU_ADDRESS 0x0 /end MEASUREMENT
/begin MEASUREMENT Com_RxSigInfo[324].ValidDlcOfRxSigInfo "" UBYTE NO_COMPU_METHOD 0 0 0 255 ECU_ADDRESS 0x0 /end MEASUREMENT
/begin MEASUREMENT Com_RxSigInfo[325].RxAccessInfoIdxOfRxSigInfo "" UWORD NO_COMPU_METHOD 0 0 0 65535 ECU_ADDRESS 0x0 /end MEASUREMENT
/begin MEASUREMENT Com_RxSigInfo[325].RxCbkFuncPtrAckIdxOfRxSigInfo "" UBYTE Com_RxCbkFuncPtrAckIdxOfRxSigInfoType 0 0 0 255 ECU_ADDRESS 0x0 /end MEASUREMENT
/begin MEASUREMENT Com_RxSigInfo[325].SignalProcessingOfRxSigInfo "" UBYTE Com_SignalProcessingOfRxSigInfoType 0 0 0 255 ECU_ADDRESS 0x0 /end MEASUREMENT
/begin MEASUREMENT Com_RxSigInfo[325].ValidDlcOfRxSigInfo "" UBYTE NO_COMPU_METHOD 0 0 0 255 ECU_ADDRESS 0x0 /end MEASUREMENT
/begin MEASUREMENT Com_RxSigInfo[326].RxAccessInfoIdxOfRxSigInfo "" UWORD NO_COMPU_METHOD 0 0 0 65535 ECU_ADDRESS 0x0 /end MEASUREMENT
/begin MEASUREMENT Com_RxSigInfo[326].RxCbkFuncPtrAckIdxOfRxSigInfo "" UBYTE Com_RxCbkFuncPtrAckIdxOfRxSigInfoType 0 0 0 255 ECU_ADDRESS 0x0 /end MEASUREMENT
/begin MEASUREMENT Com_RxSigInfo[326].SignalProcessingOfRxSigInfo "" UBYTE Com_SignalProcessingOfRxSigInfoType 0 0 0 255 ECU_ADDRESS 0x0 /end MEASUREMENT
/begin MEASUREMENT Com_RxSigInfo[326].ValidDlcOfRxSigInfo "" UBYTE NO_COMPU_METHOD 0 0 0 255 ECU_ADDRESS 0x0 /end MEASUREMENT
/begin MEASUREMENT Com_RxSigInfo[327].RxAccessInfoIdxOfRxSigInfo "" UWORD NO_COMPU_METHOD 0 0 0 65535 ECU_ADDRESS 0x0 /end MEASUREMENT
/begin MEASUREMENT Com_RxSigInfo[327].RxCbkFuncPtrAckIdxOfRxSigInfo "" UBYTE Com_RxCbkFuncPtrAckIdxOfRxSigInfoType 0 0 0 255 ECU_ADDRESS 0x0 /end MEASUREMENT
/begin MEASUREMENT Com_RxSigInfo[327].SignalProcessingOfRxSigInfo "" UBYTE Com_SignalProcessingOfRxSigInfoType 0 0 0 255 ECU_ADDRESS 0x0 /end MEASUREMENT
/begin MEASUREMENT Com_RxSigInfo[327].ValidDlcOfRxSigInfo "" UBYTE NO_COMPU_METHOD 0 0 0 255 ECU_ADDRESS 0x0 /end MEASUREMENT
/begin MEASUREMENT Com_RxSigInfo[328].RxAccessInfoIdxOfRxSigInfo "" UWORD NO_COMPU_METHOD 0 0 0 65535 ECU_ADDRESS 0x0 /end MEASUREMENT
/begin MEASUREMENT Com_RxSigInfo[328].RxCbkFuncPtrAckIdxOfRxSigInfo "" UBYTE Com_RxCbkFuncPtrAckIdxOfRxSigInfoType 0 0 0 255 ECU_ADDRESS 0x0 /end MEASUREMENT
/begin MEASUREMENT Com_RxSigInfo[328].SignalProcessingOfRxSigInfo "" UBYTE Com_SignalProcessingOfRxSigInfoType 0 0 0 255 ECU_ADDRESS 0x0 /end MEASUREMENT
/begin MEASUREMENT Com_RxSigInfo[328].ValidDlcOfRxSigInfo "" UBYTE NO_COMPU_METHOD 0 0 0 255 ECU_ADDRESS 0x0 /end MEASUREMENT
/begin MEASUREMENT Com_RxSigInfo[329].RxAccessInfoIdxOfRxSigInfo "" UWORD NO_COMPU_METHOD 0 0 0 65535 ECU_ADDRESS 0x0 /end MEASUREMENT
/begin MEASUREMENT Com_RxSigInfo[329].RxCbkFuncPtrAckIdxOfRxSigInfo "" UBYTE Com_RxCbkFuncPtrAckIdxOfRxSigInfoType 0 0 0 255 ECU_ADDRESS 0x0 /end MEASUREMENT
/begin MEASUREMENT Com_RxSigInfo[329].SignalProcessingOfRxSigInfo "" UBYTE Com_SignalProcessingOfRxSigInfoType 0 0 0 255 ECU_ADDRESS 0x0 /end MEASUREMENT
/begin MEASUREMENT Com_RxSigInfo[329].ValidDlcOfRxSigInfo "" UBYTE NO_COMPU_METHOD 0 0 0 255 ECU_ADDRESS 0x0 /end MEASUREMENT
/begin MEASUREMENT Com_RxSigInfo[32].RxAccessInfoIdxOfRxSigInfo "" UWORD NO_COMPU_METHOD 0 0 0 65535 ECU_ADDRESS 0x0 /end MEASUREMENT
/begin MEASUREMENT Com_RxSigInfo[32].RxCbkFuncPtrAckIdxOfRxSigInfo "" UBYTE Com_RxCbkFuncPtrAckIdxOfRxSigInfoType 0 0 0 255 ECU_ADDRESS 0x0 /end MEASUREMENT
/begin MEASUREMENT Com_RxSigInfo[32].SignalProcessingOfRxSigInfo "" UBYTE Com_SignalProcessingOfRxSigInfoType 0 0 0 255 ECU_ADDRESS 0x0 /end MEASUREMENT
/begin MEASUREMENT Com_RxSigInfo[32].ValidDlcOfRxSigInfo "" UBYTE NO_COMPU_METHOD 0 0 0 255 ECU_ADDRESS 0x0 /end MEASUREMENT
/begin MEASUREMENT Com_RxSigInfo[330].RxAccessInfoIdxOfRxSigInfo "" UWORD NO_COMPU_METHOD 0 0 0 65535 ECU_ADDRESS 0x0 /end MEASUREMENT
/begin MEASUREMENT Com_RxSigInfo[330].RxCbkFuncPtrAckIdxOfRxSigInfo "" UBYTE Com_RxCbkFuncPtrAckIdxOfRxSigInfoType 0 0 0 255 ECU_ADDRESS 0x0 /end MEASUREMENT
/begin MEASUREMENT Com_RxSigInfo[330].SignalProcessingOfRxSigInfo "" UBYTE Com_SignalProcessingOfRxSigInfoType 0 0 0 255 ECU_ADDRESS 0x0 /end MEASUREMENT
/begin MEASUREMENT Com_RxSigInfo[330].ValidDlcOfRxSigInfo "" UBYTE NO_COMPU_METHOD 0 0 0 255 ECU_ADDRESS 0x0 /end MEASUREMENT
/begin MEASUREMENT Com_RxSigInfo[331].RxAccessInfoIdxOfRxSigInfo "" UWORD NO_COMPU_METHOD 0 0 0 65535 ECU_ADDRESS 0x0 /end MEASUREMENT
/begin MEASUREMENT Com_RxSigInfo[331].RxCbkFuncPtrAckIdxOfRxSigInfo "" UBYTE Com_RxCbkFuncPtrAckIdxOfRxSigInfoType 0 0 0 255 ECU_ADDRESS 0x0 /end MEASUREMENT
/begin MEASUREMENT Com_RxSigInfo[331].SignalProcessingOfRxSigInfo "" UBYTE Com_SignalProcessingOfRxSigInfoType 0 0 0 255 ECU_ADDRESS 0x0 /end MEASUREMENT
/begin MEASUREMENT Com_RxSigInfo[331].ValidDlcOfRxSigInfo "" UBYTE NO_COMPU_METHOD 0 0 0 255 ECU_ADDRESS 0x0 /end MEASUREMENT
/begin MEASUREMENT Com_RxSigInfo[332].RxAccessInfoIdxOfRxSigInfo "" UWORD NO_COMPU_METHOD 0 0 0 65535 ECU_ADDRESS 0x0 /end MEASUREMENT
/begin MEASUREMENT Com_RxSigInfo[332].RxCbkFuncPtrAckIdxOfRxSigInfo "" UBYTE Com_RxCbkFuncPtrAckIdxOfRxSigInfoType 0 0 0 255 ECU_ADDRESS 0x0 /end MEASUREMENT
/begin MEASUREMENT Com_RxSigInfo[332].SignalProcessingOfRxSigInfo "" UBYTE Com_SignalProcessingOfRxSigInfoType 0 0 0 255 ECU_ADDRESS 0x0 /end MEASUREMENT
/begin MEASUREMENT Com_RxSigInfo[332].ValidDlcOfRxSigInfo "" UBYTE NO_COMPU_METHOD 0 0 0 255 ECU_ADDRESS 0x0 /end MEASUREMENT
/begin MEASUREMENT Com_RxSigInfo[333].RxAccessInfoIdxOfRxSigInfo "" UWORD NO_COMPU_METHOD 0 0 0 65535 ECU_ADDRESS 0x0 /end MEASUREMENT
/begin MEASUREMENT Com_RxSigInfo[333].RxCbkFuncPtrAckIdxOfRxSigInfo "" UBYTE Com_RxCbkFuncPtrAckIdxOfRxSigInfoType 0 0 0 255 ECU_ADDRESS 0x0 /end MEASUREMENT
/begin MEASUREMENT Com_RxSigInfo[333].SignalProcessingOfRxSigInfo "" UBYTE Com_SignalProcessingOfRxSigInfoType 0 0 0 255 ECU_ADDRESS 0x0 /end MEASUREMENT
/begin MEASUREMENT Com_RxSigInfo[333].ValidDlcOfRxSigInfo "" UBYTE NO_COMPU_METHOD 0 0 0 255 ECU_ADDRESS 0x0 /end MEASUREMENT
/begin MEASUREMENT Com_RxSigInfo[334].RxAccessInfoIdxOfRxSigInfo "" UWORD NO_COMPU_METHOD 0 0 0 65535 ECU_ADDRESS 0x0 /end MEASUREMENT
/begin MEASUREMENT Com_RxSigInfo[334].RxCbkFuncPtrAckIdxOfRxSigInfo "" UBYTE Com_RxCbkFuncPtrAckIdxOfRxSigInfoType 0 0 0 255 ECU_ADDRESS 0x0 /end MEASUREMENT
/begin MEASUREMENT Com_RxSigInfo[334].SignalProcessingOfRxSigInfo "" UBYTE Com_SignalProcessingOfRxSigInfoType 0 0 0 255 ECU_ADDRESS 0x0 /end MEASUREMENT
/begin MEASUREMENT Com_RxSigInfo[334].ValidDlcOfRxSigInfo "" UBYTE NO_COMPU_METHOD 0 0 0 255 ECU_ADDRESS 0x0 /end MEASUREMENT
/begin MEASUREMENT Com_RxSigInfo[335].RxAccessInfoIdxOfRxSigInfo "" UWORD NO_COMPU_METHOD 0 0 0 65535 ECU_ADDRESS 0x0 /end MEASUREMENT
/begin MEASUREMENT Com_RxSigInfo[335].RxCbkFuncPtrAckIdxOfRxSigInfo "" UBYTE Com_RxCbkFuncPtrAckIdxOfRxSigInfoType 0 0 0 255 ECU_ADDRESS 0x0 /end MEASUREMENT
/begin MEASUREMENT Com_RxSigInfo[335].SignalProcessingOfRxSigInfo "" UBYTE Com_SignalProcessingOfRxSigInfoType 0 0 0 255 ECU_ADDRESS 0x0 /end MEASUREMENT
/begin MEASUREMENT Com_RxSigInfo[335].ValidDlcOfRxSigInfo "" UBYTE NO_COMPU_METHOD 0 0 0 255 ECU_ADDRESS 0x0 /end MEASUREMENT
/begin MEASUREMENT Com_RxSigInfo[336].RxAccessInfoIdxOfRxSigInfo "" UWORD NO_COMPU_METHOD 0 0 0 65535 ECU_ADDRESS 0x0 /end MEASUREMENT
/begin MEASUREMENT Com_RxSigInfo[336].RxCbkFuncPtrAckIdxOfRxSigInfo "" UBYTE Com_RxCbkFuncPtrAckIdxOfRxSigInfoType 0 0 0 255 ECU_ADDRESS 0x0 /end MEASUREMENT
/begin MEASUREMENT Com_RxSigInfo[336].SignalProcessingOfRxSigInfo "" UBYTE Com_SignalProcessingOfRxSigInfoType 0 0 0 255 ECU_ADDRESS 0x0 /end MEASUREMENT
/begin MEASUREMENT Com_RxSigInfo[336].ValidDlcOfRxSigInfo "" UBYTE NO_COMPU_METHOD 0 0 0 255 ECU_ADDRESS 0x0 /end MEASUREMENT
/begin MEASUREMENT Com_RxSigInfo[337].RxAccessInfoIdxOfRxSigInfo "" UWORD NO_COMPU_METHOD 0 0 0 65535 ECU_ADDRESS 0x0 /end MEASUREMENT
/begin MEASUREMENT Com_RxSigInfo[337].RxCbkFuncPtrAckIdxOfRxSigInfo "" UBYTE Com_RxCbkFuncPtrAckIdxOfRxSigInfoType 0 0 0 255 ECU_ADDRESS 0x0 /end MEASUREMENT
/begin MEASUREMENT Com_RxSigInfo[337].SignalProcessingOfRxSigInfo "" UBYTE Com_SignalProcessingOfRxSigInfoType 0 0 0 255 ECU_ADDRESS 0x0 /end MEASUREMENT
/begin MEASUREMENT Com_RxSigInfo[337].ValidDlcOfRxSigInfo "" UBYTE NO_COMPU_METHOD 0 0 0 255 ECU_ADDRESS 0x0 /end MEASUREMENT
/begin MEASUREMENT Com_RxSigInfo[338].RxAccessInfoIdxOfRxSigInfo "" UWORD NO_COMPU_METHOD 0 0 0 65535 ECU_ADDRESS 0x0 /end MEASUREMENT
/begin MEASUREMENT Com_RxSigInfo[338].RxCbkFuncPtrAckIdxOfRxSigInfo "" UBYTE Com_RxCbkFuncPtrAckIdxOfRxSigInfoType 0 0 0 255 ECU_ADDRESS 0x0 /end MEASUREMENT
/begin MEASUREMENT Com_RxSigInfo[338].SignalProcessingOfRxSigInfo "" UBYTE Com_SignalProcessingOfRxSigInfoType 0 0 0 255 ECU_ADDRESS 0x0 /end MEASUREMENT
/begin MEASUREMENT Com_RxSigInfo[338].ValidDlcOfRxSigInfo "" UBYTE NO_COMPU_METHOD 0 0 0 255 ECU_ADDRESS 0x0 /end MEASUREMENT
/begin MEASUREMENT Com_RxSigInfo[339].RxAccessInfoIdxOfRxSigInfo "" UWORD NO_COMPU_METHOD 0 0 0 65535 ECU_ADDRESS 0x0 /end MEASUREMENT
/begin MEASUREMENT Com_RxSigInfo[339].RxCbkFuncPtrAckIdxOfRxSigInfo "" UBYTE Com_RxCbkFuncPtrAckIdxOfRxSigInfoType 0 0 0 255 ECU_ADDRESS 0x0 /end MEASUREMENT
/begin MEASUREMENT Com_RxSigInfo[339].SignalProcessingOfRxSigInfo "" UBYTE Com_SignalProcessingOfRxSigInfoType 0 0 0 255 ECU_ADDRESS 0x0 /end MEASUREMENT
/begin MEASUREMENT Com_RxSigInfo[339].ValidDlcOfRxSigInfo "" UBYTE NO_COMPU_METHOD 0 0 0 255 ECU_ADDRESS 0x0 /end MEASUREMENT
/begin MEASUREMENT Com_RxSigInfo[33].RxAccessInfoIdxOfRxSigInfo "" UWORD NO_COMPU_METHOD 0 0 0 65535 ECU_ADDRESS 0x0 /end MEASUREMENT
/begin MEASUREMENT Com_RxSigInfo[33].RxCbkFuncPtrAckIdxOfRxSigInfo "" UBYTE Com_RxCbkFuncPtrAckIdxOfRxSigInfoType 0 0 0 255 ECU_ADDRESS 0x0 /end MEASUREMENT
/begin MEASUREMENT Com_RxSigInfo[33].SignalProcessingOfRxSigInfo "" UBYTE Com_SignalProcessingOfRxSigInfoType 0 0 0 255 ECU_ADDRESS 0x0 /end MEASUREMENT
/begin MEASUREMENT Com_RxSigInfo[33].ValidDlcOfRxSigInfo "" UBYTE NO_COMPU_METHOD 0 0 0 255 ECU_ADDRESS 0x0 /end MEASUREMENT
/begin MEASUREMENT Com_RxSigInfo[340].RxAccessInfoIdxOfRxSigInfo "" UWORD NO_COMPU_METHOD 0 0 0 65535 ECU_ADDRESS 0x0 /end MEASUREMENT
/begin MEASUREMENT Com_RxSigInfo[340].RxCbkFuncPtrAckIdxOfRxSigInfo "" UBYTE Com_RxCbkFuncPtrAckIdxOfRxSigInfoType 0 0 0 255 ECU_ADDRESS 0x0 /end MEASUREMENT
/begin MEASUREMENT Com_RxSigInfo[340].SignalProcessingOfRxSigInfo "" UBYTE Com_SignalProcessingOfRxSigInfoType 0 0 0 255 ECU_ADDRESS 0x0 /end MEASUREMENT
/begin MEASUREMENT Com_RxSigInfo[340].ValidDlcOfRxSigInfo "" UBYTE NO_COMPU_METHOD 0 0 0 255 ECU_ADDRESS 0x0 /end MEASUREMENT
/begin MEASUREMENT Com_RxSigInfo[341].RxAccessInfoIdxOfRxSigInfo "" UWORD NO_COMPU_METHOD 0 0 0 65535 ECU_ADDRESS 0x0 /end MEASUREMENT
/begin MEASUREMENT Com_RxSigInfo[341].RxCbkFuncPtrAckIdxOfRxSigInfo "" UBYTE Com_RxCbkFuncPtrAckIdxOfRxSigInfoType 0 0 0 255 ECU_ADDRESS 0x0 /end MEASUREMENT
/begin MEASUREMENT Com_RxSigInfo[341].SignalProcessingOfRxSigInfo "" UBYTE Com_SignalProcessingOfRxSigInfoType 0 0 0 255 ECU_ADDRESS 0x0 /end MEASUREMENT
/begin MEASUREMENT Com_RxSigInfo[341].ValidDlcOfRxSigInfo "" UBYTE NO_COMPU_METHOD 0 0 0 255 ECU_ADDRESS 0x0 /end MEASUREMENT
/begin MEASUREMENT Com_RxSigInfo[342].RxAccessInfoIdxOfRxSigInfo "" UWORD NO_COMPU_METHOD 0 0 0 65535 ECU_ADDRESS 0x0 /end MEASUREMENT
/begin MEASUREMENT Com_RxSigInfo[342].RxCbkFuncPtrAckIdxOfRxSigInfo "" UBYTE Com_RxCbkFuncPtrAckIdxOfRxSigInfoType 0 0 0 255 ECU_ADDRESS 0x0 /end MEASUREMENT
/begin MEASUREMENT Com_RxSigInfo[342].SignalProcessingOfRxSigInfo "" UBYTE Com_SignalProcessingOfRxSigInfoType 0 0 0 255 ECU_ADDRESS 0x0 /end MEASUREMENT
/begin MEASUREMENT Com_RxSigInfo[342].ValidDlcOfRxSigInfo "" UBYTE NO_COMPU_METHOD 0 0 0 255 ECU_ADDRESS 0x0 /end MEASUREMENT
/begin MEASUREMENT Com_RxSigInfo[343].RxAccessInfoIdxOfRxSigInfo "" UWORD NO_COMPU_METHOD 0 0 0 65535 ECU_ADDRESS 0x0 /end MEASUREMENT
/begin MEASUREMENT Com_RxSigInfo[343].RxCbkFuncPtrAckIdxOfRxSigInfo "" UBYTE Com_RxCbkFuncPtrAckIdxOfRxSigInfoType 0 0 0 255 ECU_ADDRESS 0x0 /end MEASUREMENT
/begin MEASUREMENT Com_RxSigInfo[343].SignalProcessingOfRxSigInfo "" UBYTE Com_SignalProcessingOfRxSigInfoType 0 0 0 255 ECU_ADDRESS 0x0 /end MEASUREMENT
/begin MEASUREMENT Com_RxSigInfo[343].ValidDlcOfRxSigInfo "" UBYTE NO_COMPU_METHOD 0 0 0 255 ECU_ADDRESS 0x0 /end MEASUREMENT
/begin MEASUREMENT Com_RxSigInfo[344].RxAccessInfoIdxOfRxSigInfo "" UWORD NO_COMPU_METHOD 0 0 0 65535 ECU_ADDRESS 0x0 /end MEASUREMENT
/begin MEASUREMENT Com_RxSigInfo[344].RxCbkFuncPtrAckIdxOfRxSigInfo "" UBYTE Com_RxCbkFuncPtrAckIdxOfRxSigInfoType 0 0 0 255 ECU_ADDRESS 0x0 /end MEASUREMENT
/begin MEASUREMENT Com_RxSigInfo[344].SignalProcessingOfRxSigInfo "" UBYTE Com_SignalProcessingOfRxSigInfoType 0 0 0 255 ECU_ADDRESS 0x0 /end MEASUREMENT
/begin MEASUREMENT Com_RxSigInfo[344].ValidDlcOfRxSigInfo "" UBYTE NO_COMPU_METHOD 0 0 0 255 ECU_ADDRESS 0x0 /end MEASUREMENT
/begin MEASUREMENT Com_RxSigInfo[345].RxAccessInfoIdxOfRxSigInfo "" UWORD NO_COMPU_METHOD 0 0 0 65535 ECU_ADDRESS 0x0 /end MEASUREMENT
/begin MEASUREMENT Com_RxSigInfo[345].RxCbkFuncPtrAckIdxOfRxSigInfo "" UBYTE Com_RxCbkFuncPtrAckIdxOfRxSigInfoType 0 0 0 255 ECU_ADDRESS 0x0 /end MEASUREMENT
/begin MEASUREMENT Com_RxSigInfo[345].SignalProcessingOfRxSigInfo "" UBYTE Com_SignalProcessingOfRxSigInfoType 0 0 0 255 ECU_ADDRESS 0x0 /end MEASUREMENT
/begin MEASUREMENT Com_RxSigInfo[345].ValidDlcOfRxSigInfo "" UBYTE NO_COMPU_METHOD 0 0 0 255 ECU_ADDRESS 0x0 /end MEASUREMENT
/begin MEASUREMENT Com_RxSigInfo[346].RxAccessInfoIdxOfRxSigInfo "" UWORD NO_COMPU_METHOD 0 0 0 65535 ECU_ADDRESS 0x0 /end MEASUREMENT
/begin MEASUREMENT Com_RxSigInfo[346].RxCbkFuncPtrAckIdxOfRxSigInfo "" UBYTE Com_RxCbkFuncPtrAckIdxOfRxSigInfoType 0 0 0 255 ECU_ADDRESS 0x0 /end MEASUREMENT
/begin MEASUREMENT Com_RxSigInfo[346].SignalProcessingOfRxSigInfo "" UBYTE Com_SignalProcessingOfRxSigInfoType 0 0 0 255 ECU_ADDRESS 0x0 /end MEASUREMENT
/begin MEASUREMENT Com_RxSigInfo[346].ValidDlcOfRxSigInfo "" UBYTE NO_COMPU_METHOD 0 0 0 255 ECU_ADDRESS 0x0 /end MEASUREMENT
/begin MEASUREMENT Com_RxSigInfo[347].RxAccessInfoIdxOfRxSigInfo "" UWORD NO_COMPU_METHOD 0 0 0 65535 ECU_ADDRESS 0x0 /end MEASUREMENT
/begin MEASUREMENT Com_RxSigInfo[347].RxCbkFuncPtrAckIdxOfRxSigInfo "" UBYTE Com_RxCbkFuncPtrAckIdxOfRxSigInfoType 0 0 0 255 ECU_ADDRESS 0x0 /end MEASUREMENT
/begin MEASUREMENT Com_RxSigInfo[347].SignalProcessingOfRxSigInfo "" UBYTE Com_SignalProcessingOfRxSigInfoType 0 0 0 255 ECU_ADDRESS 0x0 /end MEASUREMENT
/begin MEASUREMENT Com_RxSigInfo[347].ValidDlcOfRxSigInfo "" UBYTE NO_COMPU_METHOD 0 0 0 255 ECU_ADDRESS 0x0 /end MEASUREMENT
/begin MEASUREMENT Com_RxSigInfo[348].RxAccessInfoIdxOfRxSigInfo "" UWORD NO_COMPU_METHOD 0 0 0 65535 ECU_ADDRESS 0x0 /end MEASUREMENT
/begin MEASUREMENT Com_RxSigInfo[348].RxCbkFuncPtrAckIdxOfRxSigInfo "" UBYTE Com_RxCbkFuncPtrAckIdxOfRxSigInfoType 0 0 0 255 ECU_ADDRESS 0x0 /end MEASUREMENT
/begin MEASUREMENT Com_RxSigInfo[348].SignalProcessingOfRxSigInfo "" UBYTE Com_SignalProcessingOfRxSigInfoType 0 0 0 255 ECU_ADDRESS 0x0 /end MEASUREMENT
/begin MEASUREMENT Com_RxSigInfo[348].ValidDlcOfRxSigInfo "" UBYTE NO_COMPU_METHOD 0 0 0 255 ECU_ADDRESS 0x0 /end MEASUREMENT
/begin MEASUREMENT Com_RxSigInfo[349].RxAccessInfoIdxOfRxSigInfo "" UWORD NO_COMPU_METHOD 0 0 0 65535 ECU_ADDRESS 0x0 /end MEASUREMENT
/begin MEASUREMENT Com_RxSigInfo[349].RxCbkFuncPtrAckIdxOfRxSigInfo "" UBYTE Com_RxCbkFuncPtrAckIdxOfRxSigInfoType 0 0 0 255 ECU_ADDRESS 0x0 /end MEASUREMENT
/begin MEASUREMENT Com_RxSigInfo[349].SignalProcessingOfRxSigInfo "" UBYTE Com_SignalProcessingOfRxSigInfoType 0 0 0 255 ECU_ADDRESS 0x0 /end MEASUREMENT
/begin MEASUREMENT Com_RxSigInfo[349].ValidDlcOfRxSigInfo "" UBYTE NO_COMPU_METHOD 0 0 0 255 ECU_ADDRESS 0x0 /end MEASUREMENT
/begin MEASUREMENT Com_RxSigInfo[34].RxAccessInfoIdxOfRxSigInfo "" UWORD NO_COMPU_METHOD 0 0 0 65535 ECU_ADDRESS 0x0 /end MEASUREMENT
/begin MEASUREMENT Com_RxSigInfo[34].RxCbkFuncPtrAckIdxOfRxSigInfo "" UBYTE Com_RxCbkFuncPtrAckIdxOfRxSigInfoType 0 0 0 255 ECU_ADDRESS 0x0 /end MEASUREMENT
/begin MEASUREMENT Com_RxSigInfo[34].SignalProcessingOfRxSigInfo "" UBYTE Com_SignalProcessingOfRxSigInfoType 0 0 0 255 ECU_ADDRESS 0x0 /end MEASUREMENT
/begin MEASUREMENT Com_RxSigInfo[34].ValidDlcOfRxSigInfo "" UBYTE NO_COMPU_METHOD 0 0 0 255 ECU_ADDRESS 0x0 /end MEASUREMENT
/begin MEASUREMENT Com_RxSigInfo[350].RxAccessInfoIdxOfRxSigInfo "" UWORD NO_COMPU_METHOD 0 0 0 65535 ECU_ADDRESS 0x0 /end MEASUREMENT
/begin MEASUREMENT Com_RxSigInfo[350].RxCbkFuncPtrAckIdxOfRxSigInfo "" UBYTE Com_RxCbkFuncPtrAckIdxOfRxSigInfoType 0 0 0 255 ECU_ADDRESS 0x0 /end MEASUREMENT
/begin MEASUREMENT Com_RxSigInfo[350].SignalProcessingOfRxSigInfo "" UBYTE Com_SignalProcessingOfRxSigInfoType 0 0 0 255 ECU_ADDRESS 0x0 /end MEASUREMENT
/begin MEASUREMENT Com_RxSigInfo[350].ValidDlcOfRxSigInfo "" UBYTE NO_COMPU_METHOD 0 0 0 255 ECU_ADDRESS 0x0 /end MEASUREMENT
/begin MEASUREMENT Com_RxSigInfo[351].RxAccessInfoIdxOfRxSigInfo "" UWORD NO_COMPU_METHOD 0 0 0 65535 ECU_ADDRESS 0x0 /end MEASUREMENT
/begin MEASUREMENT Com_RxSigInfo[351].RxCbkFuncPtrAckIdxOfRxSigInfo "" UBYTE Com_RxCbkFuncPtrAckIdxOfRxSigInfoType 0 0 0 255 ECU_ADDRESS 0x0 /end MEASUREMENT
/begin MEASUREMENT Com_RxSigInfo[351].SignalProcessingOfRxSigInfo "" UBYTE Com_SignalProcessingOfRxSigInfoType 0 0 0 255 ECU_ADDRESS 0x0 /end MEASUREMENT
/begin MEASUREMENT Com_RxSigInfo[351].ValidDlcOfRxSigInfo "" UBYTE NO_COMPU_METHOD 0 0 0 255 ECU_ADDRESS 0x0 /end MEASUREMENT
/begin MEASUREMENT Com_RxSigInfo[352].RxAccessInfoIdxOfRxSigInfo "" UWORD NO_COMPU_METHOD 0 0 0 65535 ECU_ADDRESS 0x0 /end MEASUREMENT
/begin MEASUREMENT Com_RxSigInfo[352].RxCbkFuncPtrAckIdxOfRxSigInfo "" UBYTE Com_RxCbkFuncPtrAckIdxOfRxSigInfoType 0 0 0 255 ECU_ADDRESS 0x0 /end MEASUREMENT
/begin MEASUREMENT Com_RxSigInfo[352].SignalProcessingOfRxSigInfo "" UBYTE Com_SignalProcessingOfRxSigInfoType 0 0 0 255 ECU_ADDRESS 0x0 /end MEASUREMENT
/begin MEASUREMENT Com_RxSigInfo[352].ValidDlcOfRxSigInfo "" UBYTE NO_COMPU_METHOD 0 0 0 255 ECU_ADDRESS 0x0 /end MEASUREMENT
/begin MEASUREMENT Com_RxSigInfo[353].RxAccessInfoIdxOfRxSigInfo "" UWORD NO_COMPU_METHOD 0 0 0 65535 ECU_ADDRESS 0x0 /end MEASUREMENT
/begin MEASUREMENT Com_RxSigInfo[353].RxCbkFuncPtrAckIdxOfRxSigInfo "" UBYTE Com_RxCbkFuncPtrAckIdxOfRxSigInfoType 0 0 0 255 ECU_ADDRESS 0x0 /end MEASUREMENT
/begin MEASUREMENT Com_RxSigInfo[353].SignalProcessingOfRxSigInfo "" UBYTE Com_SignalProcessingOfRxSigInfoType 0 0 0 255 ECU_ADDRESS 0x0 /end MEASUREMENT
/begin MEASUREMENT Com_RxSigInfo[353].ValidDlcOfRxSigInfo "" UBYTE NO_COMPU_METHOD 0 0 0 255 ECU_ADDRESS 0x0 /end MEASUREMENT
/begin MEASUREMENT Com_RxSigInfo[354].RxAccessInfoIdxOfRxSigInfo "" UWORD NO_COMPU_METHOD 0 0 0 65535 ECU_ADDRESS 0x0 /end MEASUREMENT
/begin MEASUREMENT Com_RxSigInfo[354].RxCbkFuncPtrAckIdxOfRxSigInfo "" UBYTE Com_RxCbkFuncPtrAckIdxOfRxSigInfoType 0 0 0 255 ECU_ADDRESS 0x0 /end MEASUREMENT
/begin MEASUREMENT Com_RxSigInfo[354].SignalProcessingOfRxSigInfo "" UBYTE Com_SignalProcessingOfRxSigInfoType 0 0 0 255 ECU_ADDRESS 0x0 /end MEASUREMENT
/begin MEASUREMENT Com_RxSigInfo[354].ValidDlcOfRxSigInfo "" UBYTE NO_COMPU_METHOD 0 0 0 255 ECU_ADDRESS 0x0 /end MEASUREMENT
/begin MEASUREMENT Com_RxSigInfo[355].RxAccessInfoIdxOfRxSigInfo "" UWORD NO_COMPU_METHOD 0 0 0 65535 ECU_ADDRESS 0x0 /end MEASUREMENT
/begin MEASUREMENT Com_RxSigInfo[355].RxCbkFuncPtrAckIdxOfRxSigInfo "" UBYTE Com_RxCbkFuncPtrAckIdxOfRxSigInfoType 0 0 0 255 ECU_ADDRESS 0x0 /end MEASUREMENT
/begin MEASUREMENT Com_RxSigInfo[355].SignalProcessingOfRxSigInfo "" UBYTE Com_SignalProcessingOfRxSigInfoType 0 0 0 255 ECU_ADDRESS 0x0 /end MEASUREMENT
/begin MEASUREMENT Com_RxSigInfo[355].ValidDlcOfRxSigInfo "" UBYTE NO_COMPU_METHOD 0 0 0 255 ECU_ADDRESS 0x0 /end MEASUREMENT
/begin MEASUREMENT Com_RxSigInfo[356].RxAccessInfoIdxOfRxSigInfo "" UWORD NO_COMPU_METHOD 0 0 0 65535 ECU_ADDRESS 0x0 /end MEASUREMENT
/begin MEASUREMENT Com_RxSigInfo[356].RxCbkFuncPtrAckIdxOfRxSigInfo "" UBYTE Com_RxCbkFuncPtrAckIdxOfRxSigInfoType 0 0 0 255 ECU_ADDRESS 0x0 /end MEASUREMENT
/begin MEASUREMENT Com_RxSigInfo[356].SignalProcessingOfRxSigInfo "" UBYTE Com_SignalProcessingOfRxSigInfoType 0 0 0 255 ECU_ADDRESS 0x0 /end MEASUREMENT
/begin MEASUREMENT Com_RxSigInfo[356].ValidDlcOfRxSigInfo "" UBYTE NO_COMPU_METHOD 0 0 0 255 ECU_ADDRESS 0x0 /end MEASUREMENT
/begin MEASUREMENT Com_RxSigInfo[357].RxAccessInfoIdxOfRxSigInfo "" UWORD NO_COMPU_METHOD 0 0 0 65535 ECU_ADDRESS 0x0 /end MEASUREMENT
/begin MEASUREMENT Com_RxSigInfo[357].RxCbkFuncPtrAckIdxOfRxSigInfo "" UBYTE Com_RxCbkFuncPtrAckIdxOfRxSigInfoType 0 0 0 255 ECU_ADDRESS 0x0 /end MEASUREMENT
/begin MEASUREMENT Com_RxSigInfo[357].SignalProcessingOfRxSigInfo "" UBYTE Com_SignalProcessingOfRxSigInfoType 0 0 0 255 ECU_ADDRESS 0x0 /end MEASUREMENT
/begin MEASUREMENT Com_RxSigInfo[357].ValidDlcOfRxSigInfo "" UBYTE NO_COMPU_METHOD 0 0 0 255 ECU_ADDRESS 0x0 /end MEASUREMENT
/begin MEASUREMENT Com_RxSigInfo[358].RxAccessInfoIdxOfRxSigInfo "" UWORD NO_COMPU_METHOD 0 0 0 65535 ECU_ADDRESS 0x0 /end MEASUREMENT
/begin MEASUREMENT Com_RxSigInfo[358].RxCbkFuncPtrAckIdxOfRxSigInfo "" UBYTE Com_RxCbkFuncPtrAckIdxOfRxSigInfoType 0 0 0 255 ECU_ADDRESS 0x0 /end MEASUREMENT
/begin MEASUREMENT Com_RxSigInfo[358].SignalProcessingOfRxSigInfo "" UBYTE Com_SignalProcessingOfRxSigInfoType 0 0 0 255 ECU_ADDRESS 0x0 /end MEASUREMENT
/begin MEASUREMENT Com_RxSigInfo[358].ValidDlcOfRxSigInfo "" UBYTE NO_COMPU_METHOD 0 0 0 255 ECU_ADDRESS 0x0 /end MEASUREMENT
/begin MEASUREMENT Com_RxSigInfo[359].RxAccessInfoIdxOfRxSigInfo "" UWORD NO_COMPU_METHOD 0 0 0 65535 ECU_ADDRESS 0x0 /end MEASUREMENT
/begin MEASUREMENT Com_RxSigInfo[359].RxCbkFuncPtrAckIdxOfRxSigInfo "" UBYTE Com_RxCbkFuncPtrAckIdxOfRxSigInfoType 0 0 0 255 ECU_ADDRESS 0x0 /end MEASUREMENT
/begin MEASUREMENT Com_RxSigInfo[359].SignalProcessingOfRxSigInfo "" UBYTE Com_SignalProcessingOfRxSigInfoType 0 0 0 255 ECU_ADDRESS 0x0 /end MEASUREMENT
/begin MEASUREMENT Com_RxSigInfo[359].ValidDlcOfRxSigInfo "" UBYTE NO_COMPU_METHOD 0 0 0 255 ECU_ADDRESS 0x0 /end MEASUREMENT
/begin MEASUREMENT Com_RxSigInfo[35].RxAccessInfoIdxOfRxSigInfo "" UWORD NO_COMPU_METHOD 0 0 0 65535 ECU_ADDRESS 0x0 /end MEASUREMENT
/begin MEASUREMENT Com_RxSigInfo[35].RxCbkFuncPtrAckIdxOfRxSigInfo "" UBYTE Com_RxCbkFuncPtrAckIdxOfRxSigInfoType 0 0 0 255 ECU_ADDRESS 0x0 /end MEASUREMENT
/begin MEASUREMENT Com_RxSigInfo[35].SignalProcessingOfRxSigInfo "" UBYTE Com_SignalProcessingOfRxSigInfoType 0 0 0 255 ECU_ADDRESS 0x0 /end MEASUREMENT
/begin MEASUREMENT Com_RxSigInfo[35].ValidDlcOfRxSigInfo "" UBYTE NO_COMPU_METHOD 0 0 0 255 ECU_ADDRESS 0x0 /end MEASUREMENT
/begin MEASUREMENT Com_RxSigInfo[360].RxAccessInfoIdxOfRxSigInfo "" UWORD NO_COMPU_METHOD 0 0 0 65535 ECU_ADDRESS 0x0 /end MEASUREMENT
/begin MEASUREMENT Com_RxSigInfo[360].RxCbkFuncPtrAckIdxOfRxSigInfo "" UBYTE Com_RxCbkFuncPtrAckIdxOfRxSigInfoType 0 0 0 255 ECU_ADDRESS 0x0 /end MEASUREMENT
/begin MEASUREMENT Com_RxSigInfo[360].SignalProcessingOfRxSigInfo "" UBYTE Com_SignalProcessingOfRxSigInfoType 0 0 0 255 ECU_ADDRESS 0x0 /end MEASUREMENT
/begin MEASUREMENT Com_RxSigInfo[360].ValidDlcOfRxSigInfo "" UBYTE NO_COMPU_METHOD 0 0 0 255 ECU_ADDRESS 0x0 /end MEASUREMENT
/begin MEASUREMENT Com_RxSigInfo[361].RxAccessInfoIdxOfRxSigInfo "" UWORD NO_COMPU_METHOD 0 0 0 65535 ECU_ADDRESS 0x0 /end MEASUREMENT
/begin MEASUREMENT Com_RxSigInfo[361].RxCbkFuncPtrAckIdxOfRxSigInfo "" UBYTE Com_RxCbkFuncPtrAckIdxOfRxSigInfoType 0 0 0 255 ECU_ADDRESS 0x0 /end MEASUREMENT
/begin MEASUREMENT Com_RxSigInfo[361].SignalProcessingOfRxSigInfo "" UBYTE Com_SignalProcessingOfRxSigInfoType 0 0 0 255 ECU_ADDRESS 0x0 /end MEASUREMENT
/begin MEASUREMENT Com_RxSigInfo[361].ValidDlcOfRxSigInfo "" UBYTE NO_COMPU_METHOD 0 0 0 255 ECU_ADDRESS 0x0 /end MEASUREMENT
/begin MEASUREMENT Com_RxSigInfo[362].RxAccessInfoIdxOfRxSigInfo "" UWORD NO_COMPU_METHOD 0 0 0 65535 ECU_ADDRESS 0x0 /end MEASUREMENT
/begin MEASUREMENT Com_RxSigInfo[362].RxCbkFuncPtrAckIdxOfRxSigInfo "" UBYTE Com_RxCbkFuncPtrAckIdxOfRxSigInfoType 0 0 0 255 ECU_ADDRESS 0x0 /end MEASUREMENT
/begin MEASUREMENT Com_RxSigInfo[362].SignalProcessingOfRxSigInfo "" UBYTE Com_SignalProcessingOfRxSigInfoType 0 0 0 255 ECU_ADDRESS 0x0 /end MEASUREMENT
/begin MEASUREMENT Com_RxSigInfo[362].ValidDlcOfRxSigInfo "" UBYTE NO_COMPU_METHOD 0 0 0 255 ECU_ADDRESS 0x0 /end MEASUREMENT
/begin MEASUREMENT Com_RxSigInfo[36].RxAccessInfoIdxOfRxSigInfo "" UWORD NO_COMPU_METHOD 0 0 0 65535 ECU_ADDRESS 0x0 /end MEASUREMENT
/begin MEASUREMENT Com_RxSigInfo[36].RxCbkFuncPtrAckIdxOfRxSigInfo "" UBYTE Com_RxCbkFuncPtrAckIdxOfRxSigInfoType 0 0 0 255 ECU_ADDRESS 0x0 /end MEASUREMENT
/begin MEASUREMENT Com_RxSigInfo[36].SignalProcessingOfRxSigInfo "" UBYTE Com_SignalProcessingOfRxSigInfoType 0 0 0 255 ECU_ADDRESS 0x0 /end MEASUREMENT
/begin MEASUREMENT Com_RxSigInfo[36].ValidDlcOfRxSigInfo "" UBYTE NO_COMPU_METHOD 0 0 0 255 ECU_ADDRESS 0x0 /end MEASUREMENT
/begin MEASUREMENT Com_RxSigInfo[37].RxAccessInfoIdxOfRxSigInfo "" UWORD NO_COMPU_METHOD 0 0 0 65535 ECU_ADDRESS 0x0 /end MEASUREMENT
/begin MEASUREMENT Com_RxSigInfo[37].RxCbkFuncPtrAckIdxOfRxSigInfo "" UBYTE Com_RxCbkFuncPtrAckIdxOfRxSigInfoType 0 0 0 255 ECU_ADDRESS 0x0 /end MEASUREMENT
/begin MEASUREMENT Com_RxSigInfo[37].SignalProcessingOfRxSigInfo "" UBYTE Com_SignalProcessingOfRxSigInfoType 0 0 0 255 ECU_ADDRESS 0x0 /end MEASUREMENT
/begin MEASUREMENT Com_RxSigInfo[37].ValidDlcOfRxSigInfo "" UBYTE NO_COMPU_METHOD 0 0 0 255 ECU_ADDRESS 0x0 /end MEASUREMENT
/begin MEASUREMENT Com_RxSigInfo[38].RxAccessInfoIdxOfRxSigInfo "" UWORD NO_COMPU_METHOD 0 0 0 65535 ECU_ADDRESS 0x0 /end MEASUREMENT
/begin MEASUREMENT Com_RxSigInfo[38].RxCbkFuncPtrAckIdxOfRxSigInfo "" UBYTE Com_RxCbkFuncPtrAckIdxOfRxSigInfoType 0 0 0 255 ECU_ADDRESS 0x0 /end MEASUREMENT
/begin MEASUREMENT Com_RxSigInfo[38].SignalProcessingOfRxSigInfo "" UBYTE Com_SignalProcessingOfRxSigInfoType 0 0 0 255 ECU_ADDRESS 0x0 /end MEASUREMENT
/begin MEASUREMENT Com_RxSigInfo[38].ValidDlcOfRxSigInfo "" UBYTE NO_COMPU_METHOD 0 0 0 255 ECU_ADDRESS 0x0 /end MEASUREMENT
/begin MEASUREMENT Com_RxSigInfo[39].RxAccessInfoIdxOfRxSigInfo "" UWORD NO_COMPU_METHOD 0 0 0 65535 ECU_ADDRESS 0x0 /end MEASUREMENT
/begin MEASUREMENT Com_RxSigInfo[39].RxCbkFuncPtrAckIdxOfRxSigInfo "" UBYTE Com_RxCbkFuncPtrAckIdxOfRxSigInfoType 0 0 0 255 ECU_ADDRESS 0x0 /end MEASUREMENT
/begin MEASUREMENT Com_RxSigInfo[39].SignalProcessingOfRxSigInfo "" UBYTE Com_SignalProcessingOfRxSigInfoType 0 0 0 255 ECU_ADDRESS 0x0 /end MEASUREMENT
/begin MEASUREMENT Com_RxSigInfo[39].ValidDlcOfRxSigInfo "" UBYTE NO_COMPU_METHOD 0 0 0 255 ECU_ADDRESS 0x0 /end MEASUREMENT
/begin MEASUREMENT Com_RxSigInfo[3].RxAccessInfoIdxOfRxSigInfo "" UWORD NO_COMPU_METHOD 0 0 0 65535 ECU_ADDRESS 0x0 /end MEASUREMENT
/begin MEASUREMENT Com_RxSigInfo[3].RxCbkFuncPtrAckIdxOfRxSigInfo "" UBYTE Com_RxCbkFuncPtrAckIdxOfRxSigInfoType 0 0 0 255 ECU_ADDRESS 0x0 /end MEASUREMENT
/begin MEASUREMENT Com_RxSigInfo[3].SignalProcessingOfRxSigInfo "" UBYTE Com_SignalProcessingOfRxSigInfoType 0 0 0 255 ECU_ADDRESS 0x0 /end MEASUREMENT
/begin MEASUREMENT Com_RxSigInfo[3].ValidDlcOfRxSigInfo "" UBYTE NO_COMPU_METHOD 0 0 0 255 ECU_ADDRESS 0x0 /end MEASUREMENT
/begin MEASUREMENT Com_RxSigInfo[40].RxAccessInfoIdxOfRxSigInfo "" UWORD NO_COMPU_METHOD 0 0 0 65535 ECU_ADDRESS 0x0 /end MEASUREMENT
/begin MEASUREMENT Com_RxSigInfo[40].RxCbkFuncPtrAckIdxOfRxSigInfo "" UBYTE Com_RxCbkFuncPtrAckIdxOfRxSigInfoType 0 0 0 255 ECU_ADDRESS 0x0 /end MEASUREMENT
/begin MEASUREMENT Com_RxSigInfo[40].SignalProcessingOfRxSigInfo "" UBYTE Com_SignalProcessingOfRxSigInfoType 0 0 0 255 ECU_ADDRESS 0x0 /end MEASUREMENT
/begin MEASUREMENT Com_RxSigInfo[40].ValidDlcOfRxSigInfo "" UBYTE NO_COMPU_METHOD 0 0 0 255 ECU_ADDRESS 0x0 /end MEASUREMENT
/begin MEASUREMENT Com_RxSigInfo[41].RxAccessInfoIdxOfRxSigInfo "" UWORD NO_COMPU_METHOD 0 0 0 65535 ECU_ADDRESS 0x0 /end MEASUREMENT
/begin MEASUREMENT Com_RxSigInfo[41].RxCbkFuncPtrAckIdxOfRxSigInfo "" UBYTE Com_RxCbkFuncPtrAckIdxOfRxSigInfoType 0 0 0 255 ECU_ADDRESS 0x0 /end MEASUREMENT
/begin MEASUREMENT Com_RxSigInfo[41].SignalProcessingOfRxSigInfo "" UBYTE Com_SignalProcessingOfRxSigInfoType 0 0 0 255 ECU_ADDRESS 0x0 /end MEASUREMENT
/begin MEASUREMENT Com_RxSigInfo[41].ValidDlcOfRxSigInfo "" UBYTE NO_COMPU_METHOD 0 0 0 255 ECU_ADDRESS 0x0 /end MEASUREMENT
/begin MEASUREMENT Com_RxSigInfo[42].RxAccessInfoIdxOfRxSigInfo "" UWORD NO_COMPU_METHOD 0 0 0 65535 ECU_ADDRESS 0x0 /end MEASUREMENT
/begin MEASUREMENT Com_RxSigInfo[42].RxCbkFuncPtrAckIdxOfRxSigInfo "" UBYTE Com_RxCbkFuncPtrAckIdxOfRxSigInfoType 0 0 0 255 ECU_ADDRESS 0x0 /end MEASUREMENT
/begin MEASUREMENT Com_RxSigInfo[42].SignalProcessingOfRxSigInfo "" UBYTE Com_SignalProcessingOfRxSigInfoType 0 0 0 255 ECU_ADDRESS 0x0 /end MEASUREMENT
/begin MEASUREMENT Com_RxSigInfo[42].ValidDlcOfRxSigInfo "" UBYTE NO_COMPU_METHOD 0 0 0 255 ECU_ADDRESS 0x0 /end MEASUREMENT
/begin MEASUREMENT Com_RxSigInfo[43].RxAccessInfoIdxOfRxSigInfo "" UWORD NO_COMPU_METHOD 0 0 0 65535 ECU_ADDRESS 0x0 /end MEASUREMENT
/begin MEASUREMENT Com_RxSigInfo[43].RxCbkFuncPtrAckIdxOfRxSigInfo "" UBYTE Com_RxCbkFuncPtrAckIdxOfRxSigInfoType 0 0 0 255 ECU_ADDRESS 0x0 /end MEASUREMENT
/begin MEASUREMENT Com_RxSigInfo[43].SignalProcessingOfRxSigInfo "" UBYTE Com_SignalProcessingOfRxSigInfoType 0 0 0 255 ECU_ADDRESS 0x0 /end MEASUREMENT
/begin MEASUREMENT Com_RxSigInfo[43].ValidDlcOfRxSigInfo "" UBYTE NO_COMPU_METHOD 0 0 0 255 ECU_ADDRESS 0x0 /end MEASUREMENT
/begin MEASUREMENT Com_RxSigInfo[44].RxAccessInfoIdxOfRxSigInfo "" UWORD NO_COMPU_METHOD 0 0 0 65535 ECU_ADDRESS 0x0 /end MEASUREMENT
/begin MEASUREMENT Com_RxSigInfo[44].RxCbkFuncPtrAckIdxOfRxSigInfo "" UBYTE Com_RxCbkFuncPtrAckIdxOfRxSigInfoType 0 0 0 255 ECU_ADDRESS 0x0 /end MEASUREMENT
/begin MEASUREMENT Com_RxSigInfo[44].SignalProcessingOfRxSigInfo "" UBYTE Com_SignalProcessingOfRxSigInfoType 0 0 0 255 ECU_ADDRESS 0x0 /end MEASUREMENT
/begin MEASUREMENT Com_RxSigInfo[44].ValidDlcOfRxSigInfo "" UBYTE NO_COMPU_METHOD 0 0 0 255 ECU_ADDRESS 0x0 /end MEASUREMENT
/begin MEASUREMENT Com_RxSigInfo[45].RxAccessInfoIdxOfRxSigInfo "" UWORD NO_COMPU_METHOD 0 0 0 65535 ECU_ADDRESS 0x0 /end MEASUREMENT
/begin MEASUREMENT Com_RxSigInfo[45].RxCbkFuncPtrAckIdxOfRxSigInfo "" UBYTE Com_RxCbkFuncPtrAckIdxOfRxSigInfoType 0 0 0 255 ECU_ADDRESS 0x0 /end MEASUREMENT
/begin MEASUREMENT Com_RxSigInfo[45].SignalProcessingOfRxSigInfo "" UBYTE Com_SignalProcessingOfRxSigInfoType 0 0 0 255 ECU_ADDRESS 0x0 /end MEASUREMENT
/begin MEASUREMENT Com_RxSigInfo[45].ValidDlcOfRxSigInfo "" UBYTE NO_COMPU_METHOD 0 0 0 255 ECU_ADDRESS 0x0 /end MEASUREMENT
/begin MEASUREMENT Com_RxSigInfo[46].RxAccessInfoIdxOfRxSigInfo "" UWORD NO_COMPU_METHOD 0 0 0 65535 ECU_ADDRESS 0x0 /end MEASUREMENT
/begin MEASUREMENT Com_RxSigInfo[46].RxCbkFuncPtrAckIdxOfRxSigInfo "" UBYTE Com_RxCbkFuncPtrAckIdxOfRxSigInfoType 0 0 0 255 ECU_ADDRESS 0x0 /end MEASUREMENT
/begin MEASUREMENT Com_RxSigInfo[46].SignalProcessingOfRxSigInfo "" UBYTE Com_SignalProcessingOfRxSigInfoType 0 0 0 255 ECU_ADDRESS 0x0 /end MEASUREMENT
/begin MEASUREMENT Com_RxSigInfo[46].ValidDlcOfRxSigInfo "" UBYTE NO_COMPU_METHOD 0 0 0 255 ECU_ADDRESS 0x0 /end MEASUREMENT
/begin MEASUREMENT Com_RxSigInfo[47].RxAccessInfoIdxOfRxSigInfo "" UWORD NO_COMPU_METHOD 0 0 0 65535 ECU_ADDRESS 0x0 /end MEASUREMENT
/begin MEASUREMENT Com_RxSigInfo[47].RxCbkFuncPtrAckIdxOfRxSigInfo "" UBYTE Com_RxCbkFuncPtrAckIdxOfRxSigInfoType 0 0 0 255 ECU_ADDRESS 0x0 /end MEASUREMENT
/begin MEASUREMENT Com_RxSigInfo[47].SignalProcessingOfRxSigInfo "" UBYTE Com_SignalProcessingOfRxSigInfoType 0 0 0 255 ECU_ADDRESS 0x0 /end MEASUREMENT
/begin MEASUREMENT Com_RxSigInfo[47].ValidDlcOfRxSigInfo "" UBYTE NO_COMPU_METHOD 0 0 0 255 ECU_ADDRESS 0x0 /end MEASUREMENT
/begin MEASUREMENT Com_RxSigInfo[48].RxAccessInfoIdxOfRxSigInfo "" UWORD NO_COMPU_METHOD 0 0 0 65535 ECU_ADDRESS 0x0 /end MEASUREMENT
/begin MEASUREMENT Com_RxSigInfo[48].RxCbkFuncPtrAckIdxOfRxSigInfo "" UBYTE Com_RxCbkFuncPtrAckIdxOfRxSigInfoType 0 0 0 255 ECU_ADDRESS 0x0 /end MEASUREMENT
/begin MEASUREMENT Com_RxSigInfo[48].SignalProcessingOfRxSigInfo "" UBYTE Com_SignalProcessingOfRxSigInfoType 0 0 0 255 ECU_ADDRESS 0x0 /end MEASUREMENT
/begin MEASUREMENT Com_RxSigInfo[48].ValidDlcOfRxSigInfo "" UBYTE NO_COMPU_METHOD 0 0 0 255 ECU_ADDRESS 0x0 /end MEASUREMENT
/begin MEASUREMENT Com_RxSigInfo[49].RxAccessInfoIdxOfRxSigInfo "" UWORD NO_COMPU_METHOD 0 0 0 65535 ECU_ADDRESS 0x0 /end MEASUREMENT
/begin MEASUREMENT Com_RxSigInfo[49].RxCbkFuncPtrAckIdxOfRxSigInfo "" UBYTE Com_RxCbkFuncPtrAckIdxOfRxSigInfoType 0 0 0 255 ECU_ADDRESS 0x0 /end MEASUREMENT
/begin MEASUREMENT Com_RxSigInfo[49].SignalProcessingOfRxSigInfo "" UBYTE Com_SignalProcessingOfRxSigInfoType 0 0 0 255 ECU_ADDRESS 0x0 /end MEASUREMENT
/begin MEASUREMENT Com_RxSigInfo[49].ValidDlcOfRxSigInfo "" UBYTE NO_COMPU_METHOD 0 0 0 255 ECU_ADDRESS 0x0 /end MEASUREMENT
/begin MEASUREMENT Com_RxSigInfo[4].RxAccessInfoIdxOfRxSigInfo "" UWORD NO_COMPU_METHOD 0 0 0 65535 ECU_ADDRESS 0x0 /end MEASUREMENT
/begin MEASUREMENT Com_RxSigInfo[4].RxCbkFuncPtrAckIdxOfRxSigInfo "" UBYTE Com_RxCbkFuncPtrAckIdxOfRxSigInfoType 0 0 0 255 ECU_ADDRESS 0x0 /end MEASUREMENT
/begin MEASUREMENT Com_RxSigInfo[4].SignalProcessingOfRxSigInfo "" UBYTE Com_SignalProcessingOfRxSigInfoType 0 0 0 255 ECU_ADDRESS 0x0 /end MEASUREMENT
/begin MEASUREMENT Com_RxSigInfo[4].ValidDlcOfRxSigInfo "" UBYTE NO_COMPU_METHOD 0 0 0 255 ECU_ADDRESS 0x0 /end MEASUREMENT
/begin MEASUREMENT Com_RxSigInfo[50].RxAccessInfoIdxOfRxSigInfo "" UWORD NO_COMPU_METHOD 0 0 0 65535 ECU_ADDRESS 0x0 /end MEASUREMENT
/begin MEASUREMENT Com_RxSigInfo[50].RxCbkFuncPtrAckIdxOfRxSigInfo "" UBYTE Com_RxCbkFuncPtrAckIdxOfRxSigInfoType 0 0 0 255 ECU_ADDRESS 0x0 /end MEASUREMENT
/begin MEASUREMENT Com_RxSigInfo[50].SignalProcessingOfRxSigInfo "" UBYTE Com_SignalProcessingOfRxSigInfoType 0 0 0 255 ECU_ADDRESS 0x0 /end MEASUREMENT
/begin MEASUREMENT Com_RxSigInfo[50].ValidDlcOfRxSigInfo "" UBYTE NO_COMPU_METHOD 0 0 0 255 ECU_ADDRESS 0x0 /end MEASUREMENT
/begin MEASUREMENT Com_RxSigInfo[51].RxAccessInfoIdxOfRxSigInfo "" UWORD NO_COMPU_METHOD 0 0 0 65535 ECU_ADDRESS 0x0 /end MEASUREMENT
/begin MEASUREMENT Com_RxSigInfo[51].RxCbkFuncPtrAckIdxOfRxSigInfo "" UBYTE Com_RxCbkFuncPtrAckIdxOfRxSigInfoType 0 0 0 255 ECU_ADDRESS 0x0 /end MEASUREMENT
/begin MEASUREMENT Com_RxSigInfo[51].SignalProcessingOfRxSigInfo "" UBYTE Com_SignalProcessingOfRxSigInfoType 0 0 0 255 ECU_ADDRESS 0x0 /end MEASUREMENT
/begin MEASUREMENT Com_RxSigInfo[51].ValidDlcOfRxSigInfo "" UBYTE NO_COMPU_METHOD 0 0 0 255 ECU_ADDRESS 0x0 /end MEASUREMENT
/begin MEASUREMENT Com_RxSigInfo[52].RxAccessInfoIdxOfRxSigInfo "" UWORD NO_COMPU_METHOD 0 0 0 65535 ECU_ADDRESS 0x0 /end MEASUREMENT
/begin MEASUREMENT Com_RxSigInfo[52].RxCbkFuncPtrAckIdxOfRxSigInfo "" UBYTE Com_RxCbkFuncPtrAckIdxOfRxSigInfoType 0 0 0 255 ECU_ADDRESS 0x0 /end MEASUREMENT
/begin MEASUREMENT Com_RxSigInfo[52].SignalProcessingOfRxSigInfo "" UBYTE Com_SignalProcessingOfRxSigInfoType 0 0 0 255 ECU_ADDRESS 0x0 /end MEASUREMENT
/begin MEASUREMENT Com_RxSigInfo[52].ValidDlcOfRxSigInfo "" UBYTE NO_COMPU_METHOD 0 0 0 255 ECU_ADDRESS 0x0 /end MEASUREMENT
/begin MEASUREMENT Com_RxSigInfo[53].RxAccessInfoIdxOfRxSigInfo "" UWORD NO_COMPU_METHOD 0 0 0 65535 ECU_ADDRESS 0x0 /end MEASUREMENT
/begin MEASUREMENT Com_RxSigInfo[53].RxCbkFuncPtrAckIdxOfRxSigInfo "" UBYTE Com_RxCbkFuncPtrAckIdxOfRxSigInfoType 0 0 0 255 ECU_ADDRESS 0x0 /end MEASUREMENT
/begin MEASUREMENT Com_RxSigInfo[53].SignalProcessingOfRxSigInfo "" UBYTE Com_SignalProcessingOfRxSigInfoType 0 0 0 255 ECU_ADDRESS 0x0 /end MEASUREMENT
/begin MEASUREMENT Com_RxSigInfo[53].ValidDlcOfRxSigInfo "" UBYTE NO_COMPU_METHOD 0 0 0 255 ECU_ADDRESS 0x0 /end MEASUREMENT
/begin MEASUREMENT Com_RxSigInfo[54].RxAccessInfoIdxOfRxSigInfo "" UWORD NO_COMPU_METHOD 0 0 0 65535 ECU_ADDRESS 0x0 /end MEASUREMENT
/begin MEASUREMENT Com_RxSigInfo[54].RxCbkFuncPtrAckIdxOfRxSigInfo "" UBYTE Com_RxCbkFuncPtrAckIdxOfRxSigInfoType 0 0 0 255 ECU_ADDRESS 0x0 /end MEASUREMENT
/begin MEASUREMENT Com_RxSigInfo[54].SignalProcessingOfRxSigInfo "" UBYTE Com_SignalProcessingOfRxSigInfoType 0 0 0 255 ECU_ADDRESS 0x0 /end MEASUREMENT
/begin MEASUREMENT Com_RxSigInfo[54].ValidDlcOfRxSigInfo "" UBYTE NO_COMPU_METHOD 0 0 0 255 ECU_ADDRESS 0x0 /end MEASUREMENT
/begin MEASUREMENT Com_RxSigInfo[55].RxAccessInfoIdxOfRxSigInfo "" UWORD NO_COMPU_METHOD 0 0 0 65535 ECU_ADDRESS 0x0 /end MEASUREMENT
/begin MEASUREMENT Com_RxSigInfo[55].RxCbkFuncPtrAckIdxOfRxSigInfo "" UBYTE Com_RxCbkFuncPtrAckIdxOfRxSigInfoType 0 0 0 255 ECU_ADDRESS 0x0 /end MEASUREMENT
/begin MEASUREMENT Com_RxSigInfo[55].SignalProcessingOfRxSigInfo "" UBYTE Com_SignalProcessingOfRxSigInfoType 0 0 0 255 ECU_ADDRESS 0x0 /end MEASUREMENT
/begin MEASUREMENT Com_RxSigInfo[55].ValidDlcOfRxSigInfo "" UBYTE NO_COMPU_METHOD 0 0 0 255 ECU_ADDRESS 0x0 /end MEASUREMENT
/begin MEASUREMENT Com_RxSigInfo[56].RxAccessInfoIdxOfRxSigInfo "" UWORD NO_COMPU_METHOD 0 0 0 65535 ECU_ADDRESS 0x0 /end MEASUREMENT
/begin MEASUREMENT Com_RxSigInfo[56].RxCbkFuncPtrAckIdxOfRxSigInfo "" UBYTE Com_RxCbkFuncPtrAckIdxOfRxSigInfoType 0 0 0 255 ECU_ADDRESS 0x0 /end MEASUREMENT
/begin MEASUREMENT Com_RxSigInfo[56].SignalProcessingOfRxSigInfo "" UBYTE Com_SignalProcessingOfRxSigInfoType 0 0 0 255 ECU_ADDRESS 0x0 /end MEASUREMENT
/begin MEASUREMENT Com_RxSigInfo[56].ValidDlcOfRxSigInfo "" UBYTE NO_COMPU_METHOD 0 0 0 255 ECU_ADDRESS 0x0 /end MEASUREMENT
/begin MEASUREMENT Com_RxSigInfo[57].RxAccessInfoIdxOfRxSigInfo "" UWORD NO_COMPU_METHOD 0 0 0 65535 ECU_ADDRESS 0x0 /end MEASUREMENT
/begin MEASUREMENT Com_RxSigInfo[57].RxCbkFuncPtrAckIdxOfRxSigInfo "" UBYTE Com_RxCbkFuncPtrAckIdxOfRxSigInfoType 0 0 0 255 ECU_ADDRESS 0x0 /end MEASUREMENT
/begin MEASUREMENT Com_RxSigInfo[57].SignalProcessingOfRxSigInfo "" UBYTE Com_SignalProcessingOfRxSigInfoType 0 0 0 255 ECU_ADDRESS 0x0 /end MEASUREMENT
/begin MEASUREMENT Com_RxSigInfo[57].ValidDlcOfRxSigInfo "" UBYTE NO_COMPU_METHOD 0 0 0 255 ECU_ADDRESS 0x0 /end MEASUREMENT
/begin MEASUREMENT Com_RxSigInfo[58].RxAccessInfoIdxOfRxSigInfo "" UWORD NO_COMPU_METHOD 0 0 0 65535 ECU_ADDRESS 0x0 /end MEASUREMENT
/begin MEASUREMENT Com_RxSigInfo[58].RxCbkFuncPtrAckIdxOfRxSigInfo "" UBYTE Com_RxCbkFuncPtrAckIdxOfRxSigInfoType 0 0 0 255 ECU_ADDRESS 0x0 /end MEASUREMENT
/begin MEASUREMENT Com_RxSigInfo[58].SignalProcessingOfRxSigInfo "" UBYTE Com_SignalProcessingOfRxSigInfoType 0 0 0 255 ECU_ADDRESS 0x0 /end MEASUREMENT
/begin MEASUREMENT Com_RxSigInfo[58].ValidDlcOfRxSigInfo "" UBYTE NO_COMPU_METHOD 0 0 0 255 ECU_ADDRESS 0x0 /end MEASUREMENT
/begin MEASUREMENT Com_RxSigInfo[59].RxAccessInfoIdxOfRxSigInfo "" UWORD NO_COMPU_METHOD 0 0 0 65535 ECU_ADDRESS 0x0 /end MEASUREMENT
/begin MEASUREMENT Com_RxSigInfo[59].RxCbkFuncPtrAckIdxOfRxSigInfo "" UBYTE Com_RxCbkFuncPtrAckIdxOfRxSigInfoType 0 0 0 255 ECU_ADDRESS 0x0 /end MEASUREMENT
/begin MEASUREMENT Com_RxSigInfo[59].SignalProcessingOfRxSigInfo "" UBYTE Com_SignalProcessingOfRxSigInfoType 0 0 0 255 ECU_ADDRESS 0x0 /end MEASUREMENT
/begin MEASUREMENT Com_RxSigInfo[59].ValidDlcOfRxSigInfo "" UBYTE NO_COMPU_METHOD 0 0 0 255 ECU_ADDRESS 0x0 /end MEASUREMENT
/begin MEASUREMENT Com_RxSigInfo[5].RxAccessInfoIdxOfRxSigInfo "" UWORD NO_COMPU_METHOD 0 0 0 65535 ECU_ADDRESS 0x0 /end MEASUREMENT
/begin MEASUREMENT Com_RxSigInfo[5].RxCbkFuncPtrAckIdxOfRxSigInfo "" UBYTE Com_RxCbkFuncPtrAckIdxOfRxSigInfoType 0 0 0 255 ECU_ADDRESS 0x0 /end MEASUREMENT
/begin MEASUREMENT Com_RxSigInfo[5].SignalProcessingOfRxSigInfo "" UBYTE Com_SignalProcessingOfRxSigInfoType 0 0 0 255 ECU_ADDRESS 0x0 /end MEASUREMENT
/begin MEASUREMENT Com_RxSigInfo[5].ValidDlcOfRxSigInfo "" UBYTE NO_COMPU_METHOD 0 0 0 255 ECU_ADDRESS 0x0 /end MEASUREMENT
/begin MEASUREMENT Com_RxSigInfo[60].RxAccessInfoIdxOfRxSigInfo "" UWORD NO_COMPU_METHOD 0 0 0 65535 ECU_ADDRESS 0x0 /end MEASUREMENT
/begin MEASUREMENT Com_RxSigInfo[60].RxCbkFuncPtrAckIdxOfRxSigInfo "" UBYTE Com_RxCbkFuncPtrAckIdxOfRxSigInfoType 0 0 0 255 ECU_ADDRESS 0x0 /end MEASUREMENT
/begin MEASUREMENT Com_RxSigInfo[60].SignalProcessingOfRxSigInfo "" UBYTE Com_SignalProcessingOfRxSigInfoType 0 0 0 255 ECU_ADDRESS 0x0 /end MEASUREMENT
/begin MEASUREMENT Com_RxSigInfo[60].ValidDlcOfRxSigInfo "" UBYTE NO_COMPU_METHOD 0 0 0 255 ECU_ADDRESS 0x0 /end MEASUREMENT
/begin MEASUREMENT Com_RxSigInfo[61].RxAccessInfoIdxOfRxSigInfo "" UWORD NO_COMPU_METHOD 0 0 0 65535 ECU_ADDRESS 0x0 /end MEASUREMENT
/begin MEASUREMENT Com_RxSigInfo[61].RxCbkFuncPtrAckIdxOfRxSigInfo "" UBYTE Com_RxCbkFuncPtrAckIdxOfRxSigInfoType 0 0 0 255 ECU_ADDRESS 0x0 /end MEASUREMENT
/begin MEASUREMENT Com_RxSigInfo[61].SignalProcessingOfRxSigInfo "" UBYTE Com_SignalProcessingOfRxSigInfoType 0 0 0 255 ECU_ADDRESS 0x0 /end MEASUREMENT
/begin MEASUREMENT Com_RxSigInfo[61].ValidDlcOfRxSigInfo "" UBYTE NO_COMPU_METHOD 0 0 0 255 ECU_ADDRESS 0x0 /end MEASUREMENT
/begin MEASUREMENT Com_RxSigInfo[62].RxAccessInfoIdxOfRxSigInfo "" UWORD NO_COMPU_METHOD 0 0 0 65535 ECU_ADDRESS 0x0 /end MEASUREMENT
/begin MEASUREMENT Com_RxSigInfo[62].RxCbkFuncPtrAckIdxOfRxSigInfo "" UBYTE Com_RxCbkFuncPtrAckIdxOfRxSigInfoType 0 0 0 255 ECU_ADDRESS 0x0 /end MEASUREMENT
/begin MEASUREMENT Com_RxSigInfo[62].SignalProcessingOfRxSigInfo "" UBYTE Com_SignalProcessingOfRxSigInfoType 0 0 0 255 ECU_ADDRESS 0x0 /end MEASUREMENT
/begin MEASUREMENT Com_RxSigInfo[62].ValidDlcOfRxSigInfo "" UBYTE NO_COMPU_METHOD 0 0 0 255 ECU_ADDRESS 0x0 /end MEASUREMENT
/begin MEASUREMENT Com_RxSigInfo[63].RxAccessInfoIdxOfRxSigInfo "" UWORD NO_COMPU_METHOD 0 0 0 65535 ECU_ADDRESS 0x0 /end MEASUREMENT
/begin MEASUREMENT Com_RxSigInfo[63].RxCbkFuncPtrAckIdxOfRxSigInfo "" UBYTE Com_RxCbkFuncPtrAckIdxOfRxSigInfoType 0 0 0 255 ECU_ADDRESS 0x0 /end MEASUREMENT
/begin MEASUREMENT Com_RxSigInfo[63].SignalProcessingOfRxSigInfo "" UBYTE Com_SignalProcessingOfRxSigInfoType 0 0 0 255 ECU_ADDRESS 0x0 /end MEASUREMENT
/begin MEASUREMENT Com_RxSigInfo[63].ValidDlcOfRxSigInfo "" UBYTE NO_COMPU_METHOD 0 0 0 255 ECU_ADDRESS 0x0 /end MEASUREMENT
/begin MEASUREMENT Com_RxSigInfo[64].RxAccessInfoIdxOfRxSigInfo "" UWORD NO_COMPU_METHOD 0 0 0 65535 ECU_ADDRESS 0x0 /end MEASUREMENT
/begin MEASUREMENT Com_RxSigInfo[64].RxCbkFuncPtrAckIdxOfRxSigInfo "" UBYTE Com_RxCbkFuncPtrAckIdxOfRxSigInfoType 0 0 0 255 ECU_ADDRESS 0x0 /end MEASUREMENT
/begin MEASUREMENT Com_RxSigInfo[64].SignalProcessingOfRxSigInfo "" UBYTE Com_SignalProcessingOfRxSigInfoType 0 0 0 255 ECU_ADDRESS 0x0 /end MEASUREMENT
/begin MEASUREMENT Com_RxSigInfo[64].ValidDlcOfRxSigInfo "" UBYTE NO_COMPU_METHOD 0 0 0 255 ECU_ADDRESS 0x0 /end MEASUREMENT
/begin MEASUREMENT Com_RxSigInfo[65].RxAccessInfoIdxOfRxSigInfo "" UWORD NO_COMPU_METHOD 0 0 0 65535 ECU_ADDRESS 0x0 /end MEASUREMENT
/begin MEASUREMENT Com_RxSigInfo[65].RxCbkFuncPtrAckIdxOfRxSigInfo "" UBYTE Com_RxCbkFuncPtrAckIdxOfRxSigInfoType 0 0 0 255 ECU_ADDRESS 0x0 /end MEASUREMENT
/begin MEASUREMENT Com_RxSigInfo[65].SignalProcessingOfRxSigInfo "" UBYTE Com_SignalProcessingOfRxSigInfoType 0 0 0 255 ECU_ADDRESS 0x0 /end MEASUREMENT
/begin MEASUREMENT Com_RxSigInfo[65].ValidDlcOfRxSigInfo "" UBYTE NO_COMPU_METHOD 0 0 0 255 ECU_ADDRESS 0x0 /end MEASUREMENT
/begin MEASUREMENT Com_RxSigInfo[66].RxAccessInfoIdxOfRxSigInfo "" UWORD NO_COMPU_METHOD 0 0 0 65535 ECU_ADDRESS 0x0 /end MEASUREMENT
/begin MEASUREMENT Com_RxSigInfo[66].RxCbkFuncPtrAckIdxOfRxSigInfo "" UBYTE Com_RxCbkFuncPtrAckIdxOfRxSigInfoType 0 0 0 255 ECU_ADDRESS 0x0 /end MEASUREMENT
/begin MEASUREMENT Com_RxSigInfo[66].SignalProcessingOfRxSigInfo "" UBYTE Com_SignalProcessingOfRxSigInfoType 0 0 0 255 ECU_ADDRESS 0x0 /end MEASUREMENT
/begin MEASUREMENT Com_RxSigInfo[66].ValidDlcOfRxSigInfo "" UBYTE NO_COMPU_METHOD 0 0 0 255 ECU_ADDRESS 0x0 /end MEASUREMENT
/begin MEASUREMENT Com_RxSigInfo[67].RxAccessInfoIdxOfRxSigInfo "" UWORD NO_COMPU_METHOD 0 0 0 65535 ECU_ADDRESS 0x0 /end MEASUREMENT
/begin MEASUREMENT Com_RxSigInfo[67].RxCbkFuncPtrAckIdxOfRxSigInfo "" UBYTE Com_RxCbkFuncPtrAckIdxOfRxSigInfoType 0 0 0 255 ECU_ADDRESS 0x0 /end MEASUREMENT
/begin MEASUREMENT Com_RxSigInfo[67].SignalProcessingOfRxSigInfo "" UBYTE Com_SignalProcessingOfRxSigInfoType 0 0 0 255 ECU_ADDRESS 0x0 /end MEASUREMENT
/begin MEASUREMENT Com_RxSigInfo[67].ValidDlcOfRxSigInfo "" UBYTE NO_COMPU_METHOD 0 0 0 255 ECU_ADDRESS 0x0 /end MEASUREMENT
/begin MEASUREMENT Com_RxSigInfo[68].RxAccessInfoIdxOfRxSigInfo "" UWORD NO_COMPU_METHOD 0 0 0 65535 ECU_ADDRESS 0x0 /end MEASUREMENT
/begin MEASUREMENT Com_RxSigInfo[68].RxCbkFuncPtrAckIdxOfRxSigInfo "" UBYTE Com_RxCbkFuncPtrAckIdxOfRxSigInfoType 0 0 0 255 ECU_ADDRESS 0x0 /end MEASUREMENT
/begin MEASUREMENT Com_RxSigInfo[68].SignalProcessingOfRxSigInfo "" UBYTE Com_SignalProcessingOfRxSigInfoType 0 0 0 255 ECU_ADDRESS 0x0 /end MEASUREMENT
/begin MEASUREMENT Com_RxSigInfo[68].ValidDlcOfRxSigInfo "" UBYTE NO_COMPU_METHOD 0 0 0 255 ECU_ADDRESS 0x0 /end MEASUREMENT
/begin MEASUREMENT Com_RxSigInfo[69].RxAccessInfoIdxOfRxSigInfo "" UWORD NO_COMPU_METHOD 0 0 0 65535 ECU_ADDRESS 0x0 /end MEASUREMENT
/begin MEASUREMENT Com_RxSigInfo[69].RxCbkFuncPtrAckIdxOfRxSigInfo "" UBYTE Com_RxCbkFuncPtrAckIdxOfRxSigInfoType 0 0 0 255 ECU_ADDRESS 0x0 /end MEASUREMENT
/begin MEASUREMENT Com_RxSigInfo[69].SignalProcessingOfRxSigInfo "" UBYTE Com_SignalProcessingOfRxSigInfoType 0 0 0 255 ECU_ADDRESS 0x0 /end MEASUREMENT
/begin MEASUREMENT Com_RxSigInfo[69].ValidDlcOfRxSigInfo "" UBYTE NO_COMPU_METHOD 0 0 0 255 ECU_ADDRESS 0x0 /end MEASUREMENT
/begin MEASUREMENT Com_RxSigInfo[6].RxAccessInfoIdxOfRxSigInfo "" UWORD NO_COMPU_METHOD 0 0 0 65535 ECU_ADDRESS 0x0 /end MEASUREMENT
/begin MEASUREMENT Com_RxSigInfo[6].RxCbkFuncPtrAckIdxOfRxSigInfo "" UBYTE Com_RxCbkFuncPtrAckIdxOfRxSigInfoType 0 0 0 255 ECU_ADDRESS 0x0 /end MEASUREMENT
/begin MEASUREMENT Com_RxSigInfo[6].SignalProcessingOfRxSigInfo "" UBYTE Com_SignalProcessingOfRxSigInfoType 0 0 0 255 ECU_ADDRESS 0x0 /end MEASUREMENT
/begin MEASUREMENT Com_RxSigInfo[6].ValidDlcOfRxSigInfo "" UBYTE NO_COMPU_METHOD 0 0 0 255 ECU_ADDRESS 0x0 /end MEASUREMENT
/begin MEASUREMENT Com_RxSigInfo[70].RxAccessInfoIdxOfRxSigInfo "" UWORD NO_COMPU_METHOD 0 0 0 65535 ECU_ADDRESS 0x0 /end MEASUREMENT
/begin MEASUREMENT Com_RxSigInfo[70].RxCbkFuncPtrAckIdxOfRxSigInfo "" UBYTE Com_RxCbkFuncPtrAckIdxOfRxSigInfoType 0 0 0 255 ECU_ADDRESS 0x0 /end MEASUREMENT
/begin MEASUREMENT Com_RxSigInfo[70].SignalProcessingOfRxSigInfo "" UBYTE Com_SignalProcessingOfRxSigInfoType 0 0 0 255 ECU_ADDRESS 0x0 /end MEASUREMENT
/begin MEASUREMENT Com_RxSigInfo[70].ValidDlcOfRxSigInfo "" UBYTE NO_COMPU_METHOD 0 0 0 255 ECU_ADDRESS 0x0 /end MEASUREMENT
/begin MEASUREMENT Com_RxSigInfo[71].RxAccessInfoIdxOfRxSigInfo "" UWORD NO_COMPU_METHOD 0 0 0 65535 ECU_ADDRESS 0x0 /end MEASUREMENT
/begin MEASUREMENT Com_RxSigInfo[71].RxCbkFuncPtrAckIdxOfRxSigInfo "" UBYTE Com_RxCbkFuncPtrAckIdxOfRxSigInfoType 0 0 0 255 ECU_ADDRESS 0x0 /end MEASUREMENT
/begin MEASUREMENT Com_RxSigInfo[71].SignalProcessingOfRxSigInfo "" UBYTE Com_SignalProcessingOfRxSigInfoType 0 0 0 255 ECU_ADDRESS 0x0 /end MEASUREMENT
/begin MEASUREMENT Com_RxSigInfo[71].ValidDlcOfRxSigInfo "" UBYTE NO_COMPU_METHOD 0 0 0 255 ECU_ADDRESS 0x0 /end MEASUREMENT
/begin MEASUREMENT Com_RxSigInfo[72].RxAccessInfoIdxOfRxSigInfo "" UWORD NO_COMPU_METHOD 0 0 0 65535 ECU_ADDRESS 0x0 /end MEASUREMENT
/begin MEASUREMENT Com_RxSigInfo[72].RxCbkFuncPtrAckIdxOfRxSigInfo "" UBYTE Com_RxCbkFuncPtrAckIdxOfRxSigInfoType 0 0 0 255 ECU_ADDRESS 0x0 /end MEASUREMENT
/begin MEASUREMENT Com_RxSigInfo[72].SignalProcessingOfRxSigInfo "" UBYTE Com_SignalProcessingOfRxSigInfoType 0 0 0 255 ECU_ADDRESS 0x0 /end MEASUREMENT
/begin MEASUREMENT Com_RxSigInfo[72].ValidDlcOfRxSigInfo "" UBYTE NO_COMPU_METHOD 0 0 0 255 ECU_ADDRESS 0x0 /end MEASUREMENT
/begin MEASUREMENT Com_RxSigInfo[73].RxAccessInfoIdxOfRxSigInfo "" UWORD NO_COMPU_METHOD 0 0 0 65535 ECU_ADDRESS 0x0 /end MEASUREMENT
/begin MEASUREMENT Com_RxSigInfo[73].RxCbkFuncPtrAckIdxOfRxSigInfo "" UBYTE Com_RxCbkFuncPtrAckIdxOfRxSigInfoType 0 0 0 255 ECU_ADDRESS 0x0 /end MEASUREMENT
/begin MEASUREMENT Com_RxSigInfo[73].SignalProcessingOfRxSigInfo "" UBYTE Com_SignalProcessingOfRxSigInfoType 0 0 0 255 ECU_ADDRESS 0x0 /end MEASUREMENT
/begin MEASUREMENT Com_RxSigInfo[73].ValidDlcOfRxSigInfo "" UBYTE NO_COMPU_METHOD 0 0 0 255 ECU_ADDRESS 0x0 /end MEASUREMENT
/begin MEASUREMENT Com_RxSigInfo[74].RxAccessInfoIdxOfRxSigInfo "" UWORD NO_COMPU_METHOD 0 0 0 65535 ECU_ADDRESS 0x0 /end MEASUREMENT
/begin MEASUREMENT Com_RxSigInfo[74].RxCbkFuncPtrAckIdxOfRxSigInfo "" UBYTE Com_RxCbkFuncPtrAckIdxOfRxSigInfoType 0 0 0 255 ECU_ADDRESS 0x0 /end MEASUREMENT
/begin MEASUREMENT Com_RxSigInfo[74].SignalProcessingOfRxSigInfo "" UBYTE Com_SignalProcessingOfRxSigInfoType 0 0 0 255 ECU_ADDRESS 0x0 /end MEASUREMENT
/begin MEASUREMENT Com_RxSigInfo[74].ValidDlcOfRxSigInfo "" UBYTE NO_COMPU_METHOD 0 0 0 255 ECU_ADDRESS 0x0 /end MEASUREMENT
/begin MEASUREMENT Com_RxSigInfo[75].RxAccessInfoIdxOfRxSigInfo "" UWORD NO_COMPU_METHOD 0 0 0 65535 ECU_ADDRESS 0x0 /end MEASUREMENT
/begin MEASUREMENT Com_RxSigInfo[75].RxCbkFuncPtrAckIdxOfRxSigInfo "" UBYTE Com_RxCbkFuncPtrAckIdxOfRxSigInfoType 0 0 0 255 ECU_ADDRESS 0x0 /end MEASUREMENT
/begin MEASUREMENT Com_RxSigInfo[75].SignalProcessingOfRxSigInfo "" UBYTE Com_SignalProcessingOfRxSigInfoType 0 0 0 255 ECU_ADDRESS 0x0 /end MEASUREMENT
/begin MEASUREMENT Com_RxSigInfo[75].ValidDlcOfRxSigInfo "" UBYTE NO_COMPU_METHOD 0 0 0 255 ECU_ADDRESS 0x0 /end MEASUREMENT
/begin MEASUREMENT Com_RxSigInfo[76].RxAccessInfoIdxOfRxSigInfo "" UWORD NO_COMPU_METHOD 0 0 0 65535 ECU_ADDRESS 0x0 /end MEASUREMENT
/begin MEASUREMENT Com_RxSigInfo[76].RxCbkFuncPtrAckIdxOfRxSigInfo "" UBYTE Com_RxCbkFuncPtrAckIdxOfRxSigInfoType 0 0 0 255 ECU_ADDRESS 0x0 /end MEASUREMENT
/begin MEASUREMENT Com_RxSigInfo[76].SignalProcessingOfRxSigInfo "" UBYTE Com_SignalProcessingOfRxSigInfoType 0 0 0 255 ECU_ADDRESS 0x0 /end MEASUREMENT
/begin MEASUREMENT Com_RxSigInfo[76].ValidDlcOfRxSigInfo "" UBYTE NO_COMPU_METHOD 0 0 0 255 ECU_ADDRESS 0x0 /end MEASUREMENT
/begin MEASUREMENT Com_RxSigInfo[77].RxAccessInfoIdxOfRxSigInfo "" UWORD NO_COMPU_METHOD 0 0 0 65535 ECU_ADDRESS 0x0 /end MEASUREMENT
/begin MEASUREMENT Com_RxSigInfo[77].RxCbkFuncPtrAckIdxOfRxSigInfo "" UBYTE Com_RxCbkFuncPtrAckIdxOfRxSigInfoType 0 0 0 255 ECU_ADDRESS 0x0 /end MEASUREMENT
/begin MEASUREMENT Com_RxSigInfo[77].SignalProcessingOfRxSigInfo "" UBYTE Com_SignalProcessingOfRxSigInfoType 0 0 0 255 ECU_ADDRESS 0x0 /end MEASUREMENT
/begin MEASUREMENT Com_RxSigInfo[77].ValidDlcOfRxSigInfo "" UBYTE NO_COMPU_METHOD 0 0 0 255 ECU_ADDRESS 0x0 /end MEASUREMENT
/begin MEASUREMENT Com_RxSigInfo[78].RxAccessInfoIdxOfRxSigInfo "" UWORD NO_COMPU_METHOD 0 0 0 65535 ECU_ADDRESS 0x0 /end MEASUREMENT
/begin MEASUREMENT Com_RxSigInfo[78].RxCbkFuncPtrAckIdxOfRxSigInfo "" UBYTE Com_RxCbkFuncPtrAckIdxOfRxSigInfoType 0 0 0 255 ECU_ADDRESS 0x0 /end MEASUREMENT
/begin MEASUREMENT Com_RxSigInfo[78].SignalProcessingOfRxSigInfo "" UBYTE Com_SignalProcessingOfRxSigInfoType 0 0 0 255 ECU_ADDRESS 0x0 /end MEASUREMENT
/begin MEASUREMENT Com_RxSigInfo[78].ValidDlcOfRxSigInfo "" UBYTE NO_COMPU_METHOD 0 0 0 255 ECU_ADDRESS 0x0 /end MEASUREMENT
/begin MEASUREMENT Com_RxSigInfo[79].RxAccessInfoIdxOfRxSigInfo "" UWORD NO_COMPU_METHOD 0 0 0 65535 ECU_ADDRESS 0x0 /end MEASUREMENT
/begin MEASUREMENT Com_RxSigInfo[79].RxCbkFuncPtrAckIdxOfRxSigInfo "" UBYTE Com_RxCbkFuncPtrAckIdxOfRxSigInfoType 0 0 0 255 ECU_ADDRESS 0x0 /end MEASUREMENT
/begin MEASUREMENT Com_RxSigInfo[79].SignalProcessingOfRxSigInfo "" UBYTE Com_SignalProcessingOfRxSigInfoType 0 0 0 255 ECU_ADDRESS 0x0 /end MEASUREMENT
/begin MEASUREMENT Com_RxSigInfo[79].ValidDlcOfRxSigInfo "" UBYTE NO_COMPU_METHOD 0 0 0 255 ECU_ADDRESS 0x0 /end MEASUREMENT
/begin MEASUREMENT Com_RxSigInfo[7].RxAccessInfoIdxOfRxSigInfo "" UWORD NO_COMPU_METHOD 0 0 0 65535 ECU_ADDRESS 0x0 /end MEASUREMENT
/begin MEASUREMENT Com_RxSigInfo[7].RxCbkFuncPtrAckIdxOfRxSigInfo "" UBYTE Com_RxCbkFuncPtrAckIdxOfRxSigInfoType 0 0 0 255 ECU_ADDRESS 0x0 /end MEASUREMENT
/begin MEASUREMENT Com_RxSigInfo[7].SignalProcessingOfRxSigInfo "" UBYTE Com_SignalProcessingOfRxSigInfoType 0 0 0 255 ECU_ADDRESS 0x0 /end MEASUREMENT
/begin MEASUREMENT Com_RxSigInfo[7].ValidDlcOfRxSigInfo "" UBYTE NO_COMPU_METHOD 0 0 0 255 ECU_ADDRESS 0x0 /end MEASUREMENT
/begin MEASUREMENT Com_RxSigInfo[80].RxAccessInfoIdxOfRxSigInfo "" UWORD NO_COMPU_METHOD 0 0 0 65535 ECU_ADDRESS 0x0 /end MEASUREMENT
/begin MEASUREMENT Com_RxSigInfo[80].RxCbkFuncPtrAckIdxOfRxSigInfo "" UBYTE Com_RxCbkFuncPtrAckIdxOfRxSigInfoType 0 0 0 255 ECU_ADDRESS 0x0 /end MEASUREMENT
/begin MEASUREMENT Com_RxSigInfo[80].SignalProcessingOfRxSigInfo "" UBYTE Com_SignalProcessingOfRxSigInfoType 0 0 0 255 ECU_ADDRESS 0x0 /end MEASUREMENT
/begin MEASUREMENT Com_RxSigInfo[80].ValidDlcOfRxSigInfo "" UBYTE NO_COMPU_METHOD 0 0 0 255 ECU_ADDRESS 0x0 /end MEASUREMENT
/begin MEASUREMENT Com_RxSigInfo[81].RxAccessInfoIdxOfRxSigInfo "" UWORD NO_COMPU_METHOD 0 0 0 65535 ECU_ADDRESS 0x0 /end MEASUREMENT
/begin MEASUREMENT Com_RxSigInfo[81].RxCbkFuncPtrAckIdxOfRxSigInfo "" UBYTE Com_RxCbkFuncPtrAckIdxOfRxSigInfoType 0 0 0 255 ECU_ADDRESS 0x0 /end MEASUREMENT
/begin MEASUREMENT Com_RxSigInfo[81].SignalProcessingOfRxSigInfo "" UBYTE Com_SignalProcessingOfRxSigInfoType 0 0 0 255 ECU_ADDRESS 0x0 /end MEASUREMENT
/begin MEASUREMENT Com_RxSigInfo[81].ValidDlcOfRxSigInfo "" UBYTE NO_COMPU_METHOD 0 0 0 255 ECU_ADDRESS 0x0 /end MEASUREMENT
/begin MEASUREMENT Com_RxSigInfo[82].RxAccessInfoIdxOfRxSigInfo "" UWORD NO_COMPU_METHOD 0 0 0 65535 ECU_ADDRESS 0x0 /end MEASUREMENT
/begin MEASUREMENT Com_RxSigInfo[82].RxCbkFuncPtrAckIdxOfRxSigInfo "" UBYTE Com_RxCbkFuncPtrAckIdxOfRxSigInfoType 0 0 0 255 ECU_ADDRESS 0x0 /end MEASUREMENT
/begin MEASUREMENT Com_RxSigInfo[82].SignalProcessingOfRxSigInfo "" UBYTE Com_SignalProcessingOfRxSigInfoType 0 0 0 255 ECU_ADDRESS 0x0 /end MEASUREMENT
/begin MEASUREMENT Com_RxSigInfo[82].ValidDlcOfRxSigInfo "" UBYTE NO_COMPU_METHOD 0 0 0 255 ECU_ADDRESS 0x0 /end MEASUREMENT
/begin MEASUREMENT Com_RxSigInfo[83].RxAccessInfoIdxOfRxSigInfo "" UWORD NO_COMPU_METHOD 0 0 0 65535 ECU_ADDRESS 0x0 /end MEASUREMENT
/begin MEASUREMENT Com_RxSigInfo[83].RxCbkFuncPtrAckIdxOfRxSigInfo "" UBYTE Com_RxCbkFuncPtrAckIdxOfRxSigInfoType 0 0 0 255 ECU_ADDRESS 0x0 /end MEASUREMENT
/begin MEASUREMENT Com_RxSigInfo[83].SignalProcessingOfRxSigInfo "" UBYTE Com_SignalProcessingOfRxSigInfoType 0 0 0 255 ECU_ADDRESS 0x0 /end MEASUREMENT
/begin MEASUREMENT Com_RxSigInfo[83].ValidDlcOfRxSigInfo "" UBYTE NO_COMPU_METHOD 0 0 0 255 ECU_ADDRESS 0x0 /end MEASUREMENT
/begin MEASUREMENT Com_RxSigInfo[84].RxAccessInfoIdxOfRxSigInfo "" UWORD NO_COMPU_METHOD 0 0 0 65535 ECU_ADDRESS 0x0 /end MEASUREMENT
/begin MEASUREMENT Com_RxSigInfo[84].RxCbkFuncPtrAckIdxOfRxSigInfo "" UBYTE Com_RxCbkFuncPtrAckIdxOfRxSigInfoType 0 0 0 255 ECU_ADDRESS 0x0 /end MEASUREMENT
/begin MEASUREMENT Com_RxSigInfo[84].SignalProcessingOfRxSigInfo "" UBYTE Com_SignalProcessingOfRxSigInfoType 0 0 0 255 ECU_ADDRESS 0x0 /end MEASUREMENT
/begin MEASUREMENT Com_RxSigInfo[84].ValidDlcOfRxSigInfo "" UBYTE NO_COMPU_METHOD 0 0 0 255 ECU_ADDRESS 0x0 /end MEASUREMENT
/begin MEASUREMENT Com_RxSigInfo[85].RxAccessInfoIdxOfRxSigInfo "" UWORD NO_COMPU_METHOD 0 0 0 65535 ECU_ADDRESS 0x0 /end MEASUREMENT
/begin MEASUREMENT Com_RxSigInfo[85].RxCbkFuncPtrAckIdxOfRxSigInfo "" UBYTE Com_RxCbkFuncPtrAckIdxOfRxSigInfoType 0 0 0 255 ECU_ADDRESS 0x0 /end MEASUREMENT
/begin MEASUREMENT Com_RxSigInfo[85].SignalProcessingOfRxSigInfo "" UBYTE Com_SignalProcessingOfRxSigInfoType 0 0 0 255 ECU_ADDRESS 0x0 /end MEASUREMENT
/begin MEASUREMENT Com_RxSigInfo[85].ValidDlcOfRxSigInfo "" UBYTE NO_COMPU_METHOD 0 0 0 255 ECU_ADDRESS 0x0 /end MEASUREMENT
/begin MEASUREMENT Com_RxSigInfo[86].RxAccessInfoIdxOfRxSigInfo "" UWORD NO_COMPU_METHOD 0 0 0 65535 ECU_ADDRESS 0x0 /end MEASUREMENT
/begin MEASUREMENT Com_RxSigInfo[86].RxCbkFuncPtrAckIdxOfRxSigInfo "" UBYTE Com_RxCbkFuncPtrAckIdxOfRxSigInfoType 0 0 0 255 ECU_ADDRESS 0x0 /end MEASUREMENT
/begin MEASUREMENT Com_RxSigInfo[86].SignalProcessingOfRxSigInfo "" UBYTE Com_SignalProcessingOfRxSigInfoType 0 0 0 255 ECU_ADDRESS 0x0 /end MEASUREMENT
/begin MEASUREMENT Com_RxSigInfo[86].ValidDlcOfRxSigInfo "" UBYTE NO_COMPU_METHOD 0 0 0 255 ECU_ADDRESS 0x0 /end MEASUREMENT
/begin MEASUREMENT Com_RxSigInfo[87].RxAccessInfoIdxOfRxSigInfo "" UWORD NO_COMPU_METHOD 0 0 0 65535 ECU_ADDRESS 0x0 /end MEASUREMENT
/begin MEASUREMENT Com_RxSigInfo[87].RxCbkFuncPtrAckIdxOfRxSigInfo "" UBYTE Com_RxCbkFuncPtrAckIdxOfRxSigInfoType 0 0 0 255 ECU_ADDRESS 0x0 /end MEASUREMENT
/begin MEASUREMENT Com_RxSigInfo[87].SignalProcessingOfRxSigInfo "" UBYTE Com_SignalProcessingOfRxSigInfoType 0 0 0 255 ECU_ADDRESS 0x0 /end MEASUREMENT
/begin MEASUREMENT Com_RxSigInfo[87].ValidDlcOfRxSigInfo "" UBYTE NO_COMPU_METHOD 0 0 0 255 ECU_ADDRESS 0x0 /end MEASUREMENT
/begin MEASUREMENT Com_RxSigInfo[88].RxAccessInfoIdxOfRxSigInfo "" UWORD NO_COMPU_METHOD 0 0 0 65535 ECU_ADDRESS 0x0 /end MEASUREMENT
/begin MEASUREMENT Com_RxSigInfo[88].RxCbkFuncPtrAckIdxOfRxSigInfo "" UBYTE Com_RxCbkFuncPtrAckIdxOfRxSigInfoType 0 0 0 255 ECU_ADDRESS 0x0 /end MEASUREMENT
/begin MEASUREMENT Com_RxSigInfo[88].SignalProcessingOfRxSigInfo "" UBYTE Com_SignalProcessingOfRxSigInfoType 0 0 0 255 ECU_ADDRESS 0x0 /end MEASUREMENT
/begin MEASUREMENT Com_RxSigInfo[88].ValidDlcOfRxSigInfo "" UBYTE NO_COMPU_METHOD 0 0 0 255 ECU_ADDRESS 0x0 /end MEASUREMENT
/begin MEASUREMENT Com_RxSigInfo[89].RxAccessInfoIdxOfRxSigInfo "" UWORD NO_COMPU_METHOD 0 0 0 65535 ECU_ADDRESS 0x0 /end MEASUREMENT
/begin MEASUREMENT Com_RxSigInfo[89].RxCbkFuncPtrAckIdxOfRxSigInfo "" UBYTE Com_RxCbkFuncPtrAckIdxOfRxSigInfoType 0 0 0 255 ECU_ADDRESS 0x0 /end MEASUREMENT
/begin MEASUREMENT Com_RxSigInfo[89].SignalProcessingOfRxSigInfo "" UBYTE Com_SignalProcessingOfRxSigInfoType 0 0 0 255 ECU_ADDRESS 0x0 /end MEASUREMENT
/begin MEASUREMENT Com_RxSigInfo[89].ValidDlcOfRxSigInfo "" UBYTE NO_COMPU_METHOD 0 0 0 255 ECU_ADDRESS 0x0 /end MEASUREMENT
/begin MEASUREMENT Com_RxSigInfo[8].RxAccessInfoIdxOfRxSigInfo "" UWORD NO_COMPU_METHOD 0 0 0 65535 ECU_ADDRESS 0x0 /end MEASUREMENT
/begin MEASUREMENT Com_RxSigInfo[8].RxCbkFuncPtrAckIdxOfRxSigInfo "" UBYTE Com_RxCbkFuncPtrAckIdxOfRxSigInfoType 0 0 0 255 ECU_ADDRESS 0x0 /end MEASUREMENT
/begin MEASUREMENT Com_RxSigInfo[8].SignalProcessingOfRxSigInfo "" UBYTE Com_SignalProcessingOfRxSigInfoType 0 0 0 255 ECU_ADDRESS 0x0 /end MEASUREMENT
/begin MEASUREMENT Com_RxSigInfo[8].ValidDlcOfRxSigInfo "" UBYTE NO_COMPU_METHOD 0 0 0 255 ECU_ADDRESS 0x0 /end MEASUREMENT
/begin MEASUREMENT Com_RxSigInfo[90].RxAccessInfoIdxOfRxSigInfo "" UWORD NO_COMPU_METHOD 0 0 0 65535 ECU_ADDRESS 0x0 /end MEASUREMENT
/begin MEASUREMENT Com_RxSigInfo[90].RxCbkFuncPtrAckIdxOfRxSigInfo "" UBYTE Com_RxCbkFuncPtrAckIdxOfRxSigInfoType 0 0 0 255 ECU_ADDRESS 0x0 /end MEASUREMENT
/begin MEASUREMENT Com_RxSigInfo[90].SignalProcessingOfRxSigInfo "" UBYTE Com_SignalProcessingOfRxSigInfoType 0 0 0 255 ECU_ADDRESS 0x0 /end MEASUREMENT
/begin MEASUREMENT Com_RxSigInfo[90].ValidDlcOfRxSigInfo "" UBYTE NO_COMPU_METHOD 0 0 0 255 ECU_ADDRESS 0x0 /end MEASUREMENT
/begin MEASUREMENT Com_RxSigInfo[91].RxAccessInfoIdxOfRxSigInfo "" UWORD NO_COMPU_METHOD 0 0 0 65535 ECU_ADDRESS 0x0 /end MEASUREMENT
/begin MEASUREMENT Com_RxSigInfo[91].RxCbkFuncPtrAckIdxOfRxSigInfo "" UBYTE Com_RxCbkFuncPtrAckIdxOfRxSigInfoType 0 0 0 255 ECU_ADDRESS 0x0 /end MEASUREMENT
/begin MEASUREMENT Com_RxSigInfo[91].SignalProcessingOfRxSigInfo "" UBYTE Com_SignalProcessingOfRxSigInfoType 0 0 0 255 ECU_ADDRESS 0x0 /end MEASUREMENT
/begin MEASUREMENT Com_RxSigInfo[91].ValidDlcOfRxSigInfo "" UBYTE NO_COMPU_METHOD 0 0 0 255 ECU_ADDRESS 0x0 /end MEASUREMENT
/begin MEASUREMENT Com_RxSigInfo[92].RxAccessInfoIdxOfRxSigInfo "" UWORD NO_COMPU_METHOD 0 0 0 65535 ECU_ADDRESS 0x0 /end MEASUREMENT
/begin MEASUREMENT Com_RxSigInfo[92].RxCbkFuncPtrAckIdxOfRxSigInfo "" UBYTE Com_RxCbkFuncPtrAckIdxOfRxSigInfoType 0 0 0 255 ECU_ADDRESS 0x0 /end MEASUREMENT
/begin MEASUREMENT Com_RxSigInfo[92].SignalProcessingOfRxSigInfo "" UBYTE Com_SignalProcessingOfRxSigInfoType 0 0 0 255 ECU_ADDRESS 0x0 /end MEASUREMENT
/begin MEASUREMENT Com_RxSigInfo[92].ValidDlcOfRxSigInfo "" UBYTE NO_COMPU_METHOD 0 0 0 255 ECU_ADDRESS 0x0 /end MEASUREMENT
/begin MEASUREMENT Com_RxSigInfo[93].RxAccessInfoIdxOfRxSigInfo "" UWORD NO_COMPU_METHOD 0 0 0 65535 ECU_ADDRESS 0x0 /end MEASUREMENT
/begin MEASUREMENT Com_RxSigInfo[93].RxCbkFuncPtrAckIdxOfRxSigInfo "" UBYTE Com_RxCbkFuncPtrAckIdxOfRxSigInfoType 0 0 0 255 ECU_ADDRESS 0x0 /end MEASUREMENT
/begin MEASUREMENT Com_RxSigInfo[93].SignalProcessingOfRxSigInfo "" UBYTE Com_SignalProcessingOfRxSigInfoType 0 0 0 255 ECU_ADDRESS 0x0 /end MEASUREMENT
/begin MEASUREMENT Com_RxSigInfo[93].ValidDlcOfRxSigInfo "" UBYTE NO_COMPU_METHOD 0 0 0 255 ECU_ADDRESS 0x0 /end MEASUREMENT
/begin MEASUREMENT Com_RxSigInfo[94].RxAccessInfoIdxOfRxSigInfo "" UWORD NO_COMPU_METHOD 0 0 0 65535 ECU_ADDRESS 0x0 /end MEASUREMENT
/begin MEASUREMENT Com_RxSigInfo[94].RxCbkFuncPtrAckIdxOfRxSigInfo "" UBYTE Com_RxCbkFuncPtrAckIdxOfRxSigInfoType 0 0 0 255 ECU_ADDRESS 0x0 /end MEASUREMENT
/begin MEASUREMENT Com_RxSigInfo[94].SignalProcessingOfRxSigInfo "" UBYTE Com_SignalProcessingOfRxSigInfoType 0 0 0 255 ECU_ADDRESS 0x0 /end MEASUREMENT
/begin MEASUREMENT Com_RxSigInfo[94].ValidDlcOfRxSigInfo "" UBYTE NO_COMPU_METHOD 0 0 0 255 ECU_ADDRESS 0x0 /end MEASUREMENT
/begin MEASUREMENT Com_RxSigInfo[95].RxAccessInfoIdxOfRxSigInfo "" UWORD NO_COMPU_METHOD 0 0 0 65535 ECU_ADDRESS 0x0 /end MEASUREMENT
/begin MEASUREMENT Com_RxSigInfo[95].RxCbkFuncPtrAckIdxOfRxSigInfo "" UBYTE Com_RxCbkFuncPtrAckIdxOfRxSigInfoType 0 0 0 255 ECU_ADDRESS 0x0 /end MEASUREMENT
/begin MEASUREMENT Com_RxSigInfo[95].SignalProcessingOfRxSigInfo "" UBYTE Com_SignalProcessingOfRxSigInfoType 0 0 0 255 ECU_ADDRESS 0x0 /end MEASUREMENT
/begin MEASUREMENT Com_RxSigInfo[95].ValidDlcOfRxSigInfo "" UBYTE NO_COMPU_METHOD 0 0 0 255 ECU_ADDRESS 0x0 /end MEASUREMENT
/begin MEASUREMENT Com_RxSigInfo[96].RxAccessInfoIdxOfRxSigInfo "" UWORD NO_COMPU_METHOD 0 0 0 65535 ECU_ADDRESS 0x0 /end MEASUREMENT
/begin MEASUREMENT Com_RxSigInfo[96].RxCbkFuncPtrAckIdxOfRxSigInfo "" UBYTE Com_RxCbkFuncPtrAckIdxOfRxSigInfoType 0 0 0 255 ECU_ADDRESS 0x0 /end MEASUREMENT
/begin MEASUREMENT Com_RxSigInfo[96].SignalProcessingOfRxSigInfo "" UBYTE Com_SignalProcessingOfRxSigInfoType 0 0 0 255 ECU_ADDRESS 0x0 /end MEASUREMENT
/begin MEASUREMENT Com_RxSigInfo[96].ValidDlcOfRxSigInfo "" UBYTE NO_COMPU_METHOD 0 0 0 255 ECU_ADDRESS 0x0 /end MEASUREMENT
/begin MEASUREMENT Com_RxSigInfo[97].RxAccessInfoIdxOfRxSigInfo "" UWORD NO_COMPU_METHOD 0 0 0 65535 ECU_ADDRESS 0x0 /end MEASUREMENT
/begin MEASUREMENT Com_RxSigInfo[97].RxCbkFuncPtrAckIdxOfRxSigInfo "" UBYTE Com_RxCbkFuncPtrAckIdxOfRxSigInfoType 0 0 0 255 ECU_ADDRESS 0x0 /end MEASUREMENT
/begin MEASUREMENT Com_RxSigInfo[97].SignalProcessingOfRxSigInfo "" UBYTE Com_SignalProcessingOfRxSigInfoType 0 0 0 255 ECU_ADDRESS 0x0 /end MEASUREMENT
/begin MEASUREMENT Com_RxSigInfo[97].ValidDlcOfRxSigInfo "" UBYTE NO_COMPU_METHOD 0 0 0 255 ECU_ADDRESS 0x0 /end MEASUREMENT
/begin MEASUREMENT Com_RxSigInfo[98].RxAccessInfoIdxOfRxSigInfo "" UWORD NO_COMPU_METHOD 0 0 0 65535 ECU_ADDRESS 0x0 /end MEASUREMENT
/begin MEASUREMENT Com_RxSigInfo[98].RxCbkFuncPtrAckIdxOfRxSigInfo "" UBYTE Com_RxCbkFuncPtrAckIdxOfRxSigInfoType 0 0 0 255 ECU_ADDRESS 0x0 /end MEASUREMENT
/begin MEASUREMENT Com_RxSigInfo[98].SignalProcessingOfRxSigInfo "" UBYTE Com_SignalProcessingOfRxSigInfoType 0 0 0 255 ECU_ADDRESS 0x0 /end MEASUREMENT
/begin MEASUREMENT Com_RxSigInfo[98].ValidDlcOfRxSigInfo "" UBYTE NO_COMPU_METHOD 0 0 0 255 ECU_ADDRESS 0x0 /end MEASUREMENT
/begin MEASUREMENT Com_RxSigInfo[99].RxAccessInfoIdxOfRxSigInfo "" UWORD NO_COMPU_METHOD 0 0 0 65535 ECU_ADDRESS 0x0 /end MEASUREMENT
/begin MEASUREMENT Com_RxSigInfo[99].RxCbkFuncPtrAckIdxOfRxSigInfo "" UBYTE Com_RxCbkFuncPtrAckIdxOfRxSigInfoType 0 0 0 255 ECU_ADDRESS 0x0 /end MEASUREMENT
/begin MEASUREMENT Com_RxSigInfo[99].SignalProcessingOfRxSigInfo "" UBYTE Com_SignalProcessingOfRxSigInfoType 0 0 0 255 ECU_ADDRESS 0x0 /end MEASUREMENT
/begin MEASUREMENT Com_RxSigInfo[99].ValidDlcOfRxSigInfo "" UBYTE NO_COMPU_METHOD 0 0 0 255 ECU_ADDRESS 0x0 /end MEASUREMENT
/begin MEASUREMENT Com_RxSigInfo[9].RxAccessInfoIdxOfRxSigInfo "" UWORD NO_COMPU_METHOD 0 0 0 65535 ECU_ADDRESS 0x0 /end MEASUREMENT
/begin MEASUREMENT Com_RxSigInfo[9].RxCbkFuncPtrAckIdxOfRxSigInfo "" UBYTE Com_RxCbkFuncPtrAckIdxOfRxSigInfoType 0 0 0 255 ECU_ADDRESS 0x0 /end MEASUREMENT
/begin MEASUREMENT Com_RxSigInfo[9].SignalProcessingOfRxSigInfo "" UBYTE Com_SignalProcessingOfRxSigInfoType 0 0 0 255 ECU_ADDRESS 0x0 /end MEASUREMENT
/begin MEASUREMENT Com_RxSigInfo[9].ValidDlcOfRxSigInfo "" UBYTE NO_COMPU_METHOD 0 0 0 255 ECU_ADDRESS 0x0 /end MEASUREMENT
/begin MEASUREMENT Com_RxTOutCnt "This array holds timeout counters for all Rx timeout objects." UBYTE NO_COMPU_METHOD 0 0 0 255 ECU_ADDRESS 0x0 /end MEASUREMENT
/begin MEASUREMENT Com_RxTOutInfo[0].CbkRxTOutFuncPtrIndStartIdxOfRxTOutInfo "" UBYTE Com_CbkRxTOutFuncPtrIndStartIdxOfRxTOutInfoType 0 0 0 255 ECU_ADDRESS 0x0 /end MEASUREMENT
/begin MEASUREMENT Com_RxTOutInfo[0].RxAccessInfoReplaceGrpSigIndStartIdxOfRxTOutInfo "" UBYTE Com_RxAccessInfoReplaceGrpSigIndStartIdxOfRxTOutInfoType 0 0 0 255 ECU_ADDRESS 0x0 /end MEASUREMENT
/begin MEASUREMENT Com_SigGrpEventFlag "Flag is set if a group signal write access caused a triggered event." UBYTE NO_COMPU_METHOD 0 0 0 255 ECU_ADDRESS 0x0 MATRIX_DIM 10 /end MEASUREMENT
/begin MEASUREMENT Com_TmpRxBuffer "Temporary buffer for Rx UINT8_N and UINT8_DYN signals." UBYTE NO_COMPU_METHOD 0 0 0 255 ECU_ADDRESS 0x0 MATRIX_DIM 64 /end MEASUREMENT
/begin MEASUREMENT Com_TmpRxShdBufferArrayBased "Temporary Rx Group Signal Shadow Buffer. (UINT8_N, UINT8_DYN)" UBYTE NO_COMPU_METHOD 0 0 0 255 ECU_ADDRESS 0x0 MATRIX_DIM 8 /end MEASUREMENT
/begin MEASUREMENT Com_TmpRxShdBufferUInt16 "Temporary Rx Group Signal Shadow Buffer. (UINT16)" UWORD NO_COMPU_METHOD 0 0 0 65535 ECU_ADDRESS 0x0 MATRIX_DIM 4 /end MEASUREMENT
/begin MEASUREMENT Com_TmpRxShdBufferUInt32 "Temporary Rx Group Signal Shadow Buffer. (UINT32)" ULONG NO_COMPU_METHOD 0 0 0 4294967295 ECU_ADDRESS 0x0 /end MEASUREMENT
/begin MEASUREMENT Com_TmpRxShdBufferUInt8 "Temporary Rx Group Signal Shadow Buffer. (BOOLEAN, UINT8)" UBYTE NO_COMPU_METHOD 0 0 0 255 ECU_ADDRESS 0x0 MATRIX_DIM 23 /end MEASUREMENT
/begin MEASUREMENT Com_TransmitRequest "Transmit request flag used for decoupled Tx I-PDU tranmission." UBYTE Com_TransmitRequestType 0 0 0 1 ECU_ADDRESS 0x0 MATRIX_DIM 32 SYMBOL_LINK "Com_TransmitRequest.raw" 0 /end MEASUREMENT
/begin MEASUREMENT Com_TransmitRequest_BMC_CMC_Temperatur_01_XIX_HCP5_CANFD01_13d55235_Tx "The element: BMC_CMC_Temperatur_01_XIX_HCP5_CANFD01_13d55235_Tx of Com_TransmitRequest" UBYTE Com_TransmitRequestType 0 0 0 1 ECU_ADDRESS 0x0 SYMBOL_LINK "Com_TransmitRequest.raw[0]" 0 /end MEASUREMENT
/begin MEASUREMENT Com_TransmitRequest_BMC_CMC_Temperatur_02_XIX_HCP5_CANFD01_f9538f57_Tx "The element: BMC_CMC_Temperatur_02_XIX_HCP5_CANFD01_f9538f57_Tx of Com_TransmitRequest" UBYTE Com_TransmitRequestType 0 0 0 1 ECU_ADDRESS 0x0 SYMBOL_LINK "Com_TransmitRequest.raw[1]" 0 /end MEASUREMENT
/begin MEASUREMENT Com_TransmitRequest_BMC_CMC_Temperatur_03_XIX_HCP5_CANFD01_160139b6_Tx "The element: BMC_CMC_Temperatur_03_XIX_HCP5_CANFD01_160139b6_Tx of Com_TransmitRequest" UBYTE Com_TransmitRequestType 0 0 0 1 ECU_ADDRESS 0x0 SYMBOL_LINK "Com_TransmitRequest.raw[2]" 0 /end MEASUREMENT
/begin MEASUREMENT Com_TransmitRequest_BMC_CMC_Zellspannung_01_XIX_HCP5_CANFD01_f76fbfe9_Tx "The element: BMC_CMC_Zellspannung_01_XIX_HCP5_CANFD01_f76fbfe9_Tx of Com_TransmitRequest" UBYTE Com_TransmitRequestType 0 0 0 1 ECU_ADDRESS 0x0 SYMBOL_LINK "Com_TransmitRequest.raw[3]" 0 /end MEASUREMENT
/begin MEASUREMENT Com_TransmitRequest_BMC_CMC_Zellspannung_02_XIX_HCP5_CANFD01_1de9628b_Tx "The element: BMC_CMC_Zellspannung_02_XIX_HCP5_CANFD01_1de9628b_Tx of Com_TransmitRequest" UBYTE Com_TransmitRequestType 0 0 0 1 ECU_ADDRESS 0x0 SYMBOL_LINK "Com_TransmitRequest.raw[4]" 0 /end MEASUREMENT
/begin MEASUREMENT Com_TransmitRequest_BMC_CMC_Zellspannung_03_XIX_HCP5_CANFD01_f2bbd46a_Tx "The element: BMC_CMC_Zellspannung_03_XIX_HCP5_CANFD01_f2bbd46a_Tx of Com_TransmitRequest" UBYTE Com_TransmitRequestType 0 0 0 1 ECU_ADDRESS 0x0 SYMBOL_LINK "Com_TransmitRequest.raw[5]" 0 /end MEASUREMENT
/begin MEASUREMENT Com_TransmitRequest_BMC_CMC_Zellspannung_04_XIX_HCP5_CANFD01_1395de0e_Tx "The element: BMC_CMC_Zellspannung_04_XIX_HCP5_CANFD01_1395de0e_Tx of Com_TransmitRequest" UBYTE Com_TransmitRequestType 0 0 0 1 ECU_ADDRESS 0x0 SYMBOL_LINK "Com_TransmitRequest.raw[6]" 0 /end MEASUREMENT
/begin MEASUREMENT Com_TransmitRequest_BMC_CMC_Zellspannung_05_XIX_HCP5_CANFD01_fcc768ef_Tx "The element: BMC_CMC_Zellspannung_05_XIX_HCP5_CANFD01_fcc768ef_Tx of Com_TransmitRequest" UBYTE Com_TransmitRequestType 0 0 0 1 ECU_ADDRESS 0x0 SYMBOL_LINK "Com_TransmitRequest.raw[7]" 0 /end MEASUREMENT
/begin MEASUREMENT Com_TransmitRequest_BMC_HV_01_XIX_HCP5_CANFD01_E2E_fcbbcae3_Tx "The element: BMC_HV_01_XIX_HCP5_CANFD01_E2E_fcbbcae3_Tx of Com_TransmitRequest" UBYTE Com_TransmitRequestType 0 0 0 1 ECU_ADDRESS 0x0 SYMBOL_LINK "Com_TransmitRequest.raw[8]" 0 /end MEASUREMENT
/begin MEASUREMENT Com_TransmitRequest_BMC_HV_02_XIX_HCP5_CANFD01_E2E_c5c367a3_Tx "The element: BMC_HV_02_XIX_HCP5_CANFD01_E2E_c5c367a3_Tx of Com_TransmitRequest" UBYTE Com_TransmitRequestType 0 0 0 1 ECU_ADDRESS 0x0 SYMBOL_LINK "Com_TransmitRequest.raw[9]" 0 /end MEASUREMENT
/begin MEASUREMENT Com_TransmitRequest_BMC_HV_03_XIX_HCP5_CANFD01_0617c15c_Tx "The element: BMC_HV_03_XIX_HCP5_CANFD01_0617c15c_Tx of Com_TransmitRequest" UBYTE Com_TransmitRequestType 0 0 0 1 ECU_ADDRESS 0x0 SYMBOL_LINK "Com_TransmitRequest.raw[10]" 0 /end MEASUREMENT
/begin MEASUREMENT Com_TransmitRequest_BMC_HV_04_XIX_BMC_CAN01_E2E_a4a2e7f5_Tx "The element: BMC_HV_04_XIX_BMC_CAN01_E2E_a4a2e7f5_Tx of Com_TransmitRequest" UBYTE Com_TransmitRequestType 0 0 0 1 ECU_ADDRESS 0x0 SYMBOL_LINK "Com_TransmitRequest.raw[11]" 0 /end MEASUREMENT
/begin MEASUREMENT Com_TransmitRequest_BMC_HV_05_XIX_HCP5_CANFD01_086b7dd9_Tx "The element: BMC_HV_05_XIX_HCP5_CANFD01_086b7dd9_Tx of Com_TransmitRequest" UBYTE Com_TransmitRequestType 0 0 0 1 ECU_ADDRESS 0x0 SYMBOL_LINK "Com_TransmitRequest.raw[12]" 0 /end MEASUREMENT
/begin MEASUREMENT Com_TransmitRequest_BMC_HV_06_XIX_HCP5_CANFD01_e2eda0bb_Tx "The element: BMC_HV_06_XIX_HCP5_CANFD01_e2eda0bb_Tx of Com_TransmitRequest" UBYTE Com_TransmitRequestType 0 0 0 1 ECU_ADDRESS 0x0 SYMBOL_LINK "Com_TransmitRequest.raw[13]" 0 /end MEASUREMENT
/begin MEASUREMENT Com_TransmitRequest_BMC_HV_07_XIX_HCP5_CANFD01_0dbf165a_Tx "The element: BMC_HV_07_XIX_HCP5_CANFD01_0dbf165a_Tx of Com_TransmitRequest" UBYTE Com_TransmitRequestType 0 0 0 1 ECU_ADDRESS 0x0 SYMBOL_LINK "Com_TransmitRequest.raw[14]" 0 /end MEASUREMENT
/begin MEASUREMENT Com_TransmitRequest_BMC_HV_08_XIX_HCP5_CANFD01_fbc0b232_Tx "The element: BMC_HV_08_XIX_HCP5_CANFD01_fbc0b232_Tx of Com_TransmitRequest" UBYTE Com_TransmitRequestType 0 0 0 1 ECU_ADDRESS 0x0 SYMBOL_LINK "Com_TransmitRequest.raw[15]" 0 /end MEASUREMENT
/begin MEASUREMENT Com_TransmitRequest_BMC_HV_09_XIX_HCP5_CANFD01_149204d3_Tx "The element: BMC_HV_09_XIX_HCP5_CANFD01_149204d3_Tx of Com_TransmitRequest" UBYTE Com_TransmitRequestType 0 0 0 1 ECU_ADDRESS 0x0 SYMBOL_LINK "Com_TransmitRequest.raw[16]" 0 /end MEASUREMENT
/begin MEASUREMENT Com_TransmitRequest_BMC_HV_10_XIX_BMC_CAN01_E2E_28add151_Tx "The element: BMC_HV_10_XIX_BMC_CAN01_E2E_28add151_Tx of Com_TransmitRequest" UBYTE Com_TransmitRequestType 0 0 0 1 ECU_ADDRESS 0x0 SYMBOL_LINK "Com_TransmitRequest.raw[17]" 0 /end MEASUREMENT
/begin MEASUREMENT Com_TransmitRequest_BMC_HV_11_XIX_BMC_CAN01_E2E_ff4f5109_Tx "The element: BMC_HV_11_XIX_BMC_CAN01_E2E_ff4f5109_Tx of Com_TransmitRequest" UBYTE Com_TransmitRequestType 0 0 0 1 ECU_ADDRESS 0x0 SYMBOL_LINK "Com_TransmitRequest.raw[18]" 0 /end MEASUREMENT
/begin MEASUREMENT Com_TransmitRequest_BMC_HV_12_XIX_BMC_CAN01_E2E_5c19d7a0_Tx "The element: BMC_HV_12_XIX_BMC_CAN01_E2E_5c19d7a0_Tx of Com_TransmitRequest" UBYTE Com_TransmitRequestType 0 0 0 1 ECU_ADDRESS 0x0 SYMBOL_LINK "Com_TransmitRequest.raw[19]" 0 /end MEASUREMENT
/begin MEASUREMENT Com_TransmitRequest_BMC_HV_13_XIX_BMC_CAN01_E2E_8bfb57f8_Tx "The element: BMC_HV_13_XIX_BMC_CAN01_E2E_8bfb57f8_Tx of Com_TransmitRequest" UBYTE Com_TransmitRequestType 0 0 0 1 ECU_ADDRESS 0x0 SYMBOL_LINK "Com_TransmitRequest.raw[20]" 0 /end MEASUREMENT
/begin MEASUREMENT Com_TransmitRequest_BMC_HV_14_XIX_HCP5_CANFD01_30db4b60_Tx "The element: BMC_HV_14_XIX_HCP5_CANFD01_30db4b60_Tx of Com_TransmitRequest" UBYTE Com_TransmitRequestType 0 0 0 1 ECU_ADDRESS 0x0 SYMBOL_LINK "Com_TransmitRequest.raw[21]" 0 /end MEASUREMENT
/begin MEASUREMENT Com_TransmitRequest_DEV_Hybrid_01_Resp_FF_XIX_HCP5_CANFD01_7b20ac63_Tx "The element: DEV_Hybrid_01_Resp_FF_XIX_HCP5_CANFD01_7b20ac63_Tx of Com_TransmitRequest" UBYTE Com_TransmitRequestType 0 0 0 1 ECU_ADDRESS 0x0 SYMBOL_LINK "Com_TransmitRequest.raw[22]" 0 /end MEASUREMENT
/begin MEASUREMENT Com_TransmitRequest_DS_Hybrid_01_XIX_HCP5_CANFD01_b3d0b839_Tx "The element: DS_Hybrid_01_XIX_HCP5_CANFD01_b3d0b839_Tx of Com_TransmitRequest" UBYTE Com_TransmitRequestType 0 0 0 1 ECU_ADDRESS 0x0 SYMBOL_LINK "Com_TransmitRequest.raw[23]" 0 /end MEASUREMENT
/begin MEASUREMENT Com_TransmitRequest_KN_Hybrid_01_XIX_HCP5_CANFD01_fef84477_Tx "The element: KN_Hybrid_01_XIX_HCP5_CANFD01_fef84477_Tx of Com_TransmitRequest" UBYTE Com_TransmitRequestType 0 0 0 1 ECU_ADDRESS 0x0 SYMBOL_LINK "Com_TransmitRequest.raw[24]" 0 /end MEASUREMENT
/begin MEASUREMENT Com_TransmitRequest_KS_Hybrid_01_Challenge_K_XIX_HCP5_CANFD01_306d69bd_Tx "The element: KS_Hybrid_01_Challenge_K_XIX_HCP5_CANFD01_306d69bd_Tx of Com_TransmitRequest" UBYTE Com_TransmitRequestType 0 0 0 1 ECU_ADDRESS 0x0 SYMBOL_LINK "Com_TransmitRequest.raw[25]" 0 /end MEASUREMENT
/begin MEASUREMENT Com_TransmitRequest_KS_Hybrid_01_ReqFrame_XIX_HCP5_CANFD01_b04c52dd_Tx "The element: KS_Hybrid_01_ReqFrame_XIX_HCP5_CANFD01_b04c52dd_Tx of Com_TransmitRequest" UBYTE Com_TransmitRequestType 0 0 0 1 ECU_ADDRESS 0x0 SYMBOL_LINK "Com_TransmitRequest.raw[26]" 0 /end MEASUREMENT
/begin MEASUREMENT Com_TransmitRequest_KS_Hybrid_01_Response_K_XIX_HCP5_CANFD01_76da782f_Tx "The element: KS_Hybrid_01_Response_K_XIX_HCP5_CANFD01_76da782f_Tx of Com_TransmitRequest" UBYTE Com_TransmitRequestType 0 0 0 1 ECU_ADDRESS 0x0 SYMBOL_LINK "Com_TransmitRequest.raw[27]" 0 /end MEASUREMENT
/begin MEASUREMENT Com_TransmitRequest_NMH_Hybrid_01_XIX_BMC_CAN01_b22e17f1_Tx "The element: NMH_Hybrid_01_XIX_BMC_CAN01_b22e17f1_Tx of Com_TransmitRequest" UBYTE Com_TransmitRequestType 0 0 0 1 ECU_ADDRESS 0x0 SYMBOL_LINK "Com_TransmitRequest.raw[28]" 0 /end MEASUREMENT
/begin MEASUREMENT Com_TransmitRequest_NM_Hybrid_01_XIX_HCP5_CANFD01_c84ff8a5_Tx "The element: NM_Hybrid_01_XIX_HCP5_CANFD01_c84ff8a5_Tx of Com_TransmitRequest" UBYTE Com_TransmitRequestType 0 0 0 1 ECU_ADDRESS 0x0 SYMBOL_LINK "Com_TransmitRequest.raw[29]" 0 /end MEASUREMENT
/begin MEASUREMENT Com_TransmitRequest_OBD_Hybrid_01_XIX_HCP5_CANFD01_40f9dae5_Tx "The element: OBD_Hybrid_01_XIX_HCP5_CANFD01_40f9dae5_Tx of Com_TransmitRequest" UBYTE Com_TransmitRequestType 0 0 0 1 ECU_ADDRESS 0x0 SYMBOL_LINK "Com_TransmitRequest.raw[30]" 0 /end MEASUREMENT
/begin MEASUREMENT Com_TransmitRequest_SOK_Zeit_Hybrid_01_Chal_01_XIX_HCP5_CANFD01_5939048b_Tx "The element: SOK_Zeit_Hybrid_01_Chal_01_XIX_HCP5_CANFD01_5939048b_Tx of Com_TransmitRequest" UBYTE Com_TransmitRequestType 0 0 0 1 ECU_ADDRESS 0x0 SYMBOL_LINK "Com_TransmitRequest.raw[31]" 0 /end MEASUREMENT
/begin MEASUREMENT Com_TxAccessInfo[0].TxGrpSigInfoIdxOfTxAccessInfo "" UBYTE Com_TxGrpSigInfoIdxOfTxAccessInfoType 0 0 0 255 ECU_ADDRESS 0x0 /end MEASUREMENT
/begin MEASUREMENT Com_TxAccessInfo[0].TxSigInfoIdxOfTxAccessInfo "" UWORD Com_TxSigInfoIdxOfTxAccessInfoType 0 0 0 65535 ECU_ADDRESS 0x0 /end MEASUREMENT
/begin MEASUREMENT Com_TxAccessInfo[100].TxGrpSigInfoIdxOfTxAccessInfo "" UBYTE Com_TxGrpSigInfoIdxOfTxAccessInfoType 0 0 0 255 ECU_ADDRESS 0x0 /end MEASUREMENT
/begin MEASUREMENT Com_TxAccessInfo[100].TxSigInfoIdxOfTxAccessInfo "" UWORD Com_TxSigInfoIdxOfTxAccessInfoType 0 0 0 65535 ECU_ADDRESS 0x0 /end MEASUREMENT
/begin MEASUREMENT Com_TxAccessInfo[101].TxGrpSigInfoIdxOfTxAccessInfo "" UBYTE Com_TxGrpSigInfoIdxOfTxAccessInfoType 0 0 0 255 ECU_ADDRESS 0x0 /end MEASUREMENT
/begin MEASUREMENT Com_TxAccessInfo[101].TxSigInfoIdxOfTxAccessInfo "" UWORD Com_TxSigInfoIdxOfTxAccessInfoType 0 0 0 65535 ECU_ADDRESS 0x0 /end MEASUREMENT
/begin MEASUREMENT Com_TxAccessInfo[102].TxGrpSigInfoIdxOfTxAccessInfo "" UBYTE Com_TxGrpSigInfoIdxOfTxAccessInfoType 0 0 0 255 ECU_ADDRESS 0x0 /end MEASUREMENT
/begin MEASUREMENT Com_TxAccessInfo[102].TxSigInfoIdxOfTxAccessInfo "" UWORD Com_TxSigInfoIdxOfTxAccessInfoType 0 0 0 65535 ECU_ADDRESS 0x0 /end MEASUREMENT
/begin MEASUREMENT Com_TxAccessInfo[103].TxGrpSigInfoIdxOfTxAccessInfo "" UBYTE Com_TxGrpSigInfoIdxOfTxAccessInfoType 0 0 0 255 ECU_ADDRESS 0x0 /end MEASUREMENT
/begin MEASUREMENT Com_TxAccessInfo[103].TxSigInfoIdxOfTxAccessInfo "" UWORD Com_TxSigInfoIdxOfTxAccessInfoType 0 0 0 65535 ECU_ADDRESS 0x0 /end MEASUREMENT
/begin MEASUREMENT Com_TxAccessInfo[104].TxGrpSigInfoIdxOfTxAccessInfo "" UBYTE Com_TxGrpSigInfoIdxOfTxAccessInfoType 0 0 0 255 ECU_ADDRESS 0x0 /end MEASUREMENT
/begin MEASUREMENT Com_TxAccessInfo[104].TxSigInfoIdxOfTxAccessInfo "" UWORD Com_TxSigInfoIdxOfTxAccessInfoType 0 0 0 65535 ECU_ADDRESS 0x0 /end MEASUREMENT
/begin MEASUREMENT Com_TxAccessInfo[105].TxGrpSigInfoIdxOfTxAccessInfo "" UBYTE Com_TxGrpSigInfoIdxOfTxAccessInfoType 0 0 0 255 ECU_ADDRESS 0x0 /end MEASUREMENT
/begin MEASUREMENT Com_TxAccessInfo[105].TxSigInfoIdxOfTxAccessInfo "" UWORD Com_TxSigInfoIdxOfTxAccessInfoType 0 0 0 65535 ECU_ADDRESS 0x0 /end MEASUREMENT
/begin MEASUREMENT Com_TxAccessInfo[106].TxGrpSigInfoIdxOfTxAccessInfo "" UBYTE Com_TxGrpSigInfoIdxOfTxAccessInfoType 0 0 0 255 ECU_ADDRESS 0x0 /end MEASUREMENT
/begin MEASUREMENT Com_TxAccessInfo[106].TxSigInfoIdxOfTxAccessInfo "" UWORD Com_TxSigInfoIdxOfTxAccessInfoType 0 0 0 65535 ECU_ADDRESS 0x0 /end MEASUREMENT
/begin MEASUREMENT Com_TxAccessInfo[107].TxGrpSigInfoIdxOfTxAccessInfo "" UBYTE Com_TxGrpSigInfoIdxOfTxAccessInfoType 0 0 0 255 ECU_ADDRESS 0x0 /end MEASUREMENT
/begin MEASUREMENT Com_TxAccessInfo[107].TxSigInfoIdxOfTxAccessInfo "" UWORD Com_TxSigInfoIdxOfTxAccessInfoType 0 0 0 65535 ECU_ADDRESS 0x0 /end MEASUREMENT
/begin MEASUREMENT Com_TxAccessInfo[108].TxGrpSigInfoIdxOfTxAccessInfo "" UBYTE Com_TxGrpSigInfoIdxOfTxAccessInfoType 0 0 0 255 ECU_ADDRESS 0x0 /end MEASUREMENT
/begin MEASUREMENT Com_TxAccessInfo[108].TxSigInfoIdxOfTxAccessInfo "" UWORD Com_TxSigInfoIdxOfTxAccessInfoType 0 0 0 65535 ECU_ADDRESS 0x0 /end MEASUREMENT
/begin MEASUREMENT Com_TxAccessInfo[109].TxGrpSigInfoIdxOfTxAccessInfo "" UBYTE Com_TxGrpSigInfoIdxOfTxAccessInfoType 0 0 0 255 ECU_ADDRESS 0x0 /end MEASUREMENT
/begin MEASUREMENT Com_TxAccessInfo[109].TxSigInfoIdxOfTxAccessInfo "" UWORD Com_TxSigInfoIdxOfTxAccessInfoType 0 0 0 65535 ECU_ADDRESS 0x0 /end MEASUREMENT
/begin MEASUREMENT Com_TxAccessInfo[10].TxGrpSigInfoIdxOfTxAccessInfo "" UBYTE Com_TxGrpSigInfoIdxOfTxAccessInfoType 0 0 0 255 ECU_ADDRESS 0x0 /end MEASUREMENT
/begin MEASUREMENT Com_TxAccessInfo[10].TxSigInfoIdxOfTxAccessInfo "" UWORD Com_TxSigInfoIdxOfTxAccessInfoType 0 0 0 65535 ECU_ADDRESS 0x0 /end MEASUREMENT
/begin MEASUREMENT Com_TxAccessInfo[110].TxGrpSigInfoIdxOfTxAccessInfo "" UBYTE Com_TxGrpSigInfoIdxOfTxAccessInfoType 0 0 0 255 ECU_ADDRESS 0x0 /end MEASUREMENT
/begin MEASUREMENT Com_TxAccessInfo[110].TxSigInfoIdxOfTxAccessInfo "" UWORD Com_TxSigInfoIdxOfTxAccessInfoType 0 0 0 65535 ECU_ADDRESS 0x0 /end MEASUREMENT
/begin MEASUREMENT Com_TxAccessInfo[111].TxGrpSigInfoIdxOfTxAccessInfo "" UBYTE Com_TxGrpSigInfoIdxOfTxAccessInfoType 0 0 0 255 ECU_ADDRESS 0x0 /end MEASUREMENT
/begin MEASUREMENT Com_TxAccessInfo[111].TxSigInfoIdxOfTxAccessInfo "" UWORD Com_TxSigInfoIdxOfTxAccessInfoType 0 0 0 65535 ECU_ADDRESS 0x0 /end MEASUREMENT
/begin MEASUREMENT Com_TxAccessInfo[112].TxGrpSigInfoIdxOfTxAccessInfo "" UBYTE Com_TxGrpSigInfoIdxOfTxAccessInfoType 0 0 0 255 ECU_ADDRESS 0x0 /end MEASUREMENT
/begin MEASUREMENT Com_TxAccessInfo[112].TxSigInfoIdxOfTxAccessInfo "" UWORD Com_TxSigInfoIdxOfTxAccessInfoType 0 0 0 65535 ECU_ADDRESS 0x0 /end MEASUREMENT
/begin MEASUREMENT Com_TxAccessInfo[113].TxGrpSigInfoIdxOfTxAccessInfo "" UBYTE Com_TxGrpSigInfoIdxOfTxAccessInfoType 0 0 0 255 ECU_ADDRESS 0x0 /end MEASUREMENT
/begin MEASUREMENT Com_TxAccessInfo[113].TxSigInfoIdxOfTxAccessInfo "" UWORD Com_TxSigInfoIdxOfTxAccessInfoType 0 0 0 65535 ECU_ADDRESS 0x0 /end MEASUREMENT
/begin MEASUREMENT Com_TxAccessInfo[114].TxGrpSigInfoIdxOfTxAccessInfo "" UBYTE Com_TxGrpSigInfoIdxOfTxAccessInfoType 0 0 0 255 ECU_ADDRESS 0x0 /end MEASUREMENT
/begin MEASUREMENT Com_TxAccessInfo[114].TxSigInfoIdxOfTxAccessInfo "" UWORD Com_TxSigInfoIdxOfTxAccessInfoType 0 0 0 65535 ECU_ADDRESS 0x0 /end MEASUREMENT
/begin MEASUREMENT Com_TxAccessInfo[115].TxGrpSigInfoIdxOfTxAccessInfo "" UBYTE Com_TxGrpSigInfoIdxOfTxAccessInfoType 0 0 0 255 ECU_ADDRESS 0x0 /end MEASUREMENT
/begin MEASUREMENT Com_TxAccessInfo[115].TxSigInfoIdxOfTxAccessInfo "" UWORD Com_TxSigInfoIdxOfTxAccessInfoType 0 0 0 65535 ECU_ADDRESS 0x0 /end MEASUREMENT
/begin MEASUREMENT Com_TxAccessInfo[116].TxGrpSigInfoIdxOfTxAccessInfo "" UBYTE Com_TxGrpSigInfoIdxOfTxAccessInfoType 0 0 0 255 ECU_ADDRESS 0x0 /end MEASUREMENT
/begin MEASUREMENT Com_TxAccessInfo[116].TxSigInfoIdxOfTxAccessInfo "" UWORD Com_TxSigInfoIdxOfTxAccessInfoType 0 0 0 65535 ECU_ADDRESS 0x0 /end MEASUREMENT
/begin MEASUREMENT Com_TxAccessInfo[117].TxGrpSigInfoIdxOfTxAccessInfo "" UBYTE Com_TxGrpSigInfoIdxOfTxAccessInfoType 0 0 0 255 ECU_ADDRESS 0x0 /end MEASUREMENT
/begin MEASUREMENT Com_TxAccessInfo[117].TxSigInfoIdxOfTxAccessInfo "" UWORD Com_TxSigInfoIdxOfTxAccessInfoType 0 0 0 65535 ECU_ADDRESS 0x0 /end MEASUREMENT
/begin MEASUREMENT Com_TxAccessInfo[118].TxGrpSigInfoIdxOfTxAccessInfo "" UBYTE Com_TxGrpSigInfoIdxOfTxAccessInfoType 0 0 0 255 ECU_ADDRESS 0x0 /end MEASUREMENT
/begin MEASUREMENT Com_TxAccessInfo[118].TxSigInfoIdxOfTxAccessInfo "" UWORD Com_TxSigInfoIdxOfTxAccessInfoType 0 0 0 65535 ECU_ADDRESS 0x0 /end MEASUREMENT
/begin MEASUREMENT Com_TxAccessInfo[119].TxGrpSigInfoIdxOfTxAccessInfo "" UBYTE Com_TxGrpSigInfoIdxOfTxAccessInfoType 0 0 0 255 ECU_ADDRESS 0x0 /end MEASUREMENT
/begin MEASUREMENT Com_TxAccessInfo[119].TxSigInfoIdxOfTxAccessInfo "" UWORD Com_TxSigInfoIdxOfTxAccessInfoType 0 0 0 65535 ECU_ADDRESS 0x0 /end MEASUREMENT
/begin MEASUREMENT Com_TxAccessInfo[11].TxGrpSigInfoIdxOfTxAccessInfo "" UBYTE Com_TxGrpSigInfoIdxOfTxAccessInfoType 0 0 0 255 ECU_ADDRESS 0x0 /end MEASUREMENT
/begin MEASUREMENT Com_TxAccessInfo[11].TxSigInfoIdxOfTxAccessInfo "" UWORD Com_TxSigInfoIdxOfTxAccessInfoType 0 0 0 65535 ECU_ADDRESS 0x0 /end MEASUREMENT
/begin MEASUREMENT Com_TxAccessInfo[120].TxGrpSigInfoIdxOfTxAccessInfo "" UBYTE Com_TxGrpSigInfoIdxOfTxAccessInfoType 0 0 0 255 ECU_ADDRESS 0x0 /end MEASUREMENT
/begin MEASUREMENT Com_TxAccessInfo[120].TxSigInfoIdxOfTxAccessInfo "" UWORD Com_TxSigInfoIdxOfTxAccessInfoType 0 0 0 65535 ECU_ADDRESS 0x0 /end MEASUREMENT
/begin MEASUREMENT Com_TxAccessInfo[121].TxGrpSigInfoIdxOfTxAccessInfo "" UBYTE Com_TxGrpSigInfoIdxOfTxAccessInfoType 0 0 0 255 ECU_ADDRESS 0x0 /end MEASUREMENT
/begin MEASUREMENT Com_TxAccessInfo[121].TxSigInfoIdxOfTxAccessInfo "" UWORD Com_TxSigInfoIdxOfTxAccessInfoType 0 0 0 65535 ECU_ADDRESS 0x0 /end MEASUREMENT
/begin MEASUREMENT Com_TxAccessInfo[122].TxGrpSigInfoIdxOfTxAccessInfo "" UBYTE Com_TxGrpSigInfoIdxOfTxAccessInfoType 0 0 0 255 ECU_ADDRESS 0x0 /end MEASUREMENT
/begin MEASUREMENT Com_TxAccessInfo[122].TxSigInfoIdxOfTxAccessInfo "" UWORD Com_TxSigInfoIdxOfTxAccessInfoType 0 0 0 65535 ECU_ADDRESS 0x0 /end MEASUREMENT
/begin MEASUREMENT Com_TxAccessInfo[123].TxGrpSigInfoIdxOfTxAccessInfo "" UBYTE Com_TxGrpSigInfoIdxOfTxAccessInfoType 0 0 0 255 ECU_ADDRESS 0x0 /end MEASUREMENT
/begin MEASUREMENT Com_TxAccessInfo[123].TxSigInfoIdxOfTxAccessInfo "" UWORD Com_TxSigInfoIdxOfTxAccessInfoType 0 0 0 65535 ECU_ADDRESS 0x0 /end MEASUREMENT
/begin MEASUREMENT Com_TxAccessInfo[124].TxGrpSigInfoIdxOfTxAccessInfo "" UBYTE Com_TxGrpSigInfoIdxOfTxAccessInfoType 0 0 0 255 ECU_ADDRESS 0x0 /end MEASUREMENT
/begin MEASUREMENT Com_TxAccessInfo[124].TxSigInfoIdxOfTxAccessInfo "" UWORD Com_TxSigInfoIdxOfTxAccessInfoType 0 0 0 65535 ECU_ADDRESS 0x0 /end MEASUREMENT
/begin MEASUREMENT Com_TxAccessInfo[125].TxGrpSigInfoIdxOfTxAccessInfo "" UBYTE Com_TxGrpSigInfoIdxOfTxAccessInfoType 0 0 0 255 ECU_ADDRESS 0x0 /end MEASUREMENT
/begin MEASUREMENT Com_TxAccessInfo[125].TxSigInfoIdxOfTxAccessInfo "" UWORD Com_TxSigInfoIdxOfTxAccessInfoType 0 0 0 65535 ECU_ADDRESS 0x0 /end MEASUREMENT
/begin MEASUREMENT Com_TxAccessInfo[126].TxGrpSigInfoIdxOfTxAccessInfo "" UBYTE Com_TxGrpSigInfoIdxOfTxAccessInfoType 0 0 0 255 ECU_ADDRESS 0x0 /end MEASUREMENT
/begin MEASUREMENT Com_TxAccessInfo[126].TxSigInfoIdxOfTxAccessInfo "" UWORD Com_TxSigInfoIdxOfTxAccessInfoType 0 0 0 65535 ECU_ADDRESS 0x0 /end MEASUREMENT
/begin MEASUREMENT Com_TxAccessInfo[127].TxGrpSigInfoIdxOfTxAccessInfo "" UBYTE Com_TxGrpSigInfoIdxOfTxAccessInfoType 0 0 0 255 ECU_ADDRESS 0x0 /end MEASUREMENT
/begin MEASUREMENT Com_TxAccessInfo[127].TxSigInfoIdxOfTxAccessInfo "" UWORD Com_TxSigInfoIdxOfTxAccessInfoType 0 0 0 65535 ECU_ADDRESS 0x0 /end MEASUREMENT
/begin MEASUREMENT Com_TxAccessInfo[128].TxGrpSigInfoIdxOfTxAccessInfo "" UBYTE Com_TxGrpSigInfoIdxOfTxAccessInfoType 0 0 0 255 ECU_ADDRESS 0x0 /end MEASUREMENT
/begin MEASUREMENT Com_TxAccessInfo[128].TxSigInfoIdxOfTxAccessInfo "" UWORD Com_TxSigInfoIdxOfTxAccessInfoType 0 0 0 65535 ECU_ADDRESS 0x0 /end MEASUREMENT
/begin MEASUREMENT Com_TxAccessInfo[129].TxGrpSigInfoIdxOfTxAccessInfo "" UBYTE Com_TxGrpSigInfoIdxOfTxAccessInfoType 0 0 0 255 ECU_ADDRESS 0x0 /end MEASUREMENT
/begin MEASUREMENT Com_TxAccessInfo[129].TxSigInfoIdxOfTxAccessInfo "" UWORD Com_TxSigInfoIdxOfTxAccessInfoType 0 0 0 65535 ECU_ADDRESS 0x0 /end MEASUREMENT
/begin MEASUREMENT Com_TxAccessInfo[12].TxGrpSigInfoIdxOfTxAccessInfo "" UBYTE Com_TxGrpSigInfoIdxOfTxAccessInfoType 0 0 0 255 ECU_ADDRESS 0x0 /end MEASUREMENT
/begin MEASUREMENT Com_TxAccessInfo[12].TxSigInfoIdxOfTxAccessInfo "" UWORD Com_TxSigInfoIdxOfTxAccessInfoType 0 0 0 65535 ECU_ADDRESS 0x0 /end MEASUREMENT
/begin MEASUREMENT Com_TxAccessInfo[130].TxGrpSigInfoIdxOfTxAccessInfo "" UBYTE Com_TxGrpSigInfoIdxOfTxAccessInfoType 0 0 0 255 ECU_ADDRESS 0x0 /end MEASUREMENT
/begin MEASUREMENT Com_TxAccessInfo[130].TxSigInfoIdxOfTxAccessInfo "" UWORD Com_TxSigInfoIdxOfTxAccessInfoType 0 0 0 65535 ECU_ADDRESS 0x0 /end MEASUREMENT
/begin MEASUREMENT Com_TxAccessInfo[131].TxGrpSigInfoIdxOfTxAccessInfo "" UBYTE Com_TxGrpSigInfoIdxOfTxAccessInfoType 0 0 0 255 ECU_ADDRESS 0x0 /end MEASUREMENT
/begin MEASUREMENT Com_TxAccessInfo[131].TxSigInfoIdxOfTxAccessInfo "" UWORD Com_TxSigInfoIdxOfTxAccessInfoType 0 0 0 65535 ECU_ADDRESS 0x0 /end MEASUREMENT
/begin MEASUREMENT Com_TxAccessInfo[132].TxGrpSigInfoIdxOfTxAccessInfo "" UBYTE Com_TxGrpSigInfoIdxOfTxAccessInfoType 0 0 0 255 ECU_ADDRESS 0x0 /end MEASUREMENT
/begin MEASUREMENT Com_TxAccessInfo[132].TxSigInfoIdxOfTxAccessInfo "" UWORD Com_TxSigInfoIdxOfTxAccessInfoType 0 0 0 65535 ECU_ADDRESS 0x0 /end MEASUREMENT
/begin MEASUREMENT Com_TxAccessInfo[133].TxGrpSigInfoIdxOfTxAccessInfo "" UBYTE Com_TxGrpSigInfoIdxOfTxAccessInfoType 0 0 0 255 ECU_ADDRESS 0x0 /end MEASUREMENT
/begin MEASUREMENT Com_TxAccessInfo[133].TxSigInfoIdxOfTxAccessInfo "" UWORD Com_TxSigInfoIdxOfTxAccessInfoType 0 0 0 65535 ECU_ADDRESS 0x0 /end MEASUREMENT
/begin MEASUREMENT Com_TxAccessInfo[134].TxGrpSigInfoIdxOfTxAccessInfo "" UBYTE Com_TxGrpSigInfoIdxOfTxAccessInfoType 0 0 0 255 ECU_ADDRESS 0x0 /end MEASUREMENT
/begin COMPU_METHOD Com_CbkRxTOutFuncPtrIndStartIdxOfRxTOutInfoType "" TAB_VERB "%10.1" "" COMPU_TAB_REF Com_CbkRxTOutFuncPtrIndStartIdxOfRxTOutInfoType /end COMPU_METHOD
/begin COMPU_METHOD Com_RxAccessInfoReplaceGrpSigIndStartIdxOfRxTOutInfoType "" TAB_VERB "%10.1" "" COMPU_TAB_REF Com_RxAccessInfoReplaceGrpSigIndStartIdxOfRxTOutInfoType /end COMPU_METHOD
/begin COMPU_METHOD Com_RxCbkFuncPtrAckIdxOfRxSigInfoType "" TAB_VERB "%10.1" "" COMPU_TAB_REF Com_RxCbkFuncPtrAckIdxOfRxSigInfoType /end COMPU_METHOD
/begin COMPU_METHOD Com_SignalProcessingOfRxSigInfoType "" TAB_VERB "%10.1" "" COMPU_TAB_REF Com_SignalProcessingOfRxSigInfoType /end COMPU_METHOD
/begin COMPU_METHOD Com_TransmitRequestType "" TAB_VERB "%10.1" "" COMPU_TAB_REF Com_TransmitRequestType /end COMPU_METHOD
/begin COMPU_METHOD Com_TxGrpSigInfoIdxOfTxAccessInfoType "" TAB_VERB "%10.1" "" COMPU_TAB_REF Com_TxGrpSigInfoIdxOfTxAccessInfoType /end COMPU_METHOD
/begin COMPU_METHOD Com_TxSigInfoIdxOfTxAccessInfoType "" TAB_VERB "%10.1" "" COMPU_TAB_REF Com_TxSigInfoIdxOfTxAccessInfoType /end COMPU_METHOD
/begin COMPU_VTAB Com_CbkRxTOutFuncPtrIndStartIdxOfRxTOutInfoType "" TAB_VERB 1 255 "COM_NO_CBKRXTOUTFUNCPTRINDSTARTIDXOFRXTOUTINFO" /end COMPU_VTAB
/begin COMPU_VTAB Com_RxAccessInfoReplaceGrpSigIndStartIdxOfRxTOutInfoType "" TAB_VERB 1 255 "COM_NO_RXACCESSINFOREPLACEGRPSIGINDSTARTIDXOFRXTOUTINFO" /end COMPU_VTAB
/begin COMPU_VTAB Com_RxCbkFuncPtrAckIdxOfRxSigInfoType "" TAB_VERB 1 255 "COM_NO_RXCBKFUNCPTRACKIDXOFRXSIGINFO" /end COMPU_VTAB
/begin COMPU_VTAB Com_SignalProcessingOfRxSigInfoType "" TAB_VERB 1 0 "COM_DEFERRED_SIGNALPROCESSINGOFRXSIGINFO" /end COMPU_VTAB
/begin COMPU_VTAB_RANGE Com_TransmitRequestType "" 2 0 0 "FALSE" 1 255 "TRUE" /end COMPU_VTAB_RANGE
/begin COMPU_VTAB Com_TxGrpSigInfoIdxOfTxAccessInfoType "" TAB_VERB 1 255 "COM_NO_TXGRPSIGINFOIDXOFTXACCESSINFO" /end COMPU_VTAB
/begin COMPU_VTAB Com_TxSigInfoIdxOfTxAccessInfoType "" TAB_VERB 1 65535 "COM_NO_TXSIGINFOIDXOFTXACCESSINFO" /end COMPU_VTAB
/begin GROUP Com ""
 /begin REF_MEASUREMENT Com_RxSigInfo[230].RxCbkFuncPtrAckIdxOfRxSigInfo Com_RxSigInfo[230].SignalProcessingOfRxSigInfo Com_RxSigInfo[230].ValidDlcOfRxSigInfo Com_RxSigInfo[231].RxAccessInfoIdxOfRxSigInfo Com_RxSigInfo[231].RxCbkFuncPtrAckIdxOfRxSigInfo Com_RxSigInfo[231].SignalProcessingOfRxSigInfo Com_RxSigInfo[231].ValidDlcOfRxSigInfo Com_RxSigInfo[232].RxAccessInfoIdxOfRxSigInfo Com_RxSigInfo[232].RxCbkFuncPtrAckIdxOfRxSigInfo Com_RxSigInfo[232].SignalProcessingOfRxSigInfo Com_RxSigInfo[232].ValidDlcOfRxSigInfo Com_RxSigInfo[233].RxAccessInfoIdxOfRxSigInfo Com_RxSigInfo[233].RxCbkFuncPtrAckIdxOfRxSigInfo Com_RxSigInfo[233].SignalProcessingOfRxSigInfo Com_RxSigInfo[233].ValidDlcOfRxSigInfo Com_RxSigInfo[234].RxAccessInfoIdxOfRxSigInfo Com_RxSigInfo[234].RxCbkFuncPtrAckIdxOfRxSigInfo Com_RxSigInfo[234].SignalProcessingOfRxSigInfo Com_RxSigInfo[234].ValidDlcOfRxSigInfo Com_RxSigInfo[235].RxAccessInfoIdxOfRxSigInfo Com_RxSigInfo[235].RxCbkFuncPtrAckIdxOfRxSigInfo Com_RxSigInfo[235].SignalProcessingOfRxSigInfo Com_RxSigInfo[235].ValidDlcOfRxSigInfo Com_RxSigInfo[236].RxAccessInfoIdxOfRxSigInfo Com_RxSigInfo[236].RxCbkFuncPtrAckIdxOfRxSigInfo Com_RxSigInfo[236].SignalProcessingOfRxSigInfo Com_RxSigInfo[236].ValidDlcOfRxSigInfo Com_RxSigInfo[237].RxAccessInfoIdxOfRxSigInfo Com_RxSigInfo[237].RxCbkFuncPtrAckIdxOfRxSigInfo Com_RxSigInfo[237].SignalProcessingOfRxSigInfo Com_RxSigInfo[237].ValidDlcOfRxSigInfo Com_RxSigInfo[238].RxAccessInfoIdxOfRxSigInfo Com_RxSigInfo[238].RxCbkFuncPtrAckIdxOfRxSigInfo Com_RxSigInfo[238].SignalProcessingOfRxSigInfo Com_RxSigInfo[238].ValidDlcOfRxSigInfo Com_RxSigInfo[239].RxAccessInfoIdxOfRxSigInfo Com_RxSigInfo[239].RxCbkFuncPtrAckIdxOfRxSigInfo Com_RxSigInfo[239].SignalProcessingOfRxSigInfo Com_RxSigInfo[239].ValidDlcOfRxSigInfo Com_RxSigInfo[23].RxAccessInfoIdxOfRxSigInfo Com_RxSigInfo[23].RxCbkFuncPtrAckIdxOfRxSigInfo Com_RxSigInfo[23].SignalProcessingOfRxSigInfo Com_RxSigInfo[23].ValidDlcOfRxSigInfo Com_RxSigInfo[240].RxAccessInfoIdxOfRxSigInfo Com_RxSigInfo[240].RxCbkFuncPtrAckIdxOfRxSigInfo Com_RxSigInfo[240].SignalProcessingOfRxSigInfo Com_RxSigInfo[240].ValidDlcOfRxSigInfo Com_RxSigInfo[241].RxAccessInfoIdxOfRxSigInfo Com_RxSigInfo[241].RxCbkFuncPtrAckIdxOfRxSigInfo Com_RxSigInfo[241].SignalProcessingOfRxSigInfo Com_RxSigInfo[241].ValidDlcOfRxSigInfo Com_RxSigInfo[242].RxAccessInfoIdxOfRxSigInfo Com_RxSigInfo[242].RxCbkFuncPtrAckIdxOfRxSigInfo Com_RxSigInfo[242].SignalProcessingOfRxSigInfo Com_RxSigInfo[242].ValidDlcOfRxSigInfo Com_RxSigInfo[243].RxAccessInfoIdxOfRxSigInfo Com_RxSigInfo[243].RxCbkFuncPtrAckIdxOfRxSigInfo Com_RxSigInfo[243].SignalProcessingOfRxSigInfo Com_RxSigInfo[243].ValidDlcOfRxSigInfo Com_RxSigInfo[244].RxAccessInfoIdxOfRxSigInfo Com_RxSigInfo[244].RxCbkFuncPtrAckIdxOfRxSigInfo Com_RxSigInfo[244].SignalProcessingOfRxSigInfo Com_RxSigInfo[244].ValidDlcOfRxSigInfo Com_RxSigInfo[245].RxAccessInfoIdxOfRxSigInfo Com_RxSigInfo[245].RxCbkFuncPtrAckIdxOfRxSigInfo Com_RxSigInfo[245].SignalProcessingOfRxSigInfo Com_RxSigInfo[245].ValidDlcOfRxSigInfo Com_RxSigInfo[246].RxAccessInfoIdxOfRxSigInfo Com_RxSigInfo[246].RxCbkFuncPtrAckIdxOfRxSigInfo Com_RxSigInfo[246].SignalProcessingOfRxSigInfo Com_RxSigInfo[246].ValidDlcOfRxSigInfo Com_RxSigInfo[247].RxAccessInfoIdxOfRxSigInfo Com_RxSigInfo[247].RxCbkFuncPtrAckIdxOfRxSigInfo Com_RxSigInfo[247].SignalProcessingOfRxSigInfo Com_RxSigInfo[247].ValidDlcOfRxSigInfo Com_RxSigInfo[248].RxAccessInfoIdxOfRxSigInfo Com_RxSigInfo[248].RxCbkFuncPtrAckIdxOfRxSigInfo Com_RxSigInfo[248].SignalProcessingOfRxSigInfo Com_RxSigInfo[248].ValidDlcOfRxSigInfo Com_RxSigInfo[249].RxAccessInfoIdxOfRxSigInfo Com_RxSigInfo[249].RxCbkFuncPtrAckIdxOfRxSigInfo Com_RxSigInfo[249].SignalProcessingOfRxSigInfo Com_RxSigInfo[249].ValidDlcOfRxSigInfo Com_RxSigInfo[24].RxAccessInfoIdxOfRxSigInfo Com_RxSigInfo[24].RxCbkFuncPtrAckIdxOfRxSigInfo Com_RxSigInfo[24].SignalProcessingOfRxSigInfo Com_RxSigInfo[24].ValidDlcOfRxSigInfo Com_RxSigInfo[250].RxAccessInfoIdxOfRxSigInfo Com_RxSigInfo[250].RxCbkFuncPtrAckIdxOfRxSigInfo Com_RxSigInfo[250].SignalProcessingOfRxSigInfo Com_RxSigInfo[250].ValidDlcOfRxSigInfo Com_RxSigInfo[251].RxAccessInfoIdxOfRxSigInfo Com_RxSigInfo[251].RxCbkFuncPtrAckIdxOfRxSigInfo Com_RxSigInfo[251].SignalProcessingOfRxSigInfo Com_RxSigInfo[251].ValidDlcOfRxSigInfo Com_RxSigInfo[252].RxAccessInfoIdxOfRxSigInfo Com_RxSigInfo[252].RxCbkFuncPtrAckIdxOfRxSigInfo Com_RxSigInfo[252].SignalProcessingOfRxSigInfo Com_RxSigInfo[252].ValidDlcOfRxSigInfo Com_RxSigInfo[253].RxAccessInfoIdxOfRxSigInfo Com_RxSigInfo[253].RxCbkFuncPtrAckIdxOfRxSigInfo Com_RxSigInfo[253].SignalProcessingOfRxSigInfo Com_RxSigInfo[253].ValidDlcOfRxSigInfo Com_RxSigInfo[254].RxAccessInfoIdxOfRxSigInfo Com_RxSigInfo[254].RxCbkFuncPtrAckIdxOfRxSigInfo Com_RxSigInfo[254].SignalProcessingOfRxSigInfo Com_RxSigInfo[254].ValidDlcOfRxSigInfo Com_RxSigInfo[255].RxAccessInfoIdxOfRxSigInfo Com_RxSigInfo[255].RxCbkFuncPtrAckIdxOfRxSigInfo Com_RxSigInfo[255].SignalProcessingOfRxSigInfo Com_RxSigInfo[255].ValidDlcOfRxSigInfo Com_RxSigInfo[256].RxAccessInfoIdxOfRxSigInfo Com_RxSigInfo[256].RxCbkFuncPtrAckIdxOfRxSigInfo Com_RxSigInfo[256].SignalProcessingOfRxSigInfo Com_RxSigInfo[256].ValidDlcOfRxSigInfo Com_RxSigInfo[257].RxAccessInfoIdxOfRxSigInfo Com_RxSigInfo[257].RxCbkFuncPtrAckIdxOfRxSigInfo Com_RxSigInfo[257].SignalProcessingOfRxSigInfo Com_RxSigInfo[257].ValidDlcOfRxSigInfo Com_RxSigInfo[258].RxAccessInfoIdxOfRxSigInfo Com_RxSigInfo[258].RxCbkFuncPtrAckIdxOfRxSigInfo Com_RxSigInfo[258].SignalProcessingOfRxSigInfo Com_RxSigInfo[258].ValidDlcOfRxSigInfo Com_RxSigInfo[259].RxAccessInfoIdxOfRxSigInfo Com_RxSigInfo[259].RxCbkFuncPtrAckIdxOfRxSigInfo Com_RxSigInfo[259].SignalProcessingOfRxSigInfo Com_RxSigInfo[259].ValidDlcOfRxSigInfo Com_RxSigInfo[25].RxAccessInfoIdxOfRxSigInfo Com_RxSigInfo[25].RxCbkFuncPtrAckIdxOfRxSigInfo Com_RxSigInfo[25].SignalProcessingOfRxSigInfo Com_RxSigInfo[25].ValidDlcOfRxSigInfo Com_RxSigInfo[260].RxAccessInfoIdxOfRxSigInfo Com_RxSigInfo[260].RxCbkFuncPtrAckIdxOfRxSigInfo Com_RxSigInfo[260].SignalProcessingOfRxSigInfo Com_RxSigInfo[260].ValidDlcOfRxSigInfo Com_RxSigInfo[261].RxAccessInfoIdxOfRxSigInfo Com_RxSigInfo[261].RxCbkFuncPtrAckIdxOfRxSigInfo Com_RxSigInfo[261].SignalProcessingOfRxSigInfo Com_RxSigInfo[261].ValidDlcOfRxSigInfo Com_RxSigInfo[262].RxAccessInfoIdxOfRxSigInfo Com_RxSigInfo[262].RxCbkFuncPtrAckIdxOfRxSigInfo Com_RxSigInfo[262].SignalProcessingOfRxSigInfo Com_RxSigInfo[262].ValidDlcOfRxSigInfo Com_RxSigInfo[263].RxAccessInfoIdxOfRxSigInfo Com_RxSigInfo[263].RxCbkFuncPtrAckIdxOfRxSigInfo Com_RxSigInfo[263].SignalProcessingOfRxSigInfo Com_RxSigInfo[263].ValidDlcOfRxSigInfo Com_RxSigInfo[264].RxAccessInfoIdxOfRxSigInfo Com_RxSigInfo[264].RxCbkFuncPtrAckIdxOfRxSigInfo Com_RxSigInfo[264].SignalProcessingOfRxSigInfo Com_RxSigInfo[264].ValidDlcOfRxSigInfo Com_RxSigInfo[265].RxAccessInfoIdxOfRxSigInfo Com_RxSigInfo[265].RxCbkFuncPtrAckIdxOfRxSigInfo Com_RxSigInfo[265].SignalProcessingOfRxSigInfo Com_RxSigInfo[265].ValidDlcOfRxSigInfo Com_RxSigInfo[266].RxAccessInfoIdxOfRxSigInfo Com_RxSigInfo[266].RxCbkFuncPtrAckIdxOfRxSigInfo Com_RxSigInfo[266].SignalProcessingOfRxSigInfo Com_RxSigInfo[266].ValidDlcOfRxSigInfo Com_RxSigInfo[267].RxAccessInfoIdxOfRxSigInfo Com_RxSigInfo[267].RxCbkFuncPtrAckIdxOfRxSigInfo Com_RxSigInfo[267].SignalProcessingOfRxSigInfo Com_RxSigInfo[267].ValidDlcOfRxSigInfo Com_RxSigInfo[268].RxAccessInfoIdxOfRxSigInfo Com_RxSigInfo[268].RxCbkFuncPtrAckIdxOfRxSigInfo Com_RxSigInfo[268].SignalProcessingOfRxSigInfo Com_RxSigInfo[268].ValidDlcOfRxSigInfo Com_RxSigInfo[269].RxAccessInfoIdxOfRxSigInfo Com_RxSigInfo[269].RxCbkFuncPtrAckIdxOfRxSigInfo Com_RxSigInfo[269].SignalProcessingOfRxSigInfo Com_RxSigInfo[269].ValidDlcOfRxSigInfo Com_RxSigInfo[26].RxAccessInfoIdxOfRxSigInfo Com_RxSigInfo[26].RxCbkFuncPtrAckIdxOfRxSigInfo Com_RxSigInfo[26].SignalProcessingOfRxSigInfo Com_RxSigInfo[26].ValidDlcOfRxSigInfo Com_RxSigInfo[270].RxAccessInfoIdxOfRxSigInfo Com_RxSigInfo[270].RxCbkFuncPtrAckIdxOfRxSigInfo Com_RxSigInfo[270].SignalProcessingOfRxSigInfo Com_RxSigInfo[270].ValidDlcOfRxSigInfo Com_RxSigInfo[271].RxAccessInfoIdxOfRxSigInfo Com_RxSigInfo[271].RxCbkFuncPtrAckIdxOfRxSigInfo Com_RxSigInfo[271].SignalProcessingOfRxSigInfo Com_RxSigInfo[271].ValidDlcOfRxSigInfo Com_RxSigInfo[272].RxAccessInfoIdxOfRxSigInfo Com_RxSigInfo[272].RxCbkFuncPtrAckIdxOfRxSigInfo Com_RxSigInfo[272].SignalProcessingOfRxSigInfo Com_RxSigInfo[272].ValidDlcOfRxSigInfo Com_RxSigInfo[273].RxAccessInfoIdxOfRxSigInfo Com_RxSigInfo[273].RxCbkFuncPtrAckIdxOfRxSigInfo Com_RxSigInfo[273].SignalProcessingOfRxSigInfo Com_RxSigInfo[273].ValidDlcOfRxSigInfo Com_RxSigInfo[274].RxAccessInfoIdxOfRxSigInfo Com_RxSigInfo[274].RxCbkFuncPtrAckIdxOfRxSigInfo Com_RxSigInfo[274].SignalProcessingOfRxSigInfo Com_RxSigInfo[274].ValidDlcOfRxSigInfo Com_RxSigInfo[275].RxAccessInfoIdxOfRxSigInfo Com_RxSigInfo[275].RxCbkFuncPtrAckIdxOfRxSigInfo Com_RxSigInfo[275].SignalProcessingOfRxSigInfo Com_RxSigInfo[275].ValidDlcOfRxSigInfo Com_RxSigInfo[276].RxAccessInfoIdxOfRxSigInfo Com_RxSigInfo[276].RxCbkFuncPtrAckIdxOfRxSigInfo Com_RxSigInfo[276].SignalProcessingOfRxSigInfo Com_RxSigInfo[276].ValidDlcOfRxSigInfo Com_RxSigInfo[277].RxAccessInfoIdxOfRxSigInfo Com_RxSigInfo[277].RxCbkFuncPtrAckIdxOfRxSigInfo Com_RxSigInfo[277].SignalProcessingOfRxSigInfo Com_RxSigInfo[277].ValidDlcOfRxSigInfo Com_RxSigInfo[278].RxAccessInfoIdxOfRxSigInfo Com_RxSigInfo[278].RxCbkFuncPtrAckIdxOfRxSigInfo Com_RxSigInfo[278].SignalProcessingOfRxSigInfo Com_RxSigInfo[278].ValidDlcOfRxSigInfo Com_RxSigInfo[279].RxAccessInfoIdxOfRxSigInfo Com_RxSigInfo[279].RxCbkFuncPtrAckIdxOfRxSigInfo Com_RxSigInfo[279].SignalProcessingOfRxSigInfo Com_RxSigInfo[279].ValidDlcOfRxSigInfo Com_RxSigInfo[27].RxAccessInfoIdxOfRxSigInfo Com_RxSigInfo[27].RxCbkFuncPtrAckIdxOfRxSigInfo Com_RxSigInfo[27].SignalProcessingOfRxSigInfo Com_RxSigInfo[27].ValidDlcOfRxSigInfo Com_RxSigInfo[280].RxAccessInfoIdxOfRxSigInfo Com_RxSigInfo[280].RxCbkFuncPtrAckIdxOfRxSigInfo Com_RxSigInfo[280].SignalProcessingOfRxSigInfo Com_RxSigInfo[280].ValidDlcOfRxSigInfo Com_RxSigInfo[281].RxAccessInfoIdxOfRxSigInfo Com_RxSigInfo[281].RxCbkFuncPtrAckIdxOfRxSigInfo Com_RxSigInfo[281].SignalProcessingOfRxSigInfo Com_RxSigInfo[281].ValidDlcOfRxSigInfo Com_RxSigInfo[282].RxAccessInfoIdxOfRxSigInfo Com_RxSigInfo[282].RxCbkFuncPtrAckIdxOfRxSigInfo Com_RxSigInfo[282].SignalProcessingOfRxSigInfo Com_RxSigInfo[282].ValidDlcOfRxSigInfo Com_RxSigInfo[283].RxAccessInfoIdxOfRxSigInfo Com_RxSigInfo[283].RxCbkFuncPtrAckIdxOfRxSigInfo Com_RxSigInfo[283].SignalProcessingOfRxSigInfo Com_RxSigInfo[283].ValidDlcOfRxSigInfo Com_RxSigInfo[284].RxAccessInfoIdxOfRxSigInfo Com_RxSigInfo[284].RxCbkFuncPtrAckIdxOfRxSigInfo Com_RxSigInfo[284].SignalProcessingOfRxSigInfo Com_RxSigInfo[284].ValidDlcOfRxSigInfo Com_RxSigInfo[285].RxAccessInfoIdxOfRxSigInfo Com_RxSigInfo[285].RxCbkFuncPtrAckIdxOfRxSigInfo Com_RxSigInfo[285].SignalProcessingOfRxSigInfo Com_RxSigInfo[285].ValidDlcOfRxSigInfo Com_RxSigInfo[286].RxAccessInfoIdxOfRxSigInfo Com_RxSigInfo[286].RxCbkFuncPtrAckIdxOfRxSigInfo Com_RxSigInfo[286].SignalProcessingOfRxSigInfo Com_RxSigInfo[286].ValidDlcOfRxSigInfo Com_RxSigInfo[287].RxAccessInfoIdxOfRxSigInfo Com_RxSigInfo[287].RxCbkFuncPtrAckIdxOfRxSigInfo Com_RxSigInfo[287].SignalProcessingOfRxSigInfo Com_RxSigInfo[287].ValidDlcOfRxSigInfo Com_RxSigInfo[288].RxAccessInfoIdxOfRxSigInfo Com_RxSigInfo[288].RxCbkFuncPtrAckIdxOfRxSigInfo Com_RxSigInfo[288].SignalProcessingOfRxSigInfo Com_RxSigInfo[288].ValidDlcOfRxSigInfo Com_RxSigInfo[289].RxAccessInfoIdxOfRxSigInfo Com_RxSigInfo[289].RxCbkFuncPtrAckIdxOfRxSigInfo Com_RxSigInfo[289].SignalProcessingOfRxSigInfo Com_RxSigInfo[289].ValidDlcOfRxSigInfo Com_RxSigInfo[28].RxAccessInfoIdxOfRxSigInfo Com_RxSigInfo[28].RxCbkFuncPtrAckIdxOfRxSigInfo Com_RxSigInfo[28].SignalProcessingOfRxSigInfo Com_RxSigInfo[28].ValidDlcOfRxSigInfo Com_RxSigInfo[290].RxAccessInfoIdxOfRxSigInfo Com_RxSigInfo[290].RxCbkFuncPtrAckIdxOfRxSigInfo Com_RxSigInfo[290].SignalProcessingOfRxSigInfo Com_RxSigInfo[290].ValidDlcOfRxSigInfo Com_RxSigInfo[291].RxAccessInfoIdxOfRxSigInfo Com_RxSigInfo[291].RxCbkFuncPtrAckIdxOfRxSigInfo Com_RxSigInfo[291].SignalProcessingOfRxSigInfo Com_RxSigInfo[291].ValidDlcOfRxSigInfo Com_RxSigInfo[292].RxAccessInfoIdxOfRxSigInfo Com_RxSigInfo[292].RxCbkFuncPtrAckIdxOfRxSigInfo Com_RxSigInfo[292].SignalProcessingOfRxSigInfo Com_RxSigInfo[292].ValidDlcOfRxSigInfo Com_RxSigInfo[293].RxAccessInfoIdxOfRxSigInfo Com_RxSigInfo[293].RxCbkFuncPtrAckIdxOfRxSigInfo Com_RxSigInfo[293].SignalProcessingOfRxSigInfo Com_RxSigInfo[293].ValidDlcOfRxSigInfo Com_RxSigInfo[294].RxAccessInfoIdxOfRxSigInfo Com_RxSigInfo[294].RxCbkFuncPtrAckIdxOfRxSigInfo Com_RxSigInfo[294].SignalProcessingOfRxSigInfo Com_RxSigInfo[294].ValidDlcOfRxSigInfo Com_RxSigInfo[295].RxAccessInfoIdxOfRxSigInfo Com_RxSigInfo[295].RxCbkFuncPtrAckIdxOfRxSigInfo Com_RxSigInfo[295].SignalProcessingOfRxSigInfo Com_RxSigInfo[295].ValidDlcOfRxSigInfo Com_RxSigInfo[296].RxAccessInfoIdxOfRxSigInfo Com_RxSigInfo[296].RxCbkFuncPtrAckIdxOfRxSigInfo Com_RxSigInfo[296].SignalProcessingOfRxSigInfo Com_RxSigInfo[296].ValidDlcOfRxSigInfo Com_RxSigInfo[297].RxAccessInfoIdxOfRxSigInfo Com_RxSigInfo[297].RxCbkFuncPtrAckIdxOfRxSigInfo Com_RxSigInfo[297].SignalProcessingOfRxSigInfo Com_RxSigInfo[297].ValidDlcOfRxSigInfo Com_RxSigInfo[298].RxAccessInfoIdxOfRxSigInfo Com_RxSigInfo[298].RxCbkFuncPtrAckIdxOfRxSigInfo Com_RxSigInfo[298].SignalProcessingOfRxSigInfo Com_RxSigInfo[298].ValidDlcOfRxSigInfo Com_RxSigInfo[299].RxAccessInfoIdxOfRxSigInfo Com_RxSigInfo[299].RxCbkFuncPtrAckIdxOfRxSigInfo Com_RxSigInfo[299].SignalProcessingOfRxSigInfo Com_RxSigInfo[299].ValidDlcOfRxSigInfo Com_RxSigInfo[29].RxAccessInfoIdxOfRxSigInfo Com_RxSigInfo[29].RxCbkFuncPtrAckIdxOfRxSigInfo Com_RxSigInfo[29].SignalProcessingOfRxSigInfo Com_RxSigInfo[29].ValidDlcOfRxSigInfo Com_RxSigInfo[2].RxAccessInfoIdxOfRxSigInfo Com_RxSigInfo[2].RxCbkFuncPtrAckIdxOfRxSigInfo Com_RxSigInfo[2].SignalProcessingOfRxSigInfo Com_RxSigInfo[2].ValidDlcOfRxSigInfo Com_RxSigInfo[300].RxAccessInfoIdxOfRxSigInfo Com_RxSigInfo[300].RxCbkFuncPtrAckIdxOfRxSigInfo Com_RxSigInfo[300].SignalProcessingOfRxSigInfo Com_RxSigInfo[300].ValidDlcOfRxSigInfo Com_RxSigInfo[301].RxAccessInfoIdxOfRxSigInfo Com_RxSigInfo[301].RxCbkFuncPtrAckIdxOfRxSigInfo Com_RxSigInfo[301].SignalProcessingOfRxSigInfo Com_RxSigInfo[301].ValidDlcOfRxSigInfo Com_RxSigInfo[302].RxAccessInfoIdxOfRxSigInfo Com_RxSigInfo[302].RxCbkFuncPtrAckIdxOfRxSigInfo Com_RxSigInfo[302].SignalProcessingOfRxSigInfo Com_RxSigInfo[302].ValidDlcOfRxSigInfo Com_RxSigInfo[303].RxAccessInfoIdxOfRxSigInfo Com_RxSigInfo[303].RxCbkFuncPtrAckIdxOfRxSigInfo Com_RxSigInfo[303].SignalProcessingOfRxSigInfo Com_RxSigInfo[303].ValidDlcOfRxSigInfo Com_RxSigInfo[304].RxAccessInfoIdxOfRxSigInfo Com_RxSigInfo[304].RxCbkFuncPtrAckIdxOfRxSigInfo Com_RxSigInfo[304].SignalProcessingOfRxSigInfo Com_RxSigInfo[304].ValidDlcOfRxSigInfo Com_RxSigInfo[305].RxAccessInfoIdxOfRxSigInfo Com_RxSigInfo[305].RxCbkFuncPtrAckIdxOfRxSigInfo Com_RxSigInfo[305].SignalProcessingOfRxSigInfo Com_RxSigInfo[305].ValidDlcOfRxSigInfo Com_RxSigInfo[306].RxAccessInfoIdxOfRxSigInfo Com_RxSigInfo[306].RxCbkFuncPtrAckIdxOfRxSigInfo Com_RxSigInfo[306].SignalProcessingOfRxSigInfo Com_RxSigInfo[306].ValidDlcOfRxSigInfo Com_RxSigInfo[307].RxAccessInfoIdxOfRxSigInfo Com_RxSigInfo[307].RxCbkFuncPtrAckIdxOfRxSigInfo Com_RxSigInfo[307].SignalProcessingOfRxSigInfo Com_RxSigInfo[307].ValidDlcOfRxSigInfo Com_RxSigInfo[308].RxAccessInfoIdxOfRxSigInfo Com_RxSigInfo[308].RxCbkFuncPtrAckIdxOfRxSigInfo Com_RxSigInfo[308].SignalProcessingOfRxSigInfo Com_RxSigInfo[308].ValidDlcOfRxSigInfo Com_RxSigInfo[309].RxAccessInfoIdxOfRxSigInfo Com_RxSigInfo[309].RxCbkFuncPtrAckIdxOfRxSigInfo Com_RxSigInfo[309].SignalProcessingOfRxSigInfo Com_RxSigInfo[309].ValidDlcOfRxSigInfo Com_RxSigInfo[30].RxAccessInfoIdxOfRxSigInfo Com_RxSigInfo[30].RxCbkFuncPtrAckIdxOfRxSigInfo Com_RxSigInfo[30].SignalProcessingOfRxSigInfo Com_RxSigInfo[30].ValidDlcOfRxSigInfo Com_RxSigInfo[310].RxAccessInfoIdxOfRxSigInfo Com_RxSigInfo[310].RxCbkFuncPtrAckIdxOfRxSigInfo Com_RxSigInfo[310].SignalProcessingOfRxSigInfo Com_RxSigInfo[310].ValidDlcOfRxSigInfo Com_RxSigInfo[311].RxAccessInfoIdxOfRxSigInfo Com_RxSigInfo[311].RxCbkFuncPtrAckIdxOfRxSigInfo Com_RxSigInfo[311].SignalProcessingOfRxSigInfo Com_RxSigInfo[311].ValidDlcOfRxSigInfo Com_RxSigInfo[312].RxAccessInfoIdxOfRxSigInfo Com_RxSigInfo[312].RxCbkFuncPtrAckIdxOfRxSigInfo Com_RxSigInfo[312].SignalProcessingOfRxSigInfo Com_RxSigInfo[312].ValidDlcOfRxSigInfo Com_RxSigInfo[313].RxAccessInfoIdxOfRxSigInfo Com_RxSigInfo[313].RxCbkFuncPtrAckIdxOfRxSigInfo Com_RxSigInfo[313].SignalProcessingOfRxSigInfo Com_RxSigInfo[313].ValidDlcOfRxSigInfo Com_RxSigInfo[314].RxAccessInfoIdxOfRxSigInfo Com_RxSigInfo[314].RxCbkFuncPtrAckIdxOfRxSigInfo Com_RxSigInfo[314].SignalProcessingOfRxSigInfo Com_RxSigInfo[314].ValidDlcOfRxSigInfo Com_RxSigInfo[315].RxAccessInfoIdxOfRxSigInfo Com_RxSigInfo[315].RxCbkFuncPtrAckIdxOfRxSigInfo Com_RxSigInfo[315].SignalProcessingOfRxSigInfo Com_RxSigInfo[315].ValidDlcOfRxSigInfo Com_RxSigInfo[316].RxAccessInfoIdxOfRxSigInfo Com_RxSigInfo[316].RxCbkFuncPtrAckIdxOfRxSigInfo Com_RxSigInfo[316].SignalProcessingOfRxSigInfo Com_RxSigInfo[316].ValidDlcOfRxSigInfo Com_RxSigInfo[317].RxAccessInfoIdxOfRxSigInfo Com_RxSigInfo[317].RxCbkFuncPtrAckIdxOfRxSigInfo Com_RxSigInfo[317].SignalProcessingOfRxSigInfo Com_RxSigInfo[317].ValidDlcOfRxSigInfo Com_RxSigInfo[318].RxAccessInfoIdxOfRxSigInfo Com_RxSigInfo[318].RxCbkFuncPtrAckIdxOfRxSigInfo Com_RxSigInfo[318].SignalProcessingOfRxSigInfo Com_RxSigInfo[318].ValidDlcOfRxSigInfo Com_RxSigInfo[319].RxAccessInfoIdxOfRxSigInfo Com_RxSigInfo[319].RxCbkFuncPtrAckIdxOfRxSigInfo Com_RxSigInfo[319].SignalProcessingOfRxSigInfo Com_RxSigInfo[319].ValidDlcOfRxSigInfo Com_RxSigInfo[31].RxAccessInfoIdxOfRxSigInfo Com_RxSigInfo[31].RxCbkFuncPtrAckIdxOfRxSigInfo Com_RxSigInfo[31].SignalProcessingOfRxSigInfo Com_RxSigInfo[31].ValidDlcOfRxSigInfo Com_RxSigInfo[320].RxAccessInfoIdxOfRxSigInfo Com_RxSigInfo[320].RxCbkFuncPtrAckIdxOfRxSigInfo Com_RxSigInfo[320].SignalProcessingOfRxSigInfo Com_RxSigInfo[320].ValidDlcOfRxSigInfo Com_RxSigInfo[321].RxAccessInfoIdxOfRxSigInfo Com_RxSigInfo[321].RxCbkFuncPtrAckIdxOfRxSigInfo Com_RxSigInfo[321].SignalProcessingOfRxSigInfo Com_RxSigInfo[321].ValidDlcOfRxSigInfo Com_RxSigInfo[322].RxAccessInfoIdxOfRxSigInfo Com_RxSigInfo[322].RxCbkFuncPtrAckIdxOfRxSigInfo Com_RxSigInfo[322].SignalProcessingOfRxSigInfo Com_RxSigInfo[322].ValidDlcOfRxSigInfo Com_RxSigInfo[323].RxAccessInfoIdxOfRxSigInfo Com_RxSigInfo[323].RxCbkFuncPtrAckIdxOfRxSigInfo Com_RxSigInfo[323].SignalProcessingOfRxSigInfo Com_RxSigInfo[323].ValidDlcOfRxSigInfo Com_RxSigInfo[324].RxAccessInfoIdxOfRxSigInfo Com_RxSigInfo[324].RxCbkFuncPtrAckIdxOfRxSigInfo Com_RxSigInfo[324].SignalProcessingOfRxSigInfo Com_RxSigInfo[324].ValidDlcOfRxSigInfo Com_RxSigInfo[325].RxAccessInfoIdxOfRxSigInfo Com_RxSigInfo[325].RxCbkFuncPtrAckIdxOfRxSigInfo Com_RxSigInfo[325].SignalProcessingOfRxSigInfo Com_RxSigInfo[325].ValidDlcOfRxSigInfo Com_RxSigInfo[326].RxAccessInfoIdxOfRxSigInfo Com_RxSigInfo[326].RxCbkFuncPtrAckIdxOfRxSigInfo Com_RxSigInfo[326].SignalProcessingOfRxSigInfo Com_RxSigInfo[326].ValidDlcOfRxSigInfo Com_RxSigInfo[327].RxAccessInfoIdxOfRxSigInfo Com_RxSigInfo[327].RxCbkFuncPtrAckIdxOfRxSigInfo Com_RxSigInfo[327].SignalProcessingOfRxSigInfo Com_RxSigInfo[327].ValidDlcOfRxSigInfo Com_RxSigInfo[328].RxAccessInfoIdxOfRxSigInfo Com_RxSigInfo[328].RxCbkFuncPtrAckIdxOfRxSigInfo Com_RxSigInfo[328].SignalProcessingOfRxSigInfo Com_RxSigInfo[328].ValidDlcOfRxSigInfo Com_RxSigInfo[329].RxAccessInfoIdxOfRxSigInfo Com_RxSigInfo[329].RxCbkFuncPtrAckIdxOfRxSigInfo Com_RxSigInfo[329].SignalProcessingOfRxSigInfo Com_RxSigInfo[329].ValidDlcOfRxSigInfo Com_RxSigInfo[32].RxAccessInfoIdxOfRxSigInfo Com_RxSigInfo[32].RxCbkFuncPtrAckIdxOfRxSigInfo Com_RxSigInfo[32].SignalProcessingOfRxSigInfo Com_RxSigInfo[32].ValidDlcOfRxSigInfo Com_RxSigInfo[330].RxAccessInfoIdxOfRxSigInfo Com_RxSigInfo[330].RxCbkFuncPtrAckIdxOfRxSigInfo Com_RxSigInfo[330].SignalProcessingOfRxSigInfo Com_RxSigInfo[330].ValidDlcOfRxSigInfo Com_RxSigInfo[331].RxAccessInfoIdxOfRxSigInfo Com_RxSigInfo[331].RxCbkFuncPtrAckIdxOfRxSigInfo Com_RxSigInfo[331].SignalProcessingOfRxSigInfo Com_RxSigInfo[331].ValidDlcOfRxSigInfo Com_RxSigInfo[332].RxAccessInfoIdxOfRxSigInfo Com_RxSigInfo[332].RxCbkFuncPtrAckIdxOfRxSigInfo Com_RxSigInfo[332].SignalProcessingOfRxSigInfo Com_RxSigInfo[332].ValidDlcOfRxSigInfo Com_RxSigInfo[333].RxAccessInfoIdxOfRxSigInfo Com_RxSigInfo[333].RxCbkFuncPtrAckIdxOfRxSigInfo Com_RxSigInfo[333].SignalProcessingOfRxSigInfo Com_RxSigInfo[333].ValidDlcOfRxSigInfo Com_RxSigInfo[334].RxAccessInfoIdxOfRxSigInfo Com_RxSigInfo[334].RxCbkFuncPtrAckIdxOfRxSigInfo Com_RxSigInfo[334].SignalProcessingOfRxSigInfo Com_RxSigInfo[334].ValidDlcOfRxSigInfo Com_RxSigInfo[335].RxAccessInfoIdxOfRxSigInfo Com_RxSigInfo[335].RxCbkFuncPtrAckIdxOfRxSigInfo Com_RxSigInfo[335].SignalProcessingOfRxSigInfo Com_RxSigInfo[335].ValidDlcOfRxSigInfo Com_RxSigInfo[336].RxAccessInfoIdxOfRxSigInfo Com_RxSigInfo[336].RxCbkFuncPtrAckIdxOfRxSigInfo Com_RxSigInfo[336].SignalProcessingOfRxSigInfo Com_RxSigInfo[336].ValidDlcOfRxSigInfo Com_RxSigInfo[337].RxAccessInfoIdxOfRxSigInfo Com_RxSigInfo[337].RxCbkFuncPtrAckIdxOfRxSigInfo Com_RxSigInfo[337].SignalProcessingOfRxSigInfo Com_RxSigInfo[337].ValidDlcOfRxSigInfo Com_RxSigInfo[338].RxAccessInfoIdxOfRxSigInfo Com_RxSigInfo[338].RxCbkFuncPtrAckIdxOfRxSigInfo Com_RxSigInfo[338].SignalProcessingOfRxSigInfo Com_RxSigInfo[338].ValidDlcOfRxSigInfo Com_RxSigInfo[339].RxAccessInfoIdxOfRxSigInfo Com_RxSigInfo[339].RxCbkFuncPtrAckIdxOfRxSigInfo Com_RxSigInfo[339].SignalProcessingOfRxSigInfo Com_RxSigInfo[339].ValidDlcOfRxSigInfo Com_RxSigInfo[33].RxAccessInfoIdxOfRxSigInfo Com_RxSigInfo[33].RxCbkFuncPtrAckIdxOfRxSigInfo Com_RxSigInfo[33].SignalProcessingOfRxSigInfo Com_RxSigInfo[33].ValidDlcOfRxSigInfo Com_RxSigInfo[340].RxAccessInfoIdxOfRxSigInfo Com_RxSigInfo[340].RxCbkFuncPtrAckIdxOfRxSigInfo Com_RxSigInfo[340].SignalProcessingOfRxSigInfo Com_RxSigInfo[340].ValidDlcOfRxSigInfo Com_RxSigInfo[341].RxAccessInfoIdxOfRxSigInfo Com_RxSigInfo[341].RxCbkFuncPtrAckIdxOfRxSigInfo Com_RxSigInfo[341].SignalProcessingOfRxSigInfo Com_RxSigInfo[341].ValidDlcOfRxSigInfo Com_RxSigInfo[342].RxAccessInfoIdxOfRxSigInfo Com_RxSigInfo[342].RxCbkFuncPtrAckIdxOfRxSigInfo Com_RxSigInfo[342].SignalProcessingOfRxSigInfo Com_RxSigInfo[342].ValidDlcOfRxSigInfo Com_RxSigInfo[343].RxAccessInfoIdxOfRxSigInfo Com_RxSigInfo[343].RxCbkFuncPtrAckIdxOfRxSigInfo Com_RxSigInfo[343].SignalProcessingOfRxSigInfo Com_RxSigInfo[343].ValidDlcOfRxSigInfo Com_RxSigInfo[344].RxAccessInfoIdxOfRxSigInfo Com_RxSigInfo[344].RxCbkFuncPtrAckIdxOfRxSigInfo Com_RxSigInfo[344].SignalProcessingOfRxSigInfo Com_RxSigInfo[344].ValidDlcOfRxSigInfo Com_RxSigInfo[345].RxAccessInfoIdxOfRxSigInfo Com_RxSigInfo[345].RxCbkFuncPtrAckIdxOfRxSigInfo Com_RxSigInfo[345].SignalProcessingOfRxSigInfo Com_RxSigInfo[345].ValidDlcOfRxSigInfo Com_RxSigInfo[346].RxAccessInfoIdxOfRxSigInfo Com_RxSigInfo[346].RxCbkFuncPtrAckIdxOfRxSigInfo Com_RxSigInfo[346].SignalProcessingOfRxSigInfo Com_RxSigInfo[346].ValidDlcOfRxSigInfo Com_RxSigInfo[347].RxAccessInfoIdxOfRxSigInfo Com_RxSigInfo[347].RxCbkFuncPtrAckIdxOfRxSigInfo Com_RxSigInfo[347].SignalProcessingOfRxSigInfo Com_RxSigInfo[347].ValidDlcOfRxSigInfo Com_RxSigInfo[348].RxAccessInfoIdxOfRxSigInfo Com_RxSigInfo[348].RxCbkFuncPtrAckIdxOfRxSigInfo Com_RxSigInfo[348].SignalProcessingOfRxSigInfo Com_RxSigInfo[348].ValidDlcOfRxSigInfo Com_RxSigInfo[349].RxAccessInfoIdxOfRxSigInfo Com_RxSigInfo[349].RxCbkFuncPtrAckIdxOfRxSigInfo Com_RxSigInfo[349].SignalProcessingOfRxSigInfo Com_RxSigInfo[349].ValidDlcOfRxSigInfo Com_RxSigInfo[34].RxAccessInfoIdxOfRxSigInfo Com_RxSigInfo[34].RxCbkFuncPtrAckIdxOfRxSigInfo Com_RxSigInfo[34].SignalProcessingOfRxSigInfo Com_RxSigInfo[34].ValidDlcOfRxSigInfo Com_RxSigInfo[350].RxAccessInfoIdxOfRxSigInfo Com_RxSigInfo[350].RxCbkFuncPtrAckIdxOfRxSigInfo Com_RxSigInfo[350].SignalProcessingOfRxSigInfo Com_RxSigInfo[350].ValidDlcOfRxSigInfo Com_RxSigInfo[351].RxAccessInfoIdxOfRxSigInfo Com_RxSigInfo[351].RxCbkFuncPtrAckIdxOfRxSigInfo Com_RxSigInfo[351].SignalProcessingOfRxSigInfo Com_RxSigInfo[351].ValidDlcOfRxSigInfo Com_RxSigInfo[352].RxAccessInfoIdxOfRxSigInfo Com_RxSigInfo[352].RxCbkFuncPtrAckIdxOfRxSigInfo Com_RxSigInfo[352].SignalProcessingOfRxSigInfo Com_RxSigInfo[352].ValidDlcOfRxSigInfo Com_RxSigInfo[353].RxAccessInfoIdxOfRxSigInfo Com_RxSigInfo[353].RxCbkFuncPtrAckIdxOfRxSigInfo Com_RxSigInfo[353].SignalProcessingOfRxSigInfo Com_RxSigInfo[353].ValidDlcOfRxSigInfo Com_RxSigInfo[354].RxAccessInfoIdxOfRxSigInfo Com_RxSigInfo[354].RxCbkFuncPtrAckIdxOfRxSigInfo Com_RxSigInfo[354].SignalProcessingOfRxSigInfo Com_RxSigInfo[354].ValidDlcOfRxSigInfo Com_RxSigInfo[355].RxAccessInfoIdxOfRxSigInfo Com_RxSigInfo[355].RxCbkFuncPtrAckIdxOfRxSigInfo Com_RxSigInfo[355].SignalProcessingOfRxSigInfo Com_RxSigInfo[355].ValidDlcOfRxSigInfo Com_RxSigInfo[356].RxAccessInfoIdxOfRxSigInfo Com_RxSigInfo[356].RxCbkFuncPtrAckIdxOfRxSigInfo Com_RxSigInfo[356].SignalProcessingOfRxSigInfo Com_RxSigInfo[356].ValidDlcOfRxSigInfo Com_RxSigInfo[357].RxAccessInfoIdxOfRxSigInfo Com_RxSigInfo[357].RxCbkFuncPtrAckIdxOfRxSigInfo Com_RxSigInfo[357].SignalProcessingOfRxSigInfo Com_RxSigInfo[357].ValidDlcOfRxSigInfo Com_RxSigInfo[358].RxAccessInfoIdxOfRxSigInfo Com_RxSigInfo[358].RxCbkFuncPtrAckIdxOfRxSigInfo Com_RxSigInfo[358].SignalProcessingOfRxSigInfo Com_RxSigInfo[358].ValidDlcOfRxSigInfo Com_RxSigInfo[359].RxAccessInfoIdxOfRxSigInfo Com_RxSigInfo[359].RxCbkFuncPtrAckIdxOfRxSigInfo Com_RxSigInfo[359].SignalProcessingOfRxSigInfo Com_RxSigInfo[359].ValidDlcOfRxSigInfo Com_RxSigInfo[35].RxAccessInfoIdxOfRxSigInfo Com_RxSigInfo[35].RxCbkFuncPtrAckIdxOfRxSigInfo Com_RxSigInfo[35].SignalProcessingOfRxSigInfo Com_RxSigInfo[35].ValidDlcOfRxSigInfo Com_RxSigInfo[360].RxAccessInfoIdxOfRxSigInfo Com_RxSigInfo[360].RxCbkFuncPtrAckIdxOfRxSigInfo Com_RxSigInfo[360].SignalProcessingOfRxSigInfo Com_RxSigInfo[360].ValidDlcOfRxSigInfo Com_RxSigInfo[361].RxAccessInfoIdxOfRxSigInfo Com_RxSigInfo[361].RxCbkFuncPtrAckIdxOfRxSigInfo Com_RxSigInfo[361].SignalProcessingOfRxSigInfo Com_RxSigInfo[361].ValidDlcOfRxSigInfo Com_RxSigInfo[362].RxAccessInfoIdxOfRxSigInfo Com_RxSigInfo[362].RxCbkFuncPtrAckIdxOfRxSigInfo Com_RxSigInfo[362].SignalProcessingOfRxSigInfo Com_RxSigInfo[362].ValidDlcOfRxSigInfo Com_RxSigInfo[36].RxAccessInfoIdxOfRxSigInfo Com_RxSigInfo[36].RxCbkFuncPtrAckIdxOfRxSigInfo Com_RxSigInfo[36].SignalProcessingOfRxSigInfo Com_RxSigInfo[36].ValidDlcOfRxSigInfo Com_RxSigInfo[37].RxAccessInfoIdxOfRxSigInfo Com_RxSigInfo[37].RxCbkFuncPtrAckIdxOfRxSigInfo Com_RxSigInfo[37].SignalProcessingOfRxSigInfo Com_RxSigInfo[37].ValidDlcOfRxSigInfo Com_RxSigInfo[38].RxAccessInfoIdxOfRxSigInfo Com_RxSigInfo[38].RxCbkFuncPtrAckIdxOfRxSigInfo Com_RxSigInfo[38].SignalProcessingOfRxSigInfo Com_RxSigInfo[38].ValidDlcOfRxSigInfo Com_RxSigInfo[39].RxAccessInfoIdxOfRxSigInfo Com_RxSigInfo[39].RxCbkFuncPtrAckIdxOfRxSigInfo Com_RxSigInfo[39].SignalProcessingOfRxSigInfo Com_RxSigInfo[39].ValidDlcOfRxSigInfo Com_RxSigInfo[3].RxAccessInfoIdxOfRxSigInfo Com_RxSigInfo[3].RxCbkFuncPtrAckIdxOfRxSigInfo Com_RxSigInfo[3].SignalProcessingOfRxSigInfo Com_RxSigInfo[3].ValidDlcOfRxSigInfo Com_RxSigInfo[40].RxAccessInfoIdxOfRxSigInfo Com_RxSigInfo[40].RxCbkFuncPtrAckIdxOfRxSigInfo Com_RxSigInfo[40].SignalProcessingOfRxSigInfo Com_RxSigInfo[40].ValidDlcOfRxSigInfo Com_RxSigInfo[41].RxAccessInfoIdxOfRxSigInfo Com_RxSigInfo[41].RxCbkFuncPtrAckIdxOfRxSigInfo Com_RxSigInfo[41].SignalProcessingOfRxSigInfo Com_RxSigInfo[41].ValidDlcOfRxSigInfo Com_RxSigInfo[42].RxAccessInfoIdxOfRxSigInfo Com_RxSigInfo[42].RxCbkFuncPtrAckIdxOfRxSigInfo Com_RxSigInfo[42].SignalProcessingOfRxSigInfo Com_RxSigInfo[42].ValidDlcOfRxSigInfo Com_RxSigInfo[43].RxAccessInfoIdxOfRxSigInfo Com_RxSigInfo[43].RxCbkFuncPtrAckIdxOfRxSigInfo Com_RxSigInfo[43].SignalProcessingOfRxSigInfo Com_RxSigInfo[43].ValidDlcOfRxSigInfo Com_RxSigInfo[44].RxAccessInfoIdxOfRxSigInfo Com_RxSigInfo[44].RxCbkFuncPtrAckIdxOfRxSigInfo Com_RxSigInfo[44].SignalProcessingOfRxSigInfo Com_RxSigInfo[44].ValidDlcOfRxSigInfo Com_RxSigInfo[45].RxAccessInfoIdxOfRxSigInfo Com_RxSigInfo[45].RxCbkFuncPtrAckIdxOfRxSigInfo Com_RxSigInfo[45].SignalProcessingOfRxSigInfo Com_RxSigInfo[45].ValidDlcOfRxSigInfo Com_RxSigInfo[46].RxAccessInfoIdxOfRxSigInfo Com_RxSigInfo[46].RxCbkFuncPtrAckIdxOfRxSigInfo Com_RxSigInfo[46].SignalProcessingOfRxSigInfo Com_RxSigInfo[46].ValidDlcOfRxSigInfo Com_RxSigInfo[47].RxAccessInfoIdxOfRxSigInfo Com_RxSigInfo[47].RxCbkFuncPtrAckIdxOfRxSigInfo Com_RxSigInfo[47].SignalProcessingOfRxSigInfo Com_RxSigInfo[47].ValidDlcOfRxSigInfo Com_RxSigInfo[48].RxAccessInfoIdxOfRxSigInfo Com_RxSigInfo[48].RxCbkFuncPtrAckIdxOfRxSigInfo Com_RxSigInfo[48].SignalProcessingOfRxSigInfo Com_RxSigInfo[48].ValidDlcOfRxSigInfo Com_RxSigInfo[49].RxAccessInfoIdxOfRxSigInfo Com_RxSigInfo[49].RxCbkFuncPtrAckIdxOfRxSigInfo Com_RxSigInfo[49].SignalProcessingOfRxSigInfo Com_RxSigInfo[49].ValidDlcOfRxSigInfo Com_RxSigInfo[4].RxAccessInfoIdxOfRxSigInfo Com_RxSigInfo[4].RxCbkFuncPtrAckIdxOfRxSigInfo Com_RxSigInfo[4].SignalProcessingOfRxSigInfo Com_RxSigInfo[4].ValidDlcOfRxSigInfo Com_RxSigInfo[50].RxAccessInfoIdxOfRxSigInfo Com_RxSigInfo[50].RxCbkFuncPtrAckIdxOfRxSigInfo Com_RxSigInfo[50].SignalProcessingOfRxSigInfo Com_RxSigInfo[50].ValidDlcOfRxSigInfo Com_RxSigInfo[51].RxAccessInfoIdxOfRxSigInfo Com_RxSigInfo[51].RxCbkFuncPtrAckIdxOfRxSigInfo Com_RxSigInfo[51].SignalProcessingOfRxSigInfo Com_RxSigInfo[51].ValidDlcOfRxSigInfo Com_RxSigInfo[52].RxAccessInfoIdxOfRxSigInfo Com_RxSigInfo[52].RxCbkFuncPtrAckIdxOfRxSigInfo Com_RxSigInfo[52].SignalProcessingOfRxSigInfo Com_RxSigInfo[52].ValidDlcOfRxSigInfo Com_RxSigInfo[53].RxAccessInfoIdxOfRxSigInfo Com_RxSigInfo[53].RxCbkFuncPtrAckIdxOfRxSigInfo Com_RxSigInfo[53].SignalProcessingOfRxSigInfo Com_RxSigInfo[53].ValidDlcOfRxSigInfo Com_RxSigInfo[54].RxAccessInfoIdxOfRxSigInfo Com_RxSigInfo[54].RxCbkFuncPtrAckIdxOfRxSigInfo Com_RxSigInfo[54].SignalProcessingOfRxSigInfo Com_RxSigInfo[54].ValidDlcOfRxSigInfo Com_RxSigInfo[55].RxAccessInfoIdxOfRxSigInfo Com_RxSigInfo[55].RxCbkFuncPtrAckIdxOfRxSigInfo Com_RxSigInfo[55].SignalProcessingOfRxSigInfo Com_RxSigInfo[55].ValidDlcOfRxSigInfo Com_RxSigInfo[56].RxAccessInfoIdxOfRxSigInfo Com_RxSigInfo[56].RxCbkFuncPtrAckIdxOfRxSigInfo Com_RxSigInfo[56].SignalProcessingOfRxSigInfo Com_RxSigInfo[56].ValidDlcOfRxSigInfo Com_RxSigInfo[57].RxAccessInfoIdxOfRxSigInfo Com_RxSigInfo[57].RxCbkFuncPtrAckIdxOfRxSigInfo Com_RxSigInfo[57].SignalProcessingOfRxSigInfo Com_RxSigInfo[57].ValidDlcOfRxSigInfo Com_RxSigInfo[58].RxAccessInfoIdxOfRxSigInfo Com_RxSigInfo[58].RxCbkFuncPtrAckIdxOfRxSigInfo Com_RxSigInfo[58].SignalProcessingOfRxSigInfo Com_RxSigInfo[58].ValidDlcOfRxSigInfo Com_RxSigInfo[59].RxAccessInfoIdxOfRxSigInfo Com_RxSigInfo[59].RxCbkFuncPtrAckIdxOfRxSigInfo Com_RxSigInfo[59].SignalProcessingOfRxSigInfo Com_RxSigInfo[59].ValidDlcOfRxSigInfo Com_RxSigInfo[5].RxAccessInfoIdxOfRxSigInfo Com_RxSigInfo[5].RxCbkFuncPtrAckIdxOfRxSigInfo Com_RxSigInfo[5].SignalProcessingOfRxSigInfo Com_RxSigInfo[5].ValidDlcOfRxSigInfo Com_RxSigInfo[60].RxAccessInfoIdxOfRxSigInfo Com_RxSigInfo[60].RxCbkFuncPtrAckIdxOfRxSigInfo Com_RxSigInfo[60].SignalProcessingOfRxSigInfo Com_RxSigInfo[60].ValidDlcOfRxSigInfo Com_RxSigInfo[61].RxAccessInfoIdxOfRxSigInfo Com_RxSigInfo[61].RxCbkFuncPtrAckIdxOfRxSigInfo Com_RxSigInfo[61].SignalProcessingOfRxSigInfo Com_RxSigInfo[61].ValidDlcOfRxSigInfo Com_RxSigInfo[62].RxAccessInfoIdxOfRxSigInfo Com_RxSigInfo[62].RxCbkFuncPtrAckIdxOfRxSigInfo Com_RxSigInfo[62].SignalProcessingOfRxSigInfo Com_RxSigInfo[62].ValidDlcOfRxSigInfo Com_RxSigInfo[63].RxAccessInfoIdxOfRxSigInfo Com_RxSigInfo[63].RxCbkFuncPtrAckIdxOfRxSigInfo Com_RxSigInfo[63].SignalProcessingOfRxSigInfo Com_RxSigInfo[63].ValidDlcOfRxSigInfo Com_RxSigInfo[64].RxAccessInfoIdxOfRxSigInfo Com_RxSigInfo[64].RxCbkFuncPtrAckIdxOfRxSigInfo Com_RxSigInfo[64].SignalProcessingOfRxSigInfo Com_RxSigInfo[64].ValidDlcOfRxSigInfo Com_RxSigInfo[65].RxAccessInfoIdxOfRxSigInfo Com_RxSigInfo[65].RxCbkFuncPtrAckIdxOfRxSigInfo Com_RxSigInfo[65].SignalProcessingOfRxSigInfo Com_RxSigInfo[65].ValidDlcOfRxSigInfo Com_RxSigInfo[66].RxAccessInfoIdxOfRxSigInfo Com_RxSigInfo[66].RxCbkFuncPtrAckIdxOfRxSigInfo Com_RxSigInfo[66].SignalProcessingOfRxSigInfo Com_RxSigInfo[66].ValidDlcOfRxSigInfo Com_RxSigInfo[67].RxAccessInfoIdxOfRxSigInfo Com_RxSigInfo[67].RxCbkFuncPtrAckIdxOfRxSigInfo Com_RxSigInfo[67].SignalProcessingOfRxSigInfo Com_RxSigInfo[67].ValidDlcOfRxSigInfo Com_RxSigInfo[68].RxAccessInfoIdxOfRxSigInfo Com_RxSigInfo[68].RxCbkFuncPtrAckIdxOfRxSigInfo Com_RxSigInfo[68].SignalProcessingOfRxSigInfo Com_RxSigInfo[68].ValidDlcOfRxSigInfo Com_RxSigInfo[69].RxAccessInfoIdxOfRxSigInfo Com_RxSigInfo[69].RxCbkFuncPtrAckIdxOfRxSigInfo Com_RxSigInfo[69].SignalProcessingOfRxSigInfo Com_RxSigInfo[69].ValidDlcOfRxSigInfo Com_RxSigInfo[6].RxAccessInfoIdxOfRxSigInfo Com_RxSigInfo[6].RxCbkFuncPtrAckIdxOfRxSigInfo Com_RxSigInfo[6].SignalProcessingOfRxSigInfo Com_RxSigInfo[6].ValidDlcOfRxSigInfo Com_RxSigInfo[70].RxAccessInfoIdxOfRxSigInfo Com_RxSigInfo[70].RxCbkFuncPtrAckIdxOfRxSigInfo Com_RxSigInfo[70].SignalProcessingOfRxSigInfo Com_RxSigInfo[70].ValidDlcOfRxSigInfo Com_RxSigInfo[71].RxAccessInfoIdxOfRxSigInfo Com_RxSigInfo[71].RxCbkFuncPtrAckIdxOfRxSigInfo Com_RxSigInfo[71].SignalProcessingOfRxSigInfo Com_RxSigInfo[71].ValidDlcOfRxSigInfo Com_RxSigInfo[72].RxAccessInfoIdxOfRxSigInfo Com_RxSigInfo[72].RxCbkFuncPtrAckIdxOfRxSigInfo Com_RxSigInfo[72].SignalProcessingOfRxSigInfo Com_RxSigInfo[72].ValidDlcOfRxSigInfo Com_RxSigInfo[73].RxAccessInfoIdxOfRxSigInfo Com_RxSigInfo[73].RxCbkFuncPtrAckIdxOfRxSigInfo Com_RxSigInfo[73].SignalProcessingOfRxSigInfo Com_RxSigInfo[73].ValidDlcOfRxSigInfo Com_RxSigInfo[74].RxAccessInfoIdxOfRxSigInfo Com_RxSigInfo[74].RxCbkFuncPtrAckIdxOfRxSigInfo Com_RxSigInfo[74].SignalProcessingOfRxSigInfo Com_RxSigInfo[74].ValidDlcOfRxSigInfo Com_RxSigInfo[75].RxAccessInfoIdxOfRxSigInfo Com_RxSigInfo[75].RxCbkFuncPtrAckIdxOfRxSigInfo Com_RxSigInfo[75].SignalProcessingOfRxSigInfo Com_RxSigInfo[75].ValidDlcOfRxSigInfo Com_RxSigInfo[76].RxAccessInfoIdxOfRxSigInfo Com_RxSigInfo[76].RxCbkFuncPtrAckIdxOfRxSigInfo Com_RxSigInfo[76].SignalProcessingOfRxSigInfo Com_RxSigInfo[76].ValidDlcOfRxSigInfo Com_RxSigInfo[77].RxAccessInfoIdxOfRxSigInfo Com_RxSigInfo[77].RxCbkFuncPtrAckIdxOfRxSigInfo Com_RxSigInfo[77].SignalProcessingOfRxSigInfo Com_RxSigInfo[77].ValidDlcOfRxSigInfo Com_RxSigInfo[78].RxAccessInfoIdxOfRxSigInfo Com_RxSigInfo[78].RxCbkFuncPtrAckIdxOfRxSigInfo Com_RxSigInfo[78].SignalProcessingOfRxSigInfo Com_RxSigInfo[78].ValidDlcOfRxSigInfo Com_RxSigInfo[79].RxAccessInfoIdxOfRxSigInfo Com_RxSigInfo[79].RxCbkFuncPtrAckIdxOfRxSigInfo Com_RxSigInfo[79].SignalProcessingOfRxSigInfo Com_RxSigInfo[79].ValidDlcOfRxSigInfo Com_RxSigInfo[7].RxAccessInfoIdxOfRxSigInfo Com_RxSigInfo[7].RxCbkFuncPtrAckIdxOfRxSigInfo Com_RxSigInfo[7].SignalProcessingOfRxSigInfo Com_RxSigInfo[7].ValidDlcOfRxSigInfo Com_RxSigInfo[80].RxAccessInfoIdxOfRxSigInfo Com_RxSigInfo[80].RxCbkFuncPtrAckIdxOfRxSigInfo Com_RxSigInfo[80].SignalProcessingOfRxSigInfo Com_RxSigInfo[80].ValidDlcOfRxSigInfo Com_RxSigInfo[81].RxAccessInfoIdxOfRxSigInfo Com_RxSigInfo[81].RxCbkFuncPtrAckIdxOfRxSigInfo Com_RxSigInfo[81].SignalProcessingOfRxSigInfo Com_RxSigInfo[81].ValidDlcOfRxSigInfo Com_RxSigInfo[82].RxAccessInfoIdxOfRxSigInfo Com_RxSigInfo[82].RxCbkFuncPtrAckIdxOfRxSigInfo Com_RxSigInfo[82].SignalProcessingOfRxSigInfo Com_RxSigInfo[82].ValidDlcOfRxSigInfo Com_RxSigInfo[83].RxAccessInfoIdxOfRxSigInfo Com_RxSigInfo[83].RxCbkFuncPtrAckIdxOfRxSigInfo Com_RxSigInfo[83].SignalProcessingOfRxSigInfo Com_RxSigInfo[83].ValidDlcOfRxSigInfo Com_RxSigInfo[84].RxAccessInfoIdxOfRxSigInfo Com_RxSigInfo[84].RxCbkFuncPtrAckIdxOfRxSigInfo Com_RxSigInfo[84].SignalProcessingOfRxSigInfo Com_RxSigInfo[84].ValidDlcOfRxSigInfo Com_RxSigInfo[85].RxAccessInfoIdxOfRxSigInfo Com_RxSigInfo[85].RxCbkFuncPtrAckIdxOfRxSigInfo Com_RxSigInfo[85].SignalProcessingOfRxSigInfo Com_RxSigInfo[85].ValidDlcOfRxSigInfo Com_RxSigInfo[86].RxAccessInfoIdxOfRxSigInfo Com_RxSigInfo[86].RxCbkFuncPtrAckIdxOfRxSigInfo Com_RxSigInfo[86].SignalProcessingOfRxSigInfo Com_RxSigInfo[86].ValidDlcOfRxSigInfo Com_RxSigInfo[87].RxAccessInfoIdxOfRxSigInfo Com_RxSigInfo[87].RxCbkFuncPtrAckIdxOfRxSigInfo Com_RxSigInfo[87].SignalProcessingOfRxSigInfo Com_RxSigInfo[87].ValidDlcOfRxSigInfo Com_RxSigInfo[88].RxAccessInfoIdxOfRxSigInfo Com_RxSigInfo[88].RxCbkFuncPtrAckIdxOfRxSigInfo Com_RxSigInfo[88].SignalProcessingOfRxSigInfo Com_RxSigInfo[88].ValidDlcOfRxSigInfo Com_RxSigInfo[89].RxAccessInfoIdxOfRxSigInfo Com_RxSigInfo[89].RxCbkFuncPtrAckIdxOfRxSigInfo Com_RxSigInfo[89].SignalProcessingOfRxSigInfo Com_RxSigInfo[89].ValidDlcOfRxSigInfo Com_RxSigInfo[8].RxAccessInfoIdxOfRxSigInfo Com_RxSigInfo[8].RxCbkFuncPtrAckIdxOfRxSigInfo Com_RxSigInfo[8].SignalProcessingOfRxSigInfo Com_RxSigInfo[8].ValidDlcOfRxSigInfo Com_RxSigInfo[90].RxAccessInfoIdxOfRxSigInfo Com_RxSigInfo[90].RxCbkFuncPtrAckIdxOfRxSigInfo Com_RxSigInfo[90].SignalProcessingOfRxSigInfo Com_RxSigInfo[90].ValidDlcOfRxSigInfo Com_RxSigInfo[91].RxAccessInfoIdxOfRxSigInfo Com_RxSigInfo[91].RxCbkFuncPtrAckIdxOfRxSigInfo Com_RxSigInfo[91].SignalProcessingOfRxSigInfo Com_RxSigInfo[91].ValidDlcOfRxSigInfo Com_RxSigInfo[92].RxAccessInfoIdxOfRxSigInfo Com_RxSigInfo[92].RxCbkFuncPtrAckIdxOfRxSigInfo Com_RxSigInfo[92].SignalProcessingOfRxSigInfo Com_RxSigInfo[92].ValidDlcOfRxSigInfo Com_RxSigInfo[93].RxAccessInfoIdxOfRxSigInfo Com_RxSigInfo[93].RxCbkFuncPtrAckIdxOfRxSigInfo Com_RxSigInfo[93].SignalProcessingOfRxSigInfo Com_RxSigInfo[93].ValidDlcOfRxSigInfo Com_RxSigInfo[94].RxAccessInfoIdxOfRxSigInfo Com_RxSigInfo[94].RxCbkFuncPtrAckIdxOfRxSigInfo Com_RxSigInfo[94].SignalProcessingOfRxSigInfo Com_RxSigInfo[94].ValidDlcOfRxSigInfo Com_RxSigInfo[95].RxAccessInfoIdxOfRxSigInfo Com_RxSigInfo[95].RxCbkFuncPtrAckIdxOfRxSigInfo Com_RxSigInfo[95].SignalProcessingOfRxSigInfo Com_RxSigInfo[95].ValidDlcOfRxSigInfo Com_RxSigInfo[96].RxAccessInfoIdxOfRxSigInfo Com_RxSigInfo[96].RxCbkFuncPtrAckIdxOfRxSigInfo Com_RxSigInfo[96].SignalProcessingOfRxSigInfo Com_RxSigInfo[96].ValidDlcOfRxSigInfo Com_RxSigInfo[97].RxAccessInfoIdxOfRxSigInfo Com_RxSigInfo[97].RxCbkFuncPtrAckIdxOfRxSigInfo Com_RxSigInfo[97].SignalProcessingOfRxSigInfo Com_RxSigInfo[97].ValidDlcOfRxSigInfo Com_RxSigInfo[98].RxAccessInfoIdxOfRxSigInfo Com_RxSigInfo[98].RxCbkFuncPtrAckIdxOfRxSigInfo Com_RxSigInfo[98].SignalProcessingOfRxSigInfo Com_RxSigInfo[98].ValidDlcOfRxSigInfo Com_RxSigInfo[99].RxAccessInfoIdxOfRxSigInfo Com_RxSigInfo[99].RxCbkFuncPtrAckIdxOfRxSigInfo Com_RxSigInfo[99].SignalProcessingOfRxSigInfo Com_RxSigInfo[99].ValidDlcOfRxSigInfo Com_RxSigInfo[9].RxAccessInfoIdxOfRxSigInfo Com_RxSigInfo[9].RxCbkFuncPtrAckIdxOfRxSigInfo Com_RxSigInfo[9].SignalProcessingOfRxSigInfo Com_RxSigInfo[9].ValidDlcOfRxSigInfo Com_RxTOutCnt Com_RxTOutInfo[0].CbkRxTOutFuncPtrIndStartIdxOfRxTOutInfo Com_RxTOutInfo[0].RxAccessInfoReplaceGrpSigIndStartIdxOfRxTOutInfo Com_SigGrpEventFlag Com_TmpRxBuffer Com_TmpRxShdBufferArrayBased Com_TmpRxShdBufferUInt16 Com_TmpRxShdBufferUInt32 Com_TmpRxShdBufferUInt8 Com_TransmitRequest Com_TransmitRequest_BMC_CMC_Temperatur_01_XIX_HCP5_CANFD01_13d55235_Tx Com_TransmitRequest_BMC_CMC_Temperatur_02_XIX_HCP5_CANFD01_f9538f57_Tx Com_TransmitRequest_BMC_CMC_Temperatur_03_XIX_HCP5_CANFD01_160139b6_Tx Com_TransmitRequest_BMC_CMC_Zellspannung_01_XIX_HCP5_CANFD01_f76fbfe9_Tx Com_TransmitRequest_BMC_CMC_Zellspannung_02_XIX_HCP5_CANFD01_1de9628b_Tx Com_TransmitRequest_BMC_CMC_Zellspannung_03_XIX_HCP5_CANFD01_f2bbd46a_Tx Com_TransmitRequest_BMC_CMC_Zellspannung_04_XIX_HCP5_CANFD01_1395de0e_Tx Com_TransmitRequest_BMC_CMC_Zellspannung_05_XIX_HCP5_CANFD01_fcc768ef_Tx Com_TransmitRequest_BMC_HV_01_XIX_HCP5_CANFD01_E2E_fcbbcae3_Tx Com_TransmitRequest_BMC_HV_02_XIX_HCP5_CANFD01_E2E_c5c367a3_Tx Com_TransmitRequest_BMC_HV_03_XIX_HCP5_CANFD01_0617c15c_Tx Com_TransmitRequest_BMC_HV_04_XIX_BMC_CAN01_E2E_a4a2e7f5_Tx Com_TransmitRequest_BMC_HV_05_XIX_HCP5_CANFD01_086b7dd9_Tx Com_TransmitRequest_BMC_HV_06_XIX_HCP5_CANFD01_e2eda0bb_Tx Com_TransmitRequest_BMC_HV_07_XIX_HCP5_CANFD01_0dbf165a_Tx Com_TransmitRequest_BMC_HV_08_XIX_HCP5_CANFD01_fbc0b232_Tx Com_TransmitRequest_BMC_HV_09_XIX_HCP5_CANFD01_149204d3_Tx Com_TransmitRequest_BMC_HV_10_XIX_BMC_CAN01_E2E_28add151_Tx Com_TransmitRequest_BMC_HV_11_XIX_BMC_CAN01_E2E_ff4f5109_Tx Com_TransmitRequest_BMC_HV_12_XIX_BMC_CAN01_E2E_5c19d7a0_Tx Com_TransmitRequest_BMC_HV_13_XIX_BMC_CAN01_E2E_8bfb57f8_Tx Com_TransmitRequest_BMC_HV_14_XIX_HCP5_CANFD01_30db4b60_Tx Com_TransmitRequest_DEV_Hybrid_01_Resp_FF_XIX_HCP5_CANFD01_7b20ac63_Tx Com_TransmitRequest_DS_Hybrid_01_XIX_HCP5_CANFD01_b3d0b839_Tx Com_TransmitRequest_KN_Hybrid_01_XIX_HCP5_CANFD01_fef84477_Tx Com_TransmitRequest_KS_Hybrid_01_Challenge_K_XIX_HCP5_CANFD01_306d69bd_Tx Com_TransmitRequest_KS_Hybrid_01_ReqFrame_XIX_HCP5_CANFD01_b04c52dd_Tx Com_TransmitRequest_KS_Hybrid_01_Response_K_XIX_HCP5_CANFD01_76da782f_Tx Com_TransmitRequest_NMH_Hybrid_01_XIX_BMC_CAN01_b22e17f1_Tx Com_TransmitRequest_NM_Hybrid_01_XIX_HCP5_CANFD01_c84ff8a5_Tx Com_TransmitRequest_OBD_Hybrid_01_XIX_HCP5_CANFD01_40f9dae5_Tx Com_TransmitRequest_SOK_Zeit_Hybrid_01_Chal_01_XIX_HCP5_CANFD01_5939048b_Tx Com_TxAccessInfo[0].TxGrpSigInfoIdxOfTxAccessInfo Com_TxAccessInfo[0].TxSigInfoIdxOfTxAccessInfo Com_TxAccessInfo[100].TxGrpSigInfoIdxOfTxAccessInfo Com_TxAccessInfo[100].TxSigInfoIdxOfTxAccessInfo Com_TxAccessInfo[101].TxGrpSigInfoIdxOfTxAccessInfo Com_TxAccessInfo[101].TxSigInfoIdxOfTxAccessInfo Com_TxAccessInfo[102].TxGrpSigInfoIdxOfTxAccessInfo Com_TxAccessInfo[102].TxSigInfoIdxOfTxAccessInfo Com_TxAccessInfo[103].TxGrpSigInfoIdxOfTxAccessInfo Com_TxAccessInfo[103].TxSigInfoIdxOfTxAccessInfo Com_TxAccessInfo[104].TxGrpSigInfoIdxOfTxAccessInfo Com_TxAccessInfo[104].TxSigInfoIdxOfTxAccessInfo Com_TxAccessInfo[105].TxGrpSigInfoIdxOfTxAccessInfo Com_TxAccessInfo[105].TxSigInfoIdxOfTxAccessInfo Com_TxAccessInfo[106].TxGrpSigInfoIdxOfTxAccessInfo Com_TxAccessInfo[106].TxSigInfoIdxOfTxAccessInfo Com_TxAccessInfo[107].TxGrpSigInfoIdxOfTxAccessInfo Com_TxAccessInfo[107].TxSigInfoIdxOfTxAccessInfo Com_TxAccessInfo[108].TxGrpSigInfoIdxOfTxAccessInfo Com_TxAccessInfo[108].TxSigInfoIdxOfTxAccessInfo Com_TxAccessInfo[109].TxGrpSigInfoIdxOfTxAccessInfo Com_TxAccessInfo[109].TxSigInfoIdxOfTxAccessInfo Com_TxAccessInfo[10].TxGrpSigInfoIdxOfTxAccessInfo Com_TxAccessInfo[10].TxSigInfoIdxOfTxAccessInfo Com_TxAccessInfo[110].TxGrpSigInfoIdxOfTxAccessInfo Com_TxAccessInfo[110].TxSigInfoIdxOfTxAccessInfo Com_TxAccessInfo[111].TxGrpSigInfoIdxOfTxAccessInfo Com_TxAccessInfo[111].TxSigInfoIdxOfTxAccessInfo Com_TxAccessInfo[112].TxGrpSigInfoIdxOfTxAccessInfo Com_TxAccessInfo[112].TxSigInfoIdxOfTxAccessInfo Com_TxAccessInfo[113].TxGrpSigInfoIdxOfTxAccessInfo Com_TxAccessInfo[113].TxSigInfoIdxOfTxAccessInfo Com_TxAccessInfo[114].TxGrpSigInfoIdxOfTxAccessInfo Com_TxAccessInfo[114].TxSigInfoIdxOfTxAccessInfo Com_TxAccessInfo[115].TxGrpSigInfoIdxOfTxAccessInfo Com_TxAccessInfo[115].TxSigInfoIdxOfTxAccessInfo Com_TxAccessInfo[116].TxGrpSigInfoIdxOfTxAccessInfo Com_TxAccessInfo[116].TxSigInfoIdxOfTxAccessInfo Com_TxAccessInfo[117].TxGrpSigInfoIdxOfTxAccessInfo Com_TxAccessInfo[117].TxSigInfoIdxOfTxAccessInfo Com_TxAccessInfo[118].TxGrpSigInfoIdxOfTxAccessInfo Com_TxAccessInfo[118].TxSigInfoIdxOfTxAccessInfo Com_TxAccessInfo[119].TxGrpSigInfoIdxOfTxAccessInfo Com_TxAccessInfo[119].TxSigInfoIdxOfTxAccessInfo Com_TxAccessInfo[11].TxGrpSigInfoIdxOfTxAccessInfo Com_TxAccessInfo[11].TxSigInfoIdxOfTxAccessInfo Com_TxAccessInfo[120].TxGrpSigInfoIdxOfTxAccessInfo Com_TxAccessInfo[120].TxSigInfoIdxOfTxAccessInfo Com_TxAccessInfo[121].TxGrpSigInfoIdxOfTxAccessInfo Com_TxAccessInfo[121].TxSigInfoIdxOfTxAccessInfo Com_TxAccessInfo[122].TxGrpSigInfoIdxOfTxAccessInfo Com_TxAccessInfo[122].TxSigInfoIdxOfTxAccessInfo Com_TxAccessInfo[123].TxGrpSigInfoIdxOfTxAccessInfo Com_TxAccessInfo[123].TxSigInfoIdxOfTxAccessInfo Com_TxAccessInfo[124].TxGrpSigInfoIdxOfTxAccessInfo Com_TxAccessInfo[124].TxSigInfoIdxOfTxAccessInfo Com_TxAccessInfo[125].TxGrpSigInfoIdxOfTxAccessInfo Com_TxAccessInfo[125].TxSigInfoIdxOfTxAccessInfo Com_TxAccessInfo[126].TxGrpSigInfoIdxOfTxAccessInfo Com_TxAccessInfo[126].TxSigInfoIdxOfTxAccessInfo Com_TxAccessInfo[127].TxGrpSigInfoIdxOfTxAccessInfo Com_TxAccessInfo[127].TxSigInfoIdxOfTxAccessInfo Com_TxAccessInfo[128].TxGrpSigInfoIdxOfTxAccessInfo Com_TxAccessInfo[128].TxSigInfoIdxOfTxAccessInfo Com_TxAccessInfo[129].TxGrpSigInfoIdxOfTxAccessInfo Com_TxAccessInfo[129].TxSigInfoIdxOfTxAccessInfo Com_TxAccessInfo[12].TxGrpSigInfoIdxOfTxAccessInfo Com_TxAccessInfo[12].TxSigInfoIdxOfTxAccessInfo Com_TxAccessInfo[130].TxGrpSigInfoIdxOfTxAccessInfo Com_TxAccessInfo[130].TxSigInfoIdxOfTxAccessInfo Com_TxAccessInfo[131].TxGrpSigInfoIdxOfTxAccessInfo Com_TxAccessInfo[131].TxSigInfoIdxOfTxAccessInfo Com_TxAccessInfo[132].TxGrpSigInfoIdxOfTxAccessInfo Com_TxAccessInfo[132].TxSigInfoIdxOfTxAccessInfo Com_TxAccessInfo[133].TxGrpSigInfoIdxOfTxAccessInfo Com_TxAccessInfo[133].TxSigInfoIdxOfTxAccessInfo Com_TxAccessInfo[134].TxGrpSigInfoIdxOfTxAccessInfo /end REF_MEASUREMENT
/end GROUP
/end MODULE
/end PROJECT
