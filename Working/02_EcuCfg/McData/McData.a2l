ASAP2_VERSION 1 71
/begin PROJECT MICROSAR ""
/begin MODULE CPP ""
/begin MOD_COMMON "" BYTE_ORDER MSB_LAST ALIGNMENT_BYTE 1 ALIGNMENT_WORD 2 ALIGNMENT_LONG 4 ALIGNMENT_FLOAT16_IEEE 2 ALIGNMENT_FLOAT32_IEEE 4 ALIGNMENT_FLOAT64_IEEE 8 ALIGNMENT_INT64 8 /end MOD_COMMON
/begin MEASUREMENT CddNpmGen2_MeasurementsType_NVM_LOCK_STAT_SET "Block\'s lock status" UBYTE NO_COMPU_METHOD 0 0 0 1 BIT_MASK 0x40 ECU_ADDRESS 0x0 SYMBOL_LINK "NvM_BlockMngmtArea_at[24].NvRamAttributes_u8" 0 /end MEASUREMENT
/begin MEASUREMENT CddNpmGen2_MeasurementsType_NVM_STATE_CHANGED_SET "Block\'s changed status" UBYTE NO_COMPU_METHOD 0 0 0 1 BIT_MASK 0x2 ECU_ADDRESS 0x0 SYMBOL_LINK "NvM_BlockMngmtArea_at[24].NvRamAttributes_u8" 0 /end MEASUREMENT
/begin MEASUREMENT CddNpmGen2_MeasurementsType_NVM_STATE_VALID_SET "Block\'s valid status" UBYTE NO_COMPU_METHOD 0 0 0 1 BIT_MASK 0x1 ECU_ADDRESS 0x0 SYMBOL_LINK "NvM_BlockMngmtArea_at[24].NvRamAttributes_u8" 0 /end MEASUREMENT
/begin MEASUREMENT CddNpmGen2_MeasurementsType_NVM_WR_PROT_SET "Block\'s write protection status" UBYTE NO_COMPU_METHOD 0 0 0 1 BIT_MASK 0x80 ECU_ADDRESS 0x0 SYMBOL_LINK "NvM_BlockMngmtArea_at[24].NvRamAttributes_u8" 0 /end MEASUREMENT
/begin MEASUREMENT CddNpmGen2_MeasurementsType_NvDataIndex "Block\'s dataset index" UBYTE NO_COMPU_METHOD 0 0 0 255 ECU_ADDRESS 0x0 SYMBOL_LINK "NvM_BlockMngmtArea_at[24].NvDataIndex_t" 0 /end MEASUREMENT
/begin MEASUREMENT CddNpmGen2_MeasurementsType_NvRam_ErrorStatus "Block\'s error status" UBYTE NvMErrorStatusValues 0 0 0 255 ECU_ADDRESS 0x0 SYMBOL_LINK "NvM_BlockMngmtArea_at[24].NvRamErrorStatus_u8" 0 /end MEASUREMENT
/begin MEASUREMENT CryptoKeyStorage_NVM_LOCK_STAT_SET "Block\'s lock status" UBYTE NO_COMPU_METHOD 0 0 0 1 BIT_MASK 0x40 ECU_ADDRESS 0x0 SYMBOL_LINK "NvM_BlockMngmtArea_at[21].NvRamAttributes_u8" 0 /end MEASUREMENT
/begin MEASUREMENT CryptoKeyStorage_NVM_STATE_CHANGED_SET "Block\'s changed status" UBYTE NO_COMPU_METHOD 0 0 0 1 BIT_MASK 0x2 ECU_ADDRESS 0x0 SYMBOL_LINK "NvM_BlockMngmtArea_at[21].NvRamAttributes_u8" 0 /end MEASUREMENT
/begin MEASUREMENT CryptoKeyStorage_NVM_STATE_VALID_SET "Block\'s valid status" UBYTE NO_COMPU_METHOD 0 0 0 1 BIT_MASK 0x1 ECU_ADDRESS 0x0 SYMBOL_LINK "NvM_BlockMngmtArea_at[21].NvRamAttributes_u8" 0 /end MEASUREMENT
/begin MEASUREMENT CryptoKeyStorage_NVM_WR_PROT_SET "Block\'s write protection status" UBYTE NO_COMPU_METHOD 0 0 0 1 BIT_MASK 0x80 ECU_ADDRESS 0x0 SYMBOL_LINK "NvM_BlockMngmtArea_at[21].NvRamAttributes_u8" 0 /end MEASUREMENT
/begin MEASUREMENT CryptoKeyStorage_NvDataIndex "Block\'s dataset index" UBYTE NO_COMPU_METHOD 0 0 0 255 ECU_ADDRESS 0x0 SYMBOL_LINK "NvM_BlockMngmtArea_at[21].NvDataIndex_t" 0 /end MEASUREMENT
/begin MEASUREMENT CryptoKeyStorage_NvRam_ErrorStatus "Block\'s error status" UBYTE NvMErrorStatusValues 0 0 0 255 ECU_ADDRESS 0x0 SYMBOL_LINK "NvM_BlockMngmtArea_at[21].NvRamErrorStatus_u8" 0 /end MEASUREMENT
/begin MEASUREMENT DemAdminDataBlock_NVM_LOCK_STAT_SET "Block\'s lock status" UBYTE NO_COMPU_METHOD 0 0 0 1 BIT_MASK 0x40 ECU_ADDRESS 0x0 SYMBOL_LINK "NvM_BlockMngmtArea_at[2].NvRamAttributes_u8" 0 /end MEASUREMENT
/begin MEASUREMENT DemAdminDataBlock_NVM_STATE_CHANGED_SET "Block\'s changed status" UBYTE NO_COMPU_METHOD 0 0 0 1 BIT_MASK 0x2 ECU_ADDRESS 0x0 SYMBOL_LINK "NvM_BlockMngmtArea_at[2].NvRamAttributes_u8" 0 /end MEASUREMENT
/begin MEASUREMENT DemAdminDataBlock_NVM_STATE_VALID_SET "Block\'s valid status" UBYTE NO_COMPU_METHOD 0 0 0 1 BIT_MASK 0x1 ECU_ADDRESS 0x0 SYMBOL_LINK "NvM_BlockMngmtArea_at[2].NvRamAttributes_u8" 0 /end MEASUREMENT
/begin MEASUREMENT DemAdminDataBlock_NVM_WR_PROT_SET "Block\'s write protection status" UBYTE NO_COMPU_METHOD 0 0 0 1 BIT_MASK 0x80 ECU_ADDRESS 0x0 SYMBOL_LINK "NvM_BlockMngmtArea_at[2].NvRamAttributes_u8" 0 /end MEASUREMENT
/begin MEASUREMENT DemAdminDataBlock_NvDataIndex "Block\'s dataset index" UBYTE NO_COMPU_METHOD 0 0 0 255 ECU_ADDRESS 0x0 SYMBOL_LINK "NvM_BlockMngmtArea_at[2].NvDataIndex_t" 0 /end MEASUREMENT
/begin MEASUREMENT DemAdminDataBlock_NvRam_ErrorStatus "Block\'s error status" UBYTE NvMErrorStatusValues 0 0 0 255 ECU_ADDRESS 0x0 SYMBOL_LINK "NvM_BlockMngmtArea_at[2].NvRamErrorStatus_u8" 0 /end MEASUREMENT
/begin MEASUREMENT DemPrimaryDataBlock0_NVM_LOCK_STAT_SET "Block\'s lock status" UBYTE NO_COMPU_METHOD 0 0 0 1 BIT_MASK 0x40 ECU_ADDRESS 0x0 SYMBOL_LINK "NvM_BlockMngmtArea_at[3].NvRamAttributes_u8" 0 /end MEASUREMENT
/begin MEASUREMENT DemPrimaryDataBlock0_NVM_STATE_CHANGED_SET "Block\'s changed status" UBYTE NO_COMPU_METHOD 0 0 0 1 BIT_MASK 0x2 ECU_ADDRESS 0x0 SYMBOL_LINK "NvM_BlockMngmtArea_at[3].NvRamAttributes_u8" 0 /end MEASUREMENT
/begin MEASUREMENT DemPrimaryDataBlock0_NVM_STATE_VALID_SET "Block\'s valid status" UBYTE NO_COMPU_METHOD 0 0 0 1 BIT_MASK 0x1 ECU_ADDRESS 0x0 SYMBOL_LINK "NvM_BlockMngmtArea_at[3].NvRamAttributes_u8" 0 /end MEASUREMENT
/begin MEASUREMENT DemPrimaryDataBlock0_NVM_WR_PROT_SET "Block\'s write protection status" UBYTE NO_COMPU_METHOD 0 0 0 1 BIT_MASK 0x80 ECU_ADDRESS 0x0 SYMBOL_LINK "NvM_BlockMngmtArea_at[3].NvRamAttributes_u8" 0 /end MEASUREMENT
/begin MEASUREMENT DemPrimaryDataBlock0_NvDataIndex "Block\'s dataset index" UBYTE NO_COMPU_METHOD 0 0 0 255 ECU_ADDRESS 0x0 SYMBOL_LINK "NvM_BlockMngmtArea_at[3].NvDataIndex_t" 0 /end MEASUREMENT
/begin MEASUREMENT DemPrimaryDataBlock0_NvRam_ErrorStatus "Block\'s error status" UBYTE NvMErrorStatusValues 0 0 0 255 ECU_ADDRESS 0x0 SYMBOL_LINK "NvM_BlockMngmtArea_at[3].NvRamErrorStatus_u8" 0 /end MEASUREMENT
/begin MEASUREMENT DemPrimaryDataBlock1_NVM_LOCK_STAT_SET "Block\'s lock status" UBYTE NO_COMPU_METHOD 0 0 0 1 BIT_MASK 0x40 ECU_ADDRESS 0x0 SYMBOL_LINK "NvM_BlockMngmtArea_at[4].NvRamAttributes_u8" 0 /end MEASUREMENT
/begin MEASUREMENT DemPrimaryDataBlock1_NVM_STATE_CHANGED_SET "Block\'s changed status" UBYTE NO_COMPU_METHOD 0 0 0 1 BIT_MASK 0x2 ECU_ADDRESS 0x0 SYMBOL_LINK "NvM_BlockMngmtArea_at[4].NvRamAttributes_u8" 0 /end MEASUREMENT
/begin MEASUREMENT DemPrimaryDataBlock1_NVM_STATE_VALID_SET "Block\'s valid status" UBYTE NO_COMPU_METHOD 0 0 0 1 BIT_MASK 0x1 ECU_ADDRESS 0x0 SYMBOL_LINK "NvM_BlockMngmtArea_at[4].NvRamAttributes_u8" 0 /end MEASUREMENT
/begin MEASUREMENT DemPrimaryDataBlock1_NVM_WR_PROT_SET "Block\'s write protection status" UBYTE NO_COMPU_METHOD 0 0 0 1 BIT_MASK 0x80 ECU_ADDRESS 0x0 SYMBOL_LINK "NvM_BlockMngmtArea_at[4].NvRamAttributes_u8" 0 /end MEASUREMENT
/begin MEASUREMENT DemPrimaryDataBlock1_NvDataIndex "Block\'s dataset index" UBYTE NO_COMPU_METHOD 0 0 0 255 ECU_ADDRESS 0x0 SYMBOL_LINK "NvM_BlockMngmtArea_at[4].NvDataIndex_t" 0 /end MEASUREMENT
/begin MEASUREMENT DemPrimaryDataBlock1_NvRam_ErrorStatus "Block\'s error status" UBYTE NvMErrorStatusValues 0 0 0 255 ECU_ADDRESS 0x0 SYMBOL_LINK "NvM_BlockMngmtArea_at[4].NvRamErrorStatus_u8" 0 /end MEASUREMENT
/begin MEASUREMENT DemPrimaryDataBlock2_NVM_LOCK_STAT_SET "Block\'s lock status" UBYTE NO_COMPU_METHOD 0 0 0 1 BIT_MASK 0x40 ECU_ADDRESS 0x0 SYMBOL_LINK "NvM_BlockMngmtArea_at[5].NvRamAttributes_u8" 0 /end MEASUREMENT
/begin MEASUREMENT DemPrimaryDataBlock2_NVM_STATE_CHANGED_SET "Block\'s changed status" UBYTE NO_COMPU_METHOD 0 0 0 1 BIT_MASK 0x2 ECU_ADDRESS 0x0 SYMBOL_LINK "NvM_BlockMngmtArea_at[5].NvRamAttributes_u8" 0 /end MEASUREMENT
/begin MEASUREMENT DemPrimaryDataBlock2_NVM_STATE_VALID_SET "Block\'s valid status" UBYTE NO_COMPU_METHOD 0 0 0 1 BIT_MASK 0x1 ECU_ADDRESS 0x0 SYMBOL_LINK "NvM_BlockMngmtArea_at[5].NvRamAttributes_u8" 0 /end MEASUREMENT
/begin MEASUREMENT DemPrimaryDataBlock2_NVM_WR_PROT_SET "Block\'s write protection status" UBYTE NO_COMPU_METHOD 0 0 0 1 BIT_MASK 0x80 ECU_ADDRESS 0x0 SYMBOL_LINK "NvM_BlockMngmtArea_at[5].NvRamAttributes_u8" 0 /end MEASUREMENT
/begin MEASUREMENT DemPrimaryDataBlock2_NvDataIndex "Block\'s dataset index" UBYTE NO_COMPU_METHOD 0 0 0 255 ECU_ADDRESS 0x0 SYMBOL_LINK "NvM_BlockMngmtArea_at[5].NvDataIndex_t" 0 /end MEASUREMENT
/begin MEASUREMENT DemPrimaryDataBlock2_NvRam_ErrorStatus "Block\'s error status" UBYTE NvMErrorStatusValues 0 0 0 255 ECU_ADDRESS 0x0 SYMBOL_LINK "NvM_BlockMngmtArea_at[5].NvRamErrorStatus_u8" 0 /end MEASUREMENT
/begin MEASUREMENT DemPrimaryDataBlock3_NVM_LOCK_STAT_SET "Block\'s lock status" UBYTE NO_COMPU_METHOD 0 0 0 1 BIT_MASK 0x40 ECU_ADDRESS 0x0 SYMBOL_LINK "NvM_BlockMngmtArea_at[6].NvRamAttributes_u8" 0 /end MEASUREMENT
/begin MEASUREMENT DemPrimaryDataBlock3_NVM_STATE_CHANGED_SET "Block\'s changed status" UBYTE NO_COMPU_METHOD 0 0 0 1 BIT_MASK 0x2 ECU_ADDRESS 0x0 SYMBOL_LINK "NvM_BlockMngmtArea_at[6].NvRamAttributes_u8" 0 /end MEASUREMENT
/begin MEASUREMENT DemPrimaryDataBlock3_NVM_STATE_VALID_SET "Block\'s valid status" UBYTE NO_COMPU_METHOD 0 0 0 1 BIT_MASK 0x1 ECU_ADDRESS 0x0 SYMBOL_LINK "NvM_BlockMngmtArea_at[6].NvRamAttributes_u8" 0 /end MEASUREMENT
/begin MEASUREMENT DemPrimaryDataBlock3_NVM_WR_PROT_SET "Block\'s write protection status" UBYTE NO_COMPU_METHOD 0 0 0 1 BIT_MASK 0x80 ECU_ADDRESS 0x0 SYMBOL_LINK "NvM_BlockMngmtArea_at[6].NvRamAttributes_u8" 0 /end MEASUREMENT
/begin MEASUREMENT DemPrimaryDataBlock3_NvDataIndex "Block\'s dataset index" UBYTE NO_COMPU_METHOD 0 0 0 255 ECU_ADDRESS 0x0 SYMBOL_LINK "NvM_BlockMngmtArea_at[6].NvDataIndex_t" 0 /end MEASUREMENT
/begin MEASUREMENT DemPrimaryDataBlock3_NvRam_ErrorStatus "Block\'s error status" UBYTE NvMErrorStatusValues 0 0 0 255 ECU_ADDRESS 0x0 SYMBOL_LINK "NvM_BlockMngmtArea_at[6].NvRamErrorStatus_u8" 0 /end MEASUREMENT
/begin MEASUREMENT DemPrimaryDataBlock4_NVM_LOCK_STAT_SET "Block\'s lock status" UBYTE NO_COMPU_METHOD 0 0 0 1 BIT_MASK 0x40 ECU_ADDRESS 0x0 SYMBOL_LINK "NvM_BlockMngmtArea_at[7].NvRamAttributes_u8" 0 /end MEASUREMENT
/begin MEASUREMENT DemPrimaryDataBlock4_NVM_STATE_CHANGED_SET "Block\'s changed status" UBYTE NO_COMPU_METHOD 0 0 0 1 BIT_MASK 0x2 ECU_ADDRESS 0x0 SYMBOL_LINK "NvM_BlockMngmtArea_at[7].NvRamAttributes_u8" 0 /end MEASUREMENT
/begin MEASUREMENT DemPrimaryDataBlock4_NVM_STATE_VALID_SET "Block\'s valid status" UBYTE NO_COMPU_METHOD 0 0 0 1 BIT_MASK 0x1 ECU_ADDRESS 0x0 SYMBOL_LINK "NvM_BlockMngmtArea_at[7].NvRamAttributes_u8" 0 /end MEASUREMENT
/begin MEASUREMENT DemPrimaryDataBlock4_NVM_WR_PROT_SET "Block\'s write protection status" UBYTE NO_COMPU_METHOD 0 0 0 1 BIT_MASK 0x80 ECU_ADDRESS 0x0 SYMBOL_LINK "NvM_BlockMngmtArea_at[7].NvRamAttributes_u8" 0 /end MEASUREMENT
/begin MEASUREMENT DemPrimaryDataBlock4_NvDataIndex "Block\'s dataset index" UBYTE NO_COMPU_METHOD 0 0 0 255 ECU_ADDRESS 0x0 SYMBOL_LINK "NvM_BlockMngmtArea_at[7].NvDataIndex_t" 0 /end MEASUREMENT
/begin MEASUREMENT DemPrimaryDataBlock4_NvRam_ErrorStatus "Block\'s error status" UBYTE NvMErrorStatusValues 0 0 0 255 ECU_ADDRESS 0x0 SYMBOL_LINK "NvM_BlockMngmtArea_at[7].NvRamErrorStatus_u8" 0 /end MEASUREMENT
/begin MEASUREMENT DemPrimaryDataBlock5_NVM_LOCK_STAT_SET "Block\'s lock status" UBYTE NO_COMPU_METHOD 0 0 0 1 BIT_MASK 0x40 ECU_ADDRESS 0x0 SYMBOL_LINK "NvM_BlockMngmtArea_at[8].NvRamAttributes_u8" 0 /end MEASUREMENT
/begin MEASUREMENT DemPrimaryDataBlock5_NVM_STATE_CHANGED_SET "Block\'s changed status" UBYTE NO_COMPU_METHOD 0 0 0 1 BIT_MASK 0x2 ECU_ADDRESS 0x0 SYMBOL_LINK "NvM_BlockMngmtArea_at[8].NvRamAttributes_u8" 0 /end MEASUREMENT
/begin MEASUREMENT DemPrimaryDataBlock5_NVM_STATE_VALID_SET "Block\'s valid status" UBYTE NO_COMPU_METHOD 0 0 0 1 BIT_MASK 0x1 ECU_ADDRESS 0x0 SYMBOL_LINK "NvM_BlockMngmtArea_at[8].NvRamAttributes_u8" 0 /end MEASUREMENT
/begin MEASUREMENT DemPrimaryDataBlock5_NVM_WR_PROT_SET "Block\'s write protection status" UBYTE NO_COMPU_METHOD 0 0 0 1 BIT_MASK 0x80 ECU_ADDRESS 0x0 SYMBOL_LINK "NvM_BlockMngmtArea_at[8].NvRamAttributes_u8" 0 /end MEASUREMENT
/begin MEASUREMENT DemPrimaryDataBlock5_NvDataIndex "Block\'s dataset index" UBYTE NO_COMPU_METHOD 0 0 0 255 ECU_ADDRESS 0x0 SYMBOL_LINK "NvM_BlockMngmtArea_at[8].NvDataIndex_t" 0 /end MEASUREMENT
/begin MEASUREMENT DemPrimaryDataBlock5_NvRam_ErrorStatus "Block\'s error status" UBYTE NvMErrorStatusValues 0 0 0 255 ECU_ADDRESS 0x0 SYMBOL_LINK "NvM_BlockMngmtArea_at[8].NvRamErrorStatus_u8" 0 /end MEASUREMENT
/begin MEASUREMENT DemPrimaryDataBlock6_NVM_LOCK_STAT_SET "Block\'s lock status" UBYTE NO_COMPU_METHOD 0 0 0 1 BIT_MASK 0x40 ECU_ADDRESS 0x0 SYMBOL_LINK "NvM_BlockMngmtArea_at[9].NvRamAttributes_u8" 0 /end MEASUREMENT
/begin MEASUREMENT DemPrimaryDataBlock6_NVM_STATE_CHANGED_SET "Block\'s changed status" UBYTE NO_COMPU_METHOD 0 0 0 1 BIT_MASK 0x2 ECU_ADDRESS 0x0 SYMBOL_LINK "NvM_BlockMngmtArea_at[9].NvRamAttributes_u8" 0 /end MEASUREMENT
/begin MEASUREMENT DemPrimaryDataBlock6_NVM_STATE_VALID_SET "Block\'s valid status" UBYTE NO_COMPU_METHOD 0 0 0 1 BIT_MASK 0x1 ECU_ADDRESS 0x0 SYMBOL_LINK "NvM_BlockMngmtArea_at[9].NvRamAttributes_u8" 0 /end MEASUREMENT
/begin MEASUREMENT DemPrimaryDataBlock6_NVM_WR_PROT_SET "Block\'s write protection status" UBYTE NO_COMPU_METHOD 0 0 0 1 BIT_MASK 0x80 ECU_ADDRESS 0x0 SYMBOL_LINK "NvM_BlockMngmtArea_at[9].NvRamAttributes_u8" 0 /end MEASUREMENT
/begin MEASUREMENT DemPrimaryDataBlock6_NvDataIndex "Block\'s dataset index" UBYTE NO_COMPU_METHOD 0 0 0 255 ECU_ADDRESS 0x0 SYMBOL_LINK "NvM_BlockMngmtArea_at[9].NvDataIndex_t" 0 /end MEASUREMENT
/begin MEASUREMENT DemPrimaryDataBlock6_NvRam_ErrorStatus "Block\'s error status" UBYTE NvMErrorStatusValues 0 0 0 255 ECU_ADDRESS 0x0 SYMBOL_LINK "NvM_BlockMngmtArea_at[9].NvRamErrorStatus_u8" 0 /end MEASUREMENT
/begin MEASUREMENT DemPrimaryDataBlock7_NVM_LOCK_STAT_SET "Block\'s lock status" UBYTE NO_COMPU_METHOD 0 0 0 1 BIT_MASK 0x40 ECU_ADDRESS 0x0 SYMBOL_LINK "NvM_BlockMngmtArea_at[10].NvRamAttributes_u8" 0 /end MEASUREMENT
/begin MEASUREMENT DemPrimaryDataBlock7_NVM_STATE_CHANGED_SET "Block\'s changed status" UBYTE NO_COMPU_METHOD 0 0 0 1 BIT_MASK 0x2 ECU_ADDRESS 0x0 SYMBOL_LINK "NvM_BlockMngmtArea_at[10].NvRamAttributes_u8" 0 /end MEASUREMENT
/begin MEASUREMENT DemPrimaryDataBlock7_NVM_STATE_VALID_SET "Block\'s valid status" UBYTE NO_COMPU_METHOD 0 0 0 1 BIT_MASK 0x1 ECU_ADDRESS 0x0 SYMBOL_LINK "NvM_BlockMngmtArea_at[10].NvRamAttributes_u8" 0 /end MEASUREMENT
/begin MEASUREMENT DemPrimaryDataBlock7_NVM_WR_PROT_SET "Block\'s write protection status" UBYTE NO_COMPU_METHOD 0 0 0 1 BIT_MASK 0x80 ECU_ADDRESS 0x0 SYMBOL_LINK "NvM_BlockMngmtArea_at[10].NvRamAttributes_u8" 0 /end MEASUREMENT
/begin MEASUREMENT DemPrimaryDataBlock7_NvDataIndex "Block\'s dataset index" UBYTE NO_COMPU_METHOD 0 0 0 255 ECU_ADDRESS 0x0 SYMBOL_LINK "NvM_BlockMngmtArea_at[10].NvDataIndex_t" 0 /end MEASUREMENT
/begin MEASUREMENT DemPrimaryDataBlock7_NvRam_ErrorStatus "Block\'s error status" UBYTE NvMErrorStatusValues 0 0 0 255 ECU_ADDRESS 0x0 SYMBOL_LINK "NvM_BlockMngmtArea_at[10].NvRamErrorStatus_u8" 0 /end MEASUREMENT
/begin MEASUREMENT DemStatusDataBlock_NVM_LOCK_STAT_SET "Block\'s lock status" UBYTE NO_COMPU_METHOD 0 0 0 1 BIT_MASK 0x40 ECU_ADDRESS 0x0 SYMBOL_LINK "NvM_BlockMngmtArea_at[22].NvRamAttributes_u8" 0 /end MEASUREMENT
/begin MEASUREMENT DemStatusDataBlock_NVM_STATE_CHANGED_SET "Block\'s changed status" UBYTE NO_COMPU_METHOD 0 0 0 1 BIT_MASK 0x2 ECU_ADDRESS 0x0 SYMBOL_LINK "NvM_BlockMngmtArea_at[22].NvRamAttributes_u8" 0 /end MEASUREMENT
/begin MEASUREMENT DemStatusDataBlock_NVM_STATE_VALID_SET "Block\'s valid status" UBYTE NO_COMPU_METHOD 0 0 0 1 BIT_MASK 0x1 ECU_ADDRESS 0x0 SYMBOL_LINK "NvM_BlockMngmtArea_at[22].NvRamAttributes_u8" 0 /end MEASUREMENT
/begin MEASUREMENT DemStatusDataBlock_NVM_WR_PROT_SET "Block\'s write protection status" UBYTE NO_COMPU_METHOD 0 0 0 1 BIT_MASK 0x80 ECU_ADDRESS 0x0 SYMBOL_LINK "NvM_BlockMngmtArea_at[22].NvRamAttributes_u8" 0 /end MEASUREMENT
/begin MEASUREMENT DemStatusDataBlock_NvDataIndex "Block\'s dataset index" UBYTE NO_COMPU_METHOD 0 0 0 255 ECU_ADDRESS 0x0 SYMBOL_LINK "NvM_BlockMngmtArea_at[22].NvDataIndex_t" 0 /end MEASUREMENT
/begin MEASUREMENT DemStatusDataBlock_NvRam_ErrorStatus "Block\'s error status" UBYTE NvMErrorStatusValues 0 0 0 255 ECU_ADDRESS 0x0 SYMBOL_LINK "NvM_BlockMngmtArea_at[22].NvRamErrorStatus_u8" 0 /end MEASUREMENT
/begin MEASUREMENT Nm_Initialized "Initialized state" UBYTE Nm_InitializedType 0 0 0 1 ECU_ADDRESS 0x0 /end MEASUREMENT
/begin MEASUREMENT Nm_PartitionIdentifiers[0].PCPartitionConfigIdxOfPartitionIdentifiers "" UBYTE NO_COMPU_METHOD 0 0 0 255 ECU_ADDRESS 0x0 /end MEASUREMENT
/begin MEASUREMENT Nm_PartitionIdentifiers[0].PartitionSNVOfPartitionIdentifiers "" ULONG NO_COMPU_METHOD 0 0 0 4294967295 ECU_ADDRESS 0x0 /end MEASUREMENT
/begin MEASUREMENT Nm_PostInitialized "Post-Initialized state" UBYTE Nm_PostInitializedType 0 0 0 1 ECU_ADDRESS 0x0 /end MEASUREMENT
/begin MEASUREMENT NvMBlock_0x0250_NVM_LOCK_STAT_SET "Block\'s lock status" UBYTE NO_COMPU_METHOD 0 0 0 1 BIT_MASK 0x40 ECU_ADDRESS 0x0 SYMBOL_LINK "NvM_BlockMngmtArea_at[23].NvRamAttributes_u8" 0 /end MEASUREMENT
/begin MEASUREMENT NvMBlock_0x0250_NVM_STATE_CHANGED_SET "Block\'s changed status" UBYTE NO_COMPU_METHOD 0 0 0 1 BIT_MASK 0x2 ECU_ADDRESS 0x0 SYMBOL_LINK "NvM_BlockMngmtArea_at[23].NvRamAttributes_u8" 0 /end MEASUREMENT
/begin MEASUREMENT NvMBlock_0x0250_NVM_STATE_VALID_SET "Block\'s valid status" UBYTE NO_COMPU_METHOD 0 0 0 1 BIT_MASK 0x1 ECU_ADDRESS 0x0 SYMBOL_LINK "NvM_BlockMngmtArea_at[23].NvRamAttributes_u8" 0 /end MEASUREMENT
/begin MEASUREMENT NvMBlock_0x0250_NVM_WR_PROT_SET "Block\'s write protection status" UBYTE NO_COMPU_METHOD 0 0 0 1 BIT_MASK 0x80 ECU_ADDRESS 0x0 SYMBOL_LINK "NvM_BlockMngmtArea_at[23].NvRamAttributes_u8" 0 /end MEASUREMENT
/begin MEASUREMENT NvMBlock_0x0250_NvDataIndex "Block\'s dataset index" UBYTE NO_COMPU_METHOD 0 0 0 255 ECU_ADDRESS 0x0 SYMBOL_LINK "NvM_BlockMngmtArea_at[23].NvDataIndex_t" 0 /end MEASUREMENT
/begin MEASUREMENT NvMBlock_0x0250_NvRam_ErrorStatus "Block\'s error status" UBYTE NvMErrorStatusValues 0 0 0 255 ECU_ADDRESS 0x0 SYMBOL_LINK "NvM_BlockMngmtArea_at[23].NvRamErrorStatus_u8" 0 /end MEASUREMENT
/begin MEASUREMENT NvMConfigBlock_NVM_LOCK_STAT_SET "Block\'s lock status" UBYTE NO_COMPU_METHOD 0 0 0 1 BIT_MASK 0x40 ECU_ADDRESS 0x0 SYMBOL_LINK "NvM_BlockMngmtArea_at[1].NvRamAttributes_u8" 0 /end MEASUREMENT
/begin MEASUREMENT NvMConfigBlock_NVM_STATE_CHANGED_SET "Block\'s changed status" UBYTE NO_COMPU_METHOD 0 0 0 1 BIT_MASK 0x2 ECU_ADDRESS 0x0 SYMBOL_LINK "NvM_BlockMngmtArea_at[1].NvRamAttributes_u8" 0 /end MEASUREMENT
/begin MEASUREMENT NvMConfigBlock_NVM_STATE_VALID_SET "Block\'s valid status" UBYTE NO_COMPU_METHOD 0 0 0 1 BIT_MASK 0x1 ECU_ADDRESS 0x0 SYMBOL_LINK "NvM_BlockMngmtArea_at[1].NvRamAttributes_u8" 0 /end MEASUREMENT
/begin MEASUREMENT NvMConfigBlock_NVM_WR_PROT_SET "Block\'s write protection status" UBYTE NO_COMPU_METHOD 0 0 0 1 BIT_MASK 0x80 ECU_ADDRESS 0x0 SYMBOL_LINK "NvM_BlockMngmtArea_at[1].NvRamAttributes_u8" 0 /end MEASUREMENT
/begin MEASUREMENT NvMConfigBlock_NvDataIndex "Block\'s dataset index" UBYTE NO_COMPU_METHOD 0 0 0 255 ECU_ADDRESS 0x0 SYMBOL_LINK "NvM_BlockMngmtArea_at[1].NvDataIndex_t" 0 /end MEASUREMENT
/begin MEASUREMENT NvMConfigBlock_NvRam_ErrorStatus "Block\'s error status" UBYTE NvMErrorStatusValues 0 0 0 255 ECU_ADDRESS 0x0 SYMBOL_LINK "NvM_BlockMngmtArea_at[1].NvRamErrorStatus_u8" 0 /end MEASUREMENT
/begin MEASUREMENT PduR_BmTxBufferArrayRam "PduR BufferManagere TxBufferArray Table" UBYTE NO_COMPU_METHOD 0 0 0 255 ECU_ADDRESS 0x0 MATRIX_DIM 181 SYMBOL_LINK "PduR_BmTxBufferArrayRam.raw" 0 /end MEASUREMENT
/begin MEASUREMENT PduR_BmTxBufferArrayRam_PduRTxBuffer_32 "The element: PduRTxBuffer_32 of PduR_BmTxBufferArrayRam" UBYTE NO_COMPU_METHOD 0 0 0 255 ECU_ADDRESS 0x0 MATRIX_DIM 33 SYMBOL_LINK "PduR_BmTxBufferArrayRam.raw[9]" 0 /end MEASUREMENT
/begin MEASUREMENT PduR_BmTxBufferArrayRam_PduRTxBuffer_33 "The element: PduRTxBuffer_33 of PduR_BmTxBufferArrayRam" UBYTE NO_COMPU_METHOD 0 0 0 255 ECU_ADDRESS 0x0 MATRIX_DIM 33 SYMBOL_LINK "PduR_BmTxBufferArrayRam.raw[42]" 0 /end MEASUREMENT
/begin MEASUREMENT PduR_BmTxBufferArrayRam_PduRTxBuffer_34 "The element: PduRTxBuffer_34 of PduR_BmTxBufferArrayRam" UBYTE NO_COMPU_METHOD 0 0 0 255 ECU_ADDRESS 0x0 MATRIX_DIM 33 SYMBOL_LINK "PduR_BmTxBufferArrayRam.raw[75]" 0 /end MEASUREMENT
/begin MEASUREMENT PduR_BmTxBufferArrayRam_PduRTxBuffer_72 "The element: PduRTxBuffer_72 of PduR_BmTxBufferArrayRam" UBYTE NO_COMPU_METHOD 0 0 0 255 ECU_ADDRESS 0x0 MATRIX_DIM 73 SYMBOL_LINK "PduR_BmTxBufferArrayRam.raw[108]" 0 /end MEASUREMENT
/begin MEASUREMENT PduR_BmTxBufferArrayRam_PduRTxBuffer_8 "The element: PduRTxBuffer_8 of PduR_BmTxBufferArrayRam" UBYTE NO_COMPU_METHOD 0 0 0 255 ECU_ADDRESS 0x0 MATRIX_DIM 9 SYMBOL_LINK "PduR_BmTxBufferArrayRam.raw[0]" 0 /end MEASUREMENT
/begin MEASUREMENT PduR_BmTxBufferInstanceRam[0].BmTxBufferArrayRamReadIdxOfBmTxBufferInstanceRam "" ULONG NO_COMPU_METHOD 0 0 0 4294967295 ECU_ADDRESS 0x0 SYMBOL_LINK "PduR_BmTxBufferInstanceRam.raw[0].BmTxBufferArrayRamReadIdxOfBmTxBufferInstanceRam" 0 /end MEASUREMENT
/begin MEASUREMENT PduR_BmTxBufferInstanceRam[1].BmTxBufferArrayRamReadIdxOfBmTxBufferInstanceRam "" ULONG NO_COMPU_METHOD 0 0 0 4294967295 ECU_ADDRESS 0x0 SYMBOL_LINK "PduR_BmTxBufferInstanceRam.raw[1].BmTxBufferArrayRamReadIdxOfBmTxBufferInstanceRam" 0 /end MEASUREMENT
/begin MEASUREMENT PduR_BmTxBufferInstanceRam[2].BmTxBufferArrayRamReadIdxOfBmTxBufferInstanceRam "" ULONG NO_COMPU_METHOD 0 0 0 4294967295 ECU_ADDRESS 0x0 SYMBOL_LINK "PduR_BmTxBufferInstanceRam.raw[2].BmTxBufferArrayRamReadIdxOfBmTxBufferInstanceRam" 0 /end MEASUREMENT
/begin MEASUREMENT PduR_BmTxBufferInstanceRam[3].BmTxBufferArrayRamReadIdxOfBmTxBufferInstanceRam "" ULONG NO_COMPU_METHOD 0 0 0 4294967295 ECU_ADDRESS 0x0 SYMBOL_LINK "PduR_BmTxBufferInstanceRam.raw[3].BmTxBufferArrayRamReadIdxOfBmTxBufferInstanceRam" 0 /end MEASUREMENT
/begin MEASUREMENT PduR_BmTxBufferInstanceRam[4].BmTxBufferArrayRamReadIdxOfBmTxBufferInstanceRam "" ULONG NO_COMPU_METHOD 0 0 0 4294967295 ECU_ADDRESS 0x0 SYMBOL_LINK "PduR_BmTxBufferInstanceRam.raw[4].BmTxBufferArrayRamReadIdxOfBmTxBufferInstanceRam" 0 /end MEASUREMENT
/begin MEASUREMENT PduR_BmTxBufferInstanceRam[5].BmTxBufferArrayRamReadIdxOfBmTxBufferInstanceRam "" ULONG NO_COMPU_METHOD 0 0 0 4294967295 ECU_ADDRESS 0x0 SYMBOL_LINK "PduR_BmTxBufferInstanceRam.raw[5].BmTxBufferArrayRamReadIdxOfBmTxBufferInstanceRam" 0 /end MEASUREMENT
/begin MEASUREMENT PduR_BmTxBufferInstanceRam[6].BmTxBufferArrayRamReadIdxOfBmTxBufferInstanceRam "" ULONG NO_COMPU_METHOD 0 0 0 4294967295 ECU_ADDRESS 0x0 SYMBOL_LINK "PduR_BmTxBufferInstanceRam.raw[6].BmTxBufferArrayRamReadIdxOfBmTxBufferInstanceRam" 0 /end MEASUREMENT
/begin MEASUREMENT PduR_BmTxBufferInstanceRam[7].BmTxBufferArrayRamReadIdxOfBmTxBufferInstanceRam "" ULONG NO_COMPU_METHOD 0 0 0 4294967295 ECU_ADDRESS 0x0 SYMBOL_LINK "PduR_BmTxBufferInstanceRam.raw[7].BmTxBufferArrayRamReadIdxOfBmTxBufferInstanceRam" 0 /end MEASUREMENT
/begin MEASUREMENT PduR_BmTxBufferInstanceRam[8].BmTxBufferArrayRamReadIdxOfBmTxBufferInstanceRam "" ULONG NO_COMPU_METHOD 0 0 0 4294967295 ECU_ADDRESS 0x0 SYMBOL_LINK "PduR_BmTxBufferInstanceRam.raw[8].BmTxBufferArrayRamReadIdxOfBmTxBufferInstanceRam" 0 /end MEASUREMENT
/begin MEASUREMENT PduR_BmTxBufferInstanceRam[9].BmTxBufferArrayRamReadIdxOfBmTxBufferInstanceRam "" ULONG NO_COMPU_METHOD 0 0 0 4294967295 ECU_ADDRESS 0x0 SYMBOL_LINK "PduR_BmTxBufferInstanceRam.raw[9].BmTxBufferArrayRamReadIdxOfBmTxBufferInstanceRam" 0 /end MEASUREMENT
/begin MEASUREMENT PduR_BmTxBufferInstanceRam_PduRTxBuffer_32[0].BmTxBufferArrayRamReadIdxOfBmTxBufferInstanceRam "" ULONG NO_COMPU_METHOD 0 0 0 4294967295 ECU_ADDRESS 0x0 SYMBOL_LINK "PduR_BmTxBufferInstanceRam.raw[2][0].BmTxBufferArrayRamReadIdxOfBmTxBufferInstanceRam" 0 /end MEASUREMENT
/begin MEASUREMENT PduR_BmTxBufferInstanceRam_PduRTxBuffer_32[1].BmTxBufferArrayRamReadIdxOfBmTxBufferInstanceRam "" ULONG NO_COMPU_METHOD 0 0 0 4294967295 ECU_ADDRESS 0x0 SYMBOL_LINK "PduR_BmTxBufferInstanceRam.raw[2][1].BmTxBufferArrayRamReadIdxOfBmTxBufferInstanceRam" 0 /end MEASUREMENT
/begin MEASUREMENT PduR_BmTxBufferInstanceRam_PduRTxBuffer_33[0].BmTxBufferArrayRamReadIdxOfBmTxBufferInstanceRam "" ULONG NO_COMPU_METHOD 0 0 0 4294967295 ECU_ADDRESS 0x0 SYMBOL_LINK "PduR_BmTxBufferInstanceRam.raw[4][0].BmTxBufferArrayRamReadIdxOfBmTxBufferInstanceRam" 0 /end MEASUREMENT
/begin MEASUREMENT PduR_BmTxBufferInstanceRam_PduRTxBuffer_33[1].BmTxBufferArrayRamReadIdxOfBmTxBufferInstanceRam "" ULONG NO_COMPU_METHOD 0 0 0 4294967295 ECU_ADDRESS 0x0 SYMBOL_LINK "PduR_BmTxBufferInstanceRam.raw[4][1].BmTxBufferArrayRamReadIdxOfBmTxBufferInstanceRam" 0 /end MEASUREMENT
/begin MEASUREMENT PduR_BmTxBufferInstanceRam_PduRTxBuffer_34[0].BmTxBufferArrayRamReadIdxOfBmTxBufferInstanceRam "" ULONG NO_COMPU_METHOD 0 0 0 4294967295 ECU_ADDRESS 0x0 SYMBOL_LINK "PduR_BmTxBufferInstanceRam.raw[6][0].BmTxBufferArrayRamReadIdxOfBmTxBufferInstanceRam" 0 /end MEASUREMENT
/begin MEASUREMENT PduR_BmTxBufferInstanceRam_PduRTxBuffer_34[1].BmTxBufferArrayRamReadIdxOfBmTxBufferInstanceRam "" ULONG NO_COMPU_METHOD 0 0 0 4294967295 ECU_ADDRESS 0x0 SYMBOL_LINK "PduR_BmTxBufferInstanceRam.raw[6][1].BmTxBufferArrayRamReadIdxOfBmTxBufferInstanceRam" 0 /end MEASUREMENT
/begin MEASUREMENT PduR_BmTxBufferInstanceRam_PduRTxBuffer_72[0].BmTxBufferArrayRamReadIdxOfBmTxBufferInstanceRam "" ULONG NO_COMPU_METHOD 0 0 0 4294967295 ECU_ADDRESS 0x0 SYMBOL_LINK "PduR_BmTxBufferInstanceRam.raw[8][0].BmTxBufferArrayRamReadIdxOfBmTxBufferInstanceRam" 0 /end MEASUREMENT
/begin MEASUREMENT PduR_BmTxBufferInstanceRam_PduRTxBuffer_72[1].BmTxBufferArrayRamReadIdxOfBmTxBufferInstanceRam "" ULONG NO_COMPU_METHOD 0 0 0 4294967295 ECU_ADDRESS 0x0 SYMBOL_LINK "PduR_BmTxBufferInstanceRam.raw[8][1].BmTxBufferArrayRamReadIdxOfBmTxBufferInstanceRam" 0 /end MEASUREMENT
/begin MEASUREMENT PduR_BmTxBufferInstanceRam_PduRTxBuffer_8[0].BmTxBufferArrayRamReadIdxOfBmTxBufferInstanceRam "" ULONG NO_COMPU_METHOD 0 0 0 4294967295 ECU_ADDRESS 0x0 SYMBOL_LINK "PduR_BmTxBufferInstanceRam.raw[0][0].BmTxBufferArrayRamReadIdxOfBmTxBufferInstanceRam" 0 /end MEASUREMENT
/begin MEASUREMENT PduR_BmTxBufferInstanceRam_PduRTxBuffer_8[1].BmTxBufferArrayRamReadIdxOfBmTxBufferInstanceRam "" ULONG NO_COMPU_METHOD 0 0 0 4294967295 ECU_ADDRESS 0x0 SYMBOL_LINK "PduR_BmTxBufferInstanceRam.raw[0][1].BmTxBufferArrayRamReadIdxOfBmTxBufferInstanceRam" 0 /end MEASUREMENT
/begin MEASUREMENT PduR_BmTxBufferInstanceRom[0].BmTxBufferRomIdxOfBmTxBufferInstanceRom "" UBYTE NO_COMPU_METHOD 0 0 0 255 ECU_ADDRESS 0x0 /end MEASUREMENT
/begin MEASUREMENT PduR_BmTxBufferInstanceRom[1].BmTxBufferRomIdxOfBmTxBufferInstanceRom "" UBYTE NO_COMPU_METHOD 0 0 0 255 ECU_ADDRESS 0x0 /end MEASUREMENT
/begin MEASUREMENT PduR_BmTxBufferInstanceRom[2].BmTxBufferRomIdxOfBmTxBufferInstanceRom "" UBYTE NO_COMPU_METHOD 0 0 0 255 ECU_ADDRESS 0x0 /end MEASUREMENT
/begin MEASUREMENT PduR_BmTxBufferInstanceRom[3].BmTxBufferRomIdxOfBmTxBufferInstanceRom "" UBYTE NO_COMPU_METHOD 0 0 0 255 ECU_ADDRESS 0x0 /end MEASUREMENT
/begin MEASUREMENT PduR_BmTxBufferInstanceRom[4].BmTxBufferRomIdxOfBmTxBufferInstanceRom "" UBYTE NO_COMPU_METHOD 0 0 0 255 ECU_ADDRESS 0x0 /end MEASUREMENT
/begin MEASUREMENT PduR_BmTxBufferInstanceRom[5].BmTxBufferRomIdxOfBmTxBufferInstanceRom "" UBYTE NO_COMPU_METHOD 0 0 0 255 ECU_ADDRESS 0x0 /end MEASUREMENT
/begin MEASUREMENT PduR_BmTxBufferInstanceRom[6].BmTxBufferRomIdxOfBmTxBufferInstanceRom "" UBYTE NO_COMPU_METHOD 0 0 0 255 ECU_ADDRESS 0x0 /end MEASUREMENT
/begin MEASUREMENT PduR_BmTxBufferInstanceRom[7].BmTxBufferRomIdxOfBmTxBufferInstanceRom "" UBYTE NO_COMPU_METHOD 0 0 0 255 ECU_ADDRESS 0x0 /end MEASUREMENT
/begin MEASUREMENT PduR_BmTxBufferInstanceRom[8].BmTxBufferRomIdxOfBmTxBufferInstanceRom "" UBYTE NO_COMPU_METHOD 0 0 0 255 ECU_ADDRESS 0x0 /end MEASUREMENT
/begin MEASUREMENT PduR_BmTxBufferInstanceRom[9].BmTxBufferRomIdxOfBmTxBufferInstanceRom "" UBYTE NO_COMPU_METHOD 0 0 0 255 ECU_ADDRESS 0x0 /end MEASUREMENT
/begin MEASUREMENT PduR_BmTxBufferRam[0].AllocatedOfBmTxBufferRam "" UBYTE PduR_AllocatedOfBmTxBufferRamType 0 0 0 1 ECU_ADDRESS 0x0 SYMBOL_LINK "PduR_BmTxBufferRam.raw[0].AllocatedOfBmTxBufferRam" 0 /end MEASUREMENT
/begin MEASUREMENT PduR_BmTxBufferRam[0].BmTxBufferArrayRamWriteIdxOfBmTxBufferRam "" ULONG NO_COMPU_METHOD 0 0 0 4294967295 ECU_ADDRESS 0x0 SYMBOL_LINK "PduR_BmTxBufferRam.raw[0].BmTxBufferArrayRamWriteIdxOfBmTxBufferRam" 0 /end MEASUREMENT
/begin MEASUREMENT PduR_BmTxBufferRam[0].RxLengthOfBmTxBufferRam "" UWORD NO_COMPU_METHOD 0 0 0 65535 ECU_ADDRESS 0x0 SYMBOL_LINK "PduR_BmTxBufferRam.raw[0].RxLengthOfBmTxBufferRam" 0 /end MEASUREMENT
/begin MEASUREMENT PduR_BmTxBufferRam[1].AllocatedOfBmTxBufferRam "" UBYTE PduR_AllocatedOfBmTxBufferRamType 0 0 0 1 ECU_ADDRESS 0x0 SYMBOL_LINK "PduR_BmTxBufferRam.raw[1].AllocatedOfBmTxBufferRam" 0 /end MEASUREMENT
/begin MEASUREMENT PduR_BmTxBufferRam[1].BmTxBufferArrayRamWriteIdxOfBmTxBufferRam "" ULONG NO_COMPU_METHOD 0 0 0 4294967295 ECU_ADDRESS 0x0 SYMBOL_LINK "PduR_BmTxBufferRam.raw[1].BmTxBufferArrayRamWriteIdxOfBmTxBufferRam" 0 /end MEASUREMENT
/begin MEASUREMENT PduR_BmTxBufferRam[1].RxLengthOfBmTxBufferRam "" UWORD NO_COMPU_METHOD 0 0 0 65535 ECU_ADDRESS 0x0 SYMBOL_LINK "PduR_BmTxBufferRam.raw[1].RxLengthOfBmTxBufferRam" 0 /end MEASUREMENT
/begin MEASUREMENT PduR_BmTxBufferRam[2].AllocatedOfBmTxBufferRam "" UBYTE PduR_AllocatedOfBmTxBufferRamType 0 0 0 1 ECU_ADDRESS 0x0 SYMBOL_LINK "PduR_BmTxBufferRam.raw[2].AllocatedOfBmTxBufferRam" 0 /end MEASUREMENT
/begin MEASUREMENT PduR_BmTxBufferRam[2].BmTxBufferArrayRamWriteIdxOfBmTxBufferRam "" ULONG NO_COMPU_METHOD 0 0 0 4294967295 ECU_ADDRESS 0x0 SYMBOL_LINK "PduR_BmTxBufferRam.raw[2].BmTxBufferArrayRamWriteIdxOfBmTxBufferRam" 0 /end MEASUREMENT
/begin MEASUREMENT PduR_BmTxBufferRam[2].RxLengthOfBmTxBufferRam "" UWORD NO_COMPU_METHOD 0 0 0 65535 ECU_ADDRESS 0x0 SYMBOL_LINK "PduR_BmTxBufferRam.raw[2].RxLengthOfBmTxBufferRam" 0 /end MEASUREMENT
/begin MEASUREMENT PduR_BmTxBufferRam[3].AllocatedOfBmTxBufferRam "" UBYTE PduR_AllocatedOfBmTxBufferRamType 0 0 0 1 ECU_ADDRESS 0x0 SYMBOL_LINK "PduR_BmTxBufferRam.raw[3].AllocatedOfBmTxBufferRam" 0 /end MEASUREMENT
/begin MEASUREMENT PduR_BmTxBufferRam[3].BmTxBufferArrayRamWriteIdxOfBmTxBufferRam "" ULONG NO_COMPU_METHOD 0 0 0 4294967295 ECU_ADDRESS 0x0 SYMBOL_LINK "PduR_BmTxBufferRam.raw[3].BmTxBufferArrayRamWriteIdxOfBmTxBufferRam" 0 /end MEASUREMENT
/begin MEASUREMENT PduR_BmTxBufferRam[3].RxLengthOfBmTxBufferRam "" UWORD NO_COMPU_METHOD 0 0 0 65535 ECU_ADDRESS 0x0 SYMBOL_LINK "PduR_BmTxBufferRam.raw[3].RxLengthOfBmTxBufferRam" 0 /end MEASUREMENT
/begin MEASUREMENT PduR_BmTxBufferRam[4].AllocatedOfBmTxBufferRam "" UBYTE PduR_AllocatedOfBmTxBufferRamType 0 0 0 1 ECU_ADDRESS 0x0 SYMBOL_LINK "PduR_BmTxBufferRam.raw[4].AllocatedOfBmTxBufferRam" 0 /end MEASUREMENT
/begin MEASUREMENT PduR_BmTxBufferRam[4].BmTxBufferArrayRamWriteIdxOfBmTxBufferRam "" ULONG NO_COMPU_METHOD 0 0 0 4294967295 ECU_ADDRESS 0x0 SYMBOL_LINK "PduR_BmTxBufferRam.raw[4].BmTxBufferArrayRamWriteIdxOfBmTxBufferRam" 0 /end MEASUREMENT
/begin MEASUREMENT PduR_BmTxBufferRam[4].RxLengthOfBmTxBufferRam "" UWORD NO_COMPU_METHOD 0 0 0 65535 ECU_ADDRESS 0x0 SYMBOL_LINK "PduR_BmTxBufferRam.raw[4].RxLengthOfBmTxBufferRam" 0 /end MEASUREMENT
/begin MEASUREMENT PduR_BmTxBufferRam_PduRTxBuffer_32[0].AllocatedOfBmTxBufferRam "" UBYTE PduR_AllocatedOfBmTxBufferRamType 0 0 0 1 ECU_ADDRESS 0x0 SYMBOL_LINK "PduR_BmTxBufferRam.raw[1][0].AllocatedOfBmTxBufferRam" 0 /end MEASUREMENT
/begin MEASUREMENT PduR_BmTxBufferRam_PduRTxBuffer_32[0].BmTxBufferArrayRamWriteIdxOfBmTxBufferRam "" ULONG NO_COMPU_METHOD 0 0 0 4294967295 ECU_ADDRESS 0x0 SYMBOL_LINK "PduR_BmTxBufferRam.raw[1][0].BmTxBufferArrayRamWriteIdxOfBmTxBufferRam" 0 /end MEASUREMENT
/begin MEASUREMENT PduR_BmTxBufferRam_PduRTxBuffer_32[0].RxLengthOfBmTxBufferRam "" UWORD NO_COMPU_METHOD 0 0 0 65535 ECU_ADDRESS 0x0 SYMBOL_LINK "PduR_BmTxBufferRam.raw[1][0].RxLengthOfBmTxBufferRam" 0 /end MEASUREMENT
/begin MEASUREMENT PduR_BmTxBufferRam_PduRTxBuffer_33[0].AllocatedOfBmTxBufferRam "" UBYTE PduR_AllocatedOfBmTxBufferRamType 0 0 0 1 ECU_ADDRESS 0x0 SYMBOL_LINK "PduR_BmTxBufferRam.raw[2][0].AllocatedOfBmTxBufferRam" 0 /end MEASUREMENT
/begin MEASUREMENT PduR_BmTxBufferRam_PduRTxBuffer_33[0].BmTxBufferArrayRamWriteIdxOfBmTxBufferRam "" ULONG NO_COMPU_METHOD 0 0 0 4294967295 ECU_ADDRESS 0x0 SYMBOL_LINK "PduR_BmTxBufferRam.raw[2][0].BmTxBufferArrayRamWriteIdxOfBmTxBufferRam" 0 /end MEASUREMENT
/begin MEASUREMENT PduR_BmTxBufferRam_PduRTxBuffer_33[0].RxLengthOfBmTxBufferRam "" UWORD NO_COMPU_METHOD 0 0 0 65535 ECU_ADDRESS 0x0 SYMBOL_LINK "PduR_BmTxBufferRam.raw[2][0].RxLengthOfBmTxBufferRam" 0 /end MEASUREMENT
/begin MEASUREMENT PduR_BmTxBufferRam_PduRTxBuffer_34[0].AllocatedOfBmTxBufferRam "" UBYTE PduR_AllocatedOfBmTxBufferRamType 0 0 0 1 ECU_ADDRESS 0x0 SYMBOL_LINK "PduR_BmTxBufferRam.raw[3][0].AllocatedOfBmTxBufferRam" 0 /end MEASUREMENT
/begin MEASUREMENT PduR_BmTxBufferRam_PduRTxBuffer_34[0].BmTxBufferArrayRamWriteIdxOfBmTxBufferRam "" ULONG NO_COMPU_METHOD 0 0 0 4294967295 ECU_ADDRESS 0x0 SYMBOL_LINK "PduR_BmTxBufferRam.raw[3][0].BmTxBufferArrayRamWriteIdxOfBmTxBufferRam" 0 /end MEASUREMENT
/begin MEASUREMENT PduR_BmTxBufferRam_PduRTxBuffer_34[0].RxLengthOfBmTxBufferRam "" UWORD NO_COMPU_METHOD 0 0 0 65535 ECU_ADDRESS 0x0 SYMBOL_LINK "PduR_BmTxBufferRam.raw[3][0].RxLengthOfBmTxBufferRam" 0 /end MEASUREMENT
/begin MEASUREMENT PduR_BmTxBufferRam_PduRTxBuffer_72[0].AllocatedOfBmTxBufferRam "" UBYTE PduR_AllocatedOfBmTxBufferRamType 0 0 0 1 ECU_ADDRESS 0x0 SYMBOL_LINK "PduR_BmTxBufferRam.raw[4][0].AllocatedOfBmTxBufferRam" 0 /end MEASUREMENT
/begin MEASUREMENT PduR_BmTxBufferRam_PduRTxBuffer_72[0].BmTxBufferArrayRamWriteIdxOfBmTxBufferRam "" ULONG NO_COMPU_METHOD 0 0 0 4294967295 ECU_ADDRESS 0x0 SYMBOL_LINK "PduR_BmTxBufferRam.raw[4][0].BmTxBufferArrayRamWriteIdxOfBmTxBufferRam" 0 /end MEASUREMENT
/begin MEASUREMENT PduR_BmTxBufferRam_PduRTxBuffer_72[0].RxLengthOfBmTxBufferRam "" UWORD NO_COMPU_METHOD 0 0 0 65535 ECU_ADDRESS 0x0 SYMBOL_LINK "PduR_BmTxBufferRam.raw[4][0].RxLengthOfBmTxBufferRam" 0 /end MEASUREMENT
/begin MEASUREMENT PduR_BmTxBufferRam_PduRTxBuffer_8[0].AllocatedOfBmTxBufferRam "" UBYTE PduR_AllocatedOfBmTxBufferRamType 0 0 0 1 ECU_ADDRESS 0x0 SYMBOL_LINK "PduR_BmTxBufferRam.raw[0][0].AllocatedOfBmTxBufferRam" 0 /end MEASUREMENT
/begin MEASUREMENT PduR_BmTxBufferRam_PduRTxBuffer_8[0].BmTxBufferArrayRamWriteIdxOfBmTxBufferRam "" ULONG NO_COMPU_METHOD 0 0 0 4294967295 ECU_ADDRESS 0x0 SYMBOL_LINK "PduR_BmTxBufferRam.raw[0][0].BmTxBufferArrayRamWriteIdxOfBmTxBufferRam" 0 /end MEASUREMENT
/begin MEASUREMENT PduR_BmTxBufferRam_PduRTxBuffer_8[0].RxLengthOfBmTxBufferRam "" UWORD NO_COMPU_METHOD 0 0 0 65535 ECU_ADDRESS 0x0 SYMBOL_LINK "PduR_BmTxBufferRam.raw[0][0].RxLengthOfBmTxBufferRam" 0 /end MEASUREMENT
/begin MEASUREMENT PduR_BmTxBufferRom[0].BmTxBufferArrayRamEndIdxOfBmTxBufferRom "" UBYTE NO_COMPU_METHOD 0 0 0 255 ECU_ADDRESS 0x0 /end MEASUREMENT
/begin MEASUREMENT PduR_BmTxBufferRom[0].BmTxBufferArrayRamStartIdxOfBmTxBufferRom "" UBYTE NO_COMPU_METHOD 0 0 0 255 ECU_ADDRESS 0x0 /end MEASUREMENT
/begin MEASUREMENT PduR_BmTxBufferRom[0].BmTxBufferInstanceRomStartIdxOfBmTxBufferRom "" UBYTE NO_COMPU_METHOD 0 0 0 255 ECU_ADDRESS 0x0 /end MEASUREMENT
/begin MEASUREMENT PduR_BmTxBufferRom[1].BmTxBufferArrayRamEndIdxOfBmTxBufferRom "" UBYTE NO_COMPU_METHOD 0 0 0 255 ECU_ADDRESS 0x0 /end MEASUREMENT
/begin MEASUREMENT PduR_BmTxBufferRom[1].BmTxBufferArrayRamStartIdxOfBmTxBufferRom "" UBYTE NO_COMPU_METHOD 0 0 0 255 ECU_ADDRESS 0x0 /end MEASUREMENT
/begin MEASUREMENT PduR_BmTxBufferRom[1].BmTxBufferInstanceRomStartIdxOfBmTxBufferRom "" UBYTE NO_COMPU_METHOD 0 0 0 255 ECU_ADDRESS 0x0 /end MEASUREMENT
/begin MEASUREMENT PduR_BmTxBufferRom[2].BmTxBufferArrayRamEndIdxOfBmTxBufferRom "" UBYTE NO_COMPU_METHOD 0 0 0 255 ECU_ADDRESS 0x0 /end MEASUREMENT
/begin MEASUREMENT PduR_BmTxBufferRom[2].BmTxBufferArrayRamStartIdxOfBmTxBufferRom "" UBYTE NO_COMPU_METHOD 0 0 0 255 ECU_ADDRESS 0x0 /end MEASUREMENT
/begin MEASUREMENT PduR_BmTxBufferRom[2].BmTxBufferInstanceRomStartIdxOfBmTxBufferRom "" UBYTE NO_COMPU_METHOD 0 0 0 255 ECU_ADDRESS 0x0 /end MEASUREMENT
/begin MEASUREMENT PduR_BmTxBufferRom[3].BmTxBufferArrayRamEndIdxOfBmTxBufferRom "" UBYTE NO_COMPU_METHOD 0 0 0 255 ECU_ADDRESS 0x0 /end MEASUREMENT
/begin MEASUREMENT PduR_BmTxBufferRom[3].BmTxBufferArrayRamStartIdxOfBmTxBufferRom "" UBYTE NO_COMPU_METHOD 0 0 0 255 ECU_ADDRESS 0x0 /end MEASUREMENT
/begin MEASUREMENT PduR_BmTxBufferRom[3].BmTxBufferInstanceRomStartIdxOfBmTxBufferRom "" UBYTE NO_COMPU_METHOD 0 0 0 255 ECU_ADDRESS 0x0 /end MEASUREMENT
/begin MEASUREMENT PduR_BmTxBufferRom[4].BmTxBufferArrayRamEndIdxOfBmTxBufferRom "" UBYTE NO_COMPU_METHOD 0 0 0 255 ECU_ADDRESS 0x0 /end MEASUREMENT
/begin MEASUREMENT PduR_BmTxBufferRom[4].BmTxBufferArrayRamStartIdxOfBmTxBufferRom "" UBYTE NO_COMPU_METHOD 0 0 0 255 ECU_ADDRESS 0x0 /end MEASUREMENT
/begin MEASUREMENT PduR_BmTxBufferRom[4].BmTxBufferInstanceRomStartIdxOfBmTxBufferRom "" UBYTE NO_COMPU_METHOD 0 0 0 255 ECU_ADDRESS 0x0 /end MEASUREMENT
/begin MEASUREMENT PduR_DestApplicationManagerRom[0].RmGDestRomStartIdxOfDestApplicationManagerRom "" UBYTE PduR_RmGDestRomStartIdxOfDestApplicationManagerRomType 0 0 0 255 ECU_ADDRESS 0x0 /end MEASUREMENT
/begin MEASUREMENT PduR_FmFifoElementRam[0].BmTxBufferRomIdxOfFmFifoElementRam "" UBYTE NO_COMPU_METHOD 0 0 0 255 ECU_ADDRESS 0x0 SYMBOL_LINK "PduR_FmFifoElementRam.raw[0].BmTxBufferRomIdxOfFmFifoElementRam" 0 /end MEASUREMENT
/begin MEASUREMENT PduR_FmFifoElementRam[0].RmDestRomIdxOfFmFifoElementRam "" UBYTE NO_COMPU_METHOD 0 0 0 255 ECU_ADDRESS 0x0 SYMBOL_LINK "PduR_FmFifoElementRam.raw[0].RmDestRomIdxOfFmFifoElementRam" 0 /end MEASUREMENT
/begin MEASUREMENT PduR_FmFifoElementRam[1].BmTxBufferRomIdxOfFmFifoElementRam "" UBYTE NO_COMPU_METHOD 0 0 0 255 ECU_ADDRESS 0x0 SYMBOL_LINK "PduR_FmFifoElementRam.raw[1].BmTxBufferRomIdxOfFmFifoElementRam" 0 /end MEASUREMENT
/begin MEASUREMENT PduR_FmFifoElementRam[1].RmDestRomIdxOfFmFifoElementRam "" UBYTE NO_COMPU_METHOD 0 0 0 255 ECU_ADDRESS 0x0 SYMBOL_LINK "PduR_FmFifoElementRam.raw[1].RmDestRomIdxOfFmFifoElementRam" 0 /end MEASUREMENT
/begin MEASUREMENT PduR_FmFifoElementRam_PduRQueue[0].BmTxBufferRomIdxOfFmFifoElementRam "" UBYTE NO_COMPU_METHOD 0 0 0 255 ECU_ADDRESS 0x0 SYMBOL_LINK "PduR_FmFifoElementRam.raw[0][0].BmTxBufferRomIdxOfFmFifoElementRam" 0 /end MEASUREMENT
/begin MEASUREMENT PduR_FmFifoElementRam_PduRQueue[0].RmDestRomIdxOfFmFifoElementRam "" UBYTE NO_COMPU_METHOD 0 0 0 255 ECU_ADDRESS 0x0 SYMBOL_LINK "PduR_FmFifoElementRam.raw[0][0].RmDestRomIdxOfFmFifoElementRam" 0 /end MEASUREMENT
/begin MEASUREMENT PduR_FmFifoElementRam_PduRQueue[1].BmTxBufferRomIdxOfFmFifoElementRam "" UBYTE NO_COMPU_METHOD 0 0 0 255 ECU_ADDRESS 0x0 SYMBOL_LINK "PduR_FmFifoElementRam.raw[0][1].BmTxBufferRomIdxOfFmFifoElementRam" 0 /end MEASUREMENT
/begin MEASUREMENT PduR_FmFifoElementRam_PduRQueue[1].RmDestRomIdxOfFmFifoElementRam "" UBYTE NO_COMPU_METHOD 0 0 0 255 ECU_ADDRESS 0x0 SYMBOL_LINK "PduR_FmFifoElementRam.raw[0][1].RmDestRomIdxOfFmFifoElementRam" 0 /end MEASUREMENT
/begin MEASUREMENT PduR_FmFifoInstanceRam[0].BmTxBufferInstanceRomIdxOfFmFifoInstanceRam "" UBYTE NO_COMPU_METHOD 0 0 0 255 ECU_ADDRESS 0x0 SYMBOL_LINK "PduR_FmFifoInstanceRam.raw[0].BmTxBufferInstanceRomIdxOfFmFifoInstanceRam" 0 /end MEASUREMENT
/begin MEASUREMENT PduR_FmFifoInstanceRam_DCM_BMC_CAN01_XIX_TPCHType_CANHS_OBDC_Diagnose_XIX_0x17FD0200_XIX_Functional_e9b636f2_Tx[0].BmTxBufferInstanceRomIdxOfFmFifoInstanceRam "" UBYTE NO_COMPU_METHOD 0 0 0 255 ECU_ADDRESS 0x0 SYMBOL_LINK "PduR_FmFifoInstanceRam.raw[0][0].BmTxBufferInstanceRomIdxOfFmFifoInstanceRam" 0 /end MEASUREMENT
/begin MEASUREMENT PduR_GeneralPropertiesRom[0].hasIfRoutingOfGeneralPropertiesRom "" UBYTE PduR_hasIfRoutingOfGeneralPropertiesRomType 0 0 0 1 ECU_ADDRESS 0x0 /end MEASUREMENT
/begin MEASUREMENT PduR_InitializedRam "Initialized status of each partition the PduR runs on." UBYTE PduR_InitializedRamType 0 0 0 1 ECU_ADDRESS 0x0 SYMBOL_LINK "PduR_InitializedRam.raw" 0 /end MEASUREMENT
/begin MEASUREMENT PduR_InitializedRam_PduRSinglePartitionDummy "The element: PduRSinglePartitionDummy of PduR_InitializedRam" UBYTE PduR_InitializedRamType 0 0 0 1 ECU_ADDRESS 0x0 SYMBOL_LINK "PduR_InitializedRam.raw[0]" 0 /end MEASUREMENT
/begin MEASUREMENT PduR_LockRom[0].ExclusiveAreaRomIdxOfLockRom "" UBYTE PduR_ExclusiveAreaRomIdxOfLockRomType 0 0 0 255 ECU_ADDRESS 0x0 /end MEASUREMENT
/begin MEASUREMENT PduR_PartitionIdentifiers[0].PartitionSNVOfPartitionIdentifiers "" ULONG NO_COMPU_METHOD 0 0 0 4294967295 ECU_ADDRESS 0x0 /end MEASUREMENT
/begin MEASUREMENT PduR_RmBufferedTpPropertiesRam[0].FmFifoElementRamIdxOfRmBufferedTpPropertiesRam "" UBYTE NO_COMPU_METHOD 0 0 0 255 ECU_ADDRESS 0x0 SYMBOL_LINK "PduR_RmBufferedTpPropertiesRam.raw[0].FmFifoElementRamIdxOfRmBufferedTpPropertiesRam" 0 /end MEASUREMENT
/begin MEASUREMENT PduR_RmBufferedTpPropertiesRam[0].TpRxSmStateOfRmBufferedTpPropertiesRam "" UBYTE PduR_TpRxSmStateOfRmBufferedTpPropertiesRamType 0 0 0 255 ECU_ADDRESS 0x0 SYMBOL_LINK "PduR_RmBufferedTpPropertiesRam.raw[0].TpRxSmStateOfRmBufferedTpPropertiesRam" 0 /end MEASUREMENT
/begin MEASUREMENT PduR_RmBufferedTpPropertiesRam_PduRSrcPdu_31fc5fb2[0].FmFifoElementRamIdxOfRmBufferedTpPropertiesRam "" UBYTE NO_COMPU_METHOD 0 0 0 255 ECU_ADDRESS 0x0 SYMBOL_LINK "PduR_RmBufferedTpPropertiesRam.raw[0][0].FmFifoElementRamIdxOfRmBufferedTpPropertiesRam" 0 /end MEASUREMENT
/begin MEASUREMENT PduR_RmBufferedTpPropertiesRam_PduRSrcPdu_31fc5fb2[0].TpRxSmStateOfRmBufferedTpPropertiesRam "" UBYTE PduR_TpRxSmStateOfRmBufferedTpPropertiesRamType 0 0 0 255 ECU_ADDRESS 0x0 SYMBOL_LINK "PduR_RmBufferedTpPropertiesRam.raw[0][0].TpRxSmStateOfRmBufferedTpPropertiesRam" 0 /end MEASUREMENT
/begin MEASUREMENT PduR_RmDestRom[0].PduLengthHandlingStrategyOfRmDestRom "" UBYTE PduR_PduLengthHandlingStrategyOfRmDestRomType 0 0 0 255 ECU_ADDRESS 0x0 /end MEASUREMENT
/begin MEASUREMENT PduR_RmDestRom[0].RmGDestRomIdxOfRmDestRom "" UBYTE NO_COMPU_METHOD 0 0 0 255 ECU_ADDRESS 0x0 /end MEASUREMENT
/begin MEASUREMENT PduR_RmDestRom[0].RmSrcRomIdxOfRmDestRom "" UBYTE NO_COMPU_METHOD 0 0 0 255 ECU_ADDRESS 0x0 /end MEASUREMENT
/begin MEASUREMENT PduR_RmDestRom[0].RoutingTypeOfRmDestRom "" UBYTE PduR_RoutingTypeOfRmDestRomType 0 0 0 255 ECU_ADDRESS 0x0 /end MEASUREMENT
/begin MEASUREMENT PduR_RmDestRom[100].PduLengthHandlingStrategyOfRmDestRom "" UBYTE PduR_PduLengthHandlingStrategyOfRmDestRomType 0 0 0 255 ECU_ADDRESS 0x0 /end MEASUREMENT
/begin MEASUREMENT PduR_RmDestRom[100].RmGDestRomIdxOfRmDestRom "" UBYTE NO_COMPU_METHOD 0 0 0 255 ECU_ADDRESS 0x0 /end MEASUREMENT
/begin MEASUREMENT PduR_RmDestRom[100].RmSrcRomIdxOfRmDestRom "" UBYTE NO_COMPU_METHOD 0 0 0 255 ECU_ADDRESS 0x0 /end MEASUREMENT
/begin MEASUREMENT PduR_RmDestRom[100].RoutingTypeOfRmDestRom "" UBYTE PduR_RoutingTypeOfRmDestRomType 0 0 0 255 ECU_ADDRESS 0x0 /end MEASUREMENT
/begin MEASUREMENT PduR_RmDestRom[101].PduLengthHandlingStrategyOfRmDestRom "" UBYTE PduR_PduLengthHandlingStrategyOfRmDestRomType 0 0 0 255 ECU_ADDRESS 0x0 /end MEASUREMENT
/begin MEASUREMENT PduR_RmDestRom[101].RmGDestRomIdxOfRmDestRom "" UBYTE NO_COMPU_METHOD 0 0 0 255 ECU_ADDRESS 0x0 /end MEASUREMENT
/begin MEASUREMENT PduR_RmDestRom[101].RmSrcRomIdxOfRmDestRom "" UBYTE NO_COMPU_METHOD 0 0 0 255 ECU_ADDRESS 0x0 /end MEASUREMENT
/begin MEASUREMENT PduR_RmDestRom[101].RoutingTypeOfRmDestRom "" UBYTE PduR_RoutingTypeOfRmDestRomType 0 0 0 255 ECU_ADDRESS 0x0 /end MEASUREMENT
/begin MEASUREMENT PduR_RmDestRom[102].PduLengthHandlingStrategyOfRmDestRom "" UBYTE PduR_PduLengthHandlingStrategyOfRmDestRomType 0 0 0 255 ECU_ADDRESS 0x0 /end MEASUREMENT
/begin MEASUREMENT PduR_RmDestRom[102].RmGDestRomIdxOfRmDestRom "" UBYTE NO_COMPU_METHOD 0 0 0 255 ECU_ADDRESS 0x0 /end MEASUREMENT
/begin MEASUREMENT PduR_RmDestRom[102].RmSrcRomIdxOfRmDestRom "" UBYTE NO_COMPU_METHOD 0 0 0 255 ECU_ADDRESS 0x0 /end MEASUREMENT
/begin MEASUREMENT PduR_RmDestRom[102].RoutingTypeOfRmDestRom "" UBYTE PduR_RoutingTypeOfRmDestRomType 0 0 0 255 ECU_ADDRESS 0x0 /end MEASUREMENT
/begin MEASUREMENT PduR_RmDestRom[103].PduLengthHandlingStrategyOfRmDestRom "" UBYTE PduR_PduLengthHandlingStrategyOfRmDestRomType 0 0 0 255 ECU_ADDRESS 0x0 /end MEASUREMENT
/begin MEASUREMENT PduR_RmDestRom[103].RmGDestRomIdxOfRmDestRom "" UBYTE NO_COMPU_METHOD 0 0 0 255 ECU_ADDRESS 0x0 /end MEASUREMENT
/begin MEASUREMENT PduR_RmDestRom[103].RmSrcRomIdxOfRmDestRom "" UBYTE NO_COMPU_METHOD 0 0 0 255 ECU_ADDRESS 0x0 /end MEASUREMENT
/begin MEASUREMENT PduR_RmDestRom[103].RoutingTypeOfRmDestRom "" UBYTE PduR_RoutingTypeOfRmDestRomType 0 0 0 255 ECU_ADDRESS 0x0 /end MEASUREMENT
/begin MEASUREMENT PduR_RmDestRom[104].PduLengthHandlingStrategyOfRmDestRom "" UBYTE PduR_PduLengthHandlingStrategyOfRmDestRomType 0 0 0 255 ECU_ADDRESS 0x0 /end MEASUREMENT
/begin MEASUREMENT PduR_RmDestRom[104].RmGDestRomIdxOfRmDestRom "" UBYTE NO_COMPU_METHOD 0 0 0 255 ECU_ADDRESS 0x0 /end MEASUREMENT
/begin MEASUREMENT PduR_RmDestRom[104].RmSrcRomIdxOfRmDestRom "" UBYTE NO_COMPU_METHOD 0 0 0 255 ECU_ADDRESS 0x0 /end MEASUREMENT
/begin MEASUREMENT PduR_RmDestRom[104].RoutingTypeOfRmDestRom "" UBYTE PduR_RoutingTypeOfRmDestRomType 0 0 0 255 ECU_ADDRESS 0x0 /end MEASUREMENT
/begin MEASUREMENT PduR_RmDestRom[105].PduLengthHandlingStrategyOfRmDestRom "" UBYTE PduR_PduLengthHandlingStrategyOfRmDestRomType 0 0 0 255 ECU_ADDRESS 0x0 /end MEASUREMENT
/begin MEASUREMENT PduR_RmDestRom[105].RmGDestRomIdxOfRmDestRom "" UBYTE NO_COMPU_METHOD 0 0 0 255 ECU_ADDRESS 0x0 /end MEASUREMENT
/begin MEASUREMENT PduR_RmDestRom[105].RmSrcRomIdxOfRmDestRom "" UBYTE NO_COMPU_METHOD 0 0 0 255 ECU_ADDRESS 0x0 /end MEASUREMENT
/begin MEASUREMENT PduR_RmDestRom[105].RoutingTypeOfRmDestRom "" UBYTE PduR_RoutingTypeOfRmDestRomType 0 0 0 255 ECU_ADDRESS 0x0 /end MEASUREMENT
/begin MEASUREMENT PduR_RmDestRom[106].PduLengthHandlingStrategyOfRmDestRom "" UBYTE PduR_PduLengthHandlingStrategyOfRmDestRomType 0 0 0 255 ECU_ADDRESS 0x0 /end MEASUREMENT
/begin MEASUREMENT PduR_RmDestRom[106].RmGDestRomIdxOfRmDestRom "" UBYTE NO_COMPU_METHOD 0 0 0 255 ECU_ADDRESS 0x0 /end MEASUREMENT
/begin MEASUREMENT PduR_RmDestRom[106].RmSrcRomIdxOfRmDestRom "" UBYTE NO_COMPU_METHOD 0 0 0 255 ECU_ADDRESS 0x0 /end MEASUREMENT
/begin MEASUREMENT PduR_RmDestRom[106].RoutingTypeOfRmDestRom "" UBYTE PduR_RoutingTypeOfRmDestRomType 0 0 0 255 ECU_ADDRESS 0x0 /end MEASUREMENT
/begin MEASUREMENT PduR_RmDestRom[107].PduLengthHandlingStrategyOfRmDestRom "" UBYTE PduR_PduLengthHandlingStrategyOfRmDestRomType 0 0 0 255 ECU_ADDRESS 0x0 /end MEASUREMENT
/begin MEASUREMENT PduR_RmDestRom[107].RmGDestRomIdxOfRmDestRom "" UBYTE NO_COMPU_METHOD 0 0 0 255 ECU_ADDRESS 0x0 /end MEASUREMENT
/begin MEASUREMENT PduR_RmDestRom[107].RmSrcRomIdxOfRmDestRom "" UBYTE NO_COMPU_METHOD 0 0 0 255 ECU_ADDRESS 0x0 /end MEASUREMENT
/begin MEASUREMENT PduR_RmDestRom[107].RoutingTypeOfRmDestRom "" UBYTE PduR_RoutingTypeOfRmDestRomType 0 0 0 255 ECU_ADDRESS 0x0 /end MEASUREMENT
/begin MEASUREMENT PduR_RmDestRom[108].PduLengthHandlingStrategyOfRmDestRom "" UBYTE PduR_PduLengthHandlingStrategyOfRmDestRomType 0 0 0 255 ECU_ADDRESS 0x0 /end MEASUREMENT
/begin MEASUREMENT PduR_RmDestRom[108].RmGDestRomIdxOfRmDestRom "" UBYTE NO_COMPU_METHOD 0 0 0 255 ECU_ADDRESS 0x0 /end MEASUREMENT
/begin MEASUREMENT PduR_RmDestRom[108].RmSrcRomIdxOfRmDestRom "" UBYTE NO_COMPU_METHOD 0 0 0 255 ECU_ADDRESS 0x0 /end MEASUREMENT
/begin MEASUREMENT PduR_RmDestRom[108].RoutingTypeOfRmDestRom "" UBYTE PduR_RoutingTypeOfRmDestRomType 0 0 0 255 ECU_ADDRESS 0x0 /end MEASUREMENT
/begin MEASUREMENT PduR_RmDestRom[109].PduLengthHandlingStrategyOfRmDestRom "" UBYTE PduR_PduLengthHandlingStrategyOfRmDestRomType 0 0 0 255 ECU_ADDRESS 0x0 /end MEASUREMENT
/begin MEASUREMENT PduR_RmDestRom[109].RmGDestRomIdxOfRmDestRom "" UBYTE NO_COMPU_METHOD 0 0 0 255 ECU_ADDRESS 0x0 /end MEASUREMENT
/begin MEASUREMENT PduR_RmDestRom[109].RmSrcRomIdxOfRmDestRom "" UBYTE NO_COMPU_METHOD 0 0 0 255 ECU_ADDRESS 0x0 /end MEASUREMENT
/begin MEASUREMENT PduR_RmDestRom[109].RoutingTypeOfRmDestRom "" UBYTE PduR_RoutingTypeOfRmDestRomType 0 0 0 255 ECU_ADDRESS 0x0 /end MEASUREMENT
/begin MEASUREMENT PduR_RmDestRom[10].PduLengthHandlingStrategyOfRmDestRom "" UBYTE PduR_PduLengthHandlingStrategyOfRmDestRomType 0 0 0 255 ECU_ADDRESS 0x0 /end MEASUREMENT
/begin MEASUREMENT PduR_RmDestRom[10].RmGDestRomIdxOfRmDestRom "" UBYTE NO_COMPU_METHOD 0 0 0 255 ECU_ADDRESS 0x0 /end MEASUREMENT
/begin MEASUREMENT PduR_RmDestRom[10].RmSrcRomIdxOfRmDestRom "" UBYTE NO_COMPU_METHOD 0 0 0 255 ECU_ADDRESS 0x0 /end MEASUREMENT
/begin MEASUREMENT PduR_RmDestRom[10].RoutingTypeOfRmDestRom "" UBYTE PduR_RoutingTypeOfRmDestRomType 0 0 0 255 ECU_ADDRESS 0x0 /end MEASUREMENT
/begin MEASUREMENT PduR_RmDestRom[110].PduLengthHandlingStrategyOfRmDestRom "" UBYTE PduR_PduLengthHandlingStrategyOfRmDestRomType 0 0 0 255 ECU_ADDRESS 0x0 /end MEASUREMENT
/begin MEASUREMENT PduR_RmDestRom[110].RmGDestRomIdxOfRmDestRom "" UBYTE NO_COMPU_METHOD 0 0 0 255 ECU_ADDRESS 0x0 /end MEASUREMENT
/begin MEASUREMENT PduR_RmDestRom[110].RmSrcRomIdxOfRmDestRom "" UBYTE NO_COMPU_METHOD 0 0 0 255 ECU_ADDRESS 0x0 /end MEASUREMENT
/begin MEASUREMENT PduR_RmDestRom[110].RoutingTypeOfRmDestRom "" UBYTE PduR_RoutingTypeOfRmDestRomType 0 0 0 255 ECU_ADDRESS 0x0 /end MEASUREMENT
/begin MEASUREMENT PduR_RmDestRom[111].PduLengthHandlingStrategyOfRmDestRom "" UBYTE PduR_PduLengthHandlingStrategyOfRmDestRomType 0 0 0 255 ECU_ADDRESS 0x0 /end MEASUREMENT
/begin MEASUREMENT PduR_RmDestRom[111].RmGDestRomIdxOfRmDestRom "" UBYTE NO_COMPU_METHOD 0 0 0 255 ECU_ADDRESS 0x0 /end MEASUREMENT
/begin MEASUREMENT PduR_RmDestRom[111].RmSrcRomIdxOfRmDestRom "" UBYTE NO_COMPU_METHOD 0 0 0 255 ECU_ADDRESS 0x0 /end MEASUREMENT
/begin MEASUREMENT PduR_RmDestRom[111].RoutingTypeOfRmDestRom "" UBYTE PduR_RoutingTypeOfRmDestRomType 0 0 0 255 ECU_ADDRESS 0x0 /end MEASUREMENT
/begin MEASUREMENT PduR_RmDestRom[112].PduLengthHandlingStrategyOfRmDestRom "" UBYTE PduR_PduLengthHandlingStrategyOfRmDestRomType 0 0 0 255 ECU_ADDRESS 0x0 /end MEASUREMENT
/begin MEASUREMENT PduR_RmDestRom[112].RmGDestRomIdxOfRmDestRom "" UBYTE NO_COMPU_METHOD 0 0 0 255 ECU_ADDRESS 0x0 /end MEASUREMENT
/begin MEASUREMENT PduR_RmDestRom[112].RmSrcRomIdxOfRmDestRom "" UBYTE NO_COMPU_METHOD 0 0 0 255 ECU_ADDRESS 0x0 /end MEASUREMENT
/begin MEASUREMENT PduR_RmDestRom[112].RoutingTypeOfRmDestRom "" UBYTE PduR_RoutingTypeOfRmDestRomType 0 0 0 255 ECU_ADDRESS 0x0 /end MEASUREMENT
/begin MEASUREMENT PduR_RmDestRom[113].PduLengthHandlingStrategyOfRmDestRom "" UBYTE PduR_PduLengthHandlingStrategyOfRmDestRomType 0 0 0 255 ECU_ADDRESS 0x0 /end MEASUREMENT
/begin MEASUREMENT PduR_RmDestRom[113].RmGDestRomIdxOfRmDestRom "" UBYTE NO_COMPU_METHOD 0 0 0 255 ECU_ADDRESS 0x0 /end MEASUREMENT
/begin MEASUREMENT PduR_RmDestRom[113].RmSrcRomIdxOfRmDestRom "" UBYTE NO_COMPU_METHOD 0 0 0 255 ECU_ADDRESS 0x0 /end MEASUREMENT
/begin MEASUREMENT PduR_RmDestRom[113].RoutingTypeOfRmDestRom "" UBYTE PduR_RoutingTypeOfRmDestRomType 0 0 0 255 ECU_ADDRESS 0x0 /end MEASUREMENT
/begin MEASUREMENT PduR_RmDestRom[114].PduLengthHandlingStrategyOfRmDestRom "" UBYTE PduR_PduLengthHandlingStrategyOfRmDestRomType 0 0 0 255 ECU_ADDRESS 0x0 /end MEASUREMENT
/begin MEASUREMENT PduR_RmDestRom[114].RmGDestRomIdxOfRmDestRom "" UBYTE NO_COMPU_METHOD 0 0 0 255 ECU_ADDRESS 0x0 /end MEASUREMENT
/begin MEASUREMENT PduR_RmDestRom[114].RmSrcRomIdxOfRmDestRom "" UBYTE NO_COMPU_METHOD 0 0 0 255 ECU_ADDRESS 0x0 /end MEASUREMENT
/begin MEASUREMENT PduR_RmDestRom[114].RoutingTypeOfRmDestRom "" UBYTE PduR_RoutingTypeOfRmDestRomType 0 0 0 255 ECU_ADDRESS 0x0 /end MEASUREMENT
/begin MEASUREMENT PduR_RmDestRom[115].PduLengthHandlingStrategyOfRmDestRom "" UBYTE PduR_PduLengthHandlingStrategyOfRmDestRomType 0 0 0 255 ECU_ADDRESS 0x0 /end MEASUREMENT
/begin MEASUREMENT PduR_RmDestRom[115].RmGDestRomIdxOfRmDestRom "" UBYTE NO_COMPU_METHOD 0 0 0 255 ECU_ADDRESS 0x0 /end MEASUREMENT
/begin MEASUREMENT PduR_RmDestRom[115].RmSrcRomIdxOfRmDestRom "" UBYTE NO_COMPU_METHOD 0 0 0 255 ECU_ADDRESS 0x0 /end MEASUREMENT
/begin MEASUREMENT PduR_RmDestRom[115].RoutingTypeOfRmDestRom "" UBYTE PduR_RoutingTypeOfRmDestRomType 0 0 0 255 ECU_ADDRESS 0x0 /end MEASUREMENT
/begin MEASUREMENT PduR_RmDestRom[116].PduLengthHandlingStrategyOfRmDestRom "" UBYTE PduR_PduLengthHandlingStrategyOfRmDestRomType 0 0 0 255 ECU_ADDRESS 0x0 /end MEASUREMENT
/begin MEASUREMENT PduR_RmDestRom[116].RmGDestRomIdxOfRmDestRom "" UBYTE NO_COMPU_METHOD 0 0 0 255 ECU_ADDRESS 0x0 /end MEASUREMENT
/begin MEASUREMENT PduR_RmDestRom[116].RmSrcRomIdxOfRmDestRom "" UBYTE NO_COMPU_METHOD 0 0 0 255 ECU_ADDRESS 0x0 /end MEASUREMENT
/begin MEASUREMENT PduR_RmDestRom[116].RoutingTypeOfRmDestRom "" UBYTE PduR_RoutingTypeOfRmDestRomType 0 0 0 255 ECU_ADDRESS 0x0 /end MEASUREMENT
/begin MEASUREMENT PduR_RmDestRom[117].PduLengthHandlingStrategyOfRmDestRom "" UBYTE PduR_PduLengthHandlingStrategyOfRmDestRomType 0 0 0 255 ECU_ADDRESS 0x0 /end MEASUREMENT
/begin MEASUREMENT PduR_RmDestRom[117].RmGDestRomIdxOfRmDestRom "" UBYTE NO_COMPU_METHOD 0 0 0 255 ECU_ADDRESS 0x0 /end MEASUREMENT
/begin MEASUREMENT PduR_RmDestRom[117].RmSrcRomIdxOfRmDestRom "" UBYTE NO_COMPU_METHOD 0 0 0 255 ECU_ADDRESS 0x0 /end MEASUREMENT
/begin MEASUREMENT PduR_RmDestRom[117].RoutingTypeOfRmDestRom "" UBYTE PduR_RoutingTypeOfRmDestRomType 0 0 0 255 ECU_ADDRESS 0x0 /end MEASUREMENT
/begin MEASUREMENT PduR_RmDestRom[118].PduLengthHandlingStrategyOfRmDestRom "" UBYTE PduR_PduLengthHandlingStrategyOfRmDestRomType 0 0 0 255 ECU_ADDRESS 0x0 /end MEASUREMENT
/begin MEASUREMENT PduR_RmDestRom[118].RmGDestRomIdxOfRmDestRom "" UBYTE NO_COMPU_METHOD 0 0 0 255 ECU_ADDRESS 0x0 /end MEASUREMENT
/begin MEASUREMENT PduR_RmDestRom[118].RmSrcRomIdxOfRmDestRom "" UBYTE NO_COMPU_METHOD 0 0 0 255 ECU_ADDRESS 0x0 /end MEASUREMENT
/begin MEASUREMENT PduR_RmDestRom[118].RoutingTypeOfRmDestRom "" UBYTE PduR_RoutingTypeOfRmDestRomType 0 0 0 255 ECU_ADDRESS 0x0 /end MEASUREMENT
/begin MEASUREMENT PduR_RmDestRom[119].PduLengthHandlingStrategyOfRmDestRom "" UBYTE PduR_PduLengthHandlingStrategyOfRmDestRomType 0 0 0 255 ECU_ADDRESS 0x0 /end MEASUREMENT
/begin MEASUREMENT PduR_RmDestRom[119].RmGDestRomIdxOfRmDestRom "" UBYTE NO_COMPU_METHOD 0 0 0 255 ECU_ADDRESS 0x0 /end MEASUREMENT
/begin MEASUREMENT PduR_RmDestRom[119].RmSrcRomIdxOfRmDestRom "" UBYTE NO_COMPU_METHOD 0 0 0 255 ECU_ADDRESS 0x0 /end MEASUREMENT
/begin MEASUREMENT PduR_RmDestRom[119].RoutingTypeOfRmDestRom "" UBYTE PduR_RoutingTypeOfRmDestRomType 0 0 0 255 ECU_ADDRESS 0x0 /end MEASUREMENT
/begin MEASUREMENT PduR_RmDestRom[11].PduLengthHandlingStrategyOfRmDestRom "" UBYTE PduR_PduLengthHandlingStrategyOfRmDestRomType 0 0 0 255 ECU_ADDRESS 0x0 /end MEASUREMENT
/begin MEASUREMENT PduR_RmDestRom[11].RmGDestRomIdxOfRmDestRom "" UBYTE NO_COMPU_METHOD 0 0 0 255 ECU_ADDRESS 0x0 /end MEASUREMENT
/begin MEASUREMENT PduR_RmDestRom[11].RmSrcRomIdxOfRmDestRom "" UBYTE NO_COMPU_METHOD 0 0 0 255 ECU_ADDRESS 0x0 /end MEASUREMENT
/begin MEASUREMENT PduR_RmDestRom[11].RoutingTypeOfRmDestRom "" UBYTE PduR_RoutingTypeOfRmDestRomType 0 0 0 255 ECU_ADDRESS 0x0 /end MEASUREMENT
/begin MEASUREMENT PduR_RmDestRom[120].PduLengthHandlingStrategyOfRmDestRom "" UBYTE PduR_PduLengthHandlingStrategyOfRmDestRomType 0 0 0 255 ECU_ADDRESS 0x0 /end MEASUREMENT
/begin MEASUREMENT PduR_RmDestRom[120].RmGDestRomIdxOfRmDestRom "" UBYTE NO_COMPU_METHOD 0 0 0 255 ECU_ADDRESS 0x0 /end MEASUREMENT
/begin MEASUREMENT PduR_RmDestRom[120].RmSrcRomIdxOfRmDestRom "" UBYTE NO_COMPU_METHOD 0 0 0 255 ECU_ADDRESS 0x0 /end MEASUREMENT
/begin MEASUREMENT PduR_RmDestRom[120].RoutingTypeOfRmDestRom "" UBYTE PduR_RoutingTypeOfRmDestRomType 0 0 0 255 ECU_ADDRESS 0x0 /end MEASUREMENT
/begin MEASUREMENT PduR_RmDestRom[121].PduLengthHandlingStrategyOfRmDestRom "" UBYTE PduR_PduLengthHandlingStrategyOfRmDestRomType 0 0 0 255 ECU_ADDRESS 0x0 /end MEASUREMENT
/begin MEASUREMENT PduR_RmDestRom[121].RmGDestRomIdxOfRmDestRom "" UBYTE NO_COMPU_METHOD 0 0 0 255 ECU_ADDRESS 0x0 /end MEASUREMENT
/begin MEASUREMENT PduR_RmDestRom[121].RmSrcRomIdxOfRmDestRom "" UBYTE NO_COMPU_METHOD 0 0 0 255 ECU_ADDRESS 0x0 /end MEASUREMENT
/begin MEASUREMENT PduR_RmDestRom[121].RoutingTypeOfRmDestRom "" UBYTE PduR_RoutingTypeOfRmDestRomType 0 0 0 255 ECU_ADDRESS 0x0 /end MEASUREMENT
/begin MEASUREMENT PduR_RmDestRom[122].PduLengthHandlingStrategyOfRmDestRom "" UBYTE PduR_PduLengthHandlingStrategyOfRmDestRomType 0 0 0 255 ECU_ADDRESS 0x0 /end MEASUREMENT
/begin MEASUREMENT PduR_RmDestRom[122].RmGDestRomIdxOfRmDestRom "" UBYTE NO_COMPU_METHOD 0 0 0 255 ECU_ADDRESS 0x0 /end MEASUREMENT
/begin MEASUREMENT PduR_RmDestRom[122].RmSrcRomIdxOfRmDestRom "" UBYTE NO_COMPU_METHOD 0 0 0 255 ECU_ADDRESS 0x0 /end MEASUREMENT
/begin MEASUREMENT PduR_RmDestRom[122].RoutingTypeOfRmDestRom "" UBYTE PduR_RoutingTypeOfRmDestRomType 0 0 0 255 ECU_ADDRESS 0x0 /end MEASUREMENT
/begin MEASUREMENT PduR_RmDestRom[123].PduLengthHandlingStrategyOfRmDestRom "" UBYTE PduR_PduLengthHandlingStrategyOfRmDestRomType 0 0 0 255 ECU_ADDRESS 0x0 /end MEASUREMENT
/begin MEASUREMENT PduR_RmDestRom[123].RmGDestRomIdxOfRmDestRom "" UBYTE NO_COMPU_METHOD 0 0 0 255 ECU_ADDRESS 0x0 /end MEASUREMENT
/begin MEASUREMENT PduR_RmDestRom[123].RmSrcRomIdxOfRmDestRom "" UBYTE NO_COMPU_METHOD 0 0 0 255 ECU_ADDRESS 0x0 /end MEASUREMENT
/begin MEASUREMENT PduR_RmDestRom[123].RoutingTypeOfRmDestRom "" UBYTE PduR_RoutingTypeOfRmDestRomType 0 0 0 255 ECU_ADDRESS 0x0 /end MEASUREMENT
/begin MEASUREMENT PduR_RmDestRom[124].PduLengthHandlingStrategyOfRmDestRom "" UBYTE PduR_PduLengthHandlingStrategyOfRmDestRomType 0 0 0 255 ECU_ADDRESS 0x0 /end MEASUREMENT
/begin MEASUREMENT PduR_RmDestRom[124].RmGDestRomIdxOfRmDestRom "" UBYTE NO_COMPU_METHOD 0 0 0 255 ECU_ADDRESS 0x0 /end MEASUREMENT
/begin MEASUREMENT PduR_RmDestRom[124].RmSrcRomIdxOfRmDestRom "" UBYTE NO_COMPU_METHOD 0 0 0 255 ECU_ADDRESS 0x0 /end MEASUREMENT
/begin MEASUREMENT PduR_RmDestRom[124].RoutingTypeOfRmDestRom "" UBYTE PduR_RoutingTypeOfRmDestRomType 0 0 0 255 ECU_ADDRESS 0x0 /end MEASUREMENT
/begin MEASUREMENT PduR_RmDestRom[125].PduLengthHandlingStrategyOfRmDestRom "" UBYTE PduR_PduLengthHandlingStrategyOfRmDestRomType 0 0 0 255 ECU_ADDRESS 0x0 /end MEASUREMENT
/begin MEASUREMENT PduR_RmDestRom[125].RmGDestRomIdxOfRmDestRom "" UBYTE NO_COMPU_METHOD 0 0 0 255 ECU_ADDRESS 0x0 /end MEASUREMENT
/begin MEASUREMENT PduR_RmDestRom[125].RmSrcRomIdxOfRmDestRom "" UBYTE NO_COMPU_METHOD 0 0 0 255 ECU_ADDRESS 0x0 /end MEASUREMENT
/begin MEASUREMENT PduR_RmDestRom[125].RoutingTypeOfRmDestRom "" UBYTE PduR_RoutingTypeOfRmDestRomType 0 0 0 255 ECU_ADDRESS 0x0 /end MEASUREMENT
/begin MEASUREMENT PduR_RmDestRom[126].PduLengthHandlingStrategyOfRmDestRom "" UBYTE PduR_PduLengthHandlingStrategyOfRmDestRomType 0 0 0 255 ECU_ADDRESS 0x0 /end MEASUREMENT
/begin MEASUREMENT PduR_RmDestRom[126].RmGDestRomIdxOfRmDestRom "" UBYTE NO_COMPU_METHOD 0 0 0 255 ECU_ADDRESS 0x0 /end MEASUREMENT
/begin MEASUREMENT PduR_RmDestRom[126].RmSrcRomIdxOfRmDestRom "" UBYTE NO_COMPU_METHOD 0 0 0 255 ECU_ADDRESS 0x0 /end MEASUREMENT
/begin MEASUREMENT PduR_RmDestRom[126].RoutingTypeOfRmDestRom "" UBYTE PduR_RoutingTypeOfRmDestRomType 0 0 0 255 ECU_ADDRESS 0x0 /end MEASUREMENT
/begin MEASUREMENT PduR_RmDestRom[127].PduLengthHandlingStrategyOfRmDestRom "" UBYTE PduR_PduLengthHandlingStrategyOfRmDestRomType 0 0 0 255 ECU_ADDRESS 0x0 /end MEASUREMENT
/begin MEASUREMENT PduR_RmDestRom[127].RmGDestRomIdxOfRmDestRom "" UBYTE NO_COMPU_METHOD 0 0 0 255 ECU_ADDRESS 0x0 /end MEASUREMENT
/begin MEASUREMENT PduR_RmDestRom[127].RmSrcRomIdxOfRmDestRom "" UBYTE NO_COMPU_METHOD 0 0 0 255 ECU_ADDRESS 0x0 /end MEASUREMENT
/begin MEASUREMENT PduR_RmDestRom[127].RoutingTypeOfRmDestRom "" UBYTE PduR_RoutingTypeOfRmDestRomType 0 0 0 255 ECU_ADDRESS 0x0 /end MEASUREMENT
/begin MEASUREMENT PduR_RmDestRom[128].PduLengthHandlingStrategyOfRmDestRom "" UBYTE PduR_PduLengthHandlingStrategyOfRmDestRomType 0 0 0 255 ECU_ADDRESS 0x0 /end MEASUREMENT
/begin MEASUREMENT PduR_RmDestRom[128].RmGDestRomIdxOfRmDestRom "" UBYTE NO_COMPU_METHOD 0 0 0 255 ECU_ADDRESS 0x0 /end MEASUREMENT
/begin MEASUREMENT PduR_RmDestRom[128].RmSrcRomIdxOfRmDestRom "" UBYTE NO_COMPU_METHOD 0 0 0 255 ECU_ADDRESS 0x0 /end MEASUREMENT
/begin MEASUREMENT PduR_RmDestRom[128].RoutingTypeOfRmDestRom "" UBYTE PduR_RoutingTypeOfRmDestRomType 0 0 0 255 ECU_ADDRESS 0x0 /end MEASUREMENT
/begin MEASUREMENT PduR_RmDestRom[129].PduLengthHandlingStrategyOfRmDestRom "" UBYTE PduR_PduLengthHandlingStrategyOfRmDestRomType 0 0 0 255 ECU_ADDRESS 0x0 /end MEASUREMENT
/begin MEASUREMENT PduR_RmDestRom[129].RmGDestRomIdxOfRmDestRom "" UBYTE NO_COMPU_METHOD 0 0 0 255 ECU_ADDRESS 0x0 /end MEASUREMENT
/begin MEASUREMENT PduR_RmDestRom[129].RmSrcRomIdxOfRmDestRom "" UBYTE NO_COMPU_METHOD 0 0 0 255 ECU_ADDRESS 0x0 /end MEASUREMENT
/begin MEASUREMENT PduR_RmDestRom[129].RoutingTypeOfRmDestRom "" UBYTE PduR_RoutingTypeOfRmDestRomType 0 0 0 255 ECU_ADDRESS 0x0 /end MEASUREMENT
/begin MEASUREMENT PduR_RmDestRom[12].PduLengthHandlingStrategyOfRmDestRom "" UBYTE PduR_PduLengthHandlingStrategyOfRmDestRomType 0 0 0 255 ECU_ADDRESS 0x0 /end MEASUREMENT
/begin MEASUREMENT PduR_RmDestRom[12].RmGDestRomIdxOfRmDestRom "" UBYTE NO_COMPU_METHOD 0 0 0 255 ECU_ADDRESS 0x0 /end MEASUREMENT
/begin MEASUREMENT PduR_RmDestRom[12].RmSrcRomIdxOfRmDestRom "" UBYTE NO_COMPU_METHOD 0 0 0 255 ECU_ADDRESS 0x0 /end MEASUREMENT
/begin MEASUREMENT PduR_RmDestRom[12].RoutingTypeOfRmDestRom "" UBYTE PduR_RoutingTypeOfRmDestRomType 0 0 0 255 ECU_ADDRESS 0x0 /end MEASUREMENT
/begin MEASUREMENT PduR_RmDestRom[130].PduLengthHandlingStrategyOfRmDestRom "" UBYTE PduR_PduLengthHandlingStrategyOfRmDestRomType 0 0 0 255 ECU_ADDRESS 0x0 /end MEASUREMENT
/begin MEASUREMENT PduR_RmDestRom[130].RmGDestRomIdxOfRmDestRom "" UBYTE NO_COMPU_METHOD 0 0 0 255 ECU_ADDRESS 0x0 /end MEASUREMENT
/begin MEASUREMENT PduR_RmDestRom[130].RmSrcRomIdxOfRmDestRom "" UBYTE NO_COMPU_METHOD 0 0 0 255 ECU_ADDRESS 0x0 /end MEASUREMENT
/begin MEASUREMENT PduR_RmDestRom[130].RoutingTypeOfRmDestRom "" UBYTE PduR_RoutingTypeOfRmDestRomType 0 0 0 255 ECU_ADDRESS 0x0 /end MEASUREMENT
/begin MEASUREMENT PduR_RmDestRom[131].PduLengthHandlingStrategyOfRmDestRom "" UBYTE PduR_PduLengthHandlingStrategyOfRmDestRomType 0 0 0 255 ECU_ADDRESS 0x0 /end MEASUREMENT
/begin MEASUREMENT PduR_RmDestRom[131].RmGDestRomIdxOfRmDestRom "" UBYTE NO_COMPU_METHOD 0 0 0 255 ECU_ADDRESS 0x0 /end MEASUREMENT
/begin MEASUREMENT PduR_RmDestRom[131].RmSrcRomIdxOfRmDestRom "" UBYTE NO_COMPU_METHOD 0 0 0 255 ECU_ADDRESS 0x0 /end MEASUREMENT
/begin MEASUREMENT PduR_RmDestRom[131].RoutingTypeOfRmDestRom "" UBYTE PduR_RoutingTypeOfRmDestRomType 0 0 0 255 ECU_ADDRESS 0x0 /end MEASUREMENT
/begin MEASUREMENT PduR_RmDestRom[132].PduLengthHandlingStrategyOfRmDestRom "" UBYTE PduR_PduLengthHandlingStrategyOfRmDestRomType 0 0 0 255 ECU_ADDRESS 0x0 /end MEASUREMENT
/begin MEASUREMENT PduR_RmDestRom[132].RmGDestRomIdxOfRmDestRom "" UBYTE NO_COMPU_METHOD 0 0 0 255 ECU_ADDRESS 0x0 /end MEASUREMENT
/begin MEASUREMENT PduR_RmDestRom[132].RmSrcRomIdxOfRmDestRom "" UBYTE NO_COMPU_METHOD 0 0 0 255 ECU_ADDRESS 0x0 /end MEASUREMENT
/begin MEASUREMENT PduR_RmDestRom[132].RoutingTypeOfRmDestRom "" UBYTE PduR_RoutingTypeOfRmDestRomType 0 0 0 255 ECU_ADDRESS 0x0 /end MEASUREMENT
/begin MEASUREMENT PduR_RmDestRom[133].PduLengthHandlingStrategyOfRmDestRom "" UBYTE PduR_PduLengthHandlingStrategyOfRmDestRomType 0 0 0 255 ECU_ADDRESS 0x0 /end MEASUREMENT
/begin MEASUREMENT PduR_RmDestRom[133].RmGDestRomIdxOfRmDestRom "" UBYTE NO_COMPU_METHOD 0 0 0 255 ECU_ADDRESS 0x0 /end MEASUREMENT
/begin MEASUREMENT PduR_RmDestRom[133].RmSrcRomIdxOfRmDestRom "" UBYTE NO_COMPU_METHOD 0 0 0 255 ECU_ADDRESS 0x0 /end MEASUREMENT
/begin MEASUREMENT PduR_RmDestRom[133].RoutingTypeOfRmDestRom "" UBYTE PduR_RoutingTypeOfRmDestRomType 0 0 0 255 ECU_ADDRESS 0x0 /end MEASUREMENT
/begin MEASUREMENT PduR_RmDestRom[134].PduLengthHandlingStrategyOfRmDestRom "" UBYTE PduR_PduLengthHandlingStrategyOfRmDestRomType 0 0 0 255 ECU_ADDRESS 0x0 /end MEASUREMENT
/begin MEASUREMENT PduR_RmDestRom[134].RmGDestRomIdxOfRmDestRom "" UBYTE NO_COMPU_METHOD 0 0 0 255 ECU_ADDRESS 0x0 /end MEASUREMENT
/begin MEASUREMENT PduR_RmDestRom[134].RmSrcRomIdxOfRmDestRom "" UBYTE NO_COMPU_METHOD 0 0 0 255 ECU_ADDRESS 0x0 /end MEASUREMENT
/begin MEASUREMENT PduR_RmDestRom[134].RoutingTypeOfRmDestRom "" UBYTE PduR_RoutingTypeOfRmDestRomType 0 0 0 255 ECU_ADDRESS 0x0 /end MEASUREMENT
/begin MEASUREMENT PduR_RmDestRom[135].PduLengthHandlingStrategyOfRmDestRom "" UBYTE PduR_PduLengthHandlingStrategyOfRmDestRomType 0 0 0 255 ECU_ADDRESS 0x0 /end MEASUREMENT
/begin MEASUREMENT PduR_RmDestRom[135].RmGDestRomIdxOfRmDestRom "" UBYTE NO_COMPU_METHOD 0 0 0 255 ECU_ADDRESS 0x0 /end MEASUREMENT
/begin MEASUREMENT PduR_RmDestRom[135].RmSrcRomIdxOfRmDestRom "" UBYTE NO_COMPU_METHOD 0 0 0 255 ECU_ADDRESS 0x0 /end MEASUREMENT
/begin MEASUREMENT PduR_RmDestRom[135].RoutingTypeOfRmDestRom "" UBYTE PduR_RoutingTypeOfRmDestRomType 0 0 0 255 ECU_ADDRESS 0x0 /end MEASUREMENT
/begin MEASUREMENT PduR_RmDestRom[136].PduLengthHandlingStrategyOfRmDestRom "" UBYTE PduR_PduLengthHandlingStrategyOfRmDestRomType 0 0 0 255 ECU_ADDRESS 0x0 /end MEASUREMENT
/begin MEASUREMENT PduR_RmDestRom[136].RmGDestRomIdxOfRmDestRom "" UBYTE NO_COMPU_METHOD 0 0 0 255 ECU_ADDRESS 0x0 /end MEASUREMENT
/begin MEASUREMENT PduR_RmDestRom[136].RmSrcRomIdxOfRmDestRom "" UBYTE NO_COMPU_METHOD 0 0 0 255 ECU_ADDRESS 0x0 /end MEASUREMENT
/begin MEASUREMENT PduR_RmDestRom[136].RoutingTypeOfRmDestRom "" UBYTE PduR_RoutingTypeOfRmDestRomType 0 0 0 255 ECU_ADDRESS 0x0 /end MEASUREMENT
/begin MEASUREMENT PduR_RmDestRom[137].PduLengthHandlingStrategyOfRmDestRom "" UBYTE PduR_PduLengthHandlingStrategyOfRmDestRomType 0 0 0 255 ECU_ADDRESS 0x0 /end MEASUREMENT
/begin MEASUREMENT PduR_RmDestRom[137].RmGDestRomIdxOfRmDestRom "" UBYTE NO_COMPU_METHOD 0 0 0 255 ECU_ADDRESS 0x0 /end MEASUREMENT
/begin MEASUREMENT PduR_RmDestRom[137].RmSrcRomIdxOfRmDestRom "" UBYTE NO_COMPU_METHOD 0 0 0 255 ECU_ADDRESS 0x0 /end MEASUREMENT
/begin MEASUREMENT PduR_RmDestRom[137].RoutingTypeOfRmDestRom "" UBYTE PduR_RoutingTypeOfRmDestRomType 0 0 0 255 ECU_ADDRESS 0x0 /end MEASUREMENT
/begin MEASUREMENT PduR_RmDestRom[138].PduLengthHandlingStrategyOfRmDestRom "" UBYTE PduR_PduLengthHandlingStrategyOfRmDestRomType 0 0 0 255 ECU_ADDRESS 0x0 /end MEASUREMENT
/begin MEASUREMENT PduR_RmDestRom[138].RmGDestRomIdxOfRmDestRom "" UBYTE NO_COMPU_METHOD 0 0 0 255 ECU_ADDRESS 0x0 /end MEASUREMENT
/begin MEASUREMENT PduR_RmDestRom[138].RmSrcRomIdxOfRmDestRom "" UBYTE NO_COMPU_METHOD 0 0 0 255 ECU_ADDRESS 0x0 /end MEASUREMENT
/begin MEASUREMENT PduR_RmDestRom[138].RoutingTypeOfRmDestRom "" UBYTE PduR_RoutingTypeOfRmDestRomType 0 0 0 255 ECU_ADDRESS 0x0 /end MEASUREMENT
/begin MEASUREMENT PduR_RmDestRom[139].PduLengthHandlingStrategyOfRmDestRom "" UBYTE PduR_PduLengthHandlingStrategyOfRmDestRomType 0 0 0 255 ECU_ADDRESS 0x0 /end MEASUREMENT
/begin MEASUREMENT PduR_RmDestRom[139].RmGDestRomIdxOfRmDestRom "" UBYTE NO_COMPU_METHOD 0 0 0 255 ECU_ADDRESS 0x0 /end MEASUREMENT
/begin MEASUREMENT PduR_RmDestRom[139].RmSrcRomIdxOfRmDestRom "" UBYTE NO_COMPU_METHOD 0 0 0 255 ECU_ADDRESS 0x0 /end MEASUREMENT
/begin MEASUREMENT PduR_RmDestRom[139].RoutingTypeOfRmDestRom "" UBYTE PduR_RoutingTypeOfRmDestRomType 0 0 0 255 ECU_ADDRESS 0x0 /end MEASUREMENT
/begin MEASUREMENT PduR_RmDestRom[13].PduLengthHandlingStrategyOfRmDestRom "" UBYTE PduR_PduLengthHandlingStrategyOfRmDestRomType 0 0 0 255 ECU_ADDRESS 0x0 /end MEASUREMENT
/begin MEASUREMENT PduR_RmDestRom[13].RmGDestRomIdxOfRmDestRom "" UBYTE NO_COMPU_METHOD 0 0 0 255 ECU_ADDRESS 0x0 /end MEASUREMENT
/begin MEASUREMENT PduR_RmDestRom[13].RmSrcRomIdxOfRmDestRom "" UBYTE NO_COMPU_METHOD 0 0 0 255 ECU_ADDRESS 0x0 /end MEASUREMENT
/begin MEASUREMENT PduR_RmDestRom[13].RoutingTypeOfRmDestRom "" UBYTE PduR_RoutingTypeOfRmDestRomType 0 0 0 255 ECU_ADDRESS 0x0 /end MEASUREMENT
/begin MEASUREMENT PduR_RmDestRom[140].PduLengthHandlingStrategyOfRmDestRom "" UBYTE PduR_PduLengthHandlingStrategyOfRmDestRomType 0 0 0 255 ECU_ADDRESS 0x0 /end MEASUREMENT
/begin MEASUREMENT PduR_RmDestRom[140].RmGDestRomIdxOfRmDestRom "" UBYTE NO_COMPU_METHOD 0 0 0 255 ECU_ADDRESS 0x0 /end MEASUREMENT
/begin MEASUREMENT PduR_RmDestRom[140].RmSrcRomIdxOfRmDestRom "" UBYTE NO_COMPU_METHOD 0 0 0 255 ECU_ADDRESS 0x0 /end MEASUREMENT
/begin MEASUREMENT PduR_RmDestRom[140].RoutingTypeOfRmDestRom "" UBYTE PduR_RoutingTypeOfRmDestRomType 0 0 0 255 ECU_ADDRESS 0x0 /end MEASUREMENT
/begin MEASUREMENT PduR_RmDestRom[141].PduLengthHandlingStrategyOfRmDestRom "" UBYTE PduR_PduLengthHandlingStrategyOfRmDestRomType 0 0 0 255 ECU_ADDRESS 0x0 /end MEASUREMENT
/begin MEASUREMENT PduR_RmDestRom[141].RmGDestRomIdxOfRmDestRom "" UBYTE NO_COMPU_METHOD 0 0 0 255 ECU_ADDRESS 0x0 /end MEASUREMENT
/begin MEASUREMENT PduR_RmDestRom[141].RmSrcRomIdxOfRmDestRom "" UBYTE NO_COMPU_METHOD 0 0 0 255 ECU_ADDRESS 0x0 /end MEASUREMENT
/begin MEASUREMENT PduR_RmDestRom[141].RoutingTypeOfRmDestRom "" UBYTE PduR_RoutingTypeOfRmDestRomType 0 0 0 255 ECU_ADDRESS 0x0 /end MEASUREMENT
/begin MEASUREMENT PduR_RmDestRom[142].PduLengthHandlingStrategyOfRmDestRom "" UBYTE PduR_PduLengthHandlingStrategyOfRmDestRomType 0 0 0 255 ECU_ADDRESS 0x0 /end MEASUREMENT
/begin MEASUREMENT PduR_RmDestRom[142].RmGDestRomIdxOfRmDestRom "" UBYTE NO_COMPU_METHOD 0 0 0 255 ECU_ADDRESS 0x0 /end MEASUREMENT
/begin MEASUREMENT PduR_RmDestRom[142].RmSrcRomIdxOfRmDestRom "" UBYTE NO_COMPU_METHOD 0 0 0 255 ECU_ADDRESS 0x0 /end MEASUREMENT
/begin MEASUREMENT PduR_RmDestRom[142].RoutingTypeOfRmDestRom "" UBYTE PduR_RoutingTypeOfRmDestRomType 0 0 0 255 ECU_ADDRESS 0x0 /end MEASUREMENT
/begin MEASUREMENT PduR_RmDestRom[143].PduLengthHandlingStrategyOfRmDestRom "" UBYTE PduR_PduLengthHandlingStrategyOfRmDestRomType 0 0 0 255 ECU_ADDRESS 0x0 /end MEASUREMENT
/begin MEASUREMENT PduR_RmDestRom[143].RmGDestRomIdxOfRmDestRom "" UBYTE NO_COMPU_METHOD 0 0 0 255 ECU_ADDRESS 0x0 /end MEASUREMENT
/begin MEASUREMENT PduR_RmDestRom[143].RmSrcRomIdxOfRmDestRom "" UBYTE NO_COMPU_METHOD 0 0 0 255 ECU_ADDRESS 0x0 /end MEASUREMENT
/begin MEASUREMENT PduR_RmDestRom[143].RoutingTypeOfRmDestRom "" UBYTE PduR_RoutingTypeOfRmDestRomType 0 0 0 255 ECU_ADDRESS 0x0 /end MEASUREMENT
/begin MEASUREMENT PduR_RmDestRom[144].PduLengthHandlingStrategyOfRmDestRom "" UBYTE PduR_PduLengthHandlingStrategyOfRmDestRomType 0 0 0 255 ECU_ADDRESS 0x0 /end MEASUREMENT
/begin MEASUREMENT PduR_RmDestRom[144].RmGDestRomIdxOfRmDestRom "" UBYTE NO_COMPU_METHOD 0 0 0 255 ECU_ADDRESS 0x0 /end MEASUREMENT
/begin MEASUREMENT PduR_RmDestRom[144].RmSrcRomIdxOfRmDestRom "" UBYTE NO_COMPU_METHOD 0 0 0 255 ECU_ADDRESS 0x0 /end MEASUREMENT
/begin MEASUREMENT PduR_RmDestRom[144].RoutingTypeOfRmDestRom "" UBYTE PduR_RoutingTypeOfRmDestRomType 0 0 0 255 ECU_ADDRESS 0x0 /end MEASUREMENT
/begin MEASUREMENT PduR_RmDestRom[145].PduLengthHandlingStrategyOfRmDestRom "" UBYTE PduR_PduLengthHandlingStrategyOfRmDestRomType 0 0 0 255 ECU_ADDRESS 0x0 /end MEASUREMENT
/begin MEASUREMENT PduR_RmDestRom[145].RmGDestRomIdxOfRmDestRom "" UBYTE NO_COMPU_METHOD 0 0 0 255 ECU_ADDRESS 0x0 /end MEASUREMENT
/begin MEASUREMENT PduR_RmDestRom[145].RmSrcRomIdxOfRmDestRom "" UBYTE NO_COMPU_METHOD 0 0 0 255 ECU_ADDRESS 0x0 /end MEASUREMENT
/begin MEASUREMENT PduR_RmDestRom[145].RoutingTypeOfRmDestRom "" UBYTE PduR_RoutingTypeOfRmDestRomType 0 0 0 255 ECU_ADDRESS 0x0 /end MEASUREMENT
/begin MEASUREMENT PduR_RmDestRom[146].PduLengthHandlingStrategyOfRmDestRom "" UBYTE PduR_PduLengthHandlingStrategyOfRmDestRomType 0 0 0 255 ECU_ADDRESS 0x0 /end MEASUREMENT
/begin MEASUREMENT PduR_RmDestRom[146].RmGDestRomIdxOfRmDestRom "" UBYTE NO_COMPU_METHOD 0 0 0 255 ECU_ADDRESS 0x0 /end MEASUREMENT
/begin MEASUREMENT PduR_RmDestRom[146].RmSrcRomIdxOfRmDestRom "" UBYTE NO_COMPU_METHOD 0 0 0 255 ECU_ADDRESS 0x0 /end MEASUREMENT
/begin MEASUREMENT PduR_RmDestRom[146].RoutingTypeOfRmDestRom "" UBYTE PduR_RoutingTypeOfRmDestRomType 0 0 0 255 ECU_ADDRESS 0x0 /end MEASUREMENT
/begin MEASUREMENT PduR_RmDestRom[147].PduLengthHandlingStrategyOfRmDestRom "" UBYTE PduR_PduLengthHandlingStrategyOfRmDestRomType 0 0 0 255 ECU_ADDRESS 0x0 /end MEASUREMENT
/begin MEASUREMENT PduR_RmDestRom[147].RmGDestRomIdxOfRmDestRom "" UBYTE NO_COMPU_METHOD 0 0 0 255 ECU_ADDRESS 0x0 /end MEASUREMENT
/begin MEASUREMENT PduR_RmDestRom[147].RmSrcRomIdxOfRmDestRom "" UBYTE NO_COMPU_METHOD 0 0 0 255 ECU_ADDRESS 0x0 /end MEASUREMENT
/begin MEASUREMENT PduR_RmDestRom[147].RoutingTypeOfRmDestRom "" UBYTE PduR_RoutingTypeOfRmDestRomType 0 0 0 255 ECU_ADDRESS 0x0 /end MEASUREMENT
/begin MEASUREMENT PduR_RmDestRom[148].PduLengthHandlingStrategyOfRmDestRom "" UBYTE PduR_PduLengthHandlingStrategyOfRmDestRomType 0 0 0 255 ECU_ADDRESS 0x0 /end MEASUREMENT
/begin MEASUREMENT PduR_RmDestRom[148].RmGDestRomIdxOfRmDestRom "" UBYTE NO_COMPU_METHOD 0 0 0 255 ECU_ADDRESS 0x0 /end MEASUREMENT
/begin MEASUREMENT PduR_RmDestRom[148].RmSrcRomIdxOfRmDestRom "" UBYTE NO_COMPU_METHOD 0 0 0 255 ECU_ADDRESS 0x0 /end MEASUREMENT
/begin MEASUREMENT PduR_RmDestRom[148].RoutingTypeOfRmDestRom "" UBYTE PduR_RoutingTypeOfRmDestRomType 0 0 0 255 ECU_ADDRESS 0x0 /end MEASUREMENT
/begin MEASUREMENT PduR_RmDestRom[149].PduLengthHandlingStrategyOfRmDestRom "" UBYTE PduR_PduLengthHandlingStrategyOfRmDestRomType 0 0 0 255 ECU_ADDRESS 0x0 /end MEASUREMENT
/begin MEASUREMENT PduR_RmDestRom[149].RmGDestRomIdxOfRmDestRom "" UBYTE NO_COMPU_METHOD 0 0 0 255 ECU_ADDRESS 0x0 /end MEASUREMENT
/begin MEASUREMENT PduR_RmDestRom[149].RmSrcRomIdxOfRmDestRom "" UBYTE NO_COMPU_METHOD 0 0 0 255 ECU_ADDRESS 0x0 /end MEASUREMENT
/begin MEASUREMENT PduR_RmDestRom[149].RoutingTypeOfRmDestRom "" UBYTE PduR_RoutingTypeOfRmDestRomType 0 0 0 255 ECU_ADDRESS 0x0 /end MEASUREMENT
/begin MEASUREMENT PduR_RmDestRom[14].PduLengthHandlingStrategyOfRmDestRom "" UBYTE PduR_PduLengthHandlingStrategyOfRmDestRomType 0 0 0 255 ECU_ADDRESS 0x0 /end MEASUREMENT
/begin MEASUREMENT PduR_RmDestRom[14].RmGDestRomIdxOfRmDestRom "" UBYTE NO_COMPU_METHOD 0 0 0 255 ECU_ADDRESS 0x0 /end MEASUREMENT
/begin MEASUREMENT PduR_RmDestRom[14].RmSrcRomIdxOfRmDestRom "" UBYTE NO_COMPU_METHOD 0 0 0 255 ECU_ADDRESS 0x0 /end MEASUREMENT
/begin MEASUREMENT PduR_RmDestRom[14].RoutingTypeOfRmDestRom "" UBYTE PduR_RoutingTypeOfRmDestRomType 0 0 0 255 ECU_ADDRESS 0x0 /end MEASUREMENT
/begin MEASUREMENT PduR_RmDestRom[150].PduLengthHandlingStrategyOfRmDestRom "" UBYTE PduR_PduLengthHandlingStrategyOfRmDestRomType 0 0 0 255 ECU_ADDRESS 0x0 /end MEASUREMENT
/begin MEASUREMENT PduR_RmDestRom[150].RmGDestRomIdxOfRmDestRom "" UBYTE NO_COMPU_METHOD 0 0 0 255 ECU_ADDRESS 0x0 /end MEASUREMENT
/begin MEASUREMENT PduR_RmDestRom[150].RmSrcRomIdxOfRmDestRom "" UBYTE NO_COMPU_METHOD 0 0 0 255 ECU_ADDRESS 0x0 /end MEASUREMENT
/begin MEASUREMENT PduR_RmDestRom[150].RoutingTypeOfRmDestRom "" UBYTE PduR_RoutingTypeOfRmDestRomType 0 0 0 255 ECU_ADDRESS 0x0 /end MEASUREMENT
/begin MEASUREMENT PduR_RmDestRom[15].PduLengthHandlingStrategyOfRmDestRom "" UBYTE PduR_PduLengthHandlingStrategyOfRmDestRomType 0 0 0 255 ECU_ADDRESS 0x0 /end MEASUREMENT
/begin MEASUREMENT PduR_RmDestRom[15].RmGDestRomIdxOfRmDestRom "" UBYTE NO_COMPU_METHOD 0 0 0 255 ECU_ADDRESS 0x0 /end MEASUREMENT
/begin MEASUREMENT PduR_RmDestRom[15].RmSrcRomIdxOfRmDestRom "" UBYTE NO_COMPU_METHOD 0 0 0 255 ECU_ADDRESS 0x0 /end MEASUREMENT
/begin MEASUREMENT PduR_RmDestRom[15].RoutingTypeOfRmDestRom "" UBYTE PduR_RoutingTypeOfRmDestRomType 0 0 0 255 ECU_ADDRESS 0x0 /end MEASUREMENT
/begin MEASUREMENT PduR_RmDestRom[16].PduLengthHandlingStrategyOfRmDestRom "" UBYTE PduR_PduLengthHandlingStrategyOfRmDestRomType 0 0 0 255 ECU_ADDRESS 0x0 /end MEASUREMENT
/begin MEASUREMENT PduR_RmDestRom[16].RmGDestRomIdxOfRmDestRom "" UBYTE NO_COMPU_METHOD 0 0 0 255 ECU_ADDRESS 0x0 /end MEASUREMENT
/begin MEASUREMENT PduR_RmDestRom[16].RmSrcRomIdxOfRmDestRom "" UBYTE NO_COMPU_METHOD 0 0 0 255 ECU_ADDRESS 0x0 /end MEASUREMENT
/begin MEASUREMENT PduR_RmDestRom[16].RoutingTypeOfRmDestRom "" UBYTE PduR_RoutingTypeOfRmDestRomType 0 0 0 255 ECU_ADDRESS 0x0 /end MEASUREMENT
/begin MEASUREMENT PduR_RmDestRom[17].PduLengthHandlingStrategyOfRmDestRom "" UBYTE PduR_PduLengthHandlingStrategyOfRmDestRomType 0 0 0 255 ECU_ADDRESS 0x0 /end MEASUREMENT
/begin MEASUREMENT PduR_RmDestRom[17].RmGDestRomIdxOfRmDestRom "" UBYTE NO_COMPU_METHOD 0 0 0 255 ECU_ADDRESS 0x0 /end MEASUREMENT
/begin MEASUREMENT PduR_RmDestRom[17].RmSrcRomIdxOfRmDestRom "" UBYTE NO_COMPU_METHOD 0 0 0 255 ECU_ADDRESS 0x0 /end MEASUREMENT
/begin MEASUREMENT PduR_RmDestRom[17].RoutingTypeOfRmDestRom "" UBYTE PduR_RoutingTypeOfRmDestRomType 0 0 0 255 ECU_ADDRESS 0x0 /end MEASUREMENT
/begin MEASUREMENT PduR_RmDestRom[18].PduLengthHandlingStrategyOfRmDestRom "" UBYTE PduR_PduLengthHandlingStrategyOfRmDestRomType 0 0 0 255 ECU_ADDRESS 0x0 /end MEASUREMENT
/begin MEASUREMENT PduR_RmDestRom[18].RmGDestRomIdxOfRmDestRom "" UBYTE NO_COMPU_METHOD 0 0 0 255 ECU_ADDRESS 0x0 /end MEASUREMENT
/begin MEASUREMENT PduR_RmDestRom[18].RmSrcRomIdxOfRmDestRom "" UBYTE NO_COMPU_METHOD 0 0 0 255 ECU_ADDRESS 0x0 /end MEASUREMENT
/begin MEASUREMENT PduR_RmDestRom[18].RoutingTypeOfRmDestRom "" UBYTE PduR_RoutingTypeOfRmDestRomType 0 0 0 255 ECU_ADDRESS 0x0 /end MEASUREMENT
/begin MEASUREMENT PduR_RmDestRom[19].PduLengthHandlingStrategyOfRmDestRom "" UBYTE PduR_PduLengthHandlingStrategyOfRmDestRomType 0 0 0 255 ECU_ADDRESS 0x0 /end MEASUREMENT
/begin MEASUREMENT PduR_RmDestRom[19].RmGDestRomIdxOfRmDestRom "" UBYTE NO_COMPU_METHOD 0 0 0 255 ECU_ADDRESS 0x0 /end MEASUREMENT
/begin MEASUREMENT PduR_RmDestRom[19].RmSrcRomIdxOfRmDestRom "" UBYTE NO_COMPU_METHOD 0 0 0 255 ECU_ADDRESS 0x0 /end MEASUREMENT
/begin MEASUREMENT PduR_RmDestRom[19].RoutingTypeOfRmDestRom "" UBYTE PduR_RoutingTypeOfRmDestRomType 0 0 0 255 ECU_ADDRESS 0x0 /end MEASUREMENT
/begin MEASUREMENT PduR_RmDestRom[1].PduLengthHandlingStrategyOfRmDestRom "" UBYTE PduR_PduLengthHandlingStrategyOfRmDestRomType 0 0 0 255 ECU_ADDRESS 0x0 /end MEASUREMENT
/begin MEASUREMENT PduR_RmDestRom[1].RmGDestRomIdxOfRmDestRom "" UBYTE NO_COMPU_METHOD 0 0 0 255 ECU_ADDRESS 0x0 /end MEASUREMENT
/begin MEASUREMENT PduR_RmDestRom[1].RmSrcRomIdxOfRmDestRom "" UBYTE NO_COMPU_METHOD 0 0 0 255 ECU_ADDRESS 0x0 /end MEASUREMENT
/begin MEASUREMENT PduR_RmDestRom[1].RoutingTypeOfRmDestRom "" UBYTE PduR_RoutingTypeOfRmDestRomType 0 0 0 255 ECU_ADDRESS 0x0 /end MEASUREMENT
/begin MEASUREMENT PduR_RmDestRom[20].PduLengthHandlingStrategyOfRmDestRom "" UBYTE PduR_PduLengthHandlingStrategyOfRmDestRomType 0 0 0 255 ECU_ADDRESS 0x0 /end MEASUREMENT
/begin MEASUREMENT PduR_RmDestRom[20].RmGDestRomIdxOfRmDestRom "" UBYTE NO_COMPU_METHOD 0 0 0 255 ECU_ADDRESS 0x0 /end MEASUREMENT
/begin MEASUREMENT PduR_RmDestRom[20].RmSrcRomIdxOfRmDestRom "" UBYTE NO_COMPU_METHOD 0 0 0 255 ECU_ADDRESS 0x0 /end MEASUREMENT
/begin MEASUREMENT PduR_RmDestRom[20].RoutingTypeOfRmDestRom "" UBYTE PduR_RoutingTypeOfRmDestRomType 0 0 0 255 ECU_ADDRESS 0x0 /end MEASUREMENT
/begin MEASUREMENT PduR_RmDestRom[21].PduLengthHandlingStrategyOfRmDestRom "" UBYTE PduR_PduLengthHandlingStrategyOfRmDestRomType 0 0 0 255 ECU_ADDRESS 0x0 /end MEASUREMENT
/begin MEASUREMENT PduR_RmDestRom[21].RmGDestRomIdxOfRmDestRom "" UBYTE NO_COMPU_METHOD 0 0 0 255 ECU_ADDRESS 0x0 /end MEASUREMENT
/begin MEASUREMENT PduR_RmDestRom[21].RmSrcRomIdxOfRmDestRom "" UBYTE NO_COMPU_METHOD 0 0 0 255 ECU_ADDRESS 0x0 /end MEASUREMENT
/begin MEASUREMENT PduR_RmDestRom[21].RoutingTypeOfRmDestRom "" UBYTE PduR_RoutingTypeOfRmDestRomType 0 0 0 255 ECU_ADDRESS 0x0 /end MEASUREMENT
/begin MEASUREMENT PduR_RmDestRom[22].PduLengthHandlingStrategyOfRmDestRom "" UBYTE PduR_PduLengthHandlingStrategyOfRmDestRomType 0 0 0 255 ECU_ADDRESS 0x0 /end MEASUREMENT
/begin MEASUREMENT PduR_RmDestRom[22].RmGDestRomIdxOfRmDestRom "" UBYTE NO_COMPU_METHOD 0 0 0 255 ECU_ADDRESS 0x0 /end MEASUREMENT
/begin MEASUREMENT PduR_RmDestRom[22].RmSrcRomIdxOfRmDestRom "" UBYTE NO_COMPU_METHOD 0 0 0 255 ECU_ADDRESS 0x0 /end MEASUREMENT
/begin MEASUREMENT PduR_RmDestRom[22].RoutingTypeOfRmDestRom "" UBYTE PduR_RoutingTypeOfRmDestRomType 0 0 0 255 ECU_ADDRESS 0x0 /end MEASUREMENT
/begin MEASUREMENT PduR_RmDestRom[23].PduLengthHandlingStrategyOfRmDestRom "" UBYTE PduR_PduLengthHandlingStrategyOfRmDestRomType 0 0 0 255 ECU_ADDRESS 0x0 /end MEASUREMENT
/begin MEASUREMENT PduR_RmDestRom[23].RmGDestRomIdxOfRmDestRom "" UBYTE NO_COMPU_METHOD 0 0 0 255 ECU_ADDRESS 0x0 /end MEASUREMENT
/begin MEASUREMENT PduR_RmDestRom[23].RmSrcRomIdxOfRmDestRom "" UBYTE NO_COMPU_METHOD 0 0 0 255 ECU_ADDRESS 0x0 /end MEASUREMENT
/begin MEASUREMENT PduR_RmDestRom[23].RoutingTypeOfRmDestRom "" UBYTE PduR_RoutingTypeOfRmDestRomType 0 0 0 255 ECU_ADDRESS 0x0 /end MEASUREMENT
/begin MEASUREMENT PduR_RmDestRom[24].PduLengthHandlingStrategyOfRmDestRom "" UBYTE PduR_PduLengthHandlingStrategyOfRmDestRomType 0 0 0 255 ECU_ADDRESS 0x0 /end MEASUREMENT
/begin MEASUREMENT PduR_RmDestRom[24].RmGDestRomIdxOfRmDestRom "" UBYTE NO_COMPU_METHOD 0 0 0 255 ECU_ADDRESS 0x0 /end MEASUREMENT
/begin MEASUREMENT PduR_RmDestRom[24].RmSrcRomIdxOfRmDestRom "" UBYTE NO_COMPU_METHOD 0 0 0 255 ECU_ADDRESS 0x0 /end MEASUREMENT
/begin MEASUREMENT PduR_RmDestRom[24].RoutingTypeOfRmDestRom "" UBYTE PduR_RoutingTypeOfRmDestRomType 0 0 0 255 ECU_ADDRESS 0x0 /end MEASUREMENT
/begin MEASUREMENT PduR_RmDestRom[25].PduLengthHandlingStrategyOfRmDestRom "" UBYTE PduR_PduLengthHandlingStrategyOfRmDestRomType 0 0 0 255 ECU_ADDRESS 0x0 /end MEASUREMENT
/begin MEASUREMENT PduR_RmDestRom[25].RmGDestRomIdxOfRmDestRom "" UBYTE NO_COMPU_METHOD 0 0 0 255 ECU_ADDRESS 0x0 /end MEASUREMENT
/begin MEASUREMENT PduR_RmDestRom[25].RmSrcRomIdxOfRmDestRom "" UBYTE NO_COMPU_METHOD 0 0 0 255 ECU_ADDRESS 0x0 /end MEASUREMENT
/begin MEASUREMENT PduR_RmDestRom[25].RoutingTypeOfRmDestRom "" UBYTE PduR_RoutingTypeOfRmDestRomType 0 0 0 255 ECU_ADDRESS 0x0 /end MEASUREMENT
/begin MEASUREMENT PduR_RmDestRom[26].PduLengthHandlingStrategyOfRmDestRom "" UBYTE PduR_PduLengthHandlingStrategyOfRmDestRomType 0 0 0 255 ECU_ADDRESS 0x0 /end MEASUREMENT
/begin MEASUREMENT PduR_RmDestRom[26].RmGDestRomIdxOfRmDestRom "" UBYTE NO_COMPU_METHOD 0 0 0 255 ECU_ADDRESS 0x0 /end MEASUREMENT
/begin MEASUREMENT PduR_RmDestRom[26].RmSrcRomIdxOfRmDestRom "" UBYTE NO_COMPU_METHOD 0 0 0 255 ECU_ADDRESS 0x0 /end MEASUREMENT
/begin MEASUREMENT PduR_RmDestRom[26].RoutingTypeOfRmDestRom "" UBYTE PduR_RoutingTypeOfRmDestRomType 0 0 0 255 ECU_ADDRESS 0x0 /end MEASUREMENT
/begin MEASUREMENT PduR_RmDestRom[27].PduLengthHandlingStrategyOfRmDestRom "" UBYTE PduR_PduLengthHandlingStrategyOfRmDestRomType 0 0 0 255 ECU_ADDRESS 0x0 /end MEASUREMENT
/begin MEASUREMENT PduR_RmDestRom[27].RmGDestRomIdxOfRmDestRom "" UBYTE NO_COMPU_METHOD 0 0 0 255 ECU_ADDRESS 0x0 /end MEASUREMENT
/begin MEASUREMENT PduR_RmDestRom[27].RmSrcRomIdxOfRmDestRom "" UBYTE NO_COMPU_METHOD 0 0 0 255 ECU_ADDRESS 0x0 /end MEASUREMENT
/begin MEASUREMENT PduR_RmDestRom[27].RoutingTypeOfRmDestRom "" UBYTE PduR_RoutingTypeOfRmDestRomType 0 0 0 255 ECU_ADDRESS 0x0 /end MEASUREMENT
/begin MEASUREMENT PduR_RmDestRom[28].PduLengthHandlingStrategyOfRmDestRom "" UBYTE PduR_PduLengthHandlingStrategyOfRmDestRomType 0 0 0 255 ECU_ADDRESS 0x0 /end MEASUREMENT
/begin MEASUREMENT PduR_RmDestRom[28].RmGDestRomIdxOfRmDestRom "" UBYTE NO_COMPU_METHOD 0 0 0 255 ECU_ADDRESS 0x0 /end MEASUREMENT
/begin MEASUREMENT PduR_RmDestRom[28].RmSrcRomIdxOfRmDestRom "" UBYTE NO_COMPU_METHOD 0 0 0 255 ECU_ADDRESS 0x0 /end MEASUREMENT
/begin MEASUREMENT PduR_RmDestRom[28].RoutingTypeOfRmDestRom "" UBYTE PduR_RoutingTypeOfRmDestRomType 0 0 0 255 ECU_ADDRESS 0x0 /end MEASUREMENT
/begin MEASUREMENT PduR_RmDestRom[29].PduLengthHandlingStrategyOfRmDestRom "" UBYTE PduR_PduLengthHandlingStrategyOfRmDestRomType 0 0 0 255 ECU_ADDRESS 0x0 /end MEASUREMENT
/begin MEASUREMENT PduR_RmDestRom[29].RmGDestRomIdxOfRmDestRom "" UBYTE NO_COMPU_METHOD 0 0 0 255 ECU_ADDRESS 0x0 /end MEASUREMENT
/begin MEASUREMENT PduR_RmDestRom[29].RmSrcRomIdxOfRmDestRom "" UBYTE NO_COMPU_METHOD 0 0 0 255 ECU_ADDRESS 0x0 /end MEASUREMENT
/begin MEASUREMENT PduR_RmDestRom[29].RoutingTypeOfRmDestRom "" UBYTE PduR_RoutingTypeOfRmDestRomType 0 0 0 255 ECU_ADDRESS 0x0 /end MEASUREMENT
/begin MEASUREMENT PduR_RmDestRom[2].PduLengthHandlingStrategyOfRmDestRom "" UBYTE PduR_PduLengthHandlingStrategyOfRmDestRomType 0 0 0 255 ECU_ADDRESS 0x0 /end MEASUREMENT
/begin MEASUREMENT PduR_RmDestRom[2].RmGDestRomIdxOfRmDestRom "" UBYTE NO_COMPU_METHOD 0 0 0 255 ECU_ADDRESS 0x0 /end MEASUREMENT
/begin MEASUREMENT PduR_RmDestRom[2].RmSrcRomIdxOfRmDestRom "" UBYTE NO_COMPU_METHOD 0 0 0 255 ECU_ADDRESS 0x0 /end MEASUREMENT
/begin MEASUREMENT PduR_RmDestRom[2].RoutingTypeOfRmDestRom "" UBYTE PduR_RoutingTypeOfRmDestRomType 0 0 0 255 ECU_ADDRESS 0x0 /end MEASUREMENT
/begin MEASUREMENT RT_Vishnu_NvMBlock_NVM_LOCK_STAT_SET "Block\'s lock status" UBYTE NO_COMPU_METHOD 0 0 0 1 BIT_MASK 0x40 ECU_ADDRESS 0x0 SYMBOL_LINK "NvM_BlockMngmtArea_at[25].NvRamAttributes_u8" 0 /end MEASUREMENT
/begin MEASUREMENT RT_Vishnu_NvMBlock_NVM_STATE_CHANGED_SET "Block\'s changed status" UBYTE NO_COMPU_METHOD 0 0 0 1 BIT_MASK 0x2 ECU_ADDRESS 0x0 SYMBOL_LINK "NvM_BlockMngmtArea_at[25].NvRamAttributes_u8" 0 /end MEASUREMENT
/begin MEASUREMENT RT_Vishnu_NvMBlock_NVM_STATE_VALID_SET "Block\'s valid status" UBYTE NO_COMPU_METHOD 0 0 0 1 BIT_MASK 0x1 ECU_ADDRESS 0x0 SYMBOL_LINK "NvM_BlockMngmtArea_at[25].NvRamAttributes_u8" 0 /end MEASUREMENT
/begin MEASUREMENT RT_Vishnu_NvMBlock_NVM_WR_PROT_SET "Block\'s write protection status" UBYTE NO_COMPU_METHOD 0 0 0 1 BIT_MASK 0x80 ECU_ADDRESS 0x0 SYMBOL_LINK "NvM_BlockMngmtArea_at[25].NvRamAttributes_u8" 0 /end MEASUREMENT
/begin MEASUREMENT RT_Vishnu_NvMBlock_NvDataIndex "Block\'s dataset index" UBYTE NO_COMPU_METHOD 0 0 0 255 ECU_ADDRESS 0x0 SYMBOL_LINK "NvM_BlockMngmtArea_at[25].NvDataIndex_t" 0 /end MEASUREMENT
/begin MEASUREMENT RT_Vishnu_NvMBlock_NvRam_ErrorStatus "Block\'s error status" UBYTE NvMErrorStatusValues 0 0 0 255 ECU_ADDRESS 0x0 SYMBOL_LINK "NvM_BlockMngmtArea_at[25].NvRamErrorStatus_u8" 0 /end MEASUREMENT
/begin MEASUREMENT StartApplication_NvMBlock1_NVM_LOCK_STAT_SET "Block\'s lock status" UBYTE NO_COMPU_METHOD 0 0 0 1 BIT_MASK 0x40 ECU_ADDRESS 0x0 SYMBOL_LINK "NvM_BlockMngmtArea_at[11].NvRamAttributes_u8" 0 /end MEASUREMENT
/begin MEASUREMENT StartApplication_NvMBlock1_NVM_STATE_CHANGED_SET "Block\'s changed status" UBYTE NO_COMPU_METHOD 0 0 0 1 BIT_MASK 0x2 ECU_ADDRESS 0x0 SYMBOL_LINK "NvM_BlockMngmtArea_at[11].NvRamAttributes_u8" 0 /end MEASUREMENT
/begin MEASUREMENT StartApplication_NvMBlock1_NVM_STATE_VALID_SET "Block\'s valid status" UBYTE NO_COMPU_METHOD 0 0 0 1 BIT_MASK 0x1 ECU_ADDRESS 0x0 SYMBOL_LINK "NvM_BlockMngmtArea_at[11].NvRamAttributes_u8" 0 /end MEASUREMENT
/begin MEASUREMENT StartApplication_NvMBlock1_NVM_WR_PROT_SET "Block\'s write protection status" UBYTE NO_COMPU_METHOD 0 0 0 1 BIT_MASK 0x80 ECU_ADDRESS 0x0 SYMBOL_LINK "NvM_BlockMngmtArea_at[11].NvRamAttributes_u8" 0 /end MEASUREMENT
/begin MEASUREMENT StartApplication_NvMBlock1_NvDataIndex "Block\'s dataset index" UBYTE NO_COMPU_METHOD 0 0 0 255 ECU_ADDRESS 0x0 SYMBOL_LINK "NvM_BlockMngmtArea_at[11].NvDataIndex_t" 0 /end MEASUREMENT
/begin MEASUREMENT StartApplication_NvMBlock1_NvRam_ErrorStatus "Block\'s error status" UBYTE NvMErrorStatusValues 0 0 0 255 ECU_ADDRESS 0x0 SYMBOL_LINK "NvM_BlockMngmtArea_at[11].NvRamErrorStatus_u8" 0 /end MEASUREMENT
/begin MEASUREMENT StartApplication_NvMBlock2_NVM_LOCK_STAT_SET "Block\'s lock status" UBYTE NO_COMPU_METHOD 0 0 0 1 BIT_MASK 0x40 ECU_ADDRESS 0x0 SYMBOL_LINK "NvM_BlockMngmtArea_at[0].NvRamAttributes_u8" 0 /end MEASUREMENT
/begin MEASUREMENT StartApplication_NvMBlock2_NVM_STATE_CHANGED_SET "Block\'s changed status" UBYTE NO_COMPU_METHOD 0 0 0 1 BIT_MASK 0x2 ECU_ADDRESS 0x0 SYMBOL_LINK "NvM_BlockMngmtArea_at[0].NvRamAttributes_u8" 0 /end MEASUREMENT
/begin MEASUREMENT StartApplication_NvMBlock2_NVM_STATE_VALID_SET "Block\'s valid status" UBYTE NO_COMPU_METHOD 0 0 0 1 BIT_MASK 0x1 ECU_ADDRESS 0x0 SYMBOL_LINK "NvM_BlockMngmtArea_at[0].NvRamAttributes_u8" 0 /end MEASUREMENT
/begin MEASUREMENT StartApplication_NvMBlock2_NVM_WR_PROT_SET "Block\'s write protection status" UBYTE NO_COMPU_METHOD 0 0 0 1 BIT_MASK 0x80 ECU_ADDRESS 0x0 SYMBOL_LINK "NvM_BlockMngmtArea_at[0].NvRamAttributes_u8" 0 /end MEASUREMENT
/begin MEASUREMENT StartApplication_NvMBlock2_NvDataIndex "Block\'s dataset index" UBYTE NO_COMPU_METHOD 0 0 0 255 ECU_ADDRESS 0x0 SYMBOL_LINK "NvM_BlockMngmtArea_at[0].NvDataIndex_t" 0 /end MEASUREMENT
/begin MEASUREMENT StartApplication_NvMBlock2_NvRam_ErrorStatus "Block\'s error status" UBYTE NvMErrorStatusValues 0 0 0 255 ECU_ADDRESS 0x0 SYMBOL_LINK "NvM_BlockMngmtArea_at[0].NvRamErrorStatus_u8" 0 /end MEASUREMENT
/begin MEASUREMENT vFotaH_NvMModuleInfo_NVM_LOCK_STAT_SET "Block\'s lock status" UBYTE NO_COMPU_METHOD 0 0 0 1 BIT_MASK 0x40 ECU_ADDRESS 0x0 SYMBOL_LINK "NvM_BlockMngmtArea_at[12].NvRamAttributes_u8" 0 /end MEASUREMENT
/begin MEASUREMENT vFotaH_NvMModuleInfo_NVM_STATE_CHANGED_SET "Block\'s changed status" UBYTE NO_COMPU_METHOD 0 0 0 1 BIT_MASK 0x2 ECU_ADDRESS 0x0 SYMBOL_LINK "NvM_BlockMngmtArea_at[12].NvRamAttributes_u8" 0 /end MEASUREMENT
/begin MEASUREMENT vFotaH_NvMModuleInfo_NVM_STATE_VALID_SET "Block\'s valid status" UBYTE NO_COMPU_METHOD 0 0 0 1 BIT_MASK 0x1 ECU_ADDRESS 0x0 SYMBOL_LINK "NvM_BlockMngmtArea_at[12].NvRamAttributes_u8" 0 /end MEASUREMENT
/begin MEASUREMENT vFotaH_NvMModuleInfo_NVM_WR_PROT_SET "Block\'s write protection status" UBYTE NO_COMPU_METHOD 0 0 0 1 BIT_MASK 0x80 ECU_ADDRESS 0x0 SYMBOL_LINK "NvM_BlockMngmtArea_at[12].NvRamAttributes_u8" 0 /end MEASUREMENT
/begin MEASUREMENT vFotaH_NvMModuleInfo_NvDataIndex "Block\'s dataset index" UBYTE NO_COMPU_METHOD 0 0 0 255 ECU_ADDRESS 0x0 SYMBOL_LINK "NvM_BlockMngmtArea_at[12].NvDataIndex_t" 0 /end MEASUREMENT
/begin MEASUREMENT vFotaH_NvMModuleInfo_NvRam_ErrorStatus "Block\'s error status" UBYTE NvMErrorStatusValues 0 0 0 255 ECU_ADDRESS 0x0 SYMBOL_LINK "NvM_BlockMngmtArea_at[12].NvRamErrorStatus_u8" 0 /end MEASUREMENT
/begin MEASUREMENT vSwUpdM_Appl_NvModuleInfo_NVM_LOCK_STAT_SET "Block\'s lock status" UBYTE NO_COMPU_METHOD 0 0 0 1 BIT_MASK 0x40 ECU_ADDRESS 0x0 SYMBOL_LINK "NvM_BlockMngmtArea_at[13].NvRamAttributes_u8" 0 /end MEASUREMENT
/begin MEASUREMENT vSwUpdM_Appl_NvModuleInfo_NVM_STATE_CHANGED_SET "Block\'s changed status" UBYTE NO_COMPU_METHOD 0 0 0 1 BIT_MASK 0x2 ECU_ADDRESS 0x0 SYMBOL_LINK "NvM_BlockMngmtArea_at[13].NvRamAttributes_u8" 0 /end MEASUREMENT
/begin MEASUREMENT vSwUpdM_Appl_NvModuleInfo_NVM_STATE_VALID_SET "Block\'s valid status" UBYTE NO_COMPU_METHOD 0 0 0 1 BIT_MASK 0x1 ECU_ADDRESS 0x0 SYMBOL_LINK "NvM_BlockMngmtArea_at[13].NvRamAttributes_u8" 0 /end MEASUREMENT
/begin MEASUREMENT vSwUpdM_Appl_NvModuleInfo_NVM_WR_PROT_SET "Block\'s write protection status" UBYTE NO_COMPU_METHOD 0 0 0 1 BIT_MASK 0x80 ECU_ADDRESS 0x0 SYMBOL_LINK "NvM_BlockMngmtArea_at[13].NvRamAttributes_u8" 0 /end MEASUREMENT
/begin MEASUREMENT vSwUpdM_Appl_NvModuleInfo_NvDataIndex "Block\'s dataset index" UBYTE NO_COMPU_METHOD 0 0 0 255 ECU_ADDRESS 0x0 SYMBOL_LINK "NvM_BlockMngmtArea_at[13].NvDataIndex_t" 0 /end MEASUREMENT
/begin MEASUREMENT vSwUpdM_Appl_NvModuleInfo_NvRam_ErrorStatus "Block\'s error status" UBYTE NvMErrorStatusValues 0 0 0 255 ECU_ADDRESS 0x0 SYMBOL_LINK "NvM_BlockMngmtArea_at[13].NvRamErrorStatus_u8" 0 /end MEASUREMENT
/begin MEASUREMENT vSwUpdM_Appl_NvPartitionInfo_NVM_LOCK_STAT_SET "Block\'s lock status" UBYTE NO_COMPU_METHOD 0 0 0 1 BIT_MASK 0x40 ECU_ADDRESS 0x0 SYMBOL_LINK "NvM_BlockMngmtArea_at[14].NvRamAttributes_u8" 0 /end MEASUREMENT
/begin MEASUREMENT vSwUpdM_Appl_NvPartitionInfo_NVM_STATE_CHANGED_SET "Block\'s changed status" UBYTE NO_COMPU_METHOD 0 0 0 1 BIT_MASK 0x2 ECU_ADDRESS 0x0 SYMBOL_LINK "NvM_BlockMngmtArea_at[14].NvRamAttributes_u8" 0 /end MEASUREMENT
/begin MEASUREMENT vSwUpdM_Appl_NvPartitionInfo_NVM_STATE_VALID_SET "Block\'s valid status" UBYTE NO_COMPU_METHOD 0 0 0 1 BIT_MASK 0x1 ECU_ADDRESS 0x0 SYMBOL_LINK "NvM_BlockMngmtArea_at[14].NvRamAttributes_u8" 0 /end MEASUREMENT
/begin MEASUREMENT vSwUpdM_Appl_NvPartitionInfo_NVM_WR_PROT_SET "Block\'s write protection status" UBYTE NO_COMPU_METHOD 0 0 0 1 BIT_MASK 0x80 ECU_ADDRESS 0x0 SYMBOL_LINK "NvM_BlockMngmtArea_at[14].NvRamAttributes_u8" 0 /end MEASUREMENT
/begin MEASUREMENT vSwUpdM_Appl_NvPartitionInfo_NvDataIndex "Block\'s dataset index" UBYTE NO_COMPU_METHOD 0 0 0 255 ECU_ADDRESS 0x0 SYMBOL_LINK "NvM_BlockMngmtArea_at[14].NvDataIndex_t" 0 /end MEASUREMENT
/begin MEASUREMENT vSwUpdM_Appl_NvPartitionInfo_NvRam_ErrorStatus "Block\'s error status" UBYTE NvMErrorStatusValues 0 0 0 255 ECU_ADDRESS 0x0 SYMBOL_LINK "NvM_BlockMngmtArea_at[14].NvRamErrorStatus_u8" 0 /end MEASUREMENT
/begin MEASUREMENT vSwUpdM_Appl_NvRegionInfo_NVM_LOCK_STAT_SET "Block\'s lock status" UBYTE NO_COMPU_METHOD 0 0 0 1 BIT_MASK 0x40 ECU_ADDRESS 0x0 SYMBOL_LINK "NvM_BlockMngmtArea_at[15].NvRamAttributes_u8" 0 /end MEASUREMENT
/begin MEASUREMENT vSwUpdM_Appl_NvRegionInfo_NVM_STATE_CHANGED_SET "Block\'s changed status" UBYTE NO_COMPU_METHOD 0 0 0 1 BIT_MASK 0x2 ECU_ADDRESS 0x0 SYMBOL_LINK "NvM_BlockMngmtArea_at[15].NvRamAttributes_u8" 0 /end MEASUREMENT
/begin MEASUREMENT vSwUpdM_Appl_NvRegionInfo_NVM_STATE_VALID_SET "Block\'s valid status" UBYTE NO_COMPU_METHOD 0 0 0 1 BIT_MASK 0x1 ECU_ADDRESS 0x0 SYMBOL_LINK "NvM_BlockMngmtArea_at[15].NvRamAttributes_u8" 0 /end MEASUREMENT
/begin MEASUREMENT vSwUpdM_Appl_NvRegionInfo_NVM_WR_PROT_SET "Block\'s write protection status" UBYTE NO_COMPU_METHOD 0 0 0 1 BIT_MASK 0x80 ECU_ADDRESS 0x0 SYMBOL_LINK "NvM_BlockMngmtArea_at[15].NvRamAttributes_u8" 0 /end MEASUREMENT
/begin MEASUREMENT vSwUpdM_Appl_NvRegionInfo_NvDataIndex "Block\'s dataset index" UBYTE NO_COMPU_METHOD 0 0 0 255 ECU_ADDRESS 0x0 SYMBOL_LINK "NvM_BlockMngmtArea_at[15].NvDataIndex_t" 0 /end MEASUREMENT
/begin MEASUREMENT vSwUpdM_Appl_NvRegionInfo_NvRam_ErrorStatus "Block\'s error status" UBYTE NvMErrorStatusValues 0 0 0 255 ECU_ADDRESS 0x0 SYMBOL_LINK "NvM_BlockMngmtArea_at[15].NvRamErrorStatus_u8" 0 /end MEASUREMENT
/begin MEASUREMENT vSwUpdM_Appl_NvResumeInfo_NVM_LOCK_STAT_SET "Block\'s lock status" UBYTE NO_COMPU_METHOD 0 0 0 1 BIT_MASK 0x40 ECU_ADDRESS 0x0 SYMBOL_LINK "NvM_BlockMngmtArea_at[16].NvRamAttributes_u8" 0 /end MEASUREMENT
/begin MEASUREMENT vSwUpdM_Appl_NvResumeInfo_NVM_STATE_CHANGED_SET "Block\'s changed status" UBYTE NO_COMPU_METHOD 0 0 0 1 BIT_MASK 0x2 ECU_ADDRESS 0x0 SYMBOL_LINK "NvM_BlockMngmtArea_at[16].NvRamAttributes_u8" 0 /end MEASUREMENT
/begin MEASUREMENT vSwUpdM_Appl_NvResumeInfo_NVM_STATE_VALID_SET "Block\'s valid status" UBYTE NO_COMPU_METHOD 0 0 0 1 BIT_MASK 0x1 ECU_ADDRESS 0x0 SYMBOL_LINK "NvM_BlockMngmtArea_at[16].NvRamAttributes_u8" 0 /end MEASUREMENT
/begin MEASUREMENT vSwUpdM_Appl_NvResumeInfo_NVM_WR_PROT_SET "Block\'s write protection status" UBYTE NO_COMPU_METHOD 0 0 0 1 BIT_MASK 0x80 ECU_ADDRESS 0x0 SYMBOL_LINK "NvM_BlockMngmtArea_at[16].NvRamAttributes_u8" 0 /end MEASUREMENT
/begin MEASUREMENT vSwUpdM_Appl_NvResumeInfo_NvDataIndex "Block\'s dataset index" UBYTE NO_COMPU_METHOD 0 0 0 255 ECU_ADDRESS 0x0 SYMBOL_LINK "NvM_BlockMngmtArea_at[16].NvDataIndex_t" 0 /end MEASUREMENT
/begin MEASUREMENT vSwUpdM_Appl_NvResumeInfo_NvRam_ErrorStatus "Block\'s error status" UBYTE NvMErrorStatusValues 0 0 0 255 ECU_ADDRESS 0x0 SYMBOL_LINK "NvM_BlockMngmtArea_at[16].NvRamErrorStatus_u8" 0 /end MEASUREMENT
/begin MEASUREMENT vSwUpdM_Appl_NvSegmentAttributes_NVM_LOCK_STAT_SET "Block\'s lock status" UBYTE NO_COMPU_METHOD 0 0 0 1 BIT_MASK 0x40 ECU_ADDRESS 0x0 SYMBOL_LINK "NvM_BlockMngmtArea_at[17].NvRamAttributes_u8" 0 /end MEASUREMENT
/begin MEASUREMENT vSwUpdM_Appl_NvSegmentAttributes_NVM_STATE_CHANGED_SET "Block\'s changed status" UBYTE NO_COMPU_METHOD 0 0 0 1 BIT_MASK 0x2 ECU_ADDRESS 0x0 SYMBOL_LINK "NvM_BlockMngmtArea_at[17].NvRamAttributes_u8" 0 /end MEASUREMENT
/begin MEASUREMENT vSwUpdM_Appl_NvSegmentAttributes_NVM_STATE_VALID_SET "Block\'s valid status" UBYTE NO_COMPU_METHOD 0 0 0 1 BIT_MASK 0x1 ECU_ADDRESS 0x0 SYMBOL_LINK "NvM_BlockMngmtArea_at[17].NvRamAttributes_u8" 0 /end MEASUREMENT
/begin MEASUREMENT vSwUpdM_Appl_NvSegmentAttributes_NVM_WR_PROT_SET "Block\'s write protection status" UBYTE NO_COMPU_METHOD 0 0 0 1 BIT_MASK 0x80 ECU_ADDRESS 0x0 SYMBOL_LINK "NvM_BlockMngmtArea_at[17].NvRamAttributes_u8" 0 /end MEASUREMENT
/begin MEASUREMENT vSwUpdM_Appl_NvSegmentAttributes_NvDataIndex "Block\'s dataset index" UBYTE NO_COMPU_METHOD 0 0 0 255 ECU_ADDRESS 0x0 SYMBOL_LINK "NvM_BlockMngmtArea_at[17].NvDataIndex_t" 0 /end MEASUREMENT
/begin MEASUREMENT vSwUpdM_Appl_NvSegmentAttributes_NvRam_ErrorStatus "Block\'s error status" UBYTE NvMErrorStatusValues 0 0 0 255 ECU_ADDRESS 0x0 SYMBOL_LINK "NvM_BlockMngmtArea_at[17].NvRamErrorStatus_u8" 0 /end MEASUREMENT
/begin MEASUREMENT vSwUpdM_Appl_NvSegmentCount_NVM_LOCK_STAT_SET "Block\'s lock status" UBYTE NO_COMPU_METHOD 0 0 0 1 BIT_MASK 0x40 ECU_ADDRESS 0x0 SYMBOL_LINK "NvM_BlockMngmtArea_at[18].NvRamAttributes_u8" 0 /end MEASUREMENT
/begin MEASUREMENT vSwUpdM_Appl_NvSegmentCount_NVM_STATE_CHANGED_SET "Block\'s changed status" UBYTE NO_COMPU_METHOD 0 0 0 1 BIT_MASK 0x2 ECU_ADDRESS 0x0 SYMBOL_LINK "NvM_BlockMngmtArea_at[18].NvRamAttributes_u8" 0 /end MEASUREMENT
/begin MEASUREMENT vSwUpdM_Appl_NvSegmentCount_NVM_STATE_VALID_SET "Block\'s valid status" UBYTE NO_COMPU_METHOD 0 0 0 1 BIT_MASK 0x1 ECU_ADDRESS 0x0 SYMBOL_LINK "NvM_BlockMngmtArea_at[18].NvRamAttributes_u8" 0 /end MEASUREMENT
/begin MEASUREMENT vSwUpdM_Appl_NvSegmentCount_NVM_WR_PROT_SET "Block\'s write protection status" UBYTE NO_COMPU_METHOD 0 0 0 1 BIT_MASK 0x80 ECU_ADDRESS 0x0 SYMBOL_LINK "NvM_BlockMngmtArea_at[18].NvRamAttributes_u8" 0 /end MEASUREMENT
/begin MEASUREMENT vSwUpdM_Appl_NvSegmentCount_NvDataIndex "Block\'s dataset index" UBYTE NO_COMPU_METHOD 0 0 0 255 ECU_ADDRESS 0x0 SYMBOL_LINK "NvM_BlockMngmtArea_at[18].NvDataIndex_t" 0 /end MEASUREMENT
/begin MEASUREMENT vSwUpdM_Appl_NvSegmentCount_NvRam_ErrorStatus "Block\'s error status" UBYTE NvMErrorStatusValues 0 0 0 255 ECU_ADDRESS 0x0 SYMBOL_LINK "NvM_BlockMngmtArea_at[18].NvRamErrorStatus_u8" 0 /end MEASUREMENT
/begin MEASUREMENT vSwUpdM_Appl_NvSegmentWriteAddress_NVM_LOCK_STAT_SET "Block\'s lock status" UBYTE NO_COMPU_METHOD 0 0 0 1 BIT_MASK 0x40 ECU_ADDRESS 0x0 SYMBOL_LINK "NvM_BlockMngmtArea_at[19].NvRamAttributes_u8" 0 /end MEASUREMENT
/begin MEASUREMENT vSwUpdM_Appl_NvSegmentWriteAddress_NVM_STATE_CHANGED_SET "Block\'s changed status" UBYTE NO_COMPU_METHOD 0 0 0 1 BIT_MASK 0x2 ECU_ADDRESS 0x0 SYMBOL_LINK "NvM_BlockMngmtArea_at[19].NvRamAttributes_u8" 0 /end MEASUREMENT
/begin MEASUREMENT vSwUpdM_Appl_NvSegmentWriteAddress_NVM_STATE_VALID_SET "Block\'s valid status" UBYTE NO_COMPU_METHOD 0 0 0 1 BIT_MASK 0x1 ECU_ADDRESS 0x0 SYMBOL_LINK "NvM_BlockMngmtArea_at[19].NvRamAttributes_u8" 0 /end MEASUREMENT
/begin MEASUREMENT vSwUpdM_Appl_NvSegmentWriteAddress_NVM_WR_PROT_SET "Block\'s write protection status" UBYTE NO_COMPU_METHOD 0 0 0 1 BIT_MASK 0x80 ECU_ADDRESS 0x0 SYMBOL_LINK "NvM_BlockMngmtArea_at[19].NvRamAttributes_u8" 0 /end MEASUREMENT
/begin MEASUREMENT vSwUpdM_Appl_NvSegmentWriteAddress_NvDataIndex "Block\'s dataset index" UBYTE NO_COMPU_METHOD 0 0 0 255 ECU_ADDRESS 0x0 SYMBOL_LINK "NvM_BlockMngmtArea_at[19].NvDataIndex_t" 0 /end MEASUREMENT
/begin MEASUREMENT vSwUpdM_Appl_NvSegmentWriteAddress_NvRam_ErrorStatus "Block\'s error status" UBYTE NvMErrorStatusValues 0 0 0 255 ECU_ADDRESS 0x0 SYMBOL_LINK "NvM_BlockMngmtArea_at[19].NvRamErrorStatus_u8" 0 /end MEASUREMENT
/begin MEASUREMENT vSwUpdM_Appl_NvUpdateState_NVM_LOCK_STAT_SET "Block\'s lock status" UBYTE NO_COMPU_METHOD 0 0 0 1 BIT_MASK 0x40 ECU_ADDRESS 0x0 SYMBOL_LINK "NvM_BlockMngmtArea_at[20].NvRamAttributes_u8" 0 /end MEASUREMENT
/begin MEASUREMENT vSwUpdM_Appl_NvUpdateState_NVM_STATE_CHANGED_SET "Block\'s changed status" UBYTE NO_COMPU_METHOD 0 0 0 1 BIT_MASK 0x2 ECU_ADDRESS 0x0 SYMBOL_LINK "NvM_BlockMngmtArea_at[20].NvRamAttributes_u8" 0 /end MEASUREMENT
/begin MEASUREMENT vSwUpdM_Appl_NvUpdateState_NVM_STATE_VALID_SET "Block\'s valid status" UBYTE NO_COMPU_METHOD 0 0 0 1 BIT_MASK 0x1 ECU_ADDRESS 0x0 SYMBOL_LINK "NvM_BlockMngmtArea_at[20].NvRamAttributes_u8" 0 /end MEASUREMENT
/begin MEASUREMENT vSwUpdM_Appl_NvUpdateState_NVM_WR_PROT_SET "Block\'s write protection status" UBYTE NO_COMPU_METHOD 0 0 0 1 BIT_MASK 0x80 ECU_ADDRESS 0x0 SYMBOL_LINK "NvM_BlockMngmtArea_at[20].NvRamAttributes_u8" 0 /end MEASUREMENT
/begin MEASUREMENT vSwUpdM_Appl_NvUpdateState_NvDataIndex "Block\'s dataset index" UBYTE NO_COMPU_METHOD 0 0 0 255 ECU_ADDRESS 0x0 SYMBOL_LINK "NvM_BlockMngmtArea_at[20].NvDataIndex_t" 0 /end MEASUREMENT
/begin MEASUREMENT vSwUpdM_Appl_NvUpdateState_NvRam_ErrorStatus "Block\'s error status" UBYTE NvMErrorStatusValues 0 0 0 255 ECU_ADDRESS 0x0 SYMBOL_LINK "NvM_BlockMngmtArea_at[20].NvRamErrorStatus_u8" 0 /end MEASUREMENT
/begin COMPU_METHOD CM_DCDC_NV_Komponentenfehler_60 "" TAB_VERB "%10.1" "" COMPU_TAB_REF CM_DCDC_NV_Komponentenfehler_60 /end COMPU_METHOD
/begin COMPU_METHOD CM_DCDC_NV_Komponentenfehler_61 "" TAB_VERB "%10.1" "" COMPU_TAB_REF CM_DCDC_NV_Komponentenfehler_61 /end COMPU_METHOD
/begin COMPU_METHOD CM_DCDC_NV_Komponentenfehler_62 "" TAB_VERB "%10.1" "" COMPU_TAB_REF CM_DCDC_NV_Komponentenfehler_62 /end COMPU_METHOD
/begin COMPU_METHOD CM_DCDC_NV_Komponentenfehler_63 "" TAB_VERB "%10.1" "" COMPU_TAB_REF CM_DCDC_NV_Komponentenfehler_63 /end COMPU_METHOD
/begin COMPU_METHOD CM_DCDC_NV_Komponentenfehler_64 "" TAB_VERB "%10.1" "" COMPU_TAB_REF CM_DCDC_NV_Komponentenfehler_64 /end COMPU_METHOD
/begin COMPU_METHOD CM_DCDC_NV_Komponentenfehler_65 "" TAB_VERB "%10.1" "" COMPU_TAB_REF CM_DCDC_NV_Komponentenfehler_65 /end COMPU_METHOD
/begin COMPU_METHOD CM_DCDC_NV_Komponentenfehler_66 "" TAB_VERB "%10.1" "" COMPU_TAB_REF CM_DCDC_NV_Komponentenfehler_66 /end COMPU_METHOD
/begin COMPU_METHOD CM_DCDC_NV_Komponentenfehler_67 "" TAB_VERB "%10.1" "" COMPU_TAB_REF CM_DCDC_NV_Komponentenfehler_67 /end COMPU_METHOD
/begin COMPU_METHOD CM_DCDC_NV_Komponentenfehler_68 "" TAB_VERB "%10.1" "" COMPU_TAB_REF CM_DCDC_NV_Komponentenfehler_68 /end COMPU_METHOD
/begin COMPU_METHOD CM_DCDC_NV_Komponentenfehler_69 "" TAB_VERB "%10.1" "" COMPU_TAB_REF CM_DCDC_NV_Komponentenfehler_69 /end COMPU_METHOD
/begin COMPU_METHOD CM_DCDC_NV_Komponentenfehler_70 "" TAB_VERB "%10.1" "" COMPU_TAB_REF CM_DCDC_NV_Komponentenfehler_70 /end COMPU_METHOD
/begin COMPU_METHOD CM_DCDC_NV_Komponentenfehler_71 "" TAB_VERB "%10.1" "" COMPU_TAB_REF CM_DCDC_NV_Komponentenfehler_71 /end COMPU_METHOD
/begin COMPU_METHOD CM_DCDC_NV_Komponentenfehler_72 "" TAB_VERB "%10.1" "" COMPU_TAB_REF CM_DCDC_NV_Komponentenfehler_72 /end COMPU_METHOD
/begin COMPU_METHOD CM_DCDC_NV_Komponentenfehler_73 "" TAB_VERB "%10.1" "" COMPU_TAB_REF CM_DCDC_NV_Komponentenfehler_73 /end COMPU_METHOD
/begin COMPU_METHOD CM_DCDC_NV_Komponentenfehler_74 "" TAB_VERB "%10.1" "" COMPU_TAB_REF CM_DCDC_NV_Komponentenfehler_74 /end COMPU_METHOD
/begin COMPU_METHOD CM_DCDC_NV_Komponentenfehler_75 "" TAB_VERB "%10.1" "" COMPU_TAB_REF CM_DCDC_NV_Komponentenfehler_75 /end COMPU_METHOD
/begin COMPU_METHOD CM_DCDC_NV_Komponentenfehler_76 "" TAB_VERB "%10.1" "" COMPU_TAB_REF CM_DCDC_NV_Komponentenfehler_76 /end COMPU_METHOD
/begin COMPU_METHOD CM_DCDC_NV_Komponentenfehler_77 "" TAB_VERB "%10.1" "" COMPU_TAB_REF CM_DCDC_NV_Komponentenfehler_77 /end COMPU_METHOD
/begin COMPU_METHOD CM_DCDC_NV_Komponentenfehler_78 "" TAB_VERB "%10.1" "" COMPU_TAB_REF CM_DCDC_NV_Komponentenfehler_78 /end COMPU_METHOD
/begin COMPU_METHOD CM_DCDC_NV_Komponentenfehler_79 "" TAB_VERB "%10.1" "" COMPU_TAB_REF CM_DCDC_NV_Komponentenfehler_79 /end COMPU_METHOD
/begin COMPU_METHOD CM_DCDC_NV_Komponentenfehler_80 "" TAB_VERB "%10.1" "" COMPU_TAB_REF CM_DCDC_NV_Komponentenfehler_80 /end COMPU_METHOD
/begin COMPU_METHOD CM_DCDC_NV_Komponentenfehler_VLD "" TAB_VERB "%10.1" "" COMPU_TAB_REF CM_DCDC_NV_Komponentenfehler_VLD /end COMPU_METHOD
/begin COMPU_METHOD CM_DC_IstLeistung_HV "" TAB_INTP "%10.1" "Unit_Watt" COMPU_TAB_REF CM_DC_IstLeistung_HV STATUS_STRING_REF CM_DC_IstLeistung_HV.StatusText /end COMPU_METHOD
/begin COMPU_METHOD CM_DS_Hybrid_01_ConfDTCChanged "" TAB_INTP "%10.1" "" COMPU_TAB_REF CM_DS_Hybrid_01_ConfDTCChanged /end COMPU_METHOD
/begin COMPU_METHOD CM_DS_Hybrid_01_DiagAdr "" TAB_INTP "%10.1" "" COMPU_TAB_REF CM_DS_Hybrid_01_DiagAdr /end COMPU_METHOD
/begin COMPU_METHOD CM_DS_Hybrid_01_MemSel10Changed "" TAB_INTP "%10.1" "" COMPU_TAB_REF CM_DS_Hybrid_01_MemSel10Changed /end COMPU_METHOD
/begin COMPU_METHOD CM_DS_Hybrid_01_MemSelChanged "" TAB_INTP "%10.1" "" COMPU_TAB_REF CM_DS_Hybrid_01_MemSelChanged /end COMPU_METHOD
/begin COMPU_METHOD CM_DS_Hybrid_01_StMemChanged "" TAB_INTP "%10.1" "" COMPU_TAB_REF CM_DS_Hybrid_01_StMemChanged /end COMPU_METHOD
/begin COMPU_METHOD CM_DS_Hybrid_01_TestFailedChanged "" TAB_INTP "%10.1" "" COMPU_TAB_REF CM_DS_Hybrid_01_TestFailedChanged /end COMPU_METHOD
/begin COMPU_METHOD CM_DS_Hybrid_01_WIRChanged "" TAB_INTP "%10.1" "" COMPU_TAB_REF CM_DS_Hybrid_01_WIRChanged /end COMPU_METHOD
/begin COMPU_METHOD CM_DW_Kilometerstand "" TAB_INTP "%10.1" "Unit_KiloMeter" COMPU_TAB_REF CM_DW_Kilometerstand STATUS_STRING_REF CM_DW_Kilometerstand.StatusText /end COMPU_METHOD
/begin COMPU_METHOD CM_EKK_HVK_EoHVL_Status "" TAB_VERB "%10.1" "" COMPU_TAB_REF CM_EKK_HVK_EoHVL_Status /end COMPU_METHOD
/begin COMPU_METHOD CM_ErrorType "" TAB_VERB "%10.1" "" COMPU_TAB_REF CM_ErrorType /end COMPU_METHOD
/begin COMPU_METHOD CM_HVEM_BMC_CHA_Wunschleistung "" TAB_INTP "%10.1" "Unit_Watt" COMPU_TAB_REF CM_HVEM_BMC_CHA_Wunschleistung STATUS_STRING_REF CM_HVEM_BMC_CHA_Wunschleistung.StatusText /end COMPU_METHOD
/begin COMPU_METHOD CM_HVEM_BMC_CHA_Wunschleistung_02 "" TAB_INTP "%10.1" "Unit_Watt" COMPU_TAB_REF CM_HVEM_BMC_CHA_Wunschleistung_02 STATUS_STRING_REF CM_HVEM_BMC_CHA_Wunschleistung_02.StatusText /end COMPU_METHOD
/begin COMPU_METHOD CM_HVEM_MMTR_State "" TAB_VERB "%10.1" "" COMPU_TAB_REF CM_HVEM_MMTR_State /end COMPU_METHOD
/begin COMPU_METHOD CM_HVEM_SystemMinLeistungsgrenze "" TAB_INTP "%10.1" "Unit_Watt" COMPU_TAB_REF CM_HVEM_SystemMinLeistungsgrenze STATUS_STRING_REF CM_HVEM_SystemMinLeistungsgrenze.StatusText /end COMPU_METHOD
/begin COMPU_METHOD CM_HVK_03_BZ "" TAB_INTP "%10.1" "" COMPU_TAB_REF CM_HVK_03_BZ /end COMPU_METHOD
/begin COMPU_METHOD CM_HVK_03_CRC "" TAB_INTP "%10.1" "" COMPU_TAB_REF CM_HVK_03_CRC /end COMPU_METHOD
/begin COMPU_METHOD CM_HVK_AIAD_Sollmodus "" TAB_VERB "%10.1" "" COMPU_TAB_REF CM_HVK_AIAD_Sollmodus /end COMPU_METHOD
/begin COMPU_METHOD CM_HVK_AktiveEntladung_Anf "" TAB_VERB "%10.1" "" COMPU_TAB_REF CM_HVK_AktiveEntladung_Anf /end COMPU_METHOD
/begin COMPU_METHOD CM_HVK_BMC_Sollmodus "" TAB_VERB "%10.1" "" COMPU_TAB_REF CM_HVK_BMC_Sollmodus /end COMPU_METHOD
/begin COMPU_METHOD CM_HVK_BMC_Spannung_Anf "" TAB_VERB "%10.1" "" COMPU_TAB_REF CM_HVK_BMC_Spannung_Anf /end COMPU_METHOD
/begin COMPU_METHOD CM_HVK_DCDC_Sollmodus "" TAB_VERB "%10.1" "" COMPU_TAB_REF CM_HVK_DCDC_Sollmodus /end COMPU_METHOD
/begin COMPU_METHOD CM_HVK_EKK_Sollmodus "" TAB_VERB "%10.1" "" COMPU_TAB_REF CM_HVK_EKK_Sollmodus /end COMPU_METHOD
/begin COMPU_METHOD CM_HVK_ETM_Freigabe "" TAB_VERB "%10.1" "" COMPU_TAB_REF CM_HVK_ETM_Freigabe /end COMPU_METHOD
/begin COMPU_METHOD CM_HVK_Gesamtst_Spgfreiheit "" TAB_VERB "%10.1" "" COMPU_TAB_REF CM_HVK_Gesamtst_Spgfreiheit /end COMPU_METHOD
/begin COMPU_METHOD CM_HVK_HVHL_Sollmodus "" TAB_VERB "%10.1" "" COMPU_TAB_REF CM_HVK_HVHL_Sollmodus /end COMPU_METHOD
/begin COMPU_METHOD CM_HVK_HVHW_Sollmodus "" TAB_VERB "%10.1" "" COMPU_TAB_REF CM_HVK_HVHW_Sollmodus /end COMPU_METHOD
/begin COMPU_METHOD CM_HVK_HVLM_Sollmodus "" TAB_VERB "%10.1" "" COMPU_TAB_REF CM_HVK_HVLM_Sollmodus /end COMPU_METHOD
/begin COMPU_METHOD CM_HVK_HV_Netz_Warnungen "" TAB_VERB "%10.1" "" COMPU_TAB_REF CM_HVK_HV_Netz_Warnungen /end COMPU_METHOD
/begin COMPU_METHOD CM_HVK_HV_Netz_Zustand "" TAB_VERB "%10.1" "" COMPU_TAB_REF CM_HVK_HV_Netz_Zustand /end COMPU_METHOD
/begin COMPU_METHOD CM_HVK_Iso_Messung_Start "" TAB_VERB "%10.1" "" COMPU_TAB_REF CM_HVK_Iso_Messung_Start /end COMPU_METHOD
/begin COMPU_METHOD CM_HVK_Istmodus_Anf "" TAB_VERB "%10.1" "" COMPU_TAB_REF CM_HVK_Istmodus_Anf /end COMPU_METHOD
/begin COMPU_METHOD CM_HVK_Vorladung_aktiv "" TAB_VERB "%10.1" "" COMPU_TAB_REF CM_HVK_Vorladung_aktiv /end COMPU_METHOD
/begin COMPU_METHOD CM_HVK_eKAT_Sollmodus "" TAB_VERB "%10.1" "" COMPU_TAB_REF CM_HVK_eKAT_Sollmodus /end COMPU_METHOD
/begin COMPU_METHOD CM_HVLE_IstSpannung_HV "" TAB_INTP "%10.1" "Unit_Volt" COMPU_TAB_REF CM_HVLE_IstSpannung_HV STATUS_STRING_REF CM_HVLE_IstSpannung_HV.StatusText /end COMPU_METHOD
/begin COMPU_METHOD CM_HVLE_OBG_IstModus "" TAB_VERB "%10.1" "" COMPU_TAB_REF CM_HVLE_OBG_IstModus /end COMPU_METHOD
/begin COMPU_METHOD CM_HVLM_14_BZ "" TAB_INTP "%10.1" "" COMPU_TAB_REF CM_HVLM_14_BZ /end COMPU_METHOD
/begin COMPU_METHOD CM_HVLM_14_CRC "" TAB_INTP "%10.1" "" COMPU_TAB_REF CM_HVLM_14_CRC /end COMPU_METHOD
/begin COMPU_METHOD CM_HVLM_Aktive_Ladeart "" TAB_VERB "%10.1" "" COMPU_TAB_REF CM_HVLM_Aktive_Ladeart /end COMPU_METHOD
/begin COMPU_METHOD CM_HVLM_BCAM_Aktiv "" TAB_VERB "%10.1" "" COMPU_TAB_REF CM_HVLM_BCAM_Aktiv /end COMPU_METHOD
/begin COMPU_METHOD CM_HVLM_BidiLadeModus "" TAB_VERB "%10.1" "" COMPU_TAB_REF CM_HVLM_BidiLadeModus /end COMPU_METHOD
/begin COMPU_METHOD CM_HVLM_DC_Aufstartmodus "" TAB_VERB "%10.1" "" COMPU_TAB_REF CM_HVLM_DC_Aufstartmodus /end COMPU_METHOD
/begin COMPU_METHOD CM_HVLM_Grundladen_Anf "" TAB_VERB "%10.1" "" COMPU_TAB_REF CM_HVLM_Grundladen_Anf /end COMPU_METHOD
/begin COMPU_METHOD CM_HVLM_Intensitaet_Lk1 "" TAB_INTP "%10.1" "Unit_PerCent" COMPU_TAB_REF CM_HVLM_Intensitaet_Lk1 STATUS_STRING_REF CM_HVLM_Intensitaet_Lk1.StatusText /end COMPU_METHOD
/begin COMPU_METHOD CM_HVLM_Intensitaet_Lk2 "" TAB_INTP "%10.1" "Unit_PerCent" COMPU_TAB_REF CM_HVLM_Intensitaet_Lk2 STATUS_STRING_REF CM_HVLM_Intensitaet_Lk2.StatusText /end COMPU_METHOD
/begin COMPU_METHOD CM_HVLM_Laden_ISO_Messung_Anf "" TAB_VERB "%10.1" "" COMPU_TAB_REF CM_HVLM_Laden_ISO_Messung_Anf /end COMPU_METHOD
/begin COMPU_METHOD CM_HVLM_Ladenaktiv_Standzyklus "" TAB_VERB "%10.1" "" COMPU_TAB_REF CM_HVLM_Ladenaktiv_Standzyklus /end COMPU_METHOD
/begin COMPU_METHOD CM_HVLM_Ladeniveau_Anf "" TAB_VERB "%10.1" "" COMPU_TAB_REF CM_HVLM_Ladeniveau_Anf /end COMPU_METHOD
/begin COMPU_METHOD CM_HVLM_Ladeszenario "" TAB_VERB "%10.1" "" COMPU_TAB_REF CM_HVLM_Ladeszenario /end COMPU_METHOD
/begin COMPU_METHOD CM_HVLM_Ladevorgang_Anf "" TAB_VERB "%10.1" "" COMPU_TAB_REF CM_HVLM_Ladevorgang_Anf /end COMPU_METHOD
/begin COMPU_METHOD CM_HVLM_PrkCtl_StAlyReq "" TAB_VERB "%10.1" "" COMPU_TAB_REF CM_HVLM_PrkCtl_StAlyReq /end COMPU_METHOD
/begin COMPU_METHOD CM_HVLM_PrkCtl_StPrkLockReq "" TAB_VERB "%10.1" "" COMPU_TAB_REF CM_HVLM_PrkCtl_StPrkLockReq /end COMPU_METHOD
/begin COMPU_METHOD CM_HVLM_Pulsierstufe "" TAB_VERB "%10.1" "" COMPU_TAB_REF CM_HVLM_Pulsierstufe /end COMPU_METHOD
/begin COMPU_METHOD CM_HVLM_Start_Pulserkennung "" TAB_VERB "%10.1" "" COMPU_TAB_REF CM_HVLM_Start_Pulserkennung /end COMPU_METHOD
/begin COMPU_METHOD CM_HVLM_Steckerstatus "" TAB_VERB "%10.1" "" COMPU_TAB_REF CM_HVLM_Steckerstatus /end COMPU_METHOD
/begin COMPU_METHOD CM_HVLM_WakeUpZaehlerResetAnf "" TAB_VERB "%10.1" "" COMPU_TAB_REF CM_HVLM_WakeUpZaehlerResetAnf /end COMPU_METHOD
/begin COMPU_METHOD CM_HVLM_ZustandLadeablauf "" TAB_VERB "%10.1" "" COMPU_TAB_REF CM_HVLM_ZustandLadeablauf /end COMPU_METHOD
/begin COMPU_METHOD CM_HV_Bordnetz_Fehler "" TAB_VERB "%10.1" "" COMPU_TAB_REF CM_HV_Bordnetz_Fehler /end COMPU_METHOD
/begin COMPU_METHOD CM_HV_Bordnetz_aktiv "" TAB_VERB "%10.1" "" COMPU_TAB_REF CM_HV_Bordnetz_aktiv /end COMPU_METHOD
/begin COMPU_METHOD CM_Hybrid_01_OBD_Lampe_Anf "" TAB_VERB "%10.1" "" COMPU_TAB_REF CM_Hybrid_01_OBD_Lampe_Anf /end COMPU_METHOD
/begin COMPU_METHOD CM_Hybrid_01_SNI_10 "" TAB_INTP "%10.1" "Unit_None" COMPU_TAB_REF CM_Hybrid_01_SNI_10 /end COMPU_METHOD
/begin COMPU_METHOD CM_IndType "" TAB_VERB "%10.1" "" COMPU_TAB_REF CM_IndType /end COMPU_METHOD
/begin COMPU_METHOD CM_KN_Hybrid_01_BusKnockOutTimer "" TAB_INTP "%10.1" "" COMPU_TAB_REF CM_KN_Hybrid_01_BusKnockOutTimer STATUS_STRING_REF CM_KN_Hybrid_01_BusKnockOutTimer.StatusText /end COMPU_METHOD
/begin COMPU_METHOD CM_KN_Hybrid_01_ECUKnockOutTimer "" TAB_INTP "%10.1" "" COMPU_TAB_REF CM_KN_Hybrid_01_ECUKnockOutTimer STATUS_STRING_REF CM_KN_Hybrid_01_ECUKnockOutTimer.StatusText /end COMPU_METHOD
/begin COMPU_METHOD CM_KST_KL_15 "" TAB_VERB "%10.1" "" COMPU_TAB_REF CM_KST_KL_15 /end COMPU_METHOD
/begin COMPU_METHOD CM_KS_Hybrid_01_ChK "" TAB_INTP "%10.1" "Unit_None" COMPU_TAB_REF CM_KS_Hybrid_01_ChK /end COMPU_METHOD
/begin COMPU_METHOD CM_KS_Hybrid_01_ChK_IKACtr "" TAB_INTP "%10.1" "Unit_None" COMPU_TAB_REF CM_KS_Hybrid_01_ChK_IKACtr /end COMPU_METHOD
/begin COMPU_METHOD CM_KS_Hybrid_01_ChK_SID "" TAB_INTP "%10.1" "Unit_None" COMPU_TAB_REF CM_KS_Hybrid_01_ChK_SID /end COMPU_METHOD
/begin COMPU_METHOD CM_KS_Hybrid_01_ChM "" TAB_INTP "%10.1" "Unit_None" COMPU_TAB_REF CM_KS_Hybrid_01_ChM /end COMPU_METHOD
/begin COMPU_METHOD CM_KS_Hybrid_01_ChM_IKACtr "" TAB_INTP "%10.1" "Unit_None" COMPU_TAB_REF CM_KS_Hybrid_01_ChM_IKACtr /end COMPU_METHOD
/begin COMPU_METHOD CM_KS_Hybrid_01_ChM_SID "" TAB_INTP "%10.1" "Unit_None" COMPU_TAB_REF CM_KS_Hybrid_01_ChM_SID /end COMPU_METHOD
/begin COMPU_METHOD CM_KS_Hybrid_01_ReK "" TAB_INTP "%10.1" "Unit_None" COMPU_TAB_REF CM_KS_Hybrid_01_ReK /end COMPU_METHOD
/begin COMPU_METHOD CM_KS_Hybrid_01_ReK_IKACtr "" TAB_INTP "%10.1" "Unit_None" COMPU_TAB_REF CM_KS_Hybrid_01_ReK_IKACtr /end COMPU_METHOD
/begin COMPU_METHOD CM_KS_Hybrid_01_ReK_SID "" TAB_INTP "%10.1" "Unit_None" COMPU_TAB_REF CM_KS_Hybrid_01_ReK_SID /end COMPU_METHOD
/begin COMPU_METHOD CM_KS_Hybrid_01_ReM "" TAB_INTP "%10.1" "Unit_None" COMPU_TAB_REF CM_KS_Hybrid_01_ReM /end COMPU_METHOD
/begin COMPU_METHOD CM_KS_Hybrid_01_ReM_IKACtr "" TAB_INTP "%10.1" "Unit_None" COMPU_TAB_REF CM_KS_Hybrid_01_ReM_IKACtr /end COMPU_METHOD
/begin COMPU_METHOD CM_KS_Hybrid_01_ReM_SID "" TAB_INTP "%10.1" "Unit_None" COMPU_TAB_REF CM_KS_Hybrid_01_ReM_SID /end COMPU_METHOD
/begin COMPU_METHOD CM_KS_Hybrid_01_Req_ErrCtr "" TAB_INTP "%10.1" "Unit_None" COMPU_TAB_REF CM_KS_Hybrid_01_Req_ErrCtr /end COMPU_METHOD
/begin COMPU_METHOD CM_KS_Hybrid_01_Req_IKA_Retry "" TAB_VERB "%10.1" "" COMPU_TAB_REF CM_KS_Hybrid_01_Req_IKA_Retry /end COMPU_METHOD
/begin COMPU_METHOD CM_KS_Hybrid_01_Req_Prio "" TAB_VERB "%10.1" "" COMPU_TAB_REF CM_KS_Hybrid_01_Req_Prio /end COMPU_METHOD
/begin COMPU_METHOD CM_KS_Hybrid_01_Req_SID "" TAB_INTP "%10.1" "Unit_None" COMPU_TAB_REF CM_KS_Hybrid_01_Req_SID /end COMPU_METHOD
/begin COMPU_METHOD CM_KS_Hybrid_01_Req_SWMaj "" TAB_INTP "%10.1" "Unit_None" COMPU_TAB_REF CM_KS_Hybrid_01_Req_SWMaj /end COMPU_METHOD
/begin COMPU_METHOD CM_KS_Hybrid_01_Req_SWMin "" TAB_INTP "%10.1" "Unit_None" COMPU_TAB_REF CM_KS_Hybrid_01_Req_SWMin /end COMPU_METHOD
/begin COMPU_METHOD CM_KS_Hybrid_01_Req_SWPat "" TAB_INTP "%10.1" "Unit_None" COMPU_TAB_REF CM_KS_Hybrid_01_Req_SWPat /end COMPU_METHOD
/begin COMPU_METHOD CM_KS_Hybrid_01_Req_VKMS_Err "" TAB_VERB "%10.1" "" COMPU_TAB_REF CM_KS_Hybrid_01_Req_VKMS_Err /end COMPU_METHOD
/begin COMPU_METHOD CM_MM_PropulsionSystemActive "" TAB_VERB "%10.1" "" COMPU_TAB_REF CM_MM_PropulsionSystemActive /end COMPU_METHOD
/begin COMPU_METHOD CM_NVEM_Abschaltstufe "" TAB_VERB "%10.1" "" COMPU_TAB_REF CM_NVEM_Abschaltstufe /end COMPU_METHOD
/begin COMPU_METHOD CM_OBDProtocol_req "" TAB_VERB "%10.1" "" COMPU_TAB_REF CM_OBDProtocol_req /end COMPU_METHOD
/begin COMPU_METHOD CM_OBD_Abs_Pedal_Pos "" TAB_INTP "%10.1" "Unit_PerCent" COMPU_TAB_REF CM_OBD_Abs_Pedal_Pos /end COMPU_METHOD
/begin COMPU_METHOD CM_OBD_Aussen_Temp_gef "" TAB_INTP "%10.1" "Unit_DegreCelsi" COMPU_TAB_REF CM_OBD_Aussen_Temp_gef STATUS_STRING_REF CM_OBD_Aussen_Temp_gef.StatusText /end COMPU_METHOD
/begin COMPU_METHOD CM_OBD_Barometric_Pressure "" TAB_INTP "%10.1" "Unit_KiloPascal" COMPU_TAB_REF CM_OBD_Barometric_Pressure /end COMPU_METHOD
/begin COMPU_METHOD CM_OBD_Calc_Load_Val "" TAB_INTP "%10.1" "Unit_PerCent" COMPU_TAB_REF CM_OBD_Calc_Load_Val /end COMPU_METHOD
/begin COMPU_METHOD CM_OBD_ClearMem_Inhibit "" TAB_VERB "%10.1" "" COMPU_TAB_REF CM_OBD_ClearMem_Inhibit /end COMPU_METHOD
/begin COMPU_METHOD CM_OBD_Driving_Cycle "" TAB_VERB "%10.1" "" COMPU_TAB_REF CM_OBD_Driving_Cycle /end COMPU_METHOD
/begin COMPU_METHOD CM_OBD_Eng_Cool_Temp "" TAB_INTP "%10.1" "Unit_DegreCelsi" COMPU_TAB_REF CM_OBD_Eng_Cool_Temp /end COMPU_METHOD
/begin COMPU_METHOD CM_OBD_Engine_RPM "" TAB_INTP "%10.1" "Unit_MinutInver" COMPU_TAB_REF CM_OBD_Engine_RPM /end COMPU_METHOD
/begin COMPU_METHOD CM_OBD_Kaltstart_Denominator "" TAB_VERB "%10.1" "" COMPU_TAB_REF CM_OBD_Kaltstart_Denominator /end COMPU_METHOD
/begin COMPU_METHOD CM_OBD_Minimum_Trip "" TAB_VERB "%10.1" "" COMPU_TAB_REF CM_OBD_Minimum_Trip /end COMPU_METHOD
/begin COMPU_METHOD CM_OBD_Normed_Trip "" TAB_VERB "%10.1" "" COMPU_TAB_REF CM_OBD_Normed_Trip /end COMPU_METHOD
/begin COMPU_METHOD CM_OBD_NumDcyMilOnReq "" TAB_INTP "%10.1" "Unit_None" COMPU_TAB_REF CM_OBD_NumDcyMilOnReq /end COMPU_METHOD
/begin COMPU_METHOD CM_OBD_QBit_Aussen_Temp "" TAB_VERB "%10.1" "" COMPU_TAB_REF CM_OBD_QBit_Aussen_Temp /end COMPU_METHOD
/begin COMPU_METHOD CM_OBD_Sperrung_IUMPR "" TAB_VERB "%10.1" "" COMPU_TAB_REF CM_OBD_Sperrung_IUMPR /end COMPU_METHOD
/begin COMPU_METHOD CM_OBD_Sperrung_Kaltstart_Denom "" TAB_VERB "%10.1" "" COMPU_TAB_REF CM_OBD_Sperrung_Kaltstart_Denom /end COMPU_METHOD
/begin COMPU_METHOD CM_OBD_Typ "" TAB_VERB "%10.1" "" COMPU_TAB_REF CM_OBD_Typ /end COMPU_METHOD
/begin COMPU_METHOD CM_OBD_Warm_Up_Cycle "" TAB_VERB "%10.1" "" COMPU_TAB_REF CM_OBD_Warm_Up_Cycle /end COMPU_METHOD
/begin COMPU_METHOD CM_ORU_Control_A_01_BZ "" TAB_INTP "%10.1" "" COMPU_TAB_REF CM_ORU_Control_A_01_BZ /end COMPU_METHOD
/begin COMPU_METHOD CM_ORU_Control_A_01_CRC "" TAB_INTP "%10.1" "" COMPU_TAB_REF CM_ORU_Control_A_01_CRC /end COMPU_METHOD
/begin COMPU_METHOD CM_ORU_Control_D_01_BZ "" TAB_INTP "%10.1" "" COMPU_TAB_REF CM_ORU_Control_D_01_BZ /end COMPU_METHOD
/begin COMPU_METHOD CM_ORU_Control_D_01_CRC "" TAB_INTP "%10.1" "" COMPU_TAB_REF CM_ORU_Control_D_01_CRC /end COMPU_METHOD
/begin COMPU_METHOD CM_ORU_Status "" TAB_VERB "%10.1" "" COMPU_TAB_REF CM_ORU_Status /end COMPU_METHOD
/begin COMPU_METHOD CM_OTAMC_D_01_BZ "" TAB_INTP "%10.1" "" COMPU_TAB_REF CM_OTAMC_D_01_BZ /end COMPU_METHOD
/begin COMPU_METHOD CM_OTAMC_D_01_CRC "" TAB_INTP "%10.1" "" COMPU_TAB_REF CM_OTAMC_D_01_CRC /end COMPU_METHOD
/begin COMPU_METHOD CM_OTP_Aussen_Temp_OBD "" TAB_VERB "%10.1" "" COMPU_TAB_REF CM_OTP_Aussen_Temp_OBD /end COMPU_METHOD
/begin COMPU_METHOD CM_OTP_Aussen_Temp_ungef "" TAB_INTP "%10.1" "Unit_DegreCelsi" COMPU_TAB_REF CM_OTP_Aussen_Temp_ungef STATUS_STRING_REF CM_OTP_Aussen_Temp_ungef.StatusText /end COMPU_METHOD
/begin COMPU_METHOD CM_OnlineRemoteUpdateControlA "" TAB_VERB "%10.1" "" COMPU_TAB_REF CM_OnlineRemoteUpdateControlA /end COMPU_METHOD
/begin COMPU_METHOD CM_OnlineRemoteUpdateControlD "" TAB_VERB "%10.1" "" COMPU_TAB_REF CM_OnlineRemoteUpdateControlD /end COMPU_METHOD
/begin COMPU_METHOD CM_OnlineRemoteUpdateControlOldA "" TAB_VERB "%10.1" "" COMPU_TAB_REF CM_OnlineRemoteUpdateControlOldA /end COMPU_METHOD
/begin COMPU_METHOD CM_OnlineRemoteUpdateControlOldD "" TAB_VERB "%10.1" "" COMPU_TAB_REF CM_OnlineRemoteUpdateControlOldD /end COMPU_METHOD
/begin COMPU_METHOD CM_OruControlReleaseA "" TAB_INTP "%10.1" "Unit_None" COMPU_TAB_REF CM_OruControlReleaseA /end COMPU_METHOD
/begin COMPU_METHOD CM_OruControlReleaseD "" TAB_INTP "%10.1" "Unit_None" COMPU_TAB_REF CM_OruControlReleaseD /end COMPU_METHOD
/begin COMPU_METHOD CM_OruControlStateA "" TAB_VERB "%10.1" "" COMPU_TAB_REF CM_OruControlStateA /end COMPU_METHOD
/begin COMPU_METHOD CM_OruControlStateD "" TAB_VERB "%10.1" "" COMPU_TAB_REF CM_OruControlStateD /end COMPU_METHOD
/begin COMPU_METHOD CM_OruHostUpdateA "" TAB_VERB "%10.1" "" COMPU_TAB_REF CM_OruHostUpdateA /end COMPU_METHOD
/begin COMPU_METHOD CM_OruHostUpdateD "" TAB_VERB "%10.1" "" COMPU_TAB_REF CM_OruHostUpdateD /end COMPU_METHOD
/begin COMPU_METHOD CM_OruIntegrityCheckActiveA "" TAB_VERB "%10.1" "" COMPU_TAB_REF CM_OruIntegrityCheckActiveA /end COMPU_METHOD
/begin COMPU_METHOD CM_OruIntegrityCheckActiveD "" TAB_VERB "%10.1" "" COMPU_TAB_REF CM_OruIntegrityCheckActiveD /end COMPU_METHOD
/begin COMPU_METHOD CM_OruReleasePartitionSwitchA "" TAB_VERB "%10.1" "" COMPU_TAB_REF CM_OruReleasePartitionSwitchA /end COMPU_METHOD
/begin COMPU_METHOD CM_OruReleasePartitionSwitchD "" TAB_VERB "%10.1" "" COMPU_TAB_REF CM_OruReleasePartitionSwitchD /end COMPU_METHOD
/begin COMPU_METHOD CM_OruVehicleLockRequestA "" TAB_VERB "%10.1" "" COMPU_TAB_REF CM_OruVehicleLockRequestA /end COMPU_METHOD
/begin COMPU_METHOD CM_OruVehicleLockRequestD "" TAB_VERB "%10.1" "" COMPU_TAB_REF CM_OruVehicleLockRequestD /end COMPU_METHOD
/begin COMPU_METHOD CM_PCM_BMC_VTD_Freeze_Req "" TAB_VERB "%10.1" "" COMPU_TAB_REF CM_PCM_BMC_VTD_Freeze_Req /end COMPU_METHOD
/begin COMPU_METHOD CM_PCM_BMC_VTD_LifeTimeReset_Req "" TAB_VERB "%10.1" "" COMPU_TAB_REF CM_PCM_BMC_VTD_LifeTimeReset_Req /end COMPU_METHOD
/begin COMPU_METHOD CM_PCM_BMC_VTD_LifeTimeReset_Resp "" TAB_VERB "%10.1" "" COMPU_TAB_REF CM_PCM_BMC_VTD_LifeTimeReset_Resp /end COMPU_METHOD
/begin COMPU_METHOD CM_PCM_BMC_VTD_RecentReset_Req "" TAB_VERB "%10.1" "" COMPU_TAB_REF CM_PCM_BMC_VTD_RecentReset_Req /end COMPU_METHOD
/begin COMPU_METHOD CM_ReqType "" TAB_VERB "%10.1" "" COMPU_TAB_REF CM_ReqType /end COMPU_METHOD
/begin COMPU_METHOD CM_SI_NWDF "" TAB_VERB "%10.1" "" COMPU_TAB_REF CM_SI_NWDF /end COMPU_METHOD
/begin COMPU_METHOD CM_SI_NWDF_30 "" TAB_VERB "%10.1" "" COMPU_TAB_REF CM_SI_NWDF_30 /end COMPU_METHOD
/begin COMPU_METHOD CM_SI_P_Mode "" TAB_VERB "%10.1" "" COMPU_TAB_REF CM_SI_P_Mode /end COMPU_METHOD
/begin COMPU_METHOD CM_SI_P_Mode_gueltig "" TAB_VERB "%10.1" "" COMPU_TAB_REF CM_SI_P_Mode_gueltig /end COMPU_METHOD
/begin COMPU_METHOD CM_SI_T_Mode "" TAB_VERB "%10.1" "" COMPU_TAB_REF CM_SI_T_Mode /end COMPU_METHOD
/begin COMPU_METHOD CM_SOK_Zeit_Hybrid_01_Challenge "" TAB_INTP "%10.1" "Unit_None" COMPU_TAB_REF CM_SOK_Zeit_Hybrid_01_Challenge /end COMPU_METHOD
/begin COMPU_METHOD CM_SOK_Zeit_Hybrid_01_Zeit "" TAB_INTP "%10.1" "Unit_None" COMPU_TAB_REF CM_SOK_Zeit_Hybrid_01_Zeit /end COMPU_METHOD
/begin COMPU_METHOD CM_SOK_ungeschuetzte_Zeit "" TAB_INTP "%10.1" "Unit_None" COMPU_TAB_REF CM_SOK_ungeschuetzte_Zeit STATUS_STRING_REF CM_SOK_ungeschuetzte_Zeit.StatusText /end COMPU_METHOD
/begin COMPU_METHOD CM_TME_Batt_Kond_Verf "" TAB_VERB "%10.1" "" COMPU_TAB_REF CM_TME_Batt_Kond_Verf /end COMPU_METHOD
/begin COMPU_METHOD CM_TME_Therm_IstLeistung_HVBatterie "" TAB_INTP "%10.1" "Unit_Watt" COMPU_TAB_REF CM_TME_Therm_IstLeistung_HVBatterie STATUS_STRING_REF CM_TME_Therm_IstLeistung_HVBatterie.StatusText /end COMPU_METHOD
/begin COMPU_METHOD CM_UH_Jahr "" TAB_INTP "%10.1" "Unit_Year" COMPU_TAB_REF CM_UH_Jahr /end COMPU_METHOD
/begin COMPU_METHOD CM_UH_Minute "" TAB_INTP "%10.1" "Unit_Minut" COMPU_TAB_REF CM_UH_Minute /end COMPU_METHOD
/begin COMPU_METHOD CM_UH_Monat "" TAB_INTP "%10.1" "Unit_Month" COMPU_TAB_REF CM_UH_Monat STATUS_STRING_REF CM_UH_Monat.StatusText /end COMPU_METHOD
/begin COMPU_METHOD CM_UH_Sekunde "" TAB_INTP "%10.1" "Unit_Secon" COMPU_TAB_REF CM_UH_Sekunde /end COMPU_METHOD
/begin COMPU_METHOD CM_UH_Stunde "" TAB_INTP "%10.1" "Unit_Hours" COMPU_TAB_REF CM_UH_Stunde /end COMPU_METHOD
/begin COMPU_METHOD CM_UH_Tag "" TAB_INTP "%10.1" "Unit_Day" COMPU_TAB_REF CM_UH_Tag STATUS_STRING_REF CM_UH_Tag.StatusText /end COMPU_METHOD
/begin COMPU_METHOD CM_UI1_Iso_Neg "" TAB_INTP "%10.1" "Unit_Ohm" COMPU_TAB_REF CM_UI1_Iso_Neg STATUS_STRING_REF CM_UI1_Iso_Neg.StatusText /end COMPU_METHOD
/begin COMPU_METHOD Nm_InitializedType "" TAB_VERB "%10.1" "" COMPU_TAB_REF Nm_InitializedType /end COMPU_METHOD
/begin COMPU_METHOD Nm_PostInitializedType "" TAB_VERB "%10.1" "" COMPU_TAB_REF Nm_PostInitializedType /end COMPU_METHOD
/begin COMPU_METHOD NvMErrorStatusValues "" TAB_VERB "%10.1" "" COMPU_TAB_REF NvMErrorStatusValues /end COMPU_METHOD
/begin COMPU_METHOD PduR_AllocatedOfBmTxBufferRamType "" TAB_VERB "%10.1" "" COMPU_TAB_REF PduR_AllocatedOfBmTxBufferRamType /end COMPU_METHOD
/begin COMPU_METHOD PduR_ExclusiveAreaRomIdxOfLockRomType "" TAB_VERB "%10.1" "" COMPU_TAB_REF PduR_ExclusiveAreaRomIdxOfLockRomType /end COMPU_METHOD
/begin COMPU_METHOD PduR_InitializedRamType "" TAB_VERB "%10.1" "" COMPU_TAB_REF PduR_InitializedRamType /end COMPU_METHOD
/begin COMPU_METHOD PduR_PduLengthHandlingStrategyOfRmDestRomType "" TAB_VERB "%10.1" "" COMPU_TAB_REF PduR_PduLengthHandlingStrategyOfRmDestRomType /end COMPU_METHOD
/begin COMPU_METHOD PduR_RmGDestRomStartIdxOfDestApplicationManagerRomType "" TAB_VERB "%10.1" "" COMPU_TAB_REF PduR_RmGDestRomStartIdxOfDestApplicationManagerRomType /end COMPU_METHOD
/begin COMPU_METHOD PduR_RoutingTypeOfRmDestRomType "" TAB_VERB "%10.1" "" COMPU_TAB_REF PduR_RoutingTypeOfRmDestRomType /end COMPU_METHOD
/begin COMPU_METHOD PduR_TpRxSmStateOfRmBufferedTpPropertiesRamType "" TAB_VERB "%10.1" "" COMPU_TAB_REF PduR_TpRxSmStateOfRmBufferedTpPropertiesRamType /end COMPU_METHOD
/begin COMPU_METHOD PduR_hasIfRoutingOfGeneralPropertiesRomType "" TAB_VERB "%10.1" "" COMPU_TAB_REF PduR_hasIfRoutingOfGeneralPropertiesRomType /end COMPU_METHOD
/begin COMPU_VTAB CM_DCDC_NV_Komponentenfehler_60 "" TAB_VERB 4 0 "CM_DCDC_NV_Komponentenfehler_60_Cx0_TstNotComplThisOpCycle_Init" 1 "CM_DCDC_NV_Komponentenfehler_60_Cx1_TstComplThisOpCycle_Pass" 2 "CM_DCDC_NV_Komponentenfehler_60_Cx2_TstCmplThisCycle_Pass_TimeElapse" 3 "CM_DCDC_NV_Komponentenfehler_60_Cx3_TstComplThisOpCycle_FAIL" /end COMPU_VTAB
/begin COMPU_VTAB CM_DCDC_NV_Komponentenfehler_61 "" TAB_VERB 4 0 "CM_DCDC_NV_Komponentenfehler_61_Cx0_TstNotComplThisOpCycle_Init" 1 "CM_DCDC_NV_Komponentenfehler_61_Cx1_TstComplThisOpCycle_Pass" 2 "CM_DCDC_NV_Komponentenfehler_61_Cx2_TstCmplThisCycle_Pass_TimeElapse" 3 "CM_DCDC_NV_Komponentenfehler_61_Cx3_TstComplThisOpCycle_FAIL" /end COMPU_VTAB
/begin COMPU_VTAB CM_DCDC_NV_Komponentenfehler_62 "" TAB_VERB 4 0 "CM_DCDC_NV_Komponentenfehler_62_Cx0_TstNotComplThisOpCycle_Init" 1 "CM_DCDC_NV_Komponentenfehler_62_Cx1_TstComplThisOpCycle_Pass" 2 "CM_DCDC_NV_Komponentenfehler_62_Cx2_TstCmplThisCycle_Pass_TimeElapse" 3 "CM_DCDC_NV_Komponentenfehler_62_Cx3_TstComplThisOpCycle_FAIL" /end COMPU_VTAB
/begin COMPU_VTAB CM_DCDC_NV_Komponentenfehler_63 "" TAB_VERB 4 0 "CM_DCDC_NV_Komponentenfehler_63_Cx0_TstNotComplThisOpCycle_Init" 1 "CM_DCDC_NV_Komponentenfehler_63_Cx1_TstComplThisOpCycle_Pass" 2 "CM_DCDC_NV_Komponentenfehler_63_Cx2_TstCmplThisCycle_Pass_TimeElapse" 3 "CM_DCDC_NV_Komponentenfehler_63_Cx3_TstComplThisOpCycle_FAIL" /end COMPU_VTAB
/begin COMPU_VTAB CM_DCDC_NV_Komponentenfehler_64 "" TAB_VERB 4 0 "CM_DCDC_NV_Komponentenfehler_64_Cx0_TstNotComplThisOpCycle_Init" 1 "CM_DCDC_NV_Komponentenfehler_64_Cx1_TstComplThisOpCycle_Pass" 2 "CM_DCDC_NV_Komponentenfehler_64_Cx2_TstCmplThisCycle_Pass_TimeElapse" 3 "CM_DCDC_NV_Komponentenfehler_64_Cx3_TstComplThisOpCycle_FAIL" /end COMPU_VTAB
/begin COMPU_VTAB CM_DCDC_NV_Komponentenfehler_65 "" TAB_VERB 4 0 "CM_DCDC_NV_Komponentenfehler_65_Cx0_TstNotComplThisOpCycle_Init" 1 "CM_DCDC_NV_Komponentenfehler_65_Cx1_TstComplThisOpCycle_Pass" 2 "CM_DCDC_NV_Komponentenfehler_65_Cx2_TstCmplThisCycle_Pass_TimeElapse" 3 "CM_DCDC_NV_Komponentenfehler_65_Cx3_TstComplThisOpCycle_FAIL" /end COMPU_VTAB
/begin COMPU_VTAB CM_DCDC_NV_Komponentenfehler_66 "" TAB_VERB 4 0 "CM_DCDC_NV_Komponentenfehler_66_Cx0_TstNotComplThisOpCycle_Init" 1 "CM_DCDC_NV_Komponentenfehler_66_Cx1_TstComplThisOpCycle_Pass" 2 "CM_DCDC_NV_Komponentenfehler_66_Cx2_TstCmplThisCycle_Pass_TimeElapse" 3 "CM_DCDC_NV_Komponentenfehler_66_Cx3_TstComplThisOpCycle_FAIL" /end COMPU_VTAB
/begin COMPU_VTAB CM_DCDC_NV_Komponentenfehler_67 "" TAB_VERB 4 0 "CM_DCDC_NV_Komponentenfehler_67_Cx0_TstNotComplThisOpCycle_Init" 1 "CM_DCDC_NV_Komponentenfehler_67_Cx1_TstComplThisOpCycle_Pass" 2 "CM_DCDC_NV_Komponentenfehler_67_Cx2_TstCmplThisCycle_Pass_TimeElapse" 3 "CM_DCDC_NV_Komponentenfehler_67_Cx3_TstComplThisOpCycle_FAIL" /end COMPU_VTAB
/begin COMPU_VTAB CM_DCDC_NV_Komponentenfehler_68 "" TAB_VERB 4 0 "CM_DCDC_NV_Komponentenfehler_68_Cx0_TstNotComplThisOpCycle_Init" 1 "CM_DCDC_NV_Komponentenfehler_68_Cx1_TstComplThisOpCycle_Pass" 2 "CM_DCDC_NV_Komponentenfehler_68_Cx2_TstCmplThisCycle_Pass_TimeElapse" 3 "CM_DCDC_NV_Komponentenfehler_68_Cx3_TstComplThisOpCycle_FAIL" /end COMPU_VTAB
/begin COMPU_VTAB CM_DCDC_NV_Komponentenfehler_69 "" TAB_VERB 4 0 "CM_DCDC_NV_Komponentenfehler_69_Cx0_TstNotComplThisOpCycle_Init" 1 "CM_DCDC_NV_Komponentenfehler_69_Cx1_TstComplThisOpCycle_Pass" 2 "CM_DCDC_NV_Komponentenfehler_69_Cx2_TstCmplThisCycle_Pass_TimeElapse" 3 "CM_DCDC_NV_Komponentenfehler_69_Cx3_TstComplThisOpCycle_FAIL" /end COMPU_VTAB
/begin COMPU_VTAB CM_DCDC_NV_Komponentenfehler_70 "" TAB_VERB 4 0 "CM_DCDC_NV_Komponentenfehler_70_Cx0_TstNotComplThisOpCycle_Init" 1 "CM_DCDC_NV_Komponentenfehler_70_Cx1_TstComplThisOpCycle_Pass" 2 "CM_DCDC_NV_Komponentenfehler_70_Cx2_TstCmplThisCycle_Pass_TimeElapse" 3 "CM_DCDC_NV_Komponentenfehler_70_Cx3_TstComplThisOpCycle_FAIL" /end COMPU_VTAB
/begin COMPU_VTAB CM_DCDC_NV_Komponentenfehler_71 "" TAB_VERB 4 0 "CM_DCDC_NV_Komponentenfehler_71_Cx0_TstNotComplThisOpCycle_Init" 1 "CM_DCDC_NV_Komponentenfehler_71_Cx1_TstComplThisOpCycle_Pass" 2 "CM_DCDC_NV_Komponentenfehler_71_Cx2_TstCmplThisCycle_Pass_TimeElapse" 3 "CM_DCDC_NV_Komponentenfehler_71_Cx3_TstComplThisOpCycle_FAIL" /end COMPU_VTAB
/begin COMPU_VTAB CM_DCDC_NV_Komponentenfehler_72 "" TAB_VERB 4 0 "CM_DCDC_NV_Komponentenfehler_72_Cx0_TstNotComplThisOpCycle_Init" 1 "CM_DCDC_NV_Komponentenfehler_72_Cx1_TstComplThisOpCycle_Pass" 2 "CM_DCDC_NV_Komponentenfehler_72_Cx2_TstCmplThisCycle_Pass_TimeElapse" 3 "CM_DCDC_NV_Komponentenfehler_72_Cx3_TstComplThisOpCycle_FAIL" /end COMPU_VTAB
/begin COMPU_VTAB CM_DCDC_NV_Komponentenfehler_73 "" TAB_VERB 4 0 "CM_DCDC_NV_Komponentenfehler_73_Cx0_TstNotComplThisOpCycle_Init" 1 "CM_DCDC_NV_Komponentenfehler_73_Cx1_TstComplThisOpCycle_Pass" 2 "CM_DCDC_NV_Komponentenfehler_73_Cx2_TstCmplThisCycle_Pass_TimeElapse" 3 "CM_DCDC_NV_Komponentenfehler_73_Cx3_TstComplThisOpCycle_FAIL" /end COMPU_VTAB
/begin COMPU_VTAB CM_DCDC_NV_Komponentenfehler_74 "" TAB_VERB 4 0 "CM_DCDC_NV_Komponentenfehler_74_Cx0_TstNotComplThisOpCycle_Init" 1 "CM_DCDC_NV_Komponentenfehler_74_Cx1_TstComplThisOpCycle_Pass" 2 "CM_DCDC_NV_Komponentenfehler_74_Cx2_TstCmplThisCycle_Pass_TimeElapse" 3 "CM_DCDC_NV_Komponentenfehler_74_Cx3_TstComplThisOpCycle_FAIL" /end COMPU_VTAB
/begin COMPU_VTAB CM_DCDC_NV_Komponentenfehler_75 "" TAB_VERB 4 0 "CM_DCDC_NV_Komponentenfehler_75_Cx0_TstNotComplThisOpCycle_Init" 1 "CM_DCDC_NV_Komponentenfehler_75_Cx1_TstComplThisOpCycle_Pass" 2 "CM_DCDC_NV_Komponentenfehler_75_Cx2_TstCmplThisCycle_Pass_TimeElapse" 3 "CM_DCDC_NV_Komponentenfehler_75_Cx3_TstComplThisOpCycle_FAIL" /end COMPU_VTAB
/begin COMPU_VTAB CM_DCDC_NV_Komponentenfehler_76 "" TAB_VERB 4 0 "CM_DCDC_NV_Komponentenfehler_76_Cx0_TstNotComplThisOpCycle_Init" 1 "CM_DCDC_NV_Komponentenfehler_76_Cx1_TstComplThisOpCycle_Pass" 2 "CM_DCDC_NV_Komponentenfehler_76_Cx2_TstCmplThisCycle_Pass_TimeElapse" 3 "CM_DCDC_NV_Komponentenfehler_76_Cx3_TstComplThisOpCycle_FAIL" /end COMPU_VTAB
/begin COMPU_VTAB CM_DCDC_NV_Komponentenfehler_77 "" TAB_VERB 4 0 "CM_DCDC_NV_Komponentenfehler_77_Cx0_TstNotComplThisOpCycle_Init" 1 "CM_DCDC_NV_Komponentenfehler_77_Cx1_TstComplThisOpCycle_Pass" 2 "CM_DCDC_NV_Komponentenfehler_77_Cx2_TstCmplThisCycle_Pass_TimeElapse" 3 "CM_DCDC_NV_Komponentenfehler_77_Cx3_TstComplThisOpCycle_FAIL" /end COMPU_VTAB
/begin COMPU_VTAB CM_DCDC_NV_Komponentenfehler_78 "" TAB_VERB 4 0 "CM_DCDC_NV_Komponentenfehler_78_Cx0_TstNotComplThisOpCycle_Init" 1 "CM_DCDC_NV_Komponentenfehler_78_Cx1_TstComplThisOpCycle_Pass" 2 "CM_DCDC_NV_Komponentenfehler_78_Cx2_TstCmplThisCycle_Pass_TimeElapse" 3 "CM_DCDC_NV_Komponentenfehler_78_Cx3_TstComplThisOpCycle_FAIL" /end COMPU_VTAB
/begin COMPU_VTAB CM_DCDC_NV_Komponentenfehler_79 "" TAB_VERB 4 0 "CM_DCDC_NV_Komponentenfehler_79_Cx0_TstNotComplThisOpCycle_Init" 1 "CM_DCDC_NV_Komponentenfehler_79_Cx1_TstComplThisOpCycle_Pass" 2 "CM_DCDC_NV_Komponentenfehler_79_Cx2_TstCmplThisCycle_Pass_TimeElapse" 3 "CM_DCDC_NV_Komponentenfehler_79_Cx3_TstComplThisOpCycle_FAIL" /end COMPU_VTAB
/begin COMPU_VTAB CM_DCDC_NV_Komponentenfehler_80 "" TAB_VERB 4 0 "CM_DCDC_NV_Komponentenfehler_80_Cx0_TstNotComplThisOpCycle_Init" 1 "CM_DCDC_NV_Komponentenfehler_80_Cx1_TstComplThisOpCycle_Pass" 2 "CM_DCDC_NV_Komponentenfehler_80_Cx2_TstCmplThisCycle_Pass_TimeElapse" 3 "CM_DCDC_NV_Komponentenfehler_80_Cx3_TstComplThisOpCycle_FAIL" /end COMPU_VTAB
/begin COMPU_VTAB CM_DCDC_NV_Komponentenfehler_VLD "" TAB_VERB 2 0 "CM_DCDC_NV_Komponentenfehler_VLD_Cx0_ungueltig" 1 "CM_DCDC_NV_Komponentenfehler_VLD_Cx1_gueltig" /end COMPU_VTAB
/begin COMPU_TAB CM_DC_IstLeistung_HV "" TAB_INTP 2 0 -4000 1021 6210 /end COMPU_TAB
/begin COMPU_VTAB CM_DC_IstLeistung_HV.StatusText "" TAB_VERB 2 1022 "CM_DC_IstLeistung_HV_Cx3fe_Init" 1023 "CM_DC_IstLeistung_HV_Cx3ff_Fehler" /end COMPU_VTAB
/begin COMPU_TAB CM_DS_Hybrid_01_ConfDTCChanged "" TAB_INTP 2 0 0 1 1 /end COMPU_TAB
/begin COMPU_TAB CM_DS_Hybrid_01_DiagAdr "" TAB_INTP 2 0 0 65535 65535 /end COMPU_TAB
/begin COMPU_TAB CM_DS_Hybrid_01_MemSel10Changed "" TAB_INTP 2 0 0 1 1 /end COMPU_TAB
/begin COMPU_TAB CM_DS_Hybrid_01_MemSelChanged "" TAB_INTP 2 0 0 1 1 /end COMPU_TAB
/begin COMPU_TAB CM_DS_Hybrid_01_StMemChanged "" TAB_INTP 2 0 0 1 1 /end COMPU_TAB
/begin COMPU_TAB CM_DS_Hybrid_01_TestFailedChanged "" TAB_INTP 2 0 0 1 1 /end COMPU_TAB
/begin COMPU_TAB CM_DS_Hybrid_01_WIRChanged "" TAB_INTP 2 0 0 1 1 /end COMPU_TAB
/begin COMPU_TAB CM_DW_Kilometerstand "" TAB_INTP 2 0 0 1048573 1048573 /end COMPU_TAB
/begin COMPU_VTAB CM_DW_Kilometerstand.StatusText "" TAB_VERB 2 1048574 "CM_DW_Kilometerstand_Cxffffe_Init" 1048575 "CM_DW_Kilometerstand_Cxfffff_Fehler" /end COMPU_VTAB
/begin COMPU_VTAB CM_EKK_HVK_EoHVL_Status "" TAB_VERB 4 0 "CM_EKK_HVK_EoHVL_Status_Cx0_Init" 1 "CM_EKK_HVK_EoHVL_Status_Cx1_Uzwkr_kleiner_UEoHVL_Schwell" 2 "CM_EKK_HVK_EoHVL_Status_Cx2_Uzwkr_groesgleich_UEoHVL_Schwell" 3 "CM_EKK_HVK_EoHVL_Status_Cx3_Fehler" /end COMPU_VTAB
/begin COMPU_VTAB CM_ErrorType "" TAB_VERB 20 0 "BapErr_OK" 18 "BapErr_IllegalSequence" 19 "BapErr_SequenceNumber" 20 "BapErr_TimeoutSegmentation" 21 "BapErr_OversizeSegmentation" 22 "BapErr_BadDataLength" 23 "BapErr_ReceivedDataLost" 33 "BapErr_TimeoutHeartbeat" 34 "BapErr_RetryNotSuccessful" 35 "BapErr_Busy" 36 "BapErr_ReqTimeout" 50 "BapErr_IncompatibleProtocolVersion" 51 "BapErr_IncompatibleDataSpecification" 52 "BapErr_CacheInvalid" 53 "BapErr_InvalidState" 54 "BapErr_CacheNotAvailable" 55 "BapErr_InvalidArg" 56 "BapErr_ProcessingTimeout" 57 "BapErr_GetAllMessageCorrupted" 80 "BapErr_Aborted" /end COMPU_VTAB
/begin COMPU_TAB CM_HVEM_BMC_CHA_Wunschleistung "" TAB_INTP 2 0 0 8189 818900 /end COMPU_TAB
/begin COMPU_VTAB CM_HVEM_BMC_CHA_Wunschleistung.StatusText "" TAB_VERB 2 8190 "CM_HVEM_BMC_CHA_Wunschleistung_Cx1ffe_Init" 8191 "CM_HVEM_BMC_CHA_Wunschleistung_Cx1fff_Fehler" /end COMPU_VTAB
/begin COMPU_TAB CM_HVEM_BMC_CHA_Wunschleistung_02 "" TAB_INTP 2 0 0 32500 3250000 /end COMPU_TAB
/begin COMPU_VTAB CM_HVEM_BMC_CHA_Wunschleistung_02.StatusText "" TAB_VERB 2 32766 "CM_HVEM_BMC_CHA_Wunschleistung_02_Cx7ffe_Init" 32767 "CM_HVEM_BMC_CHA_Wunschleistung_02_Cx7fff_Fehler" /end COMPU_VTAB
/begin COMPU_VTAB CM_HVEM_MMTR_State "" TAB_VERB 10 0 "CM_HVEM_MMTR_State_Cx0_Nicht_verfuegbar" 1 "CM_HVEM_MMTR_State_Cx1_Inaktiv" 2 "CM_HVEM_MMTR_State_Cx2_Aktiv_Vorkonditionierung" 3 "CM_HVEM_MMTR_State_Cx3_Abgeschlossen_Vorkonditionierung" 4 "CM_HVEM_MMTR_State_Cx4_Aktiv_TrackSession" 5 "CM_HVEM_MMTR_State_Cx5_Aktiv_Endurance" 6 "CM_HVEM_MMTR_State_Cx6_Aktiv_HotLap" 7 "CM_HVEM_MMTR_State_Cx7_Beendet_TrackSession" 14 "CM_HVEM_MMTR_State_Cxe_Init" 15 "CM_HVEM_MMTR_State_Cxf_Fehler" /end COMPU_VTAB
/begin COMPU_TAB CM_HVEM_SystemMinLeistungsgrenze "" TAB_INTP 2 0 0 125 125000 /end COMPU_TAB
/begin COMPU_VTAB CM_HVEM_SystemMinLeistungsgrenze.StatusText "" TAB_VERB 2 126 "CM_HVEM_SystemMinLeistungsgrenze_Cx7e_Init" 127 "CM_HVEM_SystemMinLeistungsgrenze_Cx7f_Fehler" /end COMPU_VTAB
/begin COMPU_TAB CM_HVK_03_BZ "" TAB_INTP 2 0 0 15 15 /end COMPU_TAB
/begin COMPU_TAB CM_HVK_03_CRC "" TAB_INTP 2 0 0 255 255 /end COMPU_TAB
/begin COMPU_VTAB CM_HVK_AIAD_Sollmodus "" TAB_VERB 4 0 "CM_HVK_AIAD_Sollmodus_Cx0_Keine_Freigabe" 1 "CM_HVK_AIAD_Sollmodus_Cx1_Freigabe" 2 "CM_HVK_AIAD_Sollmodus_Cx2_Freigabe_ausgesetzt" 3 "CM_HVK_AIAD_Sollmodus_Cx3_Init" /end COMPU_VTAB
/begin COMPU_VTAB CM_HVK_AktiveEntladung_Anf "" TAB_VERB 2 0 "CM_HVK_AktiveEntladung_Anf_Cx0_nicht_angefordert" 1 "CM_HVK_AktiveEntladung_Anf_Cx1_angefordert" /end COMPU_VTAB
/begin COMPU_VTAB CM_HVK_BMC_Sollmodus "" TAB_VERB 5 0 "CM_HVK_BMC_Sollmodus_Cx0_HV_Off" 1 "CM_HVK_BMC_Sollmodus_Cx1_HV_On" 4 "CM_HVK_BMC_Sollmodus_Cx4_AC_Laden" 6 "CM_HVK_BMC_Sollmodus_Cx6_DC_Laden" 7 "CM_HVK_BMC_Sollmodus_Cx7_Init" /end COMPU_VTAB
/begin COMPU_VTAB CM_HVK_BMC_Spannung_Anf "" TAB_VERB 4 0 "CM_HVK_BMC_Spannung_Anf_Cx0_keine_Spg_Anforderung" 1 "CM_HVK_BMC_Spannung_Anf_Cx1_400V_Spg_Anforderung" 2 "CM_HVK_BMC_Spannung_Anf_Cx2_800V_Spg_Anforderung" 3 "CM_HVK_BMC_Spannung_Anf_Cx3_Init" /end COMPU_VTAB
/begin COMPU_VTAB CM_HVK_DCDC_Sollmodus "" TAB_VERB 7 0 "CM_HVK_DCDC_Sollmodus_Cx0_Standby" 1 "CM_HVK_DCDC_Sollmodus_Cx1_HV_On_Vorladen" 2 "CM_HVK_DCDC_Sollmodus_Cx2_Tiefsetzen" 3 "CM_HVK_DCDC_Sollmodus_Cx3_Hochsetzen" 4 "CM_HVK_DCDC_Sollmodus_Cx4_Pruefpuls_12V" 6 "CM_HVK_DCDC_Sollmodus_Cx6_Pruefpuls_DC_Laden" 7 "CM_HVK_DCDC_Sollmodus_Cx7_Initialisierung" /end COMPU_VTAB
/begin COMPU_VTAB CM_HVK_EKK_Sollmodus "" TAB_VERB 4 0 "CM_HVK_EKK_Sollmodus_Cx0_Keine_Freigabe" 1 "CM_HVK_EKK_Sollmodus_Cx1_Freigabe" 2 "CM_HVK_EKK_Sollmodus_Cx2_Freigabe_ausgesetzt" 7 "CM_HVK_EKK_Sollmodus_Cx7_Init" /end COMPU_VTAB
/begin COMPU_VTAB CM_HVK_ETM_Freigabe "" TAB_VERB 4 0 "CM_HVK_ETM_Freigabe_Cx0_keine_Freigabe" 1 "CM_HVK_ETM_Freigabe_Cx1_Freigabe" 2 "CM_HVK_ETM_Freigabe_Cx2_Freigabe_Sonderbetrieb" 3 "CM_HVK_ETM_Freigabe_Cx3_Init" /end COMPU_VTAB
/begin COMPU_VTAB CM_HVK_Gesamtst_Spgfreiheit "" TAB_VERB 4 0 "CM_HVK_Gesamtst_Spgfreiheit_Cx0_Funktion_Init_ohne_Funktion" 1 "CM_HVK_Gesamtst_Spgfreiheit_Cx1_HV_System_spannungsfrei" 2 "CM_HVK_Gesamtst_Spgfreiheit_Cx2_HV_System_nicht_spannungsfrei" 3 "CM_HVK_Gesamtst_Spgfreiheit_Cx3_Fehler" /end COMPU_VTAB
/begin COMPU_VTAB CM_HVK_HVHL_Sollmodus "" TAB_VERB 4 0 "CM_HVK_HVHL_Sollmodus_Cx0_Keine_Freigabe" 1 "CM_HVK_HVHL_Sollmodus_Cx1_Freigabe" 2 "CM_HVK_HVHL_Sollmodus_Cx2_Freigabe_ausgesetzt" 3 "CM_HVK_HVHL_Sollmodus_Cx3_Init" /end COMPU_VTAB
/begin COMPU_VTAB CM_HVK_HVHW_Sollmodus "" TAB_VERB 4 0 "CM_HVK_HVHW_Sollmodus_Cx0_Keine_Freigabe" 1 "CM_HVK_HVHW_Sollmodus_Cx1_Freigabe" 2 "CM_HVK_HVHW_Sollmodus_Cx2_Freigabe_ausgesetzt" 3 "CM_HVK_HVHW_Sollmodus_Cx3_Init" /end COMPU_VTAB
/begin COMPU_VTAB CM_HVK_HVLM_Sollmodus "" TAB_VERB 4 0 "CM_HVK_HVLM_Sollmodus_Cx0_keine_Freigabe" 1 "CM_HVK_HVLM_Sollmodus_Cx1_Freigabe_Lademanager" 2 "CM_HVK_HVLM_Sollmodus_Cx2_Vorladung_AC_Pfad" 7 "CM_HVK_HVLM_Sollmodus_Cx7_Init" /end COMPU_VTAB
/begin COMPU_VTAB CM_HVK_HV_Netz_Warnungen "" TAB_VERB 4 0 "CM_HVK_HV_Netz_Warnungen_Cx0_Keine_Warnung" 1 "CM_HVK_HV_Netz_Warnungen_Cx1_Warntext_HV_Netz_Anf" 2 "CM_HVK_HV_Netz_Warnungen_Cx2_Fehlertext_HV_Netz_Anf" 3 "CM_HVK_HV_Netz_Warnungen_Cx3_Warnung_Kein_Wiederstart_moeglich" /end COMPU_VTAB
/begin COMPU_VTAB CM_HVK_HV_Netz_Zustand "" TAB_VERB 13 0 "CM_HVK_HV_Netz_Zustand_Cx0_Aus" 1 "CM_HVK_HV_Netz_Zustand_Cx1_Aktivierung" 2 "CM_HVK_HV_Netz_Zustand_Cx2_Diagnose" 3 "CM_HVK_HV_Netz_Zustand_Cx3_Aktiv" 4 "CM_HVK_HV_Netz_Zustand_Cx4_Fahrbetrieb" 5 "CM_HVK_HV_Netz_Zustand_Cx5_AC_Ladebetrieb" 6 "CM_HVK_HV_Netz_Zustand_Cx6_DC_Ladebetrieb" 7 "CM_HVK_HV_Netz_Zustand_Cx7_Aktiv_ohne_HVSpeicher" 11 "CM_HVK_HV_Netz_Zustand_Cxb_Aus_Fehlerfall" 12 "CM_HVK_HV_Netz_Zustand_Cxc_lastfreie_Abschaltung" 13 "CM_HVK_HV_Netz_Zustand_Cxd_Notabschaltung" 14 "CM_HVK_HV_Netz_Zustand_Cxe_Entladung" 15 "CM_HVK_HV_Netz_Zustand_Cxf_Init" /end COMPU_VTAB
/begin COMPU_VTAB CM_HVK_Iso_Messung_Start "" TAB_VERB 4 0 "CM_HVK_Iso_Messung_Start_Cx0_keine_Messung" 1 "CM_HVK_Iso_Messung_Start_Cx1_Messung_HV_Netz_1" 2 "CM_HVK_Iso_Messung_Start_Cx2_Messung_HV_Netz_2" 4 "CM_HVK_Iso_Messung_Start_Cx4_deaktiviert" /end COMPU_VTAB
/begin COMPU_VTAB CM_HVK_Istmodus_Anf "" TAB_VERB 2 0 "CM_HVK_Istmodus_Anf_Cx0_nicht_angefordert" 1 "CM_HVK_Istmodus_Anf_Cx1_angefordert" /end COMPU_VTAB
/begin COMPU_VTAB CM_HVK_Vorladung_aktiv "" TAB_VERB 2 0 "CM_HVK_Vorladung_aktiv_Cx0_Vorladung_nicht_aktiv" 1 "CM_HVK_Vorladung_aktiv_Cx1_Vorladung_aktiv" /end COMPU_VTAB
/begin COMPU_VTAB CM_HVK_eKAT_Sollmodus "" TAB_VERB 4 0 "CM_HVK_eKAT_Sollmodus_Cx0_Standby" 1 "CM_HVK_eKAT_Sollmodus_Cx1_Freigabe" 2 "CM_HVK_eKAT_Sollmodus_Cx2_Freigabe_ausgesetzt" 3 "CM_HVK_eKAT_Sollmodus_Cx3_Init" /end COMPU_VTAB
/begin COMPU_TAB CM_HVLE_IstSpannung_HV "" TAB_INTP 2 0 0 1021 1021 /end COMPU_TAB
/begin COMPU_VTAB CM_HVLE_IstSpannung_HV.StatusText "" TAB_VERB 2 1022 "CM_HVLE_IstSpannung_HV_Cx3fe_Init" 1023 "CM_HVLE_IstSpannung_HV_Cx3ff_Fehler" /end COMPU_VTAB
/begin COMPU_VTAB CM_HVLE_OBG_IstModus "" TAB_VERB 8 0 "CM_HVLE_OBG_IstModus_Cx0_Standby" 1 "CM_HVLE_OBG_IstModus_Cx1_Netzladung_aktiv" 2 "CM_HVLE_OBG_IstModus_Cx2_Rueckspeisung_aktiv" 3 "CM_HVLE_OBG_IstModus_Cx3_Vorladen_aktiv" 4 "CM_HVLE_OBG_IstModus_Cx4_Vorladespannung_erreicht_und_halten" 5 "CM_HVLE_OBG_IstModus_Cx5_reserve" 6 "CM_HVLE_OBG_IstModus_Cx6_Init" 7 "CM_HVLE_OBG_IstModus_Cx7_Fehler" /end COMPU_VTAB
/begin COMPU_TAB CM_HVLM_14_BZ "" TAB_INTP 2 0 0 15 15 /end COMPU_TAB
/begin COMPU_TAB CM_HVLM_14_CRC "" TAB_INTP 2 0 0 255 255 /end COMPU_TAB
/begin COMPU_VTAB CM_HVLM_Aktive_Ladeart "" TAB_VERB 8 0 "CM_HVLM_Aktive_Ladeart_Cx0_Kein_Laden_aktiv" 1 "CM_HVLM_Aktive_Ladeart_Cx1_AC_Laden_aktiv" 2 "CM_HVLM_Aktive_Ladeart_Cx2_DC_Laden_aktiv" 3 "CM_HVLM_Aktive_Ladeart_Cx3_AWC" 4 "CM_HVLM_Aktive_Ladeart_Cx4_Reserve" 5 "CM_HVLM_Aktive_Ladeart_Cx5_Reserve" 6 "CM_HVLM_Aktive_Ladeart_Cx6_Reserve" 7 "CM_HVLM_Aktive_Ladeart_Cx7_Fehler" /end COMPU_VTAB
/begin COMPU_VTAB CM_HVLM_BCAM_Aktiv "" TAB_VERB 2 0 "CM_HVLM_BCAM_Aktiv_Cx0_inaktiv" 1 "CM_HVLM_BCAM_Aktiv_Cx1_aktiv" /end COMPU_VTAB
/begin COMPU_VTAB CM_HVLM_BidiLadeModus "" TAB_VERB 3 0 "CM_HVLM_BidiLadeModus_Cx0_InitWert_kein_bidi_Laden" 1 "CM_HVLM_BidiLadeModus_Cx1_bidi_Laden_kleine_Leistung" 2 "CM_HVLM_BidiLadeModus_Cx2_bidi_Laden_mittlere_Leistung" /end COMPU_VTAB
/begin COMPU_VTAB CM_HVLM_DC_Aufstartmodus "" TAB_VERB 4 0 "CM_HVLM_DC_Aufstartmodus_Cx0_keine_Anforderung" 1 "CM_HVLM_DC_Aufstartmodus_Cx1_Angleich_Fahrzeug" 2 "CM_HVLM_DC_Aufstartmodus_Cx2_Angleich_LS_1" 3 "CM_HVLM_DC_Aufstartmodus_Cx3_Angleich_LS_2" /end COMPU_VTAB
/begin COMPU_VTAB CM_HVLM_Grundladen_Anf "" TAB_VERB 2 0 "CM_HVLM_Grundladen_Anf_Cx0_Keine_Anforderung_Sofortladen" 1 "CM_HVLM_Grundladen_Anf_Cx1_Sofortladen_Kundenwunsch" /end COMPU_VTAB
/begin COMPU_TAB CM_HVLM_Intensitaet_Lk1 "" TAB_INTP 2 0 0 100 100 /end COMPU_TAB
/begin COMPU_VTAB CM_HVLM_Intensitaet_Lk1.StatusText "" TAB_VERB 2 126 "CM_HVLM_Intensitaet_Lk1_Cx7e_Init" 127 "CM_HVLM_Intensitaet_Lk1_Cx7f_Fehler" /end COMPU_VTAB
/begin COMPU_TAB CM_HVLM_Intensitaet_Lk2 "" TAB_INTP 2 0 0 100 100 /end COMPU_TAB
/begin COMPU_VTAB CM_HVLM_Intensitaet_Lk2.StatusText "" TAB_VERB 2 126 "CM_HVLM_Intensitaet_Lk2_Cx7e_Init" 127 "CM_HVLM_Intensitaet_Lk2_Cx7f_Fehler" /end COMPU_VTAB
/begin COMPU_VTAB CM_HVLM_Laden_ISO_Messung_Anf "" TAB_VERB 2 0 "CM_HVLM_Laden_ISO_Messung_Anf_Cx0_Anforderung" 1 "CM_HVLM_Laden_ISO_Messung_Anf_Cx1_keine_Anforderung" /end COMPU_VTAB
/begin COMPU_VTAB CM_HVLM_Ladenaktiv_Standzyklus "" TAB_VERB 2 0 "CM_HVLM_Ladenaktiv_Standzyklus_Cx0_inaktiv" 1 "CM_HVLM_Ladenaktiv_Standzyklus_Cx1_aktiv" /end COMPU_VTAB
/begin COMPU_VTAB CM_HVLM_Ladeniveau_Anf "" TAB_VERB 8 0 "CM_HVLM_Ladeniveau_Anf_Cx0_Keine_Ladeniveau_Anf" 1 "CM_HVLM_Ladeniveau_Anf_Cx1_Bevorsteh_Ladevorgang_erkannt" 2 "CM_HVLM_Ladeniveau_Anf_Cx2_Ladeposition_wird_angefahren" 3 "CM_HVLM_Ladeniveau_Anf_Cx3_Ladeposition_erreicht" 4 "CM_HVLM_Ladeniveau_Anf_Cx4_Ladevorgang_aktiv" 5 "CM_HVLM_Ladeniveau_Anf_Cx5_Ladevorgang_abgeschlossen" 6 "CM_HVLM_Ladeniveau_Anf_Cx6_Init" 7 "CM_HVLM_Ladeniveau_Anf_Cx7_Fehler" /end COMPU_VTAB
/begin COMPU_VTAB CM_HVLM_Ladeszenario "" TAB_VERB 19 0 "CM_HVLM_Ladeszenario_Cx0_Aus" 1 "CM_HVLM_Ladeszenario_Cx1_Timerladen_abgeschlossen" 2 "CM_HVLM_Ladeszenario_Cx2_Sofortladen_abgeschlossen" 3 "CM_HVLM_Ladeszenario_Cx3_Optimiertes_Laden_abgeschlossen" 4 "CM_HVLM_Ladeszenario_Cx4_Timerladen_aktiv" 5 "CM_HVLM_Ladeszenario_Cx5_Sofortladen_aktiv" 6 "CM_HVLM_Ladeszenario_Cx6_Optimiertes_Laden_aktiv" 7 "CM_HVLM_Ladeszenario_Cx7_Timerladen_warten" 8 "CM_HVLM_Ladeszenario_Cx8_Optimiertes_Laden_warten" 9 "CM_HVLM_Ladeszenario_Cx9_Keine_Netzspannung" 10 "CM_HVLM_Ladeszenario_Cxa_Fehler_Verriegelung" 11 "CM_HVLM_Ladeszenario_Cxb_Fehler_Ladesytem" 12 "CM_HVLM_Ladeszenario_Cxc_Init_Ladekommunikation" 15 "CM_HVLM_Ladeszenario_Cxf_Notladen" 16 "CM_HVLM_Ladeszenario_Cx10_Ladeunterbrechung_Kunde" 17 "CM_HVLM_Ladeszenario_Cx11_Stecker_abziehbar" 18 "CM_HVLM_Ladeszenario_Cx12_Kompatibilitaets_Umschaltung_aktiv" 30 "CM_HVLM_Ladeszenario_Cx1e_Init" 31 "CM_HVLM_Ladeszenario_Cx1f_Fehler" /end COMPU_VTAB
/begin COMPU_VTAB CM_HVLM_Ladevorgang_Anf "" TAB_VERB 8 0 "CM_HVLM_Ladevorgang_Anf_Cx0_Laden_nicht_angefordert" 1 "CM_HVLM_Ladevorgang_Anf_Cx1_AC_Laden_Angefordert" 2 "CM_HVLM_Ladevorgang_Anf_Cx2_DC_Laden_Angefordert" 3 "CM_HVLM_Ladevorgang_Anf_Cx3_AC_und_DC_Angefordert" 4 "CM_HVLM_Ladevorgang_Anf_Cx4_Induktiv_Laden_Angef" 5 "CM_HVLM_Ladevorgang_Anf_Cx5_AC_und_Induktiv_Angef" 6 "CM_HVLM_Ladevorgang_Anf_Cx6_DC_und_Induktiv_Angef" 7 "CM_HVLM_Ladevorgang_Anf_Cx7_AC_DC_und_Induktiv_Angef" /end COMPU_VTAB
/begin COMPU_VTAB CM_HVLM_PrkCtl_StAlyReq "" TAB_VERB 8 0 "CM_HVLM_PrkCtl_StAlyReq_Cx0_NoReq" 1 "CM_HVLM_PrkCtl_StAlyReq_Cx1_Park" 2 "CM_HVLM_PrkCtl_StAlyReq_Cx2_ParkWithPPosn" 3 "CM_HVLM_PrkCtl_StAlyReq_Cx3_State3" 4 "CM_HVLM_PrkCtl_StAlyReq_Cx4_State4" 5 "CM_HVLM_PrkCtl_StAlyReq_Cx5_State5" 6 "CM_HVLM_PrkCtl_StAlyReq_Cx6_Init" 7 "CM_HVLM_PrkCtl_StAlyReq_Cx7_Fehler" /end COMPU_VTAB
/begin COMPU_VTAB CM_HVLM_PrkCtl_StPrkLockReq "" TAB_VERB 4 0 "CM_HVLM_PrkCtl_StPrkLockReq_Cx0_NoReq" 1 "CM_HVLM_PrkCtl_StPrkLockReq_Cx1_ParkLock" 2 "CM_HVLM_PrkCtl_StPrkLockReq_Cx2_Init" 3 "CM_HVLM_PrkCtl_StPrkLockReq_Cx3_Fehler" /end COMPU_VTAB
/begin COMPU_VTAB CM_HVLM_Pulsierstufe "" TAB_VERB 8 0 "CM_HVLM_Pulsierstufe_Cx0_keine_Anforderung" 1 "CM_HVLM_Pulsierstufe_Cx1_Stufe_0" 2 "CM_HVLM_Pulsierstufe_Cx2_Stufe_1" 3 "CM_HVLM_Pulsierstufe_Cx3_Stufe_2" 4 "CM_HVLM_Pulsierstufe_Cx4_Stufe_3" 5 "CM_HVLM_Pulsierstufe_Cx5_Stufe_4" 6 "CM_HVLM_Pulsierstufe_Cx6_Stufe_5" 7 "CM_HVLM_Pulsierstufe_Cx7_Stufe_6" /end COMPU_VTAB
/begin COMPU_VTAB CM_HVLM_Start_Pulserkennung "" TAB_VERB 2 0 "CM_HVLM_Start_Pulserkennung_Cx0_keine_Anforderung" 1 "CM_HVLM_Start_Pulserkennung_Cx1_Pulserkennung_starten" /end COMPU_VTAB
/begin COMPU_VTAB CM_HVLM_Steckerstatus "" TAB_VERB 4 0 "CM_HVLM_Steckerstatus_Cx0_Init" 1 "CM_HVLM_Steckerstatus_Cx1_kein_Stecker_erkannt" 2 "CM_HVLM_Steckerstatus_Cx2_Stecker_erkannt" 3 "CM_HVLM_Steckerstatus_Cx3_Fehler" /end COMPU_VTAB
/begin COMPU_VTAB CM_HVLM_WakeUpZaehlerResetAnf "" TAB_VERB 2 0 "CM_HVLM_WakeUpZaehlerResetAnf_Cx0_keine_Anforderung" 1 "CM_HVLM_WakeUpZaehlerResetAnf_Cx1_Reset_Zaehler" /end COMPU_VTAB
/begin COMPU_VTAB CM_HVLM_ZustandLadeablauf "" TAB_VERB 9 0 "CM_HVLM_ZustandLadeablauf_Cx0_Init" 1 "CM_HVLM_ZustandLadeablauf_Cx1_Stby_Ladevorbed_erfuellt" 2 "CM_HVLM_ZustandLadeablauf_Cx2_Stby_Ladevorbed_nicht_erfuellt" 3 "CM_HVLM_ZustandLadeablauf_Cx3_Fehler" 4 "CM_HVLM_ZustandLadeablauf_Cx4_Laden_starten" 5 "CM_HVLM_ZustandLadeablauf_Cx5_Laden_beenden" 6 "CM_HVLM_ZustandLadeablauf_Cx6_HVBatterie_Laden" 7 "CM_HVLM_ZustandLadeablauf_Cx7_HVBatterie_Entladen" 8 "CM_HVLM_ZustandLadeablauf_Cx8_Erhaltungsladen" /end COMPU_VTAB
/begin COMPU_VTAB CM_HV_Bordnetz_Fehler "" TAB_VERB 2 0 "CM_HV_Bordnetz_Fehler_Cx0_kein_Fehler" 1 "CM_HV_Bordnetz_Fehler_Cx1_Fehler" /end COMPU_VTAB
/begin COMPU_VTAB CM_HV_Bordnetz_aktiv "" TAB_VERB 2 0 "CM_HV_Bordnetz_aktiv_Cx0_inaktiv" 1 "CM_HV_Bordnetz_aktiv_Cx1_aktiv" /end COMPU_VTAB
/begin COMPU_VTAB CM_Hybrid_01_OBD_Lampe_Anf "" TAB_VERB 2 0 "CM_Hybrid_01_OBD_Lampe_Anf_Cx0_Kein_MIL_Request" 1 "CM_Hybrid_01_OBD_Lampe_Anf_Cx1_MIL_Request" /end COMPU_VTAB
/begin COMPU_TAB CM_Hybrid_01_SNI_10 "" TAB_INTP 2 0 0 1023 1023 /end COMPU_TAB
/begin COMPU_VTAB CM_IndType "" TAB_VERB 7 0 "BapInd_Data" 1 "BapInd_Reset" 2 "BapInd_DataAck" 3 "BapInd_Result" 4 "BapInd_Processing" 5 "BapInd_Changed" 31 "BapInd_Invalid" /end COMPU_VTAB
/begin COMPU_TAB CM_KN_Hybrid_01_BusKnockOutTimer "" TAB_INTP 2 0 0 254 254 /end COMPU_TAB
/begin COMPU_VTAB CM_KN_Hybrid_01_BusKnockOutTimer.StatusText "" TAB_VERB 1 255 "CM_KN_Hybrid_01_BusKnockOutTimer_Cxff_BusKnockOut_deaktiviert" /end COMPU_VTAB
/begin COMPU_TAB CM_KN_Hybrid_01_ECUKnockOutTimer "" TAB_INTP 2 0 0 62 62 /end COMPU_TAB
/begin COMPU_VTAB CM_KN_Hybrid_01_ECUKnockOutTimer.StatusText "" TAB_VERB 1 63 "CM_KN_Hybrid_01_ECUKnockOutTimer_Cx3f_ECUKnockOut_deaktiviert" /end COMPU_VTAB
/begin COMPU_VTAB CM_KST_KL_15 "" TAB_VERB 2 0 "CM_KST_KL_15_Cx0_aus" 1 "CM_KST_KL_15_Cx1_ein" /end COMPU_VTAB
/begin COMPU_TAB CM_KS_Hybrid_01_ChK "" TAB_INTP 2 0 0 1.8446744073709552E+19 1.8446744073709552E+19 /end COMPU_TAB
/begin COMPU_TAB CM_KS_Hybrid_01_ChK_IKACtr "" TAB_INTP 2 0 0 255 255 /end COMPU_TAB
/begin COMPU_TAB CM_KS_Hybrid_01_ChK_SID "" TAB_INTP 2 0 0 65535 65535 /end COMPU_TAB
/begin COMPU_TAB CM_KS_Hybrid_01_ChM "" TAB_INTP 2 0 0 1.8446744073709552E+19 1.8446744073709552E+19 /end COMPU_TAB
/begin COMPU_TAB CM_KS_Hybrid_01_ChM_IKACtr "" TAB_INTP 2 0 0 255 255 /end COMPU_TAB
/begin COMPU_TAB CM_KS_Hybrid_01_ChM_SID "" TAB_INTP 2 0 0 65535 65535 /end COMPU_TAB
/begin COMPU_TAB CM_KS_Hybrid_01_ReK "" TAB_INTP 2 0 0 1.8446744073709552E+19 1.8446744073709552E+19 /end COMPU_TAB
/begin COMPU_TAB CM_KS_Hybrid_01_ReK_IKACtr "" TAB_INTP 2 0 0 255 255 /end COMPU_TAB
/begin COMPU_TAB CM_KS_Hybrid_01_ReK_SID "" TAB_INTP 2 0 0 65535 65535 /end COMPU_TAB
/begin COMPU_TAB CM_KS_Hybrid_01_ReM "" TAB_INTP 2 0 0 1.8446744073709552E+19 1.8446744073709552E+19 /end COMPU_TAB
/begin COMPU_TAB CM_KS_Hybrid_01_ReM_IKACtr "" TAB_INTP 2 0 0 255 255 /end COMPU_TAB
/begin COMPU_TAB CM_KS_Hybrid_01_ReM_SID "" TAB_INTP 2 0 0 65535 65535 /end COMPU_TAB
/begin COMPU_TAB CM_KS_Hybrid_01_Req_ErrCtr "" TAB_INTP 2 0 0 255 255 /end COMPU_TAB
/begin COMPU_VTAB CM_KS_Hybrid_01_Req_IKA_Retry "" TAB_VERB 2 0 "CM_KS_Hybrid_01_Req_IKA_Retry_Cx0_Erste_IKA_Anfrage_des_KS_Slave" 1 "CM_KS_Hybrid_01_Req_IKA_Retry_Cx1_Wiederholte_IKA_Anfrage_des_KS_Slave_AuthRetryCounter_0" /end COMPU_VTAB
/begin COMPU_VTAB CM_KS_Hybrid_01_Req_Prio "" TAB_VERB 2 0 "CM_KS_Hybrid_01_Req_Prio_Cx0_KS_Slave_wird_normal_authentifiziert" 1 "CM_KS_Hybrid_01_Req_Prio_Cx1_KS_Slave_fordert_priorisierte_Authentifikation" /end COMPU_VTAB
/begin COMPU_TAB CM_KS_Hybrid_01_Req_SID "" TAB_INTP 2 0 0 65535 65535 /end COMPU_TAB
/begin COMPU_TAB CM_KS_Hybrid_01_Req_SWMaj "" TAB_INTP 2 0 0 255 255 /end COMPU_TAB
/begin COMPU_TAB CM_KS_Hybrid_01_Req_SWMin "" TAB_INTP 2 0 0 255 255 /end COMPU_TAB
/begin COMPU_TAB CM_KS_Hybrid_01_Req_SWPat "" TAB_INTP 2 0 0 255 255 /end COMPU_TAB
/begin COMPU_VTAB CM_KS_Hybrid_01_Req_VKMS_Err "" TAB_VERB 2 0 "CM_KS_Hybrid_01_Req_VKMS_Err_Cx0_Im_KS_Slave_liegt_kein_VKMS_Fehler_vor_VKMS_Type_Id_Ready_VKMS_ERR_NONE" 1 "CM_KS_Hybrid_01_Req_VKMS_Err_Cx1_Im_KS_Slave_liegt_ein_VKMS_Fehler_vor_VKMS_Type_Id_Ready_VKMS_ERR_NONE" /end COMPU_VTAB
/begin COMPU_VTAB CM_MM_PropulsionSystemActive "" TAB_VERB 2 0 "CM_MM_PropulsionSystemActive_Cx0_PropulsionSystemNotActive" 1 "CM_MM_PropulsionSystemActive_Cx1_PropulsionSystemActive" /end COMPU_VTAB
/begin COMPU_VTAB CM_NVEM_Abschaltstufe "" TAB_VERB 4 0 "CM_NVEM_Abschaltstufe_Cx0_Stufe_0_keine_Einschraenkung" 1 "CM_NVEM_Abschaltstufe_Cx1_Stufe_1" 2 "CM_NVEM_Abschaltstufe_Cx2_Stufe_2" 3 "CM_NVEM_Abschaltstufe_Cx3_Stufe_3" /end COMPU_VTAB
/begin COMPU_VTAB CM_OBDProtocol_req "" TAB_VERB 6 0 "CM_OBDProtocol_req_Cx0_not_available" 1 "CM_OBDProtocol_req_Cx1_OBDclassic" 2 "CM_OBDProtocol_req_Cx2_OBDonUDS" 3 "CM_OBDProtocol_req_Cx3_ZEVonUDS" 14 "CM_OBDProtocol_req_Cxe_Init" 15 "CM_OBDProtocol_req_Cxf_Fehler" /end COMPU_VTAB
/begin COMPU_TAB CM_OBD_Abs_Pedal_Pos "" TAB_INTP 2 0 0 255 100 /end COMPU_TAB
/begin COMPU_TAB CM_OBD_Aussen_Temp_gef "" TAB_INTP 2 0 -40 253 213 /end COMPU_TAB
/begin COMPU_VTAB CM_OBD_Aussen_Temp_gef.StatusText "" TAB_VERB 2 254 "CM_OBD_Aussen_Temp_gef_Cxfe_Initwert" 255 "CM_OBD_Aussen_Temp_gef_Cxff_Fehler" /end COMPU_VTAB
/begin COMPU_TAB CM_OBD_Barometric_Pressure "" TAB_INTP 2 0 0 255 255 /end COMPU_TAB
/begin COMPU_TAB CM_OBD_Calc_Load_Val "" TAB_INTP 2 0 0 255 100 /end COMPU_TAB
/begin COMPU_VTAB CM_OBD_ClearMem_Inhibit "" TAB_VERB 2 0 "CM_OBD_ClearMem_Inhibit_Cx0_FSP_Loeschen_zulaessig" 1 "CM_OBD_ClearMem_Inhibit_Cx1_FSP_Loeschen_nicht_zulaessig" /end COMPU_VTAB
/begin COMPU_VTAB CM_OBD_Driving_Cycle "" TAB_VERB 2 0 "CM_OBD_Driving_Cycle_Cx0_kein_Driving_Cycle_erkannt" 1 "CM_OBD_Driving_Cycle_Cx1_Driving_Cycle_erkannt" /end COMPU_VTAB
/begin COMPU_TAB CM_OBD_Eng_Cool_Temp "" TAB_INTP 2 0 -40 255 215 /end COMPU_TAB
/begin COMPU_TAB CM_OBD_Engine_RPM "" TAB_INTP 2 0 0 65535 16383.75 /end COMPU_TAB
/begin COMPU_VTAB CM_OBD_Kaltstart_Denominator "" TAB_VERB 2 0 "CM_OBD_Kaltstart_Denominator_Cx0_Denominator_nicht_hochzaehlen" 1 "CM_OBD_Kaltstart_Denominator_Cx1_Bedingungen_zum_Inkr_des_Kaltstart_Denom_erf" /end COMPU_VTAB
/begin COMPU_VTAB CM_OBD_Minimum_Trip "" TAB_VERB 2 0 "CM_OBD_Minimum_Trip_Cx0_kein_Min_Normed_Trip" 1 "CM_OBD_Minimum_Trip_Cx1_Min_Normed_Trip" /end COMPU_VTAB
/begin COMPU_VTAB CM_OBD_Normed_Trip "" TAB_VERB 2 0 "CM_OBD_Normed_Trip_Cx0_kein_Normed_Trip" 1 "CM_OBD_Normed_Trip_Cx1_Normed_Trip" /end COMPU_VTAB
/begin COMPU_TAB CM_OBD_NumDcyMilOnReq "" TAB_INTP 2 0 0 255 255 /end COMPU_TAB
/begin COMPU_VTAB CM_OBD_QBit_Aussen_Temp "" TAB_VERB 2 0 "CM_OBD_QBit_Aussen_Temp_Cx0_gueltiger_Wert" 1 "CM_OBD_QBit_Aussen_Temp_Cx1_Ersatz_Init_oder_Fehlerwert" /end COMPU_VTAB
/begin COMPU_VTAB CM_OBD_Sperrung_IUMPR "" TAB_VERB 2 0 "CM_OBD_Sperrung_IUMPR_Cx0_IUMPR_Berechnung_freigegeben" 1 "CM_OBD_Sperrung_IUMPR_Cx1_IUMPR_Berechnung_gesperrt" /end COMPU_VTAB
/begin COMPU_VTAB CM_OBD_Sperrung_Kaltstart_Denom "" TAB_VERB 2 0 "CM_OBD_Sperrung_Kaltstart_Denom_Cx0_EVAP_Berechnung_freigegeben" 1 "CM_OBD_Sperrung_Kaltstart_Denom_Cx1_EVAP_Berechnung_gesperrt" /end COMPU_VTAB
/begin COMPU_VTAB CM_OBD_Typ "" TAB_VERB 2 0 "CM_OBD_Typ_Cx0_OBDReady" 1 "CM_OBD_Typ_Cx1_FullOBD" /end COMPU_VTAB
/begin COMPU_VTAB CM_OBD_Warm_Up_Cycle "" TAB_VERB 2 0 "CM_OBD_Warm_Up_Cycle_Cx0_kein_Warm_Up_Cycle_erkannt" 1 "CM_OBD_Warm_Up_Cycle_Cx1_Warm_Up_Cycle_erkannt" /end COMPU_VTAB
/begin COMPU_TAB CM_ORU_Control_A_01_BZ "" TAB_INTP 2 0 0 15 15 /end COMPU_TAB
/begin COMPU_TAB CM_ORU_Control_A_01_CRC "" TAB_INTP 2 0 0 255 255 /end COMPU_TAB
/begin COMPU_TAB CM_ORU_Control_D_01_BZ "" TAB_INTP 2 0 0 15 15 /end COMPU_TAB
/begin COMPU_TAB CM_ORU_Control_D_01_CRC "" TAB_INTP 2 0 0 255 255 /end COMPU_TAB
/begin COMPU_VTAB CM_ORU_Status "" TAB_VERB 8 0 "CM_ORU_Status_Cx0_IDLE" 1 "CM_ORU_Status_Cx1_PENDING" 2 "CM_ORU_Status_Cx2_PREPARATION" 3 "CM_ORU_Status_Cx3_PREPARATION_HV" 4 "CM_ORU_Status_Cx4_RUNNING" 5 "CM_ORU_Status_Cx5_RUNNING_HV" 6 "CM_ORU_Status_Cx6_PENDING_NOTREADY" 7 "CM_ORU_Status_Cx7_FAILURE_POWERTRAIN_DISABLED" /end COMPU_VTAB
/begin COMPU_TAB CM_OTAMC_D_01_BZ "" TAB_INTP 2 0 0 15 15 /end COMPU_TAB
/begin COMPU_TAB CM_OTAMC_D_01_CRC "" TAB_INTP 2 0 0 255 255 /end COMPU_TAB
/begin COMPU_VTAB CM_OTP_Aussen_Temp_OBD "" TAB_VERB 2 0 "CM_OTP_Aussen_Temp_OBD_Cx0_gueltiger_Wert" 1 "CM_OTP_Aussen_Temp_OBD_Cx1_Ersatz_Init_oder_Fehlerwert" /end COMPU_VTAB
/begin COMPU_TAB CM_OTP_Aussen_Temp_ungef "" TAB_INTP 2 0 -50 252 76 /end COMPU_TAB
/begin COMPU_VTAB CM_OTP_Aussen_Temp_ungef.StatusText "" TAB_VERB 3 253 "CM_OTP_Aussen_Temp_ungef_Cxfd_nicht_verbaut" 254 "CM_OTP_Aussen_Temp_ungef_Cxfe_Initwert" 255 "CM_OTP_Aussen_Temp_ungef_Cxff_Fehler" /end COMPU_VTAB
/begin COMPU_VTAB CM_OnlineRemoteUpdateControlA "" TAB_VERB 11 0 "CM_OnlineRemoteUpdateControlA_Cx0_IDLE" 1 "CM_OnlineRemoteUpdateControlA_Cx1_PENDING" 2 "CM_OnlineRemoteUpdateControlA_Cx2_PREPARATION" 3 "CM_OnlineRemoteUpdateControlA_Cx3_PREPARATION_HV" 4 "CM_OnlineRemoteUpdateControlA_Cx4_RUNNING" 5 "CM_OnlineRemoteUpdateControlA_Cx5_RUNNING_HV" 6 "CM_OnlineRemoteUpdateControlA_Cx6_PENDING_NOTREADY" 7 "CM_OnlineRemoteUpdateControlA_Cx7_OTA_FAILURE_POWERTRAIN_DISABLED" 8 "CM_OnlineRemoteUpdateControlA_Cx8_FUNCTIONAL_SAFETY_RELEASED" 9 "CM_OnlineRemoteUpdateControlA_Cx9_PREPARATION_SG" 15 "CM_OnlineRemoteUpdateControlA_Cxf_Fehler" /end COMPU_VTAB
/begin COMPU_VTAB CM_OnlineRemoteUpdateControlD "" TAB_VERB 11 0 "CM_OnlineRemoteUpdateControlD_Cx0_IDLE" 1 "CM_OnlineRemoteUpdateControlD_Cx1_PENDING" 2 "CM_OnlineRemoteUpdateControlD_Cx2_PREPARATION" 3 "CM_OnlineRemoteUpdateControlD_Cx3_PREPARATION_HV" 4 "CM_OnlineRemoteUpdateControlD_Cx4_RUNNING" 5 "CM_OnlineRemoteUpdateControlD_Cx5_RUNNING_HV" 6 "CM_OnlineRemoteUpdateControlD_Cx6_PENDING_NOTREADY" 7 "CM_OnlineRemoteUpdateControlD_Cx7_OTA_FAILURE_POWERTRAIN_DISABLED" 8 "CM_OnlineRemoteUpdateControlD_Cx8_FUNCTIONAL_SAFETY_RELEASE" 9 "CM_OnlineRemoteUpdateControlD_Cx9_PREPARATION_SG" 15 "CM_OnlineRemoteUpdateControlD_Cxf_Fehler" /end COMPU_VTAB
/begin COMPU_VTAB CM_OnlineRemoteUpdateControlOldA "" TAB_VERB 11 0 "CM_OnlineRemoteUpdateControlOldA_Cx0_IDLE" 1 "CM_OnlineRemoteUpdateControlOldA_Cx1_PENDING" 2 "CM_OnlineRemoteUpdateControlOldA_Cx2_PREPARATION" 3 "CM_OnlineRemoteUpdateControlOldA_Cx3_PREPARATION_HV" 4 "CM_OnlineRemoteUpdateControlOldA_Cx4_RUNNING" 5 "CM_OnlineRemoteUpdateControlOldA_Cx5_RUNNING_HV" 6 "CM_OnlineRemoteUpdateControlOldA_Cx6_PENDING_NOTREADY" 7 "CM_OnlineRemoteUpdateControlOldA_Cx7_OTA_FAILURE_POWERTRAIN_DISABLED" 8 "CM_OnlineRemoteUpdateControlOldA_Cx8_FUNCTIONAL_SAFETY_RELEASE" 9 "CM_OnlineRemoteUpdateControlOldA_Cx9_PREPARATION_SG" 15 "CM_OnlineRemoteUpdateControlOldA_Cxf_Fehler" /end COMPU_VTAB
/begin COMPU_VTAB CM_OnlineRemoteUpdateControlOldD "" TAB_VERB 11 0 "CM_OnlineRemoteUpdateControlOldD_Cx0_IDLE" 1 "CM_OnlineRemoteUpdateControlOldD_Cx1_PENDING" 2 "CM_OnlineRemoteUpdateControlOldD_Cx2_PREPARATION" 3 "CM_OnlineRemoteUpdateControlOldD_Cx3_PREPARATION_HV" 4 "CM_OnlineRemoteUpdateControlOldD_Cx4_RUNNING" 5 "CM_OnlineRemoteUpdateControlOldD_Cx5_RUNNING_HV" 6 "CM_OnlineRemoteUpdateControlOldD_Cx6_PENDING_NOTREADY" 7 "CM_OnlineRemoteUpdateControlOldD_Cx7_OTA_FAILURE_POWERTRAIN_DISABLED" 8 "CM_OnlineRemoteUpdateControlOldD_Cx8_FUNCTIONAL_SAFETY_RELEASE" 9 "CM_OnlineRemoteUpdateControlOldD_Cx9_PREPARATION_SG" 15 "CM_OnlineRemoteUpdateControlOldD_Cxf_Fehler" /end COMPU_VTAB
/begin COMPU_TAB CM_OruControlReleaseA "" TAB_INTP 2 0 0 65535 65535 /end COMPU_TAB
/begin COMPU_TAB CM_OruControlReleaseD "" TAB_INTP 2 0 0 65535 65535 /end COMPU_TAB
/begin COMPU_VTAB CM_OruControlStateA "" TAB_VERB 9 0 "CM_OruControlStateA_Cx0_Idle" 1 "CM_OruControlStateA_Cx1_Check" 3 "CM_OruControlStateA_Cx3_DataPresent" 7 "CM_OruControlStateA_Cx7_LockActive" 15 "CM_OruControlStateA_Cxf_Running" 31 "CM_OruControlStateA_Cx1f_Save" 63 "CM_OruControlStateA_Cx3f_Done" 65 "CM_OruControlStateA_Cx41_Fail" 129 "CM_OruControlStateA_Cx81_Fehler" /end COMPU_VTAB
/begin COMPU_VTAB CM_OruControlStateD "" TAB_VERB 9 0 "CM_OruControlStateD_Cx0_Idle" 1 "CM_OruControlStateD_Cx1_Check" 3 "CM_OruControlStateD_Cx3_DataPresent" 7 "CM_OruControlStateD_Cx7_LockActive" 15 "CM_OruControlStateD_Cxf_Running" 31 "CM_OruControlStateD_Cx1f_Save" 63 "CM_OruControlStateD_Cx3f_Done" 65 "CM_OruControlStateD_Cx41_Fail" 129 "CM_OruControlStateD_Cx81_Fehler" /end COMPU_VTAB
/begin COMPU_VTAB CM_OruHostUpdateA "" TAB_VERB 5 0 "CM_OruHostUpdateA_Cx0_Init" 1 "CM_OruHostUpdateA_Cx1_HostControl1" 2 "CM_OruHostUpdateA_Cx2_HostControl2" 3 "CM_OruHostUpdateA_Cx3_HostControlOther" 4 "CM_OruHostUpdateA_Cx4_Fehler" /end COMPU_VTAB
/begin COMPU_VTAB CM_OruHostUpdateD "" TAB_VERB 5 0 "CM_OruHostUpdateD_Cx0_Init" 1 "CM_OruHostUpdateD_Cx1_HostControl1" 2 "CM_OruHostUpdateD_Cx2_HostControl2" 3 "CM_OruHostUpdateD_Cx3_HostControlOther" 4 "CM_OruHostUpdateD_Cx4_Fehler" /end COMPU_VTAB
/begin COMPU_VTAB CM_OruIntegrityCheckActiveA "" TAB_VERB 4 0 "CM_OruIntegrityCheckActiveA_Cx0_Init" 1 "CM_OruIntegrityCheckActiveA_Cx1_Inactive" 2 "CM_OruIntegrityCheckActiveA_Cx2_Active" 3 "CM_OruIntegrityCheckActiveA_Cx3_Fehler" /end COMPU_VTAB
/begin COMPU_VTAB CM_OruIntegrityCheckActiveD "" TAB_VERB 4 0 "CM_OruIntegrityCheckActiveD_Cx0_Init" 1 "CM_OruIntegrityCheckActiveD_Cx1_Inactive" 2 "CM_OruIntegrityCheckActiveD_Cx2_Active" 3 "CM_OruIntegrityCheckActiveD_Cx3_Fehler" /end COMPU_VTAB
/begin COMPU_VTAB CM_OruReleasePartitionSwitchA "" TAB_VERB 4 0 "CM_OruReleasePartitionSwitchA_Cx0_Init" 1 "CM_OruReleasePartitionSwitchA_Cx1_Lock" 2 "CM_OruReleasePartitionSwitchA_Cx2_Release" 3 "CM_OruReleasePartitionSwitchA_Cx3_Fehler" /end COMPU_VTAB
/begin COMPU_VTAB CM_OruReleasePartitionSwitchD "" TAB_VERB 4 0 "CM_OruReleasePartitionSwitchD_Cx0_Init" 1 "CM_OruReleasePartitionSwitchD_Cx1_Lock" 2 "CM_OruReleasePartitionSwitchD_Cx2_Release" 3 "CM_OruReleasePartitionSwitchD_Cx3_Fehler" /end COMPU_VTAB
/begin COMPU_VTAB CM_OruVehicleLockRequestA "" TAB_VERB 4 0 "CM_OruVehicleLockRequestA_Cx0_Init" 1 "CM_OruVehicleLockRequestA_Cx1_Lock" 2 "CM_OruVehicleLockRequestA_Cx2_Release" 3 "CM_OruVehicleLockRequestA_Cx3_Fehler" /end COMPU_VTAB
/begin COMPU_VTAB CM_OruVehicleLockRequestD "" TAB_VERB 4 0 "CM_OruVehicleLockRequestD_Cx0_Init" 1 "CM_OruVehicleLockRequestD_Cx1_Lock" 2 "CM_OruVehicleLockRequestD_Cx2_Release" 3 "CM_OruVehicleLockRequestD_Cx3_Fehler" /end COMPU_VTAB
/begin COMPU_VTAB CM_PCM_BMC_VTD_Freeze_Req "" TAB_VERB 4 0 "CM_PCM_BMC_VTD_Freeze_Req_Cx0_NoResetResponse" 1 "CM_PCM_BMC_VTD_Freeze_Req_Cx1_ResetResponse" 2 "CM_PCM_BMC_VTD_Freeze_Req_Cx2_Init" 3 "CM_PCM_BMC_VTD_Freeze_Req_Cx3_Fehler" /end COMPU_VTAB
/begin COMPU_VTAB CM_PCM_BMC_VTD_LifeTimeReset_Req "" TAB_VERB 4 0 "CM_PCM_BMC_VTD_LifeTimeReset_Req_Cx0_NoResetResponse" 1 "CM_PCM_BMC_VTD_LifeTimeReset_Req_Cx1_ResetResponse" 2 "CM_PCM_BMC_VTD_LifeTimeReset_Req_Cx2_Init" 3 "CM_PCM_BMC_VTD_LifeTimeReset_Req_Cx3_Fehler" /end COMPU_VTAB
/begin COMPU_VTAB CM_PCM_BMC_VTD_LifeTimeReset_Resp "" TAB_VERB 4 0 "CM_PCM_BMC_VTD_LifeTimeReset_Resp_Cx0_NoResetResponse" 1 "CM_PCM_BMC_VTD_LifeTimeReset_Resp_Cx1_ResetResponse" 2 "CM_PCM_BMC_VTD_LifeTimeReset_Resp_Cx2_Init" 3 "CM_PCM_BMC_VTD_LifeTimeReset_Resp_Cx3_Fehler" /end COMPU_VTAB
/begin COMPU_VTAB CM_PCM_BMC_VTD_RecentReset_Req "" TAB_VERB 4 0 "CM_PCM_BMC_VTD_RecentReset_Req_Cx0_NoResetResponse" 1 "CM_PCM_BMC_VTD_RecentReset_Req_Cx1_ResetResponse" 2 "CM_PCM_BMC_VTD_RecentReset_Req_Cx2_Init" 3 "CM_PCM_BMC_VTD_RecentReset_Req_Cx3_Fehler" /end COMPU_VTAB
/begin COMPU_VTAB CM_ReqType "" TAB_VERB 8 0 "BapReq_DataSetGet" 1 "BapReq_DataSet" 2 "BapReq_DataGet" 5 "BapReq_Start" 6 "BapReq_StartResult" 7 "BapReq_Abort" 11 "BapReq_Ack" 31 "BapReq_Invalid" /end COMPU_VTAB
/begin COMPU_VTAB CM_SI_NWDF "" TAB_VERB 2 0 "CM_SI_NWDF_Cx0_Ueberwachung_nicht_freigegeben" 1 "CM_SI_NWDF_Cx1_Ueberwachung_freigegeben" /end COMPU_VTAB
/begin COMPU_VTAB CM_SI_NWDF_30 "" TAB_VERB 2 0 "CM_SI_NWDF_30_Cx0_Ueberwachung_nicht_freigegeben" 1 "CM_SI_NWDF_30_Cx1_Ueberwachung_freigegeben" /end COMPU_VTAB
/begin COMPU_VTAB CM_SI_P_Mode "" TAB_VERB 2 0 "CM_SI_P_Mode_Cx0_inaktiv" 1 "CM_SI_P_Mode_Cx1_aktiv" /end COMPU_VTAB
/begin COMPU_VTAB CM_SI_P_Mode_gueltig "" TAB_VERB 2 0 "CM_SI_P_Mode_gueltig_Cx0_dezentraler_Produktionsmode" 1 "CM_SI_P_Mode_gueltig_Cx1_zentraler_Produktionsmode" /end COMPU_VTAB
/begin COMPU_VTAB CM_SI_T_Mode "" TAB_VERB 2 0 "CM_SI_T_Mode_Cx0_Transportmodus_nicht_aktiv" 1 "CM_SI_T_Mode_Cx1_Transportmodus_aktiv" /end COMPU_VTAB
/begin COMPU_TAB CM_SOK_Zeit_Hybrid_01_Challenge "" TAB_INTP 2 0 0 1.8446744073709552E+19 1.8446744073709552E+19 /end COMPU_TAB
/begin COMPU_TAB CM_SOK_Zeit_Hybrid_01_Zeit "" TAB_INTP 2 0 0 72057594037927936 72057594037927936 /end COMPU_TAB
/begin COMPU_TAB CM_SOK_ungeschuetzte_Zeit "" TAB_INTP 2 1 1 72057594037927936 72057594037927936 /end COMPU_TAB
/begin COMPU_VTAB CM_SOK_ungeschuetzte_Zeit.StatusText "" TAB_VERB 1 0 "CM_SOK_ungeschuetzte_Zeit_Cx0_Init" /end COMPU_VTAB
/begin COMPU_VTAB CM_TME_Batt_Kond_Verf "" TAB_VERB 4 0 "CM_TME_Batt_Kond_Verf_Cx0_nicht_verfuegbar" 1 "CM_TME_Batt_Kond_Verf_Cx1_passive_Kuehlung" 2 "CM_TME_Batt_Kond_Verf_Cx2_aktive_Kuehlung" 4 "CM_TME_Batt_Kond_Verf_Cx4_Heizen" /end COMPU_VTAB
/begin COMPU_TAB CM_TME_Therm_IstLeistung_HVBatterie "" TAB_INTP 2 0 -25500 509 25400 /end COMPU_TAB
/begin COMPU_VTAB CM_TME_Therm_IstLeistung_HVBatterie.StatusText "" TAB_VERB 2 510 "CM_TME_Therm_IstLeistung_HVBatterie_Cx1fe_Init" 511 "CM_TME_Therm_IstLeistung_HVBatterie_Cx1ff_Fehler" /end COMPU_VTAB
/begin COMPU_TAB CM_UH_Jahr "" TAB_INTP 2 0 2000 127 2127 /end COMPU_TAB
/begin COMPU_TAB CM_UH_Minute "" TAB_INTP 2 0 0 59 59 /end COMPU_TAB
/begin COMPU_TAB CM_UH_Monat "" TAB_INTP 2 1 1 12 12 /end COMPU_TAB
/begin COMPU_VTAB CM_UH_Monat.StatusText "" TAB_VERB 3 0 "CM_UH_Monat_Cx0_Init" 14 "CM_UH_Monat_Cxe_Relatives_Datum" 15 "CM_UH_Monat_Cxf_Fehler" /end COMPU_VTAB
/begin COMPU_TAB CM_UH_Sekunde "" TAB_INTP 2 0 0 59 59 /end COMPU_TAB
/begin COMPU_TAB CM_UH_Stunde "" TAB_INTP 2 0 0 23 23 /end COMPU_TAB
/begin COMPU_TAB CM_UH_Tag "" TAB_INTP 2 1 1 31 31 /end COMPU_TAB
/begin COMPU_VTAB CM_UH_Tag.StatusText "" TAB_VERB 1 0 "CM_UH_Tag_Cx0_Init" /end COMPU_VTAB
/begin COMPU_TAB CM_UI1_Iso_Neg "" TAB_INTP 2 0 0 65532 6553200 /end COMPU_TAB
/begin COMPU_VTAB CM_UI1_Iso_Neg.StatusText "" TAB_VERB 3 65533 "CM_UI1_Iso_Neg_Cxfffd_nicht_verfuegbar" 65534 "CM_UI1_Iso_Neg_Cxfffe_Init" 65535 "CM_UI1_Iso_Neg_Cxffff_Fehler" /end COMPU_VTAB
/begin COMPU_VTAB_RANGE Nm_InitializedType "" 2 0 0 "FALSE" 1 255 "TRUE" /end COMPU_VTAB_RANGE
/begin COMPU_VTAB_RANGE Nm_PostInitializedType "" 2 0 0 "FALSE" 1 255 "TRUE" /end COMPU_VTAB_RANGE
/begin COMPU_VTAB NvMErrorStatusValues "" TAB_VERB 9 0 "NVM_REQ_OK" 1 "NVM_REQ_NOT_OK" 2 "NVM_REQ_PENDING" 3 "NVM_REQ_INTEGRITY_FAILED" 4 "NVM_REQ_BLOCK_SKIPPED" 5 "NVM_REQ_NV_INVALIDATED" 6 "NVM_REQ_CANCELED" 7 "NVM_REQ_REDUNDANCY_FAILED" 8 "NVM_REQ_RESTORED_FROM_ROM" /end COMPU_VTAB
/begin COMPU_VTAB_RANGE PduR_AllocatedOfBmTxBufferRamType "" 2 0 0 "FALSE" 1 255 "TRUE" /end COMPU_VTAB_RANGE
/begin COMPU_VTAB PduR_ExclusiveAreaRomIdxOfLockRomType "" TAB_VERB 1 255 "PDUR_NO_EXCLUSIVEAREAROMIDXOFLOCKROM" /end COMPU_VTAB
/begin COMPU_VTAB_RANGE PduR_InitializedRamType "" 2 0 0 "FALSE" 1 255 "TRUE" /end COMPU_VTAB_RANGE
/begin COMPU_VTAB PduR_PduLengthHandlingStrategyOfRmDestRomType "" TAB_VERB 2 2 "PDUR_IGNORE_PDULENGTHHANDLINGSTRATEGYOFRMDESTROM" 3 "PDUR_UNUSED_PDULENGTHHANDLINGSTRATEGYOFRMDESTROM" /end COMPU_VTAB
/begin COMPU_VTAB PduR_RmGDestRomStartIdxOfDestApplicationManagerRomType "" TAB_VERB 1 255 "PDUR_NO_RMGDESTROMSTARTIDXOFDESTAPPLICATIONMANAGERROM" /end COMPU_VTAB
/begin COMPU_VTAB PduR_RoutingTypeOfRmDestRomType "" TAB_VERB 6 0 "PDUR_IF_UNBUFFERED_RX_API_FWD_ROUTINGTYPEOFRMDESTROM" 1 "PDUR_IF_UNBUFFERED_TX_API_FWD_ROUTINGTYPEOFRMDESTROM" 3 "PDUR_IF_NOBUFFER_GATEWAY_ROUTINGTYPEOFRMDESTROM" 5 "PDUR_TP_UNBUFFERED_RX_API_FWD_ROUTINGTYPEOFRMDESTROM" 6 "PDUR_TP_UNBUFFERED_TX_API_FWD_ROUTINGTYPEOFRMDESTROM" 7 "PDUR_TP_BUFFERED_ROUTINGTYPEOFRMDESTROM" /end COMPU_VTAB
/begin COMPU_VTAB PduR_TpRxSmStateOfRmBufferedTpPropertiesRamType "" TAB_VERB 3 0 "PDUR_RM_RX_IDLE_TPRXSMSTATEOFRMBUFFEREDTPPROPERTIESRAM" 1 "PDUR_RM_RX_ACTIVE_TPRXSMSTATEOFRMBUFFEREDTPPROPERTIESRAM" 2 "PDUR_RM_RX_ABORTED_TPRXSMSTATEOFRMBUFFEREDTPPROPERTIESRAM" /end COMPU_VTAB
/begin COMPU_VTAB_RANGE PduR_hasIfRoutingOfGeneralPropertiesRomType "" 2 0 0 "FALSE" 1 255 "TRUE" /end COMPU_VTAB_RANGE
/begin GROUP Nm ""
 /begin REF_MEASUREMENT Nm_Initialized Nm_PartitionIdentifiers[0].PCPartitionConfigIdxOfPartitionIdentifiers Nm_PartitionIdentifiers[0].PartitionSNVOfPartitionIdentifiers Nm_PostInitialized /end REF_MEASUREMENT
/end GROUP
/begin GROUP NvM ""
 /begin REF_MEASUREMENT CddNpmGen2_MeasurementsType_NVM_LOCK_STAT_SET CddNpmGen2_MeasurementsType_NVM_STATE_CHANGED_SET CddNpmGen2_MeasurementsType_NVM_STATE_VALID_SET CddNpmGen2_MeasurementsType_NVM_WR_PROT_SET CddNpmGen2_MeasurementsType_NvDataIndex CddNpmGen2_MeasurementsType_NvRam_ErrorStatus CryptoKeyStorage_NVM_LOCK_STAT_SET CryptoKeyStorage_NVM_STATE_CHANGED_SET CryptoKeyStorage_NVM_STATE_VALID_SET CryptoKeyStorage_NVM_WR_PROT_SET CryptoKeyStorage_NvDataIndex CryptoKeyStorage_NvRam_ErrorStatus DemAdminDataBlock_NVM_LOCK_STAT_SET DemAdminDataBlock_NVM_STATE_CHANGED_SET DemAdminDataBlock_NVM_STATE_VALID_SET DemAdminDataBlock_NVM_WR_PROT_SET DemAdminDataBlock_NvDataIndex DemAdminDataBlock_NvRam_ErrorStatus DemPrimaryDataBlock0_NVM_LOCK_STAT_SET DemPrimaryDataBlock0_NVM_STATE_CHANGED_SET DemPrimaryDataBlock0_NVM_STATE_VALID_SET DemPrimaryDataBlock0_NVM_WR_PROT_SET DemPrimaryDataBlock0_NvDataIndex DemPrimaryDataBlock0_NvRam_ErrorStatus DemPrimaryDataBlock1_NVM_LOCK_STAT_SET DemPrimaryDataBlock1_NVM_STATE_CHANGED_SET DemPrimaryDataBlock1_NVM_STATE_VALID_SET DemPrimaryDataBlock1_NVM_WR_PROT_SET DemPrimaryDataBlock1_NvDataIndex DemPrimaryDataBlock1_NvRam_ErrorStatus DemPrimaryDataBlock2_NVM_LOCK_STAT_SET DemPrimaryDataBlock2_NVM_STATE_CHANGED_SET DemPrimaryDataBlock2_NVM_STATE_VALID_SET DemPrimaryDataBlock2_NVM_WR_PROT_SET DemPrimaryDataBlock2_NvDataIndex DemPrimaryDataBlock2_NvRam_ErrorStatus DemPrimaryDataBlock3_NVM_LOCK_STAT_SET DemPrimaryDataBlock3_NVM_STATE_CHANGED_SET DemPrimaryDataBlock3_NVM_STATE_VALID_SET DemPrimaryDataBlock3_NVM_WR_PROT_SET DemPrimaryDataBlock3_NvDataIndex DemPrimaryDataBlock3_NvRam_ErrorStatus DemPrimaryDataBlock4_NVM_LOCK_STAT_SET DemPrimaryDataBlock4_NVM_STATE_CHANGED_SET DemPrimaryDataBlock4_NVM_STATE_VALID_SET DemPrimaryDataBlock4_NVM_WR_PROT_SET DemPrimaryDataBlock4_NvDataIndex DemPrimaryDataBlock4_NvRam_ErrorStatus DemPrimaryDataBlock5_NVM_LOCK_STAT_SET DemPrimaryDataBlock5_NVM_STATE_CHANGED_SET DemPrimaryDataBlock5_NVM_STATE_VALID_SET DemPrimaryDataBlock5_NVM_WR_PROT_SET DemPrimaryDataBlock5_NvDataIndex DemPrimaryDataBlock5_NvRam_ErrorStatus DemPrimaryDataBlock6_NVM_LOCK_STAT_SET DemPrimaryDataBlock6_NVM_STATE_CHANGED_SET DemPrimaryDataBlock6_NVM_STATE_VALID_SET DemPrimaryDataBlock6_NVM_WR_PROT_SET DemPrimaryDataBlock6_NvDataIndex DemPrimaryDataBlock6_NvRam_ErrorStatus DemPrimaryDataBlock7_NVM_LOCK_STAT_SET DemPrimaryDataBlock7_NVM_STATE_CHANGED_SET DemPrimaryDataBlock7_NVM_STATE_VALID_SET DemPrimaryDataBlock7_NVM_WR_PROT_SET DemPrimaryDataBlock7_NvDataIndex DemPrimaryDataBlock7_NvRam_ErrorStatus DemStatusDataBlock_NVM_LOCK_STAT_SET DemStatusDataBlock_NVM_STATE_CHANGED_SET DemStatusDataBlock_NVM_STATE_VALID_SET DemStatusDataBlock_NVM_WR_PROT_SET DemStatusDataBlock_NvDataIndex DemStatusDataBlock_NvRam_ErrorStatus NvMBlock_0x0250_NVM_LOCK_STAT_SET NvMBlock_0x0250_NVM_STATE_CHANGED_SET NvMBlock_0x0250_NVM_STATE_VALID_SET NvMBlock_0x0250_NVM_WR_PROT_SET NvMBlock_0x0250_NvDataIndex NvMBlock_0x0250_NvRam_ErrorStatus NvMConfigBlock_NVM_LOCK_STAT_SET NvMConfigBlock_NVM_STATE_CHANGED_SET NvMConfigBlock_NVM_STATE_VALID_SET NvMConfigBlock_NVM_WR_PROT_SET NvMConfigBlock_NvDataIndex NvMConfigBlock_NvRam_ErrorStatus RT_Vishnu_NvMBlock_NVM_LOCK_STAT_SET RT_Vishnu_NvMBlock_NVM_STATE_CHANGED_SET RT_Vishnu_NvMBlock_NVM_STATE_VALID_SET RT_Vishnu_NvMBlock_NVM_WR_PROT_SET RT_Vishnu_NvMBlock_NvDataIndex RT_Vishnu_NvMBlock_NvRam_ErrorStatus StartApplication_NvMBlock1_NVM_LOCK_STAT_SET StartApplication_NvMBlock1_NVM_STATE_CHANGED_SET StartApplication_NvMBlock1_NVM_STATE_VALID_SET StartApplication_NvMBlock1_NVM_WR_PROT_SET StartApplication_NvMBlock1_NvDataIndex StartApplication_NvMBlock1_NvRam_ErrorStatus StartApplication_NvMBlock2_NVM_LOCK_STAT_SET StartApplication_NvMBlock2_NVM_STATE_CHANGED_SET StartApplication_NvMBlock2_NVM_STATE_VALID_SET StartApplication_NvMBlock2_NVM_WR_PROT_SET StartApplication_NvMBlock2_NvDataIndex StartApplication_NvMBlock2_NvRam_ErrorStatus vFotaH_NvMModuleInfo_NVM_LOCK_STAT_SET vFotaH_NvMModuleInfo_NVM_STATE_CHANGED_SET vFotaH_NvMModuleInfo_NVM_STATE_VALID_SET vFotaH_NvMModuleInfo_NVM_WR_PROT_SET vFotaH_NvMModuleInfo_NvDataIndex vFotaH_NvMModuleInfo_NvRam_ErrorStatus vSwUpdM_Appl_NvModuleInfo_NVM_LOCK_STAT_SET vSwUpdM_Appl_NvModuleInfo_NVM_STATE_CHANGED_SET vSwUpdM_Appl_NvModuleInfo_NVM_STATE_VALID_SET vSwUpdM_Appl_NvModuleInfo_NVM_WR_PROT_SET vSwUpdM_Appl_NvModuleInfo_NvDataIndex vSwUpdM_Appl_NvModuleInfo_NvRam_ErrorStatus vSwUpdM_Appl_NvPartitionInfo_NVM_LOCK_STAT_SET vSwUpdM_Appl_NvPartitionInfo_NVM_STATE_CHANGED_SET vSwUpdM_Appl_NvPartitionInfo_NVM_STATE_VALID_SET vSwUpdM_Appl_NvPartitionInfo_NVM_WR_PROT_SET vSwUpdM_Appl_NvPartitionInfo_NvDataIndex vSwUpdM_Appl_NvPartitionInfo_NvRam_ErrorStatus vSwUpdM_Appl_NvRegionInfo_NVM_LOCK_STAT_SET vSwUpdM_Appl_NvRegionInfo_NVM_STATE_CHANGED_SET vSwUpdM_Appl_NvRegionInfo_NVM_STATE_VALID_SET vSwUpdM_Appl_NvRegionInfo_NVM_WR_PROT_SET vSwUpdM_Appl_NvRegionInfo_NvDataIndex vSwUpdM_Appl_NvRegionInfo_NvRam_ErrorStatus vSwUpdM_Appl_NvResumeInfo_NVM_LOCK_STAT_SET vSwUpdM_Appl_NvResumeInfo_NVM_STATE_CHANGED_SET vSwUpdM_Appl_NvResumeInfo_NVM_STATE_VALID_SET vSwUpdM_Appl_NvResumeInfo_NVM_WR_PROT_SET vSwUpdM_Appl_NvResumeInfo_NvDataIndex vSwUpdM_Appl_NvResumeInfo_NvRam_ErrorStatus vSwUpdM_Appl_NvSegmentAttributes_NVM_LOCK_STAT_SET vSwUpdM_Appl_NvSegmentAttributes_NVM_STATE_CHANGED_SET vSwUpdM_Appl_NvSegmentAttributes_NVM_STATE_VALID_SET vSwUpdM_Appl_NvSegmentAttributes_NVM_WR_PROT_SET vSwUpdM_Appl_NvSegmentAttributes_NvDataIndex vSwUpdM_Appl_NvSegmentAttributes_NvRam_ErrorStatus vSwUpdM_Appl_NvSegmentCount_NVM_LOCK_STAT_SET vSwUpdM_Appl_NvSegmentCount_NVM_STATE_CHANGED_SET vSwUpdM_Appl_NvSegmentCount_NVM_STATE_VALID_SET vSwUpdM_Appl_NvSegmentCount_NVM_WR_PROT_SET vSwUpdM_Appl_NvSegmentCount_NvDataIndex vSwUpdM_Appl_NvSegmentCount_NvRam_ErrorStatus vSwUpdM_Appl_NvSegmentWriteAddress_NVM_LOCK_STAT_SET vSwUpdM_Appl_NvSegmentWriteAddress_NVM_STATE_CHANGED_SET vSwUpdM_Appl_NvSegmentWriteAddress_NVM_STATE_VALID_SET vSwUpdM_Appl_NvSegmentWriteAddress_NVM_WR_PROT_SET vSwUpdM_Appl_NvSegmentWriteAddress_NvDataIndex vSwUpdM_Appl_NvSegmentWriteAddress_NvRam_ErrorStatus vSwUpdM_Appl_NvUpdateState_NVM_LOCK_STAT_SET vSwUpdM_Appl_NvUpdateState_NVM_STATE_CHANGED_SET vSwUpdM_Appl_NvUpdateState_NVM_STATE_VALID_SET vSwUpdM_Appl_NvUpdateState_NVM_WR_PROT_SET vSwUpdM_Appl_NvUpdateState_NvDataIndex vSwUpdM_Appl_NvUpdateState_NvRam_ErrorStatus /end REF_MEASUREMENT
/end GROUP
/begin GROUP PduR ""
 /begin REF_MEASUREMENT PduR_BmTxBufferArrayRam PduR_BmTxBufferArrayRam_PduRTxBuffer_32 PduR_BmTxBufferArrayRam_PduRTxBuffer_33 PduR_BmTxBufferArrayRam_PduRTxBuffer_34 PduR_BmTxBufferArrayRam_PduRTxBuffer_72 PduR_BmTxBufferArrayRam_PduRTxBuffer_8 PduR_BmTxBufferInstanceRam[0].BmTxBufferArrayRamReadIdxOfBmTxBufferInstanceRam PduR_BmTxBufferInstanceRam[1].BmTxBufferArrayRamReadIdxOfBmTxBufferInstanceRam PduR_BmTxBufferInstanceRam[2].BmTxBufferArrayRamReadIdxOfBmTxBufferInstanceRam PduR_BmTxBufferInstanceRam[3].BmTxBufferArrayRamReadIdxOfBmTxBufferInstanceRam PduR_BmTxBufferInstanceRam[4].BmTxBufferArrayRamReadIdxOfBmTxBufferInstanceRam PduR_BmTxBufferInstanceRam[5].BmTxBufferArrayRamReadIdxOfBmTxBufferInstanceRam PduR_BmTxBufferInstanceRam[6].BmTxBufferArrayRamReadIdxOfBmTxBufferInstanceRam PduR_BmTxBufferInstanceRam[7].BmTxBufferArrayRamReadIdxOfBmTxBufferInstanceRam PduR_BmTxBufferInstanceRam[8].BmTxBufferArrayRamReadIdxOfBmTxBufferInstanceRam PduR_BmTxBufferInstanceRam[9].BmTxBufferArrayRamReadIdxOfBmTxBufferInstanceRam PduR_BmTxBufferInstanceRam_PduRTxBuffer_32[0].BmTxBufferArrayRamReadIdxOfBmTxBufferInstanceRam PduR_BmTxBufferInstanceRam_PduRTxBuffer_32[1].BmTxBufferArrayRamReadIdxOfBmTxBufferInstanceRam PduR_BmTxBufferInstanceRam_PduRTxBuffer_33[0].BmTxBufferArrayRamReadIdxOfBmTxBufferInstanceRam PduR_BmTxBufferInstanceRam_PduRTxBuffer_33[1].BmTxBufferArrayRamReadIdxOfBmTxBufferInstanceRam PduR_BmTxBufferInstanceRam_PduRTxBuffer_34[0].BmTxBufferArrayRamReadIdxOfBmTxBufferInstanceRam PduR_BmTxBufferInstanceRam_PduRTxBuffer_34[1].BmTxBufferArrayRamReadIdxOfBmTxBufferInstanceRam PduR_BmTxBufferInstanceRam_PduRTxBuffer_72[0].BmTxBufferArrayRamReadIdxOfBmTxBufferInstanceRam PduR_BmTxBufferInstanceRam_PduRTxBuffer_72[1].BmTxBufferArrayRamReadIdxOfBmTxBufferInstanceRam PduR_BmTxBufferInstanceRam_PduRTxBuffer_8[0].BmTxBufferArrayRamReadIdxOfBmTxBufferInstanceRam PduR_BmTxBufferInstanceRam_PduRTxBuffer_8[1].BmTxBufferArrayRamReadIdxOfBmTxBufferInstanceRam PduR_BmTxBufferInstanceRom[0].BmTxBufferRomIdxOfBmTxBufferInstanceRom PduR_BmTxBufferInstanceRom[1].BmTxBufferRomIdxOfBmTxBufferInstanceRom PduR_BmTxBufferInstanceRom[2].BmTxBufferRomIdxOfBmTxBufferInstanceRom PduR_BmTxBufferInstanceRom[3].BmTxBufferRomIdxOfBmTxBufferInstanceRom PduR_BmTxBufferInstanceRom[4].BmTxBufferRomIdxOfBmTxBufferInstanceRom PduR_BmTxBufferInstanceRom[5].BmTxBufferRomIdxOfBmTxBufferInstanceRom PduR_BmTxBufferInstanceRom[6].BmTxBufferRomIdxOfBmTxBufferInstanceRom PduR_BmTxBufferInstanceRom[7].BmTxBufferRomIdxOfBmTxBufferInstanceRom PduR_BmTxBufferInstanceRom[8].BmTxBufferRomIdxOfBmTxBufferInstanceRom PduR_BmTxBufferInstanceRom[9].BmTxBufferRomIdxOfBmTxBufferInstanceRom PduR_BmTxBufferRam[0].AllocatedOfBmTxBufferRam PduR_BmTxBufferRam[0].BmTxBufferArrayRamWriteIdxOfBmTxBufferRam PduR_BmTxBufferRam[0].RxLengthOfBmTxBufferRam PduR_BmTxBufferRam[1].AllocatedOfBmTxBufferRam PduR_BmTxBufferRam[1].BmTxBufferArrayRamWriteIdxOfBmTxBufferRam PduR_BmTxBufferRam[1].RxLengthOfBmTxBufferRam PduR_BmTxBufferRam[2].AllocatedOfBmTxBufferRam PduR_BmTxBufferRam[2].BmTxBufferArrayRamWriteIdxOfBmTxBufferRam PduR_BmTxBufferRam[2].RxLengthOfBmTxBufferRam PduR_BmTxBufferRam[3].AllocatedOfBmTxBufferRam PduR_BmTxBufferRam[3].BmTxBufferArrayRamWriteIdxOfBmTxBufferRam PduR_BmTxBufferRam[3].RxLengthOfBmTxBufferRam PduR_BmTxBufferRam[4].AllocatedOfBmTxBufferRam PduR_BmTxBufferRam[4].BmTxBufferArrayRamWriteIdxOfBmTxBufferRam PduR_BmTxBufferRam[4].RxLengthOfBmTxBufferRam PduR_BmTxBufferRam_PduRTxBuffer_32[0].AllocatedOfBmTxBufferRam PduR_BmTxBufferRam_PduRTxBuffer_32[0].BmTxBufferArrayRamWriteIdxOfBmTxBufferRam PduR_BmTxBufferRam_PduRTxBuffer_32[0].RxLengthOfBmTxBufferRam PduR_BmTxBufferRam_PduRTxBuffer_33[0].AllocatedOfBmTxBufferRam PduR_BmTxBufferRam_PduRTxBuffer_33[0].BmTxBufferArrayRamWriteIdxOfBmTxBufferRam PduR_BmTxBufferRam_PduRTxBuffer_33[0].RxLengthOfBmTxBufferRam PduR_BmTxBufferRam_PduRTxBuffer_34[0].AllocatedOfBmTxBufferRam PduR_BmTxBufferRam_PduRTxBuffer_34[0].BmTxBufferArrayRamWriteIdxOfBmTxBufferRam PduR_BmTxBufferRam_PduRTxBuffer_34[0].RxLengthOfBmTxBufferRam PduR_BmTxBufferRam_PduRTxBuffer_72[0].AllocatedOfBmTxBufferRam PduR_BmTxBufferRam_PduRTxBuffer_72[0].BmTxBufferArrayRamWriteIdxOfBmTxBufferRam PduR_BmTxBufferRam_PduRTxBuffer_72[0].RxLengthOfBmTxBufferRam PduR_BmTxBufferRam_PduRTxBuffer_8[0].AllocatedOfBmTxBufferRam PduR_BmTxBufferRam_PduRTxBuffer_8[0].BmTxBufferArrayRamWriteIdxOfBmTxBufferRam PduR_BmTxBufferRam_PduRTxBuffer_8[0].RxLengthOfBmTxBufferRam PduR_BmTxBufferRom[0].BmTxBufferArrayRamEndIdxOfBmTxBufferRom PduR_BmTxBufferRom[0].BmTxBufferArrayRamStartIdxOfBmTxBufferRom PduR_BmTxBufferRom[0].BmTxBufferInstanceRomStartIdxOfBmTxBufferRom PduR_BmTxBufferRom[1].BmTxBufferArrayRamEndIdxOfBmTxBufferRom PduR_BmTxBufferRom[1].BmTxBufferArrayRamStartIdxOfBmTxBufferRom PduR_BmTxBufferRom[1].BmTxBufferInstanceRomStartIdxOfBmTxBufferRom PduR_BmTxBufferRom[2].BmTxBufferArrayRamEndIdxOfBmTxBufferRom PduR_BmTxBufferRom[2].BmTxBufferArrayRamStartIdxOfBmTxBufferRom PduR_BmTxBufferRom[2].BmTxBufferInstanceRomStartIdxOfBmTxBufferRom PduR_BmTxBufferRom[3].BmTxBufferArrayRamEndIdxOfBmTxBufferRom PduR_BmTxBufferRom[3].BmTxBufferArrayRamStartIdxOfBmTxBufferRom PduR_BmTxBufferRom[3].BmTxBufferInstanceRomStartIdxOfBmTxBufferRom PduR_BmTxBufferRom[4].BmTxBufferArrayRamEndIdxOfBmTxBufferRom PduR_BmTxBufferRom[4].BmTxBufferArrayRamStartIdxOfBmTxBufferRom PduR_BmTxBufferRom[4].BmTxBufferInstanceRomStartIdxOfBmTxBufferRom PduR_DestApplicationManagerRom[0].RmGDestRomStartIdxOfDestApplicationManagerRom PduR_FmFifoElementRam[0].BmTxBufferRomIdxOfFmFifoElementRam PduR_FmFifoElementRam[0].RmDestRomIdxOfFmFifoElementRam PduR_FmFifoElementRam[1].BmTxBufferRomIdxOfFmFifoElementRam PduR_FmFifoElementRam[1].RmDestRomIdxOfFmFifoElementRam PduR_FmFifoElementRam_PduRQueue[0].BmTxBufferRomIdxOfFmFifoElementRam PduR_FmFifoElementRam_PduRQueue[0].RmDestRomIdxOfFmFifoElementRam PduR_FmFifoElementRam_PduRQueue[1].BmTxBufferRomIdxOfFmFifoElementRam PduR_FmFifoElementRam_PduRQueue[1].RmDestRomIdxOfFmFifoElementRam PduR_FmFifoInstanceRam[0].BmTxBufferInstanceRomIdxOfFmFifoInstanceRam PduR_FmFifoInstanceRam_DCM_BMC_CAN01_XIX_TPCHType_CANHS_OBDC_Diagnose_XIX_0x17FD0200_XIX_Functional_e9b636f2_Tx[0].BmTxBufferInstanceRomIdxOfFmFifoInstanceRam PduR_GeneralPropertiesRom[0].hasIfRoutingOfGeneralPropertiesRom PduR_InitializedRam PduR_InitializedRam_PduRSinglePartitionDummy PduR_LockRom[0].ExclusiveAreaRomIdxOfLockRom PduR_PartitionIdentifiers[0].PartitionSNVOfPartitionIdentifiers PduR_RmBufferedTpPropertiesRam[0].FmFifoElementRamIdxOfRmBufferedTpPropertiesRam PduR_RmBufferedTpPropertiesRam[0].TpRxSmStateOfRmBufferedTpPropertiesRam PduR_RmBufferedTpPropertiesRam_PduRSrcPdu_31fc5fb2[0].FmFifoElementRamIdxOfRmBufferedTpPropertiesRam PduR_RmBufferedTpPropertiesRam_PduRSrcPdu_31fc5fb2[0].TpRxSmStateOfRmBufferedTpPropertiesRam PduR_RmDestRom[0].PduLengthHandlingStrategyOfRmDestRom PduR_RmDestRom[0].RmGDestRomIdxOfRmDestRom PduR_RmDestRom[0].RmSrcRomIdxOfRmDestRom PduR_RmDestRom[0].RoutingTypeOfRmDestRom PduR_RmDestRom[100].PduLengthHandlingStrategyOfRmDestRom PduR_RmDestRom[100].RmGDestRomIdxOfRmDestRom PduR_RmDestRom[100].RmSrcRomIdxOfRmDestRom PduR_RmDestRom[100].RoutingTypeOfRmDestRom PduR_RmDestRom[101].PduLengthHandlingStrategyOfRmDestRom PduR_RmDestRom[101].RmGDestRomIdxOfRmDestRom PduR_RmDestRom[101].RmSrcRomIdxOfRmDestRom PduR_RmDestRom[101].RoutingTypeOfRmDestRom PduR_RmDestRom[102].PduLengthHandlingStrategyOfRmDestRom PduR_RmDestRom[102].RmGDestRomIdxOfRmDestRom PduR_RmDestRom[102].RmSrcRomIdxOfRmDestRom PduR_RmDestRom[102].RoutingTypeOfRmDestRom PduR_RmDestRom[103].PduLengthHandlingStrategyOfRmDestRom PduR_RmDestRom[103].RmGDestRomIdxOfRmDestRom PduR_RmDestRom[103].RmSrcRomIdxOfRmDestRom PduR_RmDestRom[103].RoutingTypeOfRmDestRom PduR_RmDestRom[104].PduLengthHandlingStrategyOfRmDestRom PduR_RmDestRom[104].RmGDestRomIdxOfRmDestRom PduR_RmDestRom[104].RmSrcRomIdxOfRmDestRom PduR_RmDestRom[104].RoutingTypeOfRmDestRom PduR_RmDestRom[105].PduLengthHandlingStrategyOfRmDestRom PduR_RmDestRom[105].RmGDestRomIdxOfRmDestRom PduR_RmDestRom[105].RmSrcRomIdxOfRmDestRom PduR_RmDestRom[105].RoutingTypeOfRmDestRom PduR_RmDestRom[106].PduLengthHandlingStrategyOfRmDestRom PduR_RmDestRom[106].RmGDestRomIdxOfRmDestRom PduR_RmDestRom[106].RmSrcRomIdxOfRmDestRom PduR_RmDestRom[106].RoutingTypeOfRmDestRom PduR_RmDestRom[107].PduLengthHandlingStrategyOfRmDestRom PduR_RmDestRom[107].RmGDestRomIdxOfRmDestRom PduR_RmDestRom[107].RmSrcRomIdxOfRmDestRom PduR_RmDestRom[107].RoutingTypeOfRmDestRom PduR_RmDestRom[108].PduLengthHandlingStrategyOfRmDestRom PduR_RmDestRom[108].RmGDestRomIdxOfRmDestRom PduR_RmDestRom[108].RmSrcRomIdxOfRmDestRom PduR_RmDestRom[108].RoutingTypeOfRmDestRom PduR_RmDestRom[109].PduLengthHandlingStrategyOfRmDestRom PduR_RmDestRom[109].RmGDestRomIdxOfRmDestRom PduR_RmDestRom[109].RmSrcRomIdxOfRmDestRom PduR_RmDestRom[109].RoutingTypeOfRmDestRom PduR_RmDestRom[10].PduLengthHandlingStrategyOfRmDestRom PduR_RmDestRom[10].RmGDestRomIdxOfRmDestRom PduR_RmDestRom[10].RmSrcRomIdxOfRmDestRom PduR_RmDestRom[10].RoutingTypeOfRmDestRom PduR_RmDestRom[110].PduLengthHandlingStrategyOfRmDestRom PduR_RmDestRom[110].RmGDestRomIdxOfRmDestRom PduR_RmDestRom[110].RmSrcRomIdxOfRmDestRom PduR_RmDestRom[110].RoutingTypeOfRmDestRom PduR_RmDestRom[111].PduLengthHandlingStrategyOfRmDestRom PduR_RmDestRom[111].RmGDestRomIdxOfRmDestRom PduR_RmDestRom[111].RmSrcRomIdxOfRmDestRom PduR_RmDestRom[111].RoutingTypeOfRmDestRom PduR_RmDestRom[112].PduLengthHandlingStrategyOfRmDestRom PduR_RmDestRom[112].RmGDestRomIdxOfRmDestRom PduR_RmDestRom[112].RmSrcRomIdxOfRmDestRom PduR_RmDestRom[112].RoutingTypeOfRmDestRom PduR_RmDestRom[113].PduLengthHandlingStrategyOfRmDestRom PduR_RmDestRom[113].RmGDestRomIdxOfRmDestRom PduR_RmDestRom[113].RmSrcRomIdxOfRmDestRom PduR_RmDestRom[113].RoutingTypeOfRmDestRom PduR_RmDestRom[114].PduLengthHandlingStrategyOfRmDestRom PduR_RmDestRom[114].RmGDestRomIdxOfRmDestRom PduR_RmDestRom[114].RmSrcRomIdxOfRmDestRom PduR_RmDestRom[114].RoutingTypeOfRmDestRom PduR_RmDestRom[115].PduLengthHandlingStrategyOfRmDestRom PduR_RmDestRom[115].RmGDestRomIdxOfRmDestRom PduR_RmDestRom[115].RmSrcRomIdxOfRmDestRom PduR_RmDestRom[115].RoutingTypeOfRmDestRom PduR_RmDestRom[116].PduLengthHandlingStrategyOfRmDestRom PduR_RmDestRom[116].RmGDestRomIdxOfRmDestRom PduR_RmDestRom[116].RmSrcRomIdxOfRmDestRom PduR_RmDestRom[116].RoutingTypeOfRmDestRom PduR_RmDestRom[117].PduLengthHandlingStrategyOfRmDestRom PduR_RmDestRom[117].RmGDestRomIdxOfRmDestRom PduR_RmDestRom[117].RmSrcRomIdxOfRmDestRom PduR_RmDestRom[117].RoutingTypeOfRmDestRom PduR_RmDestRom[118].PduLengthHandlingStrategyOfRmDestRom PduR_RmDestRom[118].RmGDestRomIdxOfRmDestRom PduR_RmDestRom[118].RmSrcRomIdxOfRmDestRom PduR_RmDestRom[118].RoutingTypeOfRmDestRom PduR_RmDestRom[119].PduLengthHandlingStrategyOfRmDestRom PduR_RmDestRom[119].RmGDestRomIdxOfRmDestRom PduR_RmDestRom[119].RmSrcRomIdxOfRmDestRom PduR_RmDestRom[119].RoutingTypeOfRmDestRom PduR_RmDestRom[11].PduLengthHandlingStrategyOfRmDestRom PduR_RmDestRom[11].RmGDestRomIdxOfRmDestRom PduR_RmDestRom[11].RmSrcRomIdxOfRmDestRom PduR_RmDestRom[11].RoutingTypeOfRmDestRom PduR_RmDestRom[120].PduLengthHandlingStrategyOfRmDestRom PduR_RmDestRom[120].RmGDestRomIdxOfRmDestRom PduR_RmDestRom[120].RmSrcRomIdxOfRmDestRom PduR_RmDestRom[120].RoutingTypeOfRmDestRom PduR_RmDestRom[121].PduLengthHandlingStrategyOfRmDestRom PduR_RmDestRom[121].RmGDestRomIdxOfRmDestRom PduR_RmDestRom[121].RmSrcRomIdxOfRmDestRom PduR_RmDestRom[121].RoutingTypeOfRmDestRom PduR_RmDestRom[122].PduLengthHandlingStrategyOfRmDestRom PduR_RmDestRom[122].RmGDestRomIdxOfRmDestRom PduR_RmDestRom[122].RmSrcRomIdxOfRmDestRom PduR_RmDestRom[122].RoutingTypeOfRmDestRom PduR_RmDestRom[123].PduLengthHandlingStrategyOfRmDestRom PduR_RmDestRom[123].RmGDestRomIdxOfRmDestRom PduR_RmDestRom[123].RmSrcRomIdxOfRmDestRom PduR_RmDestRom[123].RoutingTypeOfRmDestRom PduR_RmDestRom[124].PduLengthHandlingStrategyOfRmDestRom PduR_RmDestRom[124].RmGDestRomIdxOfRmDestRom PduR_RmDestRom[124].RmSrcRomIdxOfRmDestRom PduR_RmDestRom[124].RoutingTypeOfRmDestRom PduR_RmDestRom[125].PduLengthHandlingStrategyOfRmDestRom PduR_RmDestRom[125].RmGDestRomIdxOfRmDestRom PduR_RmDestRom[125].RmSrcRomIdxOfRmDestRom PduR_RmDestRom[125].RoutingTypeOfRmDestRom PduR_RmDestRom[126].PduLengthHandlingStrategyOfRmDestRom PduR_RmDestRom[126].RmGDestRomIdxOfRmDestRom PduR_RmDestRom[126].RmSrcRomIdxOfRmDestRom PduR_RmDestRom[126].RoutingTypeOfRmDestRom PduR_RmDestRom[127].PduLengthHandlingStrategyOfRmDestRom PduR_RmDestRom[127].RmGDestRomIdxOfRmDestRom PduR_RmDestRom[127].RmSrcRomIdxOfRmDestRom PduR_RmDestRom[127].RoutingTypeOfRmDestRom PduR_RmDestRom[128].PduLengthHandlingStrategyOfRmDestRom PduR_RmDestRom[128].RmGDestRomIdxOfRmDestRom PduR_RmDestRom[128].RmSrcRomIdxOfRmDestRom PduR_RmDestRom[128].RoutingTypeOfRmDestRom PduR_RmDestRom[129].PduLengthHandlingStrategyOfRmDestRom PduR_RmDestRom[129].RmGDestRomIdxOfRmDestRom PduR_RmDestRom[129].RmSrcRomIdxOfRmDestRom PduR_RmDestRom[129].RoutingTypeOfRmDestRom PduR_RmDestRom[12].PduLengthHandlingStrategyOfRmDestRom PduR_RmDestRom[12].RmGDestRomIdxOfRmDestRom PduR_RmDestRom[12].RmSrcRomIdxOfRmDestRom PduR_RmDestRom[12].RoutingTypeOfRmDestRom PduR_RmDestRom[130].PduLengthHandlingStrategyOfRmDestRom PduR_RmDestRom[130].RmGDestRomIdxOfRmDestRom PduR_RmDestRom[130].RmSrcRomIdxOfRmDestRom PduR_RmDestRom[130].RoutingTypeOfRmDestRom PduR_RmDestRom[131].PduLengthHandlingStrategyOfRmDestRom PduR_RmDestRom[131].RmGDestRomIdxOfRmDestRom PduR_RmDestRom[131].RmSrcRomIdxOfRmDestRom PduR_RmDestRom[131].RoutingTypeOfRmDestRom PduR_RmDestRom[132].PduLengthHandlingStrategyOfRmDestRom PduR_RmDestRom[132].RmGDestRomIdxOfRmDestRom PduR_RmDestRom[132].RmSrcRomIdxOfRmDestRom PduR_RmDestRom[132].RoutingTypeOfRmDestRom PduR_RmDestRom[133].PduLengthHandlingStrategyOfRmDestRom PduR_RmDestRom[133].RmGDestRomIdxOfRmDestRom PduR_RmDestRom[133].RmSrcRomIdxOfRmDestRom PduR_RmDestRom[133].RoutingTypeOfRmDestRom PduR_RmDestRom[134].PduLengthHandlingStrategyOfRmDestRom PduR_RmDestRom[134].RmGDestRomIdxOfRmDestRom PduR_RmDestRom[134].RmSrcRomIdxOfRmDestRom PduR_RmDestRom[134].RoutingTypeOfRmDestRom PduR_RmDestRom[135].PduLengthHandlingStrategyOfRmDestRom PduR_RmDestRom[135].RmGDestRomIdxOfRmDestRom PduR_RmDestRom[135].RmSrcRomIdxOfRmDestRom PduR_RmDestRom[135].RoutingTypeOfRmDestRom PduR_RmDestRom[136].PduLengthHandlingStrategyOfRmDestRom PduR_RmDestRom[136].RmGDestRomIdxOfRmDestRom PduR_RmDestRom[136].RmSrcRomIdxOfRmDestRom PduR_RmDestRom[136].RoutingTypeOfRmDestRom PduR_RmDestRom[137].PduLengthHandlingStrategyOfRmDestRom PduR_RmDestRom[137].RmGDestRomIdxOfRmDestRom PduR_RmDestRom[137].RmSrcRomIdxOfRmDestRom PduR_RmDestRom[137].RoutingTypeOfRmDestRom PduR_RmDestRom[138].PduLengthHandlingStrategyOfRmDestRom PduR_RmDestRom[138].RmGDestRomIdxOfRmDestRom PduR_RmDestRom[138].RmSrcRomIdxOfRmDestRom PduR_RmDestRom[138].RoutingTypeOfRmDestRom PduR_RmDestRom[139].PduLengthHandlingStrategyOfRmDestRom PduR_RmDestRom[139].RmGDestRomIdxOfRmDestRom PduR_RmDestRom[139].RmSrcRomIdxOfRmDestRom PduR_RmDestRom[139].RoutingTypeOfRmDestRom PduR_RmDestRom[13].PduLengthHandlingStrategyOfRmDestRom PduR_RmDestRom[13].RmGDestRomIdxOfRmDestRom PduR_RmDestRom[13].RmSrcRomIdxOfRmDestRom PduR_RmDestRom[13].RoutingTypeOfRmDestRom PduR_RmDestRom[140].PduLengthHandlingStrategyOfRmDestRom PduR_RmDestRom[140].RmGDestRomIdxOfRmDestRom PduR_RmDestRom[140].RmSrcRomIdxOfRmDestRom PduR_RmDestRom[140].RoutingTypeOfRmDestRom PduR_RmDestRom[141].PduLengthHandlingStrategyOfRmDestRom PduR_RmDestRom[141].RmGDestRomIdxOfRmDestRom PduR_RmDestRom[141].RmSrcRomIdxOfRmDestRom PduR_RmDestRom[141].RoutingTypeOfRmDestRom PduR_RmDestRom[142].PduLengthHandlingStrategyOfRmDestRom PduR_RmDestRom[142].RmGDestRomIdxOfRmDestRom PduR_RmDestRom[142].RmSrcRomIdxOfRmDestRom PduR_RmDestRom[142].RoutingTypeOfRmDestRom PduR_RmDestRom[143].PduLengthHandlingStrategyOfRmDestRom PduR_RmDestRom[143].RmGDestRomIdxOfRmDestRom PduR_RmDestRom[143].RmSrcRomIdxOfRmDestRom PduR_RmDestRom[143].RoutingTypeOfRmDestRom PduR_RmDestRom[144].PduLengthHandlingStrategyOfRmDestRom PduR_RmDestRom[144].RmGDestRomIdxOfRmDestRom PduR_RmDestRom[144].RmSrcRomIdxOfRmDestRom PduR_RmDestRom[144].RoutingTypeOfRmDestRom PduR_RmDestRom[145].PduLengthHandlingStrategyOfRmDestRom PduR_RmDestRom[145].RmGDestRomIdxOfRmDestRom PduR_RmDestRom[145].RmSrcRomIdxOfRmDestRom PduR_RmDestRom[145].RoutingTypeOfRmDestRom PduR_RmDestRom[146].PduLengthHandlingStrategyOfRmDestRom PduR_RmDestRom[146].RmGDestRomIdxOfRmDestRom PduR_RmDestRom[146].RmSrcRomIdxOfRmDestRom PduR_RmDestRom[146].RoutingTypeOfRmDestRom PduR_RmDestRom[147].PduLengthHandlingStrategyOfRmDestRom PduR_RmDestRom[147].RmGDestRomIdxOfRmDestRom PduR_RmDestRom[147].RmSrcRomIdxOfRmDestRom PduR_RmDestRom[147].RoutingTypeOfRmDestRom PduR_RmDestRom[148].PduLengthHandlingStrategyOfRmDestRom PduR_RmDestRom[148].RmGDestRomIdxOfRmDestRom PduR_RmDestRom[148].RmSrcRomIdxOfRmDestRom PduR_RmDestRom[148].RoutingTypeOfRmDestRom PduR_RmDestRom[149].PduLengthHandlingStrategyOfRmDestRom PduR_RmDestRom[149].RmGDestRomIdxOfRmDestRom PduR_RmDestRom[149].RmSrcRomIdxOfRmDestRom PduR_RmDestRom[149].RoutingTypeOfRmDestRom PduR_RmDestRom[14].PduLengthHandlingStrategyOfRmDestRom PduR_RmDestRom[14].RmGDestRomIdxOfRmDestRom PduR_RmDestRom[14].RmSrcRomIdxOfRmDestRom PduR_RmDestRom[14].RoutingTypeOfRmDestRom PduR_RmDestRom[150].PduLengthHandlingStrategyOfRmDestRom PduR_RmDestRom[150].RmGDestRomIdxOfRmDestRom PduR_RmDestRom[150].RmSrcRomIdxOfRmDestRom PduR_RmDestRom[150].RoutingTypeOfRmDestRom PduR_RmDestRom[15].PduLengthHandlingStrategyOfRmDestRom PduR_RmDestRom[15].RmGDestRomIdxOfRmDestRom PduR_RmDestRom[15].RmSrcRomIdxOfRmDestRom PduR_RmDestRom[15].RoutingTypeOfRmDestRom PduR_RmDestRom[16].PduLengthHandlingStrategyOfRmDestRom PduR_RmDestRom[16].RmGDestRomIdxOfRmDestRom PduR_RmDestRom[16].RmSrcRomIdxOfRmDestRom PduR_RmDestRom[16].RoutingTypeOfRmDestRom PduR_RmDestRom[17].PduLengthHandlingStrategyOfRmDestRom PduR_RmDestRom[17].RmGDestRomIdxOfRmDestRom PduR_RmDestRom[17].RmSrcRomIdxOfRmDestRom PduR_RmDestRom[17].RoutingTypeOfRmDestRom PduR_RmDestRom[18].PduLengthHandlingStrategyOfRmDestRom PduR_RmDestRom[18].RmGDestRomIdxOfRmDestRom PduR_RmDestRom[18].RmSrcRomIdxOfRmDestRom PduR_RmDestRom[18].RoutingTypeOfRmDestRom PduR_RmDestRom[19].PduLengthHandlingStrategyOfRmDestRom PduR_RmDestRom[19].RmGDestRomIdxOfRmDestRom PduR_RmDestRom[19].RmSrcRomIdxOfRmDestRom PduR_RmDestRom[19].RoutingTypeOfRmDestRom PduR_RmDestRom[1].PduLengthHandlingStrategyOfRmDestRom PduR_RmDestRom[1].RmGDestRomIdxOfRmDestRom PduR_RmDestRom[1].RmSrcRomIdxOfRmDestRom PduR_RmDestRom[1].RoutingTypeOfRmDestRom PduR_RmDestRom[20].PduLengthHandlingStrategyOfRmDestRom PduR_RmDestRom[20].RmGDestRomIdxOfRmDestRom PduR_RmDestRom[20].RmSrcRomIdxOfRmDestRom PduR_RmDestRom[20].RoutingTypeOfRmDestRom PduR_RmDestRom[21].PduLengthHandlingStrategyOfRmDestRom PduR_RmDestRom[21].RmGDestRomIdxOfRmDestRom PduR_RmDestRom[21].RmSrcRomIdxOfRmDestRom PduR_RmDestRom[21].RoutingTypeOfRmDestRom PduR_RmDestRom[22].PduLengthHandlingStrategyOfRmDestRom PduR_RmDestRom[22].RmGDestRomIdxOfRmDestRom PduR_RmDestRom[22].RmSrcRomIdxOfRmDestRom PduR_RmDestRom[22].RoutingTypeOfRmDestRom PduR_RmDestRom[23].PduLengthHandlingStrategyOfRmDestRom PduR_RmDestRom[23].RmGDestRomIdxOfRmDestRom PduR_RmDestRom[23].RmSrcRomIdxOfRmDestRom PduR_RmDestRom[23].RoutingTypeOfRmDestRom PduR_RmDestRom[24].PduLengthHandlingStrategyOfRmDestRom PduR_RmDestRom[24].RmGDestRomIdxOfRmDestRom PduR_RmDestRom[24].RmSrcRomIdxOfRmDestRom PduR_RmDestRom[24].RoutingTypeOfRmDestRom PduR_RmDestRom[25].PduLengthHandlingStrategyOfRmDestRom PduR_RmDestRom[25].RmGDestRomIdxOfRmDestRom PduR_RmDestRom[25].RmSrcRomIdxOfRmDestRom PduR_RmDestRom[25].RoutingTypeOfRmDestRom PduR_RmDestRom[26].PduLengthHandlingStrategyOfRmDestRom PduR_RmDestRom[26].RmGDestRomIdxOfRmDestRom PduR_RmDestRom[26].RmSrcRomIdxOfRmDestRom PduR_RmDestRom[26].RoutingTypeOfRmDestRom PduR_RmDestRom[27].PduLengthHandlingStrategyOfRmDestRom PduR_RmDestRom[27].RmGDestRomIdxOfRmDestRom PduR_RmDestRom[27].RmSrcRomIdxOfRmDestRom PduR_RmDestRom[27].RoutingTypeOfRmDestRom PduR_RmDestRom[28].PduLengthHandlingStrategyOfRmDestRom PduR_RmDestRom[28].RmGDestRomIdxOfRmDestRom PduR_RmDestRom[28].RmSrcRomIdxOfRmDestRom PduR_RmDestRom[28].RoutingTypeOfRmDestRom PduR_RmDestRom[29].PduLengthHandlingStrategyOfRmDestRom PduR_RmDestRom[29].RmGDestRomIdxOfRmDestRom PduR_RmDestRom[29].RmSrcRomIdxOfRmDestRom PduR_RmDestRom[29].RoutingTypeOfRmDestRom PduR_RmDestRom[2].PduLengthHandlingStrategyOfRmDestRom PduR_RmDestRom[2].RmGDestRomIdxOfRmDestRom PduR_RmDestRom[2].RmSrcRomIdxOfRmDestRom PduR_RmDestRom[2].RoutingTypeOfRmDestRom /end REF_MEASUREMENT
/end GROUP
/end MODULE
/end PROJECT
