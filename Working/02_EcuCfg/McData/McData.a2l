ASAP2_VERSION 1 71
/begin PROJECT MICROSAR ""
/begin MODULE CPP ""
/begin MOD_COMMON "" BYTE_ORDER MSB_LAST ALIGNMENT_BYTE 1 ALIGNMENT_WORD 2 ALIGNMENT_LONG 4 ALIGNMENT_FLOAT16_IEEE 2 ALIGNMENT_FLOAT32_IEEE 4 ALIGNMENT_FLOAT64_IEEE 8 ALIGNMENT_INT64 8 /end MOD_COMMON
/begin MEASUREMENT Com_TxModeInfo[27].MinimumDelayOfTxModeInfo "" UBYTE NO_COMPU_METHOD 0 0 0 255 ECU_ADDRESS 0x0 /end MEASUREMENT
/begin MEASUREMENT Com_TxModeInfo[27].TxModeTrueIdxOfTxModeInfo "" UBYTE NO_COMPU_METHOD 0 0 0 255 ECU_ADDRESS 0x0 /end MEASUREMENT
/begin MEASUREMENT Com_TxModeInfo[27].TxSigInfoFilterInitValueIndEndIdxOfTxModeInfo "" UBYTE Com_TxSigInfoFilterInitValueIndEndIdxOfTxModeInfoType 0 0 0 255 ECU_ADDRESS 0x0 /end MEASUREMENT
/begin MEASUREMENT Com_TxModeInfo[27].TxSigInfoFilterInitValueIndStartIdxOfTxModeInfo "" UBYTE Com_TxSigInfoFilterInitValueIndStartIdxOfTxModeInfoType 0 0 0 255 ECU_ADDRESS 0x0 /end MEASUREMENT
/begin MEASUREMENT Com_TxModeInfo[28].InitModeOfTxModeInfo "" UBYTE Com_InitModeOfTxModeInfoType 0 0 0 1 ECU_ADDRESS 0x0 /end MEASUREMENT
/begin MEASUREMENT Com_TxModeInfo[28].MinimumDelayOfTxModeInfo "" UBYTE NO_COMPU_METHOD 0 0 0 255 ECU_ADDRESS 0x0 /end MEASUREMENT
/begin MEASUREMENT Com_TxModeInfo[28].TxModeTrueIdxOfTxModeInfo "" UBYTE NO_COMPU_METHOD 0 0 0 255 ECU_ADDRESS 0x0 /end MEASUREMENT
/begin MEASUREMENT Com_TxModeInfo[28].TxSigInfoFilterInitValueIndEndIdxOfTxModeInfo "" UBYTE Com_TxSigInfoFilterInitValueIndEndIdxOfTxModeInfoType 0 0 0 255 ECU_ADDRESS 0x0 /end MEASUREMENT
/begin MEASUREMENT Com_TxModeInfo[28].TxSigInfoFilterInitValueIndStartIdxOfTxModeInfo "" UBYTE Com_TxSigInfoFilterInitValueIndStartIdxOfTxModeInfoType 0 0 0 255 ECU_ADDRESS 0x0 /end MEASUREMENT
/begin MEASUREMENT Com_TxModeInfo[29].InitModeOfTxModeInfo "" UBYTE Com_InitModeOfTxModeInfoType 0 0 0 1 ECU_ADDRESS 0x0 /end MEASUREMENT
/begin MEASUREMENT Com_TxModeInfo[29].MinimumDelayOfTxModeInfo "" UBYTE NO_COMPU_METHOD 0 0 0 255 ECU_ADDRESS 0x0 /end MEASUREMENT
/begin MEASUREMENT Com_TxModeInfo[29].TxModeTrueIdxOfTxModeInfo "" UBYTE NO_COMPU_METHOD 0 0 0 255 ECU_ADDRESS 0x0 /end MEASUREMENT
/begin MEASUREMENT Com_TxModeInfo[29].TxSigInfoFilterInitValueIndEndIdxOfTxModeInfo "" UBYTE Com_TxSigInfoFilterInitValueIndEndIdxOfTxModeInfoType 0 0 0 255 ECU_ADDRESS 0x0 /end MEASUREMENT
/begin MEASUREMENT Com_TxModeInfo[29].TxSigInfoFilterInitValueIndStartIdxOfTxModeInfo "" UBYTE Com_TxSigInfoFilterInitValueIndStartIdxOfTxModeInfoType 0 0 0 255 ECU_ADDRESS 0x0 /end MEASUREMENT
/begin MEASUREMENT Com_TxModeInfo[2].InitModeOfTxModeInfo "" UBYTE Com_InitModeOfTxModeInfoType 0 0 0 1 ECU_ADDRESS 0x0 /end MEASUREMENT
/begin MEASUREMENT Com_TxModeInfo[2].MinimumDelayOfTxModeInfo "" UBYTE NO_COMPU_METHOD 0 0 0 255 ECU_ADDRESS 0x0 /end MEASUREMENT
/begin MEASUREMENT Com_TxModeInfo[2].TxModeTrueIdxOfTxModeInfo "" UBYTE NO_COMPU_METHOD 0 0 0 255 ECU_ADDRESS 0x0 /end MEASUREMENT
/begin MEASUREMENT Com_TxModeInfo[2].TxSigInfoFilterInitValueIndEndIdxOfTxModeInfo "" UBYTE Com_TxSigInfoFilterInitValueIndEndIdxOfTxModeInfoType 0 0 0 255 ECU_ADDRESS 0x0 /end MEASUREMENT
/begin MEASUREMENT Com_TxModeInfo[2].TxSigInfoFilterInitValueIndStartIdxOfTxModeInfo "" UBYTE Com_TxSigInfoFilterInitValueIndStartIdxOfTxModeInfoType 0 0 0 255 ECU_ADDRESS 0x0 /end MEASUREMENT
/begin MEASUREMENT Com_TxModeInfo[30].InitModeOfTxModeInfo "" UBYTE Com_InitModeOfTxModeInfoType 0 0 0 1 ECU_ADDRESS 0x0 /end MEASUREMENT
/begin MEASUREMENT Com_TxModeInfo[30].MinimumDelayOfTxModeInfo "" UBYTE NO_COMPU_METHOD 0 0 0 255 ECU_ADDRESS 0x0 /end MEASUREMENT
/begin MEASUREMENT Com_TxModeInfo[30].TxModeTrueIdxOfTxModeInfo "" UBYTE NO_COMPU_METHOD 0 0 0 255 ECU_ADDRESS 0x0 /end MEASUREMENT
/begin MEASUREMENT Com_TxModeInfo[30].TxSigInfoFilterInitValueIndEndIdxOfTxModeInfo "" UBYTE Com_TxSigInfoFilterInitValueIndEndIdxOfTxModeInfoType 0 0 0 255 ECU_ADDRESS 0x0 /end MEASUREMENT
/begin MEASUREMENT Com_TxModeInfo[30].TxSigInfoFilterInitValueIndStartIdxOfTxModeInfo "" UBYTE Com_TxSigInfoFilterInitValueIndStartIdxOfTxModeInfoType 0 0 0 255 ECU_ADDRESS 0x0 /end MEASUREMENT
/begin MEASUREMENT Com_TxModeInfo[31].InitModeOfTxModeInfo "" UBYTE Com_InitModeOfTxModeInfoType 0 0 0 1 ECU_ADDRESS 0x0 /end MEASUREMENT
/begin MEASUREMENT Com_TxModeInfo[31].MinimumDelayOfTxModeInfo "" UBYTE NO_COMPU_METHOD 0 0 0 255 ECU_ADDRESS 0x0 /end MEASUREMENT
/begin MEASUREMENT Com_TxModeInfo[31].TxModeTrueIdxOfTxModeInfo "" UBYTE NO_COMPU_METHOD 0 0 0 255 ECU_ADDRESS 0x0 /end MEASUREMENT
/begin MEASUREMENT Com_TxModeInfo[31].TxSigInfoFilterInitValueIndEndIdxOfTxModeInfo "" UBYTE Com_TxSigInfoFilterInitValueIndEndIdxOfTxModeInfoType 0 0 0 255 ECU_ADDRESS 0x0 /end MEASUREMENT
/begin MEASUREMENT Com_TxModeInfo[31].TxSigInfoFilterInitValueIndStartIdxOfTxModeInfo "" UBYTE Com_TxSigInfoFilterInitValueIndStartIdxOfTxModeInfoType 0 0 0 255 ECU_ADDRESS 0x0 /end MEASUREMENT
/begin MEASUREMENT Com_TxModeInfo[3].InitModeOfTxModeInfo "" UBYTE Com_InitModeOfTxModeInfoType 0 0 0 1 ECU_ADDRESS 0x0 /end MEASUREMENT
/begin MEASUREMENT Com_TxModeInfo[3].MinimumDelayOfTxModeInfo "" UBYTE NO_COMPU_METHOD 0 0 0 255 ECU_ADDRESS 0x0 /end MEASUREMENT
/begin MEASUREMENT Com_TxModeInfo[3].TxModeTrueIdxOfTxModeInfo "" UBYTE NO_COMPU_METHOD 0 0 0 255 ECU_ADDRESS 0x0 /end MEASUREMENT
/begin MEASUREMENT Com_TxModeInfo[3].TxSigInfoFilterInitValueIndEndIdxOfTxModeInfo "" UBYTE Com_TxSigInfoFilterInitValueIndEndIdxOfTxModeInfoType 0 0 0 255 ECU_ADDRESS 0x0 /end MEASUREMENT
/begin MEASUREMENT Com_TxModeInfo[3].TxSigInfoFilterInitValueIndStartIdxOfTxModeInfo "" UBYTE Com_TxSigInfoFilterInitValueIndStartIdxOfTxModeInfoType 0 0 0 255 ECU_ADDRESS 0x0 /end MEASUREMENT
/begin MEASUREMENT Com_TxModeInfo[4].InitModeOfTxModeInfo "" UBYTE Com_InitModeOfTxModeInfoType 0 0 0 1 ECU_ADDRESS 0x0 /end MEASUREMENT
/begin MEASUREMENT Com_TxModeInfo[4].MinimumDelayOfTxModeInfo "" UBYTE NO_COMPU_METHOD 0 0 0 255 ECU_ADDRESS 0x0 /end MEASUREMENT
/begin MEASUREMENT Com_TxModeInfo[4].TxModeTrueIdxOfTxModeInfo "" UBYTE NO_COMPU_METHOD 0 0 0 255 ECU_ADDRESS 0x0 /end MEASUREMENT
/begin MEASUREMENT Com_TxModeInfo[4].TxSigInfoFilterInitValueIndEndIdxOfTxModeInfo "" UBYTE Com_TxSigInfoFilterInitValueIndEndIdxOfTxModeInfoType 0 0 0 255 ECU_ADDRESS 0x0 /end MEASUREMENT
/begin MEASUREMENT Com_TxModeInfo[4].TxSigInfoFilterInitValueIndStartIdxOfTxModeInfo "" UBYTE Com_TxSigInfoFilterInitValueIndStartIdxOfTxModeInfoType 0 0 0 255 ECU_ADDRESS 0x0 /end MEASUREMENT
/begin MEASUREMENT Com_TxModeInfo[5].InitModeOfTxModeInfo "" UBYTE Com_InitModeOfTxModeInfoType 0 0 0 1 ECU_ADDRESS 0x0 /end MEASUREMENT
/begin MEASUREMENT Com_TxModeInfo[5].MinimumDelayOfTxModeInfo "" UBYTE NO_COMPU_METHOD 0 0 0 255 ECU_ADDRESS 0x0 /end MEASUREMENT
/begin MEASUREMENT Com_TxModeInfo[5].TxModeTrueIdxOfTxModeInfo "" UBYTE NO_COMPU_METHOD 0 0 0 255 ECU_ADDRESS 0x0 /end MEASUREMENT
/begin MEASUREMENT Com_TxModeInfo[5].TxSigInfoFilterInitValueIndEndIdxOfTxModeInfo "" UBYTE Com_TxSigInfoFilterInitValueIndEndIdxOfTxModeInfoType 0 0 0 255 ECU_ADDRESS 0x0 /end MEASUREMENT
/begin MEASUREMENT Com_TxModeInfo[5].TxSigInfoFilterInitValueIndStartIdxOfTxModeInfo "" UBYTE Com_TxSigInfoFilterInitValueIndStartIdxOfTxModeInfoType 0 0 0 255 ECU_ADDRESS 0x0 /end MEASUREMENT
/begin MEASUREMENT Com_TxModeInfo[6].InitModeOfTxModeInfo "" UBYTE Com_InitModeOfTxModeInfoType 0 0 0 1 ECU_ADDRESS 0x0 /end MEASUREMENT
/begin MEASUREMENT Com_TxModeInfo[6].MinimumDelayOfTxModeInfo "" UBYTE NO_COMPU_METHOD 0 0 0 255 ECU_ADDRESS 0x0 /end MEASUREMENT
/begin MEASUREMENT Com_TxModeInfo[6].TxModeTrueIdxOfTxModeInfo "" UBYTE NO_COMPU_METHOD 0 0 0 255 ECU_ADDRESS 0x0 /end MEASUREMENT
/begin MEASUREMENT Com_TxModeInfo[6].TxSigInfoFilterInitValueIndEndIdxOfTxModeInfo "" UBYTE Com_TxSigInfoFilterInitValueIndEndIdxOfTxModeInfoType 0 0 0 255 ECU_ADDRESS 0x0 /end MEASUREMENT
/begin MEASUREMENT Com_TxModeInfo[6].TxSigInfoFilterInitValueIndStartIdxOfTxModeInfo "" UBYTE Com_TxSigInfoFilterInitValueIndStartIdxOfTxModeInfoType 0 0 0 255 ECU_ADDRESS 0x0 /end MEASUREMENT
/begin MEASUREMENT Com_TxModeInfo[7].InitModeOfTxModeInfo "" UBYTE Com_InitModeOfTxModeInfoType 0 0 0 1 ECU_ADDRESS 0x0 /end MEASUREMENT
/begin MEASUREMENT Com_TxModeInfo[7].MinimumDelayOfTxModeInfo "" UBYTE NO_COMPU_METHOD 0 0 0 255 ECU_ADDRESS 0x0 /end MEASUREMENT
/begin MEASUREMENT Com_TxModeInfo[7].TxModeTrueIdxOfTxModeInfo "" UBYTE NO_COMPU_METHOD 0 0 0 255 ECU_ADDRESS 0x0 /end MEASUREMENT
/begin MEASUREMENT Com_TxModeInfo[7].TxSigInfoFilterInitValueIndEndIdxOfTxModeInfo "" UBYTE Com_TxSigInfoFilterInitValueIndEndIdxOfTxModeInfoType 0 0 0 255 ECU_ADDRESS 0x0 /end MEASUREMENT
/begin MEASUREMENT Com_TxModeInfo[7].TxSigInfoFilterInitValueIndStartIdxOfTxModeInfo "" UBYTE Com_TxSigInfoFilterInitValueIndStartIdxOfTxModeInfoType 0 0 0 255 ECU_ADDRESS 0x0 /end MEASUREMENT
/begin MEASUREMENT Com_TxModeInfo[8].InitModeOfTxModeInfo "" UBYTE Com_InitModeOfTxModeInfoType 0 0 0 1 ECU_ADDRESS 0x0 /end MEASUREMENT
/begin MEASUREMENT Com_TxModeInfo[8].MinimumDelayOfTxModeInfo "" UBYTE NO_COMPU_METHOD 0 0 0 255 ECU_ADDRESS 0x0 /end MEASUREMENT
/begin MEASUREMENT Com_TxModeInfo[8].TxModeTrueIdxOfTxModeInfo "" UBYTE NO_COMPU_METHOD 0 0 0 255 ECU_ADDRESS 0x0 /end MEASUREMENT
/begin MEASUREMENT Com_TxModeInfo[8].TxSigInfoFilterInitValueIndEndIdxOfTxModeInfo "" UBYTE Com_TxSigInfoFilterInitValueIndEndIdxOfTxModeInfoType 0 0 0 255 ECU_ADDRESS 0x0 /end MEASUREMENT
/begin MEASUREMENT Com_TxModeInfo[8].TxSigInfoFilterInitValueIndStartIdxOfTxModeInfo "" UBYTE Com_TxSigInfoFilterInitValueIndStartIdxOfTxModeInfoType 0 0 0 255 ECU_ADDRESS 0x0 /end MEASUREMENT
/begin MEASUREMENT Com_TxModeInfo[9].InitModeOfTxModeInfo "" UBYTE Com_InitModeOfTxModeInfoType 0 0 0 1 ECU_ADDRESS 0x0 /end MEASUREMENT
/begin MEASUREMENT Com_TxModeInfo[9].MinimumDelayOfTxModeInfo "" UBYTE NO_COMPU_METHOD 0 0 0 255 ECU_ADDRESS 0x0 /end MEASUREMENT
/begin MEASUREMENT Com_TxModeInfo[9].TxModeTrueIdxOfTxModeInfo "" UBYTE NO_COMPU_METHOD 0 0 0 255 ECU_ADDRESS 0x0 /end MEASUREMENT
/begin MEASUREMENT Com_TxModeInfo[9].TxSigInfoFilterInitValueIndEndIdxOfTxModeInfo "" UBYTE Com_TxSigInfoFilterInitValueIndEndIdxOfTxModeInfoType 0 0 0 255 ECU_ADDRESS 0x0 /end MEASUREMENT
/begin MEASUREMENT Com_TxModeInfo[9].TxSigInfoFilterInitValueIndStartIdxOfTxModeInfo "" UBYTE Com_TxSigInfoFilterInitValueIndStartIdxOfTxModeInfoType 0 0 0 255 ECU_ADDRESS 0x0 /end MEASUREMENT
/begin MEASUREMENT Com_TxModeTrue[0].DirectOfTxModeTrue "" UBYTE Com_DirectOfTxModeTrueType 0 0 0 1 ECU_ADDRESS 0x0 /end MEASUREMENT
/begin MEASUREMENT Com_TxModeTrue[0].TimePeriodOfTxModeTrue "" UBYTE NO_COMPU_METHOD 0 0 0 255 ECU_ADDRESS 0x0 /end MEASUREMENT
/begin MEASUREMENT Com_TxModeTrue[1].DirectOfTxModeTrue "" UBYTE Com_DirectOfTxModeTrueType 0 0 0 1 ECU_ADDRESS 0x0 /end MEASUREMENT
/begin MEASUREMENT Com_TxModeTrue[1].TimePeriodOfTxModeTrue "" UBYTE NO_COMPU_METHOD 0 0 0 255 ECU_ADDRESS 0x0 /end MEASUREMENT
/begin MEASUREMENT Com_TxModeTrue[2].DirectOfTxModeTrue "" UBYTE Com_DirectOfTxModeTrueType 0 0 0 1 ECU_ADDRESS 0x0 /end MEASUREMENT
/begin MEASUREMENT Com_TxModeTrue[2].TimePeriodOfTxModeTrue "" UBYTE NO_COMPU_METHOD 0 0 0 255 ECU_ADDRESS 0x0 /end MEASUREMENT
/begin MEASUREMENT Com_TxModeTrue[3].DirectOfTxModeTrue "" UBYTE Com_DirectOfTxModeTrueType 0 0 0 1 ECU_ADDRESS 0x0 /end MEASUREMENT
/begin MEASUREMENT Com_TxModeTrue[3].TimePeriodOfTxModeTrue "" UBYTE NO_COMPU_METHOD 0 0 0 255 ECU_ADDRESS 0x0 /end MEASUREMENT
/begin MEASUREMENT Com_TxModeTrue[4].DirectOfTxModeTrue "" UBYTE Com_DirectOfTxModeTrueType 0 0 0 1 ECU_ADDRESS 0x0 /end MEASUREMENT
/begin MEASUREMENT Com_TxModeTrue[4].TimePeriodOfTxModeTrue "" UBYTE NO_COMPU_METHOD 0 0 0 255 ECU_ADDRESS 0x0 /end MEASUREMENT
/begin MEASUREMENT Com_TxModeTrue[5].DirectOfTxModeTrue "" UBYTE Com_DirectOfTxModeTrueType 0 0 0 1 ECU_ADDRESS 0x0 /end MEASUREMENT
/begin MEASUREMENT Com_TxModeTrue[5].TimePeriodOfTxModeTrue "" UBYTE NO_COMPU_METHOD 0 0 0 255 ECU_ADDRESS 0x0 /end MEASUREMENT
/begin MEASUREMENT Com_TxModeTrue[6].DirectOfTxModeTrue "" UBYTE Com_DirectOfTxModeTrueType 0 0 0 1 ECU_ADDRESS 0x0 /end MEASUREMENT
/begin MEASUREMENT Com_TxModeTrue[6].TimePeriodOfTxModeTrue "" UBYTE NO_COMPU_METHOD 0 0 0 255 ECU_ADDRESS 0x0 /end MEASUREMENT
/begin MEASUREMENT Com_TxModeTrue[7].DirectOfTxModeTrue "" UBYTE Com_DirectOfTxModeTrueType 0 0 0 1 ECU_ADDRESS 0x0 /end MEASUREMENT
/begin MEASUREMENT Com_TxModeTrue[7].TimePeriodOfTxModeTrue "" UBYTE NO_COMPU_METHOD 0 0 0 255 ECU_ADDRESS 0x0 /end MEASUREMENT
/begin MEASUREMENT Com_TxModeTrue[8].DirectOfTxModeTrue "" UBYTE Com_DirectOfTxModeTrueType 0 0 0 1 ECU_ADDRESS 0x0 /end MEASUREMENT
/begin MEASUREMENT Com_TxModeTrue[8].TimePeriodOfTxModeTrue "" UBYTE NO_COMPU_METHOD 0 0 0 255 ECU_ADDRESS 0x0 /end MEASUREMENT
/begin MEASUREMENT Com_TxModeTrue[9].DirectOfTxModeTrue "" UBYTE Com_DirectOfTxModeTrueType 0 0 0 1 ECU_ADDRESS 0x0 /end MEASUREMENT
/begin MEASUREMENT Com_TxModeTrue[9].TimePeriodOfTxModeTrue "" UBYTE NO_COMPU_METHOD 0 0 0 255 ECU_ADDRESS 0x0 /end MEASUREMENT
/begin MEASUREMENT Com_TxPduGrpActive "Tx I-PDU based state (started/stopped) of the corresponding I-PDU-Group." UBYTE Com_TxPduGrpActiveType 0 0 0 1 ECU_ADDRESS 0x0 MATRIX_DIM 32 /end MEASUREMENT
/begin MEASUREMENT Com_TxPduInfoInd "the indexes of the 1:1 sorted relation pointing to Com_TxPduInfo" UBYTE NO_COMPU_METHOD 0 0 0 255 ECU_ADDRESS 0x0 MATRIX_DIM 55 /end MEASUREMENT
/begin MEASUREMENT Com_TxPduInfo[0].CbkTxAckDefFuncPtrIndEndIdxOfTxPduInfo "" UBYTE Com_CbkTxAckDefFuncPtrIndEndIdxOfTxPduInfoType 0 0 0 255 ECU_ADDRESS 0x0 /end MEASUREMENT
/begin MEASUREMENT Com_TxPduInfo[0].CbkTxAckDefFuncPtrIndStartIdxOfTxPduInfo "" UBYTE Com_CbkTxAckDefFuncPtrIndStartIdxOfTxPduInfoType 0 0 0 255 ECU_ADDRESS 0x0 /end MEASUREMENT
/begin MEASUREMENT Com_TxPduInfo[0].ExternalIdOfTxPduInfo "" UBYTE NO_COMPU_METHOD 0 0 0 255 ECU_ADDRESS 0x0 /end MEASUREMENT
/begin MEASUREMENT Com_TxPduInfo[0].IPduGroupInfoOfTxPduInfoIndEndIdxOfTxPduInfo "" UBYTE Com_IPduGroupInfoOfTxPduInfoIndEndIdxOfTxPduInfoType 0 0 0 255 ECU_ADDRESS 0x0 /end MEASUREMENT
/begin MEASUREMENT Com_TxPduInfo[0].IPduGroupInfoOfTxPduInfoIndStartIdxOfTxPduInfo "" UBYTE Com_IPduGroupInfoOfTxPduInfoIndStartIdxOfTxPduInfoType 0 0 0 255 ECU_ADDRESS 0x0 /end MEASUREMENT
/begin MEASUREMENT Com_TxPduInfo[0].PartitionsTxStructIdxOfTxPduInfo "" UBYTE NO_COMPU_METHOD 0 0 0 255 ECU_ADDRESS 0x0 /end MEASUREMENT
/begin MEASUREMENT Com_TxPduInfo[0].TxBufferLengthOfTxPduInfo "" UBYTE NO_COMPU_METHOD 0 0 0 255 ECU_ADDRESS 0x0 /end MEASUREMENT
/begin MEASUREMENT Com_TxPduInfo[0].TxPduCalloutFuncPtrIdxOfTxPduInfo "" UBYTE Com_TxPduCalloutFuncPtrIdxOfTxPduInfoType 0 0 0 255 ECU_ADDRESS 0x0 /end MEASUREMENT
/begin MEASUREMENT Com_TxPduInfo[0].TxPduInitValueEndIdxOfTxPduInfo "" UWORD Com_TxPduInitValueEndIdxOfTxPduInfoType 0 0 0 65535 ECU_ADDRESS 0x0 /end MEASUREMENT
/begin MEASUREMENT Com_TxPduInfo[0].TxPduInitValueStartIdxOfTxPduInfo "" UWORD Com_TxPduInitValueStartIdxOfTxPduInfoType 0 0 0 65535 ECU_ADDRESS 0x0 /end MEASUREMENT
/begin MEASUREMENT Com_TxPduInfo[0].TxSigGrpInfoIndEndIdxOfTxPduInfo "" UBYTE Com_TxSigGrpInfoIndEndIdxOfTxPduInfoType 0 0 0 255 ECU_ADDRESS 0x0 /end MEASUREMENT
/begin MEASUREMENT Com_TxPduInfo[0].TxSigGrpInfoIndStartIdxOfTxPduInfo "" UBYTE Com_TxSigGrpInfoIndStartIdxOfTxPduInfoType 0 0 0 255 ECU_ADDRESS 0x0 /end MEASUREMENT
/begin MEASUREMENT Com_TxPduInfo[0].TxTOutInfoIdxOfTxPduInfo "" UBYTE Com_TxTOutInfoIdxOfTxPduInfoType 0 0 0 255 ECU_ADDRESS 0x0 /end MEASUREMENT
/begin MEASUREMENT Com_TxPduInfo[10].CbkTxAckDefFuncPtrIndEndIdxOfTxPduInfo "" UBYTE Com_CbkTxAckDefFuncPtrIndEndIdxOfTxPduInfoType 0 0 0 255 ECU_ADDRESS 0x0 /end MEASUREMENT
/begin MEASUREMENT Com_TxPduInfo[10].CbkTxAckDefFuncPtrIndStartIdxOfTxPduInfo "" UBYTE Com_CbkTxAckDefFuncPtrIndStartIdxOfTxPduInfoType 0 0 0 255 ECU_ADDRESS 0x0 /end MEASUREMENT
/begin MEASUREMENT Com_TxPduInfo[10].ExternalIdOfTxPduInfo "" UBYTE NO_COMPU_METHOD 0 0 0 255 ECU_ADDRESS 0x0 /end MEASUREMENT
/begin MEASUREMENT Com_TxPduInfo[10].IPduGroupInfoOfTxPduInfoIndEndIdxOfTxPduInfo "" UBYTE Com_IPduGroupInfoOfTxPduInfoIndEndIdxOfTxPduInfoType 0 0 0 255 ECU_ADDRESS 0x0 /end MEASUREMENT
/begin MEASUREMENT Com_TxPduInfo[10].IPduGroupInfoOfTxPduInfoIndStartIdxOfTxPduInfo "" UBYTE Com_IPduGroupInfoOfTxPduInfoIndStartIdxOfTxPduInfoType 0 0 0 255 ECU_ADDRESS 0x0 /end MEASUREMENT
/begin MEASUREMENT Com_TxPduInfo[10].PartitionsTxStructIdxOfTxPduInfo "" UBYTE NO_COMPU_METHOD 0 0 0 255 ECU_ADDRESS 0x0 /end MEASUREMENT
/begin MEASUREMENT Com_TxPduInfo[10].TxBufferLengthOfTxPduInfo "" UBYTE NO_COMPU_METHOD 0 0 0 255 ECU_ADDRESS 0x0 /end MEASUREMENT
/begin MEASUREMENT Com_TxPduInfo[10].TxPduCalloutFuncPtrIdxOfTxPduInfo "" UBYTE Com_TxPduCalloutFuncPtrIdxOfTxPduInfoType 0 0 0 255 ECU_ADDRESS 0x0 /end MEASUREMENT
/begin MEASUREMENT Com_TxPduInfo[10].TxPduInitValueEndIdxOfTxPduInfo "" UWORD Com_TxPduInitValueEndIdxOfTxPduInfoType 0 0 0 65535 ECU_ADDRESS 0x0 /end MEASUREMENT
/begin MEASUREMENT Com_TxPduInfo[10].TxPduInitValueStartIdxOfTxPduInfo "" UWORD Com_TxPduInitValueStartIdxOfTxPduInfoType 0 0 0 65535 ECU_ADDRESS 0x0 /end MEASUREMENT
/begin MEASUREMENT Com_TxPduInfo[10].TxSigGrpInfoIndEndIdxOfTxPduInfo "" UBYTE Com_TxSigGrpInfoIndEndIdxOfTxPduInfoType 0 0 0 255 ECU_ADDRESS 0x0 /end MEASUREMENT
/begin MEASUREMENT Com_TxPduInfo[10].TxSigGrpInfoIndStartIdxOfTxPduInfo "" UBYTE Com_TxSigGrpInfoIndStartIdxOfTxPduInfoType 0 0 0 255 ECU_ADDRESS 0x0 /end MEASUREMENT
/begin MEASUREMENT Com_TxPduInfo[10].TxTOutInfoIdxOfTxPduInfo "" UBYTE Com_TxTOutInfoIdxOfTxPduInfoType 0 0 0 255 ECU_ADDRESS 0x0 /end MEASUREMENT
/begin MEASUREMENT Com_TxPduInfo[11].CbkTxAckDefFuncPtrIndEndIdxOfTxPduInfo "" UBYTE Com_CbkTxAckDefFuncPtrIndEndIdxOfTxPduInfoType 0 0 0 255 ECU_ADDRESS 0x0 /end MEASUREMENT
/begin MEASUREMENT Com_TxPduInfo[11].CbkTxAckDefFuncPtrIndStartIdxOfTxPduInfo "" UBYTE Com_CbkTxAckDefFuncPtrIndStartIdxOfTxPduInfoType 0 0 0 255 ECU_ADDRESS 0x0 /end MEASUREMENT
/begin MEASUREMENT Com_TxPduInfo[11].ExternalIdOfTxPduInfo "" UBYTE NO_COMPU_METHOD 0 0 0 255 ECU_ADDRESS 0x0 /end MEASUREMENT
/begin MEASUREMENT Com_TxPduInfo[11].IPduGroupInfoOfTxPduInfoIndEndIdxOfTxPduInfo "" UBYTE Com_IPduGroupInfoOfTxPduInfoIndEndIdxOfTxPduInfoType 0 0 0 255 ECU_ADDRESS 0x0 /end MEASUREMENT
/begin MEASUREMENT Com_TxPduInfo[11].IPduGroupInfoOfTxPduInfoIndStartIdxOfTxPduInfo "" UBYTE Com_IPduGroupInfoOfTxPduInfoIndStartIdxOfTxPduInfoType 0 0 0 255 ECU_ADDRESS 0x0 /end MEASUREMENT
/begin MEASUREMENT Com_TxPduInfo[11].PartitionsTxStructIdxOfTxPduInfo "" UBYTE NO_COMPU_METHOD 0 0 0 255 ECU_ADDRESS 0x0 /end MEASUREMENT
/begin MEASUREMENT Com_TxPduInfo[11].TxBufferLengthOfTxPduInfo "" UBYTE NO_COMPU_METHOD 0 0 0 255 ECU_ADDRESS 0x0 /end MEASUREMENT
/begin MEASUREMENT Com_TxPduInfo[11].TxPduCalloutFuncPtrIdxOfTxPduInfo "" UBYTE Com_TxPduCalloutFuncPtrIdxOfTxPduInfoType 0 0 0 255 ECU_ADDRESS 0x0 /end MEASUREMENT
/begin MEASUREMENT Com_TxPduInfo[11].TxPduInitValueEndIdxOfTxPduInfo "" UWORD Com_TxPduInitValueEndIdxOfTxPduInfoType 0 0 0 65535 ECU_ADDRESS 0x0 /end MEASUREMENT
/begin MEASUREMENT Com_TxPduInfo[11].TxPduInitValueStartIdxOfTxPduInfo "" UWORD Com_TxPduInitValueStartIdxOfTxPduInfoType 0 0 0 65535 ECU_ADDRESS 0x0 /end MEASUREMENT
/begin MEASUREMENT Com_TxPduInfo[11].TxSigGrpInfoIndEndIdxOfTxPduInfo "" UBYTE Com_TxSigGrpInfoIndEndIdxOfTxPduInfoType 0 0 0 255 ECU_ADDRESS 0x0 /end MEASUREMENT
/begin MEASUREMENT Com_TxPduInfo[11].TxSigGrpInfoIndStartIdxOfTxPduInfo "" UBYTE Com_TxSigGrpInfoIndStartIdxOfTxPduInfoType 0 0 0 255 ECU_ADDRESS 0x0 /end MEASUREMENT
/begin MEASUREMENT Com_TxPduInfo[11].TxTOutInfoIdxOfTxPduInfo "" UBYTE Com_TxTOutInfoIdxOfTxPduInfoType 0 0 0 255 ECU_ADDRESS 0x0 /end MEASUREMENT
/begin MEASUREMENT Com_TxPduInfo[12].CbkTxAckDefFuncPtrIndEndIdxOfTxPduInfo "" UBYTE Com_CbkTxAckDefFuncPtrIndEndIdxOfTxPduInfoType 0 0 0 255 ECU_ADDRESS 0x0 /end MEASUREMENT
/begin MEASUREMENT Com_TxPduInfo[12].CbkTxAckDefFuncPtrIndStartIdxOfTxPduInfo "" UBYTE Com_CbkTxAckDefFuncPtrIndStartIdxOfTxPduInfoType 0 0 0 255 ECU_ADDRESS 0x0 /end MEASUREMENT
/begin MEASUREMENT Com_TxPduInfo[12].ExternalIdOfTxPduInfo "" UBYTE NO_COMPU_METHOD 0 0 0 255 ECU_ADDRESS 0x0 /end MEASUREMENT
/begin MEASUREMENT Com_TxPduInfo[12].IPduGroupInfoOfTxPduInfoIndEndIdxOfTxPduInfo "" UBYTE Com_IPduGroupInfoOfTxPduInfoIndEndIdxOfTxPduInfoType 0 0 0 255 ECU_ADDRESS 0x0 /end MEASUREMENT
/begin MEASUREMENT Com_TxPduInfo[12].IPduGroupInfoOfTxPduInfoIndStartIdxOfTxPduInfo "" UBYTE Com_IPduGroupInfoOfTxPduInfoIndStartIdxOfTxPduInfoType 0 0 0 255 ECU_ADDRESS 0x0 /end MEASUREMENT
/begin MEASUREMENT Com_TxPduInfo[12].PartitionsTxStructIdxOfTxPduInfo "" UBYTE NO_COMPU_METHOD 0 0 0 255 ECU_ADDRESS 0x0 /end MEASUREMENT
/begin MEASUREMENT Com_TxPduInfo[12].TxBufferLengthOfTxPduInfo "" UBYTE NO_COMPU_METHOD 0 0 0 255 ECU_ADDRESS 0x0 /end MEASUREMENT
/begin MEASUREMENT Com_TxPduInfo[12].TxPduCalloutFuncPtrIdxOfTxPduInfo "" UBYTE Com_TxPduCalloutFuncPtrIdxOfTxPduInfoType 0 0 0 255 ECU_ADDRESS 0x0 /end MEASUREMENT
/begin MEASUREMENT Com_TxPduInfo[12].TxPduInitValueEndIdxOfTxPduInfo "" UWORD Com_TxPduInitValueEndIdxOfTxPduInfoType 0 0 0 65535 ECU_ADDRESS 0x0 /end MEASUREMENT
/begin MEASUREMENT Com_TxPduInfo[12].TxPduInitValueStartIdxOfTxPduInfo "" UWORD Com_TxPduInitValueStartIdxOfTxPduInfoType 0 0 0 65535 ECU_ADDRESS 0x0 /end MEASUREMENT
/begin MEASUREMENT Com_TxPduInfo[12].TxSigGrpInfoIndEndIdxOfTxPduInfo "" UBYTE Com_TxSigGrpInfoIndEndIdxOfTxPduInfoType 0 0 0 255 ECU_ADDRESS 0x0 /end MEASUREMENT
/begin MEASUREMENT Com_TxPduInfo[12].TxSigGrpInfoIndStartIdxOfTxPduInfo "" UBYTE Com_TxSigGrpInfoIndStartIdxOfTxPduInfoType 0 0 0 255 ECU_ADDRESS 0x0 /end MEASUREMENT
/begin MEASUREMENT Com_TxPduInfo[12].TxTOutInfoIdxOfTxPduInfo "" UBYTE Com_TxTOutInfoIdxOfTxPduInfoType 0 0 0 255 ECU_ADDRESS 0x0 /end MEASUREMENT
/begin MEASUREMENT Com_TxPduInfo[13].CbkTxAckDefFuncPtrIndEndIdxOfTxPduInfo "" UBYTE Com_CbkTxAckDefFuncPtrIndEndIdxOfTxPduInfoType 0 0 0 255 ECU_ADDRESS 0x0 /end MEASUREMENT
/begin MEASUREMENT Com_TxPduInfo[13].CbkTxAckDefFuncPtrIndStartIdxOfTxPduInfo "" UBYTE Com_CbkTxAckDefFuncPtrIndStartIdxOfTxPduInfoType 0 0 0 255 ECU_ADDRESS 0x0 /end MEASUREMENT
/begin MEASUREMENT Com_TxPduInfo[13].ExternalIdOfTxPduInfo "" UBYTE NO_COMPU_METHOD 0 0 0 255 ECU_ADDRESS 0x0 /end MEASUREMENT
/begin MEASUREMENT Com_TxPduInfo[13].IPduGroupInfoOfTxPduInfoIndEndIdxOfTxPduInfo "" UBYTE Com_IPduGroupInfoOfTxPduInfoIndEndIdxOfTxPduInfoType 0 0 0 255 ECU_ADDRESS 0x0 /end MEASUREMENT
/begin MEASUREMENT Com_TxPduInfo[13].IPduGroupInfoOfTxPduInfoIndStartIdxOfTxPduInfo "" UBYTE Com_IPduGroupInfoOfTxPduInfoIndStartIdxOfTxPduInfoType 0 0 0 255 ECU_ADDRESS 0x0 /end MEASUREMENT
/begin MEASUREMENT Com_TxPduInfo[13].PartitionsTxStructIdxOfTxPduInfo "" UBYTE NO_COMPU_METHOD 0 0 0 255 ECU_ADDRESS 0x0 /end MEASUREMENT
/begin MEASUREMENT Com_TxPduInfo[13].TxBufferLengthOfTxPduInfo "" UBYTE NO_COMPU_METHOD 0 0 0 255 ECU_ADDRESS 0x0 /end MEASUREMENT
/begin MEASUREMENT Com_TxPduInfo[13].TxPduCalloutFuncPtrIdxOfTxPduInfo "" UBYTE Com_TxPduCalloutFuncPtrIdxOfTxPduInfoType 0 0 0 255 ECU_ADDRESS 0x0 /end MEASUREMENT
/begin MEASUREMENT Com_TxPduInfo[13].TxPduInitValueEndIdxOfTxPduInfo "" UWORD Com_TxPduInitValueEndIdxOfTxPduInfoType 0 0 0 65535 ECU_ADDRESS 0x0 /end MEASUREMENT
/begin MEASUREMENT Com_TxPduInfo[13].TxPduInitValueStartIdxOfTxPduInfo "" UWORD Com_TxPduInitValueStartIdxOfTxPduInfoType 0 0 0 65535 ECU_ADDRESS 0x0 /end MEASUREMENT
/begin MEASUREMENT Com_TxPduInfo[13].TxSigGrpInfoIndEndIdxOfTxPduInfo "" UBYTE Com_TxSigGrpInfoIndEndIdxOfTxPduInfoType 0 0 0 255 ECU_ADDRESS 0x0 /end MEASUREMENT
/begin MEASUREMENT Com_TxPduInfo[13].TxSigGrpInfoIndStartIdxOfTxPduInfo "" UBYTE Com_TxSigGrpInfoIndStartIdxOfTxPduInfoType 0 0 0 255 ECU_ADDRESS 0x0 /end MEASUREMENT
/begin MEASUREMENT Com_TxPduInfo[13].TxTOutInfoIdxOfTxPduInfo "" UBYTE Com_TxTOutInfoIdxOfTxPduInfoType 0 0 0 255 ECU_ADDRESS 0x0 /end MEASUREMENT
/begin MEASUREMENT Com_TxPduInfo[14].CbkTxAckDefFuncPtrIndEndIdxOfTxPduInfo "" UBYTE Com_CbkTxAckDefFuncPtrIndEndIdxOfTxPduInfoType 0 0 0 255 ECU_ADDRESS 0x0 /end MEASUREMENT
/begin MEASUREMENT Com_TxPduInfo[14].CbkTxAckDefFuncPtrIndStartIdxOfTxPduInfo "" UBYTE Com_CbkTxAckDefFuncPtrIndStartIdxOfTxPduInfoType 0 0 0 255 ECU_ADDRESS 0x0 /end MEASUREMENT
/begin MEASUREMENT Com_TxPduInfo[14].ExternalIdOfTxPduInfo "" UBYTE NO_COMPU_METHOD 0 0 0 255 ECU_ADDRESS 0x0 /end MEASUREMENT
/begin MEASUREMENT Com_TxPduInfo[14].IPduGroupInfoOfTxPduInfoIndEndIdxOfTxPduInfo "" UBYTE Com_IPduGroupInfoOfTxPduInfoIndEndIdxOfTxPduInfoType 0 0 0 255 ECU_ADDRESS 0x0 /end MEASUREMENT
/begin MEASUREMENT Com_TxPduInfo[14].IPduGroupInfoOfTxPduInfoIndStartIdxOfTxPduInfo "" UBYTE Com_IPduGroupInfoOfTxPduInfoIndStartIdxOfTxPduInfoType 0 0 0 255 ECU_ADDRESS 0x0 /end MEASUREMENT
/begin MEASUREMENT Com_TxPduInfo[14].PartitionsTxStructIdxOfTxPduInfo "" UBYTE NO_COMPU_METHOD 0 0 0 255 ECU_ADDRESS 0x0 /end MEASUREMENT
/begin MEASUREMENT Com_TxPduInfo[14].TxBufferLengthOfTxPduInfo "" UBYTE NO_COMPU_METHOD 0 0 0 255 ECU_ADDRESS 0x0 /end MEASUREMENT
/begin MEASUREMENT Com_TxPduInfo[14].TxPduCalloutFuncPtrIdxOfTxPduInfo "" UBYTE Com_TxPduCalloutFuncPtrIdxOfTxPduInfoType 0 0 0 255 ECU_ADDRESS 0x0 /end MEASUREMENT
/begin MEASUREMENT Com_TxPduInfo[14].TxPduInitValueEndIdxOfTxPduInfo "" UWORD Com_TxPduInitValueEndIdxOfTxPduInfoType 0 0 0 65535 ECU_ADDRESS 0x0 /end MEASUREMENT
/begin MEASUREMENT Com_TxPduInfo[14].TxPduInitValueStartIdxOfTxPduInfo "" UWORD Com_TxPduInitValueStartIdxOfTxPduInfoType 0 0 0 65535 ECU_ADDRESS 0x0 /end MEASUREMENT
/begin MEASUREMENT Com_TxPduInfo[14].TxSigGrpInfoIndEndIdxOfTxPduInfo "" UBYTE Com_TxSigGrpInfoIndEndIdxOfTxPduInfoType 0 0 0 255 ECU_ADDRESS 0x0 /end MEASUREMENT
/begin MEASUREMENT Com_TxPduInfo[14].TxSigGrpInfoIndStartIdxOfTxPduInfo "" UBYTE Com_TxSigGrpInfoIndStartIdxOfTxPduInfoType 0 0 0 255 ECU_ADDRESS 0x0 /end MEASUREMENT
/begin MEASUREMENT Com_TxPduInfo[14].TxTOutInfoIdxOfTxPduInfo "" UBYTE Com_TxTOutInfoIdxOfTxPduInfoType 0 0 0 255 ECU_ADDRESS 0x0 /end MEASUREMENT
/begin MEASUREMENT Com_TxPduInfo[15].CbkTxAckDefFuncPtrIndEndIdxOfTxPduInfo "" UBYTE Com_CbkTxAckDefFuncPtrIndEndIdxOfTxPduInfoType 0 0 0 255 ECU_ADDRESS 0x0 /end MEASUREMENT
/begin MEASUREMENT Com_TxPduInfo[15].CbkTxAckDefFuncPtrIndStartIdxOfTxPduInfo "" UBYTE Com_CbkTxAckDefFuncPtrIndStartIdxOfTxPduInfoType 0 0 0 255 ECU_ADDRESS 0x0 /end MEASUREMENT
/begin MEASUREMENT Com_TxPduInfo[15].ExternalIdOfTxPduInfo "" UBYTE NO_COMPU_METHOD 0 0 0 255 ECU_ADDRESS 0x0 /end MEASUREMENT
/begin MEASUREMENT Com_TxPduInfo[15].IPduGroupInfoOfTxPduInfoIndEndIdxOfTxPduInfo "" UBYTE Com_IPduGroupInfoOfTxPduInfoIndEndIdxOfTxPduInfoType 0 0 0 255 ECU_ADDRESS 0x0 /end MEASUREMENT
/begin MEASUREMENT Com_TxPduInfo[15].IPduGroupInfoOfTxPduInfoIndStartIdxOfTxPduInfo "" UBYTE Com_IPduGroupInfoOfTxPduInfoIndStartIdxOfTxPduInfoType 0 0 0 255 ECU_ADDRESS 0x0 /end MEASUREMENT
/begin MEASUREMENT Com_TxPduInfo[15].PartitionsTxStructIdxOfTxPduInfo "" UBYTE NO_COMPU_METHOD 0 0 0 255 ECU_ADDRESS 0x0 /end MEASUREMENT
/begin MEASUREMENT Com_TxPduInfo[15].TxBufferLengthOfTxPduInfo "" UBYTE NO_COMPU_METHOD 0 0 0 255 ECU_ADDRESS 0x0 /end MEASUREMENT
/begin MEASUREMENT Com_TxPduInfo[15].TxPduCalloutFuncPtrIdxOfTxPduInfo "" UBYTE Com_TxPduCalloutFuncPtrIdxOfTxPduInfoType 0 0 0 255 ECU_ADDRESS 0x0 /end MEASUREMENT
/begin MEASUREMENT Com_TxPduInfo[15].TxPduInitValueEndIdxOfTxPduInfo "" UWORD Com_TxPduInitValueEndIdxOfTxPduInfoType 0 0 0 65535 ECU_ADDRESS 0x0 /end MEASUREMENT
/begin MEASUREMENT Com_TxPduInfo[15].TxPduInitValueStartIdxOfTxPduInfo "" UWORD Com_TxPduInitValueStartIdxOfTxPduInfoType 0 0 0 65535 ECU_ADDRESS 0x0 /end MEASUREMENT
/begin MEASUREMENT Com_TxPduInfo[15].TxSigGrpInfoIndEndIdxOfTxPduInfo "" UBYTE Com_TxSigGrpInfoIndEndIdxOfTxPduInfoType 0 0 0 255 ECU_ADDRESS 0x0 /end MEASUREMENT
/begin MEASUREMENT Com_TxPduInfo[15].TxSigGrpInfoIndStartIdxOfTxPduInfo "" UBYTE Com_TxSigGrpInfoIndStartIdxOfTxPduInfoType 0 0 0 255 ECU_ADDRESS 0x0 /end MEASUREMENT
/begin MEASUREMENT Com_TxPduInfo[15].TxTOutInfoIdxOfTxPduInfo "" UBYTE Com_TxTOutInfoIdxOfTxPduInfoType 0 0 0 255 ECU_ADDRESS 0x0 /end MEASUREMENT
/begin MEASUREMENT Com_TxPduInfo[16].CbkTxAckDefFuncPtrIndEndIdxOfTxPduInfo "" UBYTE Com_CbkTxAckDefFuncPtrIndEndIdxOfTxPduInfoType 0 0 0 255 ECU_ADDRESS 0x0 /end MEASUREMENT
/begin MEASUREMENT Com_TxPduInfo[16].CbkTxAckDefFuncPtrIndStartIdxOfTxPduInfo "" UBYTE Com_CbkTxAckDefFuncPtrIndStartIdxOfTxPduInfoType 0 0 0 255 ECU_ADDRESS 0x0 /end MEASUREMENT
/begin MEASUREMENT Com_TxPduInfo[16].ExternalIdOfTxPduInfo "" UBYTE NO_COMPU_METHOD 0 0 0 255 ECU_ADDRESS 0x0 /end MEASUREMENT
/begin MEASUREMENT Com_TxPduInfo[16].IPduGroupInfoOfTxPduInfoIndEndIdxOfTxPduInfo "" UBYTE Com_IPduGroupInfoOfTxPduInfoIndEndIdxOfTxPduInfoType 0 0 0 255 ECU_ADDRESS 0x0 /end MEASUREMENT
/begin MEASUREMENT Com_TxPduInfo[16].IPduGroupInfoOfTxPduInfoIndStartIdxOfTxPduInfo "" UBYTE Com_IPduGroupInfoOfTxPduInfoIndStartIdxOfTxPduInfoType 0 0 0 255 ECU_ADDRESS 0x0 /end MEASUREMENT
/begin MEASUREMENT Com_TxPduInfo[16].PartitionsTxStructIdxOfTxPduInfo "" UBYTE NO_COMPU_METHOD 0 0 0 255 ECU_ADDRESS 0x0 /end MEASUREMENT
/begin MEASUREMENT Com_TxPduInfo[16].TxBufferLengthOfTxPduInfo "" UBYTE NO_COMPU_METHOD 0 0 0 255 ECU_ADDRESS 0x0 /end MEASUREMENT
/begin MEASUREMENT Com_TxPduInfo[16].TxPduCalloutFuncPtrIdxOfTxPduInfo "" UBYTE Com_TxPduCalloutFuncPtrIdxOfTxPduInfoType 0 0 0 255 ECU_ADDRESS 0x0 /end MEASUREMENT
/begin MEASUREMENT Com_TxPduInfo[16].TxPduInitValueEndIdxOfTxPduInfo "" UWORD Com_TxPduInitValueEndIdxOfTxPduInfoType 0 0 0 65535 ECU_ADDRESS 0x0 /end MEASUREMENT
/begin MEASUREMENT Com_TxPduInfo[16].TxPduInitValueStartIdxOfTxPduInfo "" UWORD Com_TxPduInitValueStartIdxOfTxPduInfoType 0 0 0 65535 ECU_ADDRESS 0x0 /end MEASUREMENT
/begin MEASUREMENT Com_TxPduInfo[16].TxSigGrpInfoIndEndIdxOfTxPduInfo "" UBYTE Com_TxSigGrpInfoIndEndIdxOfTxPduInfoType 0 0 0 255 ECU_ADDRESS 0x0 /end MEASUREMENT
/begin MEASUREMENT Com_TxPduInfo[16].TxSigGrpInfoIndStartIdxOfTxPduInfo "" UBYTE Com_TxSigGrpInfoIndStartIdxOfTxPduInfoType 0 0 0 255 ECU_ADDRESS 0x0 /end MEASUREMENT
/begin MEASUREMENT Com_TxPduInfo[16].TxTOutInfoIdxOfTxPduInfo "" UBYTE Com_TxTOutInfoIdxOfTxPduInfoType 0 0 0 255 ECU_ADDRESS 0x0 /end MEASUREMENT
/begin MEASUREMENT Com_TxPduInfo[17].CbkTxAckDefFuncPtrIndEndIdxOfTxPduInfo "" UBYTE Com_CbkTxAckDefFuncPtrIndEndIdxOfTxPduInfoType 0 0 0 255 ECU_ADDRESS 0x0 /end MEASUREMENT
/begin MEASUREMENT Com_TxPduInfo[17].CbkTxAckDefFuncPtrIndStartIdxOfTxPduInfo "" UBYTE Com_CbkTxAckDefFuncPtrIndStartIdxOfTxPduInfoType 0 0 0 255 ECU_ADDRESS 0x0 /end MEASUREMENT
/begin MEASUREMENT Com_TxPduInfo[17].ExternalIdOfTxPduInfo "" UBYTE NO_COMPU_METHOD 0 0 0 255 ECU_ADDRESS 0x0 /end MEASUREMENT
/begin MEASUREMENT Com_TxPduInfo[17].IPduGroupInfoOfTxPduInfoIndEndIdxOfTxPduInfo "" UBYTE Com_IPduGroupInfoOfTxPduInfoIndEndIdxOfTxPduInfoType 0 0 0 255 ECU_ADDRESS 0x0 /end MEASUREMENT
/begin MEASUREMENT Com_TxPduInfo[17].IPduGroupInfoOfTxPduInfoIndStartIdxOfTxPduInfo "" UBYTE Com_IPduGroupInfoOfTxPduInfoIndStartIdxOfTxPduInfoType 0 0 0 255 ECU_ADDRESS 0x0 /end MEASUREMENT
/begin MEASUREMENT Com_TxPduInfo[17].PartitionsTxStructIdxOfTxPduInfo "" UBYTE NO_COMPU_METHOD 0 0 0 255 ECU_ADDRESS 0x0 /end MEASUREMENT
/begin MEASUREMENT Com_TxPduInfo[17].TxBufferLengthOfTxPduInfo "" UBYTE NO_COMPU_METHOD 0 0 0 255 ECU_ADDRESS 0x0 /end MEASUREMENT
/begin MEASUREMENT Com_TxPduInfo[17].TxPduCalloutFuncPtrIdxOfTxPduInfo "" UBYTE Com_TxPduCalloutFuncPtrIdxOfTxPduInfoType 0 0 0 255 ECU_ADDRESS 0x0 /end MEASUREMENT
/begin MEASUREMENT Com_TxPduInfo[17].TxPduInitValueEndIdxOfTxPduInfo "" UWORD Com_TxPduInitValueEndIdxOfTxPduInfoType 0 0 0 65535 ECU_ADDRESS 0x0 /end MEASUREMENT
/begin MEASUREMENT Com_TxPduInfo[17].TxPduInitValueStartIdxOfTxPduInfo "" UWORD Com_TxPduInitValueStartIdxOfTxPduInfoType 0 0 0 65535 ECU_ADDRESS 0x0 /end MEASUREMENT
/begin MEASUREMENT Com_TxPduInfo[17].TxSigGrpInfoIndEndIdxOfTxPduInfo "" UBYTE Com_TxSigGrpInfoIndEndIdxOfTxPduInfoType 0 0 0 255 ECU_ADDRESS 0x0 /end MEASUREMENT
/begin MEASUREMENT Com_TxPduInfo[17].TxSigGrpInfoIndStartIdxOfTxPduInfo "" UBYTE Com_TxSigGrpInfoIndStartIdxOfTxPduInfoType 0 0 0 255 ECU_ADDRESS 0x0 /end MEASUREMENT
/begin MEASUREMENT Com_TxPduInfo[17].TxTOutInfoIdxOfTxPduInfo "" UBYTE Com_TxTOutInfoIdxOfTxPduInfoType 0 0 0 255 ECU_ADDRESS 0x0 /end MEASUREMENT
/begin MEASUREMENT Com_TxPduInfo[18].CbkTxAckDefFuncPtrIndEndIdxOfTxPduInfo "" UBYTE Com_CbkTxAckDefFuncPtrIndEndIdxOfTxPduInfoType 0 0 0 255 ECU_ADDRESS 0x0 /end MEASUREMENT
/begin MEASUREMENT Com_TxPduInfo[18].CbkTxAckDefFuncPtrIndStartIdxOfTxPduInfo "" UBYTE Com_CbkTxAckDefFuncPtrIndStartIdxOfTxPduInfoType 0 0 0 255 ECU_ADDRESS 0x0 /end MEASUREMENT
/begin MEASUREMENT Com_TxPduInfo[18].ExternalIdOfTxPduInfo "" UBYTE NO_COMPU_METHOD 0 0 0 255 ECU_ADDRESS 0x0 /end MEASUREMENT
/begin MEASUREMENT Com_TxPduInfo[18].IPduGroupInfoOfTxPduInfoIndEndIdxOfTxPduInfo "" UBYTE Com_IPduGroupInfoOfTxPduInfoIndEndIdxOfTxPduInfoType 0 0 0 255 ECU_ADDRESS 0x0 /end MEASUREMENT
/begin MEASUREMENT Com_TxPduInfo[18].IPduGroupInfoOfTxPduInfoIndStartIdxOfTxPduInfo "" UBYTE Com_IPduGroupInfoOfTxPduInfoIndStartIdxOfTxPduInfoType 0 0 0 255 ECU_ADDRESS 0x0 /end MEASUREMENT
/begin MEASUREMENT Com_TxPduInfo[18].PartitionsTxStructIdxOfTxPduInfo "" UBYTE NO_COMPU_METHOD 0 0 0 255 ECU_ADDRESS 0x0 /end MEASUREMENT
/begin MEASUREMENT Com_TxPduInfo[18].TxBufferLengthOfTxPduInfo "" UBYTE NO_COMPU_METHOD 0 0 0 255 ECU_ADDRESS 0x0 /end MEASUREMENT
/begin MEASUREMENT Com_TxPduInfo[18].TxPduCalloutFuncPtrIdxOfTxPduInfo "" UBYTE Com_TxPduCalloutFuncPtrIdxOfTxPduInfoType 0 0 0 255 ECU_ADDRESS 0x0 /end MEASUREMENT
/begin MEASUREMENT Com_TxPduInfo[18].TxPduInitValueEndIdxOfTxPduInfo "" UWORD Com_TxPduInitValueEndIdxOfTxPduInfoType 0 0 0 65535 ECU_ADDRESS 0x0 /end MEASUREMENT
/begin MEASUREMENT Com_TxPduInfo[18].TxPduInitValueStartIdxOfTxPduInfo "" UWORD Com_TxPduInitValueStartIdxOfTxPduInfoType 0 0 0 65535 ECU_ADDRESS 0x0 /end MEASUREMENT
/begin MEASUREMENT Com_TxPduInfo[18].TxSigGrpInfoIndEndIdxOfTxPduInfo "" UBYTE Com_TxSigGrpInfoIndEndIdxOfTxPduInfoType 0 0 0 255 ECU_ADDRESS 0x0 /end MEASUREMENT
/begin MEASUREMENT Com_TxPduInfo[18].TxSigGrpInfoIndStartIdxOfTxPduInfo "" UBYTE Com_TxSigGrpInfoIndStartIdxOfTxPduInfoType 0 0 0 255 ECU_ADDRESS 0x0 /end MEASUREMENT
/begin MEASUREMENT Com_TxPduInfo[18].TxTOutInfoIdxOfTxPduInfo "" UBYTE Com_TxTOutInfoIdxOfTxPduInfoType 0 0 0 255 ECU_ADDRESS 0x0 /end MEASUREMENT
/begin MEASUREMENT Com_TxPduInfo[19].CbkTxAckDefFuncPtrIndEndIdxOfTxPduInfo "" UBYTE Com_CbkTxAckDefFuncPtrIndEndIdxOfTxPduInfoType 0 0 0 255 ECU_ADDRESS 0x0 /end MEASUREMENT
/begin MEASUREMENT Com_TxPduInfo[19].CbkTxAckDefFuncPtrIndStartIdxOfTxPduInfo "" UBYTE Com_CbkTxAckDefFuncPtrIndStartIdxOfTxPduInfoType 0 0 0 255 ECU_ADDRESS 0x0 /end MEASUREMENT
/begin MEASUREMENT Com_TxPduInfo[19].ExternalIdOfTxPduInfo "" UBYTE NO_COMPU_METHOD 0 0 0 255 ECU_ADDRESS 0x0 /end MEASUREMENT
/begin MEASUREMENT Com_TxPduInfo[19].IPduGroupInfoOfTxPduInfoIndEndIdxOfTxPduInfo "" UBYTE Com_IPduGroupInfoOfTxPduInfoIndEndIdxOfTxPduInfoType 0 0 0 255 ECU_ADDRESS 0x0 /end MEASUREMENT
/begin MEASUREMENT Com_TxPduInfo[19].IPduGroupInfoOfTxPduInfoIndStartIdxOfTxPduInfo "" UBYTE Com_IPduGroupInfoOfTxPduInfoIndStartIdxOfTxPduInfoType 0 0 0 255 ECU_ADDRESS 0x0 /end MEASUREMENT
/begin MEASUREMENT Com_TxPduInfo[19].PartitionsTxStructIdxOfTxPduInfo "" UBYTE NO_COMPU_METHOD 0 0 0 255 ECU_ADDRESS 0x0 /end MEASUREMENT
/begin MEASUREMENT Com_TxPduInfo[19].TxBufferLengthOfTxPduInfo "" UBYTE NO_COMPU_METHOD 0 0 0 255 ECU_ADDRESS 0x0 /end MEASUREMENT
/begin MEASUREMENT Com_TxPduInfo[19].TxPduCalloutFuncPtrIdxOfTxPduInfo "" UBYTE Com_TxPduCalloutFuncPtrIdxOfTxPduInfoType 0 0 0 255 ECU_ADDRESS 0x0 /end MEASUREMENT
/begin MEASUREMENT Com_TxPduInfo[19].TxPduInitValueEndIdxOfTxPduInfo "" UWORD Com_TxPduInitValueEndIdxOfTxPduInfoType 0 0 0 65535 ECU_ADDRESS 0x0 /end MEASUREMENT
/begin MEASUREMENT Com_TxPduInfo[19].TxPduInitValueStartIdxOfTxPduInfo "" UWORD Com_TxPduInitValueStartIdxOfTxPduInfoType 0 0 0 65535 ECU_ADDRESS 0x0 /end MEASUREMENT
/begin MEASUREMENT Com_TxPduInfo[19].TxSigGrpInfoIndEndIdxOfTxPduInfo "" UBYTE Com_TxSigGrpInfoIndEndIdxOfTxPduInfoType 0 0 0 255 ECU_ADDRESS 0x0 /end MEASUREMENT
/begin MEASUREMENT Com_TxPduInfo[19].TxSigGrpInfoIndStartIdxOfTxPduInfo "" UBYTE Com_TxSigGrpInfoIndStartIdxOfTxPduInfoType 0 0 0 255 ECU_ADDRESS 0x0 /end MEASUREMENT
/begin MEASUREMENT Com_TxPduInfo[19].TxTOutInfoIdxOfTxPduInfo "" UBYTE Com_TxTOutInfoIdxOfTxPduInfoType 0 0 0 255 ECU_ADDRESS 0x0 /end MEASUREMENT
/begin MEASUREMENT Com_TxPduInfo[1].CbkTxAckDefFuncPtrIndEndIdxOfTxPduInfo "" UBYTE Com_CbkTxAckDefFuncPtrIndEndIdxOfTxPduInfoType 0 0 0 255 ECU_ADDRESS 0x0 /end MEASUREMENT
/begin MEASUREMENT Com_TxPduInfo[1].CbkTxAckDefFuncPtrIndStartIdxOfTxPduInfo "" UBYTE Com_CbkTxAckDefFuncPtrIndStartIdxOfTxPduInfoType 0 0 0 255 ECU_ADDRESS 0x0 /end MEASUREMENT
/begin MEASUREMENT Com_TxPduInfo[1].ExternalIdOfTxPduInfo "" UBYTE NO_COMPU_METHOD 0 0 0 255 ECU_ADDRESS 0x0 /end MEASUREMENT
/begin MEASUREMENT Com_TxPduInfo[1].IPduGroupInfoOfTxPduInfoIndEndIdxOfTxPduInfo "" UBYTE Com_IPduGroupInfoOfTxPduInfoIndEndIdxOfTxPduInfoType 0 0 0 255 ECU_ADDRESS 0x0 /end MEASUREMENT
/begin MEASUREMENT Com_TxPduInfo[1].IPduGroupInfoOfTxPduInfoIndStartIdxOfTxPduInfo "" UBYTE Com_IPduGroupInfoOfTxPduInfoIndStartIdxOfTxPduInfoType 0 0 0 255 ECU_ADDRESS 0x0 /end MEASUREMENT
/begin MEASUREMENT Com_TxPduInfo[1].PartitionsTxStructIdxOfTxPduInfo "" UBYTE NO_COMPU_METHOD 0 0 0 255 ECU_ADDRESS 0x0 /end MEASUREMENT
/begin MEASUREMENT Com_TxPduInfo[1].TxBufferLengthOfTxPduInfo "" UBYTE NO_COMPU_METHOD 0 0 0 255 ECU_ADDRESS 0x0 /end MEASUREMENT
/begin MEASUREMENT Com_TxPduInfo[1].TxPduCalloutFuncPtrIdxOfTxPduInfo "" UBYTE Com_TxPduCalloutFuncPtrIdxOfTxPduInfoType 0 0 0 255 ECU_ADDRESS 0x0 /end MEASUREMENT
/begin MEASUREMENT Com_TxPduInfo[1].TxPduInitValueEndIdxOfTxPduInfo "" UWORD Com_TxPduInitValueEndIdxOfTxPduInfoType 0 0 0 65535 ECU_ADDRESS 0x0 /end MEASUREMENT
/begin MEASUREMENT Com_TxPduInfo[1].TxPduInitValueStartIdxOfTxPduInfo "" UWORD Com_TxPduInitValueStartIdxOfTxPduInfoType 0 0 0 65535 ECU_ADDRESS 0x0 /end MEASUREMENT
/begin MEASUREMENT Com_TxPduInfo[1].TxSigGrpInfoIndEndIdxOfTxPduInfo "" UBYTE Com_TxSigGrpInfoIndEndIdxOfTxPduInfoType 0 0 0 255 ECU_ADDRESS 0x0 /end MEASUREMENT
/begin MEASUREMENT Com_TxPduInfo[1].TxSigGrpInfoIndStartIdxOfTxPduInfo "" UBYTE Com_TxSigGrpInfoIndStartIdxOfTxPduInfoType 0 0 0 255 ECU_ADDRESS 0x0 /end MEASUREMENT
/begin MEASUREMENT Com_TxPduInfo[1].TxTOutInfoIdxOfTxPduInfo "" UBYTE Com_TxTOutInfoIdxOfTxPduInfoType 0 0 0 255 ECU_ADDRESS 0x0 /end MEASUREMENT
/begin MEASUREMENT Com_TxPduInfo[20].CbkTxAckDefFuncPtrIndEndIdxOfTxPduInfo "" UBYTE Com_CbkTxAckDefFuncPtrIndEndIdxOfTxPduInfoType 0 0 0 255 ECU_ADDRESS 0x0 /end MEASUREMENT
/begin MEASUREMENT Com_TxPduInfo[20].CbkTxAckDefFuncPtrIndStartIdxOfTxPduInfo "" UBYTE Com_CbkTxAckDefFuncPtrIndStartIdxOfTxPduInfoType 0 0 0 255 ECU_ADDRESS 0x0 /end MEASUREMENT
/begin MEASUREMENT Com_TxPduInfo[20].ExternalIdOfTxPduInfo "" UBYTE NO_COMPU_METHOD 0 0 0 255 ECU_ADDRESS 0x0 /end MEASUREMENT
/begin MEASUREMENT Com_TxPduInfo[20].IPduGroupInfoOfTxPduInfoIndEndIdxOfTxPduInfo "" UBYTE Com_IPduGroupInfoOfTxPduInfoIndEndIdxOfTxPduInfoType 0 0 0 255 ECU_ADDRESS 0x0 /end MEASUREMENT
/begin MEASUREMENT Com_TxPduInfo[20].IPduGroupInfoOfTxPduInfoIndStartIdxOfTxPduInfo "" UBYTE Com_IPduGroupInfoOfTxPduInfoIndStartIdxOfTxPduInfoType 0 0 0 255 ECU_ADDRESS 0x0 /end MEASUREMENT
/begin MEASUREMENT Com_TxPduInfo[20].PartitionsTxStructIdxOfTxPduInfo "" UBYTE NO_COMPU_METHOD 0 0 0 255 ECU_ADDRESS 0x0 /end MEASUREMENT
/begin MEASUREMENT Com_TxPduInfo[20].TxBufferLengthOfTxPduInfo "" UBYTE NO_COMPU_METHOD 0 0 0 255 ECU_ADDRESS 0x0 /end MEASUREMENT
/begin MEASUREMENT Com_TxPduInfo[20].TxPduCalloutFuncPtrIdxOfTxPduInfo "" UBYTE Com_TxPduCalloutFuncPtrIdxOfTxPduInfoType 0 0 0 255 ECU_ADDRESS 0x0 /end MEASUREMENT
/begin MEASUREMENT Com_TxPduInfo[20].TxPduInitValueEndIdxOfTxPduInfo "" UWORD Com_TxPduInitValueEndIdxOfTxPduInfoType 0 0 0 65535 ECU_ADDRESS 0x0 /end MEASUREMENT
/begin MEASUREMENT Com_TxPduInfo[20].TxPduInitValueStartIdxOfTxPduInfo "" UWORD Com_TxPduInitValueStartIdxOfTxPduInfoType 0 0 0 65535 ECU_ADDRESS 0x0 /end MEASUREMENT
/begin MEASUREMENT Com_TxPduInfo[20].TxSigGrpInfoIndEndIdxOfTxPduInfo "" UBYTE Com_TxSigGrpInfoIndEndIdxOfTxPduInfoType 0 0 0 255 ECU_ADDRESS 0x0 /end MEASUREMENT
/begin MEASUREMENT Com_TxPduInfo[20].TxSigGrpInfoIndStartIdxOfTxPduInfo "" UBYTE Com_TxSigGrpInfoIndStartIdxOfTxPduInfoType 0 0 0 255 ECU_ADDRESS 0x0 /end MEASUREMENT
/begin MEASUREMENT Com_TxPduInfo[20].TxTOutInfoIdxOfTxPduInfo "" UBYTE Com_TxTOutInfoIdxOfTxPduInfoType 0 0 0 255 ECU_ADDRESS 0x0 /end MEASUREMENT
/begin MEASUREMENT Com_TxPduInfo[21].CbkTxAckDefFuncPtrIndEndIdxOfTxPduInfo "" UBYTE Com_CbkTxAckDefFuncPtrIndEndIdxOfTxPduInfoType 0 0 0 255 ECU_ADDRESS 0x0 /end MEASUREMENT
/begin MEASUREMENT Com_TxPduInfo[21].CbkTxAckDefFuncPtrIndStartIdxOfTxPduInfo "" UBYTE Com_CbkTxAckDefFuncPtrIndStartIdxOfTxPduInfoType 0 0 0 255 ECU_ADDRESS 0x0 /end MEASUREMENT
/begin MEASUREMENT Com_TxPduInfo[21].ExternalIdOfTxPduInfo "" UBYTE NO_COMPU_METHOD 0 0 0 255 ECU_ADDRESS 0x0 /end MEASUREMENT
/begin MEASUREMENT Com_TxPduInfo[21].IPduGroupInfoOfTxPduInfoIndEndIdxOfTxPduInfo "" UBYTE Com_IPduGroupInfoOfTxPduInfoIndEndIdxOfTxPduInfoType 0 0 0 255 ECU_ADDRESS 0x0 /end MEASUREMENT
/begin MEASUREMENT Com_TxPduInfo[21].IPduGroupInfoOfTxPduInfoIndStartIdxOfTxPduInfo "" UBYTE Com_IPduGroupInfoOfTxPduInfoIndStartIdxOfTxPduInfoType 0 0 0 255 ECU_ADDRESS 0x0 /end MEASUREMENT
/begin MEASUREMENT Com_TxPduInfo[21].PartitionsTxStructIdxOfTxPduInfo "" UBYTE NO_COMPU_METHOD 0 0 0 255 ECU_ADDRESS 0x0 /end MEASUREMENT
/begin MEASUREMENT Com_TxPduInfo[21].TxBufferLengthOfTxPduInfo "" UBYTE NO_COMPU_METHOD 0 0 0 255 ECU_ADDRESS 0x0 /end MEASUREMENT
/begin MEASUREMENT Com_TxPduInfo[21].TxPduCalloutFuncPtrIdxOfTxPduInfo "" UBYTE Com_TxPduCalloutFuncPtrIdxOfTxPduInfoType 0 0 0 255 ECU_ADDRESS 0x0 /end MEASUREMENT
/begin MEASUREMENT Com_TxPduInfo[21].TxPduInitValueEndIdxOfTxPduInfo "" UWORD Com_TxPduInitValueEndIdxOfTxPduInfoType 0 0 0 65535 ECU_ADDRESS 0x0 /end MEASUREMENT
/begin MEASUREMENT Com_TxPduInfo[21].TxPduInitValueStartIdxOfTxPduInfo "" UWORD Com_TxPduInitValueStartIdxOfTxPduInfoType 0 0 0 65535 ECU_ADDRESS 0x0 /end MEASUREMENT
/begin MEASUREMENT Com_TxPduInfo[21].TxSigGrpInfoIndEndIdxOfTxPduInfo "" UBYTE Com_TxSigGrpInfoIndEndIdxOfTxPduInfoType 0 0 0 255 ECU_ADDRESS 0x0 /end MEASUREMENT
/begin MEASUREMENT Com_TxPduInfo[21].TxSigGrpInfoIndStartIdxOfTxPduInfo "" UBYTE Com_TxSigGrpInfoIndStartIdxOfTxPduInfoType 0 0 0 255 ECU_ADDRESS 0x0 /end MEASUREMENT
/begin MEASUREMENT Com_TxPduInfo[21].TxTOutInfoIdxOfTxPduInfo "" UBYTE Com_TxTOutInfoIdxOfTxPduInfoType 0 0 0 255 ECU_ADDRESS 0x0 /end MEASUREMENT
/begin MEASUREMENT Com_TxPduInfo[22].CbkTxAckDefFuncPtrIndEndIdxOfTxPduInfo "" UBYTE Com_CbkTxAckDefFuncPtrIndEndIdxOfTxPduInfoType 0 0 0 255 ECU_ADDRESS 0x0 /end MEASUREMENT
/begin MEASUREMENT Com_TxPduInfo[22].CbkTxAckDefFuncPtrIndStartIdxOfTxPduInfo "" UBYTE Com_CbkTxAckDefFuncPtrIndStartIdxOfTxPduInfoType 0 0 0 255 ECU_ADDRESS 0x0 /end MEASUREMENT
/begin MEASUREMENT Com_TxPduInfo[22].ExternalIdOfTxPduInfo "" UBYTE NO_COMPU_METHOD 0 0 0 255 ECU_ADDRESS 0x0 /end MEASUREMENT
/begin MEASUREMENT Com_TxPduInfo[22].IPduGroupInfoOfTxPduInfoIndEndIdxOfTxPduInfo "" UBYTE Com_IPduGroupInfoOfTxPduInfoIndEndIdxOfTxPduInfoType 0 0 0 255 ECU_ADDRESS 0x0 /end MEASUREMENT
/begin MEASUREMENT Com_TxPduInfo[22].IPduGroupInfoOfTxPduInfoIndStartIdxOfTxPduInfo "" UBYTE Com_IPduGroupInfoOfTxPduInfoIndStartIdxOfTxPduInfoType 0 0 0 255 ECU_ADDRESS 0x0 /end MEASUREMENT
/begin MEASUREMENT Com_TxPduInfo[22].PartitionsTxStructIdxOfTxPduInfo "" UBYTE NO_COMPU_METHOD 0 0 0 255 ECU_ADDRESS 0x0 /end MEASUREMENT
/begin MEASUREMENT Com_TxPduInfo[22].TxBufferLengthOfTxPduInfo "" UBYTE NO_COMPU_METHOD 0 0 0 255 ECU_ADDRESS 0x0 /end MEASUREMENT
/begin MEASUREMENT Com_TxPduInfo[22].TxPduCalloutFuncPtrIdxOfTxPduInfo "" UBYTE Com_TxPduCalloutFuncPtrIdxOfTxPduInfoType 0 0 0 255 ECU_ADDRESS 0x0 /end MEASUREMENT
/begin MEASUREMENT Com_TxPduInfo[22].TxPduInitValueEndIdxOfTxPduInfo "" UWORD Com_TxPduInitValueEndIdxOfTxPduInfoType 0 0 0 65535 ECU_ADDRESS 0x0 /end MEASUREMENT
/begin MEASUREMENT Com_TxPduInfo[22].TxPduInitValueStartIdxOfTxPduInfo "" UWORD Com_TxPduInitValueStartIdxOfTxPduInfoType 0 0 0 65535 ECU_ADDRESS 0x0 /end MEASUREMENT
/begin MEASUREMENT Com_TxPduInfo[22].TxSigGrpInfoIndEndIdxOfTxPduInfo "" UBYTE Com_TxSigGrpInfoIndEndIdxOfTxPduInfoType 0 0 0 255 ECU_ADDRESS 0x0 /end MEASUREMENT
/begin MEASUREMENT Com_TxPduInfo[22].TxSigGrpInfoIndStartIdxOfTxPduInfo "" UBYTE Com_TxSigGrpInfoIndStartIdxOfTxPduInfoType 0 0 0 255 ECU_ADDRESS 0x0 /end MEASUREMENT
/begin MEASUREMENT Com_TxPduInfo[22].TxTOutInfoIdxOfTxPduInfo "" UBYTE Com_TxTOutInfoIdxOfTxPduInfoType 0 0 0 255 ECU_ADDRESS 0x0 /end MEASUREMENT
/begin MEASUREMENT Com_TxPduInfo[23].CbkTxAckDefFuncPtrIndEndIdxOfTxPduInfo "" UBYTE Com_CbkTxAckDefFuncPtrIndEndIdxOfTxPduInfoType 0 0 0 255 ECU_ADDRESS 0x0 /end MEASUREMENT
/begin MEASUREMENT Com_TxPduInfo[23].CbkTxAckDefFuncPtrIndStartIdxOfTxPduInfo "" UBYTE Com_CbkTxAckDefFuncPtrIndStartIdxOfTxPduInfoType 0 0 0 255 ECU_ADDRESS 0x0 /end MEASUREMENT
/begin MEASUREMENT Com_TxPduInfo[23].ExternalIdOfTxPduInfo "" UBYTE NO_COMPU_METHOD 0 0 0 255 ECU_ADDRESS 0x0 /end MEASUREMENT
/begin MEASUREMENT Com_TxPduInfo[23].IPduGroupInfoOfTxPduInfoIndEndIdxOfTxPduInfo "" UBYTE Com_IPduGroupInfoOfTxPduInfoIndEndIdxOfTxPduInfoType 0 0 0 255 ECU_ADDRESS 0x0 /end MEASUREMENT
/begin MEASUREMENT Com_TxPduInfo[23].IPduGroupInfoOfTxPduInfoIndStartIdxOfTxPduInfo "" UBYTE Com_IPduGroupInfoOfTxPduInfoIndStartIdxOfTxPduInfoType 0 0 0 255 ECU_ADDRESS 0x0 /end MEASUREMENT
/begin MEASUREMENT Com_TxPduInfo[23].PartitionsTxStructIdxOfTxPduInfo "" UBYTE NO_COMPU_METHOD 0 0 0 255 ECU_ADDRESS 0x0 /end MEASUREMENT
/begin MEASUREMENT Com_TxPduInfo[23].TxBufferLengthOfTxPduInfo "" UBYTE NO_COMPU_METHOD 0 0 0 255 ECU_ADDRESS 0x0 /end MEASUREMENT
/begin MEASUREMENT Com_TxPduInfo[23].TxPduCalloutFuncPtrIdxOfTxPduInfo "" UBYTE Com_TxPduCalloutFuncPtrIdxOfTxPduInfoType 0 0 0 255 ECU_ADDRESS 0x0 /end MEASUREMENT
/begin MEASUREMENT Com_TxPduInfo[23].TxPduInitValueEndIdxOfTxPduInfo "" UWORD Com_TxPduInitValueEndIdxOfTxPduInfoType 0 0 0 65535 ECU_ADDRESS 0x0 /end MEASUREMENT
/begin MEASUREMENT Com_TxPduInfo[23].TxPduInitValueStartIdxOfTxPduInfo "" UWORD Com_TxPduInitValueStartIdxOfTxPduInfoType 0 0 0 65535 ECU_ADDRESS 0x0 /end MEASUREMENT
/begin MEASUREMENT Com_TxPduInfo[23].TxSigGrpInfoIndEndIdxOfTxPduInfo "" UBYTE Com_TxSigGrpInfoIndEndIdxOfTxPduInfoType 0 0 0 255 ECU_ADDRESS 0x0 /end MEASUREMENT
/begin MEASUREMENT Com_TxPduInfo[23].TxSigGrpInfoIndStartIdxOfTxPduInfo "" UBYTE Com_TxSigGrpInfoIndStartIdxOfTxPduInfoType 0 0 0 255 ECU_ADDRESS 0x0 /end MEASUREMENT
/begin MEASUREMENT Com_TxPduInfo[23].TxTOutInfoIdxOfTxPduInfo "" UBYTE Com_TxTOutInfoIdxOfTxPduInfoType 0 0 0 255 ECU_ADDRESS 0x0 /end MEASUREMENT
/begin MEASUREMENT Com_TxPduInfo[24].CbkTxAckDefFuncPtrIndEndIdxOfTxPduInfo "" UBYTE Com_CbkTxAckDefFuncPtrIndEndIdxOfTxPduInfoType 0 0 0 255 ECU_ADDRESS 0x0 /end MEASUREMENT
/begin MEASUREMENT Com_TxPduInfo[24].CbkTxAckDefFuncPtrIndStartIdxOfTxPduInfo "" UBYTE Com_CbkTxAckDefFuncPtrIndStartIdxOfTxPduInfoType 0 0 0 255 ECU_ADDRESS 0x0 /end MEASUREMENT
/begin MEASUREMENT Com_TxPduInfo[24].ExternalIdOfTxPduInfo "" UBYTE NO_COMPU_METHOD 0 0 0 255 ECU_ADDRESS 0x0 /end MEASUREMENT
/begin MEASUREMENT Com_TxPduInfo[24].IPduGroupInfoOfTxPduInfoIndEndIdxOfTxPduInfo "" UBYTE Com_IPduGroupInfoOfTxPduInfoIndEndIdxOfTxPduInfoType 0 0 0 255 ECU_ADDRESS 0x0 /end MEASUREMENT
/begin MEASUREMENT Com_TxPduInfo[24].IPduGroupInfoOfTxPduInfoIndStartIdxOfTxPduInfo "" UBYTE Com_IPduGroupInfoOfTxPduInfoIndStartIdxOfTxPduInfoType 0 0 0 255 ECU_ADDRESS 0x0 /end MEASUREMENT
/begin MEASUREMENT Com_TxPduInfo[24].PartitionsTxStructIdxOfTxPduInfo "" UBYTE NO_COMPU_METHOD 0 0 0 255 ECU_ADDRESS 0x0 /end MEASUREMENT
/begin MEASUREMENT Com_TxPduInfo[24].TxBufferLengthOfTxPduInfo "" UBYTE NO_COMPU_METHOD 0 0 0 255 ECU_ADDRESS 0x0 /end MEASUREMENT
/begin MEASUREMENT Com_TxPduInfo[24].TxPduCalloutFuncPtrIdxOfTxPduInfo "" UBYTE Com_TxPduCalloutFuncPtrIdxOfTxPduInfoType 0 0 0 255 ECU_ADDRESS 0x0 /end MEASUREMENT
/begin MEASUREMENT Com_TxPduInfo[24].TxPduInitValueEndIdxOfTxPduInfo "" UWORD Com_TxPduInitValueEndIdxOfTxPduInfoType 0 0 0 65535 ECU_ADDRESS 0x0 /end MEASUREMENT
/begin MEASUREMENT Com_TxPduInfo[24].TxPduInitValueStartIdxOfTxPduInfo "" UWORD Com_TxPduInitValueStartIdxOfTxPduInfoType 0 0 0 65535 ECU_ADDRESS 0x0 /end MEASUREMENT
/begin MEASUREMENT Com_TxPduInfo[24].TxSigGrpInfoIndEndIdxOfTxPduInfo "" UBYTE Com_TxSigGrpInfoIndEndIdxOfTxPduInfoType 0 0 0 255 ECU_ADDRESS 0x0 /end MEASUREMENT
/begin MEASUREMENT Com_TxPduInfo[24].TxSigGrpInfoIndStartIdxOfTxPduInfo "" UBYTE Com_TxSigGrpInfoIndStartIdxOfTxPduInfoType 0 0 0 255 ECU_ADDRESS 0x0 /end MEASUREMENT
/begin MEASUREMENT Com_TxPduInfo[24].TxTOutInfoIdxOfTxPduInfo "" UBYTE Com_TxTOutInfoIdxOfTxPduInfoType 0 0 0 255 ECU_ADDRESS 0x0 /end MEASUREMENT
/begin MEASUREMENT Com_TxPduInfo[25].CbkTxAckDefFuncPtrIndEndIdxOfTxPduInfo "" UBYTE Com_CbkTxAckDefFuncPtrIndEndIdxOfTxPduInfoType 0 0 0 255 ECU_ADDRESS 0x0 /end MEASUREMENT
/begin MEASUREMENT Com_TxPduInfo[25].CbkTxAckDefFuncPtrIndStartIdxOfTxPduInfo "" UBYTE Com_CbkTxAckDefFuncPtrIndStartIdxOfTxPduInfoType 0 0 0 255 ECU_ADDRESS 0x0 /end MEASUREMENT
/begin MEASUREMENT Com_TxPduInfo[25].ExternalIdOfTxPduInfo "" UBYTE NO_COMPU_METHOD 0 0 0 255 ECU_ADDRESS 0x0 /end MEASUREMENT
/begin MEASUREMENT Com_TxPduInfo[25].IPduGroupInfoOfTxPduInfoIndEndIdxOfTxPduInfo "" UBYTE Com_IPduGroupInfoOfTxPduInfoIndEndIdxOfTxPduInfoType 0 0 0 255 ECU_ADDRESS 0x0 /end MEASUREMENT
/begin MEASUREMENT Com_TxPduInfo[25].IPduGroupInfoOfTxPduInfoIndStartIdxOfTxPduInfo "" UBYTE Com_IPduGroupInfoOfTxPduInfoIndStartIdxOfTxPduInfoType 0 0 0 255 ECU_ADDRESS 0x0 /end MEASUREMENT
/begin MEASUREMENT Com_TxPduInfo[25].PartitionsTxStructIdxOfTxPduInfo "" UBYTE NO_COMPU_METHOD 0 0 0 255 ECU_ADDRESS 0x0 /end MEASUREMENT
/begin MEASUREMENT Com_TxPduInfo[25].TxBufferLengthOfTxPduInfo "" UBYTE NO_COMPU_METHOD 0 0 0 255 ECU_ADDRESS 0x0 /end MEASUREMENT
/begin MEASUREMENT Com_TxPduInfo[25].TxPduCalloutFuncPtrIdxOfTxPduInfo "" UBYTE Com_TxPduCalloutFuncPtrIdxOfTxPduInfoType 0 0 0 255 ECU_ADDRESS 0x0 /end MEASUREMENT
/begin MEASUREMENT Com_TxPduInfo[25].TxPduInitValueEndIdxOfTxPduInfo "" UWORD Com_TxPduInitValueEndIdxOfTxPduInfoType 0 0 0 65535 ECU_ADDRESS 0x0 /end MEASUREMENT
/begin MEASUREMENT Com_TxPduInfo[25].TxPduInitValueStartIdxOfTxPduInfo "" UWORD Com_TxPduInitValueStartIdxOfTxPduInfoType 0 0 0 65535 ECU_ADDRESS 0x0 /end MEASUREMENT
/begin MEASUREMENT Com_TxPduInfo[25].TxSigGrpInfoIndEndIdxOfTxPduInfo "" UBYTE Com_TxSigGrpInfoIndEndIdxOfTxPduInfoType 0 0 0 255 ECU_ADDRESS 0x0 /end MEASUREMENT
/begin MEASUREMENT Com_TxPduInfo[25].TxSigGrpInfoIndStartIdxOfTxPduInfo "" UBYTE Com_TxSigGrpInfoIndStartIdxOfTxPduInfoType 0 0 0 255 ECU_ADDRESS 0x0 /end MEASUREMENT
/begin MEASUREMENT Com_TxPduInfo[25].TxTOutInfoIdxOfTxPduInfo "" UBYTE Com_TxTOutInfoIdxOfTxPduInfoType 0 0 0 255 ECU_ADDRESS 0x0 /end MEASUREMENT
/begin MEASUREMENT Com_TxPduInfo[26].CbkTxAckDefFuncPtrIndEndIdxOfTxPduInfo "" UBYTE Com_CbkTxAckDefFuncPtrIndEndIdxOfTxPduInfoType 0 0 0 255 ECU_ADDRESS 0x0 /end MEASUREMENT
/begin MEASUREMENT Com_TxPduInfo[26].CbkTxAckDefFuncPtrIndStartIdxOfTxPduInfo "" UBYTE Com_CbkTxAckDefFuncPtrIndStartIdxOfTxPduInfoType 0 0 0 255 ECU_ADDRESS 0x0 /end MEASUREMENT
/begin MEASUREMENT Com_TxPduInfo[26].ExternalIdOfTxPduInfo "" UBYTE NO_COMPU_METHOD 0 0 0 255 ECU_ADDRESS 0x0 /end MEASUREMENT
/begin MEASUREMENT Com_TxPduInfo[26].IPduGroupInfoOfTxPduInfoIndEndIdxOfTxPduInfo "" UBYTE Com_IPduGroupInfoOfTxPduInfoIndEndIdxOfTxPduInfoType 0 0 0 255 ECU_ADDRESS 0x0 /end MEASUREMENT
/begin MEASUREMENT Com_TxPduInfo[26].IPduGroupInfoOfTxPduInfoIndStartIdxOfTxPduInfo "" UBYTE Com_IPduGroupInfoOfTxPduInfoIndStartIdxOfTxPduInfoType 0 0 0 255 ECU_ADDRESS 0x0 /end MEASUREMENT
/begin MEASUREMENT Com_TxPduInfo[26].PartitionsTxStructIdxOfTxPduInfo "" UBYTE NO_COMPU_METHOD 0 0 0 255 ECU_ADDRESS 0x0 /end MEASUREMENT
/begin MEASUREMENT Com_TxPduInfo[26].TxBufferLengthOfTxPduInfo "" UBYTE NO_COMPU_METHOD 0 0 0 255 ECU_ADDRESS 0x0 /end MEASUREMENT
/begin MEASUREMENT Com_TxPduInfo[26].TxPduCalloutFuncPtrIdxOfTxPduInfo "" UBYTE Com_TxPduCalloutFuncPtrIdxOfTxPduInfoType 0 0 0 255 ECU_ADDRESS 0x0 /end MEASUREMENT
/begin MEASUREMENT Com_TxPduInfo[26].TxPduInitValueEndIdxOfTxPduInfo "" UWORD Com_TxPduInitValueEndIdxOfTxPduInfoType 0 0 0 65535 ECU_ADDRESS 0x0 /end MEASUREMENT
/begin MEASUREMENT Com_TxPduInfo[26].TxPduInitValueStartIdxOfTxPduInfo "" UWORD Com_TxPduInitValueStartIdxOfTxPduInfoType 0 0 0 65535 ECU_ADDRESS 0x0 /end MEASUREMENT
/begin MEASUREMENT Com_TxPduInfo[26].TxSigGrpInfoIndEndIdxOfTxPduInfo "" UBYTE Com_TxSigGrpInfoIndEndIdxOfTxPduInfoType 0 0 0 255 ECU_ADDRESS 0x0 /end MEASUREMENT
/begin MEASUREMENT Com_TxPduInfo[26].TxSigGrpInfoIndStartIdxOfTxPduInfo "" UBYTE Com_TxSigGrpInfoIndStartIdxOfTxPduInfoType 0 0 0 255 ECU_ADDRESS 0x0 /end MEASUREMENT
/begin MEASUREMENT Com_TxPduInfo[26].TxTOutInfoIdxOfTxPduInfo "" UBYTE Com_TxTOutInfoIdxOfTxPduInfoType 0 0 0 255 ECU_ADDRESS 0x0 /end MEASUREMENT
/begin MEASUREMENT Com_TxPduInfo[27].CbkTxAckDefFuncPtrIndEndIdxOfTxPduInfo "" UBYTE Com_CbkTxAckDefFuncPtrIndEndIdxOfTxPduInfoType 0 0 0 255 ECU_ADDRESS 0x0 /end MEASUREMENT
/begin MEASUREMENT Com_TxPduInfo[27].CbkTxAckDefFuncPtrIndStartIdxOfTxPduInfo "" UBYTE Com_CbkTxAckDefFuncPtrIndStartIdxOfTxPduInfoType 0 0 0 255 ECU_ADDRESS 0x0 /end MEASUREMENT
/begin MEASUREMENT Com_TxPduInfo[27].ExternalIdOfTxPduInfo "" UBYTE NO_COMPU_METHOD 0 0 0 255 ECU_ADDRESS 0x0 /end MEASUREMENT
/begin MEASUREMENT Com_TxPduInfo[27].IPduGroupInfoOfTxPduInfoIndEndIdxOfTxPduInfo "" UBYTE Com_IPduGroupInfoOfTxPduInfoIndEndIdxOfTxPduInfoType 0 0 0 255 ECU_ADDRESS 0x0 /end MEASUREMENT
/begin MEASUREMENT Com_TxPduInfo[27].IPduGroupInfoOfTxPduInfoIndStartIdxOfTxPduInfo "" UBYTE Com_IPduGroupInfoOfTxPduInfoIndStartIdxOfTxPduInfoType 0 0 0 255 ECU_ADDRESS 0x0 /end MEASUREMENT
/begin MEASUREMENT Com_TxPduInfo[27].PartitionsTxStructIdxOfTxPduInfo "" UBYTE NO_COMPU_METHOD 0 0 0 255 ECU_ADDRESS 0x0 /end MEASUREMENT
/begin MEASUREMENT Com_TxPduInfo[27].TxBufferLengthOfTxPduInfo "" UBYTE NO_COMPU_METHOD 0 0 0 255 ECU_ADDRESS 0x0 /end MEASUREMENT
/begin MEASUREMENT Com_TxPduInfo[27].TxPduCalloutFuncPtrIdxOfTxPduInfo "" UBYTE Com_TxPduCalloutFuncPtrIdxOfTxPduInfoType 0 0 0 255 ECU_ADDRESS 0x0 /end MEASUREMENT
/begin MEASUREMENT Com_TxPduInfo[27].TxPduInitValueEndIdxOfTxPduInfo "" UWORD Com_TxPduInitValueEndIdxOfTxPduInfoType 0 0 0 65535 ECU_ADDRESS 0x0 /end MEASUREMENT
/begin MEASUREMENT Com_TxPduInfo[27].TxPduInitValueStartIdxOfTxPduInfo "" UWORD Com_TxPduInitValueStartIdxOfTxPduInfoType 0 0 0 65535 ECU_ADDRESS 0x0 /end MEASUREMENT
/begin MEASUREMENT Com_TxPduInfo[27].TxSigGrpInfoIndEndIdxOfTxPduInfo "" UBYTE Com_TxSigGrpInfoIndEndIdxOfTxPduInfoType 0 0 0 255 ECU_ADDRESS 0x0 /end MEASUREMENT
/begin MEASUREMENT Com_TxPduInfo[27].TxSigGrpInfoIndStartIdxOfTxPduInfo "" UBYTE Com_TxSigGrpInfoIndStartIdxOfTxPduInfoType 0 0 0 255 ECU_ADDRESS 0x0 /end MEASUREMENT
/begin MEASUREMENT Com_TxPduInfo[27].TxTOutInfoIdxOfTxPduInfo "" UBYTE Com_TxTOutInfoIdxOfTxPduInfoType 0 0 0 255 ECU_ADDRESS 0x0 /end MEASUREMENT
/begin MEASUREMENT Com_TxPduInfo[28].CbkTxAckDefFuncPtrIndEndIdxOfTxPduInfo "" UBYTE Com_CbkTxAckDefFuncPtrIndEndIdxOfTxPduInfoType 0 0 0 255 ECU_ADDRESS 0x0 /end MEASUREMENT
/begin MEASUREMENT Com_TxPduInfo[28].CbkTxAckDefFuncPtrIndStartIdxOfTxPduInfo "" UBYTE Com_CbkTxAckDefFuncPtrIndStartIdxOfTxPduInfoType 0 0 0 255 ECU_ADDRESS 0x0 /end MEASUREMENT
/begin MEASUREMENT Com_TxPduInfo[28].ExternalIdOfTxPduInfo "" UBYTE NO_COMPU_METHOD 0 0 0 255 ECU_ADDRESS 0x0 /end MEASUREMENT
/begin MEASUREMENT Com_TxPduInfo[28].IPduGroupInfoOfTxPduInfoIndEndIdxOfTxPduInfo "" UBYTE Com_IPduGroupInfoOfTxPduInfoIndEndIdxOfTxPduInfoType 0 0 0 255 ECU_ADDRESS 0x0 /end MEASUREMENT
/begin MEASUREMENT Com_TxPduInfo[28].IPduGroupInfoOfTxPduInfoIndStartIdxOfTxPduInfo "" UBYTE Com_IPduGroupInfoOfTxPduInfoIndStartIdxOfTxPduInfoType 0 0 0 255 ECU_ADDRESS 0x0 /end MEASUREMENT
/begin MEASUREMENT Com_TxPduInfo[28].PartitionsTxStructIdxOfTxPduInfo "" UBYTE NO_COMPU_METHOD 0 0 0 255 ECU_ADDRESS 0x0 /end MEASUREMENT
/begin MEASUREMENT Com_TxPduInfo[28].TxBufferLengthOfTxPduInfo "" UBYTE NO_COMPU_METHOD 0 0 0 255 ECU_ADDRESS 0x0 /end MEASUREMENT
/begin MEASUREMENT Com_TxPduInfo[28].TxPduCalloutFuncPtrIdxOfTxPduInfo "" UBYTE Com_TxPduCalloutFuncPtrIdxOfTxPduInfoType 0 0 0 255 ECU_ADDRESS 0x0 /end MEASUREMENT
/begin MEASUREMENT Com_TxPduInfo[28].TxPduInitValueEndIdxOfTxPduInfo "" UWORD Com_TxPduInitValueEndIdxOfTxPduInfoType 0 0 0 65535 ECU_ADDRESS 0x0 /end MEASUREMENT
/begin MEASUREMENT Com_TxPduInfo[28].TxPduInitValueStartIdxOfTxPduInfo "" UWORD Com_TxPduInitValueStartIdxOfTxPduInfoType 0 0 0 65535 ECU_ADDRESS 0x0 /end MEASUREMENT
/begin MEASUREMENT Com_TxPduInfo[28].TxSigGrpInfoIndEndIdxOfTxPduInfo "" UBYTE Com_TxSigGrpInfoIndEndIdxOfTxPduInfoType 0 0 0 255 ECU_ADDRESS 0x0 /end MEASUREMENT
/begin MEASUREMENT Com_TxPduInfo[28].TxSigGrpInfoIndStartIdxOfTxPduInfo "" UBYTE Com_TxSigGrpInfoIndStartIdxOfTxPduInfoType 0 0 0 255 ECU_ADDRESS 0x0 /end MEASUREMENT
/begin MEASUREMENT Com_TxPduInfo[28].TxTOutInfoIdxOfTxPduInfo "" UBYTE Com_TxTOutInfoIdxOfTxPduInfoType 0 0 0 255 ECU_ADDRESS 0x0 /end MEASUREMENT
/begin MEASUREMENT Com_TxPduInfo[29].CbkTxAckDefFuncPtrIndEndIdxOfTxPduInfo "" UBYTE Com_CbkTxAckDefFuncPtrIndEndIdxOfTxPduInfoType 0 0 0 255 ECU_ADDRESS 0x0 /end MEASUREMENT
/begin MEASUREMENT Com_TxPduInfo[29].CbkTxAckDefFuncPtrIndStartIdxOfTxPduInfo "" UBYTE Com_CbkTxAckDefFuncPtrIndStartIdxOfTxPduInfoType 0 0 0 255 ECU_ADDRESS 0x0 /end MEASUREMENT
/begin MEASUREMENT Com_TxPduInfo[29].ExternalIdOfTxPduInfo "" UBYTE NO_COMPU_METHOD 0 0 0 255 ECU_ADDRESS 0x0 /end MEASUREMENT
/begin MEASUREMENT Com_TxPduInfo[29].IPduGroupInfoOfTxPduInfoIndEndIdxOfTxPduInfo "" UBYTE Com_IPduGroupInfoOfTxPduInfoIndEndIdxOfTxPduInfoType 0 0 0 255 ECU_ADDRESS 0x0 /end MEASUREMENT
/begin MEASUREMENT Com_TxPduInfo[29].IPduGroupInfoOfTxPduInfoIndStartIdxOfTxPduInfo "" UBYTE Com_IPduGroupInfoOfTxPduInfoIndStartIdxOfTxPduInfoType 0 0 0 255 ECU_ADDRESS 0x0 /end MEASUREMENT
/begin MEASUREMENT Com_TxPduInfo[29].PartitionsTxStructIdxOfTxPduInfo "" UBYTE NO_COMPU_METHOD 0 0 0 255 ECU_ADDRESS 0x0 /end MEASUREMENT
/begin MEASUREMENT Com_TxPduInfo[29].TxBufferLengthOfTxPduInfo "" UBYTE NO_COMPU_METHOD 0 0 0 255 ECU_ADDRESS 0x0 /end MEASUREMENT
/begin MEASUREMENT Com_TxPduInfo[29].TxPduCalloutFuncPtrIdxOfTxPduInfo "" UBYTE Com_TxPduCalloutFuncPtrIdxOfTxPduInfoType 0 0 0 255 ECU_ADDRESS 0x0 /end MEASUREMENT
/begin MEASUREMENT Com_TxPduInfo[29].TxPduInitValueEndIdxOfTxPduInfo "" UWORD Com_TxPduInitValueEndIdxOfTxPduInfoType 0 0 0 65535 ECU_ADDRESS 0x0 /end MEASUREMENT
/begin MEASUREMENT Com_TxPduInfo[29].TxPduInitValueStartIdxOfTxPduInfo "" UWORD Com_TxPduInitValueStartIdxOfTxPduInfoType 0 0 0 65535 ECU_ADDRESS 0x0 /end MEASUREMENT
/begin MEASUREMENT Com_TxPduInfo[29].TxSigGrpInfoIndEndIdxOfTxPduInfo "" UBYTE Com_TxSigGrpInfoIndEndIdxOfTxPduInfoType 0 0 0 255 ECU_ADDRESS 0x0 /end MEASUREMENT
/begin MEASUREMENT Com_TxPduInfo[29].TxSigGrpInfoIndStartIdxOfTxPduInfo "" UBYTE Com_TxSigGrpInfoIndStartIdxOfTxPduInfoType 0 0 0 255 ECU_ADDRESS 0x0 /end MEASUREMENT
/begin MEASUREMENT Com_TxPduInfo[29].TxTOutInfoIdxOfTxPduInfo "" UBYTE Com_TxTOutInfoIdxOfTxPduInfoType 0 0 0 255 ECU_ADDRESS 0x0 /end MEASUREMENT
/begin MEASUREMENT Com_TxPduInfo[2].CbkTxAckDefFuncPtrIndEndIdxOfTxPduInfo "" UBYTE Com_CbkTxAckDefFuncPtrIndEndIdxOfTxPduInfoType 0 0 0 255 ECU_ADDRESS 0x0 /end MEASUREMENT
/begin MEASUREMENT Com_TxPduInfo[2].CbkTxAckDefFuncPtrIndStartIdxOfTxPduInfo "" UBYTE Com_CbkTxAckDefFuncPtrIndStartIdxOfTxPduInfoType 0 0 0 255 ECU_ADDRESS 0x0 /end MEASUREMENT
/begin MEASUREMENT Com_TxPduInfo[2].ExternalIdOfTxPduInfo "" UBYTE NO_COMPU_METHOD 0 0 0 255 ECU_ADDRESS 0x0 /end MEASUREMENT
/begin MEASUREMENT Com_TxPduInfo[2].IPduGroupInfoOfTxPduInfoIndEndIdxOfTxPduInfo "" UBYTE Com_IPduGroupInfoOfTxPduInfoIndEndIdxOfTxPduInfoType 0 0 0 255 ECU_ADDRESS 0x0 /end MEASUREMENT
/begin MEASUREMENT Com_TxPduInfo[2].IPduGroupInfoOfTxPduInfoIndStartIdxOfTxPduInfo "" UBYTE Com_IPduGroupInfoOfTxPduInfoIndStartIdxOfTxPduInfoType 0 0 0 255 ECU_ADDRESS 0x0 /end MEASUREMENT
/begin MEASUREMENT Com_TxPduInfo[2].PartitionsTxStructIdxOfTxPduInfo "" UBYTE NO_COMPU_METHOD 0 0 0 255 ECU_ADDRESS 0x0 /end MEASUREMENT
/begin MEASUREMENT Com_TxPduInfo[2].TxBufferLengthOfTxPduInfo "" UBYTE NO_COMPU_METHOD 0 0 0 255 ECU_ADDRESS 0x0 /end MEASUREMENT
/begin MEASUREMENT Com_TxPduInfo[2].TxPduCalloutFuncPtrIdxOfTxPduInfo "" UBYTE Com_TxPduCalloutFuncPtrIdxOfTxPduInfoType 0 0 0 255 ECU_ADDRESS 0x0 /end MEASUREMENT
/begin MEASUREMENT Com_TxPduInfo[2].TxPduInitValueEndIdxOfTxPduInfo "" UWORD Com_TxPduInitValueEndIdxOfTxPduInfoType 0 0 0 65535 ECU_ADDRESS 0x0 /end MEASUREMENT
/begin MEASUREMENT Com_TxPduInfo[2].TxPduInitValueStartIdxOfTxPduInfo "" UWORD Com_TxPduInitValueStartIdxOfTxPduInfoType 0 0 0 65535 ECU_ADDRESS 0x0 /end MEASUREMENT
/begin MEASUREMENT Com_TxPduInfo[2].TxSigGrpInfoIndEndIdxOfTxPduInfo "" UBYTE Com_TxSigGrpInfoIndEndIdxOfTxPduInfoType 0 0 0 255 ECU_ADDRESS 0x0 /end MEASUREMENT
/begin MEASUREMENT Com_TxPduInfo[2].TxSigGrpInfoIndStartIdxOfTxPduInfo "" UBYTE Com_TxSigGrpInfoIndStartIdxOfTxPduInfoType 0 0 0 255 ECU_ADDRESS 0x0 /end MEASUREMENT
/begin MEASUREMENT Com_TxPduInfo[2].TxTOutInfoIdxOfTxPduInfo "" UBYTE Com_TxTOutInfoIdxOfTxPduInfoType 0 0 0 255 ECU_ADDRESS 0x0 /end MEASUREMENT
/begin MEASUREMENT Com_TxPduInfo[30].CbkTxAckDefFuncPtrIndEndIdxOfTxPduInfo "" UBYTE Com_CbkTxAckDefFuncPtrIndEndIdxOfTxPduInfoType 0 0 0 255 ECU_ADDRESS 0x0 /end MEASUREMENT
/begin MEASUREMENT Com_TxPduInfo[30].CbkTxAckDefFuncPtrIndStartIdxOfTxPduInfo "" UBYTE Com_CbkTxAckDefFuncPtrIndStartIdxOfTxPduInfoType 0 0 0 255 ECU_ADDRESS 0x0 /end MEASUREMENT
/begin MEASUREMENT Com_TxPduInfo[30].ExternalIdOfTxPduInfo "" UBYTE NO_COMPU_METHOD 0 0 0 255 ECU_ADDRESS 0x0 /end MEASUREMENT
/begin MEASUREMENT Com_TxPduInfo[30].IPduGroupInfoOfTxPduInfoIndEndIdxOfTxPduInfo "" UBYTE Com_IPduGroupInfoOfTxPduInfoIndEndIdxOfTxPduInfoType 0 0 0 255 ECU_ADDRESS 0x0 /end MEASUREMENT
/begin MEASUREMENT Com_TxPduInfo[30].IPduGroupInfoOfTxPduInfoIndStartIdxOfTxPduInfo "" UBYTE Com_IPduGroupInfoOfTxPduInfoIndStartIdxOfTxPduInfoType 0 0 0 255 ECU_ADDRESS 0x0 /end MEASUREMENT
/begin MEASUREMENT Com_TxPduInfo[30].PartitionsTxStructIdxOfTxPduInfo "" UBYTE NO_COMPU_METHOD 0 0 0 255 ECU_ADDRESS 0x0 /end MEASUREMENT
/begin MEASUREMENT Com_TxPduInfo[30].TxBufferLengthOfTxPduInfo "" UBYTE NO_COMPU_METHOD 0 0 0 255 ECU_ADDRESS 0x0 /end MEASUREMENT
/begin MEASUREMENT Com_TxPduInfo[30].TxPduCalloutFuncPtrIdxOfTxPduInfo "" UBYTE Com_TxPduCalloutFuncPtrIdxOfTxPduInfoType 0 0 0 255 ECU_ADDRESS 0x0 /end MEASUREMENT
/begin MEASUREMENT Com_TxPduInfo[30].TxPduInitValueEndIdxOfTxPduInfo "" UWORD Com_TxPduInitValueEndIdxOfTxPduInfoType 0 0 0 65535 ECU_ADDRESS 0x0 /end MEASUREMENT
/begin MEASUREMENT Com_TxPduInfo[30].TxPduInitValueStartIdxOfTxPduInfo "" UWORD Com_TxPduInitValueStartIdxOfTxPduInfoType 0 0 0 65535 ECU_ADDRESS 0x0 /end MEASUREMENT
/begin MEASUREMENT Com_TxPduInfo[30].TxSigGrpInfoIndEndIdxOfTxPduInfo "" UBYTE Com_TxSigGrpInfoIndEndIdxOfTxPduInfoType 0 0 0 255 ECU_ADDRESS 0x0 /end MEASUREMENT
/begin MEASUREMENT Com_TxPduInfo[30].TxSigGrpInfoIndStartIdxOfTxPduInfo "" UBYTE Com_TxSigGrpInfoIndStartIdxOfTxPduInfoType 0 0 0 255 ECU_ADDRESS 0x0 /end MEASUREMENT
/begin MEASUREMENT Com_TxPduInfo[30].TxTOutInfoIdxOfTxPduInfo "" UBYTE Com_TxTOutInfoIdxOfTxPduInfoType 0 0 0 255 ECU_ADDRESS 0x0 /end MEASUREMENT
/begin MEASUREMENT Com_TxPduInfo[31].CbkTxAckDefFuncPtrIndEndIdxOfTxPduInfo "" UBYTE Com_CbkTxAckDefFuncPtrIndEndIdxOfTxPduInfoType 0 0 0 255 ECU_ADDRESS 0x0 /end MEASUREMENT
/begin MEASUREMENT Com_TxPduInfo[31].CbkTxAckDefFuncPtrIndStartIdxOfTxPduInfo "" UBYTE Com_CbkTxAckDefFuncPtrIndStartIdxOfTxPduInfoType 0 0 0 255 ECU_ADDRESS 0x0 /end MEASUREMENT
/begin MEASUREMENT Com_TxPduInfo[31].ExternalIdOfTxPduInfo "" UBYTE NO_COMPU_METHOD 0 0 0 255 ECU_ADDRESS 0x0 /end MEASUREMENT
/begin MEASUREMENT Com_TxPduInfo[31].IPduGroupInfoOfTxPduInfoIndEndIdxOfTxPduInfo "" UBYTE Com_IPduGroupInfoOfTxPduInfoIndEndIdxOfTxPduInfoType 0 0 0 255 ECU_ADDRESS 0x0 /end MEASUREMENT
/begin MEASUREMENT Com_TxPduInfo[31].IPduGroupInfoOfTxPduInfoIndStartIdxOfTxPduInfo "" UBYTE Com_IPduGroupInfoOfTxPduInfoIndStartIdxOfTxPduInfoType 0 0 0 255 ECU_ADDRESS 0x0 /end MEASUREMENT
/begin MEASUREMENT Com_TxPduInfo[31].PartitionsTxStructIdxOfTxPduInfo "" UBYTE NO_COMPU_METHOD 0 0 0 255 ECU_ADDRESS 0x0 /end MEASUREMENT
/begin MEASUREMENT Com_TxPduInfo[31].TxBufferLengthOfTxPduInfo "" UBYTE NO_COMPU_METHOD 0 0 0 255 ECU_ADDRESS 0x0 /end MEASUREMENT
/begin MEASUREMENT Com_TxPduInfo[31].TxPduCalloutFuncPtrIdxOfTxPduInfo "" UBYTE Com_TxPduCalloutFuncPtrIdxOfTxPduInfoType 0 0 0 255 ECU_ADDRESS 0x0 /end MEASUREMENT
/begin MEASUREMENT Com_TxPduInfo[31].TxPduInitValueEndIdxOfTxPduInfo "" UWORD Com_TxPduInitValueEndIdxOfTxPduInfoType 0 0 0 65535 ECU_ADDRESS 0x0 /end MEASUREMENT
/begin MEASUREMENT Com_TxPduInfo[31].TxPduInitValueStartIdxOfTxPduInfo "" UWORD Com_TxPduInitValueStartIdxOfTxPduInfoType 0 0 0 65535 ECU_ADDRESS 0x0 /end MEASUREMENT
/begin MEASUREMENT Com_TxPduInfo[31].TxSigGrpInfoIndEndIdxOfTxPduInfo "" UBYTE Com_TxSigGrpInfoIndEndIdxOfTxPduInfoType 0 0 0 255 ECU_ADDRESS 0x0 /end MEASUREMENT
/begin MEASUREMENT Com_TxPduInfo[31].TxSigGrpInfoIndStartIdxOfTxPduInfo "" UBYTE Com_TxSigGrpInfoIndStartIdxOfTxPduInfoType 0 0 0 255 ECU_ADDRESS 0x0 /end MEASUREMENT
/begin MEASUREMENT Com_TxPduInfo[31].TxTOutInfoIdxOfTxPduInfo "" UBYTE Com_TxTOutInfoIdxOfTxPduInfoType 0 0 0 255 ECU_ADDRESS 0x0 /end MEASUREMENT
/begin MEASUREMENT Com_TxPduInfo[3].CbkTxAckDefFuncPtrIndEndIdxOfTxPduInfo "" UBYTE Com_CbkTxAckDefFuncPtrIndEndIdxOfTxPduInfoType 0 0 0 255 ECU_ADDRESS 0x0 /end MEASUREMENT
/begin MEASUREMENT Com_TxPduInfo[3].CbkTxAckDefFuncPtrIndStartIdxOfTxPduInfo "" UBYTE Com_CbkTxAckDefFuncPtrIndStartIdxOfTxPduInfoType 0 0 0 255 ECU_ADDRESS 0x0 /end MEASUREMENT
/begin MEASUREMENT Com_TxPduInfo[3].ExternalIdOfTxPduInfo "" UBYTE NO_COMPU_METHOD 0 0 0 255 ECU_ADDRESS 0x0 /end MEASUREMENT
/begin MEASUREMENT Com_TxPduInfo[3].IPduGroupInfoOfTxPduInfoIndEndIdxOfTxPduInfo "" UBYTE Com_IPduGroupInfoOfTxPduInfoIndEndIdxOfTxPduInfoType 0 0 0 255 ECU_ADDRESS 0x0 /end MEASUREMENT
/begin MEASUREMENT Com_TxPduInfo[3].IPduGroupInfoOfTxPduInfoIndStartIdxOfTxPduInfo "" UBYTE Com_IPduGroupInfoOfTxPduInfoIndStartIdxOfTxPduInfoType 0 0 0 255 ECU_ADDRESS 0x0 /end MEASUREMENT
/begin MEASUREMENT Com_TxPduInfo[3].PartitionsTxStructIdxOfTxPduInfo "" UBYTE NO_COMPU_METHOD 0 0 0 255 ECU_ADDRESS 0x0 /end MEASUREMENT
/begin MEASUREMENT Com_TxPduInfo[3].TxBufferLengthOfTxPduInfo "" UBYTE NO_COMPU_METHOD 0 0 0 255 ECU_ADDRESS 0x0 /end MEASUREMENT
/begin MEASUREMENT Com_TxPduInfo[3].TxPduCalloutFuncPtrIdxOfTxPduInfo "" UBYTE Com_TxPduCalloutFuncPtrIdxOfTxPduInfoType 0 0 0 255 ECU_ADDRESS 0x0 /end MEASUREMENT
/begin MEASUREMENT Com_TxPduInfo[3].TxPduInitValueEndIdxOfTxPduInfo "" UWORD Com_TxPduInitValueEndIdxOfTxPduInfoType 0 0 0 65535 ECU_ADDRESS 0x0 /end MEASUREMENT
/begin MEASUREMENT Com_TxPduInfo[3].TxPduInitValueStartIdxOfTxPduInfo "" UWORD Com_TxPduInitValueStartIdxOfTxPduInfoType 0 0 0 65535 ECU_ADDRESS 0x0 /end MEASUREMENT
/begin MEASUREMENT Com_TxPduInfo[3].TxSigGrpInfoIndEndIdxOfTxPduInfo "" UBYTE Com_TxSigGrpInfoIndEndIdxOfTxPduInfoType 0 0 0 255 ECU_ADDRESS 0x0 /end MEASUREMENT
/begin MEASUREMENT Com_TxPduInfo[3].TxSigGrpInfoIndStartIdxOfTxPduInfo "" UBYTE Com_TxSigGrpInfoIndStartIdxOfTxPduInfoType 0 0 0 255 ECU_ADDRESS 0x0 /end MEASUREMENT
/begin MEASUREMENT Com_TxPduInfo[3].TxTOutInfoIdxOfTxPduInfo "" UBYTE Com_TxTOutInfoIdxOfTxPduInfoType 0 0 0 255 ECU_ADDRESS 0x0 /end MEASUREMENT
/begin MEASUREMENT Com_TxPduInfo[4].CbkTxAckDefFuncPtrIndEndIdxOfTxPduInfo "" UBYTE Com_CbkTxAckDefFuncPtrIndEndIdxOfTxPduInfoType 0 0 0 255 ECU_ADDRESS 0x0 /end MEASUREMENT
/begin MEASUREMENT Com_TxPduInfo[4].CbkTxAckDefFuncPtrIndStartIdxOfTxPduInfo "" UBYTE Com_CbkTxAckDefFuncPtrIndStartIdxOfTxPduInfoType 0 0 0 255 ECU_ADDRESS 0x0 /end MEASUREMENT
/begin MEASUREMENT Com_TxPduInfo[4].ExternalIdOfTxPduInfo "" UBYTE NO_COMPU_METHOD 0 0 0 255 ECU_ADDRESS 0x0 /end MEASUREMENT
/begin MEASUREMENT Com_TxPduInfo[4].IPduGroupInfoOfTxPduInfoIndEndIdxOfTxPduInfo "" UBYTE Com_IPduGroupInfoOfTxPduInfoIndEndIdxOfTxPduInfoType 0 0 0 255 ECU_ADDRESS 0x0 /end MEASUREMENT
/begin MEASUREMENT Com_TxPduInfo[4].IPduGroupInfoOfTxPduInfoIndStartIdxOfTxPduInfo "" UBYTE Com_IPduGroupInfoOfTxPduInfoIndStartIdxOfTxPduInfoType 0 0 0 255 ECU_ADDRESS 0x0 /end MEASUREMENT
/begin MEASUREMENT Com_TxPduInfo[4].PartitionsTxStructIdxOfTxPduInfo "" UBYTE NO_COMPU_METHOD 0 0 0 255 ECU_ADDRESS 0x0 /end MEASUREMENT
/begin MEASUREMENT Com_TxPduInfo[4].TxBufferLengthOfTxPduInfo "" UBYTE NO_COMPU_METHOD 0 0 0 255 ECU_ADDRESS 0x0 /end MEASUREMENT
/begin MEASUREMENT Com_TxPduInfo[4].TxPduCalloutFuncPtrIdxOfTxPduInfo "" UBYTE Com_TxPduCalloutFuncPtrIdxOfTxPduInfoType 0 0 0 255 ECU_ADDRESS 0x0 /end MEASUREMENT
/begin MEASUREMENT Com_TxPduInfo[4].TxPduInitValueEndIdxOfTxPduInfo "" UWORD Com_TxPduInitValueEndIdxOfTxPduInfoType 0 0 0 65535 ECU_ADDRESS 0x0 /end MEASUREMENT
/begin MEASUREMENT Com_TxPduInfo[4].TxPduInitValueStartIdxOfTxPduInfo "" UWORD Com_TxPduInitValueStartIdxOfTxPduInfoType 0 0 0 65535 ECU_ADDRESS 0x0 /end MEASUREMENT
/begin MEASUREMENT Com_TxPduInfo[4].TxSigGrpInfoIndEndIdxOfTxPduInfo "" UBYTE Com_TxSigGrpInfoIndEndIdxOfTxPduInfoType 0 0 0 255 ECU_ADDRESS 0x0 /end MEASUREMENT
/begin MEASUREMENT Com_TxPduInfo[4].TxSigGrpInfoIndStartIdxOfTxPduInfo "" UBYTE Com_TxSigGrpInfoIndStartIdxOfTxPduInfoType 0 0 0 255 ECU_ADDRESS 0x0 /end MEASUREMENT
/begin MEASUREMENT Com_TxPduInfo[4].TxTOutInfoIdxOfTxPduInfo "" UBYTE Com_TxTOutInfoIdxOfTxPduInfoType 0 0 0 255 ECU_ADDRESS 0x0 /end MEASUREMENT
/begin MEASUREMENT Com_TxPduInfo[5].CbkTxAckDefFuncPtrIndEndIdxOfTxPduInfo "" UBYTE Com_CbkTxAckDefFuncPtrIndEndIdxOfTxPduInfoType 0 0 0 255 ECU_ADDRESS 0x0 /end MEASUREMENT
/begin MEASUREMENT Com_TxPduInfo[5].CbkTxAckDefFuncPtrIndStartIdxOfTxPduInfo "" UBYTE Com_CbkTxAckDefFuncPtrIndStartIdxOfTxPduInfoType 0 0 0 255 ECU_ADDRESS 0x0 /end MEASUREMENT
/begin MEASUREMENT Com_TxPduInfo[5].ExternalIdOfTxPduInfo "" UBYTE NO_COMPU_METHOD 0 0 0 255 ECU_ADDRESS 0x0 /end MEASUREMENT
/begin MEASUREMENT Com_TxPduInfo[5].IPduGroupInfoOfTxPduInfoIndEndIdxOfTxPduInfo "" UBYTE Com_IPduGroupInfoOfTxPduInfoIndEndIdxOfTxPduInfoType 0 0 0 255 ECU_ADDRESS 0x0 /end MEASUREMENT
/begin MEASUREMENT Com_TxPduInfo[5].IPduGroupInfoOfTxPduInfoIndStartIdxOfTxPduInfo "" UBYTE Com_IPduGroupInfoOfTxPduInfoIndStartIdxOfTxPduInfoType 0 0 0 255 ECU_ADDRESS 0x0 /end MEASUREMENT
/begin MEASUREMENT Com_TxPduInfo[5].PartitionsTxStructIdxOfTxPduInfo "" UBYTE NO_COMPU_METHOD 0 0 0 255 ECU_ADDRESS 0x0 /end MEASUREMENT
/begin MEASUREMENT Com_TxPduInfo[5].TxBufferLengthOfTxPduInfo "" UBYTE NO_COMPU_METHOD 0 0 0 255 ECU_ADDRESS 0x0 /end MEASUREMENT
/begin MEASUREMENT Com_TxPduInfo[5].TxPduCalloutFuncPtrIdxOfTxPduInfo "" UBYTE Com_TxPduCalloutFuncPtrIdxOfTxPduInfoType 0 0 0 255 ECU_ADDRESS 0x0 /end MEASUREMENT
/begin MEASUREMENT Com_TxPduInfo[5].TxPduInitValueEndIdxOfTxPduInfo "" UWORD Com_TxPduInitValueEndIdxOfTxPduInfoType 0 0 0 65535 ECU_ADDRESS 0x0 /end MEASUREMENT
/begin MEASUREMENT Com_TxPduInfo[5].TxPduInitValueStartIdxOfTxPduInfo "" UWORD Com_TxPduInitValueStartIdxOfTxPduInfoType 0 0 0 65535 ECU_ADDRESS 0x0 /end MEASUREMENT
/begin MEASUREMENT Com_TxPduInfo[5].TxSigGrpInfoIndEndIdxOfTxPduInfo "" UBYTE Com_TxSigGrpInfoIndEndIdxOfTxPduInfoType 0 0 0 255 ECU_ADDRESS 0x0 /end MEASUREMENT
/begin MEASUREMENT Com_TxPduInfo[5].TxSigGrpInfoIndStartIdxOfTxPduInfo "" UBYTE Com_TxSigGrpInfoIndStartIdxOfTxPduInfoType 0 0 0 255 ECU_ADDRESS 0x0 /end MEASUREMENT
/begin MEASUREMENT Com_TxPduInfo[5].TxTOutInfoIdxOfTxPduInfo "" UBYTE Com_TxTOutInfoIdxOfTxPduInfoType 0 0 0 255 ECU_ADDRESS 0x0 /end MEASUREMENT
/begin MEASUREMENT Com_TxPduInfo[6].CbkTxAckDefFuncPtrIndEndIdxOfTxPduInfo "" UBYTE Com_CbkTxAckDefFuncPtrIndEndIdxOfTxPduInfoType 0 0 0 255 ECU_ADDRESS 0x0 /end MEASUREMENT
/begin MEASUREMENT Com_TxPduInfo[6].CbkTxAckDefFuncPtrIndStartIdxOfTxPduInfo "" UBYTE Com_CbkTxAckDefFuncPtrIndStartIdxOfTxPduInfoType 0 0 0 255 ECU_ADDRESS 0x0 /end MEASUREMENT
/begin MEASUREMENT Com_TxPduInfo[6].ExternalIdOfTxPduInfo "" UBYTE NO_COMPU_METHOD 0 0 0 255 ECU_ADDRESS 0x0 /end MEASUREMENT
/begin MEASUREMENT Com_TxPduInfo[6].IPduGroupInfoOfTxPduInfoIndEndIdxOfTxPduInfo "" UBYTE Com_IPduGroupInfoOfTxPduInfoIndEndIdxOfTxPduInfoType 0 0 0 255 ECU_ADDRESS 0x0 /end MEASUREMENT
/begin MEASUREMENT Com_TxPduInfo[6].IPduGroupInfoOfTxPduInfoIndStartIdxOfTxPduInfo "" UBYTE Com_IPduGroupInfoOfTxPduInfoIndStartIdxOfTxPduInfoType 0 0 0 255 ECU_ADDRESS 0x0 /end MEASUREMENT
/begin MEASUREMENT Com_TxPduInfo[6].PartitionsTxStructIdxOfTxPduInfo "" UBYTE NO_COMPU_METHOD 0 0 0 255 ECU_ADDRESS 0x0 /end MEASUREMENT
/begin MEASUREMENT Com_TxPduInfo[6].TxBufferLengthOfTxPduInfo "" UBYTE NO_COMPU_METHOD 0 0 0 255 ECU_ADDRESS 0x0 /end MEASUREMENT
/begin MEASUREMENT Com_TxPduInfo[6].TxPduCalloutFuncPtrIdxOfTxPduInfo "" UBYTE Com_TxPduCalloutFuncPtrIdxOfTxPduInfoType 0 0 0 255 ECU_ADDRESS 0x0 /end MEASUREMENT
/begin MEASUREMENT Com_TxPduInfo[6].TxPduInitValueEndIdxOfTxPduInfo "" UWORD Com_TxPduInitValueEndIdxOfTxPduInfoType 0 0 0 65535 ECU_ADDRESS 0x0 /end MEASUREMENT
/begin MEASUREMENT Com_TxPduInfo[6].TxPduInitValueStartIdxOfTxPduInfo "" UWORD Com_TxPduInitValueStartIdxOfTxPduInfoType 0 0 0 65535 ECU_ADDRESS 0x0 /end MEASUREMENT
/begin MEASUREMENT Com_TxPduInfo[6].TxSigGrpInfoIndEndIdxOfTxPduInfo "" UBYTE Com_TxSigGrpInfoIndEndIdxOfTxPduInfoType 0 0 0 255 ECU_ADDRESS 0x0 /end MEASUREMENT
/begin MEASUREMENT Com_TxPduInfo[6].TxSigGrpInfoIndStartIdxOfTxPduInfo "" UBYTE Com_TxSigGrpInfoIndStartIdxOfTxPduInfoType 0 0 0 255 ECU_ADDRESS 0x0 /end MEASUREMENT
/begin MEASUREMENT Com_TxPduInfo[6].TxTOutInfoIdxOfTxPduInfo "" UBYTE Com_TxTOutInfoIdxOfTxPduInfoType 0 0 0 255 ECU_ADDRESS 0x0 /end MEASUREMENT
/begin MEASUREMENT Com_TxPduInfo[7].CbkTxAckDefFuncPtrIndEndIdxOfTxPduInfo "" UBYTE Com_CbkTxAckDefFuncPtrIndEndIdxOfTxPduInfoType 0 0 0 255 ECU_ADDRESS 0x0 /end MEASUREMENT
/begin MEASUREMENT Com_TxPduInfo[7].CbkTxAckDefFuncPtrIndStartIdxOfTxPduInfo "" UBYTE Com_CbkTxAckDefFuncPtrIndStartIdxOfTxPduInfoType 0 0 0 255 ECU_ADDRESS 0x0 /end MEASUREMENT
/begin MEASUREMENT Com_TxPduInfo[7].ExternalIdOfTxPduInfo "" UBYTE NO_COMPU_METHOD 0 0 0 255 ECU_ADDRESS 0x0 /end MEASUREMENT
/begin MEASUREMENT Com_TxPduInfo[7].IPduGroupInfoOfTxPduInfoIndEndIdxOfTxPduInfo "" UBYTE Com_IPduGroupInfoOfTxPduInfoIndEndIdxOfTxPduInfoType 0 0 0 255 ECU_ADDRESS 0x0 /end MEASUREMENT
/begin MEASUREMENT Com_TxPduInfo[7].IPduGroupInfoOfTxPduInfoIndStartIdxOfTxPduInfo "" UBYTE Com_IPduGroupInfoOfTxPduInfoIndStartIdxOfTxPduInfoType 0 0 0 255 ECU_ADDRESS 0x0 /end MEASUREMENT
/begin MEASUREMENT Com_TxPduInfo[7].PartitionsTxStructIdxOfTxPduInfo "" UBYTE NO_COMPU_METHOD 0 0 0 255 ECU_ADDRESS 0x0 /end MEASUREMENT
/begin MEASUREMENT Com_TxPduInfo[7].TxBufferLengthOfTxPduInfo "" UBYTE NO_COMPU_METHOD 0 0 0 255 ECU_ADDRESS 0x0 /end MEASUREMENT
/begin MEASUREMENT Com_TxPduInfo[7].TxPduCalloutFuncPtrIdxOfTxPduInfo "" UBYTE Com_TxPduCalloutFuncPtrIdxOfTxPduInfoType 0 0 0 255 ECU_ADDRESS 0x0 /end MEASUREMENT
/begin MEASUREMENT Com_TxPduInfo[7].TxPduInitValueEndIdxOfTxPduInfo "" UWORD Com_TxPduInitValueEndIdxOfTxPduInfoType 0 0 0 65535 ECU_ADDRESS 0x0 /end MEASUREMENT
/begin MEASUREMENT Com_TxPduInfo[7].TxPduInitValueStartIdxOfTxPduInfo "" UWORD Com_TxPduInitValueStartIdxOfTxPduInfoType 0 0 0 65535 ECU_ADDRESS 0x0 /end MEASUREMENT
/begin MEASUREMENT Com_TxPduInfo[7].TxSigGrpInfoIndEndIdxOfTxPduInfo "" UBYTE Com_TxSigGrpInfoIndEndIdxOfTxPduInfoType 0 0 0 255 ECU_ADDRESS 0x0 /end MEASUREMENT
/begin MEASUREMENT Com_TxPduInfo[7].TxSigGrpInfoIndStartIdxOfTxPduInfo "" UBYTE Com_TxSigGrpInfoIndStartIdxOfTxPduInfoType 0 0 0 255 ECU_ADDRESS 0x0 /end MEASUREMENT
/begin MEASUREMENT Com_TxPduInfo[7].TxTOutInfoIdxOfTxPduInfo "" UBYTE Com_TxTOutInfoIdxOfTxPduInfoType 0 0 0 255 ECU_ADDRESS 0x0 /end MEASUREMENT
/begin MEASUREMENT Com_TxPduInfo[8].CbkTxAckDefFuncPtrIndEndIdxOfTxPduInfo "" UBYTE Com_CbkTxAckDefFuncPtrIndEndIdxOfTxPduInfoType 0 0 0 255 ECU_ADDRESS 0x0 /end MEASUREMENT
/begin MEASUREMENT Com_TxPduInfo[8].CbkTxAckDefFuncPtrIndStartIdxOfTxPduInfo "" UBYTE Com_CbkTxAckDefFuncPtrIndStartIdxOfTxPduInfoType 0 0 0 255 ECU_ADDRESS 0x0 /end MEASUREMENT
/begin MEASUREMENT Com_TxPduInfo[8].ExternalIdOfTxPduInfo "" UBYTE NO_COMPU_METHOD 0 0 0 255 ECU_ADDRESS 0x0 /end MEASUREMENT
/begin MEASUREMENT Com_TxPduInfo[8].IPduGroupInfoOfTxPduInfoIndEndIdxOfTxPduInfo "" UBYTE Com_IPduGroupInfoOfTxPduInfoIndEndIdxOfTxPduInfoType 0 0 0 255 ECU_ADDRESS 0x0 /end MEASUREMENT
/begin MEASUREMENT Com_TxPduInfo[8].IPduGroupInfoOfTxPduInfoIndStartIdxOfTxPduInfo "" UBYTE Com_IPduGroupInfoOfTxPduInfoIndStartIdxOfTxPduInfoType 0 0 0 255 ECU_ADDRESS 0x0 /end MEASUREMENT
/begin MEASUREMENT Com_TxPduInfo[8].PartitionsTxStructIdxOfTxPduInfo "" UBYTE NO_COMPU_METHOD 0 0 0 255 ECU_ADDRESS 0x0 /end MEASUREMENT
/begin MEASUREMENT Com_TxPduInfo[8].TxBufferLengthOfTxPduInfo "" UBYTE NO_COMPU_METHOD 0 0 0 255 ECU_ADDRESS 0x0 /end MEASUREMENT
/begin MEASUREMENT Com_TxPduInfo[8].TxPduCalloutFuncPtrIdxOfTxPduInfo "" UBYTE Com_TxPduCalloutFuncPtrIdxOfTxPduInfoType 0 0 0 255 ECU_ADDRESS 0x0 /end MEASUREMENT
/begin MEASUREMENT Com_TxPduInfo[8].TxPduInitValueEndIdxOfTxPduInfo "" UWORD Com_TxPduInitValueEndIdxOfTxPduInfoType 0 0 0 65535 ECU_ADDRESS 0x0 /end MEASUREMENT
/begin MEASUREMENT Com_TxPduInfo[8].TxPduInitValueStartIdxOfTxPduInfo "" UWORD Com_TxPduInitValueStartIdxOfTxPduInfoType 0 0 0 65535 ECU_ADDRESS 0x0 /end MEASUREMENT
/begin MEASUREMENT Com_TxPduInfo[8].TxSigGrpInfoIndEndIdxOfTxPduInfo "" UBYTE Com_TxSigGrpInfoIndEndIdxOfTxPduInfoType 0 0 0 255 ECU_ADDRESS 0x0 /end MEASUREMENT
/begin MEASUREMENT Com_TxPduInfo[8].TxSigGrpInfoIndStartIdxOfTxPduInfo "" UBYTE Com_TxSigGrpInfoIndStartIdxOfTxPduInfoType 0 0 0 255 ECU_ADDRESS 0x0 /end MEASUREMENT
/begin MEASUREMENT Com_TxPduInfo[8].TxTOutInfoIdxOfTxPduInfo "" UBYTE Com_TxTOutInfoIdxOfTxPduInfoType 0 0 0 255 ECU_ADDRESS 0x0 /end MEASUREMENT
/begin MEASUREMENT Com_TxPduInfo[9].CbkTxAckDefFuncPtrIndEndIdxOfTxPduInfo "" UBYTE Com_CbkTxAckDefFuncPtrIndEndIdxOfTxPduInfoType 0 0 0 255 ECU_ADDRESS 0x0 /end MEASUREMENT
/begin MEASUREMENT Com_TxPduInfo[9].CbkTxAckDefFuncPtrIndStartIdxOfTxPduInfo "" UBYTE Com_CbkTxAckDefFuncPtrIndStartIdxOfTxPduInfoType 0 0 0 255 ECU_ADDRESS 0x0 /end MEASUREMENT
/begin MEASUREMENT Com_TxPduInfo[9].ExternalIdOfTxPduInfo "" UBYTE NO_COMPU_METHOD 0 0 0 255 ECU_ADDRESS 0x0 /end MEASUREMENT
/begin MEASUREMENT Com_TxPduInfo[9].IPduGroupInfoOfTxPduInfoIndEndIdxOfTxPduInfo "" UBYTE Com_IPduGroupInfoOfTxPduInfoIndEndIdxOfTxPduInfoType 0 0 0 255 ECU_ADDRESS 0x0 /end MEASUREMENT
/begin MEASUREMENT Com_TxPduInfo[9].IPduGroupInfoOfTxPduInfoIndStartIdxOfTxPduInfo "" UBYTE Com_IPduGroupInfoOfTxPduInfoIndStartIdxOfTxPduInfoType 0 0 0 255 ECU_ADDRESS 0x0 /end MEASUREMENT
/begin MEASUREMENT Com_TxPduInfo[9].PartitionsTxStructIdxOfTxPduInfo "" UBYTE NO_COMPU_METHOD 0 0 0 255 ECU_ADDRESS 0x0 /end MEASUREMENT
/begin MEASUREMENT Com_TxPduInfo[9].TxBufferLengthOfTxPduInfo "" UBYTE NO_COMPU_METHOD 0 0 0 255 ECU_ADDRESS 0x0 /end MEASUREMENT
/begin MEASUREMENT Com_TxPduInfo[9].TxPduCalloutFuncPtrIdxOfTxPduInfo "" UBYTE Com_TxPduCalloutFuncPtrIdxOfTxPduInfoType 0 0 0 255 ECU_ADDRESS 0x0 /end MEASUREMENT
/begin MEASUREMENT Com_TxPduInfo[9].TxPduInitValueEndIdxOfTxPduInfo "" UWORD Com_TxPduInitValueEndIdxOfTxPduInfoType 0 0 0 65535 ECU_ADDRESS 0x0 /end MEASUREMENT
/begin MEASUREMENT Com_TxPduInfo[9].TxPduInitValueStartIdxOfTxPduInfo "" UWORD Com_TxPduInitValueStartIdxOfTxPduInfoType 0 0 0 65535 ECU_ADDRESS 0x0 /end MEASUREMENT
/begin MEASUREMENT Com_TxPduInfo[9].TxSigGrpInfoIndEndIdxOfTxPduInfo "" UBYTE Com_TxSigGrpInfoIndEndIdxOfTxPduInfoType 0 0 0 255 ECU_ADDRESS 0x0 /end MEASUREMENT
/begin MEASUREMENT Com_TxPduInfo[9].TxSigGrpInfoIndStartIdxOfTxPduInfo "" UBYTE Com_TxSigGrpInfoIndStartIdxOfTxPduInfoType 0 0 0 255 ECU_ADDRESS 0x0 /end MEASUREMENT
/begin MEASUREMENT Com_TxPduInfo[9].TxTOutInfoIdxOfTxPduInfo "" UBYTE Com_TxTOutInfoIdxOfTxPduInfoType 0 0 0 255 ECU_ADDRESS 0x0 /end MEASUREMENT
/begin MEASUREMENT Com_TxPduInitValue "Initial values used for Tx I-PDU buffer initialization." UBYTE NO_COMPU_METHOD 0 0 0 255 ECU_ADDRESS 0x0 MATRIX_DIM 851 /end MEASUREMENT
/begin MEASUREMENT Com_TxProcessingISRLockCounter "" UWORD NO_COMPU_METHOD 0 0 0 65535 ECU_ADDRESS 0x0 SYMBOL_LINK "Com_TxProcessingISRLockCounter.raw" 0 /end MEASUREMENT
/begin MEASUREMENT Com_TxProcessingISRLockCounter_ComMainFunctionTx "The element: ComMainFunctionTx of Com_TxProcessingISRLockCounter" UWORD NO_COMPU_METHOD 0 0 0 65535 ECU_ADDRESS 0x0 SYMBOL_LINK "Com_TxProcessingISRLockCounter.raw[0]" 0 /end MEASUREMENT
/begin MEASUREMENT Com_TxSduLength "This var Array contains the Com Ipdu Length." UWORD NO_COMPU_METHOD 0 0 0 65535 ECU_ADDRESS 0x0 MATRIX_DIM 32 /end MEASUREMENT
/begin MEASUREMENT Com_TxSigGrpInfo[0].SigGroupOnChangeOffsetOfTxSigGrpInfo "" UBYTE NO_COMPU_METHOD 0 0 0 255 ECU_ADDRESS 0x0 /end MEASUREMENT
/begin MEASUREMENT Com_TxSigGrpInfo[0].TransferPropertyOfTxSigGrpInfo "" UBYTE Com_TransferPropertyOfTxSigGrpInfoType 0 0 0 255 ECU_ADDRESS 0x0 /end MEASUREMENT
/begin MEASUREMENT Com_TxSigGrpInfo[0].TxBufferEndIdxOfTxSigGrpInfo "" UWORD Com_TxBufferEndIdxOfTxSigGrpInfoType 0 0 0 65535 ECU_ADDRESS 0x0 /end MEASUREMENT
/begin MEASUREMENT Com_TxSigGrpInfo[0].TxBufferSigGrpInTxIPDUEndIdxOfTxSigGrpInfo "" UWORD Com_TxBufferSigGrpInTxIPDUEndIdxOfTxSigGrpInfoType 0 0 0 65535 ECU_ADDRESS 0x0 /end MEASUREMENT
/begin MEASUREMENT Com_TxSigGrpInfo[0].TxBufferSigGrpInTxIPDUStartIdxOfTxSigGrpInfo "" UWORD Com_TxBufferSigGrpInTxIPDUStartIdxOfTxSigGrpInfoType 0 0 0 65535 ECU_ADDRESS 0x0 /end MEASUREMENT
/begin MEASUREMENT Com_TxSigGrpInfo[0].TxBufferStartIdxOfTxSigGrpInfo "" UWORD Com_TxBufferStartIdxOfTxSigGrpInfoType 0 0 0 65535 ECU_ADDRESS 0x0 /end MEASUREMENT
/begin MEASUREMENT Com_TxSigGrpInfo[0].TxGrpSigInfoInvValueIndEndIdxOfTxSigGrpInfo "" UBYTE Com_TxGrpSigInfoInvValueIndEndIdxOfTxSigGrpInfoType 0 0 0 255 ECU_ADDRESS 0x0 /end MEASUREMENT
/begin MEASUREMENT Com_TxSigGrpInfo[0].TxGrpSigInfoInvValueIndStartIdxOfTxSigGrpInfo "" UBYTE Com_TxGrpSigInfoInvValueIndStartIdxOfTxSigGrpInfoType 0 0 0 255 ECU_ADDRESS 0x0 /end MEASUREMENT
/begin MEASUREMENT Com_TxSigGrpInfo[0].TxPduInfoIdxOfTxSigGrpInfo "" UBYTE NO_COMPU_METHOD 0 0 0 255 ECU_ADDRESS 0x0 /end MEASUREMENT
/begin MEASUREMENT Com_TxSigGrpInfo[0].TxSigGrpMaskEndIdxOfTxSigGrpInfo "" UBYTE Com_TxSigGrpMaskEndIdxOfTxSigGrpInfoType 0 0 0 255 ECU_ADDRESS 0x0 /end MEASUREMENT
/begin MEASUREMENT Com_TxSigGrpInfo[0].TxSigGrpMaskStartIdxOfTxSigGrpInfo "" UBYTE Com_TxSigGrpMaskStartIdxOfTxSigGrpInfoType 0 0 0 255 ECU_ADDRESS 0x0 /end MEASUREMENT
/begin MEASUREMENT Com_TxSigGrpInfo[1].SigGroupOnChangeOffsetOfTxSigGrpInfo "" UBYTE NO_COMPU_METHOD 0 0 0 255 ECU_ADDRESS 0x0 /end MEASUREMENT
/begin MEASUREMENT Com_TxSigGrpInfo[1].TransferPropertyOfTxSigGrpInfo "" UBYTE Com_TransferPropertyOfTxSigGrpInfoType 0 0 0 255 ECU_ADDRESS 0x0 /end MEASUREMENT
/begin MEASUREMENT Com_TxSigGrpInfo[1].TxBufferEndIdxOfTxSigGrpInfo "" UWORD Com_TxBufferEndIdxOfTxSigGrpInfoType 0 0 0 65535 ECU_ADDRESS 0x0 /end MEASUREMENT
/begin MEASUREMENT Com_TxSigGrpInfo[1].TxBufferSigGrpInTxIPDUEndIdxOfTxSigGrpInfo "" UWORD Com_TxBufferSigGrpInTxIPDUEndIdxOfTxSigGrpInfoType 0 0 0 65535 ECU_ADDRESS 0x0 /end MEASUREMENT
/begin MEASUREMENT Com_TxSigGrpInfo[1].TxBufferSigGrpInTxIPDUStartIdxOfTxSigGrpInfo "" UWORD Com_TxBufferSigGrpInTxIPDUStartIdxOfTxSigGrpInfoType 0 0 0 65535 ECU_ADDRESS 0x0 /end MEASUREMENT
/begin MEASUREMENT Com_TxSigGrpInfo[1].TxBufferStartIdxOfTxSigGrpInfo "" UWORD Com_TxBufferStartIdxOfTxSigGrpInfoType 0 0 0 65535 ECU_ADDRESS 0x0 /end MEASUREMENT
/begin MEASUREMENT Com_TxSigGrpInfo[1].TxGrpSigInfoInvValueIndEndIdxOfTxSigGrpInfo "" UBYTE Com_TxGrpSigInfoInvValueIndEndIdxOfTxSigGrpInfoType 0 0 0 255 ECU_ADDRESS 0x0 /end MEASUREMENT
/begin MEASUREMENT Com_TxSigGrpInfo[1].TxGrpSigInfoInvValueIndStartIdxOfTxSigGrpInfo "" UBYTE Com_TxGrpSigInfoInvValueIndStartIdxOfTxSigGrpInfoType 0 0 0 255 ECU_ADDRESS 0x0 /end MEASUREMENT
/begin MEASUREMENT Com_TxSigGrpInfo[1].TxPduInfoIdxOfTxSigGrpInfo "" UBYTE NO_COMPU_METHOD 0 0 0 255 ECU_ADDRESS 0x0 /end MEASUREMENT
/begin MEASUREMENT Com_TxSigGrpInfo[1].TxSigGrpMaskEndIdxOfTxSigGrpInfo "" UBYTE Com_TxSigGrpMaskEndIdxOfTxSigGrpInfoType 0 0 0 255 ECU_ADDRESS 0x0 /end MEASUREMENT
/begin MEASUREMENT Com_TxSigGrpInfo[1].TxSigGrpMaskStartIdxOfTxSigGrpInfo "" UBYTE Com_TxSigGrpMaskStartIdxOfTxSigGrpInfoType 0 0 0 255 ECU_ADDRESS 0x0 /end MEASUREMENT
/begin MEASUREMENT Com_TxSigGrpInfo[2].SigGroupOnChangeOffsetOfTxSigGrpInfo "" UBYTE NO_COMPU_METHOD 0 0 0 255 ECU_ADDRESS 0x0 /end MEASUREMENT
/begin MEASUREMENT Com_TxSigGrpInfo[2].TransferPropertyOfTxSigGrpInfo "" UBYTE Com_TransferPropertyOfTxSigGrpInfoType 0 0 0 255 ECU_ADDRESS 0x0 /end MEASUREMENT
/begin MEASUREMENT Com_TxSigGrpInfo[2].TxBufferEndIdxOfTxSigGrpInfo "" UWORD Com_TxBufferEndIdxOfTxSigGrpInfoType 0 0 0 65535 ECU_ADDRESS 0x0 /end MEASUREMENT
/begin MEASUREMENT Com_TxSigGrpInfo[2].TxBufferSigGrpInTxIPDUEndIdxOfTxSigGrpInfo "" UWORD Com_TxBufferSigGrpInTxIPDUEndIdxOfTxSigGrpInfoType 0 0 0 65535 ECU_ADDRESS 0x0 /end MEASUREMENT
/begin MEASUREMENT Com_TxSigGrpInfo[2].TxBufferSigGrpInTxIPDUStartIdxOfTxSigGrpInfo "" UWORD Com_TxBufferSigGrpInTxIPDUStartIdxOfTxSigGrpInfoType 0 0 0 65535 ECU_ADDRESS 0x0 /end MEASUREMENT
/begin MEASUREMENT Com_TxSigGrpInfo[2].TxBufferStartIdxOfTxSigGrpInfo "" UWORD Com_TxBufferStartIdxOfTxSigGrpInfoType 0 0 0 65535 ECU_ADDRESS 0x0 /end MEASUREMENT
/begin MEASUREMENT Com_TxSigGrpInfo[2].TxGrpSigInfoInvValueIndEndIdxOfTxSigGrpInfo "" UBYTE Com_TxGrpSigInfoInvValueIndEndIdxOfTxSigGrpInfoType 0 0 0 255 ECU_ADDRESS 0x0 /end MEASUREMENT
/begin MEASUREMENT Com_TxSigGrpInfo[2].TxGrpSigInfoInvValueIndStartIdxOfTxSigGrpInfo "" UBYTE Com_TxGrpSigInfoInvValueIndStartIdxOfTxSigGrpInfoType 0 0 0 255 ECU_ADDRESS 0x0 /end MEASUREMENT
/begin MEASUREMENT Com_TxSigGrpInfo[2].TxPduInfoIdxOfTxSigGrpInfo "" UBYTE NO_COMPU_METHOD 0 0 0 255 ECU_ADDRESS 0x0 /end MEASUREMENT
/begin MEASUREMENT Com_TxSigGrpInfo[2].TxSigGrpMaskEndIdxOfTxSigGrpInfo "" UBYTE Com_TxSigGrpMaskEndIdxOfTxSigGrpInfoType 0 0 0 255 ECU_ADDRESS 0x0 /end MEASUREMENT
/begin MEASUREMENT Com_TxSigGrpInfo[2].TxSigGrpMaskStartIdxOfTxSigGrpInfo "" UBYTE Com_TxSigGrpMaskStartIdxOfTxSigGrpInfoType 0 0 0 255 ECU_ADDRESS 0x0 /end MEASUREMENT
/begin MEASUREMENT Com_TxSigGrpInfo[3].SigGroupOnChangeOffsetOfTxSigGrpInfo "" UBYTE NO_COMPU_METHOD 0 0 0 255 ECU_ADDRESS 0x0 /end MEASUREMENT
/begin MEASUREMENT Com_TxSigGrpInfo[3].TransferPropertyOfTxSigGrpInfo "" UBYTE Com_TransferPropertyOfTxSigGrpInfoType 0 0 0 255 ECU_ADDRESS 0x0 /end MEASUREMENT
/begin MEASUREMENT Com_TxSigGrpInfo[3].TxBufferEndIdxOfTxSigGrpInfo "" UWORD Com_TxBufferEndIdxOfTxSigGrpInfoType 0 0 0 65535 ECU_ADDRESS 0x0 /end MEASUREMENT
/begin MEASUREMENT Com_TxSigGrpInfo[3].TxBufferSigGrpInTxIPDUEndIdxOfTxSigGrpInfo "" UWORD Com_TxBufferSigGrpInTxIPDUEndIdxOfTxSigGrpInfoType 0 0 0 65535 ECU_ADDRESS 0x0 /end MEASUREMENT
/begin MEASUREMENT Com_TxSigGrpInfo[3].TxBufferSigGrpInTxIPDUStartIdxOfTxSigGrpInfo "" UWORD Com_TxBufferSigGrpInTxIPDUStartIdxOfTxSigGrpInfoType 0 0 0 65535 ECU_ADDRESS 0x0 /end MEASUREMENT
/begin MEASUREMENT Com_TxSigGrpInfo[3].TxBufferStartIdxOfTxSigGrpInfo "" UWORD Com_TxBufferStartIdxOfTxSigGrpInfoType 0 0 0 65535 ECU_ADDRESS 0x0 /end MEASUREMENT
/begin MEASUREMENT Com_TxSigGrpInfo[3].TxGrpSigInfoInvValueIndEndIdxOfTxSigGrpInfo "" UBYTE Com_TxGrpSigInfoInvValueIndEndIdxOfTxSigGrpInfoType 0 0 0 255 ECU_ADDRESS 0x0 /end MEASUREMENT
/begin MEASUREMENT Com_TxSigGrpInfo[3].TxGrpSigInfoInvValueIndStartIdxOfTxSigGrpInfo "" UBYTE Com_TxGrpSigInfoInvValueIndStartIdxOfTxSigGrpInfoType 0 0 0 255 ECU_ADDRESS 0x0 /end MEASUREMENT
/begin MEASUREMENT Com_TxSigGrpInfo[3].TxPduInfoIdxOfTxSigGrpInfo "" UBYTE NO_COMPU_METHOD 0 0 0 255 ECU_ADDRESS 0x0 /end MEASUREMENT
/begin MEASUREMENT Com_TxSigGrpInfo[3].TxSigGrpMaskEndIdxOfTxSigGrpInfo "" UBYTE Com_TxSigGrpMaskEndIdxOfTxSigGrpInfoType 0 0 0 255 ECU_ADDRESS 0x0 /end MEASUREMENT
/begin MEASUREMENT Com_TxSigGrpInfo[3].TxSigGrpMaskStartIdxOfTxSigGrpInfo "" UBYTE Com_TxSigGrpMaskStartIdxOfTxSigGrpInfoType 0 0 0 255 ECU_ADDRESS 0x0 /end MEASUREMENT
/begin MEASUREMENT Com_TxSigGrpInfo[4].SigGroupOnChangeOffsetOfTxSigGrpInfo "" UBYTE NO_COMPU_METHOD 0 0 0 255 ECU_ADDRESS 0x0 /end MEASUREMENT
/begin MEASUREMENT Com_TxSigGrpInfo[4].TransferPropertyOfTxSigGrpInfo "" UBYTE Com_TransferPropertyOfTxSigGrpInfoType 0 0 0 255 ECU_ADDRESS 0x0 /end MEASUREMENT
/begin MEASUREMENT Com_TxSigGrpInfo[4].TxBufferEndIdxOfTxSigGrpInfo "" UWORD Com_TxBufferEndIdxOfTxSigGrpInfoType 0 0 0 65535 ECU_ADDRESS 0x0 /end MEASUREMENT
/begin MEASUREMENT Com_TxSigGrpInfo[4].TxBufferSigGrpInTxIPDUEndIdxOfTxSigGrpInfo "" UWORD Com_TxBufferSigGrpInTxIPDUEndIdxOfTxSigGrpInfoType 0 0 0 65535 ECU_ADDRESS 0x0 /end MEASUREMENT
/begin MEASUREMENT Com_TxSigGrpInfo[4].TxBufferSigGrpInTxIPDUStartIdxOfTxSigGrpInfo "" UWORD Com_TxBufferSigGrpInTxIPDUStartIdxOfTxSigGrpInfoType 0 0 0 65535 ECU_ADDRESS 0x0 /end MEASUREMENT
/begin MEASUREMENT Com_TxSigGrpInfo[4].TxBufferStartIdxOfTxSigGrpInfo "" UWORD Com_TxBufferStartIdxOfTxSigGrpInfoType 0 0 0 65535 ECU_ADDRESS 0x0 /end MEASUREMENT
/begin MEASUREMENT Com_TxSigGrpInfo[4].TxGrpSigInfoInvValueIndEndIdxOfTxSigGrpInfo "" UBYTE Com_TxGrpSigInfoInvValueIndEndIdxOfTxSigGrpInfoType 0 0 0 255 ECU_ADDRESS 0x0 /end MEASUREMENT
/begin MEASUREMENT Com_TxSigGrpInfo[4].TxGrpSigInfoInvValueIndStartIdxOfTxSigGrpInfo "" UBYTE Com_TxGrpSigInfoInvValueIndStartIdxOfTxSigGrpInfoType 0 0 0 255 ECU_ADDRESS 0x0 /end MEASUREMENT
/begin MEASUREMENT Com_TxSigGrpInfo[4].TxPduInfoIdxOfTxSigGrpInfo "" UBYTE NO_COMPU_METHOD 0 0 0 255 ECU_ADDRESS 0x0 /end MEASUREMENT
/begin MEASUREMENT Com_TxSigGrpInfo[4].TxSigGrpMaskEndIdxOfTxSigGrpInfo "" UBYTE Com_TxSigGrpMaskEndIdxOfTxSigGrpInfoType 0 0 0 255 ECU_ADDRESS 0x0 /end MEASUREMENT
/begin MEASUREMENT Com_TxSigGrpInfo[4].TxSigGrpMaskStartIdxOfTxSigGrpInfo "" UBYTE Com_TxSigGrpMaskStartIdxOfTxSigGrpInfoType 0 0 0 255 ECU_ADDRESS 0x0 /end MEASUREMENT
/begin MEASUREMENT Com_TxSigGrpInfo[5].SigGroupOnChangeOffsetOfTxSigGrpInfo "" UBYTE NO_COMPU_METHOD 0 0 0 255 ECU_ADDRESS 0x0 /end MEASUREMENT
/begin MEASUREMENT Com_TxSigGrpInfo[5].TransferPropertyOfTxSigGrpInfo "" UBYTE Com_TransferPropertyOfTxSigGrpInfoType 0 0 0 255 ECU_ADDRESS 0x0 /end MEASUREMENT
/begin MEASUREMENT Com_TxSigGrpInfo[5].TxBufferEndIdxOfTxSigGrpInfo "" UWORD Com_TxBufferEndIdxOfTxSigGrpInfoType 0 0 0 65535 ECU_ADDRESS 0x0 /end MEASUREMENT
/begin MEASUREMENT Com_TxSigGrpInfo[5].TxBufferSigGrpInTxIPDUEndIdxOfTxSigGrpInfo "" UWORD Com_TxBufferSigGrpInTxIPDUEndIdxOfTxSigGrpInfoType 0 0 0 65535 ECU_ADDRESS 0x0 /end MEASUREMENT
/begin MEASUREMENT Com_TxSigGrpInfo[5].TxBufferSigGrpInTxIPDUStartIdxOfTxSigGrpInfo "" UWORD Com_TxBufferSigGrpInTxIPDUStartIdxOfTxSigGrpInfoType 0 0 0 65535 ECU_ADDRESS 0x0 /end MEASUREMENT
/begin MEASUREMENT Com_TxSigGrpInfo[5].TxBufferStartIdxOfTxSigGrpInfo "" UWORD Com_TxBufferStartIdxOfTxSigGrpInfoType 0 0 0 65535 ECU_ADDRESS 0x0 /end MEASUREMENT
/begin MEASUREMENT Com_TxSigGrpInfo[5].TxGrpSigInfoInvValueIndEndIdxOfTxSigGrpInfo "" UBYTE Com_TxGrpSigInfoInvValueIndEndIdxOfTxSigGrpInfoType 0 0 0 255 ECU_ADDRESS 0x0 /end MEASUREMENT
/begin MEASUREMENT Com_TxSigGrpInfo[5].TxGrpSigInfoInvValueIndStartIdxOfTxSigGrpInfo "" UBYTE Com_TxGrpSigInfoInvValueIndStartIdxOfTxSigGrpInfoType 0 0 0 255 ECU_ADDRESS 0x0 /end MEASUREMENT
/begin MEASUREMENT Com_TxSigGrpInfo[5].TxPduInfoIdxOfTxSigGrpInfo "" UBYTE NO_COMPU_METHOD 0 0 0 255 ECU_ADDRESS 0x0 /end MEASUREMENT
/begin MEASUREMENT Com_TxSigGrpInfo[5].TxSigGrpMaskEndIdxOfTxSigGrpInfo "" UBYTE Com_TxSigGrpMaskEndIdxOfTxSigGrpInfoType 0 0 0 255 ECU_ADDRESS 0x0 /end MEASUREMENT
/begin MEASUREMENT Com_TxSigGrpInfo[5].TxSigGrpMaskStartIdxOfTxSigGrpInfo "" UBYTE Com_TxSigGrpMaskStartIdxOfTxSigGrpInfoType 0 0 0 255 ECU_ADDRESS 0x0 /end MEASUREMENT
/begin MEASUREMENT Com_TxSigGrpInfo[6].SigGroupOnChangeOffsetOfTxSigGrpInfo "" UBYTE NO_COMPU_METHOD 0 0 0 255 ECU_ADDRESS 0x0 /end MEASUREMENT
/begin MEASUREMENT Com_TxSigGrpInfo[6].TransferPropertyOfTxSigGrpInfo "" UBYTE Com_TransferPropertyOfTxSigGrpInfoType 0 0 0 255 ECU_ADDRESS 0x0 /end MEASUREMENT
/begin MEASUREMENT Com_TxSigGrpInfo[6].TxBufferEndIdxOfTxSigGrpInfo "" UWORD Com_TxBufferEndIdxOfTxSigGrpInfoType 0 0 0 65535 ECU_ADDRESS 0x0 /end MEASUREMENT
/begin MEASUREMENT Com_TxSigGrpInfo[6].TxBufferSigGrpInTxIPDUEndIdxOfTxSigGrpInfo "" UWORD Com_TxBufferSigGrpInTxIPDUEndIdxOfTxSigGrpInfoType 0 0 0 65535 ECU_ADDRESS 0x0 /end MEASUREMENT
/begin MEASUREMENT Com_TxSigGrpInfo[6].TxBufferSigGrpInTxIPDUStartIdxOfTxSigGrpInfo "" UWORD Com_TxBufferSigGrpInTxIPDUStartIdxOfTxSigGrpInfoType 0 0 0 65535 ECU_ADDRESS 0x0 /end MEASUREMENT
/begin MEASUREMENT Com_TxSigGrpInfo[6].TxBufferStartIdxOfTxSigGrpInfo "" UWORD Com_TxBufferStartIdxOfTxSigGrpInfoType 0 0 0 65535 ECU_ADDRESS 0x0 /end MEASUREMENT
/begin MEASUREMENT Com_TxSigGrpInfo[6].TxGrpSigInfoInvValueIndEndIdxOfTxSigGrpInfo "" UBYTE Com_TxGrpSigInfoInvValueIndEndIdxOfTxSigGrpInfoType 0 0 0 255 ECU_ADDRESS 0x0 /end MEASUREMENT
/begin MEASUREMENT Com_TxSigGrpInfo[6].TxGrpSigInfoInvValueIndStartIdxOfTxSigGrpInfo "" UBYTE Com_TxGrpSigInfoInvValueIndStartIdxOfTxSigGrpInfoType 0 0 0 255 ECU_ADDRESS 0x0 /end MEASUREMENT
/begin MEASUREMENT Com_TxSigGrpInfo[6].TxPduInfoIdxOfTxSigGrpInfo "" UBYTE NO_COMPU_METHOD 0 0 0 255 ECU_ADDRESS 0x0 /end MEASUREMENT
/begin MEASUREMENT Com_TxSigGrpInfo[6].TxSigGrpMaskEndIdxOfTxSigGrpInfo "" UBYTE Com_TxSigGrpMaskEndIdxOfTxSigGrpInfoType 0 0 0 255 ECU_ADDRESS 0x0 /end MEASUREMENT
/begin MEASUREMENT Com_TxSigGrpInfo[6].TxSigGrpMaskStartIdxOfTxSigGrpInfo "" UBYTE Com_TxSigGrpMaskStartIdxOfTxSigGrpInfoType 0 0 0 255 ECU_ADDRESS 0x0 /end MEASUREMENT
/begin MEASUREMENT Com_TxSigGrpInfo[7].SigGroupOnChangeOffsetOfTxSigGrpInfo "" UBYTE NO_COMPU_METHOD 0 0 0 255 ECU_ADDRESS 0x0 /end MEASUREMENT
/begin MEASUREMENT Com_TxSigGrpInfo[7].TransferPropertyOfTxSigGrpInfo "" UBYTE Com_TransferPropertyOfTxSigGrpInfoType 0 0 0 255 ECU_ADDRESS 0x0 /end MEASUREMENT
/begin MEASUREMENT Com_TxSigGrpInfo[7].TxBufferEndIdxOfTxSigGrpInfo "" UWORD Com_TxBufferEndIdxOfTxSigGrpInfoType 0 0 0 65535 ECU_ADDRESS 0x0 /end MEASUREMENT
/begin MEASUREMENT Com_TxSigGrpInfo[7].TxBufferSigGrpInTxIPDUEndIdxOfTxSigGrpInfo "" UWORD Com_TxBufferSigGrpInTxIPDUEndIdxOfTxSigGrpInfoType 0 0 0 65535 ECU_ADDRESS 0x0 /end MEASUREMENT
/begin MEASUREMENT Com_TxSigGrpInfo[7].TxBufferSigGrpInTxIPDUStartIdxOfTxSigGrpInfo "" UWORD Com_TxBufferSigGrpInTxIPDUStartIdxOfTxSigGrpInfoType 0 0 0 65535 ECU_ADDRESS 0x0 /end MEASUREMENT
/begin MEASUREMENT Com_TxSigGrpInfo[7].TxBufferStartIdxOfTxSigGrpInfo "" UWORD Com_TxBufferStartIdxOfTxSigGrpInfoType 0 0 0 65535 ECU_ADDRESS 0x0 /end MEASUREMENT
/begin MEASUREMENT Com_TxSigGrpInfo[7].TxGrpSigInfoInvValueIndEndIdxOfTxSigGrpInfo "" UBYTE Com_TxGrpSigInfoInvValueIndEndIdxOfTxSigGrpInfoType 0 0 0 255 ECU_ADDRESS 0x0 /end MEASUREMENT
/begin MEASUREMENT Com_TxSigGrpInfo[7].TxGrpSigInfoInvValueIndStartIdxOfTxSigGrpInfo "" UBYTE Com_TxGrpSigInfoInvValueIndStartIdxOfTxSigGrpInfoType 0 0 0 255 ECU_ADDRESS 0x0 /end MEASUREMENT
/begin MEASUREMENT Com_TxSigGrpInfo[7].TxPduInfoIdxOfTxSigGrpInfo "" UBYTE NO_COMPU_METHOD 0 0 0 255 ECU_ADDRESS 0x0 /end MEASUREMENT
/begin MEASUREMENT Com_TxSigGrpInfo[7].TxSigGrpMaskEndIdxOfTxSigGrpInfo "" UBYTE Com_TxSigGrpMaskEndIdxOfTxSigGrpInfoType 0 0 0 255 ECU_ADDRESS 0x0 /end MEASUREMENT
/begin MEASUREMENT Com_TxSigGrpInfo[7].TxSigGrpMaskStartIdxOfTxSigGrpInfo "" UBYTE Com_TxSigGrpMaskStartIdxOfTxSigGrpInfoType 0 0 0 255 ECU_ADDRESS 0x0 /end MEASUREMENT
/begin MEASUREMENT Com_TxSigGrpInfo[8].SigGroupOnChangeOffsetOfTxSigGrpInfo "" UBYTE NO_COMPU_METHOD 0 0 0 255 ECU_ADDRESS 0x0 /end MEASUREMENT
/begin MEASUREMENT Com_TxSigGrpInfo[8].TransferPropertyOfTxSigGrpInfo "" UBYTE Com_TransferPropertyOfTxSigGrpInfoType 0 0 0 255 ECU_ADDRESS 0x0 /end MEASUREMENT
/begin MEASUREMENT Com_TxSigGrpInfo[8].TxBufferEndIdxOfTxSigGrpInfo "" UWORD Com_TxBufferEndIdxOfTxSigGrpInfoType 0 0 0 65535 ECU_ADDRESS 0x0 /end MEASUREMENT
/begin MEASUREMENT Com_TxSigGrpInfo[8].TxBufferSigGrpInTxIPDUEndIdxOfTxSigGrpInfo "" UWORD Com_TxBufferSigGrpInTxIPDUEndIdxOfTxSigGrpInfoType 0 0 0 65535 ECU_ADDRESS 0x0 /end MEASUREMENT
/begin MEASUREMENT Com_TxSigGrpInfo[8].TxBufferSigGrpInTxIPDUStartIdxOfTxSigGrpInfo "" UWORD Com_TxBufferSigGrpInTxIPDUStartIdxOfTxSigGrpInfoType 0 0 0 65535 ECU_ADDRESS 0x0 /end MEASUREMENT
/begin MEASUREMENT Com_TxSigGrpInfo[8].TxBufferStartIdxOfTxSigGrpInfo "" UWORD Com_TxBufferStartIdxOfTxSigGrpInfoType 0 0 0 65535 ECU_ADDRESS 0x0 /end MEASUREMENT
/begin MEASUREMENT Com_TxSigGrpInfo[8].TxGrpSigInfoInvValueIndEndIdxOfTxSigGrpInfo "" UBYTE Com_TxGrpSigInfoInvValueIndEndIdxOfTxSigGrpInfoType 0 0 0 255 ECU_ADDRESS 0x0 /end MEASUREMENT
/begin MEASUREMENT Com_TxSigGrpInfo[8].TxGrpSigInfoInvValueIndStartIdxOfTxSigGrpInfo "" UBYTE Com_TxGrpSigInfoInvValueIndStartIdxOfTxSigGrpInfoType 0 0 0 255 ECU_ADDRESS 0x0 /end MEASUREMENT
/begin MEASUREMENT Com_TxSigGrpInfo[8].TxPduInfoIdxOfTxSigGrpInfo "" UBYTE NO_COMPU_METHOD 0 0 0 255 ECU_ADDRESS 0x0 /end MEASUREMENT
/begin MEASUREMENT Com_TxSigGrpInfo[8].TxSigGrpMaskEndIdxOfTxSigGrpInfo "" UBYTE Com_TxSigGrpMaskEndIdxOfTxSigGrpInfoType 0 0 0 255 ECU_ADDRESS 0x0 /end MEASUREMENT
/begin MEASUREMENT Com_TxSigGrpInfo[8].TxSigGrpMaskStartIdxOfTxSigGrpInfo "" UBYTE Com_TxSigGrpMaskStartIdxOfTxSigGrpInfoType 0 0 0 255 ECU_ADDRESS 0x0 /end MEASUREMENT
/begin MEASUREMENT Com_TxSigGrpInfo[9].SigGroupOnChangeOffsetOfTxSigGrpInfo "" UBYTE NO_COMPU_METHOD 0 0 0 255 ECU_ADDRESS 0x0 /end MEASUREMENT
/begin MEASUREMENT Com_TxSigGrpInfo[9].TransferPropertyOfTxSigGrpInfo "" UBYTE Com_TransferPropertyOfTxSigGrpInfoType 0 0 0 255 ECU_ADDRESS 0x0 /end MEASUREMENT
/begin MEASUREMENT Com_TxSigGrpInfo[9].TxBufferEndIdxOfTxSigGrpInfo "" UWORD Com_TxBufferEndIdxOfTxSigGrpInfoType 0 0 0 65535 ECU_ADDRESS 0x0 /end MEASUREMENT
/begin MEASUREMENT Com_TxSigGrpInfo[9].TxBufferSigGrpInTxIPDUEndIdxOfTxSigGrpInfo "" UWORD Com_TxBufferSigGrpInTxIPDUEndIdxOfTxSigGrpInfoType 0 0 0 65535 ECU_ADDRESS 0x0 /end MEASUREMENT
/begin MEASUREMENT Com_TxSigGrpInfo[9].TxBufferSigGrpInTxIPDUStartIdxOfTxSigGrpInfo "" UWORD Com_TxBufferSigGrpInTxIPDUStartIdxOfTxSigGrpInfoType 0 0 0 65535 ECU_ADDRESS 0x0 /end MEASUREMENT
/begin MEASUREMENT Com_TxSigGrpInfo[9].TxBufferStartIdxOfTxSigGrpInfo "" UWORD Com_TxBufferStartIdxOfTxSigGrpInfoType 0 0 0 65535 ECU_ADDRESS 0x0 /end MEASUREMENT
/begin MEASUREMENT Com_TxSigGrpInfo[9].TxGrpSigInfoInvValueIndEndIdxOfTxSigGrpInfo "" UBYTE Com_TxGrpSigInfoInvValueIndEndIdxOfTxSigGrpInfoType 0 0 0 255 ECU_ADDRESS 0x0 /end MEASUREMENT
/begin MEASUREMENT Com_TxSigGrpInfo[9].TxGrpSigInfoInvValueIndStartIdxOfTxSigGrpInfo "" UBYTE Com_TxGrpSigInfoInvValueIndStartIdxOfTxSigGrpInfoType 0 0 0 255 ECU_ADDRESS 0x0 /end MEASUREMENT
/begin MEASUREMENT Com_TxSigGrpInfo[9].TxPduInfoIdxOfTxSigGrpInfo "" UBYTE NO_COMPU_METHOD 0 0 0 255 ECU_ADDRESS 0x0 /end MEASUREMENT
/begin MEASUREMENT Com_TxSigGrpInfo[9].TxSigGrpMaskEndIdxOfTxSigGrpInfo "" UBYTE Com_TxSigGrpMaskEndIdxOfTxSigGrpInfoType 0 0 0 255 ECU_ADDRESS 0x0 /end MEASUREMENT
/begin MEASUREMENT Com_TxSigGrpInfo[9].TxSigGrpMaskStartIdxOfTxSigGrpInfo "" UBYTE Com_TxSigGrpMaskStartIdxOfTxSigGrpInfoType 0 0 0 255 ECU_ADDRESS 0x0 /end MEASUREMENT
/begin MEASUREMENT Com_TxSigGrpMask "Signal group mask needed to copy interlaced signal groups to the Tx PDU buffer." UBYTE NO_COMPU_METHOD 0 0 0 255 ECU_ADDRESS 0x0 MATRIX_DIM 50 /end MEASUREMENT
/begin MEASUREMENT Com_TxSigInfoFilterInitValueInd "the indexes of the 1:1 sorted relation pointing to Com_TxSigInfo" UWORD NO_COMPU_METHOD 0 0 0 65535 ECU_ADDRESS 0x0 MATRIX_DIM 12 /end MEASUREMENT
/begin MEASUREMENT Com_TxSigInfo[0].ApplTypeOfTxSigInfo "" UBYTE Com_ApplTypeOfTxSigInfoType 0 0 0 255 ECU_ADDRESS 0x0 /end MEASUREMENT
/begin MEASUREMENT Com_TxSigInfo[0].BitLengthOfTxSigInfo "" UWORD NO_COMPU_METHOD 0 0 0 65535 ECU_ADDRESS 0x0 /end MEASUREMENT
/begin MEASUREMENT Com_TxSigInfo[0].BitPositionOfTxSigInfo "" UWORD NO_COMPU_METHOD 0 0 0 65535 ECU_ADDRESS 0x0 /end MEASUREMENT
/begin MEASUREMENT Com_TxSigInfo[0].BusAccOfTxSigInfo "" UBYTE Com_BusAccOfTxSigInfoType 0 0 0 255 ECU_ADDRESS 0x0 /end MEASUREMENT
/begin MEASUREMENT Com_TxSigInfo[0].ByteLengthOfTxSigInfo "" UBYTE NO_COMPU_METHOD 0 0 0 255 ECU_ADDRESS 0x0 /end MEASUREMENT
/begin MEASUREMENT Com_TxSigInfo[0].DynSignalOfTxSigInfo "" UBYTE Com_DynSignalOfTxSigInfoType 0 0 0 1 ECU_ADDRESS 0x0 /end MEASUREMENT
/begin MEASUREMENT Com_TxSigInfo[0].FilterInitValueIdxOfTxSigInfo "" UBYTE Com_FilterInitValueIdxOfTxSigInfoType 0 0 0 255 ECU_ADDRESS 0x0 /end MEASUREMENT
/begin MEASUREMENT Com_TxSigInfo[0].FilterInitValueOfTxSigInfo "" UBYTE Com_FilterInitValueOfTxSigInfoType 0 0 0 255 ECU_ADDRESS 0x0 /end MEASUREMENT
/begin MEASUREMENT Com_TxSigInfo[0].InvValueIdxOfTxSigInfo "" UBYTE Com_InvValueIdxOfTxSigInfoType 0 0 0 255 ECU_ADDRESS 0x0 /end MEASUREMENT
/begin MEASUREMENT Com_TxSigInfo[0].InvValueOfTxSigInfo "" UBYTE Com_InvValueOfTxSigInfoType 0 0 0 255 ECU_ADDRESS 0x0 /end MEASUREMENT
/begin MEASUREMENT Com_TxSigInfo[0].OnChangeIdxOfTxSigInfo "" UBYTE Com_OnChangeIdxOfTxSigInfoType 0 0 0 255 ECU_ADDRESS 0x0 /end MEASUREMENT
/begin MEASUREMENT Com_TxSigInfo[0].OnChangeOfTxSigInfo "" UBYTE Com_OnChangeOfTxSigInfoType 0 0 0 255 ECU_ADDRESS 0x0 /end MEASUREMENT
/begin MEASUREMENT Com_TxSigInfo[0].StartByteInPduPositionOfTxSigInfo "" UBYTE NO_COMPU_METHOD 0 0 0 255 ECU_ADDRESS 0x0 /end MEASUREMENT
/begin MEASUREMENT Com_TxSigInfo[0].TxAccessInfoIdxOfTxSigInfo "" UWORD NO_COMPU_METHOD 0 0 0 65535 ECU_ADDRESS 0x0 /end MEASUREMENT
/begin MEASUREMENT Com_TxSigInfo[0].TxBufferEndIdxOfTxSigInfo "" UWORD Com_TxBufferEndIdxOfTxSigInfoType 0 0 0 65535 ECU_ADDRESS 0x0 /end MEASUREMENT
/begin MEASUREMENT Com_TxSigInfo[0].TxBufferStartIdxOfTxSigInfo "" UWORD Com_TxBufferStartIdxOfTxSigInfoType 0 0 0 65535 ECU_ADDRESS 0x0 /end MEASUREMENT
/begin MEASUREMENT Com_TxSigInfo[0].TxFilterInitValueArrayBasedFilterInitValueEndIdxOfTxSigInfo "" UBYTE Com_TxFilterInitValueArrayBasedFilterInitValueEndIdxOfTxSigInfoType 0 0 0 255 ECU_ADDRESS 0x0 /end MEASUREMENT
/begin MEASUREMENT Com_TxSigInfo[0].TxFilterInitValueArrayBasedFilterInitValueStartIdxOfTxSigInfo "" UBYTE Com_TxFilterInitValueArrayBasedFilterInitValueStartIdxOfTxSigInfoType 0 0 0 255 ECU_ADDRESS 0x0 /end MEASUREMENT
/begin MEASUREMENT Com_TxSigInfo[0].TxPduInfoIdxOfTxSigInfo "" UBYTE NO_COMPU_METHOD 0 0 0 255 ECU_ADDRESS 0x0 /end MEASUREMENT
/begin MEASUREMENT Com_TxSigInfo[100].ApplTypeOfTxSigInfo "" UBYTE Com_ApplTypeOfTxSigInfoType 0 0 0 255 ECU_ADDRESS 0x0 /end MEASUREMENT
/begin MEASUREMENT Com_TxSigInfo[100].BitLengthOfTxSigInfo "" UWORD NO_COMPU_METHOD 0 0 0 65535 ECU_ADDRESS 0x0 /end MEASUREMENT
/begin MEASUREMENT Com_TxSigInfo[100].BitPositionOfTxSigInfo "" UWORD NO_COMPU_METHOD 0 0 0 65535 ECU_ADDRESS 0x0 /end MEASUREMENT
/begin MEASUREMENT Com_TxSigInfo[100].BusAccOfTxSigInfo "" UBYTE Com_BusAccOfTxSigInfoType 0 0 0 255 ECU_ADDRESS 0x0 /end MEASUREMENT
/begin MEASUREMENT Com_TxSigInfo[100].ByteLengthOfTxSigInfo "" UBYTE NO_COMPU_METHOD 0 0 0 255 ECU_ADDRESS 0x0 /end MEASUREMENT
/begin MEASUREMENT Com_TxSigInfo[100].DynSignalOfTxSigInfo "" UBYTE Com_DynSignalOfTxSigInfoType 0 0 0 1 ECU_ADDRESS 0x0 /end MEASUREMENT
/begin MEASUREMENT Com_TxSigInfo[100].FilterInitValueIdxOfTxSigInfo "" UBYTE Com_FilterInitValueIdxOfTxSigInfoType 0 0 0 255 ECU_ADDRESS 0x0 /end MEASUREMENT
/begin MEASUREMENT Com_TxSigInfo[100].FilterInitValueOfTxSigInfo "" UBYTE Com_FilterInitValueOfTxSigInfoType 0 0 0 255 ECU_ADDRESS 0x0 /end MEASUREMENT
/begin MEASUREMENT Com_TxSigInfo[100].InvValueIdxOfTxSigInfo "" UBYTE Com_InvValueIdxOfTxSigInfoType 0 0 0 255 ECU_ADDRESS 0x0 /end MEASUREMENT
/begin MEASUREMENT Com_TxSigInfo[100].InvValueOfTxSigInfo "" UBYTE Com_InvValueOfTxSigInfoType 0 0 0 255 ECU_ADDRESS 0x0 /end MEASUREMENT
/begin MEASUREMENT Com_TxSigInfo[100].OnChangeIdxOfTxSigInfo "" UBYTE Com_OnChangeIdxOfTxSigInfoType 0 0 0 255 ECU_ADDRESS 0x0 /end MEASUREMENT
/begin MEASUREMENT Com_TxSigInfo[100].OnChangeOfTxSigInfo "" UBYTE Com_OnChangeOfTxSigInfoType 0 0 0 255 ECU_ADDRESS 0x0 /end MEASUREMENT
/begin MEASUREMENT Com_TxSigInfo[100].StartByteInPduPositionOfTxSigInfo "" UBYTE NO_COMPU_METHOD 0 0 0 255 ECU_ADDRESS 0x0 /end MEASUREMENT
/begin MEASUREMENT Com_TxSigInfo[100].TxAccessInfoIdxOfTxSigInfo "" UWORD NO_COMPU_METHOD 0 0 0 65535 ECU_ADDRESS 0x0 /end MEASUREMENT
/begin MEASUREMENT Com_TxSigInfo[100].TxBufferEndIdxOfTxSigInfo "" UWORD Com_TxBufferEndIdxOfTxSigInfoType 0 0 0 65535 ECU_ADDRESS 0x0 /end MEASUREMENT
/begin MEASUREMENT Com_TxSigInfo[100].TxBufferStartIdxOfTxSigInfo "" UWORD Com_TxBufferStartIdxOfTxSigInfoType 0 0 0 65535 ECU_ADDRESS 0x0 /end MEASUREMENT
/begin MEASUREMENT Com_TxSigInfo[100].TxFilterInitValueArrayBasedFilterInitValueEndIdxOfTxSigInfo "" UBYTE Com_TxFilterInitValueArrayBasedFilterInitValueEndIdxOfTxSigInfoType 0 0 0 255 ECU_ADDRESS 0x0 /end MEASUREMENT
/begin MEASUREMENT Com_TxSigInfo[100].TxFilterInitValueArrayBasedFilterInitValueStartIdxOfTxSigInfo "" UBYTE Com_TxFilterInitValueArrayBasedFilterInitValueStartIdxOfTxSigInfoType 0 0 0 255 ECU_ADDRESS 0x0 /end MEASUREMENT
/begin MEASUREMENT Com_TxSigInfo[100].TxPduInfoIdxOfTxSigInfo "" UBYTE NO_COMPU_METHOD 0 0 0 255 ECU_ADDRESS 0x0 /end MEASUREMENT
/begin MEASUREMENT Com_TxSigInfo[101].ApplTypeOfTxSigInfo "" UBYTE Com_ApplTypeOfTxSigInfoType 0 0 0 255 ECU_ADDRESS 0x0 /end MEASUREMENT
/begin MEASUREMENT Com_TxSigInfo[101].BitLengthOfTxSigInfo "" UWORD NO_COMPU_METHOD 0 0 0 65535 ECU_ADDRESS 0x0 /end MEASUREMENT
/begin MEASUREMENT Com_TxSigInfo[101].BitPositionOfTxSigInfo "" UWORD NO_COMPU_METHOD 0 0 0 65535 ECU_ADDRESS 0x0 /end MEASUREMENT
/begin MEASUREMENT Com_TxSigInfo[101].BusAccOfTxSigInfo "" UBYTE Com_BusAccOfTxSigInfoType 0 0 0 255 ECU_ADDRESS 0x0 /end MEASUREMENT
/begin MEASUREMENT Com_TxSigInfo[101].ByteLengthOfTxSigInfo "" UBYTE NO_COMPU_METHOD 0 0 0 255 ECU_ADDRESS 0x0 /end MEASUREMENT
/begin MEASUREMENT Com_TxSigInfo[101].DynSignalOfTxSigInfo "" UBYTE Com_DynSignalOfTxSigInfoType 0 0 0 1 ECU_ADDRESS 0x0 /end MEASUREMENT
/begin MEASUREMENT Com_TxSigInfo[101].FilterInitValueIdxOfTxSigInfo "" UBYTE Com_FilterInitValueIdxOfTxSigInfoType 0 0 0 255 ECU_ADDRESS 0x0 /end MEASUREMENT
/begin MEASUREMENT Com_TxSigInfo[101].FilterInitValueOfTxSigInfo "" UBYTE Com_FilterInitValueOfTxSigInfoType 0 0 0 255 ECU_ADDRESS 0x0 /end MEASUREMENT
/begin MEASUREMENT Com_TxSigInfo[101].InvValueIdxOfTxSigInfo "" UBYTE Com_InvValueIdxOfTxSigInfoType 0 0 0 255 ECU_ADDRESS 0x0 /end MEASUREMENT
/begin MEASUREMENT Com_TxSigInfo[101].InvValueOfTxSigInfo "" UBYTE Com_InvValueOfTxSigInfoType 0 0 0 255 ECU_ADDRESS 0x0 /end MEASUREMENT
/begin MEASUREMENT Com_TxSigInfo[101].OnChangeIdxOfTxSigInfo "" UBYTE Com_OnChangeIdxOfTxSigInfoType 0 0 0 255 ECU_ADDRESS 0x0 /end MEASUREMENT
/begin MEASUREMENT Com_TxSigInfo[101].OnChangeOfTxSigInfo "" UBYTE Com_OnChangeOfTxSigInfoType 0 0 0 255 ECU_ADDRESS 0x0 /end MEASUREMENT
/begin MEASUREMENT Com_TxSigInfo[101].StartByteInPduPositionOfTxSigInfo "" UBYTE NO_COMPU_METHOD 0 0 0 255 ECU_ADDRESS 0x0 /end MEASUREMENT
/begin MEASUREMENT Com_TxSigInfo[101].TxAccessInfoIdxOfTxSigInfo "" UWORD NO_COMPU_METHOD 0 0 0 65535 ECU_ADDRESS 0x0 /end MEASUREMENT
/begin MEASUREMENT Com_TxSigInfo[101].TxBufferEndIdxOfTxSigInfo "" UWORD Com_TxBufferEndIdxOfTxSigInfoType 0 0 0 65535 ECU_ADDRESS 0x0 /end MEASUREMENT
/begin MEASUREMENT Com_TxSigInfo[101].TxBufferStartIdxOfTxSigInfo "" UWORD Com_TxBufferStartIdxOfTxSigInfoType 0 0 0 65535 ECU_ADDRESS 0x0 /end MEASUREMENT
/begin MEASUREMENT Com_TxSigInfo[101].TxFilterInitValueArrayBasedFilterInitValueEndIdxOfTxSigInfo "" UBYTE Com_TxFilterInitValueArrayBasedFilterInitValueEndIdxOfTxSigInfoType 0 0 0 255 ECU_ADDRESS 0x0 /end MEASUREMENT
/begin MEASUREMENT Com_TxSigInfo[101].TxFilterInitValueArrayBasedFilterInitValueStartIdxOfTxSigInfo "" UBYTE Com_TxFilterInitValueArrayBasedFilterInitValueStartIdxOfTxSigInfoType 0 0 0 255 ECU_ADDRESS 0x0 /end MEASUREMENT
/begin MEASUREMENT Com_TxSigInfo[101].TxPduInfoIdxOfTxSigInfo "" UBYTE NO_COMPU_METHOD 0 0 0 255 ECU_ADDRESS 0x0 /end MEASUREMENT
/begin MEASUREMENT Com_TxSigInfo[102].ApplTypeOfTxSigInfo "" UBYTE Com_ApplTypeOfTxSigInfoType 0 0 0 255 ECU_ADDRESS 0x0 /end MEASUREMENT
/begin MEASUREMENT Com_TxSigInfo[102].BitLengthOfTxSigInfo "" UWORD NO_COMPU_METHOD 0 0 0 65535 ECU_ADDRESS 0x0 /end MEASUREMENT
/begin MEASUREMENT Com_TxSigInfo[102].BitPositionOfTxSigInfo "" UWORD NO_COMPU_METHOD 0 0 0 65535 ECU_ADDRESS 0x0 /end MEASUREMENT
/begin MEASUREMENT Com_TxSigInfo[102].BusAccOfTxSigInfo "" UBYTE Com_BusAccOfTxSigInfoType 0 0 0 255 ECU_ADDRESS 0x0 /end MEASUREMENT
/begin MEASUREMENT Com_TxSigInfo[102].ByteLengthOfTxSigInfo "" UBYTE NO_COMPU_METHOD 0 0 0 255 ECU_ADDRESS 0x0 /end MEASUREMENT
/begin MEASUREMENT Com_TxSigInfo[102].DynSignalOfTxSigInfo "" UBYTE Com_DynSignalOfTxSigInfoType 0 0 0 1 ECU_ADDRESS 0x0 /end MEASUREMENT
/begin MEASUREMENT Com_TxSigInfo[102].FilterInitValueIdxOfTxSigInfo "" UBYTE Com_FilterInitValueIdxOfTxSigInfoType 0 0 0 255 ECU_ADDRESS 0x0 /end MEASUREMENT
/begin MEASUREMENT Com_TxSigInfo[102].FilterInitValueOfTxSigInfo "" UBYTE Com_FilterInitValueOfTxSigInfoType 0 0 0 255 ECU_ADDRESS 0x0 /end MEASUREMENT
/begin MEASUREMENT Com_TxSigInfo[102].InvValueIdxOfTxSigInfo "" UBYTE Com_InvValueIdxOfTxSigInfoType 0 0 0 255 ECU_ADDRESS 0x0 /end MEASUREMENT
/begin MEASUREMENT Com_TxSigInfo[102].InvValueOfTxSigInfo "" UBYTE Com_InvValueOfTxSigInfoType 0 0 0 255 ECU_ADDRESS 0x0 /end MEASUREMENT
/begin MEASUREMENT Com_TxSigInfo[102].OnChangeIdxOfTxSigInfo "" UBYTE Com_OnChangeIdxOfTxSigInfoType 0 0 0 255 ECU_ADDRESS 0x0 /end MEASUREMENT
/begin MEASUREMENT Com_TxSigInfo[102].OnChangeOfTxSigInfo "" UBYTE Com_OnChangeOfTxSigInfoType 0 0 0 255 ECU_ADDRESS 0x0 /end MEASUREMENT
/begin MEASUREMENT Com_TxSigInfo[102].StartByteInPduPositionOfTxSigInfo "" UBYTE NO_COMPU_METHOD 0 0 0 255 ECU_ADDRESS 0x0 /end MEASUREMENT
/begin MEASUREMENT Com_TxSigInfo[102].TxAccessInfoIdxOfTxSigInfo "" UWORD NO_COMPU_METHOD 0 0 0 65535 ECU_ADDRESS 0x0 /end MEASUREMENT
/begin MEASUREMENT Com_TxSigInfo[102].TxBufferEndIdxOfTxSigInfo "" UWORD Com_TxBufferEndIdxOfTxSigInfoType 0 0 0 65535 ECU_ADDRESS 0x0 /end MEASUREMENT
/begin MEASUREMENT Com_TxSigInfo[102].TxBufferStartIdxOfTxSigInfo "" UWORD Com_TxBufferStartIdxOfTxSigInfoType 0 0 0 65535 ECU_ADDRESS 0x0 /end MEASUREMENT
/begin MEASUREMENT Com_TxSigInfo[102].TxFilterInitValueArrayBasedFilterInitValueEndIdxOfTxSigInfo "" UBYTE Com_TxFilterInitValueArrayBasedFilterInitValueEndIdxOfTxSigInfoType 0 0 0 255 ECU_ADDRESS 0x0 /end MEASUREMENT
/begin MEASUREMENT Com_TxSigInfo[102].TxFilterInitValueArrayBasedFilterInitValueStartIdxOfTxSigInfo "" UBYTE Com_TxFilterInitValueArrayBasedFilterInitValueStartIdxOfTxSigInfoType 0 0 0 255 ECU_ADDRESS 0x0 /end MEASUREMENT
/begin MEASUREMENT Com_TxSigInfo[102].TxPduInfoIdxOfTxSigInfo "" UBYTE NO_COMPU_METHOD 0 0 0 255 ECU_ADDRESS 0x0 /end MEASUREMENT
/begin MEASUREMENT Com_TxSigInfo[103].ApplTypeOfTxSigInfo "" UBYTE Com_ApplTypeOfTxSigInfoType 0 0 0 255 ECU_ADDRESS 0x0 /end MEASUREMENT
/begin MEASUREMENT Com_TxSigInfo[103].BitLengthOfTxSigInfo "" UWORD NO_COMPU_METHOD 0 0 0 65535 ECU_ADDRESS 0x0 /end MEASUREMENT
/begin MEASUREMENT Com_TxSigInfo[103].BitPositionOfTxSigInfo "" UWORD NO_COMPU_METHOD 0 0 0 65535 ECU_ADDRESS 0x0 /end MEASUREMENT
/begin MEASUREMENT Com_TxSigInfo[103].BusAccOfTxSigInfo "" UBYTE Com_BusAccOfTxSigInfoType 0 0 0 255 ECU_ADDRESS 0x0 /end MEASUREMENT
/begin MEASUREMENT Com_TxSigInfo[103].ByteLengthOfTxSigInfo "" UBYTE NO_COMPU_METHOD 0 0 0 255 ECU_ADDRESS 0x0 /end MEASUREMENT
/begin MEASUREMENT Com_TxSigInfo[103].DynSignalOfTxSigInfo "" UBYTE Com_DynSignalOfTxSigInfoType 0 0 0 1 ECU_ADDRESS 0x0 /end MEASUREMENT
/begin MEASUREMENT Com_TxSigInfo[103].FilterInitValueIdxOfTxSigInfo "" UBYTE Com_FilterInitValueIdxOfTxSigInfoType 0 0 0 255 ECU_ADDRESS 0x0 /end MEASUREMENT
/begin MEASUREMENT Com_TxSigInfo[103].FilterInitValueOfTxSigInfo "" UBYTE Com_FilterInitValueOfTxSigInfoType 0 0 0 255 ECU_ADDRESS 0x0 /end MEASUREMENT
/begin MEASUREMENT Com_TxSigInfo[103].InvValueIdxOfTxSigInfo "" UBYTE Com_InvValueIdxOfTxSigInfoType 0 0 0 255 ECU_ADDRESS 0x0 /end MEASUREMENT
/begin MEASUREMENT Com_TxSigInfo[103].InvValueOfTxSigInfo "" UBYTE Com_InvValueOfTxSigInfoType 0 0 0 255 ECU_ADDRESS 0x0 /end MEASUREMENT
/begin MEASUREMENT Com_TxSigInfo[103].OnChangeIdxOfTxSigInfo "" UBYTE Com_OnChangeIdxOfTxSigInfoType 0 0 0 255 ECU_ADDRESS 0x0 /end MEASUREMENT
/begin MEASUREMENT Com_TxSigInfo[103].OnChangeOfTxSigInfo "" UBYTE Com_OnChangeOfTxSigInfoType 0 0 0 255 ECU_ADDRESS 0x0 /end MEASUREMENT
/begin MEASUREMENT Com_TxSigInfo[103].StartByteInPduPositionOfTxSigInfo "" UBYTE NO_COMPU_METHOD 0 0 0 255 ECU_ADDRESS 0x0 /end MEASUREMENT
/begin MEASUREMENT Com_TxSigInfo[103].TxAccessInfoIdxOfTxSigInfo "" UWORD NO_COMPU_METHOD 0 0 0 65535 ECU_ADDRESS 0x0 /end MEASUREMENT
/begin MEASUREMENT Com_TxSigInfo[103].TxBufferEndIdxOfTxSigInfo "" UWORD Com_TxBufferEndIdxOfTxSigInfoType 0 0 0 65535 ECU_ADDRESS 0x0 /end MEASUREMENT
/begin MEASUREMENT Com_TxSigInfo[103].TxBufferStartIdxOfTxSigInfo "" UWORD Com_TxBufferStartIdxOfTxSigInfoType 0 0 0 65535 ECU_ADDRESS 0x0 /end MEASUREMENT
/begin MEASUREMENT Com_TxSigInfo[103].TxFilterInitValueArrayBasedFilterInitValueEndIdxOfTxSigInfo "" UBYTE Com_TxFilterInitValueArrayBasedFilterInitValueEndIdxOfTxSigInfoType 0 0 0 255 ECU_ADDRESS 0x0 /end MEASUREMENT
/begin MEASUREMENT Com_TxSigInfo[103].TxFilterInitValueArrayBasedFilterInitValueStartIdxOfTxSigInfo "" UBYTE Com_TxFilterInitValueArrayBasedFilterInitValueStartIdxOfTxSigInfoType 0 0 0 255 ECU_ADDRESS 0x0 /end MEASUREMENT
/begin MEASUREMENT Com_TxSigInfo[103].TxPduInfoIdxOfTxSigInfo "" UBYTE NO_COMPU_METHOD 0 0 0 255 ECU_ADDRESS 0x0 /end MEASUREMENT
/begin MEASUREMENT Com_TxSigInfo[104].ApplTypeOfTxSigInfo "" UBYTE Com_ApplTypeOfTxSigInfoType 0 0 0 255 ECU_ADDRESS 0x0 /end MEASUREMENT
/begin MEASUREMENT Com_TxSigInfo[104].BitLengthOfTxSigInfo "" UWORD NO_COMPU_METHOD 0 0 0 65535 ECU_ADDRESS 0x0 /end MEASUREMENT
/begin MEASUREMENT Com_TxSigInfo[104].BitPositionOfTxSigInfo "" UWORD NO_COMPU_METHOD 0 0 0 65535 ECU_ADDRESS 0x0 /end MEASUREMENT
/begin MEASUREMENT Com_TxSigInfo[104].BusAccOfTxSigInfo "" UBYTE Com_BusAccOfTxSigInfoType 0 0 0 255 ECU_ADDRESS 0x0 /end MEASUREMENT
/begin MEASUREMENT Com_TxSigInfo[104].ByteLengthOfTxSigInfo "" UBYTE NO_COMPU_METHOD 0 0 0 255 ECU_ADDRESS 0x0 /end MEASUREMENT
/begin MEASUREMENT Com_TxSigInfo[104].DynSignalOfTxSigInfo "" UBYTE Com_DynSignalOfTxSigInfoType 0 0 0 1 ECU_ADDRESS 0x0 /end MEASUREMENT
/begin MEASUREMENT Com_TxSigInfo[104].FilterInitValueIdxOfTxSigInfo "" UBYTE Com_FilterInitValueIdxOfTxSigInfoType 0 0 0 255 ECU_ADDRESS 0x0 /end MEASUREMENT
/begin MEASUREMENT Com_TxSigInfo[104].FilterInitValueOfTxSigInfo "" UBYTE Com_FilterInitValueOfTxSigInfoType 0 0 0 255 ECU_ADDRESS 0x0 /end MEASUREMENT
/begin MEASUREMENT Com_TxSigInfo[104].InvValueIdxOfTxSigInfo "" UBYTE Com_InvValueIdxOfTxSigInfoType 0 0 0 255 ECU_ADDRESS 0x0 /end MEASUREMENT
/begin MEASUREMENT Com_TxSigInfo[104].InvValueOfTxSigInfo "" UBYTE Com_InvValueOfTxSigInfoType 0 0 0 255 ECU_ADDRESS 0x0 /end MEASUREMENT
/begin MEASUREMENT Com_TxSigInfo[104].OnChangeIdxOfTxSigInfo "" UBYTE Com_OnChangeIdxOfTxSigInfoType 0 0 0 255 ECU_ADDRESS 0x0 /end MEASUREMENT
/begin MEASUREMENT Com_TxSigInfo[104].OnChangeOfTxSigInfo "" UBYTE Com_OnChangeOfTxSigInfoType 0 0 0 255 ECU_ADDRESS 0x0 /end MEASUREMENT
/begin MEASUREMENT Com_TxSigInfo[104].StartByteInPduPositionOfTxSigInfo "" UBYTE NO_COMPU_METHOD 0 0 0 255 ECU_ADDRESS 0x0 /end MEASUREMENT
/begin MEASUREMENT Com_TxSigInfo[104].TxAccessInfoIdxOfTxSigInfo "" UWORD NO_COMPU_METHOD 0 0 0 65535 ECU_ADDRESS 0x0 /end MEASUREMENT
/begin MEASUREMENT Com_TxSigInfo[104].TxBufferEndIdxOfTxSigInfo "" UWORD Com_TxBufferEndIdxOfTxSigInfoType 0 0 0 65535 ECU_ADDRESS 0x0 /end MEASUREMENT
/begin MEASUREMENT Com_TxSigInfo[104].TxBufferStartIdxOfTxSigInfo "" UWORD Com_TxBufferStartIdxOfTxSigInfoType 0 0 0 65535 ECU_ADDRESS 0x0 /end MEASUREMENT
/begin MEASUREMENT Com_TxSigInfo[104].TxFilterInitValueArrayBasedFilterInitValueEndIdxOfTxSigInfo "" UBYTE Com_TxFilterInitValueArrayBasedFilterInitValueEndIdxOfTxSigInfoType 0 0 0 255 ECU_ADDRESS 0x0 /end MEASUREMENT
/begin MEASUREMENT Com_TxSigInfo[104].TxFilterInitValueArrayBasedFilterInitValueStartIdxOfTxSigInfo "" UBYTE Com_TxFilterInitValueArrayBasedFilterInitValueStartIdxOfTxSigInfoType 0 0 0 255 ECU_ADDRESS 0x0 /end MEASUREMENT
/begin MEASUREMENT Com_TxSigInfo[104].TxPduInfoIdxOfTxSigInfo "" UBYTE NO_COMPU_METHOD 0 0 0 255 ECU_ADDRESS 0x0 /end MEASUREMENT
/begin MEASUREMENT Com_TxSigInfo[105].ApplTypeOfTxSigInfo "" UBYTE Com_ApplTypeOfTxSigInfoType 0 0 0 255 ECU_ADDRESS 0x0 /end MEASUREMENT
/begin MEASUREMENT Com_TxSigInfo[105].BitLengthOfTxSigInfo "" UWORD NO_COMPU_METHOD 0 0 0 65535 ECU_ADDRESS 0x0 /end MEASUREMENT
/begin MEASUREMENT Com_TxSigInfo[105].BitPositionOfTxSigInfo "" UWORD NO_COMPU_METHOD 0 0 0 65535 ECU_ADDRESS 0x0 /end MEASUREMENT
/begin MEASUREMENT Com_TxSigInfo[105].BusAccOfTxSigInfo "" UBYTE Com_BusAccOfTxSigInfoType 0 0 0 255 ECU_ADDRESS 0x0 /end MEASUREMENT
/begin MEASUREMENT Com_TxSigInfo[105].ByteLengthOfTxSigInfo "" UBYTE NO_COMPU_METHOD 0 0 0 255 ECU_ADDRESS 0x0 /end MEASUREMENT
/begin MEASUREMENT Com_TxSigInfo[105].DynSignalOfTxSigInfo "" UBYTE Com_DynSignalOfTxSigInfoType 0 0 0 1 ECU_ADDRESS 0x0 /end MEASUREMENT
/begin MEASUREMENT Com_TxSigInfo[105].FilterInitValueIdxOfTxSigInfo "" UBYTE Com_FilterInitValueIdxOfTxSigInfoType 0 0 0 255 ECU_ADDRESS 0x0 /end MEASUREMENT
/begin MEASUREMENT Com_TxSigInfo[105].FilterInitValueOfTxSigInfo "" UBYTE Com_FilterInitValueOfTxSigInfoType 0 0 0 255 ECU_ADDRESS 0x0 /end MEASUREMENT
/begin MEASUREMENT Com_TxSigInfo[105].InvValueIdxOfTxSigInfo "" UBYTE Com_InvValueIdxOfTxSigInfoType 0 0 0 255 ECU_ADDRESS 0x0 /end MEASUREMENT
/begin MEASUREMENT Com_TxSigInfo[105].InvValueOfTxSigInfo "" UBYTE Com_InvValueOfTxSigInfoType 0 0 0 255 ECU_ADDRESS 0x0 /end MEASUREMENT
/begin MEASUREMENT Com_TxSigInfo[105].OnChangeIdxOfTxSigInfo "" UBYTE Com_OnChangeIdxOfTxSigInfoType 0 0 0 255 ECU_ADDRESS 0x0 /end MEASUREMENT
/begin MEASUREMENT Com_TxSigInfo[105].OnChangeOfTxSigInfo "" UBYTE Com_OnChangeOfTxSigInfoType 0 0 0 255 ECU_ADDRESS 0x0 /end MEASUREMENT
/begin MEASUREMENT Com_TxSigInfo[105].StartByteInPduPositionOfTxSigInfo "" UBYTE NO_COMPU_METHOD 0 0 0 255 ECU_ADDRESS 0x0 /end MEASUREMENT
/begin MEASUREMENT Com_TxSigInfo[105].TxAccessInfoIdxOfTxSigInfo "" UWORD NO_COMPU_METHOD 0 0 0 65535 ECU_ADDRESS 0x0 /end MEASUREMENT
/begin MEASUREMENT Com_TxSigInfo[105].TxBufferEndIdxOfTxSigInfo "" UWORD Com_TxBufferEndIdxOfTxSigInfoType 0 0 0 65535 ECU_ADDRESS 0x0 /end MEASUREMENT
/begin MEASUREMENT Com_TxSigInfo[105].TxBufferStartIdxOfTxSigInfo "" UWORD Com_TxBufferStartIdxOfTxSigInfoType 0 0 0 65535 ECU_ADDRESS 0x0 /end MEASUREMENT
/begin MEASUREMENT Com_TxSigInfo[105].TxFilterInitValueArrayBasedFilterInitValueEndIdxOfTxSigInfo "" UBYTE Com_TxFilterInitValueArrayBasedFilterInitValueEndIdxOfTxSigInfoType 0 0 0 255 ECU_ADDRESS 0x0 /end MEASUREMENT
/begin MEASUREMENT Com_TxSigInfo[105].TxFilterInitValueArrayBasedFilterInitValueStartIdxOfTxSigInfo "" UBYTE Com_TxFilterInitValueArrayBasedFilterInitValueStartIdxOfTxSigInfoType 0 0 0 255 ECU_ADDRESS 0x0 /end MEASUREMENT
/begin MEASUREMENT Com_TxSigInfo[105].TxPduInfoIdxOfTxSigInfo "" UBYTE NO_COMPU_METHOD 0 0 0 255 ECU_ADDRESS 0x0 /end MEASUREMENT
/begin MEASUREMENT Com_TxSigInfo[106].ApplTypeOfTxSigInfo "" UBYTE Com_ApplTypeOfTxSigInfoType 0 0 0 255 ECU_ADDRESS 0x0 /end MEASUREMENT
/begin MEASUREMENT Com_TxSigInfo[106].BitLengthOfTxSigInfo "" UWORD NO_COMPU_METHOD 0 0 0 65535 ECU_ADDRESS 0x0 /end MEASUREMENT
/begin MEASUREMENT Com_TxSigInfo[106].BitPositionOfTxSigInfo "" UWORD NO_COMPU_METHOD 0 0 0 65535 ECU_ADDRESS 0x0 /end MEASUREMENT
/begin MEASUREMENT Com_TxSigInfo[106].BusAccOfTxSigInfo "" UBYTE Com_BusAccOfTxSigInfoType 0 0 0 255 ECU_ADDRESS 0x0 /end MEASUREMENT
/begin MEASUREMENT Com_TxSigInfo[106].ByteLengthOfTxSigInfo "" UBYTE NO_COMPU_METHOD 0 0 0 255 ECU_ADDRESS 0x0 /end MEASUREMENT
/begin MEASUREMENT Com_TxSigInfo[106].DynSignalOfTxSigInfo "" UBYTE Com_DynSignalOfTxSigInfoType 0 0 0 1 ECU_ADDRESS 0x0 /end MEASUREMENT
/begin MEASUREMENT Com_TxSigInfo[106].FilterInitValueIdxOfTxSigInfo "" UBYTE Com_FilterInitValueIdxOfTxSigInfoType 0 0 0 255 ECU_ADDRESS 0x0 /end MEASUREMENT
/begin MEASUREMENT Com_TxSigInfo[106].FilterInitValueOfTxSigInfo "" UBYTE Com_FilterInitValueOfTxSigInfoType 0 0 0 255 ECU_ADDRESS 0x0 /end MEASUREMENT
/begin MEASUREMENT Com_TxSigInfo[106].InvValueIdxOfTxSigInfo "" UBYTE Com_InvValueIdxOfTxSigInfoType 0 0 0 255 ECU_ADDRESS 0x0 /end MEASUREMENT
/begin MEASUREMENT Com_TxSigInfo[106].InvValueOfTxSigInfo "" UBYTE Com_InvValueOfTxSigInfoType 0 0 0 255 ECU_ADDRESS 0x0 /end MEASUREMENT
/begin MEASUREMENT Com_TxSigInfo[106].OnChangeIdxOfTxSigInfo "" UBYTE Com_OnChangeIdxOfTxSigInfoType 0 0 0 255 ECU_ADDRESS 0x0 /end MEASUREMENT
/begin MEASUREMENT Com_TxSigInfo[106].OnChangeOfTxSigInfo "" UBYTE Com_OnChangeOfTxSigInfoType 0 0 0 255 ECU_ADDRESS 0x0 /end MEASUREMENT
/begin MEASUREMENT Com_TxSigInfo[106].StartByteInPduPositionOfTxSigInfo "" UBYTE NO_COMPU_METHOD 0 0 0 255 ECU_ADDRESS 0x0 /end MEASUREMENT
/begin MEASUREMENT Com_TxSigInfo[106].TxAccessInfoIdxOfTxSigInfo "" UWORD NO_COMPU_METHOD 0 0 0 65535 ECU_ADDRESS 0x0 /end MEASUREMENT
/begin MEASUREMENT Com_TxSigInfo[106].TxBufferEndIdxOfTxSigInfo "" UWORD Com_TxBufferEndIdxOfTxSigInfoType 0 0 0 65535 ECU_ADDRESS 0x0 /end MEASUREMENT
/begin MEASUREMENT Com_TxSigInfo[106].TxBufferStartIdxOfTxSigInfo "" UWORD Com_TxBufferStartIdxOfTxSigInfoType 0 0 0 65535 ECU_ADDRESS 0x0 /end MEASUREMENT
/begin MEASUREMENT Com_TxSigInfo[106].TxFilterInitValueArrayBasedFilterInitValueEndIdxOfTxSigInfo "" UBYTE Com_TxFilterInitValueArrayBasedFilterInitValueEndIdxOfTxSigInfoType 0 0 0 255 ECU_ADDRESS 0x0 /end MEASUREMENT
/begin MEASUREMENT Com_TxSigInfo[106].TxFilterInitValueArrayBasedFilterInitValueStartIdxOfTxSigInfo "" UBYTE Com_TxFilterInitValueArrayBasedFilterInitValueStartIdxOfTxSigInfoType 0 0 0 255 ECU_ADDRESS 0x0 /end MEASUREMENT
/begin MEASUREMENT Com_TxSigInfo[106].TxPduInfoIdxOfTxSigInfo "" UBYTE NO_COMPU_METHOD 0 0 0 255 ECU_ADDRESS 0x0 /end MEASUREMENT
/begin MEASUREMENT Com_TxSigInfo[107].ApplTypeOfTxSigInfo "" UBYTE Com_ApplTypeOfTxSigInfoType 0 0 0 255 ECU_ADDRESS 0x0 /end MEASUREMENT
/begin MEASUREMENT Com_TxSigInfo[107].BitLengthOfTxSigInfo "" UWORD NO_COMPU_METHOD 0 0 0 65535 ECU_ADDRESS 0x0 /end MEASUREMENT
/begin MEASUREMENT Com_TxSigInfo[107].BitPositionOfTxSigInfo "" UWORD NO_COMPU_METHOD 0 0 0 65535 ECU_ADDRESS 0x0 /end MEASUREMENT
/begin MEASUREMENT Com_TxSigInfo[107].BusAccOfTxSigInfo "" UBYTE Com_BusAccOfTxSigInfoType 0 0 0 255 ECU_ADDRESS 0x0 /end MEASUREMENT
/begin MEASUREMENT Com_TxSigInfo[107].ByteLengthOfTxSigInfo "" UBYTE NO_COMPU_METHOD 0 0 0 255 ECU_ADDRESS 0x0 /end MEASUREMENT
/begin MEASUREMENT Com_TxSigInfo[107].DynSignalOfTxSigInfo "" UBYTE Com_DynSignalOfTxSigInfoType 0 0 0 1 ECU_ADDRESS 0x0 /end MEASUREMENT
/begin MEASUREMENT Com_TxSigInfo[107].FilterInitValueIdxOfTxSigInfo "" UBYTE Com_FilterInitValueIdxOfTxSigInfoType 0 0 0 255 ECU_ADDRESS 0x0 /end MEASUREMENT
/begin MEASUREMENT Com_TxSigInfo[107].FilterInitValueOfTxSigInfo "" UBYTE Com_FilterInitValueOfTxSigInfoType 0 0 0 255 ECU_ADDRESS 0x0 /end MEASUREMENT
/begin MEASUREMENT Com_TxSigInfo[107].InvValueIdxOfTxSigInfo "" UBYTE Com_InvValueIdxOfTxSigInfoType 0 0 0 255 ECU_ADDRESS 0x0 /end MEASUREMENT
/begin MEASUREMENT Com_TxSigInfo[107].InvValueOfTxSigInfo "" UBYTE Com_InvValueOfTxSigInfoType 0 0 0 255 ECU_ADDRESS 0x0 /end MEASUREMENT
/begin MEASUREMENT Com_TxSigInfo[107].OnChangeIdxOfTxSigInfo "" UBYTE Com_OnChangeIdxOfTxSigInfoType 0 0 0 255 ECU_ADDRESS 0x0 /end MEASUREMENT
/begin MEASUREMENT Com_TxSigInfo[107].OnChangeOfTxSigInfo "" UBYTE Com_OnChangeOfTxSigInfoType 0 0 0 255 ECU_ADDRESS 0x0 /end MEASUREMENT
/begin MEASUREMENT Com_TxSigInfo[107].StartByteInPduPositionOfTxSigInfo "" UBYTE NO_COMPU_METHOD 0 0 0 255 ECU_ADDRESS 0x0 /end MEASUREMENT
/begin MEASUREMENT Com_TxSigInfo[107].TxAccessInfoIdxOfTxSigInfo "" UWORD NO_COMPU_METHOD 0 0 0 65535 ECU_ADDRESS 0x0 /end MEASUREMENT
/begin MEASUREMENT Com_TxSigInfo[107].TxBufferEndIdxOfTxSigInfo "" UWORD Com_TxBufferEndIdxOfTxSigInfoType 0 0 0 65535 ECU_ADDRESS 0x0 /end MEASUREMENT
/begin MEASUREMENT Com_TxSigInfo[107].TxBufferStartIdxOfTxSigInfo "" UWORD Com_TxBufferStartIdxOfTxSigInfoType 0 0 0 65535 ECU_ADDRESS 0x0 /end MEASUREMENT
/begin MEASUREMENT Com_TxSigInfo[107].TxFilterInitValueArrayBasedFilterInitValueEndIdxOfTxSigInfo "" UBYTE Com_TxFilterInitValueArrayBasedFilterInitValueEndIdxOfTxSigInfoType 0 0 0 255 ECU_ADDRESS 0x0 /end MEASUREMENT
/begin MEASUREMENT Com_TxSigInfo[107].TxFilterInitValueArrayBasedFilterInitValueStartIdxOfTxSigInfo "" UBYTE Com_TxFilterInitValueArrayBasedFilterInitValueStartIdxOfTxSigInfoType 0 0 0 255 ECU_ADDRESS 0x0 /end MEASUREMENT
/begin MEASUREMENT Com_TxSigInfo[107].TxPduInfoIdxOfTxSigInfo "" UBYTE NO_COMPU_METHOD 0 0 0 255 ECU_ADDRESS 0x0 /end MEASUREMENT
/begin MEASUREMENT Com_TxSigInfo[108].ApplTypeOfTxSigInfo "" UBYTE Com_ApplTypeOfTxSigInfoType 0 0 0 255 ECU_ADDRESS 0x0 /end MEASUREMENT
/begin MEASUREMENT Com_TxSigInfo[108].BitLengthOfTxSigInfo "" UWORD NO_COMPU_METHOD 0 0 0 65535 ECU_ADDRESS 0x0 /end MEASUREMENT
/begin MEASUREMENT Com_TxSigInfo[108].BitPositionOfTxSigInfo "" UWORD NO_COMPU_METHOD 0 0 0 65535 ECU_ADDRESS 0x0 /end MEASUREMENT
/begin MEASUREMENT Com_TxSigInfo[108].BusAccOfTxSigInfo "" UBYTE Com_BusAccOfTxSigInfoType 0 0 0 255 ECU_ADDRESS 0x0 /end MEASUREMENT
/begin MEASUREMENT Com_TxSigInfo[108].ByteLengthOfTxSigInfo "" UBYTE NO_COMPU_METHOD 0 0 0 255 ECU_ADDRESS 0x0 /end MEASUREMENT
/begin MEASUREMENT Com_TxSigInfo[108].DynSignalOfTxSigInfo "" UBYTE Com_DynSignalOfTxSigInfoType 0 0 0 1 ECU_ADDRESS 0x0 /end MEASUREMENT
/begin MEASUREMENT Com_TxSigInfo[108].FilterInitValueIdxOfTxSigInfo "" UBYTE Com_FilterInitValueIdxOfTxSigInfoType 0 0 0 255 ECU_ADDRESS 0x0 /end MEASUREMENT
/begin MEASUREMENT Com_TxSigInfo[108].FilterInitValueOfTxSigInfo "" UBYTE Com_FilterInitValueOfTxSigInfoType 0 0 0 255 ECU_ADDRESS 0x0 /end MEASUREMENT
/begin MEASUREMENT Com_TxSigInfo[108].InvValueIdxOfTxSigInfo "" UBYTE Com_InvValueIdxOfTxSigInfoType 0 0 0 255 ECU_ADDRESS 0x0 /end MEASUREMENT
/begin MEASUREMENT Com_TxSigInfo[108].InvValueOfTxSigInfo "" UBYTE Com_InvValueOfTxSigInfoType 0 0 0 255 ECU_ADDRESS 0x0 /end MEASUREMENT
/begin MEASUREMENT Com_TxSigInfo[108].OnChangeIdxOfTxSigInfo "" UBYTE Com_OnChangeIdxOfTxSigInfoType 0 0 0 255 ECU_ADDRESS 0x0 /end MEASUREMENT
/begin MEASUREMENT Com_TxSigInfo[108].OnChangeOfTxSigInfo "" UBYTE Com_OnChangeOfTxSigInfoType 0 0 0 255 ECU_ADDRESS 0x0 /end MEASUREMENT
/begin MEASUREMENT Com_TxSigInfo[108].StartByteInPduPositionOfTxSigInfo "" UBYTE NO_COMPU_METHOD 0 0 0 255 ECU_ADDRESS 0x0 /end MEASUREMENT
/begin MEASUREMENT Com_TxSigInfo[108].TxAccessInfoIdxOfTxSigInfo "" UWORD NO_COMPU_METHOD 0 0 0 65535 ECU_ADDRESS 0x0 /end MEASUREMENT
/begin MEASUREMENT Com_TxSigInfo[108].TxBufferEndIdxOfTxSigInfo "" UWORD Com_TxBufferEndIdxOfTxSigInfoType 0 0 0 65535 ECU_ADDRESS 0x0 /end MEASUREMENT
/begin MEASUREMENT Com_TxSigInfo[108].TxBufferStartIdxOfTxSigInfo "" UWORD Com_TxBufferStartIdxOfTxSigInfoType 0 0 0 65535 ECU_ADDRESS 0x0 /end MEASUREMENT
/begin MEASUREMENT Com_TxSigInfo[108].TxFilterInitValueArrayBasedFilterInitValueEndIdxOfTxSigInfo "" UBYTE Com_TxFilterInitValueArrayBasedFilterInitValueEndIdxOfTxSigInfoType 0 0 0 255 ECU_ADDRESS 0x0 /end MEASUREMENT
/begin MEASUREMENT Com_TxSigInfo[108].TxFilterInitValueArrayBasedFilterInitValueStartIdxOfTxSigInfo "" UBYTE Com_TxFilterInitValueArrayBasedFilterInitValueStartIdxOfTxSigInfoType 0 0 0 255 ECU_ADDRESS 0x0 /end MEASUREMENT
/begin MEASUREMENT Com_TxSigInfo[108].TxPduInfoIdxOfTxSigInfo "" UBYTE NO_COMPU_METHOD 0 0 0 255 ECU_ADDRESS 0x0 /end MEASUREMENT
/begin MEASUREMENT Com_TxSigInfo[109].ApplTypeOfTxSigInfo "" UBYTE Com_ApplTypeOfTxSigInfoType 0 0 0 255 ECU_ADDRESS 0x0 /end MEASUREMENT
/begin MEASUREMENT Com_TxSigInfo[109].BitLengthOfTxSigInfo "" UWORD NO_COMPU_METHOD 0 0 0 65535 ECU_ADDRESS 0x0 /end MEASUREMENT
/begin MEASUREMENT Com_TxSigInfo[109].BitPositionOfTxSigInfo "" UWORD NO_COMPU_METHOD 0 0 0 65535 ECU_ADDRESS 0x0 /end MEASUREMENT
/begin MEASUREMENT Com_TxSigInfo[109].BusAccOfTxSigInfo "" UBYTE Com_BusAccOfTxSigInfoType 0 0 0 255 ECU_ADDRESS 0x0 /end MEASUREMENT
/begin MEASUREMENT Com_TxSigInfo[109].ByteLengthOfTxSigInfo "" UBYTE NO_COMPU_METHOD 0 0 0 255 ECU_ADDRESS 0x0 /end MEASUREMENT
/begin MEASUREMENT Com_TxSigInfo[109].DynSignalOfTxSigInfo "" UBYTE Com_DynSignalOfTxSigInfoType 0 0 0 1 ECU_ADDRESS 0x0 /end MEASUREMENT
/begin MEASUREMENT Com_TxSigInfo[109].FilterInitValueIdxOfTxSigInfo "" UBYTE Com_FilterInitValueIdxOfTxSigInfoType 0 0 0 255 ECU_ADDRESS 0x0 /end MEASUREMENT
/begin MEASUREMENT Com_TxSigInfo[109].FilterInitValueOfTxSigInfo "" UBYTE Com_FilterInitValueOfTxSigInfoType 0 0 0 255 ECU_ADDRESS 0x0 /end MEASUREMENT
/begin MEASUREMENT Com_TxSigInfo[109].InvValueIdxOfTxSigInfo "" UBYTE Com_InvValueIdxOfTxSigInfoType 0 0 0 255 ECU_ADDRESS 0x0 /end MEASUREMENT
/begin MEASUREMENT Com_TxSigInfo[109].InvValueOfTxSigInfo "" UBYTE Com_InvValueOfTxSigInfoType 0 0 0 255 ECU_ADDRESS 0x0 /end MEASUREMENT
/begin MEASUREMENT Com_TxSigInfo[109].OnChangeIdxOfTxSigInfo "" UBYTE Com_OnChangeIdxOfTxSigInfoType 0 0 0 255 ECU_ADDRESS 0x0 /end MEASUREMENT
/begin MEASUREMENT Com_TxSigInfo[109].OnChangeOfTxSigInfo "" UBYTE Com_OnChangeOfTxSigInfoType 0 0 0 255 ECU_ADDRESS 0x0 /end MEASUREMENT
/begin MEASUREMENT Com_TxSigInfo[109].StartByteInPduPositionOfTxSigInfo "" UBYTE NO_COMPU_METHOD 0 0 0 255 ECU_ADDRESS 0x0 /end MEASUREMENT
/begin MEASUREMENT Com_TxSigInfo[109].TxAccessInfoIdxOfTxSigInfo "" UWORD NO_COMPU_METHOD 0 0 0 65535 ECU_ADDRESS 0x0 /end MEASUREMENT
/begin MEASUREMENT Com_TxSigInfo[109].TxBufferEndIdxOfTxSigInfo "" UWORD Com_TxBufferEndIdxOfTxSigInfoType 0 0 0 65535 ECU_ADDRESS 0x0 /end MEASUREMENT
/begin MEASUREMENT Com_TxSigInfo[109].TxBufferStartIdxOfTxSigInfo "" UWORD Com_TxBufferStartIdxOfTxSigInfoType 0 0 0 65535 ECU_ADDRESS 0x0 /end MEASUREMENT
/begin MEASUREMENT Com_TxSigInfo[109].TxFilterInitValueArrayBasedFilterInitValueEndIdxOfTxSigInfo "" UBYTE Com_TxFilterInitValueArrayBasedFilterInitValueEndIdxOfTxSigInfoType 0 0 0 255 ECU_ADDRESS 0x0 /end MEASUREMENT
/begin MEASUREMENT Com_TxSigInfo[109].TxFilterInitValueArrayBasedFilterInitValueStartIdxOfTxSigInfo "" UBYTE Com_TxFilterInitValueArrayBasedFilterInitValueStartIdxOfTxSigInfoType 0 0 0 255 ECU_ADDRESS 0x0 /end MEASUREMENT
/begin MEASUREMENT Com_TxSigInfo[109].TxPduInfoIdxOfTxSigInfo "" UBYTE NO_COMPU_METHOD 0 0 0 255 ECU_ADDRESS 0x0 /end MEASUREMENT
/begin MEASUREMENT Com_TxSigInfo[10].ApplTypeOfTxSigInfo "" UBYTE Com_ApplTypeOfTxSigInfoType 0 0 0 255 ECU_ADDRESS 0x0 /end MEASUREMENT
/begin MEASUREMENT Com_TxSigInfo[10].BitLengthOfTxSigInfo "" UWORD NO_COMPU_METHOD 0 0 0 65535 ECU_ADDRESS 0x0 /end MEASUREMENT
/begin MEASUREMENT Com_TxSigInfo[10].BitPositionOfTxSigInfo "" UWORD NO_COMPU_METHOD 0 0 0 65535 ECU_ADDRESS 0x0 /end MEASUREMENT
/begin MEASUREMENT Com_TxSigInfo[10].BusAccOfTxSigInfo "" UBYTE Com_BusAccOfTxSigInfoType 0 0 0 255 ECU_ADDRESS 0x0 /end MEASUREMENT
/begin MEASUREMENT Com_TxSigInfo[10].ByteLengthOfTxSigInfo "" UBYTE NO_COMPU_METHOD 0 0 0 255 ECU_ADDRESS 0x0 /end MEASUREMENT
/begin MEASUREMENT Com_TxSigInfo[10].DynSignalOfTxSigInfo "" UBYTE Com_DynSignalOfTxSigInfoType 0 0 0 1 ECU_ADDRESS 0x0 /end MEASUREMENT
/begin MEASUREMENT Com_TxSigInfo[10].FilterInitValueIdxOfTxSigInfo "" UBYTE Com_FilterInitValueIdxOfTxSigInfoType 0 0 0 255 ECU_ADDRESS 0x0 /end MEASUREMENT
/begin MEASUREMENT Com_TxSigInfo[10].FilterInitValueOfTxSigInfo "" UBYTE Com_FilterInitValueOfTxSigInfoType 0 0 0 255 ECU_ADDRESS 0x0 /end MEASUREMENT
/begin MEASUREMENT Com_TxSigInfo[10].InvValueIdxOfTxSigInfo "" UBYTE Com_InvValueIdxOfTxSigInfoType 0 0 0 255 ECU_ADDRESS 0x0 /end MEASUREMENT
/begin MEASUREMENT Com_TxSigInfo[10].InvValueOfTxSigInfo "" UBYTE Com_InvValueOfTxSigInfoType 0 0 0 255 ECU_ADDRESS 0x0 /end MEASUREMENT
/begin MEASUREMENT Com_TxSigInfo[10].OnChangeIdxOfTxSigInfo "" UBYTE Com_OnChangeIdxOfTxSigInfoType 0 0 0 255 ECU_ADDRESS 0x0 /end MEASUREMENT
/begin MEASUREMENT Com_TxSigInfo[10].OnChangeOfTxSigInfo "" UBYTE Com_OnChangeOfTxSigInfoType 0 0 0 255 ECU_ADDRESS 0x0 /end MEASUREMENT
/begin MEASUREMENT Com_TxSigInfo[10].StartByteInPduPositionOfTxSigInfo "" UBYTE NO_COMPU_METHOD 0 0 0 255 ECU_ADDRESS 0x0 /end MEASUREMENT
/begin MEASUREMENT Com_TxSigInfo[10].TxAccessInfoIdxOfTxSigInfo "" UWORD NO_COMPU_METHOD 0 0 0 65535 ECU_ADDRESS 0x0 /end MEASUREMENT
/begin MEASUREMENT Com_TxSigInfo[10].TxBufferEndIdxOfTxSigInfo "" UWORD Com_TxBufferEndIdxOfTxSigInfoType 0 0 0 65535 ECU_ADDRESS 0x0 /end MEASUREMENT
/begin MEASUREMENT Com_TxSigInfo[10].TxBufferStartIdxOfTxSigInfo "" UWORD Com_TxBufferStartIdxOfTxSigInfoType 0 0 0 65535 ECU_ADDRESS 0x0 /end MEASUREMENT
/begin MEASUREMENT Com_TxSigInfo[10].TxFilterInitValueArrayBasedFilterInitValueEndIdxOfTxSigInfo "" UBYTE Com_TxFilterInitValueArrayBasedFilterInitValueEndIdxOfTxSigInfoType 0 0 0 255 ECU_ADDRESS 0x0 /end MEASUREMENT
/begin MEASUREMENT Com_TxSigInfo[10].TxFilterInitValueArrayBasedFilterInitValueStartIdxOfTxSigInfo "" UBYTE Com_TxFilterInitValueArrayBasedFilterInitValueStartIdxOfTxSigInfoType 0 0 0 255 ECU_ADDRESS 0x0 /end MEASUREMENT
/begin MEASUREMENT Com_TxSigInfo[10].TxPduInfoIdxOfTxSigInfo "" UBYTE NO_COMPU_METHOD 0 0 0 255 ECU_ADDRESS 0x0 /end MEASUREMENT
/begin MEASUREMENT Com_TxSigInfo[110].ApplTypeOfTxSigInfo "" UBYTE Com_ApplTypeOfTxSigInfoType 0 0 0 255 ECU_ADDRESS 0x0 /end MEASUREMENT
/begin MEASUREMENT Com_TxSigInfo[110].BitLengthOfTxSigInfo "" UWORD NO_COMPU_METHOD 0 0 0 65535 ECU_ADDRESS 0x0 /end MEASUREMENT
/begin MEASUREMENT Com_TxSigInfo[110].BitPositionOfTxSigInfo "" UWORD NO_COMPU_METHOD 0 0 0 65535 ECU_ADDRESS 0x0 /end MEASUREMENT
/begin MEASUREMENT Com_TxSigInfo[110].BusAccOfTxSigInfo "" UBYTE Com_BusAccOfTxSigInfoType 0 0 0 255 ECU_ADDRESS 0x0 /end MEASUREMENT
/begin MEASUREMENT Com_TxSigInfo[110].ByteLengthOfTxSigInfo "" UBYTE NO_COMPU_METHOD 0 0 0 255 ECU_ADDRESS 0x0 /end MEASUREMENT
/begin MEASUREMENT Com_TxSigInfo[110].DynSignalOfTxSigInfo "" UBYTE Com_DynSignalOfTxSigInfoType 0 0 0 1 ECU_ADDRESS 0x0 /end MEASUREMENT
/begin MEASUREMENT Com_TxSigInfo[110].FilterInitValueIdxOfTxSigInfo "" UBYTE Com_FilterInitValueIdxOfTxSigInfoType 0 0 0 255 ECU_ADDRESS 0x0 /end MEASUREMENT
/begin MEASUREMENT Com_TxSigInfo[110].FilterInitValueOfTxSigInfo "" UBYTE Com_FilterInitValueOfTxSigInfoType 0 0 0 255 ECU_ADDRESS 0x0 /end MEASUREMENT
/begin MEASUREMENT Com_TxSigInfo[110].InvValueIdxOfTxSigInfo "" UBYTE Com_InvValueIdxOfTxSigInfoType 0 0 0 255 ECU_ADDRESS 0x0 /end MEASUREMENT
/begin MEASUREMENT Com_TxSigInfo[110].InvValueOfTxSigInfo "" UBYTE Com_InvValueOfTxSigInfoType 0 0 0 255 ECU_ADDRESS 0x0 /end MEASUREMENT
/begin MEASUREMENT Com_TxSigInfo[110].OnChangeIdxOfTxSigInfo "" UBYTE Com_OnChangeIdxOfTxSigInfoType 0 0 0 255 ECU_ADDRESS 0x0 /end MEASUREMENT
/begin MEASUREMENT Com_TxSigInfo[110].OnChangeOfTxSigInfo "" UBYTE Com_OnChangeOfTxSigInfoType 0 0 0 255 ECU_ADDRESS 0x0 /end MEASUREMENT
/begin MEASUREMENT Com_TxSigInfo[110].StartByteInPduPositionOfTxSigInfo "" UBYTE NO_COMPU_METHOD 0 0 0 255 ECU_ADDRESS 0x0 /end MEASUREMENT
/begin MEASUREMENT Com_TxSigInfo[110].TxAccessInfoIdxOfTxSigInfo "" UWORD NO_COMPU_METHOD 0 0 0 65535 ECU_ADDRESS 0x0 /end MEASUREMENT
/begin MEASUREMENT Com_TxSigInfo[110].TxBufferEndIdxOfTxSigInfo "" UWORD Com_TxBufferEndIdxOfTxSigInfoType 0 0 0 65535 ECU_ADDRESS 0x0 /end MEASUREMENT
/begin MEASUREMENT Com_TxSigInfo[110].TxBufferStartIdxOfTxSigInfo "" UWORD Com_TxBufferStartIdxOfTxSigInfoType 0 0 0 65535 ECU_ADDRESS 0x0 /end MEASUREMENT
/begin MEASUREMENT Com_TxSigInfo[110].TxFilterInitValueArrayBasedFilterInitValueEndIdxOfTxSigInfo "" UBYTE Com_TxFilterInitValueArrayBasedFilterInitValueEndIdxOfTxSigInfoType 0 0 0 255 ECU_ADDRESS 0x0 /end MEASUREMENT
/begin MEASUREMENT Com_TxSigInfo[110].TxFilterInitValueArrayBasedFilterInitValueStartIdxOfTxSigInfo "" UBYTE Com_TxFilterInitValueArrayBasedFilterInitValueStartIdxOfTxSigInfoType 0 0 0 255 ECU_ADDRESS 0x0 /end MEASUREMENT
/begin MEASUREMENT Com_TxSigInfo[110].TxPduInfoIdxOfTxSigInfo "" UBYTE NO_COMPU_METHOD 0 0 0 255 ECU_ADDRESS 0x0 /end MEASUREMENT
/begin MEASUREMENT Com_TxSigInfo[111].ApplTypeOfTxSigInfo "" UBYTE Com_ApplTypeOfTxSigInfoType 0 0 0 255 ECU_ADDRESS 0x0 /end MEASUREMENT
/begin MEASUREMENT Com_TxSigInfo[111].BitLengthOfTxSigInfo "" UWORD NO_COMPU_METHOD 0 0 0 65535 ECU_ADDRESS 0x0 /end MEASUREMENT
/begin MEASUREMENT Com_TxSigInfo[111].BitPositionOfTxSigInfo "" UWORD NO_COMPU_METHOD 0 0 0 65535 ECU_ADDRESS 0x0 /end MEASUREMENT
/begin MEASUREMENT Com_TxSigInfo[111].BusAccOfTxSigInfo "" UBYTE Com_BusAccOfTxSigInfoType 0 0 0 255 ECU_ADDRESS 0x0 /end MEASUREMENT
/begin MEASUREMENT Com_TxSigInfo[111].ByteLengthOfTxSigInfo "" UBYTE NO_COMPU_METHOD 0 0 0 255 ECU_ADDRESS 0x0 /end MEASUREMENT
/begin MEASUREMENT Com_TxSigInfo[111].DynSignalOfTxSigInfo "" UBYTE Com_DynSignalOfTxSigInfoType 0 0 0 1 ECU_ADDRESS 0x0 /end MEASUREMENT
/begin MEASUREMENT Com_TxSigInfo[111].FilterInitValueIdxOfTxSigInfo "" UBYTE Com_FilterInitValueIdxOfTxSigInfoType 0 0 0 255 ECU_ADDRESS 0x0 /end MEASUREMENT
/begin MEASUREMENT Com_TxSigInfo[111].FilterInitValueOfTxSigInfo "" UBYTE Com_FilterInitValueOfTxSigInfoType 0 0 0 255 ECU_ADDRESS 0x0 /end MEASUREMENT
/begin MEASUREMENT Com_TxSigInfo[111].InvValueIdxOfTxSigInfo "" UBYTE Com_InvValueIdxOfTxSigInfoType 0 0 0 255 ECU_ADDRESS 0x0 /end MEASUREMENT
/begin MEASUREMENT Com_TxSigInfo[111].InvValueOfTxSigInfo "" UBYTE Com_InvValueOfTxSigInfoType 0 0 0 255 ECU_ADDRESS 0x0 /end MEASUREMENT
/begin MEASUREMENT Com_TxSigInfo[111].OnChangeIdxOfTxSigInfo "" UBYTE Com_OnChangeIdxOfTxSigInfoType 0 0 0 255 ECU_ADDRESS 0x0 /end MEASUREMENT
/begin MEASUREMENT Com_TxSigInfo[111].OnChangeOfTxSigInfo "" UBYTE Com_OnChangeOfTxSigInfoType 0 0 0 255 ECU_ADDRESS 0x0 /end MEASUREMENT
/begin MEASUREMENT Com_TxSigInfo[111].StartByteInPduPositionOfTxSigInfo "" UBYTE NO_COMPU_METHOD 0 0 0 255 ECU_ADDRESS 0x0 /end MEASUREMENT
/begin MEASUREMENT Com_TxSigInfo[111].TxAccessInfoIdxOfTxSigInfo "" UWORD NO_COMPU_METHOD 0 0 0 65535 ECU_ADDRESS 0x0 /end MEASUREMENT
/begin MEASUREMENT Com_TxSigInfo[111].TxBufferEndIdxOfTxSigInfo "" UWORD Com_TxBufferEndIdxOfTxSigInfoType 0 0 0 65535 ECU_ADDRESS 0x0 /end MEASUREMENT
/begin MEASUREMENT Com_TxSigInfo[111].TxBufferStartIdxOfTxSigInfo "" UWORD Com_TxBufferStartIdxOfTxSigInfoType 0 0 0 65535 ECU_ADDRESS 0x0 /end MEASUREMENT
/begin COMPU_METHOD Com_ApplTypeOfTxSigInfoType "" TAB_VERB "%10.1" "" COMPU_TAB_REF Com_ApplTypeOfTxSigInfoType /end COMPU_METHOD
/begin COMPU_METHOD Com_BusAccOfTxSigInfoType "" TAB_VERB "%10.1" "" COMPU_TAB_REF Com_BusAccOfTxSigInfoType /end COMPU_METHOD
/begin COMPU_METHOD Com_CbkTxAckDefFuncPtrIndEndIdxOfTxPduInfoType "" TAB_VERB "%10.1" "" COMPU_TAB_REF Com_CbkTxAckDefFuncPtrIndEndIdxOfTxPduInfoType /end COMPU_METHOD
/begin COMPU_METHOD Com_CbkTxAckDefFuncPtrIndStartIdxOfTxPduInfoType "" TAB_VERB "%10.1" "" COMPU_TAB_REF Com_CbkTxAckDefFuncPtrIndStartIdxOfTxPduInfoType /end COMPU_METHOD
/begin COMPU_METHOD Com_DirectOfTxModeTrueType "" TAB_VERB "%10.1" "" COMPU_TAB_REF Com_DirectOfTxModeTrueType /end COMPU_METHOD
/begin COMPU_METHOD Com_DynSignalOfTxSigInfoType "" TAB_VERB "%10.1" "" COMPU_TAB_REF Com_DynSignalOfTxSigInfoType /end COMPU_METHOD
/begin COMPU_METHOD Com_FilterInitValueIdxOfTxSigInfoType "" TAB_VERB "%10.1" "" COMPU_TAB_REF Com_FilterInitValueIdxOfTxSigInfoType /end COMPU_METHOD
/begin COMPU_METHOD Com_FilterInitValueOfTxSigInfoType "" TAB_VERB "%10.1" "" COMPU_TAB_REF Com_FilterInitValueOfTxSigInfoType /end COMPU_METHOD
/begin COMPU_METHOD Com_IPduGroupInfoOfTxPduInfoIndEndIdxOfTxPduInfoType "" TAB_VERB "%10.1" "" COMPU_TAB_REF Com_IPduGroupInfoOfTxPduInfoIndEndIdxOfTxPduInfoType /end COMPU_METHOD
/begin COMPU_METHOD Com_IPduGroupInfoOfTxPduInfoIndStartIdxOfTxPduInfoType "" TAB_VERB "%10.1" "" COMPU_TAB_REF Com_IPduGroupInfoOfTxPduInfoIndStartIdxOfTxPduInfoType /end COMPU_METHOD
/begin COMPU_METHOD Com_InitModeOfTxModeInfoType "" TAB_VERB "%10.1" "" COMPU_TAB_REF Com_InitModeOfTxModeInfoType /end COMPU_METHOD
/begin COMPU_METHOD Com_InvValueIdxOfTxSigInfoType "" TAB_VERB "%10.1" "" COMPU_TAB_REF Com_InvValueIdxOfTxSigInfoType /end COMPU_METHOD
/begin COMPU_METHOD Com_InvValueOfTxSigInfoType "" TAB_VERB "%10.1" "" COMPU_TAB_REF Com_InvValueOfTxSigInfoType /end COMPU_METHOD
/begin COMPU_METHOD Com_OnChangeIdxOfTxSigInfoType "" TAB_VERB "%10.1" "" COMPU_TAB_REF Com_OnChangeIdxOfTxSigInfoType /end COMPU_METHOD
/begin COMPU_METHOD Com_OnChangeOfTxSigInfoType "" TAB_VERB "%10.1" "" COMPU_TAB_REF Com_OnChangeOfTxSigInfoType /end COMPU_METHOD
/begin COMPU_METHOD Com_TransferPropertyOfTxSigGrpInfoType "" TAB_VERB "%10.1" "" COMPU_TAB_REF Com_TransferPropertyOfTxSigGrpInfoType /end COMPU_METHOD
/begin COMPU_METHOD Com_TxBufferEndIdxOfTxSigGrpInfoType "" TAB_VERB "%10.1" "" COMPU_TAB_REF Com_TxBufferEndIdxOfTxSigGrpInfoType /end COMPU_METHOD
/begin COMPU_METHOD Com_TxBufferEndIdxOfTxSigInfoType "" TAB_VERB "%10.1" "" COMPU_TAB_REF Com_TxBufferEndIdxOfTxSigInfoType /end COMPU_METHOD
/begin COMPU_METHOD Com_TxBufferSigGrpInTxIPDUEndIdxOfTxSigGrpInfoType "" TAB_VERB "%10.1" "" COMPU_TAB_REF Com_TxBufferSigGrpInTxIPDUEndIdxOfTxSigGrpInfoType /end COMPU_METHOD
/begin COMPU_METHOD Com_TxBufferSigGrpInTxIPDUStartIdxOfTxSigGrpInfoType "" TAB_VERB "%10.1" "" COMPU_TAB_REF Com_TxBufferSigGrpInTxIPDUStartIdxOfTxSigGrpInfoType /end COMPU_METHOD
/begin COMPU_METHOD Com_TxBufferStartIdxOfTxSigGrpInfoType "" TAB_VERB "%10.1" "" COMPU_TAB_REF Com_TxBufferStartIdxOfTxSigGrpInfoType /end COMPU_METHOD
/begin COMPU_METHOD Com_TxBufferStartIdxOfTxSigInfoType "" TAB_VERB "%10.1" "" COMPU_TAB_REF Com_TxBufferStartIdxOfTxSigInfoType /end COMPU_METHOD
/begin COMPU_METHOD Com_TxFilterInitValueArrayBasedFilterInitValueEndIdxOfTxSigInfoType "" TAB_VERB "%10.1" "" COMPU_TAB_REF Com_TxFilterInitValueArrayBasedFilterInitValueEndIdxOfTxSigInfoType /end COMPU_METHOD
/begin COMPU_METHOD Com_TxFilterInitValueArrayBasedFilterInitValueStartIdxOfTxSigInfoType "" TAB_VERB "%10.1" "" COMPU_TAB_REF Com_TxFilterInitValueArrayBasedFilterInitValueStartIdxOfTxSigInfoType /end COMPU_METHOD
/begin COMPU_METHOD Com_TxGrpSigInfoInvValueIndEndIdxOfTxSigGrpInfoType "" TAB_VERB "%10.1" "" COMPU_TAB_REF Com_TxGrpSigInfoInvValueIndEndIdxOfTxSigGrpInfoType /end COMPU_METHOD
/begin COMPU_METHOD Com_TxGrpSigInfoInvValueIndStartIdxOfTxSigGrpInfoType "" TAB_VERB "%10.1" "" COMPU_TAB_REF Com_TxGrpSigInfoInvValueIndStartIdxOfTxSigGrpInfoType /end COMPU_METHOD
/begin COMPU_METHOD Com_TxPduCalloutFuncPtrIdxOfTxPduInfoType "" TAB_VERB "%10.1" "" COMPU_TAB_REF Com_TxPduCalloutFuncPtrIdxOfTxPduInfoType /end COMPU_METHOD
/begin COMPU_METHOD Com_TxPduGrpActiveType "" TAB_VERB "%10.1" "" COMPU_TAB_REF Com_TxPduGrpActiveType /end COMPU_METHOD
/begin COMPU_METHOD Com_TxPduInitValueEndIdxOfTxPduInfoType "" TAB_VERB "%10.1" "" COMPU_TAB_REF Com_TxPduInitValueEndIdxOfTxPduInfoType /end COMPU_METHOD
/begin COMPU_METHOD Com_TxPduInitValueStartIdxOfTxPduInfoType "" TAB_VERB "%10.1" "" COMPU_TAB_REF Com_TxPduInitValueStartIdxOfTxPduInfoType /end COMPU_METHOD
/begin COMPU_METHOD Com_TxSigGrpInfoIndEndIdxOfTxPduInfoType "" TAB_VERB "%10.1" "" COMPU_TAB_REF Com_TxSigGrpInfoIndEndIdxOfTxPduInfoType /end COMPU_METHOD
/begin COMPU_METHOD Com_TxSigGrpInfoIndStartIdxOfTxPduInfoType "" TAB_VERB "%10.1" "" COMPU_TAB_REF Com_TxSigGrpInfoIndStartIdxOfTxPduInfoType /end COMPU_METHOD
/begin COMPU_METHOD Com_TxSigGrpMaskEndIdxOfTxSigGrpInfoType "" TAB_VERB "%10.1" "" COMPU_TAB_REF Com_TxSigGrpMaskEndIdxOfTxSigGrpInfoType /end COMPU_METHOD
/begin COMPU_METHOD Com_TxSigGrpMaskStartIdxOfTxSigGrpInfoType "" TAB_VERB "%10.1" "" COMPU_TAB_REF Com_TxSigGrpMaskStartIdxOfTxSigGrpInfoType /end COMPU_METHOD
/begin COMPU_METHOD Com_TxSigInfoFilterInitValueIndEndIdxOfTxModeInfoType "" TAB_VERB "%10.1" "" COMPU_TAB_REF Com_TxSigInfoFilterInitValueIndEndIdxOfTxModeInfoType /end COMPU_METHOD
/begin COMPU_METHOD Com_TxSigInfoFilterInitValueIndStartIdxOfTxModeInfoType "" TAB_VERB "%10.1" "" COMPU_TAB_REF Com_TxSigInfoFilterInitValueIndStartIdxOfTxModeInfoType /end COMPU_METHOD
/begin COMPU_METHOD Com_TxTOutInfoIdxOfTxPduInfoType "" TAB_VERB "%10.1" "" COMPU_TAB_REF Com_TxTOutInfoIdxOfTxPduInfoType /end COMPU_METHOD
/begin COMPU_VTAB Com_ApplTypeOfTxSigInfoType "" TAB_VERB 4 0 "COM_UINT8_APPLTYPEOFTXSIGINFO" 2 "COM_UINT16_APPLTYPEOFTXSIGINFO" 4 "COM_UINT32_APPLTYPEOFTXSIGINFO" 8 "COM_UINT8_N_APPLTYPEOFTXSIGINFO" /end COMPU_VTAB
/begin COMPU_VTAB Com_BusAccOfTxSigInfoType "" TAB_VERB 5 0 "COM_NBIT_BUSACCOFTXSIGINFO" 1 "COM_BYTE_BUSACCOFTXSIGINFO" 2 "COM_NBYTE_BUSACCOFTXSIGINFO" 4 "COM_NBITNBYTE_BUSACCOFTXSIGINFO" 6 "COM_ARRAY_BASED_BUSACCOFTXSIGINFO" /end COMPU_VTAB
/begin COMPU_VTAB Com_CbkTxAckDefFuncPtrIndEndIdxOfTxPduInfoType "" TAB_VERB 1 255 "COM_NO_CBKTXACKDEFFUNCPTRINDENDIDXOFTXPDUINFO" /end COMPU_VTAB
/begin COMPU_VTAB Com_CbkTxAckDefFuncPtrIndStartIdxOfTxPduInfoType "" TAB_VERB 1 255 "COM_NO_CBKTXACKDEFFUNCPTRINDSTARTIDXOFTXPDUINFO" /end COMPU_VTAB
/begin COMPU_VTAB_RANGE Com_DirectOfTxModeTrueType "" 2 0 0 "FALSE" 1 255 "TRUE" /end COMPU_VTAB_RANGE
/begin COMPU_VTAB_RANGE Com_DynSignalOfTxSigInfoType "" 2 0 0 "FALSE" 1 255 "TRUE" /end COMPU_VTAB_RANGE
/begin COMPU_VTAB Com_FilterInitValueIdxOfTxSigInfoType "" TAB_VERB 1 255 "COM_NO_FILTERINITVALUEIDXOFTXSIGINFO" /end COMPU_VTAB
/begin COMPU_VTAB Com_FilterInitValueOfTxSigInfoType "" TAB_VERB 3 0 "COM_TXFILTERINITVALUEUINT8_FILTERINITVALUEOFTXSIGINFO" 1 "COM_TXFILTERINITVALUEUINT16_FILTERINITVALUEOFTXSIGINFO" 255 "COM_NO_FILTERINITVALUEOFTXSIGINFO" /end COMPU_VTAB
/begin COMPU_VTAB Com_IPduGroupInfoOfTxPduInfoIndEndIdxOfTxPduInfoType "" TAB_VERB 1 255 "COM_NO_IPDUGROUPINFOOFTXPDUINFOINDENDIDXOFTXPDUINFO" /end COMPU_VTAB
/begin COMPU_VTAB Com_IPduGroupInfoOfTxPduInfoIndStartIdxOfTxPduInfoType "" TAB_VERB 1 255 "COM_NO_IPDUGROUPINFOOFTXPDUINFOINDSTARTIDXOFTXPDUINFO" /end COMPU_VTAB
/begin COMPU_VTAB_RANGE Com_InitModeOfTxModeInfoType "" 2 0 0 "FALSE" 1 255 "TRUE" /end COMPU_VTAB_RANGE
/begin COMPU_VTAB Com_InvValueIdxOfTxSigInfoType "" TAB_VERB 1 255 "COM_NO_INVVALUEIDXOFTXSIGINFO" /end COMPU_VTAB
/begin COMPU_VTAB Com_InvValueOfTxSigInfoType "" TAB_VERB 4 0 "COM_CONSTVALUEUINT8_INVVALUEOFTXSIGINFO" 1 "COM_CONSTVALUEUINT16_INVVALUEOFTXSIGINFO" 2 "COM_CONSTVALUEUINT32_INVVALUEOFTXSIGINFO" 255 "COM_NO_INVVALUEOFTXSIGINFO" /end COMPU_VTAB
/begin COMPU_VTAB Com_OnChangeIdxOfTxSigInfoType "" TAB_VERB 1 255 "COM_NO_ONCHANGEIDXOFTXSIGINFO" /end COMPU_VTAB
/begin COMPU_VTAB Com_OnChangeOfTxSigInfoType "" TAB_VERB 4 0 "COM_FILTERINFO_UINT8_ONCHANGEOFTXSIGINFO" 2 "COM_FILTERINFO_UINT16_ONCHANGEOFTXSIGINFO" 10 "COM_FILTERINFO_UINT8_N_ONCHANGEOFTXSIGINFO" 255 "COM_NO_ONCHANGEOFTXSIGINFO" /end COMPU_VTAB
/begin COMPU_VTAB Com_TransferPropertyOfTxSigGrpInfoType "" TAB_VERB 2 0 "COM_PENDING_TRANSFERPROPERTYOFTXSIGGRPINFO" 3 "COM_TRIGGERED_WITHOUT_REPETITION_TRANSFERPROPERTYOFTXSIGGRPINFO" /end COMPU_VTAB
/begin COMPU_VTAB Com_TxBufferEndIdxOfTxSigGrpInfoType "" TAB_VERB 1 65535 "COM_NO_TXBUFFERENDIDXOFTXSIGGRPINFO" /end COMPU_VTAB
/begin COMPU_VTAB Com_TxBufferEndIdxOfTxSigInfoType "" TAB_VERB 1 65535 "COM_NO_TXBUFFERENDIDXOFTXSIGINFO" /end COMPU_VTAB
/begin COMPU_VTAB Com_TxBufferSigGrpInTxIPDUEndIdxOfTxSigGrpInfoType "" TAB_VERB 1 65535 "COM_NO_TXBUFFERSIGGRPINTXIPDUENDIDXOFTXSIGGRPINFO" /end COMPU_VTAB
/begin COMPU_VTAB Com_TxBufferSigGrpInTxIPDUStartIdxOfTxSigGrpInfoType "" TAB_VERB 1 65535 "COM_NO_TXBUFFERSIGGRPINTXIPDUSTARTIDXOFTXSIGGRPINFO" /end COMPU_VTAB
/begin COMPU_VTAB Com_TxBufferStartIdxOfTxSigGrpInfoType "" TAB_VERB 1 65535 "COM_NO_TXBUFFERSTARTIDXOFTXSIGGRPINFO" /end COMPU_VTAB
/begin COMPU_VTAB Com_TxBufferStartIdxOfTxSigInfoType "" TAB_VERB 1 65535 "COM_NO_TXBUFFERSTARTIDXOFTXSIGINFO" /end COMPU_VTAB
/begin COMPU_VTAB Com_TxFilterInitValueArrayBasedFilterInitValueEndIdxOfTxSigInfoType "" TAB_VERB 1 255 "COM_NO_TXFILTERINITVALUEARRAYBASEDFILTERINITVALUEENDIDXOFTXSIGINFO" /end COMPU_VTAB
/begin COMPU_VTAB Com_TxFilterInitValueArrayBasedFilterInitValueStartIdxOfTxSigInfoType "" TAB_VERB 1 255 "COM_NO_TXFILTERINITVALUEARRAYBASEDFILTERINITVALUESTARTIDXOFTXSIGINFO" /end COMPU_VTAB
/begin COMPU_VTAB Com_TxGrpSigInfoInvValueIndEndIdxOfTxSigGrpInfoType "" TAB_VERB 1 255 "COM_NO_TXGRPSIGINFOINVVALUEINDENDIDXOFTXSIGGRPINFO" /end COMPU_VTAB
/begin COMPU_VTAB Com_TxGrpSigInfoInvValueIndStartIdxOfTxSigGrpInfoType "" TAB_VERB 1 255 "COM_NO_TXGRPSIGINFOINVVALUEINDSTARTIDXOFTXSIGGRPINFO" /end COMPU_VTAB
/begin COMPU_VTAB Com_TxPduCalloutFuncPtrIdxOfTxPduInfoType "" TAB_VERB 1 255 "COM_NO_TXPDUCALLOUTFUNCPTRIDXOFTXPDUINFO" /end COMPU_VTAB
/begin COMPU_VTAB_RANGE Com_TxPduGrpActiveType "" 2 0 0 "FALSE" 1 255 "TRUE" /end COMPU_VTAB_RANGE
/begin COMPU_VTAB Com_TxPduInitValueEndIdxOfTxPduInfoType "" TAB_VERB 1 65535 "COM_NO_TXPDUINITVALUEENDIDXOFTXPDUINFO" /end COMPU_VTAB
/begin COMPU_VTAB Com_TxPduInitValueStartIdxOfTxPduInfoType "" TAB_VERB 1 65535 "COM_NO_TXPDUINITVALUESTARTIDXOFTXPDUINFO" /end COMPU_VTAB
/begin COMPU_VTAB Com_TxSigGrpInfoIndEndIdxOfTxPduInfoType "" TAB_VERB 1 255 "COM_NO_TXSIGGRPINFOINDENDIDXOFTXPDUINFO" /end COMPU_VTAB
/begin COMPU_VTAB Com_TxSigGrpInfoIndStartIdxOfTxPduInfoType "" TAB_VERB 1 255 "COM_NO_TXSIGGRPINFOINDSTARTIDXOFTXPDUINFO" /end COMPU_VTAB
/begin COMPU_VTAB Com_TxSigGrpMaskEndIdxOfTxSigGrpInfoType "" TAB_VERB 1 255 "COM_NO_TXSIGGRPMASKENDIDXOFTXSIGGRPINFO" /end COMPU_VTAB
/begin COMPU_VTAB Com_TxSigGrpMaskStartIdxOfTxSigGrpInfoType "" TAB_VERB 1 255 "COM_NO_TXSIGGRPMASKSTARTIDXOFTXSIGGRPINFO" /end COMPU_VTAB
/begin COMPU_VTAB Com_TxSigInfoFilterInitValueIndEndIdxOfTxModeInfoType "" TAB_VERB 1 255 "COM_NO_TXSIGINFOFILTERINITVALUEINDENDIDXOFTXMODEINFO" /end COMPU_VTAB
/begin COMPU_VTAB Com_TxSigInfoFilterInitValueIndStartIdxOfTxModeInfoType "" TAB_VERB 1 255 "COM_NO_TXSIGINFOFILTERINITVALUEINDSTARTIDXOFTXMODEINFO" /end COMPU_VTAB
/begin COMPU_VTAB Com_TxTOutInfoIdxOfTxPduInfoType "" TAB_VERB 1 255 "COM_NO_TXTOUTINFOIDXOFTXPDUINFO" /end COMPU_VTAB
/begin GROUP Com ""
 /begin REF_MEASUREMENT Com_TxModeInfo[27].MinimumDelayOfTxModeInfo Com_TxModeInfo[27].TxModeTrueIdxOfTxModeInfo Com_TxModeInfo[27].TxSigInfoFilterInitValueIndEndIdxOfTxModeInfo Com_TxModeInfo[27].TxSigInfoFilterInitValueIndStartIdxOfTxModeInfo Com_TxModeInfo[28].InitModeOfTxModeInfo Com_TxModeInfo[28].MinimumDelayOfTxModeInfo Com_TxModeInfo[28].TxModeTrueIdxOfTxModeInfo Com_TxModeInfo[28].TxSigInfoFilterInitValueIndEndIdxOfTxModeInfo Com_TxModeInfo[28].TxSigInfoFilterInitValueIndStartIdxOfTxModeInfo Com_TxModeInfo[29].InitModeOfTxModeInfo Com_TxModeInfo[29].MinimumDelayOfTxModeInfo Com_TxModeInfo[29].TxModeTrueIdxOfTxModeInfo Com_TxModeInfo[29].TxSigInfoFilterInitValueIndEndIdxOfTxModeInfo Com_TxModeInfo[29].TxSigInfoFilterInitValueIndStartIdxOfTxModeInfo Com_TxModeInfo[2].InitModeOfTxModeInfo Com_TxModeInfo[2].MinimumDelayOfTxModeInfo Com_TxModeInfo[2].TxModeTrueIdxOfTxModeInfo Com_TxModeInfo[2].TxSigInfoFilterInitValueIndEndIdxOfTxModeInfo Com_TxModeInfo[2].TxSigInfoFilterInitValueIndStartIdxOfTxModeInfo Com_TxModeInfo[30].InitModeOfTxModeInfo Com_TxModeInfo[30].MinimumDelayOfTxModeInfo Com_TxModeInfo[30].TxModeTrueIdxOfTxModeInfo Com_TxModeInfo[30].TxSigInfoFilterInitValueIndEndIdxOfTxModeInfo Com_TxModeInfo[30].TxSigInfoFilterInitValueIndStartIdxOfTxModeInfo Com_TxModeInfo[31].InitModeOfTxModeInfo Com_TxModeInfo[31].MinimumDelayOfTxModeInfo Com_TxModeInfo[31].TxModeTrueIdxOfTxModeInfo Com_TxModeInfo[31].TxSigInfoFilterInitValueIndEndIdxOfTxModeInfo Com_TxModeInfo[31].TxSigInfoFilterInitValueIndStartIdxOfTxModeInfo Com_TxModeInfo[3].InitModeOfTxModeInfo Com_TxModeInfo[3].MinimumDelayOfTxModeInfo Com_TxModeInfo[3].TxModeTrueIdxOfTxModeInfo Com_TxModeInfo[3].TxSigInfoFilterInitValueIndEndIdxOfTxModeInfo Com_TxModeInfo[3].TxSigInfoFilterInitValueIndStartIdxOfTxModeInfo Com_TxModeInfo[4].InitModeOfTxModeInfo Com_TxModeInfo[4].MinimumDelayOfTxModeInfo Com_TxModeInfo[4].TxModeTrueIdxOfTxModeInfo Com_TxModeInfo[4].TxSigInfoFilterInitValueIndEndIdxOfTxModeInfo Com_TxModeInfo[4].TxSigInfoFilterInitValueIndStartIdxOfTxModeInfo Com_TxModeInfo[5].InitModeOfTxModeInfo Com_TxModeInfo[5].MinimumDelayOfTxModeInfo Com_TxModeInfo[5].TxModeTrueIdxOfTxModeInfo Com_TxModeInfo[5].TxSigInfoFilterInitValueIndEndIdxOfTxModeInfo Com_TxModeInfo[5].TxSigInfoFilterInitValueIndStartIdxOfTxModeInfo Com_TxModeInfo[6].InitModeOfTxModeInfo Com_TxModeInfo[6].MinimumDelayOfTxModeInfo Com_TxModeInfo[6].TxModeTrueIdxOfTxModeInfo Com_TxModeInfo[6].TxSigInfoFilterInitValueIndEndIdxOfTxModeInfo Com_TxModeInfo[6].TxSigInfoFilterInitValueIndStartIdxOfTxModeInfo Com_TxModeInfo[7].InitModeOfTxModeInfo Com_TxModeInfo[7].MinimumDelayOfTxModeInfo Com_TxModeInfo[7].TxModeTrueIdxOfTxModeInfo Com_TxModeInfo[7].TxSigInfoFilterInitValueIndEndIdxOfTxModeInfo Com_TxModeInfo[7].TxSigInfoFilterInitValueIndStartIdxOfTxModeInfo Com_TxModeInfo[8].InitModeOfTxModeInfo Com_TxModeInfo[8].MinimumDelayOfTxModeInfo Com_TxModeInfo[8].TxModeTrueIdxOfTxModeInfo Com_TxModeInfo[8].TxSigInfoFilterInitValueIndEndIdxOfTxModeInfo Com_TxModeInfo[8].TxSigInfoFilterInitValueIndStartIdxOfTxModeInfo Com_TxModeInfo[9].InitModeOfTxModeInfo Com_TxModeInfo[9].MinimumDelayOfTxModeInfo Com_TxModeInfo[9].TxModeTrueIdxOfTxModeInfo Com_TxModeInfo[9].TxSigInfoFilterInitValueIndEndIdxOfTxModeInfo Com_TxModeInfo[9].TxSigInfoFilterInitValueIndStartIdxOfTxModeInfo Com_TxModeTrue[0].DirectOfTxModeTrue Com_TxModeTrue[0].TimePeriodOfTxModeTrue Com_TxModeTrue[1].DirectOfTxModeTrue Com_TxModeTrue[1].TimePeriodOfTxModeTrue Com_TxModeTrue[2].DirectOfTxModeTrue Com_TxModeTrue[2].TimePeriodOfTxModeTrue Com_TxModeTrue[3].DirectOfTxModeTrue Com_TxModeTrue[3].TimePeriodOfTxModeTrue Com_TxModeTrue[4].DirectOfTxModeTrue Com_TxModeTrue[4].TimePeriodOfTxModeTrue Com_TxModeTrue[5].DirectOfTxModeTrue Com_TxModeTrue[5].TimePeriodOfTxModeTrue Com_TxModeTrue[6].DirectOfTxModeTrue Com_TxModeTrue[6].TimePeriodOfTxModeTrue Com_TxModeTrue[7].DirectOfTxModeTrue Com_TxModeTrue[7].TimePeriodOfTxModeTrue Com_TxModeTrue[8].DirectOfTxModeTrue Com_TxModeTrue[8].TimePeriodOfTxModeTrue Com_TxModeTrue[9].DirectOfTxModeTrue Com_TxModeTrue[9].TimePeriodOfTxModeTrue Com_TxPduGrpActive Com_TxPduInfoInd Com_TxPduInfo[0].CbkTxAckDefFuncPtrIndEndIdxOfTxPduInfo Com_TxPduInfo[0].CbkTxAckDefFuncPtrIndStartIdxOfTxPduInfo Com_TxPduInfo[0].ExternalIdOfTxPduInfo Com_TxPduInfo[0].IPduGroupInfoOfTxPduInfoIndEndIdxOfTxPduInfo Com_TxPduInfo[0].IPduGroupInfoOfTxPduInfoIndStartIdxOfTxPduInfo Com_TxPduInfo[0].PartitionsTxStructIdxOfTxPduInfo Com_TxPduInfo[0].TxBufferLengthOfTxPduInfo Com_TxPduInfo[0].TxPduCalloutFuncPtrIdxOfTxPduInfo Com_TxPduInfo[0].TxPduInitValueEndIdxOfTxPduInfo Com_TxPduInfo[0].TxPduInitValueStartIdxOfTxPduInfo Com_TxPduInfo[0].TxSigGrpInfoIndEndIdxOfTxPduInfo Com_TxPduInfo[0].TxSigGrpInfoIndStartIdxOfTxPduInfo Com_TxPduInfo[0].TxTOutInfoIdxOfTxPduInfo Com_TxPduInfo[10].CbkTxAckDefFuncPtrIndEndIdxOfTxPduInfo Com_TxPduInfo[10].CbkTxAckDefFuncPtrIndStartIdxOfTxPduInfo Com_TxPduInfo[10].ExternalIdOfTxPduInfo Com_TxPduInfo[10].IPduGroupInfoOfTxPduInfoIndEndIdxOfTxPduInfo Com_TxPduInfo[10].IPduGroupInfoOfTxPduInfoIndStartIdxOfTxPduInfo Com_TxPduInfo[10].PartitionsTxStructIdxOfTxPduInfo Com_TxPduInfo[10].TxBufferLengthOfTxPduInfo Com_TxPduInfo[10].TxPduCalloutFuncPtrIdxOfTxPduInfo Com_TxPduInfo[10].TxPduInitValueEndIdxOfTxPduInfo Com_TxPduInfo[10].TxPduInitValueStartIdxOfTxPduInfo Com_TxPduInfo[10].TxSigGrpInfoIndEndIdxOfTxPduInfo Com_TxPduInfo[10].TxSigGrpInfoIndStartIdxOfTxPduInfo Com_TxPduInfo[10].TxTOutInfoIdxOfTxPduInfo Com_TxPduInfo[11].CbkTxAckDefFuncPtrIndEndIdxOfTxPduInfo Com_TxPduInfo[11].CbkTxAckDefFuncPtrIndStartIdxOfTxPduInfo Com_TxPduInfo[11].ExternalIdOfTxPduInfo Com_TxPduInfo[11].IPduGroupInfoOfTxPduInfoIndEndIdxOfTxPduInfo Com_TxPduInfo[11].IPduGroupInfoOfTxPduInfoIndStartIdxOfTxPduInfo Com_TxPduInfo[11].PartitionsTxStructIdxOfTxPduInfo Com_TxPduInfo[11].TxBufferLengthOfTxPduInfo Com_TxPduInfo[11].TxPduCalloutFuncPtrIdxOfTxPduInfo Com_TxPduInfo[11].TxPduInitValueEndIdxOfTxPduInfo Com_TxPduInfo[11].TxPduInitValueStartIdxOfTxPduInfo Com_TxPduInfo[11].TxSigGrpInfoIndEndIdxOfTxPduInfo Com_TxPduInfo[11].TxSigGrpInfoIndStartIdxOfTxPduInfo Com_TxPduInfo[11].TxTOutInfoIdxOfTxPduInfo Com_TxPduInfo[12].CbkTxAckDefFuncPtrIndEndIdxOfTxPduInfo Com_TxPduInfo[12].CbkTxAckDefFuncPtrIndStartIdxOfTxPduInfo Com_TxPduInfo[12].ExternalIdOfTxPduInfo Com_TxPduInfo[12].IPduGroupInfoOfTxPduInfoIndEndIdxOfTxPduInfo Com_TxPduInfo[12].IPduGroupInfoOfTxPduInfoIndStartIdxOfTxPduInfo Com_TxPduInfo[12].PartitionsTxStructIdxOfTxPduInfo Com_TxPduInfo[12].TxBufferLengthOfTxPduInfo Com_TxPduInfo[12].TxPduCalloutFuncPtrIdxOfTxPduInfo Com_TxPduInfo[12].TxPduInitValueEndIdxOfTxPduInfo Com_TxPduInfo[12].TxPduInitValueStartIdxOfTxPduInfo Com_TxPduInfo[12].TxSigGrpInfoIndEndIdxOfTxPduInfo Com_TxPduInfo[12].TxSigGrpInfoIndStartIdxOfTxPduInfo Com_TxPduInfo[12].TxTOutInfoIdxOfTxPduInfo Com_TxPduInfo[13].CbkTxAckDefFuncPtrIndEndIdxOfTxPduInfo Com_TxPduInfo[13].CbkTxAckDefFuncPtrIndStartIdxOfTxPduInfo Com_TxPduInfo[13].ExternalIdOfTxPduInfo Com_TxPduInfo[13].IPduGroupInfoOfTxPduInfoIndEndIdxOfTxPduInfo Com_TxPduInfo[13].IPduGroupInfoOfTxPduInfoIndStartIdxOfTxPduInfo Com_TxPduInfo[13].PartitionsTxStructIdxOfTxPduInfo Com_TxPduInfo[13].TxBufferLengthOfTxPduInfo Com_TxPduInfo[13].TxPduCalloutFuncPtrIdxOfTxPduInfo Com_TxPduInfo[13].TxPduInitValueEndIdxOfTxPduInfo Com_TxPduInfo[13].TxPduInitValueStartIdxOfTxPduInfo Com_TxPduInfo[13].TxSigGrpInfoIndEndIdxOfTxPduInfo Com_TxPduInfo[13].TxSigGrpInfoIndStartIdxOfTxPduInfo Com_TxPduInfo[13].TxTOutInfoIdxOfTxPduInfo Com_TxPduInfo[14].CbkTxAckDefFuncPtrIndEndIdxOfTxPduInfo Com_TxPduInfo[14].CbkTxAckDefFuncPtrIndStartIdxOfTxPduInfo Com_TxPduInfo[14].ExternalIdOfTxPduInfo Com_TxPduInfo[14].IPduGroupInfoOfTxPduInfoIndEndIdxOfTxPduInfo Com_TxPduInfo[14].IPduGroupInfoOfTxPduInfoIndStartIdxOfTxPduInfo Com_TxPduInfo[14].PartitionsTxStructIdxOfTxPduInfo Com_TxPduInfo[14].TxBufferLengthOfTxPduInfo Com_TxPduInfo[14].TxPduCalloutFuncPtrIdxOfTxPduInfo Com_TxPduInfo[14].TxPduInitValueEndIdxOfTxPduInfo Com_TxPduInfo[14].TxPduInitValueStartIdxOfTxPduInfo Com_TxPduInfo[14].TxSigGrpInfoIndEndIdxOfTxPduInfo Com_TxPduInfo[14].TxSigGrpInfoIndStartIdxOfTxPduInfo Com_TxPduInfo[14].TxTOutInfoIdxOfTxPduInfo Com_TxPduInfo[15].CbkTxAckDefFuncPtrIndEndIdxOfTxPduInfo Com_TxPduInfo[15].CbkTxAckDefFuncPtrIndStartIdxOfTxPduInfo Com_TxPduInfo[15].ExternalIdOfTxPduInfo Com_TxPduInfo[15].IPduGroupInfoOfTxPduInfoIndEndIdxOfTxPduInfo Com_TxPduInfo[15].IPduGroupInfoOfTxPduInfoIndStartIdxOfTxPduInfo Com_TxPduInfo[15].PartitionsTxStructIdxOfTxPduInfo Com_TxPduInfo[15].TxBufferLengthOfTxPduInfo Com_TxPduInfo[15].TxPduCalloutFuncPtrIdxOfTxPduInfo Com_TxPduInfo[15].TxPduInitValueEndIdxOfTxPduInfo Com_TxPduInfo[15].TxPduInitValueStartIdxOfTxPduInfo Com_TxPduInfo[15].TxSigGrpInfoIndEndIdxOfTxPduInfo Com_TxPduInfo[15].TxSigGrpInfoIndStartIdxOfTxPduInfo Com_TxPduInfo[15].TxTOutInfoIdxOfTxPduInfo Com_TxPduInfo[16].CbkTxAckDefFuncPtrIndEndIdxOfTxPduInfo Com_TxPduInfo[16].CbkTxAckDefFuncPtrIndStartIdxOfTxPduInfo Com_TxPduInfo[16].ExternalIdOfTxPduInfo Com_TxPduInfo[16].IPduGroupInfoOfTxPduInfoIndEndIdxOfTxPduInfo Com_TxPduInfo[16].IPduGroupInfoOfTxPduInfoIndStartIdxOfTxPduInfo Com_TxPduInfo[16].PartitionsTxStructIdxOfTxPduInfo Com_TxPduInfo[16].TxBufferLengthOfTxPduInfo Com_TxPduInfo[16].TxPduCalloutFuncPtrIdxOfTxPduInfo Com_TxPduInfo[16].TxPduInitValueEndIdxOfTxPduInfo Com_TxPduInfo[16].TxPduInitValueStartIdxOfTxPduInfo Com_TxPduInfo[16].TxSigGrpInfoIndEndIdxOfTxPduInfo Com_TxPduInfo[16].TxSigGrpInfoIndStartIdxOfTxPduInfo Com_TxPduInfo[16].TxTOutInfoIdxOfTxPduInfo Com_TxPduInfo[17].CbkTxAckDefFuncPtrIndEndIdxOfTxPduInfo Com_TxPduInfo[17].CbkTxAckDefFuncPtrIndStartIdxOfTxPduInfo Com_TxPduInfo[17].ExternalIdOfTxPduInfo Com_TxPduInfo[17].IPduGroupInfoOfTxPduInfoIndEndIdxOfTxPduInfo Com_TxPduInfo[17].IPduGroupInfoOfTxPduInfoIndStartIdxOfTxPduInfo Com_TxPduInfo[17].PartitionsTxStructIdxOfTxPduInfo Com_TxPduInfo[17].TxBufferLengthOfTxPduInfo Com_TxPduInfo[17].TxPduCalloutFuncPtrIdxOfTxPduInfo Com_TxPduInfo[17].TxPduInitValueEndIdxOfTxPduInfo Com_TxPduInfo[17].TxPduInitValueStartIdxOfTxPduInfo Com_TxPduInfo[17].TxSigGrpInfoIndEndIdxOfTxPduInfo Com_TxPduInfo[17].TxSigGrpInfoIndStartIdxOfTxPduInfo Com_TxPduInfo[17].TxTOutInfoIdxOfTxPduInfo Com_TxPduInfo[18].CbkTxAckDefFuncPtrIndEndIdxOfTxPduInfo Com_TxPduInfo[18].CbkTxAckDefFuncPtrIndStartIdxOfTxPduInfo Com_TxPduInfo[18].ExternalIdOfTxPduInfo Com_TxPduInfo[18].IPduGroupInfoOfTxPduInfoIndEndIdxOfTxPduInfo Com_TxPduInfo[18].IPduGroupInfoOfTxPduInfoIndStartIdxOfTxPduInfo Com_TxPduInfo[18].PartitionsTxStructIdxOfTxPduInfo Com_TxPduInfo[18].TxBufferLengthOfTxPduInfo Com_TxPduInfo[18].TxPduCalloutFuncPtrIdxOfTxPduInfo Com_TxPduInfo[18].TxPduInitValueEndIdxOfTxPduInfo Com_TxPduInfo[18].TxPduInitValueStartIdxOfTxPduInfo Com_TxPduInfo[18].TxSigGrpInfoIndEndIdxOfTxPduInfo Com_TxPduInfo[18].TxSigGrpInfoIndStartIdxOfTxPduInfo Com_TxPduInfo[18].TxTOutInfoIdxOfTxPduInfo Com_TxPduInfo[19].CbkTxAckDefFuncPtrIndEndIdxOfTxPduInfo Com_TxPduInfo[19].CbkTxAckDefFuncPtrIndStartIdxOfTxPduInfo Com_TxPduInfo[19].ExternalIdOfTxPduInfo Com_TxPduInfo[19].IPduGroupInfoOfTxPduInfoIndEndIdxOfTxPduInfo Com_TxPduInfo[19].IPduGroupInfoOfTxPduInfoIndStartIdxOfTxPduInfo Com_TxPduInfo[19].PartitionsTxStructIdxOfTxPduInfo Com_TxPduInfo[19].TxBufferLengthOfTxPduInfo Com_TxPduInfo[19].TxPduCalloutFuncPtrIdxOfTxPduInfo Com_TxPduInfo[19].TxPduInitValueEndIdxOfTxPduInfo Com_TxPduInfo[19].TxPduInitValueStartIdxOfTxPduInfo Com_TxPduInfo[19].TxSigGrpInfoIndEndIdxOfTxPduInfo Com_TxPduInfo[19].TxSigGrpInfoIndStartIdxOfTxPduInfo Com_TxPduInfo[19].TxTOutInfoIdxOfTxPduInfo Com_TxPduInfo[1].CbkTxAckDefFuncPtrIndEndIdxOfTxPduInfo Com_TxPduInfo[1].CbkTxAckDefFuncPtrIndStartIdxOfTxPduInfo Com_TxPduInfo[1].ExternalIdOfTxPduInfo Com_TxPduInfo[1].IPduGroupInfoOfTxPduInfoIndEndIdxOfTxPduInfo Com_TxPduInfo[1].IPduGroupInfoOfTxPduInfoIndStartIdxOfTxPduInfo Com_TxPduInfo[1].PartitionsTxStructIdxOfTxPduInfo Com_TxPduInfo[1].TxBufferLengthOfTxPduInfo Com_TxPduInfo[1].TxPduCalloutFuncPtrIdxOfTxPduInfo Com_TxPduInfo[1].TxPduInitValueEndIdxOfTxPduInfo Com_TxPduInfo[1].TxPduInitValueStartIdxOfTxPduInfo Com_TxPduInfo[1].TxSigGrpInfoIndEndIdxOfTxPduInfo Com_TxPduInfo[1].TxSigGrpInfoIndStartIdxOfTxPduInfo Com_TxPduInfo[1].TxTOutInfoIdxOfTxPduInfo Com_TxPduInfo[20].CbkTxAckDefFuncPtrIndEndIdxOfTxPduInfo Com_TxPduInfo[20].CbkTxAckDefFuncPtrIndStartIdxOfTxPduInfo Com_TxPduInfo[20].ExternalIdOfTxPduInfo Com_TxPduInfo[20].IPduGroupInfoOfTxPduInfoIndEndIdxOfTxPduInfo Com_TxPduInfo[20].IPduGroupInfoOfTxPduInfoIndStartIdxOfTxPduInfo Com_TxPduInfo[20].PartitionsTxStructIdxOfTxPduInfo Com_TxPduInfo[20].TxBufferLengthOfTxPduInfo Com_TxPduInfo[20].TxPduCalloutFuncPtrIdxOfTxPduInfo Com_TxPduInfo[20].TxPduInitValueEndIdxOfTxPduInfo Com_TxPduInfo[20].TxPduInitValueStartIdxOfTxPduInfo Com_TxPduInfo[20].TxSigGrpInfoIndEndIdxOfTxPduInfo Com_TxPduInfo[20].TxSigGrpInfoIndStartIdxOfTxPduInfo Com_TxPduInfo[20].TxTOutInfoIdxOfTxPduInfo Com_TxPduInfo[21].CbkTxAckDefFuncPtrIndEndIdxOfTxPduInfo Com_TxPduInfo[21].CbkTxAckDefFuncPtrIndStartIdxOfTxPduInfo Com_TxPduInfo[21].ExternalIdOfTxPduInfo Com_TxPduInfo[21].IPduGroupInfoOfTxPduInfoIndEndIdxOfTxPduInfo Com_TxPduInfo[21].IPduGroupInfoOfTxPduInfoIndStartIdxOfTxPduInfo Com_TxPduInfo[21].PartitionsTxStructIdxOfTxPduInfo Com_TxPduInfo[21].TxBufferLengthOfTxPduInfo Com_TxPduInfo[21].TxPduCalloutFuncPtrIdxOfTxPduInfo Com_TxPduInfo[21].TxPduInitValueEndIdxOfTxPduInfo Com_TxPduInfo[21].TxPduInitValueStartIdxOfTxPduInfo Com_TxPduInfo[21].TxSigGrpInfoIndEndIdxOfTxPduInfo Com_TxPduInfo[21].TxSigGrpInfoIndStartIdxOfTxPduInfo Com_TxPduInfo[21].TxTOutInfoIdxOfTxPduInfo Com_TxPduInfo[22].CbkTxAckDefFuncPtrIndEndIdxOfTxPduInfo Com_TxPduInfo[22].CbkTxAckDefFuncPtrIndStartIdxOfTxPduInfo Com_TxPduInfo[22].ExternalIdOfTxPduInfo Com_TxPduInfo[22].IPduGroupInfoOfTxPduInfoIndEndIdxOfTxPduInfo Com_TxPduInfo[22].IPduGroupInfoOfTxPduInfoIndStartIdxOfTxPduInfo Com_TxPduInfo[22].PartitionsTxStructIdxOfTxPduInfo Com_TxPduInfo[22].TxBufferLengthOfTxPduInfo Com_TxPduInfo[22].TxPduCalloutFuncPtrIdxOfTxPduInfo Com_TxPduInfo[22].TxPduInitValueEndIdxOfTxPduInfo Com_TxPduInfo[22].TxPduInitValueStartIdxOfTxPduInfo Com_TxPduInfo[22].TxSigGrpInfoIndEndIdxOfTxPduInfo Com_TxPduInfo[22].TxSigGrpInfoIndStartIdxOfTxPduInfo Com_TxPduInfo[22].TxTOutInfoIdxOfTxPduInfo Com_TxPduInfo[23].CbkTxAckDefFuncPtrIndEndIdxOfTxPduInfo Com_TxPduInfo[23].CbkTxAckDefFuncPtrIndStartIdxOfTxPduInfo Com_TxPduInfo[23].ExternalIdOfTxPduInfo Com_TxPduInfo[23].IPduGroupInfoOfTxPduInfoIndEndIdxOfTxPduInfo Com_TxPduInfo[23].IPduGroupInfoOfTxPduInfoIndStartIdxOfTxPduInfo Com_TxPduInfo[23].PartitionsTxStructIdxOfTxPduInfo Com_TxPduInfo[23].TxBufferLengthOfTxPduInfo Com_TxPduInfo[23].TxPduCalloutFuncPtrIdxOfTxPduInfo Com_TxPduInfo[23].TxPduInitValueEndIdxOfTxPduInfo Com_TxPduInfo[23].TxPduInitValueStartIdxOfTxPduInfo Com_TxPduInfo[23].TxSigGrpInfoIndEndIdxOfTxPduInfo Com_TxPduInfo[23].TxSigGrpInfoIndStartIdxOfTxPduInfo Com_TxPduInfo[23].TxTOutInfoIdxOfTxPduInfo Com_TxPduInfo[24].CbkTxAckDefFuncPtrIndEndIdxOfTxPduInfo Com_TxPduInfo[24].CbkTxAckDefFuncPtrIndStartIdxOfTxPduInfo Com_TxPduInfo[24].ExternalIdOfTxPduInfo Com_TxPduInfo[24].IPduGroupInfoOfTxPduInfoIndEndIdxOfTxPduInfo Com_TxPduInfo[24].IPduGroupInfoOfTxPduInfoIndStartIdxOfTxPduInfo Com_TxPduInfo[24].PartitionsTxStructIdxOfTxPduInfo Com_TxPduInfo[24].TxBufferLengthOfTxPduInfo Com_TxPduInfo[24].TxPduCalloutFuncPtrIdxOfTxPduInfo Com_TxPduInfo[24].TxPduInitValueEndIdxOfTxPduInfo Com_TxPduInfo[24].TxPduInitValueStartIdxOfTxPduInfo Com_TxPduInfo[24].TxSigGrpInfoIndEndIdxOfTxPduInfo Com_TxPduInfo[24].TxSigGrpInfoIndStartIdxOfTxPduInfo Com_TxPduInfo[24].TxTOutInfoIdxOfTxPduInfo Com_TxPduInfo[25].CbkTxAckDefFuncPtrIndEndIdxOfTxPduInfo Com_TxPduInfo[25].CbkTxAckDefFuncPtrIndStartIdxOfTxPduInfo Com_TxPduInfo[25].ExternalIdOfTxPduInfo Com_TxPduInfo[25].IPduGroupInfoOfTxPduInfoIndEndIdxOfTxPduInfo Com_TxPduInfo[25].IPduGroupInfoOfTxPduInfoIndStartIdxOfTxPduInfo Com_TxPduInfo[25].PartitionsTxStructIdxOfTxPduInfo Com_TxPduInfo[25].TxBufferLengthOfTxPduInfo Com_TxPduInfo[25].TxPduCalloutFuncPtrIdxOfTxPduInfo Com_TxPduInfo[25].TxPduInitValueEndIdxOfTxPduInfo Com_TxPduInfo[25].TxPduInitValueStartIdxOfTxPduInfo Com_TxPduInfo[25].TxSigGrpInfoIndEndIdxOfTxPduInfo Com_TxPduInfo[25].TxSigGrpInfoIndStartIdxOfTxPduInfo Com_TxPduInfo[25].TxTOutInfoIdxOfTxPduInfo Com_TxPduInfo[26].CbkTxAckDefFuncPtrIndEndIdxOfTxPduInfo Com_TxPduInfo[26].CbkTxAckDefFuncPtrIndStartIdxOfTxPduInfo Com_TxPduInfo[26].ExternalIdOfTxPduInfo Com_TxPduInfo[26].IPduGroupInfoOfTxPduInfoIndEndIdxOfTxPduInfo Com_TxPduInfo[26].IPduGroupInfoOfTxPduInfoIndStartIdxOfTxPduInfo Com_TxPduInfo[26].PartitionsTxStructIdxOfTxPduInfo Com_TxPduInfo[26].TxBufferLengthOfTxPduInfo Com_TxPduInfo[26].TxPduCalloutFuncPtrIdxOfTxPduInfo Com_TxPduInfo[26].TxPduInitValueEndIdxOfTxPduInfo Com_TxPduInfo[26].TxPduInitValueStartIdxOfTxPduInfo Com_TxPduInfo[26].TxSigGrpInfoIndEndIdxOfTxPduInfo Com_TxPduInfo[26].TxSigGrpInfoIndStartIdxOfTxPduInfo Com_TxPduInfo[26].TxTOutInfoIdxOfTxPduInfo Com_TxPduInfo[27].CbkTxAckDefFuncPtrIndEndIdxOfTxPduInfo Com_TxPduInfo[27].CbkTxAckDefFuncPtrIndStartIdxOfTxPduInfo Com_TxPduInfo[27].ExternalIdOfTxPduInfo Com_TxPduInfo[27].IPduGroupInfoOfTxPduInfoIndEndIdxOfTxPduInfo Com_TxPduInfo[27].IPduGroupInfoOfTxPduInfoIndStartIdxOfTxPduInfo Com_TxPduInfo[27].PartitionsTxStructIdxOfTxPduInfo Com_TxPduInfo[27].TxBufferLengthOfTxPduInfo Com_TxPduInfo[27].TxPduCalloutFuncPtrIdxOfTxPduInfo Com_TxPduInfo[27].TxPduInitValueEndIdxOfTxPduInfo Com_TxPduInfo[27].TxPduInitValueStartIdxOfTxPduInfo Com_TxPduInfo[27].TxSigGrpInfoIndEndIdxOfTxPduInfo Com_TxPduInfo[27].TxSigGrpInfoIndStartIdxOfTxPduInfo Com_TxPduInfo[27].TxTOutInfoIdxOfTxPduInfo Com_TxPduInfo[28].CbkTxAckDefFuncPtrIndEndIdxOfTxPduInfo Com_TxPduInfo[28].CbkTxAckDefFuncPtrIndStartIdxOfTxPduInfo Com_TxPduInfo[28].ExternalIdOfTxPduInfo Com_TxPduInfo[28].IPduGroupInfoOfTxPduInfoIndEndIdxOfTxPduInfo Com_TxPduInfo[28].IPduGroupInfoOfTxPduInfoIndStartIdxOfTxPduInfo Com_TxPduInfo[28].PartitionsTxStructIdxOfTxPduInfo Com_TxPduInfo[28].TxBufferLengthOfTxPduInfo Com_TxPduInfo[28].TxPduCalloutFuncPtrIdxOfTxPduInfo Com_TxPduInfo[28].TxPduInitValueEndIdxOfTxPduInfo Com_TxPduInfo[28].TxPduInitValueStartIdxOfTxPduInfo Com_TxPduInfo[28].TxSigGrpInfoIndEndIdxOfTxPduInfo Com_TxPduInfo[28].TxSigGrpInfoIndStartIdxOfTxPduInfo Com_TxPduInfo[28].TxTOutInfoIdxOfTxPduInfo Com_TxPduInfo[29].CbkTxAckDefFuncPtrIndEndIdxOfTxPduInfo Com_TxPduInfo[29].CbkTxAckDefFuncPtrIndStartIdxOfTxPduInfo Com_TxPduInfo[29].ExternalIdOfTxPduInfo Com_TxPduInfo[29].IPduGroupInfoOfTxPduInfoIndEndIdxOfTxPduInfo Com_TxPduInfo[29].IPduGroupInfoOfTxPduInfoIndStartIdxOfTxPduInfo Com_TxPduInfo[29].PartitionsTxStructIdxOfTxPduInfo Com_TxPduInfo[29].TxBufferLengthOfTxPduInfo Com_TxPduInfo[29].TxPduCalloutFuncPtrIdxOfTxPduInfo Com_TxPduInfo[29].TxPduInitValueEndIdxOfTxPduInfo Com_TxPduInfo[29].TxPduInitValueStartIdxOfTxPduInfo Com_TxPduInfo[29].TxSigGrpInfoIndEndIdxOfTxPduInfo Com_TxPduInfo[29].TxSigGrpInfoIndStartIdxOfTxPduInfo Com_TxPduInfo[29].TxTOutInfoIdxOfTxPduInfo Com_TxPduInfo[2].CbkTxAckDefFuncPtrIndEndIdxOfTxPduInfo Com_TxPduInfo[2].CbkTxAckDefFuncPtrIndStartIdxOfTxPduInfo Com_TxPduInfo[2].ExternalIdOfTxPduInfo Com_TxPduInfo[2].IPduGroupInfoOfTxPduInfoIndEndIdxOfTxPduInfo Com_TxPduInfo[2].IPduGroupInfoOfTxPduInfoIndStartIdxOfTxPduInfo Com_TxPduInfo[2].PartitionsTxStructIdxOfTxPduInfo Com_TxPduInfo[2].TxBufferLengthOfTxPduInfo Com_TxPduInfo[2].TxPduCalloutFuncPtrIdxOfTxPduInfo Com_TxPduInfo[2].TxPduInitValueEndIdxOfTxPduInfo Com_TxPduInfo[2].TxPduInitValueStartIdxOfTxPduInfo Com_TxPduInfo[2].TxSigGrpInfoIndEndIdxOfTxPduInfo Com_TxPduInfo[2].TxSigGrpInfoIndStartIdxOfTxPduInfo Com_TxPduInfo[2].TxTOutInfoIdxOfTxPduInfo Com_TxPduInfo[30].CbkTxAckDefFuncPtrIndEndIdxOfTxPduInfo Com_TxPduInfo[30].CbkTxAckDefFuncPtrIndStartIdxOfTxPduInfo Com_TxPduInfo[30].ExternalIdOfTxPduInfo Com_TxPduInfo[30].IPduGroupInfoOfTxPduInfoIndEndIdxOfTxPduInfo Com_TxPduInfo[30].IPduGroupInfoOfTxPduInfoIndStartIdxOfTxPduInfo Com_TxPduInfo[30].PartitionsTxStructIdxOfTxPduInfo Com_TxPduInfo[30].TxBufferLengthOfTxPduInfo Com_TxPduInfo[30].TxPduCalloutFuncPtrIdxOfTxPduInfo Com_TxPduInfo[30].TxPduInitValueEndIdxOfTxPduInfo Com_TxPduInfo[30].TxPduInitValueStartIdxOfTxPduInfo Com_TxPduInfo[30].TxSigGrpInfoIndEndIdxOfTxPduInfo Com_TxPduInfo[30].TxSigGrpInfoIndStartIdxOfTxPduInfo Com_TxPduInfo[30].TxTOutInfoIdxOfTxPduInfo Com_TxPduInfo[31].CbkTxAckDefFuncPtrIndEndIdxOfTxPduInfo Com_TxPduInfo[31].CbkTxAckDefFuncPtrIndStartIdxOfTxPduInfo Com_TxPduInfo[31].ExternalIdOfTxPduInfo Com_TxPduInfo[31].IPduGroupInfoOfTxPduInfoIndEndIdxOfTxPduInfo Com_TxPduInfo[31].IPduGroupInfoOfTxPduInfoIndStartIdxOfTxPduInfo Com_TxPduInfo[31].PartitionsTxStructIdxOfTxPduInfo Com_TxPduInfo[31].TxBufferLengthOfTxPduInfo Com_TxPduInfo[31].TxPduCalloutFuncPtrIdxOfTxPduInfo Com_TxPduInfo[31].TxPduInitValueEndIdxOfTxPduInfo Com_TxPduInfo[31].TxPduInitValueStartIdxOfTxPduInfo Com_TxPduInfo[31].TxSigGrpInfoIndEndIdxOfTxPduInfo Com_TxPduInfo[31].TxSigGrpInfoIndStartIdxOfTxPduInfo Com_TxPduInfo[31].TxTOutInfoIdxOfTxPduInfo Com_TxPduInfo[3].CbkTxAckDefFuncPtrIndEndIdxOfTxPduInfo Com_TxPduInfo[3].CbkTxAckDefFuncPtrIndStartIdxOfTxPduInfo Com_TxPduInfo[3].ExternalIdOfTxPduInfo Com_TxPduInfo[3].IPduGroupInfoOfTxPduInfoIndEndIdxOfTxPduInfo Com_TxPduInfo[3].IPduGroupInfoOfTxPduInfoIndStartIdxOfTxPduInfo Com_TxPduInfo[3].PartitionsTxStructIdxOfTxPduInfo Com_TxPduInfo[3].TxBufferLengthOfTxPduInfo Com_TxPduInfo[3].TxPduCalloutFuncPtrIdxOfTxPduInfo Com_TxPduInfo[3].TxPduInitValueEndIdxOfTxPduInfo Com_TxPduInfo[3].TxPduInitValueStartIdxOfTxPduInfo Com_TxPduInfo[3].TxSigGrpInfoIndEndIdxOfTxPduInfo Com_TxPduInfo[3].TxSigGrpInfoIndStartIdxOfTxPduInfo Com_TxPduInfo[3].TxTOutInfoIdxOfTxPduInfo Com_TxPduInfo[4].CbkTxAckDefFuncPtrIndEndIdxOfTxPduInfo Com_TxPduInfo[4].CbkTxAckDefFuncPtrIndStartIdxOfTxPduInfo Com_TxPduInfo[4].ExternalIdOfTxPduInfo Com_TxPduInfo[4].IPduGroupInfoOfTxPduInfoIndEndIdxOfTxPduInfo Com_TxPduInfo[4].IPduGroupInfoOfTxPduInfoIndStartIdxOfTxPduInfo Com_TxPduInfo[4].PartitionsTxStructIdxOfTxPduInfo Com_TxPduInfo[4].TxBufferLengthOfTxPduInfo Com_TxPduInfo[4].TxPduCalloutFuncPtrIdxOfTxPduInfo Com_TxPduInfo[4].TxPduInitValueEndIdxOfTxPduInfo Com_TxPduInfo[4].TxPduInitValueStartIdxOfTxPduInfo Com_TxPduInfo[4].TxSigGrpInfoIndEndIdxOfTxPduInfo Com_TxPduInfo[4].TxSigGrpInfoIndStartIdxOfTxPduInfo Com_TxPduInfo[4].TxTOutInfoIdxOfTxPduInfo Com_TxPduInfo[5].CbkTxAckDefFuncPtrIndEndIdxOfTxPduInfo Com_TxPduInfo[5].CbkTxAckDefFuncPtrIndStartIdxOfTxPduInfo Com_TxPduInfo[5].ExternalIdOfTxPduInfo Com_TxPduInfo[5].IPduGroupInfoOfTxPduInfoIndEndIdxOfTxPduInfo Com_TxPduInfo[5].IPduGroupInfoOfTxPduInfoIndStartIdxOfTxPduInfo Com_TxPduInfo[5].PartitionsTxStructIdxOfTxPduInfo Com_TxPduInfo[5].TxBufferLengthOfTxPduInfo Com_TxPduInfo[5].TxPduCalloutFuncPtrIdxOfTxPduInfo Com_TxPduInfo[5].TxPduInitValueEndIdxOfTxPduInfo Com_TxPduInfo[5].TxPduInitValueStartIdxOfTxPduInfo Com_TxPduInfo[5].TxSigGrpInfoIndEndIdxOfTxPduInfo Com_TxPduInfo[5].TxSigGrpInfoIndStartIdxOfTxPduInfo Com_TxPduInfo[5].TxTOutInfoIdxOfTxPduInfo Com_TxPduInfo[6].CbkTxAckDefFuncPtrIndEndIdxOfTxPduInfo Com_TxPduInfo[6].CbkTxAckDefFuncPtrIndStartIdxOfTxPduInfo Com_TxPduInfo[6].ExternalIdOfTxPduInfo Com_TxPduInfo[6].IPduGroupInfoOfTxPduInfoIndEndIdxOfTxPduInfo Com_TxPduInfo[6].IPduGroupInfoOfTxPduInfoIndStartIdxOfTxPduInfo Com_TxPduInfo[6].PartitionsTxStructIdxOfTxPduInfo Com_TxPduInfo[6].TxBufferLengthOfTxPduInfo Com_TxPduInfo[6].TxPduCalloutFuncPtrIdxOfTxPduInfo Com_TxPduInfo[6].TxPduInitValueEndIdxOfTxPduInfo Com_TxPduInfo[6].TxPduInitValueStartIdxOfTxPduInfo Com_TxPduInfo[6].TxSigGrpInfoIndEndIdxOfTxPduInfo Com_TxPduInfo[6].TxSigGrpInfoIndStartIdxOfTxPduInfo Com_TxPduInfo[6].TxTOutInfoIdxOfTxPduInfo Com_TxPduInfo[7].CbkTxAckDefFuncPtrIndEndIdxOfTxPduInfo Com_TxPduInfo[7].CbkTxAckDefFuncPtrIndStartIdxOfTxPduInfo Com_TxPduInfo[7].ExternalIdOfTxPduInfo Com_TxPduInfo[7].IPduGroupInfoOfTxPduInfoIndEndIdxOfTxPduInfo Com_TxPduInfo[7].IPduGroupInfoOfTxPduInfoIndStartIdxOfTxPduInfo Com_TxPduInfo[7].PartitionsTxStructIdxOfTxPduInfo Com_TxPduInfo[7].TxBufferLengthOfTxPduInfo Com_TxPduInfo[7].TxPduCalloutFuncPtrIdxOfTxPduInfo Com_TxPduInfo[7].TxPduInitValueEndIdxOfTxPduInfo Com_TxPduInfo[7].TxPduInitValueStartIdxOfTxPduInfo Com_TxPduInfo[7].TxSigGrpInfoIndEndIdxOfTxPduInfo Com_TxPduInfo[7].TxSigGrpInfoIndStartIdxOfTxPduInfo Com_TxPduInfo[7].TxTOutInfoIdxOfTxPduInfo Com_TxPduInfo[8].CbkTxAckDefFuncPtrIndEndIdxOfTxPduInfo Com_TxPduInfo[8].CbkTxAckDefFuncPtrIndStartIdxOfTxPduInfo Com_TxPduInfo[8].ExternalIdOfTxPduInfo Com_TxPduInfo[8].IPduGroupInfoOfTxPduInfoIndEndIdxOfTxPduInfo Com_TxPduInfo[8].IPduGroupInfoOfTxPduInfoIndStartIdxOfTxPduInfo Com_TxPduInfo[8].PartitionsTxStructIdxOfTxPduInfo Com_TxPduInfo[8].TxBufferLengthOfTxPduInfo Com_TxPduInfo[8].TxPduCalloutFuncPtrIdxOfTxPduInfo Com_TxPduInfo[8].TxPduInitValueEndIdxOfTxPduInfo Com_TxPduInfo[8].TxPduInitValueStartIdxOfTxPduInfo Com_TxPduInfo[8].TxSigGrpInfoIndEndIdxOfTxPduInfo Com_TxPduInfo[8].TxSigGrpInfoIndStartIdxOfTxPduInfo Com_TxPduInfo[8].TxTOutInfoIdxOfTxPduInfo Com_TxPduInfo[9].CbkTxAckDefFuncPtrIndEndIdxOfTxPduInfo Com_TxPduInfo[9].CbkTxAckDefFuncPtrIndStartIdxOfTxPduInfo Com_TxPduInfo[9].ExternalIdOfTxPduInfo Com_TxPduInfo[9].IPduGroupInfoOfTxPduInfoIndEndIdxOfTxPduInfo Com_TxPduInfo[9].IPduGroupInfoOfTxPduInfoIndStartIdxOfTxPduInfo Com_TxPduInfo[9].PartitionsTxStructIdxOfTxPduInfo Com_TxPduInfo[9].TxBufferLengthOfTxPduInfo Com_TxPduInfo[9].TxPduCalloutFuncPtrIdxOfTxPduInfo Com_TxPduInfo[9].TxPduInitValueEndIdxOfTxPduInfo Com_TxPduInfo[9].TxPduInitValueStartIdxOfTxPduInfo Com_TxPduInfo[9].TxSigGrpInfoIndEndIdxOfTxPduInfo Com_TxPduInfo[9].TxSigGrpInfoIndStartIdxOfTxPduInfo Com_TxPduInfo[9].TxTOutInfoIdxOfTxPduInfo Com_TxPduInitValue Com_TxProcessingISRLockCounter Com_TxProcessingISRLockCounter_ComMainFunctionTx Com_TxSduLength Com_TxSigGrpInfo[0].SigGroupOnChangeOffsetOfTxSigGrpInfo Com_TxSigGrpInfo[0].TransferPropertyOfTxSigGrpInfo Com_TxSigGrpInfo[0].TxBufferEndIdxOfTxSigGrpInfo Com_TxSigGrpInfo[0].TxBufferSigGrpInTxIPDUEndIdxOfTxSigGrpInfo Com_TxSigGrpInfo[0].TxBufferSigGrpInTxIPDUStartIdxOfTxSigGrpInfo Com_TxSigGrpInfo[0].TxBufferStartIdxOfTxSigGrpInfo Com_TxSigGrpInfo[0].TxGrpSigInfoInvValueIndEndIdxOfTxSigGrpInfo Com_TxSigGrpInfo[0].TxGrpSigInfoInvValueIndStartIdxOfTxSigGrpInfo Com_TxSigGrpInfo[0].TxPduInfoIdxOfTxSigGrpInfo Com_TxSigGrpInfo[0].TxSigGrpMaskEndIdxOfTxSigGrpInfo Com_TxSigGrpInfo[0].TxSigGrpMaskStartIdxOfTxSigGrpInfo Com_TxSigGrpInfo[1].SigGroupOnChangeOffsetOfTxSigGrpInfo Com_TxSigGrpInfo[1].TransferPropertyOfTxSigGrpInfo Com_TxSigGrpInfo[1].TxBufferEndIdxOfTxSigGrpInfo Com_TxSigGrpInfo[1].TxBufferSigGrpInTxIPDUEndIdxOfTxSigGrpInfo Com_TxSigGrpInfo[1].TxBufferSigGrpInTxIPDUStartIdxOfTxSigGrpInfo Com_TxSigGrpInfo[1].TxBufferStartIdxOfTxSigGrpInfo Com_TxSigGrpInfo[1].TxGrpSigInfoInvValueIndEndIdxOfTxSigGrpInfo Com_TxSigGrpInfo[1].TxGrpSigInfoInvValueIndStartIdxOfTxSigGrpInfo Com_TxSigGrpInfo[1].TxPduInfoIdxOfTxSigGrpInfo Com_TxSigGrpInfo[1].TxSigGrpMaskEndIdxOfTxSigGrpInfo Com_TxSigGrpInfo[1].TxSigGrpMaskStartIdxOfTxSigGrpInfo Com_TxSigGrpInfo[2].SigGroupOnChangeOffsetOfTxSigGrpInfo Com_TxSigGrpInfo[2].TransferPropertyOfTxSigGrpInfo Com_TxSigGrpInfo[2].TxBufferEndIdxOfTxSigGrpInfo Com_TxSigGrpInfo[2].TxBufferSigGrpInTxIPDUEndIdxOfTxSigGrpInfo Com_TxSigGrpInfo[2].TxBufferSigGrpInTxIPDUStartIdxOfTxSigGrpInfo Com_TxSigGrpInfo[2].TxBufferStartIdxOfTxSigGrpInfo Com_TxSigGrpInfo[2].TxGrpSigInfoInvValueIndEndIdxOfTxSigGrpInfo Com_TxSigGrpInfo[2].TxGrpSigInfoInvValueIndStartIdxOfTxSigGrpInfo Com_TxSigGrpInfo[2].TxPduInfoIdxOfTxSigGrpInfo Com_TxSigGrpInfo[2].TxSigGrpMaskEndIdxOfTxSigGrpInfo Com_TxSigGrpInfo[2].TxSigGrpMaskStartIdxOfTxSigGrpInfo Com_TxSigGrpInfo[3].SigGroupOnChangeOffsetOfTxSigGrpInfo Com_TxSigGrpInfo[3].TransferPropertyOfTxSigGrpInfo Com_TxSigGrpInfo[3].TxBufferEndIdxOfTxSigGrpInfo Com_TxSigGrpInfo[3].TxBufferSigGrpInTxIPDUEndIdxOfTxSigGrpInfo Com_TxSigGrpInfo[3].TxBufferSigGrpInTxIPDUStartIdxOfTxSigGrpInfo Com_TxSigGrpInfo[3].TxBufferStartIdxOfTxSigGrpInfo Com_TxSigGrpInfo[3].TxGrpSigInfoInvValueIndEndIdxOfTxSigGrpInfo Com_TxSigGrpInfo[3].TxGrpSigInfoInvValueIndStartIdxOfTxSigGrpInfo Com_TxSigGrpInfo[3].TxPduInfoIdxOfTxSigGrpInfo Com_TxSigGrpInfo[3].TxSigGrpMaskEndIdxOfTxSigGrpInfo Com_TxSigGrpInfo[3].TxSigGrpMaskStartIdxOfTxSigGrpInfo Com_TxSigGrpInfo[4].SigGroupOnChangeOffsetOfTxSigGrpInfo Com_TxSigGrpInfo[4].TransferPropertyOfTxSigGrpInfo Com_TxSigGrpInfo[4].TxBufferEndIdxOfTxSigGrpInfo Com_TxSigGrpInfo[4].TxBufferSigGrpInTxIPDUEndIdxOfTxSigGrpInfo Com_TxSigGrpInfo[4].TxBufferSigGrpInTxIPDUStartIdxOfTxSigGrpInfo Com_TxSigGrpInfo[4].TxBufferStartIdxOfTxSigGrpInfo Com_TxSigGrpInfo[4].TxGrpSigInfoInvValueIndEndIdxOfTxSigGrpInfo Com_TxSigGrpInfo[4].TxGrpSigInfoInvValueIndStartIdxOfTxSigGrpInfo Com_TxSigGrpInfo[4].TxPduInfoIdxOfTxSigGrpInfo Com_TxSigGrpInfo[4].TxSigGrpMaskEndIdxOfTxSigGrpInfo Com_TxSigGrpInfo[4].TxSigGrpMaskStartIdxOfTxSigGrpInfo Com_TxSigGrpInfo[5].SigGroupOnChangeOffsetOfTxSigGrpInfo Com_TxSigGrpInfo[5].TransferPropertyOfTxSigGrpInfo Com_TxSigGrpInfo[5].TxBufferEndIdxOfTxSigGrpInfo Com_TxSigGrpInfo[5].TxBufferSigGrpInTxIPDUEndIdxOfTxSigGrpInfo Com_TxSigGrpInfo[5].TxBufferSigGrpInTxIPDUStartIdxOfTxSigGrpInfo Com_TxSigGrpInfo[5].TxBufferStartIdxOfTxSigGrpInfo Com_TxSigGrpInfo[5].TxGrpSigInfoInvValueIndEndIdxOfTxSigGrpInfo Com_TxSigGrpInfo[5].TxGrpSigInfoInvValueIndStartIdxOfTxSigGrpInfo Com_TxSigGrpInfo[5].TxPduInfoIdxOfTxSigGrpInfo Com_TxSigGrpInfo[5].TxSigGrpMaskEndIdxOfTxSigGrpInfo Com_TxSigGrpInfo[5].TxSigGrpMaskStartIdxOfTxSigGrpInfo Com_TxSigGrpInfo[6].SigGroupOnChangeOffsetOfTxSigGrpInfo Com_TxSigGrpInfo[6].TransferPropertyOfTxSigGrpInfo Com_TxSigGrpInfo[6].TxBufferEndIdxOfTxSigGrpInfo Com_TxSigGrpInfo[6].TxBufferSigGrpInTxIPDUEndIdxOfTxSigGrpInfo Com_TxSigGrpInfo[6].TxBufferSigGrpInTxIPDUStartIdxOfTxSigGrpInfo Com_TxSigGrpInfo[6].TxBufferStartIdxOfTxSigGrpInfo Com_TxSigGrpInfo[6].TxGrpSigInfoInvValueIndEndIdxOfTxSigGrpInfo Com_TxSigGrpInfo[6].TxGrpSigInfoInvValueIndStartIdxOfTxSigGrpInfo Com_TxSigGrpInfo[6].TxPduInfoIdxOfTxSigGrpInfo Com_TxSigGrpInfo[6].TxSigGrpMaskEndIdxOfTxSigGrpInfo Com_TxSigGrpInfo[6].TxSigGrpMaskStartIdxOfTxSigGrpInfo Com_TxSigGrpInfo[7].SigGroupOnChangeOffsetOfTxSigGrpInfo Com_TxSigGrpInfo[7].TransferPropertyOfTxSigGrpInfo Com_TxSigGrpInfo[7].TxBufferEndIdxOfTxSigGrpInfo Com_TxSigGrpInfo[7].TxBufferSigGrpInTxIPDUEndIdxOfTxSigGrpInfo Com_TxSigGrpInfo[7].TxBufferSigGrpInTxIPDUStartIdxOfTxSigGrpInfo Com_TxSigGrpInfo[7].TxBufferStartIdxOfTxSigGrpInfo Com_TxSigGrpInfo[7].TxGrpSigInfoInvValueIndEndIdxOfTxSigGrpInfo Com_TxSigGrpInfo[7].TxGrpSigInfoInvValueIndStartIdxOfTxSigGrpInfo Com_TxSigGrpInfo[7].TxPduInfoIdxOfTxSigGrpInfo Com_TxSigGrpInfo[7].TxSigGrpMaskEndIdxOfTxSigGrpInfo Com_TxSigGrpInfo[7].TxSigGrpMaskStartIdxOfTxSigGrpInfo Com_TxSigGrpInfo[8].SigGroupOnChangeOffsetOfTxSigGrpInfo Com_TxSigGrpInfo[8].TransferPropertyOfTxSigGrpInfo Com_TxSigGrpInfo[8].TxBufferEndIdxOfTxSigGrpInfo Com_TxSigGrpInfo[8].TxBufferSigGrpInTxIPDUEndIdxOfTxSigGrpInfo Com_TxSigGrpInfo[8].TxBufferSigGrpInTxIPDUStartIdxOfTxSigGrpInfo Com_TxSigGrpInfo[8].TxBufferStartIdxOfTxSigGrpInfo Com_TxSigGrpInfo[8].TxGrpSigInfoInvValueIndEndIdxOfTxSigGrpInfo Com_TxSigGrpInfo[8].TxGrpSigInfoInvValueIndStartIdxOfTxSigGrpInfo Com_TxSigGrpInfo[8].TxPduInfoIdxOfTxSigGrpInfo Com_TxSigGrpInfo[8].TxSigGrpMaskEndIdxOfTxSigGrpInfo Com_TxSigGrpInfo[8].TxSigGrpMaskStartIdxOfTxSigGrpInfo Com_TxSigGrpInfo[9].SigGroupOnChangeOffsetOfTxSigGrpInfo Com_TxSigGrpInfo[9].TransferPropertyOfTxSigGrpInfo Com_TxSigGrpInfo[9].TxBufferEndIdxOfTxSigGrpInfo Com_TxSigGrpInfo[9].TxBufferSigGrpInTxIPDUEndIdxOfTxSigGrpInfo Com_TxSigGrpInfo[9].TxBufferSigGrpInTxIPDUStartIdxOfTxSigGrpInfo Com_TxSigGrpInfo[9].TxBufferStartIdxOfTxSigGrpInfo Com_TxSigGrpInfo[9].TxGrpSigInfoInvValueIndEndIdxOfTxSigGrpInfo Com_TxSigGrpInfo[9].TxGrpSigInfoInvValueIndStartIdxOfTxSigGrpInfo Com_TxSigGrpInfo[9].TxPduInfoIdxOfTxSigGrpInfo Com_TxSigGrpInfo[9].TxSigGrpMaskEndIdxOfTxSigGrpInfo Com_TxSigGrpInfo[9].TxSigGrpMaskStartIdxOfTxSigGrpInfo Com_TxSigGrpMask Com_TxSigInfoFilterInitValueInd Com_TxSigInfo[0].ApplTypeOfTxSigInfo Com_TxSigInfo[0].BitLengthOfTxSigInfo Com_TxSigInfo[0].BitPositionOfTxSigInfo Com_TxSigInfo[0].BusAccOfTxSigInfo Com_TxSigInfo[0].ByteLengthOfTxSigInfo Com_TxSigInfo[0].DynSignalOfTxSigInfo Com_TxSigInfo[0].FilterInitValueIdxOfTxSigInfo Com_TxSigInfo[0].FilterInitValueOfTxSigInfo Com_TxSigInfo[0].InvValueIdxOfTxSigInfo Com_TxSigInfo[0].InvValueOfTxSigInfo Com_TxSigInfo[0].OnChangeIdxOfTxSigInfo Com_TxSigInfo[0].OnChangeOfTxSigInfo Com_TxSigInfo[0].StartByteInPduPositionOfTxSigInfo Com_TxSigInfo[0].TxAccessInfoIdxOfTxSigInfo Com_TxSigInfo[0].TxBufferEndIdxOfTxSigInfo Com_TxSigInfo[0].TxBufferStartIdxOfTxSigInfo Com_TxSigInfo[0].TxFilterInitValueArrayBasedFilterInitValueEndIdxOfTxSigInfo Com_TxSigInfo[0].TxFilterInitValueArrayBasedFilterInitValueStartIdxOfTxSigInfo Com_TxSigInfo[0].TxPduInfoIdxOfTxSigInfo Com_TxSigInfo[100].ApplTypeOfTxSigInfo Com_TxSigInfo[100].BitLengthOfTxSigInfo Com_TxSigInfo[100].BitPositionOfTxSigInfo Com_TxSigInfo[100].BusAccOfTxSigInfo Com_TxSigInfo[100].ByteLengthOfTxSigInfo Com_TxSigInfo[100].DynSignalOfTxSigInfo Com_TxSigInfo[100].FilterInitValueIdxOfTxSigInfo Com_TxSigInfo[100].FilterInitValueOfTxSigInfo Com_TxSigInfo[100].InvValueIdxOfTxSigInfo Com_TxSigInfo[100].InvValueOfTxSigInfo Com_TxSigInfo[100].OnChangeIdxOfTxSigInfo Com_TxSigInfo[100].OnChangeOfTxSigInfo Com_TxSigInfo[100].StartByteInPduPositionOfTxSigInfo Com_TxSigInfo[100].TxAccessInfoIdxOfTxSigInfo Com_TxSigInfo[100].TxBufferEndIdxOfTxSigInfo Com_TxSigInfo[100].TxBufferStartIdxOfTxSigInfo Com_TxSigInfo[100].TxFilterInitValueArrayBasedFilterInitValueEndIdxOfTxSigInfo Com_TxSigInfo[100].TxFilterInitValueArrayBasedFilterInitValueStartIdxOfTxSigInfo Com_TxSigInfo[100].TxPduInfoIdxOfTxSigInfo Com_TxSigInfo[101].ApplTypeOfTxSigInfo Com_TxSigInfo[101].BitLengthOfTxSigInfo Com_TxSigInfo[101].BitPositionOfTxSigInfo Com_TxSigInfo[101].BusAccOfTxSigInfo Com_TxSigInfo[101].ByteLengthOfTxSigInfo Com_TxSigInfo[101].DynSignalOfTxSigInfo Com_TxSigInfo[101].FilterInitValueIdxOfTxSigInfo Com_TxSigInfo[101].FilterInitValueOfTxSigInfo Com_TxSigInfo[101].InvValueIdxOfTxSigInfo Com_TxSigInfo[101].InvValueOfTxSigInfo Com_TxSigInfo[101].OnChangeIdxOfTxSigInfo Com_TxSigInfo[101].OnChangeOfTxSigInfo Com_TxSigInfo[101].StartByteInPduPositionOfTxSigInfo Com_TxSigInfo[101].TxAccessInfoIdxOfTxSigInfo Com_TxSigInfo[101].TxBufferEndIdxOfTxSigInfo Com_TxSigInfo[101].TxBufferStartIdxOfTxSigInfo Com_TxSigInfo[101].TxFilterInitValueArrayBasedFilterInitValueEndIdxOfTxSigInfo Com_TxSigInfo[101].TxFilterInitValueArrayBasedFilterInitValueStartIdxOfTxSigInfo Com_TxSigInfo[101].TxPduInfoIdxOfTxSigInfo Com_TxSigInfo[102].ApplTypeOfTxSigInfo Com_TxSigInfo[102].BitLengthOfTxSigInfo Com_TxSigInfo[102].BitPositionOfTxSigInfo Com_TxSigInfo[102].BusAccOfTxSigInfo Com_TxSigInfo[102].ByteLengthOfTxSigInfo Com_TxSigInfo[102].DynSignalOfTxSigInfo Com_TxSigInfo[102].FilterInitValueIdxOfTxSigInfo Com_TxSigInfo[102].FilterInitValueOfTxSigInfo Com_TxSigInfo[102].InvValueIdxOfTxSigInfo Com_TxSigInfo[102].InvValueOfTxSigInfo Com_TxSigInfo[102].OnChangeIdxOfTxSigInfo Com_TxSigInfo[102].OnChangeOfTxSigInfo Com_TxSigInfo[102].StartByteInPduPositionOfTxSigInfo Com_TxSigInfo[102].TxAccessInfoIdxOfTxSigInfo Com_TxSigInfo[102].TxBufferEndIdxOfTxSigInfo Com_TxSigInfo[102].TxBufferStartIdxOfTxSigInfo Com_TxSigInfo[102].TxFilterInitValueArrayBasedFilterInitValueEndIdxOfTxSigInfo Com_TxSigInfo[102].TxFilterInitValueArrayBasedFilterInitValueStartIdxOfTxSigInfo Com_TxSigInfo[102].TxPduInfoIdxOfTxSigInfo Com_TxSigInfo[103].ApplTypeOfTxSigInfo Com_TxSigInfo[103].BitLengthOfTxSigInfo Com_TxSigInfo[103].BitPositionOfTxSigInfo Com_TxSigInfo[103].BusAccOfTxSigInfo Com_TxSigInfo[103].ByteLengthOfTxSigInfo Com_TxSigInfo[103].DynSignalOfTxSigInfo Com_TxSigInfo[103].FilterInitValueIdxOfTxSigInfo Com_TxSigInfo[103].FilterInitValueOfTxSigInfo Com_TxSigInfo[103].InvValueIdxOfTxSigInfo Com_TxSigInfo[103].InvValueOfTxSigInfo Com_TxSigInfo[103].OnChangeIdxOfTxSigInfo Com_TxSigInfo[103].OnChangeOfTxSigInfo Com_TxSigInfo[103].StartByteInPduPositionOfTxSigInfo Com_TxSigInfo[103].TxAccessInfoIdxOfTxSigInfo Com_TxSigInfo[103].TxBufferEndIdxOfTxSigInfo Com_TxSigInfo[103].TxBufferStartIdxOfTxSigInfo Com_TxSigInfo[103].TxFilterInitValueArrayBasedFilterInitValueEndIdxOfTxSigInfo Com_TxSigInfo[103].TxFilterInitValueArrayBasedFilterInitValueStartIdxOfTxSigInfo Com_TxSigInfo[103].TxPduInfoIdxOfTxSigInfo Com_TxSigInfo[104].ApplTypeOfTxSigInfo Com_TxSigInfo[104].BitLengthOfTxSigInfo Com_TxSigInfo[104].BitPositionOfTxSigInfo Com_TxSigInfo[104].BusAccOfTxSigInfo Com_TxSigInfo[104].ByteLengthOfTxSigInfo Com_TxSigInfo[104].DynSignalOfTxSigInfo Com_TxSigInfo[104].FilterInitValueIdxOfTxSigInfo Com_TxSigInfo[104].FilterInitValueOfTxSigInfo Com_TxSigInfo[104].InvValueIdxOfTxSigInfo Com_TxSigInfo[104].InvValueOfTxSigInfo Com_TxSigInfo[104].OnChangeIdxOfTxSigInfo Com_TxSigInfo[104].OnChangeOfTxSigInfo Com_TxSigInfo[104].StartByteInPduPositionOfTxSigInfo Com_TxSigInfo[104].TxAccessInfoIdxOfTxSigInfo Com_TxSigInfo[104].TxBufferEndIdxOfTxSigInfo Com_TxSigInfo[104].TxBufferStartIdxOfTxSigInfo Com_TxSigInfo[104].TxFilterInitValueArrayBasedFilterInitValueEndIdxOfTxSigInfo Com_TxSigInfo[104].TxFilterInitValueArrayBasedFilterInitValueStartIdxOfTxSigInfo Com_TxSigInfo[104].TxPduInfoIdxOfTxSigInfo Com_TxSigInfo[105].ApplTypeOfTxSigInfo Com_TxSigInfo[105].BitLengthOfTxSigInfo Com_TxSigInfo[105].BitPositionOfTxSigInfo Com_TxSigInfo[105].BusAccOfTxSigInfo Com_TxSigInfo[105].ByteLengthOfTxSigInfo Com_TxSigInfo[105].DynSignalOfTxSigInfo Com_TxSigInfo[105].FilterInitValueIdxOfTxSigInfo Com_TxSigInfo[105].FilterInitValueOfTxSigInfo Com_TxSigInfo[105].InvValueIdxOfTxSigInfo Com_TxSigInfo[105].InvValueOfTxSigInfo Com_TxSigInfo[105].OnChangeIdxOfTxSigInfo Com_TxSigInfo[105].OnChangeOfTxSigInfo Com_TxSigInfo[105].StartByteInPduPositionOfTxSigInfo Com_TxSigInfo[105].TxAccessInfoIdxOfTxSigInfo Com_TxSigInfo[105].TxBufferEndIdxOfTxSigInfo Com_TxSigInfo[105].TxBufferStartIdxOfTxSigInfo Com_TxSigInfo[105].TxFilterInitValueArrayBasedFilterInitValueEndIdxOfTxSigInfo Com_TxSigInfo[105].TxFilterInitValueArrayBasedFilterInitValueStartIdxOfTxSigInfo Com_TxSigInfo[105].TxPduInfoIdxOfTxSigInfo Com_TxSigInfo[106].ApplTypeOfTxSigInfo Com_TxSigInfo[106].BitLengthOfTxSigInfo Com_TxSigInfo[106].BitPositionOfTxSigInfo Com_TxSigInfo[106].BusAccOfTxSigInfo Com_TxSigInfo[106].ByteLengthOfTxSigInfo Com_TxSigInfo[106].DynSignalOfTxSigInfo Com_TxSigInfo[106].FilterInitValueIdxOfTxSigInfo Com_TxSigInfo[106].FilterInitValueOfTxSigInfo Com_TxSigInfo[106].InvValueIdxOfTxSigInfo Com_TxSigInfo[106].InvValueOfTxSigInfo Com_TxSigInfo[106].OnChangeIdxOfTxSigInfo Com_TxSigInfo[106].OnChangeOfTxSigInfo Com_TxSigInfo[106].StartByteInPduPositionOfTxSigInfo Com_TxSigInfo[106].TxAccessInfoIdxOfTxSigInfo Com_TxSigInfo[106].TxBufferEndIdxOfTxSigInfo Com_TxSigInfo[106].TxBufferStartIdxOfTxSigInfo Com_TxSigInfo[106].TxFilterInitValueArrayBasedFilterInitValueEndIdxOfTxSigInfo Com_TxSigInfo[106].TxFilterInitValueArrayBasedFilterInitValueStartIdxOfTxSigInfo Com_TxSigInfo[106].TxPduInfoIdxOfTxSigInfo Com_TxSigInfo[107].ApplTypeOfTxSigInfo Com_TxSigInfo[107].BitLengthOfTxSigInfo Com_TxSigInfo[107].BitPositionOfTxSigInfo Com_TxSigInfo[107].BusAccOfTxSigInfo Com_TxSigInfo[107].ByteLengthOfTxSigInfo Com_TxSigInfo[107].DynSignalOfTxSigInfo Com_TxSigInfo[107].FilterInitValueIdxOfTxSigInfo Com_TxSigInfo[107].FilterInitValueOfTxSigInfo Com_TxSigInfo[107].InvValueIdxOfTxSigInfo Com_TxSigInfo[107].InvValueOfTxSigInfo Com_TxSigInfo[107].OnChangeIdxOfTxSigInfo Com_TxSigInfo[107].OnChangeOfTxSigInfo Com_TxSigInfo[107].StartByteInPduPositionOfTxSigInfo Com_TxSigInfo[107].TxAccessInfoIdxOfTxSigInfo Com_TxSigInfo[107].TxBufferEndIdxOfTxSigInfo Com_TxSigInfo[107].TxBufferStartIdxOfTxSigInfo Com_TxSigInfo[107].TxFilterInitValueArrayBasedFilterInitValueEndIdxOfTxSigInfo Com_TxSigInfo[107].TxFilterInitValueArrayBasedFilterInitValueStartIdxOfTxSigInfo Com_TxSigInfo[107].TxPduInfoIdxOfTxSigInfo Com_TxSigInfo[108].ApplTypeOfTxSigInfo Com_TxSigInfo[108].BitLengthOfTxSigInfo Com_TxSigInfo[108].BitPositionOfTxSigInfo Com_TxSigInfo[108].BusAccOfTxSigInfo Com_TxSigInfo[108].ByteLengthOfTxSigInfo Com_TxSigInfo[108].DynSignalOfTxSigInfo Com_TxSigInfo[108].FilterInitValueIdxOfTxSigInfo Com_TxSigInfo[108].FilterInitValueOfTxSigInfo Com_TxSigInfo[108].InvValueIdxOfTxSigInfo Com_TxSigInfo[108].InvValueOfTxSigInfo Com_TxSigInfo[108].OnChangeIdxOfTxSigInfo Com_TxSigInfo[108].OnChangeOfTxSigInfo Com_TxSigInfo[108].StartByteInPduPositionOfTxSigInfo Com_TxSigInfo[108].TxAccessInfoIdxOfTxSigInfo Com_TxSigInfo[108].TxBufferEndIdxOfTxSigInfo Com_TxSigInfo[108].TxBufferStartIdxOfTxSigInfo Com_TxSigInfo[108].TxFilterInitValueArrayBasedFilterInitValueEndIdxOfTxSigInfo Com_TxSigInfo[108].TxFilterInitValueArrayBasedFilterInitValueStartIdxOfTxSigInfo Com_TxSigInfo[108].TxPduInfoIdxOfTxSigInfo Com_TxSigInfo[109].ApplTypeOfTxSigInfo Com_TxSigInfo[109].BitLengthOfTxSigInfo Com_TxSigInfo[109].BitPositionOfTxSigInfo Com_TxSigInfo[109].BusAccOfTxSigInfo Com_TxSigInfo[109].ByteLengthOfTxSigInfo Com_TxSigInfo[109].DynSignalOfTxSigInfo Com_TxSigInfo[109].FilterInitValueIdxOfTxSigInfo Com_TxSigInfo[109].FilterInitValueOfTxSigInfo Com_TxSigInfo[109].InvValueIdxOfTxSigInfo Com_TxSigInfo[109].InvValueOfTxSigInfo Com_TxSigInfo[109].OnChangeIdxOfTxSigInfo Com_TxSigInfo[109].OnChangeOfTxSigInfo Com_TxSigInfo[109].StartByteInPduPositionOfTxSigInfo Com_TxSigInfo[109].TxAccessInfoIdxOfTxSigInfo Com_TxSigInfo[109].TxBufferEndIdxOfTxSigInfo Com_TxSigInfo[109].TxBufferStartIdxOfTxSigInfo Com_TxSigInfo[109].TxFilterInitValueArrayBasedFilterInitValueEndIdxOfTxSigInfo Com_TxSigInfo[109].TxFilterInitValueArrayBasedFilterInitValueStartIdxOfTxSigInfo Com_TxSigInfo[109].TxPduInfoIdxOfTxSigInfo Com_TxSigInfo[10].ApplTypeOfTxSigInfo Com_TxSigInfo[10].BitLengthOfTxSigInfo Com_TxSigInfo[10].BitPositionOfTxSigInfo Com_TxSigInfo[10].BusAccOfTxSigInfo Com_TxSigInfo[10].ByteLengthOfTxSigInfo Com_TxSigInfo[10].DynSignalOfTxSigInfo Com_TxSigInfo[10].FilterInitValueIdxOfTxSigInfo Com_TxSigInfo[10].FilterInitValueOfTxSigInfo Com_TxSigInfo[10].InvValueIdxOfTxSigInfo Com_TxSigInfo[10].InvValueOfTxSigInfo Com_TxSigInfo[10].OnChangeIdxOfTxSigInfo Com_TxSigInfo[10].OnChangeOfTxSigInfo Com_TxSigInfo[10].StartByteInPduPositionOfTxSigInfo Com_TxSigInfo[10].TxAccessInfoIdxOfTxSigInfo Com_TxSigInfo[10].TxBufferEndIdxOfTxSigInfo Com_TxSigInfo[10].TxBufferStartIdxOfTxSigInfo Com_TxSigInfo[10].TxFilterInitValueArrayBasedFilterInitValueEndIdxOfTxSigInfo Com_TxSigInfo[10].TxFilterInitValueArrayBasedFilterInitValueStartIdxOfTxSigInfo Com_TxSigInfo[10].TxPduInfoIdxOfTxSigInfo Com_TxSigInfo[110].ApplTypeOfTxSigInfo Com_TxSigInfo[110].BitLengthOfTxSigInfo Com_TxSigInfo[110].BitPositionOfTxSigInfo Com_TxSigInfo[110].BusAccOfTxSigInfo Com_TxSigInfo[110].ByteLengthOfTxSigInfo Com_TxSigInfo[110].DynSignalOfTxSigInfo Com_TxSigInfo[110].FilterInitValueIdxOfTxSigInfo Com_TxSigInfo[110].FilterInitValueOfTxSigInfo Com_TxSigInfo[110].InvValueIdxOfTxSigInfo Com_TxSigInfo[110].InvValueOfTxSigInfo Com_TxSigInfo[110].OnChangeIdxOfTxSigInfo Com_TxSigInfo[110].OnChangeOfTxSigInfo Com_TxSigInfo[110].StartByteInPduPositionOfTxSigInfo Com_TxSigInfo[110].TxAccessInfoIdxOfTxSigInfo Com_TxSigInfo[110].TxBufferEndIdxOfTxSigInfo Com_TxSigInfo[110].TxBufferStartIdxOfTxSigInfo Com_TxSigInfo[110].TxFilterInitValueArrayBasedFilterInitValueEndIdxOfTxSigInfo Com_TxSigInfo[110].TxFilterInitValueArrayBasedFilterInitValueStartIdxOfTxSigInfo Com_TxSigInfo[110].TxPduInfoIdxOfTxSigInfo Com_TxSigInfo[111].ApplTypeOfTxSigInfo Com_TxSigInfo[111].BitLengthOfTxSigInfo Com_TxSigInfo[111].BitPositionOfTxSigInfo Com_TxSigInfo[111].BusAccOfTxSigInfo Com_TxSigInfo[111].ByteLengthOfTxSigInfo Com_TxSigInfo[111].DynSignalOfTxSigInfo Com_TxSigInfo[111].FilterInitValueIdxOfTxSigInfo Com_TxSigInfo[111].FilterInitValueOfTxSigInfo Com_TxSigInfo[111].InvValueIdxOfTxSigInfo Com_TxSigInfo[111].InvValueOfTxSigInfo Com_TxSigInfo[111].OnChangeIdxOfTxSigInfo Com_TxSigInfo[111].OnChangeOfTxSigInfo Com_TxSigInfo[111].StartByteInPduPositionOfTxSigInfo Com_TxSigInfo[111].TxAccessInfoIdxOfTxSigInfo Com_TxSigInfo[111].TxBufferEndIdxOfTxSigInfo Com_TxSigInfo[111].TxBufferStartIdxOfTxSigInfo /end REF_MEASUREMENT
/end GROUP
/end MODULE
/end PROJECT
