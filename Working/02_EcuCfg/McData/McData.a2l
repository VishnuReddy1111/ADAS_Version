ASAP2_VERSION 1 71
/begin PROJECT MICROSAR ""
/begin MODULE CPP ""
/begin MOD_COMMON "" BYTE_ORDER MSB_LAST ALIGNMENT_BYTE 1 ALIGNMENT_WORD 2 ALIGNMENT_LONG 4 ALIGNMENT_FLOAT16_IEEE 2 ALIGNMENT_FLOAT32_IEEE 4 ALIGNMENT_FLOAT64_IEEE 8 ALIGNMENT_INT64 8 /end MOD_COMMON
/begin MEASUREMENT Com_RxAccessInfo[120].ConstValueArrayBasedInitValueEndIdxOfRxAccessInfo "" UBYTE Com_ConstValueArrayBasedInitValueEndIdxOfRxAccessInfoType 0 0 0 255 ECU_ADDRESS 0x0 /end MEASUREMENT
/begin MEASUREMENT Com_RxAccessInfo[120].ConstValueArrayBasedInitValueStartIdxOfRxAccessInfo "" UBYTE Com_ConstValueArrayBasedInitValueStartIdxOfRxAccessInfoType 0 0 0 255 ECU_ADDRESS 0x0 /end MEASUREMENT
/begin MEASUREMENT Com_RxAccessInfo[120].DynSignalOfRxAccessInfo "" UBYTE Com_DynSignalOfRxAccessInfoType 0 0 0 1 ECU_ADDRESS 0x0 /end MEASUREMENT
/begin MEASUREMENT Com_RxAccessInfo[120].InitValueIdxOfRxAccessInfo "" UBYTE Com_InitValueIdxOfRxAccessInfoType 0 0 0 255 ECU_ADDRESS 0x0 /end MEASUREMENT
/begin MEASUREMENT Com_RxAccessInfo[120].InitValueOfRxAccessInfo "" UBYTE Com_InitValueOfRxAccessInfoType 0 0 0 255 ECU_ADDRESS 0x0 /end MEASUREMENT
/begin MEASUREMENT Com_RxAccessInfo[120].InvValueIdxOfRxAccessInfo "" UBYTE Com_InvValueIdxOfRxAccessInfoType 0 0 0 255 ECU_ADDRESS 0x0 /end MEASUREMENT
/begin MEASUREMENT Com_RxAccessInfo[120].InvValueOfRxAccessInfo "" UBYTE Com_InvValueOfRxAccessInfoType 0 0 0 255 ECU_ADDRESS 0x0 /end MEASUREMENT
/begin MEASUREMENT Com_RxAccessInfo[120].IsGroupSignalOfRxAccessInfo "" UBYTE Com_IsGroupSignalOfRxAccessInfoType 0 0 0 1 ECU_ADDRESS 0x0 /end MEASUREMENT
/begin MEASUREMENT Com_RxAccessInfo[120].RxDataTimeoutSubstitutionValueIdxOfRxAccessInfo "" UBYTE Com_RxDataTimeoutSubstitutionValueIdxOfRxAccessInfoType 0 0 0 255 ECU_ADDRESS 0x0 /end MEASUREMENT
/begin MEASUREMENT Com_RxAccessInfo[120].RxDataTimeoutSubstitutionValueOfRxAccessInfo "" UBYTE Com_RxDataTimeoutSubstitutionValueOfRxAccessInfoType 0 0 0 255 ECU_ADDRESS 0x0 /end MEASUREMENT
/begin MEASUREMENT Com_RxAccessInfo[120].RxPduInfoIdxOfRxAccessInfo "" UBYTE NO_COMPU_METHOD 0 0 0 255 ECU_ADDRESS 0x0 /end MEASUREMENT
/begin MEASUREMENT Com_RxAccessInfo[120].RxSigBufferArrayBasedBufferEndIdxOfRxAccessInfo "" UBYTE Com_RxSigBufferArrayBasedBufferEndIdxOfRxAccessInfoType 0 0 0 255 ECU_ADDRESS 0x0 /end MEASUREMENT
/begin MEASUREMENT Com_RxAccessInfo[120].RxSigBufferArrayBasedBufferStartIdxOfRxAccessInfo "" UBYTE Com_RxSigBufferArrayBasedBufferStartIdxOfRxAccessInfoType 0 0 0 255 ECU_ADDRESS 0x0 /end MEASUREMENT
/begin MEASUREMENT Com_RxAccessInfo[120].RxSigBufferArrayBasedShdBufferEndIdxOfRxAccessInfo "" UBYTE Com_RxSigBufferArrayBasedShdBufferEndIdxOfRxAccessInfoType 0 0 0 255 ECU_ADDRESS 0x0 /end MEASUREMENT
/begin MEASUREMENT Com_RxAccessInfo[120].RxSigBufferArrayBasedShdBufferStartIdxOfRxAccessInfo "" UBYTE Com_RxSigBufferArrayBasedShdBufferStartIdxOfRxAccessInfoType 0 0 0 255 ECU_ADDRESS 0x0 /end MEASUREMENT
/begin MEASUREMENT Com_RxAccessInfo[120].RxTOutInfoIdxOfRxAccessInfo "" UBYTE Com_RxTOutInfoIdxOfRxAccessInfoType 0 0 0 255 ECU_ADDRESS 0x0 /end MEASUREMENT
/begin MEASUREMENT Com_RxAccessInfo[120].ShdBufferIdxOfRxAccessInfo "" UWORD Com_ShdBufferIdxOfRxAccessInfoType 0 0 0 65535 ECU_ADDRESS 0x0 /end MEASUREMENT
/begin MEASUREMENT Com_RxAccessInfo[120].SignalLengthInByteOfRxAccessInfo "" UBYTE NO_COMPU_METHOD 0 0 0 255 ECU_ADDRESS 0x0 /end MEASUREMENT
/begin MEASUREMENT Com_RxAccessInfo[120].StartByteInPduPositionOfRxAccessInfo "" UBYTE NO_COMPU_METHOD 0 0 0 255 ECU_ADDRESS 0x0 /end MEASUREMENT
/begin MEASUREMENT Com_RxAccessInfo[120].TmpBufferIdxOfRxAccessInfo "" UBYTE Com_TmpBufferIdxOfRxAccessInfoType 0 0 0 255 ECU_ADDRESS 0x0 /end MEASUREMENT
/begin MEASUREMENT Com_RxAccessInfo[120].TmpBufferOfRxAccessInfo "" UBYTE Com_TmpBufferOfRxAccessInfoType 0 0 0 255 ECU_ADDRESS 0x0 /end MEASUREMENT
/begin MEASUREMENT Com_RxAccessInfo[120].TmpRxShdBufferArrayBasedTmpBufferEndIdxOfRxAccessInfo "" UBYTE Com_TmpRxShdBufferArrayBasedTmpBufferEndIdxOfRxAccessInfoType 0 0 0 255 ECU_ADDRESS 0x0 /end MEASUREMENT
/begin MEASUREMENT Com_RxAccessInfo[120].TmpRxShdBufferArrayBasedTmpBufferStartIdxOfRxAccessInfo "" UBYTE Com_TmpRxShdBufferArrayBasedTmpBufferStartIdxOfRxAccessInfoType 0 0 0 255 ECU_ADDRESS 0x0 /end MEASUREMENT
/begin MEASUREMENT Com_RxAccessInfo[121].ApplTypeOfRxAccessInfo "" UBYTE Com_ApplTypeOfRxAccessInfoType 0 0 0 255 ECU_ADDRESS 0x0 /end MEASUREMENT
/begin MEASUREMENT Com_RxAccessInfo[121].BitLengthOfRxAccessInfo "" UWORD NO_COMPU_METHOD 0 0 0 65535 ECU_ADDRESS 0x0 /end MEASUREMENT
/begin MEASUREMENT Com_RxAccessInfo[121].BitPositionOfRxAccessInfo "" UWORD NO_COMPU_METHOD 0 0 0 65535 ECU_ADDRESS 0x0 /end MEASUREMENT
/begin MEASUREMENT Com_RxAccessInfo[121].BufferIdxOfRxAccessInfo "" UWORD Com_BufferIdxOfRxAccessInfoType 0 0 0 65535 ECU_ADDRESS 0x0 /end MEASUREMENT
/begin MEASUREMENT Com_RxAccessInfo[121].BusAccOfRxAccessInfo "" UBYTE Com_BusAccOfRxAccessInfoType 0 0 0 255 ECU_ADDRESS 0x0 /end MEASUREMENT
/begin MEASUREMENT Com_RxAccessInfo[121].ByteLengthOfRxAccessInfo "" UBYTE NO_COMPU_METHOD 0 0 0 255 ECU_ADDRESS 0x0 /end MEASUREMENT
/begin MEASUREMENT Com_RxAccessInfo[121].ConstValueArrayBasedInitValueEndIdxOfRxAccessInfo "" UBYTE Com_ConstValueArrayBasedInitValueEndIdxOfRxAccessInfoType 0 0 0 255 ECU_ADDRESS 0x0 /end MEASUREMENT
/begin MEASUREMENT Com_RxAccessInfo[121].ConstValueArrayBasedInitValueStartIdxOfRxAccessInfo "" UBYTE Com_ConstValueArrayBasedInitValueStartIdxOfRxAccessInfoType 0 0 0 255 ECU_ADDRESS 0x0 /end MEASUREMENT
/begin MEASUREMENT Com_RxAccessInfo[121].DynSignalOfRxAccessInfo "" UBYTE Com_DynSignalOfRxAccessInfoType 0 0 0 1 ECU_ADDRESS 0x0 /end MEASUREMENT
/begin MEASUREMENT Com_RxAccessInfo[121].InitValueIdxOfRxAccessInfo "" UBYTE Com_InitValueIdxOfRxAccessInfoType 0 0 0 255 ECU_ADDRESS 0x0 /end MEASUREMENT
/begin MEASUREMENT Com_RxAccessInfo[121].InitValueOfRxAccessInfo "" UBYTE Com_InitValueOfRxAccessInfoType 0 0 0 255 ECU_ADDRESS 0x0 /end MEASUREMENT
/begin MEASUREMENT Com_RxAccessInfo[121].InvValueIdxOfRxAccessInfo "" UBYTE Com_InvValueIdxOfRxAccessInfoType 0 0 0 255 ECU_ADDRESS 0x0 /end MEASUREMENT
/begin MEASUREMENT Com_RxAccessInfo[121].InvValueOfRxAccessInfo "" UBYTE Com_InvValueOfRxAccessInfoType 0 0 0 255 ECU_ADDRESS 0x0 /end MEASUREMENT
/begin MEASUREMENT Com_RxAccessInfo[121].IsGroupSignalOfRxAccessInfo "" UBYTE Com_IsGroupSignalOfRxAccessInfoType 0 0 0 1 ECU_ADDRESS 0x0 /end MEASUREMENT
/begin MEASUREMENT Com_RxAccessInfo[121].RxDataTimeoutSubstitutionValueIdxOfRxAccessInfo "" UBYTE Com_RxDataTimeoutSubstitutionValueIdxOfRxAccessInfoType 0 0 0 255 ECU_ADDRESS 0x0 /end MEASUREMENT
/begin MEASUREMENT Com_RxAccessInfo[121].RxDataTimeoutSubstitutionValueOfRxAccessInfo "" UBYTE Com_RxDataTimeoutSubstitutionValueOfRxAccessInfoType 0 0 0 255 ECU_ADDRESS 0x0 /end MEASUREMENT
/begin MEASUREMENT Com_RxAccessInfo[121].RxPduInfoIdxOfRxAccessInfo "" UBYTE NO_COMPU_METHOD 0 0 0 255 ECU_ADDRESS 0x0 /end MEASUREMENT
/begin MEASUREMENT Com_RxAccessInfo[121].RxSigBufferArrayBasedBufferEndIdxOfRxAccessInfo "" UBYTE Com_RxSigBufferArrayBasedBufferEndIdxOfRxAccessInfoType 0 0 0 255 ECU_ADDRESS 0x0 /end MEASUREMENT
/begin MEASUREMENT Com_RxAccessInfo[121].RxSigBufferArrayBasedBufferStartIdxOfRxAccessInfo "" UBYTE Com_RxSigBufferArrayBasedBufferStartIdxOfRxAccessInfoType 0 0 0 255 ECU_ADDRESS 0x0 /end MEASUREMENT
/begin MEASUREMENT Com_RxAccessInfo[121].RxSigBufferArrayBasedShdBufferEndIdxOfRxAccessInfo "" UBYTE Com_RxSigBufferArrayBasedShdBufferEndIdxOfRxAccessInfoType 0 0 0 255 ECU_ADDRESS 0x0 /end MEASUREMENT
/begin MEASUREMENT Com_RxAccessInfo[121].RxSigBufferArrayBasedShdBufferStartIdxOfRxAccessInfo "" UBYTE Com_RxSigBufferArrayBasedShdBufferStartIdxOfRxAccessInfoType 0 0 0 255 ECU_ADDRESS 0x0 /end MEASUREMENT
/begin MEASUREMENT Com_RxAccessInfo[121].RxTOutInfoIdxOfRxAccessInfo "" UBYTE Com_RxTOutInfoIdxOfRxAccessInfoType 0 0 0 255 ECU_ADDRESS 0x0 /end MEASUREMENT
/begin MEASUREMENT Com_RxAccessInfo[121].ShdBufferIdxOfRxAccessInfo "" UWORD Com_ShdBufferIdxOfRxAccessInfoType 0 0 0 65535 ECU_ADDRESS 0x0 /end MEASUREMENT
/begin MEASUREMENT Com_RxAccessInfo[121].SignalLengthInByteOfRxAccessInfo "" UBYTE NO_COMPU_METHOD 0 0 0 255 ECU_ADDRESS 0x0 /end MEASUREMENT
/begin MEASUREMENT Com_RxAccessInfo[121].StartByteInPduPositionOfRxAccessInfo "" UBYTE NO_COMPU_METHOD 0 0 0 255 ECU_ADDRESS 0x0 /end MEASUREMENT
/begin MEASUREMENT Com_RxAccessInfo[121].TmpBufferIdxOfRxAccessInfo "" UBYTE Com_TmpBufferIdxOfRxAccessInfoType 0 0 0 255 ECU_ADDRESS 0x0 /end MEASUREMENT
/begin MEASUREMENT Com_RxAccessInfo[121].TmpBufferOfRxAccessInfo "" UBYTE Com_TmpBufferOfRxAccessInfoType 0 0 0 255 ECU_ADDRESS 0x0 /end MEASUREMENT
/begin MEASUREMENT Com_RxAccessInfo[121].TmpRxShdBufferArrayBasedTmpBufferEndIdxOfRxAccessInfo "" UBYTE Com_TmpRxShdBufferArrayBasedTmpBufferEndIdxOfRxAccessInfoType 0 0 0 255 ECU_ADDRESS 0x0 /end MEASUREMENT
/begin MEASUREMENT Com_RxAccessInfo[121].TmpRxShdBufferArrayBasedTmpBufferStartIdxOfRxAccessInfo "" UBYTE Com_TmpRxShdBufferArrayBasedTmpBufferStartIdxOfRxAccessInfoType 0 0 0 255 ECU_ADDRESS 0x0 /end MEASUREMENT
/begin MEASUREMENT Com_RxAccessInfo[122].ApplTypeOfRxAccessInfo "" UBYTE Com_ApplTypeOfRxAccessInfoType 0 0 0 255 ECU_ADDRESS 0x0 /end MEASUREMENT
/begin MEASUREMENT Com_RxAccessInfo[122].BitLengthOfRxAccessInfo "" UWORD NO_COMPU_METHOD 0 0 0 65535 ECU_ADDRESS 0x0 /end MEASUREMENT
/begin MEASUREMENT Com_RxAccessInfo[122].BitPositionOfRxAccessInfo "" UWORD NO_COMPU_METHOD 0 0 0 65535 ECU_ADDRESS 0x0 /end MEASUREMENT
/begin MEASUREMENT Com_RxAccessInfo[122].BufferIdxOfRxAccessInfo "" UWORD Com_BufferIdxOfRxAccessInfoType 0 0 0 65535 ECU_ADDRESS 0x0 /end MEASUREMENT
/begin MEASUREMENT Com_RxAccessInfo[122].BusAccOfRxAccessInfo "" UBYTE Com_BusAccOfRxAccessInfoType 0 0 0 255 ECU_ADDRESS 0x0 /end MEASUREMENT
/begin MEASUREMENT Com_RxAccessInfo[122].ByteLengthOfRxAccessInfo "" UBYTE NO_COMPU_METHOD 0 0 0 255 ECU_ADDRESS 0x0 /end MEASUREMENT
/begin MEASUREMENT Com_RxAccessInfo[122].ConstValueArrayBasedInitValueEndIdxOfRxAccessInfo "" UBYTE Com_ConstValueArrayBasedInitValueEndIdxOfRxAccessInfoType 0 0 0 255 ECU_ADDRESS 0x0 /end MEASUREMENT
/begin MEASUREMENT Com_RxAccessInfo[122].ConstValueArrayBasedInitValueStartIdxOfRxAccessInfo "" UBYTE Com_ConstValueArrayBasedInitValueStartIdxOfRxAccessInfoType 0 0 0 255 ECU_ADDRESS 0x0 /end MEASUREMENT
/begin MEASUREMENT Com_RxAccessInfo[122].DynSignalOfRxAccessInfo "" UBYTE Com_DynSignalOfRxAccessInfoType 0 0 0 1 ECU_ADDRESS 0x0 /end MEASUREMENT
/begin MEASUREMENT Com_RxAccessInfo[122].InitValueIdxOfRxAccessInfo "" UBYTE Com_InitValueIdxOfRxAccessInfoType 0 0 0 255 ECU_ADDRESS 0x0 /end MEASUREMENT
/begin MEASUREMENT Com_RxAccessInfo[122].InitValueOfRxAccessInfo "" UBYTE Com_InitValueOfRxAccessInfoType 0 0 0 255 ECU_ADDRESS 0x0 /end MEASUREMENT
/begin MEASUREMENT Com_RxAccessInfo[122].InvValueIdxOfRxAccessInfo "" UBYTE Com_InvValueIdxOfRxAccessInfoType 0 0 0 255 ECU_ADDRESS 0x0 /end MEASUREMENT
/begin MEASUREMENT Com_RxAccessInfo[122].InvValueOfRxAccessInfo "" UBYTE Com_InvValueOfRxAccessInfoType 0 0 0 255 ECU_ADDRESS 0x0 /end MEASUREMENT
/begin MEASUREMENT Com_RxAccessInfo[122].IsGroupSignalOfRxAccessInfo "" UBYTE Com_IsGroupSignalOfRxAccessInfoType 0 0 0 1 ECU_ADDRESS 0x0 /end MEASUREMENT
/begin MEASUREMENT Com_RxAccessInfo[122].RxDataTimeoutSubstitutionValueIdxOfRxAccessInfo "" UBYTE Com_RxDataTimeoutSubstitutionValueIdxOfRxAccessInfoType 0 0 0 255 ECU_ADDRESS 0x0 /end MEASUREMENT
/begin MEASUREMENT Com_RxAccessInfo[122].RxDataTimeoutSubstitutionValueOfRxAccessInfo "" UBYTE Com_RxDataTimeoutSubstitutionValueOfRxAccessInfoType 0 0 0 255 ECU_ADDRESS 0x0 /end MEASUREMENT
/begin MEASUREMENT Com_RxAccessInfo[122].RxPduInfoIdxOfRxAccessInfo "" UBYTE NO_COMPU_METHOD 0 0 0 255 ECU_ADDRESS 0x0 /end MEASUREMENT
/begin MEASUREMENT Com_RxAccessInfo[122].RxSigBufferArrayBasedBufferEndIdxOfRxAccessInfo "" UBYTE Com_RxSigBufferArrayBasedBufferEndIdxOfRxAccessInfoType 0 0 0 255 ECU_ADDRESS 0x0 /end MEASUREMENT
/begin MEASUREMENT Com_RxAccessInfo[122].RxSigBufferArrayBasedBufferStartIdxOfRxAccessInfo "" UBYTE Com_RxSigBufferArrayBasedBufferStartIdxOfRxAccessInfoType 0 0 0 255 ECU_ADDRESS 0x0 /end MEASUREMENT
/begin MEASUREMENT Com_RxAccessInfo[122].RxSigBufferArrayBasedShdBufferEndIdxOfRxAccessInfo "" UBYTE Com_RxSigBufferArrayBasedShdBufferEndIdxOfRxAccessInfoType 0 0 0 255 ECU_ADDRESS 0x0 /end MEASUREMENT
/begin MEASUREMENT Com_RxAccessInfo[122].RxSigBufferArrayBasedShdBufferStartIdxOfRxAccessInfo "" UBYTE Com_RxSigBufferArrayBasedShdBufferStartIdxOfRxAccessInfoType 0 0 0 255 ECU_ADDRESS 0x0 /end MEASUREMENT
/begin MEASUREMENT Com_RxAccessInfo[122].RxTOutInfoIdxOfRxAccessInfo "" UBYTE Com_RxTOutInfoIdxOfRxAccessInfoType 0 0 0 255 ECU_ADDRESS 0x0 /end MEASUREMENT
/begin MEASUREMENT Com_RxAccessInfo[122].ShdBufferIdxOfRxAccessInfo "" UWORD Com_ShdBufferIdxOfRxAccessInfoType 0 0 0 65535 ECU_ADDRESS 0x0 /end MEASUREMENT
/begin MEASUREMENT Com_RxAccessInfo[122].SignalLengthInByteOfRxAccessInfo "" UBYTE NO_COMPU_METHOD 0 0 0 255 ECU_ADDRESS 0x0 /end MEASUREMENT
/begin MEASUREMENT Com_RxAccessInfo[122].StartByteInPduPositionOfRxAccessInfo "" UBYTE NO_COMPU_METHOD 0 0 0 255 ECU_ADDRESS 0x0 /end MEASUREMENT
/begin MEASUREMENT Com_RxAccessInfo[122].TmpBufferIdxOfRxAccessInfo "" UBYTE Com_TmpBufferIdxOfRxAccessInfoType 0 0 0 255 ECU_ADDRESS 0x0 /end MEASUREMENT
/begin MEASUREMENT Com_RxAccessInfo[122].TmpBufferOfRxAccessInfo "" UBYTE Com_TmpBufferOfRxAccessInfoType 0 0 0 255 ECU_ADDRESS 0x0 /end MEASUREMENT
/begin MEASUREMENT Com_RxAccessInfo[122].TmpRxShdBufferArrayBasedTmpBufferEndIdxOfRxAccessInfo "" UBYTE Com_TmpRxShdBufferArrayBasedTmpBufferEndIdxOfRxAccessInfoType 0 0 0 255 ECU_ADDRESS 0x0 /end MEASUREMENT
/begin MEASUREMENT Com_RxAccessInfo[122].TmpRxShdBufferArrayBasedTmpBufferStartIdxOfRxAccessInfo "" UBYTE Com_TmpRxShdBufferArrayBasedTmpBufferStartIdxOfRxAccessInfoType 0 0 0 255 ECU_ADDRESS 0x0 /end MEASUREMENT
/begin MEASUREMENT Com_RxAccessInfo[123].ApplTypeOfRxAccessInfo "" UBYTE Com_ApplTypeOfRxAccessInfoType 0 0 0 255 ECU_ADDRESS 0x0 /end MEASUREMENT
/begin MEASUREMENT Com_RxAccessInfo[123].BitLengthOfRxAccessInfo "" UWORD NO_COMPU_METHOD 0 0 0 65535 ECU_ADDRESS 0x0 /end MEASUREMENT
/begin MEASUREMENT Com_RxAccessInfo[123].BitPositionOfRxAccessInfo "" UWORD NO_COMPU_METHOD 0 0 0 65535 ECU_ADDRESS 0x0 /end MEASUREMENT
/begin MEASUREMENT Com_RxAccessInfo[123].BufferIdxOfRxAccessInfo "" UWORD Com_BufferIdxOfRxAccessInfoType 0 0 0 65535 ECU_ADDRESS 0x0 /end MEASUREMENT
/begin MEASUREMENT Com_RxAccessInfo[123].BusAccOfRxAccessInfo "" UBYTE Com_BusAccOfRxAccessInfoType 0 0 0 255 ECU_ADDRESS 0x0 /end MEASUREMENT
/begin MEASUREMENT Com_RxAccessInfo[123].ByteLengthOfRxAccessInfo "" UBYTE NO_COMPU_METHOD 0 0 0 255 ECU_ADDRESS 0x0 /end MEASUREMENT
/begin MEASUREMENT Com_RxAccessInfo[123].ConstValueArrayBasedInitValueEndIdxOfRxAccessInfo "" UBYTE Com_ConstValueArrayBasedInitValueEndIdxOfRxAccessInfoType 0 0 0 255 ECU_ADDRESS 0x0 /end MEASUREMENT
/begin MEASUREMENT Com_RxAccessInfo[123].ConstValueArrayBasedInitValueStartIdxOfRxAccessInfo "" UBYTE Com_ConstValueArrayBasedInitValueStartIdxOfRxAccessInfoType 0 0 0 255 ECU_ADDRESS 0x0 /end MEASUREMENT
/begin MEASUREMENT Com_RxAccessInfo[123].DynSignalOfRxAccessInfo "" UBYTE Com_DynSignalOfRxAccessInfoType 0 0 0 1 ECU_ADDRESS 0x0 /end MEASUREMENT
/begin MEASUREMENT Com_RxAccessInfo[123].InitValueIdxOfRxAccessInfo "" UBYTE Com_InitValueIdxOfRxAccessInfoType 0 0 0 255 ECU_ADDRESS 0x0 /end MEASUREMENT
/begin MEASUREMENT Com_RxAccessInfo[123].InitValueOfRxAccessInfo "" UBYTE Com_InitValueOfRxAccessInfoType 0 0 0 255 ECU_ADDRESS 0x0 /end MEASUREMENT
/begin MEASUREMENT Com_RxAccessInfo[123].InvValueIdxOfRxAccessInfo "" UBYTE Com_InvValueIdxOfRxAccessInfoType 0 0 0 255 ECU_ADDRESS 0x0 /end MEASUREMENT
/begin MEASUREMENT Com_RxAccessInfo[123].InvValueOfRxAccessInfo "" UBYTE Com_InvValueOfRxAccessInfoType 0 0 0 255 ECU_ADDRESS 0x0 /end MEASUREMENT
/begin MEASUREMENT Com_RxAccessInfo[123].IsGroupSignalOfRxAccessInfo "" UBYTE Com_IsGroupSignalOfRxAccessInfoType 0 0 0 1 ECU_ADDRESS 0x0 /end MEASUREMENT
/begin MEASUREMENT Com_RxAccessInfo[123].RxDataTimeoutSubstitutionValueIdxOfRxAccessInfo "" UBYTE Com_RxDataTimeoutSubstitutionValueIdxOfRxAccessInfoType 0 0 0 255 ECU_ADDRESS 0x0 /end MEASUREMENT
/begin MEASUREMENT Com_RxAccessInfo[123].RxDataTimeoutSubstitutionValueOfRxAccessInfo "" UBYTE Com_RxDataTimeoutSubstitutionValueOfRxAccessInfoType 0 0 0 255 ECU_ADDRESS 0x0 /end MEASUREMENT
/begin MEASUREMENT Com_RxAccessInfo[123].RxPduInfoIdxOfRxAccessInfo "" UBYTE NO_COMPU_METHOD 0 0 0 255 ECU_ADDRESS 0x0 /end MEASUREMENT
/begin MEASUREMENT Com_RxAccessInfo[123].RxSigBufferArrayBasedBufferEndIdxOfRxAccessInfo "" UBYTE Com_RxSigBufferArrayBasedBufferEndIdxOfRxAccessInfoType 0 0 0 255 ECU_ADDRESS 0x0 /end MEASUREMENT
/begin MEASUREMENT Com_RxAccessInfo[123].RxSigBufferArrayBasedBufferStartIdxOfRxAccessInfo "" UBYTE Com_RxSigBufferArrayBasedBufferStartIdxOfRxAccessInfoType 0 0 0 255 ECU_ADDRESS 0x0 /end MEASUREMENT
/begin MEASUREMENT Com_RxAccessInfo[123].RxSigBufferArrayBasedShdBufferEndIdxOfRxAccessInfo "" UBYTE Com_RxSigBufferArrayBasedShdBufferEndIdxOfRxAccessInfoType 0 0 0 255 ECU_ADDRESS 0x0 /end MEASUREMENT
/begin MEASUREMENT Com_RxAccessInfo[123].RxSigBufferArrayBasedShdBufferStartIdxOfRxAccessInfo "" UBYTE Com_RxSigBufferArrayBasedShdBufferStartIdxOfRxAccessInfoType 0 0 0 255 ECU_ADDRESS 0x0 /end MEASUREMENT
/begin MEASUREMENT Com_RxAccessInfo[123].RxTOutInfoIdxOfRxAccessInfo "" UBYTE Com_RxTOutInfoIdxOfRxAccessInfoType 0 0 0 255 ECU_ADDRESS 0x0 /end MEASUREMENT
/begin MEASUREMENT Com_RxAccessInfo[123].ShdBufferIdxOfRxAccessInfo "" UWORD Com_ShdBufferIdxOfRxAccessInfoType 0 0 0 65535 ECU_ADDRESS 0x0 /end MEASUREMENT
/begin MEASUREMENT Com_RxAccessInfo[123].SignalLengthInByteOfRxAccessInfo "" UBYTE NO_COMPU_METHOD 0 0 0 255 ECU_ADDRESS 0x0 /end MEASUREMENT
/begin MEASUREMENT Com_RxAccessInfo[123].StartByteInPduPositionOfRxAccessInfo "" UBYTE NO_COMPU_METHOD 0 0 0 255 ECU_ADDRESS 0x0 /end MEASUREMENT
/begin MEASUREMENT Com_RxAccessInfo[123].TmpBufferIdxOfRxAccessInfo "" UBYTE Com_TmpBufferIdxOfRxAccessInfoType 0 0 0 255 ECU_ADDRESS 0x0 /end MEASUREMENT
/begin MEASUREMENT Com_RxAccessInfo[123].TmpBufferOfRxAccessInfo "" UBYTE Com_TmpBufferOfRxAccessInfoType 0 0 0 255 ECU_ADDRESS 0x0 /end MEASUREMENT
/begin MEASUREMENT Com_RxAccessInfo[123].TmpRxShdBufferArrayBasedTmpBufferEndIdxOfRxAccessInfo "" UBYTE Com_TmpRxShdBufferArrayBasedTmpBufferEndIdxOfRxAccessInfoType 0 0 0 255 ECU_ADDRESS 0x0 /end MEASUREMENT
/begin MEASUREMENT Com_RxAccessInfo[123].TmpRxShdBufferArrayBasedTmpBufferStartIdxOfRxAccessInfo "" UBYTE Com_TmpRxShdBufferArrayBasedTmpBufferStartIdxOfRxAccessInfoType 0 0 0 255 ECU_ADDRESS 0x0 /end MEASUREMENT
/begin MEASUREMENT Com_RxAccessInfo[124].ApplTypeOfRxAccessInfo "" UBYTE Com_ApplTypeOfRxAccessInfoType 0 0 0 255 ECU_ADDRESS 0x0 /end MEASUREMENT
/begin MEASUREMENT Com_RxAccessInfo[124].BitLengthOfRxAccessInfo "" UWORD NO_COMPU_METHOD 0 0 0 65535 ECU_ADDRESS 0x0 /end MEASUREMENT
/begin MEASUREMENT Com_RxAccessInfo[124].BitPositionOfRxAccessInfo "" UWORD NO_COMPU_METHOD 0 0 0 65535 ECU_ADDRESS 0x0 /end MEASUREMENT
/begin MEASUREMENT Com_RxAccessInfo[124].BufferIdxOfRxAccessInfo "" UWORD Com_BufferIdxOfRxAccessInfoType 0 0 0 65535 ECU_ADDRESS 0x0 /end MEASUREMENT
/begin MEASUREMENT Com_RxAccessInfo[124].BusAccOfRxAccessInfo "" UBYTE Com_BusAccOfRxAccessInfoType 0 0 0 255 ECU_ADDRESS 0x0 /end MEASUREMENT
/begin MEASUREMENT Com_RxAccessInfo[124].ByteLengthOfRxAccessInfo "" UBYTE NO_COMPU_METHOD 0 0 0 255 ECU_ADDRESS 0x0 /end MEASUREMENT
/begin MEASUREMENT Com_RxAccessInfo[124].ConstValueArrayBasedInitValueEndIdxOfRxAccessInfo "" UBYTE Com_ConstValueArrayBasedInitValueEndIdxOfRxAccessInfoType 0 0 0 255 ECU_ADDRESS 0x0 /end MEASUREMENT
/begin MEASUREMENT Com_RxAccessInfo[124].ConstValueArrayBasedInitValueStartIdxOfRxAccessInfo "" UBYTE Com_ConstValueArrayBasedInitValueStartIdxOfRxAccessInfoType 0 0 0 255 ECU_ADDRESS 0x0 /end MEASUREMENT
/begin MEASUREMENT Com_RxAccessInfo[124].DynSignalOfRxAccessInfo "" UBYTE Com_DynSignalOfRxAccessInfoType 0 0 0 1 ECU_ADDRESS 0x0 /end MEASUREMENT
/begin MEASUREMENT Com_RxAccessInfo[124].InitValueIdxOfRxAccessInfo "" UBYTE Com_InitValueIdxOfRxAccessInfoType 0 0 0 255 ECU_ADDRESS 0x0 /end MEASUREMENT
/begin MEASUREMENT Com_RxAccessInfo[124].InitValueOfRxAccessInfo "" UBYTE Com_InitValueOfRxAccessInfoType 0 0 0 255 ECU_ADDRESS 0x0 /end MEASUREMENT
/begin MEASUREMENT Com_RxAccessInfo[124].InvValueIdxOfRxAccessInfo "" UBYTE Com_InvValueIdxOfRxAccessInfoType 0 0 0 255 ECU_ADDRESS 0x0 /end MEASUREMENT
/begin MEASUREMENT Com_RxAccessInfo[124].InvValueOfRxAccessInfo "" UBYTE Com_InvValueOfRxAccessInfoType 0 0 0 255 ECU_ADDRESS 0x0 /end MEASUREMENT
/begin MEASUREMENT Com_RxAccessInfo[124].IsGroupSignalOfRxAccessInfo "" UBYTE Com_IsGroupSignalOfRxAccessInfoType 0 0 0 1 ECU_ADDRESS 0x0 /end MEASUREMENT
/begin MEASUREMENT Com_RxAccessInfo[124].RxDataTimeoutSubstitutionValueIdxOfRxAccessInfo "" UBYTE Com_RxDataTimeoutSubstitutionValueIdxOfRxAccessInfoType 0 0 0 255 ECU_ADDRESS 0x0 /end MEASUREMENT
/begin MEASUREMENT Com_RxAccessInfo[124].RxDataTimeoutSubstitutionValueOfRxAccessInfo "" UBYTE Com_RxDataTimeoutSubstitutionValueOfRxAccessInfoType 0 0 0 255 ECU_ADDRESS 0x0 /end MEASUREMENT
/begin MEASUREMENT Com_RxAccessInfo[124].RxPduInfoIdxOfRxAccessInfo "" UBYTE NO_COMPU_METHOD 0 0 0 255 ECU_ADDRESS 0x0 /end MEASUREMENT
/begin MEASUREMENT Com_RxAccessInfo[124].RxSigBufferArrayBasedBufferEndIdxOfRxAccessInfo "" UBYTE Com_RxSigBufferArrayBasedBufferEndIdxOfRxAccessInfoType 0 0 0 255 ECU_ADDRESS 0x0 /end MEASUREMENT
/begin MEASUREMENT Com_RxAccessInfo[124].RxSigBufferArrayBasedBufferStartIdxOfRxAccessInfo "" UBYTE Com_RxSigBufferArrayBasedBufferStartIdxOfRxAccessInfoType 0 0 0 255 ECU_ADDRESS 0x0 /end MEASUREMENT
/begin MEASUREMENT Com_RxAccessInfo[124].RxSigBufferArrayBasedShdBufferEndIdxOfRxAccessInfo "" UBYTE Com_RxSigBufferArrayBasedShdBufferEndIdxOfRxAccessInfoType 0 0 0 255 ECU_ADDRESS 0x0 /end MEASUREMENT
/begin MEASUREMENT Com_RxAccessInfo[124].RxSigBufferArrayBasedShdBufferStartIdxOfRxAccessInfo "" UBYTE Com_RxSigBufferArrayBasedShdBufferStartIdxOfRxAccessInfoType 0 0 0 255 ECU_ADDRESS 0x0 /end MEASUREMENT
/begin MEASUREMENT Com_RxAccessInfo[124].RxTOutInfoIdxOfRxAccessInfo "" UBYTE Com_RxTOutInfoIdxOfRxAccessInfoType 0 0 0 255 ECU_ADDRESS 0x0 /end MEASUREMENT
/begin MEASUREMENT Com_RxAccessInfo[124].ShdBufferIdxOfRxAccessInfo "" UWORD Com_ShdBufferIdxOfRxAccessInfoType 0 0 0 65535 ECU_ADDRESS 0x0 /end MEASUREMENT
/begin MEASUREMENT Com_RxAccessInfo[124].SignalLengthInByteOfRxAccessInfo "" UBYTE NO_COMPU_METHOD 0 0 0 255 ECU_ADDRESS 0x0 /end MEASUREMENT
/begin MEASUREMENT Com_RxAccessInfo[124].StartByteInPduPositionOfRxAccessInfo "" UBYTE NO_COMPU_METHOD 0 0 0 255 ECU_ADDRESS 0x0 /end MEASUREMENT
/begin MEASUREMENT Com_RxAccessInfo[124].TmpBufferIdxOfRxAccessInfo "" UBYTE Com_TmpBufferIdxOfRxAccessInfoType 0 0 0 255 ECU_ADDRESS 0x0 /end MEASUREMENT
/begin MEASUREMENT Com_RxAccessInfo[124].TmpBufferOfRxAccessInfo "" UBYTE Com_TmpBufferOfRxAccessInfoType 0 0 0 255 ECU_ADDRESS 0x0 /end MEASUREMENT
/begin MEASUREMENT Com_RxAccessInfo[124].TmpRxShdBufferArrayBasedTmpBufferEndIdxOfRxAccessInfo "" UBYTE Com_TmpRxShdBufferArrayBasedTmpBufferEndIdxOfRxAccessInfoType 0 0 0 255 ECU_ADDRESS 0x0 /end MEASUREMENT
/begin MEASUREMENT Com_RxAccessInfo[124].TmpRxShdBufferArrayBasedTmpBufferStartIdxOfRxAccessInfo "" UBYTE Com_TmpRxShdBufferArrayBasedTmpBufferStartIdxOfRxAccessInfoType 0 0 0 255 ECU_ADDRESS 0x0 /end MEASUREMENT
/begin MEASUREMENT Com_RxAccessInfo[125].ApplTypeOfRxAccessInfo "" UBYTE Com_ApplTypeOfRxAccessInfoType 0 0 0 255 ECU_ADDRESS 0x0 /end MEASUREMENT
/begin MEASUREMENT Com_RxAccessInfo[125].BitLengthOfRxAccessInfo "" UWORD NO_COMPU_METHOD 0 0 0 65535 ECU_ADDRESS 0x0 /end MEASUREMENT
/begin MEASUREMENT Com_RxAccessInfo[125].BitPositionOfRxAccessInfo "" UWORD NO_COMPU_METHOD 0 0 0 65535 ECU_ADDRESS 0x0 /end MEASUREMENT
/begin MEASUREMENT Com_RxAccessInfo[125].BufferIdxOfRxAccessInfo "" UWORD Com_BufferIdxOfRxAccessInfoType 0 0 0 65535 ECU_ADDRESS 0x0 /end MEASUREMENT
/begin MEASUREMENT Com_RxAccessInfo[125].BusAccOfRxAccessInfo "" UBYTE Com_BusAccOfRxAccessInfoType 0 0 0 255 ECU_ADDRESS 0x0 /end MEASUREMENT
/begin MEASUREMENT Com_RxAccessInfo[125].ByteLengthOfRxAccessInfo "" UBYTE NO_COMPU_METHOD 0 0 0 255 ECU_ADDRESS 0x0 /end MEASUREMENT
/begin MEASUREMENT Com_RxAccessInfo[125].ConstValueArrayBasedInitValueEndIdxOfRxAccessInfo "" UBYTE Com_ConstValueArrayBasedInitValueEndIdxOfRxAccessInfoType 0 0 0 255 ECU_ADDRESS 0x0 /end MEASUREMENT
/begin MEASUREMENT Com_RxAccessInfo[125].ConstValueArrayBasedInitValueStartIdxOfRxAccessInfo "" UBYTE Com_ConstValueArrayBasedInitValueStartIdxOfRxAccessInfoType 0 0 0 255 ECU_ADDRESS 0x0 /end MEASUREMENT
/begin MEASUREMENT Com_RxAccessInfo[125].DynSignalOfRxAccessInfo "" UBYTE Com_DynSignalOfRxAccessInfoType 0 0 0 1 ECU_ADDRESS 0x0 /end MEASUREMENT
/begin MEASUREMENT Com_RxAccessInfo[125].InitValueIdxOfRxAccessInfo "" UBYTE Com_InitValueIdxOfRxAccessInfoType 0 0 0 255 ECU_ADDRESS 0x0 /end MEASUREMENT
/begin MEASUREMENT Com_RxAccessInfo[125].InitValueOfRxAccessInfo "" UBYTE Com_InitValueOfRxAccessInfoType 0 0 0 255 ECU_ADDRESS 0x0 /end MEASUREMENT
/begin MEASUREMENT Com_RxAccessInfo[125].InvValueIdxOfRxAccessInfo "" UBYTE Com_InvValueIdxOfRxAccessInfoType 0 0 0 255 ECU_ADDRESS 0x0 /end MEASUREMENT
/begin MEASUREMENT Com_RxAccessInfo[125].InvValueOfRxAccessInfo "" UBYTE Com_InvValueOfRxAccessInfoType 0 0 0 255 ECU_ADDRESS 0x0 /end MEASUREMENT
/begin MEASUREMENT Com_RxAccessInfo[125].IsGroupSignalOfRxAccessInfo "" UBYTE Com_IsGroupSignalOfRxAccessInfoType 0 0 0 1 ECU_ADDRESS 0x0 /end MEASUREMENT
/begin MEASUREMENT Com_RxAccessInfo[125].RxDataTimeoutSubstitutionValueIdxOfRxAccessInfo "" UBYTE Com_RxDataTimeoutSubstitutionValueIdxOfRxAccessInfoType 0 0 0 255 ECU_ADDRESS 0x0 /end MEASUREMENT
/begin MEASUREMENT Com_RxAccessInfo[125].RxDataTimeoutSubstitutionValueOfRxAccessInfo "" UBYTE Com_RxDataTimeoutSubstitutionValueOfRxAccessInfoType 0 0 0 255 ECU_ADDRESS 0x0 /end MEASUREMENT
/begin MEASUREMENT Com_RxAccessInfo[125].RxPduInfoIdxOfRxAccessInfo "" UBYTE NO_COMPU_METHOD 0 0 0 255 ECU_ADDRESS 0x0 /end MEASUREMENT
/begin MEASUREMENT Com_RxAccessInfo[125].RxSigBufferArrayBasedBufferEndIdxOfRxAccessInfo "" UBYTE Com_RxSigBufferArrayBasedBufferEndIdxOfRxAccessInfoType 0 0 0 255 ECU_ADDRESS 0x0 /end MEASUREMENT
/begin MEASUREMENT Com_RxAccessInfo[125].RxSigBufferArrayBasedBufferStartIdxOfRxAccessInfo "" UBYTE Com_RxSigBufferArrayBasedBufferStartIdxOfRxAccessInfoType 0 0 0 255 ECU_ADDRESS 0x0 /end MEASUREMENT
/begin MEASUREMENT Com_RxAccessInfo[125].RxSigBufferArrayBasedShdBufferEndIdxOfRxAccessInfo "" UBYTE Com_RxSigBufferArrayBasedShdBufferEndIdxOfRxAccessInfoType 0 0 0 255 ECU_ADDRESS 0x0 /end MEASUREMENT
/begin MEASUREMENT Com_RxAccessInfo[125].RxSigBufferArrayBasedShdBufferStartIdxOfRxAccessInfo "" UBYTE Com_RxSigBufferArrayBasedShdBufferStartIdxOfRxAccessInfoType 0 0 0 255 ECU_ADDRESS 0x0 /end MEASUREMENT
/begin MEASUREMENT Com_RxAccessInfo[125].RxTOutInfoIdxOfRxAccessInfo "" UBYTE Com_RxTOutInfoIdxOfRxAccessInfoType 0 0 0 255 ECU_ADDRESS 0x0 /end MEASUREMENT
/begin MEASUREMENT Com_RxAccessInfo[125].ShdBufferIdxOfRxAccessInfo "" UWORD Com_ShdBufferIdxOfRxAccessInfoType 0 0 0 65535 ECU_ADDRESS 0x0 /end MEASUREMENT
/begin MEASUREMENT Com_RxAccessInfo[125].SignalLengthInByteOfRxAccessInfo "" UBYTE NO_COMPU_METHOD 0 0 0 255 ECU_ADDRESS 0x0 /end MEASUREMENT
/begin MEASUREMENT Com_RxAccessInfo[125].StartByteInPduPositionOfRxAccessInfo "" UBYTE NO_COMPU_METHOD 0 0 0 255 ECU_ADDRESS 0x0 /end MEASUREMENT
/begin MEASUREMENT Com_RxAccessInfo[125].TmpBufferIdxOfRxAccessInfo "" UBYTE Com_TmpBufferIdxOfRxAccessInfoType 0 0 0 255 ECU_ADDRESS 0x0 /end MEASUREMENT
/begin MEASUREMENT Com_RxAccessInfo[125].TmpBufferOfRxAccessInfo "" UBYTE Com_TmpBufferOfRxAccessInfoType 0 0 0 255 ECU_ADDRESS 0x0 /end MEASUREMENT
/begin MEASUREMENT Com_RxAccessInfo[125].TmpRxShdBufferArrayBasedTmpBufferEndIdxOfRxAccessInfo "" UBYTE Com_TmpRxShdBufferArrayBasedTmpBufferEndIdxOfRxAccessInfoType 0 0 0 255 ECU_ADDRESS 0x0 /end MEASUREMENT
/begin MEASUREMENT Com_RxAccessInfo[125].TmpRxShdBufferArrayBasedTmpBufferStartIdxOfRxAccessInfo "" UBYTE Com_TmpRxShdBufferArrayBasedTmpBufferStartIdxOfRxAccessInfoType 0 0 0 255 ECU_ADDRESS 0x0 /end MEASUREMENT
/begin MEASUREMENT Com_RxAccessInfo[126].ApplTypeOfRxAccessInfo "" UBYTE Com_ApplTypeOfRxAccessInfoType 0 0 0 255 ECU_ADDRESS 0x0 /end MEASUREMENT
/begin MEASUREMENT Com_RxAccessInfo[126].BitLengthOfRxAccessInfo "" UWORD NO_COMPU_METHOD 0 0 0 65535 ECU_ADDRESS 0x0 /end MEASUREMENT
/begin MEASUREMENT Com_RxAccessInfo[126].BitPositionOfRxAccessInfo "" UWORD NO_COMPU_METHOD 0 0 0 65535 ECU_ADDRESS 0x0 /end MEASUREMENT
/begin MEASUREMENT Com_RxAccessInfo[126].BufferIdxOfRxAccessInfo "" UWORD Com_BufferIdxOfRxAccessInfoType 0 0 0 65535 ECU_ADDRESS 0x0 /end MEASUREMENT
/begin MEASUREMENT Com_RxAccessInfo[126].BusAccOfRxAccessInfo "" UBYTE Com_BusAccOfRxAccessInfoType 0 0 0 255 ECU_ADDRESS 0x0 /end MEASUREMENT
/begin MEASUREMENT Com_RxAccessInfo[126].ByteLengthOfRxAccessInfo "" UBYTE NO_COMPU_METHOD 0 0 0 255 ECU_ADDRESS 0x0 /end MEASUREMENT
/begin MEASUREMENT Com_RxAccessInfo[126].ConstValueArrayBasedInitValueEndIdxOfRxAccessInfo "" UBYTE Com_ConstValueArrayBasedInitValueEndIdxOfRxAccessInfoType 0 0 0 255 ECU_ADDRESS 0x0 /end MEASUREMENT
/begin MEASUREMENT Com_RxAccessInfo[126].ConstValueArrayBasedInitValueStartIdxOfRxAccessInfo "" UBYTE Com_ConstValueArrayBasedInitValueStartIdxOfRxAccessInfoType 0 0 0 255 ECU_ADDRESS 0x0 /end MEASUREMENT
/begin MEASUREMENT Com_RxAccessInfo[126].DynSignalOfRxAccessInfo "" UBYTE Com_DynSignalOfRxAccessInfoType 0 0 0 1 ECU_ADDRESS 0x0 /end MEASUREMENT
/begin MEASUREMENT Com_RxAccessInfo[126].InitValueIdxOfRxAccessInfo "" UBYTE Com_InitValueIdxOfRxAccessInfoType 0 0 0 255 ECU_ADDRESS 0x0 /end MEASUREMENT
/begin MEASUREMENT Com_RxAccessInfo[126].InitValueOfRxAccessInfo "" UBYTE Com_InitValueOfRxAccessInfoType 0 0 0 255 ECU_ADDRESS 0x0 /end MEASUREMENT
/begin MEASUREMENT Com_RxAccessInfo[126].InvValueIdxOfRxAccessInfo "" UBYTE Com_InvValueIdxOfRxAccessInfoType 0 0 0 255 ECU_ADDRESS 0x0 /end MEASUREMENT
/begin MEASUREMENT Com_RxAccessInfo[126].InvValueOfRxAccessInfo "" UBYTE Com_InvValueOfRxAccessInfoType 0 0 0 255 ECU_ADDRESS 0x0 /end MEASUREMENT
/begin MEASUREMENT Com_RxAccessInfo[126].IsGroupSignalOfRxAccessInfo "" UBYTE Com_IsGroupSignalOfRxAccessInfoType 0 0 0 1 ECU_ADDRESS 0x0 /end MEASUREMENT
/begin MEASUREMENT Com_RxAccessInfo[126].RxDataTimeoutSubstitutionValueIdxOfRxAccessInfo "" UBYTE Com_RxDataTimeoutSubstitutionValueIdxOfRxAccessInfoType 0 0 0 255 ECU_ADDRESS 0x0 /end MEASUREMENT
/begin MEASUREMENT Com_RxAccessInfo[126].RxDataTimeoutSubstitutionValueOfRxAccessInfo "" UBYTE Com_RxDataTimeoutSubstitutionValueOfRxAccessInfoType 0 0 0 255 ECU_ADDRESS 0x0 /end MEASUREMENT
/begin MEASUREMENT Com_RxAccessInfo[126].RxPduInfoIdxOfRxAccessInfo "" UBYTE NO_COMPU_METHOD 0 0 0 255 ECU_ADDRESS 0x0 /end MEASUREMENT
/begin MEASUREMENT Com_RxAccessInfo[126].RxSigBufferArrayBasedBufferEndIdxOfRxAccessInfo "" UBYTE Com_RxSigBufferArrayBasedBufferEndIdxOfRxAccessInfoType 0 0 0 255 ECU_ADDRESS 0x0 /end MEASUREMENT
/begin MEASUREMENT Com_RxAccessInfo[126].RxSigBufferArrayBasedBufferStartIdxOfRxAccessInfo "" UBYTE Com_RxSigBufferArrayBasedBufferStartIdxOfRxAccessInfoType 0 0 0 255 ECU_ADDRESS 0x0 /end MEASUREMENT
/begin MEASUREMENT Com_RxAccessInfo[126].RxSigBufferArrayBasedShdBufferEndIdxOfRxAccessInfo "" UBYTE Com_RxSigBufferArrayBasedShdBufferEndIdxOfRxAccessInfoType 0 0 0 255 ECU_ADDRESS 0x0 /end MEASUREMENT
/begin MEASUREMENT Com_RxAccessInfo[126].RxSigBufferArrayBasedShdBufferStartIdxOfRxAccessInfo "" UBYTE Com_RxSigBufferArrayBasedShdBufferStartIdxOfRxAccessInfoType 0 0 0 255 ECU_ADDRESS 0x0 /end MEASUREMENT
/begin MEASUREMENT Com_RxAccessInfo[126].RxTOutInfoIdxOfRxAccessInfo "" UBYTE Com_RxTOutInfoIdxOfRxAccessInfoType 0 0 0 255 ECU_ADDRESS 0x0 /end MEASUREMENT
/begin MEASUREMENT Com_RxAccessInfo[126].ShdBufferIdxOfRxAccessInfo "" UWORD Com_ShdBufferIdxOfRxAccessInfoType 0 0 0 65535 ECU_ADDRESS 0x0 /end MEASUREMENT
/begin MEASUREMENT Com_RxAccessInfo[126].SignalLengthInByteOfRxAccessInfo "" UBYTE NO_COMPU_METHOD 0 0 0 255 ECU_ADDRESS 0x0 /end MEASUREMENT
/begin MEASUREMENT Com_RxAccessInfo[126].StartByteInPduPositionOfRxAccessInfo "" UBYTE NO_COMPU_METHOD 0 0 0 255 ECU_ADDRESS 0x0 /end MEASUREMENT
/begin MEASUREMENT Com_RxAccessInfo[126].TmpBufferIdxOfRxAccessInfo "" UBYTE Com_TmpBufferIdxOfRxAccessInfoType 0 0 0 255 ECU_ADDRESS 0x0 /end MEASUREMENT
/begin MEASUREMENT Com_RxAccessInfo[126].TmpBufferOfRxAccessInfo "" UBYTE Com_TmpBufferOfRxAccessInfoType 0 0 0 255 ECU_ADDRESS 0x0 /end MEASUREMENT
/begin MEASUREMENT Com_RxAccessInfo[126].TmpRxShdBufferArrayBasedTmpBufferEndIdxOfRxAccessInfo "" UBYTE Com_TmpRxShdBufferArrayBasedTmpBufferEndIdxOfRxAccessInfoType 0 0 0 255 ECU_ADDRESS 0x0 /end MEASUREMENT
/begin MEASUREMENT Com_RxAccessInfo[126].TmpRxShdBufferArrayBasedTmpBufferStartIdxOfRxAccessInfo "" UBYTE Com_TmpRxShdBufferArrayBasedTmpBufferStartIdxOfRxAccessInfoType 0 0 0 255 ECU_ADDRESS 0x0 /end MEASUREMENT
/begin MEASUREMENT Com_RxAccessInfo[127].ApplTypeOfRxAccessInfo "" UBYTE Com_ApplTypeOfRxAccessInfoType 0 0 0 255 ECU_ADDRESS 0x0 /end MEASUREMENT
/begin MEASUREMENT Com_RxAccessInfo[127].BitLengthOfRxAccessInfo "" UWORD NO_COMPU_METHOD 0 0 0 65535 ECU_ADDRESS 0x0 /end MEASUREMENT
/begin MEASUREMENT Com_RxAccessInfo[127].BitPositionOfRxAccessInfo "" UWORD NO_COMPU_METHOD 0 0 0 65535 ECU_ADDRESS 0x0 /end MEASUREMENT
/begin MEASUREMENT Com_RxAccessInfo[127].BufferIdxOfRxAccessInfo "" UWORD Com_BufferIdxOfRxAccessInfoType 0 0 0 65535 ECU_ADDRESS 0x0 /end MEASUREMENT
/begin MEASUREMENT Com_RxAccessInfo[127].BusAccOfRxAccessInfo "" UBYTE Com_BusAccOfRxAccessInfoType 0 0 0 255 ECU_ADDRESS 0x0 /end MEASUREMENT
/begin MEASUREMENT Com_RxAccessInfo[127].ByteLengthOfRxAccessInfo "" UBYTE NO_COMPU_METHOD 0 0 0 255 ECU_ADDRESS 0x0 /end MEASUREMENT
/begin MEASUREMENT Com_RxAccessInfo[127].ConstValueArrayBasedInitValueEndIdxOfRxAccessInfo "" UBYTE Com_ConstValueArrayBasedInitValueEndIdxOfRxAccessInfoType 0 0 0 255 ECU_ADDRESS 0x0 /end MEASUREMENT
/begin MEASUREMENT Com_RxAccessInfo[127].ConstValueArrayBasedInitValueStartIdxOfRxAccessInfo "" UBYTE Com_ConstValueArrayBasedInitValueStartIdxOfRxAccessInfoType 0 0 0 255 ECU_ADDRESS 0x0 /end MEASUREMENT
/begin MEASUREMENT Com_RxAccessInfo[127].DynSignalOfRxAccessInfo "" UBYTE Com_DynSignalOfRxAccessInfoType 0 0 0 1 ECU_ADDRESS 0x0 /end MEASUREMENT
/begin MEASUREMENT Com_RxAccessInfo[127].InitValueIdxOfRxAccessInfo "" UBYTE Com_InitValueIdxOfRxAccessInfoType 0 0 0 255 ECU_ADDRESS 0x0 /end MEASUREMENT
/begin MEASUREMENT Com_RxAccessInfo[127].InitValueOfRxAccessInfo "" UBYTE Com_InitValueOfRxAccessInfoType 0 0 0 255 ECU_ADDRESS 0x0 /end MEASUREMENT
/begin MEASUREMENT Com_RxAccessInfo[127].InvValueIdxOfRxAccessInfo "" UBYTE Com_InvValueIdxOfRxAccessInfoType 0 0 0 255 ECU_ADDRESS 0x0 /end MEASUREMENT
/begin MEASUREMENT Com_RxAccessInfo[127].InvValueOfRxAccessInfo "" UBYTE Com_InvValueOfRxAccessInfoType 0 0 0 255 ECU_ADDRESS 0x0 /end MEASUREMENT
/begin MEASUREMENT Com_RxAccessInfo[127].IsGroupSignalOfRxAccessInfo "" UBYTE Com_IsGroupSignalOfRxAccessInfoType 0 0 0 1 ECU_ADDRESS 0x0 /end MEASUREMENT
/begin MEASUREMENT Com_RxAccessInfo[127].RxDataTimeoutSubstitutionValueIdxOfRxAccessInfo "" UBYTE Com_RxDataTimeoutSubstitutionValueIdxOfRxAccessInfoType 0 0 0 255 ECU_ADDRESS 0x0 /end MEASUREMENT
/begin MEASUREMENT Com_RxAccessInfo[127].RxDataTimeoutSubstitutionValueOfRxAccessInfo "" UBYTE Com_RxDataTimeoutSubstitutionValueOfRxAccessInfoType 0 0 0 255 ECU_ADDRESS 0x0 /end MEASUREMENT
/begin MEASUREMENT Com_RxAccessInfo[127].RxPduInfoIdxOfRxAccessInfo "" UBYTE NO_COMPU_METHOD 0 0 0 255 ECU_ADDRESS 0x0 /end MEASUREMENT
/begin MEASUREMENT Com_RxAccessInfo[127].RxSigBufferArrayBasedBufferEndIdxOfRxAccessInfo "" UBYTE Com_RxSigBufferArrayBasedBufferEndIdxOfRxAccessInfoType 0 0 0 255 ECU_ADDRESS 0x0 /end MEASUREMENT
/begin MEASUREMENT Com_RxAccessInfo[127].RxSigBufferArrayBasedBufferStartIdxOfRxAccessInfo "" UBYTE Com_RxSigBufferArrayBasedBufferStartIdxOfRxAccessInfoType 0 0 0 255 ECU_ADDRESS 0x0 /end MEASUREMENT
/begin MEASUREMENT Com_RxAccessInfo[127].RxSigBufferArrayBasedShdBufferEndIdxOfRxAccessInfo "" UBYTE Com_RxSigBufferArrayBasedShdBufferEndIdxOfRxAccessInfoType 0 0 0 255 ECU_ADDRESS 0x0 /end MEASUREMENT
/begin MEASUREMENT Com_RxAccessInfo[127].RxSigBufferArrayBasedShdBufferStartIdxOfRxAccessInfo "" UBYTE Com_RxSigBufferArrayBasedShdBufferStartIdxOfRxAccessInfoType 0 0 0 255 ECU_ADDRESS 0x0 /end MEASUREMENT
/begin MEASUREMENT Com_RxAccessInfo[127].RxTOutInfoIdxOfRxAccessInfo "" UBYTE Com_RxTOutInfoIdxOfRxAccessInfoType 0 0 0 255 ECU_ADDRESS 0x0 /end MEASUREMENT
/begin MEASUREMENT Com_RxAccessInfo[127].ShdBufferIdxOfRxAccessInfo "" UWORD Com_ShdBufferIdxOfRxAccessInfoType 0 0 0 65535 ECU_ADDRESS 0x0 /end MEASUREMENT
/begin MEASUREMENT Com_RxAccessInfo[127].SignalLengthInByteOfRxAccessInfo "" UBYTE NO_COMPU_METHOD 0 0 0 255 ECU_ADDRESS 0x0 /end MEASUREMENT
/begin MEASUREMENT Com_RxAccessInfo[127].StartByteInPduPositionOfRxAccessInfo "" UBYTE NO_COMPU_METHOD 0 0 0 255 ECU_ADDRESS 0x0 /end MEASUREMENT
/begin MEASUREMENT Com_RxAccessInfo[127].TmpBufferIdxOfRxAccessInfo "" UBYTE Com_TmpBufferIdxOfRxAccessInfoType 0 0 0 255 ECU_ADDRESS 0x0 /end MEASUREMENT
/begin MEASUREMENT Com_RxAccessInfo[127].TmpBufferOfRxAccessInfo "" UBYTE Com_TmpBufferOfRxAccessInfoType 0 0 0 255 ECU_ADDRESS 0x0 /end MEASUREMENT
/begin MEASUREMENT Com_RxAccessInfo[127].TmpRxShdBufferArrayBasedTmpBufferEndIdxOfRxAccessInfo "" UBYTE Com_TmpRxShdBufferArrayBasedTmpBufferEndIdxOfRxAccessInfoType 0 0 0 255 ECU_ADDRESS 0x0 /end MEASUREMENT
/begin MEASUREMENT Com_RxAccessInfo[127].TmpRxShdBufferArrayBasedTmpBufferStartIdxOfRxAccessInfo "" UBYTE Com_TmpRxShdBufferArrayBasedTmpBufferStartIdxOfRxAccessInfoType 0 0 0 255 ECU_ADDRESS 0x0 /end MEASUREMENT
/begin MEASUREMENT Com_RxAccessInfo[128].ApplTypeOfRxAccessInfo "" UBYTE Com_ApplTypeOfRxAccessInfoType 0 0 0 255 ECU_ADDRESS 0x0 /end MEASUREMENT
/begin MEASUREMENT Com_RxAccessInfo[128].BitLengthOfRxAccessInfo "" UWORD NO_COMPU_METHOD 0 0 0 65535 ECU_ADDRESS 0x0 /end MEASUREMENT
/begin MEASUREMENT Com_RxAccessInfo[128].BitPositionOfRxAccessInfo "" UWORD NO_COMPU_METHOD 0 0 0 65535 ECU_ADDRESS 0x0 /end MEASUREMENT
/begin MEASUREMENT Com_RxAccessInfo[128].BufferIdxOfRxAccessInfo "" UWORD Com_BufferIdxOfRxAccessInfoType 0 0 0 65535 ECU_ADDRESS 0x0 /end MEASUREMENT
/begin MEASUREMENT Com_RxAccessInfo[128].BusAccOfRxAccessInfo "" UBYTE Com_BusAccOfRxAccessInfoType 0 0 0 255 ECU_ADDRESS 0x0 /end MEASUREMENT
/begin MEASUREMENT Com_RxAccessInfo[128].ByteLengthOfRxAccessInfo "" UBYTE NO_COMPU_METHOD 0 0 0 255 ECU_ADDRESS 0x0 /end MEASUREMENT
/begin MEASUREMENT Com_RxAccessInfo[128].ConstValueArrayBasedInitValueEndIdxOfRxAccessInfo "" UBYTE Com_ConstValueArrayBasedInitValueEndIdxOfRxAccessInfoType 0 0 0 255 ECU_ADDRESS 0x0 /end MEASUREMENT
/begin MEASUREMENT Com_RxAccessInfo[128].ConstValueArrayBasedInitValueStartIdxOfRxAccessInfo "" UBYTE Com_ConstValueArrayBasedInitValueStartIdxOfRxAccessInfoType 0 0 0 255 ECU_ADDRESS 0x0 /end MEASUREMENT
/begin MEASUREMENT Com_RxAccessInfo[128].DynSignalOfRxAccessInfo "" UBYTE Com_DynSignalOfRxAccessInfoType 0 0 0 1 ECU_ADDRESS 0x0 /end MEASUREMENT
/begin MEASUREMENT Com_RxAccessInfo[128].InitValueIdxOfRxAccessInfo "" UBYTE Com_InitValueIdxOfRxAccessInfoType 0 0 0 255 ECU_ADDRESS 0x0 /end MEASUREMENT
/begin MEASUREMENT Com_RxAccessInfo[128].InitValueOfRxAccessInfo "" UBYTE Com_InitValueOfRxAccessInfoType 0 0 0 255 ECU_ADDRESS 0x0 /end MEASUREMENT
/begin MEASUREMENT Com_RxAccessInfo[128].InvValueIdxOfRxAccessInfo "" UBYTE Com_InvValueIdxOfRxAccessInfoType 0 0 0 255 ECU_ADDRESS 0x0 /end MEASUREMENT
/begin MEASUREMENT Com_RxAccessInfo[128].InvValueOfRxAccessInfo "" UBYTE Com_InvValueOfRxAccessInfoType 0 0 0 255 ECU_ADDRESS 0x0 /end MEASUREMENT
/begin MEASUREMENT Com_RxAccessInfo[128].IsGroupSignalOfRxAccessInfo "" UBYTE Com_IsGroupSignalOfRxAccessInfoType 0 0 0 1 ECU_ADDRESS 0x0 /end MEASUREMENT
/begin MEASUREMENT Com_RxAccessInfo[128].RxDataTimeoutSubstitutionValueIdxOfRxAccessInfo "" UBYTE Com_RxDataTimeoutSubstitutionValueIdxOfRxAccessInfoType 0 0 0 255 ECU_ADDRESS 0x0 /end MEASUREMENT
/begin MEASUREMENT Com_RxAccessInfo[128].RxDataTimeoutSubstitutionValueOfRxAccessInfo "" UBYTE Com_RxDataTimeoutSubstitutionValueOfRxAccessInfoType 0 0 0 255 ECU_ADDRESS 0x0 /end MEASUREMENT
/begin MEASUREMENT Com_RxAccessInfo[128].RxPduInfoIdxOfRxAccessInfo "" UBYTE NO_COMPU_METHOD 0 0 0 255 ECU_ADDRESS 0x0 /end MEASUREMENT
/begin MEASUREMENT Com_RxAccessInfo[128].RxSigBufferArrayBasedBufferEndIdxOfRxAccessInfo "" UBYTE Com_RxSigBufferArrayBasedBufferEndIdxOfRxAccessInfoType 0 0 0 255 ECU_ADDRESS 0x0 /end MEASUREMENT
/begin MEASUREMENT Com_RxAccessInfo[128].RxSigBufferArrayBasedBufferStartIdxOfRxAccessInfo "" UBYTE Com_RxSigBufferArrayBasedBufferStartIdxOfRxAccessInfoType 0 0 0 255 ECU_ADDRESS 0x0 /end MEASUREMENT
/begin MEASUREMENT Com_RxAccessInfo[128].RxSigBufferArrayBasedShdBufferEndIdxOfRxAccessInfo "" UBYTE Com_RxSigBufferArrayBasedShdBufferEndIdxOfRxAccessInfoType 0 0 0 255 ECU_ADDRESS 0x0 /end MEASUREMENT
/begin MEASUREMENT Com_RxAccessInfo[128].RxSigBufferArrayBasedShdBufferStartIdxOfRxAccessInfo "" UBYTE Com_RxSigBufferArrayBasedShdBufferStartIdxOfRxAccessInfoType 0 0 0 255 ECU_ADDRESS 0x0 /end MEASUREMENT
/begin MEASUREMENT Com_RxAccessInfo[128].RxTOutInfoIdxOfRxAccessInfo "" UBYTE Com_RxTOutInfoIdxOfRxAccessInfoType 0 0 0 255 ECU_ADDRESS 0x0 /end MEASUREMENT
/begin MEASUREMENT Com_RxAccessInfo[128].ShdBufferIdxOfRxAccessInfo "" UWORD Com_ShdBufferIdxOfRxAccessInfoType 0 0 0 65535 ECU_ADDRESS 0x0 /end MEASUREMENT
/begin MEASUREMENT Com_RxAccessInfo[128].SignalLengthInByteOfRxAccessInfo "" UBYTE NO_COMPU_METHOD 0 0 0 255 ECU_ADDRESS 0x0 /end MEASUREMENT
/begin MEASUREMENT Com_RxAccessInfo[128].StartByteInPduPositionOfRxAccessInfo "" UBYTE NO_COMPU_METHOD 0 0 0 255 ECU_ADDRESS 0x0 /end MEASUREMENT
/begin MEASUREMENT Com_RxAccessInfo[128].TmpBufferIdxOfRxAccessInfo "" UBYTE Com_TmpBufferIdxOfRxAccessInfoType 0 0 0 255 ECU_ADDRESS 0x0 /end MEASUREMENT
/begin MEASUREMENT Com_RxAccessInfo[128].TmpBufferOfRxAccessInfo "" UBYTE Com_TmpBufferOfRxAccessInfoType 0 0 0 255 ECU_ADDRESS 0x0 /end MEASUREMENT
/begin MEASUREMENT Com_RxAccessInfo[128].TmpRxShdBufferArrayBasedTmpBufferEndIdxOfRxAccessInfo "" UBYTE Com_TmpRxShdBufferArrayBasedTmpBufferEndIdxOfRxAccessInfoType 0 0 0 255 ECU_ADDRESS 0x0 /end MEASUREMENT
/begin MEASUREMENT Com_RxAccessInfo[128].TmpRxShdBufferArrayBasedTmpBufferStartIdxOfRxAccessInfo "" UBYTE Com_TmpRxShdBufferArrayBasedTmpBufferStartIdxOfRxAccessInfoType 0 0 0 255 ECU_ADDRESS 0x0 /end MEASUREMENT
/begin MEASUREMENT Com_RxAccessInfo[129].ApplTypeOfRxAccessInfo "" UBYTE Com_ApplTypeOfRxAccessInfoType 0 0 0 255 ECU_ADDRESS 0x0 /end MEASUREMENT
/begin MEASUREMENT Com_RxAccessInfo[129].BitLengthOfRxAccessInfo "" UWORD NO_COMPU_METHOD 0 0 0 65535 ECU_ADDRESS 0x0 /end MEASUREMENT
/begin MEASUREMENT Com_RxAccessInfo[129].BitPositionOfRxAccessInfo "" UWORD NO_COMPU_METHOD 0 0 0 65535 ECU_ADDRESS 0x0 /end MEASUREMENT
/begin MEASUREMENT Com_RxAccessInfo[129].BufferIdxOfRxAccessInfo "" UWORD Com_BufferIdxOfRxAccessInfoType 0 0 0 65535 ECU_ADDRESS 0x0 /end MEASUREMENT
/begin MEASUREMENT Com_RxAccessInfo[129].BusAccOfRxAccessInfo "" UBYTE Com_BusAccOfRxAccessInfoType 0 0 0 255 ECU_ADDRESS 0x0 /end MEASUREMENT
/begin MEASUREMENT Com_RxAccessInfo[129].ByteLengthOfRxAccessInfo "" UBYTE NO_COMPU_METHOD 0 0 0 255 ECU_ADDRESS 0x0 /end MEASUREMENT
/begin MEASUREMENT Com_RxAccessInfo[129].ConstValueArrayBasedInitValueEndIdxOfRxAccessInfo "" UBYTE Com_ConstValueArrayBasedInitValueEndIdxOfRxAccessInfoType 0 0 0 255 ECU_ADDRESS 0x0 /end MEASUREMENT
/begin MEASUREMENT Com_RxAccessInfo[129].ConstValueArrayBasedInitValueStartIdxOfRxAccessInfo "" UBYTE Com_ConstValueArrayBasedInitValueStartIdxOfRxAccessInfoType 0 0 0 255 ECU_ADDRESS 0x0 /end MEASUREMENT
/begin MEASUREMENT Com_RxAccessInfo[129].DynSignalOfRxAccessInfo "" UBYTE Com_DynSignalOfRxAccessInfoType 0 0 0 1 ECU_ADDRESS 0x0 /end MEASUREMENT
/begin MEASUREMENT Com_RxAccessInfo[129].InitValueIdxOfRxAccessInfo "" UBYTE Com_InitValueIdxOfRxAccessInfoType 0 0 0 255 ECU_ADDRESS 0x0 /end MEASUREMENT
/begin MEASUREMENT Com_RxAccessInfo[129].InitValueOfRxAccessInfo "" UBYTE Com_InitValueOfRxAccessInfoType 0 0 0 255 ECU_ADDRESS 0x0 /end MEASUREMENT
/begin MEASUREMENT Com_RxAccessInfo[129].InvValueIdxOfRxAccessInfo "" UBYTE Com_InvValueIdxOfRxAccessInfoType 0 0 0 255 ECU_ADDRESS 0x0 /end MEASUREMENT
/begin MEASUREMENT Com_RxAccessInfo[129].InvValueOfRxAccessInfo "" UBYTE Com_InvValueOfRxAccessInfoType 0 0 0 255 ECU_ADDRESS 0x0 /end MEASUREMENT
/begin MEASUREMENT Com_RxAccessInfo[129].IsGroupSignalOfRxAccessInfo "" UBYTE Com_IsGroupSignalOfRxAccessInfoType 0 0 0 1 ECU_ADDRESS 0x0 /end MEASUREMENT
/begin MEASUREMENT Com_RxAccessInfo[129].RxDataTimeoutSubstitutionValueIdxOfRxAccessInfo "" UBYTE Com_RxDataTimeoutSubstitutionValueIdxOfRxAccessInfoType 0 0 0 255 ECU_ADDRESS 0x0 /end MEASUREMENT
/begin MEASUREMENT Com_RxAccessInfo[129].RxDataTimeoutSubstitutionValueOfRxAccessInfo "" UBYTE Com_RxDataTimeoutSubstitutionValueOfRxAccessInfoType 0 0 0 255 ECU_ADDRESS 0x0 /end MEASUREMENT
/begin MEASUREMENT Com_RxAccessInfo[129].RxPduInfoIdxOfRxAccessInfo "" UBYTE NO_COMPU_METHOD 0 0 0 255 ECU_ADDRESS 0x0 /end MEASUREMENT
/begin MEASUREMENT Com_RxAccessInfo[129].RxSigBufferArrayBasedBufferEndIdxOfRxAccessInfo "" UBYTE Com_RxSigBufferArrayBasedBufferEndIdxOfRxAccessInfoType 0 0 0 255 ECU_ADDRESS 0x0 /end MEASUREMENT
/begin MEASUREMENT Com_RxAccessInfo[129].RxSigBufferArrayBasedBufferStartIdxOfRxAccessInfo "" UBYTE Com_RxSigBufferArrayBasedBufferStartIdxOfRxAccessInfoType 0 0 0 255 ECU_ADDRESS 0x0 /end MEASUREMENT
/begin MEASUREMENT Com_RxAccessInfo[129].RxSigBufferArrayBasedShdBufferEndIdxOfRxAccessInfo "" UBYTE Com_RxSigBufferArrayBasedShdBufferEndIdxOfRxAccessInfoType 0 0 0 255 ECU_ADDRESS 0x0 /end MEASUREMENT
/begin MEASUREMENT Com_RxAccessInfo[129].RxSigBufferArrayBasedShdBufferStartIdxOfRxAccessInfo "" UBYTE Com_RxSigBufferArrayBasedShdBufferStartIdxOfRxAccessInfoType 0 0 0 255 ECU_ADDRESS 0x0 /end MEASUREMENT
/begin MEASUREMENT Com_RxAccessInfo[129].RxTOutInfoIdxOfRxAccessInfo "" UBYTE Com_RxTOutInfoIdxOfRxAccessInfoType 0 0 0 255 ECU_ADDRESS 0x0 /end MEASUREMENT
/begin MEASUREMENT Com_RxAccessInfo[129].ShdBufferIdxOfRxAccessInfo "" UWORD Com_ShdBufferIdxOfRxAccessInfoType 0 0 0 65535 ECU_ADDRESS 0x0 /end MEASUREMENT
/begin MEASUREMENT Com_RxAccessInfo[129].SignalLengthInByteOfRxAccessInfo "" UBYTE NO_COMPU_METHOD 0 0 0 255 ECU_ADDRESS 0x0 /end MEASUREMENT
/begin MEASUREMENT Com_RxAccessInfo[129].StartByteInPduPositionOfRxAccessInfo "" UBYTE NO_COMPU_METHOD 0 0 0 255 ECU_ADDRESS 0x0 /end MEASUREMENT
/begin MEASUREMENT Com_RxAccessInfo[129].TmpBufferIdxOfRxAccessInfo "" UBYTE Com_TmpBufferIdxOfRxAccessInfoType 0 0 0 255 ECU_ADDRESS 0x0 /end MEASUREMENT
/begin MEASUREMENT Com_RxAccessInfo[129].TmpBufferOfRxAccessInfo "" UBYTE Com_TmpBufferOfRxAccessInfoType 0 0 0 255 ECU_ADDRESS 0x0 /end MEASUREMENT
/begin MEASUREMENT Com_RxAccessInfo[129].TmpRxShdBufferArrayBasedTmpBufferEndIdxOfRxAccessInfo "" UBYTE Com_TmpRxShdBufferArrayBasedTmpBufferEndIdxOfRxAccessInfoType 0 0 0 255 ECU_ADDRESS 0x0 /end MEASUREMENT
/begin MEASUREMENT Com_RxAccessInfo[129].TmpRxShdBufferArrayBasedTmpBufferStartIdxOfRxAccessInfo "" UBYTE Com_TmpRxShdBufferArrayBasedTmpBufferStartIdxOfRxAccessInfoType 0 0 0 255 ECU_ADDRESS 0x0 /end MEASUREMENT
/begin MEASUREMENT Com_RxAccessInfo[12].ApplTypeOfRxAccessInfo "" UBYTE Com_ApplTypeOfRxAccessInfoType 0 0 0 255 ECU_ADDRESS 0x0 /end MEASUREMENT
/begin MEASUREMENT Com_RxAccessInfo[12].BitLengthOfRxAccessInfo "" UWORD NO_COMPU_METHOD 0 0 0 65535 ECU_ADDRESS 0x0 /end MEASUREMENT
/begin MEASUREMENT Com_RxAccessInfo[12].BitPositionOfRxAccessInfo "" UWORD NO_COMPU_METHOD 0 0 0 65535 ECU_ADDRESS 0x0 /end MEASUREMENT
/begin MEASUREMENT Com_RxAccessInfo[12].BufferIdxOfRxAccessInfo "" UWORD Com_BufferIdxOfRxAccessInfoType 0 0 0 65535 ECU_ADDRESS 0x0 /end MEASUREMENT
/begin MEASUREMENT Com_RxAccessInfo[12].BusAccOfRxAccessInfo "" UBYTE Com_BusAccOfRxAccessInfoType 0 0 0 255 ECU_ADDRESS 0x0 /end MEASUREMENT
/begin MEASUREMENT Com_RxAccessInfo[12].ByteLengthOfRxAccessInfo "" UBYTE NO_COMPU_METHOD 0 0 0 255 ECU_ADDRESS 0x0 /end MEASUREMENT
/begin MEASUREMENT Com_RxAccessInfo[12].ConstValueArrayBasedInitValueEndIdxOfRxAccessInfo "" UBYTE Com_ConstValueArrayBasedInitValueEndIdxOfRxAccessInfoType 0 0 0 255 ECU_ADDRESS 0x0 /end MEASUREMENT
/begin MEASUREMENT Com_RxAccessInfo[12].ConstValueArrayBasedInitValueStartIdxOfRxAccessInfo "" UBYTE Com_ConstValueArrayBasedInitValueStartIdxOfRxAccessInfoType 0 0 0 255 ECU_ADDRESS 0x0 /end MEASUREMENT
/begin MEASUREMENT Com_RxAccessInfo[12].DynSignalOfRxAccessInfo "" UBYTE Com_DynSignalOfRxAccessInfoType 0 0 0 1 ECU_ADDRESS 0x0 /end MEASUREMENT
/begin MEASUREMENT Com_RxAccessInfo[12].InitValueIdxOfRxAccessInfo "" UBYTE Com_InitValueIdxOfRxAccessInfoType 0 0 0 255 ECU_ADDRESS 0x0 /end MEASUREMENT
/begin MEASUREMENT Com_RxAccessInfo[12].InitValueOfRxAccessInfo "" UBYTE Com_InitValueOfRxAccessInfoType 0 0 0 255 ECU_ADDRESS 0x0 /end MEASUREMENT
/begin MEASUREMENT Com_RxAccessInfo[12].InvValueIdxOfRxAccessInfo "" UBYTE Com_InvValueIdxOfRxAccessInfoType 0 0 0 255 ECU_ADDRESS 0x0 /end MEASUREMENT
/begin MEASUREMENT Com_RxAccessInfo[12].InvValueOfRxAccessInfo "" UBYTE Com_InvValueOfRxAccessInfoType 0 0 0 255 ECU_ADDRESS 0x0 /end MEASUREMENT
/begin MEASUREMENT Com_RxAccessInfo[12].IsGroupSignalOfRxAccessInfo "" UBYTE Com_IsGroupSignalOfRxAccessInfoType 0 0 0 1 ECU_ADDRESS 0x0 /end MEASUREMENT
/begin MEASUREMENT Com_RxAccessInfo[12].RxDataTimeoutSubstitutionValueIdxOfRxAccessInfo "" UBYTE Com_RxDataTimeoutSubstitutionValueIdxOfRxAccessInfoType 0 0 0 255 ECU_ADDRESS 0x0 /end MEASUREMENT
/begin MEASUREMENT Com_RxAccessInfo[12].RxDataTimeoutSubstitutionValueOfRxAccessInfo "" UBYTE Com_RxDataTimeoutSubstitutionValueOfRxAccessInfoType 0 0 0 255 ECU_ADDRESS 0x0 /end MEASUREMENT
/begin MEASUREMENT Com_RxAccessInfo[12].RxPduInfoIdxOfRxAccessInfo "" UBYTE NO_COMPU_METHOD 0 0 0 255 ECU_ADDRESS 0x0 /end MEASUREMENT
/begin MEASUREMENT Com_RxAccessInfo[12].RxSigBufferArrayBasedBufferEndIdxOfRxAccessInfo "" UBYTE Com_RxSigBufferArrayBasedBufferEndIdxOfRxAccessInfoType 0 0 0 255 ECU_ADDRESS 0x0 /end MEASUREMENT
/begin MEASUREMENT Com_RxAccessInfo[12].RxSigBufferArrayBasedBufferStartIdxOfRxAccessInfo "" UBYTE Com_RxSigBufferArrayBasedBufferStartIdxOfRxAccessInfoType 0 0 0 255 ECU_ADDRESS 0x0 /end MEASUREMENT
/begin MEASUREMENT Com_RxAccessInfo[12].RxSigBufferArrayBasedShdBufferEndIdxOfRxAccessInfo "" UBYTE Com_RxSigBufferArrayBasedShdBufferEndIdxOfRxAccessInfoType 0 0 0 255 ECU_ADDRESS 0x0 /end MEASUREMENT
/begin MEASUREMENT Com_RxAccessInfo[12].RxSigBufferArrayBasedShdBufferStartIdxOfRxAccessInfo "" UBYTE Com_RxSigBufferArrayBasedShdBufferStartIdxOfRxAccessInfoType 0 0 0 255 ECU_ADDRESS 0x0 /end MEASUREMENT
/begin MEASUREMENT Com_RxAccessInfo[12].RxTOutInfoIdxOfRxAccessInfo "" UBYTE Com_RxTOutInfoIdxOfRxAccessInfoType 0 0 0 255 ECU_ADDRESS 0x0 /end MEASUREMENT
/begin MEASUREMENT Com_RxAccessInfo[12].ShdBufferIdxOfRxAccessInfo "" UWORD Com_ShdBufferIdxOfRxAccessInfoType 0 0 0 65535 ECU_ADDRESS 0x0 /end MEASUREMENT
/begin MEASUREMENT Com_RxAccessInfo[12].SignalLengthInByteOfRxAccessInfo "" UBYTE NO_COMPU_METHOD 0 0 0 255 ECU_ADDRESS 0x0 /end MEASUREMENT
/begin MEASUREMENT Com_RxAccessInfo[12].StartByteInPduPositionOfRxAccessInfo "" UBYTE NO_COMPU_METHOD 0 0 0 255 ECU_ADDRESS 0x0 /end MEASUREMENT
/begin MEASUREMENT Com_RxAccessInfo[12].TmpBufferIdxOfRxAccessInfo "" UBYTE Com_TmpBufferIdxOfRxAccessInfoType 0 0 0 255 ECU_ADDRESS 0x0 /end MEASUREMENT
/begin MEASUREMENT Com_RxAccessInfo[12].TmpBufferOfRxAccessInfo "" UBYTE Com_TmpBufferOfRxAccessInfoType 0 0 0 255 ECU_ADDRESS 0x0 /end MEASUREMENT
/begin MEASUREMENT Com_RxAccessInfo[12].TmpRxShdBufferArrayBasedTmpBufferEndIdxOfRxAccessInfo "" UBYTE Com_TmpRxShdBufferArrayBasedTmpBufferEndIdxOfRxAccessInfoType 0 0 0 255 ECU_ADDRESS 0x0 /end MEASUREMENT
/begin MEASUREMENT Com_RxAccessInfo[12].TmpRxShdBufferArrayBasedTmpBufferStartIdxOfRxAccessInfo "" UBYTE Com_TmpRxShdBufferArrayBasedTmpBufferStartIdxOfRxAccessInfoType 0 0 0 255 ECU_ADDRESS 0x0 /end MEASUREMENT
/begin MEASUREMENT Com_RxAccessInfo[130].ApplTypeOfRxAccessInfo "" UBYTE Com_ApplTypeOfRxAccessInfoType 0 0 0 255 ECU_ADDRESS 0x0 /end MEASUREMENT
/begin MEASUREMENT Com_RxAccessInfo[130].BitLengthOfRxAccessInfo "" UWORD NO_COMPU_METHOD 0 0 0 65535 ECU_ADDRESS 0x0 /end MEASUREMENT
/begin MEASUREMENT Com_RxAccessInfo[130].BitPositionOfRxAccessInfo "" UWORD NO_COMPU_METHOD 0 0 0 65535 ECU_ADDRESS 0x0 /end MEASUREMENT
/begin MEASUREMENT Com_RxAccessInfo[130].BufferIdxOfRxAccessInfo "" UWORD Com_BufferIdxOfRxAccessInfoType 0 0 0 65535 ECU_ADDRESS 0x0 /end MEASUREMENT
/begin MEASUREMENT Com_RxAccessInfo[130].BusAccOfRxAccessInfo "" UBYTE Com_BusAccOfRxAccessInfoType 0 0 0 255 ECU_ADDRESS 0x0 /end MEASUREMENT
/begin MEASUREMENT Com_RxAccessInfo[130].ByteLengthOfRxAccessInfo "" UBYTE NO_COMPU_METHOD 0 0 0 255 ECU_ADDRESS 0x0 /end MEASUREMENT
/begin MEASUREMENT Com_RxAccessInfo[130].ConstValueArrayBasedInitValueEndIdxOfRxAccessInfo "" UBYTE Com_ConstValueArrayBasedInitValueEndIdxOfRxAccessInfoType 0 0 0 255 ECU_ADDRESS 0x0 /end MEASUREMENT
/begin MEASUREMENT Com_RxAccessInfo[130].ConstValueArrayBasedInitValueStartIdxOfRxAccessInfo "" UBYTE Com_ConstValueArrayBasedInitValueStartIdxOfRxAccessInfoType 0 0 0 255 ECU_ADDRESS 0x0 /end MEASUREMENT
/begin MEASUREMENT Com_RxAccessInfo[130].DynSignalOfRxAccessInfo "" UBYTE Com_DynSignalOfRxAccessInfoType 0 0 0 1 ECU_ADDRESS 0x0 /end MEASUREMENT
/begin MEASUREMENT Com_RxAccessInfo[130].InitValueIdxOfRxAccessInfo "" UBYTE Com_InitValueIdxOfRxAccessInfoType 0 0 0 255 ECU_ADDRESS 0x0 /end MEASUREMENT
/begin MEASUREMENT Com_RxAccessInfo[130].InitValueOfRxAccessInfo "" UBYTE Com_InitValueOfRxAccessInfoType 0 0 0 255 ECU_ADDRESS 0x0 /end MEASUREMENT
/begin MEASUREMENT Com_RxAccessInfo[130].InvValueIdxOfRxAccessInfo "" UBYTE Com_InvValueIdxOfRxAccessInfoType 0 0 0 255 ECU_ADDRESS 0x0 /end MEASUREMENT
/begin MEASUREMENT Com_RxAccessInfo[130].InvValueOfRxAccessInfo "" UBYTE Com_InvValueOfRxAccessInfoType 0 0 0 255 ECU_ADDRESS 0x0 /end MEASUREMENT
/begin MEASUREMENT Com_RxAccessInfo[130].IsGroupSignalOfRxAccessInfo "" UBYTE Com_IsGroupSignalOfRxAccessInfoType 0 0 0 1 ECU_ADDRESS 0x0 /end MEASUREMENT
/begin MEASUREMENT Com_RxAccessInfo[130].RxDataTimeoutSubstitutionValueIdxOfRxAccessInfo "" UBYTE Com_RxDataTimeoutSubstitutionValueIdxOfRxAccessInfoType 0 0 0 255 ECU_ADDRESS 0x0 /end MEASUREMENT
/begin MEASUREMENT Com_RxAccessInfo[130].RxDataTimeoutSubstitutionValueOfRxAccessInfo "" UBYTE Com_RxDataTimeoutSubstitutionValueOfRxAccessInfoType 0 0 0 255 ECU_ADDRESS 0x0 /end MEASUREMENT
/begin MEASUREMENT Com_RxAccessInfo[130].RxPduInfoIdxOfRxAccessInfo "" UBYTE NO_COMPU_METHOD 0 0 0 255 ECU_ADDRESS 0x0 /end MEASUREMENT
/begin MEASUREMENT Com_RxAccessInfo[130].RxSigBufferArrayBasedBufferEndIdxOfRxAccessInfo "" UBYTE Com_RxSigBufferArrayBasedBufferEndIdxOfRxAccessInfoType 0 0 0 255 ECU_ADDRESS 0x0 /end MEASUREMENT
/begin MEASUREMENT Com_RxAccessInfo[130].RxSigBufferArrayBasedBufferStartIdxOfRxAccessInfo "" UBYTE Com_RxSigBufferArrayBasedBufferStartIdxOfRxAccessInfoType 0 0 0 255 ECU_ADDRESS 0x0 /end MEASUREMENT
/begin MEASUREMENT Com_RxAccessInfo[130].RxSigBufferArrayBasedShdBufferEndIdxOfRxAccessInfo "" UBYTE Com_RxSigBufferArrayBasedShdBufferEndIdxOfRxAccessInfoType 0 0 0 255 ECU_ADDRESS 0x0 /end MEASUREMENT
/begin MEASUREMENT Com_RxAccessInfo[130].RxSigBufferArrayBasedShdBufferStartIdxOfRxAccessInfo "" UBYTE Com_RxSigBufferArrayBasedShdBufferStartIdxOfRxAccessInfoType 0 0 0 255 ECU_ADDRESS 0x0 /end MEASUREMENT
/begin MEASUREMENT Com_RxAccessInfo[130].RxTOutInfoIdxOfRxAccessInfo "" UBYTE Com_RxTOutInfoIdxOfRxAccessInfoType 0 0 0 255 ECU_ADDRESS 0x0 /end MEASUREMENT
/begin MEASUREMENT Com_RxAccessInfo[130].ShdBufferIdxOfRxAccessInfo "" UWORD Com_ShdBufferIdxOfRxAccessInfoType 0 0 0 65535 ECU_ADDRESS 0x0 /end MEASUREMENT
/begin MEASUREMENT Com_RxAccessInfo[130].SignalLengthInByteOfRxAccessInfo "" UBYTE NO_COMPU_METHOD 0 0 0 255 ECU_ADDRESS 0x0 /end MEASUREMENT
/begin MEASUREMENT Com_RxAccessInfo[130].StartByteInPduPositionOfRxAccessInfo "" UBYTE NO_COMPU_METHOD 0 0 0 255 ECU_ADDRESS 0x0 /end MEASUREMENT
/begin MEASUREMENT Com_RxAccessInfo[130].TmpBufferIdxOfRxAccessInfo "" UBYTE Com_TmpBufferIdxOfRxAccessInfoType 0 0 0 255 ECU_ADDRESS 0x0 /end MEASUREMENT
/begin MEASUREMENT Com_RxAccessInfo[130].TmpBufferOfRxAccessInfo "" UBYTE Com_TmpBufferOfRxAccessInfoType 0 0 0 255 ECU_ADDRESS 0x0 /end MEASUREMENT
/begin MEASUREMENT Com_RxAccessInfo[130].TmpRxShdBufferArrayBasedTmpBufferEndIdxOfRxAccessInfo "" UBYTE Com_TmpRxShdBufferArrayBasedTmpBufferEndIdxOfRxAccessInfoType 0 0 0 255 ECU_ADDRESS 0x0 /end MEASUREMENT
/begin MEASUREMENT Com_RxAccessInfo[130].TmpRxShdBufferArrayBasedTmpBufferStartIdxOfRxAccessInfo "" UBYTE Com_TmpRxShdBufferArrayBasedTmpBufferStartIdxOfRxAccessInfoType 0 0 0 255 ECU_ADDRESS 0x0 /end MEASUREMENT
/begin MEASUREMENT Com_RxAccessInfo[131].ApplTypeOfRxAccessInfo "" UBYTE Com_ApplTypeOfRxAccessInfoType 0 0 0 255 ECU_ADDRESS 0x0 /end MEASUREMENT
/begin MEASUREMENT Com_RxAccessInfo[131].BitLengthOfRxAccessInfo "" UWORD NO_COMPU_METHOD 0 0 0 65535 ECU_ADDRESS 0x0 /end MEASUREMENT
/begin MEASUREMENT Com_RxAccessInfo[131].BitPositionOfRxAccessInfo "" UWORD NO_COMPU_METHOD 0 0 0 65535 ECU_ADDRESS 0x0 /end MEASUREMENT
/begin MEASUREMENT Com_RxAccessInfo[131].BufferIdxOfRxAccessInfo "" UWORD Com_BufferIdxOfRxAccessInfoType 0 0 0 65535 ECU_ADDRESS 0x0 /end MEASUREMENT
/begin MEASUREMENT Com_RxAccessInfo[131].BusAccOfRxAccessInfo "" UBYTE Com_BusAccOfRxAccessInfoType 0 0 0 255 ECU_ADDRESS 0x0 /end MEASUREMENT
/begin MEASUREMENT Com_RxAccessInfo[131].ByteLengthOfRxAccessInfo "" UBYTE NO_COMPU_METHOD 0 0 0 255 ECU_ADDRESS 0x0 /end MEASUREMENT
/begin MEASUREMENT Com_RxAccessInfo[131].ConstValueArrayBasedInitValueEndIdxOfRxAccessInfo "" UBYTE Com_ConstValueArrayBasedInitValueEndIdxOfRxAccessInfoType 0 0 0 255 ECU_ADDRESS 0x0 /end MEASUREMENT
/begin MEASUREMENT Com_RxAccessInfo[131].ConstValueArrayBasedInitValueStartIdxOfRxAccessInfo "" UBYTE Com_ConstValueArrayBasedInitValueStartIdxOfRxAccessInfoType 0 0 0 255 ECU_ADDRESS 0x0 /end MEASUREMENT
/begin MEASUREMENT Com_RxAccessInfo[131].DynSignalOfRxAccessInfo "" UBYTE Com_DynSignalOfRxAccessInfoType 0 0 0 1 ECU_ADDRESS 0x0 /end MEASUREMENT
/begin MEASUREMENT Com_RxAccessInfo[131].InitValueIdxOfRxAccessInfo "" UBYTE Com_InitValueIdxOfRxAccessInfoType 0 0 0 255 ECU_ADDRESS 0x0 /end MEASUREMENT
/begin MEASUREMENT Com_RxAccessInfo[131].InitValueOfRxAccessInfo "" UBYTE Com_InitValueOfRxAccessInfoType 0 0 0 255 ECU_ADDRESS 0x0 /end MEASUREMENT
/begin MEASUREMENT Com_RxAccessInfo[131].InvValueIdxOfRxAccessInfo "" UBYTE Com_InvValueIdxOfRxAccessInfoType 0 0 0 255 ECU_ADDRESS 0x0 /end MEASUREMENT
/begin MEASUREMENT Com_RxAccessInfo[131].InvValueOfRxAccessInfo "" UBYTE Com_InvValueOfRxAccessInfoType 0 0 0 255 ECU_ADDRESS 0x0 /end MEASUREMENT
/begin MEASUREMENT Com_RxAccessInfo[131].IsGroupSignalOfRxAccessInfo "" UBYTE Com_IsGroupSignalOfRxAccessInfoType 0 0 0 1 ECU_ADDRESS 0x0 /end MEASUREMENT
/begin MEASUREMENT Com_RxAccessInfo[131].RxDataTimeoutSubstitutionValueIdxOfRxAccessInfo "" UBYTE Com_RxDataTimeoutSubstitutionValueIdxOfRxAccessInfoType 0 0 0 255 ECU_ADDRESS 0x0 /end MEASUREMENT
/begin MEASUREMENT Com_RxAccessInfo[131].RxDataTimeoutSubstitutionValueOfRxAccessInfo "" UBYTE Com_RxDataTimeoutSubstitutionValueOfRxAccessInfoType 0 0 0 255 ECU_ADDRESS 0x0 /end MEASUREMENT
/begin MEASUREMENT Com_RxAccessInfo[131].RxPduInfoIdxOfRxAccessInfo "" UBYTE NO_COMPU_METHOD 0 0 0 255 ECU_ADDRESS 0x0 /end MEASUREMENT
/begin MEASUREMENT Com_RxAccessInfo[131].RxSigBufferArrayBasedBufferEndIdxOfRxAccessInfo "" UBYTE Com_RxSigBufferArrayBasedBufferEndIdxOfRxAccessInfoType 0 0 0 255 ECU_ADDRESS 0x0 /end MEASUREMENT
/begin MEASUREMENT Com_RxAccessInfo[131].RxSigBufferArrayBasedBufferStartIdxOfRxAccessInfo "" UBYTE Com_RxSigBufferArrayBasedBufferStartIdxOfRxAccessInfoType 0 0 0 255 ECU_ADDRESS 0x0 /end MEASUREMENT
/begin MEASUREMENT Com_RxAccessInfo[131].RxSigBufferArrayBasedShdBufferEndIdxOfRxAccessInfo "" UBYTE Com_RxSigBufferArrayBasedShdBufferEndIdxOfRxAccessInfoType 0 0 0 255 ECU_ADDRESS 0x0 /end MEASUREMENT
/begin MEASUREMENT Com_RxAccessInfo[131].RxSigBufferArrayBasedShdBufferStartIdxOfRxAccessInfo "" UBYTE Com_RxSigBufferArrayBasedShdBufferStartIdxOfRxAccessInfoType 0 0 0 255 ECU_ADDRESS 0x0 /end MEASUREMENT
/begin MEASUREMENT Com_RxAccessInfo[131].RxTOutInfoIdxOfRxAccessInfo "" UBYTE Com_RxTOutInfoIdxOfRxAccessInfoType 0 0 0 255 ECU_ADDRESS 0x0 /end MEASUREMENT
/begin MEASUREMENT Com_RxAccessInfo[131].ShdBufferIdxOfRxAccessInfo "" UWORD Com_ShdBufferIdxOfRxAccessInfoType 0 0 0 65535 ECU_ADDRESS 0x0 /end MEASUREMENT
/begin MEASUREMENT Com_RxAccessInfo[131].SignalLengthInByteOfRxAccessInfo "" UBYTE NO_COMPU_METHOD 0 0 0 255 ECU_ADDRESS 0x0 /end MEASUREMENT
/begin MEASUREMENT Com_RxAccessInfo[131].StartByteInPduPositionOfRxAccessInfo "" UBYTE NO_COMPU_METHOD 0 0 0 255 ECU_ADDRESS 0x0 /end MEASUREMENT
/begin MEASUREMENT Com_RxAccessInfo[131].TmpBufferIdxOfRxAccessInfo "" UBYTE Com_TmpBufferIdxOfRxAccessInfoType 0 0 0 255 ECU_ADDRESS 0x0 /end MEASUREMENT
/begin MEASUREMENT Com_RxAccessInfo[131].TmpBufferOfRxAccessInfo "" UBYTE Com_TmpBufferOfRxAccessInfoType 0 0 0 255 ECU_ADDRESS 0x0 /end MEASUREMENT
/begin MEASUREMENT Com_RxAccessInfo[131].TmpRxShdBufferArrayBasedTmpBufferEndIdxOfRxAccessInfo "" UBYTE Com_TmpRxShdBufferArrayBasedTmpBufferEndIdxOfRxAccessInfoType 0 0 0 255 ECU_ADDRESS 0x0 /end MEASUREMENT
/begin MEASUREMENT Com_RxAccessInfo[131].TmpRxShdBufferArrayBasedTmpBufferStartIdxOfRxAccessInfo "" UBYTE Com_TmpRxShdBufferArrayBasedTmpBufferStartIdxOfRxAccessInfoType 0 0 0 255 ECU_ADDRESS 0x0 /end MEASUREMENT
/begin MEASUREMENT Com_RxAccessInfo[132].ApplTypeOfRxAccessInfo "" UBYTE Com_ApplTypeOfRxAccessInfoType 0 0 0 255 ECU_ADDRESS 0x0 /end MEASUREMENT
/begin MEASUREMENT Com_RxAccessInfo[132].BitLengthOfRxAccessInfo "" UWORD NO_COMPU_METHOD 0 0 0 65535 ECU_ADDRESS 0x0 /end MEASUREMENT
/begin MEASUREMENT Com_RxAccessInfo[132].BitPositionOfRxAccessInfo "" UWORD NO_COMPU_METHOD 0 0 0 65535 ECU_ADDRESS 0x0 /end MEASUREMENT
/begin MEASUREMENT Com_RxAccessInfo[132].BufferIdxOfRxAccessInfo "" UWORD Com_BufferIdxOfRxAccessInfoType 0 0 0 65535 ECU_ADDRESS 0x0 /end MEASUREMENT
/begin MEASUREMENT Com_RxAccessInfo[132].BusAccOfRxAccessInfo "" UBYTE Com_BusAccOfRxAccessInfoType 0 0 0 255 ECU_ADDRESS 0x0 /end MEASUREMENT
/begin MEASUREMENT Com_RxAccessInfo[132].ByteLengthOfRxAccessInfo "" UBYTE NO_COMPU_METHOD 0 0 0 255 ECU_ADDRESS 0x0 /end MEASUREMENT
/begin MEASUREMENT Com_RxAccessInfo[132].ConstValueArrayBasedInitValueEndIdxOfRxAccessInfo "" UBYTE Com_ConstValueArrayBasedInitValueEndIdxOfRxAccessInfoType 0 0 0 255 ECU_ADDRESS 0x0 /end MEASUREMENT
/begin MEASUREMENT Com_RxAccessInfo[132].ConstValueArrayBasedInitValueStartIdxOfRxAccessInfo "" UBYTE Com_ConstValueArrayBasedInitValueStartIdxOfRxAccessInfoType 0 0 0 255 ECU_ADDRESS 0x0 /end MEASUREMENT
/begin MEASUREMENT Com_RxAccessInfo[132].DynSignalOfRxAccessInfo "" UBYTE Com_DynSignalOfRxAccessInfoType 0 0 0 1 ECU_ADDRESS 0x0 /end MEASUREMENT
/begin MEASUREMENT Com_RxAccessInfo[132].InitValueIdxOfRxAccessInfo "" UBYTE Com_InitValueIdxOfRxAccessInfoType 0 0 0 255 ECU_ADDRESS 0x0 /end MEASUREMENT
/begin MEASUREMENT Com_RxAccessInfo[132].InitValueOfRxAccessInfo "" UBYTE Com_InitValueOfRxAccessInfoType 0 0 0 255 ECU_ADDRESS 0x0 /end MEASUREMENT
/begin MEASUREMENT Com_RxAccessInfo[132].InvValueIdxOfRxAccessInfo "" UBYTE Com_InvValueIdxOfRxAccessInfoType 0 0 0 255 ECU_ADDRESS 0x0 /end MEASUREMENT
/begin MEASUREMENT Com_RxAccessInfo[132].InvValueOfRxAccessInfo "" UBYTE Com_InvValueOfRxAccessInfoType 0 0 0 255 ECU_ADDRESS 0x0 /end MEASUREMENT
/begin MEASUREMENT Com_RxAccessInfo[132].IsGroupSignalOfRxAccessInfo "" UBYTE Com_IsGroupSignalOfRxAccessInfoType 0 0 0 1 ECU_ADDRESS 0x0 /end MEASUREMENT
/begin MEASUREMENT Com_RxAccessInfo[132].RxDataTimeoutSubstitutionValueIdxOfRxAccessInfo "" UBYTE Com_RxDataTimeoutSubstitutionValueIdxOfRxAccessInfoType 0 0 0 255 ECU_ADDRESS 0x0 /end MEASUREMENT
/begin MEASUREMENT Com_RxAccessInfo[132].RxDataTimeoutSubstitutionValueOfRxAccessInfo "" UBYTE Com_RxDataTimeoutSubstitutionValueOfRxAccessInfoType 0 0 0 255 ECU_ADDRESS 0x0 /end MEASUREMENT
/begin MEASUREMENT Com_RxAccessInfo[132].RxPduInfoIdxOfRxAccessInfo "" UBYTE NO_COMPU_METHOD 0 0 0 255 ECU_ADDRESS 0x0 /end MEASUREMENT
/begin MEASUREMENT Com_RxAccessInfo[132].RxSigBufferArrayBasedBufferEndIdxOfRxAccessInfo "" UBYTE Com_RxSigBufferArrayBasedBufferEndIdxOfRxAccessInfoType 0 0 0 255 ECU_ADDRESS 0x0 /end MEASUREMENT
/begin MEASUREMENT Com_RxAccessInfo[132].RxSigBufferArrayBasedBufferStartIdxOfRxAccessInfo "" UBYTE Com_RxSigBufferArrayBasedBufferStartIdxOfRxAccessInfoType 0 0 0 255 ECU_ADDRESS 0x0 /end MEASUREMENT
/begin MEASUREMENT Com_RxAccessInfo[132].RxSigBufferArrayBasedShdBufferEndIdxOfRxAccessInfo "" UBYTE Com_RxSigBufferArrayBasedShdBufferEndIdxOfRxAccessInfoType 0 0 0 255 ECU_ADDRESS 0x0 /end MEASUREMENT
/begin MEASUREMENT Com_RxAccessInfo[132].RxSigBufferArrayBasedShdBufferStartIdxOfRxAccessInfo "" UBYTE Com_RxSigBufferArrayBasedShdBufferStartIdxOfRxAccessInfoType 0 0 0 255 ECU_ADDRESS 0x0 /end MEASUREMENT
/begin MEASUREMENT Com_RxAccessInfo[132].RxTOutInfoIdxOfRxAccessInfo "" UBYTE Com_RxTOutInfoIdxOfRxAccessInfoType 0 0 0 255 ECU_ADDRESS 0x0 /end MEASUREMENT
/begin MEASUREMENT Com_RxAccessInfo[132].ShdBufferIdxOfRxAccessInfo "" UWORD Com_ShdBufferIdxOfRxAccessInfoType 0 0 0 65535 ECU_ADDRESS 0x0 /end MEASUREMENT
/begin MEASUREMENT Com_RxAccessInfo[132].SignalLengthInByteOfRxAccessInfo "" UBYTE NO_COMPU_METHOD 0 0 0 255 ECU_ADDRESS 0x0 /end MEASUREMENT
/begin MEASUREMENT Com_RxAccessInfo[132].StartByteInPduPositionOfRxAccessInfo "" UBYTE NO_COMPU_METHOD 0 0 0 255 ECU_ADDRESS 0x0 /end MEASUREMENT
/begin MEASUREMENT Com_RxAccessInfo[132].TmpBufferIdxOfRxAccessInfo "" UBYTE Com_TmpBufferIdxOfRxAccessInfoType 0 0 0 255 ECU_ADDRESS 0x0 /end MEASUREMENT
/begin MEASUREMENT Com_RxAccessInfo[132].TmpBufferOfRxAccessInfo "" UBYTE Com_TmpBufferOfRxAccessInfoType 0 0 0 255 ECU_ADDRESS 0x0 /end MEASUREMENT
/begin MEASUREMENT Com_RxAccessInfo[132].TmpRxShdBufferArrayBasedTmpBufferEndIdxOfRxAccessInfo "" UBYTE Com_TmpRxShdBufferArrayBasedTmpBufferEndIdxOfRxAccessInfoType 0 0 0 255 ECU_ADDRESS 0x0 /end MEASUREMENT
/begin MEASUREMENT Com_RxAccessInfo[132].TmpRxShdBufferArrayBasedTmpBufferStartIdxOfRxAccessInfo "" UBYTE Com_TmpRxShdBufferArrayBasedTmpBufferStartIdxOfRxAccessInfoType 0 0 0 255 ECU_ADDRESS 0x0 /end MEASUREMENT
/begin MEASUREMENT Com_RxAccessInfo[133].ApplTypeOfRxAccessInfo "" UBYTE Com_ApplTypeOfRxAccessInfoType 0 0 0 255 ECU_ADDRESS 0x0 /end MEASUREMENT
/begin MEASUREMENT Com_RxAccessInfo[133].BitLengthOfRxAccessInfo "" UWORD NO_COMPU_METHOD 0 0 0 65535 ECU_ADDRESS 0x0 /end MEASUREMENT
/begin MEASUREMENT Com_RxAccessInfo[133].BitPositionOfRxAccessInfo "" UWORD NO_COMPU_METHOD 0 0 0 65535 ECU_ADDRESS 0x0 /end MEASUREMENT
/begin MEASUREMENT Com_RxAccessInfo[133].BufferIdxOfRxAccessInfo "" UWORD Com_BufferIdxOfRxAccessInfoType 0 0 0 65535 ECU_ADDRESS 0x0 /end MEASUREMENT
/begin MEASUREMENT Com_RxAccessInfo[133].BusAccOfRxAccessInfo "" UBYTE Com_BusAccOfRxAccessInfoType 0 0 0 255 ECU_ADDRESS 0x0 /end MEASUREMENT
/begin MEASUREMENT Com_RxAccessInfo[133].ByteLengthOfRxAccessInfo "" UBYTE NO_COMPU_METHOD 0 0 0 255 ECU_ADDRESS 0x0 /end MEASUREMENT
/begin MEASUREMENT Com_RxAccessInfo[133].ConstValueArrayBasedInitValueEndIdxOfRxAccessInfo "" UBYTE Com_ConstValueArrayBasedInitValueEndIdxOfRxAccessInfoType 0 0 0 255 ECU_ADDRESS 0x0 /end MEASUREMENT
/begin MEASUREMENT Com_RxAccessInfo[133].ConstValueArrayBasedInitValueStartIdxOfRxAccessInfo "" UBYTE Com_ConstValueArrayBasedInitValueStartIdxOfRxAccessInfoType 0 0 0 255 ECU_ADDRESS 0x0 /end MEASUREMENT
/begin MEASUREMENT Com_RxAccessInfo[133].DynSignalOfRxAccessInfo "" UBYTE Com_DynSignalOfRxAccessInfoType 0 0 0 1 ECU_ADDRESS 0x0 /end MEASUREMENT
/begin MEASUREMENT Com_RxAccessInfo[133].InitValueIdxOfRxAccessInfo "" UBYTE Com_InitValueIdxOfRxAccessInfoType 0 0 0 255 ECU_ADDRESS 0x0 /end MEASUREMENT
/begin MEASUREMENT Com_RxAccessInfo[133].InitValueOfRxAccessInfo "" UBYTE Com_InitValueOfRxAccessInfoType 0 0 0 255 ECU_ADDRESS 0x0 /end MEASUREMENT
/begin MEASUREMENT Com_RxAccessInfo[133].InvValueIdxOfRxAccessInfo "" UBYTE Com_InvValueIdxOfRxAccessInfoType 0 0 0 255 ECU_ADDRESS 0x0 /end MEASUREMENT
/begin MEASUREMENT Com_RxAccessInfo[133].InvValueOfRxAccessInfo "" UBYTE Com_InvValueOfRxAccessInfoType 0 0 0 255 ECU_ADDRESS 0x0 /end MEASUREMENT
/begin MEASUREMENT Com_RxAccessInfo[133].IsGroupSignalOfRxAccessInfo "" UBYTE Com_IsGroupSignalOfRxAccessInfoType 0 0 0 1 ECU_ADDRESS 0x0 /end MEASUREMENT
/begin MEASUREMENT Com_RxAccessInfo[133].RxDataTimeoutSubstitutionValueIdxOfRxAccessInfo "" UBYTE Com_RxDataTimeoutSubstitutionValueIdxOfRxAccessInfoType 0 0 0 255 ECU_ADDRESS 0x0 /end MEASUREMENT
/begin MEASUREMENT Com_RxAccessInfo[133].RxDataTimeoutSubstitutionValueOfRxAccessInfo "" UBYTE Com_RxDataTimeoutSubstitutionValueOfRxAccessInfoType 0 0 0 255 ECU_ADDRESS 0x0 /end MEASUREMENT
/begin MEASUREMENT Com_RxAccessInfo[133].RxPduInfoIdxOfRxAccessInfo "" UBYTE NO_COMPU_METHOD 0 0 0 255 ECU_ADDRESS 0x0 /end MEASUREMENT
/begin MEASUREMENT Com_RxAccessInfo[133].RxSigBufferArrayBasedBufferEndIdxOfRxAccessInfo "" UBYTE Com_RxSigBufferArrayBasedBufferEndIdxOfRxAccessInfoType 0 0 0 255 ECU_ADDRESS 0x0 /end MEASUREMENT
/begin MEASUREMENT Com_RxAccessInfo[133].RxSigBufferArrayBasedBufferStartIdxOfRxAccessInfo "" UBYTE Com_RxSigBufferArrayBasedBufferStartIdxOfRxAccessInfoType 0 0 0 255 ECU_ADDRESS 0x0 /end MEASUREMENT
/begin MEASUREMENT Com_RxAccessInfo[133].RxSigBufferArrayBasedShdBufferEndIdxOfRxAccessInfo "" UBYTE Com_RxSigBufferArrayBasedShdBufferEndIdxOfRxAccessInfoType 0 0 0 255 ECU_ADDRESS 0x0 /end MEASUREMENT
/begin MEASUREMENT Com_RxAccessInfo[133].RxSigBufferArrayBasedShdBufferStartIdxOfRxAccessInfo "" UBYTE Com_RxSigBufferArrayBasedShdBufferStartIdxOfRxAccessInfoType 0 0 0 255 ECU_ADDRESS 0x0 /end MEASUREMENT
/begin MEASUREMENT Com_RxAccessInfo[133].RxTOutInfoIdxOfRxAccessInfo "" UBYTE Com_RxTOutInfoIdxOfRxAccessInfoType 0 0 0 255 ECU_ADDRESS 0x0 /end MEASUREMENT
/begin MEASUREMENT Com_RxAccessInfo[133].ShdBufferIdxOfRxAccessInfo "" UWORD Com_ShdBufferIdxOfRxAccessInfoType 0 0 0 65535 ECU_ADDRESS 0x0 /end MEASUREMENT
/begin MEASUREMENT Com_RxAccessInfo[133].SignalLengthInByteOfRxAccessInfo "" UBYTE NO_COMPU_METHOD 0 0 0 255 ECU_ADDRESS 0x0 /end MEASUREMENT
/begin MEASUREMENT Com_RxAccessInfo[133].StartByteInPduPositionOfRxAccessInfo "" UBYTE NO_COMPU_METHOD 0 0 0 255 ECU_ADDRESS 0x0 /end MEASUREMENT
/begin MEASUREMENT Com_RxAccessInfo[133].TmpBufferIdxOfRxAccessInfo "" UBYTE Com_TmpBufferIdxOfRxAccessInfoType 0 0 0 255 ECU_ADDRESS 0x0 /end MEASUREMENT
/begin MEASUREMENT Com_RxAccessInfo[133].TmpBufferOfRxAccessInfo "" UBYTE Com_TmpBufferOfRxAccessInfoType 0 0 0 255 ECU_ADDRESS 0x0 /end MEASUREMENT
/begin MEASUREMENT Com_RxAccessInfo[133].TmpRxShdBufferArrayBasedTmpBufferEndIdxOfRxAccessInfo "" UBYTE Com_TmpRxShdBufferArrayBasedTmpBufferEndIdxOfRxAccessInfoType 0 0 0 255 ECU_ADDRESS 0x0 /end MEASUREMENT
/begin MEASUREMENT Com_RxAccessInfo[133].TmpRxShdBufferArrayBasedTmpBufferStartIdxOfRxAccessInfo "" UBYTE Com_TmpRxShdBufferArrayBasedTmpBufferStartIdxOfRxAccessInfoType 0 0 0 255 ECU_ADDRESS 0x0 /end MEASUREMENT
/begin MEASUREMENT Com_RxAccessInfo[134].ApplTypeOfRxAccessInfo "" UBYTE Com_ApplTypeOfRxAccessInfoType 0 0 0 255 ECU_ADDRESS 0x0 /end MEASUREMENT
/begin MEASUREMENT Com_RxAccessInfo[134].BitLengthOfRxAccessInfo "" UWORD NO_COMPU_METHOD 0 0 0 65535 ECU_ADDRESS 0x0 /end MEASUREMENT
/begin MEASUREMENT Com_RxAccessInfo[134].BitPositionOfRxAccessInfo "" UWORD NO_COMPU_METHOD 0 0 0 65535 ECU_ADDRESS 0x0 /end MEASUREMENT
/begin MEASUREMENT Com_RxAccessInfo[134].BufferIdxOfRxAccessInfo "" UWORD Com_BufferIdxOfRxAccessInfoType 0 0 0 65535 ECU_ADDRESS 0x0 /end MEASUREMENT
/begin MEASUREMENT Com_RxAccessInfo[134].BusAccOfRxAccessInfo "" UBYTE Com_BusAccOfRxAccessInfoType 0 0 0 255 ECU_ADDRESS 0x0 /end MEASUREMENT
/begin MEASUREMENT Com_RxAccessInfo[134].ByteLengthOfRxAccessInfo "" UBYTE NO_COMPU_METHOD 0 0 0 255 ECU_ADDRESS 0x0 /end MEASUREMENT
/begin MEASUREMENT Com_RxAccessInfo[134].ConstValueArrayBasedInitValueEndIdxOfRxAccessInfo "" UBYTE Com_ConstValueArrayBasedInitValueEndIdxOfRxAccessInfoType 0 0 0 255 ECU_ADDRESS 0x0 /end MEASUREMENT
/begin MEASUREMENT Com_RxAccessInfo[134].ConstValueArrayBasedInitValueStartIdxOfRxAccessInfo "" UBYTE Com_ConstValueArrayBasedInitValueStartIdxOfRxAccessInfoType 0 0 0 255 ECU_ADDRESS 0x0 /end MEASUREMENT
/begin MEASUREMENT Com_RxAccessInfo[134].DynSignalOfRxAccessInfo "" UBYTE Com_DynSignalOfRxAccessInfoType 0 0 0 1 ECU_ADDRESS 0x0 /end MEASUREMENT
/begin MEASUREMENT Com_RxAccessInfo[134].InitValueIdxOfRxAccessInfo "" UBYTE Com_InitValueIdxOfRxAccessInfoType 0 0 0 255 ECU_ADDRESS 0x0 /end MEASUREMENT
/begin MEASUREMENT Com_RxAccessInfo[134].InitValueOfRxAccessInfo "" UBYTE Com_InitValueOfRxAccessInfoType 0 0 0 255 ECU_ADDRESS 0x0 /end MEASUREMENT
/begin MEASUREMENT Com_RxAccessInfo[134].InvValueIdxOfRxAccessInfo "" UBYTE Com_InvValueIdxOfRxAccessInfoType 0 0 0 255 ECU_ADDRESS 0x0 /end MEASUREMENT
/begin MEASUREMENT Com_RxAccessInfo[134].InvValueOfRxAccessInfo "" UBYTE Com_InvValueOfRxAccessInfoType 0 0 0 255 ECU_ADDRESS 0x0 /end MEASUREMENT
/begin MEASUREMENT Com_RxAccessInfo[134].IsGroupSignalOfRxAccessInfo "" UBYTE Com_IsGroupSignalOfRxAccessInfoType 0 0 0 1 ECU_ADDRESS 0x0 /end MEASUREMENT
/begin MEASUREMENT Com_RxAccessInfo[134].RxDataTimeoutSubstitutionValueIdxOfRxAccessInfo "" UBYTE Com_RxDataTimeoutSubstitutionValueIdxOfRxAccessInfoType 0 0 0 255 ECU_ADDRESS 0x0 /end MEASUREMENT
/begin MEASUREMENT Com_RxAccessInfo[134].RxDataTimeoutSubstitutionValueOfRxAccessInfo "" UBYTE Com_RxDataTimeoutSubstitutionValueOfRxAccessInfoType 0 0 0 255 ECU_ADDRESS 0x0 /end MEASUREMENT
/begin MEASUREMENT Com_RxAccessInfo[134].RxPduInfoIdxOfRxAccessInfo "" UBYTE NO_COMPU_METHOD 0 0 0 255 ECU_ADDRESS 0x0 /end MEASUREMENT
/begin MEASUREMENT Com_RxAccessInfo[134].RxSigBufferArrayBasedBufferEndIdxOfRxAccessInfo "" UBYTE Com_RxSigBufferArrayBasedBufferEndIdxOfRxAccessInfoType 0 0 0 255 ECU_ADDRESS 0x0 /end MEASUREMENT
/begin MEASUREMENT Com_RxAccessInfo[134].RxSigBufferArrayBasedBufferStartIdxOfRxAccessInfo "" UBYTE Com_RxSigBufferArrayBasedBufferStartIdxOfRxAccessInfoType 0 0 0 255 ECU_ADDRESS 0x0 /end MEASUREMENT
/begin MEASUREMENT Com_RxAccessInfo[134].RxSigBufferArrayBasedShdBufferEndIdxOfRxAccessInfo "" UBYTE Com_RxSigBufferArrayBasedShdBufferEndIdxOfRxAccessInfoType 0 0 0 255 ECU_ADDRESS 0x0 /end MEASUREMENT
/begin MEASUREMENT Com_RxAccessInfo[134].RxSigBufferArrayBasedShdBufferStartIdxOfRxAccessInfo "" UBYTE Com_RxSigBufferArrayBasedShdBufferStartIdxOfRxAccessInfoType 0 0 0 255 ECU_ADDRESS 0x0 /end MEASUREMENT
/begin MEASUREMENT Com_RxAccessInfo[134].RxTOutInfoIdxOfRxAccessInfo "" UBYTE Com_RxTOutInfoIdxOfRxAccessInfoType 0 0 0 255 ECU_ADDRESS 0x0 /end MEASUREMENT
/begin MEASUREMENT Com_RxAccessInfo[134].ShdBufferIdxOfRxAccessInfo "" UWORD Com_ShdBufferIdxOfRxAccessInfoType 0 0 0 65535 ECU_ADDRESS 0x0 /end MEASUREMENT
/begin MEASUREMENT Com_RxAccessInfo[134].SignalLengthInByteOfRxAccessInfo "" UBYTE NO_COMPU_METHOD 0 0 0 255 ECU_ADDRESS 0x0 /end MEASUREMENT
/begin MEASUREMENT Com_RxAccessInfo[134].StartByteInPduPositionOfRxAccessInfo "" UBYTE NO_COMPU_METHOD 0 0 0 255 ECU_ADDRESS 0x0 /end MEASUREMENT
/begin MEASUREMENT Com_RxAccessInfo[134].TmpBufferIdxOfRxAccessInfo "" UBYTE Com_TmpBufferIdxOfRxAccessInfoType 0 0 0 255 ECU_ADDRESS 0x0 /end MEASUREMENT
/begin MEASUREMENT Com_RxAccessInfo[134].TmpBufferOfRxAccessInfo "" UBYTE Com_TmpBufferOfRxAccessInfoType 0 0 0 255 ECU_ADDRESS 0x0 /end MEASUREMENT
/begin MEASUREMENT Com_RxAccessInfo[134].TmpRxShdBufferArrayBasedTmpBufferEndIdxOfRxAccessInfo "" UBYTE Com_TmpRxShdBufferArrayBasedTmpBufferEndIdxOfRxAccessInfoType 0 0 0 255 ECU_ADDRESS 0x0 /end MEASUREMENT
/begin MEASUREMENT Com_RxAccessInfo[134].TmpRxShdBufferArrayBasedTmpBufferStartIdxOfRxAccessInfo "" UBYTE Com_TmpRxShdBufferArrayBasedTmpBufferStartIdxOfRxAccessInfoType 0 0 0 255 ECU_ADDRESS 0x0 /end MEASUREMENT
/begin MEASUREMENT Com_RxAccessInfo[135].ApplTypeOfRxAccessInfo "" UBYTE Com_ApplTypeOfRxAccessInfoType 0 0 0 255 ECU_ADDRESS 0x0 /end MEASUREMENT
/begin MEASUREMENT Com_RxAccessInfo[135].BitLengthOfRxAccessInfo "" UWORD NO_COMPU_METHOD 0 0 0 65535 ECU_ADDRESS 0x0 /end MEASUREMENT
/begin MEASUREMENT Com_RxAccessInfo[135].BitPositionOfRxAccessInfo "" UWORD NO_COMPU_METHOD 0 0 0 65535 ECU_ADDRESS 0x0 /end MEASUREMENT
/begin MEASUREMENT Com_RxAccessInfo[135].BufferIdxOfRxAccessInfo "" UWORD Com_BufferIdxOfRxAccessInfoType 0 0 0 65535 ECU_ADDRESS 0x0 /end MEASUREMENT
/begin MEASUREMENT Com_RxAccessInfo[135].BusAccOfRxAccessInfo "" UBYTE Com_BusAccOfRxAccessInfoType 0 0 0 255 ECU_ADDRESS 0x0 /end MEASUREMENT
/begin MEASUREMENT Com_RxAccessInfo[135].ByteLengthOfRxAccessInfo "" UBYTE NO_COMPU_METHOD 0 0 0 255 ECU_ADDRESS 0x0 /end MEASUREMENT
/begin MEASUREMENT Com_RxAccessInfo[135].ConstValueArrayBasedInitValueEndIdxOfRxAccessInfo "" UBYTE Com_ConstValueArrayBasedInitValueEndIdxOfRxAccessInfoType 0 0 0 255 ECU_ADDRESS 0x0 /end MEASUREMENT
/begin MEASUREMENT Com_RxAccessInfo[135].ConstValueArrayBasedInitValueStartIdxOfRxAccessInfo "" UBYTE Com_ConstValueArrayBasedInitValueStartIdxOfRxAccessInfoType 0 0 0 255 ECU_ADDRESS 0x0 /end MEASUREMENT
/begin MEASUREMENT Com_RxAccessInfo[135].DynSignalOfRxAccessInfo "" UBYTE Com_DynSignalOfRxAccessInfoType 0 0 0 1 ECU_ADDRESS 0x0 /end MEASUREMENT
/begin MEASUREMENT Com_RxAccessInfo[135].InitValueIdxOfRxAccessInfo "" UBYTE Com_InitValueIdxOfRxAccessInfoType 0 0 0 255 ECU_ADDRESS 0x0 /end MEASUREMENT
/begin MEASUREMENT Com_RxAccessInfo[135].InitValueOfRxAccessInfo "" UBYTE Com_InitValueOfRxAccessInfoType 0 0 0 255 ECU_ADDRESS 0x0 /end MEASUREMENT
/begin MEASUREMENT Com_RxAccessInfo[135].InvValueIdxOfRxAccessInfo "" UBYTE Com_InvValueIdxOfRxAccessInfoType 0 0 0 255 ECU_ADDRESS 0x0 /end MEASUREMENT
/begin MEASUREMENT Com_RxAccessInfo[135].InvValueOfRxAccessInfo "" UBYTE Com_InvValueOfRxAccessInfoType 0 0 0 255 ECU_ADDRESS 0x0 /end MEASUREMENT
/begin MEASUREMENT Com_RxAccessInfo[135].IsGroupSignalOfRxAccessInfo "" UBYTE Com_IsGroupSignalOfRxAccessInfoType 0 0 0 1 ECU_ADDRESS 0x0 /end MEASUREMENT
/begin MEASUREMENT Com_RxAccessInfo[135].RxDataTimeoutSubstitutionValueIdxOfRxAccessInfo "" UBYTE Com_RxDataTimeoutSubstitutionValueIdxOfRxAccessInfoType 0 0 0 255 ECU_ADDRESS 0x0 /end MEASUREMENT
/begin MEASUREMENT Com_RxAccessInfo[135].RxDataTimeoutSubstitutionValueOfRxAccessInfo "" UBYTE Com_RxDataTimeoutSubstitutionValueOfRxAccessInfoType 0 0 0 255 ECU_ADDRESS 0x0 /end MEASUREMENT
/begin MEASUREMENT Com_RxAccessInfo[135].RxPduInfoIdxOfRxAccessInfo "" UBYTE NO_COMPU_METHOD 0 0 0 255 ECU_ADDRESS 0x0 /end MEASUREMENT
/begin MEASUREMENT Com_RxAccessInfo[135].RxSigBufferArrayBasedBufferEndIdxOfRxAccessInfo "" UBYTE Com_RxSigBufferArrayBasedBufferEndIdxOfRxAccessInfoType 0 0 0 255 ECU_ADDRESS 0x0 /end MEASUREMENT
/begin MEASUREMENT Com_RxAccessInfo[135].RxSigBufferArrayBasedBufferStartIdxOfRxAccessInfo "" UBYTE Com_RxSigBufferArrayBasedBufferStartIdxOfRxAccessInfoType 0 0 0 255 ECU_ADDRESS 0x0 /end MEASUREMENT
/begin MEASUREMENT Com_RxAccessInfo[135].RxSigBufferArrayBasedShdBufferEndIdxOfRxAccessInfo "" UBYTE Com_RxSigBufferArrayBasedShdBufferEndIdxOfRxAccessInfoType 0 0 0 255 ECU_ADDRESS 0x0 /end MEASUREMENT
/begin MEASUREMENT Com_RxAccessInfo[135].RxSigBufferArrayBasedShdBufferStartIdxOfRxAccessInfo "" UBYTE Com_RxSigBufferArrayBasedShdBufferStartIdxOfRxAccessInfoType 0 0 0 255 ECU_ADDRESS 0x0 /end MEASUREMENT
/begin MEASUREMENT Com_RxAccessInfo[135].RxTOutInfoIdxOfRxAccessInfo "" UBYTE Com_RxTOutInfoIdxOfRxAccessInfoType 0 0 0 255 ECU_ADDRESS 0x0 /end MEASUREMENT
/begin MEASUREMENT Com_RxAccessInfo[135].ShdBufferIdxOfRxAccessInfo "" UWORD Com_ShdBufferIdxOfRxAccessInfoType 0 0 0 65535 ECU_ADDRESS 0x0 /end MEASUREMENT
/begin MEASUREMENT Com_RxAccessInfo[135].SignalLengthInByteOfRxAccessInfo "" UBYTE NO_COMPU_METHOD 0 0 0 255 ECU_ADDRESS 0x0 /end MEASUREMENT
/begin MEASUREMENT Com_RxAccessInfo[135].StartByteInPduPositionOfRxAccessInfo "" UBYTE NO_COMPU_METHOD 0 0 0 255 ECU_ADDRESS 0x0 /end MEASUREMENT
/begin MEASUREMENT Com_RxAccessInfo[135].TmpBufferIdxOfRxAccessInfo "" UBYTE Com_TmpBufferIdxOfRxAccessInfoType 0 0 0 255 ECU_ADDRESS 0x0 /end MEASUREMENT
/begin MEASUREMENT Com_RxAccessInfo[135].TmpBufferOfRxAccessInfo "" UBYTE Com_TmpBufferOfRxAccessInfoType 0 0 0 255 ECU_ADDRESS 0x0 /end MEASUREMENT
/begin MEASUREMENT Com_RxAccessInfo[135].TmpRxShdBufferArrayBasedTmpBufferEndIdxOfRxAccessInfo "" UBYTE Com_TmpRxShdBufferArrayBasedTmpBufferEndIdxOfRxAccessInfoType 0 0 0 255 ECU_ADDRESS 0x0 /end MEASUREMENT
/begin MEASUREMENT Com_RxAccessInfo[135].TmpRxShdBufferArrayBasedTmpBufferStartIdxOfRxAccessInfo "" UBYTE Com_TmpRxShdBufferArrayBasedTmpBufferStartIdxOfRxAccessInfoType 0 0 0 255 ECU_ADDRESS 0x0 /end MEASUREMENT
/begin MEASUREMENT Com_RxAccessInfo[136].ApplTypeOfRxAccessInfo "" UBYTE Com_ApplTypeOfRxAccessInfoType 0 0 0 255 ECU_ADDRESS 0x0 /end MEASUREMENT
/begin MEASUREMENT Com_RxAccessInfo[136].BitLengthOfRxAccessInfo "" UWORD NO_COMPU_METHOD 0 0 0 65535 ECU_ADDRESS 0x0 /end MEASUREMENT
/begin MEASUREMENT Com_RxAccessInfo[136].BitPositionOfRxAccessInfo "" UWORD NO_COMPU_METHOD 0 0 0 65535 ECU_ADDRESS 0x0 /end MEASUREMENT
/begin MEASUREMENT Com_RxAccessInfo[136].BufferIdxOfRxAccessInfo "" UWORD Com_BufferIdxOfRxAccessInfoType 0 0 0 65535 ECU_ADDRESS 0x0 /end MEASUREMENT
/begin MEASUREMENT Com_RxAccessInfo[136].BusAccOfRxAccessInfo "" UBYTE Com_BusAccOfRxAccessInfoType 0 0 0 255 ECU_ADDRESS 0x0 /end MEASUREMENT
/begin MEASUREMENT Com_RxAccessInfo[136].ByteLengthOfRxAccessInfo "" UBYTE NO_COMPU_METHOD 0 0 0 255 ECU_ADDRESS 0x0 /end MEASUREMENT
/begin MEASUREMENT Com_RxAccessInfo[136].ConstValueArrayBasedInitValueEndIdxOfRxAccessInfo "" UBYTE Com_ConstValueArrayBasedInitValueEndIdxOfRxAccessInfoType 0 0 0 255 ECU_ADDRESS 0x0 /end MEASUREMENT
/begin MEASUREMENT Com_RxAccessInfo[136].ConstValueArrayBasedInitValueStartIdxOfRxAccessInfo "" UBYTE Com_ConstValueArrayBasedInitValueStartIdxOfRxAccessInfoType 0 0 0 255 ECU_ADDRESS 0x0 /end MEASUREMENT
/begin MEASUREMENT Com_RxAccessInfo[136].DynSignalOfRxAccessInfo "" UBYTE Com_DynSignalOfRxAccessInfoType 0 0 0 1 ECU_ADDRESS 0x0 /end MEASUREMENT
/begin MEASUREMENT Com_RxAccessInfo[136].InitValueIdxOfRxAccessInfo "" UBYTE Com_InitValueIdxOfRxAccessInfoType 0 0 0 255 ECU_ADDRESS 0x0 /end MEASUREMENT
/begin MEASUREMENT Com_RxAccessInfo[136].InitValueOfRxAccessInfo "" UBYTE Com_InitValueOfRxAccessInfoType 0 0 0 255 ECU_ADDRESS 0x0 /end MEASUREMENT
/begin MEASUREMENT Com_RxAccessInfo[136].InvValueIdxOfRxAccessInfo "" UBYTE Com_InvValueIdxOfRxAccessInfoType 0 0 0 255 ECU_ADDRESS 0x0 /end MEASUREMENT
/begin MEASUREMENT Com_RxAccessInfo[136].InvValueOfRxAccessInfo "" UBYTE Com_InvValueOfRxAccessInfoType 0 0 0 255 ECU_ADDRESS 0x0 /end MEASUREMENT
/begin MEASUREMENT Com_RxAccessInfo[136].IsGroupSignalOfRxAccessInfo "" UBYTE Com_IsGroupSignalOfRxAccessInfoType 0 0 0 1 ECU_ADDRESS 0x0 /end MEASUREMENT
/begin MEASUREMENT Com_RxAccessInfo[136].RxDataTimeoutSubstitutionValueIdxOfRxAccessInfo "" UBYTE Com_RxDataTimeoutSubstitutionValueIdxOfRxAccessInfoType 0 0 0 255 ECU_ADDRESS 0x0 /end MEASUREMENT
/begin MEASUREMENT Com_RxAccessInfo[136].RxDataTimeoutSubstitutionValueOfRxAccessInfo "" UBYTE Com_RxDataTimeoutSubstitutionValueOfRxAccessInfoType 0 0 0 255 ECU_ADDRESS 0x0 /end MEASUREMENT
/begin MEASUREMENT Com_RxAccessInfo[136].RxPduInfoIdxOfRxAccessInfo "" UBYTE NO_COMPU_METHOD 0 0 0 255 ECU_ADDRESS 0x0 /end MEASUREMENT
/begin MEASUREMENT Com_RxAccessInfo[136].RxSigBufferArrayBasedBufferEndIdxOfRxAccessInfo "" UBYTE Com_RxSigBufferArrayBasedBufferEndIdxOfRxAccessInfoType 0 0 0 255 ECU_ADDRESS 0x0 /end MEASUREMENT
/begin MEASUREMENT Com_RxAccessInfo[136].RxSigBufferArrayBasedBufferStartIdxOfRxAccessInfo "" UBYTE Com_RxSigBufferArrayBasedBufferStartIdxOfRxAccessInfoType 0 0 0 255 ECU_ADDRESS 0x0 /end MEASUREMENT
/begin MEASUREMENT Com_RxAccessInfo[136].RxSigBufferArrayBasedShdBufferEndIdxOfRxAccessInfo "" UBYTE Com_RxSigBufferArrayBasedShdBufferEndIdxOfRxAccessInfoType 0 0 0 255 ECU_ADDRESS 0x0 /end MEASUREMENT
/begin MEASUREMENT Com_RxAccessInfo[136].RxSigBufferArrayBasedShdBufferStartIdxOfRxAccessInfo "" UBYTE Com_RxSigBufferArrayBasedShdBufferStartIdxOfRxAccessInfoType 0 0 0 255 ECU_ADDRESS 0x0 /end MEASUREMENT
/begin MEASUREMENT Com_RxAccessInfo[136].RxTOutInfoIdxOfRxAccessInfo "" UBYTE Com_RxTOutInfoIdxOfRxAccessInfoType 0 0 0 255 ECU_ADDRESS 0x0 /end MEASUREMENT
/begin MEASUREMENT Com_RxAccessInfo[136].ShdBufferIdxOfRxAccessInfo "" UWORD Com_ShdBufferIdxOfRxAccessInfoType 0 0 0 65535 ECU_ADDRESS 0x0 /end MEASUREMENT
/begin MEASUREMENT Com_RxAccessInfo[136].SignalLengthInByteOfRxAccessInfo "" UBYTE NO_COMPU_METHOD 0 0 0 255 ECU_ADDRESS 0x0 /end MEASUREMENT
/begin MEASUREMENT Com_RxAccessInfo[136].StartByteInPduPositionOfRxAccessInfo "" UBYTE NO_COMPU_METHOD 0 0 0 255 ECU_ADDRESS 0x0 /end MEASUREMENT
/begin MEASUREMENT Com_RxAccessInfo[136].TmpBufferIdxOfRxAccessInfo "" UBYTE Com_TmpBufferIdxOfRxAccessInfoType 0 0 0 255 ECU_ADDRESS 0x0 /end MEASUREMENT
/begin MEASUREMENT Com_RxAccessInfo[136].TmpBufferOfRxAccessInfo "" UBYTE Com_TmpBufferOfRxAccessInfoType 0 0 0 255 ECU_ADDRESS 0x0 /end MEASUREMENT
/begin MEASUREMENT Com_RxAccessInfo[136].TmpRxShdBufferArrayBasedTmpBufferEndIdxOfRxAccessInfo "" UBYTE Com_TmpRxShdBufferArrayBasedTmpBufferEndIdxOfRxAccessInfoType 0 0 0 255 ECU_ADDRESS 0x0 /end MEASUREMENT
/begin MEASUREMENT Com_RxAccessInfo[136].TmpRxShdBufferArrayBasedTmpBufferStartIdxOfRxAccessInfo "" UBYTE Com_TmpRxShdBufferArrayBasedTmpBufferStartIdxOfRxAccessInfoType 0 0 0 255 ECU_ADDRESS 0x0 /end MEASUREMENT
/begin MEASUREMENT Com_RxAccessInfo[137].ApplTypeOfRxAccessInfo "" UBYTE Com_ApplTypeOfRxAccessInfoType 0 0 0 255 ECU_ADDRESS 0x0 /end MEASUREMENT
/begin MEASUREMENT Com_RxAccessInfo[137].BitLengthOfRxAccessInfo "" UWORD NO_COMPU_METHOD 0 0 0 65535 ECU_ADDRESS 0x0 /end MEASUREMENT
/begin MEASUREMENT Com_RxAccessInfo[137].BitPositionOfRxAccessInfo "" UWORD NO_COMPU_METHOD 0 0 0 65535 ECU_ADDRESS 0x0 /end MEASUREMENT
/begin MEASUREMENT Com_RxAccessInfo[137].BufferIdxOfRxAccessInfo "" UWORD Com_BufferIdxOfRxAccessInfoType 0 0 0 65535 ECU_ADDRESS 0x0 /end MEASUREMENT
/begin MEASUREMENT Com_RxAccessInfo[137].BusAccOfRxAccessInfo "" UBYTE Com_BusAccOfRxAccessInfoType 0 0 0 255 ECU_ADDRESS 0x0 /end MEASUREMENT
/begin MEASUREMENT Com_RxAccessInfo[137].ByteLengthOfRxAccessInfo "" UBYTE NO_COMPU_METHOD 0 0 0 255 ECU_ADDRESS 0x0 /end MEASUREMENT
/begin MEASUREMENT Com_RxAccessInfo[137].ConstValueArrayBasedInitValueEndIdxOfRxAccessInfo "" UBYTE Com_ConstValueArrayBasedInitValueEndIdxOfRxAccessInfoType 0 0 0 255 ECU_ADDRESS 0x0 /end MEASUREMENT
/begin MEASUREMENT Com_RxAccessInfo[137].ConstValueArrayBasedInitValueStartIdxOfRxAccessInfo "" UBYTE Com_ConstValueArrayBasedInitValueStartIdxOfRxAccessInfoType 0 0 0 255 ECU_ADDRESS 0x0 /end MEASUREMENT
/begin MEASUREMENT Com_RxAccessInfo[137].DynSignalOfRxAccessInfo "" UBYTE Com_DynSignalOfRxAccessInfoType 0 0 0 1 ECU_ADDRESS 0x0 /end MEASUREMENT
/begin MEASUREMENT Com_RxAccessInfo[137].InitValueIdxOfRxAccessInfo "" UBYTE Com_InitValueIdxOfRxAccessInfoType 0 0 0 255 ECU_ADDRESS 0x0 /end MEASUREMENT
/begin MEASUREMENT Com_RxAccessInfo[137].InitValueOfRxAccessInfo "" UBYTE Com_InitValueOfRxAccessInfoType 0 0 0 255 ECU_ADDRESS 0x0 /end MEASUREMENT
/begin MEASUREMENT Com_RxAccessInfo[137].InvValueIdxOfRxAccessInfo "" UBYTE Com_InvValueIdxOfRxAccessInfoType 0 0 0 255 ECU_ADDRESS 0x0 /end MEASUREMENT
/begin MEASUREMENT Com_RxAccessInfo[137].InvValueOfRxAccessInfo "" UBYTE Com_InvValueOfRxAccessInfoType 0 0 0 255 ECU_ADDRESS 0x0 /end MEASUREMENT
/begin MEASUREMENT Com_RxAccessInfo[137].IsGroupSignalOfRxAccessInfo "" UBYTE Com_IsGroupSignalOfRxAccessInfoType 0 0 0 1 ECU_ADDRESS 0x0 /end MEASUREMENT
/begin MEASUREMENT Com_RxAccessInfo[137].RxDataTimeoutSubstitutionValueIdxOfRxAccessInfo "" UBYTE Com_RxDataTimeoutSubstitutionValueIdxOfRxAccessInfoType 0 0 0 255 ECU_ADDRESS 0x0 /end MEASUREMENT
/begin MEASUREMENT Com_RxAccessInfo[137].RxDataTimeoutSubstitutionValueOfRxAccessInfo "" UBYTE Com_RxDataTimeoutSubstitutionValueOfRxAccessInfoType 0 0 0 255 ECU_ADDRESS 0x0 /end MEASUREMENT
/begin MEASUREMENT Com_RxAccessInfo[137].RxPduInfoIdxOfRxAccessInfo "" UBYTE NO_COMPU_METHOD 0 0 0 255 ECU_ADDRESS 0x0 /end MEASUREMENT
/begin MEASUREMENT Com_RxAccessInfo[137].RxSigBufferArrayBasedBufferEndIdxOfRxAccessInfo "" UBYTE Com_RxSigBufferArrayBasedBufferEndIdxOfRxAccessInfoType 0 0 0 255 ECU_ADDRESS 0x0 /end MEASUREMENT
/begin MEASUREMENT Com_RxAccessInfo[137].RxSigBufferArrayBasedBufferStartIdxOfRxAccessInfo "" UBYTE Com_RxSigBufferArrayBasedBufferStartIdxOfRxAccessInfoType 0 0 0 255 ECU_ADDRESS 0x0 /end MEASUREMENT
/begin MEASUREMENT Com_RxAccessInfo[137].RxSigBufferArrayBasedShdBufferEndIdxOfRxAccessInfo "" UBYTE Com_RxSigBufferArrayBasedShdBufferEndIdxOfRxAccessInfoType 0 0 0 255 ECU_ADDRESS 0x0 /end MEASUREMENT
/begin MEASUREMENT Com_RxAccessInfo[137].RxSigBufferArrayBasedShdBufferStartIdxOfRxAccessInfo "" UBYTE Com_RxSigBufferArrayBasedShdBufferStartIdxOfRxAccessInfoType 0 0 0 255 ECU_ADDRESS 0x0 /end MEASUREMENT
/begin MEASUREMENT Com_RxAccessInfo[137].RxTOutInfoIdxOfRxAccessInfo "" UBYTE Com_RxTOutInfoIdxOfRxAccessInfoType 0 0 0 255 ECU_ADDRESS 0x0 /end MEASUREMENT
/begin MEASUREMENT Com_RxAccessInfo[137].ShdBufferIdxOfRxAccessInfo "" UWORD Com_ShdBufferIdxOfRxAccessInfoType 0 0 0 65535 ECU_ADDRESS 0x0 /end MEASUREMENT
/begin MEASUREMENT Com_RxAccessInfo[137].SignalLengthInByteOfRxAccessInfo "" UBYTE NO_COMPU_METHOD 0 0 0 255 ECU_ADDRESS 0x0 /end MEASUREMENT
/begin MEASUREMENT Com_RxAccessInfo[137].StartByteInPduPositionOfRxAccessInfo "" UBYTE NO_COMPU_METHOD 0 0 0 255 ECU_ADDRESS 0x0 /end MEASUREMENT
/begin MEASUREMENT Com_RxAccessInfo[137].TmpBufferIdxOfRxAccessInfo "" UBYTE Com_TmpBufferIdxOfRxAccessInfoType 0 0 0 255 ECU_ADDRESS 0x0 /end MEASUREMENT
/begin MEASUREMENT Com_RxAccessInfo[137].TmpBufferOfRxAccessInfo "" UBYTE Com_TmpBufferOfRxAccessInfoType 0 0 0 255 ECU_ADDRESS 0x0 /end MEASUREMENT
/begin MEASUREMENT Com_RxAccessInfo[137].TmpRxShdBufferArrayBasedTmpBufferEndIdxOfRxAccessInfo "" UBYTE Com_TmpRxShdBufferArrayBasedTmpBufferEndIdxOfRxAccessInfoType 0 0 0 255 ECU_ADDRESS 0x0 /end MEASUREMENT
/begin MEASUREMENT Com_RxAccessInfo[137].TmpRxShdBufferArrayBasedTmpBufferStartIdxOfRxAccessInfo "" UBYTE Com_TmpRxShdBufferArrayBasedTmpBufferStartIdxOfRxAccessInfoType 0 0 0 255 ECU_ADDRESS 0x0 /end MEASUREMENT
/begin MEASUREMENT Com_RxAccessInfo[138].ApplTypeOfRxAccessInfo "" UBYTE Com_ApplTypeOfRxAccessInfoType 0 0 0 255 ECU_ADDRESS 0x0 /end MEASUREMENT
/begin MEASUREMENT Com_RxAccessInfo[138].BitLengthOfRxAccessInfo "" UWORD NO_COMPU_METHOD 0 0 0 65535 ECU_ADDRESS 0x0 /end MEASUREMENT
/begin MEASUREMENT Com_RxAccessInfo[138].BitPositionOfRxAccessInfo "" UWORD NO_COMPU_METHOD 0 0 0 65535 ECU_ADDRESS 0x0 /end MEASUREMENT
/begin MEASUREMENT Com_RxAccessInfo[138].BufferIdxOfRxAccessInfo "" UWORD Com_BufferIdxOfRxAccessInfoType 0 0 0 65535 ECU_ADDRESS 0x0 /end MEASUREMENT
/begin MEASUREMENT Com_RxAccessInfo[138].BusAccOfRxAccessInfo "" UBYTE Com_BusAccOfRxAccessInfoType 0 0 0 255 ECU_ADDRESS 0x0 /end MEASUREMENT
/begin MEASUREMENT Com_RxAccessInfo[138].ByteLengthOfRxAccessInfo "" UBYTE NO_COMPU_METHOD 0 0 0 255 ECU_ADDRESS 0x0 /end MEASUREMENT
/begin MEASUREMENT Com_RxAccessInfo[138].ConstValueArrayBasedInitValueEndIdxOfRxAccessInfo "" UBYTE Com_ConstValueArrayBasedInitValueEndIdxOfRxAccessInfoType 0 0 0 255 ECU_ADDRESS 0x0 /end MEASUREMENT
/begin MEASUREMENT Com_RxAccessInfo[138].ConstValueArrayBasedInitValueStartIdxOfRxAccessInfo "" UBYTE Com_ConstValueArrayBasedInitValueStartIdxOfRxAccessInfoType 0 0 0 255 ECU_ADDRESS 0x0 /end MEASUREMENT
/begin MEASUREMENT Com_RxAccessInfo[138].DynSignalOfRxAccessInfo "" UBYTE Com_DynSignalOfRxAccessInfoType 0 0 0 1 ECU_ADDRESS 0x0 /end MEASUREMENT
/begin MEASUREMENT Com_RxAccessInfo[138].InitValueIdxOfRxAccessInfo "" UBYTE Com_InitValueIdxOfRxAccessInfoType 0 0 0 255 ECU_ADDRESS 0x0 /end MEASUREMENT
/begin MEASUREMENT Com_RxAccessInfo[138].InitValueOfRxAccessInfo "" UBYTE Com_InitValueOfRxAccessInfoType 0 0 0 255 ECU_ADDRESS 0x0 /end MEASUREMENT
/begin MEASUREMENT Com_RxAccessInfo[138].InvValueIdxOfRxAccessInfo "" UBYTE Com_InvValueIdxOfRxAccessInfoType 0 0 0 255 ECU_ADDRESS 0x0 /end MEASUREMENT
/begin MEASUREMENT Com_RxAccessInfo[138].InvValueOfRxAccessInfo "" UBYTE Com_InvValueOfRxAccessInfoType 0 0 0 255 ECU_ADDRESS 0x0 /end MEASUREMENT
/begin MEASUREMENT Com_RxAccessInfo[138].IsGroupSignalOfRxAccessInfo "" UBYTE Com_IsGroupSignalOfRxAccessInfoType 0 0 0 1 ECU_ADDRESS 0x0 /end MEASUREMENT
/begin MEASUREMENT Com_RxAccessInfo[138].RxDataTimeoutSubstitutionValueIdxOfRxAccessInfo "" UBYTE Com_RxDataTimeoutSubstitutionValueIdxOfRxAccessInfoType 0 0 0 255 ECU_ADDRESS 0x0 /end MEASUREMENT
/begin MEASUREMENT Com_RxAccessInfo[138].RxDataTimeoutSubstitutionValueOfRxAccessInfo "" UBYTE Com_RxDataTimeoutSubstitutionValueOfRxAccessInfoType 0 0 0 255 ECU_ADDRESS 0x0 /end MEASUREMENT
/begin MEASUREMENT Com_RxAccessInfo[138].RxPduInfoIdxOfRxAccessInfo "" UBYTE NO_COMPU_METHOD 0 0 0 255 ECU_ADDRESS 0x0 /end MEASUREMENT
/begin MEASUREMENT Com_RxAccessInfo[138].RxSigBufferArrayBasedBufferEndIdxOfRxAccessInfo "" UBYTE Com_RxSigBufferArrayBasedBufferEndIdxOfRxAccessInfoType 0 0 0 255 ECU_ADDRESS 0x0 /end MEASUREMENT
/begin MEASUREMENT Com_RxAccessInfo[138].RxSigBufferArrayBasedBufferStartIdxOfRxAccessInfo "" UBYTE Com_RxSigBufferArrayBasedBufferStartIdxOfRxAccessInfoType 0 0 0 255 ECU_ADDRESS 0x0 /end MEASUREMENT
/begin MEASUREMENT Com_RxAccessInfo[138].RxSigBufferArrayBasedShdBufferEndIdxOfRxAccessInfo "" UBYTE Com_RxSigBufferArrayBasedShdBufferEndIdxOfRxAccessInfoType 0 0 0 255 ECU_ADDRESS 0x0 /end MEASUREMENT
/begin MEASUREMENT Com_RxAccessInfo[138].RxSigBufferArrayBasedShdBufferStartIdxOfRxAccessInfo "" UBYTE Com_RxSigBufferArrayBasedShdBufferStartIdxOfRxAccessInfoType 0 0 0 255 ECU_ADDRESS 0x0 /end MEASUREMENT
/begin MEASUREMENT Com_RxAccessInfo[138].RxTOutInfoIdxOfRxAccessInfo "" UBYTE Com_RxTOutInfoIdxOfRxAccessInfoType 0 0 0 255 ECU_ADDRESS 0x0 /end MEASUREMENT
/begin MEASUREMENT Com_RxAccessInfo[138].ShdBufferIdxOfRxAccessInfo "" UWORD Com_ShdBufferIdxOfRxAccessInfoType 0 0 0 65535 ECU_ADDRESS 0x0 /end MEASUREMENT
/begin MEASUREMENT Com_RxAccessInfo[138].SignalLengthInByteOfRxAccessInfo "" UBYTE NO_COMPU_METHOD 0 0 0 255 ECU_ADDRESS 0x0 /end MEASUREMENT
/begin MEASUREMENT Com_RxAccessInfo[138].StartByteInPduPositionOfRxAccessInfo "" UBYTE NO_COMPU_METHOD 0 0 0 255 ECU_ADDRESS 0x0 /end MEASUREMENT
/begin MEASUREMENT Com_RxAccessInfo[138].TmpBufferIdxOfRxAccessInfo "" UBYTE Com_TmpBufferIdxOfRxAccessInfoType 0 0 0 255 ECU_ADDRESS 0x0 /end MEASUREMENT
/begin MEASUREMENT Com_RxAccessInfo[138].TmpBufferOfRxAccessInfo "" UBYTE Com_TmpBufferOfRxAccessInfoType 0 0 0 255 ECU_ADDRESS 0x0 /end MEASUREMENT
/begin MEASUREMENT Com_RxAccessInfo[138].TmpRxShdBufferArrayBasedTmpBufferEndIdxOfRxAccessInfo "" UBYTE Com_TmpRxShdBufferArrayBasedTmpBufferEndIdxOfRxAccessInfoType 0 0 0 255 ECU_ADDRESS 0x0 /end MEASUREMENT
/begin MEASUREMENT Com_RxAccessInfo[138].TmpRxShdBufferArrayBasedTmpBufferStartIdxOfRxAccessInfo "" UBYTE Com_TmpRxShdBufferArrayBasedTmpBufferStartIdxOfRxAccessInfoType 0 0 0 255 ECU_ADDRESS 0x0 /end MEASUREMENT
/begin MEASUREMENT Com_RxAccessInfo[139].ApplTypeOfRxAccessInfo "" UBYTE Com_ApplTypeOfRxAccessInfoType 0 0 0 255 ECU_ADDRESS 0x0 /end MEASUREMENT
/begin MEASUREMENT Com_RxAccessInfo[139].BitLengthOfRxAccessInfo "" UWORD NO_COMPU_METHOD 0 0 0 65535 ECU_ADDRESS 0x0 /end MEASUREMENT
/begin MEASUREMENT Com_RxAccessInfo[139].BitPositionOfRxAccessInfo "" UWORD NO_COMPU_METHOD 0 0 0 65535 ECU_ADDRESS 0x0 /end MEASUREMENT
/begin MEASUREMENT Com_RxAccessInfo[139].BufferIdxOfRxAccessInfo "" UWORD Com_BufferIdxOfRxAccessInfoType 0 0 0 65535 ECU_ADDRESS 0x0 /end MEASUREMENT
/begin MEASUREMENT Com_RxAccessInfo[139].BusAccOfRxAccessInfo "" UBYTE Com_BusAccOfRxAccessInfoType 0 0 0 255 ECU_ADDRESS 0x0 /end MEASUREMENT
/begin MEASUREMENT Com_RxAccessInfo[139].ByteLengthOfRxAccessInfo "" UBYTE NO_COMPU_METHOD 0 0 0 255 ECU_ADDRESS 0x0 /end MEASUREMENT
/begin MEASUREMENT Com_RxAccessInfo[139].ConstValueArrayBasedInitValueEndIdxOfRxAccessInfo "" UBYTE Com_ConstValueArrayBasedInitValueEndIdxOfRxAccessInfoType 0 0 0 255 ECU_ADDRESS 0x0 /end MEASUREMENT
/begin MEASUREMENT Com_RxAccessInfo[139].ConstValueArrayBasedInitValueStartIdxOfRxAccessInfo "" UBYTE Com_ConstValueArrayBasedInitValueStartIdxOfRxAccessInfoType 0 0 0 255 ECU_ADDRESS 0x0 /end MEASUREMENT
/begin MEASUREMENT Com_RxAccessInfo[139].DynSignalOfRxAccessInfo "" UBYTE Com_DynSignalOfRxAccessInfoType 0 0 0 1 ECU_ADDRESS 0x0 /end MEASUREMENT
/begin MEASUREMENT Com_RxAccessInfo[139].InitValueIdxOfRxAccessInfo "" UBYTE Com_InitValueIdxOfRxAccessInfoType 0 0 0 255 ECU_ADDRESS 0x0 /end MEASUREMENT
/begin MEASUREMENT Com_RxAccessInfo[139].InitValueOfRxAccessInfo "" UBYTE Com_InitValueOfRxAccessInfoType 0 0 0 255 ECU_ADDRESS 0x0 /end MEASUREMENT
/begin MEASUREMENT Com_RxAccessInfo[139].InvValueIdxOfRxAccessInfo "" UBYTE Com_InvValueIdxOfRxAccessInfoType 0 0 0 255 ECU_ADDRESS 0x0 /end MEASUREMENT
/begin MEASUREMENT Com_RxAccessInfo[139].InvValueOfRxAccessInfo "" UBYTE Com_InvValueOfRxAccessInfoType 0 0 0 255 ECU_ADDRESS 0x0 /end MEASUREMENT
/begin MEASUREMENT Com_RxAccessInfo[139].IsGroupSignalOfRxAccessInfo "" UBYTE Com_IsGroupSignalOfRxAccessInfoType 0 0 0 1 ECU_ADDRESS 0x0 /end MEASUREMENT
/begin MEASUREMENT Com_RxAccessInfo[139].RxDataTimeoutSubstitutionValueIdxOfRxAccessInfo "" UBYTE Com_RxDataTimeoutSubstitutionValueIdxOfRxAccessInfoType 0 0 0 255 ECU_ADDRESS 0x0 /end MEASUREMENT
/begin MEASUREMENT Com_RxAccessInfo[139].RxDataTimeoutSubstitutionValueOfRxAccessInfo "" UBYTE Com_RxDataTimeoutSubstitutionValueOfRxAccessInfoType 0 0 0 255 ECU_ADDRESS 0x0 /end MEASUREMENT
/begin MEASUREMENT Com_RxAccessInfo[139].RxPduInfoIdxOfRxAccessInfo "" UBYTE NO_COMPU_METHOD 0 0 0 255 ECU_ADDRESS 0x0 /end MEASUREMENT
/begin MEASUREMENT Com_RxAccessInfo[139].RxSigBufferArrayBasedBufferEndIdxOfRxAccessInfo "" UBYTE Com_RxSigBufferArrayBasedBufferEndIdxOfRxAccessInfoType 0 0 0 255 ECU_ADDRESS 0x0 /end MEASUREMENT
/begin MEASUREMENT Com_RxAccessInfo[139].RxSigBufferArrayBasedBufferStartIdxOfRxAccessInfo "" UBYTE Com_RxSigBufferArrayBasedBufferStartIdxOfRxAccessInfoType 0 0 0 255 ECU_ADDRESS 0x0 /end MEASUREMENT
/begin MEASUREMENT Com_RxAccessInfo[139].RxSigBufferArrayBasedShdBufferEndIdxOfRxAccessInfo "" UBYTE Com_RxSigBufferArrayBasedShdBufferEndIdxOfRxAccessInfoType 0 0 0 255 ECU_ADDRESS 0x0 /end MEASUREMENT
/begin MEASUREMENT Com_RxAccessInfo[139].RxSigBufferArrayBasedShdBufferStartIdxOfRxAccessInfo "" UBYTE Com_RxSigBufferArrayBasedShdBufferStartIdxOfRxAccessInfoType 0 0 0 255 ECU_ADDRESS 0x0 /end MEASUREMENT
/begin MEASUREMENT Com_RxAccessInfo[139].RxTOutInfoIdxOfRxAccessInfo "" UBYTE Com_RxTOutInfoIdxOfRxAccessInfoType 0 0 0 255 ECU_ADDRESS 0x0 /end MEASUREMENT
/begin MEASUREMENT Com_RxAccessInfo[139].ShdBufferIdxOfRxAccessInfo "" UWORD Com_ShdBufferIdxOfRxAccessInfoType 0 0 0 65535 ECU_ADDRESS 0x0 /end MEASUREMENT
/begin MEASUREMENT Com_RxAccessInfo[139].SignalLengthInByteOfRxAccessInfo "" UBYTE NO_COMPU_METHOD 0 0 0 255 ECU_ADDRESS 0x0 /end MEASUREMENT
/begin MEASUREMENT Com_RxAccessInfo[139].StartByteInPduPositionOfRxAccessInfo "" UBYTE NO_COMPU_METHOD 0 0 0 255 ECU_ADDRESS 0x0 /end MEASUREMENT
/begin MEASUREMENT Com_RxAccessInfo[139].TmpBufferIdxOfRxAccessInfo "" UBYTE Com_TmpBufferIdxOfRxAccessInfoType 0 0 0 255 ECU_ADDRESS 0x0 /end MEASUREMENT
/begin MEASUREMENT Com_RxAccessInfo[139].TmpBufferOfRxAccessInfo "" UBYTE Com_TmpBufferOfRxAccessInfoType 0 0 0 255 ECU_ADDRESS 0x0 /end MEASUREMENT
/begin MEASUREMENT Com_RxAccessInfo[139].TmpRxShdBufferArrayBasedTmpBufferEndIdxOfRxAccessInfo "" UBYTE Com_TmpRxShdBufferArrayBasedTmpBufferEndIdxOfRxAccessInfoType 0 0 0 255 ECU_ADDRESS 0x0 /end MEASUREMENT
/begin MEASUREMENT Com_RxAccessInfo[139].TmpRxShdBufferArrayBasedTmpBufferStartIdxOfRxAccessInfo "" UBYTE Com_TmpRxShdBufferArrayBasedTmpBufferStartIdxOfRxAccessInfoType 0 0 0 255 ECU_ADDRESS 0x0 /end MEASUREMENT
/begin MEASUREMENT Com_RxAccessInfo[13].ApplTypeOfRxAccessInfo "" UBYTE Com_ApplTypeOfRxAccessInfoType 0 0 0 255 ECU_ADDRESS 0x0 /end MEASUREMENT
/begin MEASUREMENT Com_RxAccessInfo[13].BitLengthOfRxAccessInfo "" UWORD NO_COMPU_METHOD 0 0 0 65535 ECU_ADDRESS 0x0 /end MEASUREMENT
/begin MEASUREMENT Com_RxAccessInfo[13].BitPositionOfRxAccessInfo "" UWORD NO_COMPU_METHOD 0 0 0 65535 ECU_ADDRESS 0x0 /end MEASUREMENT
/begin MEASUREMENT Com_RxAccessInfo[13].BufferIdxOfRxAccessInfo "" UWORD Com_BufferIdxOfRxAccessInfoType 0 0 0 65535 ECU_ADDRESS 0x0 /end MEASUREMENT
/begin MEASUREMENT Com_RxAccessInfo[13].BusAccOfRxAccessInfo "" UBYTE Com_BusAccOfRxAccessInfoType 0 0 0 255 ECU_ADDRESS 0x0 /end MEASUREMENT
/begin MEASUREMENT Com_RxAccessInfo[13].ByteLengthOfRxAccessInfo "" UBYTE NO_COMPU_METHOD 0 0 0 255 ECU_ADDRESS 0x0 /end MEASUREMENT
/begin MEASUREMENT Com_RxAccessInfo[13].ConstValueArrayBasedInitValueEndIdxOfRxAccessInfo "" UBYTE Com_ConstValueArrayBasedInitValueEndIdxOfRxAccessInfoType 0 0 0 255 ECU_ADDRESS 0x0 /end MEASUREMENT
/begin MEASUREMENT Com_RxAccessInfo[13].ConstValueArrayBasedInitValueStartIdxOfRxAccessInfo "" UBYTE Com_ConstValueArrayBasedInitValueStartIdxOfRxAccessInfoType 0 0 0 255 ECU_ADDRESS 0x0 /end MEASUREMENT
/begin MEASUREMENT Com_RxAccessInfo[13].DynSignalOfRxAccessInfo "" UBYTE Com_DynSignalOfRxAccessInfoType 0 0 0 1 ECU_ADDRESS 0x0 /end MEASUREMENT
/begin MEASUREMENT Com_RxAccessInfo[13].InitValueIdxOfRxAccessInfo "" UBYTE Com_InitValueIdxOfRxAccessInfoType 0 0 0 255 ECU_ADDRESS 0x0 /end MEASUREMENT
/begin MEASUREMENT Com_RxAccessInfo[13].InitValueOfRxAccessInfo "" UBYTE Com_InitValueOfRxAccessInfoType 0 0 0 255 ECU_ADDRESS 0x0 /end MEASUREMENT
/begin MEASUREMENT Com_RxAccessInfo[13].InvValueIdxOfRxAccessInfo "" UBYTE Com_InvValueIdxOfRxAccessInfoType 0 0 0 255 ECU_ADDRESS 0x0 /end MEASUREMENT
/begin MEASUREMENT Com_RxAccessInfo[13].InvValueOfRxAccessInfo "" UBYTE Com_InvValueOfRxAccessInfoType 0 0 0 255 ECU_ADDRESS 0x0 /end MEASUREMENT
/begin MEASUREMENT Com_RxAccessInfo[13].IsGroupSignalOfRxAccessInfo "" UBYTE Com_IsGroupSignalOfRxAccessInfoType 0 0 0 1 ECU_ADDRESS 0x0 /end MEASUREMENT
/begin MEASUREMENT Com_RxAccessInfo[13].RxDataTimeoutSubstitutionValueIdxOfRxAccessInfo "" UBYTE Com_RxDataTimeoutSubstitutionValueIdxOfRxAccessInfoType 0 0 0 255 ECU_ADDRESS 0x0 /end MEASUREMENT
/begin MEASUREMENT Com_RxAccessInfo[13].RxDataTimeoutSubstitutionValueOfRxAccessInfo "" UBYTE Com_RxDataTimeoutSubstitutionValueOfRxAccessInfoType 0 0 0 255 ECU_ADDRESS 0x0 /end MEASUREMENT
/begin MEASUREMENT Com_RxAccessInfo[13].RxPduInfoIdxOfRxAccessInfo "" UBYTE NO_COMPU_METHOD 0 0 0 255 ECU_ADDRESS 0x0 /end MEASUREMENT
/begin MEASUREMENT Com_RxAccessInfo[13].RxSigBufferArrayBasedBufferEndIdxOfRxAccessInfo "" UBYTE Com_RxSigBufferArrayBasedBufferEndIdxOfRxAccessInfoType 0 0 0 255 ECU_ADDRESS 0x0 /end MEASUREMENT
/begin MEASUREMENT Com_RxAccessInfo[13].RxSigBufferArrayBasedBufferStartIdxOfRxAccessInfo "" UBYTE Com_RxSigBufferArrayBasedBufferStartIdxOfRxAccessInfoType 0 0 0 255 ECU_ADDRESS 0x0 /end MEASUREMENT
/begin MEASUREMENT Com_RxAccessInfo[13].RxSigBufferArrayBasedShdBufferEndIdxOfRxAccessInfo "" UBYTE Com_RxSigBufferArrayBasedShdBufferEndIdxOfRxAccessInfoType 0 0 0 255 ECU_ADDRESS 0x0 /end MEASUREMENT
/begin MEASUREMENT Com_RxAccessInfo[13].RxSigBufferArrayBasedShdBufferStartIdxOfRxAccessInfo "" UBYTE Com_RxSigBufferArrayBasedShdBufferStartIdxOfRxAccessInfoType 0 0 0 255 ECU_ADDRESS 0x0 /end MEASUREMENT
/begin MEASUREMENT Com_RxAccessInfo[13].RxTOutInfoIdxOfRxAccessInfo "" UBYTE Com_RxTOutInfoIdxOfRxAccessInfoType 0 0 0 255 ECU_ADDRESS 0x0 /end MEASUREMENT
/begin MEASUREMENT Com_RxAccessInfo[13].ShdBufferIdxOfRxAccessInfo "" UWORD Com_ShdBufferIdxOfRxAccessInfoType 0 0 0 65535 ECU_ADDRESS 0x0 /end MEASUREMENT
/begin MEASUREMENT Com_RxAccessInfo[13].SignalLengthInByteOfRxAccessInfo "" UBYTE NO_COMPU_METHOD 0 0 0 255 ECU_ADDRESS 0x0 /end MEASUREMENT
/begin MEASUREMENT Com_RxAccessInfo[13].StartByteInPduPositionOfRxAccessInfo "" UBYTE NO_COMPU_METHOD 0 0 0 255 ECU_ADDRESS 0x0 /end MEASUREMENT
/begin MEASUREMENT Com_RxAccessInfo[13].TmpBufferIdxOfRxAccessInfo "" UBYTE Com_TmpBufferIdxOfRxAccessInfoType 0 0 0 255 ECU_ADDRESS 0x0 /end MEASUREMENT
/begin MEASUREMENT Com_RxAccessInfo[13].TmpBufferOfRxAccessInfo "" UBYTE Com_TmpBufferOfRxAccessInfoType 0 0 0 255 ECU_ADDRESS 0x0 /end MEASUREMENT
/begin MEASUREMENT Com_RxAccessInfo[13].TmpRxShdBufferArrayBasedTmpBufferEndIdxOfRxAccessInfo "" UBYTE Com_TmpRxShdBufferArrayBasedTmpBufferEndIdxOfRxAccessInfoType 0 0 0 255 ECU_ADDRESS 0x0 /end MEASUREMENT
/begin MEASUREMENT Com_RxAccessInfo[13].TmpRxShdBufferArrayBasedTmpBufferStartIdxOfRxAccessInfo "" UBYTE Com_TmpRxShdBufferArrayBasedTmpBufferStartIdxOfRxAccessInfoType 0 0 0 255 ECU_ADDRESS 0x0 /end MEASUREMENT
/begin MEASUREMENT Com_RxAccessInfo[140].ApplTypeOfRxAccessInfo "" UBYTE Com_ApplTypeOfRxAccessInfoType 0 0 0 255 ECU_ADDRESS 0x0 /end MEASUREMENT
/begin MEASUREMENT Com_RxAccessInfo[140].BitLengthOfRxAccessInfo "" UWORD NO_COMPU_METHOD 0 0 0 65535 ECU_ADDRESS 0x0 /end MEASUREMENT
/begin MEASUREMENT Com_RxAccessInfo[140].BitPositionOfRxAccessInfo "" UWORD NO_COMPU_METHOD 0 0 0 65535 ECU_ADDRESS 0x0 /end MEASUREMENT
/begin MEASUREMENT Com_RxAccessInfo[140].BufferIdxOfRxAccessInfo "" UWORD Com_BufferIdxOfRxAccessInfoType 0 0 0 65535 ECU_ADDRESS 0x0 /end MEASUREMENT
/begin MEASUREMENT Com_RxAccessInfo[140].BusAccOfRxAccessInfo "" UBYTE Com_BusAccOfRxAccessInfoType 0 0 0 255 ECU_ADDRESS 0x0 /end MEASUREMENT
/begin MEASUREMENT Com_RxAccessInfo[140].ByteLengthOfRxAccessInfo "" UBYTE NO_COMPU_METHOD 0 0 0 255 ECU_ADDRESS 0x0 /end MEASUREMENT
/begin MEASUREMENT Com_RxAccessInfo[140].ConstValueArrayBasedInitValueEndIdxOfRxAccessInfo "" UBYTE Com_ConstValueArrayBasedInitValueEndIdxOfRxAccessInfoType 0 0 0 255 ECU_ADDRESS 0x0 /end MEASUREMENT
/begin MEASUREMENT Com_RxAccessInfo[140].ConstValueArrayBasedInitValueStartIdxOfRxAccessInfo "" UBYTE Com_ConstValueArrayBasedInitValueStartIdxOfRxAccessInfoType 0 0 0 255 ECU_ADDRESS 0x0 /end MEASUREMENT
/begin MEASUREMENT Com_RxAccessInfo[140].DynSignalOfRxAccessInfo "" UBYTE Com_DynSignalOfRxAccessInfoType 0 0 0 1 ECU_ADDRESS 0x0 /end MEASUREMENT
/begin MEASUREMENT Com_RxAccessInfo[140].InitValueIdxOfRxAccessInfo "" UBYTE Com_InitValueIdxOfRxAccessInfoType 0 0 0 255 ECU_ADDRESS 0x0 /end MEASUREMENT
/begin MEASUREMENT Com_RxAccessInfo[140].InitValueOfRxAccessInfo "" UBYTE Com_InitValueOfRxAccessInfoType 0 0 0 255 ECU_ADDRESS 0x0 /end MEASUREMENT
/begin MEASUREMENT Com_RxAccessInfo[140].InvValueIdxOfRxAccessInfo "" UBYTE Com_InvValueIdxOfRxAccessInfoType 0 0 0 255 ECU_ADDRESS 0x0 /end MEASUREMENT
/begin MEASUREMENT Com_RxAccessInfo[140].InvValueOfRxAccessInfo "" UBYTE Com_InvValueOfRxAccessInfoType 0 0 0 255 ECU_ADDRESS 0x0 /end MEASUREMENT
/begin MEASUREMENT Com_RxAccessInfo[140].IsGroupSignalOfRxAccessInfo "" UBYTE Com_IsGroupSignalOfRxAccessInfoType 0 0 0 1 ECU_ADDRESS 0x0 /end MEASUREMENT
/begin MEASUREMENT Com_RxAccessInfo[140].RxDataTimeoutSubstitutionValueIdxOfRxAccessInfo "" UBYTE Com_RxDataTimeoutSubstitutionValueIdxOfRxAccessInfoType 0 0 0 255 ECU_ADDRESS 0x0 /end MEASUREMENT
/begin MEASUREMENT Com_RxAccessInfo[140].RxDataTimeoutSubstitutionValueOfRxAccessInfo "" UBYTE Com_RxDataTimeoutSubstitutionValueOfRxAccessInfoType 0 0 0 255 ECU_ADDRESS 0x0 /end MEASUREMENT
/begin MEASUREMENT Com_RxAccessInfo[140].RxPduInfoIdxOfRxAccessInfo "" UBYTE NO_COMPU_METHOD 0 0 0 255 ECU_ADDRESS 0x0 /end MEASUREMENT
/begin MEASUREMENT Com_RxAccessInfo[140].RxSigBufferArrayBasedBufferEndIdxOfRxAccessInfo "" UBYTE Com_RxSigBufferArrayBasedBufferEndIdxOfRxAccessInfoType 0 0 0 255 ECU_ADDRESS 0x0 /end MEASUREMENT
/begin MEASUREMENT Com_RxAccessInfo[140].RxSigBufferArrayBasedBufferStartIdxOfRxAccessInfo "" UBYTE Com_RxSigBufferArrayBasedBufferStartIdxOfRxAccessInfoType 0 0 0 255 ECU_ADDRESS 0x0 /end MEASUREMENT
/begin MEASUREMENT Com_RxAccessInfo[140].RxSigBufferArrayBasedShdBufferEndIdxOfRxAccessInfo "" UBYTE Com_RxSigBufferArrayBasedShdBufferEndIdxOfRxAccessInfoType 0 0 0 255 ECU_ADDRESS 0x0 /end MEASUREMENT
/begin MEASUREMENT Com_RxAccessInfo[140].RxSigBufferArrayBasedShdBufferStartIdxOfRxAccessInfo "" UBYTE Com_RxSigBufferArrayBasedShdBufferStartIdxOfRxAccessInfoType 0 0 0 255 ECU_ADDRESS 0x0 /end MEASUREMENT
/begin MEASUREMENT Com_RxAccessInfo[140].RxTOutInfoIdxOfRxAccessInfo "" UBYTE Com_RxTOutInfoIdxOfRxAccessInfoType 0 0 0 255 ECU_ADDRESS 0x0 /end MEASUREMENT
/begin MEASUREMENT Com_RxAccessInfo[140].ShdBufferIdxOfRxAccessInfo "" UWORD Com_ShdBufferIdxOfRxAccessInfoType 0 0 0 65535 ECU_ADDRESS 0x0 /end MEASUREMENT
/begin MEASUREMENT Com_RxAccessInfo[140].SignalLengthInByteOfRxAccessInfo "" UBYTE NO_COMPU_METHOD 0 0 0 255 ECU_ADDRESS 0x0 /end MEASUREMENT
/begin MEASUREMENT Com_RxAccessInfo[140].StartByteInPduPositionOfRxAccessInfo "" UBYTE NO_COMPU_METHOD 0 0 0 255 ECU_ADDRESS 0x0 /end MEASUREMENT
/begin MEASUREMENT Com_RxAccessInfo[140].TmpBufferIdxOfRxAccessInfo "" UBYTE Com_TmpBufferIdxOfRxAccessInfoType 0 0 0 255 ECU_ADDRESS 0x0 /end MEASUREMENT
/begin MEASUREMENT Com_RxAccessInfo[140].TmpBufferOfRxAccessInfo "" UBYTE Com_TmpBufferOfRxAccessInfoType 0 0 0 255 ECU_ADDRESS 0x0 /end MEASUREMENT
/begin MEASUREMENT Com_RxAccessInfo[140].TmpRxShdBufferArrayBasedTmpBufferEndIdxOfRxAccessInfo "" UBYTE Com_TmpRxShdBufferArrayBasedTmpBufferEndIdxOfRxAccessInfoType 0 0 0 255 ECU_ADDRESS 0x0 /end MEASUREMENT
/begin MEASUREMENT Com_RxAccessInfo[140].TmpRxShdBufferArrayBasedTmpBufferStartIdxOfRxAccessInfo "" UBYTE Com_TmpRxShdBufferArrayBasedTmpBufferStartIdxOfRxAccessInfoType 0 0 0 255 ECU_ADDRESS 0x0 /end MEASUREMENT
/begin MEASUREMENT Com_RxAccessInfo[141].ApplTypeOfRxAccessInfo "" UBYTE Com_ApplTypeOfRxAccessInfoType 0 0 0 255 ECU_ADDRESS 0x0 /end MEASUREMENT
/begin MEASUREMENT Com_RxAccessInfo[141].BitLengthOfRxAccessInfo "" UWORD NO_COMPU_METHOD 0 0 0 65535 ECU_ADDRESS 0x0 /end MEASUREMENT
/begin MEASUREMENT Com_RxAccessInfo[141].BitPositionOfRxAccessInfo "" UWORD NO_COMPU_METHOD 0 0 0 65535 ECU_ADDRESS 0x0 /end MEASUREMENT
/begin MEASUREMENT Com_RxAccessInfo[141].BufferIdxOfRxAccessInfo "" UWORD Com_BufferIdxOfRxAccessInfoType 0 0 0 65535 ECU_ADDRESS 0x0 /end MEASUREMENT
/begin MEASUREMENT Com_RxAccessInfo[141].BusAccOfRxAccessInfo "" UBYTE Com_BusAccOfRxAccessInfoType 0 0 0 255 ECU_ADDRESS 0x0 /end MEASUREMENT
/begin MEASUREMENT Com_RxAccessInfo[141].ByteLengthOfRxAccessInfo "" UBYTE NO_COMPU_METHOD 0 0 0 255 ECU_ADDRESS 0x0 /end MEASUREMENT
/begin MEASUREMENT Com_RxAccessInfo[141].ConstValueArrayBasedInitValueEndIdxOfRxAccessInfo "" UBYTE Com_ConstValueArrayBasedInitValueEndIdxOfRxAccessInfoType 0 0 0 255 ECU_ADDRESS 0x0 /end MEASUREMENT
/begin MEASUREMENT Com_RxAccessInfo[141].ConstValueArrayBasedInitValueStartIdxOfRxAccessInfo "" UBYTE Com_ConstValueArrayBasedInitValueStartIdxOfRxAccessInfoType 0 0 0 255 ECU_ADDRESS 0x0 /end MEASUREMENT
/begin MEASUREMENT Com_RxAccessInfo[141].DynSignalOfRxAccessInfo "" UBYTE Com_DynSignalOfRxAccessInfoType 0 0 0 1 ECU_ADDRESS 0x0 /end MEASUREMENT
/begin MEASUREMENT Com_RxAccessInfo[141].InitValueIdxOfRxAccessInfo "" UBYTE Com_InitValueIdxOfRxAccessInfoType 0 0 0 255 ECU_ADDRESS 0x0 /end MEASUREMENT
/begin MEASUREMENT Com_RxAccessInfo[141].InitValueOfRxAccessInfo "" UBYTE Com_InitValueOfRxAccessInfoType 0 0 0 255 ECU_ADDRESS 0x0 /end MEASUREMENT
/begin MEASUREMENT Com_RxAccessInfo[141].InvValueIdxOfRxAccessInfo "" UBYTE Com_InvValueIdxOfRxAccessInfoType 0 0 0 255 ECU_ADDRESS 0x0 /end MEASUREMENT
/begin MEASUREMENT Com_RxAccessInfo[141].InvValueOfRxAccessInfo "" UBYTE Com_InvValueOfRxAccessInfoType 0 0 0 255 ECU_ADDRESS 0x0 /end MEASUREMENT
/begin MEASUREMENT Com_RxAccessInfo[141].IsGroupSignalOfRxAccessInfo "" UBYTE Com_IsGroupSignalOfRxAccessInfoType 0 0 0 1 ECU_ADDRESS 0x0 /end MEASUREMENT
/begin MEASUREMENT Com_RxAccessInfo[141].RxDataTimeoutSubstitutionValueIdxOfRxAccessInfo "" UBYTE Com_RxDataTimeoutSubstitutionValueIdxOfRxAccessInfoType 0 0 0 255 ECU_ADDRESS 0x0 /end MEASUREMENT
/begin MEASUREMENT Com_RxAccessInfo[141].RxDataTimeoutSubstitutionValueOfRxAccessInfo "" UBYTE Com_RxDataTimeoutSubstitutionValueOfRxAccessInfoType 0 0 0 255 ECU_ADDRESS 0x0 /end MEASUREMENT
/begin MEASUREMENT Com_RxAccessInfo[141].RxPduInfoIdxOfRxAccessInfo "" UBYTE NO_COMPU_METHOD 0 0 0 255 ECU_ADDRESS 0x0 /end MEASUREMENT
/begin MEASUREMENT Com_RxAccessInfo[141].RxSigBufferArrayBasedBufferEndIdxOfRxAccessInfo "" UBYTE Com_RxSigBufferArrayBasedBufferEndIdxOfRxAccessInfoType 0 0 0 255 ECU_ADDRESS 0x0 /end MEASUREMENT
/begin MEASUREMENT Com_RxAccessInfo[141].RxSigBufferArrayBasedBufferStartIdxOfRxAccessInfo "" UBYTE Com_RxSigBufferArrayBasedBufferStartIdxOfRxAccessInfoType 0 0 0 255 ECU_ADDRESS 0x0 /end MEASUREMENT
/begin MEASUREMENT Com_RxAccessInfo[141].RxSigBufferArrayBasedShdBufferEndIdxOfRxAccessInfo "" UBYTE Com_RxSigBufferArrayBasedShdBufferEndIdxOfRxAccessInfoType 0 0 0 255 ECU_ADDRESS 0x0 /end MEASUREMENT
/begin MEASUREMENT Com_RxAccessInfo[141].RxSigBufferArrayBasedShdBufferStartIdxOfRxAccessInfo "" UBYTE Com_RxSigBufferArrayBasedShdBufferStartIdxOfRxAccessInfoType 0 0 0 255 ECU_ADDRESS 0x0 /end MEASUREMENT
/begin MEASUREMENT Com_RxAccessInfo[141].RxTOutInfoIdxOfRxAccessInfo "" UBYTE Com_RxTOutInfoIdxOfRxAccessInfoType 0 0 0 255 ECU_ADDRESS 0x0 /end MEASUREMENT
/begin MEASUREMENT Com_RxAccessInfo[141].ShdBufferIdxOfRxAccessInfo "" UWORD Com_ShdBufferIdxOfRxAccessInfoType 0 0 0 65535 ECU_ADDRESS 0x0 /end MEASUREMENT
/begin MEASUREMENT Com_RxAccessInfo[141].SignalLengthInByteOfRxAccessInfo "" UBYTE NO_COMPU_METHOD 0 0 0 255 ECU_ADDRESS 0x0 /end MEASUREMENT
/begin MEASUREMENT Com_RxAccessInfo[141].StartByteInPduPositionOfRxAccessInfo "" UBYTE NO_COMPU_METHOD 0 0 0 255 ECU_ADDRESS 0x0 /end MEASUREMENT
/begin MEASUREMENT Com_RxAccessInfo[141].TmpBufferIdxOfRxAccessInfo "" UBYTE Com_TmpBufferIdxOfRxAccessInfoType 0 0 0 255 ECU_ADDRESS 0x0 /end MEASUREMENT
/begin MEASUREMENT Com_RxAccessInfo[141].TmpBufferOfRxAccessInfo "" UBYTE Com_TmpBufferOfRxAccessInfoType 0 0 0 255 ECU_ADDRESS 0x0 /end MEASUREMENT
/begin MEASUREMENT Com_RxAccessInfo[141].TmpRxShdBufferArrayBasedTmpBufferEndIdxOfRxAccessInfo "" UBYTE Com_TmpRxShdBufferArrayBasedTmpBufferEndIdxOfRxAccessInfoType 0 0 0 255 ECU_ADDRESS 0x0 /end MEASUREMENT
/begin MEASUREMENT Com_RxAccessInfo[141].TmpRxShdBufferArrayBasedTmpBufferStartIdxOfRxAccessInfo "" UBYTE Com_TmpRxShdBufferArrayBasedTmpBufferStartIdxOfRxAccessInfoType 0 0 0 255 ECU_ADDRESS 0x0 /end MEASUREMENT
/begin MEASUREMENT Com_RxAccessInfo[142].ApplTypeOfRxAccessInfo "" UBYTE Com_ApplTypeOfRxAccessInfoType 0 0 0 255 ECU_ADDRESS 0x0 /end MEASUREMENT
/begin MEASUREMENT Com_RxAccessInfo[142].BitLengthOfRxAccessInfo "" UWORD NO_COMPU_METHOD 0 0 0 65535 ECU_ADDRESS 0x0 /end MEASUREMENT
/begin MEASUREMENT Com_RxAccessInfo[142].BitPositionOfRxAccessInfo "" UWORD NO_COMPU_METHOD 0 0 0 65535 ECU_ADDRESS 0x0 /end MEASUREMENT
/begin MEASUREMENT Com_RxAccessInfo[142].BufferIdxOfRxAccessInfo "" UWORD Com_BufferIdxOfRxAccessInfoType 0 0 0 65535 ECU_ADDRESS 0x0 /end MEASUREMENT
/begin MEASUREMENT Com_RxAccessInfo[142].BusAccOfRxAccessInfo "" UBYTE Com_BusAccOfRxAccessInfoType 0 0 0 255 ECU_ADDRESS 0x0 /end MEASUREMENT
/begin MEASUREMENT Com_RxAccessInfo[142].ByteLengthOfRxAccessInfo "" UBYTE NO_COMPU_METHOD 0 0 0 255 ECU_ADDRESS 0x0 /end MEASUREMENT
/begin MEASUREMENT Com_RxAccessInfo[142].ConstValueArrayBasedInitValueEndIdxOfRxAccessInfo "" UBYTE Com_ConstValueArrayBasedInitValueEndIdxOfRxAccessInfoType 0 0 0 255 ECU_ADDRESS 0x0 /end MEASUREMENT
/begin MEASUREMENT Com_RxAccessInfo[142].ConstValueArrayBasedInitValueStartIdxOfRxAccessInfo "" UBYTE Com_ConstValueArrayBasedInitValueStartIdxOfRxAccessInfoType 0 0 0 255 ECU_ADDRESS 0x0 /end MEASUREMENT
/begin MEASUREMENT Com_RxAccessInfo[142].DynSignalOfRxAccessInfo "" UBYTE Com_DynSignalOfRxAccessInfoType 0 0 0 1 ECU_ADDRESS 0x0 /end MEASUREMENT
/begin MEASUREMENT Com_RxAccessInfo[142].InitValueIdxOfRxAccessInfo "" UBYTE Com_InitValueIdxOfRxAccessInfoType 0 0 0 255 ECU_ADDRESS 0x0 /end MEASUREMENT
/begin MEASUREMENT Com_RxAccessInfo[142].InitValueOfRxAccessInfo "" UBYTE Com_InitValueOfRxAccessInfoType 0 0 0 255 ECU_ADDRESS 0x0 /end MEASUREMENT
/begin MEASUREMENT Com_RxAccessInfo[142].InvValueIdxOfRxAccessInfo "" UBYTE Com_InvValueIdxOfRxAccessInfoType 0 0 0 255 ECU_ADDRESS 0x0 /end MEASUREMENT
/begin MEASUREMENT Com_RxAccessInfo[142].InvValueOfRxAccessInfo "" UBYTE Com_InvValueOfRxAccessInfoType 0 0 0 255 ECU_ADDRESS 0x0 /end MEASUREMENT
/begin MEASUREMENT Com_RxAccessInfo[142].IsGroupSignalOfRxAccessInfo "" UBYTE Com_IsGroupSignalOfRxAccessInfoType 0 0 0 1 ECU_ADDRESS 0x0 /end MEASUREMENT
/begin MEASUREMENT Com_RxAccessInfo[142].RxDataTimeoutSubstitutionValueIdxOfRxAccessInfo "" UBYTE Com_RxDataTimeoutSubstitutionValueIdxOfRxAccessInfoType 0 0 0 255 ECU_ADDRESS 0x0 /end MEASUREMENT
/begin MEASUREMENT Com_RxAccessInfo[142].RxDataTimeoutSubstitutionValueOfRxAccessInfo "" UBYTE Com_RxDataTimeoutSubstitutionValueOfRxAccessInfoType 0 0 0 255 ECU_ADDRESS 0x0 /end MEASUREMENT
/begin MEASUREMENT Com_RxAccessInfo[142].RxPduInfoIdxOfRxAccessInfo "" UBYTE NO_COMPU_METHOD 0 0 0 255 ECU_ADDRESS 0x0 /end MEASUREMENT
/begin MEASUREMENT Com_RxAccessInfo[142].RxSigBufferArrayBasedBufferEndIdxOfRxAccessInfo "" UBYTE Com_RxSigBufferArrayBasedBufferEndIdxOfRxAccessInfoType 0 0 0 255 ECU_ADDRESS 0x0 /end MEASUREMENT
/begin MEASUREMENT Com_RxAccessInfo[142].RxSigBufferArrayBasedBufferStartIdxOfRxAccessInfo "" UBYTE Com_RxSigBufferArrayBasedBufferStartIdxOfRxAccessInfoType 0 0 0 255 ECU_ADDRESS 0x0 /end MEASUREMENT
/begin MEASUREMENT Com_RxAccessInfo[142].RxSigBufferArrayBasedShdBufferEndIdxOfRxAccessInfo "" UBYTE Com_RxSigBufferArrayBasedShdBufferEndIdxOfRxAccessInfoType 0 0 0 255 ECU_ADDRESS 0x0 /end MEASUREMENT
/begin MEASUREMENT Com_RxAccessInfo[142].RxSigBufferArrayBasedShdBufferStartIdxOfRxAccessInfo "" UBYTE Com_RxSigBufferArrayBasedShdBufferStartIdxOfRxAccessInfoType 0 0 0 255 ECU_ADDRESS 0x0 /end MEASUREMENT
/begin MEASUREMENT Com_RxAccessInfo[142].RxTOutInfoIdxOfRxAccessInfo "" UBYTE Com_RxTOutInfoIdxOfRxAccessInfoType 0 0 0 255 ECU_ADDRESS 0x0 /end MEASUREMENT
/begin MEASUREMENT Com_RxAccessInfo[142].ShdBufferIdxOfRxAccessInfo "" UWORD Com_ShdBufferIdxOfRxAccessInfoType 0 0 0 65535 ECU_ADDRESS 0x0 /end MEASUREMENT
/begin MEASUREMENT Com_RxAccessInfo[142].SignalLengthInByteOfRxAccessInfo "" UBYTE NO_COMPU_METHOD 0 0 0 255 ECU_ADDRESS 0x0 /end MEASUREMENT
/begin MEASUREMENT Com_RxAccessInfo[142].StartByteInPduPositionOfRxAccessInfo "" UBYTE NO_COMPU_METHOD 0 0 0 255 ECU_ADDRESS 0x0 /end MEASUREMENT
/begin MEASUREMENT Com_RxAccessInfo[142].TmpBufferIdxOfRxAccessInfo "" UBYTE Com_TmpBufferIdxOfRxAccessInfoType 0 0 0 255 ECU_ADDRESS 0x0 /end MEASUREMENT
/begin MEASUREMENT Com_RxAccessInfo[142].TmpBufferOfRxAccessInfo "" UBYTE Com_TmpBufferOfRxAccessInfoType 0 0 0 255 ECU_ADDRESS 0x0 /end MEASUREMENT
/begin MEASUREMENT Com_RxAccessInfo[142].TmpRxShdBufferArrayBasedTmpBufferEndIdxOfRxAccessInfo "" UBYTE Com_TmpRxShdBufferArrayBasedTmpBufferEndIdxOfRxAccessInfoType 0 0 0 255 ECU_ADDRESS 0x0 /end MEASUREMENT
/begin MEASUREMENT Com_RxAccessInfo[142].TmpRxShdBufferArrayBasedTmpBufferStartIdxOfRxAccessInfo "" UBYTE Com_TmpRxShdBufferArrayBasedTmpBufferStartIdxOfRxAccessInfoType 0 0 0 255 ECU_ADDRESS 0x0 /end MEASUREMENT
/begin MEASUREMENT Com_RxAccessInfo[143].ApplTypeOfRxAccessInfo "" UBYTE Com_ApplTypeOfRxAccessInfoType 0 0 0 255 ECU_ADDRESS 0x0 /end MEASUREMENT
/begin MEASUREMENT Com_RxAccessInfo[143].BitLengthOfRxAccessInfo "" UWORD NO_COMPU_METHOD 0 0 0 65535 ECU_ADDRESS 0x0 /end MEASUREMENT
/begin MEASUREMENT Com_RxAccessInfo[143].BitPositionOfRxAccessInfo "" UWORD NO_COMPU_METHOD 0 0 0 65535 ECU_ADDRESS 0x0 /end MEASUREMENT
/begin MEASUREMENT Com_RxAccessInfo[143].BufferIdxOfRxAccessInfo "" UWORD Com_BufferIdxOfRxAccessInfoType 0 0 0 65535 ECU_ADDRESS 0x0 /end MEASUREMENT
/begin MEASUREMENT Com_RxAccessInfo[143].BusAccOfRxAccessInfo "" UBYTE Com_BusAccOfRxAccessInfoType 0 0 0 255 ECU_ADDRESS 0x0 /end MEASUREMENT
/begin MEASUREMENT Com_RxAccessInfo[143].ByteLengthOfRxAccessInfo "" UBYTE NO_COMPU_METHOD 0 0 0 255 ECU_ADDRESS 0x0 /end MEASUREMENT
/begin MEASUREMENT Com_RxAccessInfo[143].ConstValueArrayBasedInitValueEndIdxOfRxAccessInfo "" UBYTE Com_ConstValueArrayBasedInitValueEndIdxOfRxAccessInfoType 0 0 0 255 ECU_ADDRESS 0x0 /end MEASUREMENT
/begin MEASUREMENT Com_RxAccessInfo[143].ConstValueArrayBasedInitValueStartIdxOfRxAccessInfo "" UBYTE Com_ConstValueArrayBasedInitValueStartIdxOfRxAccessInfoType 0 0 0 255 ECU_ADDRESS 0x0 /end MEASUREMENT
/begin MEASUREMENT Com_RxAccessInfo[143].DynSignalOfRxAccessInfo "" UBYTE Com_DynSignalOfRxAccessInfoType 0 0 0 1 ECU_ADDRESS 0x0 /end MEASUREMENT
/begin MEASUREMENT Com_RxAccessInfo[143].InitValueIdxOfRxAccessInfo "" UBYTE Com_InitValueIdxOfRxAccessInfoType 0 0 0 255 ECU_ADDRESS 0x0 /end MEASUREMENT
/begin MEASUREMENT Com_RxAccessInfo[143].InitValueOfRxAccessInfo "" UBYTE Com_InitValueOfRxAccessInfoType 0 0 0 255 ECU_ADDRESS 0x0 /end MEASUREMENT
/begin MEASUREMENT Com_RxAccessInfo[143].InvValueIdxOfRxAccessInfo "" UBYTE Com_InvValueIdxOfRxAccessInfoType 0 0 0 255 ECU_ADDRESS 0x0 /end MEASUREMENT
/begin MEASUREMENT Com_RxAccessInfo[143].InvValueOfRxAccessInfo "" UBYTE Com_InvValueOfRxAccessInfoType 0 0 0 255 ECU_ADDRESS 0x0 /end MEASUREMENT
/begin MEASUREMENT Com_RxAccessInfo[143].IsGroupSignalOfRxAccessInfo "" UBYTE Com_IsGroupSignalOfRxAccessInfoType 0 0 0 1 ECU_ADDRESS 0x0 /end MEASUREMENT
/begin MEASUREMENT Com_RxAccessInfo[143].RxDataTimeoutSubstitutionValueIdxOfRxAccessInfo "" UBYTE Com_RxDataTimeoutSubstitutionValueIdxOfRxAccessInfoType 0 0 0 255 ECU_ADDRESS 0x0 /end MEASUREMENT
/begin MEASUREMENT Com_RxAccessInfo[143].RxDataTimeoutSubstitutionValueOfRxAccessInfo "" UBYTE Com_RxDataTimeoutSubstitutionValueOfRxAccessInfoType 0 0 0 255 ECU_ADDRESS 0x0 /end MEASUREMENT
/begin MEASUREMENT Com_RxAccessInfo[143].RxPduInfoIdxOfRxAccessInfo "" UBYTE NO_COMPU_METHOD 0 0 0 255 ECU_ADDRESS 0x0 /end MEASUREMENT
/begin MEASUREMENT Com_RxAccessInfo[143].RxSigBufferArrayBasedBufferEndIdxOfRxAccessInfo "" UBYTE Com_RxSigBufferArrayBasedBufferEndIdxOfRxAccessInfoType 0 0 0 255 ECU_ADDRESS 0x0 /end MEASUREMENT
/begin MEASUREMENT Com_RxAccessInfo[143].RxSigBufferArrayBasedBufferStartIdxOfRxAccessInfo "" UBYTE Com_RxSigBufferArrayBasedBufferStartIdxOfRxAccessInfoType 0 0 0 255 ECU_ADDRESS 0x0 /end MEASUREMENT
/begin MEASUREMENT Com_RxAccessInfo[143].RxSigBufferArrayBasedShdBufferEndIdxOfRxAccessInfo "" UBYTE Com_RxSigBufferArrayBasedShdBufferEndIdxOfRxAccessInfoType 0 0 0 255 ECU_ADDRESS 0x0 /end MEASUREMENT
/begin MEASUREMENT Com_RxAccessInfo[143].RxSigBufferArrayBasedShdBufferStartIdxOfRxAccessInfo "" UBYTE Com_RxSigBufferArrayBasedShdBufferStartIdxOfRxAccessInfoType 0 0 0 255 ECU_ADDRESS 0x0 /end MEASUREMENT
/begin MEASUREMENT Com_RxAccessInfo[143].RxTOutInfoIdxOfRxAccessInfo "" UBYTE Com_RxTOutInfoIdxOfRxAccessInfoType 0 0 0 255 ECU_ADDRESS 0x0 /end MEASUREMENT
/begin MEASUREMENT Com_RxAccessInfo[143].ShdBufferIdxOfRxAccessInfo "" UWORD Com_ShdBufferIdxOfRxAccessInfoType 0 0 0 65535 ECU_ADDRESS 0x0 /end MEASUREMENT
/begin MEASUREMENT Com_RxAccessInfo[143].SignalLengthInByteOfRxAccessInfo "" UBYTE NO_COMPU_METHOD 0 0 0 255 ECU_ADDRESS 0x0 /end MEASUREMENT
/begin MEASUREMENT Com_RxAccessInfo[143].StartByteInPduPositionOfRxAccessInfo "" UBYTE NO_COMPU_METHOD 0 0 0 255 ECU_ADDRESS 0x0 /end MEASUREMENT
/begin MEASUREMENT Com_RxAccessInfo[143].TmpBufferIdxOfRxAccessInfo "" UBYTE Com_TmpBufferIdxOfRxAccessInfoType 0 0 0 255 ECU_ADDRESS 0x0 /end MEASUREMENT
/begin MEASUREMENT Com_RxAccessInfo[143].TmpBufferOfRxAccessInfo "" UBYTE Com_TmpBufferOfRxAccessInfoType 0 0 0 255 ECU_ADDRESS 0x0 /end MEASUREMENT
/begin MEASUREMENT Com_RxAccessInfo[143].TmpRxShdBufferArrayBasedTmpBufferEndIdxOfRxAccessInfo "" UBYTE Com_TmpRxShdBufferArrayBasedTmpBufferEndIdxOfRxAccessInfoType 0 0 0 255 ECU_ADDRESS 0x0 /end MEASUREMENT
/begin MEASUREMENT Com_RxAccessInfo[143].TmpRxShdBufferArrayBasedTmpBufferStartIdxOfRxAccessInfo "" UBYTE Com_TmpRxShdBufferArrayBasedTmpBufferStartIdxOfRxAccessInfoType 0 0 0 255 ECU_ADDRESS 0x0 /end MEASUREMENT
/begin MEASUREMENT Com_RxAccessInfo[144].ApplTypeOfRxAccessInfo "" UBYTE Com_ApplTypeOfRxAccessInfoType 0 0 0 255 ECU_ADDRESS 0x0 /end MEASUREMENT
/begin MEASUREMENT Com_RxAccessInfo[144].BitLengthOfRxAccessInfo "" UWORD NO_COMPU_METHOD 0 0 0 65535 ECU_ADDRESS 0x0 /end MEASUREMENT
/begin MEASUREMENT Com_RxAccessInfo[144].BitPositionOfRxAccessInfo "" UWORD NO_COMPU_METHOD 0 0 0 65535 ECU_ADDRESS 0x0 /end MEASUREMENT
/begin MEASUREMENT Com_RxAccessInfo[144].BufferIdxOfRxAccessInfo "" UWORD Com_BufferIdxOfRxAccessInfoType 0 0 0 65535 ECU_ADDRESS 0x0 /end MEASUREMENT
/begin MEASUREMENT Com_RxAccessInfo[144].BusAccOfRxAccessInfo "" UBYTE Com_BusAccOfRxAccessInfoType 0 0 0 255 ECU_ADDRESS 0x0 /end MEASUREMENT
/begin MEASUREMENT Com_RxAccessInfo[144].ByteLengthOfRxAccessInfo "" UBYTE NO_COMPU_METHOD 0 0 0 255 ECU_ADDRESS 0x0 /end MEASUREMENT
/begin MEASUREMENT Com_RxAccessInfo[144].ConstValueArrayBasedInitValueEndIdxOfRxAccessInfo "" UBYTE Com_ConstValueArrayBasedInitValueEndIdxOfRxAccessInfoType 0 0 0 255 ECU_ADDRESS 0x0 /end MEASUREMENT
/begin MEASUREMENT Com_RxAccessInfo[144].ConstValueArrayBasedInitValueStartIdxOfRxAccessInfo "" UBYTE Com_ConstValueArrayBasedInitValueStartIdxOfRxAccessInfoType 0 0 0 255 ECU_ADDRESS 0x0 /end MEASUREMENT
/begin MEASUREMENT Com_RxAccessInfo[144].DynSignalOfRxAccessInfo "" UBYTE Com_DynSignalOfRxAccessInfoType 0 0 0 1 ECU_ADDRESS 0x0 /end MEASUREMENT
/begin MEASUREMENT Com_RxAccessInfo[144].InitValueIdxOfRxAccessInfo "" UBYTE Com_InitValueIdxOfRxAccessInfoType 0 0 0 255 ECU_ADDRESS 0x0 /end MEASUREMENT
/begin MEASUREMENT Com_RxAccessInfo[144].InitValueOfRxAccessInfo "" UBYTE Com_InitValueOfRxAccessInfoType 0 0 0 255 ECU_ADDRESS 0x0 /end MEASUREMENT
/begin MEASUREMENT Com_RxAccessInfo[144].InvValueIdxOfRxAccessInfo "" UBYTE Com_InvValueIdxOfRxAccessInfoType 0 0 0 255 ECU_ADDRESS 0x0 /end MEASUREMENT
/begin MEASUREMENT Com_RxAccessInfo[144].InvValueOfRxAccessInfo "" UBYTE Com_InvValueOfRxAccessInfoType 0 0 0 255 ECU_ADDRESS 0x0 /end MEASUREMENT
/begin MEASUREMENT Com_RxAccessInfo[144].IsGroupSignalOfRxAccessInfo "" UBYTE Com_IsGroupSignalOfRxAccessInfoType 0 0 0 1 ECU_ADDRESS 0x0 /end MEASUREMENT
/begin MEASUREMENT Com_RxAccessInfo[144].RxDataTimeoutSubstitutionValueIdxOfRxAccessInfo "" UBYTE Com_RxDataTimeoutSubstitutionValueIdxOfRxAccessInfoType 0 0 0 255 ECU_ADDRESS 0x0 /end MEASUREMENT
/begin MEASUREMENT Com_RxAccessInfo[144].RxDataTimeoutSubstitutionValueOfRxAccessInfo "" UBYTE Com_RxDataTimeoutSubstitutionValueOfRxAccessInfoType 0 0 0 255 ECU_ADDRESS 0x0 /end MEASUREMENT
/begin MEASUREMENT Com_RxAccessInfo[144].RxPduInfoIdxOfRxAccessInfo "" UBYTE NO_COMPU_METHOD 0 0 0 255 ECU_ADDRESS 0x0 /end MEASUREMENT
/begin MEASUREMENT Com_RxAccessInfo[144].RxSigBufferArrayBasedBufferEndIdxOfRxAccessInfo "" UBYTE Com_RxSigBufferArrayBasedBufferEndIdxOfRxAccessInfoType 0 0 0 255 ECU_ADDRESS 0x0 /end MEASUREMENT
/begin MEASUREMENT Com_RxAccessInfo[144].RxSigBufferArrayBasedBufferStartIdxOfRxAccessInfo "" UBYTE Com_RxSigBufferArrayBasedBufferStartIdxOfRxAccessInfoType 0 0 0 255 ECU_ADDRESS 0x0 /end MEASUREMENT
/begin MEASUREMENT Com_RxAccessInfo[144].RxSigBufferArrayBasedShdBufferEndIdxOfRxAccessInfo "" UBYTE Com_RxSigBufferArrayBasedShdBufferEndIdxOfRxAccessInfoType 0 0 0 255 ECU_ADDRESS 0x0 /end MEASUREMENT
/begin MEASUREMENT Com_RxAccessInfo[144].RxSigBufferArrayBasedShdBufferStartIdxOfRxAccessInfo "" UBYTE Com_RxSigBufferArrayBasedShdBufferStartIdxOfRxAccessInfoType 0 0 0 255 ECU_ADDRESS 0x0 /end MEASUREMENT
/begin MEASUREMENT Com_RxAccessInfo[144].RxTOutInfoIdxOfRxAccessInfo "" UBYTE Com_RxTOutInfoIdxOfRxAccessInfoType 0 0 0 255 ECU_ADDRESS 0x0 /end MEASUREMENT
/begin MEASUREMENT Com_RxAccessInfo[144].ShdBufferIdxOfRxAccessInfo "" UWORD Com_ShdBufferIdxOfRxAccessInfoType 0 0 0 65535 ECU_ADDRESS 0x0 /end MEASUREMENT
/begin MEASUREMENT Com_RxAccessInfo[144].SignalLengthInByteOfRxAccessInfo "" UBYTE NO_COMPU_METHOD 0 0 0 255 ECU_ADDRESS 0x0 /end MEASUREMENT
/begin MEASUREMENT Com_RxAccessInfo[144].StartByteInPduPositionOfRxAccessInfo "" UBYTE NO_COMPU_METHOD 0 0 0 255 ECU_ADDRESS 0x0 /end MEASUREMENT
/begin MEASUREMENT Com_RxAccessInfo[144].TmpBufferIdxOfRxAccessInfo "" UBYTE Com_TmpBufferIdxOfRxAccessInfoType 0 0 0 255 ECU_ADDRESS 0x0 /end MEASUREMENT
/begin MEASUREMENT Com_RxAccessInfo[144].TmpBufferOfRxAccessInfo "" UBYTE Com_TmpBufferOfRxAccessInfoType 0 0 0 255 ECU_ADDRESS 0x0 /end MEASUREMENT
/begin MEASUREMENT Com_RxAccessInfo[144].TmpRxShdBufferArrayBasedTmpBufferEndIdxOfRxAccessInfo "" UBYTE Com_TmpRxShdBufferArrayBasedTmpBufferEndIdxOfRxAccessInfoType 0 0 0 255 ECU_ADDRESS 0x0 /end MEASUREMENT
/begin MEASUREMENT Com_RxAccessInfo[144].TmpRxShdBufferArrayBasedTmpBufferStartIdxOfRxAccessInfo "" UBYTE Com_TmpRxShdBufferArrayBasedTmpBufferStartIdxOfRxAccessInfoType 0 0 0 255 ECU_ADDRESS 0x0 /end MEASUREMENT
/begin MEASUREMENT Com_RxAccessInfo[145].ApplTypeOfRxAccessInfo "" UBYTE Com_ApplTypeOfRxAccessInfoType 0 0 0 255 ECU_ADDRESS 0x0 /end MEASUREMENT
/begin MEASUREMENT Com_RxAccessInfo[145].BitLengthOfRxAccessInfo "" UWORD NO_COMPU_METHOD 0 0 0 65535 ECU_ADDRESS 0x0 /end MEASUREMENT
/begin MEASUREMENT Com_RxAccessInfo[145].BitPositionOfRxAccessInfo "" UWORD NO_COMPU_METHOD 0 0 0 65535 ECU_ADDRESS 0x0 /end MEASUREMENT
/begin MEASUREMENT Com_RxAccessInfo[145].BufferIdxOfRxAccessInfo "" UWORD Com_BufferIdxOfRxAccessInfoType 0 0 0 65535 ECU_ADDRESS 0x0 /end MEASUREMENT
/begin MEASUREMENT Com_RxAccessInfo[145].BusAccOfRxAccessInfo "" UBYTE Com_BusAccOfRxAccessInfoType 0 0 0 255 ECU_ADDRESS 0x0 /end MEASUREMENT
/begin MEASUREMENT Com_RxAccessInfo[145].ByteLengthOfRxAccessInfo "" UBYTE NO_COMPU_METHOD 0 0 0 255 ECU_ADDRESS 0x0 /end MEASUREMENT
/begin MEASUREMENT Com_RxAccessInfo[145].ConstValueArrayBasedInitValueEndIdxOfRxAccessInfo "" UBYTE Com_ConstValueArrayBasedInitValueEndIdxOfRxAccessInfoType 0 0 0 255 ECU_ADDRESS 0x0 /end MEASUREMENT
/begin MEASUREMENT Com_RxAccessInfo[145].ConstValueArrayBasedInitValueStartIdxOfRxAccessInfo "" UBYTE Com_ConstValueArrayBasedInitValueStartIdxOfRxAccessInfoType 0 0 0 255 ECU_ADDRESS 0x0 /end MEASUREMENT
/begin MEASUREMENT Com_RxAccessInfo[145].DynSignalOfRxAccessInfo "" UBYTE Com_DynSignalOfRxAccessInfoType 0 0 0 1 ECU_ADDRESS 0x0 /end MEASUREMENT
/begin MEASUREMENT Com_RxAccessInfo[145].InitValueIdxOfRxAccessInfo "" UBYTE Com_InitValueIdxOfRxAccessInfoType 0 0 0 255 ECU_ADDRESS 0x0 /end MEASUREMENT
/begin MEASUREMENT Com_RxAccessInfo[145].InitValueOfRxAccessInfo "" UBYTE Com_InitValueOfRxAccessInfoType 0 0 0 255 ECU_ADDRESS 0x0 /end MEASUREMENT
/begin MEASUREMENT Com_RxAccessInfo[145].InvValueIdxOfRxAccessInfo "" UBYTE Com_InvValueIdxOfRxAccessInfoType 0 0 0 255 ECU_ADDRESS 0x0 /end MEASUREMENT
/begin MEASUREMENT Com_RxAccessInfo[145].InvValueOfRxAccessInfo "" UBYTE Com_InvValueOfRxAccessInfoType 0 0 0 255 ECU_ADDRESS 0x0 /end MEASUREMENT
/begin MEASUREMENT Com_RxAccessInfo[145].IsGroupSignalOfRxAccessInfo "" UBYTE Com_IsGroupSignalOfRxAccessInfoType 0 0 0 1 ECU_ADDRESS 0x0 /end MEASUREMENT
/begin MEASUREMENT Com_RxAccessInfo[145].RxDataTimeoutSubstitutionValueIdxOfRxAccessInfo "" UBYTE Com_RxDataTimeoutSubstitutionValueIdxOfRxAccessInfoType 0 0 0 255 ECU_ADDRESS 0x0 /end MEASUREMENT
/begin MEASUREMENT Com_RxAccessInfo[145].RxDataTimeoutSubstitutionValueOfRxAccessInfo "" UBYTE Com_RxDataTimeoutSubstitutionValueOfRxAccessInfoType 0 0 0 255 ECU_ADDRESS 0x0 /end MEASUREMENT
/begin MEASUREMENT Com_RxAccessInfo[145].RxPduInfoIdxOfRxAccessInfo "" UBYTE NO_COMPU_METHOD 0 0 0 255 ECU_ADDRESS 0x0 /end MEASUREMENT
/begin MEASUREMENT Com_RxAccessInfo[145].RxSigBufferArrayBasedBufferEndIdxOfRxAccessInfo "" UBYTE Com_RxSigBufferArrayBasedBufferEndIdxOfRxAccessInfoType 0 0 0 255 ECU_ADDRESS 0x0 /end MEASUREMENT
/begin MEASUREMENT Com_RxAccessInfo[145].RxSigBufferArrayBasedBufferStartIdxOfRxAccessInfo "" UBYTE Com_RxSigBufferArrayBasedBufferStartIdxOfRxAccessInfoType 0 0 0 255 ECU_ADDRESS 0x0 /end MEASUREMENT
/begin MEASUREMENT Com_RxAccessInfo[145].RxSigBufferArrayBasedShdBufferEndIdxOfRxAccessInfo "" UBYTE Com_RxSigBufferArrayBasedShdBufferEndIdxOfRxAccessInfoType 0 0 0 255 ECU_ADDRESS 0x0 /end MEASUREMENT
/begin MEASUREMENT Com_RxAccessInfo[145].RxSigBufferArrayBasedShdBufferStartIdxOfRxAccessInfo "" UBYTE Com_RxSigBufferArrayBasedShdBufferStartIdxOfRxAccessInfoType 0 0 0 255 ECU_ADDRESS 0x0 /end MEASUREMENT
/begin MEASUREMENT Com_RxAccessInfo[145].RxTOutInfoIdxOfRxAccessInfo "" UBYTE Com_RxTOutInfoIdxOfRxAccessInfoType 0 0 0 255 ECU_ADDRESS 0x0 /end MEASUREMENT
/begin MEASUREMENT Com_RxAccessInfo[145].ShdBufferIdxOfRxAccessInfo "" UWORD Com_ShdBufferIdxOfRxAccessInfoType 0 0 0 65535 ECU_ADDRESS 0x0 /end MEASUREMENT
/begin MEASUREMENT Com_RxAccessInfo[145].SignalLengthInByteOfRxAccessInfo "" UBYTE NO_COMPU_METHOD 0 0 0 255 ECU_ADDRESS 0x0 /end MEASUREMENT
/begin MEASUREMENT Com_RxAccessInfo[145].StartByteInPduPositionOfRxAccessInfo "" UBYTE NO_COMPU_METHOD 0 0 0 255 ECU_ADDRESS 0x0 /end MEASUREMENT
/begin MEASUREMENT Com_RxAccessInfo[145].TmpBufferIdxOfRxAccessInfo "" UBYTE Com_TmpBufferIdxOfRxAccessInfoType 0 0 0 255 ECU_ADDRESS 0x0 /end MEASUREMENT
/begin MEASUREMENT Com_RxAccessInfo[145].TmpBufferOfRxAccessInfo "" UBYTE Com_TmpBufferOfRxAccessInfoType 0 0 0 255 ECU_ADDRESS 0x0 /end MEASUREMENT
/begin MEASUREMENT Com_RxAccessInfo[145].TmpRxShdBufferArrayBasedTmpBufferEndIdxOfRxAccessInfo "" UBYTE Com_TmpRxShdBufferArrayBasedTmpBufferEndIdxOfRxAccessInfoType 0 0 0 255 ECU_ADDRESS 0x0 /end MEASUREMENT
/begin MEASUREMENT Com_RxAccessInfo[145].TmpRxShdBufferArrayBasedTmpBufferStartIdxOfRxAccessInfo "" UBYTE Com_TmpRxShdBufferArrayBasedTmpBufferStartIdxOfRxAccessInfoType 0 0 0 255 ECU_ADDRESS 0x0 /end MEASUREMENT
/begin MEASUREMENT Com_RxAccessInfo[146].ApplTypeOfRxAccessInfo "" UBYTE Com_ApplTypeOfRxAccessInfoType 0 0 0 255 ECU_ADDRESS 0x0 /end MEASUREMENT
/begin MEASUREMENT Com_RxAccessInfo[146].BitLengthOfRxAccessInfo "" UWORD NO_COMPU_METHOD 0 0 0 65535 ECU_ADDRESS 0x0 /end MEASUREMENT
/begin MEASUREMENT Com_RxAccessInfo[146].BitPositionOfRxAccessInfo "" UWORD NO_COMPU_METHOD 0 0 0 65535 ECU_ADDRESS 0x0 /end MEASUREMENT
/begin MEASUREMENT Com_RxAccessInfo[146].BufferIdxOfRxAccessInfo "" UWORD Com_BufferIdxOfRxAccessInfoType 0 0 0 65535 ECU_ADDRESS 0x0 /end MEASUREMENT
/begin MEASUREMENT Com_RxAccessInfo[146].BusAccOfRxAccessInfo "" UBYTE Com_BusAccOfRxAccessInfoType 0 0 0 255 ECU_ADDRESS 0x0 /end MEASUREMENT
/begin MEASUREMENT Com_RxAccessInfo[146].ByteLengthOfRxAccessInfo "" UBYTE NO_COMPU_METHOD 0 0 0 255 ECU_ADDRESS 0x0 /end MEASUREMENT
/begin MEASUREMENT Com_RxAccessInfo[146].ConstValueArrayBasedInitValueEndIdxOfRxAccessInfo "" UBYTE Com_ConstValueArrayBasedInitValueEndIdxOfRxAccessInfoType 0 0 0 255 ECU_ADDRESS 0x0 /end MEASUREMENT
/begin MEASUREMENT Com_RxAccessInfo[146].ConstValueArrayBasedInitValueStartIdxOfRxAccessInfo "" UBYTE Com_ConstValueArrayBasedInitValueStartIdxOfRxAccessInfoType 0 0 0 255 ECU_ADDRESS 0x0 /end MEASUREMENT
/begin MEASUREMENT Com_RxAccessInfo[146].DynSignalOfRxAccessInfo "" UBYTE Com_DynSignalOfRxAccessInfoType 0 0 0 1 ECU_ADDRESS 0x0 /end MEASUREMENT
/begin MEASUREMENT Com_RxAccessInfo[146].InitValueIdxOfRxAccessInfo "" UBYTE Com_InitValueIdxOfRxAccessInfoType 0 0 0 255 ECU_ADDRESS 0x0 /end MEASUREMENT
/begin MEASUREMENT Com_RxAccessInfo[146].InitValueOfRxAccessInfo "" UBYTE Com_InitValueOfRxAccessInfoType 0 0 0 255 ECU_ADDRESS 0x0 /end MEASUREMENT
/begin MEASUREMENT Com_RxAccessInfo[146].InvValueIdxOfRxAccessInfo "" UBYTE Com_InvValueIdxOfRxAccessInfoType 0 0 0 255 ECU_ADDRESS 0x0 /end MEASUREMENT
/begin MEASUREMENT Com_RxAccessInfo[146].InvValueOfRxAccessInfo "" UBYTE Com_InvValueOfRxAccessInfoType 0 0 0 255 ECU_ADDRESS 0x0 /end MEASUREMENT
/begin MEASUREMENT Com_RxAccessInfo[146].IsGroupSignalOfRxAccessInfo "" UBYTE Com_IsGroupSignalOfRxAccessInfoType 0 0 0 1 ECU_ADDRESS 0x0 /end MEASUREMENT
/begin MEASUREMENT Com_RxAccessInfo[146].RxDataTimeoutSubstitutionValueIdxOfRxAccessInfo "" UBYTE Com_RxDataTimeoutSubstitutionValueIdxOfRxAccessInfoType 0 0 0 255 ECU_ADDRESS 0x0 /end MEASUREMENT
/begin MEASUREMENT Com_RxAccessInfo[146].RxDataTimeoutSubstitutionValueOfRxAccessInfo "" UBYTE Com_RxDataTimeoutSubstitutionValueOfRxAccessInfoType 0 0 0 255 ECU_ADDRESS 0x0 /end MEASUREMENT
/begin MEASUREMENT Com_RxAccessInfo[146].RxPduInfoIdxOfRxAccessInfo "" UBYTE NO_COMPU_METHOD 0 0 0 255 ECU_ADDRESS 0x0 /end MEASUREMENT
/begin MEASUREMENT Com_RxAccessInfo[146].RxSigBufferArrayBasedBufferEndIdxOfRxAccessInfo "" UBYTE Com_RxSigBufferArrayBasedBufferEndIdxOfRxAccessInfoType 0 0 0 255 ECU_ADDRESS 0x0 /end MEASUREMENT
/begin MEASUREMENT Com_RxAccessInfo[146].RxSigBufferArrayBasedBufferStartIdxOfRxAccessInfo "" UBYTE Com_RxSigBufferArrayBasedBufferStartIdxOfRxAccessInfoType 0 0 0 255 ECU_ADDRESS 0x0 /end MEASUREMENT
/begin MEASUREMENT Com_RxAccessInfo[146].RxSigBufferArrayBasedShdBufferEndIdxOfRxAccessInfo "" UBYTE Com_RxSigBufferArrayBasedShdBufferEndIdxOfRxAccessInfoType 0 0 0 255 ECU_ADDRESS 0x0 /end MEASUREMENT
/begin MEASUREMENT Com_RxAccessInfo[146].RxSigBufferArrayBasedShdBufferStartIdxOfRxAccessInfo "" UBYTE Com_RxSigBufferArrayBasedShdBufferStartIdxOfRxAccessInfoType 0 0 0 255 ECU_ADDRESS 0x0 /end MEASUREMENT
/begin MEASUREMENT Com_RxAccessInfo[146].RxTOutInfoIdxOfRxAccessInfo "" UBYTE Com_RxTOutInfoIdxOfRxAccessInfoType 0 0 0 255 ECU_ADDRESS 0x0 /end MEASUREMENT
/begin MEASUREMENT Com_RxAccessInfo[146].ShdBufferIdxOfRxAccessInfo "" UWORD Com_ShdBufferIdxOfRxAccessInfoType 0 0 0 65535 ECU_ADDRESS 0x0 /end MEASUREMENT
/begin MEASUREMENT Com_RxAccessInfo[146].SignalLengthInByteOfRxAccessInfo "" UBYTE NO_COMPU_METHOD 0 0 0 255 ECU_ADDRESS 0x0 /end MEASUREMENT
/begin MEASUREMENT Com_RxAccessInfo[146].StartByteInPduPositionOfRxAccessInfo "" UBYTE NO_COMPU_METHOD 0 0 0 255 ECU_ADDRESS 0x0 /end MEASUREMENT
/begin MEASUREMENT Com_RxAccessInfo[146].TmpBufferIdxOfRxAccessInfo "" UBYTE Com_TmpBufferIdxOfRxAccessInfoType 0 0 0 255 ECU_ADDRESS 0x0 /end MEASUREMENT
/begin MEASUREMENT Com_RxAccessInfo[146].TmpBufferOfRxAccessInfo "" UBYTE Com_TmpBufferOfRxAccessInfoType 0 0 0 255 ECU_ADDRESS 0x0 /end MEASUREMENT
/begin MEASUREMENT Com_RxAccessInfo[146].TmpRxShdBufferArrayBasedTmpBufferEndIdxOfRxAccessInfo "" UBYTE Com_TmpRxShdBufferArrayBasedTmpBufferEndIdxOfRxAccessInfoType 0 0 0 255 ECU_ADDRESS 0x0 /end MEASUREMENT
/begin MEASUREMENT Com_RxAccessInfo[146].TmpRxShdBufferArrayBasedTmpBufferStartIdxOfRxAccessInfo "" UBYTE Com_TmpRxShdBufferArrayBasedTmpBufferStartIdxOfRxAccessInfoType 0 0 0 255 ECU_ADDRESS 0x0 /end MEASUREMENT
/begin MEASUREMENT Com_RxAccessInfo[147].ApplTypeOfRxAccessInfo "" UBYTE Com_ApplTypeOfRxAccessInfoType 0 0 0 255 ECU_ADDRESS 0x0 /end MEASUREMENT
/begin MEASUREMENT Com_RxAccessInfo[147].BitLengthOfRxAccessInfo "" UWORD NO_COMPU_METHOD 0 0 0 65535 ECU_ADDRESS 0x0 /end MEASUREMENT
/begin MEASUREMENT Com_RxAccessInfo[147].BitPositionOfRxAccessInfo "" UWORD NO_COMPU_METHOD 0 0 0 65535 ECU_ADDRESS 0x0 /end MEASUREMENT
/begin MEASUREMENT Com_RxAccessInfo[147].BufferIdxOfRxAccessInfo "" UWORD Com_BufferIdxOfRxAccessInfoType 0 0 0 65535 ECU_ADDRESS 0x0 /end MEASUREMENT
/begin COMPU_METHOD Com_ApplTypeOfRxAccessInfoType "" TAB_VERB "%10.1" "" COMPU_TAB_REF Com_ApplTypeOfRxAccessInfoType /end COMPU_METHOD
/begin COMPU_METHOD Com_BufferIdxOfRxAccessInfoType "" TAB_VERB "%10.1" "" COMPU_TAB_REF Com_BufferIdxOfRxAccessInfoType /end COMPU_METHOD
/begin COMPU_METHOD Com_BusAccOfRxAccessInfoType "" TAB_VERB "%10.1" "" COMPU_TAB_REF Com_BusAccOfRxAccessInfoType /end COMPU_METHOD
/begin COMPU_METHOD Com_ConstValueArrayBasedInitValueEndIdxOfRxAccessInfoType "" TAB_VERB "%10.1" "" COMPU_TAB_REF Com_ConstValueArrayBasedInitValueEndIdxOfRxAccessInfoType /end COMPU_METHOD
/begin COMPU_METHOD Com_ConstValueArrayBasedInitValueStartIdxOfRxAccessInfoType "" TAB_VERB "%10.1" "" COMPU_TAB_REF Com_ConstValueArrayBasedInitValueStartIdxOfRxAccessInfoType /end COMPU_METHOD
/begin COMPU_METHOD Com_DynSignalOfRxAccessInfoType "" TAB_VERB "%10.1" "" COMPU_TAB_REF Com_DynSignalOfRxAccessInfoType /end COMPU_METHOD
/begin COMPU_METHOD Com_InitValueIdxOfRxAccessInfoType "" TAB_VERB "%10.1" "" COMPU_TAB_REF Com_InitValueIdxOfRxAccessInfoType /end COMPU_METHOD
/begin COMPU_METHOD Com_InitValueOfRxAccessInfoType "" TAB_VERB "%10.1" "" COMPU_TAB_REF Com_InitValueOfRxAccessInfoType /end COMPU_METHOD
/begin COMPU_METHOD Com_InvValueIdxOfRxAccessInfoType "" TAB_VERB "%10.1" "" COMPU_TAB_REF Com_InvValueIdxOfRxAccessInfoType /end COMPU_METHOD
/begin COMPU_METHOD Com_InvValueOfRxAccessInfoType "" TAB_VERB "%10.1" "" COMPU_TAB_REF Com_InvValueOfRxAccessInfoType /end COMPU_METHOD
/begin COMPU_METHOD Com_IsGroupSignalOfRxAccessInfoType "" TAB_VERB "%10.1" "" COMPU_TAB_REF Com_IsGroupSignalOfRxAccessInfoType /end COMPU_METHOD
/begin COMPU_METHOD Com_RxDataTimeoutSubstitutionValueIdxOfRxAccessInfoType "" TAB_VERB "%10.1" "" COMPU_TAB_REF Com_RxDataTimeoutSubstitutionValueIdxOfRxAccessInfoType /end COMPU_METHOD
/begin COMPU_METHOD Com_RxDataTimeoutSubstitutionValueOfRxAccessInfoType "" TAB_VERB "%10.1" "" COMPU_TAB_REF Com_RxDataTimeoutSubstitutionValueOfRxAccessInfoType /end COMPU_METHOD
/begin COMPU_METHOD Com_RxSigBufferArrayBasedBufferEndIdxOfRxAccessInfoType "" TAB_VERB "%10.1" "" COMPU_TAB_REF Com_RxSigBufferArrayBasedBufferEndIdxOfRxAccessInfoType /end COMPU_METHOD
/begin COMPU_METHOD Com_RxSigBufferArrayBasedBufferStartIdxOfRxAccessInfoType "" TAB_VERB "%10.1" "" COMPU_TAB_REF Com_RxSigBufferArrayBasedBufferStartIdxOfRxAccessInfoType /end COMPU_METHOD
/begin COMPU_METHOD Com_RxSigBufferArrayBasedShdBufferEndIdxOfRxAccessInfoType "" TAB_VERB "%10.1" "" COMPU_TAB_REF Com_RxSigBufferArrayBasedShdBufferEndIdxOfRxAccessInfoType /end COMPU_METHOD
/begin COMPU_METHOD Com_RxSigBufferArrayBasedShdBufferStartIdxOfRxAccessInfoType "" TAB_VERB "%10.1" "" COMPU_TAB_REF Com_RxSigBufferArrayBasedShdBufferStartIdxOfRxAccessInfoType /end COMPU_METHOD
/begin COMPU_METHOD Com_RxTOutInfoIdxOfRxAccessInfoType "" TAB_VERB "%10.1" "" COMPU_TAB_REF Com_RxTOutInfoIdxOfRxAccessInfoType /end COMPU_METHOD
/begin COMPU_METHOD Com_ShdBufferIdxOfRxAccessInfoType "" TAB_VERB "%10.1" "" COMPU_TAB_REF Com_ShdBufferIdxOfRxAccessInfoType /end COMPU_METHOD
/begin COMPU_METHOD Com_TmpBufferIdxOfRxAccessInfoType "" TAB_VERB "%10.1" "" COMPU_TAB_REF Com_TmpBufferIdxOfRxAccessInfoType /end COMPU_METHOD
/begin COMPU_METHOD Com_TmpBufferOfRxAccessInfoType "" TAB_VERB "%10.1" "" COMPU_TAB_REF Com_TmpBufferOfRxAccessInfoType /end COMPU_METHOD
/begin COMPU_METHOD Com_TmpRxShdBufferArrayBasedTmpBufferEndIdxOfRxAccessInfoType "" TAB_VERB "%10.1" "" COMPU_TAB_REF Com_TmpRxShdBufferArrayBasedTmpBufferEndIdxOfRxAccessInfoType /end COMPU_METHOD
/begin COMPU_METHOD Com_TmpRxShdBufferArrayBasedTmpBufferStartIdxOfRxAccessInfoType "" TAB_VERB "%10.1" "" COMPU_TAB_REF Com_TmpRxShdBufferArrayBasedTmpBufferStartIdxOfRxAccessInfoType /end COMPU_METHOD
/begin COMPU_VTAB Com_ApplTypeOfRxAccessInfoType "" TAB_VERB 4 0 "COM_UINT8_APPLTYPEOFRXACCESSINFO" 2 "COM_UINT16_APPLTYPEOFRXACCESSINFO" 4 "COM_UINT32_APPLTYPEOFRXACCESSINFO" 8 "COM_UINT8_N_APPLTYPEOFRXACCESSINFO" /end COMPU_VTAB
/begin COMPU_VTAB Com_BufferIdxOfRxAccessInfoType "" TAB_VERB 1 65535 "COM_NO_BUFFERIDXOFRXACCESSINFO" /end COMPU_VTAB
/begin COMPU_VTAB Com_BusAccOfRxAccessInfoType "" TAB_VERB 5 0 "COM_NBIT_BUSACCOFRXACCESSINFO" 1 "COM_BYTE_BUSACCOFRXACCESSINFO" 2 "COM_NBYTE_BUSACCOFRXACCESSINFO" 4 "COM_NBITNBYTE_BUSACCOFRXACCESSINFO" 6 "COM_ARRAY_BASED_BUSACCOFRXACCESSINFO" /end COMPU_VTAB
/begin COMPU_VTAB Com_ConstValueArrayBasedInitValueEndIdxOfRxAccessInfoType "" TAB_VERB 1 255 "COM_NO_CONSTVALUEARRAYBASEDINITVALUEENDIDXOFRXACCESSINFO" /end COMPU_VTAB
/begin COMPU_VTAB Com_ConstValueArrayBasedInitValueStartIdxOfRxAccessInfoType "" TAB_VERB 1 255 "COM_NO_CONSTVALUEARRAYBASEDINITVALUESTARTIDXOFRXACCESSINFO" /end COMPU_VTAB
/begin COMPU_VTAB_RANGE Com_DynSignalOfRxAccessInfoType "" 2 0 0 "FALSE" 1 255 "TRUE" /end COMPU_VTAB_RANGE
/begin COMPU_VTAB Com_InitValueIdxOfRxAccessInfoType "" TAB_VERB 1 255 "COM_NO_INITVALUEIDXOFRXACCESSINFO" /end COMPU_VTAB
/begin COMPU_VTAB Com_InitValueOfRxAccessInfoType "" TAB_VERB 4 0 "COM_CONSTVALUEUINT8_INITVALUEOFRXACCESSINFO" 1 "COM_CONSTVALUEUINT16_INITVALUEOFRXACCESSINFO" 2 "COM_CONSTVALUEUINT32_INITVALUEOFRXACCESSINFO" 255 "COM_NO_INITVALUEOFRXACCESSINFO" /end COMPU_VTAB
/begin COMPU_VTAB Com_InvValueIdxOfRxAccessInfoType "" TAB_VERB 1 255 "COM_NO_INVVALUEIDXOFRXACCESSINFO" /end COMPU_VTAB
/begin COMPU_VTAB Com_InvValueOfRxAccessInfoType "" TAB_VERB 4 0 "COM_CONSTVALUEUINT8_INVVALUEOFRXACCESSINFO" 1 "COM_CONSTVALUEUINT16_INVVALUEOFRXACCESSINFO" 2 "COM_CONSTVALUEUINT32_INVVALUEOFRXACCESSINFO" 255 "COM_NO_INVVALUEOFRXACCESSINFO" /end COMPU_VTAB
/begin COMPU_VTAB_RANGE Com_IsGroupSignalOfRxAccessInfoType "" 2 0 0 "FALSE" 1 255 "TRUE" /end COMPU_VTAB_RANGE
/begin COMPU_VTAB Com_RxDataTimeoutSubstitutionValueIdxOfRxAccessInfoType "" TAB_VERB 1 255 "COM_NO_RXDATATIMEOUTSUBSTITUTIONVALUEIDXOFRXACCESSINFO" /end COMPU_VTAB
/begin COMPU_VTAB Com_RxDataTimeoutSubstitutionValueOfRxAccessInfoType "" TAB_VERB 3 0 "COM_CONSTVALUEUINT8_RXDATATIMEOUTSUBSTITUTIONVALUEOFRXACCESSINFO" 2 "COM_CONSTVALUEUINT32_RXDATATIMEOUTSUBSTITUTIONVALUEOFRXACCESSINFO" 255 "COM_NO_RXDATATIMEOUTSUBSTITUTIONVALUEOFRXACCESSINFO" /end COMPU_VTAB
/begin COMPU_VTAB Com_RxSigBufferArrayBasedBufferEndIdxOfRxAccessInfoType "" TAB_VERB 1 255 "COM_NO_RXSIGBUFFERARRAYBASEDBUFFERENDIDXOFRXACCESSINFO" /end COMPU_VTAB
/begin COMPU_VTAB Com_RxSigBufferArrayBasedBufferStartIdxOfRxAccessInfoType "" TAB_VERB 1 255 "COM_NO_RXSIGBUFFERARRAYBASEDBUFFERSTARTIDXOFRXACCESSINFO" /end COMPU_VTAB
/begin COMPU_VTAB Com_RxSigBufferArrayBasedShdBufferEndIdxOfRxAccessInfoType "" TAB_VERB 1 255 "COM_NO_RXSIGBUFFERARRAYBASEDSHDBUFFERENDIDXOFRXACCESSINFO" /end COMPU_VTAB
/begin COMPU_VTAB Com_RxSigBufferArrayBasedShdBufferStartIdxOfRxAccessInfoType "" TAB_VERB 1 255 "COM_NO_RXSIGBUFFERARRAYBASEDSHDBUFFERSTARTIDXOFRXACCESSINFO" /end COMPU_VTAB
/begin COMPU_VTAB Com_RxTOutInfoIdxOfRxAccessInfoType "" TAB_VERB 1 255 "COM_NO_RXTOUTINFOIDXOFRXACCESSINFO" /end COMPU_VTAB
/begin COMPU_VTAB Com_ShdBufferIdxOfRxAccessInfoType "" TAB_VERB 1 65535 "COM_NO_SHDBUFFERIDXOFRXACCESSINFO" /end COMPU_VTAB
/begin COMPU_VTAB Com_TmpBufferIdxOfRxAccessInfoType "" TAB_VERB 1 255 "COM_NO_TMPBUFFERIDXOFRXACCESSINFO" /end COMPU_VTAB
/begin COMPU_VTAB Com_TmpBufferOfRxAccessInfoType "" TAB_VERB 4 0 "COM_TMPRXSHDBUFFERUINT8_TMPBUFFEROFRXACCESSINFO" 1 "COM_TMPRXSHDBUFFERUINT16_TMPBUFFEROFRXACCESSINFO" 2 "COM_TMPRXSHDBUFFERUINT32_TMPBUFFEROFRXACCESSINFO" 255 "COM_NO_TMPBUFFEROFRXACCESSINFO" /end COMPU_VTAB
/begin COMPU_VTAB Com_TmpRxShdBufferArrayBasedTmpBufferEndIdxOfRxAccessInfoType "" TAB_VERB 1 255 "COM_NO_TMPRXSHDBUFFERARRAYBASEDTMPBUFFERENDIDXOFRXACCESSINFO" /end COMPU_VTAB
/begin COMPU_VTAB Com_TmpRxShdBufferArrayBasedTmpBufferStartIdxOfRxAccessInfoType "" TAB_VERB 1 255 "COM_NO_TMPRXSHDBUFFERARRAYBASEDTMPBUFFERSTARTIDXOFRXACCESSINFO" /end COMPU_VTAB
/begin GROUP Com ""
 /begin REF_MEASUREMENT Com_RxAccessInfo[120].ConstValueArrayBasedInitValueEndIdxOfRxAccessInfo Com_RxAccessInfo[120].ConstValueArrayBasedInitValueStartIdxOfRxAccessInfo Com_RxAccessInfo[120].DynSignalOfRxAccessInfo Com_RxAccessInfo[120].InitValueIdxOfRxAccessInfo Com_RxAccessInfo[120].InitValueOfRxAccessInfo Com_RxAccessInfo[120].InvValueIdxOfRxAccessInfo Com_RxAccessInfo[120].InvValueOfRxAccessInfo Com_RxAccessInfo[120].IsGroupSignalOfRxAccessInfo Com_RxAccessInfo[120].RxDataTimeoutSubstitutionValueIdxOfRxAccessInfo Com_RxAccessInfo[120].RxDataTimeoutSubstitutionValueOfRxAccessInfo Com_RxAccessInfo[120].RxPduInfoIdxOfRxAccessInfo Com_RxAccessInfo[120].RxSigBufferArrayBasedBufferEndIdxOfRxAccessInfo Com_RxAccessInfo[120].RxSigBufferArrayBasedBufferStartIdxOfRxAccessInfo Com_RxAccessInfo[120].RxSigBufferArrayBasedShdBufferEndIdxOfRxAccessInfo Com_RxAccessInfo[120].RxSigBufferArrayBasedShdBufferStartIdxOfRxAccessInfo Com_RxAccessInfo[120].RxTOutInfoIdxOfRxAccessInfo Com_RxAccessInfo[120].ShdBufferIdxOfRxAccessInfo Com_RxAccessInfo[120].SignalLengthInByteOfRxAccessInfo Com_RxAccessInfo[120].StartByteInPduPositionOfRxAccessInfo Com_RxAccessInfo[120].TmpBufferIdxOfRxAccessInfo Com_RxAccessInfo[120].TmpBufferOfRxAccessInfo Com_RxAccessInfo[120].TmpRxShdBufferArrayBasedTmpBufferEndIdxOfRxAccessInfo Com_RxAccessInfo[120].TmpRxShdBufferArrayBasedTmpBufferStartIdxOfRxAccessInfo Com_RxAccessInfo[121].ApplTypeOfRxAccessInfo Com_RxAccessInfo[121].BitLengthOfRxAccessInfo Com_RxAccessInfo[121].BitPositionOfRxAccessInfo Com_RxAccessInfo[121].BufferIdxOfRxAccessInfo Com_RxAccessInfo[121].BusAccOfRxAccessInfo Com_RxAccessInfo[121].ByteLengthOfRxAccessInfo Com_RxAccessInfo[121].ConstValueArrayBasedInitValueEndIdxOfRxAccessInfo Com_RxAccessInfo[121].ConstValueArrayBasedInitValueStartIdxOfRxAccessInfo Com_RxAccessInfo[121].DynSignalOfRxAccessInfo Com_RxAccessInfo[121].InitValueIdxOfRxAccessInfo Com_RxAccessInfo[121].InitValueOfRxAccessInfo Com_RxAccessInfo[121].InvValueIdxOfRxAccessInfo Com_RxAccessInfo[121].InvValueOfRxAccessInfo Com_RxAccessInfo[121].IsGroupSignalOfRxAccessInfo Com_RxAccessInfo[121].RxDataTimeoutSubstitutionValueIdxOfRxAccessInfo Com_RxAccessInfo[121].RxDataTimeoutSubstitutionValueOfRxAccessInfo Com_RxAccessInfo[121].RxPduInfoIdxOfRxAccessInfo Com_RxAccessInfo[121].RxSigBufferArrayBasedBufferEndIdxOfRxAccessInfo Com_RxAccessInfo[121].RxSigBufferArrayBasedBufferStartIdxOfRxAccessInfo Com_RxAccessInfo[121].RxSigBufferArrayBasedShdBufferEndIdxOfRxAccessInfo Com_RxAccessInfo[121].RxSigBufferArrayBasedShdBufferStartIdxOfRxAccessInfo Com_RxAccessInfo[121].RxTOutInfoIdxOfRxAccessInfo Com_RxAccessInfo[121].ShdBufferIdxOfRxAccessInfo Com_RxAccessInfo[121].SignalLengthInByteOfRxAccessInfo Com_RxAccessInfo[121].StartByteInPduPositionOfRxAccessInfo Com_RxAccessInfo[121].TmpBufferIdxOfRxAccessInfo Com_RxAccessInfo[121].TmpBufferOfRxAccessInfo Com_RxAccessInfo[121].TmpRxShdBufferArrayBasedTmpBufferEndIdxOfRxAccessInfo Com_RxAccessInfo[121].TmpRxShdBufferArrayBasedTmpBufferStartIdxOfRxAccessInfo Com_RxAccessInfo[122].ApplTypeOfRxAccessInfo Com_RxAccessInfo[122].BitLengthOfRxAccessInfo Com_RxAccessInfo[122].BitPositionOfRxAccessInfo Com_RxAccessInfo[122].BufferIdxOfRxAccessInfo Com_RxAccessInfo[122].BusAccOfRxAccessInfo Com_RxAccessInfo[122].ByteLengthOfRxAccessInfo Com_RxAccessInfo[122].ConstValueArrayBasedInitValueEndIdxOfRxAccessInfo Com_RxAccessInfo[122].ConstValueArrayBasedInitValueStartIdxOfRxAccessInfo Com_RxAccessInfo[122].DynSignalOfRxAccessInfo Com_RxAccessInfo[122].InitValueIdxOfRxAccessInfo Com_RxAccessInfo[122].InitValueOfRxAccessInfo Com_RxAccessInfo[122].InvValueIdxOfRxAccessInfo Com_RxAccessInfo[122].InvValueOfRxAccessInfo Com_RxAccessInfo[122].IsGroupSignalOfRxAccessInfo Com_RxAccessInfo[122].RxDataTimeoutSubstitutionValueIdxOfRxAccessInfo Com_RxAccessInfo[122].RxDataTimeoutSubstitutionValueOfRxAccessInfo Com_RxAccessInfo[122].RxPduInfoIdxOfRxAccessInfo Com_RxAccessInfo[122].RxSigBufferArrayBasedBufferEndIdxOfRxAccessInfo Com_RxAccessInfo[122].RxSigBufferArrayBasedBufferStartIdxOfRxAccessInfo Com_RxAccessInfo[122].RxSigBufferArrayBasedShdBufferEndIdxOfRxAccessInfo Com_RxAccessInfo[122].RxSigBufferArrayBasedShdBufferStartIdxOfRxAccessInfo Com_RxAccessInfo[122].RxTOutInfoIdxOfRxAccessInfo Com_RxAccessInfo[122].ShdBufferIdxOfRxAccessInfo Com_RxAccessInfo[122].SignalLengthInByteOfRxAccessInfo Com_RxAccessInfo[122].StartByteInPduPositionOfRxAccessInfo Com_RxAccessInfo[122].TmpBufferIdxOfRxAccessInfo Com_RxAccessInfo[122].TmpBufferOfRxAccessInfo Com_RxAccessInfo[122].TmpRxShdBufferArrayBasedTmpBufferEndIdxOfRxAccessInfo Com_RxAccessInfo[122].TmpRxShdBufferArrayBasedTmpBufferStartIdxOfRxAccessInfo Com_RxAccessInfo[123].ApplTypeOfRxAccessInfo Com_RxAccessInfo[123].BitLengthOfRxAccessInfo Com_RxAccessInfo[123].BitPositionOfRxAccessInfo Com_RxAccessInfo[123].BufferIdxOfRxAccessInfo Com_RxAccessInfo[123].BusAccOfRxAccessInfo Com_RxAccessInfo[123].ByteLengthOfRxAccessInfo Com_RxAccessInfo[123].ConstValueArrayBasedInitValueEndIdxOfRxAccessInfo Com_RxAccessInfo[123].ConstValueArrayBasedInitValueStartIdxOfRxAccessInfo Com_RxAccessInfo[123].DynSignalOfRxAccessInfo Com_RxAccessInfo[123].InitValueIdxOfRxAccessInfo Com_RxAccessInfo[123].InitValueOfRxAccessInfo Com_RxAccessInfo[123].InvValueIdxOfRxAccessInfo Com_RxAccessInfo[123].InvValueOfRxAccessInfo Com_RxAccessInfo[123].IsGroupSignalOfRxAccessInfo Com_RxAccessInfo[123].RxDataTimeoutSubstitutionValueIdxOfRxAccessInfo Com_RxAccessInfo[123].RxDataTimeoutSubstitutionValueOfRxAccessInfo Com_RxAccessInfo[123].RxPduInfoIdxOfRxAccessInfo Com_RxAccessInfo[123].RxSigBufferArrayBasedBufferEndIdxOfRxAccessInfo Com_RxAccessInfo[123].RxSigBufferArrayBasedBufferStartIdxOfRxAccessInfo Com_RxAccessInfo[123].RxSigBufferArrayBasedShdBufferEndIdxOfRxAccessInfo Com_RxAccessInfo[123].RxSigBufferArrayBasedShdBufferStartIdxOfRxAccessInfo Com_RxAccessInfo[123].RxTOutInfoIdxOfRxAccessInfo Com_RxAccessInfo[123].ShdBufferIdxOfRxAccessInfo Com_RxAccessInfo[123].SignalLengthInByteOfRxAccessInfo Com_RxAccessInfo[123].StartByteInPduPositionOfRxAccessInfo Com_RxAccessInfo[123].TmpBufferIdxOfRxAccessInfo Com_RxAccessInfo[123].TmpBufferOfRxAccessInfo Com_RxAccessInfo[123].TmpRxShdBufferArrayBasedTmpBufferEndIdxOfRxAccessInfo Com_RxAccessInfo[123].TmpRxShdBufferArrayBasedTmpBufferStartIdxOfRxAccessInfo Com_RxAccessInfo[124].ApplTypeOfRxAccessInfo Com_RxAccessInfo[124].BitLengthOfRxAccessInfo Com_RxAccessInfo[124].BitPositionOfRxAccessInfo Com_RxAccessInfo[124].BufferIdxOfRxAccessInfo Com_RxAccessInfo[124].BusAccOfRxAccessInfo Com_RxAccessInfo[124].ByteLengthOfRxAccessInfo Com_RxAccessInfo[124].ConstValueArrayBasedInitValueEndIdxOfRxAccessInfo Com_RxAccessInfo[124].ConstValueArrayBasedInitValueStartIdxOfRxAccessInfo Com_RxAccessInfo[124].DynSignalOfRxAccessInfo Com_RxAccessInfo[124].InitValueIdxOfRxAccessInfo Com_RxAccessInfo[124].InitValueOfRxAccessInfo Com_RxAccessInfo[124].InvValueIdxOfRxAccessInfo Com_RxAccessInfo[124].InvValueOfRxAccessInfo Com_RxAccessInfo[124].IsGroupSignalOfRxAccessInfo Com_RxAccessInfo[124].RxDataTimeoutSubstitutionValueIdxOfRxAccessInfo Com_RxAccessInfo[124].RxDataTimeoutSubstitutionValueOfRxAccessInfo Com_RxAccessInfo[124].RxPduInfoIdxOfRxAccessInfo Com_RxAccessInfo[124].RxSigBufferArrayBasedBufferEndIdxOfRxAccessInfo Com_RxAccessInfo[124].RxSigBufferArrayBasedBufferStartIdxOfRxAccessInfo Com_RxAccessInfo[124].RxSigBufferArrayBasedShdBufferEndIdxOfRxAccessInfo Com_RxAccessInfo[124].RxSigBufferArrayBasedShdBufferStartIdxOfRxAccessInfo Com_RxAccessInfo[124].RxTOutInfoIdxOfRxAccessInfo Com_RxAccessInfo[124].ShdBufferIdxOfRxAccessInfo Com_RxAccessInfo[124].SignalLengthInByteOfRxAccessInfo Com_RxAccessInfo[124].StartByteInPduPositionOfRxAccessInfo Com_RxAccessInfo[124].TmpBufferIdxOfRxAccessInfo Com_RxAccessInfo[124].TmpBufferOfRxAccessInfo Com_RxAccessInfo[124].TmpRxShdBufferArrayBasedTmpBufferEndIdxOfRxAccessInfo Com_RxAccessInfo[124].TmpRxShdBufferArrayBasedTmpBufferStartIdxOfRxAccessInfo Com_RxAccessInfo[125].ApplTypeOfRxAccessInfo Com_RxAccessInfo[125].BitLengthOfRxAccessInfo Com_RxAccessInfo[125].BitPositionOfRxAccessInfo Com_RxAccessInfo[125].BufferIdxOfRxAccessInfo Com_RxAccessInfo[125].BusAccOfRxAccessInfo Com_RxAccessInfo[125].ByteLengthOfRxAccessInfo Com_RxAccessInfo[125].ConstValueArrayBasedInitValueEndIdxOfRxAccessInfo Com_RxAccessInfo[125].ConstValueArrayBasedInitValueStartIdxOfRxAccessInfo Com_RxAccessInfo[125].DynSignalOfRxAccessInfo Com_RxAccessInfo[125].InitValueIdxOfRxAccessInfo Com_RxAccessInfo[125].InitValueOfRxAccessInfo Com_RxAccessInfo[125].InvValueIdxOfRxAccessInfo Com_RxAccessInfo[125].InvValueOfRxAccessInfo Com_RxAccessInfo[125].IsGroupSignalOfRxAccessInfo Com_RxAccessInfo[125].RxDataTimeoutSubstitutionValueIdxOfRxAccessInfo Com_RxAccessInfo[125].RxDataTimeoutSubstitutionValueOfRxAccessInfo Com_RxAccessInfo[125].RxPduInfoIdxOfRxAccessInfo Com_RxAccessInfo[125].RxSigBufferArrayBasedBufferEndIdxOfRxAccessInfo Com_RxAccessInfo[125].RxSigBufferArrayBasedBufferStartIdxOfRxAccessInfo Com_RxAccessInfo[125].RxSigBufferArrayBasedShdBufferEndIdxOfRxAccessInfo Com_RxAccessInfo[125].RxSigBufferArrayBasedShdBufferStartIdxOfRxAccessInfo Com_RxAccessInfo[125].RxTOutInfoIdxOfRxAccessInfo Com_RxAccessInfo[125].ShdBufferIdxOfRxAccessInfo Com_RxAccessInfo[125].SignalLengthInByteOfRxAccessInfo Com_RxAccessInfo[125].StartByteInPduPositionOfRxAccessInfo Com_RxAccessInfo[125].TmpBufferIdxOfRxAccessInfo Com_RxAccessInfo[125].TmpBufferOfRxAccessInfo Com_RxAccessInfo[125].TmpRxShdBufferArrayBasedTmpBufferEndIdxOfRxAccessInfo Com_RxAccessInfo[125].TmpRxShdBufferArrayBasedTmpBufferStartIdxOfRxAccessInfo Com_RxAccessInfo[126].ApplTypeOfRxAccessInfo Com_RxAccessInfo[126].BitLengthOfRxAccessInfo Com_RxAccessInfo[126].BitPositionOfRxAccessInfo Com_RxAccessInfo[126].BufferIdxOfRxAccessInfo Com_RxAccessInfo[126].BusAccOfRxAccessInfo Com_RxAccessInfo[126].ByteLengthOfRxAccessInfo Com_RxAccessInfo[126].ConstValueArrayBasedInitValueEndIdxOfRxAccessInfo Com_RxAccessInfo[126].ConstValueArrayBasedInitValueStartIdxOfRxAccessInfo Com_RxAccessInfo[126].DynSignalOfRxAccessInfo Com_RxAccessInfo[126].InitValueIdxOfRxAccessInfo Com_RxAccessInfo[126].InitValueOfRxAccessInfo Com_RxAccessInfo[126].InvValueIdxOfRxAccessInfo Com_RxAccessInfo[126].InvValueOfRxAccessInfo Com_RxAccessInfo[126].IsGroupSignalOfRxAccessInfo Com_RxAccessInfo[126].RxDataTimeoutSubstitutionValueIdxOfRxAccessInfo Com_RxAccessInfo[126].RxDataTimeoutSubstitutionValueOfRxAccessInfo Com_RxAccessInfo[126].RxPduInfoIdxOfRxAccessInfo Com_RxAccessInfo[126].RxSigBufferArrayBasedBufferEndIdxOfRxAccessInfo Com_RxAccessInfo[126].RxSigBufferArrayBasedBufferStartIdxOfRxAccessInfo Com_RxAccessInfo[126].RxSigBufferArrayBasedShdBufferEndIdxOfRxAccessInfo Com_RxAccessInfo[126].RxSigBufferArrayBasedShdBufferStartIdxOfRxAccessInfo Com_RxAccessInfo[126].RxTOutInfoIdxOfRxAccessInfo Com_RxAccessInfo[126].ShdBufferIdxOfRxAccessInfo Com_RxAccessInfo[126].SignalLengthInByteOfRxAccessInfo Com_RxAccessInfo[126].StartByteInPduPositionOfRxAccessInfo Com_RxAccessInfo[126].TmpBufferIdxOfRxAccessInfo Com_RxAccessInfo[126].TmpBufferOfRxAccessInfo Com_RxAccessInfo[126].TmpRxShdBufferArrayBasedTmpBufferEndIdxOfRxAccessInfo Com_RxAccessInfo[126].TmpRxShdBufferArrayBasedTmpBufferStartIdxOfRxAccessInfo Com_RxAccessInfo[127].ApplTypeOfRxAccessInfo Com_RxAccessInfo[127].BitLengthOfRxAccessInfo Com_RxAccessInfo[127].BitPositionOfRxAccessInfo Com_RxAccessInfo[127].BufferIdxOfRxAccessInfo Com_RxAccessInfo[127].BusAccOfRxAccessInfo Com_RxAccessInfo[127].ByteLengthOfRxAccessInfo Com_RxAccessInfo[127].ConstValueArrayBasedInitValueEndIdxOfRxAccessInfo Com_RxAccessInfo[127].ConstValueArrayBasedInitValueStartIdxOfRxAccessInfo Com_RxAccessInfo[127].DynSignalOfRxAccessInfo Com_RxAccessInfo[127].InitValueIdxOfRxAccessInfo Com_RxAccessInfo[127].InitValueOfRxAccessInfo Com_RxAccessInfo[127].InvValueIdxOfRxAccessInfo Com_RxAccessInfo[127].InvValueOfRxAccessInfo Com_RxAccessInfo[127].IsGroupSignalOfRxAccessInfo Com_RxAccessInfo[127].RxDataTimeoutSubstitutionValueIdxOfRxAccessInfo Com_RxAccessInfo[127].RxDataTimeoutSubstitutionValueOfRxAccessInfo Com_RxAccessInfo[127].RxPduInfoIdxOfRxAccessInfo Com_RxAccessInfo[127].RxSigBufferArrayBasedBufferEndIdxOfRxAccessInfo Com_RxAccessInfo[127].RxSigBufferArrayBasedBufferStartIdxOfRxAccessInfo Com_RxAccessInfo[127].RxSigBufferArrayBasedShdBufferEndIdxOfRxAccessInfo Com_RxAccessInfo[127].RxSigBufferArrayBasedShdBufferStartIdxOfRxAccessInfo Com_RxAccessInfo[127].RxTOutInfoIdxOfRxAccessInfo Com_RxAccessInfo[127].ShdBufferIdxOfRxAccessInfo Com_RxAccessInfo[127].SignalLengthInByteOfRxAccessInfo Com_RxAccessInfo[127].StartByteInPduPositionOfRxAccessInfo Com_RxAccessInfo[127].TmpBufferIdxOfRxAccessInfo Com_RxAccessInfo[127].TmpBufferOfRxAccessInfo Com_RxAccessInfo[127].TmpRxShdBufferArrayBasedTmpBufferEndIdxOfRxAccessInfo Com_RxAccessInfo[127].TmpRxShdBufferArrayBasedTmpBufferStartIdxOfRxAccessInfo Com_RxAccessInfo[128].ApplTypeOfRxAccessInfo Com_RxAccessInfo[128].BitLengthOfRxAccessInfo Com_RxAccessInfo[128].BitPositionOfRxAccessInfo Com_RxAccessInfo[128].BufferIdxOfRxAccessInfo Com_RxAccessInfo[128].BusAccOfRxAccessInfo Com_RxAccessInfo[128].ByteLengthOfRxAccessInfo Com_RxAccessInfo[128].ConstValueArrayBasedInitValueEndIdxOfRxAccessInfo Com_RxAccessInfo[128].ConstValueArrayBasedInitValueStartIdxOfRxAccessInfo Com_RxAccessInfo[128].DynSignalOfRxAccessInfo Com_RxAccessInfo[128].InitValueIdxOfRxAccessInfo Com_RxAccessInfo[128].InitValueOfRxAccessInfo Com_RxAccessInfo[128].InvValueIdxOfRxAccessInfo Com_RxAccessInfo[128].InvValueOfRxAccessInfo Com_RxAccessInfo[128].IsGroupSignalOfRxAccessInfo Com_RxAccessInfo[128].RxDataTimeoutSubstitutionValueIdxOfRxAccessInfo Com_RxAccessInfo[128].RxDataTimeoutSubstitutionValueOfRxAccessInfo Com_RxAccessInfo[128].RxPduInfoIdxOfRxAccessInfo Com_RxAccessInfo[128].RxSigBufferArrayBasedBufferEndIdxOfRxAccessInfo Com_RxAccessInfo[128].RxSigBufferArrayBasedBufferStartIdxOfRxAccessInfo Com_RxAccessInfo[128].RxSigBufferArrayBasedShdBufferEndIdxOfRxAccessInfo Com_RxAccessInfo[128].RxSigBufferArrayBasedShdBufferStartIdxOfRxAccessInfo Com_RxAccessInfo[128].RxTOutInfoIdxOfRxAccessInfo Com_RxAccessInfo[128].ShdBufferIdxOfRxAccessInfo Com_RxAccessInfo[128].SignalLengthInByteOfRxAccessInfo Com_RxAccessInfo[128].StartByteInPduPositionOfRxAccessInfo Com_RxAccessInfo[128].TmpBufferIdxOfRxAccessInfo Com_RxAccessInfo[128].TmpBufferOfRxAccessInfo Com_RxAccessInfo[128].TmpRxShdBufferArrayBasedTmpBufferEndIdxOfRxAccessInfo Com_RxAccessInfo[128].TmpRxShdBufferArrayBasedTmpBufferStartIdxOfRxAccessInfo Com_RxAccessInfo[129].ApplTypeOfRxAccessInfo Com_RxAccessInfo[129].BitLengthOfRxAccessInfo Com_RxAccessInfo[129].BitPositionOfRxAccessInfo Com_RxAccessInfo[129].BufferIdxOfRxAccessInfo Com_RxAccessInfo[129].BusAccOfRxAccessInfo Com_RxAccessInfo[129].ByteLengthOfRxAccessInfo Com_RxAccessInfo[129].ConstValueArrayBasedInitValueEndIdxOfRxAccessInfo Com_RxAccessInfo[129].ConstValueArrayBasedInitValueStartIdxOfRxAccessInfo Com_RxAccessInfo[129].DynSignalOfRxAccessInfo Com_RxAccessInfo[129].InitValueIdxOfRxAccessInfo Com_RxAccessInfo[129].InitValueOfRxAccessInfo Com_RxAccessInfo[129].InvValueIdxOfRxAccessInfo Com_RxAccessInfo[129].InvValueOfRxAccessInfo Com_RxAccessInfo[129].IsGroupSignalOfRxAccessInfo Com_RxAccessInfo[129].RxDataTimeoutSubstitutionValueIdxOfRxAccessInfo Com_RxAccessInfo[129].RxDataTimeoutSubstitutionValueOfRxAccessInfo Com_RxAccessInfo[129].RxPduInfoIdxOfRxAccessInfo Com_RxAccessInfo[129].RxSigBufferArrayBasedBufferEndIdxOfRxAccessInfo Com_RxAccessInfo[129].RxSigBufferArrayBasedBufferStartIdxOfRxAccessInfo Com_RxAccessInfo[129].RxSigBufferArrayBasedShdBufferEndIdxOfRxAccessInfo Com_RxAccessInfo[129].RxSigBufferArrayBasedShdBufferStartIdxOfRxAccessInfo Com_RxAccessInfo[129].RxTOutInfoIdxOfRxAccessInfo Com_RxAccessInfo[129].ShdBufferIdxOfRxAccessInfo Com_RxAccessInfo[129].SignalLengthInByteOfRxAccessInfo Com_RxAccessInfo[129].StartByteInPduPositionOfRxAccessInfo Com_RxAccessInfo[129].TmpBufferIdxOfRxAccessInfo Com_RxAccessInfo[129].TmpBufferOfRxAccessInfo Com_RxAccessInfo[129].TmpRxShdBufferArrayBasedTmpBufferEndIdxOfRxAccessInfo Com_RxAccessInfo[129].TmpRxShdBufferArrayBasedTmpBufferStartIdxOfRxAccessInfo Com_RxAccessInfo[12].ApplTypeOfRxAccessInfo Com_RxAccessInfo[12].BitLengthOfRxAccessInfo Com_RxAccessInfo[12].BitPositionOfRxAccessInfo Com_RxAccessInfo[12].BufferIdxOfRxAccessInfo Com_RxAccessInfo[12].BusAccOfRxAccessInfo Com_RxAccessInfo[12].ByteLengthOfRxAccessInfo Com_RxAccessInfo[12].ConstValueArrayBasedInitValueEndIdxOfRxAccessInfo Com_RxAccessInfo[12].ConstValueArrayBasedInitValueStartIdxOfRxAccessInfo Com_RxAccessInfo[12].DynSignalOfRxAccessInfo Com_RxAccessInfo[12].InitValueIdxOfRxAccessInfo Com_RxAccessInfo[12].InitValueOfRxAccessInfo Com_RxAccessInfo[12].InvValueIdxOfRxAccessInfo Com_RxAccessInfo[12].InvValueOfRxAccessInfo Com_RxAccessInfo[12].IsGroupSignalOfRxAccessInfo Com_RxAccessInfo[12].RxDataTimeoutSubstitutionValueIdxOfRxAccessInfo Com_RxAccessInfo[12].RxDataTimeoutSubstitutionValueOfRxAccessInfo Com_RxAccessInfo[12].RxPduInfoIdxOfRxAccessInfo Com_RxAccessInfo[12].RxSigBufferArrayBasedBufferEndIdxOfRxAccessInfo Com_RxAccessInfo[12].RxSigBufferArrayBasedBufferStartIdxOfRxAccessInfo Com_RxAccessInfo[12].RxSigBufferArrayBasedShdBufferEndIdxOfRxAccessInfo Com_RxAccessInfo[12].RxSigBufferArrayBasedShdBufferStartIdxOfRxAccessInfo Com_RxAccessInfo[12].RxTOutInfoIdxOfRxAccessInfo Com_RxAccessInfo[12].ShdBufferIdxOfRxAccessInfo Com_RxAccessInfo[12].SignalLengthInByteOfRxAccessInfo Com_RxAccessInfo[12].StartByteInPduPositionOfRxAccessInfo Com_RxAccessInfo[12].TmpBufferIdxOfRxAccessInfo Com_RxAccessInfo[12].TmpBufferOfRxAccessInfo Com_RxAccessInfo[12].TmpRxShdBufferArrayBasedTmpBufferEndIdxOfRxAccessInfo Com_RxAccessInfo[12].TmpRxShdBufferArrayBasedTmpBufferStartIdxOfRxAccessInfo Com_RxAccessInfo[130].ApplTypeOfRxAccessInfo Com_RxAccessInfo[130].BitLengthOfRxAccessInfo Com_RxAccessInfo[130].BitPositionOfRxAccessInfo Com_RxAccessInfo[130].BufferIdxOfRxAccessInfo Com_RxAccessInfo[130].BusAccOfRxAccessInfo Com_RxAccessInfo[130].ByteLengthOfRxAccessInfo Com_RxAccessInfo[130].ConstValueArrayBasedInitValueEndIdxOfRxAccessInfo Com_RxAccessInfo[130].ConstValueArrayBasedInitValueStartIdxOfRxAccessInfo Com_RxAccessInfo[130].DynSignalOfRxAccessInfo Com_RxAccessInfo[130].InitValueIdxOfRxAccessInfo Com_RxAccessInfo[130].InitValueOfRxAccessInfo Com_RxAccessInfo[130].InvValueIdxOfRxAccessInfo Com_RxAccessInfo[130].InvValueOfRxAccessInfo Com_RxAccessInfo[130].IsGroupSignalOfRxAccessInfo Com_RxAccessInfo[130].RxDataTimeoutSubstitutionValueIdxOfRxAccessInfo Com_RxAccessInfo[130].RxDataTimeoutSubstitutionValueOfRxAccessInfo Com_RxAccessInfo[130].RxPduInfoIdxOfRxAccessInfo Com_RxAccessInfo[130].RxSigBufferArrayBasedBufferEndIdxOfRxAccessInfo Com_RxAccessInfo[130].RxSigBufferArrayBasedBufferStartIdxOfRxAccessInfo Com_RxAccessInfo[130].RxSigBufferArrayBasedShdBufferEndIdxOfRxAccessInfo Com_RxAccessInfo[130].RxSigBufferArrayBasedShdBufferStartIdxOfRxAccessInfo Com_RxAccessInfo[130].RxTOutInfoIdxOfRxAccessInfo Com_RxAccessInfo[130].ShdBufferIdxOfRxAccessInfo Com_RxAccessInfo[130].SignalLengthInByteOfRxAccessInfo Com_RxAccessInfo[130].StartByteInPduPositionOfRxAccessInfo Com_RxAccessInfo[130].TmpBufferIdxOfRxAccessInfo Com_RxAccessInfo[130].TmpBufferOfRxAccessInfo Com_RxAccessInfo[130].TmpRxShdBufferArrayBasedTmpBufferEndIdxOfRxAccessInfo Com_RxAccessInfo[130].TmpRxShdBufferArrayBasedTmpBufferStartIdxOfRxAccessInfo Com_RxAccessInfo[131].ApplTypeOfRxAccessInfo Com_RxAccessInfo[131].BitLengthOfRxAccessInfo Com_RxAccessInfo[131].BitPositionOfRxAccessInfo Com_RxAccessInfo[131].BufferIdxOfRxAccessInfo Com_RxAccessInfo[131].BusAccOfRxAccessInfo Com_RxAccessInfo[131].ByteLengthOfRxAccessInfo Com_RxAccessInfo[131].ConstValueArrayBasedInitValueEndIdxOfRxAccessInfo Com_RxAccessInfo[131].ConstValueArrayBasedInitValueStartIdxOfRxAccessInfo Com_RxAccessInfo[131].DynSignalOfRxAccessInfo Com_RxAccessInfo[131].InitValueIdxOfRxAccessInfo Com_RxAccessInfo[131].InitValueOfRxAccessInfo Com_RxAccessInfo[131].InvValueIdxOfRxAccessInfo Com_RxAccessInfo[131].InvValueOfRxAccessInfo Com_RxAccessInfo[131].IsGroupSignalOfRxAccessInfo Com_RxAccessInfo[131].RxDataTimeoutSubstitutionValueIdxOfRxAccessInfo Com_RxAccessInfo[131].RxDataTimeoutSubstitutionValueOfRxAccessInfo Com_RxAccessInfo[131].RxPduInfoIdxOfRxAccessInfo Com_RxAccessInfo[131].RxSigBufferArrayBasedBufferEndIdxOfRxAccessInfo Com_RxAccessInfo[131].RxSigBufferArrayBasedBufferStartIdxOfRxAccessInfo Com_RxAccessInfo[131].RxSigBufferArrayBasedShdBufferEndIdxOfRxAccessInfo Com_RxAccessInfo[131].RxSigBufferArrayBasedShdBufferStartIdxOfRxAccessInfo Com_RxAccessInfo[131].RxTOutInfoIdxOfRxAccessInfo Com_RxAccessInfo[131].ShdBufferIdxOfRxAccessInfo Com_RxAccessInfo[131].SignalLengthInByteOfRxAccessInfo Com_RxAccessInfo[131].StartByteInPduPositionOfRxAccessInfo Com_RxAccessInfo[131].TmpBufferIdxOfRxAccessInfo Com_RxAccessInfo[131].TmpBufferOfRxAccessInfo Com_RxAccessInfo[131].TmpRxShdBufferArrayBasedTmpBufferEndIdxOfRxAccessInfo Com_RxAccessInfo[131].TmpRxShdBufferArrayBasedTmpBufferStartIdxOfRxAccessInfo Com_RxAccessInfo[132].ApplTypeOfRxAccessInfo Com_RxAccessInfo[132].BitLengthOfRxAccessInfo Com_RxAccessInfo[132].BitPositionOfRxAccessInfo Com_RxAccessInfo[132].BufferIdxOfRxAccessInfo Com_RxAccessInfo[132].BusAccOfRxAccessInfo Com_RxAccessInfo[132].ByteLengthOfRxAccessInfo Com_RxAccessInfo[132].ConstValueArrayBasedInitValueEndIdxOfRxAccessInfo Com_RxAccessInfo[132].ConstValueArrayBasedInitValueStartIdxOfRxAccessInfo Com_RxAccessInfo[132].DynSignalOfRxAccessInfo Com_RxAccessInfo[132].InitValueIdxOfRxAccessInfo Com_RxAccessInfo[132].InitValueOfRxAccessInfo Com_RxAccessInfo[132].InvValueIdxOfRxAccessInfo Com_RxAccessInfo[132].InvValueOfRxAccessInfo Com_RxAccessInfo[132].IsGroupSignalOfRxAccessInfo Com_RxAccessInfo[132].RxDataTimeoutSubstitutionValueIdxOfRxAccessInfo Com_RxAccessInfo[132].RxDataTimeoutSubstitutionValueOfRxAccessInfo Com_RxAccessInfo[132].RxPduInfoIdxOfRxAccessInfo Com_RxAccessInfo[132].RxSigBufferArrayBasedBufferEndIdxOfRxAccessInfo Com_RxAccessInfo[132].RxSigBufferArrayBasedBufferStartIdxOfRxAccessInfo Com_RxAccessInfo[132].RxSigBufferArrayBasedShdBufferEndIdxOfRxAccessInfo Com_RxAccessInfo[132].RxSigBufferArrayBasedShdBufferStartIdxOfRxAccessInfo Com_RxAccessInfo[132].RxTOutInfoIdxOfRxAccessInfo Com_RxAccessInfo[132].ShdBufferIdxOfRxAccessInfo Com_RxAccessInfo[132].SignalLengthInByteOfRxAccessInfo Com_RxAccessInfo[132].StartByteInPduPositionOfRxAccessInfo Com_RxAccessInfo[132].TmpBufferIdxOfRxAccessInfo Com_RxAccessInfo[132].TmpBufferOfRxAccessInfo Com_RxAccessInfo[132].TmpRxShdBufferArrayBasedTmpBufferEndIdxOfRxAccessInfo Com_RxAccessInfo[132].TmpRxShdBufferArrayBasedTmpBufferStartIdxOfRxAccessInfo Com_RxAccessInfo[133].ApplTypeOfRxAccessInfo Com_RxAccessInfo[133].BitLengthOfRxAccessInfo Com_RxAccessInfo[133].BitPositionOfRxAccessInfo Com_RxAccessInfo[133].BufferIdxOfRxAccessInfo Com_RxAccessInfo[133].BusAccOfRxAccessInfo Com_RxAccessInfo[133].ByteLengthOfRxAccessInfo Com_RxAccessInfo[133].ConstValueArrayBasedInitValueEndIdxOfRxAccessInfo Com_RxAccessInfo[133].ConstValueArrayBasedInitValueStartIdxOfRxAccessInfo Com_RxAccessInfo[133].DynSignalOfRxAccessInfo Com_RxAccessInfo[133].InitValueIdxOfRxAccessInfo Com_RxAccessInfo[133].InitValueOfRxAccessInfo Com_RxAccessInfo[133].InvValueIdxOfRxAccessInfo Com_RxAccessInfo[133].InvValueOfRxAccessInfo Com_RxAccessInfo[133].IsGroupSignalOfRxAccessInfo Com_RxAccessInfo[133].RxDataTimeoutSubstitutionValueIdxOfRxAccessInfo Com_RxAccessInfo[133].RxDataTimeoutSubstitutionValueOfRxAccessInfo Com_RxAccessInfo[133].RxPduInfoIdxOfRxAccessInfo Com_RxAccessInfo[133].RxSigBufferArrayBasedBufferEndIdxOfRxAccessInfo Com_RxAccessInfo[133].RxSigBufferArrayBasedBufferStartIdxOfRxAccessInfo Com_RxAccessInfo[133].RxSigBufferArrayBasedShdBufferEndIdxOfRxAccessInfo Com_RxAccessInfo[133].RxSigBufferArrayBasedShdBufferStartIdxOfRxAccessInfo Com_RxAccessInfo[133].RxTOutInfoIdxOfRxAccessInfo Com_RxAccessInfo[133].ShdBufferIdxOfRxAccessInfo Com_RxAccessInfo[133].SignalLengthInByteOfRxAccessInfo Com_RxAccessInfo[133].StartByteInPduPositionOfRxAccessInfo Com_RxAccessInfo[133].TmpBufferIdxOfRxAccessInfo Com_RxAccessInfo[133].TmpBufferOfRxAccessInfo Com_RxAccessInfo[133].TmpRxShdBufferArrayBasedTmpBufferEndIdxOfRxAccessInfo Com_RxAccessInfo[133].TmpRxShdBufferArrayBasedTmpBufferStartIdxOfRxAccessInfo Com_RxAccessInfo[134].ApplTypeOfRxAccessInfo Com_RxAccessInfo[134].BitLengthOfRxAccessInfo Com_RxAccessInfo[134].BitPositionOfRxAccessInfo Com_RxAccessInfo[134].BufferIdxOfRxAccessInfo Com_RxAccessInfo[134].BusAccOfRxAccessInfo Com_RxAccessInfo[134].ByteLengthOfRxAccessInfo Com_RxAccessInfo[134].ConstValueArrayBasedInitValueEndIdxOfRxAccessInfo Com_RxAccessInfo[134].ConstValueArrayBasedInitValueStartIdxOfRxAccessInfo Com_RxAccessInfo[134].DynSignalOfRxAccessInfo Com_RxAccessInfo[134].InitValueIdxOfRxAccessInfo Com_RxAccessInfo[134].InitValueOfRxAccessInfo Com_RxAccessInfo[134].InvValueIdxOfRxAccessInfo Com_RxAccessInfo[134].InvValueOfRxAccessInfo Com_RxAccessInfo[134].IsGroupSignalOfRxAccessInfo Com_RxAccessInfo[134].RxDataTimeoutSubstitutionValueIdxOfRxAccessInfo Com_RxAccessInfo[134].RxDataTimeoutSubstitutionValueOfRxAccessInfo Com_RxAccessInfo[134].RxPduInfoIdxOfRxAccessInfo Com_RxAccessInfo[134].RxSigBufferArrayBasedBufferEndIdxOfRxAccessInfo Com_RxAccessInfo[134].RxSigBufferArrayBasedBufferStartIdxOfRxAccessInfo Com_RxAccessInfo[134].RxSigBufferArrayBasedShdBufferEndIdxOfRxAccessInfo Com_RxAccessInfo[134].RxSigBufferArrayBasedShdBufferStartIdxOfRxAccessInfo Com_RxAccessInfo[134].RxTOutInfoIdxOfRxAccessInfo Com_RxAccessInfo[134].ShdBufferIdxOfRxAccessInfo Com_RxAccessInfo[134].SignalLengthInByteOfRxAccessInfo Com_RxAccessInfo[134].StartByteInPduPositionOfRxAccessInfo Com_RxAccessInfo[134].TmpBufferIdxOfRxAccessInfo Com_RxAccessInfo[134].TmpBufferOfRxAccessInfo Com_RxAccessInfo[134].TmpRxShdBufferArrayBasedTmpBufferEndIdxOfRxAccessInfo Com_RxAccessInfo[134].TmpRxShdBufferArrayBasedTmpBufferStartIdxOfRxAccessInfo Com_RxAccessInfo[135].ApplTypeOfRxAccessInfo Com_RxAccessInfo[135].BitLengthOfRxAccessInfo Com_RxAccessInfo[135].BitPositionOfRxAccessInfo Com_RxAccessInfo[135].BufferIdxOfRxAccessInfo Com_RxAccessInfo[135].BusAccOfRxAccessInfo Com_RxAccessInfo[135].ByteLengthOfRxAccessInfo Com_RxAccessInfo[135].ConstValueArrayBasedInitValueEndIdxOfRxAccessInfo Com_RxAccessInfo[135].ConstValueArrayBasedInitValueStartIdxOfRxAccessInfo Com_RxAccessInfo[135].DynSignalOfRxAccessInfo Com_RxAccessInfo[135].InitValueIdxOfRxAccessInfo Com_RxAccessInfo[135].InitValueOfRxAccessInfo Com_RxAccessInfo[135].InvValueIdxOfRxAccessInfo Com_RxAccessInfo[135].InvValueOfRxAccessInfo Com_RxAccessInfo[135].IsGroupSignalOfRxAccessInfo Com_RxAccessInfo[135].RxDataTimeoutSubstitutionValueIdxOfRxAccessInfo Com_RxAccessInfo[135].RxDataTimeoutSubstitutionValueOfRxAccessInfo Com_RxAccessInfo[135].RxPduInfoIdxOfRxAccessInfo Com_RxAccessInfo[135].RxSigBufferArrayBasedBufferEndIdxOfRxAccessInfo Com_RxAccessInfo[135].RxSigBufferArrayBasedBufferStartIdxOfRxAccessInfo Com_RxAccessInfo[135].RxSigBufferArrayBasedShdBufferEndIdxOfRxAccessInfo Com_RxAccessInfo[135].RxSigBufferArrayBasedShdBufferStartIdxOfRxAccessInfo Com_RxAccessInfo[135].RxTOutInfoIdxOfRxAccessInfo Com_RxAccessInfo[135].ShdBufferIdxOfRxAccessInfo Com_RxAccessInfo[135].SignalLengthInByteOfRxAccessInfo Com_RxAccessInfo[135].StartByteInPduPositionOfRxAccessInfo Com_RxAccessInfo[135].TmpBufferIdxOfRxAccessInfo Com_RxAccessInfo[135].TmpBufferOfRxAccessInfo Com_RxAccessInfo[135].TmpRxShdBufferArrayBasedTmpBufferEndIdxOfRxAccessInfo Com_RxAccessInfo[135].TmpRxShdBufferArrayBasedTmpBufferStartIdxOfRxAccessInfo Com_RxAccessInfo[136].ApplTypeOfRxAccessInfo Com_RxAccessInfo[136].BitLengthOfRxAccessInfo Com_RxAccessInfo[136].BitPositionOfRxAccessInfo Com_RxAccessInfo[136].BufferIdxOfRxAccessInfo Com_RxAccessInfo[136].BusAccOfRxAccessInfo Com_RxAccessInfo[136].ByteLengthOfRxAccessInfo Com_RxAccessInfo[136].ConstValueArrayBasedInitValueEndIdxOfRxAccessInfo Com_RxAccessInfo[136].ConstValueArrayBasedInitValueStartIdxOfRxAccessInfo Com_RxAccessInfo[136].DynSignalOfRxAccessInfo Com_RxAccessInfo[136].InitValueIdxOfRxAccessInfo Com_RxAccessInfo[136].InitValueOfRxAccessInfo Com_RxAccessInfo[136].InvValueIdxOfRxAccessInfo Com_RxAccessInfo[136].InvValueOfRxAccessInfo Com_RxAccessInfo[136].IsGroupSignalOfRxAccessInfo Com_RxAccessInfo[136].RxDataTimeoutSubstitutionValueIdxOfRxAccessInfo Com_RxAccessInfo[136].RxDataTimeoutSubstitutionValueOfRxAccessInfo Com_RxAccessInfo[136].RxPduInfoIdxOfRxAccessInfo Com_RxAccessInfo[136].RxSigBufferArrayBasedBufferEndIdxOfRxAccessInfo Com_RxAccessInfo[136].RxSigBufferArrayBasedBufferStartIdxOfRxAccessInfo Com_RxAccessInfo[136].RxSigBufferArrayBasedShdBufferEndIdxOfRxAccessInfo Com_RxAccessInfo[136].RxSigBufferArrayBasedShdBufferStartIdxOfRxAccessInfo Com_RxAccessInfo[136].RxTOutInfoIdxOfRxAccessInfo Com_RxAccessInfo[136].ShdBufferIdxOfRxAccessInfo Com_RxAccessInfo[136].SignalLengthInByteOfRxAccessInfo Com_RxAccessInfo[136].StartByteInPduPositionOfRxAccessInfo Com_RxAccessInfo[136].TmpBufferIdxOfRxAccessInfo Com_RxAccessInfo[136].TmpBufferOfRxAccessInfo Com_RxAccessInfo[136].TmpRxShdBufferArrayBasedTmpBufferEndIdxOfRxAccessInfo Com_RxAccessInfo[136].TmpRxShdBufferArrayBasedTmpBufferStartIdxOfRxAccessInfo Com_RxAccessInfo[137].ApplTypeOfRxAccessInfo Com_RxAccessInfo[137].BitLengthOfRxAccessInfo Com_RxAccessInfo[137].BitPositionOfRxAccessInfo Com_RxAccessInfo[137].BufferIdxOfRxAccessInfo Com_RxAccessInfo[137].BusAccOfRxAccessInfo Com_RxAccessInfo[137].ByteLengthOfRxAccessInfo Com_RxAccessInfo[137].ConstValueArrayBasedInitValueEndIdxOfRxAccessInfo Com_RxAccessInfo[137].ConstValueArrayBasedInitValueStartIdxOfRxAccessInfo Com_RxAccessInfo[137].DynSignalOfRxAccessInfo Com_RxAccessInfo[137].InitValueIdxOfRxAccessInfo Com_RxAccessInfo[137].InitValueOfRxAccessInfo Com_RxAccessInfo[137].InvValueIdxOfRxAccessInfo Com_RxAccessInfo[137].InvValueOfRxAccessInfo Com_RxAccessInfo[137].IsGroupSignalOfRxAccessInfo Com_RxAccessInfo[137].RxDataTimeoutSubstitutionValueIdxOfRxAccessInfo Com_RxAccessInfo[137].RxDataTimeoutSubstitutionValueOfRxAccessInfo Com_RxAccessInfo[137].RxPduInfoIdxOfRxAccessInfo Com_RxAccessInfo[137].RxSigBufferArrayBasedBufferEndIdxOfRxAccessInfo Com_RxAccessInfo[137].RxSigBufferArrayBasedBufferStartIdxOfRxAccessInfo Com_RxAccessInfo[137].RxSigBufferArrayBasedShdBufferEndIdxOfRxAccessInfo Com_RxAccessInfo[137].RxSigBufferArrayBasedShdBufferStartIdxOfRxAccessInfo Com_RxAccessInfo[137].RxTOutInfoIdxOfRxAccessInfo Com_RxAccessInfo[137].ShdBufferIdxOfRxAccessInfo Com_RxAccessInfo[137].SignalLengthInByteOfRxAccessInfo Com_RxAccessInfo[137].StartByteInPduPositionOfRxAccessInfo Com_RxAccessInfo[137].TmpBufferIdxOfRxAccessInfo Com_RxAccessInfo[137].TmpBufferOfRxAccessInfo Com_RxAccessInfo[137].TmpRxShdBufferArrayBasedTmpBufferEndIdxOfRxAccessInfo Com_RxAccessInfo[137].TmpRxShdBufferArrayBasedTmpBufferStartIdxOfRxAccessInfo Com_RxAccessInfo[138].ApplTypeOfRxAccessInfo Com_RxAccessInfo[138].BitLengthOfRxAccessInfo Com_RxAccessInfo[138].BitPositionOfRxAccessInfo Com_RxAccessInfo[138].BufferIdxOfRxAccessInfo Com_RxAccessInfo[138].BusAccOfRxAccessInfo Com_RxAccessInfo[138].ByteLengthOfRxAccessInfo Com_RxAccessInfo[138].ConstValueArrayBasedInitValueEndIdxOfRxAccessInfo Com_RxAccessInfo[138].ConstValueArrayBasedInitValueStartIdxOfRxAccessInfo Com_RxAccessInfo[138].DynSignalOfRxAccessInfo Com_RxAccessInfo[138].InitValueIdxOfRxAccessInfo Com_RxAccessInfo[138].InitValueOfRxAccessInfo Com_RxAccessInfo[138].InvValueIdxOfRxAccessInfo Com_RxAccessInfo[138].InvValueOfRxAccessInfo Com_RxAccessInfo[138].IsGroupSignalOfRxAccessInfo Com_RxAccessInfo[138].RxDataTimeoutSubstitutionValueIdxOfRxAccessInfo Com_RxAccessInfo[138].RxDataTimeoutSubstitutionValueOfRxAccessInfo Com_RxAccessInfo[138].RxPduInfoIdxOfRxAccessInfo Com_RxAccessInfo[138].RxSigBufferArrayBasedBufferEndIdxOfRxAccessInfo Com_RxAccessInfo[138].RxSigBufferArrayBasedBufferStartIdxOfRxAccessInfo Com_RxAccessInfo[138].RxSigBufferArrayBasedShdBufferEndIdxOfRxAccessInfo Com_RxAccessInfo[138].RxSigBufferArrayBasedShdBufferStartIdxOfRxAccessInfo Com_RxAccessInfo[138].RxTOutInfoIdxOfRxAccessInfo Com_RxAccessInfo[138].ShdBufferIdxOfRxAccessInfo Com_RxAccessInfo[138].SignalLengthInByteOfRxAccessInfo Com_RxAccessInfo[138].StartByteInPduPositionOfRxAccessInfo Com_RxAccessInfo[138].TmpBufferIdxOfRxAccessInfo Com_RxAccessInfo[138].TmpBufferOfRxAccessInfo Com_RxAccessInfo[138].TmpRxShdBufferArrayBasedTmpBufferEndIdxOfRxAccessInfo Com_RxAccessInfo[138].TmpRxShdBufferArrayBasedTmpBufferStartIdxOfRxAccessInfo Com_RxAccessInfo[139].ApplTypeOfRxAccessInfo Com_RxAccessInfo[139].BitLengthOfRxAccessInfo Com_RxAccessInfo[139].BitPositionOfRxAccessInfo Com_RxAccessInfo[139].BufferIdxOfRxAccessInfo Com_RxAccessInfo[139].BusAccOfRxAccessInfo Com_RxAccessInfo[139].ByteLengthOfRxAccessInfo Com_RxAccessInfo[139].ConstValueArrayBasedInitValueEndIdxOfRxAccessInfo Com_RxAccessInfo[139].ConstValueArrayBasedInitValueStartIdxOfRxAccessInfo Com_RxAccessInfo[139].DynSignalOfRxAccessInfo Com_RxAccessInfo[139].InitValueIdxOfRxAccessInfo Com_RxAccessInfo[139].InitValueOfRxAccessInfo Com_RxAccessInfo[139].InvValueIdxOfRxAccessInfo Com_RxAccessInfo[139].InvValueOfRxAccessInfo Com_RxAccessInfo[139].IsGroupSignalOfRxAccessInfo Com_RxAccessInfo[139].RxDataTimeoutSubstitutionValueIdxOfRxAccessInfo Com_RxAccessInfo[139].RxDataTimeoutSubstitutionValueOfRxAccessInfo Com_RxAccessInfo[139].RxPduInfoIdxOfRxAccessInfo Com_RxAccessInfo[139].RxSigBufferArrayBasedBufferEndIdxOfRxAccessInfo Com_RxAccessInfo[139].RxSigBufferArrayBasedBufferStartIdxOfRxAccessInfo Com_RxAccessInfo[139].RxSigBufferArrayBasedShdBufferEndIdxOfRxAccessInfo Com_RxAccessInfo[139].RxSigBufferArrayBasedShdBufferStartIdxOfRxAccessInfo Com_RxAccessInfo[139].RxTOutInfoIdxOfRxAccessInfo Com_RxAccessInfo[139].ShdBufferIdxOfRxAccessInfo Com_RxAccessInfo[139].SignalLengthInByteOfRxAccessInfo Com_RxAccessInfo[139].StartByteInPduPositionOfRxAccessInfo Com_RxAccessInfo[139].TmpBufferIdxOfRxAccessInfo Com_RxAccessInfo[139].TmpBufferOfRxAccessInfo Com_RxAccessInfo[139].TmpRxShdBufferArrayBasedTmpBufferEndIdxOfRxAccessInfo Com_RxAccessInfo[139].TmpRxShdBufferArrayBasedTmpBufferStartIdxOfRxAccessInfo Com_RxAccessInfo[13].ApplTypeOfRxAccessInfo Com_RxAccessInfo[13].BitLengthOfRxAccessInfo Com_RxAccessInfo[13].BitPositionOfRxAccessInfo Com_RxAccessInfo[13].BufferIdxOfRxAccessInfo Com_RxAccessInfo[13].BusAccOfRxAccessInfo Com_RxAccessInfo[13].ByteLengthOfRxAccessInfo Com_RxAccessInfo[13].ConstValueArrayBasedInitValueEndIdxOfRxAccessInfo Com_RxAccessInfo[13].ConstValueArrayBasedInitValueStartIdxOfRxAccessInfo Com_RxAccessInfo[13].DynSignalOfRxAccessInfo Com_RxAccessInfo[13].InitValueIdxOfRxAccessInfo Com_RxAccessInfo[13].InitValueOfRxAccessInfo Com_RxAccessInfo[13].InvValueIdxOfRxAccessInfo Com_RxAccessInfo[13].InvValueOfRxAccessInfo Com_RxAccessInfo[13].IsGroupSignalOfRxAccessInfo Com_RxAccessInfo[13].RxDataTimeoutSubstitutionValueIdxOfRxAccessInfo Com_RxAccessInfo[13].RxDataTimeoutSubstitutionValueOfRxAccessInfo Com_RxAccessInfo[13].RxPduInfoIdxOfRxAccessInfo Com_RxAccessInfo[13].RxSigBufferArrayBasedBufferEndIdxOfRxAccessInfo Com_RxAccessInfo[13].RxSigBufferArrayBasedBufferStartIdxOfRxAccessInfo Com_RxAccessInfo[13].RxSigBufferArrayBasedShdBufferEndIdxOfRxAccessInfo Com_RxAccessInfo[13].RxSigBufferArrayBasedShdBufferStartIdxOfRxAccessInfo Com_RxAccessInfo[13].RxTOutInfoIdxOfRxAccessInfo Com_RxAccessInfo[13].ShdBufferIdxOfRxAccessInfo Com_RxAccessInfo[13].SignalLengthInByteOfRxAccessInfo Com_RxAccessInfo[13].StartByteInPduPositionOfRxAccessInfo Com_RxAccessInfo[13].TmpBufferIdxOfRxAccessInfo Com_RxAccessInfo[13].TmpBufferOfRxAccessInfo Com_RxAccessInfo[13].TmpRxShdBufferArrayBasedTmpBufferEndIdxOfRxAccessInfo Com_RxAccessInfo[13].TmpRxShdBufferArrayBasedTmpBufferStartIdxOfRxAccessInfo Com_RxAccessInfo[140].ApplTypeOfRxAccessInfo Com_RxAccessInfo[140].BitLengthOfRxAccessInfo Com_RxAccessInfo[140].BitPositionOfRxAccessInfo Com_RxAccessInfo[140].BufferIdxOfRxAccessInfo Com_RxAccessInfo[140].BusAccOfRxAccessInfo Com_RxAccessInfo[140].ByteLengthOfRxAccessInfo Com_RxAccessInfo[140].ConstValueArrayBasedInitValueEndIdxOfRxAccessInfo Com_RxAccessInfo[140].ConstValueArrayBasedInitValueStartIdxOfRxAccessInfo Com_RxAccessInfo[140].DynSignalOfRxAccessInfo Com_RxAccessInfo[140].InitValueIdxOfRxAccessInfo Com_RxAccessInfo[140].InitValueOfRxAccessInfo Com_RxAccessInfo[140].InvValueIdxOfRxAccessInfo Com_RxAccessInfo[140].InvValueOfRxAccessInfo Com_RxAccessInfo[140].IsGroupSignalOfRxAccessInfo Com_RxAccessInfo[140].RxDataTimeoutSubstitutionValueIdxOfRxAccessInfo Com_RxAccessInfo[140].RxDataTimeoutSubstitutionValueOfRxAccessInfo Com_RxAccessInfo[140].RxPduInfoIdxOfRxAccessInfo Com_RxAccessInfo[140].RxSigBufferArrayBasedBufferEndIdxOfRxAccessInfo Com_RxAccessInfo[140].RxSigBufferArrayBasedBufferStartIdxOfRxAccessInfo Com_RxAccessInfo[140].RxSigBufferArrayBasedShdBufferEndIdxOfRxAccessInfo Com_RxAccessInfo[140].RxSigBufferArrayBasedShdBufferStartIdxOfRxAccessInfo Com_RxAccessInfo[140].RxTOutInfoIdxOfRxAccessInfo Com_RxAccessInfo[140].ShdBufferIdxOfRxAccessInfo Com_RxAccessInfo[140].SignalLengthInByteOfRxAccessInfo Com_RxAccessInfo[140].StartByteInPduPositionOfRxAccessInfo Com_RxAccessInfo[140].TmpBufferIdxOfRxAccessInfo Com_RxAccessInfo[140].TmpBufferOfRxAccessInfo Com_RxAccessInfo[140].TmpRxShdBufferArrayBasedTmpBufferEndIdxOfRxAccessInfo Com_RxAccessInfo[140].TmpRxShdBufferArrayBasedTmpBufferStartIdxOfRxAccessInfo Com_RxAccessInfo[141].ApplTypeOfRxAccessInfo Com_RxAccessInfo[141].BitLengthOfRxAccessInfo Com_RxAccessInfo[141].BitPositionOfRxAccessInfo Com_RxAccessInfo[141].BufferIdxOfRxAccessInfo Com_RxAccessInfo[141].BusAccOfRxAccessInfo Com_RxAccessInfo[141].ByteLengthOfRxAccessInfo Com_RxAccessInfo[141].ConstValueArrayBasedInitValueEndIdxOfRxAccessInfo Com_RxAccessInfo[141].ConstValueArrayBasedInitValueStartIdxOfRxAccessInfo Com_RxAccessInfo[141].DynSignalOfRxAccessInfo Com_RxAccessInfo[141].InitValueIdxOfRxAccessInfo Com_RxAccessInfo[141].InitValueOfRxAccessInfo Com_RxAccessInfo[141].InvValueIdxOfRxAccessInfo Com_RxAccessInfo[141].InvValueOfRxAccessInfo Com_RxAccessInfo[141].IsGroupSignalOfRxAccessInfo Com_RxAccessInfo[141].RxDataTimeoutSubstitutionValueIdxOfRxAccessInfo Com_RxAccessInfo[141].RxDataTimeoutSubstitutionValueOfRxAccessInfo Com_RxAccessInfo[141].RxPduInfoIdxOfRxAccessInfo Com_RxAccessInfo[141].RxSigBufferArrayBasedBufferEndIdxOfRxAccessInfo Com_RxAccessInfo[141].RxSigBufferArrayBasedBufferStartIdxOfRxAccessInfo Com_RxAccessInfo[141].RxSigBufferArrayBasedShdBufferEndIdxOfRxAccessInfo Com_RxAccessInfo[141].RxSigBufferArrayBasedShdBufferStartIdxOfRxAccessInfo Com_RxAccessInfo[141].RxTOutInfoIdxOfRxAccessInfo Com_RxAccessInfo[141].ShdBufferIdxOfRxAccessInfo Com_RxAccessInfo[141].SignalLengthInByteOfRxAccessInfo Com_RxAccessInfo[141].StartByteInPduPositionOfRxAccessInfo Com_RxAccessInfo[141].TmpBufferIdxOfRxAccessInfo Com_RxAccessInfo[141].TmpBufferOfRxAccessInfo Com_RxAccessInfo[141].TmpRxShdBufferArrayBasedTmpBufferEndIdxOfRxAccessInfo Com_RxAccessInfo[141].TmpRxShdBufferArrayBasedTmpBufferStartIdxOfRxAccessInfo Com_RxAccessInfo[142].ApplTypeOfRxAccessInfo Com_RxAccessInfo[142].BitLengthOfRxAccessInfo Com_RxAccessInfo[142].BitPositionOfRxAccessInfo Com_RxAccessInfo[142].BufferIdxOfRxAccessInfo Com_RxAccessInfo[142].BusAccOfRxAccessInfo Com_RxAccessInfo[142].ByteLengthOfRxAccessInfo Com_RxAccessInfo[142].ConstValueArrayBasedInitValueEndIdxOfRxAccessInfo Com_RxAccessInfo[142].ConstValueArrayBasedInitValueStartIdxOfRxAccessInfo Com_RxAccessInfo[142].DynSignalOfRxAccessInfo Com_RxAccessInfo[142].InitValueIdxOfRxAccessInfo Com_RxAccessInfo[142].InitValueOfRxAccessInfo Com_RxAccessInfo[142].InvValueIdxOfRxAccessInfo Com_RxAccessInfo[142].InvValueOfRxAccessInfo Com_RxAccessInfo[142].IsGroupSignalOfRxAccessInfo Com_RxAccessInfo[142].RxDataTimeoutSubstitutionValueIdxOfRxAccessInfo Com_RxAccessInfo[142].RxDataTimeoutSubstitutionValueOfRxAccessInfo Com_RxAccessInfo[142].RxPduInfoIdxOfRxAccessInfo Com_RxAccessInfo[142].RxSigBufferArrayBasedBufferEndIdxOfRxAccessInfo Com_RxAccessInfo[142].RxSigBufferArrayBasedBufferStartIdxOfRxAccessInfo Com_RxAccessInfo[142].RxSigBufferArrayBasedShdBufferEndIdxOfRxAccessInfo Com_RxAccessInfo[142].RxSigBufferArrayBasedShdBufferStartIdxOfRxAccessInfo Com_RxAccessInfo[142].RxTOutInfoIdxOfRxAccessInfo Com_RxAccessInfo[142].ShdBufferIdxOfRxAccessInfo Com_RxAccessInfo[142].SignalLengthInByteOfRxAccessInfo Com_RxAccessInfo[142].StartByteInPduPositionOfRxAccessInfo Com_RxAccessInfo[142].TmpBufferIdxOfRxAccessInfo Com_RxAccessInfo[142].TmpBufferOfRxAccessInfo Com_RxAccessInfo[142].TmpRxShdBufferArrayBasedTmpBufferEndIdxOfRxAccessInfo Com_RxAccessInfo[142].TmpRxShdBufferArrayBasedTmpBufferStartIdxOfRxAccessInfo Com_RxAccessInfo[143].ApplTypeOfRxAccessInfo Com_RxAccessInfo[143].BitLengthOfRxAccessInfo Com_RxAccessInfo[143].BitPositionOfRxAccessInfo Com_RxAccessInfo[143].BufferIdxOfRxAccessInfo Com_RxAccessInfo[143].BusAccOfRxAccessInfo Com_RxAccessInfo[143].ByteLengthOfRxAccessInfo Com_RxAccessInfo[143].ConstValueArrayBasedInitValueEndIdxOfRxAccessInfo Com_RxAccessInfo[143].ConstValueArrayBasedInitValueStartIdxOfRxAccessInfo Com_RxAccessInfo[143].DynSignalOfRxAccessInfo Com_RxAccessInfo[143].InitValueIdxOfRxAccessInfo Com_RxAccessInfo[143].InitValueOfRxAccessInfo Com_RxAccessInfo[143].InvValueIdxOfRxAccessInfo Com_RxAccessInfo[143].InvValueOfRxAccessInfo Com_RxAccessInfo[143].IsGroupSignalOfRxAccessInfo Com_RxAccessInfo[143].RxDataTimeoutSubstitutionValueIdxOfRxAccessInfo Com_RxAccessInfo[143].RxDataTimeoutSubstitutionValueOfRxAccessInfo Com_RxAccessInfo[143].RxPduInfoIdxOfRxAccessInfo Com_RxAccessInfo[143].RxSigBufferArrayBasedBufferEndIdxOfRxAccessInfo Com_RxAccessInfo[143].RxSigBufferArrayBasedBufferStartIdxOfRxAccessInfo Com_RxAccessInfo[143].RxSigBufferArrayBasedShdBufferEndIdxOfRxAccessInfo Com_RxAccessInfo[143].RxSigBufferArrayBasedShdBufferStartIdxOfRxAccessInfo Com_RxAccessInfo[143].RxTOutInfoIdxOfRxAccessInfo Com_RxAccessInfo[143].ShdBufferIdxOfRxAccessInfo Com_RxAccessInfo[143].SignalLengthInByteOfRxAccessInfo Com_RxAccessInfo[143].StartByteInPduPositionOfRxAccessInfo Com_RxAccessInfo[143].TmpBufferIdxOfRxAccessInfo Com_RxAccessInfo[143].TmpBufferOfRxAccessInfo Com_RxAccessInfo[143].TmpRxShdBufferArrayBasedTmpBufferEndIdxOfRxAccessInfo Com_RxAccessInfo[143].TmpRxShdBufferArrayBasedTmpBufferStartIdxOfRxAccessInfo Com_RxAccessInfo[144].ApplTypeOfRxAccessInfo Com_RxAccessInfo[144].BitLengthOfRxAccessInfo Com_RxAccessInfo[144].BitPositionOfRxAccessInfo Com_RxAccessInfo[144].BufferIdxOfRxAccessInfo Com_RxAccessInfo[144].BusAccOfRxAccessInfo Com_RxAccessInfo[144].ByteLengthOfRxAccessInfo Com_RxAccessInfo[144].ConstValueArrayBasedInitValueEndIdxOfRxAccessInfo Com_RxAccessInfo[144].ConstValueArrayBasedInitValueStartIdxOfRxAccessInfo Com_RxAccessInfo[144].DynSignalOfRxAccessInfo Com_RxAccessInfo[144].InitValueIdxOfRxAccessInfo Com_RxAccessInfo[144].InitValueOfRxAccessInfo Com_RxAccessInfo[144].InvValueIdxOfRxAccessInfo Com_RxAccessInfo[144].InvValueOfRxAccessInfo Com_RxAccessInfo[144].IsGroupSignalOfRxAccessInfo Com_RxAccessInfo[144].RxDataTimeoutSubstitutionValueIdxOfRxAccessInfo Com_RxAccessInfo[144].RxDataTimeoutSubstitutionValueOfRxAccessInfo Com_RxAccessInfo[144].RxPduInfoIdxOfRxAccessInfo Com_RxAccessInfo[144].RxSigBufferArrayBasedBufferEndIdxOfRxAccessInfo Com_RxAccessInfo[144].RxSigBufferArrayBasedBufferStartIdxOfRxAccessInfo Com_RxAccessInfo[144].RxSigBufferArrayBasedShdBufferEndIdxOfRxAccessInfo Com_RxAccessInfo[144].RxSigBufferArrayBasedShdBufferStartIdxOfRxAccessInfo Com_RxAccessInfo[144].RxTOutInfoIdxOfRxAccessInfo Com_RxAccessInfo[144].ShdBufferIdxOfRxAccessInfo Com_RxAccessInfo[144].SignalLengthInByteOfRxAccessInfo Com_RxAccessInfo[144].StartByteInPduPositionOfRxAccessInfo Com_RxAccessInfo[144].TmpBufferIdxOfRxAccessInfo Com_RxAccessInfo[144].TmpBufferOfRxAccessInfo Com_RxAccessInfo[144].TmpRxShdBufferArrayBasedTmpBufferEndIdxOfRxAccessInfo Com_RxAccessInfo[144].TmpRxShdBufferArrayBasedTmpBufferStartIdxOfRxAccessInfo Com_RxAccessInfo[145].ApplTypeOfRxAccessInfo Com_RxAccessInfo[145].BitLengthOfRxAccessInfo Com_RxAccessInfo[145].BitPositionOfRxAccessInfo Com_RxAccessInfo[145].BufferIdxOfRxAccessInfo Com_RxAccessInfo[145].BusAccOfRxAccessInfo Com_RxAccessInfo[145].ByteLengthOfRxAccessInfo Com_RxAccessInfo[145].ConstValueArrayBasedInitValueEndIdxOfRxAccessInfo Com_RxAccessInfo[145].ConstValueArrayBasedInitValueStartIdxOfRxAccessInfo Com_RxAccessInfo[145].DynSignalOfRxAccessInfo Com_RxAccessInfo[145].InitValueIdxOfRxAccessInfo Com_RxAccessInfo[145].InitValueOfRxAccessInfo Com_RxAccessInfo[145].InvValueIdxOfRxAccessInfo Com_RxAccessInfo[145].InvValueOfRxAccessInfo Com_RxAccessInfo[145].IsGroupSignalOfRxAccessInfo Com_RxAccessInfo[145].RxDataTimeoutSubstitutionValueIdxOfRxAccessInfo Com_RxAccessInfo[145].RxDataTimeoutSubstitutionValueOfRxAccessInfo Com_RxAccessInfo[145].RxPduInfoIdxOfRxAccessInfo Com_RxAccessInfo[145].RxSigBufferArrayBasedBufferEndIdxOfRxAccessInfo Com_RxAccessInfo[145].RxSigBufferArrayBasedBufferStartIdxOfRxAccessInfo Com_RxAccessInfo[145].RxSigBufferArrayBasedShdBufferEndIdxOfRxAccessInfo Com_RxAccessInfo[145].RxSigBufferArrayBasedShdBufferStartIdxOfRxAccessInfo Com_RxAccessInfo[145].RxTOutInfoIdxOfRxAccessInfo Com_RxAccessInfo[145].ShdBufferIdxOfRxAccessInfo Com_RxAccessInfo[145].SignalLengthInByteOfRxAccessInfo Com_RxAccessInfo[145].StartByteInPduPositionOfRxAccessInfo Com_RxAccessInfo[145].TmpBufferIdxOfRxAccessInfo Com_RxAccessInfo[145].TmpBufferOfRxAccessInfo Com_RxAccessInfo[145].TmpRxShdBufferArrayBasedTmpBufferEndIdxOfRxAccessInfo Com_RxAccessInfo[145].TmpRxShdBufferArrayBasedTmpBufferStartIdxOfRxAccessInfo Com_RxAccessInfo[146].ApplTypeOfRxAccessInfo Com_RxAccessInfo[146].BitLengthOfRxAccessInfo Com_RxAccessInfo[146].BitPositionOfRxAccessInfo Com_RxAccessInfo[146].BufferIdxOfRxAccessInfo Com_RxAccessInfo[146].BusAccOfRxAccessInfo Com_RxAccessInfo[146].ByteLengthOfRxAccessInfo Com_RxAccessInfo[146].ConstValueArrayBasedInitValueEndIdxOfRxAccessInfo Com_RxAccessInfo[146].ConstValueArrayBasedInitValueStartIdxOfRxAccessInfo Com_RxAccessInfo[146].DynSignalOfRxAccessInfo Com_RxAccessInfo[146].InitValueIdxOfRxAccessInfo Com_RxAccessInfo[146].InitValueOfRxAccessInfo Com_RxAccessInfo[146].InvValueIdxOfRxAccessInfo Com_RxAccessInfo[146].InvValueOfRxAccessInfo Com_RxAccessInfo[146].IsGroupSignalOfRxAccessInfo Com_RxAccessInfo[146].RxDataTimeoutSubstitutionValueIdxOfRxAccessInfo Com_RxAccessInfo[146].RxDataTimeoutSubstitutionValueOfRxAccessInfo Com_RxAccessInfo[146].RxPduInfoIdxOfRxAccessInfo Com_RxAccessInfo[146].RxSigBufferArrayBasedBufferEndIdxOfRxAccessInfo Com_RxAccessInfo[146].RxSigBufferArrayBasedBufferStartIdxOfRxAccessInfo Com_RxAccessInfo[146].RxSigBufferArrayBasedShdBufferEndIdxOfRxAccessInfo Com_RxAccessInfo[146].RxSigBufferArrayBasedShdBufferStartIdxOfRxAccessInfo Com_RxAccessInfo[146].RxTOutInfoIdxOfRxAccessInfo Com_RxAccessInfo[146].ShdBufferIdxOfRxAccessInfo Com_RxAccessInfo[146].SignalLengthInByteOfRxAccessInfo Com_RxAccessInfo[146].StartByteInPduPositionOfRxAccessInfo Com_RxAccessInfo[146].TmpBufferIdxOfRxAccessInfo Com_RxAccessInfo[146].TmpBufferOfRxAccessInfo Com_RxAccessInfo[146].TmpRxShdBufferArrayBasedTmpBufferEndIdxOfRxAccessInfo Com_RxAccessInfo[146].TmpRxShdBufferArrayBasedTmpBufferStartIdxOfRxAccessInfo Com_RxAccessInfo[147].ApplTypeOfRxAccessInfo Com_RxAccessInfo[147].BitLengthOfRxAccessInfo Com_RxAccessInfo[147].BitPositionOfRxAccessInfo Com_RxAccessInfo[147].BufferIdxOfRxAccessInfo /end REF_MEASUREMENT
/end GROUP
/end MODULE
/end PROJECT
