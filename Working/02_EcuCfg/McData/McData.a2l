ASAP2_VERSION 1 71
/begin PROJECT MICROSAR ""
/begin MODULE CPP ""
/begin MOD_COMMON "" BYTE_ORDER MSB_LAST ALIGNMENT_BYTE 1 ALIGNMENT_WORD 2 ALIGNMENT_LONG 4 ALIGNMENT_FLOAT16_IEEE 2 ALIGNMENT_FLOAT32_IEEE 4 ALIGNMENT_FLOAT64_IEEE 8 ALIGNMENT_INT64 8 /end MOD_COMMON
/begin MEASUREMENT CanSM_ChannelVarRecord[0].CanSM_BusOffCounter "" UBYTE NO_COMPU_METHOD 0 0 0 255 ECU_ADDRESS 0x0 /end MEASUREMENT
/begin MEASUREMENT CanSM_ChannelVarRecord[0].CanSM_BusOffFlag "" UBYTE NO_COMPU_METHOD 0 0 0 255 ECU_ADDRESS 0x0 /end MEASUREMENT
/begin MEASUREMENT CanSM_ChannelVarRecord[0].CanSM_CurrentState "" UBYTE CompuMethodEnum_CanSMSubStateTypes 0 0 0 255 ECU_ADDRESS 0x0 /end MEASUREMENT
/begin MEASUREMENT CanSM_ChannelVarRecord[0].CanSM_IndicatedComMode "" UBYTE CompuMethodEnum_ComModeTypes 0 0 0 2 ECU_ADDRESS 0x0 /end MEASUREMENT
/begin MEASUREMENT CanSM_ChannelVarRecord[0].CanSM_LastValidBaudRate "" UWORD NO_COMPU_METHOD 0 0 0 65535 ECU_ADDRESS 0x0 /end MEASUREMENT
/begin MEASUREMENT CanSM_ChannelVarRecord[0].CanSM_ModeRequestRepetitionCounter "" UBYTE NO_COMPU_METHOD 0 0 0 255 ECU_ADDRESS 0x0 /end MEASUREMENT
/begin MEASUREMENT CanSM_ChannelVarRecord[0].CanSM_RequestedComMode "" UBYTE CompuMethodEnum_ComModeTypes 0 0 0 2 ECU_ADDRESS 0x0 /end MEASUREMENT
/begin MEASUREMENT CanSM_ChannelVarRecord[0].CanSM_UniversalTimer "" UWORD NO_COMPU_METHOD 0 0 0 65535 ECU_ADDRESS 0x0 /end MEASUREMENT
/begin MEASUREMENT CanTp_RxState[0].BufferState "" UBYTE NO_COMPU_METHOD 0 0 0 255 ECU_ADDRESS 0x0 /end MEASUREMENT
/begin MEASUREMENT CanTp_RxState[0].ChannelState "" UBYTE NO_COMPU_METHOD 0 0 0 255 ECU_ADDRESS 0x0 /end MEASUREMENT
/begin MEASUREMENT CanTp_RxState[0].DataIndex "" UWORD NO_COMPU_METHOD 0 0 0 65535 ECU_ADDRESS 0x0 /end MEASUREMENT
/begin MEASUREMENT CanTp_RxState[0].DataLength "" UWORD NO_COMPU_METHOD 0 0 0 65535 ECU_ADDRESS 0x0 /end MEASUREMENT
/begin MEASUREMENT CanTp_RxState[0].ExpectedSN "" UBYTE NO_COMPU_METHOD 0 0 0 255 ECU_ADDRESS 0x0 /end MEASUREMENT
/begin MEASUREMENT CanTp_RxState[0].FrameType "" UBYTE NO_COMPU_METHOD 0 0 0 255 ECU_ADDRESS 0x0 /end MEASUREMENT
/begin MEASUREMENT CanTp_RxState[0].ProvidedBufferSize "" UWORD NO_COMPU_METHOD 0 0 0 65535 ECU_ADDRESS 0x0 /end MEASUREMENT
/begin MEASUREMENT CanTp_RxState[0].Timer "" UWORD NO_COMPU_METHOD 0 0 0 65535 ECU_ADDRESS 0x0 /end MEASUREMENT
/begin MEASUREMENT CanTp_RxState[1].BufferState "" UBYTE NO_COMPU_METHOD 0 0 0 255 ECU_ADDRESS 0x0 /end MEASUREMENT
/begin MEASUREMENT CanTp_RxState[1].ChannelState "" UBYTE NO_COMPU_METHOD 0 0 0 255 ECU_ADDRESS 0x0 /end MEASUREMENT
/begin MEASUREMENT CanTp_RxState[1].DataIndex "" UWORD NO_COMPU_METHOD 0 0 0 65535 ECU_ADDRESS 0x0 /end MEASUREMENT
/begin MEASUREMENT CanTp_RxState[1].DataLength "" UWORD NO_COMPU_METHOD 0 0 0 65535 ECU_ADDRESS 0x0 /end MEASUREMENT
/begin MEASUREMENT CanTp_RxState[1].ExpectedSN "" UBYTE NO_COMPU_METHOD 0 0 0 255 ECU_ADDRESS 0x0 /end MEASUREMENT
/begin MEASUREMENT CanTp_RxState[1].FrameType "" UBYTE NO_COMPU_METHOD 0 0 0 255 ECU_ADDRESS 0x0 /end MEASUREMENT
/begin MEASUREMENT CanTp_RxState[1].ProvidedBufferSize "" UWORD NO_COMPU_METHOD 0 0 0 65535 ECU_ADDRESS 0x0 /end MEASUREMENT
/begin MEASUREMENT CanTp_RxState[1].Timer "" UWORD NO_COMPU_METHOD 0 0 0 65535 ECU_ADDRESS 0x0 /end MEASUREMENT
/begin MEASUREMENT CanTp_RxState[2].BufferState "" UBYTE NO_COMPU_METHOD 0 0 0 255 ECU_ADDRESS 0x0 /end MEASUREMENT
/begin MEASUREMENT CanTp_RxState[2].ChannelState "" UBYTE NO_COMPU_METHOD 0 0 0 255 ECU_ADDRESS 0x0 /end MEASUREMENT
/begin MEASUREMENT CanTp_RxState[2].DataIndex "" UWORD NO_COMPU_METHOD 0 0 0 65535 ECU_ADDRESS 0x0 /end MEASUREMENT
/begin MEASUREMENT CanTp_RxState[2].DataLength "" UWORD NO_COMPU_METHOD 0 0 0 65535 ECU_ADDRESS 0x0 /end MEASUREMENT
/begin MEASUREMENT CanTp_RxState[2].ExpectedSN "" UBYTE NO_COMPU_METHOD 0 0 0 255 ECU_ADDRESS 0x0 /end MEASUREMENT
/begin MEASUREMENT CanTp_RxState[2].FrameType "" UBYTE NO_COMPU_METHOD 0 0 0 255 ECU_ADDRESS 0x0 /end MEASUREMENT
/begin MEASUREMENT CanTp_RxState[2].ProvidedBufferSize "" UWORD NO_COMPU_METHOD 0 0 0 65535 ECU_ADDRESS 0x0 /end MEASUREMENT
/begin MEASUREMENT CanTp_RxState[2].Timer "" UWORD NO_COMPU_METHOD 0 0 0 65535 ECU_ADDRESS 0x0 /end MEASUREMENT
/begin MEASUREMENT CanTp_RxState[3].BufferState "" UBYTE NO_COMPU_METHOD 0 0 0 255 ECU_ADDRESS 0x0 /end MEASUREMENT
/begin MEASUREMENT CanTp_RxState[3].ChannelState "" UBYTE NO_COMPU_METHOD 0 0 0 255 ECU_ADDRESS 0x0 /end MEASUREMENT
/begin MEASUREMENT CanTp_RxState[3].DataIndex "" UWORD NO_COMPU_METHOD 0 0 0 65535 ECU_ADDRESS 0x0 /end MEASUREMENT
/begin MEASUREMENT CanTp_RxState[3].DataLength "" UWORD NO_COMPU_METHOD 0 0 0 65535 ECU_ADDRESS 0x0 /end MEASUREMENT
/begin MEASUREMENT CanTp_RxState[3].ExpectedSN "" UBYTE NO_COMPU_METHOD 0 0 0 255 ECU_ADDRESS 0x0 /end MEASUREMENT
/begin MEASUREMENT CanTp_RxState[3].FrameType "" UBYTE NO_COMPU_METHOD 0 0 0 255 ECU_ADDRESS 0x0 /end MEASUREMENT
/begin MEASUREMENT CanTp_RxState[3].ProvidedBufferSize "" UWORD NO_COMPU_METHOD 0 0 0 65535 ECU_ADDRESS 0x0 /end MEASUREMENT
/begin MEASUREMENT CanTp_RxState[3].Timer "" UWORD NO_COMPU_METHOD 0 0 0 65535 ECU_ADDRESS 0x0 /end MEASUREMENT
/begin MEASUREMENT CanTp_RxState[4].BufferState "" UBYTE NO_COMPU_METHOD 0 0 0 255 ECU_ADDRESS 0x0 /end MEASUREMENT
/begin MEASUREMENT CanTp_RxState[4].ChannelState "" UBYTE NO_COMPU_METHOD 0 0 0 255 ECU_ADDRESS 0x0 /end MEASUREMENT
/begin MEASUREMENT CanTp_RxState[4].DataIndex "" UWORD NO_COMPU_METHOD 0 0 0 65535 ECU_ADDRESS 0x0 /end MEASUREMENT
/begin MEASUREMENT CanTp_RxState[4].DataLength "" UWORD NO_COMPU_METHOD 0 0 0 65535 ECU_ADDRESS 0x0 /end MEASUREMENT
/begin MEASUREMENT CanTp_RxState[4].ExpectedSN "" UBYTE NO_COMPU_METHOD 0 0 0 255 ECU_ADDRESS 0x0 /end MEASUREMENT
/begin MEASUREMENT CanTp_RxState[4].FrameType "" UBYTE NO_COMPU_METHOD 0 0 0 255 ECU_ADDRESS 0x0 /end MEASUREMENT
/begin MEASUREMENT CanTp_RxState[4].ProvidedBufferSize "" UWORD NO_COMPU_METHOD 0 0 0 65535 ECU_ADDRESS 0x0 /end MEASUREMENT
/begin MEASUREMENT CanTp_RxState[4].Timer "" UWORD NO_COMPU_METHOD 0 0 0 65535 ECU_ADDRESS 0x0 /end MEASUREMENT
/begin MEASUREMENT CanTp_RxState[5].BufferState "" UBYTE NO_COMPU_METHOD 0 0 0 255 ECU_ADDRESS 0x0 /end MEASUREMENT
/begin MEASUREMENT CanTp_RxState[5].ChannelState "" UBYTE NO_COMPU_METHOD 0 0 0 255 ECU_ADDRESS 0x0 /end MEASUREMENT
/begin MEASUREMENT CanTp_RxState[5].DataIndex "" UWORD NO_COMPU_METHOD 0 0 0 65535 ECU_ADDRESS 0x0 /end MEASUREMENT
/begin MEASUREMENT CanTp_RxState[5].DataLength "" UWORD NO_COMPU_METHOD 0 0 0 65535 ECU_ADDRESS 0x0 /end MEASUREMENT
/begin MEASUREMENT CanTp_RxState[5].ExpectedSN "" UBYTE NO_COMPU_METHOD 0 0 0 255 ECU_ADDRESS 0x0 /end MEASUREMENT
/begin MEASUREMENT CanTp_RxState[5].FrameType "" UBYTE NO_COMPU_METHOD 0 0 0 255 ECU_ADDRESS 0x0 /end MEASUREMENT
/begin MEASUREMENT CanTp_RxState[5].ProvidedBufferSize "" UWORD NO_COMPU_METHOD 0 0 0 65535 ECU_ADDRESS 0x0 /end MEASUREMENT
/begin MEASUREMENT CanTp_RxState[5].Timer "" UWORD NO_COMPU_METHOD 0 0 0 65535 ECU_ADDRESS 0x0 /end MEASUREMENT
/begin MEASUREMENT CanTp_RxState[6].BufferState "" UBYTE NO_COMPU_METHOD 0 0 0 255 ECU_ADDRESS 0x0 /end MEASUREMENT
/begin MEASUREMENT CanTp_RxState[6].ChannelState "" UBYTE NO_COMPU_METHOD 0 0 0 255 ECU_ADDRESS 0x0 /end MEASUREMENT
/begin MEASUREMENT CanTp_RxState[6].DataIndex "" UWORD NO_COMPU_METHOD 0 0 0 65535 ECU_ADDRESS 0x0 /end MEASUREMENT
/begin MEASUREMENT CanTp_RxState[6].DataLength "" UWORD NO_COMPU_METHOD 0 0 0 65535 ECU_ADDRESS 0x0 /end MEASUREMENT
/begin MEASUREMENT CanTp_RxState[6].ExpectedSN "" UBYTE NO_COMPU_METHOD 0 0 0 255 ECU_ADDRESS 0x0 /end MEASUREMENT
/begin MEASUREMENT CanTp_RxState[6].FrameType "" UBYTE NO_COMPU_METHOD 0 0 0 255 ECU_ADDRESS 0x0 /end MEASUREMENT
/begin MEASUREMENT CanTp_RxState[6].ProvidedBufferSize "" UWORD NO_COMPU_METHOD 0 0 0 65535 ECU_ADDRESS 0x0 /end MEASUREMENT
/begin MEASUREMENT CanTp_RxState[6].Timer "" UWORD NO_COMPU_METHOD 0 0 0 65535 ECU_ADDRESS 0x0 /end MEASUREMENT
/begin MEASUREMENT CanTp_RxState[7].BufferState "" UBYTE NO_COMPU_METHOD 0 0 0 255 ECU_ADDRESS 0x0 /end MEASUREMENT
/begin MEASUREMENT CanTp_RxState[7].ChannelState "" UBYTE NO_COMPU_METHOD 0 0 0 255 ECU_ADDRESS 0x0 /end MEASUREMENT
/begin MEASUREMENT CanTp_RxState[7].DataIndex "" UWORD NO_COMPU_METHOD 0 0 0 65535 ECU_ADDRESS 0x0 /end MEASUREMENT
/begin MEASUREMENT CanTp_RxState[7].DataLength "" UWORD NO_COMPU_METHOD 0 0 0 65535 ECU_ADDRESS 0x0 /end MEASUREMENT
/begin MEASUREMENT CanTp_RxState[7].ExpectedSN "" UBYTE NO_COMPU_METHOD 0 0 0 255 ECU_ADDRESS 0x0 /end MEASUREMENT
/begin MEASUREMENT CanTp_RxState[7].FrameType "" UBYTE NO_COMPU_METHOD 0 0 0 255 ECU_ADDRESS 0x0 /end MEASUREMENT
/begin MEASUREMENT CanTp_RxState[7].ProvidedBufferSize "" UWORD NO_COMPU_METHOD 0 0 0 65535 ECU_ADDRESS 0x0 /end MEASUREMENT
/begin MEASUREMENT CanTp_RxState[7].Timer "" UWORD NO_COMPU_METHOD 0 0 0 65535 ECU_ADDRESS 0x0 /end MEASUREMENT
/begin MEASUREMENT CanTp_TxSemaphores[0].Direction "" UBYTE NO_COMPU_METHOD 0 0 0 255 ECU_ADDRESS 0x0 /end MEASUREMENT
/begin MEASUREMENT CanTp_TxSemaphores[0].Handle "" UWORD NO_COMPU_METHOD 0 0 0 65535 ECU_ADDRESS 0x0 /end MEASUREMENT
/begin MEASUREMENT CanTp_TxSemaphores[1].Direction "" UBYTE NO_COMPU_METHOD 0 0 0 255 ECU_ADDRESS 0x0 /end MEASUREMENT
/begin MEASUREMENT CanTp_TxSemaphores[1].Handle "" UWORD NO_COMPU_METHOD 0 0 0 65535 ECU_ADDRESS 0x0 /end MEASUREMENT
/begin MEASUREMENT CanTp_TxSemaphores[2].Direction "" UBYTE NO_COMPU_METHOD 0 0 0 255 ECU_ADDRESS 0x0 /end MEASUREMENT
/begin MEASUREMENT CanTp_TxSemaphores[2].Handle "" UWORD NO_COMPU_METHOD 0 0 0 65535 ECU_ADDRESS 0x0 /end MEASUREMENT
/begin MEASUREMENT CanTp_TxSemaphores[3].Direction "" UBYTE NO_COMPU_METHOD 0 0 0 255 ECU_ADDRESS 0x0 /end MEASUREMENT
/begin MEASUREMENT CanTp_TxSemaphores[3].Handle "" UWORD NO_COMPU_METHOD 0 0 0 65535 ECU_ADDRESS 0x0 /end MEASUREMENT
/begin MEASUREMENT CanTp_TxSemaphores[4].Direction "" UBYTE NO_COMPU_METHOD 0 0 0 255 ECU_ADDRESS 0x0 /end MEASUREMENT
/begin MEASUREMENT CanTp_TxSemaphores[4].Handle "" UWORD NO_COMPU_METHOD 0 0 0 65535 ECU_ADDRESS 0x0 /end MEASUREMENT
/begin MEASUREMENT CanTp_TxSemaphores[5].Direction "" UBYTE NO_COMPU_METHOD 0 0 0 255 ECU_ADDRESS 0x0 /end MEASUREMENT
/begin MEASUREMENT CanTp_TxSemaphores[5].Handle "" UWORD NO_COMPU_METHOD 0 0 0 65535 ECU_ADDRESS 0x0 /end MEASUREMENT
/begin MEASUREMENT CanTp_TxState[0].BlocksizeCounter "" UBYTE NO_COMPU_METHOD 0 0 0 255 ECU_ADDRESS 0x0 /end MEASUREMENT
/begin MEASUREMENT CanTp_TxState[0].BufferState "" UBYTE NO_COMPU_METHOD 0 0 0 255 ECU_ADDRESS 0x0 /end MEASUREMENT
/begin MEASUREMENT CanTp_TxState[0].ChannelState "" UBYTE NO_COMPU_METHOD 0 0 0 255 ECU_ADDRESS 0x0 /end MEASUREMENT
/begin MEASUREMENT CanTp_TxState[0].DataIndex "" UWORD NO_COMPU_METHOD 0 0 0 65535 ECU_ADDRESS 0x0 /end MEASUREMENT
/begin MEASUREMENT CanTp_TxState[0].DataLength "" UWORD NO_COMPU_METHOD 0 0 0 65535 ECU_ADDRESS 0x0 /end MEASUREMENT
/begin MEASUREMENT CanTp_TxState[0].STminTimer "" UBYTE NO_COMPU_METHOD 0 0 0 255 ECU_ADDRESS 0x0 /end MEASUREMENT
/begin MEASUREMENT CanTp_TxState[0].SeqNumber "" UBYTE NO_COMPU_METHOD 0 0 0 255 ECU_ADDRESS 0x0 /end MEASUREMENT
/begin MEASUREMENT CanTp_TxState[0].Timer "" UWORD NO_COMPU_METHOD 0 0 0 65535 ECU_ADDRESS 0x0 /end MEASUREMENT
/begin MEASUREMENT CanTp_TxState[1].BlocksizeCounter "" UBYTE NO_COMPU_METHOD 0 0 0 255 ECU_ADDRESS 0x0 /end MEASUREMENT
/begin MEASUREMENT CanTp_TxState[1].BufferState "" UBYTE NO_COMPU_METHOD 0 0 0 255 ECU_ADDRESS 0x0 /end MEASUREMENT
/begin MEASUREMENT CanTp_TxState[1].ChannelState "" UBYTE NO_COMPU_METHOD 0 0 0 255 ECU_ADDRESS 0x0 /end MEASUREMENT
/begin MEASUREMENT CanTp_TxState[1].DataIndex "" UWORD NO_COMPU_METHOD 0 0 0 65535 ECU_ADDRESS 0x0 /end MEASUREMENT
/begin MEASUREMENT CanTp_TxState[1].DataLength "" UWORD NO_COMPU_METHOD 0 0 0 65535 ECU_ADDRESS 0x0 /end MEASUREMENT
/begin MEASUREMENT CanTp_TxState[1].STminTimer "" UBYTE NO_COMPU_METHOD 0 0 0 255 ECU_ADDRESS 0x0 /end MEASUREMENT
/begin MEASUREMENT CanTp_TxState[1].SeqNumber "" UBYTE NO_COMPU_METHOD 0 0 0 255 ECU_ADDRESS 0x0 /end MEASUREMENT
/begin MEASUREMENT CanTp_TxState[1].Timer "" UWORD NO_COMPU_METHOD 0 0 0 65535 ECU_ADDRESS 0x0 /end MEASUREMENT
/begin MEASUREMENT CanTp_TxState[2].BlocksizeCounter "" UBYTE NO_COMPU_METHOD 0 0 0 255 ECU_ADDRESS 0x0 /end MEASUREMENT
/begin MEASUREMENT CanTp_TxState[2].BufferState "" UBYTE NO_COMPU_METHOD 0 0 0 255 ECU_ADDRESS 0x0 /end MEASUREMENT
/begin MEASUREMENT CanTp_TxState[2].ChannelState "" UBYTE NO_COMPU_METHOD 0 0 0 255 ECU_ADDRESS 0x0 /end MEASUREMENT
/begin MEASUREMENT CanTp_TxState[2].DataIndex "" UWORD NO_COMPU_METHOD 0 0 0 65535 ECU_ADDRESS 0x0 /end MEASUREMENT
/begin MEASUREMENT CanTp_TxState[2].DataLength "" UWORD NO_COMPU_METHOD 0 0 0 65535 ECU_ADDRESS 0x0 /end MEASUREMENT
/begin MEASUREMENT CanTp_TxState[2].STminTimer "" UBYTE NO_COMPU_METHOD 0 0 0 255 ECU_ADDRESS 0x0 /end MEASUREMENT
/begin MEASUREMENT CanTp_TxState[2].SeqNumber "" UBYTE NO_COMPU_METHOD 0 0 0 255 ECU_ADDRESS 0x0 /end MEASUREMENT
/begin MEASUREMENT CanTp_TxState[2].Timer "" UWORD NO_COMPU_METHOD 0 0 0 65535 ECU_ADDRESS 0x0 /end MEASUREMENT
/begin MEASUREMENT CanTp_TxState[3].BlocksizeCounter "" UBYTE NO_COMPU_METHOD 0 0 0 255 ECU_ADDRESS 0x0 /end MEASUREMENT
/begin MEASUREMENT CanTp_TxState[3].BufferState "" UBYTE NO_COMPU_METHOD 0 0 0 255 ECU_ADDRESS 0x0 /end MEASUREMENT
/begin MEASUREMENT CanTp_TxState[3].ChannelState "" UBYTE NO_COMPU_METHOD 0 0 0 255 ECU_ADDRESS 0x0 /end MEASUREMENT
/begin MEASUREMENT CanTp_TxState[3].DataIndex "" UWORD NO_COMPU_METHOD 0 0 0 65535 ECU_ADDRESS 0x0 /end MEASUREMENT
/begin MEASUREMENT CanTp_TxState[3].DataLength "" UWORD NO_COMPU_METHOD 0 0 0 65535 ECU_ADDRESS 0x0 /end MEASUREMENT
/begin MEASUREMENT CanTp_TxState[3].STminTimer "" UBYTE NO_COMPU_METHOD 0 0 0 255 ECU_ADDRESS 0x0 /end MEASUREMENT
/begin MEASUREMENT CanTp_TxState[3].SeqNumber "" UBYTE NO_COMPU_METHOD 0 0 0 255 ECU_ADDRESS 0x0 /end MEASUREMENT
/begin MEASUREMENT CanTp_TxState[3].Timer "" UWORD NO_COMPU_METHOD 0 0 0 65535 ECU_ADDRESS 0x0 /end MEASUREMENT
/begin MEASUREMENT CanTp_TxState[4].BlocksizeCounter "" UBYTE NO_COMPU_METHOD 0 0 0 255 ECU_ADDRESS 0x0 /end MEASUREMENT
/begin MEASUREMENT CanTp_TxState[4].BufferState "" UBYTE NO_COMPU_METHOD 0 0 0 255 ECU_ADDRESS 0x0 /end MEASUREMENT
/begin MEASUREMENT CanTp_TxState[4].ChannelState "" UBYTE NO_COMPU_METHOD 0 0 0 255 ECU_ADDRESS 0x0 /end MEASUREMENT
/begin MEASUREMENT CanTp_TxState[4].DataIndex "" UWORD NO_COMPU_METHOD 0 0 0 65535 ECU_ADDRESS 0x0 /end MEASUREMENT
/begin MEASUREMENT CanTp_TxState[4].DataLength "" UWORD NO_COMPU_METHOD 0 0 0 65535 ECU_ADDRESS 0x0 /end MEASUREMENT
/begin MEASUREMENT CanTp_TxState[4].STminTimer "" UBYTE NO_COMPU_METHOD 0 0 0 255 ECU_ADDRESS 0x0 /end MEASUREMENT
/begin MEASUREMENT CanTp_TxState[4].SeqNumber "" UBYTE NO_COMPU_METHOD 0 0 0 255 ECU_ADDRESS 0x0 /end MEASUREMENT
/begin MEASUREMENT CanTp_TxState[4].Timer "" UWORD NO_COMPU_METHOD 0 0 0 65535 ECU_ADDRESS 0x0 /end MEASUREMENT
/begin MEASUREMENT CanTp_TxState[5].BlocksizeCounter "" UBYTE NO_COMPU_METHOD 0 0 0 255 ECU_ADDRESS 0x0 /end MEASUREMENT
/begin MEASUREMENT CanTp_TxState[5].BufferState "" UBYTE NO_COMPU_METHOD 0 0 0 255 ECU_ADDRESS 0x0 /end MEASUREMENT
/begin MEASUREMENT CanTp_TxState[5].ChannelState "" UBYTE NO_COMPU_METHOD 0 0 0 255 ECU_ADDRESS 0x0 /end MEASUREMENT
/begin MEASUREMENT CanTp_TxState[5].DataIndex "" UWORD NO_COMPU_METHOD 0 0 0 65535 ECU_ADDRESS 0x0 /end MEASUREMENT
/begin MEASUREMENT CanTp_TxState[5].DataLength "" UWORD NO_COMPU_METHOD 0 0 0 65535 ECU_ADDRESS 0x0 /end MEASUREMENT
/begin MEASUREMENT CanTp_TxState[5].STminTimer "" UBYTE NO_COMPU_METHOD 0 0 0 255 ECU_ADDRESS 0x0 /end MEASUREMENT
/begin MEASUREMENT CanTp_TxState[5].SeqNumber "" UBYTE NO_COMPU_METHOD 0 0 0 255 ECU_ADDRESS 0x0 /end MEASUREMENT
/begin MEASUREMENT CanTp_TxState[5].Timer "" UWORD NO_COMPU_METHOD 0 0 0 65535 ECU_ADDRESS 0x0 /end MEASUREMENT
/begin MEASUREMENT Com_AlwaysActiveTxComIPdus[0].PartitionsAlwaysActiveTxComIPdusStructIdxOfAlwaysActiveTxComIPdus "" UBYTE NO_COMPU_METHOD 0 0 0 255 ECU_ADDRESS 0x0 /end MEASUREMENT
/begin MEASUREMENT Com_AlwaysActiveTxComIPdus[1].PartitionsAlwaysActiveTxComIPdusStructIdxOfAlwaysActiveTxComIPdus "" UBYTE NO_COMPU_METHOD 0 0 0 255 ECU_ADDRESS 0x0 /end MEASUREMENT
/begin MEASUREMENT Com_ConstValueArrayBased "Optimized array of commonly used values like initial or invalid values. (UINT8_N, UINT8_DYN)" UBYTE NO_COMPU_METHOD 0 0 0 255 ECU_ADDRESS 0x0 MATRIX_DIM 64 /end MEASUREMENT
/begin MEASUREMENT Com_ConstValueUInt16 "Optimized array of commonly used values like initial or invalid values. (UINT16)" UWORD NO_COMPU_METHOD 0 0 0 65535 ECU_ADDRESS 0x0 MATRIX_DIM 15 /end MEASUREMENT
/begin MEASUREMENT Com_ConstValueUInt32 "Optimized array of commonly used values like initial or invalid values. (UINT32)" ULONG NO_COMPU_METHOD 0 0 0 4294967295 ECU_ADDRESS 0x0 MATRIX_DIM 4 /end MEASUREMENT
/begin MEASUREMENT Com_ConstValueUInt8 "Optimized array of commonly used values like initial or invalid values. (BOOLEAN, UINT8)" UBYTE NO_COMPU_METHOD 0 0 0 255 ECU_ADDRESS 0x0 MATRIX_DIM 15 /end MEASUREMENT
/begin MEASUREMENT Com_CurrentTxMode "Current transmission mode state of all Tx I-PDUs." UBYTE Com_CurrentTxModeType 0 0 0 1 ECU_ADDRESS 0x0 MATRIX_DIM 32 SYMBOL_LINK "Com_CurrentTxMode.raw" 0 /end MEASUREMENT
/begin MEASUREMENT Com_CurrentTxMode_BMC_CMC_Temperatur_01_XIX_HCP5_CANFD01_13d55235_Tx "The element: BMC_CMC_Temperatur_01_XIX_HCP5_CANFD01_13d55235_Tx of Com_CurrentTxMode" UBYTE Com_CurrentTxModeType 0 0 0 1 ECU_ADDRESS 0x0 SYMBOL_LINK "Com_CurrentTxMode.raw[0]" 0 /end MEASUREMENT
/begin MEASUREMENT Com_CurrentTxMode_BMC_CMC_Temperatur_02_XIX_HCP5_CANFD01_f9538f57_Tx "The element: BMC_CMC_Temperatur_02_XIX_HCP5_CANFD01_f9538f57_Tx of Com_CurrentTxMode" UBYTE Com_CurrentTxModeType 0 0 0 1 ECU_ADDRESS 0x0 SYMBOL_LINK "Com_CurrentTxMode.raw[1]" 0 /end MEASUREMENT
/begin MEASUREMENT Com_CurrentTxMode_BMC_CMC_Temperatur_03_XIX_HCP5_CANFD01_160139b6_Tx "The element: BMC_CMC_Temperatur_03_XIX_HCP5_CANFD01_160139b6_Tx of Com_CurrentTxMode" UBYTE Com_CurrentTxModeType 0 0 0 1 ECU_ADDRESS 0x0 SYMBOL_LINK "Com_CurrentTxMode.raw[2]" 0 /end MEASUREMENT
/begin MEASUREMENT Com_CurrentTxMode_BMC_CMC_Zellspannung_01_XIX_HCP5_CANFD01_f76fbfe9_Tx "The element: BMC_CMC_Zellspannung_01_XIX_HCP5_CANFD01_f76fbfe9_Tx of Com_CurrentTxMode" UBYTE Com_CurrentTxModeType 0 0 0 1 ECU_ADDRESS 0x0 SYMBOL_LINK "Com_CurrentTxMode.raw[3]" 0 /end MEASUREMENT
/begin MEASUREMENT Com_CurrentTxMode_BMC_CMC_Zellspannung_02_XIX_HCP5_CANFD01_1de9628b_Tx "The element: BMC_CMC_Zellspannung_02_XIX_HCP5_CANFD01_1de9628b_Tx of Com_CurrentTxMode" UBYTE Com_CurrentTxModeType 0 0 0 1 ECU_ADDRESS 0x0 SYMBOL_LINK "Com_CurrentTxMode.raw[4]" 0 /end MEASUREMENT
/begin MEASUREMENT Com_CurrentTxMode_BMC_CMC_Zellspannung_03_XIX_HCP5_CANFD01_f2bbd46a_Tx "The element: BMC_CMC_Zellspannung_03_XIX_HCP5_CANFD01_f2bbd46a_Tx of Com_CurrentTxMode" UBYTE Com_CurrentTxModeType 0 0 0 1 ECU_ADDRESS 0x0 SYMBOL_LINK "Com_CurrentTxMode.raw[5]" 0 /end MEASUREMENT
/begin MEASUREMENT Com_CurrentTxMode_BMC_CMC_Zellspannung_04_XIX_HCP5_CANFD01_1395de0e_Tx "The element: BMC_CMC_Zellspannung_04_XIX_HCP5_CANFD01_1395de0e_Tx of Com_CurrentTxMode" UBYTE Com_CurrentTxModeType 0 0 0 1 ECU_ADDRESS 0x0 SYMBOL_LINK "Com_CurrentTxMode.raw[6]" 0 /end MEASUREMENT
/begin MEASUREMENT Com_CurrentTxMode_BMC_CMC_Zellspannung_05_XIX_HCP5_CANFD01_fcc768ef_Tx "The element: BMC_CMC_Zellspannung_05_XIX_HCP5_CANFD01_fcc768ef_Tx of Com_CurrentTxMode" UBYTE Com_CurrentTxModeType 0 0 0 1 ECU_ADDRESS 0x0 SYMBOL_LINK "Com_CurrentTxMode.raw[7]" 0 /end MEASUREMENT
/begin MEASUREMENT Com_CurrentTxMode_BMC_HV_01_XIX_HCP5_CANFD01_E2E_fcbbcae3_Tx "The element: BMC_HV_01_XIX_HCP5_CANFD01_E2E_fcbbcae3_Tx of Com_CurrentTxMode" UBYTE Com_CurrentTxModeType 0 0 0 1 ECU_ADDRESS 0x0 SYMBOL_LINK "Com_CurrentTxMode.raw[8]" 0 /end MEASUREMENT
/begin MEASUREMENT Com_CurrentTxMode_BMC_HV_02_XIX_HCP5_CANFD01_E2E_c5c367a3_Tx "The element: BMC_HV_02_XIX_HCP5_CANFD01_E2E_c5c367a3_Tx of Com_CurrentTxMode" UBYTE Com_CurrentTxModeType 0 0 0 1 ECU_ADDRESS 0x0 SYMBOL_LINK "Com_CurrentTxMode.raw[9]" 0 /end MEASUREMENT
/begin MEASUREMENT Com_CurrentTxMode_BMC_HV_03_XIX_HCP5_CANFD01_0617c15c_Tx "The element: BMC_HV_03_XIX_HCP5_CANFD01_0617c15c_Tx of Com_CurrentTxMode" UBYTE Com_CurrentTxModeType 0 0 0 1 ECU_ADDRESS 0x0 SYMBOL_LINK "Com_CurrentTxMode.raw[10]" 0 /end MEASUREMENT
/begin MEASUREMENT Com_CurrentTxMode_BMC_HV_04_XIX_BMC_CAN01_E2E_a4a2e7f5_Tx "The element: BMC_HV_04_XIX_BMC_CAN01_E2E_a4a2e7f5_Tx of Com_CurrentTxMode" UBYTE Com_CurrentTxModeType 0 0 0 1 ECU_ADDRESS 0x0 SYMBOL_LINK "Com_CurrentTxMode.raw[11]" 0 /end MEASUREMENT
/begin MEASUREMENT Com_CurrentTxMode_BMC_HV_05_XIX_HCP5_CANFD01_086b7dd9_Tx "The element: BMC_HV_05_XIX_HCP5_CANFD01_086b7dd9_Tx of Com_CurrentTxMode" UBYTE Com_CurrentTxModeType 0 0 0 1 ECU_ADDRESS 0x0 SYMBOL_LINK "Com_CurrentTxMode.raw[12]" 0 /end MEASUREMENT
/begin MEASUREMENT Com_CurrentTxMode_BMC_HV_06_XIX_HCP5_CANFD01_e2eda0bb_Tx "The element: BMC_HV_06_XIX_HCP5_CANFD01_e2eda0bb_Tx of Com_CurrentTxMode" UBYTE Com_CurrentTxModeType 0 0 0 1 ECU_ADDRESS 0x0 SYMBOL_LINK "Com_CurrentTxMode.raw[13]" 0 /end MEASUREMENT
/begin MEASUREMENT Com_CurrentTxMode_BMC_HV_07_XIX_HCP5_CANFD01_0dbf165a_Tx "The element: BMC_HV_07_XIX_HCP5_CANFD01_0dbf165a_Tx of Com_CurrentTxMode" UBYTE Com_CurrentTxModeType 0 0 0 1 ECU_ADDRESS 0x0 SYMBOL_LINK "Com_CurrentTxMode.raw[14]" 0 /end MEASUREMENT
/begin MEASUREMENT Com_CurrentTxMode_BMC_HV_08_XIX_HCP5_CANFD01_fbc0b232_Tx "The element: BMC_HV_08_XIX_HCP5_CANFD01_fbc0b232_Tx of Com_CurrentTxMode" UBYTE Com_CurrentTxModeType 0 0 0 1 ECU_ADDRESS 0x0 SYMBOL_LINK "Com_CurrentTxMode.raw[15]" 0 /end MEASUREMENT
/begin MEASUREMENT Com_CurrentTxMode_BMC_HV_09_XIX_HCP5_CANFD01_149204d3_Tx "The element: BMC_HV_09_XIX_HCP5_CANFD01_149204d3_Tx of Com_CurrentTxMode" UBYTE Com_CurrentTxModeType 0 0 0 1 ECU_ADDRESS 0x0 SYMBOL_LINK "Com_CurrentTxMode.raw[16]" 0 /end MEASUREMENT
/begin MEASUREMENT Com_CurrentTxMode_BMC_HV_10_XIX_BMC_CAN01_E2E_28add151_Tx "The element: BMC_HV_10_XIX_BMC_CAN01_E2E_28add151_Tx of Com_CurrentTxMode" UBYTE Com_CurrentTxModeType 0 0 0 1 ECU_ADDRESS 0x0 SYMBOL_LINK "Com_CurrentTxMode.raw[17]" 0 /end MEASUREMENT
/begin MEASUREMENT Com_CurrentTxMode_BMC_HV_11_XIX_BMC_CAN01_E2E_ff4f5109_Tx "The element: BMC_HV_11_XIX_BMC_CAN01_E2E_ff4f5109_Tx of Com_CurrentTxMode" UBYTE Com_CurrentTxModeType 0 0 0 1 ECU_ADDRESS 0x0 SYMBOL_LINK "Com_CurrentTxMode.raw[18]" 0 /end MEASUREMENT
/begin MEASUREMENT Com_CurrentTxMode_BMC_HV_12_XIX_BMC_CAN01_E2E_5c19d7a0_Tx "The element: BMC_HV_12_XIX_BMC_CAN01_E2E_5c19d7a0_Tx of Com_CurrentTxMode" UBYTE Com_CurrentTxModeType 0 0 0 1 ECU_ADDRESS 0x0 SYMBOL_LINK "Com_CurrentTxMode.raw[19]" 0 /end MEASUREMENT
/begin MEASUREMENT Com_CurrentTxMode_BMC_HV_13_XIX_BMC_CAN01_E2E_8bfb57f8_Tx "The element: BMC_HV_13_XIX_BMC_CAN01_E2E_8bfb57f8_Tx of Com_CurrentTxMode" UBYTE Com_CurrentTxModeType 0 0 0 1 ECU_ADDRESS 0x0 SYMBOL_LINK "Com_CurrentTxMode.raw[20]" 0 /end MEASUREMENT
/begin MEASUREMENT Com_CurrentTxMode_BMC_HV_14_XIX_HCP5_CANFD01_30db4b60_Tx "The element: BMC_HV_14_XIX_HCP5_CANFD01_30db4b60_Tx of Com_CurrentTxMode" UBYTE Com_CurrentTxModeType 0 0 0 1 ECU_ADDRESS 0x0 SYMBOL_LINK "Com_CurrentTxMode.raw[21]" 0 /end MEASUREMENT
/begin MEASUREMENT Com_CurrentTxMode_DEV_Hybrid_01_Resp_FF_XIX_HCP5_CANFD01_7b20ac63_Tx "The element: DEV_Hybrid_01_Resp_FF_XIX_HCP5_CANFD01_7b20ac63_Tx of Com_CurrentTxMode" UBYTE Com_CurrentTxModeType 0 0 0 1 ECU_ADDRESS 0x0 SYMBOL_LINK "Com_CurrentTxMode.raw[22]" 0 /end MEASUREMENT
/begin MEASUREMENT Com_CurrentTxMode_DS_Hybrid_01_XIX_HCP5_CANFD01_b3d0b839_Tx "The element: DS_Hybrid_01_XIX_HCP5_CANFD01_b3d0b839_Tx of Com_CurrentTxMode" UBYTE Com_CurrentTxModeType 0 0 0 1 ECU_ADDRESS 0x0 SYMBOL_LINK "Com_CurrentTxMode.raw[23]" 0 /end MEASUREMENT
/begin MEASUREMENT Com_CurrentTxMode_KN_Hybrid_01_XIX_HCP5_CANFD01_fef84477_Tx "The element: KN_Hybrid_01_XIX_HCP5_CANFD01_fef84477_Tx of Com_CurrentTxMode" UBYTE Com_CurrentTxModeType 0 0 0 1 ECU_ADDRESS 0x0 SYMBOL_LINK "Com_CurrentTxMode.raw[24]" 0 /end MEASUREMENT
/begin MEASUREMENT Com_CurrentTxMode_KS_Hybrid_01_Challenge_K_XIX_HCP5_CANFD01_306d69bd_Tx "The element: KS_Hybrid_01_Challenge_K_XIX_HCP5_CANFD01_306d69bd_Tx of Com_CurrentTxMode" UBYTE Com_CurrentTxModeType 0 0 0 1 ECU_ADDRESS 0x0 SYMBOL_LINK "Com_CurrentTxMode.raw[25]" 0 /end MEASUREMENT
/begin MEASUREMENT Com_CurrentTxMode_KS_Hybrid_01_ReqFrame_XIX_HCP5_CANFD01_b04c52dd_Tx "The element: KS_Hybrid_01_ReqFrame_XIX_HCP5_CANFD01_b04c52dd_Tx of Com_CurrentTxMode" UBYTE Com_CurrentTxModeType 0 0 0 1 ECU_ADDRESS 0x0 SYMBOL_LINK "Com_CurrentTxMode.raw[26]" 0 /end MEASUREMENT
/begin MEASUREMENT Com_CurrentTxMode_KS_Hybrid_01_Response_K_XIX_HCP5_CANFD01_76da782f_Tx "The element: KS_Hybrid_01_Response_K_XIX_HCP5_CANFD01_76da782f_Tx of Com_CurrentTxMode" UBYTE Com_CurrentTxModeType 0 0 0 1 ECU_ADDRESS 0x0 SYMBOL_LINK "Com_CurrentTxMode.raw[27]" 0 /end MEASUREMENT
/begin MEASUREMENT Com_CurrentTxMode_NMH_Hybrid_01_XIX_BMC_CAN01_b22e17f1_Tx "The element: NMH_Hybrid_01_XIX_BMC_CAN01_b22e17f1_Tx of Com_CurrentTxMode" UBYTE Com_CurrentTxModeType 0 0 0 1 ECU_ADDRESS 0x0 SYMBOL_LINK "Com_CurrentTxMode.raw[28]" 0 /end MEASUREMENT
/begin MEASUREMENT Com_CurrentTxMode_NM_Hybrid_01_XIX_HCP5_CANFD01_c84ff8a5_Tx "The element: NM_Hybrid_01_XIX_HCP5_CANFD01_c84ff8a5_Tx of Com_CurrentTxMode" UBYTE Com_CurrentTxModeType 0 0 0 1 ECU_ADDRESS 0x0 SYMBOL_LINK "Com_CurrentTxMode.raw[29]" 0 /end MEASUREMENT
/begin MEASUREMENT Com_CurrentTxMode_OBD_Hybrid_01_XIX_HCP5_CANFD01_40f9dae5_Tx "The element: OBD_Hybrid_01_XIX_HCP5_CANFD01_40f9dae5_Tx of Com_CurrentTxMode" UBYTE Com_CurrentTxModeType 0 0 0 1 ECU_ADDRESS 0x0 SYMBOL_LINK "Com_CurrentTxMode.raw[30]" 0 /end MEASUREMENT
/begin MEASUREMENT Com_CurrentTxMode_SOK_Zeit_Hybrid_01_Chal_01_XIX_HCP5_CANFD01_5939048b_Tx "The element: SOK_Zeit_Hybrid_01_Chal_01_XIX_HCP5_CANFD01_5939048b_Tx of Com_CurrentTxMode" UBYTE Com_CurrentTxModeType 0 0 0 1 ECU_ADDRESS 0x0 SYMBOL_LINK "Com_CurrentTxMode.raw[31]" 0 /end MEASUREMENT
/begin MEASUREMENT Com_CycleTimeCnt "Current counter value of cyclic transmission." UBYTE NO_COMPU_METHOD 0 0 0 255 ECU_ADDRESS 0x0 MATRIX_DIM 32 SYMBOL_LINK "Com_CycleTimeCnt.raw" 0 /end MEASUREMENT
/begin MEASUREMENT Com_CycleTimeCnt_BMC_CMC_Temperatur_01_XIX_HCP5_CANFD01_13d55235_Tx "The element: BMC_CMC_Temperatur_01_XIX_HCP5_CANFD01_13d55235_Tx of Com_CycleTimeCnt" UBYTE NO_COMPU_METHOD 0 0 0 255 ECU_ADDRESS 0x0 SYMBOL_LINK "Com_CycleTimeCnt.raw[0]" 0 /end MEASUREMENT
/begin MEASUREMENT Com_CycleTimeCnt_BMC_CMC_Temperatur_02_XIX_HCP5_CANFD01_f9538f57_Tx "The element: BMC_CMC_Temperatur_02_XIX_HCP5_CANFD01_f9538f57_Tx of Com_CycleTimeCnt" UBYTE NO_COMPU_METHOD 0 0 0 255 ECU_ADDRESS 0x0 SYMBOL_LINK "Com_CycleTimeCnt.raw[1]" 0 /end MEASUREMENT
/begin MEASUREMENT Com_CycleTimeCnt_BMC_CMC_Temperatur_03_XIX_HCP5_CANFD01_160139b6_Tx "The element: BMC_CMC_Temperatur_03_XIX_HCP5_CANFD01_160139b6_Tx of Com_CycleTimeCnt" UBYTE NO_COMPU_METHOD 0 0 0 255 ECU_ADDRESS 0x0 SYMBOL_LINK "Com_CycleTimeCnt.raw[2]" 0 /end MEASUREMENT
/begin MEASUREMENT Com_CycleTimeCnt_BMC_CMC_Zellspannung_01_XIX_HCP5_CANFD01_f76fbfe9_Tx "The element: BMC_CMC_Zellspannung_01_XIX_HCP5_CANFD01_f76fbfe9_Tx of Com_CycleTimeCnt" UBYTE NO_COMPU_METHOD 0 0 0 255 ECU_ADDRESS 0x0 SYMBOL_LINK "Com_CycleTimeCnt.raw[3]" 0 /end MEASUREMENT
/begin MEASUREMENT Com_CycleTimeCnt_BMC_CMC_Zellspannung_02_XIX_HCP5_CANFD01_1de9628b_Tx "The element: BMC_CMC_Zellspannung_02_XIX_HCP5_CANFD01_1de9628b_Tx of Com_CycleTimeCnt" UBYTE NO_COMPU_METHOD 0 0 0 255 ECU_ADDRESS 0x0 SYMBOL_LINK "Com_CycleTimeCnt.raw[4]" 0 /end MEASUREMENT
/begin MEASUREMENT Com_CycleTimeCnt_BMC_CMC_Zellspannung_03_XIX_HCP5_CANFD01_f2bbd46a_Tx "The element: BMC_CMC_Zellspannung_03_XIX_HCP5_CANFD01_f2bbd46a_Tx of Com_CycleTimeCnt" UBYTE NO_COMPU_METHOD 0 0 0 255 ECU_ADDRESS 0x0 SYMBOL_LINK "Com_CycleTimeCnt.raw[5]" 0 /end MEASUREMENT
/begin MEASUREMENT Com_CycleTimeCnt_BMC_CMC_Zellspannung_04_XIX_HCP5_CANFD01_1395de0e_Tx "The element: BMC_CMC_Zellspannung_04_XIX_HCP5_CANFD01_1395de0e_Tx of Com_CycleTimeCnt" UBYTE NO_COMPU_METHOD 0 0 0 255 ECU_ADDRESS 0x0 SYMBOL_LINK "Com_CycleTimeCnt.raw[6]" 0 /end MEASUREMENT
/begin MEASUREMENT Com_CycleTimeCnt_BMC_CMC_Zellspannung_05_XIX_HCP5_CANFD01_fcc768ef_Tx "The element: BMC_CMC_Zellspannung_05_XIX_HCP5_CANFD01_fcc768ef_Tx of Com_CycleTimeCnt" UBYTE NO_COMPU_METHOD 0 0 0 255 ECU_ADDRESS 0x0 SYMBOL_LINK "Com_CycleTimeCnt.raw[7]" 0 /end MEASUREMENT
/begin MEASUREMENT Com_CycleTimeCnt_BMC_HV_01_XIX_HCP5_CANFD01_E2E_fcbbcae3_Tx "The element: BMC_HV_01_XIX_HCP5_CANFD01_E2E_fcbbcae3_Tx of Com_CycleTimeCnt" UBYTE NO_COMPU_METHOD 0 0 0 255 ECU_ADDRESS 0x0 SYMBOL_LINK "Com_CycleTimeCnt.raw[8]" 0 /end MEASUREMENT
/begin MEASUREMENT Com_CycleTimeCnt_BMC_HV_02_XIX_HCP5_CANFD01_E2E_c5c367a3_Tx "The element: BMC_HV_02_XIX_HCP5_CANFD01_E2E_c5c367a3_Tx of Com_CycleTimeCnt" UBYTE NO_COMPU_METHOD 0 0 0 255 ECU_ADDRESS 0x0 SYMBOL_LINK "Com_CycleTimeCnt.raw[9]" 0 /end MEASUREMENT
/begin MEASUREMENT Com_CycleTimeCnt_BMC_HV_03_XIX_HCP5_CANFD01_0617c15c_Tx "The element: BMC_HV_03_XIX_HCP5_CANFD01_0617c15c_Tx of Com_CycleTimeCnt" UBYTE NO_COMPU_METHOD 0 0 0 255 ECU_ADDRESS 0x0 SYMBOL_LINK "Com_CycleTimeCnt.raw[10]" 0 /end MEASUREMENT
/begin MEASUREMENT Com_CycleTimeCnt_BMC_HV_04_XIX_BMC_CAN01_E2E_a4a2e7f5_Tx "The element: BMC_HV_04_XIX_BMC_CAN01_E2E_a4a2e7f5_Tx of Com_CycleTimeCnt" UBYTE NO_COMPU_METHOD 0 0 0 255 ECU_ADDRESS 0x0 SYMBOL_LINK "Com_CycleTimeCnt.raw[11]" 0 /end MEASUREMENT
/begin MEASUREMENT Com_CycleTimeCnt_BMC_HV_05_XIX_HCP5_CANFD01_086b7dd9_Tx "The element: BMC_HV_05_XIX_HCP5_CANFD01_086b7dd9_Tx of Com_CycleTimeCnt" UBYTE NO_COMPU_METHOD 0 0 0 255 ECU_ADDRESS 0x0 SYMBOL_LINK "Com_CycleTimeCnt.raw[12]" 0 /end MEASUREMENT
/begin MEASUREMENT Com_CycleTimeCnt_BMC_HV_06_XIX_HCP5_CANFD01_e2eda0bb_Tx "The element: BMC_HV_06_XIX_HCP5_CANFD01_e2eda0bb_Tx of Com_CycleTimeCnt" UBYTE NO_COMPU_METHOD 0 0 0 255 ECU_ADDRESS 0x0 SYMBOL_LINK "Com_CycleTimeCnt.raw[13]" 0 /end MEASUREMENT
/begin MEASUREMENT Com_CycleTimeCnt_BMC_HV_07_XIX_HCP5_CANFD01_0dbf165a_Tx "The element: BMC_HV_07_XIX_HCP5_CANFD01_0dbf165a_Tx of Com_CycleTimeCnt" UBYTE NO_COMPU_METHOD 0 0 0 255 ECU_ADDRESS 0x0 SYMBOL_LINK "Com_CycleTimeCnt.raw[14]" 0 /end MEASUREMENT
/begin MEASUREMENT Com_CycleTimeCnt_BMC_HV_08_XIX_HCP5_CANFD01_fbc0b232_Tx "The element: BMC_HV_08_XIX_HCP5_CANFD01_fbc0b232_Tx of Com_CycleTimeCnt" UBYTE NO_COMPU_METHOD 0 0 0 255 ECU_ADDRESS 0x0 SYMBOL_LINK "Com_CycleTimeCnt.raw[15]" 0 /end MEASUREMENT
/begin MEASUREMENT Com_CycleTimeCnt_BMC_HV_09_XIX_HCP5_CANFD01_149204d3_Tx "The element: BMC_HV_09_XIX_HCP5_CANFD01_149204d3_Tx of Com_CycleTimeCnt" UBYTE NO_COMPU_METHOD 0 0 0 255 ECU_ADDRESS 0x0 SYMBOL_LINK "Com_CycleTimeCnt.raw[16]" 0 /end MEASUREMENT
/begin MEASUREMENT Com_CycleTimeCnt_BMC_HV_10_XIX_BMC_CAN01_E2E_28add151_Tx "The element: BMC_HV_10_XIX_BMC_CAN01_E2E_28add151_Tx of Com_CycleTimeCnt" UBYTE NO_COMPU_METHOD 0 0 0 255 ECU_ADDRESS 0x0 SYMBOL_LINK "Com_CycleTimeCnt.raw[17]" 0 /end MEASUREMENT
/begin MEASUREMENT Com_CycleTimeCnt_BMC_HV_11_XIX_BMC_CAN01_E2E_ff4f5109_Tx "The element: BMC_HV_11_XIX_BMC_CAN01_E2E_ff4f5109_Tx of Com_CycleTimeCnt" UBYTE NO_COMPU_METHOD 0 0 0 255 ECU_ADDRESS 0x0 SYMBOL_LINK "Com_CycleTimeCnt.raw[18]" 0 /end MEASUREMENT
/begin MEASUREMENT Com_CycleTimeCnt_BMC_HV_12_XIX_BMC_CAN01_E2E_5c19d7a0_Tx "The element: BMC_HV_12_XIX_BMC_CAN01_E2E_5c19d7a0_Tx of Com_CycleTimeCnt" UBYTE NO_COMPU_METHOD 0 0 0 255 ECU_ADDRESS 0x0 SYMBOL_LINK "Com_CycleTimeCnt.raw[19]" 0 /end MEASUREMENT
/begin MEASUREMENT Com_CycleTimeCnt_BMC_HV_13_XIX_BMC_CAN01_E2E_8bfb57f8_Tx "The element: BMC_HV_13_XIX_BMC_CAN01_E2E_8bfb57f8_Tx of Com_CycleTimeCnt" UBYTE NO_COMPU_METHOD 0 0 0 255 ECU_ADDRESS 0x0 SYMBOL_LINK "Com_CycleTimeCnt.raw[20]" 0 /end MEASUREMENT
/begin MEASUREMENT Com_CycleTimeCnt_BMC_HV_14_XIX_HCP5_CANFD01_30db4b60_Tx "The element: BMC_HV_14_XIX_HCP5_CANFD01_30db4b60_Tx of Com_CycleTimeCnt" UBYTE NO_COMPU_METHOD 0 0 0 255 ECU_ADDRESS 0x0 SYMBOL_LINK "Com_CycleTimeCnt.raw[21]" 0 /end MEASUREMENT
/begin MEASUREMENT Com_CycleTimeCnt_DEV_Hybrid_01_Resp_FF_XIX_HCP5_CANFD01_7b20ac63_Tx "The element: DEV_Hybrid_01_Resp_FF_XIX_HCP5_CANFD01_7b20ac63_Tx of Com_CycleTimeCnt" UBYTE NO_COMPU_METHOD 0 0 0 255 ECU_ADDRESS 0x0 SYMBOL_LINK "Com_CycleTimeCnt.raw[22]" 0 /end MEASUREMENT
/begin MEASUREMENT Com_CycleTimeCnt_DS_Hybrid_01_XIX_HCP5_CANFD01_b3d0b839_Tx "The element: DS_Hybrid_01_XIX_HCP5_CANFD01_b3d0b839_Tx of Com_CycleTimeCnt" UBYTE NO_COMPU_METHOD 0 0 0 255 ECU_ADDRESS 0x0 SYMBOL_LINK "Com_CycleTimeCnt.raw[23]" 0 /end MEASUREMENT
/begin MEASUREMENT Com_CycleTimeCnt_KN_Hybrid_01_XIX_HCP5_CANFD01_fef84477_Tx "The element: KN_Hybrid_01_XIX_HCP5_CANFD01_fef84477_Tx of Com_CycleTimeCnt" UBYTE NO_COMPU_METHOD 0 0 0 255 ECU_ADDRESS 0x0 SYMBOL_LINK "Com_CycleTimeCnt.raw[24]" 0 /end MEASUREMENT
/begin MEASUREMENT Com_CycleTimeCnt_KS_Hybrid_01_Challenge_K_XIX_HCP5_CANFD01_306d69bd_Tx "The element: KS_Hybrid_01_Challenge_K_XIX_HCP5_CANFD01_306d69bd_Tx of Com_CycleTimeCnt" UBYTE NO_COMPU_METHOD 0 0 0 255 ECU_ADDRESS 0x0 SYMBOL_LINK "Com_CycleTimeCnt.raw[25]" 0 /end MEASUREMENT
/begin MEASUREMENT Com_CycleTimeCnt_KS_Hybrid_01_ReqFrame_XIX_HCP5_CANFD01_b04c52dd_Tx "The element: KS_Hybrid_01_ReqFrame_XIX_HCP5_CANFD01_b04c52dd_Tx of Com_CycleTimeCnt" UBYTE NO_COMPU_METHOD 0 0 0 255 ECU_ADDRESS 0x0 SYMBOL_LINK "Com_CycleTimeCnt.raw[26]" 0 /end MEASUREMENT
/begin MEASUREMENT Com_CycleTimeCnt_KS_Hybrid_01_Response_K_XIX_HCP5_CANFD01_76da782f_Tx "The element: KS_Hybrid_01_Response_K_XIX_HCP5_CANFD01_76da782f_Tx of Com_CycleTimeCnt" UBYTE NO_COMPU_METHOD 0 0 0 255 ECU_ADDRESS 0x0 SYMBOL_LINK "Com_CycleTimeCnt.raw[27]" 0 /end MEASUREMENT
/begin MEASUREMENT Com_CycleTimeCnt_NMH_Hybrid_01_XIX_BMC_CAN01_b22e17f1_Tx "The element: NMH_Hybrid_01_XIX_BMC_CAN01_b22e17f1_Tx of Com_CycleTimeCnt" UBYTE NO_COMPU_METHOD 0 0 0 255 ECU_ADDRESS 0x0 SYMBOL_LINK "Com_CycleTimeCnt.raw[28]" 0 /end MEASUREMENT
/begin MEASUREMENT Com_CycleTimeCnt_NM_Hybrid_01_XIX_HCP5_CANFD01_c84ff8a5_Tx "The element: NM_Hybrid_01_XIX_HCP5_CANFD01_c84ff8a5_Tx of Com_CycleTimeCnt" UBYTE NO_COMPU_METHOD 0 0 0 255 ECU_ADDRESS 0x0 SYMBOL_LINK "Com_CycleTimeCnt.raw[29]" 0 /end MEASUREMENT
/begin MEASUREMENT Com_CycleTimeCnt_OBD_Hybrid_01_XIX_HCP5_CANFD01_40f9dae5_Tx "The element: OBD_Hybrid_01_XIX_HCP5_CANFD01_40f9dae5_Tx of Com_CycleTimeCnt" UBYTE NO_COMPU_METHOD 0 0 0 255 ECU_ADDRESS 0x0 SYMBOL_LINK "Com_CycleTimeCnt.raw[30]" 0 /end MEASUREMENT
/begin MEASUREMENT Com_CycleTimeCnt_SOK_Zeit_Hybrid_01_Chal_01_XIX_HCP5_CANFD01_5939048b_Tx "The element: SOK_Zeit_Hybrid_01_Chal_01_XIX_HCP5_CANFD01_5939048b_Tx of Com_CycleTimeCnt" UBYTE NO_COMPU_METHOD 0 0 0 255 ECU_ADDRESS 0x0 SYMBOL_LINK "Com_CycleTimeCnt.raw[31]" 0 /end MEASUREMENT
/begin MEASUREMENT Com_CyclicSendRequest "Cyclic send request flag used to indicate cyclic transmission mode for all Tx I-PDU." UBYTE Com_CyclicSendRequestType 0 0 0 1 ECU_ADDRESS 0x0 MATRIX_DIM 32 SYMBOL_LINK "Com_CyclicSendRequest.raw" 0 /end MEASUREMENT
/begin MEASUREMENT Com_CyclicSendRequest_BMC_CMC_Temperatur_01_XIX_HCP5_CANFD01_13d55235_Tx "The element: BMC_CMC_Temperatur_01_XIX_HCP5_CANFD01_13d55235_Tx of Com_CyclicSendRequest" UBYTE Com_CyclicSendRequestType 0 0 0 1 ECU_ADDRESS 0x0 SYMBOL_LINK "Com_CyclicSendRequest.raw[0]" 0 /end MEASUREMENT
/begin MEASUREMENT Com_CyclicSendRequest_BMC_CMC_Temperatur_02_XIX_HCP5_CANFD01_f9538f57_Tx "The element: BMC_CMC_Temperatur_02_XIX_HCP5_CANFD01_f9538f57_Tx of Com_CyclicSendRequest" UBYTE Com_CyclicSendRequestType 0 0 0 1 ECU_ADDRESS 0x0 SYMBOL_LINK "Com_CyclicSendRequest.raw[1]" 0 /end MEASUREMENT
/begin MEASUREMENT Com_CyclicSendRequest_BMC_CMC_Temperatur_03_XIX_HCP5_CANFD01_160139b6_Tx "The element: BMC_CMC_Temperatur_03_XIX_HCP5_CANFD01_160139b6_Tx of Com_CyclicSendRequest" UBYTE Com_CyclicSendRequestType 0 0 0 1 ECU_ADDRESS 0x0 SYMBOL_LINK "Com_CyclicSendRequest.raw[2]" 0 /end MEASUREMENT
/begin MEASUREMENT Com_CyclicSendRequest_BMC_CMC_Zellspannung_01_XIX_HCP5_CANFD01_f76fbfe9_Tx "The element: BMC_CMC_Zellspannung_01_XIX_HCP5_CANFD01_f76fbfe9_Tx of Com_CyclicSendRequest" UBYTE Com_CyclicSendRequestType 0 0 0 1 ECU_ADDRESS 0x0 SYMBOL_LINK "Com_CyclicSendRequest.raw[3]" 0 /end MEASUREMENT
/begin MEASUREMENT Com_CyclicSendRequest_BMC_CMC_Zellspannung_02_XIX_HCP5_CANFD01_1de9628b_Tx "The element: BMC_CMC_Zellspannung_02_XIX_HCP5_CANFD01_1de9628b_Tx of Com_CyclicSendRequest" UBYTE Com_CyclicSendRequestType 0 0 0 1 ECU_ADDRESS 0x0 SYMBOL_LINK "Com_CyclicSendRequest.raw[4]" 0 /end MEASUREMENT
/begin MEASUREMENT Com_CyclicSendRequest_BMC_CMC_Zellspannung_03_XIX_HCP5_CANFD01_f2bbd46a_Tx "The element: BMC_CMC_Zellspannung_03_XIX_HCP5_CANFD01_f2bbd46a_Tx of Com_CyclicSendRequest" UBYTE Com_CyclicSendRequestType 0 0 0 1 ECU_ADDRESS 0x0 SYMBOL_LINK "Com_CyclicSendRequest.raw[5]" 0 /end MEASUREMENT
/begin MEASUREMENT Com_CyclicSendRequest_BMC_CMC_Zellspannung_04_XIX_HCP5_CANFD01_1395de0e_Tx "The element: BMC_CMC_Zellspannung_04_XIX_HCP5_CANFD01_1395de0e_Tx of Com_CyclicSendRequest" UBYTE Com_CyclicSendRequestType 0 0 0 1 ECU_ADDRESS 0x0 SYMBOL_LINK "Com_CyclicSendRequest.raw[6]" 0 /end MEASUREMENT
/begin MEASUREMENT Com_CyclicSendRequest_BMC_CMC_Zellspannung_05_XIX_HCP5_CANFD01_fcc768ef_Tx "The element: BMC_CMC_Zellspannung_05_XIX_HCP5_CANFD01_fcc768ef_Tx of Com_CyclicSendRequest" UBYTE Com_CyclicSendRequestType 0 0 0 1 ECU_ADDRESS 0x0 SYMBOL_LINK "Com_CyclicSendRequest.raw[7]" 0 /end MEASUREMENT
/begin MEASUREMENT Com_CyclicSendRequest_BMC_HV_01_XIX_HCP5_CANFD01_E2E_fcbbcae3_Tx "The element: BMC_HV_01_XIX_HCP5_CANFD01_E2E_fcbbcae3_Tx of Com_CyclicSendRequest" UBYTE Com_CyclicSendRequestType 0 0 0 1 ECU_ADDRESS 0x0 SYMBOL_LINK "Com_CyclicSendRequest.raw[8]" 0 /end MEASUREMENT
/begin MEASUREMENT Com_CyclicSendRequest_BMC_HV_02_XIX_HCP5_CANFD01_E2E_c5c367a3_Tx "The element: BMC_HV_02_XIX_HCP5_CANFD01_E2E_c5c367a3_Tx of Com_CyclicSendRequest" UBYTE Com_CyclicSendRequestType 0 0 0 1 ECU_ADDRESS 0x0 SYMBOL_LINK "Com_CyclicSendRequest.raw[9]" 0 /end MEASUREMENT
/begin MEASUREMENT Com_CyclicSendRequest_BMC_HV_03_XIX_HCP5_CANFD01_0617c15c_Tx "The element: BMC_HV_03_XIX_HCP5_CANFD01_0617c15c_Tx of Com_CyclicSendRequest" UBYTE Com_CyclicSendRequestType 0 0 0 1 ECU_ADDRESS 0x0 SYMBOL_LINK "Com_CyclicSendRequest.raw[10]" 0 /end MEASUREMENT
/begin MEASUREMENT Com_CyclicSendRequest_BMC_HV_04_XIX_BMC_CAN01_E2E_a4a2e7f5_Tx "The element: BMC_HV_04_XIX_BMC_CAN01_E2E_a4a2e7f5_Tx of Com_CyclicSendRequest" UBYTE Com_CyclicSendRequestType 0 0 0 1 ECU_ADDRESS 0x0 SYMBOL_LINK "Com_CyclicSendRequest.raw[11]" 0 /end MEASUREMENT
/begin MEASUREMENT Com_CyclicSendRequest_BMC_HV_05_XIX_HCP5_CANFD01_086b7dd9_Tx "The element: BMC_HV_05_XIX_HCP5_CANFD01_086b7dd9_Tx of Com_CyclicSendRequest" UBYTE Com_CyclicSendRequestType 0 0 0 1 ECU_ADDRESS 0x0 SYMBOL_LINK "Com_CyclicSendRequest.raw[12]" 0 /end MEASUREMENT
/begin MEASUREMENT Com_CyclicSendRequest_BMC_HV_06_XIX_HCP5_CANFD01_e2eda0bb_Tx "The element: BMC_HV_06_XIX_HCP5_CANFD01_e2eda0bb_Tx of Com_CyclicSendRequest" UBYTE Com_CyclicSendRequestType 0 0 0 1 ECU_ADDRESS 0x0 SYMBOL_LINK "Com_CyclicSendRequest.raw[13]" 0 /end MEASUREMENT
/begin MEASUREMENT Com_CyclicSendRequest_BMC_HV_07_XIX_HCP5_CANFD01_0dbf165a_Tx "The element: BMC_HV_07_XIX_HCP5_CANFD01_0dbf165a_Tx of Com_CyclicSendRequest" UBYTE Com_CyclicSendRequestType 0 0 0 1 ECU_ADDRESS 0x0 SYMBOL_LINK "Com_CyclicSendRequest.raw[14]" 0 /end MEASUREMENT
/begin MEASUREMENT Com_CyclicSendRequest_BMC_HV_08_XIX_HCP5_CANFD01_fbc0b232_Tx "The element: BMC_HV_08_XIX_HCP5_CANFD01_fbc0b232_Tx of Com_CyclicSendRequest" UBYTE Com_CyclicSendRequestType 0 0 0 1 ECU_ADDRESS 0x0 SYMBOL_LINK "Com_CyclicSendRequest.raw[15]" 0 /end MEASUREMENT
/begin MEASUREMENT Com_CyclicSendRequest_BMC_HV_09_XIX_HCP5_CANFD01_149204d3_Tx "The element: BMC_HV_09_XIX_HCP5_CANFD01_149204d3_Tx of Com_CyclicSendRequest" UBYTE Com_CyclicSendRequestType 0 0 0 1 ECU_ADDRESS 0x0 SYMBOL_LINK "Com_CyclicSendRequest.raw[16]" 0 /end MEASUREMENT
/begin MEASUREMENT Com_CyclicSendRequest_BMC_HV_10_XIX_BMC_CAN01_E2E_28add151_Tx "The element: BMC_HV_10_XIX_BMC_CAN01_E2E_28add151_Tx of Com_CyclicSendRequest" UBYTE Com_CyclicSendRequestType 0 0 0 1 ECU_ADDRESS 0x0 SYMBOL_LINK "Com_CyclicSendRequest.raw[17]" 0 /end MEASUREMENT
/begin MEASUREMENT Com_CyclicSendRequest_BMC_HV_11_XIX_BMC_CAN01_E2E_ff4f5109_Tx "The element: BMC_HV_11_XIX_BMC_CAN01_E2E_ff4f5109_Tx of Com_CyclicSendRequest" UBYTE Com_CyclicSendRequestType 0 0 0 1 ECU_ADDRESS 0x0 SYMBOL_LINK "Com_CyclicSendRequest.raw[18]" 0 /end MEASUREMENT
/begin MEASUREMENT Com_CyclicSendRequest_BMC_HV_12_XIX_BMC_CAN01_E2E_5c19d7a0_Tx "The element: BMC_HV_12_XIX_BMC_CAN01_E2E_5c19d7a0_Tx of Com_CyclicSendRequest" UBYTE Com_CyclicSendRequestType 0 0 0 1 ECU_ADDRESS 0x0 SYMBOL_LINK "Com_CyclicSendRequest.raw[19]" 0 /end MEASUREMENT
/begin MEASUREMENT Com_CyclicSendRequest_BMC_HV_13_XIX_BMC_CAN01_E2E_8bfb57f8_Tx "The element: BMC_HV_13_XIX_BMC_CAN01_E2E_8bfb57f8_Tx of Com_CyclicSendRequest" UBYTE Com_CyclicSendRequestType 0 0 0 1 ECU_ADDRESS 0x0 SYMBOL_LINK "Com_CyclicSendRequest.raw[20]" 0 /end MEASUREMENT
/begin MEASUREMENT Com_CyclicSendRequest_BMC_HV_14_XIX_HCP5_CANFD01_30db4b60_Tx "The element: BMC_HV_14_XIX_HCP5_CANFD01_30db4b60_Tx of Com_CyclicSendRequest" UBYTE Com_CyclicSendRequestType 0 0 0 1 ECU_ADDRESS 0x0 SYMBOL_LINK "Com_CyclicSendRequest.raw[21]" 0 /end MEASUREMENT
/begin MEASUREMENT Com_CyclicSendRequest_DEV_Hybrid_01_Resp_FF_XIX_HCP5_CANFD01_7b20ac63_Tx "The element: DEV_Hybrid_01_Resp_FF_XIX_HCP5_CANFD01_7b20ac63_Tx of Com_CyclicSendRequest" UBYTE Com_CyclicSendRequestType 0 0 0 1 ECU_ADDRESS 0x0 SYMBOL_LINK "Com_CyclicSendRequest.raw[22]" 0 /end MEASUREMENT
/begin MEASUREMENT Com_CyclicSendRequest_DS_Hybrid_01_XIX_HCP5_CANFD01_b3d0b839_Tx "The element: DS_Hybrid_01_XIX_HCP5_CANFD01_b3d0b839_Tx of Com_CyclicSendRequest" UBYTE Com_CyclicSendRequestType 0 0 0 1 ECU_ADDRESS 0x0 SYMBOL_LINK "Com_CyclicSendRequest.raw[23]" 0 /end MEASUREMENT
/begin MEASUREMENT Com_CyclicSendRequest_KN_Hybrid_01_XIX_HCP5_CANFD01_fef84477_Tx "The element: KN_Hybrid_01_XIX_HCP5_CANFD01_fef84477_Tx of Com_CyclicSendRequest" UBYTE Com_CyclicSendRequestType 0 0 0 1 ECU_ADDRESS 0x0 SYMBOL_LINK "Com_CyclicSendRequest.raw[24]" 0 /end MEASUREMENT
/begin MEASUREMENT Com_CyclicSendRequest_KS_Hybrid_01_Challenge_K_XIX_HCP5_CANFD01_306d69bd_Tx "The element: KS_Hybrid_01_Challenge_K_XIX_HCP5_CANFD01_306d69bd_Tx of Com_CyclicSendRequest" UBYTE Com_CyclicSendRequestType 0 0 0 1 ECU_ADDRESS 0x0 SYMBOL_LINK "Com_CyclicSendRequest.raw[25]" 0 /end MEASUREMENT
/begin MEASUREMENT Com_CyclicSendRequest_KS_Hybrid_01_ReqFrame_XIX_HCP5_CANFD01_b04c52dd_Tx "The element: KS_Hybrid_01_ReqFrame_XIX_HCP5_CANFD01_b04c52dd_Tx of Com_CyclicSendRequest" UBYTE Com_CyclicSendRequestType 0 0 0 1 ECU_ADDRESS 0x0 SYMBOL_LINK "Com_CyclicSendRequest.raw[26]" 0 /end MEASUREMENT
/begin MEASUREMENT Com_CyclicSendRequest_KS_Hybrid_01_Response_K_XIX_HCP5_CANFD01_76da782f_Tx "The element: KS_Hybrid_01_Response_K_XIX_HCP5_CANFD01_76da782f_Tx of Com_CyclicSendRequest" UBYTE Com_CyclicSendRequestType 0 0 0 1 ECU_ADDRESS 0x0 SYMBOL_LINK "Com_CyclicSendRequest.raw[27]" 0 /end MEASUREMENT
/begin MEASUREMENT Com_CyclicSendRequest_NMH_Hybrid_01_XIX_BMC_CAN01_b22e17f1_Tx "The element: NMH_Hybrid_01_XIX_BMC_CAN01_b22e17f1_Tx of Com_CyclicSendRequest" UBYTE Com_CyclicSendRequestType 0 0 0 1 ECU_ADDRESS 0x0 SYMBOL_LINK "Com_CyclicSendRequest.raw[28]" 0 /end MEASUREMENT
/begin MEASUREMENT Com_CyclicSendRequest_NM_Hybrid_01_XIX_HCP5_CANFD01_c84ff8a5_Tx "The element: NM_Hybrid_01_XIX_HCP5_CANFD01_c84ff8a5_Tx of Com_CyclicSendRequest" UBYTE Com_CyclicSendRequestType 0 0 0 1 ECU_ADDRESS 0x0 SYMBOL_LINK "Com_CyclicSendRequest.raw[29]" 0 /end MEASUREMENT
/begin MEASUREMENT Com_CyclicSendRequest_OBD_Hybrid_01_XIX_HCP5_CANFD01_40f9dae5_Tx "The element: OBD_Hybrid_01_XIX_HCP5_CANFD01_40f9dae5_Tx of Com_CyclicSendRequest" UBYTE Com_CyclicSendRequestType 0 0 0 1 ECU_ADDRESS 0x0 SYMBOL_LINK "Com_CyclicSendRequest.raw[30]" 0 /end MEASUREMENT
/begin MEASUREMENT Com_CyclicSendRequest_SOK_Zeit_Hybrid_01_Chal_01_XIX_HCP5_CANFD01_5939048b_Tx "The element: SOK_Zeit_Hybrid_01_Chal_01_XIX_HCP5_CANFD01_5939048b_Tx of Com_CyclicSendRequest" UBYTE Com_CyclicSendRequestType 0 0 0 1 ECU_ADDRESS 0x0 SYMBOL_LINK "Com_CyclicSendRequest.raw[31]" 0 /end MEASUREMENT
/begin MEASUREMENT Com_DelayTimeCnt "Current counter value of minimum delay counter." UBYTE NO_COMPU_METHOD 0 0 0 255 ECU_ADDRESS 0x0 MATRIX_DIM 32 /end MEASUREMENT
/begin MEASUREMENT Com_HandleRxPduDeferred "Array indicating received Rx I-PDUs to be processed deferred within the next call of Com_MainfunctionRx()." UWORD NO_COMPU_METHOD 0 0 0 65535 ECU_ADDRESS 0x0 MATRIX_DIM 66 SYMBOL_LINK "Com_HandleRxPduDeferred.raw" 0 /end MEASUREMENT
/begin MEASUREMENT Com_HandleRxPduDeferred_Airbag_10_XIX_HCP5_CANFD01_7f2c77c5_Rx "The element: Airbag_10_XIX_HCP5_CANFD01_7f2c77c5_Rx of Com_HandleRxPduDeferred" UWORD NO_COMPU_METHOD 0 0 0 65535 ECU_ADDRESS 0x0 SYMBOL_LINK "Com_HandleRxPduDeferred.raw[0]" 0 /end MEASUREMENT
/begin MEASUREMENT Com_HandleRxPduDeferred_BJB_08_XIX_BMC_CAN01_1db9ae10_Rx "The element: BJB_08_XIX_BMC_CAN01_1db9ae10_Rx of Com_HandleRxPduDeferred" UWORD NO_COMPU_METHOD 0 0 0 65535 ECU_ADDRESS 0x0 SYMBOL_LINK "Com_HandleRxPduDeferred.raw[1]" 0 /end MEASUREMENT
/begin MEASUREMENT Com_HandleRxPduDeferred_BJB_10_XIX_BMC_CAN01_E2E_968516b3_Rx "The element: BJB_10_XIX_BMC_CAN01_E2E_968516b3_Rx of Com_HandleRxPduDeferred" UWORD NO_COMPU_METHOD 0 0 0 65535 ECU_ADDRESS 0x0 SYMBOL_LINK "Com_HandleRxPduDeferred.raw[2]" 0 /end MEASUREMENT
/begin MEASUREMENT Com_HandleRxPduDeferred_BJB_11_XIX_BMC_CAN01_E2E_416796eb_Rx "The element: BJB_11_XIX_BMC_CAN01_E2E_416796eb_Rx of Com_HandleRxPduDeferred" UWORD NO_COMPU_METHOD 0 0 0 65535 ECU_ADDRESS 0x0 SYMBOL_LINK "Com_HandleRxPduDeferred.raw[3]" 0 /end MEASUREMENT
/begin MEASUREMENT Com_HandleRxPduDeferred_BJB_12_XIX_BMC_CAN01_E2E_e2311042_Rx "The element: BJB_12_XIX_BMC_CAN01_E2E_e2311042_Rx of Com_HandleRxPduDeferred" UWORD NO_COMPU_METHOD 0 0 0 65535 ECU_ADDRESS 0x0 SYMBOL_LINK "Com_HandleRxPduDeferred.raw[4]" 0 /end MEASUREMENT
/begin MEASUREMENT Com_HandleRxPduDeferred_BJB_13_XIX_BMC_CAN01_E2E_35d3901a_Rx "The element: BJB_13_XIX_BMC_CAN01_E2E_35d3901a_Rx of Com_HandleRxPduDeferred" UWORD NO_COMPU_METHOD 0 0 0 65535 ECU_ADDRESS 0x0 SYMBOL_LINK "Com_HandleRxPduDeferred.raw[5]" 0 /end MEASUREMENT
/begin MEASUREMENT Com_HandleRxPduDeferred_BJB_CALID_01_XIX_BMC_CAN01_adee7d66_Rx "The element: BJB_CALID_01_XIX_BMC_CAN01_adee7d66_Rx of Com_HandleRxPduDeferred" UWORD NO_COMPU_METHOD 0 0 0 65535 ECU_ADDRESS 0x0 SYMBOL_LINK "Com_HandleRxPduDeferred.raw[6]" 0 /end MEASUREMENT
/begin MEASUREMENT Com_HandleRxPduDeferred_BJB_CALID_02_XIX_BMC_CAN01_bc93171f_Rx "The element: BJB_CALID_02_XIX_BMC_CAN01_bc93171f_Rx of Com_HandleRxPduDeferred" UWORD NO_COMPU_METHOD 0 0 0 65535 ECU_ADDRESS 0x0 SYMBOL_LINK "Com_HandleRxPduDeferred.raw[7]" 0 /end MEASUREMENT
/begin MEASUREMENT Com_HandleRxPduDeferred_BJB_CVN_01_XIX_BMC_CAN01_301c1ddb_Rx "The element: BJB_CVN_01_XIX_BMC_CAN01_301c1ddb_Rx of Com_HandleRxPduDeferred" UWORD NO_COMPU_METHOD 0 0 0 65535 ECU_ADDRESS 0x0 SYMBOL_LINK "Com_HandleRxPduDeferred.raw[8]" 0 /end MEASUREMENT
/begin MEASUREMENT Com_HandleRxPduDeferred_Charisma_20_XIX_HCP5_CANFD01_f51eced8_Rx "The element: Charisma_20_XIX_HCP5_CANFD01_f51eced8_Rx of Com_HandleRxPduDeferred" UWORD NO_COMPU_METHOD 0 0 0 65535 ECU_ADDRESS 0x0 SYMBOL_LINK "Com_HandleRxPduDeferred.raw[9]" 0 /end MEASUREMENT
/begin MEASUREMENT Com_HandleRxPduDeferred_ClampControl_01_XIX_HCP5_CANFD01_8c24343b_Rx "The element: ClampControl_01_XIX_HCP5_CANFD01_8c24343b_Rx of Com_HandleRxPduDeferred" UWORD NO_COMPU_METHOD 0 0 0 65535 ECU_ADDRESS 0x0 SYMBOL_LINK "Com_HandleRxPduDeferred.raw[10]" 0 /end MEASUREMENT
/begin MEASUREMENT Com_HandleRxPduDeferred_ComIPduPnc_EIRA_CAN_Rx "The element: ComIPduPnc_EIRA_CAN_Rx of Com_HandleRxPduDeferred" UWORD NO_COMPU_METHOD 0 0 0 65535 ECU_ADDRESS 0x0 SYMBOL_LINK "Com_HandleRxPduDeferred.raw[11]" 0 /end MEASUREMENT
/begin MEASUREMENT Com_HandleRxPduDeferred_DCDC_04_XIX_HCP5_CANFD01_8ca88b97_Rx "The element: DCDC_04_XIX_HCP5_CANFD01_8ca88b97_Rx of Com_HandleRxPduDeferred" UWORD NO_COMPU_METHOD 0 0 0 65535 ECU_ADDRESS 0x0 SYMBOL_LINK "Com_HandleRxPduDeferred.raw[12]" 0 /end MEASUREMENT
/begin MEASUREMENT Com_HandleRxPduDeferred_DCDC_NV_CALID_XIX_HCP5_CANFD01_46b970f2_Rx "The element: DCDC_NV_CALID_XIX_HCP5_CANFD01_46b970f2_Rx of Com_HandleRxPduDeferred" UWORD NO_COMPU_METHOD 0 0 0 65535 ECU_ADDRESS 0x0 SYMBOL_LINK "Com_HandleRxPduDeferred.raw[13]" 0 /end MEASUREMENT
/begin MEASUREMENT Com_HandleRxPduDeferred_DCDC_NV_CVN_XIX_HCP5_CANFD01_55665719_Rx "The element: DCDC_NV_CVN_XIX_HCP5_CANFD01_55665719_Rx of Com_HandleRxPduDeferred" UWORD NO_COMPU_METHOD 0 0 0 65535 ECU_ADDRESS 0x0 SYMBOL_LINK "Com_HandleRxPduDeferred.raw[14]" 0 /end MEASUREMENT
/begin MEASUREMENT Com_HandleRxPduDeferred_DCDC_NV_Komponentenfehler_01_XIX_HCP5_CANFD01_dd687766_Rx "The element: DCDC_NV_Komponentenfehler_01_XIX_HCP5_CANFD01_dd687766_Rx of Com_HandleRxPduDeferred" UWORD NO_COMPU_METHOD 0 0 0 65535 ECU_ADDRESS 0x0 SYMBOL_LINK "Com_HandleRxPduDeferred.raw[15]" 0 /end MEASUREMENT
/begin MEASUREMENT Com_HandleRxPduDeferred_DCDC_NV_Komponentenfehler_02_XIX_HCP5_CANFD01_37eeaa04_Rx "The element: DCDC_NV_Komponentenfehler_02_XIX_HCP5_CANFD01_37eeaa04_Rx of Com_HandleRxPduDeferred" UWORD NO_COMPU_METHOD 0 0 0 65535 ECU_ADDRESS 0x0 SYMBOL_LINK "Com_HandleRxPduDeferred.raw[16]" 0 /end MEASUREMENT
/begin MEASUREMENT Com_HandleRxPduDeferred_DCDC_NV_Komponentenfehler_03_XIX_HCP5_CANFD01_d8bc1ce5_Rx "The element: DCDC_NV_Komponentenfehler_03_XIX_HCP5_CANFD01_d8bc1ce5_Rx of Com_HandleRxPduDeferred" UWORD NO_COMPU_METHOD 0 0 0 65535 ECU_ADDRESS 0x0 SYMBOL_LINK "Com_HandleRxPduDeferred.raw[17]" 0 /end MEASUREMENT
/begin MEASUREMENT Com_HandleRxPduDeferred_DCDC_NV_Komponentenfehler_04_XIX_HCP5_CANFD01_39921681_Rx "The element: DCDC_NV_Komponentenfehler_04_XIX_HCP5_CANFD01_39921681_Rx of Com_HandleRxPduDeferred" UWORD NO_COMPU_METHOD 0 0 0 65535 ECU_ADDRESS 0x0 SYMBOL_LINK "Com_HandleRxPduDeferred.raw[18]" 0 /end MEASUREMENT
/begin MEASUREMENT Com_HandleRxPduDeferred_DEV_Hybrid_01_Req_00_XIX_HCP5_CANFD01_5661b344_Rx "The element: DEV_Hybrid_01_Req_00_XIX_HCP5_CANFD01_5661b344_Rx of Com_HandleRxPduDeferred" UWORD NO_COMPU_METHOD 0 0 0 65535 ECU_ADDRESS 0x0 SYMBOL_LINK "Com_HandleRxPduDeferred.raw[19]" 0 /end MEASUREMENT
/begin MEASUREMENT Com_HandleRxPduDeferred_Diagnose_01_XIX_HCP5_CANFD01_426f0ab5_Rx "The element: Diagnose_01_XIX_HCP5_CANFD01_426f0ab5_Rx of Com_HandleRxPduDeferred" UWORD NO_COMPU_METHOD 0 0 0 65535 ECU_ADDRESS 0x0 SYMBOL_LINK "Com_HandleRxPduDeferred.raw[20]" 0 /end MEASUREMENT
/begin MEASUREMENT Com_HandleRxPduDeferred_ELF_06_XIX_HCP5_CANFD01_d78b945c_Rx "The element: ELF_06_XIX_HCP5_CANFD01_d78b945c_Rx of Com_HandleRxPduDeferred" UWORD NO_COMPU_METHOD 0 0 0 65535 ECU_ADDRESS 0x0 SYMBOL_LINK "Com_HandleRxPduDeferred.raw[21]" 0 /end MEASUREMENT
/begin MEASUREMENT Com_HandleRxPduDeferred_HCP1_17_XIX_HCP5_CANFD01_3398d6b5_Rx "The element: HCP1_17_XIX_HCP5_CANFD01_3398d6b5_Rx of Com_HandleRxPduDeferred" UWORD NO_COMPU_METHOD 0 0 0 65535 ECU_ADDRESS 0x0 SYMBOL_LINK "Com_HandleRxPduDeferred.raw[22]" 0 /end MEASUREMENT
/begin MEASUREMENT Com_HandleRxPduDeferred_HVEM_07_XIX_HCP5_CANFD01_839f516f_Rx "The element: HVEM_07_XIX_HCP5_CANFD01_839f516f_Rx of Com_HandleRxPduDeferred" UWORD NO_COMPU_METHOD 0 0 0 65535 ECU_ADDRESS 0x0 SYMBOL_LINK "Com_HandleRxPduDeferred.raw[23]" 0 /end MEASUREMENT
/begin MEASUREMENT Com_HandleRxPduDeferred_HVK_03_XIX_HCP5_CANFD01_E2E_8a76edcb_Rx "The element: HVK_03_XIX_HCP5_CANFD01_E2E_8a76edcb_Rx of Com_HandleRxPduDeferred" UWORD NO_COMPU_METHOD 0 0 0 65535 ECU_ADDRESS 0x0 SYMBOL_LINK "Com_HandleRxPduDeferred.raw[24]" 0 /end MEASUREMENT
/begin MEASUREMENT Com_HandleRxPduDeferred_HVLM_13_XIX_HCP5_CANFD01_f1be44f1_Rx "The element: HVLM_13_XIX_HCP5_CANFD01_f1be44f1_Rx of Com_HandleRxPduDeferred" UWORD NO_COMPU_METHOD 0 0 0 65535 ECU_ADDRESS 0x0 SYMBOL_LINK "Com_HandleRxPduDeferred.raw[25]" 0 /end MEASUREMENT
/begin MEASUREMENT Com_HandleRxPduDeferred_HVLM_14_XIX_HCP5_CANFD01_E2E_b3d1458f_Rx "The element: HVLM_14_XIX_HCP5_CANFD01_E2E_b3d1458f_Rx of Com_HandleRxPduDeferred" UWORD NO_COMPU_METHOD 0 0 0 65535 ECU_ADDRESS 0x0 SYMBOL_LINK "Com_HandleRxPduDeferred.raw[26]" 0 /end MEASUREMENT
/begin MEASUREMENT Com_HandleRxPduDeferred_KS_Hybrid_01_Challenge_M_XIX_HCP5_CANFD01_3e11d538_Rx "The element: KS_Hybrid_01_Challenge_M_XIX_HCP5_CANFD01_3e11d538_Rx of Com_HandleRxPduDeferred" UWORD NO_COMPU_METHOD 0 0 0 65535 ECU_ADDRESS 0x0 SYMBOL_LINK "Com_HandleRxPduDeferred.raw[27]" 0 /end MEASUREMENT
/begin MEASUREMENT Com_HandleRxPduDeferred_KS_Hybrid_01_Response_M_XIX_HCP5_CANFD01_78a6c4aa_Rx "The element: KS_Hybrid_01_Response_M_XIX_HCP5_CANFD01_78a6c4aa_Rx of Com_HandleRxPduDeferred" UWORD NO_COMPU_METHOD 0 0 0 65535 ECU_ADDRESS 0x0 SYMBOL_LINK "Com_HandleRxPduDeferred.raw[28]" 0 /end MEASUREMENT
/begin MEASUREMENT Com_HandleRxPduDeferred_NVEM_12_XIX_HCP5_CANFD01_00bae280_Rx "The element: NVEM_12_XIX_HCP5_CANFD01_00bae280_Rx of Com_HandleRxPduDeferred" UWORD NO_COMPU_METHOD 0 0 0 65535 ECU_ADDRESS 0x0 SYMBOL_LINK "Com_HandleRxPduDeferred.raw[29]" 0 /end MEASUREMENT
/begin MEASUREMENT Com_HandleRxPduDeferred_OBD_03_XIX_HCP5_CANFD01_f1281889_Rx "The element: OBD_03_XIX_HCP5_CANFD01_f1281889_Rx of Com_HandleRxPduDeferred" UWORD NO_COMPU_METHOD 0 0 0 65535 ECU_ADDRESS 0x0 SYMBOL_LINK "Com_HandleRxPduDeferred.raw[30]" 0 /end MEASUREMENT
/begin MEASUREMENT Com_HandleRxPduDeferred_OBD_04_XIX_HCP5_CANFD01_100612ed_Rx "The element: OBD_04_XIX_HCP5_CANFD01_100612ed_Rx of Com_HandleRxPduDeferred" UWORD NO_COMPU_METHOD 0 0 0 65535 ECU_ADDRESS 0x0 SYMBOL_LINK "Com_HandleRxPduDeferred.raw[31]" 0 /end MEASUREMENT
/begin MEASUREMENT Com_HandleRxPduDeferred_OBD_HCP1_XIX_HCP5_CANFD01_1b389b6c_Rx "The element: OBD_HCP1_XIX_HCP5_CANFD01_1b389b6c_Rx of Com_HandleRxPduDeferred" UWORD NO_COMPU_METHOD 0 0 0 65535 ECU_ADDRESS 0x0 SYMBOL_LINK "Com_HandleRxPduDeferred.raw[32]" 0 /end MEASUREMENT
/begin MEASUREMENT Com_HandleRxPduDeferred_OBG_01_XIX_HCP5_CANFD01_8fe2f1e9_Rx "The element: OBG_01_XIX_HCP5_CANFD01_8fe2f1e9_Rx of Com_HandleRxPduDeferred" UWORD NO_COMPU_METHOD 0 0 0 65535 ECU_ADDRESS 0x0 SYMBOL_LINK "Com_HandleRxPduDeferred.raw[33]" 0 /end MEASUREMENT
/begin MEASUREMENT Com_HandleRxPduDeferred_ORU_01_XIX_HCP5_CANFD01_8935a839_Rx "The element: ORU_01_XIX_HCP5_CANFD01_8935a839_Rx of Com_HandleRxPduDeferred" UWORD NO_COMPU_METHOD 0 0 0 65535 ECU_ADDRESS 0x0 SYMBOL_LINK "Com_HandleRxPduDeferred.raw[34]" 0 /end MEASUREMENT
/begin MEASUREMENT Com_HandleRxPduDeferred_ORU_Control_A_01_XIX_HCP5_CANFD01_E2E_3007747a_Rx "The element: ORU_Control_A_01_XIX_HCP5_CANFD01_E2E_3007747a_Rx of Com_HandleRxPduDeferred" UWORD NO_COMPU_METHOD 0 0 0 65535 ECU_ADDRESS 0x0 SYMBOL_LINK "Com_HandleRxPduDeferred.raw[35]" 0 /end MEASUREMENT
/begin MEASUREMENT Com_HandleRxPduDeferred_ORU_Control_D_01_XIX_HCP5_CANFD01_E2E_6e31ae8f_Rx "The element: ORU_Control_D_01_XIX_HCP5_CANFD01_E2E_6e31ae8f_Rx of Com_HandleRxPduDeferred" UWORD NO_COMPU_METHOD 0 0 0 65535 ECU_ADDRESS 0x0 SYMBOL_LINK "Com_HandleRxPduDeferred.raw[36]" 0 /end MEASUREMENT
/begin MEASUREMENT Com_HandleRxPduDeferred_OTAMC_D_01_XIX_HCP5_CANFD01_E2E_c199b3e6_Rx "The element: OTAMC_D_01_XIX_HCP5_CANFD01_E2E_c199b3e6_Rx of Com_HandleRxPduDeferred" UWORD NO_COMPU_METHOD 0 0 0 65535 ECU_ADDRESS 0x0 SYMBOL_LINK "Com_HandleRxPduDeferred.raw[37]" 0 /end MEASUREMENT
/begin MEASUREMENT Com_HandleRxPduDeferred_OTP_01_XIX_HCP5_CANFD01_76e7759c_Rx "The element: OTP_01_XIX_HCP5_CANFD01_76e7759c_Rx of Com_HandleRxPduDeferred" UWORD NO_COMPU_METHOD 0 0 0 65535 ECU_ADDRESS 0x0 SYMBOL_LINK "Com_HandleRxPduDeferred.raw[38]" 0 /end MEASUREMENT
/begin MEASUREMENT Com_HandleRxPduDeferred_SOK_NoAuthenticTime_01_XIX_HCP5_CANFD01_a407ae2f_Rx "The element: SOK_NoAuthenticTime_01_XIX_HCP5_CANFD01_a407ae2f_Rx of Com_HandleRxPduDeferred" UWORD NO_COMPU_METHOD 0 0 0 65535 ECU_ADDRESS 0x0 SYMBOL_LINK "Com_HandleRxPduDeferred.raw[39]" 0 /end MEASUREMENT
/begin MEASUREMENT Com_HandleRxPduDeferred_SOK_Zeit_Hybrid_01_Resp_01_XIX_HCP5_CANFD01_c7a98a10_Rx "The element: SOK_Zeit_Hybrid_01_Resp_01_XIX_HCP5_CANFD01_c7a98a10_Rx of Com_HandleRxPduDeferred" UWORD NO_COMPU_METHOD 0 0 0 65535 ECU_ADDRESS 0x0 SYMBOL_LINK "Com_HandleRxPduDeferred.raw[40]" 0 /end MEASUREMENT
/begin MEASUREMENT Com_HandleRxPduDeferred_Systeminfo_01_XIX_HCP5_CANFD01_fb27c5ed_Rx "The element: Systeminfo_01_XIX_HCP5_CANFD01_fb27c5ed_Rx of Com_HandleRxPduDeferred" UWORD NO_COMPU_METHOD 0 0 0 65535 ECU_ADDRESS 0x0 SYMBOL_LINK "Com_HandleRxPduDeferred.raw[41]" 0 /end MEASUREMENT
/begin MEASUREMENT Com_HandleRxPduDeferred_Thermomanagement_01_XIX_HCP5_CANFD01_60e8cf38_Rx "The element: Thermomanagement_01_XIX_HCP5_CANFD01_60e8cf38_Rx of Com_HandleRxPduDeferred" UWORD NO_COMPU_METHOD 0 0 0 65535 ECU_ADDRESS 0x0 SYMBOL_LINK "Com_HandleRxPduDeferred.raw[42]" 0 /end MEASUREMENT
/begin MEASUREMENT Com_HandleRxPduDeferred_UI1_01_XIX_BMC_CAN01_E2E_cec88adf_Rx "The element: UI1_01_XIX_BMC_CAN01_E2E_cec88adf_Rx of Com_HandleRxPduDeferred" UWORD NO_COMPU_METHOD 0 0 0 65535 ECU_ADDRESS 0x0 SYMBOL_LINK "Com_HandleRxPduDeferred.raw[43]" 0 /end MEASUREMENT
/begin MEASUREMENT Com_HandleRxPduDeferred_UI1_02_XIX_BMC_CAN01_E2E_6d9e0c76_Rx "The element: UI1_02_XIX_BMC_CAN01_E2E_6d9e0c76_Rx of Com_HandleRxPduDeferred" UWORD NO_COMPU_METHOD 0 0 0 65535 ECU_ADDRESS 0x0 SYMBOL_LINK "Com_HandleRxPduDeferred.raw[44]" 0 /end MEASUREMENT
/begin MEASUREMENT Com_HandleRxPduDeferred_UI1_03_XIX_BMC_CAN01_4277cadb_Rx "The element: UI1_03_XIX_BMC_CAN01_4277cadb_Rx of Com_HandleRxPduDeferred" UWORD NO_COMPU_METHOD 0 0 0 65535 ECU_ADDRESS 0x0 SYMBOL_LINK "Com_HandleRxPduDeferred.raw[45]" 0 /end MEASUREMENT
/begin MEASUREMENT Com_HandleRxPduDeferred_UI1_04_XIX_BMC_CAN01_d976c5c1_Rx "The element: UI1_04_XIX_BMC_CAN01_d976c5c1_Rx of Com_HandleRxPduDeferred" UWORD NO_COMPU_METHOD 0 0 0 65535 ECU_ADDRESS 0x0 SYMBOL_LINK "Com_HandleRxPduDeferred.raw[46]" 0 /end MEASUREMENT
/begin MEASUREMENT Com_HandleRxPduDeferred_UI1_05_XIX_BMC_CAN01_608d1e29_Rx "The element: UI1_05_XIX_BMC_CAN01_608d1e29_Rx of Com_HandleRxPduDeferred" UWORD NO_COMPU_METHOD 0 0 0 65535 ECU_ADDRESS 0x0 SYMBOL_LINK "Com_HandleRxPduDeferred.raw[47]" 0 /end MEASUREMENT
/begin MEASUREMENT Com_HandleRxPduDeferred_UI1_Komponentenfehler_01_XIX_BMC_CAN01_08861f77_Rx "The element: UI1_Komponentenfehler_01_XIX_BMC_CAN01_08861f77_Rx of Com_HandleRxPduDeferred" UWORD NO_COMPU_METHOD 0 0 0 65535 ECU_ADDRESS 0x0 SYMBOL_LINK "Com_HandleRxPduDeferred.raw[48]" 0 /end MEASUREMENT
/begin MEASUREMENT Com_HandleRxPduDeferred_UI1_Komponentenfehler_02_XIX_BMC_CAN01_19fb750e_Rx "The element: UI1_Komponentenfehler_02_XIX_BMC_CAN01_19fb750e_Rx of Com_HandleRxPduDeferred" UWORD NO_COMPU_METHOD 0 0 0 65535 ECU_ADDRESS 0x0 SYMBOL_LINK "Com_HandleRxPduDeferred.raw[49]" 0 /end MEASUREMENT
/begin MEASUREMENT Com_HandleRxPduDeferred_UI2Sens01_CALID_01_XIX_BMC_CAN01_f3c92280_Rx "The element: UI2Sens01_CALID_01_XIX_BMC_CAN01_f3c92280_Rx of Com_HandleRxPduDeferred" UWORD NO_COMPU_METHOD 0 0 0 65535 ECU_ADDRESS 0x0 SYMBOL_LINK "Com_HandleRxPduDeferred.raw[50]" 0 /end MEASUREMENT
/begin MEASUREMENT Com_HandleRxPduDeferred_UI2Sens01_CALID_02_XIX_BMC_CAN01_e2b448f9_Rx "The element: UI2Sens01_CALID_02_XIX_BMC_CAN01_e2b448f9_Rx of Com_HandleRxPduDeferred" UWORD NO_COMPU_METHOD 0 0 0 65535 ECU_ADDRESS 0x0 SYMBOL_LINK "Com_HandleRxPduDeferred.raw[51]" 0 /end MEASUREMENT
/begin MEASUREMENT Com_HandleRxPduDeferred_UI2Sens01_CVN_XIX_BMC_CAN01_fe6b52fc_Rx "The element: UI2Sens01_CVN_XIX_BMC_CAN01_fe6b52fc_Rx of Com_HandleRxPduDeferred" UWORD NO_COMPU_METHOD 0 0 0 65535 ECU_ADDRESS 0x0 SYMBOL_LINK "Com_HandleRxPduDeferred.raw[52]" 0 /end MEASUREMENT
/begin MEASUREMENT Com_HandleRxPduDeferred_UI2Sens02_CALID_01_XIX_BMC_CAN01_abd78ba8_Rx "The element: UI2Sens02_CALID_01_XIX_BMC_CAN01_abd78ba8_Rx of Com_HandleRxPduDeferred" UWORD NO_COMPU_METHOD 0 0 0 65535 ECU_ADDRESS 0x0 SYMBOL_LINK "Com_HandleRxPduDeferred.raw[53]" 0 /end MEASUREMENT
/begin MEASUREMENT Com_HandleRxPduDeferred_UI2Sens02_CALID_02_XIX_BMC_CAN01_baaae1d1_Rx "The element: UI2Sens02_CALID_02_XIX_BMC_CAN01_baaae1d1_Rx of Com_HandleRxPduDeferred" UWORD NO_COMPU_METHOD 0 0 0 65535 ECU_ADDRESS 0x0 SYMBOL_LINK "Com_HandleRxPduDeferred.raw[54]" 0 /end MEASUREMENT
/begin MEASUREMENT Com_HandleRxPduDeferred_UI2Sens02_CVN_XIX_BMC_CAN01_5d3dd455_Rx "The element: UI2Sens02_CVN_XIX_BMC_CAN01_5d3dd455_Rx of Com_HandleRxPduDeferred" UWORD NO_COMPU_METHOD 0 0 0 65535 ECU_ADDRESS 0x0 SYMBOL_LINK "Com_HandleRxPduDeferred.raw[55]" 0 /end MEASUREMENT
/begin MEASUREMENT Com_HandleRxPduDeferred_UI2_01_XIX_BMC_CAN01_E2E_f7b0279f_Rx "The element: UI2_01_XIX_BMC_CAN01_E2E_f7b0279f_Rx of Com_HandleRxPduDeferred" UWORD NO_COMPU_METHOD 0 0 0 65535 ECU_ADDRESS 0x0 SYMBOL_LINK "Com_HandleRxPduDeferred.raw[56]" 0 /end MEASUREMENT
/begin MEASUREMENT Com_HandleRxPduDeferred_UI2_02_XIX_BMC_CAN01_E2E_54e6a136_Rx "The element: UI2_02_XIX_BMC_CAN01_E2E_54e6a136_Rx of Com_HandleRxPduDeferred" UWORD NO_COMPU_METHOD 0 0 0 65535 ECU_ADDRESS 0x0 SYMBOL_LINK "Com_HandleRxPduDeferred.raw[57]" 0 /end MEASUREMENT
/begin MEASUREMENT Com_HandleRxPduDeferred_UI2_03_XIX_BMC_CAN01_E2E_8304216e_Rx "The element: UI2_03_XIX_BMC_CAN01_E2E_8304216e_Rx of Com_HandleRxPduDeferred" UWORD NO_COMPU_METHOD 0 0 0 65535 ECU_ADDRESS 0x0 SYMBOL_LINK "Com_HandleRxPduDeferred.raw[58]" 0 /end MEASUREMENT
/begin MEASUREMENT Com_HandleRxPduDeferred_UI2_04_XIX_BMC_CAN01_33f018a3_Rx "The element: UI2_04_XIX_BMC_CAN01_33f018a3_Rx of Com_HandleRxPduDeferred" UWORD NO_COMPU_METHOD 0 0 0 65535 ECU_ADDRESS 0x0 SYMBOL_LINK "Com_HandleRxPduDeferred.raw[59]" 0 /end MEASUREMENT
/begin MEASUREMENT Com_HandleRxPduDeferred_UI2_Komponentenfehler_01_XIX_BMC_CAN01_6c666489_Rx "The element: UI2_Komponentenfehler_01_XIX_BMC_CAN01_6c666489_Rx of Com_HandleRxPduDeferred" UWORD NO_COMPU_METHOD 0 0 0 65535 ECU_ADDRESS 0x0 SYMBOL_LINK "Com_HandleRxPduDeferred.raw[60]" 0 /end MEASUREMENT
/begin MEASUREMENT Com_HandleRxPduDeferred_UI2_Komponentenfehler_02_XIX_BMC_CAN01_7d1b0ef0_Rx "The element: UI2_Komponentenfehler_02_XIX_BMC_CAN01_7d1b0ef0_Rx of Com_HandleRxPduDeferred" UWORD NO_COMPU_METHOD 0 0 0 65535 ECU_ADDRESS 0x0 SYMBOL_LINK "Com_HandleRxPduDeferred.raw[61]" 0 /end MEASUREMENT
/begin MEASUREMENT Com_HandleRxPduDeferred_VDSO_05_XIX_HCP5_CANFD01_48366f26_Rx "The element: VDSO_05_XIX_HCP5_CANFD01_48366f26_Rx of Com_HandleRxPduDeferred" UWORD NO_COMPU_METHOD 0 0 0 65535 ECU_ADDRESS 0x0 SYMBOL_LINK "Com_HandleRxPduDeferred.raw[62]" 0 /end MEASUREMENT
/begin MEASUREMENT Com_HandleRxPduDeferred_WFS_02_XIX_HCP5_CANFD01_61136cb6_Rx "The element: WFS_02_XIX_HCP5_CANFD01_61136cb6_Rx of Com_HandleRxPduDeferred" UWORD NO_COMPU_METHOD 0 0 0 65535 ECU_ADDRESS 0x0 SYMBOL_LINK "Com_HandleRxPduDeferred.raw[63]" 0 /end MEASUREMENT
/begin MEASUREMENT Com_HandleRxPduDeferred_ZeitMaster_01_XIX_HCP5_CANFD01_dad73d21_Rx "The element: ZeitMaster_01_XIX_HCP5_CANFD01_dad73d21_Rx of Com_HandleRxPduDeferred" UWORD NO_COMPU_METHOD 0 0 0 65535 ECU_ADDRESS 0x0 SYMBOL_LINK "Com_HandleRxPduDeferred.raw[64]" 0 /end MEASUREMENT
/begin MEASUREMENT Com_HandleRxPduDeferred_Zeitmaster_05_XIX_HCP5_CANFD01_5eaa5a96_Rx "The element: Zeitmaster_05_XIX_HCP5_CANFD01_5eaa5a96_Rx of Com_HandleRxPduDeferred" UWORD NO_COMPU_METHOD 0 0 0 65535 ECU_ADDRESS 0x0 SYMBOL_LINK "Com_HandleRxPduDeferred.raw[65]" 0 /end MEASUREMENT
/begin MEASUREMENT Com_HandleTxPduDeferred "Flag array used for deferred Tx confirmation handling." UBYTE Com_HandleTxPduDeferredType 0 0 0 1 ECU_ADDRESS 0x0 MATRIX_DIM 32 /end MEASUREMENT
/begin MEASUREMENT Com_IPduGroupInfoOfRxPduInfoInd "the indexes of the 1:1 sorted relation pointing to Com_IPduGroupInfo" UBYTE NO_COMPU_METHOD 0 0 0 255 ECU_ADDRESS 0x0 MATRIX_DIM 98 /end MEASUREMENT
/begin MEASUREMENT Com_IPduGroupInfoOfTxPduInfoInd "the indexes of the 1:1 sorted relation pointing to Com_IPduGroupInfo" UBYTE NO_COMPU_METHOD 0 0 0 255 ECU_ADDRESS 0x0 MATRIX_DIM 55 /end MEASUREMENT
/begin MEASUREMENT Com_IPduGroupInfo[0].IPduGroupInfoToSubIPduGroupsIndStartIdxOfIPduGroupInfo "" UBYTE Com_IPduGroupInfoToSubIPduGroupsIndStartIdxOfIPduGroupInfoType 0 0 0 255 ECU_ADDRESS 0x0 /end MEASUREMENT
/begin MEASUREMENT Com_IPduGroupInfo[0].PartitionsRxStructIdxOfIPduGroupInfo "" UBYTE Com_PartitionsRxStructIdxOfIPduGroupInfoType 0 0 0 255 ECU_ADDRESS 0x0 /end MEASUREMENT
/begin MEASUREMENT Com_IPduGroupInfo[0].PartitionsTxStructIdxOfIPduGroupInfo "" UBYTE Com_PartitionsTxStructIdxOfIPduGroupInfoType 0 0 0 255 ECU_ADDRESS 0x0 /end MEASUREMENT
/begin MEASUREMENT Com_IPduGroupInfo[0].RxPduInfoIndEndIdxOfIPduGroupInfo "" UBYTE Com_RxPduInfoIndEndIdxOfIPduGroupInfoType 0 0 0 255 ECU_ADDRESS 0x0 /end MEASUREMENT
/begin COMPU_METHOD CM_BMC_CMC_Temperatur_083 "" TAB_INTP "%10.1" "Unit_DegreCelsi" COMPU_TAB_REF CM_BMC_CMC_Temperatur_083 STATUS_STRING_REF CM_BMC_CMC_Temperatur_083.StatusText /end COMPU_METHOD
/begin COMPU_METHOD CM_BMC_CMC_Temperatur_084 "" TAB_INTP "%10.1" "Unit_DegreCelsi" COMPU_TAB_REF CM_BMC_CMC_Temperatur_084 STATUS_STRING_REF CM_BMC_CMC_Temperatur_084.StatusText /end COMPU_METHOD
/begin COMPU_METHOD CM_BMC_CMC_Temperatur_085 "" TAB_INTP "%10.1" "Unit_DegreCelsi" COMPU_TAB_REF CM_BMC_CMC_Temperatur_085 STATUS_STRING_REF CM_BMC_CMC_Temperatur_085.StatusText /end COMPU_METHOD
/begin COMPU_METHOD CM_BMC_CMC_Temperatur_086 "" TAB_INTP "%10.1" "Unit_DegreCelsi" COMPU_TAB_REF CM_BMC_CMC_Temperatur_086 STATUS_STRING_REF CM_BMC_CMC_Temperatur_086.StatusText /end COMPU_METHOD
/begin COMPU_METHOD CM_BMC_CMC_Temperatur_087 "" TAB_INTP "%10.1" "Unit_DegreCelsi" COMPU_TAB_REF CM_BMC_CMC_Temperatur_087 STATUS_STRING_REF CM_BMC_CMC_Temperatur_087.StatusText /end COMPU_METHOD
/begin COMPU_METHOD CM_BMC_CMC_Temperatur_088 "" TAB_INTP "%10.1" "Unit_DegreCelsi" COMPU_TAB_REF CM_BMC_CMC_Temperatur_088 STATUS_STRING_REF CM_BMC_CMC_Temperatur_088.StatusText /end COMPU_METHOD
/begin COMPU_METHOD CM_BMC_CMC_Temperatur_089 "" TAB_INTP "%10.1" "Unit_DegreCelsi" COMPU_TAB_REF CM_BMC_CMC_Temperatur_089 STATUS_STRING_REF CM_BMC_CMC_Temperatur_089.StatusText /end COMPU_METHOD
/begin COMPU_METHOD CM_BMC_CMC_Temperatur_090 "" TAB_INTP "%10.1" "Unit_DegreCelsi" COMPU_TAB_REF CM_BMC_CMC_Temperatur_090 STATUS_STRING_REF CM_BMC_CMC_Temperatur_090.StatusText /end COMPU_METHOD
/begin COMPU_METHOD CM_BMC_CMC_Temperatur_091 "" TAB_INTP "%10.1" "Unit_DegreCelsi" COMPU_TAB_REF CM_BMC_CMC_Temperatur_091 STATUS_STRING_REF CM_BMC_CMC_Temperatur_091.StatusText /end COMPU_METHOD
/begin COMPU_METHOD CM_BMC_CMC_Temperatur_092 "" TAB_INTP "%10.1" "Unit_DegreCelsi" COMPU_TAB_REF CM_BMC_CMC_Temperatur_092 STATUS_STRING_REF CM_BMC_CMC_Temperatur_092.StatusText /end COMPU_METHOD
/begin COMPU_METHOD CM_BMC_CMC_Temperatur_093 "" TAB_INTP "%10.1" "Unit_DegreCelsi" COMPU_TAB_REF CM_BMC_CMC_Temperatur_093 STATUS_STRING_REF CM_BMC_CMC_Temperatur_093.StatusText /end COMPU_METHOD
/begin COMPU_METHOD CM_BMC_CMC_Temperatur_094 "" TAB_INTP "%10.1" "Unit_DegreCelsi" COMPU_TAB_REF CM_BMC_CMC_Temperatur_094 STATUS_STRING_REF CM_BMC_CMC_Temperatur_094.StatusText /end COMPU_METHOD
/begin COMPU_METHOD CM_BMC_CMC_Temperatur_095 "" TAB_INTP "%10.1" "Unit_DegreCelsi" COMPU_TAB_REF CM_BMC_CMC_Temperatur_095 STATUS_STRING_REF CM_BMC_CMC_Temperatur_095.StatusText /end COMPU_METHOD
/begin COMPU_METHOD CM_BMC_CMC_Temperatur_096 "" TAB_INTP "%10.1" "Unit_DegreCelsi" COMPU_TAB_REF CM_BMC_CMC_Temperatur_096 STATUS_STRING_REF CM_BMC_CMC_Temperatur_096.StatusText /end COMPU_METHOD
/begin COMPU_METHOD CM_BMC_CMC_Zellspannung_001 "" TAB_INTP "%10.1" "Unit_MilliVolt" COMPU_TAB_REF CM_BMC_CMC_Zellspannung_001 STATUS_STRING_REF CM_BMC_CMC_Zellspannung_001.StatusText /end COMPU_METHOD
/begin COMPU_METHOD CM_BMC_CMC_Zellspannung_002 "" TAB_INTP "%10.1" "Unit_MilliVolt" COMPU_TAB_REF CM_BMC_CMC_Zellspannung_002 STATUS_STRING_REF CM_BMC_CMC_Zellspannung_002.StatusText /end COMPU_METHOD
/begin COMPU_METHOD CM_BMC_CMC_Zellspannung_003 "" TAB_INTP "%10.1" "Unit_MilliVolt" COMPU_TAB_REF CM_BMC_CMC_Zellspannung_003 STATUS_STRING_REF CM_BMC_CMC_Zellspannung_003.StatusText /end COMPU_METHOD
/begin COMPU_METHOD CM_BMC_CMC_Zellspannung_004 "" TAB_INTP "%10.1" "Unit_MilliVolt" COMPU_TAB_REF CM_BMC_CMC_Zellspannung_004 STATUS_STRING_REF CM_BMC_CMC_Zellspannung_004.StatusText /end COMPU_METHOD
/begin COMPU_METHOD CM_BMC_CMC_Zellspannung_005 "" TAB_INTP "%10.1" "Unit_MilliVolt" COMPU_TAB_REF CM_BMC_CMC_Zellspannung_005 STATUS_STRING_REF CM_BMC_CMC_Zellspannung_005.StatusText /end COMPU_METHOD
/begin COMPU_METHOD CM_BMC_CMC_Zellspannung_006 "" TAB_INTP "%10.1" "Unit_MilliVolt" COMPU_TAB_REF CM_BMC_CMC_Zellspannung_006 STATUS_STRING_REF CM_BMC_CMC_Zellspannung_006.StatusText /end COMPU_METHOD
/begin COMPU_METHOD CM_BMC_CMC_Zellspannung_007 "" TAB_INTP "%10.1" "Unit_MilliVolt" COMPU_TAB_REF CM_BMC_CMC_Zellspannung_007 STATUS_STRING_REF CM_BMC_CMC_Zellspannung_007.StatusText /end COMPU_METHOD
/begin COMPU_METHOD CM_BMC_CMC_Zellspannung_008 "" TAB_INTP "%10.1" "Unit_MilliVolt" COMPU_TAB_REF CM_BMC_CMC_Zellspannung_008 STATUS_STRING_REF CM_BMC_CMC_Zellspannung_008.StatusText /end COMPU_METHOD
/begin COMPU_METHOD CM_BMC_CMC_Zellspannung_009 "" TAB_INTP "%10.1" "Unit_MilliVolt" COMPU_TAB_REF CM_BMC_CMC_Zellspannung_009 STATUS_STRING_REF CM_BMC_CMC_Zellspannung_009.StatusText /end COMPU_METHOD
/begin COMPU_METHOD CM_BMC_CMC_Zellspannung_010 "" TAB_INTP "%10.1" "Unit_MilliVolt" COMPU_TAB_REF CM_BMC_CMC_Zellspannung_010 STATUS_STRING_REF CM_BMC_CMC_Zellspannung_010.StatusText /end COMPU_METHOD
/begin COMPU_METHOD CM_BMC_CMC_Zellspannung_011 "" TAB_INTP "%10.1" "Unit_MilliVolt" COMPU_TAB_REF CM_BMC_CMC_Zellspannung_011 STATUS_STRING_REF CM_BMC_CMC_Zellspannung_011.StatusText /end COMPU_METHOD
/begin COMPU_METHOD CM_BMC_CMC_Zellspannung_012 "" TAB_INTP "%10.1" "Unit_MilliVolt" COMPU_TAB_REF CM_BMC_CMC_Zellspannung_012 STATUS_STRING_REF CM_BMC_CMC_Zellspannung_012.StatusText /end COMPU_METHOD
/begin COMPU_METHOD CM_BMC_CMC_Zellspannung_013 "" TAB_INTP "%10.1" "Unit_MilliVolt" COMPU_TAB_REF CM_BMC_CMC_Zellspannung_013 STATUS_STRING_REF CM_BMC_CMC_Zellspannung_013.StatusText /end COMPU_METHOD
/begin COMPU_METHOD CM_BMC_CMC_Zellspannung_014 "" TAB_INTP "%10.1" "Unit_MilliVolt" COMPU_TAB_REF CM_BMC_CMC_Zellspannung_014 STATUS_STRING_REF CM_BMC_CMC_Zellspannung_014.StatusText /end COMPU_METHOD
/begin COMPU_METHOD CM_BMC_CMC_Zellspannung_015 "" TAB_INTP "%10.1" "Unit_MilliVolt" COMPU_TAB_REF CM_BMC_CMC_Zellspannung_015 STATUS_STRING_REF CM_BMC_CMC_Zellspannung_015.StatusText /end COMPU_METHOD
/begin COMPU_METHOD CM_BMC_CMC_Zellspannung_016 "" TAB_INTP "%10.1" "Unit_MilliVolt" COMPU_TAB_REF CM_BMC_CMC_Zellspannung_016 STATUS_STRING_REF CM_BMC_CMC_Zellspannung_016.StatusText /end COMPU_METHOD
/begin COMPU_METHOD CM_BMC_CMC_Zellspannung_017 "" TAB_INTP "%10.1" "Unit_MilliVolt" COMPU_TAB_REF CM_BMC_CMC_Zellspannung_017 STATUS_STRING_REF CM_BMC_CMC_Zellspannung_017.StatusText /end COMPU_METHOD
/begin COMPU_METHOD CM_BMC_CMC_Zellspannung_018 "" TAB_INTP "%10.1" "Unit_MilliVolt" COMPU_TAB_REF CM_BMC_CMC_Zellspannung_018 STATUS_STRING_REF CM_BMC_CMC_Zellspannung_018.StatusText /end COMPU_METHOD
/begin COMPU_METHOD CM_BMC_CMC_Zellspannung_019 "" TAB_INTP "%10.1" "Unit_MilliVolt" COMPU_TAB_REF CM_BMC_CMC_Zellspannung_019 STATUS_STRING_REF CM_BMC_CMC_Zellspannung_019.StatusText /end COMPU_METHOD
/begin COMPU_METHOD CM_BMC_CMC_Zellspannung_01_Messzeit "" TAB_INTP "%10.1" "Unit_None" COMPU_TAB_REF CM_BMC_CMC_Zellspannung_01_Messzeit STATUS_STRING_REF CM_BMC_CMC_Zellspannung_01_Messzeit.StatusText /end COMPU_METHOD
/begin COMPU_METHOD CM_BMC_CMC_Zellspannung_020 "" TAB_INTP "%10.1" "Unit_MilliVolt" COMPU_TAB_REF CM_BMC_CMC_Zellspannung_020 STATUS_STRING_REF CM_BMC_CMC_Zellspannung_020.StatusText /end COMPU_METHOD
/begin COMPU_METHOD CM_BMC_CMC_Zellspannung_021 "" TAB_INTP "%10.1" "Unit_MilliVolt" COMPU_TAB_REF CM_BMC_CMC_Zellspannung_021 STATUS_STRING_REF CM_BMC_CMC_Zellspannung_021.StatusText /end COMPU_METHOD
/begin COMPU_METHOD CM_BMC_CMC_Zellspannung_022 "" TAB_INTP "%10.1" "Unit_MilliVolt" COMPU_TAB_REF CM_BMC_CMC_Zellspannung_022 STATUS_STRING_REF CM_BMC_CMC_Zellspannung_022.StatusText /end COMPU_METHOD
/begin COMPU_METHOD CM_BMC_CMC_Zellspannung_023 "" TAB_INTP "%10.1" "Unit_MilliVolt" COMPU_TAB_REF CM_BMC_CMC_Zellspannung_023 STATUS_STRING_REF CM_BMC_CMC_Zellspannung_023.StatusText /end COMPU_METHOD
/begin COMPU_METHOD CM_BMC_CMC_Zellspannung_024 "" TAB_INTP "%10.1" "Unit_MilliVolt" COMPU_TAB_REF CM_BMC_CMC_Zellspannung_024 STATUS_STRING_REF CM_BMC_CMC_Zellspannung_024.StatusText /end COMPU_METHOD
/begin COMPU_METHOD CM_BMC_CMC_Zellspannung_025 "" TAB_INTP "%10.1" "Unit_MilliVolt" COMPU_TAB_REF CM_BMC_CMC_Zellspannung_025 STATUS_STRING_REF CM_BMC_CMC_Zellspannung_025.StatusText /end COMPU_METHOD
/begin COMPU_METHOD CM_BMC_CMC_Zellspannung_026 "" TAB_INTP "%10.1" "Unit_MilliVolt" COMPU_TAB_REF CM_BMC_CMC_Zellspannung_026 STATUS_STRING_REF CM_BMC_CMC_Zellspannung_026.StatusText /end COMPU_METHOD
/begin COMPU_METHOD CM_BMC_CMC_Zellspannung_027 "" TAB_INTP "%10.1" "Unit_MilliVolt" COMPU_TAB_REF CM_BMC_CMC_Zellspannung_027 STATUS_STRING_REF CM_BMC_CMC_Zellspannung_027.StatusText /end COMPU_METHOD
/begin COMPU_METHOD CM_BMC_CMC_Zellspannung_028 "" TAB_INTP "%10.1" "Unit_MilliVolt" COMPU_TAB_REF CM_BMC_CMC_Zellspannung_028 STATUS_STRING_REF CM_BMC_CMC_Zellspannung_028.StatusText /end COMPU_METHOD
/begin COMPU_METHOD CM_BMC_CMC_Zellspannung_029 "" TAB_INTP "%10.1" "Unit_MilliVolt" COMPU_TAB_REF CM_BMC_CMC_Zellspannung_029 STATUS_STRING_REF CM_BMC_CMC_Zellspannung_029.StatusText /end COMPU_METHOD
/begin COMPU_METHOD CM_BMC_CMC_Zellspannung_02_Messzeit "" TAB_INTP "%10.1" "Unit_None" COMPU_TAB_REF CM_BMC_CMC_Zellspannung_02_Messzeit STATUS_STRING_REF CM_BMC_CMC_Zellspannung_02_Messzeit.StatusText /end COMPU_METHOD
/begin COMPU_METHOD CM_BMC_CMC_Zellspannung_030 "" TAB_INTP "%10.1" "Unit_MilliVolt" COMPU_TAB_REF CM_BMC_CMC_Zellspannung_030 STATUS_STRING_REF CM_BMC_CMC_Zellspannung_030.StatusText /end COMPU_METHOD
/begin COMPU_METHOD CM_BMC_CMC_Zellspannung_031 "" TAB_INTP "%10.1" "Unit_MilliVolt" COMPU_TAB_REF CM_BMC_CMC_Zellspannung_031 STATUS_STRING_REF CM_BMC_CMC_Zellspannung_031.StatusText /end COMPU_METHOD
/begin COMPU_METHOD CM_BMC_CMC_Zellspannung_032 "" TAB_INTP "%10.1" "Unit_MilliVolt" COMPU_TAB_REF CM_BMC_CMC_Zellspannung_032 STATUS_STRING_REF CM_BMC_CMC_Zellspannung_032.StatusText /end COMPU_METHOD
/begin COMPU_METHOD CM_BMC_CMC_Zellspannung_033 "" TAB_INTP "%10.1" "Unit_MilliVolt" COMPU_TAB_REF CM_BMC_CMC_Zellspannung_033 STATUS_STRING_REF CM_BMC_CMC_Zellspannung_033.StatusText /end COMPU_METHOD
/begin COMPU_METHOD CM_BMC_CMC_Zellspannung_034 "" TAB_INTP "%10.1" "Unit_MilliVolt" COMPU_TAB_REF CM_BMC_CMC_Zellspannung_034 STATUS_STRING_REF CM_BMC_CMC_Zellspannung_034.StatusText /end COMPU_METHOD
/begin COMPU_METHOD CM_BMC_CMC_Zellspannung_035 "" TAB_INTP "%10.1" "Unit_MilliVolt" COMPU_TAB_REF CM_BMC_CMC_Zellspannung_035 STATUS_STRING_REF CM_BMC_CMC_Zellspannung_035.StatusText /end COMPU_METHOD
/begin COMPU_METHOD CM_BMC_CMC_Zellspannung_036 "" TAB_INTP "%10.1" "Unit_MilliVolt" COMPU_TAB_REF CM_BMC_CMC_Zellspannung_036 STATUS_STRING_REF CM_BMC_CMC_Zellspannung_036.StatusText /end COMPU_METHOD
/begin COMPU_METHOD CM_BMC_CMC_Zellspannung_037 "" TAB_INTP "%10.1" "Unit_MilliVolt" COMPU_TAB_REF CM_BMC_CMC_Zellspannung_037 STATUS_STRING_REF CM_BMC_CMC_Zellspannung_037.StatusText /end COMPU_METHOD
/begin COMPU_METHOD CM_BMC_CMC_Zellspannung_038 "" TAB_INTP "%10.1" "Unit_MilliVolt" COMPU_TAB_REF CM_BMC_CMC_Zellspannung_038 STATUS_STRING_REF CM_BMC_CMC_Zellspannung_038.StatusText /end COMPU_METHOD
/begin COMPU_METHOD CM_BMC_CMC_Zellspannung_039 "" TAB_INTP "%10.1" "Unit_MilliVolt" COMPU_TAB_REF CM_BMC_CMC_Zellspannung_039 STATUS_STRING_REF CM_BMC_CMC_Zellspannung_039.StatusText /end COMPU_METHOD
/begin COMPU_METHOD CM_BMC_CMC_Zellspannung_03_Messzeit "" TAB_INTP "%10.1" "Unit_None" COMPU_TAB_REF CM_BMC_CMC_Zellspannung_03_Messzeit STATUS_STRING_REF CM_BMC_CMC_Zellspannung_03_Messzeit.StatusText /end COMPU_METHOD
/begin COMPU_METHOD CM_BMC_CMC_Zellspannung_040 "" TAB_INTP "%10.1" "Unit_MilliVolt" COMPU_TAB_REF CM_BMC_CMC_Zellspannung_040 STATUS_STRING_REF CM_BMC_CMC_Zellspannung_040.StatusText /end COMPU_METHOD
/begin COMPU_METHOD CM_BMC_CMC_Zellspannung_041 "" TAB_INTP "%10.1" "Unit_MilliVolt" COMPU_TAB_REF CM_BMC_CMC_Zellspannung_041 STATUS_STRING_REF CM_BMC_CMC_Zellspannung_041.StatusText /end COMPU_METHOD
/begin COMPU_METHOD CM_BMC_CMC_Zellspannung_042 "" TAB_INTP "%10.1" "Unit_MilliVolt" COMPU_TAB_REF CM_BMC_CMC_Zellspannung_042 STATUS_STRING_REF CM_BMC_CMC_Zellspannung_042.StatusText /end COMPU_METHOD
/begin COMPU_METHOD CM_BMC_CMC_Zellspannung_043 "" TAB_INTP "%10.1" "Unit_MilliVolt" COMPU_TAB_REF CM_BMC_CMC_Zellspannung_043 STATUS_STRING_REF CM_BMC_CMC_Zellspannung_043.StatusText /end COMPU_METHOD
/begin COMPU_METHOD CM_BMC_CMC_Zellspannung_044 "" TAB_INTP "%10.1" "Unit_MilliVolt" COMPU_TAB_REF CM_BMC_CMC_Zellspannung_044 STATUS_STRING_REF CM_BMC_CMC_Zellspannung_044.StatusText /end COMPU_METHOD
/begin COMPU_METHOD CM_BMC_CMC_Zellspannung_045 "" TAB_INTP "%10.1" "Unit_MilliVolt" COMPU_TAB_REF CM_BMC_CMC_Zellspannung_045 STATUS_STRING_REF CM_BMC_CMC_Zellspannung_045.StatusText /end COMPU_METHOD
/begin COMPU_METHOD CM_BMC_CMC_Zellspannung_046 "" TAB_INTP "%10.1" "Unit_MilliVolt" COMPU_TAB_REF CM_BMC_CMC_Zellspannung_046 STATUS_STRING_REF CM_BMC_CMC_Zellspannung_046.StatusText /end COMPU_METHOD
/begin COMPU_METHOD CM_BMC_CMC_Zellspannung_047 "" TAB_INTP "%10.1" "Unit_MilliVolt" COMPU_TAB_REF CM_BMC_CMC_Zellspannung_047 STATUS_STRING_REF CM_BMC_CMC_Zellspannung_047.StatusText /end COMPU_METHOD
/begin COMPU_METHOD CM_BMC_CMC_Zellspannung_048 "" TAB_INTP "%10.1" "Unit_MilliVolt" COMPU_TAB_REF CM_BMC_CMC_Zellspannung_048 STATUS_STRING_REF CM_BMC_CMC_Zellspannung_048.StatusText /end COMPU_METHOD
/begin COMPU_METHOD CM_BMC_CMC_Zellspannung_049 "" TAB_INTP "%10.1" "Unit_MilliVolt" COMPU_TAB_REF CM_BMC_CMC_Zellspannung_049 STATUS_STRING_REF CM_BMC_CMC_Zellspannung_049.StatusText /end COMPU_METHOD
/begin COMPU_METHOD CM_BMC_CMC_Zellspannung_04_Messzeit "" TAB_INTP "%10.1" "Unit_None" COMPU_TAB_REF CM_BMC_CMC_Zellspannung_04_Messzeit STATUS_STRING_REF CM_BMC_CMC_Zellspannung_04_Messzeit.StatusText /end COMPU_METHOD
/begin COMPU_METHOD CM_BMC_CMC_Zellspannung_050 "" TAB_INTP "%10.1" "Unit_MilliVolt" COMPU_TAB_REF CM_BMC_CMC_Zellspannung_050 STATUS_STRING_REF CM_BMC_CMC_Zellspannung_050.StatusText /end COMPU_METHOD
/begin COMPU_METHOD CM_BMC_CMC_Zellspannung_051 "" TAB_INTP "%10.1" "Unit_MilliVolt" COMPU_TAB_REF CM_BMC_CMC_Zellspannung_051 STATUS_STRING_REF CM_BMC_CMC_Zellspannung_051.StatusText /end COMPU_METHOD
/begin COMPU_METHOD CM_BMC_CMC_Zellspannung_052 "" TAB_INTP "%10.1" "Unit_MilliVolt" COMPU_TAB_REF CM_BMC_CMC_Zellspannung_052 STATUS_STRING_REF CM_BMC_CMC_Zellspannung_052.StatusText /end COMPU_METHOD
/begin COMPU_METHOD CM_BMC_CMC_Zellspannung_053 "" TAB_INTP "%10.1" "Unit_MilliVolt" COMPU_TAB_REF CM_BMC_CMC_Zellspannung_053 STATUS_STRING_REF CM_BMC_CMC_Zellspannung_053.StatusText /end COMPU_METHOD
/begin COMPU_METHOD CM_BMC_CMC_Zellspannung_054 "" TAB_INTP "%10.1" "Unit_MilliVolt" COMPU_TAB_REF CM_BMC_CMC_Zellspannung_054 STATUS_STRING_REF CM_BMC_CMC_Zellspannung_054.StatusText /end COMPU_METHOD
/begin COMPU_METHOD CM_BMC_CMC_Zellspannung_055 "" TAB_INTP "%10.1" "Unit_MilliVolt" COMPU_TAB_REF CM_BMC_CMC_Zellspannung_055 STATUS_STRING_REF CM_BMC_CMC_Zellspannung_055.StatusText /end COMPU_METHOD
/begin COMPU_METHOD CM_BMC_CMC_Zellspannung_056 "" TAB_INTP "%10.1" "Unit_MilliVolt" COMPU_TAB_REF CM_BMC_CMC_Zellspannung_056 STATUS_STRING_REF CM_BMC_CMC_Zellspannung_056.StatusText /end COMPU_METHOD
/begin COMPU_METHOD CM_BMC_CMC_Zellspannung_057 "" TAB_INTP "%10.1" "Unit_MilliVolt" COMPU_TAB_REF CM_BMC_CMC_Zellspannung_057 STATUS_STRING_REF CM_BMC_CMC_Zellspannung_057.StatusText /end COMPU_METHOD
/begin COMPU_METHOD CM_BMC_CMC_Zellspannung_058 "" TAB_INTP "%10.1" "Unit_MilliVolt" COMPU_TAB_REF CM_BMC_CMC_Zellspannung_058 STATUS_STRING_REF CM_BMC_CMC_Zellspannung_058.StatusText /end COMPU_METHOD
/begin COMPU_METHOD CM_BMC_CMC_Zellspannung_059 "" TAB_INTP "%10.1" "Unit_MilliVolt" COMPU_TAB_REF CM_BMC_CMC_Zellspannung_059 STATUS_STRING_REF CM_BMC_CMC_Zellspannung_059.StatusText /end COMPU_METHOD
/begin COMPU_METHOD CM_BMC_CMC_Zellspannung_05_Messzeit "" TAB_INTP "%10.1" "Unit_None" COMPU_TAB_REF CM_BMC_CMC_Zellspannung_05_Messzeit STATUS_STRING_REF CM_BMC_CMC_Zellspannung_05_Messzeit.StatusText /end COMPU_METHOD
/begin COMPU_METHOD CM_BMC_CMC_Zellspannung_060 "" TAB_INTP "%10.1" "Unit_MilliVolt" COMPU_TAB_REF CM_BMC_CMC_Zellspannung_060 STATUS_STRING_REF CM_BMC_CMC_Zellspannung_060.StatusText /end COMPU_METHOD
/begin COMPU_METHOD CM_BMC_CMC_Zellspannung_061 "" TAB_INTP "%10.1" "Unit_MilliVolt" COMPU_TAB_REF CM_BMC_CMC_Zellspannung_061 STATUS_STRING_REF CM_BMC_CMC_Zellspannung_061.StatusText /end COMPU_METHOD
/begin COMPU_METHOD CM_BMC_CMC_Zellspannung_062 "" TAB_INTP "%10.1" "Unit_MilliVolt" COMPU_TAB_REF CM_BMC_CMC_Zellspannung_062 STATUS_STRING_REF CM_BMC_CMC_Zellspannung_062.StatusText /end COMPU_METHOD
/begin COMPU_METHOD CM_BMC_CMC_Zellspannung_063 "" TAB_INTP "%10.1" "Unit_MilliVolt" COMPU_TAB_REF CM_BMC_CMC_Zellspannung_063 STATUS_STRING_REF CM_BMC_CMC_Zellspannung_063.StatusText /end COMPU_METHOD
/begin COMPU_METHOD CM_BMC_CMC_Zellspannung_064 "" TAB_INTP "%10.1" "Unit_MilliVolt" COMPU_TAB_REF CM_BMC_CMC_Zellspannung_064 STATUS_STRING_REF CM_BMC_CMC_Zellspannung_064.StatusText /end COMPU_METHOD
/begin COMPU_METHOD CM_BMC_CMC_Zellspannung_065 "" TAB_INTP "%10.1" "Unit_MilliVolt" COMPU_TAB_REF CM_BMC_CMC_Zellspannung_065 STATUS_STRING_REF CM_BMC_CMC_Zellspannung_065.StatusText /end COMPU_METHOD
/begin COMPU_METHOD CM_BMC_CMC_Zellspannung_066 "" TAB_INTP "%10.1" "Unit_MilliVolt" COMPU_TAB_REF CM_BMC_CMC_Zellspannung_066 STATUS_STRING_REF CM_BMC_CMC_Zellspannung_066.StatusText /end COMPU_METHOD
/begin COMPU_METHOD CM_BMC_CMC_Zellspannung_067 "" TAB_INTP "%10.1" "Unit_MilliVolt" COMPU_TAB_REF CM_BMC_CMC_Zellspannung_067 STATUS_STRING_REF CM_BMC_CMC_Zellspannung_067.StatusText /end COMPU_METHOD
/begin COMPU_METHOD CM_BMC_CMC_Zellspannung_068 "" TAB_INTP "%10.1" "Unit_MilliVolt" COMPU_TAB_REF CM_BMC_CMC_Zellspannung_068 STATUS_STRING_REF CM_BMC_CMC_Zellspannung_068.StatusText /end COMPU_METHOD
/begin COMPU_METHOD CM_BMC_CMC_Zellspannung_069 "" TAB_INTP "%10.1" "Unit_MilliVolt" COMPU_TAB_REF CM_BMC_CMC_Zellspannung_069 STATUS_STRING_REF CM_BMC_CMC_Zellspannung_069.StatusText /end COMPU_METHOD
/begin COMPU_METHOD CM_BMC_CMC_Zellspannung_070 "" TAB_INTP "%10.1" "Unit_MilliVolt" COMPU_TAB_REF CM_BMC_CMC_Zellspannung_070 STATUS_STRING_REF CM_BMC_CMC_Zellspannung_070.StatusText /end COMPU_METHOD
/begin COMPU_METHOD CM_BMC_CMC_Zellspannung_071 "" TAB_INTP "%10.1" "Unit_MilliVolt" COMPU_TAB_REF CM_BMC_CMC_Zellspannung_071 STATUS_STRING_REF CM_BMC_CMC_Zellspannung_071.StatusText /end COMPU_METHOD
/begin COMPU_METHOD CM_BMC_CMC_Zellspannung_072 "" TAB_INTP "%10.1" "Unit_MilliVolt" COMPU_TAB_REF CM_BMC_CMC_Zellspannung_072 STATUS_STRING_REF CM_BMC_CMC_Zellspannung_072.StatusText /end COMPU_METHOD
/begin COMPU_METHOD CM_BMC_CMC_Zellspannung_073 "" TAB_INTP "%10.1" "Unit_MilliVolt" COMPU_TAB_REF CM_BMC_CMC_Zellspannung_073 STATUS_STRING_REF CM_BMC_CMC_Zellspannung_073.StatusText /end COMPU_METHOD
/begin COMPU_METHOD CM_BMC_CMC_Zellspannung_074 "" TAB_INTP "%10.1" "Unit_MilliVolt" COMPU_TAB_REF CM_BMC_CMC_Zellspannung_074 STATUS_STRING_REF CM_BMC_CMC_Zellspannung_074.StatusText /end COMPU_METHOD
/begin COMPU_METHOD CM_BMC_CMC_Zellspannung_075 "" TAB_INTP "%10.1" "Unit_MilliVolt" COMPU_TAB_REF CM_BMC_CMC_Zellspannung_075 STATUS_STRING_REF CM_BMC_CMC_Zellspannung_075.StatusText /end COMPU_METHOD
/begin COMPU_METHOD CM_BMC_CMC_Zellspannung_076 "" TAB_INTP "%10.1" "Unit_MilliVolt" COMPU_TAB_REF CM_BMC_CMC_Zellspannung_076 STATUS_STRING_REF CM_BMC_CMC_Zellspannung_076.StatusText /end COMPU_METHOD
/begin COMPU_METHOD CM_BMC_CMC_Zellspannung_077 "" TAB_INTP "%10.1" "Unit_MilliVolt" COMPU_TAB_REF CM_BMC_CMC_Zellspannung_077 STATUS_STRING_REF CM_BMC_CMC_Zellspannung_077.StatusText /end COMPU_METHOD
/begin COMPU_METHOD CM_BMC_CMC_Zellspannung_078 "" TAB_INTP "%10.1" "Unit_MilliVolt" COMPU_TAB_REF CM_BMC_CMC_Zellspannung_078 STATUS_STRING_REF CM_BMC_CMC_Zellspannung_078.StatusText /end COMPU_METHOD
/begin COMPU_METHOD CM_BMC_CMC_Zellspannung_079 "" TAB_INTP "%10.1" "Unit_MilliVolt" COMPU_TAB_REF CM_BMC_CMC_Zellspannung_079 STATUS_STRING_REF CM_BMC_CMC_Zellspannung_079.StatusText /end COMPU_METHOD
/begin COMPU_METHOD CM_BMC_CMC_Zellspannung_080 "" TAB_INTP "%10.1" "Unit_MilliVolt" COMPU_TAB_REF CM_BMC_CMC_Zellspannung_080 STATUS_STRING_REF CM_BMC_CMC_Zellspannung_080.StatusText /end COMPU_METHOD
/begin COMPU_METHOD CM_BMC_CMC_Zellspannung_081 "" TAB_INTP "%10.1" "Unit_MilliVolt" COMPU_TAB_REF CM_BMC_CMC_Zellspannung_081 STATUS_STRING_REF CM_BMC_CMC_Zellspannung_081.StatusText /end COMPU_METHOD
/begin COMPU_METHOD CM_BMC_CMC_Zellspannung_082 "" TAB_INTP "%10.1" "Unit_MilliVolt" COMPU_TAB_REF CM_BMC_CMC_Zellspannung_082 STATUS_STRING_REF CM_BMC_CMC_Zellspannung_082.StatusText /end COMPU_METHOD
/begin COMPU_METHOD CM_BMC_CMC_Zellspannung_083 "" TAB_INTP "%10.1" "Unit_MilliVolt" COMPU_TAB_REF CM_BMC_CMC_Zellspannung_083 STATUS_STRING_REF CM_BMC_CMC_Zellspannung_083.StatusText /end COMPU_METHOD
/begin COMPU_METHOD CM_BMC_CMC_Zellspannung_084 "" TAB_INTP "%10.1" "Unit_MilliVolt" COMPU_TAB_REF CM_BMC_CMC_Zellspannung_084 STATUS_STRING_REF CM_BMC_CMC_Zellspannung_084.StatusText /end COMPU_METHOD
/begin COMPU_METHOD CM_BMC_CMC_Zellspannung_085 "" TAB_INTP "%10.1" "Unit_MilliVolt" COMPU_TAB_REF CM_BMC_CMC_Zellspannung_085 STATUS_STRING_REF CM_BMC_CMC_Zellspannung_085.StatusText /end COMPU_METHOD
/begin COMPU_METHOD CM_BMC_CMC_Zellspannung_086 "" TAB_INTP "%10.1" "Unit_MilliVolt" COMPU_TAB_REF CM_BMC_CMC_Zellspannung_086 STATUS_STRING_REF CM_BMC_CMC_Zellspannung_086.StatusText /end COMPU_METHOD
/begin COMPU_METHOD CM_BMC_CMC_Zellspannung_087 "" TAB_INTP "%10.1" "Unit_MilliVolt" COMPU_TAB_REF CM_BMC_CMC_Zellspannung_087 STATUS_STRING_REF CM_BMC_CMC_Zellspannung_087.StatusText /end COMPU_METHOD
/begin COMPU_METHOD CM_BMC_CMC_Zellspannung_088 "" TAB_INTP "%10.1" "Unit_MilliVolt" COMPU_TAB_REF CM_BMC_CMC_Zellspannung_088 STATUS_STRING_REF CM_BMC_CMC_Zellspannung_088.StatusText /end COMPU_METHOD
/begin COMPU_METHOD CM_BMC_CMC_Zellspannung_089 "" TAB_INTP "%10.1" "Unit_MilliVolt" COMPU_TAB_REF CM_BMC_CMC_Zellspannung_089 STATUS_STRING_REF CM_BMC_CMC_Zellspannung_089.StatusText /end COMPU_METHOD
/begin COMPU_METHOD CM_BMC_CMC_Zellspannung_090 "" TAB_INTP "%10.1" "Unit_MilliVolt" COMPU_TAB_REF CM_BMC_CMC_Zellspannung_090 STATUS_STRING_REF CM_BMC_CMC_Zellspannung_090.StatusText /end COMPU_METHOD
/begin COMPU_METHOD CM_BMC_CMC_Zellspannung_091 "" TAB_INTP "%10.1" "Unit_MilliVolt" COMPU_TAB_REF CM_BMC_CMC_Zellspannung_091 STATUS_STRING_REF CM_BMC_CMC_Zellspannung_091.StatusText /end COMPU_METHOD
/begin COMPU_METHOD CM_BMC_CMC_Zellspannung_092 "" TAB_INTP "%10.1" "Unit_MilliVolt" COMPU_TAB_REF CM_BMC_CMC_Zellspannung_092 STATUS_STRING_REF CM_BMC_CMC_Zellspannung_092.StatusText /end COMPU_METHOD
/begin COMPU_METHOD CM_BMC_CMC_Zellspannung_093 "" TAB_INTP "%10.1" "Unit_MilliVolt" COMPU_TAB_REF CM_BMC_CMC_Zellspannung_093 STATUS_STRING_REF CM_BMC_CMC_Zellspannung_093.StatusText /end COMPU_METHOD
/begin COMPU_METHOD CM_BMC_CMC_Zellspannung_094 "" TAB_INTP "%10.1" "Unit_MilliVolt" COMPU_TAB_REF CM_BMC_CMC_Zellspannung_094 STATUS_STRING_REF CM_BMC_CMC_Zellspannung_094.StatusText /end COMPU_METHOD
/begin COMPU_METHOD CM_BMC_CMC_Zellspannung_095 "" TAB_INTP "%10.1" "Unit_MilliVolt" COMPU_TAB_REF CM_BMC_CMC_Zellspannung_095 STATUS_STRING_REF CM_BMC_CMC_Zellspannung_095.StatusText /end COMPU_METHOD
/begin COMPU_METHOD CM_BMC_CMC_Zellspannung_096 "" TAB_INTP "%10.1" "Unit_MilliVolt" COMPU_TAB_REF CM_BMC_CMC_Zellspannung_096 STATUS_STRING_REF CM_BMC_CMC_Zellspannung_096.StatusText /end COMPU_METHOD
/begin COMPU_METHOD CM_BMC_CMC_Zellspannung_097 "" TAB_INTP "%10.1" "Unit_MilliVolt" COMPU_TAB_REF CM_BMC_CMC_Zellspannung_097 STATUS_STRING_REF CM_BMC_CMC_Zellspannung_097.StatusText /end COMPU_METHOD
/begin COMPU_METHOD CM_BMC_CMC_Zellspannung_098 "" TAB_INTP "%10.1" "Unit_MilliVolt" COMPU_TAB_REF CM_BMC_CMC_Zellspannung_098 STATUS_STRING_REF CM_BMC_CMC_Zellspannung_098.StatusText /end COMPU_METHOD
/begin COMPU_METHOD CM_BMC_CMC_Zellspannung_099 "" TAB_INTP "%10.1" "Unit_MilliVolt" COMPU_TAB_REF CM_BMC_CMC_Zellspannung_099 STATUS_STRING_REF CM_BMC_CMC_Zellspannung_099.StatusText /end COMPU_METHOD
/begin COMPU_METHOD CM_BMC_CMC_Zellspannung_100 "" TAB_INTP "%10.1" "Unit_MilliVolt" COMPU_TAB_REF CM_BMC_CMC_Zellspannung_100 STATUS_STRING_REF CM_BMC_CMC_Zellspannung_100.StatusText /end COMPU_METHOD
/begin COMPU_METHOD CM_BMC_CMC_Zellspannung_101 "" TAB_INTP "%10.1" "Unit_MilliVolt" COMPU_TAB_REF CM_BMC_CMC_Zellspannung_101 STATUS_STRING_REF CM_BMC_CMC_Zellspannung_101.StatusText /end COMPU_METHOD
/begin COMPU_METHOD CM_BMC_CMC_Zellspannung_102 "" TAB_INTP "%10.1" "Unit_MilliVolt" COMPU_TAB_REF CM_BMC_CMC_Zellspannung_102 STATUS_STRING_REF CM_BMC_CMC_Zellspannung_102.StatusText /end COMPU_METHOD
/begin COMPU_METHOD CM_BMC_CMC_Zellspannung_103 "" TAB_INTP "%10.1" "Unit_MilliVolt" COMPU_TAB_REF CM_BMC_CMC_Zellspannung_103 STATUS_STRING_REF CM_BMC_CMC_Zellspannung_103.StatusText /end COMPU_METHOD
/begin COMPU_METHOD CM_BMC_CMC_Zellspannung_104 "" TAB_INTP "%10.1" "Unit_MilliVolt" COMPU_TAB_REF CM_BMC_CMC_Zellspannung_104 STATUS_STRING_REF CM_BMC_CMC_Zellspannung_104.StatusText /end COMPU_METHOD
/begin COMPU_METHOD CM_BMC_CMC_Zellspannung_105 "" TAB_INTP "%10.1" "Unit_MilliVolt" COMPU_TAB_REF CM_BMC_CMC_Zellspannung_105 STATUS_STRING_REF CM_BMC_CMC_Zellspannung_105.StatusText /end COMPU_METHOD
/begin COMPU_METHOD CM_BMC_CMC_Zellspannung_106 "" TAB_INTP "%10.1" "Unit_MilliVolt" COMPU_TAB_REF CM_BMC_CMC_Zellspannung_106 STATUS_STRING_REF CM_BMC_CMC_Zellspannung_106.StatusText /end COMPU_METHOD
/begin COMPU_METHOD CM_BMC_CMC_Zellspannung_107 "" TAB_INTP "%10.1" "Unit_MilliVolt" COMPU_TAB_REF CM_BMC_CMC_Zellspannung_107 STATUS_STRING_REF CM_BMC_CMC_Zellspannung_107.StatusText /end COMPU_METHOD
/begin COMPU_METHOD CM_BMC_CMC_Zellspannung_108 "" TAB_INTP "%10.1" "Unit_MilliVolt" COMPU_TAB_REF CM_BMC_CMC_Zellspannung_108 STATUS_STRING_REF CM_BMC_CMC_Zellspannung_108.StatusText /end COMPU_METHOD
/begin COMPU_METHOD CM_BMC_CMC_Zellspannung_109 "" TAB_INTP "%10.1" "Unit_MilliVolt" COMPU_TAB_REF CM_BMC_CMC_Zellspannung_109 STATUS_STRING_REF CM_BMC_CMC_Zellspannung_109.StatusText /end COMPU_METHOD
/begin COMPU_METHOD CM_BMC_CMC_Zellspannung_110 "" TAB_INTP "%10.1" "Unit_MilliVolt" COMPU_TAB_REF CM_BMC_CMC_Zellspannung_110 STATUS_STRING_REF CM_BMC_CMC_Zellspannung_110.StatusText /end COMPU_METHOD
/begin COMPU_METHOD CM_BMC_CMC_Zellspannung_111 "" TAB_INTP "%10.1" "Unit_MilliVolt" COMPU_TAB_REF CM_BMC_CMC_Zellspannung_111 STATUS_STRING_REF CM_BMC_CMC_Zellspannung_111.StatusText /end COMPU_METHOD
/begin COMPU_METHOD CM_BMC_CMC_Zellspannung_112 "" TAB_INTP "%10.1" "Unit_MilliVolt" COMPU_TAB_REF CM_BMC_CMC_Zellspannung_112 STATUS_STRING_REF CM_BMC_CMC_Zellspannung_112.StatusText /end COMPU_METHOD
/begin COMPU_METHOD CM_BMC_CMC_Zellspannung_113 "" TAB_INTP "%10.1" "Unit_MilliVolt" COMPU_TAB_REF CM_BMC_CMC_Zellspannung_113 STATUS_STRING_REF CM_BMC_CMC_Zellspannung_113.StatusText /end COMPU_METHOD
/begin COMPU_METHOD CM_BMC_CMC_Zellspannung_114 "" TAB_INTP "%10.1" "Unit_MilliVolt" COMPU_TAB_REF CM_BMC_CMC_Zellspannung_114 STATUS_STRING_REF CM_BMC_CMC_Zellspannung_114.StatusText /end COMPU_METHOD
/begin COMPU_METHOD CM_BMC_CMC_Zellspannung_115 "" TAB_INTP "%10.1" "Unit_MilliVolt" COMPU_TAB_REF CM_BMC_CMC_Zellspannung_115 STATUS_STRING_REF CM_BMC_CMC_Zellspannung_115.StatusText /end COMPU_METHOD
/begin COMPU_METHOD CM_BMC_CMC_Zellspannung_116 "" TAB_INTP "%10.1" "Unit_MilliVolt" COMPU_TAB_REF CM_BMC_CMC_Zellspannung_116 STATUS_STRING_REF CM_BMC_CMC_Zellspannung_116.StatusText /end COMPU_METHOD
/begin COMPU_METHOD CM_BMC_CMC_Zellspannung_117 "" TAB_INTP "%10.1" "Unit_MilliVolt" COMPU_TAB_REF CM_BMC_CMC_Zellspannung_117 STATUS_STRING_REF CM_BMC_CMC_Zellspannung_117.StatusText /end COMPU_METHOD
/begin COMPU_METHOD CM_BMC_CMC_Zellspannung_118 "" TAB_INTP "%10.1" "Unit_MilliVolt" COMPU_TAB_REF CM_BMC_CMC_Zellspannung_118 STATUS_STRING_REF CM_BMC_CMC_Zellspannung_118.StatusText /end COMPU_METHOD
/begin COMPU_METHOD CM_BMC_CMC_Zellspannung_119 "" TAB_INTP "%10.1" "Unit_MilliVolt" COMPU_TAB_REF CM_BMC_CMC_Zellspannung_119 STATUS_STRING_REF CM_BMC_CMC_Zellspannung_119.StatusText /end COMPU_METHOD
/begin COMPU_METHOD CM_BMC_CMC_Zellspannung_120 "" TAB_INTP "%10.1" "Unit_MilliVolt" COMPU_TAB_REF CM_BMC_CMC_Zellspannung_120 STATUS_STRING_REF CM_BMC_CMC_Zellspannung_120.StatusText /end COMPU_METHOD
/begin COMPU_METHOD CM_BMC_CMC_Zellspannung_121 "" TAB_INTP "%10.1" "Unit_MilliVolt" COMPU_TAB_REF CM_BMC_CMC_Zellspannung_121 STATUS_STRING_REF CM_BMC_CMC_Zellspannung_121.StatusText /end COMPU_METHOD
/begin COMPU_METHOD CM_BMC_CMC_Zellspannung_122 "" TAB_INTP "%10.1" "Unit_MilliVolt" COMPU_TAB_REF CM_BMC_CMC_Zellspannung_122 STATUS_STRING_REF CM_BMC_CMC_Zellspannung_122.StatusText /end COMPU_METHOD
/begin COMPU_METHOD CM_BMC_CMC_Zellspannung_123 "" TAB_INTP "%10.1" "Unit_MilliVolt" COMPU_TAB_REF CM_BMC_CMC_Zellspannung_123 STATUS_STRING_REF CM_BMC_CMC_Zellspannung_123.StatusText /end COMPU_METHOD
/begin COMPU_METHOD CM_BMC_CMC_Zellspannung_124 "" TAB_INTP "%10.1" "Unit_MilliVolt" COMPU_TAB_REF CM_BMC_CMC_Zellspannung_124 STATUS_STRING_REF CM_BMC_CMC_Zellspannung_124.StatusText /end COMPU_METHOD
/begin COMPU_METHOD CM_BMC_CMC_Zellspannung_125 "" TAB_INTP "%10.1" "Unit_MilliVolt" COMPU_TAB_REF CM_BMC_CMC_Zellspannung_125 STATUS_STRING_REF CM_BMC_CMC_Zellspannung_125.StatusText /end COMPU_METHOD
/begin COMPU_METHOD CM_BMC_CMC_Zellspannung_126 "" TAB_INTP "%10.1" "Unit_MilliVolt" COMPU_TAB_REF CM_BMC_CMC_Zellspannung_126 STATUS_STRING_REF CM_BMC_CMC_Zellspannung_126.StatusText /end COMPU_METHOD
/begin COMPU_METHOD CM_BMC_CMC_Zellspannung_127 "" TAB_INTP "%10.1" "Unit_MilliVolt" COMPU_TAB_REF CM_BMC_CMC_Zellspannung_127 STATUS_STRING_REF CM_BMC_CMC_Zellspannung_127.StatusText /end COMPU_METHOD
/begin COMPU_METHOD CM_BMC_CMC_Zellspannung_128 "" TAB_INTP "%10.1" "Unit_MilliVolt" COMPU_TAB_REF CM_BMC_CMC_Zellspannung_128 STATUS_STRING_REF CM_BMC_CMC_Zellspannung_128.StatusText /end COMPU_METHOD
/begin COMPU_METHOD CM_BMC_CMC_Zellspannung_129 "" TAB_INTP "%10.1" "Unit_MilliVolt" COMPU_TAB_REF CM_BMC_CMC_Zellspannung_129 STATUS_STRING_REF CM_BMC_CMC_Zellspannung_129.StatusText /end COMPU_METHOD
/begin COMPU_METHOD CM_BMC_CMC_Zellspannung_130 "" TAB_INTP "%10.1" "Unit_MilliVolt" COMPU_TAB_REF CM_BMC_CMC_Zellspannung_130 STATUS_STRING_REF CM_BMC_CMC_Zellspannung_130.StatusText /end COMPU_METHOD
/begin COMPU_METHOD CM_BMC_CMC_Zellspannung_131 "" TAB_INTP "%10.1" "Unit_MilliVolt" COMPU_TAB_REF CM_BMC_CMC_Zellspannung_131 STATUS_STRING_REF CM_BMC_CMC_Zellspannung_131.StatusText /end COMPU_METHOD
/begin COMPU_METHOD CM_BMC_CMC_Zellspannung_132 "" TAB_INTP "%10.1" "Unit_MilliVolt" COMPU_TAB_REF CM_BMC_CMC_Zellspannung_132 STATUS_STRING_REF CM_BMC_CMC_Zellspannung_132.StatusText /end COMPU_METHOD
/begin COMPU_METHOD CM_BMC_CMC_Zellspannung_133 "" TAB_INTP "%10.1" "Unit_MilliVolt" COMPU_TAB_REF CM_BMC_CMC_Zellspannung_133 STATUS_STRING_REF CM_BMC_CMC_Zellspannung_133.StatusText /end COMPU_METHOD
/begin COMPU_METHOD CM_BMC_CMC_Zellspannung_134 "" TAB_INTP "%10.1" "Unit_MilliVolt" COMPU_TAB_REF CM_BMC_CMC_Zellspannung_134 STATUS_STRING_REF CM_BMC_CMC_Zellspannung_134.StatusText /end COMPU_METHOD
/begin COMPU_METHOD CM_BMC_CMC_Zellspannung_135 "" TAB_INTP "%10.1" "Unit_MilliVolt" COMPU_TAB_REF CM_BMC_CMC_Zellspannung_135 STATUS_STRING_REF CM_BMC_CMC_Zellspannung_135.StatusText /end COMPU_METHOD
/begin COMPU_METHOD CM_BMC_CMC_Zellspannung_136 "" TAB_INTP "%10.1" "Unit_MilliVolt" COMPU_TAB_REF CM_BMC_CMC_Zellspannung_136 STATUS_STRING_REF CM_BMC_CMC_Zellspannung_136.StatusText /end COMPU_METHOD
/begin COMPU_METHOD CM_BMC_CMC_Zellspannung_137 "" TAB_INTP "%10.1" "Unit_MilliVolt" COMPU_TAB_REF CM_BMC_CMC_Zellspannung_137 STATUS_STRING_REF CM_BMC_CMC_Zellspannung_137.StatusText /end COMPU_METHOD
/begin COMPU_METHOD CM_BMC_CMC_Zellspannung_138 "" TAB_INTP "%10.1" "Unit_MilliVolt" COMPU_TAB_REF CM_BMC_CMC_Zellspannung_138 STATUS_STRING_REF CM_BMC_CMC_Zellspannung_138.StatusText /end COMPU_METHOD
/begin COMPU_METHOD CM_BMC_CMC_Zellspannung_139 "" TAB_INTP "%10.1" "Unit_MilliVolt" COMPU_TAB_REF CM_BMC_CMC_Zellspannung_139 STATUS_STRING_REF CM_BMC_CMC_Zellspannung_139.StatusText /end COMPU_METHOD
/begin COMPU_METHOD CM_BMC_CMC_Zellspannung_140 "" TAB_INTP "%10.1" "Unit_MilliVolt" COMPU_TAB_REF CM_BMC_CMC_Zellspannung_140 STATUS_STRING_REF CM_BMC_CMC_Zellspannung_140.StatusText /end COMPU_METHOD
/begin COMPU_METHOD CM_BMC_CMC_Zellspannung_141 "" TAB_INTP "%10.1" "Unit_MilliVolt" COMPU_TAB_REF CM_BMC_CMC_Zellspannung_141 STATUS_STRING_REF CM_BMC_CMC_Zellspannung_141.StatusText /end COMPU_METHOD
/begin COMPU_METHOD CM_BMC_CMC_Zellspannung_142 "" TAB_INTP "%10.1" "Unit_MilliVolt" COMPU_TAB_REF CM_BMC_CMC_Zellspannung_142 STATUS_STRING_REF CM_BMC_CMC_Zellspannung_142.StatusText /end COMPU_METHOD
/begin COMPU_METHOD CM_BMC_CMC_Zellspannung_143 "" TAB_INTP "%10.1" "Unit_MilliVolt" COMPU_TAB_REF CM_BMC_CMC_Zellspannung_143 STATUS_STRING_REF CM_BMC_CMC_Zellspannung_143.StatusText /end COMPU_METHOD
/begin COMPU_METHOD CM_BMC_CMC_Zellspannung_144 "" TAB_INTP "%10.1" "Unit_MilliVolt" COMPU_TAB_REF CM_BMC_CMC_Zellspannung_144 STATUS_STRING_REF CM_BMC_CMC_Zellspannung_144.StatusText /end COMPU_METHOD
/begin COMPU_METHOD CM_BMC_CMC_Zellspannung_145 "" TAB_INTP "%10.1" "Unit_MilliVolt" COMPU_TAB_REF CM_BMC_CMC_Zellspannung_145 STATUS_STRING_REF CM_BMC_CMC_Zellspannung_145.StatusText /end COMPU_METHOD
/begin COMPU_METHOD CM_BMC_CMC_Zellspannung_146 "" TAB_INTP "%10.1" "Unit_MilliVolt" COMPU_TAB_REF CM_BMC_CMC_Zellspannung_146 STATUS_STRING_REF CM_BMC_CMC_Zellspannung_146.StatusText /end COMPU_METHOD
/begin COMPU_METHOD CM_BMC_CMC_Zellspannung_147 "" TAB_INTP "%10.1" "Unit_MilliVolt" COMPU_TAB_REF CM_BMC_CMC_Zellspannung_147 STATUS_STRING_REF CM_BMC_CMC_Zellspannung_147.StatusText /end COMPU_METHOD
/begin COMPU_METHOD CM_BMC_CMC_Zellspannung_148 "" TAB_INTP "%10.1" "Unit_MilliVolt" COMPU_TAB_REF CM_BMC_CMC_Zellspannung_148 STATUS_STRING_REF CM_BMC_CMC_Zellspannung_148.StatusText /end COMPU_METHOD
/begin COMPU_METHOD CM_BMC_CMC_Zellspannung_149 "" TAB_INTP "%10.1" "Unit_MilliVolt" COMPU_TAB_REF CM_BMC_CMC_Zellspannung_149 STATUS_STRING_REF CM_BMC_CMC_Zellspannung_149.StatusText /end COMPU_METHOD
/begin COMPU_METHOD CM_BMC_CMC_Zellspannung_150 "" TAB_INTP "%10.1" "Unit_MilliVolt" COMPU_TAB_REF CM_BMC_CMC_Zellspannung_150 STATUS_STRING_REF CM_BMC_CMC_Zellspannung_150.StatusText /end COMPU_METHOD
/begin COMPU_METHOD CM_BMC_CMC_Zellspannung_151 "" TAB_INTP "%10.1" "Unit_MilliVolt" COMPU_TAB_REF CM_BMC_CMC_Zellspannung_151 STATUS_STRING_REF CM_BMC_CMC_Zellspannung_151.StatusText /end COMPU_METHOD
/begin COMPU_METHOD CM_BMC_CMC_Zellspannung_152 "" TAB_INTP "%10.1" "Unit_MilliVolt" COMPU_TAB_REF CM_BMC_CMC_Zellspannung_152 STATUS_STRING_REF CM_BMC_CMC_Zellspannung_152.StatusText /end COMPU_METHOD
/begin COMPU_METHOD CM_BMC_CMC_Zellspannung_153 "" TAB_INTP "%10.1" "Unit_MilliVolt" COMPU_TAB_REF CM_BMC_CMC_Zellspannung_153 STATUS_STRING_REF CM_BMC_CMC_Zellspannung_153.StatusText /end COMPU_METHOD
/begin COMPU_METHOD CM_BMC_CMC_Zellspannung_154 "" TAB_INTP "%10.1" "Unit_MilliVolt" COMPU_TAB_REF CM_BMC_CMC_Zellspannung_154 STATUS_STRING_REF CM_BMC_CMC_Zellspannung_154.StatusText /end COMPU_METHOD
/begin COMPU_METHOD CM_BMC_CMC_Zellspannung_155 "" TAB_INTP "%10.1" "Unit_MilliVolt" COMPU_TAB_REF CM_BMC_CMC_Zellspannung_155 STATUS_STRING_REF CM_BMC_CMC_Zellspannung_155.StatusText /end COMPU_METHOD
/begin COMPU_METHOD CM_BMC_CMC_Zellspannung_156 "" TAB_INTP "%10.1" "Unit_MilliVolt" COMPU_TAB_REF CM_BMC_CMC_Zellspannung_156 STATUS_STRING_REF CM_BMC_CMC_Zellspannung_156.StatusText /end COMPU_METHOD
/begin COMPU_METHOD CM_BMC_CMC_Zellspannung_157 "" TAB_INTP "%10.1" "Unit_MilliVolt" COMPU_TAB_REF CM_BMC_CMC_Zellspannung_157 STATUS_STRING_REF CM_BMC_CMC_Zellspannung_157.StatusText /end COMPU_METHOD
/begin COMPU_METHOD CM_BMC_CMC_Zellspannung_158 "" TAB_INTP "%10.1" "Unit_MilliVolt" COMPU_TAB_REF CM_BMC_CMC_Zellspannung_158 STATUS_STRING_REF CM_BMC_CMC_Zellspannung_158.StatusText /end COMPU_METHOD
/begin COMPU_METHOD CM_BMC_CMC_Zellspannung_159 "" TAB_INTP "%10.1" "Unit_MilliVolt" COMPU_TAB_REF CM_BMC_CMC_Zellspannung_159 STATUS_STRING_REF CM_BMC_CMC_Zellspannung_159.StatusText /end COMPU_METHOD
/begin COMPU_METHOD CM_BMC_CMC_Zellspannung_160 "" TAB_INTP "%10.1" "Unit_MilliVolt" COMPU_TAB_REF CM_BMC_CMC_Zellspannung_160 STATUS_STRING_REF CM_BMC_CMC_Zellspannung_160.StatusText /end COMPU_METHOD
/begin COMPU_METHOD CM_BMC_CMC_Zellspannung_161 "" TAB_INTP "%10.1" "Unit_MilliVolt" COMPU_TAB_REF CM_BMC_CMC_Zellspannung_161 STATUS_STRING_REF CM_BMC_CMC_Zellspannung_161.StatusText /end COMPU_METHOD
/begin COMPU_METHOD CM_BMC_CMC_Zellspannung_162 "" TAB_INTP "%10.1" "Unit_MilliVolt" COMPU_TAB_REF CM_BMC_CMC_Zellspannung_162 STATUS_STRING_REF CM_BMC_CMC_Zellspannung_162.StatusText /end COMPU_METHOD
/begin COMPU_METHOD CM_BMC_CMC_Zellspannung_163 "" TAB_INTP "%10.1" "Unit_MilliVolt" COMPU_TAB_REF CM_BMC_CMC_Zellspannung_163 STATUS_STRING_REF CM_BMC_CMC_Zellspannung_163.StatusText /end COMPU_METHOD
/begin COMPU_METHOD CM_BMC_CMC_Zellspannung_164 "" TAB_INTP "%10.1" "Unit_MilliVolt" COMPU_TAB_REF CM_BMC_CMC_Zellspannung_164 STATUS_STRING_REF CM_BMC_CMC_Zellspannung_164.StatusText /end COMPU_METHOD
/begin COMPU_METHOD CM_BMC_CMC_Zellspannung_165 "" TAB_INTP "%10.1" "Unit_MilliVolt" COMPU_TAB_REF CM_BMC_CMC_Zellspannung_165 STATUS_STRING_REF CM_BMC_CMC_Zellspannung_165.StatusText /end COMPU_METHOD
/begin COMPU_METHOD CM_BMC_CMC_Zellspannung_166 "" TAB_INTP "%10.1" "Unit_MilliVolt" COMPU_TAB_REF CM_BMC_CMC_Zellspannung_166 STATUS_STRING_REF CM_BMC_CMC_Zellspannung_166.StatusText /end COMPU_METHOD
/begin COMPU_METHOD CM_BMC_CMC_Zellspannung_167 "" TAB_INTP "%10.1" "Unit_MilliVolt" COMPU_TAB_REF CM_BMC_CMC_Zellspannung_167 STATUS_STRING_REF CM_BMC_CMC_Zellspannung_167.StatusText /end COMPU_METHOD
/begin COMPU_METHOD CM_BMC_CMC_Zellspannung_168 "" TAB_INTP "%10.1" "Unit_MilliVolt" COMPU_TAB_REF CM_BMC_CMC_Zellspannung_168 STATUS_STRING_REF CM_BMC_CMC_Zellspannung_168.StatusText /end COMPU_METHOD
/begin COMPU_METHOD CM_BMC_CMC_Zellspannung_169 "" TAB_INTP "%10.1" "Unit_MilliVolt" COMPU_TAB_REF CM_BMC_CMC_Zellspannung_169 STATUS_STRING_REF CM_BMC_CMC_Zellspannung_169.StatusText /end COMPU_METHOD
/begin COMPU_METHOD CM_BMC_CMC_Zellspannung_170 "" TAB_INTP "%10.1" "Unit_MilliVolt" COMPU_TAB_REF CM_BMC_CMC_Zellspannung_170 STATUS_STRING_REF CM_BMC_CMC_Zellspannung_170.StatusText /end COMPU_METHOD
/begin COMPU_METHOD CM_BMC_CMC_Zellspannung_171 "" TAB_INTP "%10.1" "Unit_MilliVolt" COMPU_TAB_REF CM_BMC_CMC_Zellspannung_171 STATUS_STRING_REF CM_BMC_CMC_Zellspannung_171.StatusText /end COMPU_METHOD
/begin COMPU_METHOD CM_BMC_CMC_Zellspannung_172 "" TAB_INTP "%10.1" "Unit_MilliVolt" COMPU_TAB_REF CM_BMC_CMC_Zellspannung_172 STATUS_STRING_REF CM_BMC_CMC_Zellspannung_172.StatusText /end COMPU_METHOD
/begin COMPU_METHOD CM_BMC_CMC_Zellspannung_173 "" TAB_INTP "%10.1" "Unit_MilliVolt" COMPU_TAB_REF CM_BMC_CMC_Zellspannung_173 STATUS_STRING_REF CM_BMC_CMC_Zellspannung_173.StatusText /end COMPU_METHOD
/begin COMPU_METHOD CM_BMC_CMC_Zellspannung_174 "" TAB_INTP "%10.1" "Unit_MilliVolt" COMPU_TAB_REF CM_BMC_CMC_Zellspannung_174 STATUS_STRING_REF CM_BMC_CMC_Zellspannung_174.StatusText /end COMPU_METHOD
/begin COMPU_METHOD CM_BMC_CMC_Zellspannung_175 "" TAB_INTP "%10.1" "Unit_MilliVolt" COMPU_TAB_REF CM_BMC_CMC_Zellspannung_175 STATUS_STRING_REF CM_BMC_CMC_Zellspannung_175.StatusText /end COMPU_METHOD
/begin COMPU_METHOD Com_CurrentTxModeType "" TAB_VERB "%10.1" "" COMPU_TAB_REF Com_CurrentTxModeType /end COMPU_METHOD
/begin COMPU_METHOD Com_CyclicSendRequestType "" TAB_VERB "%10.1" "" COMPU_TAB_REF Com_CyclicSendRequestType /end COMPU_METHOD
/begin COMPU_METHOD Com_HandleTxPduDeferredType "" TAB_VERB "%10.1" "" COMPU_TAB_REF Com_HandleTxPduDeferredType /end COMPU_METHOD
/begin COMPU_METHOD Com_IPduGroupInfoToSubIPduGroupsIndStartIdxOfIPduGroupInfoType "" TAB_VERB "%10.1" "" COMPU_TAB_REF Com_IPduGroupInfoToSubIPduGroupsIndStartIdxOfIPduGroupInfoType /end COMPU_METHOD
/begin COMPU_METHOD Com_PartitionsRxStructIdxOfIPduGroupInfoType "" TAB_VERB "%10.1" "" COMPU_TAB_REF Com_PartitionsRxStructIdxOfIPduGroupInfoType /end COMPU_METHOD
/begin COMPU_METHOD Com_PartitionsTxStructIdxOfIPduGroupInfoType "" TAB_VERB "%10.1" "" COMPU_TAB_REF Com_PartitionsTxStructIdxOfIPduGroupInfoType /end COMPU_METHOD
/begin COMPU_METHOD Com_RxPduInfoIndEndIdxOfIPduGroupInfoType "" TAB_VERB "%10.1" "" COMPU_TAB_REF Com_RxPduInfoIndEndIdxOfIPduGroupInfoType /end COMPU_METHOD
/begin COMPU_METHOD CompuMethodEnum_CanSMSubStateTypes "" TAB_VERB "%10.1" "" COMPU_TAB_REF CompuMethodEnum_CanSMSubStateTypes /end COMPU_METHOD
/begin COMPU_METHOD CompuMethodEnum_ComModeTypes "" TAB_VERB "%10.1" "" COMPU_TAB_REF CompuMethodEnum_ComModeTypes /end COMPU_METHOD
/begin COMPU_TAB CM_BMC_CMC_Temperatur_083 "" TAB_INTP 2 0 -40 252 86 /end COMPU_TAB
/begin COMPU_VTAB CM_BMC_CMC_Temperatur_083.StatusText "" TAB_VERB 3 253 "CM_BMC_CMC_Temperatur_083_Cxfd_nicht_vorhanden" 254 "CM_BMC_CMC_Temperatur_083_Cxfe_Init" 255 "CM_BMC_CMC_Temperatur_083_Cxff_Fehler" /end COMPU_VTAB
/begin COMPU_TAB CM_BMC_CMC_Temperatur_084 "" TAB_INTP 2 0 -40 252 86 /end COMPU_TAB
/begin COMPU_VTAB CM_BMC_CMC_Temperatur_084.StatusText "" TAB_VERB 3 253 "CM_BMC_CMC_Temperatur_084_Cxfd_nicht_vorhanden" 254 "CM_BMC_CMC_Temperatur_084_Cxfe_Init" 255 "CM_BMC_CMC_Temperatur_084_Cxff_Fehler" /end COMPU_VTAB
/begin COMPU_TAB CM_BMC_CMC_Temperatur_085 "" TAB_INTP 2 0 -40 252 86 /end COMPU_TAB
/begin COMPU_VTAB CM_BMC_CMC_Temperatur_085.StatusText "" TAB_VERB 3 253 "CM_BMC_CMC_Temperatur_085_Cxfd_nicht_vorhanden" 254 "CM_BMC_CMC_Temperatur_085_Cxfe_Init" 255 "CM_BMC_CMC_Temperatur_085_Cxff_Fehler" /end COMPU_VTAB
/begin COMPU_TAB CM_BMC_CMC_Temperatur_086 "" TAB_INTP 2 0 -40 252 86 /end COMPU_TAB
/begin COMPU_VTAB CM_BMC_CMC_Temperatur_086.StatusText "" TAB_VERB 3 253 "CM_BMC_CMC_Temperatur_086_Cxfd_nicht_vorhanden" 254 "CM_BMC_CMC_Temperatur_086_Cxfe_Init" 255 "CM_BMC_CMC_Temperatur_086_Cxff_Fehler" /end COMPU_VTAB
/begin COMPU_TAB CM_BMC_CMC_Temperatur_087 "" TAB_INTP 2 0 -40 252 86 /end COMPU_TAB
/begin COMPU_VTAB CM_BMC_CMC_Temperatur_087.StatusText "" TAB_VERB 3 253 "CM_BMC_CMC_Temperatur_087_Cxfd_nicht_vorhanden" 254 "CM_BMC_CMC_Temperatur_087_Cxfe_Init" 255 "CM_BMC_CMC_Temperatur_087_Cxff_Fehler" /end COMPU_VTAB
/begin COMPU_TAB CM_BMC_CMC_Temperatur_088 "" TAB_INTP 2 0 -40 252 86 /end COMPU_TAB
/begin COMPU_VTAB CM_BMC_CMC_Temperatur_088.StatusText "" TAB_VERB 3 253 "CM_BMC_CMC_Temperatur_088_Cxfd_nicht_vorhanden" 254 "CM_BMC_CMC_Temperatur_088_Cxfe_Init" 255 "CM_BMC_CMC_Temperatur_088_Cxff_Fehler" /end COMPU_VTAB
/begin COMPU_TAB CM_BMC_CMC_Temperatur_089 "" TAB_INTP 2 0 -40 252 86 /end COMPU_TAB
/begin COMPU_VTAB CM_BMC_CMC_Temperatur_089.StatusText "" TAB_VERB 3 253 "CM_BMC_CMC_Temperatur_089_Cxfd_nicht_vorhanden" 254 "CM_BMC_CMC_Temperatur_089_Cxfe_Init" 255 "CM_BMC_CMC_Temperatur_089_Cxff_Fehler" /end COMPU_VTAB
/begin COMPU_TAB CM_BMC_CMC_Temperatur_090 "" TAB_INTP 2 0 -40 252 86 /end COMPU_TAB
/begin COMPU_VTAB CM_BMC_CMC_Temperatur_090.StatusText "" TAB_VERB 3 253 "CM_BMC_CMC_Temperatur_090_Cxfd_nicht_vorhanden" 254 "CM_BMC_CMC_Temperatur_090_Cxfe_Init" 255 "CM_BMC_CMC_Temperatur_090_Cxff_Fehler" /end COMPU_VTAB
/begin COMPU_TAB CM_BMC_CMC_Temperatur_091 "" TAB_INTP 2 0 -40 252 86 /end COMPU_TAB
/begin COMPU_VTAB CM_BMC_CMC_Temperatur_091.StatusText "" TAB_VERB 3 253 "CM_BMC_CMC_Temperatur_091_Cxfd_nicht_vorhanden" 254 "CM_BMC_CMC_Temperatur_091_Cxfe_Init" 255 "CM_BMC_CMC_Temperatur_091_Cxff_Fehler" /end COMPU_VTAB
/begin COMPU_TAB CM_BMC_CMC_Temperatur_092 "" TAB_INTP 2 0 -40 252 86 /end COMPU_TAB
/begin COMPU_VTAB CM_BMC_CMC_Temperatur_092.StatusText "" TAB_VERB 3 253 "CM_BMC_CMC_Temperatur_092_Cxfd_nicht_vorhanden" 254 "CM_BMC_CMC_Temperatur_092_Cxfe_Init" 255 "CM_BMC_CMC_Temperatur_092_Cxff_Fehler" /end COMPU_VTAB
/begin COMPU_TAB CM_BMC_CMC_Temperatur_093 "" TAB_INTP 2 0 -40 252 86 /end COMPU_TAB
/begin COMPU_VTAB CM_BMC_CMC_Temperatur_093.StatusText "" TAB_VERB 3 253 "CM_BMC_CMC_Temperatur_093_Cxfd_nicht_vorhanden" 254 "CM_BMC_CMC_Temperatur_093_Cxfe_Init" 255 "CM_BMC_CMC_Temperatur_093_Cxff_Fehler" /end COMPU_VTAB
/begin COMPU_TAB CM_BMC_CMC_Temperatur_094 "" TAB_INTP 2 0 -40 252 86 /end COMPU_TAB
/begin COMPU_VTAB CM_BMC_CMC_Temperatur_094.StatusText "" TAB_VERB 3 253 "CM_BMC_CMC_Temperatur_094_Cxfd_nicht_vorhanden" 254 "CM_BMC_CMC_Temperatur_094_Cxfe_Init" 255 "CM_BMC_CMC_Temperatur_094_Cxff_Fehler" /end COMPU_VTAB
/begin COMPU_TAB CM_BMC_CMC_Temperatur_095 "" TAB_INTP 2 0 -40 252 86 /end COMPU_TAB
/begin COMPU_VTAB CM_BMC_CMC_Temperatur_095.StatusText "" TAB_VERB 3 253 "CM_BMC_CMC_Temperatur_095_Cxfd_nicht_vorhanden" 254 "CM_BMC_CMC_Temperatur_095_Cxfe_Init" 255 "CM_BMC_CMC_Temperatur_095_Cxff_Fehler" /end COMPU_VTAB
/begin COMPU_TAB CM_BMC_CMC_Temperatur_096 "" TAB_INTP 2 0 -40 252 86 /end COMPU_TAB
/begin COMPU_VTAB CM_BMC_CMC_Temperatur_096.StatusText "" TAB_VERB 3 253 "CM_BMC_CMC_Temperatur_096_Cxfd_nicht_vorhanden" 254 "CM_BMC_CMC_Temperatur_096_Cxfe_Init" 255 "CM_BMC_CMC_Temperatur_096_Cxff_Fehler" /end COMPU_VTAB
/begin COMPU_TAB CM_BMC_CMC_Zellspannung_001 "" TAB_INTP 2 0 1000 4091 5091 /end COMPU_TAB
/begin COMPU_VTAB CM_BMC_CMC_Zellspannung_001.StatusText "" TAB_VERB 4 4092 "CM_BMC_CMC_Zellspannung_001_Cxffc_kleiner_1V" 4093 "CM_BMC_CMC_Zellspannung_001_Cxffd_nicht_vorhanden" 4094 "CM_BMC_CMC_Zellspannung_001_Cxffe_Init" 4095 "CM_BMC_CMC_Zellspannung_001_Cxfff_Fehler" /end COMPU_VTAB
/begin COMPU_TAB CM_BMC_CMC_Zellspannung_002 "" TAB_INTP 2 0 1000 4091 5091 /end COMPU_TAB
/begin COMPU_VTAB CM_BMC_CMC_Zellspannung_002.StatusText "" TAB_VERB 4 4092 "CM_BMC_CMC_Zellspannung_002_Cxffc_kleiner_1V" 4093 "CM_BMC_CMC_Zellspannung_002_Cxffd_nicht_vorhanden" 4094 "CM_BMC_CMC_Zellspannung_002_Cxffe_Init" 4095 "CM_BMC_CMC_Zellspannung_002_Cxfff_Fehler" /end COMPU_VTAB
/begin COMPU_TAB CM_BMC_CMC_Zellspannung_003 "" TAB_INTP 2 0 1000 4091 5091 /end COMPU_TAB
/begin COMPU_VTAB CM_BMC_CMC_Zellspannung_003.StatusText "" TAB_VERB 4 4092 "CM_BMC_CMC_Zellspannung_003_Cxffc_kleiner_1V" 4093 "CM_BMC_CMC_Zellspannung_003_Cxffd_nicht_vorhanden" 4094 "CM_BMC_CMC_Zellspannung_003_Cxffe_Init" 4095 "CM_BMC_CMC_Zellspannung_003_Cxfff_Fehler" /end COMPU_VTAB
/begin COMPU_TAB CM_BMC_CMC_Zellspannung_004 "" TAB_INTP 2 0 1000 4091 5091 /end COMPU_TAB
/begin COMPU_VTAB CM_BMC_CMC_Zellspannung_004.StatusText "" TAB_VERB 4 4092 "CM_BMC_CMC_Zellspannung_004_Cxffc_kleiner_1V" 4093 "CM_BMC_CMC_Zellspannung_004_Cxffd_nicht_vorhanden" 4094 "CM_BMC_CMC_Zellspannung_004_Cxffe_Init" 4095 "CM_BMC_CMC_Zellspannung_004_Cxfff_Fehler" /end COMPU_VTAB
/begin COMPU_TAB CM_BMC_CMC_Zellspannung_005 "" TAB_INTP 2 0 1000 4091 5091 /end COMPU_TAB
/begin COMPU_VTAB CM_BMC_CMC_Zellspannung_005.StatusText "" TAB_VERB 4 4092 "CM_BMC_CMC_Zellspannung_005_Cxffc_kleiner_1V" 4093 "CM_BMC_CMC_Zellspannung_005_Cxffd_nicht_vorhanden" 4094 "CM_BMC_CMC_Zellspannung_005_Cxffe_Init" 4095 "CM_BMC_CMC_Zellspannung_005_Cxfff_Fehler" /end COMPU_VTAB
/begin COMPU_TAB CM_BMC_CMC_Zellspannung_006 "" TAB_INTP 2 0 1000 4091 5091 /end COMPU_TAB
/begin COMPU_VTAB CM_BMC_CMC_Zellspannung_006.StatusText "" TAB_VERB 4 4092 "CM_BMC_CMC_Zellspannung_006_Cxffc_kleiner_1V" 4093 "CM_BMC_CMC_Zellspannung_006_Cxffd_nicht_vorhanden" 4094 "CM_BMC_CMC_Zellspannung_006_Cxffe_Init" 4095 "CM_BMC_CMC_Zellspannung_006_Cxfff_Fehler" /end COMPU_VTAB
/begin COMPU_TAB CM_BMC_CMC_Zellspannung_007 "" TAB_INTP 2 0 1000 4091 5091 /end COMPU_TAB
/begin COMPU_VTAB CM_BMC_CMC_Zellspannung_007.StatusText "" TAB_VERB 4 4092 "CM_BMC_CMC_Zellspannung_007_Cxffc_kleiner_1V" 4093 "CM_BMC_CMC_Zellspannung_007_Cxffd_nicht_vorhanden" 4094 "CM_BMC_CMC_Zellspannung_007_Cxffe_Init" 4095 "CM_BMC_CMC_Zellspannung_007_Cxfff_Fehler" /end COMPU_VTAB
/begin COMPU_TAB CM_BMC_CMC_Zellspannung_008 "" TAB_INTP 2 0 1000 4091 5091 /end COMPU_TAB
/begin COMPU_VTAB CM_BMC_CMC_Zellspannung_008.StatusText "" TAB_VERB 4 4092 "CM_BMC_CMC_Zellspannung_008_Cxffc_kleiner_1V" 4093 "CM_BMC_CMC_Zellspannung_008_Cxffd_nicht_vorhanden" 4094 "CM_BMC_CMC_Zellspannung_008_Cxffe_Init" 4095 "CM_BMC_CMC_Zellspannung_008_Cxfff_Fehler" /end COMPU_VTAB
/begin COMPU_TAB CM_BMC_CMC_Zellspannung_009 "" TAB_INTP 2 0 1000 4091 5091 /end COMPU_TAB
/begin COMPU_VTAB CM_BMC_CMC_Zellspannung_009.StatusText "" TAB_VERB 4 4092 "CM_BMC_CMC_Zellspannung_009_Cxffc_kleiner_1V" 4093 "CM_BMC_CMC_Zellspannung_009_Cxffd_nicht_vorhanden" 4094 "CM_BMC_CMC_Zellspannung_009_Cxffe_Init" 4095 "CM_BMC_CMC_Zellspannung_009_Cxfff_Fehler" /end COMPU_VTAB
/begin COMPU_TAB CM_BMC_CMC_Zellspannung_010 "" TAB_INTP 2 0 1000 4091 5091 /end COMPU_TAB
/begin COMPU_VTAB CM_BMC_CMC_Zellspannung_010.StatusText "" TAB_VERB 4 4092 "CM_BMC_CMC_Zellspannung_010_Cxffc_kleiner_1V" 4093 "CM_BMC_CMC_Zellspannung_010_Cxffd_nicht_vorhanden" 4094 "CM_BMC_CMC_Zellspannung_010_Cxffe_Init" 4095 "CM_BMC_CMC_Zellspannung_010_Cxfff_Fehler" /end COMPU_VTAB
/begin COMPU_TAB CM_BMC_CMC_Zellspannung_011 "" TAB_INTP 2 0 1000 4091 5091 /end COMPU_TAB
/begin COMPU_VTAB CM_BMC_CMC_Zellspannung_011.StatusText "" TAB_VERB 4 4092 "CM_BMC_CMC_Zellspannung_011_Cxffc_kleiner_1V" 4093 "CM_BMC_CMC_Zellspannung_011_Cxffd_nicht_vorhanden" 4094 "CM_BMC_CMC_Zellspannung_011_Cxffe_Init" 4095 "CM_BMC_CMC_Zellspannung_011_Cxfff_Fehler" /end COMPU_VTAB
/begin COMPU_TAB CM_BMC_CMC_Zellspannung_012 "" TAB_INTP 2 0 1000 4091 5091 /end COMPU_TAB
/begin COMPU_VTAB CM_BMC_CMC_Zellspannung_012.StatusText "" TAB_VERB 4 4092 "CM_BMC_CMC_Zellspannung_012_Cxffc_kleiner_1V" 4093 "CM_BMC_CMC_Zellspannung_012_Cxffd_nicht_vorhanden" 4094 "CM_BMC_CMC_Zellspannung_012_Cxffe_Init" 4095 "CM_BMC_CMC_Zellspannung_012_Cxfff_Fehler" /end COMPU_VTAB
/begin COMPU_TAB CM_BMC_CMC_Zellspannung_013 "" TAB_INTP 2 0 1000 4091 5091 /end COMPU_TAB
/begin COMPU_VTAB CM_BMC_CMC_Zellspannung_013.StatusText "" TAB_VERB 4 4092 "CM_BMC_CMC_Zellspannung_013_Cxffc_kleiner_1V" 4093 "CM_BMC_CMC_Zellspannung_013_Cxffd_nicht_vorhanden" 4094 "CM_BMC_CMC_Zellspannung_013_Cxffe_Init" 4095 "CM_BMC_CMC_Zellspannung_013_Cxfff_Fehler" /end COMPU_VTAB
/begin COMPU_TAB CM_BMC_CMC_Zellspannung_014 "" TAB_INTP 2 0 1000 4091 5091 /end COMPU_TAB
/begin COMPU_VTAB CM_BMC_CMC_Zellspannung_014.StatusText "" TAB_VERB 4 4092 "CM_BMC_CMC_Zellspannung_014_Cxffc_kleiner_1V" 4093 "CM_BMC_CMC_Zellspannung_014_Cxffd_nicht_vorhanden" 4094 "CM_BMC_CMC_Zellspannung_014_Cxffe_Init" 4095 "CM_BMC_CMC_Zellspannung_014_Cxfff_Fehler" /end COMPU_VTAB
/begin COMPU_TAB CM_BMC_CMC_Zellspannung_015 "" TAB_INTP 2 0 1000 4091 5091 /end COMPU_TAB
/begin COMPU_VTAB CM_BMC_CMC_Zellspannung_015.StatusText "" TAB_VERB 4 4092 "CM_BMC_CMC_Zellspannung_015_Cxffc_kleiner_1V" 4093 "CM_BMC_CMC_Zellspannung_015_Cxffd_nicht_vorhanden" 4094 "CM_BMC_CMC_Zellspannung_015_Cxffe_Init" 4095 "CM_BMC_CMC_Zellspannung_015_Cxfff_Fehler" /end COMPU_VTAB
/begin COMPU_TAB CM_BMC_CMC_Zellspannung_016 "" TAB_INTP 2 0 1000 4091 5091 /end COMPU_TAB
/begin COMPU_VTAB CM_BMC_CMC_Zellspannung_016.StatusText "" TAB_VERB 4 4092 "CM_BMC_CMC_Zellspannung_016_Cxffc_kleiner_1V" 4093 "CM_BMC_CMC_Zellspannung_016_Cxffd_nicht_vorhanden" 4094 "CM_BMC_CMC_Zellspannung_016_Cxffe_Init" 4095 "CM_BMC_CMC_Zellspannung_016_Cxfff_Fehler" /end COMPU_VTAB
/begin COMPU_TAB CM_BMC_CMC_Zellspannung_017 "" TAB_INTP 2 0 1000 4091 5091 /end COMPU_TAB
/begin COMPU_VTAB CM_BMC_CMC_Zellspannung_017.StatusText "" TAB_VERB 4 4092 "CM_BMC_CMC_Zellspannung_017_Cxffc_kleiner_1V" 4093 "CM_BMC_CMC_Zellspannung_017_Cxffd_nicht_vorhanden" 4094 "CM_BMC_CMC_Zellspannung_017_Cxffe_Init" 4095 "CM_BMC_CMC_Zellspannung_017_Cxfff_Fehler" /end COMPU_VTAB
/begin COMPU_TAB CM_BMC_CMC_Zellspannung_018 "" TAB_INTP 2 0 1000 4091 5091 /end COMPU_TAB
/begin COMPU_VTAB CM_BMC_CMC_Zellspannung_018.StatusText "" TAB_VERB 4 4092 "CM_BMC_CMC_Zellspannung_018_Cxffc_kleiner_1V" 4093 "CM_BMC_CMC_Zellspannung_018_Cxffd_nicht_vorhanden" 4094 "CM_BMC_CMC_Zellspannung_018_Cxffe_Init" 4095 "CM_BMC_CMC_Zellspannung_018_Cxfff_Fehler" /end COMPU_VTAB
/begin COMPU_TAB CM_BMC_CMC_Zellspannung_019 "" TAB_INTP 2 0 1000 4091 5091 /end COMPU_TAB
/begin COMPU_VTAB CM_BMC_CMC_Zellspannung_019.StatusText "" TAB_VERB 4 4092 "CM_BMC_CMC_Zellspannung_019_Cxffc_kleiner_1V" 4093 "CM_BMC_CMC_Zellspannung_019_Cxffd_nicht_vorhanden" 4094 "CM_BMC_CMC_Zellspannung_019_Cxffe_Init" 4095 "CM_BMC_CMC_Zellspannung_019_Cxfff_Fehler" /end COMPU_VTAB
/begin COMPU_TAB CM_BMC_CMC_Zellspannung_01_Messzeit "" TAB_INTP 2 0 0 253 253 /end COMPU_TAB
/begin COMPU_VTAB CM_BMC_CMC_Zellspannung_01_Messzeit.StatusText "" TAB_VERB 2 254 "CM_BMC_CMC_Zellspannung_01_Messzeit_Cxfe_Init" 255 "CM_BMC_CMC_Zellspannung_01_Messzeit_Cxff_Fehler" /end COMPU_VTAB
/begin COMPU_TAB CM_BMC_CMC_Zellspannung_020 "" TAB_INTP 2 0 1000 4091 5091 /end COMPU_TAB
/begin COMPU_VTAB CM_BMC_CMC_Zellspannung_020.StatusText "" TAB_VERB 4 4092 "CM_BMC_CMC_Zellspannung_020_Cxffc_kleiner_1V" 4093 "CM_BMC_CMC_Zellspannung_020_Cxffd_nicht_vorhanden" 4094 "CM_BMC_CMC_Zellspannung_020_Cxffe_Init" 4095 "CM_BMC_CMC_Zellspannung_020_Cxfff_Fehler" /end COMPU_VTAB
/begin COMPU_TAB CM_BMC_CMC_Zellspannung_021 "" TAB_INTP 2 0 1000 4091 5091 /end COMPU_TAB
/begin COMPU_VTAB CM_BMC_CMC_Zellspannung_021.StatusText "" TAB_VERB 4 4092 "CM_BMC_CMC_Zellspannung_021_Cxffc_kleiner_1V" 4093 "CM_BMC_CMC_Zellspannung_021_Cxffd_nicht_vorhanden" 4094 "CM_BMC_CMC_Zellspannung_021_Cxffe_Init" 4095 "CM_BMC_CMC_Zellspannung_021_Cxfff_Fehler" /end COMPU_VTAB
/begin COMPU_TAB CM_BMC_CMC_Zellspannung_022 "" TAB_INTP 2 0 1000 4091 5091 /end COMPU_TAB
/begin COMPU_VTAB CM_BMC_CMC_Zellspannung_022.StatusText "" TAB_VERB 4 4092 "CM_BMC_CMC_Zellspannung_022_Cxffc_kleiner_1V" 4093 "CM_BMC_CMC_Zellspannung_022_Cxffd_nicht_vorhanden" 4094 "CM_BMC_CMC_Zellspannung_022_Cxffe_Init" 4095 "CM_BMC_CMC_Zellspannung_022_Cxfff_Fehler" /end COMPU_VTAB
/begin COMPU_TAB CM_BMC_CMC_Zellspannung_023 "" TAB_INTP 2 0 1000 4091 5091 /end COMPU_TAB
/begin COMPU_VTAB CM_BMC_CMC_Zellspannung_023.StatusText "" TAB_VERB 4 4092 "CM_BMC_CMC_Zellspannung_023_Cxffc_kleiner_1V" 4093 "CM_BMC_CMC_Zellspannung_023_Cxffd_nicht_vorhanden" 4094 "CM_BMC_CMC_Zellspannung_023_Cxffe_Init" 4095 "CM_BMC_CMC_Zellspannung_023_Cxfff_Fehler" /end COMPU_VTAB
/begin COMPU_TAB CM_BMC_CMC_Zellspannung_024 "" TAB_INTP 2 0 1000 4091 5091 /end COMPU_TAB
/begin COMPU_VTAB CM_BMC_CMC_Zellspannung_024.StatusText "" TAB_VERB 4 4092 "CM_BMC_CMC_Zellspannung_024_Cxffc_kleiner_1V" 4093 "CM_BMC_CMC_Zellspannung_024_Cxffd_nicht_vorhanden" 4094 "CM_BMC_CMC_Zellspannung_024_Cxffe_Init" 4095 "CM_BMC_CMC_Zellspannung_024_Cxfff_Fehler" /end COMPU_VTAB
/begin COMPU_TAB CM_BMC_CMC_Zellspannung_025 "" TAB_INTP 2 0 1000 4091 5091 /end COMPU_TAB
/begin COMPU_VTAB CM_BMC_CMC_Zellspannung_025.StatusText "" TAB_VERB 4 4092 "CM_BMC_CMC_Zellspannung_025_Cxffc_kleiner_1V" 4093 "CM_BMC_CMC_Zellspannung_025_Cxffd_nicht_vorhanden" 4094 "CM_BMC_CMC_Zellspannung_025_Cxffe_Init" 4095 "CM_BMC_CMC_Zellspannung_025_Cxfff_Fehler" /end COMPU_VTAB
/begin COMPU_TAB CM_BMC_CMC_Zellspannung_026 "" TAB_INTP 2 0 1000 4091 5091 /end COMPU_TAB
/begin COMPU_VTAB CM_BMC_CMC_Zellspannung_026.StatusText "" TAB_VERB 4 4092 "CM_BMC_CMC_Zellspannung_026_Cxffc_kleiner_1V" 4093 "CM_BMC_CMC_Zellspannung_026_Cxffd_nicht_vorhanden" 4094 "CM_BMC_CMC_Zellspannung_026_Cxffe_Init" 4095 "CM_BMC_CMC_Zellspannung_026_Cxfff_Fehler" /end COMPU_VTAB
/begin COMPU_TAB CM_BMC_CMC_Zellspannung_027 "" TAB_INTP 2 0 1000 4091 5091 /end COMPU_TAB
/begin COMPU_VTAB CM_BMC_CMC_Zellspannung_027.StatusText "" TAB_VERB 4 4092 "CM_BMC_CMC_Zellspannung_027_Cxffc_kleiner_1V" 4093 "CM_BMC_CMC_Zellspannung_027_Cxffd_nicht_vorhanden" 4094 "CM_BMC_CMC_Zellspannung_027_Cxffe_Init" 4095 "CM_BMC_CMC_Zellspannung_027_Cxfff_Fehler" /end COMPU_VTAB
/begin COMPU_TAB CM_BMC_CMC_Zellspannung_028 "" TAB_INTP 2 0 1000 4091 5091 /end COMPU_TAB
/begin COMPU_VTAB CM_BMC_CMC_Zellspannung_028.StatusText "" TAB_VERB 4 4092 "CM_BMC_CMC_Zellspannung_028_Cxffc_kleiner_1V" 4093 "CM_BMC_CMC_Zellspannung_028_Cxffd_nicht_vorhanden" 4094 "CM_BMC_CMC_Zellspannung_028_Cxffe_Init" 4095 "CM_BMC_CMC_Zellspannung_028_Cxfff_Fehler" /end COMPU_VTAB
/begin COMPU_TAB CM_BMC_CMC_Zellspannung_029 "" TAB_INTP 2 0 1000 4091 5091 /end COMPU_TAB
/begin COMPU_VTAB CM_BMC_CMC_Zellspannung_029.StatusText "" TAB_VERB 4 4092 "CM_BMC_CMC_Zellspannung_029_Cxffc_kleiner_1V" 4093 "CM_BMC_CMC_Zellspannung_029_Cxffd_nicht_vorhanden" 4094 "CM_BMC_CMC_Zellspannung_029_Cxffe_Init" 4095 "CM_BMC_CMC_Zellspannung_029_Cxfff_Fehler" /end COMPU_VTAB
/begin COMPU_TAB CM_BMC_CMC_Zellspannung_02_Messzeit "" TAB_INTP 2 0 0 253 253 /end COMPU_TAB
/begin COMPU_VTAB CM_BMC_CMC_Zellspannung_02_Messzeit.StatusText "" TAB_VERB 2 254 "CM_BMC_CMC_Zellspannung_02_Messzeit_Cxfe_Init" 255 "CM_BMC_CMC_Zellspannung_02_Messzeit_Cxff_Fehler" /end COMPU_VTAB
/begin COMPU_TAB CM_BMC_CMC_Zellspannung_030 "" TAB_INTP 2 0 1000 4091 5091 /end COMPU_TAB
/begin COMPU_VTAB CM_BMC_CMC_Zellspannung_030.StatusText "" TAB_VERB 4 4092 "CM_BMC_CMC_Zellspannung_030_Cxffc_kleiner_1V" 4093 "CM_BMC_CMC_Zellspannung_030_Cxffd_nicht_vorhanden" 4094 "CM_BMC_CMC_Zellspannung_030_Cxffe_Init" 4095 "CM_BMC_CMC_Zellspannung_030_Cxfff_Fehler" /end COMPU_VTAB
/begin COMPU_TAB CM_BMC_CMC_Zellspannung_031 "" TAB_INTP 2 0 1000 4091 5091 /end COMPU_TAB
/begin COMPU_VTAB CM_BMC_CMC_Zellspannung_031.StatusText "" TAB_VERB 4 4092 "CM_BMC_CMC_Zellspannung_031_Cxffc_kleiner_1V" 4093 "CM_BMC_CMC_Zellspannung_031_Cxffd_nicht_vorhanden" 4094 "CM_BMC_CMC_Zellspannung_031_Cxffe_Init" 4095 "CM_BMC_CMC_Zellspannung_031_Cxfff_Fehler" /end COMPU_VTAB
/begin COMPU_TAB CM_BMC_CMC_Zellspannung_032 "" TAB_INTP 2 0 1000 4091 5091 /end COMPU_TAB
/begin COMPU_VTAB CM_BMC_CMC_Zellspannung_032.StatusText "" TAB_VERB 4 4092 "CM_BMC_CMC_Zellspannung_032_Cxffc_kleiner_1V" 4093 "CM_BMC_CMC_Zellspannung_032_Cxffd_nicht_vorhanden" 4094 "CM_BMC_CMC_Zellspannung_032_Cxffe_Init" 4095 "CM_BMC_CMC_Zellspannung_032_Cxfff_Fehler" /end COMPU_VTAB
/begin COMPU_TAB CM_BMC_CMC_Zellspannung_033 "" TAB_INTP 2 0 1000 4091 5091 /end COMPU_TAB
/begin COMPU_VTAB CM_BMC_CMC_Zellspannung_033.StatusText "" TAB_VERB 4 4092 "CM_BMC_CMC_Zellspannung_033_Cxffc_kleiner_1V" 4093 "CM_BMC_CMC_Zellspannung_033_Cxffd_nicht_vorhanden" 4094 "CM_BMC_CMC_Zellspannung_033_Cxffe_Init" 4095 "CM_BMC_CMC_Zellspannung_033_Cxfff_Fehler" /end COMPU_VTAB
/begin COMPU_TAB CM_BMC_CMC_Zellspannung_034 "" TAB_INTP 2 0 1000 4091 5091 /end COMPU_TAB
/begin COMPU_VTAB CM_BMC_CMC_Zellspannung_034.StatusText "" TAB_VERB 4 4092 "CM_BMC_CMC_Zellspannung_034_Cxffc_kleiner_1V" 4093 "CM_BMC_CMC_Zellspannung_034_Cxffd_nicht_vorhanden" 4094 "CM_BMC_CMC_Zellspannung_034_Cxffe_Init" 4095 "CM_BMC_CMC_Zellspannung_034_Cxfff_Fehler" /end COMPU_VTAB
/begin COMPU_TAB CM_BMC_CMC_Zellspannung_035 "" TAB_INTP 2 0 1000 4091 5091 /end COMPU_TAB
/begin COMPU_VTAB CM_BMC_CMC_Zellspannung_035.StatusText "" TAB_VERB 4 4092 "CM_BMC_CMC_Zellspannung_035_Cxffc_kleiner_1V" 4093 "CM_BMC_CMC_Zellspannung_035_Cxffd_nicht_vorhanden" 4094 "CM_BMC_CMC_Zellspannung_035_Cxffe_Init" 4095 "CM_BMC_CMC_Zellspannung_035_Cxfff_Fehler" /end COMPU_VTAB
/begin COMPU_TAB CM_BMC_CMC_Zellspannung_036 "" TAB_INTP 2 0 1000 4091 5091 /end COMPU_TAB
/begin COMPU_VTAB CM_BMC_CMC_Zellspannung_036.StatusText "" TAB_VERB 4 4092 "CM_BMC_CMC_Zellspannung_036_Cxffc_kleiner_1V" 4093 "CM_BMC_CMC_Zellspannung_036_Cxffd_nicht_vorhanden" 4094 "CM_BMC_CMC_Zellspannung_036_Cxffe_Init" 4095 "CM_BMC_CMC_Zellspannung_036_Cxfff_Fehler" /end COMPU_VTAB
/begin COMPU_TAB CM_BMC_CMC_Zellspannung_037 "" TAB_INTP 2 0 1000 4091 5091 /end COMPU_TAB
/begin COMPU_VTAB CM_BMC_CMC_Zellspannung_037.StatusText "" TAB_VERB 4 4092 "CM_BMC_CMC_Zellspannung_037_Cxffc_kleiner_1V" 4093 "CM_BMC_CMC_Zellspannung_037_Cxffd_nicht_vorhanden" 4094 "CM_BMC_CMC_Zellspannung_037_Cxffe_Init" 4095 "CM_BMC_CMC_Zellspannung_037_Cxfff_Fehler" /end COMPU_VTAB
/begin COMPU_TAB CM_BMC_CMC_Zellspannung_038 "" TAB_INTP 2 0 1000 4091 5091 /end COMPU_TAB
/begin COMPU_VTAB CM_BMC_CMC_Zellspannung_038.StatusText "" TAB_VERB 4 4092 "CM_BMC_CMC_Zellspannung_038_Cxffc_kleiner_1V" 4093 "CM_BMC_CMC_Zellspannung_038_Cxffd_nicht_vorhanden" 4094 "CM_BMC_CMC_Zellspannung_038_Cxffe_Init" 4095 "CM_BMC_CMC_Zellspannung_038_Cxfff_Fehler" /end COMPU_VTAB
/begin COMPU_TAB CM_BMC_CMC_Zellspannung_039 "" TAB_INTP 2 0 1000 4091 5091 /end COMPU_TAB
/begin COMPU_VTAB CM_BMC_CMC_Zellspannung_039.StatusText "" TAB_VERB 4 4092 "CM_BMC_CMC_Zellspannung_039_Cxffc_kleiner_1V" 4093 "CM_BMC_CMC_Zellspannung_039_Cxffd_nicht_vorhanden" 4094 "CM_BMC_CMC_Zellspannung_039_Cxffe_Init" 4095 "CM_BMC_CMC_Zellspannung_039_Cxfff_Fehler" /end COMPU_VTAB
/begin COMPU_TAB CM_BMC_CMC_Zellspannung_03_Messzeit "" TAB_INTP 2 0 0 253 253 /end COMPU_TAB
/begin COMPU_VTAB CM_BMC_CMC_Zellspannung_03_Messzeit.StatusText "" TAB_VERB 2 254 "CM_BMC_CMC_Zellspannung_03_Messzeit_Cxfe_Init" 255 "CM_BMC_CMC_Zellspannung_03_Messzeit_Cxff_Fehler" /end COMPU_VTAB
/begin COMPU_TAB CM_BMC_CMC_Zellspannung_040 "" TAB_INTP 2 0 1000 4091 5091 /end COMPU_TAB
/begin COMPU_VTAB CM_BMC_CMC_Zellspannung_040.StatusText "" TAB_VERB 4 4092 "CM_BMC_CMC_Zellspannung_040_Cxffc_kleiner_1V" 4093 "CM_BMC_CMC_Zellspannung_040_Cxffd_nicht_vorhanden" 4094 "CM_BMC_CMC_Zellspannung_040_Cxffe_Init" 4095 "CM_BMC_CMC_Zellspannung_040_Cxfff_Fehler" /end COMPU_VTAB
/begin COMPU_TAB CM_BMC_CMC_Zellspannung_041 "" TAB_INTP 2 0 1000 4091 5091 /end COMPU_TAB
/begin COMPU_VTAB CM_BMC_CMC_Zellspannung_041.StatusText "" TAB_VERB 4 4092 "CM_BMC_CMC_Zellspannung_041_Cxffc_kleiner_1V" 4093 "CM_BMC_CMC_Zellspannung_041_Cxffd_nicht_vorhanden" 4094 "CM_BMC_CMC_Zellspannung_041_Cxffe_Init" 4095 "CM_BMC_CMC_Zellspannung_041_Cxfff_Fehler" /end COMPU_VTAB
/begin COMPU_TAB CM_BMC_CMC_Zellspannung_042 "" TAB_INTP 2 0 1000 4091 5091 /end COMPU_TAB
/begin COMPU_VTAB CM_BMC_CMC_Zellspannung_042.StatusText "" TAB_VERB 4 4092 "CM_BMC_CMC_Zellspannung_042_Cxffc_kleiner_1V" 4093 "CM_BMC_CMC_Zellspannung_042_Cxffd_nicht_vorhanden" 4094 "CM_BMC_CMC_Zellspannung_042_Cxffe_Init" 4095 "CM_BMC_CMC_Zellspannung_042_Cxfff_Fehler" /end COMPU_VTAB
/begin COMPU_TAB CM_BMC_CMC_Zellspannung_043 "" TAB_INTP 2 0 1000 4091 5091 /end COMPU_TAB
/begin COMPU_VTAB CM_BMC_CMC_Zellspannung_043.StatusText "" TAB_VERB 4 4092 "CM_BMC_CMC_Zellspannung_043_Cxffc_kleiner_1V" 4093 "CM_BMC_CMC_Zellspannung_043_Cxffd_nicht_vorhanden" 4094 "CM_BMC_CMC_Zellspannung_043_Cxffe_Init" 4095 "CM_BMC_CMC_Zellspannung_043_Cxfff_Fehler" /end COMPU_VTAB
/begin COMPU_TAB CM_BMC_CMC_Zellspannung_044 "" TAB_INTP 2 0 1000 4091 5091 /end COMPU_TAB
/begin COMPU_VTAB CM_BMC_CMC_Zellspannung_044.StatusText "" TAB_VERB 4 4092 "CM_BMC_CMC_Zellspannung_044_Cxffc_kleiner_1V" 4093 "CM_BMC_CMC_Zellspannung_044_Cxffd_nicht_vorhanden" 4094 "CM_BMC_CMC_Zellspannung_044_Cxffe_Init" 4095 "CM_BMC_CMC_Zellspannung_044_Cxfff_Fehler" /end COMPU_VTAB
/begin COMPU_TAB CM_BMC_CMC_Zellspannung_045 "" TAB_INTP 2 0 1000 4091 5091 /end COMPU_TAB
/begin COMPU_VTAB CM_BMC_CMC_Zellspannung_045.StatusText "" TAB_VERB 4 4092 "CM_BMC_CMC_Zellspannung_045_Cxffc_kleiner_1V" 4093 "CM_BMC_CMC_Zellspannung_045_Cxffd_nicht_vorhanden" 4094 "CM_BMC_CMC_Zellspannung_045_Cxffe_Init" 4095 "CM_BMC_CMC_Zellspannung_045_Cxfff_Fehler" /end COMPU_VTAB
/begin COMPU_TAB CM_BMC_CMC_Zellspannung_046 "" TAB_INTP 2 0 1000 4091 5091 /end COMPU_TAB
/begin COMPU_VTAB CM_BMC_CMC_Zellspannung_046.StatusText "" TAB_VERB 4 4092 "CM_BMC_CMC_Zellspannung_046_Cxffc_kleiner_1V" 4093 "CM_BMC_CMC_Zellspannung_046_Cxffd_nicht_vorhanden" 4094 "CM_BMC_CMC_Zellspannung_046_Cxffe_Init" 4095 "CM_BMC_CMC_Zellspannung_046_Cxfff_Fehler" /end COMPU_VTAB
/begin COMPU_TAB CM_BMC_CMC_Zellspannung_047 "" TAB_INTP 2 0 1000 4091 5091 /end COMPU_TAB
/begin COMPU_VTAB CM_BMC_CMC_Zellspannung_047.StatusText "" TAB_VERB 4 4092 "CM_BMC_CMC_Zellspannung_047_Cxffc_kleiner_1V" 4093 "CM_BMC_CMC_Zellspannung_047_Cxffd_nicht_vorhanden" 4094 "CM_BMC_CMC_Zellspannung_047_Cxffe_Init" 4095 "CM_BMC_CMC_Zellspannung_047_Cxfff_Fehler" /end COMPU_VTAB
/begin COMPU_TAB CM_BMC_CMC_Zellspannung_048 "" TAB_INTP 2 0 1000 4091 5091 /end COMPU_TAB
/begin COMPU_VTAB CM_BMC_CMC_Zellspannung_048.StatusText "" TAB_VERB 4 4092 "CM_BMC_CMC_Zellspannung_048_Cxffc_kleiner_1V" 4093 "CM_BMC_CMC_Zellspannung_048_Cxffd_nicht_vorhanden" 4094 "CM_BMC_CMC_Zellspannung_048_Cxffe_Init" 4095 "CM_BMC_CMC_Zellspannung_048_Cxfff_Fehler" /end COMPU_VTAB
/begin COMPU_TAB CM_BMC_CMC_Zellspannung_049 "" TAB_INTP 2 0 1000 4091 5091 /end COMPU_TAB
/begin COMPU_VTAB CM_BMC_CMC_Zellspannung_049.StatusText "" TAB_VERB 4 4092 "CM_BMC_CMC_Zellspannung_049_Cxffc_kleiner_1V" 4093 "CM_BMC_CMC_Zellspannung_049_Cxffd_nicht_vorhanden" 4094 "CM_BMC_CMC_Zellspannung_049_Cxffe_Init" 4095 "CM_BMC_CMC_Zellspannung_049_Cxfff_Fehler" /end COMPU_VTAB
/begin COMPU_TAB CM_BMC_CMC_Zellspannung_04_Messzeit "" TAB_INTP 2 0 0 253 253 /end COMPU_TAB
/begin COMPU_VTAB CM_BMC_CMC_Zellspannung_04_Messzeit.StatusText "" TAB_VERB 2 254 "CM_BMC_CMC_Zellspannung_04_Messzeit_Cxfe_Init" 255 "CM_BMC_CMC_Zellspannung_04_Messzeit_Cxff_Fehler" /end COMPU_VTAB
/begin COMPU_TAB CM_BMC_CMC_Zellspannung_050 "" TAB_INTP 2 0 1000 4091 5091 /end COMPU_TAB
/begin COMPU_VTAB CM_BMC_CMC_Zellspannung_050.StatusText "" TAB_VERB 4 4092 "CM_BMC_CMC_Zellspannung_050_Cxffc_kleiner_1V" 4093 "CM_BMC_CMC_Zellspannung_050_Cxffd_nicht_vorhanden" 4094 "CM_BMC_CMC_Zellspannung_050_Cxffe_Init" 4095 "CM_BMC_CMC_Zellspannung_050_Cxfff_Fehler" /end COMPU_VTAB
/begin COMPU_TAB CM_BMC_CMC_Zellspannung_051 "" TAB_INTP 2 0 1000 4091 5091 /end COMPU_TAB
/begin COMPU_VTAB CM_BMC_CMC_Zellspannung_051.StatusText "" TAB_VERB 4 4092 "CM_BMC_CMC_Zellspannung_051_Cxffc_kleiner_1V" 4093 "CM_BMC_CMC_Zellspannung_051_Cxffd_nicht_vorhanden" 4094 "CM_BMC_CMC_Zellspannung_051_Cxffe_Init" 4095 "CM_BMC_CMC_Zellspannung_051_Cxfff_Fehler" /end COMPU_VTAB
/begin COMPU_TAB CM_BMC_CMC_Zellspannung_052 "" TAB_INTP 2 0 1000 4091 5091 /end COMPU_TAB
/begin COMPU_VTAB CM_BMC_CMC_Zellspannung_052.StatusText "" TAB_VERB 4 4092 "CM_BMC_CMC_Zellspannung_052_Cxffc_kleiner_1V" 4093 "CM_BMC_CMC_Zellspannung_052_Cxffd_nicht_vorhanden" 4094 "CM_BMC_CMC_Zellspannung_052_Cxffe_Init" 4095 "CM_BMC_CMC_Zellspannung_052_Cxfff_Fehler" /end COMPU_VTAB
/begin COMPU_TAB CM_BMC_CMC_Zellspannung_053 "" TAB_INTP 2 0 1000 4091 5091 /end COMPU_TAB
/begin COMPU_VTAB CM_BMC_CMC_Zellspannung_053.StatusText "" TAB_VERB 4 4092 "CM_BMC_CMC_Zellspannung_053_Cxffc_kleiner_1V" 4093 "CM_BMC_CMC_Zellspannung_053_Cxffd_nicht_vorhanden" 4094 "CM_BMC_CMC_Zellspannung_053_Cxffe_Init" 4095 "CM_BMC_CMC_Zellspannung_053_Cxfff_Fehler" /end COMPU_VTAB
/begin COMPU_TAB CM_BMC_CMC_Zellspannung_054 "" TAB_INTP 2 0 1000 4091 5091 /end COMPU_TAB
/begin COMPU_VTAB CM_BMC_CMC_Zellspannung_054.StatusText "" TAB_VERB 4 4092 "CM_BMC_CMC_Zellspannung_054_Cxffc_kleiner_1V" 4093 "CM_BMC_CMC_Zellspannung_054_Cxffd_nicht_vorhanden" 4094 "CM_BMC_CMC_Zellspannung_054_Cxffe_Init" 4095 "CM_BMC_CMC_Zellspannung_054_Cxfff_Fehler" /end COMPU_VTAB
/begin COMPU_TAB CM_BMC_CMC_Zellspannung_055 "" TAB_INTP 2 0 1000 4091 5091 /end COMPU_TAB
/begin COMPU_VTAB CM_BMC_CMC_Zellspannung_055.StatusText "" TAB_VERB 4 4092 "CM_BMC_CMC_Zellspannung_055_Cxffc_kleiner_1V" 4093 "CM_BMC_CMC_Zellspannung_055_Cxffd_nicht_vorhanden" 4094 "CM_BMC_CMC_Zellspannung_055_Cxffe_Init" 4095 "CM_BMC_CMC_Zellspannung_055_Cxfff_Fehler" /end COMPU_VTAB
/begin COMPU_TAB CM_BMC_CMC_Zellspannung_056 "" TAB_INTP 2 0 1000 4091 5091 /end COMPU_TAB
/begin COMPU_VTAB CM_BMC_CMC_Zellspannung_056.StatusText "" TAB_VERB 4 4092 "CM_BMC_CMC_Zellspannung_056_Cxffc_kleiner_1V" 4093 "CM_BMC_CMC_Zellspannung_056_Cxffd_nicht_vorhanden" 4094 "CM_BMC_CMC_Zellspannung_056_Cxffe_Init" 4095 "CM_BMC_CMC_Zellspannung_056_Cxfff_Fehler" /end COMPU_VTAB
/begin COMPU_TAB CM_BMC_CMC_Zellspannung_057 "" TAB_INTP 2 0 1000 4091 5091 /end COMPU_TAB
/begin COMPU_VTAB CM_BMC_CMC_Zellspannung_057.StatusText "" TAB_VERB 4 4092 "CM_BMC_CMC_Zellspannung_057_Cxffc_kleiner_1V" 4093 "CM_BMC_CMC_Zellspannung_057_Cxffd_nicht_vorhanden" 4094 "CM_BMC_CMC_Zellspannung_057_Cxffe_Init" 4095 "CM_BMC_CMC_Zellspannung_057_Cxfff_Fehler" /end COMPU_VTAB
/begin COMPU_TAB CM_BMC_CMC_Zellspannung_058 "" TAB_INTP 2 0 1000 4091 5091 /end COMPU_TAB
/begin COMPU_VTAB CM_BMC_CMC_Zellspannung_058.StatusText "" TAB_VERB 4 4092 "CM_BMC_CMC_Zellspannung_058_Cxffc_kleiner_1V" 4093 "CM_BMC_CMC_Zellspannung_058_Cxffd_nicht_vorhanden" 4094 "CM_BMC_CMC_Zellspannung_058_Cxffe_Init" 4095 "CM_BMC_CMC_Zellspannung_058_Cxfff_Fehler" /end COMPU_VTAB
/begin COMPU_TAB CM_BMC_CMC_Zellspannung_059 "" TAB_INTP 2 0 1000 4091 5091 /end COMPU_TAB
/begin COMPU_VTAB CM_BMC_CMC_Zellspannung_059.StatusText "" TAB_VERB 4 4092 "CM_BMC_CMC_Zellspannung_059_Cxffc_kleiner_1V" 4093 "CM_BMC_CMC_Zellspannung_059_Cxffd_nicht_vorhanden" 4094 "CM_BMC_CMC_Zellspannung_059_Cxffe_Init" 4095 "CM_BMC_CMC_Zellspannung_059_Cxfff_Fehler" /end COMPU_VTAB
/begin COMPU_TAB CM_BMC_CMC_Zellspannung_05_Messzeit "" TAB_INTP 2 0 0 253 253 /end COMPU_TAB
/begin COMPU_VTAB CM_BMC_CMC_Zellspannung_05_Messzeit.StatusText "" TAB_VERB 2 254 "CM_BMC_CMC_Zellspannung_05_Messzeit_Cxfe_Init" 255 "CM_BMC_CMC_Zellspannung_05_Messzeit_Cxff_Fehler" /end COMPU_VTAB
/begin COMPU_TAB CM_BMC_CMC_Zellspannung_060 "" TAB_INTP 2 0 1000 4091 5091 /end COMPU_TAB
/begin COMPU_VTAB CM_BMC_CMC_Zellspannung_060.StatusText "" TAB_VERB 4 4092 "CM_BMC_CMC_Zellspannung_060_Cxffc_kleiner_1V" 4093 "CM_BMC_CMC_Zellspannung_060_Cxffd_nicht_vorhanden" 4094 "CM_BMC_CMC_Zellspannung_060_Cxffe_Init" 4095 "CM_BMC_CMC_Zellspannung_060_Cxfff_Fehler" /end COMPU_VTAB
/begin COMPU_TAB CM_BMC_CMC_Zellspannung_061 "" TAB_INTP 2 0 1000 4091 5091 /end COMPU_TAB
/begin COMPU_VTAB CM_BMC_CMC_Zellspannung_061.StatusText "" TAB_VERB 4 4092 "CM_BMC_CMC_Zellspannung_061_Cxffc_kleiner_1V" 4093 "CM_BMC_CMC_Zellspannung_061_Cxffd_nicht_vorhanden" 4094 "CM_BMC_CMC_Zellspannung_061_Cxffe_Init" 4095 "CM_BMC_CMC_Zellspannung_061_Cxfff_Fehler" /end COMPU_VTAB
/begin COMPU_TAB CM_BMC_CMC_Zellspannung_062 "" TAB_INTP 2 0 1000 4091 5091 /end COMPU_TAB
/begin COMPU_VTAB CM_BMC_CMC_Zellspannung_062.StatusText "" TAB_VERB 4 4092 "CM_BMC_CMC_Zellspannung_062_Cxffc_kleiner_1V" 4093 "CM_BMC_CMC_Zellspannung_062_Cxffd_nicht_vorhanden" 4094 "CM_BMC_CMC_Zellspannung_062_Cxffe_Init" 4095 "CM_BMC_CMC_Zellspannung_062_Cxfff_Fehler" /end COMPU_VTAB
/begin COMPU_TAB CM_BMC_CMC_Zellspannung_063 "" TAB_INTP 2 0 1000 4091 5091 /end COMPU_TAB
/begin COMPU_VTAB CM_BMC_CMC_Zellspannung_063.StatusText "" TAB_VERB 4 4092 "CM_BMC_CMC_Zellspannung_063_Cxffc_kleiner_1V" 4093 "CM_BMC_CMC_Zellspannung_063_Cxffd_nicht_vorhanden" 4094 "CM_BMC_CMC_Zellspannung_063_Cxffe_Init" 4095 "CM_BMC_CMC_Zellspannung_063_Cxfff_Fehler" /end COMPU_VTAB
/begin COMPU_TAB CM_BMC_CMC_Zellspannung_064 "" TAB_INTP 2 0 1000 4091 5091 /end COMPU_TAB
/begin COMPU_VTAB CM_BMC_CMC_Zellspannung_064.StatusText "" TAB_VERB 4 4092 "CM_BMC_CMC_Zellspannung_064_Cxffc_kleiner_1V" 4093 "CM_BMC_CMC_Zellspannung_064_Cxffd_nicht_vorhanden" 4094 "CM_BMC_CMC_Zellspannung_064_Cxffe_Init" 4095 "CM_BMC_CMC_Zellspannung_064_Cxfff_Fehler" /end COMPU_VTAB
/begin COMPU_TAB CM_BMC_CMC_Zellspannung_065 "" TAB_INTP 2 0 1000 4091 5091 /end COMPU_TAB
/begin COMPU_VTAB CM_BMC_CMC_Zellspannung_065.StatusText "" TAB_VERB 4 4092 "CM_BMC_CMC_Zellspannung_065_Cxffc_kleiner_1V" 4093 "CM_BMC_CMC_Zellspannung_065_Cxffd_nicht_vorhanden" 4094 "CM_BMC_CMC_Zellspannung_065_Cxffe_Init" 4095 "CM_BMC_CMC_Zellspannung_065_Cxfff_Fehler" /end COMPU_VTAB
/begin COMPU_TAB CM_BMC_CMC_Zellspannung_066 "" TAB_INTP 2 0 1000 4091 5091 /end COMPU_TAB
/begin COMPU_VTAB CM_BMC_CMC_Zellspannung_066.StatusText "" TAB_VERB 4 4092 "CM_BMC_CMC_Zellspannung_066_Cxffc_kleiner_1V" 4093 "CM_BMC_CMC_Zellspannung_066_Cxffd_nicht_vorhanden" 4094 "CM_BMC_CMC_Zellspannung_066_Cxffe_Init" 4095 "CM_BMC_CMC_Zellspannung_066_Cxfff_Fehler" /end COMPU_VTAB
/begin COMPU_TAB CM_BMC_CMC_Zellspannung_067 "" TAB_INTP 2 0 1000 4091 5091 /end COMPU_TAB
/begin COMPU_VTAB CM_BMC_CMC_Zellspannung_067.StatusText "" TAB_VERB 4 4092 "CM_BMC_CMC_Zellspannung_067_Cxffc_kleiner_1V" 4093 "CM_BMC_CMC_Zellspannung_067_Cxffd_nicht_vorhanden" 4094 "CM_BMC_CMC_Zellspannung_067_Cxffe_Init" 4095 "CM_BMC_CMC_Zellspannung_067_Cxfff_Fehler" /end COMPU_VTAB
/begin COMPU_TAB CM_BMC_CMC_Zellspannung_068 "" TAB_INTP 2 0 1000 4091 5091 /end COMPU_TAB
/begin COMPU_VTAB CM_BMC_CMC_Zellspannung_068.StatusText "" TAB_VERB 4 4092 "CM_BMC_CMC_Zellspannung_068_Cxffc_kleiner_1V" 4093 "CM_BMC_CMC_Zellspannung_068_Cxffd_nicht_vorhanden" 4094 "CM_BMC_CMC_Zellspannung_068_Cxffe_Init" 4095 "CM_BMC_CMC_Zellspannung_068_Cxfff_Fehler" /end COMPU_VTAB
/begin COMPU_TAB CM_BMC_CMC_Zellspannung_069 "" TAB_INTP 2 0 1000 4091 5091 /end COMPU_TAB
/begin COMPU_VTAB CM_BMC_CMC_Zellspannung_069.StatusText "" TAB_VERB 4 4092 "CM_BMC_CMC_Zellspannung_069_Cxffc_kleiner_1V" 4093 "CM_BMC_CMC_Zellspannung_069_Cxffd_nicht_vorhanden" 4094 "CM_BMC_CMC_Zellspannung_069_Cxffe_Init" 4095 "CM_BMC_CMC_Zellspannung_069_Cxfff_Fehler" /end COMPU_VTAB
/begin COMPU_TAB CM_BMC_CMC_Zellspannung_070 "" TAB_INTP 2 0 1000 4091 5091 /end COMPU_TAB
/begin COMPU_VTAB CM_BMC_CMC_Zellspannung_070.StatusText "" TAB_VERB 4 4092 "CM_BMC_CMC_Zellspannung_070_Cxffc_kleiner_1V" 4093 "CM_BMC_CMC_Zellspannung_070_Cxffd_nicht_vorhanden" 4094 "CM_BMC_CMC_Zellspannung_070_Cxffe_Init" 4095 "CM_BMC_CMC_Zellspannung_070_Cxfff_Fehler" /end COMPU_VTAB
/begin COMPU_TAB CM_BMC_CMC_Zellspannung_071 "" TAB_INTP 2 0 1000 4091 5091 /end COMPU_TAB
/begin COMPU_VTAB CM_BMC_CMC_Zellspannung_071.StatusText "" TAB_VERB 4 4092 "CM_BMC_CMC_Zellspannung_071_Cxffc_kleiner_1V" 4093 "CM_BMC_CMC_Zellspannung_071_Cxffd_nicht_vorhanden" 4094 "CM_BMC_CMC_Zellspannung_071_Cxffe_Init" 4095 "CM_BMC_CMC_Zellspannung_071_Cxfff_Fehler" /end COMPU_VTAB
/begin COMPU_TAB CM_BMC_CMC_Zellspannung_072 "" TAB_INTP 2 0 1000 4091 5091 /end COMPU_TAB
/begin COMPU_VTAB CM_BMC_CMC_Zellspannung_072.StatusText "" TAB_VERB 4 4092 "CM_BMC_CMC_Zellspannung_072_Cxffc_kleiner_1V" 4093 "CM_BMC_CMC_Zellspannung_072_Cxffd_nicht_vorhanden" 4094 "CM_BMC_CMC_Zellspannung_072_Cxffe_Init" 4095 "CM_BMC_CMC_Zellspannung_072_Cxfff_Fehler" /end COMPU_VTAB
/begin COMPU_TAB CM_BMC_CMC_Zellspannung_073 "" TAB_INTP 2 0 1000 4091 5091 /end COMPU_TAB
/begin COMPU_VTAB CM_BMC_CMC_Zellspannung_073.StatusText "" TAB_VERB 4 4092 "CM_BMC_CMC_Zellspannung_073_Cxffc_kleiner_1V" 4093 "CM_BMC_CMC_Zellspannung_073_Cxffd_nicht_vorhanden" 4094 "CM_BMC_CMC_Zellspannung_073_Cxffe_Init" 4095 "CM_BMC_CMC_Zellspannung_073_Cxfff_Fehler" /end COMPU_VTAB
/begin COMPU_TAB CM_BMC_CMC_Zellspannung_074 "" TAB_INTP 2 0 1000 4091 5091 /end COMPU_TAB
/begin COMPU_VTAB CM_BMC_CMC_Zellspannung_074.StatusText "" TAB_VERB 4 4092 "CM_BMC_CMC_Zellspannung_074_Cxffc_kleiner_1V" 4093 "CM_BMC_CMC_Zellspannung_074_Cxffd_nicht_vorhanden" 4094 "CM_BMC_CMC_Zellspannung_074_Cxffe_Init" 4095 "CM_BMC_CMC_Zellspannung_074_Cxfff_Fehler" /end COMPU_VTAB
/begin COMPU_TAB CM_BMC_CMC_Zellspannung_075 "" TAB_INTP 2 0 1000 4091 5091 /end COMPU_TAB
/begin COMPU_VTAB CM_BMC_CMC_Zellspannung_075.StatusText "" TAB_VERB 4 4092 "CM_BMC_CMC_Zellspannung_075_Cxffc_kleiner_1V" 4093 "CM_BMC_CMC_Zellspannung_075_Cxffd_nicht_vorhanden" 4094 "CM_BMC_CMC_Zellspannung_075_Cxffe_Init" 4095 "CM_BMC_CMC_Zellspannung_075_Cxfff_Fehler" /end COMPU_VTAB
/begin COMPU_TAB CM_BMC_CMC_Zellspannung_076 "" TAB_INTP 2 0 1000 4091 5091 /end COMPU_TAB
/begin COMPU_VTAB CM_BMC_CMC_Zellspannung_076.StatusText "" TAB_VERB 4 4092 "CM_BMC_CMC_Zellspannung_076_Cxffc_kleiner_1V" 4093 "CM_BMC_CMC_Zellspannung_076_Cxffd_nicht_vorhanden" 4094 "CM_BMC_CMC_Zellspannung_076_Cxffe_Init" 4095 "CM_BMC_CMC_Zellspannung_076_Cxfff_Fehler" /end COMPU_VTAB
/begin COMPU_TAB CM_BMC_CMC_Zellspannung_077 "" TAB_INTP 2 0 1000 4091 5091 /end COMPU_TAB
/begin COMPU_VTAB CM_BMC_CMC_Zellspannung_077.StatusText "" TAB_VERB 4 4092 "CM_BMC_CMC_Zellspannung_077_Cxffc_kleiner_1V" 4093 "CM_BMC_CMC_Zellspannung_077_Cxffd_nicht_vorhanden" 4094 "CM_BMC_CMC_Zellspannung_077_Cxffe_Init" 4095 "CM_BMC_CMC_Zellspannung_077_Cxfff_Fehler" /end COMPU_VTAB
/begin COMPU_TAB CM_BMC_CMC_Zellspannung_078 "" TAB_INTP 2 0 1000 4091 5091 /end COMPU_TAB
/begin COMPU_VTAB CM_BMC_CMC_Zellspannung_078.StatusText "" TAB_VERB 4 4092 "CM_BMC_CMC_Zellspannung_078_Cxffc_kleiner_1V" 4093 "CM_BMC_CMC_Zellspannung_078_Cxffd_nicht_vorhanden" 4094 "CM_BMC_CMC_Zellspannung_078_Cxffe_Init" 4095 "CM_BMC_CMC_Zellspannung_078_Cxfff_Fehler" /end COMPU_VTAB
/begin COMPU_TAB CM_BMC_CMC_Zellspannung_079 "" TAB_INTP 2 0 1000 4091 5091 /end COMPU_TAB
/begin COMPU_VTAB CM_BMC_CMC_Zellspannung_079.StatusText "" TAB_VERB 4 4092 "CM_BMC_CMC_Zellspannung_079_Cxffc_kleiner_1V" 4093 "CM_BMC_CMC_Zellspannung_079_Cxffd_nicht_vorhanden" 4094 "CM_BMC_CMC_Zellspannung_079_Cxffe_Init" 4095 "CM_BMC_CMC_Zellspannung_079_Cxfff_Fehler" /end COMPU_VTAB
/begin COMPU_TAB CM_BMC_CMC_Zellspannung_080 "" TAB_INTP 2 0 1000 4091 5091 /end COMPU_TAB
/begin COMPU_VTAB CM_BMC_CMC_Zellspannung_080.StatusText "" TAB_VERB 4 4092 "CM_BMC_CMC_Zellspannung_080_Cxffc_kleiner_1V" 4093 "CM_BMC_CMC_Zellspannung_080_Cxffd_nicht_vorhanden" 4094 "CM_BMC_CMC_Zellspannung_080_Cxffe_Init" 4095 "CM_BMC_CMC_Zellspannung_080_Cxfff_Fehler" /end COMPU_VTAB
/begin COMPU_TAB CM_BMC_CMC_Zellspannung_081 "" TAB_INTP 2 0 1000 4091 5091 /end COMPU_TAB
/begin COMPU_VTAB CM_BMC_CMC_Zellspannung_081.StatusText "" TAB_VERB 4 4092 "CM_BMC_CMC_Zellspannung_081_Cxffc_kleiner_1V" 4093 "CM_BMC_CMC_Zellspannung_081_Cxffd_nicht_vorhanden" 4094 "CM_BMC_CMC_Zellspannung_081_Cxffe_Init" 4095 "CM_BMC_CMC_Zellspannung_081_Cxfff_Fehler" /end COMPU_VTAB
/begin COMPU_TAB CM_BMC_CMC_Zellspannung_082 "" TAB_INTP 2 0 1000 4091 5091 /end COMPU_TAB
/begin COMPU_VTAB CM_BMC_CMC_Zellspannung_082.StatusText "" TAB_VERB 4 4092 "CM_BMC_CMC_Zellspannung_082_Cxffc_kleiner_1V" 4093 "CM_BMC_CMC_Zellspannung_082_Cxffd_nicht_vorhanden" 4094 "CM_BMC_CMC_Zellspannung_082_Cxffe_Init" 4095 "CM_BMC_CMC_Zellspannung_082_Cxfff_Fehler" /end COMPU_VTAB
/begin COMPU_TAB CM_BMC_CMC_Zellspannung_083 "" TAB_INTP 2 0 1000 4091 5091 /end COMPU_TAB
/begin COMPU_VTAB CM_BMC_CMC_Zellspannung_083.StatusText "" TAB_VERB 4 4092 "CM_BMC_CMC_Zellspannung_083_Cxffc_kleiner_1V" 4093 "CM_BMC_CMC_Zellspannung_083_Cxffd_nicht_vorhanden" 4094 "CM_BMC_CMC_Zellspannung_083_Cxffe_Init" 4095 "CM_BMC_CMC_Zellspannung_083_Cxfff_Fehler" /end COMPU_VTAB
/begin COMPU_TAB CM_BMC_CMC_Zellspannung_084 "" TAB_INTP 2 0 1000 4091 5091 /end COMPU_TAB
/begin COMPU_VTAB CM_BMC_CMC_Zellspannung_084.StatusText "" TAB_VERB 4 4092 "CM_BMC_CMC_Zellspannung_084_Cxffc_kleiner_1V" 4093 "CM_BMC_CMC_Zellspannung_084_Cxffd_nicht_vorhanden" 4094 "CM_BMC_CMC_Zellspannung_084_Cxffe_Init" 4095 "CM_BMC_CMC_Zellspannung_084_Cxfff_Fehler" /end COMPU_VTAB
/begin COMPU_TAB CM_BMC_CMC_Zellspannung_085 "" TAB_INTP 2 0 1000 4091 5091 /end COMPU_TAB
/begin COMPU_VTAB CM_BMC_CMC_Zellspannung_085.StatusText "" TAB_VERB 4 4092 "CM_BMC_CMC_Zellspannung_085_Cxffc_kleiner_1V" 4093 "CM_BMC_CMC_Zellspannung_085_Cxffd_nicht_vorhanden" 4094 "CM_BMC_CMC_Zellspannung_085_Cxffe_Init" 4095 "CM_BMC_CMC_Zellspannung_085_Cxfff_Fehler" /end COMPU_VTAB
/begin COMPU_TAB CM_BMC_CMC_Zellspannung_086 "" TAB_INTP 2 0 1000 4091 5091 /end COMPU_TAB
/begin COMPU_VTAB CM_BMC_CMC_Zellspannung_086.StatusText "" TAB_VERB 4 4092 "CM_BMC_CMC_Zellspannung_086_Cxffc_kleiner_1V" 4093 "CM_BMC_CMC_Zellspannung_086_Cxffd_nicht_vorhanden" 4094 "CM_BMC_CMC_Zellspannung_086_Cxffe_Init" 4095 "CM_BMC_CMC_Zellspannung_086_Cxfff_Fehler" /end COMPU_VTAB
/begin COMPU_TAB CM_BMC_CMC_Zellspannung_087 "" TAB_INTP 2 0 1000 4091 5091 /end COMPU_TAB
/begin COMPU_VTAB CM_BMC_CMC_Zellspannung_087.StatusText "" TAB_VERB 4 4092 "CM_BMC_CMC_Zellspannung_087_Cxffc_kleiner_1V" 4093 "CM_BMC_CMC_Zellspannung_087_Cxffd_nicht_vorhanden" 4094 "CM_BMC_CMC_Zellspannung_087_Cxffe_Init" 4095 "CM_BMC_CMC_Zellspannung_087_Cxfff_Fehler" /end COMPU_VTAB
/begin COMPU_TAB CM_BMC_CMC_Zellspannung_088 "" TAB_INTP 2 0 1000 4091 5091 /end COMPU_TAB
/begin COMPU_VTAB CM_BMC_CMC_Zellspannung_088.StatusText "" TAB_VERB 4 4092 "CM_BMC_CMC_Zellspannung_088_Cxffc_kleiner_1V" 4093 "CM_BMC_CMC_Zellspannung_088_Cxffd_nicht_vorhanden" 4094 "CM_BMC_CMC_Zellspannung_088_Cxffe_Init" 4095 "CM_BMC_CMC_Zellspannung_088_Cxfff_Fehler" /end COMPU_VTAB
/begin COMPU_TAB CM_BMC_CMC_Zellspannung_089 "" TAB_INTP 2 0 1000 4091 5091 /end COMPU_TAB
/begin COMPU_VTAB CM_BMC_CMC_Zellspannung_089.StatusText "" TAB_VERB 4 4092 "CM_BMC_CMC_Zellspannung_089_Cxffc_kleiner_1V" 4093 "CM_BMC_CMC_Zellspannung_089_Cxffd_nicht_vorhanden" 4094 "CM_BMC_CMC_Zellspannung_089_Cxffe_Init" 4095 "CM_BMC_CMC_Zellspannung_089_Cxfff_Fehler" /end COMPU_VTAB
/begin COMPU_TAB CM_BMC_CMC_Zellspannung_090 "" TAB_INTP 2 0 1000 4091 5091 /end COMPU_TAB
/begin COMPU_VTAB CM_BMC_CMC_Zellspannung_090.StatusText "" TAB_VERB 4 4092 "CM_BMC_CMC_Zellspannung_090_Cxffc_kleiner_1V" 4093 "CM_BMC_CMC_Zellspannung_090_Cxffd_nicht_vorhanden" 4094 "CM_BMC_CMC_Zellspannung_090_Cxffe_Init" 4095 "CM_BMC_CMC_Zellspannung_090_Cxfff_Fehler" /end COMPU_VTAB
/begin COMPU_TAB CM_BMC_CMC_Zellspannung_091 "" TAB_INTP 2 0 1000 4091 5091 /end COMPU_TAB
/begin COMPU_VTAB CM_BMC_CMC_Zellspannung_091.StatusText "" TAB_VERB 4 4092 "CM_BMC_CMC_Zellspannung_091_Cxffc_kleiner_1V" 4093 "CM_BMC_CMC_Zellspannung_091_Cxffd_nicht_vorhanden" 4094 "CM_BMC_CMC_Zellspannung_091_Cxffe_Init" 4095 "CM_BMC_CMC_Zellspannung_091_Cxfff_Fehler" /end COMPU_VTAB
/begin COMPU_TAB CM_BMC_CMC_Zellspannung_092 "" TAB_INTP 2 0 1000 4091 5091 /end COMPU_TAB
/begin COMPU_VTAB CM_BMC_CMC_Zellspannung_092.StatusText "" TAB_VERB 4 4092 "CM_BMC_CMC_Zellspannung_092_Cxffc_kleiner_1V" 4093 "CM_BMC_CMC_Zellspannung_092_Cxffd_nicht_vorhanden" 4094 "CM_BMC_CMC_Zellspannung_092_Cxffe_Init" 4095 "CM_BMC_CMC_Zellspannung_092_Cxfff_Fehler" /end COMPU_VTAB
/begin COMPU_TAB CM_BMC_CMC_Zellspannung_093 "" TAB_INTP 2 0 1000 4091 5091 /end COMPU_TAB
/begin COMPU_VTAB CM_BMC_CMC_Zellspannung_093.StatusText "" TAB_VERB 4 4092 "CM_BMC_CMC_Zellspannung_093_Cxffc_kleiner_1V" 4093 "CM_BMC_CMC_Zellspannung_093_Cxffd_nicht_vorhanden" 4094 "CM_BMC_CMC_Zellspannung_093_Cxffe_Init" 4095 "CM_BMC_CMC_Zellspannung_093_Cxfff_Fehler" /end COMPU_VTAB
/begin COMPU_TAB CM_BMC_CMC_Zellspannung_094 "" TAB_INTP 2 0 1000 4091 5091 /end COMPU_TAB
/begin COMPU_VTAB CM_BMC_CMC_Zellspannung_094.StatusText "" TAB_VERB 4 4092 "CM_BMC_CMC_Zellspannung_094_Cxffc_kleiner_1V" 4093 "CM_BMC_CMC_Zellspannung_094_Cxffd_nicht_vorhanden" 4094 "CM_BMC_CMC_Zellspannung_094_Cxffe_Init" 4095 "CM_BMC_CMC_Zellspannung_094_Cxfff_Fehler" /end COMPU_VTAB
/begin COMPU_TAB CM_BMC_CMC_Zellspannung_095 "" TAB_INTP 2 0 1000 4091 5091 /end COMPU_TAB
/begin COMPU_VTAB CM_BMC_CMC_Zellspannung_095.StatusText "" TAB_VERB 4 4092 "CM_BMC_CMC_Zellspannung_095_Cxffc_kleiner_1V" 4093 "CM_BMC_CMC_Zellspannung_095_Cxffd_nicht_vorhanden" 4094 "CM_BMC_CMC_Zellspannung_095_Cxffe_Init" 4095 "CM_BMC_CMC_Zellspannung_095_Cxfff_Fehler" /end COMPU_VTAB
/begin COMPU_TAB CM_BMC_CMC_Zellspannung_096 "" TAB_INTP 2 0 1000 4091 5091 /end COMPU_TAB
/begin COMPU_VTAB CM_BMC_CMC_Zellspannung_096.StatusText "" TAB_VERB 4 4092 "CM_BMC_CMC_Zellspannung_096_Cxffc_kleiner_1V" 4093 "CM_BMC_CMC_Zellspannung_096_Cxffd_nicht_vorhanden" 4094 "CM_BMC_CMC_Zellspannung_096_Cxffe_Init" 4095 "CM_BMC_CMC_Zellspannung_096_Cxfff_Fehler" /end COMPU_VTAB
/begin COMPU_TAB CM_BMC_CMC_Zellspannung_097 "" TAB_INTP 2 0 1000 4091 5091 /end COMPU_TAB
/begin COMPU_VTAB CM_BMC_CMC_Zellspannung_097.StatusText "" TAB_VERB 4 4092 "CM_BMC_CMC_Zellspannung_097_Cxffc_kleiner_1V" 4093 "CM_BMC_CMC_Zellspannung_097_Cxffd_nicht_vorhanden" 4094 "CM_BMC_CMC_Zellspannung_097_Cxffe_Init" 4095 "CM_BMC_CMC_Zellspannung_097_Cxfff_Fehler" /end COMPU_VTAB
/begin COMPU_TAB CM_BMC_CMC_Zellspannung_098 "" TAB_INTP 2 0 1000 4091 5091 /end COMPU_TAB
/begin COMPU_VTAB CM_BMC_CMC_Zellspannung_098.StatusText "" TAB_VERB 4 4092 "CM_BMC_CMC_Zellspannung_098_Cxffc_kleiner_1V" 4093 "CM_BMC_CMC_Zellspannung_098_Cxffd_nicht_vorhanden" 4094 "CM_BMC_CMC_Zellspannung_098_Cxffe_Init" 4095 "CM_BMC_CMC_Zellspannung_098_Cxfff_Fehler" /end COMPU_VTAB
/begin COMPU_TAB CM_BMC_CMC_Zellspannung_099 "" TAB_INTP 2 0 1000 4091 5091 /end COMPU_TAB
/begin COMPU_VTAB CM_BMC_CMC_Zellspannung_099.StatusText "" TAB_VERB 4 4092 "CM_BMC_CMC_Zellspannung_099_Cxffc_kleiner_1V" 4093 "CM_BMC_CMC_Zellspannung_099_Cxffd_nicht_vorhanden" 4094 "CM_BMC_CMC_Zellspannung_099_Cxffe_Init" 4095 "CM_BMC_CMC_Zellspannung_099_Cxfff_Fehler" /end COMPU_VTAB
/begin COMPU_TAB CM_BMC_CMC_Zellspannung_100 "" TAB_INTP 2 0 1000 4091 5091 /end COMPU_TAB
/begin COMPU_VTAB CM_BMC_CMC_Zellspannung_100.StatusText "" TAB_VERB 4 4092 "CM_BMC_CMC_Zellspannung_100_Cxffc_kleiner_1V" 4093 "CM_BMC_CMC_Zellspannung_100_Cxffd_nicht_vorhanden" 4094 "CM_BMC_CMC_Zellspannung_100_Cxffe_Init" 4095 "CM_BMC_CMC_Zellspannung_100_Cxfff_Fehler" /end COMPU_VTAB
/begin COMPU_TAB CM_BMC_CMC_Zellspannung_101 "" TAB_INTP 2 0 1000 4091 5091 /end COMPU_TAB
/begin COMPU_VTAB CM_BMC_CMC_Zellspannung_101.StatusText "" TAB_VERB 4 4092 "CM_BMC_CMC_Zellspannung_101_Cxffc_kleiner_1V" 4093 "CM_BMC_CMC_Zellspannung_101_Cxffd_nicht_vorhanden" 4094 "CM_BMC_CMC_Zellspannung_101_Cxffe_Init" 4095 "CM_BMC_CMC_Zellspannung_101_Cxfff_Fehler" /end COMPU_VTAB
/begin COMPU_TAB CM_BMC_CMC_Zellspannung_102 "" TAB_INTP 2 0 1000 4091 5091 /end COMPU_TAB
/begin COMPU_VTAB CM_BMC_CMC_Zellspannung_102.StatusText "" TAB_VERB 4 4092 "CM_BMC_CMC_Zellspannung_102_Cxffc_kleiner_1V" 4093 "CM_BMC_CMC_Zellspannung_102_Cxffd_nicht_vorhanden" 4094 "CM_BMC_CMC_Zellspannung_102_Cxffe_Init" 4095 "CM_BMC_CMC_Zellspannung_102_Cxfff_Fehler" /end COMPU_VTAB
/begin COMPU_TAB CM_BMC_CMC_Zellspannung_103 "" TAB_INTP 2 0 1000 4091 5091 /end COMPU_TAB
/begin COMPU_VTAB CM_BMC_CMC_Zellspannung_103.StatusText "" TAB_VERB 4 4092 "CM_BMC_CMC_Zellspannung_103_Cxffc_kleiner_1V" 4093 "CM_BMC_CMC_Zellspannung_103_Cxffd_nicht_vorhanden" 4094 "CM_BMC_CMC_Zellspannung_103_Cxffe_Init" 4095 "CM_BMC_CMC_Zellspannung_103_Cxfff_Fehler" /end COMPU_VTAB
/begin COMPU_TAB CM_BMC_CMC_Zellspannung_104 "" TAB_INTP 2 0 1000 4091 5091 /end COMPU_TAB
/begin COMPU_VTAB CM_BMC_CMC_Zellspannung_104.StatusText "" TAB_VERB 4 4092 "CM_BMC_CMC_Zellspannung_104_Cxffc_kleiner_1V" 4093 "CM_BMC_CMC_Zellspannung_104_Cxffd_nicht_vorhanden" 4094 "CM_BMC_CMC_Zellspannung_104_Cxffe_Init" 4095 "CM_BMC_CMC_Zellspannung_104_Cxfff_Fehler" /end COMPU_VTAB
/begin COMPU_TAB CM_BMC_CMC_Zellspannung_105 "" TAB_INTP 2 0 1000 4091 5091 /end COMPU_TAB
/begin COMPU_VTAB CM_BMC_CMC_Zellspannung_105.StatusText "" TAB_VERB 4 4092 "CM_BMC_CMC_Zellspannung_105_Cxffc_kleiner_1V" 4093 "CM_BMC_CMC_Zellspannung_105_Cxffd_nicht_vorhanden" 4094 "CM_BMC_CMC_Zellspannung_105_Cxffe_Init" 4095 "CM_BMC_CMC_Zellspannung_105_Cxfff_Fehler" /end COMPU_VTAB
/begin COMPU_TAB CM_BMC_CMC_Zellspannung_106 "" TAB_INTP 2 0 1000 4091 5091 /end COMPU_TAB
/begin COMPU_VTAB CM_BMC_CMC_Zellspannung_106.StatusText "" TAB_VERB 4 4092 "CM_BMC_CMC_Zellspannung_106_Cxffc_kleiner_1V" 4093 "CM_BMC_CMC_Zellspannung_106_Cxffd_nicht_vorhanden" 4094 "CM_BMC_CMC_Zellspannung_106_Cxffe_Init" 4095 "CM_BMC_CMC_Zellspannung_106_Cxfff_Fehler" /end COMPU_VTAB
/begin COMPU_TAB CM_BMC_CMC_Zellspannung_107 "" TAB_INTP 2 0 1000 4091 5091 /end COMPU_TAB
/begin COMPU_VTAB CM_BMC_CMC_Zellspannung_107.StatusText "" TAB_VERB 4 4092 "CM_BMC_CMC_Zellspannung_107_Cxffc_kleiner_1V" 4093 "CM_BMC_CMC_Zellspannung_107_Cxffd_nicht_vorhanden" 4094 "CM_BMC_CMC_Zellspannung_107_Cxffe_Init" 4095 "CM_BMC_CMC_Zellspannung_107_Cxfff_Fehler" /end COMPU_VTAB
/begin COMPU_TAB CM_BMC_CMC_Zellspannung_108 "" TAB_INTP 2 0 1000 4091 5091 /end COMPU_TAB
/begin COMPU_VTAB CM_BMC_CMC_Zellspannung_108.StatusText "" TAB_VERB 4 4092 "CM_BMC_CMC_Zellspannung_108_Cxffc_kleiner_1V" 4093 "CM_BMC_CMC_Zellspannung_108_Cxffd_nicht_vorhanden" 4094 "CM_BMC_CMC_Zellspannung_108_Cxffe_Init" 4095 "CM_BMC_CMC_Zellspannung_108_Cxfff_Fehler" /end COMPU_VTAB
/begin COMPU_TAB CM_BMC_CMC_Zellspannung_109 "" TAB_INTP 2 0 1000 4091 5091 /end COMPU_TAB
/begin COMPU_VTAB CM_BMC_CMC_Zellspannung_109.StatusText "" TAB_VERB 4 4092 "CM_BMC_CMC_Zellspannung_109_Cxffc_kleiner_1V" 4093 "CM_BMC_CMC_Zellspannung_109_Cxffd_nicht_vorhanden" 4094 "CM_BMC_CMC_Zellspannung_109_Cxffe_Init" 4095 "CM_BMC_CMC_Zellspannung_109_Cxfff_Fehler" /end COMPU_VTAB
/begin COMPU_TAB CM_BMC_CMC_Zellspannung_110 "" TAB_INTP 2 0 1000 4091 5091 /end COMPU_TAB
/begin COMPU_VTAB CM_BMC_CMC_Zellspannung_110.StatusText "" TAB_VERB 4 4092 "CM_BMC_CMC_Zellspannung_110_Cxffc_kleiner_1V" 4093 "CM_BMC_CMC_Zellspannung_110_Cxffd_nicht_vorhanden" 4094 "CM_BMC_CMC_Zellspannung_110_Cxffe_Init" 4095 "CM_BMC_CMC_Zellspannung_110_Cxfff_Fehler" /end COMPU_VTAB
/begin COMPU_TAB CM_BMC_CMC_Zellspannung_111 "" TAB_INTP 2 0 1000 4091 5091 /end COMPU_TAB
/begin COMPU_VTAB CM_BMC_CMC_Zellspannung_111.StatusText "" TAB_VERB 4 4092 "CM_BMC_CMC_Zellspannung_111_Cxffc_kleiner_1V" 4093 "CM_BMC_CMC_Zellspannung_111_Cxffd_nicht_vorhanden" 4094 "CM_BMC_CMC_Zellspannung_111_Cxffe_Init" 4095 "CM_BMC_CMC_Zellspannung_111_Cxfff_Fehler" /end COMPU_VTAB
/begin COMPU_TAB CM_BMC_CMC_Zellspannung_112 "" TAB_INTP 2 0 1000 4091 5091 /end COMPU_TAB
/begin COMPU_VTAB CM_BMC_CMC_Zellspannung_112.StatusText "" TAB_VERB 4 4092 "CM_BMC_CMC_Zellspannung_112_Cxffc_kleiner_1V" 4093 "CM_BMC_CMC_Zellspannung_112_Cxffd_nicht_vorhanden" 4094 "CM_BMC_CMC_Zellspannung_112_Cxffe_Init" 4095 "CM_BMC_CMC_Zellspannung_112_Cxfff_Fehler" /end COMPU_VTAB
/begin COMPU_TAB CM_BMC_CMC_Zellspannung_113 "" TAB_INTP 2 0 1000 4091 5091 /end COMPU_TAB
/begin COMPU_VTAB CM_BMC_CMC_Zellspannung_113.StatusText "" TAB_VERB 4 4092 "CM_BMC_CMC_Zellspannung_113_Cxffc_kleiner_1V" 4093 "CM_BMC_CMC_Zellspannung_113_Cxffd_nicht_vorhanden" 4094 "CM_BMC_CMC_Zellspannung_113_Cxffe_Init" 4095 "CM_BMC_CMC_Zellspannung_113_Cxfff_Fehler" /end COMPU_VTAB
/begin COMPU_TAB CM_BMC_CMC_Zellspannung_114 "" TAB_INTP 2 0 1000 4091 5091 /end COMPU_TAB
/begin COMPU_VTAB CM_BMC_CMC_Zellspannung_114.StatusText "" TAB_VERB 4 4092 "CM_BMC_CMC_Zellspannung_114_Cxffc_kleiner_1V" 4093 "CM_BMC_CMC_Zellspannung_114_Cxffd_nicht_vorhanden" 4094 "CM_BMC_CMC_Zellspannung_114_Cxffe_Init" 4095 "CM_BMC_CMC_Zellspannung_114_Cxfff_Fehler" /end COMPU_VTAB
/begin COMPU_TAB CM_BMC_CMC_Zellspannung_115 "" TAB_INTP 2 0 1000 4091 5091 /end COMPU_TAB
/begin COMPU_VTAB CM_BMC_CMC_Zellspannung_115.StatusText "" TAB_VERB 4 4092 "CM_BMC_CMC_Zellspannung_115_Cxffc_kleiner_1V" 4093 "CM_BMC_CMC_Zellspannung_115_Cxffd_nicht_vorhanden" 4094 "CM_BMC_CMC_Zellspannung_115_Cxffe_Init" 4095 "CM_BMC_CMC_Zellspannung_115_Cxfff_Fehler" /end COMPU_VTAB
/begin COMPU_TAB CM_BMC_CMC_Zellspannung_116 "" TAB_INTP 2 0 1000 4091 5091 /end COMPU_TAB
/begin COMPU_VTAB CM_BMC_CMC_Zellspannung_116.StatusText "" TAB_VERB 4 4092 "CM_BMC_CMC_Zellspannung_116_Cxffc_kleiner_1V" 4093 "CM_BMC_CMC_Zellspannung_116_Cxffd_nicht_vorhanden" 4094 "CM_BMC_CMC_Zellspannung_116_Cxffe_Init" 4095 "CM_BMC_CMC_Zellspannung_116_Cxfff_Fehler" /end COMPU_VTAB
/begin COMPU_TAB CM_BMC_CMC_Zellspannung_117 "" TAB_INTP 2 0 1000 4091 5091 /end COMPU_TAB
/begin COMPU_VTAB CM_BMC_CMC_Zellspannung_117.StatusText "" TAB_VERB 4 4092 "CM_BMC_CMC_Zellspannung_117_Cxffc_kleiner_1V" 4093 "CM_BMC_CMC_Zellspannung_117_Cxffd_nicht_vorhanden" 4094 "CM_BMC_CMC_Zellspannung_117_Cxffe_Init" 4095 "CM_BMC_CMC_Zellspannung_117_Cxfff_Fehler" /end COMPU_VTAB
/begin COMPU_TAB CM_BMC_CMC_Zellspannung_118 "" TAB_INTP 2 0 1000 4091 5091 /end COMPU_TAB
/begin COMPU_VTAB CM_BMC_CMC_Zellspannung_118.StatusText "" TAB_VERB 4 4092 "CM_BMC_CMC_Zellspannung_118_Cxffc_kleiner_1V" 4093 "CM_BMC_CMC_Zellspannung_118_Cxffd_nicht_vorhanden" 4094 "CM_BMC_CMC_Zellspannung_118_Cxffe_Init" 4095 "CM_BMC_CMC_Zellspannung_118_Cxfff_Fehler" /end COMPU_VTAB
/begin COMPU_TAB CM_BMC_CMC_Zellspannung_119 "" TAB_INTP 2 0 1000 4091 5091 /end COMPU_TAB
/begin COMPU_VTAB CM_BMC_CMC_Zellspannung_119.StatusText "" TAB_VERB 4 4092 "CM_BMC_CMC_Zellspannung_119_Cxffc_kleiner_1V" 4093 "CM_BMC_CMC_Zellspannung_119_Cxffd_nicht_vorhanden" 4094 "CM_BMC_CMC_Zellspannung_119_Cxffe_Init" 4095 "CM_BMC_CMC_Zellspannung_119_Cxfff_Fehler" /end COMPU_VTAB
/begin COMPU_TAB CM_BMC_CMC_Zellspannung_120 "" TAB_INTP 2 0 1000 4091 5091 /end COMPU_TAB
/begin COMPU_VTAB CM_BMC_CMC_Zellspannung_120.StatusText "" TAB_VERB 4 4092 "CM_BMC_CMC_Zellspannung_120_Cxffc_kleiner_1V" 4093 "CM_BMC_CMC_Zellspannung_120_Cxffd_nicht_vorhanden" 4094 "CM_BMC_CMC_Zellspannung_120_Cxffe_Init" 4095 "CM_BMC_CMC_Zellspannung_120_Cxfff_Fehler" /end COMPU_VTAB
/begin COMPU_TAB CM_BMC_CMC_Zellspannung_121 "" TAB_INTP 2 0 1000 4091 5091 /end COMPU_TAB
/begin COMPU_VTAB CM_BMC_CMC_Zellspannung_121.StatusText "" TAB_VERB 4 4092 "CM_BMC_CMC_Zellspannung_121_Cxffc_kleiner_1V" 4093 "CM_BMC_CMC_Zellspannung_121_Cxffd_nicht_vorhanden" 4094 "CM_BMC_CMC_Zellspannung_121_Cxffe_Init" 4095 "CM_BMC_CMC_Zellspannung_121_Cxfff_Fehler" /end COMPU_VTAB
/begin COMPU_TAB CM_BMC_CMC_Zellspannung_122 "" TAB_INTP 2 0 1000 4091 5091 /end COMPU_TAB
/begin COMPU_VTAB CM_BMC_CMC_Zellspannung_122.StatusText "" TAB_VERB 4 4092 "CM_BMC_CMC_Zellspannung_122_Cxffc_kleiner_1V" 4093 "CM_BMC_CMC_Zellspannung_122_Cxffd_nicht_vorhanden" 4094 "CM_BMC_CMC_Zellspannung_122_Cxffe_Init" 4095 "CM_BMC_CMC_Zellspannung_122_Cxfff_Fehler" /end COMPU_VTAB
/begin COMPU_TAB CM_BMC_CMC_Zellspannung_123 "" TAB_INTP 2 0 1000 4091 5091 /end COMPU_TAB
/begin COMPU_VTAB CM_BMC_CMC_Zellspannung_123.StatusText "" TAB_VERB 4 4092 "CM_BMC_CMC_Zellspannung_123_Cxffc_kleiner_1V" 4093 "CM_BMC_CMC_Zellspannung_123_Cxffd_nicht_vorhanden" 4094 "CM_BMC_CMC_Zellspannung_123_Cxffe_Init" 4095 "CM_BMC_CMC_Zellspannung_123_Cxfff_Fehler" /end COMPU_VTAB
/begin COMPU_TAB CM_BMC_CMC_Zellspannung_124 "" TAB_INTP 2 0 1000 4091 5091 /end COMPU_TAB
/begin COMPU_VTAB CM_BMC_CMC_Zellspannung_124.StatusText "" TAB_VERB 4 4092 "CM_BMC_CMC_Zellspannung_124_Cxffc_kleiner_1V" 4093 "CM_BMC_CMC_Zellspannung_124_Cxffd_nicht_vorhanden" 4094 "CM_BMC_CMC_Zellspannung_124_Cxffe_Init" 4095 "CM_BMC_CMC_Zellspannung_124_Cxfff_Fehler" /end COMPU_VTAB
/begin COMPU_TAB CM_BMC_CMC_Zellspannung_125 "" TAB_INTP 2 0 1000 4091 5091 /end COMPU_TAB
/begin COMPU_VTAB CM_BMC_CMC_Zellspannung_125.StatusText "" TAB_VERB 4 4092 "CM_BMC_CMC_Zellspannung_125_Cxffc_kleiner_1V" 4093 "CM_BMC_CMC_Zellspannung_125_Cxffd_nicht_vorhanden" 4094 "CM_BMC_CMC_Zellspannung_125_Cxffe_Init" 4095 "CM_BMC_CMC_Zellspannung_125_Cxfff_Fehler" /end COMPU_VTAB
/begin COMPU_TAB CM_BMC_CMC_Zellspannung_126 "" TAB_INTP 2 0 1000 4091 5091 /end COMPU_TAB
/begin COMPU_VTAB CM_BMC_CMC_Zellspannung_126.StatusText "" TAB_VERB 4 4092 "CM_BMC_CMC_Zellspannung_126_Cxffc_kleiner_1V" 4093 "CM_BMC_CMC_Zellspannung_126_Cxffd_nicht_vorhanden" 4094 "CM_BMC_CMC_Zellspannung_126_Cxffe_Init" 4095 "CM_BMC_CMC_Zellspannung_126_Cxfff_Fehler" /end COMPU_VTAB
/begin COMPU_TAB CM_BMC_CMC_Zellspannung_127 "" TAB_INTP 2 0 1000 4091 5091 /end COMPU_TAB
/begin COMPU_VTAB CM_BMC_CMC_Zellspannung_127.StatusText "" TAB_VERB 4 4092 "CM_BMC_CMC_Zellspannung_127_Cxffc_kleiner_1V" 4093 "CM_BMC_CMC_Zellspannung_127_Cxffd_nicht_vorhanden" 4094 "CM_BMC_CMC_Zellspannung_127_Cxffe_Init" 4095 "CM_BMC_CMC_Zellspannung_127_Cxfff_Fehler" /end COMPU_VTAB
/begin COMPU_TAB CM_BMC_CMC_Zellspannung_128 "" TAB_INTP 2 0 1000 4091 5091 /end COMPU_TAB
/begin COMPU_VTAB CM_BMC_CMC_Zellspannung_128.StatusText "" TAB_VERB 4 4092 "CM_BMC_CMC_Zellspannung_128_Cxffc_kleiner_1V" 4093 "CM_BMC_CMC_Zellspannung_128_Cxffd_nicht_vorhanden" 4094 "CM_BMC_CMC_Zellspannung_128_Cxffe_Init" 4095 "CM_BMC_CMC_Zellspannung_128_Cxfff_Fehler" /end COMPU_VTAB
/begin COMPU_TAB CM_BMC_CMC_Zellspannung_129 "" TAB_INTP 2 0 1000 4091 5091 /end COMPU_TAB
/begin COMPU_VTAB CM_BMC_CMC_Zellspannung_129.StatusText "" TAB_VERB 4 4092 "CM_BMC_CMC_Zellspannung_129_Cxffc_kleiner_1V" 4093 "CM_BMC_CMC_Zellspannung_129_Cxffd_nicht_vorhanden" 4094 "CM_BMC_CMC_Zellspannung_129_Cxffe_Init" 4095 "CM_BMC_CMC_Zellspannung_129_Cxfff_Fehler" /end COMPU_VTAB
/begin COMPU_TAB CM_BMC_CMC_Zellspannung_130 "" TAB_INTP 2 0 1000 4091 5091 /end COMPU_TAB
/begin COMPU_VTAB CM_BMC_CMC_Zellspannung_130.StatusText "" TAB_VERB 4 4092 "CM_BMC_CMC_Zellspannung_130_Cxffc_kleiner_1V" 4093 "CM_BMC_CMC_Zellspannung_130_Cxffd_nicht_vorhanden" 4094 "CM_BMC_CMC_Zellspannung_130_Cxffe_Init" 4095 "CM_BMC_CMC_Zellspannung_130_Cxfff_Fehler" /end COMPU_VTAB
/begin COMPU_TAB CM_BMC_CMC_Zellspannung_131 "" TAB_INTP 2 0 1000 4091 5091 /end COMPU_TAB
/begin COMPU_VTAB CM_BMC_CMC_Zellspannung_131.StatusText "" TAB_VERB 4 4092 "CM_BMC_CMC_Zellspannung_131_Cxffc_kleiner_1V" 4093 "CM_BMC_CMC_Zellspannung_131_Cxffd_nicht_vorhanden" 4094 "CM_BMC_CMC_Zellspannung_131_Cxffe_Init" 4095 "CM_BMC_CMC_Zellspannung_131_Cxfff_Fehler" /end COMPU_VTAB
/begin COMPU_TAB CM_BMC_CMC_Zellspannung_132 "" TAB_INTP 2 0 1000 4091 5091 /end COMPU_TAB
/begin COMPU_VTAB CM_BMC_CMC_Zellspannung_132.StatusText "" TAB_VERB 4 4092 "CM_BMC_CMC_Zellspannung_132_Cxffc_kleiner_1V" 4093 "CM_BMC_CMC_Zellspannung_132_Cxffd_nicht_vorhanden" 4094 "CM_BMC_CMC_Zellspannung_132_Cxffe_Init" 4095 "CM_BMC_CMC_Zellspannung_132_Cxfff_Fehler" /end COMPU_VTAB
/begin COMPU_TAB CM_BMC_CMC_Zellspannung_133 "" TAB_INTP 2 0 1000 4091 5091 /end COMPU_TAB
/begin COMPU_VTAB CM_BMC_CMC_Zellspannung_133.StatusText "" TAB_VERB 4 4092 "CM_BMC_CMC_Zellspannung_133_Cxffc_kleiner_1V" 4093 "CM_BMC_CMC_Zellspannung_133_Cxffd_nicht_vorhanden" 4094 "CM_BMC_CMC_Zellspannung_133_Cxffe_Init" 4095 "CM_BMC_CMC_Zellspannung_133_Cxfff_Fehler" /end COMPU_VTAB
/begin COMPU_TAB CM_BMC_CMC_Zellspannung_134 "" TAB_INTP 2 0 1000 4091 5091 /end COMPU_TAB
/begin COMPU_VTAB CM_BMC_CMC_Zellspannung_134.StatusText "" TAB_VERB 4 4092 "CM_BMC_CMC_Zellspannung_134_Cxffc_kleiner_1V" 4093 "CM_BMC_CMC_Zellspannung_134_Cxffd_nicht_vorhanden" 4094 "CM_BMC_CMC_Zellspannung_134_Cxffe_Init" 4095 "CM_BMC_CMC_Zellspannung_134_Cxfff_Fehler" /end COMPU_VTAB
/begin COMPU_TAB CM_BMC_CMC_Zellspannung_135 "" TAB_INTP 2 0 1000 4091 5091 /end COMPU_TAB
/begin COMPU_VTAB CM_BMC_CMC_Zellspannung_135.StatusText "" TAB_VERB 4 4092 "CM_BMC_CMC_Zellspannung_135_Cxffc_kleiner_1V" 4093 "CM_BMC_CMC_Zellspannung_135_Cxffd_nicht_vorhanden" 4094 "CM_BMC_CMC_Zellspannung_135_Cxffe_Init" 4095 "CM_BMC_CMC_Zellspannung_135_Cxfff_Fehler" /end COMPU_VTAB
/begin COMPU_TAB CM_BMC_CMC_Zellspannung_136 "" TAB_INTP 2 0 1000 4091 5091 /end COMPU_TAB
/begin COMPU_VTAB CM_BMC_CMC_Zellspannung_136.StatusText "" TAB_VERB 4 4092 "CM_BMC_CMC_Zellspannung_136_Cxffc_kleiner_1V" 4093 "CM_BMC_CMC_Zellspannung_136_Cxffd_nicht_vorhanden" 4094 "CM_BMC_CMC_Zellspannung_136_Cxffe_Init" 4095 "CM_BMC_CMC_Zellspannung_136_Cxfff_Fehler" /end COMPU_VTAB
/begin COMPU_TAB CM_BMC_CMC_Zellspannung_137 "" TAB_INTP 2 0 1000 4091 5091 /end COMPU_TAB
/begin COMPU_VTAB CM_BMC_CMC_Zellspannung_137.StatusText "" TAB_VERB 4 4092 "CM_BMC_CMC_Zellspannung_137_Cxffc_kleiner_1V" 4093 "CM_BMC_CMC_Zellspannung_137_Cxffd_nicht_vorhanden" 4094 "CM_BMC_CMC_Zellspannung_137_Cxffe_Init" 4095 "CM_BMC_CMC_Zellspannung_137_Cxfff_Fehler" /end COMPU_VTAB
/begin COMPU_TAB CM_BMC_CMC_Zellspannung_138 "" TAB_INTP 2 0 1000 4091 5091 /end COMPU_TAB
/begin COMPU_VTAB CM_BMC_CMC_Zellspannung_138.StatusText "" TAB_VERB 4 4092 "CM_BMC_CMC_Zellspannung_138_Cxffc_kleiner_1V" 4093 "CM_BMC_CMC_Zellspannung_138_Cxffd_nicht_vorhanden" 4094 "CM_BMC_CMC_Zellspannung_138_Cxffe_Init" 4095 "CM_BMC_CMC_Zellspannung_138_Cxfff_Fehler" /end COMPU_VTAB
/begin COMPU_TAB CM_BMC_CMC_Zellspannung_139 "" TAB_INTP 2 0 1000 4091 5091 /end COMPU_TAB
/begin COMPU_VTAB CM_BMC_CMC_Zellspannung_139.StatusText "" TAB_VERB 4 4092 "CM_BMC_CMC_Zellspannung_139_Cxffc_kleiner_1V" 4093 "CM_BMC_CMC_Zellspannung_139_Cxffd_nicht_vorhanden" 4094 "CM_BMC_CMC_Zellspannung_139_Cxffe_Init" 4095 "CM_BMC_CMC_Zellspannung_139_Cxfff_Fehler" /end COMPU_VTAB
/begin COMPU_TAB CM_BMC_CMC_Zellspannung_140 "" TAB_INTP 2 0 1000 4091 5091 /end COMPU_TAB
/begin COMPU_VTAB CM_BMC_CMC_Zellspannung_140.StatusText "" TAB_VERB 4 4092 "CM_BMC_CMC_Zellspannung_140_Cxffc_kleiner_1V" 4093 "CM_BMC_CMC_Zellspannung_140_Cxffd_nicht_vorhanden" 4094 "CM_BMC_CMC_Zellspannung_140_Cxffe_Init" 4095 "CM_BMC_CMC_Zellspannung_140_Cxfff_Fehler" /end COMPU_VTAB
/begin COMPU_TAB CM_BMC_CMC_Zellspannung_141 "" TAB_INTP 2 0 1000 4091 5091 /end COMPU_TAB
/begin COMPU_VTAB CM_BMC_CMC_Zellspannung_141.StatusText "" TAB_VERB 4 4092 "CM_BMC_CMC_Zellspannung_141_Cxffc_kleiner_1V" 4093 "CM_BMC_CMC_Zellspannung_141_Cxffd_nicht_vorhanden" 4094 "CM_BMC_CMC_Zellspannung_141_Cxffe_Init" 4095 "CM_BMC_CMC_Zellspannung_141_Cxfff_Fehler" /end COMPU_VTAB
/begin COMPU_TAB CM_BMC_CMC_Zellspannung_142 "" TAB_INTP 2 0 1000 4091 5091 /end COMPU_TAB
/begin COMPU_VTAB CM_BMC_CMC_Zellspannung_142.StatusText "" TAB_VERB 4 4092 "CM_BMC_CMC_Zellspannung_142_Cxffc_kleiner_1V" 4093 "CM_BMC_CMC_Zellspannung_142_Cxffd_nicht_vorhanden" 4094 "CM_BMC_CMC_Zellspannung_142_Cxffe_Init" 4095 "CM_BMC_CMC_Zellspannung_142_Cxfff_Fehler" /end COMPU_VTAB
/begin COMPU_TAB CM_BMC_CMC_Zellspannung_143 "" TAB_INTP 2 0 1000 4091 5091 /end COMPU_TAB
/begin COMPU_VTAB CM_BMC_CMC_Zellspannung_143.StatusText "" TAB_VERB 4 4092 "CM_BMC_CMC_Zellspannung_143_Cxffc_kleiner_1V" 4093 "CM_BMC_CMC_Zellspannung_143_Cxffd_nicht_vorhanden" 4094 "CM_BMC_CMC_Zellspannung_143_Cxffe_Init" 4095 "CM_BMC_CMC_Zellspannung_143_Cxfff_Fehler" /end COMPU_VTAB
/begin COMPU_TAB CM_BMC_CMC_Zellspannung_144 "" TAB_INTP 2 0 1000 4091 5091 /end COMPU_TAB
/begin COMPU_VTAB CM_BMC_CMC_Zellspannung_144.StatusText "" TAB_VERB 4 4092 "CM_BMC_CMC_Zellspannung_144_Cxffc_kleiner_1V" 4093 "CM_BMC_CMC_Zellspannung_144_Cxffd_nicht_vorhanden" 4094 "CM_BMC_CMC_Zellspannung_144_Cxffe_Init" 4095 "CM_BMC_CMC_Zellspannung_144_Cxfff_Fehler" /end COMPU_VTAB
/begin COMPU_TAB CM_BMC_CMC_Zellspannung_145 "" TAB_INTP 2 0 1000 4091 5091 /end COMPU_TAB
/begin COMPU_VTAB CM_BMC_CMC_Zellspannung_145.StatusText "" TAB_VERB 4 4092 "CM_BMC_CMC_Zellspannung_145_Cxffc_kleiner_1V" 4093 "CM_BMC_CMC_Zellspannung_145_Cxffd_nicht_vorhanden" 4094 "CM_BMC_CMC_Zellspannung_145_Cxffe_Init" 4095 "CM_BMC_CMC_Zellspannung_145_Cxfff_Fehler" /end COMPU_VTAB
/begin COMPU_TAB CM_BMC_CMC_Zellspannung_146 "" TAB_INTP 2 0 1000 4091 5091 /end COMPU_TAB
/begin COMPU_VTAB CM_BMC_CMC_Zellspannung_146.StatusText "" TAB_VERB 4 4092 "CM_BMC_CMC_Zellspannung_146_Cxffc_kleiner_1V" 4093 "CM_BMC_CMC_Zellspannung_146_Cxffd_nicht_vorhanden" 4094 "CM_BMC_CMC_Zellspannung_146_Cxffe_Init" 4095 "CM_BMC_CMC_Zellspannung_146_Cxfff_Fehler" /end COMPU_VTAB
/begin COMPU_TAB CM_BMC_CMC_Zellspannung_147 "" TAB_INTP 2 0 1000 4091 5091 /end COMPU_TAB
/begin COMPU_VTAB CM_BMC_CMC_Zellspannung_147.StatusText "" TAB_VERB 4 4092 "CM_BMC_CMC_Zellspannung_147_Cxffc_kleiner_1V" 4093 "CM_BMC_CMC_Zellspannung_147_Cxffd_nicht_vorhanden" 4094 "CM_BMC_CMC_Zellspannung_147_Cxffe_Init" 4095 "CM_BMC_CMC_Zellspannung_147_Cxfff_Fehler" /end COMPU_VTAB
/begin COMPU_TAB CM_BMC_CMC_Zellspannung_148 "" TAB_INTP 2 0 1000 4091 5091 /end COMPU_TAB
/begin COMPU_VTAB CM_BMC_CMC_Zellspannung_148.StatusText "" TAB_VERB 4 4092 "CM_BMC_CMC_Zellspannung_148_Cxffc_kleiner_1V" 4093 "CM_BMC_CMC_Zellspannung_148_Cxffd_nicht_vorhanden" 4094 "CM_BMC_CMC_Zellspannung_148_Cxffe_Init" 4095 "CM_BMC_CMC_Zellspannung_148_Cxfff_Fehler" /end COMPU_VTAB
/begin COMPU_TAB CM_BMC_CMC_Zellspannung_149 "" TAB_INTP 2 0 1000 4091 5091 /end COMPU_TAB
/begin COMPU_VTAB CM_BMC_CMC_Zellspannung_149.StatusText "" TAB_VERB 4 4092 "CM_BMC_CMC_Zellspannung_149_Cxffc_kleiner_1V" 4093 "CM_BMC_CMC_Zellspannung_149_Cxffd_nicht_vorhanden" 4094 "CM_BMC_CMC_Zellspannung_149_Cxffe_Init" 4095 "CM_BMC_CMC_Zellspannung_149_Cxfff_Fehler" /end COMPU_VTAB
/begin COMPU_TAB CM_BMC_CMC_Zellspannung_150 "" TAB_INTP 2 0 1000 4091 5091 /end COMPU_TAB
/begin COMPU_VTAB CM_BMC_CMC_Zellspannung_150.StatusText "" TAB_VERB 4 4092 "CM_BMC_CMC_Zellspannung_150_Cxffc_kleiner_1V" 4093 "CM_BMC_CMC_Zellspannung_150_Cxffd_nicht_vorhanden" 4094 "CM_BMC_CMC_Zellspannung_150_Cxffe_Init" 4095 "CM_BMC_CMC_Zellspannung_150_Cxfff_Fehler" /end COMPU_VTAB
/begin COMPU_TAB CM_BMC_CMC_Zellspannung_151 "" TAB_INTP 2 0 1000 4091 5091 /end COMPU_TAB
/begin COMPU_VTAB CM_BMC_CMC_Zellspannung_151.StatusText "" TAB_VERB 4 4092 "CM_BMC_CMC_Zellspannung_151_Cxffc_kleiner_1V" 4093 "CM_BMC_CMC_Zellspannung_151_Cxffd_nicht_vorhanden" 4094 "CM_BMC_CMC_Zellspannung_151_Cxffe_Init" 4095 "CM_BMC_CMC_Zellspannung_151_Cxfff_Fehler" /end COMPU_VTAB
/begin COMPU_TAB CM_BMC_CMC_Zellspannung_152 "" TAB_INTP 2 0 1000 4091 5091 /end COMPU_TAB
/begin COMPU_VTAB CM_BMC_CMC_Zellspannung_152.StatusText "" TAB_VERB 4 4092 "CM_BMC_CMC_Zellspannung_152_Cxffc_kleiner_1V" 4093 "CM_BMC_CMC_Zellspannung_152_Cxffd_nicht_vorhanden" 4094 "CM_BMC_CMC_Zellspannung_152_Cxffe_Init" 4095 "CM_BMC_CMC_Zellspannung_152_Cxfff_Fehler" /end COMPU_VTAB
/begin COMPU_TAB CM_BMC_CMC_Zellspannung_153 "" TAB_INTP 2 0 1000 4091 5091 /end COMPU_TAB
/begin COMPU_VTAB CM_BMC_CMC_Zellspannung_153.StatusText "" TAB_VERB 4 4092 "CM_BMC_CMC_Zellspannung_153_Cxffc_kleiner_1V" 4093 "CM_BMC_CMC_Zellspannung_153_Cxffd_nicht_vorhanden" 4094 "CM_BMC_CMC_Zellspannung_153_Cxffe_Init" 4095 "CM_BMC_CMC_Zellspannung_153_Cxfff_Fehler" /end COMPU_VTAB
/begin COMPU_TAB CM_BMC_CMC_Zellspannung_154 "" TAB_INTP 2 0 1000 4091 5091 /end COMPU_TAB
/begin COMPU_VTAB CM_BMC_CMC_Zellspannung_154.StatusText "" TAB_VERB 4 4092 "CM_BMC_CMC_Zellspannung_154_Cxffc_kleiner_1V" 4093 "CM_BMC_CMC_Zellspannung_154_Cxffd_nicht_vorhanden" 4094 "CM_BMC_CMC_Zellspannung_154_Cxffe_Init" 4095 "CM_BMC_CMC_Zellspannung_154_Cxfff_Fehler" /end COMPU_VTAB
/begin COMPU_TAB CM_BMC_CMC_Zellspannung_155 "" TAB_INTP 2 0 1000 4091 5091 /end COMPU_TAB
/begin COMPU_VTAB CM_BMC_CMC_Zellspannung_155.StatusText "" TAB_VERB 4 4092 "CM_BMC_CMC_Zellspannung_155_Cxffc_kleiner_1V" 4093 "CM_BMC_CMC_Zellspannung_155_Cxffd_nicht_vorhanden" 4094 "CM_BMC_CMC_Zellspannung_155_Cxffe_Init" 4095 "CM_BMC_CMC_Zellspannung_155_Cxfff_Fehler" /end COMPU_VTAB
/begin COMPU_TAB CM_BMC_CMC_Zellspannung_156 "" TAB_INTP 2 0 1000 4091 5091 /end COMPU_TAB
/begin COMPU_VTAB CM_BMC_CMC_Zellspannung_156.StatusText "" TAB_VERB 4 4092 "CM_BMC_CMC_Zellspannung_156_Cxffc_kleiner_1V" 4093 "CM_BMC_CMC_Zellspannung_156_Cxffd_nicht_vorhanden" 4094 "CM_BMC_CMC_Zellspannung_156_Cxffe_Init" 4095 "CM_BMC_CMC_Zellspannung_156_Cxfff_Fehler" /end COMPU_VTAB
/begin COMPU_TAB CM_BMC_CMC_Zellspannung_157 "" TAB_INTP 2 0 1000 4091 5091 /end COMPU_TAB
/begin COMPU_VTAB CM_BMC_CMC_Zellspannung_157.StatusText "" TAB_VERB 4 4092 "CM_BMC_CMC_Zellspannung_157_Cxffc_kleiner_1V" 4093 "CM_BMC_CMC_Zellspannung_157_Cxffd_nicht_vorhanden" 4094 "CM_BMC_CMC_Zellspannung_157_Cxffe_Init" 4095 "CM_BMC_CMC_Zellspannung_157_Cxfff_Fehler" /end COMPU_VTAB
/begin COMPU_TAB CM_BMC_CMC_Zellspannung_158 "" TAB_INTP 2 0 1000 4091 5091 /end COMPU_TAB
/begin COMPU_VTAB CM_BMC_CMC_Zellspannung_158.StatusText "" TAB_VERB 4 4092 "CM_BMC_CMC_Zellspannung_158_Cxffc_kleiner_1V" 4093 "CM_BMC_CMC_Zellspannung_158_Cxffd_nicht_vorhanden" 4094 "CM_BMC_CMC_Zellspannung_158_Cxffe_Init" 4095 "CM_BMC_CMC_Zellspannung_158_Cxfff_Fehler" /end COMPU_VTAB
/begin COMPU_TAB CM_BMC_CMC_Zellspannung_159 "" TAB_INTP 2 0 1000 4091 5091 /end COMPU_TAB
/begin COMPU_VTAB CM_BMC_CMC_Zellspannung_159.StatusText "" TAB_VERB 4 4092 "CM_BMC_CMC_Zellspannung_159_Cxffc_kleiner_1V" 4093 "CM_BMC_CMC_Zellspannung_159_Cxffd_nicht_vorhanden" 4094 "CM_BMC_CMC_Zellspannung_159_Cxffe_Init" 4095 "CM_BMC_CMC_Zellspannung_159_Cxfff_Fehler" /end COMPU_VTAB
/begin COMPU_TAB CM_BMC_CMC_Zellspannung_160 "" TAB_INTP 2 0 1000 4091 5091 /end COMPU_TAB
/begin COMPU_VTAB CM_BMC_CMC_Zellspannung_160.StatusText "" TAB_VERB 4 4092 "CM_BMC_CMC_Zellspannung_160_Cxffc_kleiner_1V" 4093 "CM_BMC_CMC_Zellspannung_160_Cxffd_nicht_vorhanden" 4094 "CM_BMC_CMC_Zellspannung_160_Cxffe_Init" 4095 "CM_BMC_CMC_Zellspannung_160_Cxfff_Fehler" /end COMPU_VTAB
/begin COMPU_TAB CM_BMC_CMC_Zellspannung_161 "" TAB_INTP 2 0 1000 4091 5091 /end COMPU_TAB
/begin COMPU_VTAB CM_BMC_CMC_Zellspannung_161.StatusText "" TAB_VERB 4 4092 "CM_BMC_CMC_Zellspannung_161_Cxffc_kleiner_1V" 4093 "CM_BMC_CMC_Zellspannung_161_Cxffd_nicht_vorhanden" 4094 "CM_BMC_CMC_Zellspannung_161_Cxffe_Init" 4095 "CM_BMC_CMC_Zellspannung_161_Cxfff_Fehler" /end COMPU_VTAB
/begin COMPU_TAB CM_BMC_CMC_Zellspannung_162 "" TAB_INTP 2 0 1000 4091 5091 /end COMPU_TAB
/begin COMPU_VTAB CM_BMC_CMC_Zellspannung_162.StatusText "" TAB_VERB 4 4092 "CM_BMC_CMC_Zellspannung_162_Cxffc_kleiner_1V" 4093 "CM_BMC_CMC_Zellspannung_162_Cxffd_nicht_vorhanden" 4094 "CM_BMC_CMC_Zellspannung_162_Cxffe_Init" 4095 "CM_BMC_CMC_Zellspannung_162_Cxfff_Fehler" /end COMPU_VTAB
/begin COMPU_TAB CM_BMC_CMC_Zellspannung_163 "" TAB_INTP 2 0 1000 4091 5091 /end COMPU_TAB
/begin COMPU_VTAB CM_BMC_CMC_Zellspannung_163.StatusText "" TAB_VERB 4 4092 "CM_BMC_CMC_Zellspannung_163_Cxffc_kleiner_1V" 4093 "CM_BMC_CMC_Zellspannung_163_Cxffd_nicht_vorhanden" 4094 "CM_BMC_CMC_Zellspannung_163_Cxffe_Init" 4095 "CM_BMC_CMC_Zellspannung_163_Cxfff_Fehler" /end COMPU_VTAB
/begin COMPU_TAB CM_BMC_CMC_Zellspannung_164 "" TAB_INTP 2 0 1000 4091 5091 /end COMPU_TAB
/begin COMPU_VTAB CM_BMC_CMC_Zellspannung_164.StatusText "" TAB_VERB 4 4092 "CM_BMC_CMC_Zellspannung_164_Cxffc_kleiner_1V" 4093 "CM_BMC_CMC_Zellspannung_164_Cxffd_nicht_vorhanden" 4094 "CM_BMC_CMC_Zellspannung_164_Cxffe_Init" 4095 "CM_BMC_CMC_Zellspannung_164_Cxfff_Fehler" /end COMPU_VTAB
/begin COMPU_TAB CM_BMC_CMC_Zellspannung_165 "" TAB_INTP 2 0 1000 4091 5091 /end COMPU_TAB
/begin COMPU_VTAB CM_BMC_CMC_Zellspannung_165.StatusText "" TAB_VERB 4 4092 "CM_BMC_CMC_Zellspannung_165_Cxffc_kleiner_1V" 4093 "CM_BMC_CMC_Zellspannung_165_Cxffd_nicht_vorhanden" 4094 "CM_BMC_CMC_Zellspannung_165_Cxffe_Init" 4095 "CM_BMC_CMC_Zellspannung_165_Cxfff_Fehler" /end COMPU_VTAB
/begin COMPU_TAB CM_BMC_CMC_Zellspannung_166 "" TAB_INTP 2 0 1000 4091 5091 /end COMPU_TAB
/begin COMPU_VTAB CM_BMC_CMC_Zellspannung_166.StatusText "" TAB_VERB 4 4092 "CM_BMC_CMC_Zellspannung_166_Cxffc_kleiner_1V" 4093 "CM_BMC_CMC_Zellspannung_166_Cxffd_nicht_vorhanden" 4094 "CM_BMC_CMC_Zellspannung_166_Cxffe_Init" 4095 "CM_BMC_CMC_Zellspannung_166_Cxfff_Fehler" /end COMPU_VTAB
/begin COMPU_TAB CM_BMC_CMC_Zellspannung_167 "" TAB_INTP 2 0 1000 4091 5091 /end COMPU_TAB
/begin COMPU_VTAB CM_BMC_CMC_Zellspannung_167.StatusText "" TAB_VERB 4 4092 "CM_BMC_CMC_Zellspannung_167_Cxffc_kleiner_1V" 4093 "CM_BMC_CMC_Zellspannung_167_Cxffd_nicht_vorhanden" 4094 "CM_BMC_CMC_Zellspannung_167_Cxffe_Init" 4095 "CM_BMC_CMC_Zellspannung_167_Cxfff_Fehler" /end COMPU_VTAB
/begin COMPU_TAB CM_BMC_CMC_Zellspannung_168 "" TAB_INTP 2 0 1000 4091 5091 /end COMPU_TAB
/begin COMPU_VTAB CM_BMC_CMC_Zellspannung_168.StatusText "" TAB_VERB 4 4092 "CM_BMC_CMC_Zellspannung_168_Cxffc_kleiner_1V" 4093 "CM_BMC_CMC_Zellspannung_168_Cxffd_nicht_vorhanden" 4094 "CM_BMC_CMC_Zellspannung_168_Cxffe_Init" 4095 "CM_BMC_CMC_Zellspannung_168_Cxfff_Fehler" /end COMPU_VTAB
/begin COMPU_TAB CM_BMC_CMC_Zellspannung_169 "" TAB_INTP 2 0 1000 4091 5091 /end COMPU_TAB
/begin COMPU_VTAB CM_BMC_CMC_Zellspannung_169.StatusText "" TAB_VERB 4 4092 "CM_BMC_CMC_Zellspannung_169_Cxffc_kleiner_1V" 4093 "CM_BMC_CMC_Zellspannung_169_Cxffd_nicht_vorhanden" 4094 "CM_BMC_CMC_Zellspannung_169_Cxffe_Init" 4095 "CM_BMC_CMC_Zellspannung_169_Cxfff_Fehler" /end COMPU_VTAB
/begin COMPU_TAB CM_BMC_CMC_Zellspannung_170 "" TAB_INTP 2 0 1000 4091 5091 /end COMPU_TAB
/begin COMPU_VTAB CM_BMC_CMC_Zellspannung_170.StatusText "" TAB_VERB 4 4092 "CM_BMC_CMC_Zellspannung_170_Cxffc_kleiner_1V" 4093 "CM_BMC_CMC_Zellspannung_170_Cxffd_nicht_vorhanden" 4094 "CM_BMC_CMC_Zellspannung_170_Cxffe_Init" 4095 "CM_BMC_CMC_Zellspannung_170_Cxfff_Fehler" /end COMPU_VTAB
/begin COMPU_TAB CM_BMC_CMC_Zellspannung_171 "" TAB_INTP 2 0 1000 4091 5091 /end COMPU_TAB
/begin COMPU_VTAB CM_BMC_CMC_Zellspannung_171.StatusText "" TAB_VERB 4 4092 "CM_BMC_CMC_Zellspannung_171_Cxffc_kleiner_1V" 4093 "CM_BMC_CMC_Zellspannung_171_Cxffd_nicht_vorhanden" 4094 "CM_BMC_CMC_Zellspannung_171_Cxffe_Init" 4095 "CM_BMC_CMC_Zellspannung_171_Cxfff_Fehler" /end COMPU_VTAB
/begin COMPU_TAB CM_BMC_CMC_Zellspannung_172 "" TAB_INTP 2 0 1000 4091 5091 /end COMPU_TAB
/begin COMPU_VTAB CM_BMC_CMC_Zellspannung_172.StatusText "" TAB_VERB 4 4092 "CM_BMC_CMC_Zellspannung_172_Cxffc_kleiner_1V" 4093 "CM_BMC_CMC_Zellspannung_172_Cxffd_nicht_vorhanden" 4094 "CM_BMC_CMC_Zellspannung_172_Cxffe_Init" 4095 "CM_BMC_CMC_Zellspannung_172_Cxfff_Fehler" /end COMPU_VTAB
/begin COMPU_TAB CM_BMC_CMC_Zellspannung_173 "" TAB_INTP 2 0 1000 4091 5091 /end COMPU_TAB
/begin COMPU_VTAB CM_BMC_CMC_Zellspannung_173.StatusText "" TAB_VERB 4 4092 "CM_BMC_CMC_Zellspannung_173_Cxffc_kleiner_1V" 4093 "CM_BMC_CMC_Zellspannung_173_Cxffd_nicht_vorhanden" 4094 "CM_BMC_CMC_Zellspannung_173_Cxffe_Init" 4095 "CM_BMC_CMC_Zellspannung_173_Cxfff_Fehler" /end COMPU_VTAB
/begin COMPU_TAB CM_BMC_CMC_Zellspannung_174 "" TAB_INTP 2 0 1000 4091 5091 /end COMPU_TAB
/begin COMPU_VTAB CM_BMC_CMC_Zellspannung_174.StatusText "" TAB_VERB 4 4092 "CM_BMC_CMC_Zellspannung_174_Cxffc_kleiner_1V" 4093 "CM_BMC_CMC_Zellspannung_174_Cxffd_nicht_vorhanden" 4094 "CM_BMC_CMC_Zellspannung_174_Cxffe_Init" 4095 "CM_BMC_CMC_Zellspannung_174_Cxfff_Fehler" /end COMPU_VTAB
/begin COMPU_TAB CM_BMC_CMC_Zellspannung_175 "" TAB_INTP 2 0 1000 4091 5091 /end COMPU_TAB
/begin COMPU_VTAB CM_BMC_CMC_Zellspannung_175.StatusText "" TAB_VERB 4 4092 "CM_BMC_CMC_Zellspannung_175_Cxffc_kleiner_1V" 4093 "CM_BMC_CMC_Zellspannung_175_Cxffd_nicht_vorhanden" 4094 "CM_BMC_CMC_Zellspannung_175_Cxffe_Init" 4095 "CM_BMC_CMC_Zellspannung_175_Cxfff_Fehler" /end COMPU_VTAB
/begin COMPU_VTAB_RANGE Com_CurrentTxModeType "" 2 0 0 "FALSE" 1 255 "TRUE" /end COMPU_VTAB_RANGE
/begin COMPU_VTAB_RANGE Com_CyclicSendRequestType "" 2 0 0 "FALSE" 1 255 "TRUE" /end COMPU_VTAB_RANGE
/begin COMPU_VTAB_RANGE Com_HandleTxPduDeferredType "" 2 0 0 "FALSE" 1 255 "TRUE" /end COMPU_VTAB_RANGE
/begin COMPU_VTAB Com_IPduGroupInfoToSubIPduGroupsIndStartIdxOfIPduGroupInfoType "" TAB_VERB 1 255 "COM_NO_IPDUGROUPINFOTOSUBIPDUGROUPSINDSTARTIDXOFIPDUGROUPINFO" /end COMPU_VTAB
/begin COMPU_VTAB Com_PartitionsRxStructIdxOfIPduGroupInfoType "" TAB_VERB 1 255 "COM_NO_PARTITIONSRXSTRUCTIDXOFIPDUGROUPINFO" /end COMPU_VTAB
/begin COMPU_VTAB Com_PartitionsTxStructIdxOfIPduGroupInfoType "" TAB_VERB 1 255 "COM_NO_PARTITIONSTXSTRUCTIDXOFIPDUGROUPINFO" /end COMPU_VTAB
/begin COMPU_VTAB Com_RxPduInfoIndEndIdxOfIPduGroupInfoType "" TAB_VERB 1 255 "COM_NO_RXPDUINFOINDENDIDXOFIPDUGROUPINFO" /end COMPU_VTAB
/begin COMPU_VTAB CompuMethodEnum_CanSMSubStateTypes "" TAB_VERB 16 1 "CANSM_StartUp_TRCV_NORMAL" 2 "CANSM_StartUp_CC_STOPPED" 3 "CANSM_StartUp_CC_STARTED" 16 "CANSM_S_FULLCOM_ENSURED_NO_BUS_OFF" 17 "CANSM_BusOff_CHECK" 20 "CANSM_BusOff_TX_OFFLINE" 32 "CANSM_S_SILENTCOM" 33 "CANSM_ShutDown_PN_CLEAR_WUF" 34 "CANSM_ShutDown_CC_STOPPED" 35 "CANSM_ShutDown_CC_SLEEP" 36 "CANSM_ShutDown_TRCV_NORMAL" 37 "CANSM_ShutDown_TRCV_STANDBY" 38 "CANSM_ShutDown_CC_SLEEP_PN" 39 "CANSM_ShutDown_CHK_WUF_CC_SLEEP" 40 "CANSM_ShutDown_CHK_WUF_NOT_CC_SLEEP" 64 "CANSM_S_NOCOM" /end COMPU_VTAB
/begin COMPU_VTAB CompuMethodEnum_ComModeTypes "" TAB_VERB 3 0 "COMM_NO_COMMUNICATION" 1 "COMM_SILENT_COMMUNICATION" 2 "COMM_FULL_COMMUNICATION" /end COMPU_VTAB
/begin GROUP CanSM ""
 /begin REF_MEASUREMENT CanSM_ChannelVarRecord[0].CanSM_BusOffCounter CanSM_ChannelVarRecord[0].CanSM_BusOffFlag CanSM_ChannelVarRecord[0].CanSM_CurrentState CanSM_ChannelVarRecord[0].CanSM_IndicatedComMode CanSM_ChannelVarRecord[0].CanSM_LastValidBaudRate CanSM_ChannelVarRecord[0].CanSM_ModeRequestRepetitionCounter CanSM_ChannelVarRecord[0].CanSM_RequestedComMode CanSM_ChannelVarRecord[0].CanSM_UniversalTimer /end REF_MEASUREMENT
/end GROUP
/begin GROUP CanTp ""
 /begin REF_MEASUREMENT CanTp_RxState[0].BufferState CanTp_RxState[0].ChannelState CanTp_RxState[0].DataIndex CanTp_RxState[0].DataLength CanTp_RxState[0].ExpectedSN CanTp_RxState[0].FrameType CanTp_RxState[0].ProvidedBufferSize CanTp_RxState[0].Timer CanTp_RxState[1].BufferState CanTp_RxState[1].ChannelState CanTp_RxState[1].DataIndex CanTp_RxState[1].DataLength CanTp_RxState[1].ExpectedSN CanTp_RxState[1].FrameType CanTp_RxState[1].ProvidedBufferSize CanTp_RxState[1].Timer CanTp_RxState[2].BufferState CanTp_RxState[2].ChannelState CanTp_RxState[2].DataIndex CanTp_RxState[2].DataLength CanTp_RxState[2].ExpectedSN CanTp_RxState[2].FrameType CanTp_RxState[2].ProvidedBufferSize CanTp_RxState[2].Timer CanTp_RxState[3].BufferState CanTp_RxState[3].ChannelState CanTp_RxState[3].DataIndex CanTp_RxState[3].DataLength CanTp_RxState[3].ExpectedSN CanTp_RxState[3].FrameType CanTp_RxState[3].ProvidedBufferSize CanTp_RxState[3].Timer CanTp_RxState[4].BufferState CanTp_RxState[4].ChannelState CanTp_RxState[4].DataIndex CanTp_RxState[4].DataLength CanTp_RxState[4].ExpectedSN CanTp_RxState[4].FrameType CanTp_RxState[4].ProvidedBufferSize CanTp_RxState[4].Timer CanTp_RxState[5].BufferState CanTp_RxState[5].ChannelState CanTp_RxState[5].DataIndex CanTp_RxState[5].DataLength CanTp_RxState[5].ExpectedSN CanTp_RxState[5].FrameType CanTp_RxState[5].ProvidedBufferSize CanTp_RxState[5].Timer CanTp_RxState[6].BufferState CanTp_RxState[6].ChannelState CanTp_RxState[6].DataIndex CanTp_RxState[6].DataLength CanTp_RxState[6].ExpectedSN CanTp_RxState[6].FrameType CanTp_RxState[6].ProvidedBufferSize CanTp_RxState[6].Timer CanTp_RxState[7].BufferState CanTp_RxState[7].ChannelState CanTp_RxState[7].DataIndex CanTp_RxState[7].DataLength CanTp_RxState[7].ExpectedSN CanTp_RxState[7].FrameType CanTp_RxState[7].ProvidedBufferSize CanTp_RxState[7].Timer CanTp_TxSemaphores[0].Direction CanTp_TxSemaphores[0].Handle CanTp_TxSemaphores[1].Direction CanTp_TxSemaphores[1].Handle CanTp_TxSemaphores[2].Direction CanTp_TxSemaphores[2].Handle CanTp_TxSemaphores[3].Direction CanTp_TxSemaphores[3].Handle CanTp_TxSemaphores[4].Direction CanTp_TxSemaphores[4].Handle CanTp_TxSemaphores[5].Direction CanTp_TxSemaphores[5].Handle CanTp_TxState[0].BlocksizeCounter CanTp_TxState[0].BufferState CanTp_TxState[0].ChannelState CanTp_TxState[0].DataIndex CanTp_TxState[0].DataLength CanTp_TxState[0].STminTimer CanTp_TxState[0].SeqNumber CanTp_TxState[0].Timer CanTp_TxState[1].BlocksizeCounter CanTp_TxState[1].BufferState CanTp_TxState[1].ChannelState CanTp_TxState[1].DataIndex CanTp_TxState[1].DataLength CanTp_TxState[1].STminTimer CanTp_TxState[1].SeqNumber CanTp_TxState[1].Timer CanTp_TxState[2].BlocksizeCounter CanTp_TxState[2].BufferState CanTp_TxState[2].ChannelState CanTp_TxState[2].DataIndex CanTp_TxState[2].DataLength CanTp_TxState[2].STminTimer CanTp_TxState[2].SeqNumber CanTp_TxState[2].Timer CanTp_TxState[3].BlocksizeCounter CanTp_TxState[3].BufferState CanTp_TxState[3].ChannelState CanTp_TxState[3].DataIndex CanTp_TxState[3].DataLength CanTp_TxState[3].STminTimer CanTp_TxState[3].SeqNumber CanTp_TxState[3].Timer CanTp_TxState[4].BlocksizeCounter CanTp_TxState[4].BufferState CanTp_TxState[4].ChannelState CanTp_TxState[4].DataIndex CanTp_TxState[4].DataLength CanTp_TxState[4].STminTimer CanTp_TxState[4].SeqNumber CanTp_TxState[4].Timer CanTp_TxState[5].BlocksizeCounter CanTp_TxState[5].BufferState CanTp_TxState[5].ChannelState CanTp_TxState[5].DataIndex CanTp_TxState[5].DataLength CanTp_TxState[5].STminTimer CanTp_TxState[5].SeqNumber CanTp_TxState[5].Timer /end REF_MEASUREMENT
/end GROUP
/begin GROUP Com ""
 /begin REF_MEASUREMENT Com_AlwaysActiveTxComIPdus[0].PartitionsAlwaysActiveTxComIPdusStructIdxOfAlwaysActiveTxComIPdus Com_AlwaysActiveTxComIPdus[1].PartitionsAlwaysActiveTxComIPdusStructIdxOfAlwaysActiveTxComIPdus Com_ConstValueArrayBased Com_ConstValueUInt16 Com_ConstValueUInt32 Com_ConstValueUInt8 Com_CurrentTxMode Com_CurrentTxMode_BMC_CMC_Temperatur_01_XIX_HCP5_CANFD01_13d55235_Tx Com_CurrentTxMode_BMC_CMC_Temperatur_02_XIX_HCP5_CANFD01_f9538f57_Tx Com_CurrentTxMode_BMC_CMC_Temperatur_03_XIX_HCP5_CANFD01_160139b6_Tx Com_CurrentTxMode_BMC_CMC_Zellspannung_01_XIX_HCP5_CANFD01_f76fbfe9_Tx Com_CurrentTxMode_BMC_CMC_Zellspannung_02_XIX_HCP5_CANFD01_1de9628b_Tx Com_CurrentTxMode_BMC_CMC_Zellspannung_03_XIX_HCP5_CANFD01_f2bbd46a_Tx Com_CurrentTxMode_BMC_CMC_Zellspannung_04_XIX_HCP5_CANFD01_1395de0e_Tx Com_CurrentTxMode_BMC_CMC_Zellspannung_05_XIX_HCP5_CANFD01_fcc768ef_Tx Com_CurrentTxMode_BMC_HV_01_XIX_HCP5_CANFD01_E2E_fcbbcae3_Tx Com_CurrentTxMode_BMC_HV_02_XIX_HCP5_CANFD01_E2E_c5c367a3_Tx Com_CurrentTxMode_BMC_HV_03_XIX_HCP5_CANFD01_0617c15c_Tx Com_CurrentTxMode_BMC_HV_04_XIX_BMC_CAN01_E2E_a4a2e7f5_Tx Com_CurrentTxMode_BMC_HV_05_XIX_HCP5_CANFD01_086b7dd9_Tx Com_CurrentTxMode_BMC_HV_06_XIX_HCP5_CANFD01_e2eda0bb_Tx Com_CurrentTxMode_BMC_HV_07_XIX_HCP5_CANFD01_0dbf165a_Tx Com_CurrentTxMode_BMC_HV_08_XIX_HCP5_CANFD01_fbc0b232_Tx Com_CurrentTxMode_BMC_HV_09_XIX_HCP5_CANFD01_149204d3_Tx Com_CurrentTxMode_BMC_HV_10_XIX_BMC_CAN01_E2E_28add151_Tx Com_CurrentTxMode_BMC_HV_11_XIX_BMC_CAN01_E2E_ff4f5109_Tx Com_CurrentTxMode_BMC_HV_12_XIX_BMC_CAN01_E2E_5c19d7a0_Tx Com_CurrentTxMode_BMC_HV_13_XIX_BMC_CAN01_E2E_8bfb57f8_Tx Com_CurrentTxMode_BMC_HV_14_XIX_HCP5_CANFD01_30db4b60_Tx Com_CurrentTxMode_DEV_Hybrid_01_Resp_FF_XIX_HCP5_CANFD01_7b20ac63_Tx Com_CurrentTxMode_DS_Hybrid_01_XIX_HCP5_CANFD01_b3d0b839_Tx Com_CurrentTxMode_KN_Hybrid_01_XIX_HCP5_CANFD01_fef84477_Tx Com_CurrentTxMode_KS_Hybrid_01_Challenge_K_XIX_HCP5_CANFD01_306d69bd_Tx Com_CurrentTxMode_KS_Hybrid_01_ReqFrame_XIX_HCP5_CANFD01_b04c52dd_Tx Com_CurrentTxMode_KS_Hybrid_01_Response_K_XIX_HCP5_CANFD01_76da782f_Tx Com_CurrentTxMode_NMH_Hybrid_01_XIX_BMC_CAN01_b22e17f1_Tx Com_CurrentTxMode_NM_Hybrid_01_XIX_HCP5_CANFD01_c84ff8a5_Tx Com_CurrentTxMode_OBD_Hybrid_01_XIX_HCP5_CANFD01_40f9dae5_Tx Com_CurrentTxMode_SOK_Zeit_Hybrid_01_Chal_01_XIX_HCP5_CANFD01_5939048b_Tx Com_CycleTimeCnt Com_CycleTimeCnt_BMC_CMC_Temperatur_01_XIX_HCP5_CANFD01_13d55235_Tx Com_CycleTimeCnt_BMC_CMC_Temperatur_02_XIX_HCP5_CANFD01_f9538f57_Tx Com_CycleTimeCnt_BMC_CMC_Temperatur_03_XIX_HCP5_CANFD01_160139b6_Tx Com_CycleTimeCnt_BMC_CMC_Zellspannung_01_XIX_HCP5_CANFD01_f76fbfe9_Tx Com_CycleTimeCnt_BMC_CMC_Zellspannung_02_XIX_HCP5_CANFD01_1de9628b_Tx Com_CycleTimeCnt_BMC_CMC_Zellspannung_03_XIX_HCP5_CANFD01_f2bbd46a_Tx Com_CycleTimeCnt_BMC_CMC_Zellspannung_04_XIX_HCP5_CANFD01_1395de0e_Tx Com_CycleTimeCnt_BMC_CMC_Zellspannung_05_XIX_HCP5_CANFD01_fcc768ef_Tx Com_CycleTimeCnt_BMC_HV_01_XIX_HCP5_CANFD01_E2E_fcbbcae3_Tx Com_CycleTimeCnt_BMC_HV_02_XIX_HCP5_CANFD01_E2E_c5c367a3_Tx Com_CycleTimeCnt_BMC_HV_03_XIX_HCP5_CANFD01_0617c15c_Tx Com_CycleTimeCnt_BMC_HV_04_XIX_BMC_CAN01_E2E_a4a2e7f5_Tx Com_CycleTimeCnt_BMC_HV_05_XIX_HCP5_CANFD01_086b7dd9_Tx Com_CycleTimeCnt_BMC_HV_06_XIX_HCP5_CANFD01_e2eda0bb_Tx Com_CycleTimeCnt_BMC_HV_07_XIX_HCP5_CANFD01_0dbf165a_Tx Com_CycleTimeCnt_BMC_HV_08_XIX_HCP5_CANFD01_fbc0b232_Tx Com_CycleTimeCnt_BMC_HV_09_XIX_HCP5_CANFD01_149204d3_Tx Com_CycleTimeCnt_BMC_HV_10_XIX_BMC_CAN01_E2E_28add151_Tx Com_CycleTimeCnt_BMC_HV_11_XIX_BMC_CAN01_E2E_ff4f5109_Tx Com_CycleTimeCnt_BMC_HV_12_XIX_BMC_CAN01_E2E_5c19d7a0_Tx Com_CycleTimeCnt_BMC_HV_13_XIX_BMC_CAN01_E2E_8bfb57f8_Tx Com_CycleTimeCnt_BMC_HV_14_XIX_HCP5_CANFD01_30db4b60_Tx Com_CycleTimeCnt_DEV_Hybrid_01_Resp_FF_XIX_HCP5_CANFD01_7b20ac63_Tx Com_CycleTimeCnt_DS_Hybrid_01_XIX_HCP5_CANFD01_b3d0b839_Tx Com_CycleTimeCnt_KN_Hybrid_01_XIX_HCP5_CANFD01_fef84477_Tx Com_CycleTimeCnt_KS_Hybrid_01_Challenge_K_XIX_HCP5_CANFD01_306d69bd_Tx Com_CycleTimeCnt_KS_Hybrid_01_ReqFrame_XIX_HCP5_CANFD01_b04c52dd_Tx Com_CycleTimeCnt_KS_Hybrid_01_Response_K_XIX_HCP5_CANFD01_76da782f_Tx Com_CycleTimeCnt_NMH_Hybrid_01_XIX_BMC_CAN01_b22e17f1_Tx Com_CycleTimeCnt_NM_Hybrid_01_XIX_HCP5_CANFD01_c84ff8a5_Tx Com_CycleTimeCnt_OBD_Hybrid_01_XIX_HCP5_CANFD01_40f9dae5_Tx Com_CycleTimeCnt_SOK_Zeit_Hybrid_01_Chal_01_XIX_HCP5_CANFD01_5939048b_Tx Com_CyclicSendRequest Com_CyclicSendRequest_BMC_CMC_Temperatur_01_XIX_HCP5_CANFD01_13d55235_Tx Com_CyclicSendRequest_BMC_CMC_Temperatur_02_XIX_HCP5_CANFD01_f9538f57_Tx Com_CyclicSendRequest_BMC_CMC_Temperatur_03_XIX_HCP5_CANFD01_160139b6_Tx Com_CyclicSendRequest_BMC_CMC_Zellspannung_01_XIX_HCP5_CANFD01_f76fbfe9_Tx Com_CyclicSendRequest_BMC_CMC_Zellspannung_02_XIX_HCP5_CANFD01_1de9628b_Tx Com_CyclicSendRequest_BMC_CMC_Zellspannung_03_XIX_HCP5_CANFD01_f2bbd46a_Tx Com_CyclicSendRequest_BMC_CMC_Zellspannung_04_XIX_HCP5_CANFD01_1395de0e_Tx Com_CyclicSendRequest_BMC_CMC_Zellspannung_05_XIX_HCP5_CANFD01_fcc768ef_Tx Com_CyclicSendRequest_BMC_HV_01_XIX_HCP5_CANFD01_E2E_fcbbcae3_Tx Com_CyclicSendRequest_BMC_HV_02_XIX_HCP5_CANFD01_E2E_c5c367a3_Tx Com_CyclicSendRequest_BMC_HV_03_XIX_HCP5_CANFD01_0617c15c_Tx Com_CyclicSendRequest_BMC_HV_04_XIX_BMC_CAN01_E2E_a4a2e7f5_Tx Com_CyclicSendRequest_BMC_HV_05_XIX_HCP5_CANFD01_086b7dd9_Tx Com_CyclicSendRequest_BMC_HV_06_XIX_HCP5_CANFD01_e2eda0bb_Tx Com_CyclicSendRequest_BMC_HV_07_XIX_HCP5_CANFD01_0dbf165a_Tx Com_CyclicSendRequest_BMC_HV_08_XIX_HCP5_CANFD01_fbc0b232_Tx Com_CyclicSendRequest_BMC_HV_09_XIX_HCP5_CANFD01_149204d3_Tx Com_CyclicSendRequest_BMC_HV_10_XIX_BMC_CAN01_E2E_28add151_Tx Com_CyclicSendRequest_BMC_HV_11_XIX_BMC_CAN01_E2E_ff4f5109_Tx Com_CyclicSendRequest_BMC_HV_12_XIX_BMC_CAN01_E2E_5c19d7a0_Tx Com_CyclicSendRequest_BMC_HV_13_XIX_BMC_CAN01_E2E_8bfb57f8_Tx Com_CyclicSendRequest_BMC_HV_14_XIX_HCP5_CANFD01_30db4b60_Tx Com_CyclicSendRequest_DEV_Hybrid_01_Resp_FF_XIX_HCP5_CANFD01_7b20ac63_Tx Com_CyclicSendRequest_DS_Hybrid_01_XIX_HCP5_CANFD01_b3d0b839_Tx Com_CyclicSendRequest_KN_Hybrid_01_XIX_HCP5_CANFD01_fef84477_Tx Com_CyclicSendRequest_KS_Hybrid_01_Challenge_K_XIX_HCP5_CANFD01_306d69bd_Tx Com_CyclicSendRequest_KS_Hybrid_01_ReqFrame_XIX_HCP5_CANFD01_b04c52dd_Tx Com_CyclicSendRequest_KS_Hybrid_01_Response_K_XIX_HCP5_CANFD01_76da782f_Tx Com_CyclicSendRequest_NMH_Hybrid_01_XIX_BMC_CAN01_b22e17f1_Tx Com_CyclicSendRequest_NM_Hybrid_01_XIX_HCP5_CANFD01_c84ff8a5_Tx Com_CyclicSendRequest_OBD_Hybrid_01_XIX_HCP5_CANFD01_40f9dae5_Tx Com_CyclicSendRequest_SOK_Zeit_Hybrid_01_Chal_01_XIX_HCP5_CANFD01_5939048b_Tx Com_DelayTimeCnt Com_HandleRxPduDeferred Com_HandleRxPduDeferred_Airbag_10_XIX_HCP5_CANFD01_7f2c77c5_Rx Com_HandleRxPduDeferred_BJB_08_XIX_BMC_CAN01_1db9ae10_Rx Com_HandleRxPduDeferred_BJB_10_XIX_BMC_CAN01_E2E_968516b3_Rx Com_HandleRxPduDeferred_BJB_11_XIX_BMC_CAN01_E2E_416796eb_Rx Com_HandleRxPduDeferred_BJB_12_XIX_BMC_CAN01_E2E_e2311042_Rx Com_HandleRxPduDeferred_BJB_13_XIX_BMC_CAN01_E2E_35d3901a_Rx Com_HandleRxPduDeferred_BJB_CALID_01_XIX_BMC_CAN01_adee7d66_Rx Com_HandleRxPduDeferred_BJB_CALID_02_XIX_BMC_CAN01_bc93171f_Rx Com_HandleRxPduDeferred_BJB_CVN_01_XIX_BMC_CAN01_301c1ddb_Rx Com_HandleRxPduDeferred_Charisma_20_XIX_HCP5_CANFD01_f51eced8_Rx Com_HandleRxPduDeferred_ClampControl_01_XIX_HCP5_CANFD01_8c24343b_Rx Com_HandleRxPduDeferred_ComIPduPnc_EIRA_CAN_Rx Com_HandleRxPduDeferred_DCDC_04_XIX_HCP5_CANFD01_8ca88b97_Rx Com_HandleRxPduDeferred_DCDC_NV_CALID_XIX_HCP5_CANFD01_46b970f2_Rx Com_HandleRxPduDeferred_DCDC_NV_CVN_XIX_HCP5_CANFD01_55665719_Rx Com_HandleRxPduDeferred_DCDC_NV_Komponentenfehler_01_XIX_HCP5_CANFD01_dd687766_Rx Com_HandleRxPduDeferred_DCDC_NV_Komponentenfehler_02_XIX_HCP5_CANFD01_37eeaa04_Rx Com_HandleRxPduDeferred_DCDC_NV_Komponentenfehler_03_XIX_HCP5_CANFD01_d8bc1ce5_Rx Com_HandleRxPduDeferred_DCDC_NV_Komponentenfehler_04_XIX_HCP5_CANFD01_39921681_Rx Com_HandleRxPduDeferred_DEV_Hybrid_01_Req_00_XIX_HCP5_CANFD01_5661b344_Rx Com_HandleRxPduDeferred_Diagnose_01_XIX_HCP5_CANFD01_426f0ab5_Rx Com_HandleRxPduDeferred_ELF_06_XIX_HCP5_CANFD01_d78b945c_Rx Com_HandleRxPduDeferred_HCP1_17_XIX_HCP5_CANFD01_3398d6b5_Rx Com_HandleRxPduDeferred_HVEM_07_XIX_HCP5_CANFD01_839f516f_Rx Com_HandleRxPduDeferred_HVK_03_XIX_HCP5_CANFD01_E2E_8a76edcb_Rx Com_HandleRxPduDeferred_HVLM_13_XIX_HCP5_CANFD01_f1be44f1_Rx Com_HandleRxPduDeferred_HVLM_14_XIX_HCP5_CANFD01_E2E_b3d1458f_Rx Com_HandleRxPduDeferred_KS_Hybrid_01_Challenge_M_XIX_HCP5_CANFD01_3e11d538_Rx Com_HandleRxPduDeferred_KS_Hybrid_01_Response_M_XIX_HCP5_CANFD01_78a6c4aa_Rx Com_HandleRxPduDeferred_NVEM_12_XIX_HCP5_CANFD01_00bae280_Rx Com_HandleRxPduDeferred_OBD_03_XIX_HCP5_CANFD01_f1281889_Rx Com_HandleRxPduDeferred_OBD_04_XIX_HCP5_CANFD01_100612ed_Rx Com_HandleRxPduDeferred_OBD_HCP1_XIX_HCP5_CANFD01_1b389b6c_Rx Com_HandleRxPduDeferred_OBG_01_XIX_HCP5_CANFD01_8fe2f1e9_Rx Com_HandleRxPduDeferred_ORU_01_XIX_HCP5_CANFD01_8935a839_Rx Com_HandleRxPduDeferred_ORU_Control_A_01_XIX_HCP5_CANFD01_E2E_3007747a_Rx Com_HandleRxPduDeferred_ORU_Control_D_01_XIX_HCP5_CANFD01_E2E_6e31ae8f_Rx Com_HandleRxPduDeferred_OTAMC_D_01_XIX_HCP5_CANFD01_E2E_c199b3e6_Rx Com_HandleRxPduDeferred_OTP_01_XIX_HCP5_CANFD01_76e7759c_Rx Com_HandleRxPduDeferred_SOK_NoAuthenticTime_01_XIX_HCP5_CANFD01_a407ae2f_Rx Com_HandleRxPduDeferred_SOK_Zeit_Hybrid_01_Resp_01_XIX_HCP5_CANFD01_c7a98a10_Rx Com_HandleRxPduDeferred_Systeminfo_01_XIX_HCP5_CANFD01_fb27c5ed_Rx Com_HandleRxPduDeferred_Thermomanagement_01_XIX_HCP5_CANFD01_60e8cf38_Rx Com_HandleRxPduDeferred_UI1_01_XIX_BMC_CAN01_E2E_cec88adf_Rx Com_HandleRxPduDeferred_UI1_02_XIX_BMC_CAN01_E2E_6d9e0c76_Rx Com_HandleRxPduDeferred_UI1_03_XIX_BMC_CAN01_4277cadb_Rx Com_HandleRxPduDeferred_UI1_04_XIX_BMC_CAN01_d976c5c1_Rx Com_HandleRxPduDeferred_UI1_05_XIX_BMC_CAN01_608d1e29_Rx Com_HandleRxPduDeferred_UI1_Komponentenfehler_01_XIX_BMC_CAN01_08861f77_Rx Com_HandleRxPduDeferred_UI1_Komponentenfehler_02_XIX_BMC_CAN01_19fb750e_Rx Com_HandleRxPduDeferred_UI2Sens01_CALID_01_XIX_BMC_CAN01_f3c92280_Rx Com_HandleRxPduDeferred_UI2Sens01_CALID_02_XIX_BMC_CAN01_e2b448f9_Rx Com_HandleRxPduDeferred_UI2Sens01_CVN_XIX_BMC_CAN01_fe6b52fc_Rx Com_HandleRxPduDeferred_UI2Sens02_CALID_01_XIX_BMC_CAN01_abd78ba8_Rx Com_HandleRxPduDeferred_UI2Sens02_CALID_02_XIX_BMC_CAN01_baaae1d1_Rx Com_HandleRxPduDeferred_UI2Sens02_CVN_XIX_BMC_CAN01_5d3dd455_Rx Com_HandleRxPduDeferred_UI2_01_XIX_BMC_CAN01_E2E_f7b0279f_Rx Com_HandleRxPduDeferred_UI2_02_XIX_BMC_CAN01_E2E_54e6a136_Rx Com_HandleRxPduDeferred_UI2_03_XIX_BMC_CAN01_E2E_8304216e_Rx Com_HandleRxPduDeferred_UI2_04_XIX_BMC_CAN01_33f018a3_Rx Com_HandleRxPduDeferred_UI2_Komponentenfehler_01_XIX_BMC_CAN01_6c666489_Rx Com_HandleRxPduDeferred_UI2_Komponentenfehler_02_XIX_BMC_CAN01_7d1b0ef0_Rx Com_HandleRxPduDeferred_VDSO_05_XIX_HCP5_CANFD01_48366f26_Rx Com_HandleRxPduDeferred_WFS_02_XIX_HCP5_CANFD01_61136cb6_Rx Com_HandleRxPduDeferred_ZeitMaster_01_XIX_HCP5_CANFD01_dad73d21_Rx Com_HandleRxPduDeferred_Zeitmaster_05_XIX_HCP5_CANFD01_5eaa5a96_Rx Com_HandleTxPduDeferred Com_IPduGroupInfoOfRxPduInfoInd Com_IPduGroupInfoOfTxPduInfoInd Com_IPduGroupInfo[0].IPduGroupInfoToSubIPduGroupsIndStartIdxOfIPduGroupInfo Com_IPduGroupInfo[0].PartitionsRxStructIdxOfIPduGroupInfo Com_IPduGroupInfo[0].PartitionsTxStructIdxOfIPduGroupInfo Com_IPduGroupInfo[0].RxPduInfoIndEndIdxOfIPduGroupInfo /end REF_MEASUREMENT
/end GROUP
/end MODULE
/end PROJECT
