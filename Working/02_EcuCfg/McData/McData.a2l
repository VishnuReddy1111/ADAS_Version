/*
COPYRIGHT
Copyright (c) 2013 - 2024 by Vector Informatik GmbH. All rights reserved.
This software is copyright protected and proprietary to Vector Informatik GmbH.
Vector Informatik GmbH grants to you only those rights as set out in the license conditions.
*/
ASAP2_VERSION 1 71
/begin PROJECT MICROSAR ""
/begin MODULE CPP ""
/begin MOD_COMMON "" BYTE_ORDER MSB_LAST ALIGNMENT_BYTE 1 ALIGNMENT_WORD 2 ALIGNMENT_LONG 4 ALIGNMENT_FLOAT16_IEEE 2 ALIGNMENT_FLOAT32_IEEE 4 ALIGNMENT_FLOAT64_IEEE 8 ALIGNMENT_INT64 8 /end MOD_COMMON
/begin MEASUREMENT Com_IPduGroupInfo[0].RxPduInfoIndStartIdxOfIPduGroupInfo "" UBYTE Com_RxPduInfoIndStartIdxOfIPduGroupInfoType 0 0 0 255 ECU_ADDRESS 0x0 /end MEASUREMENT
/begin MEASUREMENT Com_IPduGroupInfo[0].TxPduInfoIndEndIdxOfIPduGroupInfo "" UBYTE Com_TxPduInfoIndEndIdxOfIPduGroupInfoType 0 0 0 255 ECU_ADDRESS 0x0 /end MEASUREMENT
/begin MEASUREMENT Com_IPduGroupInfo[0].TxPduInfoIndStartIdxOfIPduGroupInfo "" UBYTE Com_TxPduInfoIndStartIdxOfIPduGroupInfoType 0 0 0 255 ECU_ADDRESS 0x0 /end MEASUREMENT
/begin MEASUREMENT Com_IPduGroupInfo[10].IPduGroupInfoToSubIPduGroupsIndStartIdxOfIPduGroupInfo "" UBYTE Com_IPduGroupInfoToSubIPduGroupsIndStartIdxOfIPduGroupInfoType 0 0 0 255 ECU_ADDRESS 0x0 /end MEASUREMENT
/begin MEASUREMENT Com_IPduGroupInfo[10].PartitionsRxStructIdxOfIPduGroupInfo "" UBYTE Com_PartitionsRxStructIdxOfIPduGroupInfoType 0 0 0 255 ECU_ADDRESS 0x0 /end MEASUREMENT
/begin MEASUREMENT Com_IPduGroupInfo[10].PartitionsTxStructIdxOfIPduGroupInfo "" UBYTE Com_PartitionsTxStructIdxOfIPduGroupInfoType 0 0 0 255 ECU_ADDRESS 0x0 /end MEASUREMENT
/begin MEASUREMENT Com_IPduGroupInfo[10].RxPduInfoIndEndIdxOfIPduGroupInfo "" UBYTE Com_RxPduInfoIndEndIdxOfIPduGroupInfoType 0 0 0 255 ECU_ADDRESS 0x0 /end MEASUREMENT
/begin MEASUREMENT Com_IPduGroupInfo[10].RxPduInfoIndStartIdxOfIPduGroupInfo "" UBYTE Com_RxPduInfoIndStartIdxOfIPduGroupInfoType 0 0 0 255 ECU_ADDRESS 0x0 /end MEASUREMENT
/begin MEASUREMENT Com_IPduGroupInfo[10].TxPduInfoIndEndIdxOfIPduGroupInfo "" UBYTE Com_TxPduInfoIndEndIdxOfIPduGroupInfoType 0 0 0 255 ECU_ADDRESS 0x0 /end MEASUREMENT
/begin MEASUREMENT Com_IPduGroupInfo[10].TxPduInfoIndStartIdxOfIPduGroupInfo "" UBYTE Com_TxPduInfoIndStartIdxOfIPduGroupInfoType 0 0 0 255 ECU_ADDRESS 0x0 /end MEASUREMENT
/begin MEASUREMENT Com_IPduGroupInfo[11].IPduGroupInfoToSubIPduGroupsIndStartIdxOfIPduGroupInfo "" UBYTE Com_IPduGroupInfoToSubIPduGroupsIndStartIdxOfIPduGroupInfoType 0 0 0 255 ECU_ADDRESS 0x0 /end MEASUREMENT
/begin MEASUREMENT Com_IPduGroupInfo[11].PartitionsRxStructIdxOfIPduGroupInfo "" UBYTE Com_PartitionsRxStructIdxOfIPduGroupInfoType 0 0 0 255 ECU_ADDRESS 0x0 /end MEASUREMENT
/begin MEASUREMENT Com_IPduGroupInfo[11].PartitionsTxStructIdxOfIPduGroupInfo "" UBYTE Com_PartitionsTxStructIdxOfIPduGroupInfoType 0 0 0 255 ECU_ADDRESS 0x0 /end MEASUREMENT
/begin MEASUREMENT Com_IPduGroupInfo[11].RxPduInfoIndEndIdxOfIPduGroupInfo "" UBYTE Com_RxPduInfoIndEndIdxOfIPduGroupInfoType 0 0 0 255 ECU_ADDRESS 0x0 /end MEASUREMENT
/begin MEASUREMENT Com_IPduGroupInfo[11].RxPduInfoIndStartIdxOfIPduGroupInfo "" UBYTE Com_RxPduInfoIndStartIdxOfIPduGroupInfoType 0 0 0 255 ECU_ADDRESS 0x0 /end MEASUREMENT
/begin MEASUREMENT Com_IPduGroupInfo[11].TxPduInfoIndEndIdxOfIPduGroupInfo "" UBYTE Com_TxPduInfoIndEndIdxOfIPduGroupInfoType 0 0 0 255 ECU_ADDRESS 0x0 /end MEASUREMENT
/begin MEASUREMENT Com_IPduGroupInfo[11].TxPduInfoIndStartIdxOfIPduGroupInfo "" UBYTE Com_TxPduInfoIndStartIdxOfIPduGroupInfoType 0 0 0 255 ECU_ADDRESS 0x0 /end MEASUREMENT
/begin MEASUREMENT Com_IPduGroupInfo[12].IPduGroupInfoToSubIPduGroupsIndStartIdxOfIPduGroupInfo "" UBYTE Com_IPduGroupInfoToSubIPduGroupsIndStartIdxOfIPduGroupInfoType 0 0 0 255 ECU_ADDRESS 0x0 /end MEASUREMENT
/begin MEASUREMENT Com_IPduGroupInfo[12].PartitionsRxStructIdxOfIPduGroupInfo "" UBYTE Com_PartitionsRxStructIdxOfIPduGroupInfoType 0 0 0 255 ECU_ADDRESS 0x0 /end MEASUREMENT
/begin MEASUREMENT Com_IPduGroupInfo[12].PartitionsTxStructIdxOfIPduGroupInfo "" UBYTE Com_PartitionsTxStructIdxOfIPduGroupInfoType 0 0 0 255 ECU_ADDRESS 0x0 /end MEASUREMENT
/begin MEASUREMENT Com_IPduGroupInfo[12].RxPduInfoIndEndIdxOfIPduGroupInfo "" UBYTE Com_RxPduInfoIndEndIdxOfIPduGroupInfoType 0 0 0 255 ECU_ADDRESS 0x0 /end MEASUREMENT
/begin MEASUREMENT Com_IPduGroupInfo[12].RxPduInfoIndStartIdxOfIPduGroupInfo "" UBYTE Com_RxPduInfoIndStartIdxOfIPduGroupInfoType 0 0 0 255 ECU_ADDRESS 0x0 /end MEASUREMENT
/begin MEASUREMENT Com_IPduGroupInfo[12].TxPduInfoIndEndIdxOfIPduGroupInfo "" UBYTE Com_TxPduInfoIndEndIdxOfIPduGroupInfoType 0 0 0 255 ECU_ADDRESS 0x0 /end MEASUREMENT
/begin MEASUREMENT Com_IPduGroupInfo[12].TxPduInfoIndStartIdxOfIPduGroupInfo "" UBYTE Com_TxPduInfoIndStartIdxOfIPduGroupInfoType 0 0 0 255 ECU_ADDRESS 0x0 /end MEASUREMENT
/begin MEASUREMENT Com_IPduGroupInfo[13].IPduGroupInfoToSubIPduGroupsIndStartIdxOfIPduGroupInfo "" UBYTE Com_IPduGroupInfoToSubIPduGroupsIndStartIdxOfIPduGroupInfoType 0 0 0 255 ECU_ADDRESS 0x0 /end MEASUREMENT
/begin MEASUREMENT Com_IPduGroupInfo[13].PartitionsRxStructIdxOfIPduGroupInfo "" UBYTE Com_PartitionsRxStructIdxOfIPduGroupInfoType 0 0 0 255 ECU_ADDRESS 0x0 /end MEASUREMENT
/begin MEASUREMENT Com_IPduGroupInfo[13].PartitionsTxStructIdxOfIPduGroupInfo "" UBYTE Com_PartitionsTxStructIdxOfIPduGroupInfoType 0 0 0 255 ECU_ADDRESS 0x0 /end MEASUREMENT
/begin MEASUREMENT Com_IPduGroupInfo[13].RxPduInfoIndEndIdxOfIPduGroupInfo "" UBYTE Com_RxPduInfoIndEndIdxOfIPduGroupInfoType 0 0 0 255 ECU_ADDRESS 0x0 /end MEASUREMENT
/begin MEASUREMENT Com_IPduGroupInfo[13].RxPduInfoIndStartIdxOfIPduGroupInfo "" UBYTE Com_RxPduInfoIndStartIdxOfIPduGroupInfoType 0 0 0 255 ECU_ADDRESS 0x0 /end MEASUREMENT
/begin MEASUREMENT Com_IPduGroupInfo[13].TxPduInfoIndEndIdxOfIPduGroupInfo "" UBYTE Com_TxPduInfoIndEndIdxOfIPduGroupInfoType 0 0 0 255 ECU_ADDRESS 0x0 /end MEASUREMENT
/begin MEASUREMENT Com_IPduGroupInfo[13].TxPduInfoIndStartIdxOfIPduGroupInfo "" UBYTE Com_TxPduInfoIndStartIdxOfIPduGroupInfoType 0 0 0 255 ECU_ADDRESS 0x0 /end MEASUREMENT
/begin MEASUREMENT Com_IPduGroupInfo[14].IPduGroupInfoToSubIPduGroupsIndStartIdxOfIPduGroupInfo "" UBYTE Com_IPduGroupInfoToSubIPduGroupsIndStartIdxOfIPduGroupInfoType 0 0 0 255 ECU_ADDRESS 0x0 /end MEASUREMENT
/begin MEASUREMENT Com_IPduGroupInfo[14].PartitionsRxStructIdxOfIPduGroupInfo "" UBYTE Com_PartitionsRxStructIdxOfIPduGroupInfoType 0 0 0 255 ECU_ADDRESS 0x0 /end MEASUREMENT
/begin MEASUREMENT Com_IPduGroupInfo[14].PartitionsTxStructIdxOfIPduGroupInfo "" UBYTE Com_PartitionsTxStructIdxOfIPduGroupInfoType 0 0 0 255 ECU_ADDRESS 0x0 /end MEASUREMENT
/begin MEASUREMENT Com_IPduGroupInfo[14].RxPduInfoIndEndIdxOfIPduGroupInfo "" UBYTE Com_RxPduInfoIndEndIdxOfIPduGroupInfoType 0 0 0 255 ECU_ADDRESS 0x0 /end MEASUREMENT
/begin MEASUREMENT Com_IPduGroupInfo[14].RxPduInfoIndStartIdxOfIPduGroupInfo "" UBYTE Com_RxPduInfoIndStartIdxOfIPduGroupInfoType 0 0 0 255 ECU_ADDRESS 0x0 /end MEASUREMENT
/begin MEASUREMENT Com_IPduGroupInfo[14].TxPduInfoIndEndIdxOfIPduGroupInfo "" UBYTE Com_TxPduInfoIndEndIdxOfIPduGroupInfoType 0 0 0 255 ECU_ADDRESS 0x0 /end MEASUREMENT
/begin MEASUREMENT Com_IPduGroupInfo[14].TxPduInfoIndStartIdxOfIPduGroupInfo "" UBYTE Com_TxPduInfoIndStartIdxOfIPduGroupInfoType 0 0 0 255 ECU_ADDRESS 0x0 /end MEASUREMENT
/begin MEASUREMENT Com_IPduGroupInfo[15].IPduGroupInfoToSubIPduGroupsIndStartIdxOfIPduGroupInfo "" UBYTE Com_IPduGroupInfoToSubIPduGroupsIndStartIdxOfIPduGroupInfoType 0 0 0 255 ECU_ADDRESS 0x0 /end MEASUREMENT
/begin MEASUREMENT Com_IPduGroupInfo[15].PartitionsRxStructIdxOfIPduGroupInfo "" UBYTE Com_PartitionsRxStructIdxOfIPduGroupInfoType 0 0 0 255 ECU_ADDRESS 0x0 /end MEASUREMENT
/begin MEASUREMENT Com_IPduGroupInfo[15].PartitionsTxStructIdxOfIPduGroupInfo "" UBYTE Com_PartitionsTxStructIdxOfIPduGroupInfoType 0 0 0 255 ECU_ADDRESS 0x0 /end MEASUREMENT
/begin MEASUREMENT Com_IPduGroupInfo[15].RxPduInfoIndEndIdxOfIPduGroupInfo "" UBYTE Com_RxPduInfoIndEndIdxOfIPduGroupInfoType 0 0 0 255 ECU_ADDRESS 0x0 /end MEASUREMENT
/begin MEASUREMENT Com_IPduGroupInfo[15].RxPduInfoIndStartIdxOfIPduGroupInfo "" UBYTE Com_RxPduInfoIndStartIdxOfIPduGroupInfoType 0 0 0 255 ECU_ADDRESS 0x0 /end MEASUREMENT
/begin MEASUREMENT Com_IPduGroupInfo[15].TxPduInfoIndEndIdxOfIPduGroupInfo "" UBYTE Com_TxPduInfoIndEndIdxOfIPduGroupInfoType 0 0 0 255 ECU_ADDRESS 0x0 /end MEASUREMENT
/begin MEASUREMENT Com_IPduGroupInfo[15].TxPduInfoIndStartIdxOfIPduGroupInfo "" UBYTE Com_TxPduInfoIndStartIdxOfIPduGroupInfoType 0 0 0 255 ECU_ADDRESS 0x0 /end MEASUREMENT
/begin MEASUREMENT Com_IPduGroupInfo[16].IPduGroupInfoToSubIPduGroupsIndStartIdxOfIPduGroupInfo "" UBYTE Com_IPduGroupInfoToSubIPduGroupsIndStartIdxOfIPduGroupInfoType 0 0 0 255 ECU_ADDRESS 0x0 /end MEASUREMENT
/begin MEASUREMENT Com_IPduGroupInfo[16].PartitionsRxStructIdxOfIPduGroupInfo "" UBYTE Com_PartitionsRxStructIdxOfIPduGroupInfoType 0 0 0 255 ECU_ADDRESS 0x0 /end MEASUREMENT
/begin MEASUREMENT Com_IPduGroupInfo[16].PartitionsTxStructIdxOfIPduGroupInfo "" UBYTE Com_PartitionsTxStructIdxOfIPduGroupInfoType 0 0 0 255 ECU_ADDRESS 0x0 /end MEASUREMENT
/begin MEASUREMENT Com_IPduGroupInfo[16].RxPduInfoIndEndIdxOfIPduGroupInfo "" UBYTE Com_RxPduInfoIndEndIdxOfIPduGroupInfoType 0 0 0 255 ECU_ADDRESS 0x0 /end MEASUREMENT
/begin MEASUREMENT Com_IPduGroupInfo[16].RxPduInfoIndStartIdxOfIPduGroupInfo "" UBYTE Com_RxPduInfoIndStartIdxOfIPduGroupInfoType 0 0 0 255 ECU_ADDRESS 0x0 /end MEASUREMENT
/begin MEASUREMENT Com_IPduGroupInfo[16].TxPduInfoIndEndIdxOfIPduGroupInfo "" UBYTE Com_TxPduInfoIndEndIdxOfIPduGroupInfoType 0 0 0 255 ECU_ADDRESS 0x0 /end MEASUREMENT
/begin MEASUREMENT Com_IPduGroupInfo[16].TxPduInfoIndStartIdxOfIPduGroupInfo "" UBYTE Com_TxPduInfoIndStartIdxOfIPduGroupInfoType 0 0 0 255 ECU_ADDRESS 0x0 /end MEASUREMENT
/begin MEASUREMENT Com_IPduGroupInfo[17].IPduGroupInfoToSubIPduGroupsIndStartIdxOfIPduGroupInfo "" UBYTE Com_IPduGroupInfoToSubIPduGroupsIndStartIdxOfIPduGroupInfoType 0 0 0 255 ECU_ADDRESS 0x0 /end MEASUREMENT
/begin MEASUREMENT Com_IPduGroupInfo[17].PartitionsRxStructIdxOfIPduGroupInfo "" UBYTE Com_PartitionsRxStructIdxOfIPduGroupInfoType 0 0 0 255 ECU_ADDRESS 0x0 /end MEASUREMENT
/begin MEASUREMENT Com_IPduGroupInfo[17].PartitionsTxStructIdxOfIPduGroupInfo "" UBYTE Com_PartitionsTxStructIdxOfIPduGroupInfoType 0 0 0 255 ECU_ADDRESS 0x0 /end MEASUREMENT
/begin MEASUREMENT Com_IPduGroupInfo[17].RxPduInfoIndEndIdxOfIPduGroupInfo "" UBYTE Com_RxPduInfoIndEndIdxOfIPduGroupInfoType 0 0 0 255 ECU_ADDRESS 0x0 /end MEASUREMENT
/begin MEASUREMENT Com_IPduGroupInfo[17].RxPduInfoIndStartIdxOfIPduGroupInfo "" UBYTE Com_RxPduInfoIndStartIdxOfIPduGroupInfoType 0 0 0 255 ECU_ADDRESS 0x0 /end MEASUREMENT
/begin MEASUREMENT Com_IPduGroupInfo[17].TxPduInfoIndEndIdxOfIPduGroupInfo "" UBYTE Com_TxPduInfoIndEndIdxOfIPduGroupInfoType 0 0 0 255 ECU_ADDRESS 0x0 /end MEASUREMENT
/begin MEASUREMENT Com_IPduGroupInfo[17].TxPduInfoIndStartIdxOfIPduGroupInfo "" UBYTE Com_TxPduInfoIndStartIdxOfIPduGroupInfoType 0 0 0 255 ECU_ADDRESS 0x0 /end MEASUREMENT
/begin MEASUREMENT Com_IPduGroupInfo[18].IPduGroupInfoToSubIPduGroupsIndStartIdxOfIPduGroupInfo "" UBYTE Com_IPduGroupInfoToSubIPduGroupsIndStartIdxOfIPduGroupInfoType 0 0 0 255 ECU_ADDRESS 0x0 /end MEASUREMENT
/begin MEASUREMENT Com_IPduGroupInfo[18].PartitionsRxStructIdxOfIPduGroupInfo "" UBYTE Com_PartitionsRxStructIdxOfIPduGroupInfoType 0 0 0 255 ECU_ADDRESS 0x0 /end MEASUREMENT
/begin MEASUREMENT Com_IPduGroupInfo[18].PartitionsTxStructIdxOfIPduGroupInfo "" UBYTE Com_PartitionsTxStructIdxOfIPduGroupInfoType 0 0 0 255 ECU_ADDRESS 0x0 /end MEASUREMENT
/begin MEASUREMENT Com_IPduGroupInfo[18].RxPduInfoIndEndIdxOfIPduGroupInfo "" UBYTE Com_RxPduInfoIndEndIdxOfIPduGroupInfoType 0 0 0 255 ECU_ADDRESS 0x0 /end MEASUREMENT
/begin MEASUREMENT Com_IPduGroupInfo[18].RxPduInfoIndStartIdxOfIPduGroupInfo "" UBYTE Com_RxPduInfoIndStartIdxOfIPduGroupInfoType 0 0 0 255 ECU_ADDRESS 0x0 /end MEASUREMENT
/begin MEASUREMENT Com_IPduGroupInfo[18].TxPduInfoIndEndIdxOfIPduGroupInfo "" UBYTE Com_TxPduInfoIndEndIdxOfIPduGroupInfoType 0 0 0 255 ECU_ADDRESS 0x0 /end MEASUREMENT
/begin MEASUREMENT Com_IPduGroupInfo[18].TxPduInfoIndStartIdxOfIPduGroupInfo "" UBYTE Com_TxPduInfoIndStartIdxOfIPduGroupInfoType 0 0 0 255 ECU_ADDRESS 0x0 /end MEASUREMENT
/begin MEASUREMENT Com_IPduGroupInfo[1].IPduGroupInfoToSubIPduGroupsIndStartIdxOfIPduGroupInfo "" UBYTE Com_IPduGroupInfoToSubIPduGroupsIndStartIdxOfIPduGroupInfoType 0 0 0 255 ECU_ADDRESS 0x0 /end MEASUREMENT
/begin MEASUREMENT Com_IPduGroupInfo[1].PartitionsRxStructIdxOfIPduGroupInfo "" UBYTE Com_PartitionsRxStructIdxOfIPduGroupInfoType 0 0 0 255 ECU_ADDRESS 0x0 /end MEASUREMENT
/begin MEASUREMENT Com_IPduGroupInfo[1].PartitionsTxStructIdxOfIPduGroupInfo "" UBYTE Com_PartitionsTxStructIdxOfIPduGroupInfoType 0 0 0 255 ECU_ADDRESS 0x0 /end MEASUREMENT
/begin MEASUREMENT Com_IPduGroupInfo[1].RxPduInfoIndEndIdxOfIPduGroupInfo "" UBYTE Com_RxPduInfoIndEndIdxOfIPduGroupInfoType 0 0 0 255 ECU_ADDRESS 0x0 /end MEASUREMENT
/begin MEASUREMENT Com_IPduGroupInfo[1].RxPduInfoIndStartIdxOfIPduGroupInfo "" UBYTE Com_RxPduInfoIndStartIdxOfIPduGroupInfoType 0 0 0 255 ECU_ADDRESS 0x0 /end MEASUREMENT
/begin MEASUREMENT Com_IPduGroupInfo[1].TxPduInfoIndEndIdxOfIPduGroupInfo "" UBYTE Com_TxPduInfoIndEndIdxOfIPduGroupInfoType 0 0 0 255 ECU_ADDRESS 0x0 /end MEASUREMENT
/begin MEASUREMENT Com_IPduGroupInfo[1].TxPduInfoIndStartIdxOfIPduGroupInfo "" UBYTE Com_TxPduInfoIndStartIdxOfIPduGroupInfoType 0 0 0 255 ECU_ADDRESS 0x0 /end MEASUREMENT
/begin MEASUREMENT Com_IPduGroupInfo[2].IPduGroupInfoToSubIPduGroupsIndStartIdxOfIPduGroupInfo "" UBYTE Com_IPduGroupInfoToSubIPduGroupsIndStartIdxOfIPduGroupInfoType 0 0 0 255 ECU_ADDRESS 0x0 /end MEASUREMENT
/begin MEASUREMENT Com_IPduGroupInfo[2].PartitionsRxStructIdxOfIPduGroupInfo "" UBYTE Com_PartitionsRxStructIdxOfIPduGroupInfoType 0 0 0 255 ECU_ADDRESS 0x0 /end MEASUREMENT
/begin MEASUREMENT Com_IPduGroupInfo[2].PartitionsTxStructIdxOfIPduGroupInfo "" UBYTE Com_PartitionsTxStructIdxOfIPduGroupInfoType 0 0 0 255 ECU_ADDRESS 0x0 /end MEASUREMENT
/begin MEASUREMENT Com_IPduGroupInfo[2].RxPduInfoIndEndIdxOfIPduGroupInfo "" UBYTE Com_RxPduInfoIndEndIdxOfIPduGroupInfoType 0 0 0 255 ECU_ADDRESS 0x0 /end MEASUREMENT
/begin MEASUREMENT Com_IPduGroupInfo[2].RxPduInfoIndStartIdxOfIPduGroupInfo "" UBYTE Com_RxPduInfoIndStartIdxOfIPduGroupInfoType 0 0 0 255 ECU_ADDRESS 0x0 /end MEASUREMENT
/begin MEASUREMENT Com_IPduGroupInfo[2].TxPduInfoIndEndIdxOfIPduGroupInfo "" UBYTE Com_TxPduInfoIndEndIdxOfIPduGroupInfoType 0 0 0 255 ECU_ADDRESS 0x0 /end MEASUREMENT
/begin MEASUREMENT Com_IPduGroupInfo[2].TxPduInfoIndStartIdxOfIPduGroupInfo "" UBYTE Com_TxPduInfoIndStartIdxOfIPduGroupInfoType 0 0 0 255 ECU_ADDRESS 0x0 /end MEASUREMENT
/begin MEASUREMENT Com_IPduGroupInfo[3].IPduGroupInfoToSubIPduGroupsIndStartIdxOfIPduGroupInfo "" UBYTE Com_IPduGroupInfoToSubIPduGroupsIndStartIdxOfIPduGroupInfoType 0 0 0 255 ECU_ADDRESS 0x0 /end MEASUREMENT
/begin MEASUREMENT Com_IPduGroupInfo[3].PartitionsRxStructIdxOfIPduGroupInfo "" UBYTE Com_PartitionsRxStructIdxOfIPduGroupInfoType 0 0 0 255 ECU_ADDRESS 0x0 /end MEASUREMENT
/begin MEASUREMENT Com_IPduGroupInfo[3].PartitionsTxStructIdxOfIPduGroupInfo "" UBYTE Com_PartitionsTxStructIdxOfIPduGroupInfoType 0 0 0 255 ECU_ADDRESS 0x0 /end MEASUREMENT
/begin MEASUREMENT Com_IPduGroupInfo[3].RxPduInfoIndEndIdxOfIPduGroupInfo "" UBYTE Com_RxPduInfoIndEndIdxOfIPduGroupInfoType 0 0 0 255 ECU_ADDRESS 0x0 /end MEASUREMENT
/begin MEASUREMENT Com_IPduGroupInfo[3].RxPduInfoIndStartIdxOfIPduGroupInfo "" UBYTE Com_RxPduInfoIndStartIdxOfIPduGroupInfoType 0 0 0 255 ECU_ADDRESS 0x0 /end MEASUREMENT
/begin MEASUREMENT Com_IPduGroupInfo[3].TxPduInfoIndEndIdxOfIPduGroupInfo "" UBYTE Com_TxPduInfoIndEndIdxOfIPduGroupInfoType 0 0 0 255 ECU_ADDRESS 0x0 /end MEASUREMENT
/begin MEASUREMENT Com_IPduGroupInfo[3].TxPduInfoIndStartIdxOfIPduGroupInfo "" UBYTE Com_TxPduInfoIndStartIdxOfIPduGroupInfoType 0 0 0 255 ECU_ADDRESS 0x0 /end MEASUREMENT
/begin MEASUREMENT Com_IPduGroupInfo[4].IPduGroupInfoToSubIPduGroupsIndStartIdxOfIPduGroupInfo "" UBYTE Com_IPduGroupInfoToSubIPduGroupsIndStartIdxOfIPduGroupInfoType 0 0 0 255 ECU_ADDRESS 0x0 /end MEASUREMENT
/begin MEASUREMENT Com_IPduGroupInfo[4].PartitionsRxStructIdxOfIPduGroupInfo "" UBYTE Com_PartitionsRxStructIdxOfIPduGroupInfoType 0 0 0 255 ECU_ADDRESS 0x0 /end MEASUREMENT
/begin MEASUREMENT Com_IPduGroupInfo[4].PartitionsTxStructIdxOfIPduGroupInfo "" UBYTE Com_PartitionsTxStructIdxOfIPduGroupInfoType 0 0 0 255 ECU_ADDRESS 0x0 /end MEASUREMENT
/begin MEASUREMENT Com_IPduGroupInfo[4].RxPduInfoIndEndIdxOfIPduGroupInfo "" UBYTE Com_RxPduInfoIndEndIdxOfIPduGroupInfoType 0 0 0 255 ECU_ADDRESS 0x0 /end MEASUREMENT
/begin MEASUREMENT Com_IPduGroupInfo[4].RxPduInfoIndStartIdxOfIPduGroupInfo "" UBYTE Com_RxPduInfoIndStartIdxOfIPduGroupInfoType 0 0 0 255 ECU_ADDRESS 0x0 /end MEASUREMENT
/begin MEASUREMENT Com_IPduGroupInfo[4].TxPduInfoIndEndIdxOfIPduGroupInfo "" UBYTE Com_TxPduInfoIndEndIdxOfIPduGroupInfoType 0 0 0 255 ECU_ADDRESS 0x0 /end MEASUREMENT
/begin MEASUREMENT Com_IPduGroupInfo[4].TxPduInfoIndStartIdxOfIPduGroupInfo "" UBYTE Com_TxPduInfoIndStartIdxOfIPduGroupInfoType 0 0 0 255 ECU_ADDRESS 0x0 /end MEASUREMENT
/begin MEASUREMENT Com_IPduGroupInfo[5].IPduGroupInfoToSubIPduGroupsIndStartIdxOfIPduGroupInfo "" UBYTE Com_IPduGroupInfoToSubIPduGroupsIndStartIdxOfIPduGroupInfoType 0 0 0 255 ECU_ADDRESS 0x0 /end MEASUREMENT
/begin MEASUREMENT Com_IPduGroupInfo[5].PartitionsRxStructIdxOfIPduGroupInfo "" UBYTE Com_PartitionsRxStructIdxOfIPduGroupInfoType 0 0 0 255 ECU_ADDRESS 0x0 /end MEASUREMENT
/begin MEASUREMENT Com_IPduGroupInfo[5].PartitionsTxStructIdxOfIPduGroupInfo "" UBYTE Com_PartitionsTxStructIdxOfIPduGroupInfoType 0 0 0 255 ECU_ADDRESS 0x0 /end MEASUREMENT
/begin MEASUREMENT Com_IPduGroupInfo[5].RxPduInfoIndEndIdxOfIPduGroupInfo "" UBYTE Com_RxPduInfoIndEndIdxOfIPduGroupInfoType 0 0 0 255 ECU_ADDRESS 0x0 /end MEASUREMENT
/begin MEASUREMENT Com_IPduGroupInfo[5].RxPduInfoIndStartIdxOfIPduGroupInfo "" UBYTE Com_RxPduInfoIndStartIdxOfIPduGroupInfoType 0 0 0 255 ECU_ADDRESS 0x0 /end MEASUREMENT
/begin MEASUREMENT Com_IPduGroupInfo[5].TxPduInfoIndEndIdxOfIPduGroupInfo "" UBYTE Com_TxPduInfoIndEndIdxOfIPduGroupInfoType 0 0 0 255 ECU_ADDRESS 0x0 /end MEASUREMENT
/begin MEASUREMENT Com_IPduGroupInfo[5].TxPduInfoIndStartIdxOfIPduGroupInfo "" UBYTE Com_TxPduInfoIndStartIdxOfIPduGroupInfoType 0 0 0 255 ECU_ADDRESS 0x0 /end MEASUREMENT
/begin MEASUREMENT Com_IPduGroupInfo[6].IPduGroupInfoToSubIPduGroupsIndStartIdxOfIPduGroupInfo "" UBYTE Com_IPduGroupInfoToSubIPduGroupsIndStartIdxOfIPduGroupInfoType 0 0 0 255 ECU_ADDRESS 0x0 /end MEASUREMENT
/begin MEASUREMENT Com_IPduGroupInfo[6].PartitionsRxStructIdxOfIPduGroupInfo "" UBYTE Com_PartitionsRxStructIdxOfIPduGroupInfoType 0 0 0 255 ECU_ADDRESS 0x0 /end MEASUREMENT
/begin MEASUREMENT Com_IPduGroupInfo[6].PartitionsTxStructIdxOfIPduGroupInfo "" UBYTE Com_PartitionsTxStructIdxOfIPduGroupInfoType 0 0 0 255 ECU_ADDRESS 0x0 /end MEASUREMENT
/begin MEASUREMENT Com_IPduGroupInfo[6].RxPduInfoIndEndIdxOfIPduGroupInfo "" UBYTE Com_RxPduInfoIndEndIdxOfIPduGroupInfoType 0 0 0 255 ECU_ADDRESS 0x0 /end MEASUREMENT
/begin MEASUREMENT Com_IPduGroupInfo[6].RxPduInfoIndStartIdxOfIPduGroupInfo "" UBYTE Com_RxPduInfoIndStartIdxOfIPduGroupInfoType 0 0 0 255 ECU_ADDRESS 0x0 /end MEASUREMENT
/begin MEASUREMENT Com_IPduGroupInfo[6].TxPduInfoIndEndIdxOfIPduGroupInfo "" UBYTE Com_TxPduInfoIndEndIdxOfIPduGroupInfoType 0 0 0 255 ECU_ADDRESS 0x0 /end MEASUREMENT
/begin MEASUREMENT Com_IPduGroupInfo[6].TxPduInfoIndStartIdxOfIPduGroupInfo "" UBYTE Com_TxPduInfoIndStartIdxOfIPduGroupInfoType 0 0 0 255 ECU_ADDRESS 0x0 /end MEASUREMENT
/begin MEASUREMENT Com_IPduGroupInfo[7].IPduGroupInfoToSubIPduGroupsIndStartIdxOfIPduGroupInfo "" UBYTE Com_IPduGroupInfoToSubIPduGroupsIndStartIdxOfIPduGroupInfoType 0 0 0 255 ECU_ADDRESS 0x0 /end MEASUREMENT
/begin MEASUREMENT Com_IPduGroupInfo[7].PartitionsRxStructIdxOfIPduGroupInfo "" UBYTE Com_PartitionsRxStructIdxOfIPduGroupInfoType 0 0 0 255 ECU_ADDRESS 0x0 /end MEASUREMENT
/begin MEASUREMENT Com_IPduGroupInfo[7].PartitionsTxStructIdxOfIPduGroupInfo "" UBYTE Com_PartitionsTxStructIdxOfIPduGroupInfoType 0 0 0 255 ECU_ADDRESS 0x0 /end MEASUREMENT
/begin MEASUREMENT Com_IPduGroupInfo[7].RxPduInfoIndEndIdxOfIPduGroupInfo "" UBYTE Com_RxPduInfoIndEndIdxOfIPduGroupInfoType 0 0 0 255 ECU_ADDRESS 0x0 /end MEASUREMENT
/begin MEASUREMENT Com_IPduGroupInfo[7].RxPduInfoIndStartIdxOfIPduGroupInfo "" UBYTE Com_RxPduInfoIndStartIdxOfIPduGroupInfoType 0 0 0 255 ECU_ADDRESS 0x0 /end MEASUREMENT
/begin MEASUREMENT Com_IPduGroupInfo[7].TxPduInfoIndEndIdxOfIPduGroupInfo "" UBYTE Com_TxPduInfoIndEndIdxOfIPduGroupInfoType 0 0 0 255 ECU_ADDRESS 0x0 /end MEASUREMENT
/begin MEASUREMENT Com_IPduGroupInfo[7].TxPduInfoIndStartIdxOfIPduGroupInfo "" UBYTE Com_TxPduInfoIndStartIdxOfIPduGroupInfoType 0 0 0 255 ECU_ADDRESS 0x0 /end MEASUREMENT
/begin MEASUREMENT Com_IPduGroupInfo[8].IPduGroupInfoToSubIPduGroupsIndStartIdxOfIPduGroupInfo "" UBYTE Com_IPduGroupInfoToSubIPduGroupsIndStartIdxOfIPduGroupInfoType 0 0 0 255 ECU_ADDRESS 0x0 /end MEASUREMENT
/begin MEASUREMENT Com_IPduGroupInfo[8].PartitionsRxStructIdxOfIPduGroupInfo "" UBYTE Com_PartitionsRxStructIdxOfIPduGroupInfoType 0 0 0 255 ECU_ADDRESS 0x0 /end MEASUREMENT
/begin MEASUREMENT Com_IPduGroupInfo[8].PartitionsTxStructIdxOfIPduGroupInfo "" UBYTE Com_PartitionsTxStructIdxOfIPduGroupInfoType 0 0 0 255 ECU_ADDRESS 0x0 /end MEASUREMENT
/begin MEASUREMENT Com_IPduGroupInfo[8].RxPduInfoIndEndIdxOfIPduGroupInfo "" UBYTE Com_RxPduInfoIndEndIdxOfIPduGroupInfoType 0 0 0 255 ECU_ADDRESS 0x0 /end MEASUREMENT
/begin MEASUREMENT Com_IPduGroupInfo[8].RxPduInfoIndStartIdxOfIPduGroupInfo "" UBYTE Com_RxPduInfoIndStartIdxOfIPduGroupInfoType 0 0 0 255 ECU_ADDRESS 0x0 /end MEASUREMENT
/begin MEASUREMENT Com_IPduGroupInfo[8].TxPduInfoIndEndIdxOfIPduGroupInfo "" UBYTE Com_TxPduInfoIndEndIdxOfIPduGroupInfoType 0 0 0 255 ECU_ADDRESS 0x0 /end MEASUREMENT
/begin MEASUREMENT Com_IPduGroupInfo[8].TxPduInfoIndStartIdxOfIPduGroupInfo "" UBYTE Com_TxPduInfoIndStartIdxOfIPduGroupInfoType 0 0 0 255 ECU_ADDRESS 0x0 /end MEASUREMENT
/begin MEASUREMENT Com_IPduGroupInfo[9].IPduGroupInfoToSubIPduGroupsIndStartIdxOfIPduGroupInfo "" UBYTE Com_IPduGroupInfoToSubIPduGroupsIndStartIdxOfIPduGroupInfoType 0 0 0 255 ECU_ADDRESS 0x0 /end MEASUREMENT
/begin MEASUREMENT Com_IPduGroupInfo[9].PartitionsRxStructIdxOfIPduGroupInfo "" UBYTE Com_PartitionsRxStructIdxOfIPduGroupInfoType 0 0 0 255 ECU_ADDRESS 0x0 /end MEASUREMENT
/begin MEASUREMENT Com_IPduGroupInfo[9].PartitionsTxStructIdxOfIPduGroupInfo "" UBYTE Com_PartitionsTxStructIdxOfIPduGroupInfoType 0 0 0 255 ECU_ADDRESS 0x0 /end MEASUREMENT
/begin MEASUREMENT Com_IPduGroupInfo[9].RxPduInfoIndEndIdxOfIPduGroupInfo "" UBYTE Com_RxPduInfoIndEndIdxOfIPduGroupInfoType 0 0 0 255 ECU_ADDRESS 0x0 /end MEASUREMENT
/begin MEASUREMENT Com_IPduGroupInfo[9].RxPduInfoIndStartIdxOfIPduGroupInfo "" UBYTE Com_RxPduInfoIndStartIdxOfIPduGroupInfoType 0 0 0 255 ECU_ADDRESS 0x0 /end MEASUREMENT
/begin MEASUREMENT Com_IPduGroupInfo[9].TxPduInfoIndEndIdxOfIPduGroupInfo "" UBYTE Com_TxPduInfoIndEndIdxOfIPduGroupInfoType 0 0 0 255 ECU_ADDRESS 0x0 /end MEASUREMENT
/begin MEASUREMENT Com_IPduGroupInfo[9].TxPduInfoIndStartIdxOfIPduGroupInfo "" UBYTE Com_TxPduInfoIndStartIdxOfIPduGroupInfoType 0 0 0 255 ECU_ADDRESS 0x0 /end MEASUREMENT
/begin MEASUREMENT Com_IPduGroupState "" UBYTE Com_IPduGroupStateType 0 0 0 255 ECU_ADDRESS 0x0 MATRIX_DIM 19 /end MEASUREMENT
/begin MEASUREMENT Com_Initialized "Initialization state of Com. TRUE, if Com_Init() has been called, else FALSE." UBYTE Com_InitializedType 0 0 0 1 ECU_ADDRESS 0x0 /end MEASUREMENT
/begin MEASUREMENT Com_MainFunctionRxStruct[0].RxPduInfoOfMainFunctionRxIndStartIdxOfMainFunctionRxStruct "" UBYTE Com_RxPduInfoOfMainFunctionRxIndStartIdxOfMainFunctionRxStructType 0 0 0 255 ECU_ADDRESS 0x0 /end MEASUREMENT
/begin MEASUREMENT Com_MainFunctionRxStruct[0].RxTOutInfoOfMainFunctionRxIndStartIdxOfMainFunctionRxStruct "" UBYTE Com_RxTOutInfoOfMainFunctionRxIndStartIdxOfMainFunctionRxStructType 0 0 0 255 ECU_ADDRESS 0x0 /end MEASUREMENT
/begin MEASUREMENT Com_MainFunctionTxStruct[0].TxCyclicPduOfMainFunctionTxIndStartIdxOfMainFunctionTxStruct "" UBYTE Com_TxCyclicPduOfMainFunctionTxIndStartIdxOfMainFunctionTxStructType 0 0 0 255 ECU_ADDRESS 0x0 /end MEASUREMENT
/begin MEASUREMENT Com_MainFunctionTxStruct[0].TxPduInfoOfMainFunctionTxIndStartIdxOfMainFunctionTxStruct "" UBYTE Com_TxPduInfoOfMainFunctionTxIndStartIdxOfMainFunctionTxStructType 0 0 0 255 ECU_ADDRESS 0x0 /end MEASUREMENT
/begin MEASUREMENT Com_MainFunctionTxStruct[0].TxTOutInfoOfMainFunctionTxIndStartIdxOfMainFunctionTxStruct "" UBYTE Com_TxTOutInfoOfMainFunctionTxIndStartIdxOfMainFunctionTxStructType 0 0 0 255 ECU_ADDRESS 0x0 /end MEASUREMENT
/begin MEASUREMENT Com_RxAccessInfoInd "the indexes of the 1:1 sorted relation pointing to Com_RxAccessInfo" UWORD NO_COMPU_METHOD 0 0 0 65535 ECU_ADDRESS 0x0 MATRIX_DIM 513 /end MEASUREMENT
/begin MEASUREMENT Com_RxAccessInfo[0].ApplTypeOfRxAccessInfo "" UBYTE Com_ApplTypeOfRxAccessInfoType 0 0 0 255 ECU_ADDRESS 0x0 /end MEASUREMENT
/begin MEASUREMENT Com_RxAccessInfo[0].BitLengthOfRxAccessInfo "" UWORD NO_COMPU_METHOD 0 0 0 65535 ECU_ADDRESS 0x0 /end MEASUREMENT
/begin MEASUREMENT Com_RxAccessInfo[0].BitPositionOfRxAccessInfo "" UWORD NO_COMPU_METHOD 0 0 0 65535 ECU_ADDRESS 0x0 /end MEASUREMENT
/begin MEASUREMENT Com_RxAccessInfo[0].BufferIdxOfRxAccessInfo "" UWORD Com_BufferIdxOfRxAccessInfoType 0 0 0 65535 ECU_ADDRESS 0x0 /end MEASUREMENT
/begin MEASUREMENT Com_RxAccessInfo[0].BusAccOfRxAccessInfo "" UBYTE Com_BusAccOfRxAccessInfoType 0 0 0 255 ECU_ADDRESS 0x0 /end MEASUREMENT
/begin MEASUREMENT Com_RxAccessInfo[0].ByteLengthOfRxAccessInfo "" UBYTE NO_COMPU_METHOD 0 0 0 255 ECU_ADDRESS 0x0 /end MEASUREMENT
/begin MEASUREMENT Com_RxAccessInfo[0].ConstValueArrayBasedInitValueEndIdxOfRxAccessInfo "" UBYTE Com_ConstValueArrayBasedInitValueEndIdxOfRxAccessInfoType 0 0 0 255 ECU_ADDRESS 0x0 /end MEASUREMENT
/begin MEASUREMENT Com_RxAccessInfo[0].ConstValueArrayBasedInitValueStartIdxOfRxAccessInfo "" UBYTE Com_ConstValueArrayBasedInitValueStartIdxOfRxAccessInfoType 0 0 0 255 ECU_ADDRESS 0x0 /end MEASUREMENT
/begin MEASUREMENT Com_RxAccessInfo[0].DynSignalOfRxAccessInfo "" UBYTE Com_DynSignalOfRxAccessInfoType 0 0 0 1 ECU_ADDRESS 0x0 /end MEASUREMENT
/begin MEASUREMENT Com_RxAccessInfo[0].InitValueIdxOfRxAccessInfo "" UBYTE Com_InitValueIdxOfRxAccessInfoType 0 0 0 255 ECU_ADDRESS 0x0 /end MEASUREMENT
/begin MEASUREMENT Com_RxAccessInfo[0].InitValueOfRxAccessInfo "" UBYTE Com_InitValueOfRxAccessInfoType 0 0 0 255 ECU_ADDRESS 0x0 /end MEASUREMENT
/begin MEASUREMENT Com_RxAccessInfo[0].InvValueIdxOfRxAccessInfo "" UBYTE Com_InvValueIdxOfRxAccessInfoType 0 0 0 255 ECU_ADDRESS 0x0 /end MEASUREMENT
/begin MEASUREMENT Com_RxAccessInfo[0].InvValueOfRxAccessInfo "" UBYTE Com_InvValueOfRxAccessInfoType 0 0 0 255 ECU_ADDRESS 0x0 /end MEASUREMENT
/begin MEASUREMENT Com_RxAccessInfo[0].IsGroupSignalOfRxAccessInfo "" UBYTE Com_IsGroupSignalOfRxAccessInfoType 0 0 0 1 ECU_ADDRESS 0x0 /end MEASUREMENT
/begin MEASUREMENT Com_RxAccessInfo[0].RxDataTimeoutSubstitutionValueIdxOfRxAccessInfo "" UBYTE Com_RxDataTimeoutSubstitutionValueIdxOfRxAccessInfoType 0 0 0 255 ECU_ADDRESS 0x0 /end MEASUREMENT
/begin MEASUREMENT Com_RxAccessInfo[0].RxDataTimeoutSubstitutionValueOfRxAccessInfo "" UBYTE Com_RxDataTimeoutSubstitutionValueOfRxAccessInfoType 0 0 0 255 ECU_ADDRESS 0x0 /end MEASUREMENT
/begin MEASUREMENT Com_RxAccessInfo[0].RxPduInfoIdxOfRxAccessInfo "" UBYTE NO_COMPU_METHOD 0 0 0 255 ECU_ADDRESS 0x0 /end MEASUREMENT
/begin MEASUREMENT Com_RxAccessInfo[0].RxSigBufferArrayBasedBufferEndIdxOfRxAccessInfo "" UBYTE Com_RxSigBufferArrayBasedBufferEndIdxOfRxAccessInfoType 0 0 0 255 ECU_ADDRESS 0x0 /end MEASUREMENT
/begin MEASUREMENT Com_RxAccessInfo[0].RxSigBufferArrayBasedBufferStartIdxOfRxAccessInfo "" UBYTE Com_RxSigBufferArrayBasedBufferStartIdxOfRxAccessInfoType 0 0 0 255 ECU_ADDRESS 0x0 /end MEASUREMENT
/begin MEASUREMENT Com_RxAccessInfo[0].RxSigBufferArrayBasedShdBufferEndIdxOfRxAccessInfo "" UBYTE Com_RxSigBufferArrayBasedShdBufferEndIdxOfRxAccessInfoType 0 0 0 255 ECU_ADDRESS 0x0 /end MEASUREMENT
/begin MEASUREMENT Com_RxAccessInfo[0].RxSigBufferArrayBasedShdBufferStartIdxOfRxAccessInfo "" UBYTE Com_RxSigBufferArrayBasedShdBufferStartIdxOfRxAccessInfoType 0 0 0 255 ECU_ADDRESS 0x0 /end MEASUREMENT
/begin MEASUREMENT Com_RxAccessInfo[0].RxTOutInfoIdxOfRxAccessInfo "" UBYTE Com_RxTOutInfoIdxOfRxAccessInfoType 0 0 0 255 ECU_ADDRESS 0x0 /end MEASUREMENT
/begin MEASUREMENT Com_RxAccessInfo[0].ShdBufferIdxOfRxAccessInfo "" UWORD Com_ShdBufferIdxOfRxAccessInfoType 0 0 0 65535 ECU_ADDRESS 0x0 /end MEASUREMENT
/begin MEASUREMENT Com_RxAccessInfo[0].SignalLengthInByteOfRxAccessInfo "" UBYTE NO_COMPU_METHOD 0 0 0 255 ECU_ADDRESS 0x0 /end MEASUREMENT
/begin MEASUREMENT Com_RxAccessInfo[0].StartByteInPduPositionOfRxAccessInfo "" UBYTE NO_COMPU_METHOD 0 0 0 255 ECU_ADDRESS 0x0 /end MEASUREMENT
/begin MEASUREMENT Com_RxAccessInfo[0].TmpBufferIdxOfRxAccessInfo "" UBYTE Com_TmpBufferIdxOfRxAccessInfoType 0 0 0 255 ECU_ADDRESS 0x0 /end MEASUREMENT
/begin MEASUREMENT Com_RxAccessInfo[0].TmpBufferOfRxAccessInfo "" UBYTE Com_TmpBufferOfRxAccessInfoType 0 0 0 255 ECU_ADDRESS 0x0 /end MEASUREMENT
/begin MEASUREMENT Com_RxAccessInfo[0].TmpRxShdBufferArrayBasedTmpBufferEndIdxOfRxAccessInfo "" UBYTE Com_TmpRxShdBufferArrayBasedTmpBufferEndIdxOfRxAccessInfoType 0 0 0 255 ECU_ADDRESS 0x0 /end MEASUREMENT
/begin MEASUREMENT Com_RxAccessInfo[0].TmpRxShdBufferArrayBasedTmpBufferStartIdxOfRxAccessInfo "" UBYTE Com_TmpRxShdBufferArrayBasedTmpBufferStartIdxOfRxAccessInfoType 0 0 0 255 ECU_ADDRESS 0x0 /end MEASUREMENT
/begin MEASUREMENT Com_RxAccessInfo[100].ApplTypeOfRxAccessInfo "" UBYTE Com_ApplTypeOfRxAccessInfoType 0 0 0 255 ECU_ADDRESS 0x0 /end MEASUREMENT
/begin MEASUREMENT Com_RxAccessInfo[100].BitLengthOfRxAccessInfo "" UWORD NO_COMPU_METHOD 0 0 0 65535 ECU_ADDRESS 0x0 /end MEASUREMENT
/begin MEASUREMENT Com_RxAccessInfo[100].BitPositionOfRxAccessInfo "" UWORD NO_COMPU_METHOD 0 0 0 65535 ECU_ADDRESS 0x0 /end MEASUREMENT
/begin MEASUREMENT Com_RxAccessInfo[100].BufferIdxOfRxAccessInfo "" UWORD Com_BufferIdxOfRxAccessInfoType 0 0 0 65535 ECU_ADDRESS 0x0 /end MEASUREMENT
/begin MEASUREMENT Com_RxAccessInfo[100].BusAccOfRxAccessInfo "" UBYTE Com_BusAccOfRxAccessInfoType 0 0 0 255 ECU_ADDRESS 0x0 /end MEASUREMENT
/begin MEASUREMENT Com_RxAccessInfo[100].ByteLengthOfRxAccessInfo "" UBYTE NO_COMPU_METHOD 0 0 0 255 ECU_ADDRESS 0x0 /end MEASUREMENT
/begin MEASUREMENT Com_RxAccessInfo[100].ConstValueArrayBasedInitValueEndIdxOfRxAccessInfo "" UBYTE Com_ConstValueArrayBasedInitValueEndIdxOfRxAccessInfoType 0 0 0 255 ECU_ADDRESS 0x0 /end MEASUREMENT
/begin MEASUREMENT Com_RxAccessInfo[100].ConstValueArrayBasedInitValueStartIdxOfRxAccessInfo "" UBYTE Com_ConstValueArrayBasedInitValueStartIdxOfRxAccessInfoType 0 0 0 255 ECU_ADDRESS 0x0 /end MEASUREMENT
/begin MEASUREMENT Com_RxAccessInfo[100].DynSignalOfRxAccessInfo "" UBYTE Com_DynSignalOfRxAccessInfoType 0 0 0 1 ECU_ADDRESS 0x0 /end MEASUREMENT
/begin MEASUREMENT Com_RxAccessInfo[100].InitValueIdxOfRxAccessInfo "" UBYTE Com_InitValueIdxOfRxAccessInfoType 0 0 0 255 ECU_ADDRESS 0x0 /end MEASUREMENT
/begin MEASUREMENT Com_RxAccessInfo[100].InitValueOfRxAccessInfo "" UBYTE Com_InitValueOfRxAccessInfoType 0 0 0 255 ECU_ADDRESS 0x0 /end MEASUREMENT
/begin MEASUREMENT Com_RxAccessInfo[100].InvValueIdxOfRxAccessInfo "" UBYTE Com_InvValueIdxOfRxAccessInfoType 0 0 0 255 ECU_ADDRESS 0x0 /end MEASUREMENT
/begin MEASUREMENT Com_RxAccessInfo[100].InvValueOfRxAccessInfo "" UBYTE Com_InvValueOfRxAccessInfoType 0 0 0 255 ECU_ADDRESS 0x0 /end MEASUREMENT
/begin MEASUREMENT Com_RxAccessInfo[100].IsGroupSignalOfRxAccessInfo "" UBYTE Com_IsGroupSignalOfRxAccessInfoType 0 0 0 1 ECU_ADDRESS 0x0 /end MEASUREMENT
/begin MEASUREMENT Com_RxAccessInfo[100].RxDataTimeoutSubstitutionValueIdxOfRxAccessInfo "" UBYTE Com_RxDataTimeoutSubstitutionValueIdxOfRxAccessInfoType 0 0 0 255 ECU_ADDRESS 0x0 /end MEASUREMENT
/begin MEASUREMENT Com_RxAccessInfo[100].RxDataTimeoutSubstitutionValueOfRxAccessInfo "" UBYTE Com_RxDataTimeoutSubstitutionValueOfRxAccessInfoType 0 0 0 255 ECU_ADDRESS 0x0 /end MEASUREMENT
/begin MEASUREMENT Com_RxAccessInfo[100].RxPduInfoIdxOfRxAccessInfo "" UBYTE NO_COMPU_METHOD 0 0 0 255 ECU_ADDRESS 0x0 /end MEASUREMENT
/begin MEASUREMENT Com_RxAccessInfo[100].RxSigBufferArrayBasedBufferEndIdxOfRxAccessInfo "" UBYTE Com_RxSigBufferArrayBasedBufferEndIdxOfRxAccessInfoType 0 0 0 255 ECU_ADDRESS 0x0 /end MEASUREMENT
/begin MEASUREMENT Com_RxAccessInfo[100].RxSigBufferArrayBasedBufferStartIdxOfRxAccessInfo "" UBYTE Com_RxSigBufferArrayBasedBufferStartIdxOfRxAccessInfoType 0 0 0 255 ECU_ADDRESS 0x0 /end MEASUREMENT
/begin MEASUREMENT Com_RxAccessInfo[100].RxSigBufferArrayBasedShdBufferEndIdxOfRxAccessInfo "" UBYTE Com_RxSigBufferArrayBasedShdBufferEndIdxOfRxAccessInfoType 0 0 0 255 ECU_ADDRESS 0x0 /end MEASUREMENT
/begin MEASUREMENT Com_RxAccessInfo[100].RxSigBufferArrayBasedShdBufferStartIdxOfRxAccessInfo "" UBYTE Com_RxSigBufferArrayBasedShdBufferStartIdxOfRxAccessInfoType 0 0 0 255 ECU_ADDRESS 0x0 /end MEASUREMENT
/begin MEASUREMENT Com_RxAccessInfo[100].RxTOutInfoIdxOfRxAccessInfo "" UBYTE Com_RxTOutInfoIdxOfRxAccessInfoType 0 0 0 255 ECU_ADDRESS 0x0 /end MEASUREMENT
/begin MEASUREMENT Com_RxAccessInfo[100].ShdBufferIdxOfRxAccessInfo "" UWORD Com_ShdBufferIdxOfRxAccessInfoType 0 0 0 65535 ECU_ADDRESS 0x0 /end MEASUREMENT
/begin MEASUREMENT Com_RxAccessInfo[100].SignalLengthInByteOfRxAccessInfo "" UBYTE NO_COMPU_METHOD 0 0 0 255 ECU_ADDRESS 0x0 /end MEASUREMENT
/begin MEASUREMENT Com_RxAccessInfo[100].StartByteInPduPositionOfRxAccessInfo "" UBYTE NO_COMPU_METHOD 0 0 0 255 ECU_ADDRESS 0x0 /end MEASUREMENT
/begin MEASUREMENT Com_RxAccessInfo[100].TmpBufferIdxOfRxAccessInfo "" UBYTE Com_TmpBufferIdxOfRxAccessInfoType 0 0 0 255 ECU_ADDRESS 0x0 /end MEASUREMENT
/begin MEASUREMENT Com_RxAccessInfo[100].TmpBufferOfRxAccessInfo "" UBYTE Com_TmpBufferOfRxAccessInfoType 0 0 0 255 ECU_ADDRESS 0x0 /end MEASUREMENT
/begin MEASUREMENT Com_RxAccessInfo[100].TmpRxShdBufferArrayBasedTmpBufferEndIdxOfRxAccessInfo "" UBYTE Com_TmpRxShdBufferArrayBasedTmpBufferEndIdxOfRxAccessInfoType 0 0 0 255 ECU_ADDRESS 0x0 /end MEASUREMENT
/begin MEASUREMENT Com_RxAccessInfo[100].TmpRxShdBufferArrayBasedTmpBufferStartIdxOfRxAccessInfo "" UBYTE Com_TmpRxShdBufferArrayBasedTmpBufferStartIdxOfRxAccessInfoType 0 0 0 255 ECU_ADDRESS 0x0 /end MEASUREMENT
/begin MEASUREMENT Com_RxAccessInfo[101].ApplTypeOfRxAccessInfo "" UBYTE Com_ApplTypeOfRxAccessInfoType 0 0 0 255 ECU_ADDRESS 0x0 /end MEASUREMENT
/begin MEASUREMENT Com_RxAccessInfo[101].BitLengthOfRxAccessInfo "" UWORD NO_COMPU_METHOD 0 0 0 65535 ECU_ADDRESS 0x0 /end MEASUREMENT
/begin MEASUREMENT Com_RxAccessInfo[101].BitPositionOfRxAccessInfo "" UWORD NO_COMPU_METHOD 0 0 0 65535 ECU_ADDRESS 0x0 /end MEASUREMENT
/begin MEASUREMENT Com_RxAccessInfo[101].BufferIdxOfRxAccessInfo "" UWORD Com_BufferIdxOfRxAccessInfoType 0 0 0 65535 ECU_ADDRESS 0x0 /end MEASUREMENT
/begin MEASUREMENT Com_RxAccessInfo[101].BusAccOfRxAccessInfo "" UBYTE Com_BusAccOfRxAccessInfoType 0 0 0 255 ECU_ADDRESS 0x0 /end MEASUREMENT
/begin MEASUREMENT Com_RxAccessInfo[101].ByteLengthOfRxAccessInfo "" UBYTE NO_COMPU_METHOD 0 0 0 255 ECU_ADDRESS 0x0 /end MEASUREMENT
/begin MEASUREMENT Com_RxAccessInfo[101].ConstValueArrayBasedInitValueEndIdxOfRxAccessInfo "" UBYTE Com_ConstValueArrayBasedInitValueEndIdxOfRxAccessInfoType 0 0 0 255 ECU_ADDRESS 0x0 /end MEASUREMENT
/begin MEASUREMENT Com_RxAccessInfo[101].ConstValueArrayBasedInitValueStartIdxOfRxAccessInfo "" UBYTE Com_ConstValueArrayBasedInitValueStartIdxOfRxAccessInfoType 0 0 0 255 ECU_ADDRESS 0x0 /end MEASUREMENT
/begin MEASUREMENT Com_RxAccessInfo[101].DynSignalOfRxAccessInfo "" UBYTE Com_DynSignalOfRxAccessInfoType 0 0 0 1 ECU_ADDRESS 0x0 /end MEASUREMENT
/begin MEASUREMENT Com_RxAccessInfo[101].InitValueIdxOfRxAccessInfo "" UBYTE Com_InitValueIdxOfRxAccessInfoType 0 0 0 255 ECU_ADDRESS 0x0 /end MEASUREMENT
/begin MEASUREMENT Com_RxAccessInfo[101].InitValueOfRxAccessInfo "" UBYTE Com_InitValueOfRxAccessInfoType 0 0 0 255 ECU_ADDRESS 0x0 /end MEASUREMENT
/begin MEASUREMENT Com_RxAccessInfo[101].InvValueIdxOfRxAccessInfo "" UBYTE Com_InvValueIdxOfRxAccessInfoType 0 0 0 255 ECU_ADDRESS 0x0 /end MEASUREMENT
/begin MEASUREMENT Com_RxAccessInfo[101].InvValueOfRxAccessInfo "" UBYTE Com_InvValueOfRxAccessInfoType 0 0 0 255 ECU_ADDRESS 0x0 /end MEASUREMENT
/begin MEASUREMENT Com_RxAccessInfo[101].IsGroupSignalOfRxAccessInfo "" UBYTE Com_IsGroupSignalOfRxAccessInfoType 0 0 0 1 ECU_ADDRESS 0x0 /end MEASUREMENT
/begin MEASUREMENT Com_RxAccessInfo[101].RxDataTimeoutSubstitutionValueIdxOfRxAccessInfo "" UBYTE Com_RxDataTimeoutSubstitutionValueIdxOfRxAccessInfoType 0 0 0 255 ECU_ADDRESS 0x0 /end MEASUREMENT
/begin MEASUREMENT Com_RxAccessInfo[101].RxDataTimeoutSubstitutionValueOfRxAccessInfo "" UBYTE Com_RxDataTimeoutSubstitutionValueOfRxAccessInfoType 0 0 0 255 ECU_ADDRESS 0x0 /end MEASUREMENT
/begin MEASUREMENT Com_RxAccessInfo[101].RxPduInfoIdxOfRxAccessInfo "" UBYTE NO_COMPU_METHOD 0 0 0 255 ECU_ADDRESS 0x0 /end MEASUREMENT
/begin MEASUREMENT Com_RxAccessInfo[101].RxSigBufferArrayBasedBufferEndIdxOfRxAccessInfo "" UBYTE Com_RxSigBufferArrayBasedBufferEndIdxOfRxAccessInfoType 0 0 0 255 ECU_ADDRESS 0x0 /end MEASUREMENT
/begin MEASUREMENT Com_RxAccessInfo[101].RxSigBufferArrayBasedBufferStartIdxOfRxAccessInfo "" UBYTE Com_RxSigBufferArrayBasedBufferStartIdxOfRxAccessInfoType 0 0 0 255 ECU_ADDRESS 0x0 /end MEASUREMENT
/begin MEASUREMENT Com_RxAccessInfo[101].RxSigBufferArrayBasedShdBufferEndIdxOfRxAccessInfo "" UBYTE Com_RxSigBufferArrayBasedShdBufferEndIdxOfRxAccessInfoType 0 0 0 255 ECU_ADDRESS 0x0 /end MEASUREMENT
/begin MEASUREMENT Com_RxAccessInfo[101].RxSigBufferArrayBasedShdBufferStartIdxOfRxAccessInfo "" UBYTE Com_RxSigBufferArrayBasedShdBufferStartIdxOfRxAccessInfoType 0 0 0 255 ECU_ADDRESS 0x0 /end MEASUREMENT
/begin MEASUREMENT Com_RxAccessInfo[101].RxTOutInfoIdxOfRxAccessInfo "" UBYTE Com_RxTOutInfoIdxOfRxAccessInfoType 0 0 0 255 ECU_ADDRESS 0x0 /end MEASUREMENT
/begin MEASUREMENT Com_RxAccessInfo[101].ShdBufferIdxOfRxAccessInfo "" UWORD Com_ShdBufferIdxOfRxAccessInfoType 0 0 0 65535 ECU_ADDRESS 0x0 /end MEASUREMENT
/begin MEASUREMENT Com_RxAccessInfo[101].SignalLengthInByteOfRxAccessInfo "" UBYTE NO_COMPU_METHOD 0 0 0 255 ECU_ADDRESS 0x0 /end MEASUREMENT
/begin MEASUREMENT Com_RxAccessInfo[101].StartByteInPduPositionOfRxAccessInfo "" UBYTE NO_COMPU_METHOD 0 0 0 255 ECU_ADDRESS 0x0 /end MEASUREMENT
/begin MEASUREMENT Com_RxAccessInfo[101].TmpBufferIdxOfRxAccessInfo "" UBYTE Com_TmpBufferIdxOfRxAccessInfoType 0 0 0 255 ECU_ADDRESS 0x0 /end MEASUREMENT
/begin MEASUREMENT Com_RxAccessInfo[101].TmpBufferOfRxAccessInfo "" UBYTE Com_TmpBufferOfRxAccessInfoType 0 0 0 255 ECU_ADDRESS 0x0 /end MEASUREMENT
/begin MEASUREMENT Com_RxAccessInfo[101].TmpRxShdBufferArrayBasedTmpBufferEndIdxOfRxAccessInfo "" UBYTE Com_TmpRxShdBufferArrayBasedTmpBufferEndIdxOfRxAccessInfoType 0 0 0 255 ECU_ADDRESS 0x0 /end MEASUREMENT
/begin MEASUREMENT Com_RxAccessInfo[101].TmpRxShdBufferArrayBasedTmpBufferStartIdxOfRxAccessInfo "" UBYTE Com_TmpRxShdBufferArrayBasedTmpBufferStartIdxOfRxAccessInfoType 0 0 0 255 ECU_ADDRESS 0x0 /end MEASUREMENT
/begin MEASUREMENT Com_RxAccessInfo[102].ApplTypeOfRxAccessInfo "" UBYTE Com_ApplTypeOfRxAccessInfoType 0 0 0 255 ECU_ADDRESS 0x0 /end MEASUREMENT
/begin MEASUREMENT Com_RxAccessInfo[102].BitLengthOfRxAccessInfo "" UWORD NO_COMPU_METHOD 0 0 0 65535 ECU_ADDRESS 0x0 /end MEASUREMENT
/begin MEASUREMENT Com_RxAccessInfo[102].BitPositionOfRxAccessInfo "" UWORD NO_COMPU_METHOD 0 0 0 65535 ECU_ADDRESS 0x0 /end MEASUREMENT
/begin MEASUREMENT Com_RxAccessInfo[102].BufferIdxOfRxAccessInfo "" UWORD Com_BufferIdxOfRxAccessInfoType 0 0 0 65535 ECU_ADDRESS 0x0 /end MEASUREMENT
/begin MEASUREMENT Com_RxAccessInfo[102].BusAccOfRxAccessInfo "" UBYTE Com_BusAccOfRxAccessInfoType 0 0 0 255 ECU_ADDRESS 0x0 /end MEASUREMENT
/begin MEASUREMENT Com_RxAccessInfo[102].ByteLengthOfRxAccessInfo "" UBYTE NO_COMPU_METHOD 0 0 0 255 ECU_ADDRESS 0x0 /end MEASUREMENT
/begin MEASUREMENT Com_RxAccessInfo[102].ConstValueArrayBasedInitValueEndIdxOfRxAccessInfo "" UBYTE Com_ConstValueArrayBasedInitValueEndIdxOfRxAccessInfoType 0 0 0 255 ECU_ADDRESS 0x0 /end MEASUREMENT
/begin MEASUREMENT Com_RxAccessInfo[102].ConstValueArrayBasedInitValueStartIdxOfRxAccessInfo "" UBYTE Com_ConstValueArrayBasedInitValueStartIdxOfRxAccessInfoType 0 0 0 255 ECU_ADDRESS 0x0 /end MEASUREMENT
/begin MEASUREMENT Com_RxAccessInfo[102].DynSignalOfRxAccessInfo "" UBYTE Com_DynSignalOfRxAccessInfoType 0 0 0 1 ECU_ADDRESS 0x0 /end MEASUREMENT
/begin MEASUREMENT Com_RxAccessInfo[102].InitValueIdxOfRxAccessInfo "" UBYTE Com_InitValueIdxOfRxAccessInfoType 0 0 0 255 ECU_ADDRESS 0x0 /end MEASUREMENT
/begin MEASUREMENT Com_RxAccessInfo[102].InitValueOfRxAccessInfo "" UBYTE Com_InitValueOfRxAccessInfoType 0 0 0 255 ECU_ADDRESS 0x0 /end MEASUREMENT
/begin MEASUREMENT Com_RxAccessInfo[102].InvValueIdxOfRxAccessInfo "" UBYTE Com_InvValueIdxOfRxAccessInfoType 0 0 0 255 ECU_ADDRESS 0x0 /end MEASUREMENT
/begin MEASUREMENT Com_RxAccessInfo[102].InvValueOfRxAccessInfo "" UBYTE Com_InvValueOfRxAccessInfoType 0 0 0 255 ECU_ADDRESS 0x0 /end MEASUREMENT
/begin MEASUREMENT Com_RxAccessInfo[102].IsGroupSignalOfRxAccessInfo "" UBYTE Com_IsGroupSignalOfRxAccessInfoType 0 0 0 1 ECU_ADDRESS 0x0 /end MEASUREMENT
/begin MEASUREMENT Com_RxAccessInfo[102].RxDataTimeoutSubstitutionValueIdxOfRxAccessInfo "" UBYTE Com_RxDataTimeoutSubstitutionValueIdxOfRxAccessInfoType 0 0 0 255 ECU_ADDRESS 0x0 /end MEASUREMENT
/begin MEASUREMENT Com_RxAccessInfo[102].RxDataTimeoutSubstitutionValueOfRxAccessInfo "" UBYTE Com_RxDataTimeoutSubstitutionValueOfRxAccessInfoType 0 0 0 255 ECU_ADDRESS 0x0 /end MEASUREMENT
/begin MEASUREMENT Com_RxAccessInfo[102].RxPduInfoIdxOfRxAccessInfo "" UBYTE NO_COMPU_METHOD 0 0 0 255 ECU_ADDRESS 0x0 /end MEASUREMENT
/begin MEASUREMENT Com_RxAccessInfo[102].RxSigBufferArrayBasedBufferEndIdxOfRxAccessInfo "" UBYTE Com_RxSigBufferArrayBasedBufferEndIdxOfRxAccessInfoType 0 0 0 255 ECU_ADDRESS 0x0 /end MEASUREMENT
/begin MEASUREMENT Com_RxAccessInfo[102].RxSigBufferArrayBasedBufferStartIdxOfRxAccessInfo "" UBYTE Com_RxSigBufferArrayBasedBufferStartIdxOfRxAccessInfoType 0 0 0 255 ECU_ADDRESS 0x0 /end MEASUREMENT
/begin MEASUREMENT Com_RxAccessInfo[102].RxSigBufferArrayBasedShdBufferEndIdxOfRxAccessInfo "" UBYTE Com_RxSigBufferArrayBasedShdBufferEndIdxOfRxAccessInfoType 0 0 0 255 ECU_ADDRESS 0x0 /end MEASUREMENT
/begin MEASUREMENT Com_RxAccessInfo[102].RxSigBufferArrayBasedShdBufferStartIdxOfRxAccessInfo "" UBYTE Com_RxSigBufferArrayBasedShdBufferStartIdxOfRxAccessInfoType 0 0 0 255 ECU_ADDRESS 0x0 /end MEASUREMENT
/begin MEASUREMENT Com_RxAccessInfo[102].RxTOutInfoIdxOfRxAccessInfo "" UBYTE Com_RxTOutInfoIdxOfRxAccessInfoType 0 0 0 255 ECU_ADDRESS 0x0 /end MEASUREMENT
/begin MEASUREMENT Com_RxAccessInfo[102].ShdBufferIdxOfRxAccessInfo "" UWORD Com_ShdBufferIdxOfRxAccessInfoType 0 0 0 65535 ECU_ADDRESS 0x0 /end MEASUREMENT
/begin MEASUREMENT Com_RxAccessInfo[102].SignalLengthInByteOfRxAccessInfo "" UBYTE NO_COMPU_METHOD 0 0 0 255 ECU_ADDRESS 0x0 /end MEASUREMENT
/begin MEASUREMENT Com_RxAccessInfo[102].StartByteInPduPositionOfRxAccessInfo "" UBYTE NO_COMPU_METHOD 0 0 0 255 ECU_ADDRESS 0x0 /end MEASUREMENT
/begin MEASUREMENT Com_RxAccessInfo[102].TmpBufferIdxOfRxAccessInfo "" UBYTE Com_TmpBufferIdxOfRxAccessInfoType 0 0 0 255 ECU_ADDRESS 0x0 /end MEASUREMENT
/begin MEASUREMENT Com_RxAccessInfo[102].TmpBufferOfRxAccessInfo "" UBYTE Com_TmpBufferOfRxAccessInfoType 0 0 0 255 ECU_ADDRESS 0x0 /end MEASUREMENT
/begin MEASUREMENT Com_RxAccessInfo[102].TmpRxShdBufferArrayBasedTmpBufferEndIdxOfRxAccessInfo "" UBYTE Com_TmpRxShdBufferArrayBasedTmpBufferEndIdxOfRxAccessInfoType 0 0 0 255 ECU_ADDRESS 0x0 /end MEASUREMENT
/begin MEASUREMENT Com_RxAccessInfo[102].TmpRxShdBufferArrayBasedTmpBufferStartIdxOfRxAccessInfo "" UBYTE Com_TmpRxShdBufferArrayBasedTmpBufferStartIdxOfRxAccessInfoType 0 0 0 255 ECU_ADDRESS 0x0 /end MEASUREMENT
/begin MEASUREMENT Com_RxAccessInfo[103].ApplTypeOfRxAccessInfo "" UBYTE Com_ApplTypeOfRxAccessInfoType 0 0 0 255 ECU_ADDRESS 0x0 /end MEASUREMENT
/begin MEASUREMENT Com_RxAccessInfo[103].BitLengthOfRxAccessInfo "" UWORD NO_COMPU_METHOD 0 0 0 65535 ECU_ADDRESS 0x0 /end MEASUREMENT
/begin MEASUREMENT Com_RxAccessInfo[103].BitPositionOfRxAccessInfo "" UWORD NO_COMPU_METHOD 0 0 0 65535 ECU_ADDRESS 0x0 /end MEASUREMENT
/begin MEASUREMENT Com_RxAccessInfo[103].BufferIdxOfRxAccessInfo "" UWORD Com_BufferIdxOfRxAccessInfoType 0 0 0 65535 ECU_ADDRESS 0x0 /end MEASUREMENT
/begin MEASUREMENT Com_RxAccessInfo[103].BusAccOfRxAccessInfo "" UBYTE Com_BusAccOfRxAccessInfoType 0 0 0 255 ECU_ADDRESS 0x0 /end MEASUREMENT
/begin MEASUREMENT Com_RxAccessInfo[103].ByteLengthOfRxAccessInfo "" UBYTE NO_COMPU_METHOD 0 0 0 255 ECU_ADDRESS 0x0 /end MEASUREMENT
/begin MEASUREMENT Com_RxAccessInfo[103].ConstValueArrayBasedInitValueEndIdxOfRxAccessInfo "" UBYTE Com_ConstValueArrayBasedInitValueEndIdxOfRxAccessInfoType 0 0 0 255 ECU_ADDRESS 0x0 /end MEASUREMENT
/begin MEASUREMENT Com_RxAccessInfo[103].ConstValueArrayBasedInitValueStartIdxOfRxAccessInfo "" UBYTE Com_ConstValueArrayBasedInitValueStartIdxOfRxAccessInfoType 0 0 0 255 ECU_ADDRESS 0x0 /end MEASUREMENT
/begin MEASUREMENT Com_RxAccessInfo[103].DynSignalOfRxAccessInfo "" UBYTE Com_DynSignalOfRxAccessInfoType 0 0 0 1 ECU_ADDRESS 0x0 /end MEASUREMENT
/begin MEASUREMENT Com_RxAccessInfo[103].InitValueIdxOfRxAccessInfo "" UBYTE Com_InitValueIdxOfRxAccessInfoType 0 0 0 255 ECU_ADDRESS 0x0 /end MEASUREMENT
/begin MEASUREMENT Com_RxAccessInfo[103].InitValueOfRxAccessInfo "" UBYTE Com_InitValueOfRxAccessInfoType 0 0 0 255 ECU_ADDRESS 0x0 /end MEASUREMENT
/begin MEASUREMENT Com_RxAccessInfo[103].InvValueIdxOfRxAccessInfo "" UBYTE Com_InvValueIdxOfRxAccessInfoType 0 0 0 255 ECU_ADDRESS 0x0 /end MEASUREMENT
/begin MEASUREMENT Com_RxAccessInfo[103].InvValueOfRxAccessInfo "" UBYTE Com_InvValueOfRxAccessInfoType 0 0 0 255 ECU_ADDRESS 0x0 /end MEASUREMENT
/begin MEASUREMENT Com_RxAccessInfo[103].IsGroupSignalOfRxAccessInfo "" UBYTE Com_IsGroupSignalOfRxAccessInfoType 0 0 0 1 ECU_ADDRESS 0x0 /end MEASUREMENT
/begin MEASUREMENT Com_RxAccessInfo[103].RxDataTimeoutSubstitutionValueIdxOfRxAccessInfo "" UBYTE Com_RxDataTimeoutSubstitutionValueIdxOfRxAccessInfoType 0 0 0 255 ECU_ADDRESS 0x0 /end MEASUREMENT
/begin MEASUREMENT Com_RxAccessInfo[103].RxDataTimeoutSubstitutionValueOfRxAccessInfo "" UBYTE Com_RxDataTimeoutSubstitutionValueOfRxAccessInfoType 0 0 0 255 ECU_ADDRESS 0x0 /end MEASUREMENT
/begin MEASUREMENT Com_RxAccessInfo[103].RxPduInfoIdxOfRxAccessInfo "" UBYTE NO_COMPU_METHOD 0 0 0 255 ECU_ADDRESS 0x0 /end MEASUREMENT
/begin MEASUREMENT Com_RxAccessInfo[103].RxSigBufferArrayBasedBufferEndIdxOfRxAccessInfo "" UBYTE Com_RxSigBufferArrayBasedBufferEndIdxOfRxAccessInfoType 0 0 0 255 ECU_ADDRESS 0x0 /end MEASUREMENT
/begin MEASUREMENT Com_RxAccessInfo[103].RxSigBufferArrayBasedBufferStartIdxOfRxAccessInfo "" UBYTE Com_RxSigBufferArrayBasedBufferStartIdxOfRxAccessInfoType 0 0 0 255 ECU_ADDRESS 0x0 /end MEASUREMENT
/begin MEASUREMENT Com_RxAccessInfo[103].RxSigBufferArrayBasedShdBufferEndIdxOfRxAccessInfo "" UBYTE Com_RxSigBufferArrayBasedShdBufferEndIdxOfRxAccessInfoType 0 0 0 255 ECU_ADDRESS 0x0 /end MEASUREMENT
/begin MEASUREMENT Com_RxAccessInfo[103].RxSigBufferArrayBasedShdBufferStartIdxOfRxAccessInfo "" UBYTE Com_RxSigBufferArrayBasedShdBufferStartIdxOfRxAccessInfoType 0 0 0 255 ECU_ADDRESS 0x0 /end MEASUREMENT
/begin MEASUREMENT Com_RxAccessInfo[103].RxTOutInfoIdxOfRxAccessInfo "" UBYTE Com_RxTOutInfoIdxOfRxAccessInfoType 0 0 0 255 ECU_ADDRESS 0x0 /end MEASUREMENT
/begin MEASUREMENT Com_RxAccessInfo[103].ShdBufferIdxOfRxAccessInfo "" UWORD Com_ShdBufferIdxOfRxAccessInfoType 0 0 0 65535 ECU_ADDRESS 0x0 /end MEASUREMENT
/begin MEASUREMENT Com_RxAccessInfo[103].SignalLengthInByteOfRxAccessInfo "" UBYTE NO_COMPU_METHOD 0 0 0 255 ECU_ADDRESS 0x0 /end MEASUREMENT
/begin MEASUREMENT Com_RxAccessInfo[103].StartByteInPduPositionOfRxAccessInfo "" UBYTE NO_COMPU_METHOD 0 0 0 255 ECU_ADDRESS 0x0 /end MEASUREMENT
/begin MEASUREMENT Com_RxAccessInfo[103].TmpBufferIdxOfRxAccessInfo "" UBYTE Com_TmpBufferIdxOfRxAccessInfoType 0 0 0 255 ECU_ADDRESS 0x0 /end MEASUREMENT
/begin MEASUREMENT Com_RxAccessInfo[103].TmpBufferOfRxAccessInfo "" UBYTE Com_TmpBufferOfRxAccessInfoType 0 0 0 255 ECU_ADDRESS 0x0 /end MEASUREMENT
/begin MEASUREMENT Com_RxAccessInfo[103].TmpRxShdBufferArrayBasedTmpBufferEndIdxOfRxAccessInfo "" UBYTE Com_TmpRxShdBufferArrayBasedTmpBufferEndIdxOfRxAccessInfoType 0 0 0 255 ECU_ADDRESS 0x0 /end MEASUREMENT
/begin MEASUREMENT Com_RxAccessInfo[103].TmpRxShdBufferArrayBasedTmpBufferStartIdxOfRxAccessInfo "" UBYTE Com_TmpRxShdBufferArrayBasedTmpBufferStartIdxOfRxAccessInfoType 0 0 0 255 ECU_ADDRESS 0x0 /end MEASUREMENT
/begin MEASUREMENT Com_RxAccessInfo[104].ApplTypeOfRxAccessInfo "" UBYTE Com_ApplTypeOfRxAccessInfoType 0 0 0 255 ECU_ADDRESS 0x0 /end MEASUREMENT
/begin MEASUREMENT Com_RxAccessInfo[104].BitLengthOfRxAccessInfo "" UWORD NO_COMPU_METHOD 0 0 0 65535 ECU_ADDRESS 0x0 /end MEASUREMENT
/begin MEASUREMENT Com_RxAccessInfo[104].BitPositionOfRxAccessInfo "" UWORD NO_COMPU_METHOD 0 0 0 65535 ECU_ADDRESS 0x0 /end MEASUREMENT
/begin MEASUREMENT Com_RxAccessInfo[104].BufferIdxOfRxAccessInfo "" UWORD Com_BufferIdxOfRxAccessInfoType 0 0 0 65535 ECU_ADDRESS 0x0 /end MEASUREMENT
/begin MEASUREMENT Com_RxAccessInfo[104].BusAccOfRxAccessInfo "" UBYTE Com_BusAccOfRxAccessInfoType 0 0 0 255 ECU_ADDRESS 0x0 /end MEASUREMENT
/begin MEASUREMENT Com_RxAccessInfo[104].ByteLengthOfRxAccessInfo "" UBYTE NO_COMPU_METHOD 0 0 0 255 ECU_ADDRESS 0x0 /end MEASUREMENT
/begin MEASUREMENT Com_RxAccessInfo[104].ConstValueArrayBasedInitValueEndIdxOfRxAccessInfo "" UBYTE Com_ConstValueArrayBasedInitValueEndIdxOfRxAccessInfoType 0 0 0 255 ECU_ADDRESS 0x0 /end MEASUREMENT
/begin MEASUREMENT Com_RxAccessInfo[104].ConstValueArrayBasedInitValueStartIdxOfRxAccessInfo "" UBYTE Com_ConstValueArrayBasedInitValueStartIdxOfRxAccessInfoType 0 0 0 255 ECU_ADDRESS 0x0 /end MEASUREMENT
/begin MEASUREMENT Com_RxAccessInfo[104].DynSignalOfRxAccessInfo "" UBYTE Com_DynSignalOfRxAccessInfoType 0 0 0 1 ECU_ADDRESS 0x0 /end MEASUREMENT
/begin MEASUREMENT Com_RxAccessInfo[104].InitValueIdxOfRxAccessInfo "" UBYTE Com_InitValueIdxOfRxAccessInfoType 0 0 0 255 ECU_ADDRESS 0x0 /end MEASUREMENT
/begin MEASUREMENT Com_RxAccessInfo[104].InitValueOfRxAccessInfo "" UBYTE Com_InitValueOfRxAccessInfoType 0 0 0 255 ECU_ADDRESS 0x0 /end MEASUREMENT
/begin MEASUREMENT Com_RxAccessInfo[104].InvValueIdxOfRxAccessInfo "" UBYTE Com_InvValueIdxOfRxAccessInfoType 0 0 0 255 ECU_ADDRESS 0x0 /end MEASUREMENT
/begin MEASUREMENT Com_RxAccessInfo[104].InvValueOfRxAccessInfo "" UBYTE Com_InvValueOfRxAccessInfoType 0 0 0 255 ECU_ADDRESS 0x0 /end MEASUREMENT
/begin MEASUREMENT Com_RxAccessInfo[104].IsGroupSignalOfRxAccessInfo "" UBYTE Com_IsGroupSignalOfRxAccessInfoType 0 0 0 1 ECU_ADDRESS 0x0 /end MEASUREMENT
/begin MEASUREMENT Com_RxAccessInfo[104].RxDataTimeoutSubstitutionValueIdxOfRxAccessInfo "" UBYTE Com_RxDataTimeoutSubstitutionValueIdxOfRxAccessInfoType 0 0 0 255 ECU_ADDRESS 0x0 /end MEASUREMENT
/begin MEASUREMENT Com_RxAccessInfo[104].RxDataTimeoutSubstitutionValueOfRxAccessInfo "" UBYTE Com_RxDataTimeoutSubstitutionValueOfRxAccessInfoType 0 0 0 255 ECU_ADDRESS 0x0 /end MEASUREMENT
/begin MEASUREMENT Com_RxAccessInfo[104].RxPduInfoIdxOfRxAccessInfo "" UBYTE NO_COMPU_METHOD 0 0 0 255 ECU_ADDRESS 0x0 /end MEASUREMENT
/begin MEASUREMENT Com_RxAccessInfo[104].RxSigBufferArrayBasedBufferEndIdxOfRxAccessInfo "" UBYTE Com_RxSigBufferArrayBasedBufferEndIdxOfRxAccessInfoType 0 0 0 255 ECU_ADDRESS 0x0 /end MEASUREMENT
/begin MEASUREMENT Com_RxAccessInfo[104].RxSigBufferArrayBasedBufferStartIdxOfRxAccessInfo "" UBYTE Com_RxSigBufferArrayBasedBufferStartIdxOfRxAccessInfoType 0 0 0 255 ECU_ADDRESS 0x0 /end MEASUREMENT
/begin MEASUREMENT Com_RxAccessInfo[104].RxSigBufferArrayBasedShdBufferEndIdxOfRxAccessInfo "" UBYTE Com_RxSigBufferArrayBasedShdBufferEndIdxOfRxAccessInfoType 0 0 0 255 ECU_ADDRESS 0x0 /end MEASUREMENT
/begin MEASUREMENT Com_RxAccessInfo[104].RxSigBufferArrayBasedShdBufferStartIdxOfRxAccessInfo "" UBYTE Com_RxSigBufferArrayBasedShdBufferStartIdxOfRxAccessInfoType 0 0 0 255 ECU_ADDRESS 0x0 /end MEASUREMENT
/begin MEASUREMENT Com_RxAccessInfo[104].RxTOutInfoIdxOfRxAccessInfo "" UBYTE Com_RxTOutInfoIdxOfRxAccessInfoType 0 0 0 255 ECU_ADDRESS 0x0 /end MEASUREMENT
/begin MEASUREMENT Com_RxAccessInfo[104].ShdBufferIdxOfRxAccessInfo "" UWORD Com_ShdBufferIdxOfRxAccessInfoType 0 0 0 65535 ECU_ADDRESS 0x0 /end MEASUREMENT
/begin MEASUREMENT Com_RxAccessInfo[104].SignalLengthInByteOfRxAccessInfo "" UBYTE NO_COMPU_METHOD 0 0 0 255 ECU_ADDRESS 0x0 /end MEASUREMENT
/begin MEASUREMENT Com_RxAccessInfo[104].StartByteInPduPositionOfRxAccessInfo "" UBYTE NO_COMPU_METHOD 0 0 0 255 ECU_ADDRESS 0x0 /end MEASUREMENT
/begin MEASUREMENT Com_RxAccessInfo[104].TmpBufferIdxOfRxAccessInfo "" UBYTE Com_TmpBufferIdxOfRxAccessInfoType 0 0 0 255 ECU_ADDRESS 0x0 /end MEASUREMENT
/begin MEASUREMENT Com_RxAccessInfo[104].TmpBufferOfRxAccessInfo "" UBYTE Com_TmpBufferOfRxAccessInfoType 0 0 0 255 ECU_ADDRESS 0x0 /end MEASUREMENT
/begin MEASUREMENT Com_RxAccessInfo[104].TmpRxShdBufferArrayBasedTmpBufferEndIdxOfRxAccessInfo "" UBYTE Com_TmpRxShdBufferArrayBasedTmpBufferEndIdxOfRxAccessInfoType 0 0 0 255 ECU_ADDRESS 0x0 /end MEASUREMENT
/begin MEASUREMENT Com_RxAccessInfo[104].TmpRxShdBufferArrayBasedTmpBufferStartIdxOfRxAccessInfo "" UBYTE Com_TmpRxShdBufferArrayBasedTmpBufferStartIdxOfRxAccessInfoType 0 0 0 255 ECU_ADDRESS 0x0 /end MEASUREMENT
/begin MEASUREMENT Com_RxAccessInfo[105].ApplTypeOfRxAccessInfo "" UBYTE Com_ApplTypeOfRxAccessInfoType 0 0 0 255 ECU_ADDRESS 0x0 /end MEASUREMENT
/begin MEASUREMENT Com_RxAccessInfo[105].BitLengthOfRxAccessInfo "" UWORD NO_COMPU_METHOD 0 0 0 65535 ECU_ADDRESS 0x0 /end MEASUREMENT
/begin MEASUREMENT Com_RxAccessInfo[105].BitPositionOfRxAccessInfo "" UWORD NO_COMPU_METHOD 0 0 0 65535 ECU_ADDRESS 0x0 /end MEASUREMENT
/begin MEASUREMENT Com_RxAccessInfo[105].BufferIdxOfRxAccessInfo "" UWORD Com_BufferIdxOfRxAccessInfoType 0 0 0 65535 ECU_ADDRESS 0x0 /end MEASUREMENT
/begin MEASUREMENT Com_RxAccessInfo[105].BusAccOfRxAccessInfo "" UBYTE Com_BusAccOfRxAccessInfoType 0 0 0 255 ECU_ADDRESS 0x0 /end MEASUREMENT
/begin MEASUREMENT Com_RxAccessInfo[105].ByteLengthOfRxAccessInfo "" UBYTE NO_COMPU_METHOD 0 0 0 255 ECU_ADDRESS 0x0 /end MEASUREMENT
/begin MEASUREMENT Com_RxAccessInfo[105].ConstValueArrayBasedInitValueEndIdxOfRxAccessInfo "" UBYTE Com_ConstValueArrayBasedInitValueEndIdxOfRxAccessInfoType 0 0 0 255 ECU_ADDRESS 0x0 /end MEASUREMENT
/begin MEASUREMENT Com_RxAccessInfo[105].ConstValueArrayBasedInitValueStartIdxOfRxAccessInfo "" UBYTE Com_ConstValueArrayBasedInitValueStartIdxOfRxAccessInfoType 0 0 0 255 ECU_ADDRESS 0x0 /end MEASUREMENT
/begin MEASUREMENT Com_RxAccessInfo[105].DynSignalOfRxAccessInfo "" UBYTE Com_DynSignalOfRxAccessInfoType 0 0 0 1 ECU_ADDRESS 0x0 /end MEASUREMENT
/begin MEASUREMENT Com_RxAccessInfo[105].InitValueIdxOfRxAccessInfo "" UBYTE Com_InitValueIdxOfRxAccessInfoType 0 0 0 255 ECU_ADDRESS 0x0 /end MEASUREMENT
/begin MEASUREMENT Com_RxAccessInfo[105].InitValueOfRxAccessInfo "" UBYTE Com_InitValueOfRxAccessInfoType 0 0 0 255 ECU_ADDRESS 0x0 /end MEASUREMENT
/begin MEASUREMENT Com_RxAccessInfo[105].InvValueIdxOfRxAccessInfo "" UBYTE Com_InvValueIdxOfRxAccessInfoType 0 0 0 255 ECU_ADDRESS 0x0 /end MEASUREMENT
/begin MEASUREMENT Com_RxAccessInfo[105].InvValueOfRxAccessInfo "" UBYTE Com_InvValueOfRxAccessInfoType 0 0 0 255 ECU_ADDRESS 0x0 /end MEASUREMENT
/begin MEASUREMENT Com_RxAccessInfo[105].IsGroupSignalOfRxAccessInfo "" UBYTE Com_IsGroupSignalOfRxAccessInfoType 0 0 0 1 ECU_ADDRESS 0x0 /end MEASUREMENT
/begin MEASUREMENT Com_RxAccessInfo[105].RxDataTimeoutSubstitutionValueIdxOfRxAccessInfo "" UBYTE Com_RxDataTimeoutSubstitutionValueIdxOfRxAccessInfoType 0 0 0 255 ECU_ADDRESS 0x0 /end MEASUREMENT
/begin MEASUREMENT Com_RxAccessInfo[105].RxDataTimeoutSubstitutionValueOfRxAccessInfo "" UBYTE Com_RxDataTimeoutSubstitutionValueOfRxAccessInfoType 0 0 0 255 ECU_ADDRESS 0x0 /end MEASUREMENT
/begin MEASUREMENT Com_RxAccessInfo[105].RxPduInfoIdxOfRxAccessInfo "" UBYTE NO_COMPU_METHOD 0 0 0 255 ECU_ADDRESS 0x0 /end MEASUREMENT
/begin MEASUREMENT Com_RxAccessInfo[105].RxSigBufferArrayBasedBufferEndIdxOfRxAccessInfo "" UBYTE Com_RxSigBufferArrayBasedBufferEndIdxOfRxAccessInfoType 0 0 0 255 ECU_ADDRESS 0x0 /end MEASUREMENT
/begin MEASUREMENT Com_RxAccessInfo[105].RxSigBufferArrayBasedBufferStartIdxOfRxAccessInfo "" UBYTE Com_RxSigBufferArrayBasedBufferStartIdxOfRxAccessInfoType 0 0 0 255 ECU_ADDRESS 0x0 /end MEASUREMENT
/begin MEASUREMENT Com_RxAccessInfo[105].RxSigBufferArrayBasedShdBufferEndIdxOfRxAccessInfo "" UBYTE Com_RxSigBufferArrayBasedShdBufferEndIdxOfRxAccessInfoType 0 0 0 255 ECU_ADDRESS 0x0 /end MEASUREMENT
/begin MEASUREMENT Com_RxAccessInfo[105].RxSigBufferArrayBasedShdBufferStartIdxOfRxAccessInfo "" UBYTE Com_RxSigBufferArrayBasedShdBufferStartIdxOfRxAccessInfoType 0 0 0 255 ECU_ADDRESS 0x0 /end MEASUREMENT
/begin MEASUREMENT Com_RxAccessInfo[105].RxTOutInfoIdxOfRxAccessInfo "" UBYTE Com_RxTOutInfoIdxOfRxAccessInfoType 0 0 0 255 ECU_ADDRESS 0x0 /end MEASUREMENT
/begin MEASUREMENT Com_RxAccessInfo[105].ShdBufferIdxOfRxAccessInfo "" UWORD Com_ShdBufferIdxOfRxAccessInfoType 0 0 0 65535 ECU_ADDRESS 0x0 /end MEASUREMENT
/begin MEASUREMENT Com_RxAccessInfo[105].SignalLengthInByteOfRxAccessInfo "" UBYTE NO_COMPU_METHOD 0 0 0 255 ECU_ADDRESS 0x0 /end MEASUREMENT
/begin MEASUREMENT Com_RxAccessInfo[105].StartByteInPduPositionOfRxAccessInfo "" UBYTE NO_COMPU_METHOD 0 0 0 255 ECU_ADDRESS 0x0 /end MEASUREMENT
/begin MEASUREMENT Com_RxAccessInfo[105].TmpBufferIdxOfRxAccessInfo "" UBYTE Com_TmpBufferIdxOfRxAccessInfoType 0 0 0 255 ECU_ADDRESS 0x0 /end MEASUREMENT
/begin MEASUREMENT Com_RxAccessInfo[105].TmpBufferOfRxAccessInfo "" UBYTE Com_TmpBufferOfRxAccessInfoType 0 0 0 255 ECU_ADDRESS 0x0 /end MEASUREMENT
/begin MEASUREMENT Com_RxAccessInfo[105].TmpRxShdBufferArrayBasedTmpBufferEndIdxOfRxAccessInfo "" UBYTE Com_TmpRxShdBufferArrayBasedTmpBufferEndIdxOfRxAccessInfoType 0 0 0 255 ECU_ADDRESS 0x0 /end MEASUREMENT
/begin MEASUREMENT Com_RxAccessInfo[105].TmpRxShdBufferArrayBasedTmpBufferStartIdxOfRxAccessInfo "" UBYTE Com_TmpRxShdBufferArrayBasedTmpBufferStartIdxOfRxAccessInfoType 0 0 0 255 ECU_ADDRESS 0x0 /end MEASUREMENT
/begin MEASUREMENT Com_RxAccessInfo[106].ApplTypeOfRxAccessInfo "" UBYTE Com_ApplTypeOfRxAccessInfoType 0 0 0 255 ECU_ADDRESS 0x0 /end MEASUREMENT
/begin MEASUREMENT Com_RxAccessInfo[106].BitLengthOfRxAccessInfo "" UWORD NO_COMPU_METHOD 0 0 0 65535 ECU_ADDRESS 0x0 /end MEASUREMENT
/begin MEASUREMENT Com_RxAccessInfo[106].BitPositionOfRxAccessInfo "" UWORD NO_COMPU_METHOD 0 0 0 65535 ECU_ADDRESS 0x0 /end MEASUREMENT
/begin MEASUREMENT Com_RxAccessInfo[106].BufferIdxOfRxAccessInfo "" UWORD Com_BufferIdxOfRxAccessInfoType 0 0 0 65535 ECU_ADDRESS 0x0 /end MEASUREMENT
/begin MEASUREMENT Com_RxAccessInfo[106].BusAccOfRxAccessInfo "" UBYTE Com_BusAccOfRxAccessInfoType 0 0 0 255 ECU_ADDRESS 0x0 /end MEASUREMENT
/begin MEASUREMENT Com_RxAccessInfo[106].ByteLengthOfRxAccessInfo "" UBYTE NO_COMPU_METHOD 0 0 0 255 ECU_ADDRESS 0x0 /end MEASUREMENT
/begin MEASUREMENT Com_RxAccessInfo[106].ConstValueArrayBasedInitValueEndIdxOfRxAccessInfo "" UBYTE Com_ConstValueArrayBasedInitValueEndIdxOfRxAccessInfoType 0 0 0 255 ECU_ADDRESS 0x0 /end MEASUREMENT
/begin MEASUREMENT Com_RxAccessInfo[106].ConstValueArrayBasedInitValueStartIdxOfRxAccessInfo "" UBYTE Com_ConstValueArrayBasedInitValueStartIdxOfRxAccessInfoType 0 0 0 255 ECU_ADDRESS 0x0 /end MEASUREMENT
/begin MEASUREMENT Com_RxAccessInfo[106].DynSignalOfRxAccessInfo "" UBYTE Com_DynSignalOfRxAccessInfoType 0 0 0 1 ECU_ADDRESS 0x0 /end MEASUREMENT
/begin MEASUREMENT Com_RxAccessInfo[106].InitValueIdxOfRxAccessInfo "" UBYTE Com_InitValueIdxOfRxAccessInfoType 0 0 0 255 ECU_ADDRESS 0x0 /end MEASUREMENT
/begin MEASUREMENT Com_RxAccessInfo[106].InitValueOfRxAccessInfo "" UBYTE Com_InitValueOfRxAccessInfoType 0 0 0 255 ECU_ADDRESS 0x0 /end MEASUREMENT
/begin MEASUREMENT Com_RxAccessInfo[106].InvValueIdxOfRxAccessInfo "" UBYTE Com_InvValueIdxOfRxAccessInfoType 0 0 0 255 ECU_ADDRESS 0x0 /end MEASUREMENT
/begin MEASUREMENT Com_RxAccessInfo[106].InvValueOfRxAccessInfo "" UBYTE Com_InvValueOfRxAccessInfoType 0 0 0 255 ECU_ADDRESS 0x0 /end MEASUREMENT
/begin MEASUREMENT Com_RxAccessInfo[106].IsGroupSignalOfRxAccessInfo "" UBYTE Com_IsGroupSignalOfRxAccessInfoType 0 0 0 1 ECU_ADDRESS 0x0 /end MEASUREMENT
/begin MEASUREMENT Com_RxAccessInfo[106].RxDataTimeoutSubstitutionValueIdxOfRxAccessInfo "" UBYTE Com_RxDataTimeoutSubstitutionValueIdxOfRxAccessInfoType 0 0 0 255 ECU_ADDRESS 0x0 /end MEASUREMENT
/begin MEASUREMENT Com_RxAccessInfo[106].RxDataTimeoutSubstitutionValueOfRxAccessInfo "" UBYTE Com_RxDataTimeoutSubstitutionValueOfRxAccessInfoType 0 0 0 255 ECU_ADDRESS 0x0 /end MEASUREMENT
/begin MEASUREMENT Com_RxAccessInfo[106].RxPduInfoIdxOfRxAccessInfo "" UBYTE NO_COMPU_METHOD 0 0 0 255 ECU_ADDRESS 0x0 /end MEASUREMENT
/begin MEASUREMENT Com_RxAccessInfo[106].RxSigBufferArrayBasedBufferEndIdxOfRxAccessInfo "" UBYTE Com_RxSigBufferArrayBasedBufferEndIdxOfRxAccessInfoType 0 0 0 255 ECU_ADDRESS 0x0 /end MEASUREMENT
/begin MEASUREMENT Com_RxAccessInfo[106].RxSigBufferArrayBasedBufferStartIdxOfRxAccessInfo "" UBYTE Com_RxSigBufferArrayBasedBufferStartIdxOfRxAccessInfoType 0 0 0 255 ECU_ADDRESS 0x0 /end MEASUREMENT
/begin MEASUREMENT Com_RxAccessInfo[106].RxSigBufferArrayBasedShdBufferEndIdxOfRxAccessInfo "" UBYTE Com_RxSigBufferArrayBasedShdBufferEndIdxOfRxAccessInfoType 0 0 0 255 ECU_ADDRESS 0x0 /end MEASUREMENT
/begin MEASUREMENT Com_RxAccessInfo[106].RxSigBufferArrayBasedShdBufferStartIdxOfRxAccessInfo "" UBYTE Com_RxSigBufferArrayBasedShdBufferStartIdxOfRxAccessInfoType 0 0 0 255 ECU_ADDRESS 0x0 /end MEASUREMENT
/begin MEASUREMENT Com_RxAccessInfo[106].RxTOutInfoIdxOfRxAccessInfo "" UBYTE Com_RxTOutInfoIdxOfRxAccessInfoType 0 0 0 255 ECU_ADDRESS 0x0 /end MEASUREMENT
/begin MEASUREMENT Com_RxAccessInfo[106].ShdBufferIdxOfRxAccessInfo "" UWORD Com_ShdBufferIdxOfRxAccessInfoType 0 0 0 65535 ECU_ADDRESS 0x0 /end MEASUREMENT
/begin MEASUREMENT Com_RxAccessInfo[106].SignalLengthInByteOfRxAccessInfo "" UBYTE NO_COMPU_METHOD 0 0 0 255 ECU_ADDRESS 0x0 /end MEASUREMENT
/begin MEASUREMENT Com_RxAccessInfo[106].StartByteInPduPositionOfRxAccessInfo "" UBYTE NO_COMPU_METHOD 0 0 0 255 ECU_ADDRESS 0x0 /end MEASUREMENT
/begin MEASUREMENT Com_RxAccessInfo[106].TmpBufferIdxOfRxAccessInfo "" UBYTE Com_TmpBufferIdxOfRxAccessInfoType 0 0 0 255 ECU_ADDRESS 0x0 /end MEASUREMENT
/begin MEASUREMENT Com_RxAccessInfo[106].TmpBufferOfRxAccessInfo "" UBYTE Com_TmpBufferOfRxAccessInfoType 0 0 0 255 ECU_ADDRESS 0x0 /end MEASUREMENT
/begin MEASUREMENT Com_RxAccessInfo[106].TmpRxShdBufferArrayBasedTmpBufferEndIdxOfRxAccessInfo "" UBYTE Com_TmpRxShdBufferArrayBasedTmpBufferEndIdxOfRxAccessInfoType 0 0 0 255 ECU_ADDRESS 0x0 /end MEASUREMENT
/begin MEASUREMENT Com_RxAccessInfo[106].TmpRxShdBufferArrayBasedTmpBufferStartIdxOfRxAccessInfo "" UBYTE Com_TmpRxShdBufferArrayBasedTmpBufferStartIdxOfRxAccessInfoType 0 0 0 255 ECU_ADDRESS 0x0 /end MEASUREMENT
/begin MEASUREMENT Com_RxAccessInfo[107].ApplTypeOfRxAccessInfo "" UBYTE Com_ApplTypeOfRxAccessInfoType 0 0 0 255 ECU_ADDRESS 0x0 /end MEASUREMENT
/begin MEASUREMENT Com_RxAccessInfo[107].BitLengthOfRxAccessInfo "" UWORD NO_COMPU_METHOD 0 0 0 65535 ECU_ADDRESS 0x0 /end MEASUREMENT
/begin MEASUREMENT Com_RxAccessInfo[107].BitPositionOfRxAccessInfo "" UWORD NO_COMPU_METHOD 0 0 0 65535 ECU_ADDRESS 0x0 /end MEASUREMENT
/begin MEASUREMENT Com_RxAccessInfo[107].BufferIdxOfRxAccessInfo "" UWORD Com_BufferIdxOfRxAccessInfoType 0 0 0 65535 ECU_ADDRESS 0x0 /end MEASUREMENT
/begin MEASUREMENT Com_RxAccessInfo[107].BusAccOfRxAccessInfo "" UBYTE Com_BusAccOfRxAccessInfoType 0 0 0 255 ECU_ADDRESS 0x0 /end MEASUREMENT
/begin MEASUREMENT Com_RxAccessInfo[107].ByteLengthOfRxAccessInfo "" UBYTE NO_COMPU_METHOD 0 0 0 255 ECU_ADDRESS 0x0 /end MEASUREMENT
/begin MEASUREMENT Com_RxAccessInfo[107].ConstValueArrayBasedInitValueEndIdxOfRxAccessInfo "" UBYTE Com_ConstValueArrayBasedInitValueEndIdxOfRxAccessInfoType 0 0 0 255 ECU_ADDRESS 0x0 /end MEASUREMENT
/begin MEASUREMENT Com_RxAccessInfo[107].ConstValueArrayBasedInitValueStartIdxOfRxAccessInfo "" UBYTE Com_ConstValueArrayBasedInitValueStartIdxOfRxAccessInfoType 0 0 0 255 ECU_ADDRESS 0x0 /end MEASUREMENT
/begin MEASUREMENT Com_RxAccessInfo[107].DynSignalOfRxAccessInfo "" UBYTE Com_DynSignalOfRxAccessInfoType 0 0 0 1 ECU_ADDRESS 0x0 /end MEASUREMENT
/begin MEASUREMENT Com_RxAccessInfo[107].InitValueIdxOfRxAccessInfo "" UBYTE Com_InitValueIdxOfRxAccessInfoType 0 0 0 255 ECU_ADDRESS 0x0 /end MEASUREMENT
/begin MEASUREMENT Com_RxAccessInfo[107].InitValueOfRxAccessInfo "" UBYTE Com_InitValueOfRxAccessInfoType 0 0 0 255 ECU_ADDRESS 0x0 /end MEASUREMENT
/begin MEASUREMENT Com_RxAccessInfo[107].InvValueIdxOfRxAccessInfo "" UBYTE Com_InvValueIdxOfRxAccessInfoType 0 0 0 255 ECU_ADDRESS 0x0 /end MEASUREMENT
/begin MEASUREMENT Com_RxAccessInfo[107].InvValueOfRxAccessInfo "" UBYTE Com_InvValueOfRxAccessInfoType 0 0 0 255 ECU_ADDRESS 0x0 /end MEASUREMENT
/begin MEASUREMENT Com_RxAccessInfo[107].IsGroupSignalOfRxAccessInfo "" UBYTE Com_IsGroupSignalOfRxAccessInfoType 0 0 0 1 ECU_ADDRESS 0x0 /end MEASUREMENT
/begin MEASUREMENT Com_RxAccessInfo[107].RxDataTimeoutSubstitutionValueIdxOfRxAccessInfo "" UBYTE Com_RxDataTimeoutSubstitutionValueIdxOfRxAccessInfoType 0 0 0 255 ECU_ADDRESS 0x0 /end MEASUREMENT
/begin MEASUREMENT Com_RxAccessInfo[107].RxDataTimeoutSubstitutionValueOfRxAccessInfo "" UBYTE Com_RxDataTimeoutSubstitutionValueOfRxAccessInfoType 0 0 0 255 ECU_ADDRESS 0x0 /end MEASUREMENT
/begin MEASUREMENT Com_RxAccessInfo[107].RxPduInfoIdxOfRxAccessInfo "" UBYTE NO_COMPU_METHOD 0 0 0 255 ECU_ADDRESS 0x0 /end MEASUREMENT
/begin MEASUREMENT Com_RxAccessInfo[107].RxSigBufferArrayBasedBufferEndIdxOfRxAccessInfo "" UBYTE Com_RxSigBufferArrayBasedBufferEndIdxOfRxAccessInfoType 0 0 0 255 ECU_ADDRESS 0x0 /end MEASUREMENT
/begin MEASUREMENT Com_RxAccessInfo[107].RxSigBufferArrayBasedBufferStartIdxOfRxAccessInfo "" UBYTE Com_RxSigBufferArrayBasedBufferStartIdxOfRxAccessInfoType 0 0 0 255 ECU_ADDRESS 0x0 /end MEASUREMENT
/begin MEASUREMENT Com_RxAccessInfo[107].RxSigBufferArrayBasedShdBufferEndIdxOfRxAccessInfo "" UBYTE Com_RxSigBufferArrayBasedShdBufferEndIdxOfRxAccessInfoType 0 0 0 255 ECU_ADDRESS 0x0 /end MEASUREMENT
/begin MEASUREMENT Com_RxAccessInfo[107].RxSigBufferArrayBasedShdBufferStartIdxOfRxAccessInfo "" UBYTE Com_RxSigBufferArrayBasedShdBufferStartIdxOfRxAccessInfoType 0 0 0 255 ECU_ADDRESS 0x0 /end MEASUREMENT
/begin MEASUREMENT Com_RxAccessInfo[107].RxTOutInfoIdxOfRxAccessInfo "" UBYTE Com_RxTOutInfoIdxOfRxAccessInfoType 0 0 0 255 ECU_ADDRESS 0x0 /end MEASUREMENT
/begin MEASUREMENT Com_RxAccessInfo[107].ShdBufferIdxOfRxAccessInfo "" UWORD Com_ShdBufferIdxOfRxAccessInfoType 0 0 0 65535 ECU_ADDRESS 0x0 /end MEASUREMENT
/begin MEASUREMENT Com_RxAccessInfo[107].SignalLengthInByteOfRxAccessInfo "" UBYTE NO_COMPU_METHOD 0 0 0 255 ECU_ADDRESS 0x0 /end MEASUREMENT
/begin MEASUREMENT Com_RxAccessInfo[107].StartByteInPduPositionOfRxAccessInfo "" UBYTE NO_COMPU_METHOD 0 0 0 255 ECU_ADDRESS 0x0 /end MEASUREMENT
/begin MEASUREMENT Com_RxAccessInfo[107].TmpBufferIdxOfRxAccessInfo "" UBYTE Com_TmpBufferIdxOfRxAccessInfoType 0 0 0 255 ECU_ADDRESS 0x0 /end MEASUREMENT
/begin MEASUREMENT Com_RxAccessInfo[107].TmpBufferOfRxAccessInfo "" UBYTE Com_TmpBufferOfRxAccessInfoType 0 0 0 255 ECU_ADDRESS 0x0 /end MEASUREMENT
/begin MEASUREMENT Com_RxAccessInfo[107].TmpRxShdBufferArrayBasedTmpBufferEndIdxOfRxAccessInfo "" UBYTE Com_TmpRxShdBufferArrayBasedTmpBufferEndIdxOfRxAccessInfoType 0 0 0 255 ECU_ADDRESS 0x0 /end MEASUREMENT
/begin MEASUREMENT Com_RxAccessInfo[107].TmpRxShdBufferArrayBasedTmpBufferStartIdxOfRxAccessInfo "" UBYTE Com_TmpRxShdBufferArrayBasedTmpBufferStartIdxOfRxAccessInfoType 0 0 0 255 ECU_ADDRESS 0x0 /end MEASUREMENT
/begin MEASUREMENT Com_RxAccessInfo[108].ApplTypeOfRxAccessInfo "" UBYTE Com_ApplTypeOfRxAccessInfoType 0 0 0 255 ECU_ADDRESS 0x0 /end MEASUREMENT
/begin MEASUREMENT Com_RxAccessInfo[108].BitLengthOfRxAccessInfo "" UWORD NO_COMPU_METHOD 0 0 0 65535 ECU_ADDRESS 0x0 /end MEASUREMENT
/begin MEASUREMENT Com_RxAccessInfo[108].BitPositionOfRxAccessInfo "" UWORD NO_COMPU_METHOD 0 0 0 65535 ECU_ADDRESS 0x0 /end MEASUREMENT
/begin MEASUREMENT Com_RxAccessInfo[108].BufferIdxOfRxAccessInfo "" UWORD Com_BufferIdxOfRxAccessInfoType 0 0 0 65535 ECU_ADDRESS 0x0 /end MEASUREMENT
/begin MEASUREMENT Com_RxAccessInfo[108].BusAccOfRxAccessInfo "" UBYTE Com_BusAccOfRxAccessInfoType 0 0 0 255 ECU_ADDRESS 0x0 /end MEASUREMENT
/begin MEASUREMENT Com_RxAccessInfo[108].ByteLengthOfRxAccessInfo "" UBYTE NO_COMPU_METHOD 0 0 0 255 ECU_ADDRESS 0x0 /end MEASUREMENT
/begin MEASUREMENT Com_RxAccessInfo[108].ConstValueArrayBasedInitValueEndIdxOfRxAccessInfo "" UBYTE Com_ConstValueArrayBasedInitValueEndIdxOfRxAccessInfoType 0 0 0 255 ECU_ADDRESS 0x0 /end MEASUREMENT
/begin MEASUREMENT Com_RxAccessInfo[108].ConstValueArrayBasedInitValueStartIdxOfRxAccessInfo "" UBYTE Com_ConstValueArrayBasedInitValueStartIdxOfRxAccessInfoType 0 0 0 255 ECU_ADDRESS 0x0 /end MEASUREMENT
/begin MEASUREMENT Com_RxAccessInfo[108].DynSignalOfRxAccessInfo "" UBYTE Com_DynSignalOfRxAccessInfoType 0 0 0 1 ECU_ADDRESS 0x0 /end MEASUREMENT
/begin MEASUREMENT Com_RxAccessInfo[108].InitValueIdxOfRxAccessInfo "" UBYTE Com_InitValueIdxOfRxAccessInfoType 0 0 0 255 ECU_ADDRESS 0x0 /end MEASUREMENT
/begin MEASUREMENT Com_RxAccessInfo[108].InitValueOfRxAccessInfo "" UBYTE Com_InitValueOfRxAccessInfoType 0 0 0 255 ECU_ADDRESS 0x0 /end MEASUREMENT
/begin MEASUREMENT Com_RxAccessInfo[108].InvValueIdxOfRxAccessInfo "" UBYTE Com_InvValueIdxOfRxAccessInfoType 0 0 0 255 ECU_ADDRESS 0x0 /end MEASUREMENT
/begin MEASUREMENT Com_RxAccessInfo[108].InvValueOfRxAccessInfo "" UBYTE Com_InvValueOfRxAccessInfoType 0 0 0 255 ECU_ADDRESS 0x0 /end MEASUREMENT
/begin MEASUREMENT Com_RxAccessInfo[108].IsGroupSignalOfRxAccessInfo "" UBYTE Com_IsGroupSignalOfRxAccessInfoType 0 0 0 1 ECU_ADDRESS 0x0 /end MEASUREMENT
/begin MEASUREMENT Com_RxAccessInfo[108].RxDataTimeoutSubstitutionValueIdxOfRxAccessInfo "" UBYTE Com_RxDataTimeoutSubstitutionValueIdxOfRxAccessInfoType 0 0 0 255 ECU_ADDRESS 0x0 /end MEASUREMENT
/begin MEASUREMENT Com_RxAccessInfo[108].RxDataTimeoutSubstitutionValueOfRxAccessInfo "" UBYTE Com_RxDataTimeoutSubstitutionValueOfRxAccessInfoType 0 0 0 255 ECU_ADDRESS 0x0 /end MEASUREMENT
/begin MEASUREMENT Com_RxAccessInfo[108].RxPduInfoIdxOfRxAccessInfo "" UBYTE NO_COMPU_METHOD 0 0 0 255 ECU_ADDRESS 0x0 /end MEASUREMENT
/begin MEASUREMENT Com_RxAccessInfo[108].RxSigBufferArrayBasedBufferEndIdxOfRxAccessInfo "" UBYTE Com_RxSigBufferArrayBasedBufferEndIdxOfRxAccessInfoType 0 0 0 255 ECU_ADDRESS 0x0 /end MEASUREMENT
/begin MEASUREMENT Com_RxAccessInfo[108].RxSigBufferArrayBasedBufferStartIdxOfRxAccessInfo "" UBYTE Com_RxSigBufferArrayBasedBufferStartIdxOfRxAccessInfoType 0 0 0 255 ECU_ADDRESS 0x0 /end MEASUREMENT
/begin MEASUREMENT Com_RxAccessInfo[108].RxSigBufferArrayBasedShdBufferEndIdxOfRxAccessInfo "" UBYTE Com_RxSigBufferArrayBasedShdBufferEndIdxOfRxAccessInfoType 0 0 0 255 ECU_ADDRESS 0x0 /end MEASUREMENT
/begin MEASUREMENT Com_RxAccessInfo[108].RxSigBufferArrayBasedShdBufferStartIdxOfRxAccessInfo "" UBYTE Com_RxSigBufferArrayBasedShdBufferStartIdxOfRxAccessInfoType 0 0 0 255 ECU_ADDRESS 0x0 /end MEASUREMENT
/begin MEASUREMENT Com_RxAccessInfo[108].RxTOutInfoIdxOfRxAccessInfo "" UBYTE Com_RxTOutInfoIdxOfRxAccessInfoType 0 0 0 255 ECU_ADDRESS 0x0 /end MEASUREMENT
/begin MEASUREMENT Com_RxAccessInfo[108].ShdBufferIdxOfRxAccessInfo "" UWORD Com_ShdBufferIdxOfRxAccessInfoType 0 0 0 65535 ECU_ADDRESS 0x0 /end MEASUREMENT
/begin MEASUREMENT Com_RxAccessInfo[108].SignalLengthInByteOfRxAccessInfo "" UBYTE NO_COMPU_METHOD 0 0 0 255 ECU_ADDRESS 0x0 /end MEASUREMENT
/begin MEASUREMENT Com_RxAccessInfo[108].StartByteInPduPositionOfRxAccessInfo "" UBYTE NO_COMPU_METHOD 0 0 0 255 ECU_ADDRESS 0x0 /end MEASUREMENT
/begin MEASUREMENT Com_RxAccessInfo[108].TmpBufferIdxOfRxAccessInfo "" UBYTE Com_TmpBufferIdxOfRxAccessInfoType 0 0 0 255 ECU_ADDRESS 0x0 /end MEASUREMENT
/begin MEASUREMENT Com_RxAccessInfo[108].TmpBufferOfRxAccessInfo "" UBYTE Com_TmpBufferOfRxAccessInfoType 0 0 0 255 ECU_ADDRESS 0x0 /end MEASUREMENT
/begin MEASUREMENT Com_RxAccessInfo[108].TmpRxShdBufferArrayBasedTmpBufferEndIdxOfRxAccessInfo "" UBYTE Com_TmpRxShdBufferArrayBasedTmpBufferEndIdxOfRxAccessInfoType 0 0 0 255 ECU_ADDRESS 0x0 /end MEASUREMENT
/begin MEASUREMENT Com_RxAccessInfo[108].TmpRxShdBufferArrayBasedTmpBufferStartIdxOfRxAccessInfo "" UBYTE Com_TmpRxShdBufferArrayBasedTmpBufferStartIdxOfRxAccessInfoType 0 0 0 255 ECU_ADDRESS 0x0 /end MEASUREMENT
/begin MEASUREMENT Com_RxAccessInfo[109].ApplTypeOfRxAccessInfo "" UBYTE Com_ApplTypeOfRxAccessInfoType 0 0 0 255 ECU_ADDRESS 0x0 /end MEASUREMENT
/begin MEASUREMENT Com_RxAccessInfo[109].BitLengthOfRxAccessInfo "" UWORD NO_COMPU_METHOD 0 0 0 65535 ECU_ADDRESS 0x0 /end MEASUREMENT
/begin MEASUREMENT Com_RxAccessInfo[109].BitPositionOfRxAccessInfo "" UWORD NO_COMPU_METHOD 0 0 0 65535 ECU_ADDRESS 0x0 /end MEASUREMENT
/begin MEASUREMENT Com_RxAccessInfo[109].BufferIdxOfRxAccessInfo "" UWORD Com_BufferIdxOfRxAccessInfoType 0 0 0 65535 ECU_ADDRESS 0x0 /end MEASUREMENT
/begin MEASUREMENT Com_RxAccessInfo[109].BusAccOfRxAccessInfo "" UBYTE Com_BusAccOfRxAccessInfoType 0 0 0 255 ECU_ADDRESS 0x0 /end MEASUREMENT
/begin MEASUREMENT Com_RxAccessInfo[109].ByteLengthOfRxAccessInfo "" UBYTE NO_COMPU_METHOD 0 0 0 255 ECU_ADDRESS 0x0 /end MEASUREMENT
/begin MEASUREMENT Com_RxAccessInfo[109].ConstValueArrayBasedInitValueEndIdxOfRxAccessInfo "" UBYTE Com_ConstValueArrayBasedInitValueEndIdxOfRxAccessInfoType 0 0 0 255 ECU_ADDRESS 0x0 /end MEASUREMENT
/begin MEASUREMENT Com_RxAccessInfo[109].ConstValueArrayBasedInitValueStartIdxOfRxAccessInfo "" UBYTE Com_ConstValueArrayBasedInitValueStartIdxOfRxAccessInfoType 0 0 0 255 ECU_ADDRESS 0x0 /end MEASUREMENT
/begin MEASUREMENT Com_RxAccessInfo[109].DynSignalOfRxAccessInfo "" UBYTE Com_DynSignalOfRxAccessInfoType 0 0 0 1 ECU_ADDRESS 0x0 /end MEASUREMENT
/begin MEASUREMENT Com_RxAccessInfo[109].InitValueIdxOfRxAccessInfo "" UBYTE Com_InitValueIdxOfRxAccessInfoType 0 0 0 255 ECU_ADDRESS 0x0 /end MEASUREMENT
/begin MEASUREMENT Com_RxAccessInfo[109].InitValueOfRxAccessInfo "" UBYTE Com_InitValueOfRxAccessInfoType 0 0 0 255 ECU_ADDRESS 0x0 /end MEASUREMENT
/begin MEASUREMENT Com_RxAccessInfo[109].InvValueIdxOfRxAccessInfo "" UBYTE Com_InvValueIdxOfRxAccessInfoType 0 0 0 255 ECU_ADDRESS 0x0 /end MEASUREMENT
/begin MEASUREMENT Com_RxAccessInfo[109].InvValueOfRxAccessInfo "" UBYTE Com_InvValueOfRxAccessInfoType 0 0 0 255 ECU_ADDRESS 0x0 /end MEASUREMENT
/begin MEASUREMENT Com_RxAccessInfo[109].IsGroupSignalOfRxAccessInfo "" UBYTE Com_IsGroupSignalOfRxAccessInfoType 0 0 0 1 ECU_ADDRESS 0x0 /end MEASUREMENT
/begin MEASUREMENT Com_RxAccessInfo[109].RxDataTimeoutSubstitutionValueIdxOfRxAccessInfo "" UBYTE Com_RxDataTimeoutSubstitutionValueIdxOfRxAccessInfoType 0 0 0 255 ECU_ADDRESS 0x0 /end MEASUREMENT
/begin MEASUREMENT Com_RxAccessInfo[109].RxDataTimeoutSubstitutionValueOfRxAccessInfo "" UBYTE Com_RxDataTimeoutSubstitutionValueOfRxAccessInfoType 0 0 0 255 ECU_ADDRESS 0x0 /end MEASUREMENT
/begin MEASUREMENT Com_RxAccessInfo[109].RxPduInfoIdxOfRxAccessInfo "" UBYTE NO_COMPU_METHOD 0 0 0 255 ECU_ADDRESS 0x0 /end MEASUREMENT
/begin MEASUREMENT Com_RxAccessInfo[109].RxSigBufferArrayBasedBufferEndIdxOfRxAccessInfo "" UBYTE Com_RxSigBufferArrayBasedBufferEndIdxOfRxAccessInfoType 0 0 0 255 ECU_ADDRESS 0x0 /end MEASUREMENT
/begin MEASUREMENT Com_RxAccessInfo[109].RxSigBufferArrayBasedBufferStartIdxOfRxAccessInfo "" UBYTE Com_RxSigBufferArrayBasedBufferStartIdxOfRxAccessInfoType 0 0 0 255 ECU_ADDRESS 0x0 /end MEASUREMENT
/begin MEASUREMENT Com_RxAccessInfo[109].RxSigBufferArrayBasedShdBufferEndIdxOfRxAccessInfo "" UBYTE Com_RxSigBufferArrayBasedShdBufferEndIdxOfRxAccessInfoType 0 0 0 255 ECU_ADDRESS 0x0 /end MEASUREMENT
/begin MEASUREMENT Com_RxAccessInfo[109].RxSigBufferArrayBasedShdBufferStartIdxOfRxAccessInfo "" UBYTE Com_RxSigBufferArrayBasedShdBufferStartIdxOfRxAccessInfoType 0 0 0 255 ECU_ADDRESS 0x0 /end MEASUREMENT
/begin MEASUREMENT Com_RxAccessInfo[109].RxTOutInfoIdxOfRxAccessInfo "" UBYTE Com_RxTOutInfoIdxOfRxAccessInfoType 0 0 0 255 ECU_ADDRESS 0x0 /end MEASUREMENT
/begin MEASUREMENT Com_RxAccessInfo[109].ShdBufferIdxOfRxAccessInfo "" UWORD Com_ShdBufferIdxOfRxAccessInfoType 0 0 0 65535 ECU_ADDRESS 0x0 /end MEASUREMENT
/begin MEASUREMENT Com_RxAccessInfo[109].SignalLengthInByteOfRxAccessInfo "" UBYTE NO_COMPU_METHOD 0 0 0 255 ECU_ADDRESS 0x0 /end MEASUREMENT
/begin MEASUREMENT Com_RxAccessInfo[109].StartByteInPduPositionOfRxAccessInfo "" UBYTE NO_COMPU_METHOD 0 0 0 255 ECU_ADDRESS 0x0 /end MEASUREMENT
/begin MEASUREMENT Com_RxAccessInfo[109].TmpBufferIdxOfRxAccessInfo "" UBYTE Com_TmpBufferIdxOfRxAccessInfoType 0 0 0 255 ECU_ADDRESS 0x0 /end MEASUREMENT
/begin MEASUREMENT Com_RxAccessInfo[109].TmpBufferOfRxAccessInfo "" UBYTE Com_TmpBufferOfRxAccessInfoType 0 0 0 255 ECU_ADDRESS 0x0 /end MEASUREMENT
/begin MEASUREMENT Com_RxAccessInfo[109].TmpRxShdBufferArrayBasedTmpBufferEndIdxOfRxAccessInfo "" UBYTE Com_TmpRxShdBufferArrayBasedTmpBufferEndIdxOfRxAccessInfoType 0 0 0 255 ECU_ADDRESS 0x0 /end MEASUREMENT
/begin MEASUREMENT Com_RxAccessInfo[109].TmpRxShdBufferArrayBasedTmpBufferStartIdxOfRxAccessInfo "" UBYTE Com_TmpRxShdBufferArrayBasedTmpBufferStartIdxOfRxAccessInfoType 0 0 0 255 ECU_ADDRESS 0x0 /end MEASUREMENT
/begin MEASUREMENT Com_RxAccessInfo[10].ApplTypeOfRxAccessInfo "" UBYTE Com_ApplTypeOfRxAccessInfoType 0 0 0 255 ECU_ADDRESS 0x0 /end MEASUREMENT
/begin MEASUREMENT Com_RxAccessInfo[10].BitLengthOfRxAccessInfo "" UWORD NO_COMPU_METHOD 0 0 0 65535 ECU_ADDRESS 0x0 /end MEASUREMENT
/begin MEASUREMENT Com_RxAccessInfo[10].BitPositionOfRxAccessInfo "" UWORD NO_COMPU_METHOD 0 0 0 65535 ECU_ADDRESS 0x0 /end MEASUREMENT
/begin MEASUREMENT Com_RxAccessInfo[10].BufferIdxOfRxAccessInfo "" UWORD Com_BufferIdxOfRxAccessInfoType 0 0 0 65535 ECU_ADDRESS 0x0 /end MEASUREMENT
/begin MEASUREMENT Com_RxAccessInfo[10].BusAccOfRxAccessInfo "" UBYTE Com_BusAccOfRxAccessInfoType 0 0 0 255 ECU_ADDRESS 0x0 /end MEASUREMENT
/begin MEASUREMENT Com_RxAccessInfo[10].ByteLengthOfRxAccessInfo "" UBYTE NO_COMPU_METHOD 0 0 0 255 ECU_ADDRESS 0x0 /end MEASUREMENT
/begin MEASUREMENT Com_RxAccessInfo[10].ConstValueArrayBasedInitValueEndIdxOfRxAccessInfo "" UBYTE Com_ConstValueArrayBasedInitValueEndIdxOfRxAccessInfoType 0 0 0 255 ECU_ADDRESS 0x0 /end MEASUREMENT
/begin MEASUREMENT Com_RxAccessInfo[10].ConstValueArrayBasedInitValueStartIdxOfRxAccessInfo "" UBYTE Com_ConstValueArrayBasedInitValueStartIdxOfRxAccessInfoType 0 0 0 255 ECU_ADDRESS 0x0 /end MEASUREMENT
/begin MEASUREMENT Com_RxAccessInfo[10].DynSignalOfRxAccessInfo "" UBYTE Com_DynSignalOfRxAccessInfoType 0 0 0 1 ECU_ADDRESS 0x0 /end MEASUREMENT
/begin MEASUREMENT Com_RxAccessInfo[10].InitValueIdxOfRxAccessInfo "" UBYTE Com_InitValueIdxOfRxAccessInfoType 0 0 0 255 ECU_ADDRESS 0x0 /end MEASUREMENT
/begin MEASUREMENT Com_RxAccessInfo[10].InitValueOfRxAccessInfo "" UBYTE Com_InitValueOfRxAccessInfoType 0 0 0 255 ECU_ADDRESS 0x0 /end MEASUREMENT
/begin MEASUREMENT Com_RxAccessInfo[10].InvValueIdxOfRxAccessInfo "" UBYTE Com_InvValueIdxOfRxAccessInfoType 0 0 0 255 ECU_ADDRESS 0x0 /end MEASUREMENT
/begin MEASUREMENT Com_RxAccessInfo[10].InvValueOfRxAccessInfo "" UBYTE Com_InvValueOfRxAccessInfoType 0 0 0 255 ECU_ADDRESS 0x0 /end MEASUREMENT
/begin MEASUREMENT Com_RxAccessInfo[10].IsGroupSignalOfRxAccessInfo "" UBYTE Com_IsGroupSignalOfRxAccessInfoType 0 0 0 1 ECU_ADDRESS 0x0 /end MEASUREMENT
/begin MEASUREMENT Com_RxAccessInfo[10].RxDataTimeoutSubstitutionValueIdxOfRxAccessInfo "" UBYTE Com_RxDataTimeoutSubstitutionValueIdxOfRxAccessInfoType 0 0 0 255 ECU_ADDRESS 0x0 /end MEASUREMENT
/begin MEASUREMENT Com_RxAccessInfo[10].RxDataTimeoutSubstitutionValueOfRxAccessInfo "" UBYTE Com_RxDataTimeoutSubstitutionValueOfRxAccessInfoType 0 0 0 255 ECU_ADDRESS 0x0 /end MEASUREMENT
/begin MEASUREMENT Com_RxAccessInfo[10].RxPduInfoIdxOfRxAccessInfo "" UBYTE NO_COMPU_METHOD 0 0 0 255 ECU_ADDRESS 0x0 /end MEASUREMENT
/begin MEASUREMENT Com_RxAccessInfo[10].RxSigBufferArrayBasedBufferEndIdxOfRxAccessInfo "" UBYTE Com_RxSigBufferArrayBasedBufferEndIdxOfRxAccessInfoType 0 0 0 255 ECU_ADDRESS 0x0 /end MEASUREMENT
/begin MEASUREMENT Com_RxAccessInfo[10].RxSigBufferArrayBasedBufferStartIdxOfRxAccessInfo "" UBYTE Com_RxSigBufferArrayBasedBufferStartIdxOfRxAccessInfoType 0 0 0 255 ECU_ADDRESS 0x0 /end MEASUREMENT
/begin MEASUREMENT Com_RxAccessInfo[10].RxSigBufferArrayBasedShdBufferEndIdxOfRxAccessInfo "" UBYTE Com_RxSigBufferArrayBasedShdBufferEndIdxOfRxAccessInfoType 0 0 0 255 ECU_ADDRESS 0x0 /end MEASUREMENT
/begin MEASUREMENT Com_RxAccessInfo[10].RxSigBufferArrayBasedShdBufferStartIdxOfRxAccessInfo "" UBYTE Com_RxSigBufferArrayBasedShdBufferStartIdxOfRxAccessInfoType 0 0 0 255 ECU_ADDRESS 0x0 /end MEASUREMENT
/begin MEASUREMENT Com_RxAccessInfo[10].RxTOutInfoIdxOfRxAccessInfo "" UBYTE Com_RxTOutInfoIdxOfRxAccessInfoType 0 0 0 255 ECU_ADDRESS 0x0 /end MEASUREMENT
/begin MEASUREMENT Com_RxAccessInfo[10].ShdBufferIdxOfRxAccessInfo "" UWORD Com_ShdBufferIdxOfRxAccessInfoType 0 0 0 65535 ECU_ADDRESS 0x0 /end MEASUREMENT
/begin MEASUREMENT Com_RxAccessInfo[10].SignalLengthInByteOfRxAccessInfo "" UBYTE NO_COMPU_METHOD 0 0 0 255 ECU_ADDRESS 0x0 /end MEASUREMENT
/begin MEASUREMENT Com_RxAccessInfo[10].StartByteInPduPositionOfRxAccessInfo "" UBYTE NO_COMPU_METHOD 0 0 0 255 ECU_ADDRESS 0x0 /end MEASUREMENT
/begin MEASUREMENT Com_RxAccessInfo[10].TmpBufferIdxOfRxAccessInfo "" UBYTE Com_TmpBufferIdxOfRxAccessInfoType 0 0 0 255 ECU_ADDRESS 0x0 /end MEASUREMENT
/begin MEASUREMENT Com_RxAccessInfo[10].TmpBufferOfRxAccessInfo "" UBYTE Com_TmpBufferOfRxAccessInfoType 0 0 0 255 ECU_ADDRESS 0x0 /end MEASUREMENT
/begin MEASUREMENT Com_RxAccessInfo[10].TmpRxShdBufferArrayBasedTmpBufferEndIdxOfRxAccessInfo "" UBYTE Com_TmpRxShdBufferArrayBasedTmpBufferEndIdxOfRxAccessInfoType 0 0 0 255 ECU_ADDRESS 0x0 /end MEASUREMENT
/begin MEASUREMENT Com_RxAccessInfo[10].TmpRxShdBufferArrayBasedTmpBufferStartIdxOfRxAccessInfo "" UBYTE Com_TmpRxShdBufferArrayBasedTmpBufferStartIdxOfRxAccessInfoType 0 0 0 255 ECU_ADDRESS 0x0 /end MEASUREMENT
/begin MEASUREMENT Com_RxAccessInfo[110].ApplTypeOfRxAccessInfo "" UBYTE Com_ApplTypeOfRxAccessInfoType 0 0 0 255 ECU_ADDRESS 0x0 /end MEASUREMENT
/begin MEASUREMENT Com_RxAccessInfo[110].BitLengthOfRxAccessInfo "" UWORD NO_COMPU_METHOD 0 0 0 65535 ECU_ADDRESS 0x0 /end MEASUREMENT
/begin MEASUREMENT Com_RxAccessInfo[110].BitPositionOfRxAccessInfo "" UWORD NO_COMPU_METHOD 0 0 0 65535 ECU_ADDRESS 0x0 /end MEASUREMENT
/begin MEASUREMENT Com_RxAccessInfo[110].BufferIdxOfRxAccessInfo "" UWORD Com_BufferIdxOfRxAccessInfoType 0 0 0 65535 ECU_ADDRESS 0x0 /end MEASUREMENT
/begin MEASUREMENT Com_RxAccessInfo[110].BusAccOfRxAccessInfo "" UBYTE Com_BusAccOfRxAccessInfoType 0 0 0 255 ECU_ADDRESS 0x0 /end MEASUREMENT
/begin MEASUREMENT Com_RxAccessInfo[110].ByteLengthOfRxAccessInfo "" UBYTE NO_COMPU_METHOD 0 0 0 255 ECU_ADDRESS 0x0 /end MEASUREMENT
/begin MEASUREMENT Com_RxAccessInfo[110].ConstValueArrayBasedInitValueEndIdxOfRxAccessInfo "" UBYTE Com_ConstValueArrayBasedInitValueEndIdxOfRxAccessInfoType 0 0 0 255 ECU_ADDRESS 0x0 /end MEASUREMENT
/begin MEASUREMENT Com_RxAccessInfo[110].ConstValueArrayBasedInitValueStartIdxOfRxAccessInfo "" UBYTE Com_ConstValueArrayBasedInitValueStartIdxOfRxAccessInfoType 0 0 0 255 ECU_ADDRESS 0x0 /end MEASUREMENT
/begin MEASUREMENT Com_RxAccessInfo[110].DynSignalOfRxAccessInfo "" UBYTE Com_DynSignalOfRxAccessInfoType 0 0 0 1 ECU_ADDRESS 0x0 /end MEASUREMENT
/begin MEASUREMENT Com_RxAccessInfo[110].InitValueIdxOfRxAccessInfo "" UBYTE Com_InitValueIdxOfRxAccessInfoType 0 0 0 255 ECU_ADDRESS 0x0 /end MEASUREMENT
/begin MEASUREMENT Com_RxAccessInfo[110].InitValueOfRxAccessInfo "" UBYTE Com_InitValueOfRxAccessInfoType 0 0 0 255 ECU_ADDRESS 0x0 /end MEASUREMENT
/begin MEASUREMENT Com_RxAccessInfo[110].InvValueIdxOfRxAccessInfo "" UBYTE Com_InvValueIdxOfRxAccessInfoType 0 0 0 255 ECU_ADDRESS 0x0 /end MEASUREMENT
/begin MEASUREMENT Com_RxAccessInfo[110].InvValueOfRxAccessInfo "" UBYTE Com_InvValueOfRxAccessInfoType 0 0 0 255 ECU_ADDRESS 0x0 /end MEASUREMENT
/begin MEASUREMENT Com_RxAccessInfo[110].IsGroupSignalOfRxAccessInfo "" UBYTE Com_IsGroupSignalOfRxAccessInfoType 0 0 0 1 ECU_ADDRESS 0x0 /end MEASUREMENT
/begin MEASUREMENT Com_RxAccessInfo[110].RxDataTimeoutSubstitutionValueIdxOfRxAccessInfo "" UBYTE Com_RxDataTimeoutSubstitutionValueIdxOfRxAccessInfoType 0 0 0 255 ECU_ADDRESS 0x0 /end MEASUREMENT
/begin MEASUREMENT Com_RxAccessInfo[110].RxDataTimeoutSubstitutionValueOfRxAccessInfo "" UBYTE Com_RxDataTimeoutSubstitutionValueOfRxAccessInfoType 0 0 0 255 ECU_ADDRESS 0x0 /end MEASUREMENT
/begin MEASUREMENT Com_RxAccessInfo[110].RxPduInfoIdxOfRxAccessInfo "" UBYTE NO_COMPU_METHOD 0 0 0 255 ECU_ADDRESS 0x0 /end MEASUREMENT
/begin MEASUREMENT Com_RxAccessInfo[110].RxSigBufferArrayBasedBufferEndIdxOfRxAccessInfo "" UBYTE Com_RxSigBufferArrayBasedBufferEndIdxOfRxAccessInfoType 0 0 0 255 ECU_ADDRESS 0x0 /end MEASUREMENT
/begin MEASUREMENT Com_RxAccessInfo[110].RxSigBufferArrayBasedBufferStartIdxOfRxAccessInfo "" UBYTE Com_RxSigBufferArrayBasedBufferStartIdxOfRxAccessInfoType 0 0 0 255 ECU_ADDRESS 0x0 /end MEASUREMENT
/begin MEASUREMENT Com_RxAccessInfo[110].RxSigBufferArrayBasedShdBufferEndIdxOfRxAccessInfo "" UBYTE Com_RxSigBufferArrayBasedShdBufferEndIdxOfRxAccessInfoType 0 0 0 255 ECU_ADDRESS 0x0 /end MEASUREMENT
/begin MEASUREMENT Com_RxAccessInfo[110].RxSigBufferArrayBasedShdBufferStartIdxOfRxAccessInfo "" UBYTE Com_RxSigBufferArrayBasedShdBufferStartIdxOfRxAccessInfoType 0 0 0 255 ECU_ADDRESS 0x0 /end MEASUREMENT
/begin MEASUREMENT Com_RxAccessInfo[110].RxTOutInfoIdxOfRxAccessInfo "" UBYTE Com_RxTOutInfoIdxOfRxAccessInfoType 0 0 0 255 ECU_ADDRESS 0x0 /end MEASUREMENT
/begin MEASUREMENT Com_RxAccessInfo[110].ShdBufferIdxOfRxAccessInfo "" UWORD Com_ShdBufferIdxOfRxAccessInfoType 0 0 0 65535 ECU_ADDRESS 0x0 /end MEASUREMENT
/begin MEASUREMENT Com_RxAccessInfo[110].SignalLengthInByteOfRxAccessInfo "" UBYTE NO_COMPU_METHOD 0 0 0 255 ECU_ADDRESS 0x0 /end MEASUREMENT
/begin MEASUREMENT Com_RxAccessInfo[110].StartByteInPduPositionOfRxAccessInfo "" UBYTE NO_COMPU_METHOD 0 0 0 255 ECU_ADDRESS 0x0 /end MEASUREMENT
/begin MEASUREMENT Com_RxAccessInfo[110].TmpBufferIdxOfRxAccessInfo "" UBYTE Com_TmpBufferIdxOfRxAccessInfoType 0 0 0 255 ECU_ADDRESS 0x0 /end MEASUREMENT
/begin MEASUREMENT Com_RxAccessInfo[110].TmpBufferOfRxAccessInfo "" UBYTE Com_TmpBufferOfRxAccessInfoType 0 0 0 255 ECU_ADDRESS 0x0 /end MEASUREMENT
/begin MEASUREMENT Com_RxAccessInfo[110].TmpRxShdBufferArrayBasedTmpBufferEndIdxOfRxAccessInfo "" UBYTE Com_TmpRxShdBufferArrayBasedTmpBufferEndIdxOfRxAccessInfoType 0 0 0 255 ECU_ADDRESS 0x0 /end MEASUREMENT
/begin MEASUREMENT Com_RxAccessInfo[110].TmpRxShdBufferArrayBasedTmpBufferStartIdxOfRxAccessInfo "" UBYTE Com_TmpRxShdBufferArrayBasedTmpBufferStartIdxOfRxAccessInfoType 0 0 0 255 ECU_ADDRESS 0x0 /end MEASUREMENT
/begin MEASUREMENT Com_RxAccessInfo[111].ApplTypeOfRxAccessInfo "" UBYTE Com_ApplTypeOfRxAccessInfoType 0 0 0 255 ECU_ADDRESS 0x0 /end MEASUREMENT
/begin MEASUREMENT Com_RxAccessInfo[111].BitLengthOfRxAccessInfo "" UWORD NO_COMPU_METHOD 0 0 0 65535 ECU_ADDRESS 0x0 /end MEASUREMENT
/begin MEASUREMENT Com_RxAccessInfo[111].BitPositionOfRxAccessInfo "" UWORD NO_COMPU_METHOD 0 0 0 65535 ECU_ADDRESS 0x0 /end MEASUREMENT
/begin MEASUREMENT Com_RxAccessInfo[111].BufferIdxOfRxAccessInfo "" UWORD Com_BufferIdxOfRxAccessInfoType 0 0 0 65535 ECU_ADDRESS 0x0 /end MEASUREMENT
/begin MEASUREMENT Com_RxAccessInfo[111].BusAccOfRxAccessInfo "" UBYTE Com_BusAccOfRxAccessInfoType 0 0 0 255 ECU_ADDRESS 0x0 /end MEASUREMENT
/begin MEASUREMENT Com_RxAccessInfo[111].ByteLengthOfRxAccessInfo "" UBYTE NO_COMPU_METHOD 0 0 0 255 ECU_ADDRESS 0x0 /end MEASUREMENT
/begin MEASUREMENT Com_RxAccessInfo[111].ConstValueArrayBasedInitValueEndIdxOfRxAccessInfo "" UBYTE Com_ConstValueArrayBasedInitValueEndIdxOfRxAccessInfoType 0 0 0 255 ECU_ADDRESS 0x0 /end MEASUREMENT
/begin MEASUREMENT Com_RxAccessInfo[111].ConstValueArrayBasedInitValueStartIdxOfRxAccessInfo "" UBYTE Com_ConstValueArrayBasedInitValueStartIdxOfRxAccessInfoType 0 0 0 255 ECU_ADDRESS 0x0 /end MEASUREMENT
/begin MEASUREMENT Com_RxAccessInfo[111].DynSignalOfRxAccessInfo "" UBYTE Com_DynSignalOfRxAccessInfoType 0 0 0 1 ECU_ADDRESS 0x0 /end MEASUREMENT
/begin MEASUREMENT Com_RxAccessInfo[111].InitValueIdxOfRxAccessInfo "" UBYTE Com_InitValueIdxOfRxAccessInfoType 0 0 0 255 ECU_ADDRESS 0x0 /end MEASUREMENT
/begin MEASUREMENT Com_RxAccessInfo[111].InitValueOfRxAccessInfo "" UBYTE Com_InitValueOfRxAccessInfoType 0 0 0 255 ECU_ADDRESS 0x0 /end MEASUREMENT
/begin MEASUREMENT Com_RxAccessInfo[111].InvValueIdxOfRxAccessInfo "" UBYTE Com_InvValueIdxOfRxAccessInfoType 0 0 0 255 ECU_ADDRESS 0x0 /end MEASUREMENT
/begin MEASUREMENT Com_RxAccessInfo[111].InvValueOfRxAccessInfo "" UBYTE Com_InvValueOfRxAccessInfoType 0 0 0 255 ECU_ADDRESS 0x0 /end MEASUREMENT
/begin MEASUREMENT Com_RxAccessInfo[111].IsGroupSignalOfRxAccessInfo "" UBYTE Com_IsGroupSignalOfRxAccessInfoType 0 0 0 1 ECU_ADDRESS 0x0 /end MEASUREMENT
/begin MEASUREMENT Com_RxAccessInfo[111].RxDataTimeoutSubstitutionValueIdxOfRxAccessInfo "" UBYTE Com_RxDataTimeoutSubstitutionValueIdxOfRxAccessInfoType 0 0 0 255 ECU_ADDRESS 0x0 /end MEASUREMENT
/begin MEASUREMENT Com_RxAccessInfo[111].RxDataTimeoutSubstitutionValueOfRxAccessInfo "" UBYTE Com_RxDataTimeoutSubstitutionValueOfRxAccessInfoType 0 0 0 255 ECU_ADDRESS 0x0 /end MEASUREMENT
/begin MEASUREMENT Com_RxAccessInfo[111].RxPduInfoIdxOfRxAccessInfo "" UBYTE NO_COMPU_METHOD 0 0 0 255 ECU_ADDRESS 0x0 /end MEASUREMENT
/begin MEASUREMENT Com_RxAccessInfo[111].RxSigBufferArrayBasedBufferEndIdxOfRxAccessInfo "" UBYTE Com_RxSigBufferArrayBasedBufferEndIdxOfRxAccessInfoType 0 0 0 255 ECU_ADDRESS 0x0 /end MEASUREMENT
/begin MEASUREMENT Com_RxAccessInfo[111].RxSigBufferArrayBasedBufferStartIdxOfRxAccessInfo "" UBYTE Com_RxSigBufferArrayBasedBufferStartIdxOfRxAccessInfoType 0 0 0 255 ECU_ADDRESS 0x0 /end MEASUREMENT
/begin MEASUREMENT Com_RxAccessInfo[111].RxSigBufferArrayBasedShdBufferEndIdxOfRxAccessInfo "" UBYTE Com_RxSigBufferArrayBasedShdBufferEndIdxOfRxAccessInfoType 0 0 0 255 ECU_ADDRESS 0x0 /end MEASUREMENT
/begin MEASUREMENT Com_RxAccessInfo[111].RxSigBufferArrayBasedShdBufferStartIdxOfRxAccessInfo "" UBYTE Com_RxSigBufferArrayBasedShdBufferStartIdxOfRxAccessInfoType 0 0 0 255 ECU_ADDRESS 0x0 /end MEASUREMENT
/begin MEASUREMENT Com_RxAccessInfo[111].RxTOutInfoIdxOfRxAccessInfo "" UBYTE Com_RxTOutInfoIdxOfRxAccessInfoType 0 0 0 255 ECU_ADDRESS 0x0 /end MEASUREMENT
/begin MEASUREMENT Com_RxAccessInfo[111].ShdBufferIdxOfRxAccessInfo "" UWORD Com_ShdBufferIdxOfRxAccessInfoType 0 0 0 65535 ECU_ADDRESS 0x0 /end MEASUREMENT
/begin MEASUREMENT Com_RxAccessInfo[111].SignalLengthInByteOfRxAccessInfo "" UBYTE NO_COMPU_METHOD 0 0 0 255 ECU_ADDRESS 0x0 /end MEASUREMENT
/begin MEASUREMENT Com_RxAccessInfo[111].StartByteInPduPositionOfRxAccessInfo "" UBYTE NO_COMPU_METHOD 0 0 0 255 ECU_ADDRESS 0x0 /end MEASUREMENT
/begin MEASUREMENT Com_RxAccessInfo[111].TmpBufferIdxOfRxAccessInfo "" UBYTE Com_TmpBufferIdxOfRxAccessInfoType 0 0 0 255 ECU_ADDRESS 0x0 /end MEASUREMENT
/begin MEASUREMENT Com_RxAccessInfo[111].TmpBufferOfRxAccessInfo "" UBYTE Com_TmpBufferOfRxAccessInfoType 0 0 0 255 ECU_ADDRESS 0x0 /end MEASUREMENT
/begin MEASUREMENT Com_RxAccessInfo[111].TmpRxShdBufferArrayBasedTmpBufferEndIdxOfRxAccessInfo "" UBYTE Com_TmpRxShdBufferArrayBasedTmpBufferEndIdxOfRxAccessInfoType 0 0 0 255 ECU_ADDRESS 0x0 /end MEASUREMENT
/begin MEASUREMENT Com_RxAccessInfo[111].TmpRxShdBufferArrayBasedTmpBufferStartIdxOfRxAccessInfo "" UBYTE Com_TmpRxShdBufferArrayBasedTmpBufferStartIdxOfRxAccessInfoType 0 0 0 255 ECU_ADDRESS 0x0 /end MEASUREMENT
/begin MEASUREMENT Com_RxAccessInfo[112].ApplTypeOfRxAccessInfo "" UBYTE Com_ApplTypeOfRxAccessInfoType 0 0 0 255 ECU_ADDRESS 0x0 /end MEASUREMENT
/begin MEASUREMENT Com_RxAccessInfo[112].BitLengthOfRxAccessInfo "" UWORD NO_COMPU_METHOD 0 0 0 65535 ECU_ADDRESS 0x0 /end MEASUREMENT
/begin MEASUREMENT Com_RxAccessInfo[112].BitPositionOfRxAccessInfo "" UWORD NO_COMPU_METHOD 0 0 0 65535 ECU_ADDRESS 0x0 /end MEASUREMENT
/begin MEASUREMENT Com_RxAccessInfo[112].BufferIdxOfRxAccessInfo "" UWORD Com_BufferIdxOfRxAccessInfoType 0 0 0 65535 ECU_ADDRESS 0x0 /end MEASUREMENT
/begin MEASUREMENT Com_RxAccessInfo[112].BusAccOfRxAccessInfo "" UBYTE Com_BusAccOfRxAccessInfoType 0 0 0 255 ECU_ADDRESS 0x0 /end MEASUREMENT
/begin MEASUREMENT Com_RxAccessInfo[112].ByteLengthOfRxAccessInfo "" UBYTE NO_COMPU_METHOD 0 0 0 255 ECU_ADDRESS 0x0 /end MEASUREMENT
/begin MEASUREMENT Com_RxAccessInfo[112].ConstValueArrayBasedInitValueEndIdxOfRxAccessInfo "" UBYTE Com_ConstValueArrayBasedInitValueEndIdxOfRxAccessInfoType 0 0 0 255 ECU_ADDRESS 0x0 /end MEASUREMENT
/begin MEASUREMENT Com_RxAccessInfo[112].ConstValueArrayBasedInitValueStartIdxOfRxAccessInfo "" UBYTE Com_ConstValueArrayBasedInitValueStartIdxOfRxAccessInfoType 0 0 0 255 ECU_ADDRESS 0x0 /end MEASUREMENT
/begin MEASUREMENT Com_RxAccessInfo[112].DynSignalOfRxAccessInfo "" UBYTE Com_DynSignalOfRxAccessInfoType 0 0 0 1 ECU_ADDRESS 0x0 /end MEASUREMENT
/begin MEASUREMENT Com_RxAccessInfo[112].InitValueIdxOfRxAccessInfo "" UBYTE Com_InitValueIdxOfRxAccessInfoType 0 0 0 255 ECU_ADDRESS 0x0 /end MEASUREMENT
/begin MEASUREMENT Com_RxAccessInfo[112].InitValueOfRxAccessInfo "" UBYTE Com_InitValueOfRxAccessInfoType 0 0 0 255 ECU_ADDRESS 0x0 /end MEASUREMENT
/begin MEASUREMENT Com_RxAccessInfo[112].InvValueIdxOfRxAccessInfo "" UBYTE Com_InvValueIdxOfRxAccessInfoType 0 0 0 255 ECU_ADDRESS 0x0 /end MEASUREMENT
/begin MEASUREMENT Com_RxAccessInfo[112].InvValueOfRxAccessInfo "" UBYTE Com_InvValueOfRxAccessInfoType 0 0 0 255 ECU_ADDRESS 0x0 /end MEASUREMENT
/begin MEASUREMENT Com_RxAccessInfo[112].IsGroupSignalOfRxAccessInfo "" UBYTE Com_IsGroupSignalOfRxAccessInfoType 0 0 0 1 ECU_ADDRESS 0x0 /end MEASUREMENT
/begin MEASUREMENT Com_RxAccessInfo[112].RxDataTimeoutSubstitutionValueIdxOfRxAccessInfo "" UBYTE Com_RxDataTimeoutSubstitutionValueIdxOfRxAccessInfoType 0 0 0 255 ECU_ADDRESS 0x0 /end MEASUREMENT
/begin MEASUREMENT Com_RxAccessInfo[112].RxDataTimeoutSubstitutionValueOfRxAccessInfo "" UBYTE Com_RxDataTimeoutSubstitutionValueOfRxAccessInfoType 0 0 0 255 ECU_ADDRESS 0x0 /end MEASUREMENT
/begin MEASUREMENT Com_RxAccessInfo[112].RxPduInfoIdxOfRxAccessInfo "" UBYTE NO_COMPU_METHOD 0 0 0 255 ECU_ADDRESS 0x0 /end MEASUREMENT
/begin MEASUREMENT Com_RxAccessInfo[112].RxSigBufferArrayBasedBufferEndIdxOfRxAccessInfo "" UBYTE Com_RxSigBufferArrayBasedBufferEndIdxOfRxAccessInfoType 0 0 0 255 ECU_ADDRESS 0x0 /end MEASUREMENT
/begin MEASUREMENT Com_RxAccessInfo[112].RxSigBufferArrayBasedBufferStartIdxOfRxAccessInfo "" UBYTE Com_RxSigBufferArrayBasedBufferStartIdxOfRxAccessInfoType 0 0 0 255 ECU_ADDRESS 0x0 /end MEASUREMENT
/begin MEASUREMENT Com_RxAccessInfo[112].RxSigBufferArrayBasedShdBufferEndIdxOfRxAccessInfo "" UBYTE Com_RxSigBufferArrayBasedShdBufferEndIdxOfRxAccessInfoType 0 0 0 255 ECU_ADDRESS 0x0 /end MEASUREMENT
/begin MEASUREMENT Com_RxAccessInfo[112].RxSigBufferArrayBasedShdBufferStartIdxOfRxAccessInfo "" UBYTE Com_RxSigBufferArrayBasedShdBufferStartIdxOfRxAccessInfoType 0 0 0 255 ECU_ADDRESS 0x0 /end MEASUREMENT
/begin MEASUREMENT Com_RxAccessInfo[112].RxTOutInfoIdxOfRxAccessInfo "" UBYTE Com_RxTOutInfoIdxOfRxAccessInfoType 0 0 0 255 ECU_ADDRESS 0x0 /end MEASUREMENT
/begin MEASUREMENT Com_RxAccessInfo[112].ShdBufferIdxOfRxAccessInfo "" UWORD Com_ShdBufferIdxOfRxAccessInfoType 0 0 0 65535 ECU_ADDRESS 0x0 /end MEASUREMENT
/begin MEASUREMENT Com_RxAccessInfo[112].SignalLengthInByteOfRxAccessInfo "" UBYTE NO_COMPU_METHOD 0 0 0 255 ECU_ADDRESS 0x0 /end MEASUREMENT
/begin MEASUREMENT Com_RxAccessInfo[112].StartByteInPduPositionOfRxAccessInfo "" UBYTE NO_COMPU_METHOD 0 0 0 255 ECU_ADDRESS 0x0 /end MEASUREMENT
/begin MEASUREMENT Com_RxAccessInfo[112].TmpBufferIdxOfRxAccessInfo "" UBYTE Com_TmpBufferIdxOfRxAccessInfoType 0 0 0 255 ECU_ADDRESS 0x0 /end MEASUREMENT
/begin MEASUREMENT Com_RxAccessInfo[112].TmpBufferOfRxAccessInfo "" UBYTE Com_TmpBufferOfRxAccessInfoType 0 0 0 255 ECU_ADDRESS 0x0 /end MEASUREMENT
/begin MEASUREMENT Com_RxAccessInfo[112].TmpRxShdBufferArrayBasedTmpBufferEndIdxOfRxAccessInfo "" UBYTE Com_TmpRxShdBufferArrayBasedTmpBufferEndIdxOfRxAccessInfoType 0 0 0 255 ECU_ADDRESS 0x0 /end MEASUREMENT
/begin MEASUREMENT Com_RxAccessInfo[112].TmpRxShdBufferArrayBasedTmpBufferStartIdxOfRxAccessInfo "" UBYTE Com_TmpRxShdBufferArrayBasedTmpBufferStartIdxOfRxAccessInfoType 0 0 0 255 ECU_ADDRESS 0x0 /end MEASUREMENT
/begin MEASUREMENT Com_RxAccessInfo[113].ApplTypeOfRxAccessInfo "" UBYTE Com_ApplTypeOfRxAccessInfoType 0 0 0 255 ECU_ADDRESS 0x0 /end MEASUREMENT
/begin MEASUREMENT Com_RxAccessInfo[113].BitLengthOfRxAccessInfo "" UWORD NO_COMPU_METHOD 0 0 0 65535 ECU_ADDRESS 0x0 /end MEASUREMENT
/begin MEASUREMENT Com_RxAccessInfo[113].BitPositionOfRxAccessInfo "" UWORD NO_COMPU_METHOD 0 0 0 65535 ECU_ADDRESS 0x0 /end MEASUREMENT
/begin MEASUREMENT Com_RxAccessInfo[113].BufferIdxOfRxAccessInfo "" UWORD Com_BufferIdxOfRxAccessInfoType 0 0 0 65535 ECU_ADDRESS 0x0 /end MEASUREMENT
/begin MEASUREMENT Com_RxAccessInfo[113].BusAccOfRxAccessInfo "" UBYTE Com_BusAccOfRxAccessInfoType 0 0 0 255 ECU_ADDRESS 0x0 /end MEASUREMENT
/begin MEASUREMENT Com_RxAccessInfo[113].ByteLengthOfRxAccessInfo "" UBYTE NO_COMPU_METHOD 0 0 0 255 ECU_ADDRESS 0x0 /end MEASUREMENT
/begin MEASUREMENT Com_RxAccessInfo[113].ConstValueArrayBasedInitValueEndIdxOfRxAccessInfo "" UBYTE Com_ConstValueArrayBasedInitValueEndIdxOfRxAccessInfoType 0 0 0 255 ECU_ADDRESS 0x0 /end MEASUREMENT
/begin MEASUREMENT Com_RxAccessInfo[113].ConstValueArrayBasedInitValueStartIdxOfRxAccessInfo "" UBYTE Com_ConstValueArrayBasedInitValueStartIdxOfRxAccessInfoType 0 0 0 255 ECU_ADDRESS 0x0 /end MEASUREMENT
/begin MEASUREMENT Com_RxAccessInfo[113].DynSignalOfRxAccessInfo "" UBYTE Com_DynSignalOfRxAccessInfoType 0 0 0 1 ECU_ADDRESS 0x0 /end MEASUREMENT
/begin MEASUREMENT Com_RxAccessInfo[113].InitValueIdxOfRxAccessInfo "" UBYTE Com_InitValueIdxOfRxAccessInfoType 0 0 0 255 ECU_ADDRESS 0x0 /end MEASUREMENT
/begin MEASUREMENT Com_RxAccessInfo[113].InitValueOfRxAccessInfo "" UBYTE Com_InitValueOfRxAccessInfoType 0 0 0 255 ECU_ADDRESS 0x0 /end MEASUREMENT
/begin MEASUREMENT Com_RxAccessInfo[113].InvValueIdxOfRxAccessInfo "" UBYTE Com_InvValueIdxOfRxAccessInfoType 0 0 0 255 ECU_ADDRESS 0x0 /end MEASUREMENT
/begin MEASUREMENT Com_RxAccessInfo[113].InvValueOfRxAccessInfo "" UBYTE Com_InvValueOfRxAccessInfoType 0 0 0 255 ECU_ADDRESS 0x0 /end MEASUREMENT
/begin MEASUREMENT Com_RxAccessInfo[113].IsGroupSignalOfRxAccessInfo "" UBYTE Com_IsGroupSignalOfRxAccessInfoType 0 0 0 1 ECU_ADDRESS 0x0 /end MEASUREMENT
/begin MEASUREMENT Com_RxAccessInfo[113].RxDataTimeoutSubstitutionValueIdxOfRxAccessInfo "" UBYTE Com_RxDataTimeoutSubstitutionValueIdxOfRxAccessInfoType 0 0 0 255 ECU_ADDRESS 0x0 /end MEASUREMENT
/begin MEASUREMENT Com_RxAccessInfo[113].RxDataTimeoutSubstitutionValueOfRxAccessInfo "" UBYTE Com_RxDataTimeoutSubstitutionValueOfRxAccessInfoType 0 0 0 255 ECU_ADDRESS 0x0 /end MEASUREMENT
/begin MEASUREMENT Com_RxAccessInfo[113].RxPduInfoIdxOfRxAccessInfo "" UBYTE NO_COMPU_METHOD 0 0 0 255 ECU_ADDRESS 0x0 /end MEASUREMENT
/begin MEASUREMENT Com_RxAccessInfo[113].RxSigBufferArrayBasedBufferEndIdxOfRxAccessInfo "" UBYTE Com_RxSigBufferArrayBasedBufferEndIdxOfRxAccessInfoType 0 0 0 255 ECU_ADDRESS 0x0 /end MEASUREMENT
/begin MEASUREMENT Com_RxAccessInfo[113].RxSigBufferArrayBasedBufferStartIdxOfRxAccessInfo "" UBYTE Com_RxSigBufferArrayBasedBufferStartIdxOfRxAccessInfoType 0 0 0 255 ECU_ADDRESS 0x0 /end MEASUREMENT
/begin MEASUREMENT Com_RxAccessInfo[113].RxSigBufferArrayBasedShdBufferEndIdxOfRxAccessInfo "" UBYTE Com_RxSigBufferArrayBasedShdBufferEndIdxOfRxAccessInfoType 0 0 0 255 ECU_ADDRESS 0x0 /end MEASUREMENT
/begin MEASUREMENT Com_RxAccessInfo[113].RxSigBufferArrayBasedShdBufferStartIdxOfRxAccessInfo "" UBYTE Com_RxSigBufferArrayBasedShdBufferStartIdxOfRxAccessInfoType 0 0 0 255 ECU_ADDRESS 0x0 /end MEASUREMENT
/begin MEASUREMENT Com_RxAccessInfo[113].RxTOutInfoIdxOfRxAccessInfo "" UBYTE Com_RxTOutInfoIdxOfRxAccessInfoType 0 0 0 255 ECU_ADDRESS 0x0 /end MEASUREMENT
/begin MEASUREMENT Com_RxAccessInfo[113].ShdBufferIdxOfRxAccessInfo "" UWORD Com_ShdBufferIdxOfRxAccessInfoType 0 0 0 65535 ECU_ADDRESS 0x0 /end MEASUREMENT
/begin MEASUREMENT Com_RxAccessInfo[113].SignalLengthInByteOfRxAccessInfo "" UBYTE NO_COMPU_METHOD 0 0 0 255 ECU_ADDRESS 0x0 /end MEASUREMENT
/begin MEASUREMENT Com_RxAccessInfo[113].StartByteInPduPositionOfRxAccessInfo "" UBYTE NO_COMPU_METHOD 0 0 0 255 ECU_ADDRESS 0x0 /end MEASUREMENT
/begin MEASUREMENT Com_RxAccessInfo[113].TmpBufferIdxOfRxAccessInfo "" UBYTE Com_TmpBufferIdxOfRxAccessInfoType 0 0 0 255 ECU_ADDRESS 0x0 /end MEASUREMENT
/begin MEASUREMENT Com_RxAccessInfo[113].TmpBufferOfRxAccessInfo "" UBYTE Com_TmpBufferOfRxAccessInfoType 0 0 0 255 ECU_ADDRESS 0x0 /end MEASUREMENT
/begin MEASUREMENT Com_RxAccessInfo[113].TmpRxShdBufferArrayBasedTmpBufferEndIdxOfRxAccessInfo "" UBYTE Com_TmpRxShdBufferArrayBasedTmpBufferEndIdxOfRxAccessInfoType 0 0 0 255 ECU_ADDRESS 0x0 /end MEASUREMENT
/begin MEASUREMENT Com_RxAccessInfo[113].TmpRxShdBufferArrayBasedTmpBufferStartIdxOfRxAccessInfo "" UBYTE Com_TmpRxShdBufferArrayBasedTmpBufferStartIdxOfRxAccessInfoType 0 0 0 255 ECU_ADDRESS 0x0 /end MEASUREMENT
/begin MEASUREMENT Com_RxAccessInfo[114].ApplTypeOfRxAccessInfo "" UBYTE Com_ApplTypeOfRxAccessInfoType 0 0 0 255 ECU_ADDRESS 0x0 /end MEASUREMENT
/begin MEASUREMENT Com_RxAccessInfo[114].BitLengthOfRxAccessInfo "" UWORD NO_COMPU_METHOD 0 0 0 65535 ECU_ADDRESS 0x0 /end MEASUREMENT
/begin MEASUREMENT Com_RxAccessInfo[114].BitPositionOfRxAccessInfo "" UWORD NO_COMPU_METHOD 0 0 0 65535 ECU_ADDRESS 0x0 /end MEASUREMENT
/begin MEASUREMENT Com_RxAccessInfo[114].BufferIdxOfRxAccessInfo "" UWORD Com_BufferIdxOfRxAccessInfoType 0 0 0 65535 ECU_ADDRESS 0x0 /end MEASUREMENT
/begin MEASUREMENT Com_RxAccessInfo[114].BusAccOfRxAccessInfo "" UBYTE Com_BusAccOfRxAccessInfoType 0 0 0 255 ECU_ADDRESS 0x0 /end MEASUREMENT
/begin MEASUREMENT Com_RxAccessInfo[114].ByteLengthOfRxAccessInfo "" UBYTE NO_COMPU_METHOD 0 0 0 255 ECU_ADDRESS 0x0 /end MEASUREMENT
/begin MEASUREMENT Com_RxAccessInfo[114].ConstValueArrayBasedInitValueEndIdxOfRxAccessInfo "" UBYTE Com_ConstValueArrayBasedInitValueEndIdxOfRxAccessInfoType 0 0 0 255 ECU_ADDRESS 0x0 /end MEASUREMENT
/begin MEASUREMENT Com_RxAccessInfo[114].ConstValueArrayBasedInitValueStartIdxOfRxAccessInfo "" UBYTE Com_ConstValueArrayBasedInitValueStartIdxOfRxAccessInfoType 0 0 0 255 ECU_ADDRESS 0x0 /end MEASUREMENT
/begin MEASUREMENT Com_RxAccessInfo[114].DynSignalOfRxAccessInfo "" UBYTE Com_DynSignalOfRxAccessInfoType 0 0 0 1 ECU_ADDRESS 0x0 /end MEASUREMENT
/begin MEASUREMENT Com_RxAccessInfo[114].InitValueIdxOfRxAccessInfo "" UBYTE Com_InitValueIdxOfRxAccessInfoType 0 0 0 255 ECU_ADDRESS 0x0 /end MEASUREMENT
/begin MEASUREMENT Com_RxAccessInfo[114].InitValueOfRxAccessInfo "" UBYTE Com_InitValueOfRxAccessInfoType 0 0 0 255 ECU_ADDRESS 0x0 /end MEASUREMENT
/begin MEASUREMENT Com_RxAccessInfo[114].InvValueIdxOfRxAccessInfo "" UBYTE Com_InvValueIdxOfRxAccessInfoType 0 0 0 255 ECU_ADDRESS 0x0 /end MEASUREMENT
/begin MEASUREMENT Com_RxAccessInfo[114].InvValueOfRxAccessInfo "" UBYTE Com_InvValueOfRxAccessInfoType 0 0 0 255 ECU_ADDRESS 0x0 /end MEASUREMENT
/begin MEASUREMENT Com_RxAccessInfo[114].IsGroupSignalOfRxAccessInfo "" UBYTE Com_IsGroupSignalOfRxAccessInfoType 0 0 0 1 ECU_ADDRESS 0x0 /end MEASUREMENT
/begin MEASUREMENT Com_RxAccessInfo[114].RxDataTimeoutSubstitutionValueIdxOfRxAccessInfo "" UBYTE Com_RxDataTimeoutSubstitutionValueIdxOfRxAccessInfoType 0 0 0 255 ECU_ADDRESS 0x0 /end MEASUREMENT
/begin MEASUREMENT Com_RxAccessInfo[114].RxDataTimeoutSubstitutionValueOfRxAccessInfo "" UBYTE Com_RxDataTimeoutSubstitutionValueOfRxAccessInfoType 0 0 0 255 ECU_ADDRESS 0x0 /end MEASUREMENT
/begin MEASUREMENT Com_RxAccessInfo[114].RxPduInfoIdxOfRxAccessInfo "" UBYTE NO_COMPU_METHOD 0 0 0 255 ECU_ADDRESS 0x0 /end MEASUREMENT
/begin MEASUREMENT Com_RxAccessInfo[114].RxSigBufferArrayBasedBufferEndIdxOfRxAccessInfo "" UBYTE Com_RxSigBufferArrayBasedBufferEndIdxOfRxAccessInfoType 0 0 0 255 ECU_ADDRESS 0x0 /end MEASUREMENT
/begin MEASUREMENT Com_RxAccessInfo[114].RxSigBufferArrayBasedBufferStartIdxOfRxAccessInfo "" UBYTE Com_RxSigBufferArrayBasedBufferStartIdxOfRxAccessInfoType 0 0 0 255 ECU_ADDRESS 0x0 /end MEASUREMENT
/begin MEASUREMENT Com_RxAccessInfo[114].RxSigBufferArrayBasedShdBufferEndIdxOfRxAccessInfo "" UBYTE Com_RxSigBufferArrayBasedShdBufferEndIdxOfRxAccessInfoType 0 0 0 255 ECU_ADDRESS 0x0 /end MEASUREMENT
/begin MEASUREMENT Com_RxAccessInfo[114].RxSigBufferArrayBasedShdBufferStartIdxOfRxAccessInfo "" UBYTE Com_RxSigBufferArrayBasedShdBufferStartIdxOfRxAccessInfoType 0 0 0 255 ECU_ADDRESS 0x0 /end MEASUREMENT
/begin MEASUREMENT Com_RxAccessInfo[114].RxTOutInfoIdxOfRxAccessInfo "" UBYTE Com_RxTOutInfoIdxOfRxAccessInfoType 0 0 0 255 ECU_ADDRESS 0x0 /end MEASUREMENT
/begin MEASUREMENT Com_RxAccessInfo[114].ShdBufferIdxOfRxAccessInfo "" UWORD Com_ShdBufferIdxOfRxAccessInfoType 0 0 0 65535 ECU_ADDRESS 0x0 /end MEASUREMENT
/begin MEASUREMENT Com_RxAccessInfo[114].SignalLengthInByteOfRxAccessInfo "" UBYTE NO_COMPU_METHOD 0 0 0 255 ECU_ADDRESS 0x0 /end MEASUREMENT
/begin MEASUREMENT Com_RxAccessInfo[114].StartByteInPduPositionOfRxAccessInfo "" UBYTE NO_COMPU_METHOD 0 0 0 255 ECU_ADDRESS 0x0 /end MEASUREMENT
/begin MEASUREMENT Com_RxAccessInfo[114].TmpBufferIdxOfRxAccessInfo "" UBYTE Com_TmpBufferIdxOfRxAccessInfoType 0 0 0 255 ECU_ADDRESS 0x0 /end MEASUREMENT
/begin MEASUREMENT Com_RxAccessInfo[114].TmpBufferOfRxAccessInfo "" UBYTE Com_TmpBufferOfRxAccessInfoType 0 0 0 255 ECU_ADDRESS 0x0 /end MEASUREMENT
/begin MEASUREMENT Com_RxAccessInfo[114].TmpRxShdBufferArrayBasedTmpBufferEndIdxOfRxAccessInfo "" UBYTE Com_TmpRxShdBufferArrayBasedTmpBufferEndIdxOfRxAccessInfoType 0 0 0 255 ECU_ADDRESS 0x0 /end MEASUREMENT
/begin MEASUREMENT Com_RxAccessInfo[114].TmpRxShdBufferArrayBasedTmpBufferStartIdxOfRxAccessInfo "" UBYTE Com_TmpRxShdBufferArrayBasedTmpBufferStartIdxOfRxAccessInfoType 0 0 0 255 ECU_ADDRESS 0x0 /end MEASUREMENT
/begin MEASUREMENT Com_RxAccessInfo[115].ApplTypeOfRxAccessInfo "" UBYTE Com_ApplTypeOfRxAccessInfoType 0 0 0 255 ECU_ADDRESS 0x0 /end MEASUREMENT
/begin MEASUREMENT Com_RxAccessInfo[115].BitLengthOfRxAccessInfo "" UWORD NO_COMPU_METHOD 0 0 0 65535 ECU_ADDRESS 0x0 /end MEASUREMENT
/begin MEASUREMENT Com_RxAccessInfo[115].BitPositionOfRxAccessInfo "" UWORD NO_COMPU_METHOD 0 0 0 65535 ECU_ADDRESS 0x0 /end MEASUREMENT
/begin MEASUREMENT Com_RxAccessInfo[115].BufferIdxOfRxAccessInfo "" UWORD Com_BufferIdxOfRxAccessInfoType 0 0 0 65535 ECU_ADDRESS 0x0 /end MEASUREMENT
/begin MEASUREMENT Com_RxAccessInfo[115].BusAccOfRxAccessInfo "" UBYTE Com_BusAccOfRxAccessInfoType 0 0 0 255 ECU_ADDRESS 0x0 /end MEASUREMENT
/begin MEASUREMENT Com_RxAccessInfo[115].ByteLengthOfRxAccessInfo "" UBYTE NO_COMPU_METHOD 0 0 0 255 ECU_ADDRESS 0x0 /end MEASUREMENT
/begin MEASUREMENT Com_RxAccessInfo[115].ConstValueArrayBasedInitValueEndIdxOfRxAccessInfo "" UBYTE Com_ConstValueArrayBasedInitValueEndIdxOfRxAccessInfoType 0 0 0 255 ECU_ADDRESS 0x0 /end MEASUREMENT
/begin MEASUREMENT Com_RxAccessInfo[115].ConstValueArrayBasedInitValueStartIdxOfRxAccessInfo "" UBYTE Com_ConstValueArrayBasedInitValueStartIdxOfRxAccessInfoType 0 0 0 255 ECU_ADDRESS 0x0 /end MEASUREMENT
/begin MEASUREMENT Com_RxAccessInfo[115].DynSignalOfRxAccessInfo "" UBYTE Com_DynSignalOfRxAccessInfoType 0 0 0 1 ECU_ADDRESS 0x0 /end MEASUREMENT
/begin MEASUREMENT Com_RxAccessInfo[115].InitValueIdxOfRxAccessInfo "" UBYTE Com_InitValueIdxOfRxAccessInfoType 0 0 0 255 ECU_ADDRESS 0x0 /end MEASUREMENT
/begin MEASUREMENT Com_RxAccessInfo[115].InitValueOfRxAccessInfo "" UBYTE Com_InitValueOfRxAccessInfoType 0 0 0 255 ECU_ADDRESS 0x0 /end MEASUREMENT
/begin MEASUREMENT Com_RxAccessInfo[115].InvValueIdxOfRxAccessInfo "" UBYTE Com_InvValueIdxOfRxAccessInfoType 0 0 0 255 ECU_ADDRESS 0x0 /end MEASUREMENT
/begin MEASUREMENT Com_RxAccessInfo[115].InvValueOfRxAccessInfo "" UBYTE Com_InvValueOfRxAccessInfoType 0 0 0 255 ECU_ADDRESS 0x0 /end MEASUREMENT
/begin MEASUREMENT Com_RxAccessInfo[115].IsGroupSignalOfRxAccessInfo "" UBYTE Com_IsGroupSignalOfRxAccessInfoType 0 0 0 1 ECU_ADDRESS 0x0 /end MEASUREMENT
/begin MEASUREMENT Com_RxAccessInfo[115].RxDataTimeoutSubstitutionValueIdxOfRxAccessInfo "" UBYTE Com_RxDataTimeoutSubstitutionValueIdxOfRxAccessInfoType 0 0 0 255 ECU_ADDRESS 0x0 /end MEASUREMENT
/begin MEASUREMENT Com_RxAccessInfo[115].RxDataTimeoutSubstitutionValueOfRxAccessInfo "" UBYTE Com_RxDataTimeoutSubstitutionValueOfRxAccessInfoType 0 0 0 255 ECU_ADDRESS 0x0 /end MEASUREMENT
/begin MEASUREMENT Com_RxAccessInfo[115].RxPduInfoIdxOfRxAccessInfo "" UBYTE NO_COMPU_METHOD 0 0 0 255 ECU_ADDRESS 0x0 /end MEASUREMENT
/begin MEASUREMENT Com_RxAccessInfo[115].RxSigBufferArrayBasedBufferEndIdxOfRxAccessInfo "" UBYTE Com_RxSigBufferArrayBasedBufferEndIdxOfRxAccessInfoType 0 0 0 255 ECU_ADDRESS 0x0 /end MEASUREMENT
/begin MEASUREMENT Com_RxAccessInfo[115].RxSigBufferArrayBasedBufferStartIdxOfRxAccessInfo "" UBYTE Com_RxSigBufferArrayBasedBufferStartIdxOfRxAccessInfoType 0 0 0 255 ECU_ADDRESS 0x0 /end MEASUREMENT
/begin MEASUREMENT Com_RxAccessInfo[115].RxSigBufferArrayBasedShdBufferEndIdxOfRxAccessInfo "" UBYTE Com_RxSigBufferArrayBasedShdBufferEndIdxOfRxAccessInfoType 0 0 0 255 ECU_ADDRESS 0x0 /end MEASUREMENT
/begin MEASUREMENT Com_RxAccessInfo[115].RxSigBufferArrayBasedShdBufferStartIdxOfRxAccessInfo "" UBYTE Com_RxSigBufferArrayBasedShdBufferStartIdxOfRxAccessInfoType 0 0 0 255 ECU_ADDRESS 0x0 /end MEASUREMENT
/begin MEASUREMENT Com_RxAccessInfo[115].RxTOutInfoIdxOfRxAccessInfo "" UBYTE Com_RxTOutInfoIdxOfRxAccessInfoType 0 0 0 255 ECU_ADDRESS 0x0 /end MEASUREMENT
/begin MEASUREMENT Com_RxAccessInfo[115].ShdBufferIdxOfRxAccessInfo "" UWORD Com_ShdBufferIdxOfRxAccessInfoType 0 0 0 65535 ECU_ADDRESS 0x0 /end MEASUREMENT
/begin MEASUREMENT Com_RxAccessInfo[115].SignalLengthInByteOfRxAccessInfo "" UBYTE NO_COMPU_METHOD 0 0 0 255 ECU_ADDRESS 0x0 /end MEASUREMENT
/begin MEASUREMENT Com_RxAccessInfo[115].StartByteInPduPositionOfRxAccessInfo "" UBYTE NO_COMPU_METHOD 0 0 0 255 ECU_ADDRESS 0x0 /end MEASUREMENT
/begin MEASUREMENT Com_RxAccessInfo[115].TmpBufferIdxOfRxAccessInfo "" UBYTE Com_TmpBufferIdxOfRxAccessInfoType 0 0 0 255 ECU_ADDRESS 0x0 /end MEASUREMENT
/begin MEASUREMENT Com_RxAccessInfo[115].TmpBufferOfRxAccessInfo "" UBYTE Com_TmpBufferOfRxAccessInfoType 0 0 0 255 ECU_ADDRESS 0x0 /end MEASUREMENT
/begin MEASUREMENT Com_RxAccessInfo[115].TmpRxShdBufferArrayBasedTmpBufferEndIdxOfRxAccessInfo "" UBYTE Com_TmpRxShdBufferArrayBasedTmpBufferEndIdxOfRxAccessInfoType 0 0 0 255 ECU_ADDRESS 0x0 /end MEASUREMENT
/begin MEASUREMENT Com_RxAccessInfo[115].TmpRxShdBufferArrayBasedTmpBufferStartIdxOfRxAccessInfo "" UBYTE Com_TmpRxShdBufferArrayBasedTmpBufferStartIdxOfRxAccessInfoType 0 0 0 255 ECU_ADDRESS 0x0 /end MEASUREMENT
/begin MEASUREMENT Com_RxAccessInfo[116].ApplTypeOfRxAccessInfo "" UBYTE Com_ApplTypeOfRxAccessInfoType 0 0 0 255 ECU_ADDRESS 0x0 /end MEASUREMENT
/begin MEASUREMENT Com_RxAccessInfo[116].BitLengthOfRxAccessInfo "" UWORD NO_COMPU_METHOD 0 0 0 65535 ECU_ADDRESS 0x0 /end MEASUREMENT
/begin MEASUREMENT Com_RxAccessInfo[116].BitPositionOfRxAccessInfo "" UWORD NO_COMPU_METHOD 0 0 0 65535 ECU_ADDRESS 0x0 /end MEASUREMENT
/begin MEASUREMENT Com_RxAccessInfo[116].BufferIdxOfRxAccessInfo "" UWORD Com_BufferIdxOfRxAccessInfoType 0 0 0 65535 ECU_ADDRESS 0x0 /end MEASUREMENT
/begin MEASUREMENT Com_RxAccessInfo[116].BusAccOfRxAccessInfo "" UBYTE Com_BusAccOfRxAccessInfoType 0 0 0 255 ECU_ADDRESS 0x0 /end MEASUREMENT
/begin MEASUREMENT Com_RxAccessInfo[116].ByteLengthOfRxAccessInfo "" UBYTE NO_COMPU_METHOD 0 0 0 255 ECU_ADDRESS 0x0 /end MEASUREMENT
/begin MEASUREMENT Com_RxAccessInfo[116].ConstValueArrayBasedInitValueEndIdxOfRxAccessInfo "" UBYTE Com_ConstValueArrayBasedInitValueEndIdxOfRxAccessInfoType 0 0 0 255 ECU_ADDRESS 0x0 /end MEASUREMENT
/begin MEASUREMENT Com_RxAccessInfo[116].ConstValueArrayBasedInitValueStartIdxOfRxAccessInfo "" UBYTE Com_ConstValueArrayBasedInitValueStartIdxOfRxAccessInfoType 0 0 0 255 ECU_ADDRESS 0x0 /end MEASUREMENT
/begin MEASUREMENT Com_RxAccessInfo[116].DynSignalOfRxAccessInfo "" UBYTE Com_DynSignalOfRxAccessInfoType 0 0 0 1 ECU_ADDRESS 0x0 /end MEASUREMENT
/begin MEASUREMENT Com_RxAccessInfo[116].InitValueIdxOfRxAccessInfo "" UBYTE Com_InitValueIdxOfRxAccessInfoType 0 0 0 255 ECU_ADDRESS 0x0 /end MEASUREMENT
/begin MEASUREMENT Com_RxAccessInfo[116].InitValueOfRxAccessInfo "" UBYTE Com_InitValueOfRxAccessInfoType 0 0 0 255 ECU_ADDRESS 0x0 /end MEASUREMENT
/begin MEASUREMENT Com_RxAccessInfo[116].InvValueIdxOfRxAccessInfo "" UBYTE Com_InvValueIdxOfRxAccessInfoType 0 0 0 255 ECU_ADDRESS 0x0 /end MEASUREMENT
/begin MEASUREMENT Com_RxAccessInfo[116].InvValueOfRxAccessInfo "" UBYTE Com_InvValueOfRxAccessInfoType 0 0 0 255 ECU_ADDRESS 0x0 /end MEASUREMENT
/begin MEASUREMENT Com_RxAccessInfo[116].IsGroupSignalOfRxAccessInfo "" UBYTE Com_IsGroupSignalOfRxAccessInfoType 0 0 0 1 ECU_ADDRESS 0x0 /end MEASUREMENT
/begin MEASUREMENT Com_RxAccessInfo[116].RxDataTimeoutSubstitutionValueIdxOfRxAccessInfo "" UBYTE Com_RxDataTimeoutSubstitutionValueIdxOfRxAccessInfoType 0 0 0 255 ECU_ADDRESS 0x0 /end MEASUREMENT
/begin MEASUREMENT Com_RxAccessInfo[116].RxDataTimeoutSubstitutionValueOfRxAccessInfo "" UBYTE Com_RxDataTimeoutSubstitutionValueOfRxAccessInfoType 0 0 0 255 ECU_ADDRESS 0x0 /end MEASUREMENT
/begin MEASUREMENT Com_RxAccessInfo[116].RxPduInfoIdxOfRxAccessInfo "" UBYTE NO_COMPU_METHOD 0 0 0 255 ECU_ADDRESS 0x0 /end MEASUREMENT
/begin MEASUREMENT Com_RxAccessInfo[116].RxSigBufferArrayBasedBufferEndIdxOfRxAccessInfo "" UBYTE Com_RxSigBufferArrayBasedBufferEndIdxOfRxAccessInfoType 0 0 0 255 ECU_ADDRESS 0x0 /end MEASUREMENT
/begin MEASUREMENT Com_RxAccessInfo[116].RxSigBufferArrayBasedBufferStartIdxOfRxAccessInfo "" UBYTE Com_RxSigBufferArrayBasedBufferStartIdxOfRxAccessInfoType 0 0 0 255 ECU_ADDRESS 0x0 /end MEASUREMENT
/begin MEASUREMENT Com_RxAccessInfo[116].RxSigBufferArrayBasedShdBufferEndIdxOfRxAccessInfo "" UBYTE Com_RxSigBufferArrayBasedShdBufferEndIdxOfRxAccessInfoType 0 0 0 255 ECU_ADDRESS 0x0 /end MEASUREMENT
/begin MEASUREMENT Com_RxAccessInfo[116].RxSigBufferArrayBasedShdBufferStartIdxOfRxAccessInfo "" UBYTE Com_RxSigBufferArrayBasedShdBufferStartIdxOfRxAccessInfoType 0 0 0 255 ECU_ADDRESS 0x0 /end MEASUREMENT
/begin MEASUREMENT Com_RxAccessInfo[116].RxTOutInfoIdxOfRxAccessInfo "" UBYTE Com_RxTOutInfoIdxOfRxAccessInfoType 0 0 0 255 ECU_ADDRESS 0x0 /end MEASUREMENT
/begin MEASUREMENT Com_RxAccessInfo[116].ShdBufferIdxOfRxAccessInfo "" UWORD Com_ShdBufferIdxOfRxAccessInfoType 0 0 0 65535 ECU_ADDRESS 0x0 /end MEASUREMENT
/begin MEASUREMENT Com_RxAccessInfo[116].SignalLengthInByteOfRxAccessInfo "" UBYTE NO_COMPU_METHOD 0 0 0 255 ECU_ADDRESS 0x0 /end MEASUREMENT
/begin MEASUREMENT Com_RxAccessInfo[116].StartByteInPduPositionOfRxAccessInfo "" UBYTE NO_COMPU_METHOD 0 0 0 255 ECU_ADDRESS 0x0 /end MEASUREMENT
/begin MEASUREMENT Com_RxAccessInfo[116].TmpBufferIdxOfRxAccessInfo "" UBYTE Com_TmpBufferIdxOfRxAccessInfoType 0 0 0 255 ECU_ADDRESS 0x0 /end MEASUREMENT
/begin MEASUREMENT Com_RxAccessInfo[116].TmpBufferOfRxAccessInfo "" UBYTE Com_TmpBufferOfRxAccessInfoType 0 0 0 255 ECU_ADDRESS 0x0 /end MEASUREMENT
/begin MEASUREMENT Com_RxAccessInfo[116].TmpRxShdBufferArrayBasedTmpBufferEndIdxOfRxAccessInfo "" UBYTE Com_TmpRxShdBufferArrayBasedTmpBufferEndIdxOfRxAccessInfoType 0 0 0 255 ECU_ADDRESS 0x0 /end MEASUREMENT
/begin MEASUREMENT Com_RxAccessInfo[116].TmpRxShdBufferArrayBasedTmpBufferStartIdxOfRxAccessInfo "" UBYTE Com_TmpRxShdBufferArrayBasedTmpBufferStartIdxOfRxAccessInfoType 0 0 0 255 ECU_ADDRESS 0x0 /end MEASUREMENT
/begin MEASUREMENT Com_RxAccessInfo[117].ApplTypeOfRxAccessInfo "" UBYTE Com_ApplTypeOfRxAccessInfoType 0 0 0 255 ECU_ADDRESS 0x0 /end MEASUREMENT
/begin MEASUREMENT Com_RxAccessInfo[117].BitLengthOfRxAccessInfo "" UWORD NO_COMPU_METHOD 0 0 0 65535 ECU_ADDRESS 0x0 /end MEASUREMENT
/begin MEASUREMENT Com_RxAccessInfo[117].BitPositionOfRxAccessInfo "" UWORD NO_COMPU_METHOD 0 0 0 65535 ECU_ADDRESS 0x0 /end MEASUREMENT
/begin MEASUREMENT Com_RxAccessInfo[117].BufferIdxOfRxAccessInfo "" UWORD Com_BufferIdxOfRxAccessInfoType 0 0 0 65535 ECU_ADDRESS 0x0 /end MEASUREMENT
/begin MEASUREMENT Com_RxAccessInfo[117].BusAccOfRxAccessInfo "" UBYTE Com_BusAccOfRxAccessInfoType 0 0 0 255 ECU_ADDRESS 0x0 /end MEASUREMENT
/begin MEASUREMENT Com_RxAccessInfo[117].ByteLengthOfRxAccessInfo "" UBYTE NO_COMPU_METHOD 0 0 0 255 ECU_ADDRESS 0x0 /end MEASUREMENT
/begin MEASUREMENT Com_RxAccessInfo[117].ConstValueArrayBasedInitValueEndIdxOfRxAccessInfo "" UBYTE Com_ConstValueArrayBasedInitValueEndIdxOfRxAccessInfoType 0 0 0 255 ECU_ADDRESS 0x0 /end MEASUREMENT
/begin MEASUREMENT Com_RxAccessInfo[117].ConstValueArrayBasedInitValueStartIdxOfRxAccessInfo "" UBYTE Com_ConstValueArrayBasedInitValueStartIdxOfRxAccessInfoType 0 0 0 255 ECU_ADDRESS 0x0 /end MEASUREMENT
/begin MEASUREMENT Com_RxAccessInfo[117].DynSignalOfRxAccessInfo "" UBYTE Com_DynSignalOfRxAccessInfoType 0 0 0 1 ECU_ADDRESS 0x0 /end MEASUREMENT
/begin MEASUREMENT Com_RxAccessInfo[117].InitValueIdxOfRxAccessInfo "" UBYTE Com_InitValueIdxOfRxAccessInfoType 0 0 0 255 ECU_ADDRESS 0x0 /end MEASUREMENT
/begin MEASUREMENT Com_RxAccessInfo[117].InitValueOfRxAccessInfo "" UBYTE Com_InitValueOfRxAccessInfoType 0 0 0 255 ECU_ADDRESS 0x0 /end MEASUREMENT
/begin MEASUREMENT Com_RxAccessInfo[117].InvValueIdxOfRxAccessInfo "" UBYTE Com_InvValueIdxOfRxAccessInfoType 0 0 0 255 ECU_ADDRESS 0x0 /end MEASUREMENT
/begin MEASUREMENT Com_RxAccessInfo[117].InvValueOfRxAccessInfo "" UBYTE Com_InvValueOfRxAccessInfoType 0 0 0 255 ECU_ADDRESS 0x0 /end MEASUREMENT
/begin MEASUREMENT Com_RxAccessInfo[117].IsGroupSignalOfRxAccessInfo "" UBYTE Com_IsGroupSignalOfRxAccessInfoType 0 0 0 1 ECU_ADDRESS 0x0 /end MEASUREMENT
/begin MEASUREMENT Com_RxAccessInfo[117].RxDataTimeoutSubstitutionValueIdxOfRxAccessInfo "" UBYTE Com_RxDataTimeoutSubstitutionValueIdxOfRxAccessInfoType 0 0 0 255 ECU_ADDRESS 0x0 /end MEASUREMENT
/begin MEASUREMENT Com_RxAccessInfo[117].RxDataTimeoutSubstitutionValueOfRxAccessInfo "" UBYTE Com_RxDataTimeoutSubstitutionValueOfRxAccessInfoType 0 0 0 255 ECU_ADDRESS 0x0 /end MEASUREMENT
/begin MEASUREMENT Com_RxAccessInfo[117].RxPduInfoIdxOfRxAccessInfo "" UBYTE NO_COMPU_METHOD 0 0 0 255 ECU_ADDRESS 0x0 /end MEASUREMENT
/begin MEASUREMENT Com_RxAccessInfo[117].RxSigBufferArrayBasedBufferEndIdxOfRxAccessInfo "" UBYTE Com_RxSigBufferArrayBasedBufferEndIdxOfRxAccessInfoType 0 0 0 255 ECU_ADDRESS 0x0 /end MEASUREMENT
/begin MEASUREMENT Com_RxAccessInfo[117].RxSigBufferArrayBasedBufferStartIdxOfRxAccessInfo "" UBYTE Com_RxSigBufferArrayBasedBufferStartIdxOfRxAccessInfoType 0 0 0 255 ECU_ADDRESS 0x0 /end MEASUREMENT
/begin MEASUREMENT Com_RxAccessInfo[117].RxSigBufferArrayBasedShdBufferEndIdxOfRxAccessInfo "" UBYTE Com_RxSigBufferArrayBasedShdBufferEndIdxOfRxAccessInfoType 0 0 0 255 ECU_ADDRESS 0x0 /end MEASUREMENT
/begin MEASUREMENT Com_RxAccessInfo[117].RxSigBufferArrayBasedShdBufferStartIdxOfRxAccessInfo "" UBYTE Com_RxSigBufferArrayBasedShdBufferStartIdxOfRxAccessInfoType 0 0 0 255 ECU_ADDRESS 0x0 /end MEASUREMENT
/begin MEASUREMENT Com_RxAccessInfo[117].RxTOutInfoIdxOfRxAccessInfo "" UBYTE Com_RxTOutInfoIdxOfRxAccessInfoType 0 0 0 255 ECU_ADDRESS 0x0 /end MEASUREMENT
/begin MEASUREMENT Com_RxAccessInfo[117].ShdBufferIdxOfRxAccessInfo "" UWORD Com_ShdBufferIdxOfRxAccessInfoType 0 0 0 65535 ECU_ADDRESS 0x0 /end MEASUREMENT
/begin MEASUREMENT Com_RxAccessInfo[117].SignalLengthInByteOfRxAccessInfo "" UBYTE NO_COMPU_METHOD 0 0 0 255 ECU_ADDRESS 0x0 /end MEASUREMENT
/begin MEASUREMENT Com_RxAccessInfo[117].StartByteInPduPositionOfRxAccessInfo "" UBYTE NO_COMPU_METHOD 0 0 0 255 ECU_ADDRESS 0x0 /end MEASUREMENT
/begin MEASUREMENT Com_RxAccessInfo[117].TmpBufferIdxOfRxAccessInfo "" UBYTE Com_TmpBufferIdxOfRxAccessInfoType 0 0 0 255 ECU_ADDRESS 0x0 /end MEASUREMENT
/begin MEASUREMENT Com_RxAccessInfo[117].TmpBufferOfRxAccessInfo "" UBYTE Com_TmpBufferOfRxAccessInfoType 0 0 0 255 ECU_ADDRESS 0x0 /end MEASUREMENT
/begin MEASUREMENT Com_RxAccessInfo[117].TmpRxShdBufferArrayBasedTmpBufferEndIdxOfRxAccessInfo "" UBYTE Com_TmpRxShdBufferArrayBasedTmpBufferEndIdxOfRxAccessInfoType 0 0 0 255 ECU_ADDRESS 0x0 /end MEASUREMENT
/begin MEASUREMENT Com_RxAccessInfo[117].TmpRxShdBufferArrayBasedTmpBufferStartIdxOfRxAccessInfo "" UBYTE Com_TmpRxShdBufferArrayBasedTmpBufferStartIdxOfRxAccessInfoType 0 0 0 255 ECU_ADDRESS 0x0 /end MEASUREMENT
/begin MEASUREMENT Com_RxAccessInfo[118].ApplTypeOfRxAccessInfo "" UBYTE Com_ApplTypeOfRxAccessInfoType 0 0 0 255 ECU_ADDRESS 0x0 /end MEASUREMENT
/begin MEASUREMENT Com_RxAccessInfo[118].BitLengthOfRxAccessInfo "" UWORD NO_COMPU_METHOD 0 0 0 65535 ECU_ADDRESS 0x0 /end MEASUREMENT
/begin MEASUREMENT Com_RxAccessInfo[118].BitPositionOfRxAccessInfo "" UWORD NO_COMPU_METHOD 0 0 0 65535 ECU_ADDRESS 0x0 /end MEASUREMENT
/begin MEASUREMENT Com_RxAccessInfo[118].BufferIdxOfRxAccessInfo "" UWORD Com_BufferIdxOfRxAccessInfoType 0 0 0 65535 ECU_ADDRESS 0x0 /end MEASUREMENT
/begin MEASUREMENT Com_RxAccessInfo[118].BusAccOfRxAccessInfo "" UBYTE Com_BusAccOfRxAccessInfoType 0 0 0 255 ECU_ADDRESS 0x0 /end MEASUREMENT
/begin MEASUREMENT Com_RxAccessInfo[118].ByteLengthOfRxAccessInfo "" UBYTE NO_COMPU_METHOD 0 0 0 255 ECU_ADDRESS 0x0 /end MEASUREMENT
/begin MEASUREMENT Com_RxAccessInfo[118].ConstValueArrayBasedInitValueEndIdxOfRxAccessInfo "" UBYTE Com_ConstValueArrayBasedInitValueEndIdxOfRxAccessInfoType 0 0 0 255 ECU_ADDRESS 0x0 /end MEASUREMENT
/begin MEASUREMENT Com_RxAccessInfo[118].ConstValueArrayBasedInitValueStartIdxOfRxAccessInfo "" UBYTE Com_ConstValueArrayBasedInitValueStartIdxOfRxAccessInfoType 0 0 0 255 ECU_ADDRESS 0x0 /end MEASUREMENT
/begin MEASUREMENT Com_RxAccessInfo[118].DynSignalOfRxAccessInfo "" UBYTE Com_DynSignalOfRxAccessInfoType 0 0 0 1 ECU_ADDRESS 0x0 /end MEASUREMENT
/begin MEASUREMENT Com_RxAccessInfo[118].InitValueIdxOfRxAccessInfo "" UBYTE Com_InitValueIdxOfRxAccessInfoType 0 0 0 255 ECU_ADDRESS 0x0 /end MEASUREMENT
/begin MEASUREMENT Com_RxAccessInfo[118].InitValueOfRxAccessInfo "" UBYTE Com_InitValueOfRxAccessInfoType 0 0 0 255 ECU_ADDRESS 0x0 /end MEASUREMENT
/begin MEASUREMENT Com_RxAccessInfo[118].InvValueIdxOfRxAccessInfo "" UBYTE Com_InvValueIdxOfRxAccessInfoType 0 0 0 255 ECU_ADDRESS 0x0 /end MEASUREMENT
/begin MEASUREMENT Com_RxAccessInfo[118].InvValueOfRxAccessInfo "" UBYTE Com_InvValueOfRxAccessInfoType 0 0 0 255 ECU_ADDRESS 0x0 /end MEASUREMENT
/begin MEASUREMENT Com_RxAccessInfo[118].IsGroupSignalOfRxAccessInfo "" UBYTE Com_IsGroupSignalOfRxAccessInfoType 0 0 0 1 ECU_ADDRESS 0x0 /end MEASUREMENT
/begin MEASUREMENT Com_RxAccessInfo[118].RxDataTimeoutSubstitutionValueIdxOfRxAccessInfo "" UBYTE Com_RxDataTimeoutSubstitutionValueIdxOfRxAccessInfoType 0 0 0 255 ECU_ADDRESS 0x0 /end MEASUREMENT
/begin MEASUREMENT Com_RxAccessInfo[118].RxDataTimeoutSubstitutionValueOfRxAccessInfo "" UBYTE Com_RxDataTimeoutSubstitutionValueOfRxAccessInfoType 0 0 0 255 ECU_ADDRESS 0x0 /end MEASUREMENT
/begin MEASUREMENT Com_RxAccessInfo[118].RxPduInfoIdxOfRxAccessInfo "" UBYTE NO_COMPU_METHOD 0 0 0 255 ECU_ADDRESS 0x0 /end MEASUREMENT
/begin MEASUREMENT Com_RxAccessInfo[118].RxSigBufferArrayBasedBufferEndIdxOfRxAccessInfo "" UBYTE Com_RxSigBufferArrayBasedBufferEndIdxOfRxAccessInfoType 0 0 0 255 ECU_ADDRESS 0x0 /end MEASUREMENT
/begin MEASUREMENT Com_RxAccessInfo[118].RxSigBufferArrayBasedBufferStartIdxOfRxAccessInfo "" UBYTE Com_RxSigBufferArrayBasedBufferStartIdxOfRxAccessInfoType 0 0 0 255 ECU_ADDRESS 0x0 /end MEASUREMENT
/begin MEASUREMENT Com_RxAccessInfo[118].RxSigBufferArrayBasedShdBufferEndIdxOfRxAccessInfo "" UBYTE Com_RxSigBufferArrayBasedShdBufferEndIdxOfRxAccessInfoType 0 0 0 255 ECU_ADDRESS 0x0 /end MEASUREMENT
/begin MEASUREMENT Com_RxAccessInfo[118].RxSigBufferArrayBasedShdBufferStartIdxOfRxAccessInfo "" UBYTE Com_RxSigBufferArrayBasedShdBufferStartIdxOfRxAccessInfoType 0 0 0 255 ECU_ADDRESS 0x0 /end MEASUREMENT
/begin MEASUREMENT Com_RxAccessInfo[118].RxTOutInfoIdxOfRxAccessInfo "" UBYTE Com_RxTOutInfoIdxOfRxAccessInfoType 0 0 0 255 ECU_ADDRESS 0x0 /end MEASUREMENT
/begin MEASUREMENT Com_RxAccessInfo[118].ShdBufferIdxOfRxAccessInfo "" UWORD Com_ShdBufferIdxOfRxAccessInfoType 0 0 0 65535 ECU_ADDRESS 0x0 /end MEASUREMENT
/begin MEASUREMENT Com_RxAccessInfo[118].SignalLengthInByteOfRxAccessInfo "" UBYTE NO_COMPU_METHOD 0 0 0 255 ECU_ADDRESS 0x0 /end MEASUREMENT
/begin MEASUREMENT Com_RxAccessInfo[118].StartByteInPduPositionOfRxAccessInfo "" UBYTE NO_COMPU_METHOD 0 0 0 255 ECU_ADDRESS 0x0 /end MEASUREMENT
/begin MEASUREMENT Com_RxAccessInfo[118].TmpBufferIdxOfRxAccessInfo "" UBYTE Com_TmpBufferIdxOfRxAccessInfoType 0 0 0 255 ECU_ADDRESS 0x0 /end MEASUREMENT
/begin MEASUREMENT Com_RxAccessInfo[118].TmpBufferOfRxAccessInfo "" UBYTE Com_TmpBufferOfRxAccessInfoType 0 0 0 255 ECU_ADDRESS 0x0 /end MEASUREMENT
/begin MEASUREMENT Com_RxAccessInfo[118].TmpRxShdBufferArrayBasedTmpBufferEndIdxOfRxAccessInfo "" UBYTE Com_TmpRxShdBufferArrayBasedTmpBufferEndIdxOfRxAccessInfoType 0 0 0 255 ECU_ADDRESS 0x0 /end MEASUREMENT
/begin MEASUREMENT Com_RxAccessInfo[118].TmpRxShdBufferArrayBasedTmpBufferStartIdxOfRxAccessInfo "" UBYTE Com_TmpRxShdBufferArrayBasedTmpBufferStartIdxOfRxAccessInfoType 0 0 0 255 ECU_ADDRESS 0x0 /end MEASUREMENT
/begin MEASUREMENT Com_RxAccessInfo[119].ApplTypeOfRxAccessInfo "" UBYTE Com_ApplTypeOfRxAccessInfoType 0 0 0 255 ECU_ADDRESS 0x0 /end MEASUREMENT
/begin MEASUREMENT Com_RxAccessInfo[119].BitLengthOfRxAccessInfo "" UWORD NO_COMPU_METHOD 0 0 0 65535 ECU_ADDRESS 0x0 /end MEASUREMENT
/begin MEASUREMENT Com_RxAccessInfo[119].BitPositionOfRxAccessInfo "" UWORD NO_COMPU_METHOD 0 0 0 65535 ECU_ADDRESS 0x0 /end MEASUREMENT
/begin MEASUREMENT Com_RxAccessInfo[119].BufferIdxOfRxAccessInfo "" UWORD Com_BufferIdxOfRxAccessInfoType 0 0 0 65535 ECU_ADDRESS 0x0 /end MEASUREMENT
/begin MEASUREMENT Com_RxAccessInfo[119].BusAccOfRxAccessInfo "" UBYTE Com_BusAccOfRxAccessInfoType 0 0 0 255 ECU_ADDRESS 0x0 /end MEASUREMENT
/begin MEASUREMENT Com_RxAccessInfo[119].ByteLengthOfRxAccessInfo "" UBYTE NO_COMPU_METHOD 0 0 0 255 ECU_ADDRESS 0x0 /end MEASUREMENT
/begin MEASUREMENT Com_RxAccessInfo[119].ConstValueArrayBasedInitValueEndIdxOfRxAccessInfo "" UBYTE Com_ConstValueArrayBasedInitValueEndIdxOfRxAccessInfoType 0 0 0 255 ECU_ADDRESS 0x0 /end MEASUREMENT
/begin MEASUREMENT Com_RxAccessInfo[119].ConstValueArrayBasedInitValueStartIdxOfRxAccessInfo "" UBYTE Com_ConstValueArrayBasedInitValueStartIdxOfRxAccessInfoType 0 0 0 255 ECU_ADDRESS 0x0 /end MEASUREMENT
/begin MEASUREMENT Com_RxAccessInfo[119].DynSignalOfRxAccessInfo "" UBYTE Com_DynSignalOfRxAccessInfoType 0 0 0 1 ECU_ADDRESS 0x0 /end MEASUREMENT
/begin MEASUREMENT Com_RxAccessInfo[119].InitValueIdxOfRxAccessInfo "" UBYTE Com_InitValueIdxOfRxAccessInfoType 0 0 0 255 ECU_ADDRESS 0x0 /end MEASUREMENT
/begin MEASUREMENT Com_RxAccessInfo[119].InitValueOfRxAccessInfo "" UBYTE Com_InitValueOfRxAccessInfoType 0 0 0 255 ECU_ADDRESS 0x0 /end MEASUREMENT
/begin MEASUREMENT Com_RxAccessInfo[119].InvValueIdxOfRxAccessInfo "" UBYTE Com_InvValueIdxOfRxAccessInfoType 0 0 0 255 ECU_ADDRESS 0x0 /end MEASUREMENT
/begin MEASUREMENT Com_RxAccessInfo[119].InvValueOfRxAccessInfo "" UBYTE Com_InvValueOfRxAccessInfoType 0 0 0 255 ECU_ADDRESS 0x0 /end MEASUREMENT
/begin MEASUREMENT Com_RxAccessInfo[119].IsGroupSignalOfRxAccessInfo "" UBYTE Com_IsGroupSignalOfRxAccessInfoType 0 0 0 1 ECU_ADDRESS 0x0 /end MEASUREMENT
/begin MEASUREMENT Com_RxAccessInfo[119].RxDataTimeoutSubstitutionValueIdxOfRxAccessInfo "" UBYTE Com_RxDataTimeoutSubstitutionValueIdxOfRxAccessInfoType 0 0 0 255 ECU_ADDRESS 0x0 /end MEASUREMENT
/begin MEASUREMENT Com_RxAccessInfo[119].RxDataTimeoutSubstitutionValueOfRxAccessInfo "" UBYTE Com_RxDataTimeoutSubstitutionValueOfRxAccessInfoType 0 0 0 255 ECU_ADDRESS 0x0 /end MEASUREMENT
/begin MEASUREMENT Com_RxAccessInfo[119].RxPduInfoIdxOfRxAccessInfo "" UBYTE NO_COMPU_METHOD 0 0 0 255 ECU_ADDRESS 0x0 /end MEASUREMENT
/begin MEASUREMENT Com_RxAccessInfo[119].RxSigBufferArrayBasedBufferEndIdxOfRxAccessInfo "" UBYTE Com_RxSigBufferArrayBasedBufferEndIdxOfRxAccessInfoType 0 0 0 255 ECU_ADDRESS 0x0 /end MEASUREMENT
/begin MEASUREMENT Com_RxAccessInfo[119].RxSigBufferArrayBasedBufferStartIdxOfRxAccessInfo "" UBYTE Com_RxSigBufferArrayBasedBufferStartIdxOfRxAccessInfoType 0 0 0 255 ECU_ADDRESS 0x0 /end MEASUREMENT
/begin MEASUREMENT Com_RxAccessInfo[119].RxSigBufferArrayBasedShdBufferEndIdxOfRxAccessInfo "" UBYTE Com_RxSigBufferArrayBasedShdBufferEndIdxOfRxAccessInfoType 0 0 0 255 ECU_ADDRESS 0x0 /end MEASUREMENT
/begin MEASUREMENT Com_RxAccessInfo[119].RxSigBufferArrayBasedShdBufferStartIdxOfRxAccessInfo "" UBYTE Com_RxSigBufferArrayBasedShdBufferStartIdxOfRxAccessInfoType 0 0 0 255 ECU_ADDRESS 0x0 /end MEASUREMENT
/begin MEASUREMENT Com_RxAccessInfo[119].RxTOutInfoIdxOfRxAccessInfo "" UBYTE Com_RxTOutInfoIdxOfRxAccessInfoType 0 0 0 255 ECU_ADDRESS 0x0 /end MEASUREMENT
/begin MEASUREMENT Com_RxAccessInfo[119].ShdBufferIdxOfRxAccessInfo "" UWORD Com_ShdBufferIdxOfRxAccessInfoType 0 0 0 65535 ECU_ADDRESS 0x0 /end MEASUREMENT
/begin MEASUREMENT Com_RxAccessInfo[119].SignalLengthInByteOfRxAccessInfo "" UBYTE NO_COMPU_METHOD 0 0 0 255 ECU_ADDRESS 0x0 /end MEASUREMENT
/begin MEASUREMENT Com_RxAccessInfo[119].StartByteInPduPositionOfRxAccessInfo "" UBYTE NO_COMPU_METHOD 0 0 0 255 ECU_ADDRESS 0x0 /end MEASUREMENT
/begin MEASUREMENT Com_RxAccessInfo[119].TmpBufferIdxOfRxAccessInfo "" UBYTE Com_TmpBufferIdxOfRxAccessInfoType 0 0 0 255 ECU_ADDRESS 0x0 /end MEASUREMENT
/begin MEASUREMENT Com_RxAccessInfo[119].TmpBufferOfRxAccessInfo "" UBYTE Com_TmpBufferOfRxAccessInfoType 0 0 0 255 ECU_ADDRESS 0x0 /end MEASUREMENT
/begin MEASUREMENT Com_RxAccessInfo[119].TmpRxShdBufferArrayBasedTmpBufferEndIdxOfRxAccessInfo "" UBYTE Com_TmpRxShdBufferArrayBasedTmpBufferEndIdxOfRxAccessInfoType 0 0 0 255 ECU_ADDRESS 0x0 /end MEASUREMENT
/begin MEASUREMENT Com_RxAccessInfo[119].TmpRxShdBufferArrayBasedTmpBufferStartIdxOfRxAccessInfo "" UBYTE Com_TmpRxShdBufferArrayBasedTmpBufferStartIdxOfRxAccessInfoType 0 0 0 255 ECU_ADDRESS 0x0 /end MEASUREMENT
/begin MEASUREMENT Com_RxAccessInfo[11].ApplTypeOfRxAccessInfo "" UBYTE Com_ApplTypeOfRxAccessInfoType 0 0 0 255 ECU_ADDRESS 0x0 /end MEASUREMENT
/begin MEASUREMENT Com_RxAccessInfo[11].BitLengthOfRxAccessInfo "" UWORD NO_COMPU_METHOD 0 0 0 65535 ECU_ADDRESS 0x0 /end MEASUREMENT
/begin MEASUREMENT Com_RxAccessInfo[11].BitPositionOfRxAccessInfo "" UWORD NO_COMPU_METHOD 0 0 0 65535 ECU_ADDRESS 0x0 /end MEASUREMENT
/begin MEASUREMENT Com_RxAccessInfo[11].BufferIdxOfRxAccessInfo "" UWORD Com_BufferIdxOfRxAccessInfoType 0 0 0 65535 ECU_ADDRESS 0x0 /end MEASUREMENT
/begin MEASUREMENT Com_RxAccessInfo[11].BusAccOfRxAccessInfo "" UBYTE Com_BusAccOfRxAccessInfoType 0 0 0 255 ECU_ADDRESS 0x0 /end MEASUREMENT
/begin MEASUREMENT Com_RxAccessInfo[11].ByteLengthOfRxAccessInfo "" UBYTE NO_COMPU_METHOD 0 0 0 255 ECU_ADDRESS 0x0 /end MEASUREMENT
/begin MEASUREMENT Com_RxAccessInfo[11].ConstValueArrayBasedInitValueEndIdxOfRxAccessInfo "" UBYTE Com_ConstValueArrayBasedInitValueEndIdxOfRxAccessInfoType 0 0 0 255 ECU_ADDRESS 0x0 /end MEASUREMENT
/begin MEASUREMENT Com_RxAccessInfo[11].ConstValueArrayBasedInitValueStartIdxOfRxAccessInfo "" UBYTE Com_ConstValueArrayBasedInitValueStartIdxOfRxAccessInfoType 0 0 0 255 ECU_ADDRESS 0x0 /end MEASUREMENT
/begin MEASUREMENT Com_RxAccessInfo[11].DynSignalOfRxAccessInfo "" UBYTE Com_DynSignalOfRxAccessInfoType 0 0 0 1 ECU_ADDRESS 0x0 /end MEASUREMENT
/begin MEASUREMENT Com_RxAccessInfo[11].InitValueIdxOfRxAccessInfo "" UBYTE Com_InitValueIdxOfRxAccessInfoType 0 0 0 255 ECU_ADDRESS 0x0 /end MEASUREMENT
/begin MEASUREMENT Com_RxAccessInfo[11].InitValueOfRxAccessInfo "" UBYTE Com_InitValueOfRxAccessInfoType 0 0 0 255 ECU_ADDRESS 0x0 /end MEASUREMENT
/begin MEASUREMENT Com_RxAccessInfo[11].InvValueIdxOfRxAccessInfo "" UBYTE Com_InvValueIdxOfRxAccessInfoType 0 0 0 255 ECU_ADDRESS 0x0 /end MEASUREMENT
/begin MEASUREMENT Com_RxAccessInfo[11].InvValueOfRxAccessInfo "" UBYTE Com_InvValueOfRxAccessInfoType 0 0 0 255 ECU_ADDRESS 0x0 /end MEASUREMENT
/begin MEASUREMENT Com_RxAccessInfo[11].IsGroupSignalOfRxAccessInfo "" UBYTE Com_IsGroupSignalOfRxAccessInfoType 0 0 0 1 ECU_ADDRESS 0x0 /end MEASUREMENT
/begin MEASUREMENT Com_RxAccessInfo[11].RxDataTimeoutSubstitutionValueIdxOfRxAccessInfo "" UBYTE Com_RxDataTimeoutSubstitutionValueIdxOfRxAccessInfoType 0 0 0 255 ECU_ADDRESS 0x0 /end MEASUREMENT
/begin MEASUREMENT Com_RxAccessInfo[11].RxDataTimeoutSubstitutionValueOfRxAccessInfo "" UBYTE Com_RxDataTimeoutSubstitutionValueOfRxAccessInfoType 0 0 0 255 ECU_ADDRESS 0x0 /end MEASUREMENT
/begin MEASUREMENT Com_RxAccessInfo[11].RxPduInfoIdxOfRxAccessInfo "" UBYTE NO_COMPU_METHOD 0 0 0 255 ECU_ADDRESS 0x0 /end MEASUREMENT
/begin MEASUREMENT Com_RxAccessInfo[11].RxSigBufferArrayBasedBufferEndIdxOfRxAccessInfo "" UBYTE Com_RxSigBufferArrayBasedBufferEndIdxOfRxAccessInfoType 0 0 0 255 ECU_ADDRESS 0x0 /end MEASUREMENT
/begin MEASUREMENT Com_RxAccessInfo[11].RxSigBufferArrayBasedBufferStartIdxOfRxAccessInfo "" UBYTE Com_RxSigBufferArrayBasedBufferStartIdxOfRxAccessInfoType 0 0 0 255 ECU_ADDRESS 0x0 /end MEASUREMENT
/begin MEASUREMENT Com_RxAccessInfo[11].RxSigBufferArrayBasedShdBufferEndIdxOfRxAccessInfo "" UBYTE Com_RxSigBufferArrayBasedShdBufferEndIdxOfRxAccessInfoType 0 0 0 255 ECU_ADDRESS 0x0 /end MEASUREMENT
/begin MEASUREMENT Com_RxAccessInfo[11].RxSigBufferArrayBasedShdBufferStartIdxOfRxAccessInfo "" UBYTE Com_RxSigBufferArrayBasedShdBufferStartIdxOfRxAccessInfoType 0 0 0 255 ECU_ADDRESS 0x0 /end MEASUREMENT
/begin MEASUREMENT Com_RxAccessInfo[11].RxTOutInfoIdxOfRxAccessInfo "" UBYTE Com_RxTOutInfoIdxOfRxAccessInfoType 0 0 0 255 ECU_ADDRESS 0x0 /end MEASUREMENT
/begin MEASUREMENT Com_RxAccessInfo[11].ShdBufferIdxOfRxAccessInfo "" UWORD Com_ShdBufferIdxOfRxAccessInfoType 0 0 0 65535 ECU_ADDRESS 0x0 /end MEASUREMENT
/begin MEASUREMENT Com_RxAccessInfo[11].SignalLengthInByteOfRxAccessInfo "" UBYTE NO_COMPU_METHOD 0 0 0 255 ECU_ADDRESS 0x0 /end MEASUREMENT
/begin MEASUREMENT Com_RxAccessInfo[11].StartByteInPduPositionOfRxAccessInfo "" UBYTE NO_COMPU_METHOD 0 0 0 255 ECU_ADDRESS 0x0 /end MEASUREMENT
/begin MEASUREMENT Com_RxAccessInfo[11].TmpBufferIdxOfRxAccessInfo "" UBYTE Com_TmpBufferIdxOfRxAccessInfoType 0 0 0 255 ECU_ADDRESS 0x0 /end MEASUREMENT
/begin MEASUREMENT Com_RxAccessInfo[11].TmpBufferOfRxAccessInfo "" UBYTE Com_TmpBufferOfRxAccessInfoType 0 0 0 255 ECU_ADDRESS 0x0 /end MEASUREMENT
/begin MEASUREMENT Com_RxAccessInfo[11].TmpRxShdBufferArrayBasedTmpBufferEndIdxOfRxAccessInfo "" UBYTE Com_TmpRxShdBufferArrayBasedTmpBufferEndIdxOfRxAccessInfoType 0 0 0 255 ECU_ADDRESS 0x0 /end MEASUREMENT
/begin MEASUREMENT Com_RxAccessInfo[11].TmpRxShdBufferArrayBasedTmpBufferStartIdxOfRxAccessInfo "" UBYTE Com_TmpRxShdBufferArrayBasedTmpBufferStartIdxOfRxAccessInfoType 0 0 0 255 ECU_ADDRESS 0x0 /end MEASUREMENT
/begin MEASUREMENT Com_RxAccessInfo[120].ApplTypeOfRxAccessInfo "" UBYTE Com_ApplTypeOfRxAccessInfoType 0 0 0 255 ECU_ADDRESS 0x0 /end MEASUREMENT
/begin MEASUREMENT Com_RxAccessInfo[120].BitLengthOfRxAccessInfo "" UWORD NO_COMPU_METHOD 0 0 0 65535 ECU_ADDRESS 0x0 /end MEASUREMENT
/begin MEASUREMENT Com_RxAccessInfo[120].BitPositionOfRxAccessInfo "" UWORD NO_COMPU_METHOD 0 0 0 65535 ECU_ADDRESS 0x0 /end MEASUREMENT
/begin MEASUREMENT Com_RxAccessInfo[120].BufferIdxOfRxAccessInfo "" UWORD Com_BufferIdxOfRxAccessInfoType 0 0 0 65535 ECU_ADDRESS 0x0 /end MEASUREMENT
/begin MEASUREMENT Com_RxAccessInfo[120].BusAccOfRxAccessInfo "" UBYTE Com_BusAccOfRxAccessInfoType 0 0 0 255 ECU_ADDRESS 0x0 /end MEASUREMENT
/begin MEASUREMENT Com_RxAccessInfo[120].ByteLengthOfRxAccessInfo "" UBYTE NO_COMPU_METHOD 0 0 0 255 ECU_ADDRESS 0x0 /end MEASUREMENT
/begin COMPU_METHOD Com_ApplTypeOfRxAccessInfoType "" TAB_VERB "%10.1" "" COMPU_TAB_REF Com_ApplTypeOfRxAccessInfoType /end COMPU_METHOD
/begin COMPU_METHOD Com_BufferIdxOfRxAccessInfoType "" TAB_VERB "%10.1" "" COMPU_TAB_REF Com_BufferIdxOfRxAccessInfoType /end COMPU_METHOD
/begin COMPU_METHOD Com_BusAccOfRxAccessInfoType "" TAB_VERB "%10.1" "" COMPU_TAB_REF Com_BusAccOfRxAccessInfoType /end COMPU_METHOD
/begin COMPU_METHOD Com_ConstValueArrayBasedInitValueEndIdxOfRxAccessInfoType "" TAB_VERB "%10.1" "" COMPU_TAB_REF Com_ConstValueArrayBasedInitValueEndIdxOfRxAccessInfoType /end COMPU_METHOD
/begin COMPU_METHOD Com_ConstValueArrayBasedInitValueStartIdxOfRxAccessInfoType "" TAB_VERB "%10.1" "" COMPU_TAB_REF Com_ConstValueArrayBasedInitValueStartIdxOfRxAccessInfoType /end COMPU_METHOD
/begin COMPU_METHOD Com_DynSignalOfRxAccessInfoType "" TAB_VERB "%10.1" "" COMPU_TAB_REF Com_DynSignalOfRxAccessInfoType /end COMPU_METHOD
/begin COMPU_METHOD Com_IPduGroupInfoToSubIPduGroupsIndStartIdxOfIPduGroupInfoType "" TAB_VERB "%10.1" "" COMPU_TAB_REF Com_IPduGroupInfoToSubIPduGroupsIndStartIdxOfIPduGroupInfoType /end COMPU_METHOD
/begin COMPU_METHOD Com_IPduGroupStateType "" TAB_VERB "%10.1" "" COMPU_TAB_REF Com_IPduGroupStateType /end COMPU_METHOD
/begin COMPU_METHOD Com_InitValueIdxOfRxAccessInfoType "" TAB_VERB "%10.1" "" COMPU_TAB_REF Com_InitValueIdxOfRxAccessInfoType /end COMPU_METHOD
/begin COMPU_METHOD Com_InitValueOfRxAccessInfoType "" TAB_VERB "%10.1" "" COMPU_TAB_REF Com_InitValueOfRxAccessInfoType /end COMPU_METHOD
/begin COMPU_METHOD Com_InitializedType "" TAB_VERB "%10.1" "" COMPU_TAB_REF Com_InitializedType /end COMPU_METHOD
/begin COMPU_METHOD Com_InvValueIdxOfRxAccessInfoType "" TAB_VERB "%10.1" "" COMPU_TAB_REF Com_InvValueIdxOfRxAccessInfoType /end COMPU_METHOD
/begin COMPU_METHOD Com_InvValueOfRxAccessInfoType "" TAB_VERB "%10.1" "" COMPU_TAB_REF Com_InvValueOfRxAccessInfoType /end COMPU_METHOD
/begin COMPU_METHOD Com_IsGroupSignalOfRxAccessInfoType "" TAB_VERB "%10.1" "" COMPU_TAB_REF Com_IsGroupSignalOfRxAccessInfoType /end COMPU_METHOD
/begin COMPU_METHOD Com_PartitionsRxStructIdxOfIPduGroupInfoType "" TAB_VERB "%10.1" "" COMPU_TAB_REF Com_PartitionsRxStructIdxOfIPduGroupInfoType /end COMPU_METHOD
/begin COMPU_METHOD Com_PartitionsTxStructIdxOfIPduGroupInfoType "" TAB_VERB "%10.1" "" COMPU_TAB_REF Com_PartitionsTxStructIdxOfIPduGroupInfoType /end COMPU_METHOD
/begin COMPU_METHOD Com_RxDataTimeoutSubstitutionValueIdxOfRxAccessInfoType "" TAB_VERB "%10.1" "" COMPU_TAB_REF Com_RxDataTimeoutSubstitutionValueIdxOfRxAccessInfoType /end COMPU_METHOD
/begin COMPU_METHOD Com_RxDataTimeoutSubstitutionValueOfRxAccessInfoType "" TAB_VERB "%10.1" "" COMPU_TAB_REF Com_RxDataTimeoutSubstitutionValueOfRxAccessInfoType /end COMPU_METHOD
/begin COMPU_METHOD Com_RxPduInfoIndEndIdxOfIPduGroupInfoType "" TAB_VERB "%10.1" "" COMPU_TAB_REF Com_RxPduInfoIndEndIdxOfIPduGroupInfoType /end COMPU_METHOD
/begin COMPU_METHOD Com_RxPduInfoIndStartIdxOfIPduGroupInfoType "" TAB_VERB "%10.1" "" COMPU_TAB_REF Com_RxPduInfoIndStartIdxOfIPduGroupInfoType /end COMPU_METHOD
/begin COMPU_METHOD Com_RxPduInfoOfMainFunctionRxIndStartIdxOfMainFunctionRxStructType "" TAB_VERB "%10.1" "" COMPU_TAB_REF Com_RxPduInfoOfMainFunctionRxIndStartIdxOfMainFunctionRxStructType /end COMPU_METHOD
/begin COMPU_METHOD Com_RxSigBufferArrayBasedBufferEndIdxOfRxAccessInfoType "" TAB_VERB "%10.1" "" COMPU_TAB_REF Com_RxSigBufferArrayBasedBufferEndIdxOfRxAccessInfoType /end COMPU_METHOD
/begin COMPU_METHOD Com_RxSigBufferArrayBasedBufferStartIdxOfRxAccessInfoType "" TAB_VERB "%10.1" "" COMPU_TAB_REF Com_RxSigBufferArrayBasedBufferStartIdxOfRxAccessInfoType /end COMPU_METHOD
/begin COMPU_METHOD Com_RxSigBufferArrayBasedShdBufferEndIdxOfRxAccessInfoType "" TAB_VERB "%10.1" "" COMPU_TAB_REF Com_RxSigBufferArrayBasedShdBufferEndIdxOfRxAccessInfoType /end COMPU_METHOD
/begin COMPU_METHOD Com_RxSigBufferArrayBasedShdBufferStartIdxOfRxAccessInfoType "" TAB_VERB "%10.1" "" COMPU_TAB_REF Com_RxSigBufferArrayBasedShdBufferStartIdxOfRxAccessInfoType /end COMPU_METHOD
/begin COMPU_METHOD Com_RxTOutInfoIdxOfRxAccessInfoType "" TAB_VERB "%10.1" "" COMPU_TAB_REF Com_RxTOutInfoIdxOfRxAccessInfoType /end COMPU_METHOD
/begin COMPU_METHOD Com_RxTOutInfoOfMainFunctionRxIndStartIdxOfMainFunctionRxStructType "" TAB_VERB "%10.1" "" COMPU_TAB_REF Com_RxTOutInfoOfMainFunctionRxIndStartIdxOfMainFunctionRxStructType /end COMPU_METHOD
/begin COMPU_METHOD Com_ShdBufferIdxOfRxAccessInfoType "" TAB_VERB "%10.1" "" COMPU_TAB_REF Com_ShdBufferIdxOfRxAccessInfoType /end COMPU_METHOD
/begin COMPU_METHOD Com_TmpBufferIdxOfRxAccessInfoType "" TAB_VERB "%10.1" "" COMPU_TAB_REF Com_TmpBufferIdxOfRxAccessInfoType /end COMPU_METHOD
/begin COMPU_METHOD Com_TmpBufferOfRxAccessInfoType "" TAB_VERB "%10.1" "" COMPU_TAB_REF Com_TmpBufferOfRxAccessInfoType /end COMPU_METHOD
/begin COMPU_METHOD Com_TmpRxShdBufferArrayBasedTmpBufferEndIdxOfRxAccessInfoType "" TAB_VERB "%10.1" "" COMPU_TAB_REF Com_TmpRxShdBufferArrayBasedTmpBufferEndIdxOfRxAccessInfoType /end COMPU_METHOD
/begin COMPU_METHOD Com_TmpRxShdBufferArrayBasedTmpBufferStartIdxOfRxAccessInfoType "" TAB_VERB "%10.1" "" COMPU_TAB_REF Com_TmpRxShdBufferArrayBasedTmpBufferStartIdxOfRxAccessInfoType /end COMPU_METHOD
/begin COMPU_METHOD Com_TxCyclicPduOfMainFunctionTxIndStartIdxOfMainFunctionTxStructType "" TAB_VERB "%10.1" "" COMPU_TAB_REF Com_TxCyclicPduOfMainFunctionTxIndStartIdxOfMainFunctionTxStructType /end COMPU_METHOD
/begin COMPU_METHOD Com_TxPduInfoIndEndIdxOfIPduGroupInfoType "" TAB_VERB "%10.1" "" COMPU_TAB_REF Com_TxPduInfoIndEndIdxOfIPduGroupInfoType /end COMPU_METHOD
/begin COMPU_METHOD Com_TxPduInfoIndStartIdxOfIPduGroupInfoType "" TAB_VERB "%10.1" "" COMPU_TAB_REF Com_TxPduInfoIndStartIdxOfIPduGroupInfoType /end COMPU_METHOD
/begin COMPU_METHOD Com_TxPduInfoOfMainFunctionTxIndStartIdxOfMainFunctionTxStructType "" TAB_VERB "%10.1" "" COMPU_TAB_REF Com_TxPduInfoOfMainFunctionTxIndStartIdxOfMainFunctionTxStructType /end COMPU_METHOD
/begin COMPU_METHOD Com_TxTOutInfoOfMainFunctionTxIndStartIdxOfMainFunctionTxStructType "" TAB_VERB "%10.1" "" COMPU_TAB_REF Com_TxTOutInfoOfMainFunctionTxIndStartIdxOfMainFunctionTxStructType /end COMPU_METHOD
/begin COMPU_VTAB Com_ApplTypeOfRxAccessInfoType "" TAB_VERB 4 0 "COM_UINT8_APPLTYPEOFRXACCESSINFO" 2 "COM_UINT16_APPLTYPEOFRXACCESSINFO" 4 "COM_UINT32_APPLTYPEOFRXACCESSINFO" 8 "COM_UINT8_N_APPLTYPEOFRXACCESSINFO" /end COMPU_VTAB
/begin COMPU_VTAB Com_BufferIdxOfRxAccessInfoType "" TAB_VERB 1 65535 "COM_NO_BUFFERIDXOFRXACCESSINFO" /end COMPU_VTAB
/begin COMPU_VTAB Com_BusAccOfRxAccessInfoType "" TAB_VERB 5 0 "COM_NBIT_BUSACCOFRXACCESSINFO" 1 "COM_BYTE_BUSACCOFRXACCESSINFO" 2 "COM_NBYTE_BUSACCOFRXACCESSINFO" 4 "COM_NBITNBYTE_BUSACCOFRXACCESSINFO" 6 "COM_ARRAY_BASED_BUSACCOFRXACCESSINFO" /end COMPU_VTAB
/begin COMPU_VTAB Com_ConstValueArrayBasedInitValueEndIdxOfRxAccessInfoType "" TAB_VERB 1 255 "COM_NO_CONSTVALUEARRAYBASEDINITVALUEENDIDXOFRXACCESSINFO" /end COMPU_VTAB
/begin COMPU_VTAB Com_ConstValueArrayBasedInitValueStartIdxOfRxAccessInfoType "" TAB_VERB 1 255 "COM_NO_CONSTVALUEARRAYBASEDINITVALUESTARTIDXOFRXACCESSINFO" /end COMPU_VTAB
/begin COMPU_VTAB_RANGE Com_DynSignalOfRxAccessInfoType "" 2 0 0 "FALSE" 1 255 "TRUE" /end COMPU_VTAB_RANGE
/begin COMPU_VTAB Com_IPduGroupInfoToSubIPduGroupsIndStartIdxOfIPduGroupInfoType "" TAB_VERB 1 255 "COM_NO_IPDUGROUPINFOTOSUBIPDUGROUPSINDSTARTIDXOFIPDUGROUPINFO" /end COMPU_VTAB
/begin COMPU_VTAB Com_IPduGroupStateType "" TAB_VERB 3 0 "COM_INACTIVE_IPDUGROUPSTATE" 1 "COM_ACTIVE_DMINACTIVE_IPDUGROUPSTATE" 2 "COM_ACTIVE_DMACTIVE_IPDUGROUPSTATE" /end COMPU_VTAB
/begin COMPU_VTAB Com_InitValueIdxOfRxAccessInfoType "" TAB_VERB 1 255 "COM_NO_INITVALUEIDXOFRXACCESSINFO" /end COMPU_VTAB
/begin COMPU_VTAB Com_InitValueOfRxAccessInfoType "" TAB_VERB 4 0 "COM_CONSTVALUEUINT8_INITVALUEOFRXACCESSINFO" 1 "COM_CONSTVALUEUINT16_INITVALUEOFRXACCESSINFO" 2 "COM_CONSTVALUEUINT32_INITVALUEOFRXACCESSINFO" 255 "COM_NO_INITVALUEOFRXACCESSINFO" /end COMPU_VTAB
/begin COMPU_VTAB_RANGE Com_InitializedType "" 2 0 0 "FALSE" 1 255 "TRUE" /end COMPU_VTAB_RANGE
/begin COMPU_VTAB Com_InvValueIdxOfRxAccessInfoType "" TAB_VERB 1 255 "COM_NO_INVVALUEIDXOFRXACCESSINFO" /end COMPU_VTAB
/begin COMPU_VTAB Com_InvValueOfRxAccessInfoType "" TAB_VERB 4 0 "COM_CONSTVALUEUINT8_INVVALUEOFRXACCESSINFO" 1 "COM_CONSTVALUEUINT16_INVVALUEOFRXACCESSINFO" 2 "COM_CONSTVALUEUINT32_INVVALUEOFRXACCESSINFO" 255 "COM_NO_INVVALUEOFRXACCESSINFO" /end COMPU_VTAB
/begin COMPU_VTAB_RANGE Com_IsGroupSignalOfRxAccessInfoType "" 2 0 0 "FALSE" 1 255 "TRUE" /end COMPU_VTAB_RANGE
/begin COMPU_VTAB Com_PartitionsRxStructIdxOfIPduGroupInfoType "" TAB_VERB 1 255 "COM_NO_PARTITIONSRXSTRUCTIDXOFIPDUGROUPINFO" /end COMPU_VTAB
/begin COMPU_VTAB Com_PartitionsTxStructIdxOfIPduGroupInfoType "" TAB_VERB 1 255 "COM_NO_PARTITIONSTXSTRUCTIDXOFIPDUGROUPINFO" /end COMPU_VTAB
/begin COMPU_VTAB Com_RxDataTimeoutSubstitutionValueIdxOfRxAccessInfoType "" TAB_VERB 1 255 "COM_NO_RXDATATIMEOUTSUBSTITUTIONVALUEIDXOFRXACCESSINFO" /end COMPU_VTAB
/begin COMPU_VTAB Com_RxDataTimeoutSubstitutionValueOfRxAccessInfoType "" TAB_VERB 3 0 "COM_CONSTVALUEUINT8_RXDATATIMEOUTSUBSTITUTIONVALUEOFRXACCESSINFO" 2 "COM_CONSTVALUEUINT32_RXDATATIMEOUTSUBSTITUTIONVALUEOFRXACCESSINFO" 255 "COM_NO_RXDATATIMEOUTSUBSTITUTIONVALUEOFRXACCESSINFO" /end COMPU_VTAB
/begin COMPU_VTAB Com_RxPduInfoIndEndIdxOfIPduGroupInfoType "" TAB_VERB 1 255 "COM_NO_RXPDUINFOINDENDIDXOFIPDUGROUPINFO" /end COMPU_VTAB
/begin COMPU_VTAB Com_RxPduInfoIndStartIdxOfIPduGroupInfoType "" TAB_VERB 1 255 "COM_NO_RXPDUINFOINDSTARTIDXOFIPDUGROUPINFO" /end COMPU_VTAB
/begin COMPU_VTAB Com_RxPduInfoOfMainFunctionRxIndStartIdxOfMainFunctionRxStructType "" TAB_VERB 1 255 "COM_NO_RXPDUINFOOFMAINFUNCTIONRXINDSTARTIDXOFMAINFUNCTIONRXSTRUCT" /end COMPU_VTAB
/begin COMPU_VTAB Com_RxSigBufferArrayBasedBufferEndIdxOfRxAccessInfoType "" TAB_VERB 1 255 "COM_NO_RXSIGBUFFERARRAYBASEDBUFFERENDIDXOFRXACCESSINFO" /end COMPU_VTAB
/begin COMPU_VTAB Com_RxSigBufferArrayBasedBufferStartIdxOfRxAccessInfoType "" TAB_VERB 1 255 "COM_NO_RXSIGBUFFERARRAYBASEDBUFFERSTARTIDXOFRXACCESSINFO" /end COMPU_VTAB
/begin COMPU_VTAB Com_RxSigBufferArrayBasedShdBufferEndIdxOfRxAccessInfoType "" TAB_VERB 1 255 "COM_NO_RXSIGBUFFERARRAYBASEDSHDBUFFERENDIDXOFRXACCESSINFO" /end COMPU_VTAB
/begin COMPU_VTAB Com_RxSigBufferArrayBasedShdBufferStartIdxOfRxAccessInfoType "" TAB_VERB 1 255 "COM_NO_RXSIGBUFFERARRAYBASEDSHDBUFFERSTARTIDXOFRXACCESSINFO" /end COMPU_VTAB
/begin COMPU_VTAB Com_RxTOutInfoIdxOfRxAccessInfoType "" TAB_VERB 1 255 "COM_NO_RXTOUTINFOIDXOFRXACCESSINFO" /end COMPU_VTAB
/begin COMPU_VTAB Com_RxTOutInfoOfMainFunctionRxIndStartIdxOfMainFunctionRxStructType "" TAB_VERB 1 255 "COM_NO_RXTOUTINFOOFMAINFUNCTIONRXINDSTARTIDXOFMAINFUNCTIONRXSTRUCT" /end COMPU_VTAB
/begin COMPU_VTAB Com_ShdBufferIdxOfRxAccessInfoType "" TAB_VERB 1 65535 "COM_NO_SHDBUFFERIDXOFRXACCESSINFO" /end COMPU_VTAB
/begin COMPU_VTAB Com_TmpBufferIdxOfRxAccessInfoType "" TAB_VERB 1 255 "COM_NO_TMPBUFFERIDXOFRXACCESSINFO" /end COMPU_VTAB
/begin COMPU_VTAB Com_TmpBufferOfRxAccessInfoType "" TAB_VERB 4 0 "COM_TMPRXSHDBUFFERUINT8_TMPBUFFEROFRXACCESSINFO" 1 "COM_TMPRXSHDBUFFERUINT16_TMPBUFFEROFRXACCESSINFO" 2 "COM_TMPRXSHDBUFFERUINT32_TMPBUFFEROFRXACCESSINFO" 255 "COM_NO_TMPBUFFEROFRXACCESSINFO" /end COMPU_VTAB
/begin COMPU_VTAB Com_TmpRxShdBufferArrayBasedTmpBufferEndIdxOfRxAccessInfoType "" TAB_VERB 1 255 "COM_NO_TMPRXSHDBUFFERARRAYBASEDTMPBUFFERENDIDXOFRXACCESSINFO" /end COMPU_VTAB
/begin COMPU_VTAB Com_TmpRxShdBufferArrayBasedTmpBufferStartIdxOfRxAccessInfoType "" TAB_VERB 1 255 "COM_NO_TMPRXSHDBUFFERARRAYBASEDTMPBUFFERSTARTIDXOFRXACCESSINFO" /end COMPU_VTAB
/begin COMPU_VTAB Com_TxCyclicPduOfMainFunctionTxIndStartIdxOfMainFunctionTxStructType "" TAB_VERB 1 255 "COM_NO_TXCYCLICPDUOFMAINFUNCTIONTXINDSTARTIDXOFMAINFUNCTIONTXSTRUCT" /end COMPU_VTAB
/begin COMPU_VTAB Com_TxPduInfoIndEndIdxOfIPduGroupInfoType "" TAB_VERB 1 255 "COM_NO_TXPDUINFOINDENDIDXOFIPDUGROUPINFO" /end COMPU_VTAB
/begin COMPU_VTAB Com_TxPduInfoIndStartIdxOfIPduGroupInfoType "" TAB_VERB 1 255 "COM_NO_TXPDUINFOINDSTARTIDXOFIPDUGROUPINFO" /end COMPU_VTAB
/begin COMPU_VTAB Com_TxPduInfoOfMainFunctionTxIndStartIdxOfMainFunctionTxStructType "" TAB_VERB 1 255 "COM_NO_TXPDUINFOOFMAINFUNCTIONTXINDSTARTIDXOFMAINFUNCTIONTXSTRUCT" /end COMPU_VTAB
/begin COMPU_VTAB Com_TxTOutInfoOfMainFunctionTxIndStartIdxOfMainFunctionTxStructType "" TAB_VERB 1 255 "COM_NO_TXTOUTINFOOFMAINFUNCTIONTXINDSTARTIDXOFMAINFUNCTIONTXSTRUCT" /end COMPU_VTAB
/begin GROUP Com ""
 /begin REF_MEASUREMENT Com_IPduGroupInfo[0].RxPduInfoIndStartIdxOfIPduGroupInfo Com_IPduGroupInfo[0].TxPduInfoIndEndIdxOfIPduGroupInfo Com_IPduGroupInfo[0].TxPduInfoIndStartIdxOfIPduGroupInfo Com_IPduGroupInfo[10].IPduGroupInfoToSubIPduGroupsIndStartIdxOfIPduGroupInfo Com_IPduGroupInfo[10].PartitionsRxStructIdxOfIPduGroupInfo Com_IPduGroupInfo[10].PartitionsTxStructIdxOfIPduGroupInfo Com_IPduGroupInfo[10].RxPduInfoIndEndIdxOfIPduGroupInfo Com_IPduGroupInfo[10].RxPduInfoIndStartIdxOfIPduGroupInfo Com_IPduGroupInfo[10].TxPduInfoIndEndIdxOfIPduGroupInfo Com_IPduGroupInfo[10].TxPduInfoIndStartIdxOfIPduGroupInfo Com_IPduGroupInfo[11].IPduGroupInfoToSubIPduGroupsIndStartIdxOfIPduGroupInfo Com_IPduGroupInfo[11].PartitionsRxStructIdxOfIPduGroupInfo Com_IPduGroupInfo[11].PartitionsTxStructIdxOfIPduGroupInfo Com_IPduGroupInfo[11].RxPduInfoIndEndIdxOfIPduGroupInfo Com_IPduGroupInfo[11].RxPduInfoIndStartIdxOfIPduGroupInfo Com_IPduGroupInfo[11].TxPduInfoIndEndIdxOfIPduGroupInfo Com_IPduGroupInfo[11].TxPduInfoIndStartIdxOfIPduGroupInfo Com_IPduGroupInfo[12].IPduGroupInfoToSubIPduGroupsIndStartIdxOfIPduGroupInfo Com_IPduGroupInfo[12].PartitionsRxStructIdxOfIPduGroupInfo Com_IPduGroupInfo[12].PartitionsTxStructIdxOfIPduGroupInfo Com_IPduGroupInfo[12].RxPduInfoIndEndIdxOfIPduGroupInfo Com_IPduGroupInfo[12].RxPduInfoIndStartIdxOfIPduGroupInfo Com_IPduGroupInfo[12].TxPduInfoIndEndIdxOfIPduGroupInfo Com_IPduGroupInfo[12].TxPduInfoIndStartIdxOfIPduGroupInfo Com_IPduGroupInfo[13].IPduGroupInfoToSubIPduGroupsIndStartIdxOfIPduGroupInfo Com_IPduGroupInfo[13].PartitionsRxStructIdxOfIPduGroupInfo Com_IPduGroupInfo[13].PartitionsTxStructIdxOfIPduGroupInfo Com_IPduGroupInfo[13].RxPduInfoIndEndIdxOfIPduGroupInfo Com_IPduGroupInfo[13].RxPduInfoIndStartIdxOfIPduGroupInfo Com_IPduGroupInfo[13].TxPduInfoIndEndIdxOfIPduGroupInfo Com_IPduGroupInfo[13].TxPduInfoIndStartIdxOfIPduGroupInfo Com_IPduGroupInfo[14].IPduGroupInfoToSubIPduGroupsIndStartIdxOfIPduGroupInfo Com_IPduGroupInfo[14].PartitionsRxStructIdxOfIPduGroupInfo Com_IPduGroupInfo[14].PartitionsTxStructIdxOfIPduGroupInfo Com_IPduGroupInfo[14].RxPduInfoIndEndIdxOfIPduGroupInfo Com_IPduGroupInfo[14].RxPduInfoIndStartIdxOfIPduGroupInfo Com_IPduGroupInfo[14].TxPduInfoIndEndIdxOfIPduGroupInfo Com_IPduGroupInfo[14].TxPduInfoIndStartIdxOfIPduGroupInfo Com_IPduGroupInfo[15].IPduGroupInfoToSubIPduGroupsIndStartIdxOfIPduGroupInfo Com_IPduGroupInfo[15].PartitionsRxStructIdxOfIPduGroupInfo Com_IPduGroupInfo[15].PartitionsTxStructIdxOfIPduGroupInfo Com_IPduGroupInfo[15].RxPduInfoIndEndIdxOfIPduGroupInfo Com_IPduGroupInfo[15].RxPduInfoIndStartIdxOfIPduGroupInfo Com_IPduGroupInfo[15].TxPduInfoIndEndIdxOfIPduGroupInfo Com_IPduGroupInfo[15].TxPduInfoIndStartIdxOfIPduGroupInfo Com_IPduGroupInfo[16].IPduGroupInfoToSubIPduGroupsIndStartIdxOfIPduGroupInfo Com_IPduGroupInfo[16].PartitionsRxStructIdxOfIPduGroupInfo Com_IPduGroupInfo[16].PartitionsTxStructIdxOfIPduGroupInfo Com_IPduGroupInfo[16].RxPduInfoIndEndIdxOfIPduGroupInfo Com_IPduGroupInfo[16].RxPduInfoIndStartIdxOfIPduGroupInfo Com_IPduGroupInfo[16].TxPduInfoIndEndIdxOfIPduGroupInfo Com_IPduGroupInfo[16].TxPduInfoIndStartIdxOfIPduGroupInfo Com_IPduGroupInfo[17].IPduGroupInfoToSubIPduGroupsIndStartIdxOfIPduGroupInfo Com_IPduGroupInfo[17].PartitionsRxStructIdxOfIPduGroupInfo Com_IPduGroupInfo[17].PartitionsTxStructIdxOfIPduGroupInfo Com_IPduGroupInfo[17].RxPduInfoIndEndIdxOfIPduGroupInfo Com_IPduGroupInfo[17].RxPduInfoIndStartIdxOfIPduGroupInfo Com_IPduGroupInfo[17].TxPduInfoIndEndIdxOfIPduGroupInfo Com_IPduGroupInfo[17].TxPduInfoIndStartIdxOfIPduGroupInfo Com_IPduGroupInfo[18].IPduGroupInfoToSubIPduGroupsIndStartIdxOfIPduGroupInfo Com_IPduGroupInfo[18].PartitionsRxStructIdxOfIPduGroupInfo Com_IPduGroupInfo[18].PartitionsTxStructIdxOfIPduGroupInfo Com_IPduGroupInfo[18].RxPduInfoIndEndIdxOfIPduGroupInfo Com_IPduGroupInfo[18].RxPduInfoIndStartIdxOfIPduGroupInfo Com_IPduGroupInfo[18].TxPduInfoIndEndIdxOfIPduGroupInfo Com_IPduGroupInfo[18].TxPduInfoIndStartIdxOfIPduGroupInfo Com_IPduGroupInfo[1].IPduGroupInfoToSubIPduGroupsIndStartIdxOfIPduGroupInfo Com_IPduGroupInfo[1].PartitionsRxStructIdxOfIPduGroupInfo Com_IPduGroupInfo[1].PartitionsTxStructIdxOfIPduGroupInfo Com_IPduGroupInfo[1].RxPduInfoIndEndIdxOfIPduGroupInfo Com_IPduGroupInfo[1].RxPduInfoIndStartIdxOfIPduGroupInfo Com_IPduGroupInfo[1].TxPduInfoIndEndIdxOfIPduGroupInfo Com_IPduGroupInfo[1].TxPduInfoIndStartIdxOfIPduGroupInfo Com_IPduGroupInfo[2].IPduGroupInfoToSubIPduGroupsIndStartIdxOfIPduGroupInfo Com_IPduGroupInfo[2].PartitionsRxStructIdxOfIPduGroupInfo Com_IPduGroupInfo[2].PartitionsTxStructIdxOfIPduGroupInfo Com_IPduGroupInfo[2].RxPduInfoIndEndIdxOfIPduGroupInfo Com_IPduGroupInfo[2].RxPduInfoIndStartIdxOfIPduGroupInfo Com_IPduGroupInfo[2].TxPduInfoIndEndIdxOfIPduGroupInfo Com_IPduGroupInfo[2].TxPduInfoIndStartIdxOfIPduGroupInfo Com_IPduGroupInfo[3].IPduGroupInfoToSubIPduGroupsIndStartIdxOfIPduGroupInfo Com_IPduGroupInfo[3].PartitionsRxStructIdxOfIPduGroupInfo Com_IPduGroupInfo[3].PartitionsTxStructIdxOfIPduGroupInfo Com_IPduGroupInfo[3].RxPduInfoIndEndIdxOfIPduGroupInfo Com_IPduGroupInfo[3].RxPduInfoIndStartIdxOfIPduGroupInfo Com_IPduGroupInfo[3].TxPduInfoIndEndIdxOfIPduGroupInfo Com_IPduGroupInfo[3].TxPduInfoIndStartIdxOfIPduGroupInfo Com_IPduGroupInfo[4].IPduGroupInfoToSubIPduGroupsIndStartIdxOfIPduGroupInfo Com_IPduGroupInfo[4].PartitionsRxStructIdxOfIPduGroupInfo Com_IPduGroupInfo[4].PartitionsTxStructIdxOfIPduGroupInfo Com_IPduGroupInfo[4].RxPduInfoIndEndIdxOfIPduGroupInfo Com_IPduGroupInfo[4].RxPduInfoIndStartIdxOfIPduGroupInfo Com_IPduGroupInfo[4].TxPduInfoIndEndIdxOfIPduGroupInfo Com_IPduGroupInfo[4].TxPduInfoIndStartIdxOfIPduGroupInfo Com_IPduGroupInfo[5].IPduGroupInfoToSubIPduGroupsIndStartIdxOfIPduGroupInfo Com_IPduGroupInfo[5].PartitionsRxStructIdxOfIPduGroupInfo Com_IPduGroupInfo[5].PartitionsTxStructIdxOfIPduGroupInfo Com_IPduGroupInfo[5].RxPduInfoIndEndIdxOfIPduGroupInfo Com_IPduGroupInfo[5].RxPduInfoIndStartIdxOfIPduGroupInfo Com_IPduGroupInfo[5].TxPduInfoIndEndIdxOfIPduGroupInfo Com_IPduGroupInfo[5].TxPduInfoIndStartIdxOfIPduGroupInfo Com_IPduGroupInfo[6].IPduGroupInfoToSubIPduGroupsIndStartIdxOfIPduGroupInfo Com_IPduGroupInfo[6].PartitionsRxStructIdxOfIPduGroupInfo Com_IPduGroupInfo[6].PartitionsTxStructIdxOfIPduGroupInfo Com_IPduGroupInfo[6].RxPduInfoIndEndIdxOfIPduGroupInfo Com_IPduGroupInfo[6].RxPduInfoIndStartIdxOfIPduGroupInfo Com_IPduGroupInfo[6].TxPduInfoIndEndIdxOfIPduGroupInfo Com_IPduGroupInfo[6].TxPduInfoIndStartIdxOfIPduGroupInfo Com_IPduGroupInfo[7].IPduGroupInfoToSubIPduGroupsIndStartIdxOfIPduGroupInfo Com_IPduGroupInfo[7].PartitionsRxStructIdxOfIPduGroupInfo Com_IPduGroupInfo[7].PartitionsTxStructIdxOfIPduGroupInfo Com_IPduGroupInfo[7].RxPduInfoIndEndIdxOfIPduGroupInfo Com_IPduGroupInfo[7].RxPduInfoIndStartIdxOfIPduGroupInfo Com_IPduGroupInfo[7].TxPduInfoIndEndIdxOfIPduGroupInfo Com_IPduGroupInfo[7].TxPduInfoIndStartIdxOfIPduGroupInfo Com_IPduGroupInfo[8].IPduGroupInfoToSubIPduGroupsIndStartIdxOfIPduGroupInfo Com_IPduGroupInfo[8].PartitionsRxStructIdxOfIPduGroupInfo Com_IPduGroupInfo[8].PartitionsTxStructIdxOfIPduGroupInfo Com_IPduGroupInfo[8].RxPduInfoIndEndIdxOfIPduGroupInfo Com_IPduGroupInfo[8].RxPduInfoIndStartIdxOfIPduGroupInfo Com_IPduGroupInfo[8].TxPduInfoIndEndIdxOfIPduGroupInfo Com_IPduGroupInfo[8].TxPduInfoIndStartIdxOfIPduGroupInfo Com_IPduGroupInfo[9].IPduGroupInfoToSubIPduGroupsIndStartIdxOfIPduGroupInfo Com_IPduGroupInfo[9].PartitionsRxStructIdxOfIPduGroupInfo Com_IPduGroupInfo[9].PartitionsTxStructIdxOfIPduGroupInfo Com_IPduGroupInfo[9].RxPduInfoIndEndIdxOfIPduGroupInfo Com_IPduGroupInfo[9].RxPduInfoIndStartIdxOfIPduGroupInfo Com_IPduGroupInfo[9].TxPduInfoIndEndIdxOfIPduGroupInfo Com_IPduGroupInfo[9].TxPduInfoIndStartIdxOfIPduGroupInfo Com_IPduGroupState Com_Initialized Com_MainFunctionRxStruct[0].RxPduInfoOfMainFunctionRxIndStartIdxOfMainFunctionRxStruct Com_MainFunctionRxStruct[0].RxTOutInfoOfMainFunctionRxIndStartIdxOfMainFunctionRxStruct Com_MainFunctionTxStruct[0].TxCyclicPduOfMainFunctionTxIndStartIdxOfMainFunctionTxStruct Com_MainFunctionTxStruct[0].TxPduInfoOfMainFunctionTxIndStartIdxOfMainFunctionTxStruct Com_MainFunctionTxStruct[0].TxTOutInfoOfMainFunctionTxIndStartIdxOfMainFunctionTxStruct Com_RxAccessInfoInd Com_RxAccessInfo[0].ApplTypeOfRxAccessInfo Com_RxAccessInfo[0].BitLengthOfRxAccessInfo Com_RxAccessInfo[0].BitPositionOfRxAccessInfo Com_RxAccessInfo[0].BufferIdxOfRxAccessInfo Com_RxAccessInfo[0].BusAccOfRxAccessInfo Com_RxAccessInfo[0].ByteLengthOfRxAccessInfo Com_RxAccessInfo[0].ConstValueArrayBasedInitValueEndIdxOfRxAccessInfo Com_RxAccessInfo[0].ConstValueArrayBasedInitValueStartIdxOfRxAccessInfo Com_RxAccessInfo[0].DynSignalOfRxAccessInfo Com_RxAccessInfo[0].InitValueIdxOfRxAccessInfo Com_RxAccessInfo[0].InitValueOfRxAccessInfo Com_RxAccessInfo[0].InvValueIdxOfRxAccessInfo Com_RxAccessInfo[0].InvValueOfRxAccessInfo Com_RxAccessInfo[0].IsGroupSignalOfRxAccessInfo Com_RxAccessInfo[0].RxDataTimeoutSubstitutionValueIdxOfRxAccessInfo Com_RxAccessInfo[0].RxDataTimeoutSubstitutionValueOfRxAccessInfo Com_RxAccessInfo[0].RxPduInfoIdxOfRxAccessInfo Com_RxAccessInfo[0].RxSigBufferArrayBasedBufferEndIdxOfRxAccessInfo Com_RxAccessInfo[0].RxSigBufferArrayBasedBufferStartIdxOfRxAccessInfo Com_RxAccessInfo[0].RxSigBufferArrayBasedShdBufferEndIdxOfRxAccessInfo Com_RxAccessInfo[0].RxSigBufferArrayBasedShdBufferStartIdxOfRxAccessInfo Com_RxAccessInfo[0].RxTOutInfoIdxOfRxAccessInfo Com_RxAccessInfo[0].ShdBufferIdxOfRxAccessInfo Com_RxAccessInfo[0].SignalLengthInByteOfRxAccessInfo Com_RxAccessInfo[0].StartByteInPduPositionOfRxAccessInfo Com_RxAccessInfo[0].TmpBufferIdxOfRxAccessInfo Com_RxAccessInfo[0].TmpBufferOfRxAccessInfo Com_RxAccessInfo[0].TmpRxShdBufferArrayBasedTmpBufferEndIdxOfRxAccessInfo Com_RxAccessInfo[0].TmpRxShdBufferArrayBasedTmpBufferStartIdxOfRxAccessInfo Com_RxAccessInfo[100].ApplTypeOfRxAccessInfo Com_RxAccessInfo[100].BitLengthOfRxAccessInfo Com_RxAccessInfo[100].BitPositionOfRxAccessInfo Com_RxAccessInfo[100].BufferIdxOfRxAccessInfo Com_RxAccessInfo[100].BusAccOfRxAccessInfo Com_RxAccessInfo[100].ByteLengthOfRxAccessInfo Com_RxAccessInfo[100].ConstValueArrayBasedInitValueEndIdxOfRxAccessInfo Com_RxAccessInfo[100].ConstValueArrayBasedInitValueStartIdxOfRxAccessInfo Com_RxAccessInfo[100].DynSignalOfRxAccessInfo Com_RxAccessInfo[100].InitValueIdxOfRxAccessInfo Com_RxAccessInfo[100].InitValueOfRxAccessInfo Com_RxAccessInfo[100].InvValueIdxOfRxAccessInfo Com_RxAccessInfo[100].InvValueOfRxAccessInfo Com_RxAccessInfo[100].IsGroupSignalOfRxAccessInfo Com_RxAccessInfo[100].RxDataTimeoutSubstitutionValueIdxOfRxAccessInfo Com_RxAccessInfo[100].RxDataTimeoutSubstitutionValueOfRxAccessInfo Com_RxAccessInfo[100].RxPduInfoIdxOfRxAccessInfo Com_RxAccessInfo[100].RxSigBufferArrayBasedBufferEndIdxOfRxAccessInfo Com_RxAccessInfo[100].RxSigBufferArrayBasedBufferStartIdxOfRxAccessInfo Com_RxAccessInfo[100].RxSigBufferArrayBasedShdBufferEndIdxOfRxAccessInfo Com_RxAccessInfo[100].RxSigBufferArrayBasedShdBufferStartIdxOfRxAccessInfo Com_RxAccessInfo[100].RxTOutInfoIdxOfRxAccessInfo Com_RxAccessInfo[100].ShdBufferIdxOfRxAccessInfo Com_RxAccessInfo[100].SignalLengthInByteOfRxAccessInfo Com_RxAccessInfo[100].StartByteInPduPositionOfRxAccessInfo Com_RxAccessInfo[100].TmpBufferIdxOfRxAccessInfo Com_RxAccessInfo[100].TmpBufferOfRxAccessInfo Com_RxAccessInfo[100].TmpRxShdBufferArrayBasedTmpBufferEndIdxOfRxAccessInfo Com_RxAccessInfo[100].TmpRxShdBufferArrayBasedTmpBufferStartIdxOfRxAccessInfo Com_RxAccessInfo[101].ApplTypeOfRxAccessInfo Com_RxAccessInfo[101].BitLengthOfRxAccessInfo Com_RxAccessInfo[101].BitPositionOfRxAccessInfo Com_RxAccessInfo[101].BufferIdxOfRxAccessInfo Com_RxAccessInfo[101].BusAccOfRxAccessInfo Com_RxAccessInfo[101].ByteLengthOfRxAccessInfo Com_RxAccessInfo[101].ConstValueArrayBasedInitValueEndIdxOfRxAccessInfo Com_RxAccessInfo[101].ConstValueArrayBasedInitValueStartIdxOfRxAccessInfo Com_RxAccessInfo[101].DynSignalOfRxAccessInfo Com_RxAccessInfo[101].InitValueIdxOfRxAccessInfo Com_RxAccessInfo[101].InitValueOfRxAccessInfo Com_RxAccessInfo[101].InvValueIdxOfRxAccessInfo Com_RxAccessInfo[101].InvValueOfRxAccessInfo Com_RxAccessInfo[101].IsGroupSignalOfRxAccessInfo Com_RxAccessInfo[101].RxDataTimeoutSubstitutionValueIdxOfRxAccessInfo Com_RxAccessInfo[101].RxDataTimeoutSubstitutionValueOfRxAccessInfo Com_RxAccessInfo[101].RxPduInfoIdxOfRxAccessInfo Com_RxAccessInfo[101].RxSigBufferArrayBasedBufferEndIdxOfRxAccessInfo Com_RxAccessInfo[101].RxSigBufferArrayBasedBufferStartIdxOfRxAccessInfo Com_RxAccessInfo[101].RxSigBufferArrayBasedShdBufferEndIdxOfRxAccessInfo Com_RxAccessInfo[101].RxSigBufferArrayBasedShdBufferStartIdxOfRxAccessInfo Com_RxAccessInfo[101].RxTOutInfoIdxOfRxAccessInfo Com_RxAccessInfo[101].ShdBufferIdxOfRxAccessInfo Com_RxAccessInfo[101].SignalLengthInByteOfRxAccessInfo Com_RxAccessInfo[101].StartByteInPduPositionOfRxAccessInfo Com_RxAccessInfo[101].TmpBufferIdxOfRxAccessInfo Com_RxAccessInfo[101].TmpBufferOfRxAccessInfo Com_RxAccessInfo[101].TmpRxShdBufferArrayBasedTmpBufferEndIdxOfRxAccessInfo Com_RxAccessInfo[101].TmpRxShdBufferArrayBasedTmpBufferStartIdxOfRxAccessInfo Com_RxAccessInfo[102].ApplTypeOfRxAccessInfo Com_RxAccessInfo[102].BitLengthOfRxAccessInfo Com_RxAccessInfo[102].BitPositionOfRxAccessInfo Com_RxAccessInfo[102].BufferIdxOfRxAccessInfo Com_RxAccessInfo[102].BusAccOfRxAccessInfo Com_RxAccessInfo[102].ByteLengthOfRxAccessInfo Com_RxAccessInfo[102].ConstValueArrayBasedInitValueEndIdxOfRxAccessInfo Com_RxAccessInfo[102].ConstValueArrayBasedInitValueStartIdxOfRxAccessInfo Com_RxAccessInfo[102].DynSignalOfRxAccessInfo Com_RxAccessInfo[102].InitValueIdxOfRxAccessInfo Com_RxAccessInfo[102].InitValueOfRxAccessInfo Com_RxAccessInfo[102].InvValueIdxOfRxAccessInfo Com_RxAccessInfo[102].InvValueOfRxAccessInfo Com_RxAccessInfo[102].IsGroupSignalOfRxAccessInfo Com_RxAccessInfo[102].RxDataTimeoutSubstitutionValueIdxOfRxAccessInfo Com_RxAccessInfo[102].RxDataTimeoutSubstitutionValueOfRxAccessInfo Com_RxAccessInfo[102].RxPduInfoIdxOfRxAccessInfo Com_RxAccessInfo[102].RxSigBufferArrayBasedBufferEndIdxOfRxAccessInfo Com_RxAccessInfo[102].RxSigBufferArrayBasedBufferStartIdxOfRxAccessInfo Com_RxAccessInfo[102].RxSigBufferArrayBasedShdBufferEndIdxOfRxAccessInfo Com_RxAccessInfo[102].RxSigBufferArrayBasedShdBufferStartIdxOfRxAccessInfo Com_RxAccessInfo[102].RxTOutInfoIdxOfRxAccessInfo Com_RxAccessInfo[102].ShdBufferIdxOfRxAccessInfo Com_RxAccessInfo[102].SignalLengthInByteOfRxAccessInfo Com_RxAccessInfo[102].StartByteInPduPositionOfRxAccessInfo Com_RxAccessInfo[102].TmpBufferIdxOfRxAccessInfo Com_RxAccessInfo[102].TmpBufferOfRxAccessInfo Com_RxAccessInfo[102].TmpRxShdBufferArrayBasedTmpBufferEndIdxOfRxAccessInfo Com_RxAccessInfo[102].TmpRxShdBufferArrayBasedTmpBufferStartIdxOfRxAccessInfo Com_RxAccessInfo[103].ApplTypeOfRxAccessInfo Com_RxAccessInfo[103].BitLengthOfRxAccessInfo Com_RxAccessInfo[103].BitPositionOfRxAccessInfo Com_RxAccessInfo[103].BufferIdxOfRxAccessInfo Com_RxAccessInfo[103].BusAccOfRxAccessInfo Com_RxAccessInfo[103].ByteLengthOfRxAccessInfo Com_RxAccessInfo[103].ConstValueArrayBasedInitValueEndIdxOfRxAccessInfo Com_RxAccessInfo[103].ConstValueArrayBasedInitValueStartIdxOfRxAccessInfo Com_RxAccessInfo[103].DynSignalOfRxAccessInfo Com_RxAccessInfo[103].InitValueIdxOfRxAccessInfo Com_RxAccessInfo[103].InitValueOfRxAccessInfo Com_RxAccessInfo[103].InvValueIdxOfRxAccessInfo Com_RxAccessInfo[103].InvValueOfRxAccessInfo Com_RxAccessInfo[103].IsGroupSignalOfRxAccessInfo Com_RxAccessInfo[103].RxDataTimeoutSubstitutionValueIdxOfRxAccessInfo Com_RxAccessInfo[103].RxDataTimeoutSubstitutionValueOfRxAccessInfo Com_RxAccessInfo[103].RxPduInfoIdxOfRxAccessInfo Com_RxAccessInfo[103].RxSigBufferArrayBasedBufferEndIdxOfRxAccessInfo Com_RxAccessInfo[103].RxSigBufferArrayBasedBufferStartIdxOfRxAccessInfo Com_RxAccessInfo[103].RxSigBufferArrayBasedShdBufferEndIdxOfRxAccessInfo Com_RxAccessInfo[103].RxSigBufferArrayBasedShdBufferStartIdxOfRxAccessInfo Com_RxAccessInfo[103].RxTOutInfoIdxOfRxAccessInfo Com_RxAccessInfo[103].ShdBufferIdxOfRxAccessInfo Com_RxAccessInfo[103].SignalLengthInByteOfRxAccessInfo Com_RxAccessInfo[103].StartByteInPduPositionOfRxAccessInfo Com_RxAccessInfo[103].TmpBufferIdxOfRxAccessInfo Com_RxAccessInfo[103].TmpBufferOfRxAccessInfo Com_RxAccessInfo[103].TmpRxShdBufferArrayBasedTmpBufferEndIdxOfRxAccessInfo Com_RxAccessInfo[103].TmpRxShdBufferArrayBasedTmpBufferStartIdxOfRxAccessInfo Com_RxAccessInfo[104].ApplTypeOfRxAccessInfo Com_RxAccessInfo[104].BitLengthOfRxAccessInfo Com_RxAccessInfo[104].BitPositionOfRxAccessInfo Com_RxAccessInfo[104].BufferIdxOfRxAccessInfo Com_RxAccessInfo[104].BusAccOfRxAccessInfo Com_RxAccessInfo[104].ByteLengthOfRxAccessInfo Com_RxAccessInfo[104].ConstValueArrayBasedInitValueEndIdxOfRxAccessInfo Com_RxAccessInfo[104].ConstValueArrayBasedInitValueStartIdxOfRxAccessInfo Com_RxAccessInfo[104].DynSignalOfRxAccessInfo Com_RxAccessInfo[104].InitValueIdxOfRxAccessInfo Com_RxAccessInfo[104].InitValueOfRxAccessInfo Com_RxAccessInfo[104].InvValueIdxOfRxAccessInfo Com_RxAccessInfo[104].InvValueOfRxAccessInfo Com_RxAccessInfo[104].IsGroupSignalOfRxAccessInfo Com_RxAccessInfo[104].RxDataTimeoutSubstitutionValueIdxOfRxAccessInfo Com_RxAccessInfo[104].RxDataTimeoutSubstitutionValueOfRxAccessInfo Com_RxAccessInfo[104].RxPduInfoIdxOfRxAccessInfo Com_RxAccessInfo[104].RxSigBufferArrayBasedBufferEndIdxOfRxAccessInfo Com_RxAccessInfo[104].RxSigBufferArrayBasedBufferStartIdxOfRxAccessInfo Com_RxAccessInfo[104].RxSigBufferArrayBasedShdBufferEndIdxOfRxAccessInfo Com_RxAccessInfo[104].RxSigBufferArrayBasedShdBufferStartIdxOfRxAccessInfo Com_RxAccessInfo[104].RxTOutInfoIdxOfRxAccessInfo Com_RxAccessInfo[104].ShdBufferIdxOfRxAccessInfo Com_RxAccessInfo[104].SignalLengthInByteOfRxAccessInfo Com_RxAccessInfo[104].StartByteInPduPositionOfRxAccessInfo Com_RxAccessInfo[104].TmpBufferIdxOfRxAccessInfo Com_RxAccessInfo[104].TmpBufferOfRxAccessInfo Com_RxAccessInfo[104].TmpRxShdBufferArrayBasedTmpBufferEndIdxOfRxAccessInfo Com_RxAccessInfo[104].TmpRxShdBufferArrayBasedTmpBufferStartIdxOfRxAccessInfo Com_RxAccessInfo[105].ApplTypeOfRxAccessInfo Com_RxAccessInfo[105].BitLengthOfRxAccessInfo Com_RxAccessInfo[105].BitPositionOfRxAccessInfo Com_RxAccessInfo[105].BufferIdxOfRxAccessInfo Com_RxAccessInfo[105].BusAccOfRxAccessInfo Com_RxAccessInfo[105].ByteLengthOfRxAccessInfo Com_RxAccessInfo[105].ConstValueArrayBasedInitValueEndIdxOfRxAccessInfo Com_RxAccessInfo[105].ConstValueArrayBasedInitValueStartIdxOfRxAccessInfo Com_RxAccessInfo[105].DynSignalOfRxAccessInfo Com_RxAccessInfo[105].InitValueIdxOfRxAccessInfo Com_RxAccessInfo[105].InitValueOfRxAccessInfo Com_RxAccessInfo[105].InvValueIdxOfRxAccessInfo Com_RxAccessInfo[105].InvValueOfRxAccessInfo Com_RxAccessInfo[105].IsGroupSignalOfRxAccessInfo Com_RxAccessInfo[105].RxDataTimeoutSubstitutionValueIdxOfRxAccessInfo Com_RxAccessInfo[105].RxDataTimeoutSubstitutionValueOfRxAccessInfo Com_RxAccessInfo[105].RxPduInfoIdxOfRxAccessInfo Com_RxAccessInfo[105].RxSigBufferArrayBasedBufferEndIdxOfRxAccessInfo Com_RxAccessInfo[105].RxSigBufferArrayBasedBufferStartIdxOfRxAccessInfo Com_RxAccessInfo[105].RxSigBufferArrayBasedShdBufferEndIdxOfRxAccessInfo Com_RxAccessInfo[105].RxSigBufferArrayBasedShdBufferStartIdxOfRxAccessInfo Com_RxAccessInfo[105].RxTOutInfoIdxOfRxAccessInfo Com_RxAccessInfo[105].ShdBufferIdxOfRxAccessInfo Com_RxAccessInfo[105].SignalLengthInByteOfRxAccessInfo Com_RxAccessInfo[105].StartByteInPduPositionOfRxAccessInfo Com_RxAccessInfo[105].TmpBufferIdxOfRxAccessInfo Com_RxAccessInfo[105].TmpBufferOfRxAccessInfo Com_RxAccessInfo[105].TmpRxShdBufferArrayBasedTmpBufferEndIdxOfRxAccessInfo Com_RxAccessInfo[105].TmpRxShdBufferArrayBasedTmpBufferStartIdxOfRxAccessInfo Com_RxAccessInfo[106].ApplTypeOfRxAccessInfo Com_RxAccessInfo[106].BitLengthOfRxAccessInfo Com_RxAccessInfo[106].BitPositionOfRxAccessInfo Com_RxAccessInfo[106].BufferIdxOfRxAccessInfo Com_RxAccessInfo[106].BusAccOfRxAccessInfo Com_RxAccessInfo[106].ByteLengthOfRxAccessInfo Com_RxAccessInfo[106].ConstValueArrayBasedInitValueEndIdxOfRxAccessInfo Com_RxAccessInfo[106].ConstValueArrayBasedInitValueStartIdxOfRxAccessInfo Com_RxAccessInfo[106].DynSignalOfRxAccessInfo Com_RxAccessInfo[106].InitValueIdxOfRxAccessInfo Com_RxAccessInfo[106].InitValueOfRxAccessInfo Com_RxAccessInfo[106].InvValueIdxOfRxAccessInfo Com_RxAccessInfo[106].InvValueOfRxAccessInfo Com_RxAccessInfo[106].IsGroupSignalOfRxAccessInfo Com_RxAccessInfo[106].RxDataTimeoutSubstitutionValueIdxOfRxAccessInfo Com_RxAccessInfo[106].RxDataTimeoutSubstitutionValueOfRxAccessInfo Com_RxAccessInfo[106].RxPduInfoIdxOfRxAccessInfo Com_RxAccessInfo[106].RxSigBufferArrayBasedBufferEndIdxOfRxAccessInfo Com_RxAccessInfo[106].RxSigBufferArrayBasedBufferStartIdxOfRxAccessInfo Com_RxAccessInfo[106].RxSigBufferArrayBasedShdBufferEndIdxOfRxAccessInfo Com_RxAccessInfo[106].RxSigBufferArrayBasedShdBufferStartIdxOfRxAccessInfo Com_RxAccessInfo[106].RxTOutInfoIdxOfRxAccessInfo Com_RxAccessInfo[106].ShdBufferIdxOfRxAccessInfo Com_RxAccessInfo[106].SignalLengthInByteOfRxAccessInfo Com_RxAccessInfo[106].StartByteInPduPositionOfRxAccessInfo Com_RxAccessInfo[106].TmpBufferIdxOfRxAccessInfo Com_RxAccessInfo[106].TmpBufferOfRxAccessInfo Com_RxAccessInfo[106].TmpRxShdBufferArrayBasedTmpBufferEndIdxOfRxAccessInfo Com_RxAccessInfo[106].TmpRxShdBufferArrayBasedTmpBufferStartIdxOfRxAccessInfo Com_RxAccessInfo[107].ApplTypeOfRxAccessInfo Com_RxAccessInfo[107].BitLengthOfRxAccessInfo Com_RxAccessInfo[107].BitPositionOfRxAccessInfo Com_RxAccessInfo[107].BufferIdxOfRxAccessInfo Com_RxAccessInfo[107].BusAccOfRxAccessInfo Com_RxAccessInfo[107].ByteLengthOfRxAccessInfo Com_RxAccessInfo[107].ConstValueArrayBasedInitValueEndIdxOfRxAccessInfo Com_RxAccessInfo[107].ConstValueArrayBasedInitValueStartIdxOfRxAccessInfo Com_RxAccessInfo[107].DynSignalOfRxAccessInfo Com_RxAccessInfo[107].InitValueIdxOfRxAccessInfo Com_RxAccessInfo[107].InitValueOfRxAccessInfo Com_RxAccessInfo[107].InvValueIdxOfRxAccessInfo Com_RxAccessInfo[107].InvValueOfRxAccessInfo Com_RxAccessInfo[107].IsGroupSignalOfRxAccessInfo Com_RxAccessInfo[107].RxDataTimeoutSubstitutionValueIdxOfRxAccessInfo Com_RxAccessInfo[107].RxDataTimeoutSubstitutionValueOfRxAccessInfo Com_RxAccessInfo[107].RxPduInfoIdxOfRxAccessInfo Com_RxAccessInfo[107].RxSigBufferArrayBasedBufferEndIdxOfRxAccessInfo Com_RxAccessInfo[107].RxSigBufferArrayBasedBufferStartIdxOfRxAccessInfo Com_RxAccessInfo[107].RxSigBufferArrayBasedShdBufferEndIdxOfRxAccessInfo Com_RxAccessInfo[107].RxSigBufferArrayBasedShdBufferStartIdxOfRxAccessInfo Com_RxAccessInfo[107].RxTOutInfoIdxOfRxAccessInfo Com_RxAccessInfo[107].ShdBufferIdxOfRxAccessInfo Com_RxAccessInfo[107].SignalLengthInByteOfRxAccessInfo Com_RxAccessInfo[107].StartByteInPduPositionOfRxAccessInfo Com_RxAccessInfo[107].TmpBufferIdxOfRxAccessInfo Com_RxAccessInfo[107].TmpBufferOfRxAccessInfo Com_RxAccessInfo[107].TmpRxShdBufferArrayBasedTmpBufferEndIdxOfRxAccessInfo Com_RxAccessInfo[107].TmpRxShdBufferArrayBasedTmpBufferStartIdxOfRxAccessInfo Com_RxAccessInfo[108].ApplTypeOfRxAccessInfo Com_RxAccessInfo[108].BitLengthOfRxAccessInfo Com_RxAccessInfo[108].BitPositionOfRxAccessInfo Com_RxAccessInfo[108].BufferIdxOfRxAccessInfo Com_RxAccessInfo[108].BusAccOfRxAccessInfo Com_RxAccessInfo[108].ByteLengthOfRxAccessInfo Com_RxAccessInfo[108].ConstValueArrayBasedInitValueEndIdxOfRxAccessInfo Com_RxAccessInfo[108].ConstValueArrayBasedInitValueStartIdxOfRxAccessInfo Com_RxAccessInfo[108].DynSignalOfRxAccessInfo Com_RxAccessInfo[108].InitValueIdxOfRxAccessInfo Com_RxAccessInfo[108].InitValueOfRxAccessInfo Com_RxAccessInfo[108].InvValueIdxOfRxAccessInfo Com_RxAccessInfo[108].InvValueOfRxAccessInfo Com_RxAccessInfo[108].IsGroupSignalOfRxAccessInfo Com_RxAccessInfo[108].RxDataTimeoutSubstitutionValueIdxOfRxAccessInfo Com_RxAccessInfo[108].RxDataTimeoutSubstitutionValueOfRxAccessInfo Com_RxAccessInfo[108].RxPduInfoIdxOfRxAccessInfo Com_RxAccessInfo[108].RxSigBufferArrayBasedBufferEndIdxOfRxAccessInfo Com_RxAccessInfo[108].RxSigBufferArrayBasedBufferStartIdxOfRxAccessInfo Com_RxAccessInfo[108].RxSigBufferArrayBasedShdBufferEndIdxOfRxAccessInfo Com_RxAccessInfo[108].RxSigBufferArrayBasedShdBufferStartIdxOfRxAccessInfo Com_RxAccessInfo[108].RxTOutInfoIdxOfRxAccessInfo Com_RxAccessInfo[108].ShdBufferIdxOfRxAccessInfo Com_RxAccessInfo[108].SignalLengthInByteOfRxAccessInfo Com_RxAccessInfo[108].StartByteInPduPositionOfRxAccessInfo Com_RxAccessInfo[108].TmpBufferIdxOfRxAccessInfo Com_RxAccessInfo[108].TmpBufferOfRxAccessInfo Com_RxAccessInfo[108].TmpRxShdBufferArrayBasedTmpBufferEndIdxOfRxAccessInfo Com_RxAccessInfo[108].TmpRxShdBufferArrayBasedTmpBufferStartIdxOfRxAccessInfo Com_RxAccessInfo[109].ApplTypeOfRxAccessInfo Com_RxAccessInfo[109].BitLengthOfRxAccessInfo Com_RxAccessInfo[109].BitPositionOfRxAccessInfo Com_RxAccessInfo[109].BufferIdxOfRxAccessInfo Com_RxAccessInfo[109].BusAccOfRxAccessInfo Com_RxAccessInfo[109].ByteLengthOfRxAccessInfo Com_RxAccessInfo[109].ConstValueArrayBasedInitValueEndIdxOfRxAccessInfo Com_RxAccessInfo[109].ConstValueArrayBasedInitValueStartIdxOfRxAccessInfo Com_RxAccessInfo[109].DynSignalOfRxAccessInfo Com_RxAccessInfo[109].InitValueIdxOfRxAccessInfo Com_RxAccessInfo[109].InitValueOfRxAccessInfo Com_RxAccessInfo[109].InvValueIdxOfRxAccessInfo Com_RxAccessInfo[109].InvValueOfRxAccessInfo Com_RxAccessInfo[109].IsGroupSignalOfRxAccessInfo Com_RxAccessInfo[109].RxDataTimeoutSubstitutionValueIdxOfRxAccessInfo Com_RxAccessInfo[109].RxDataTimeoutSubstitutionValueOfRxAccessInfo Com_RxAccessInfo[109].RxPduInfoIdxOfRxAccessInfo Com_RxAccessInfo[109].RxSigBufferArrayBasedBufferEndIdxOfRxAccessInfo Com_RxAccessInfo[109].RxSigBufferArrayBasedBufferStartIdxOfRxAccessInfo Com_RxAccessInfo[109].RxSigBufferArrayBasedShdBufferEndIdxOfRxAccessInfo Com_RxAccessInfo[109].RxSigBufferArrayBasedShdBufferStartIdxOfRxAccessInfo Com_RxAccessInfo[109].RxTOutInfoIdxOfRxAccessInfo Com_RxAccessInfo[109].ShdBufferIdxOfRxAccessInfo Com_RxAccessInfo[109].SignalLengthInByteOfRxAccessInfo Com_RxAccessInfo[109].StartByteInPduPositionOfRxAccessInfo Com_RxAccessInfo[109].TmpBufferIdxOfRxAccessInfo Com_RxAccessInfo[109].TmpBufferOfRxAccessInfo Com_RxAccessInfo[109].TmpRxShdBufferArrayBasedTmpBufferEndIdxOfRxAccessInfo Com_RxAccessInfo[109].TmpRxShdBufferArrayBasedTmpBufferStartIdxOfRxAccessInfo Com_RxAccessInfo[10].ApplTypeOfRxAccessInfo Com_RxAccessInfo[10].BitLengthOfRxAccessInfo Com_RxAccessInfo[10].BitPositionOfRxAccessInfo Com_RxAccessInfo[10].BufferIdxOfRxAccessInfo Com_RxAccessInfo[10].BusAccOfRxAccessInfo Com_RxAccessInfo[10].ByteLengthOfRxAccessInfo Com_RxAccessInfo[10].ConstValueArrayBasedInitValueEndIdxOfRxAccessInfo Com_RxAccessInfo[10].ConstValueArrayBasedInitValueStartIdxOfRxAccessInfo Com_RxAccessInfo[10].DynSignalOfRxAccessInfo Com_RxAccessInfo[10].InitValueIdxOfRxAccessInfo Com_RxAccessInfo[10].InitValueOfRxAccessInfo Com_RxAccessInfo[10].InvValueIdxOfRxAccessInfo Com_RxAccessInfo[10].InvValueOfRxAccessInfo Com_RxAccessInfo[10].IsGroupSignalOfRxAccessInfo Com_RxAccessInfo[10].RxDataTimeoutSubstitutionValueIdxOfRxAccessInfo Com_RxAccessInfo[10].RxDataTimeoutSubstitutionValueOfRxAccessInfo Com_RxAccessInfo[10].RxPduInfoIdxOfRxAccessInfo Com_RxAccessInfo[10].RxSigBufferArrayBasedBufferEndIdxOfRxAccessInfo Com_RxAccessInfo[10].RxSigBufferArrayBasedBufferStartIdxOfRxAccessInfo Com_RxAccessInfo[10].RxSigBufferArrayBasedShdBufferEndIdxOfRxAccessInfo Com_RxAccessInfo[10].RxSigBufferArrayBasedShdBufferStartIdxOfRxAccessInfo Com_RxAccessInfo[10].RxTOutInfoIdxOfRxAccessInfo Com_RxAccessInfo[10].ShdBufferIdxOfRxAccessInfo Com_RxAccessInfo[10].SignalLengthInByteOfRxAccessInfo Com_RxAccessInfo[10].StartByteInPduPositionOfRxAccessInfo Com_RxAccessInfo[10].TmpBufferIdxOfRxAccessInfo Com_RxAccessInfo[10].TmpBufferOfRxAccessInfo Com_RxAccessInfo[10].TmpRxShdBufferArrayBasedTmpBufferEndIdxOfRxAccessInfo Com_RxAccessInfo[10].TmpRxShdBufferArrayBasedTmpBufferStartIdxOfRxAccessInfo Com_RxAccessInfo[110].ApplTypeOfRxAccessInfo Com_RxAccessInfo[110].BitLengthOfRxAccessInfo Com_RxAccessInfo[110].BitPositionOfRxAccessInfo Com_RxAccessInfo[110].BufferIdxOfRxAccessInfo Com_RxAccessInfo[110].BusAccOfRxAccessInfo Com_RxAccessInfo[110].ByteLengthOfRxAccessInfo Com_RxAccessInfo[110].ConstValueArrayBasedInitValueEndIdxOfRxAccessInfo Com_RxAccessInfo[110].ConstValueArrayBasedInitValueStartIdxOfRxAccessInfo Com_RxAccessInfo[110].DynSignalOfRxAccessInfo Com_RxAccessInfo[110].InitValueIdxOfRxAccessInfo Com_RxAccessInfo[110].InitValueOfRxAccessInfo Com_RxAccessInfo[110].InvValueIdxOfRxAccessInfo Com_RxAccessInfo[110].InvValueOfRxAccessInfo Com_RxAccessInfo[110].IsGroupSignalOfRxAccessInfo Com_RxAccessInfo[110].RxDataTimeoutSubstitutionValueIdxOfRxAccessInfo Com_RxAccessInfo[110].RxDataTimeoutSubstitutionValueOfRxAccessInfo Com_RxAccessInfo[110].RxPduInfoIdxOfRxAccessInfo Com_RxAccessInfo[110].RxSigBufferArrayBasedBufferEndIdxOfRxAccessInfo Com_RxAccessInfo[110].RxSigBufferArrayBasedBufferStartIdxOfRxAccessInfo Com_RxAccessInfo[110].RxSigBufferArrayBasedShdBufferEndIdxOfRxAccessInfo Com_RxAccessInfo[110].RxSigBufferArrayBasedShdBufferStartIdxOfRxAccessInfo Com_RxAccessInfo[110].RxTOutInfoIdxOfRxAccessInfo Com_RxAccessInfo[110].ShdBufferIdxOfRxAccessInfo Com_RxAccessInfo[110].SignalLengthInByteOfRxAccessInfo Com_RxAccessInfo[110].StartByteInPduPositionOfRxAccessInfo Com_RxAccessInfo[110].TmpBufferIdxOfRxAccessInfo Com_RxAccessInfo[110].TmpBufferOfRxAccessInfo Com_RxAccessInfo[110].TmpRxShdBufferArrayBasedTmpBufferEndIdxOfRxAccessInfo Com_RxAccessInfo[110].TmpRxShdBufferArrayBasedTmpBufferStartIdxOfRxAccessInfo Com_RxAccessInfo[111].ApplTypeOfRxAccessInfo Com_RxAccessInfo[111].BitLengthOfRxAccessInfo Com_RxAccessInfo[111].BitPositionOfRxAccessInfo Com_RxAccessInfo[111].BufferIdxOfRxAccessInfo Com_RxAccessInfo[111].BusAccOfRxAccessInfo Com_RxAccessInfo[111].ByteLengthOfRxAccessInfo Com_RxAccessInfo[111].ConstValueArrayBasedInitValueEndIdxOfRxAccessInfo Com_RxAccessInfo[111].ConstValueArrayBasedInitValueStartIdxOfRxAccessInfo Com_RxAccessInfo[111].DynSignalOfRxAccessInfo Com_RxAccessInfo[111].InitValueIdxOfRxAccessInfo Com_RxAccessInfo[111].InitValueOfRxAccessInfo Com_RxAccessInfo[111].InvValueIdxOfRxAccessInfo Com_RxAccessInfo[111].InvValueOfRxAccessInfo Com_RxAccessInfo[111].IsGroupSignalOfRxAccessInfo Com_RxAccessInfo[111].RxDataTimeoutSubstitutionValueIdxOfRxAccessInfo Com_RxAccessInfo[111].RxDataTimeoutSubstitutionValueOfRxAccessInfo Com_RxAccessInfo[111].RxPduInfoIdxOfRxAccessInfo Com_RxAccessInfo[111].RxSigBufferArrayBasedBufferEndIdxOfRxAccessInfo Com_RxAccessInfo[111].RxSigBufferArrayBasedBufferStartIdxOfRxAccessInfo Com_RxAccessInfo[111].RxSigBufferArrayBasedShdBufferEndIdxOfRxAccessInfo Com_RxAccessInfo[111].RxSigBufferArrayBasedShdBufferStartIdxOfRxAccessInfo Com_RxAccessInfo[111].RxTOutInfoIdxOfRxAccessInfo Com_RxAccessInfo[111].ShdBufferIdxOfRxAccessInfo Com_RxAccessInfo[111].SignalLengthInByteOfRxAccessInfo Com_RxAccessInfo[111].StartByteInPduPositionOfRxAccessInfo Com_RxAccessInfo[111].TmpBufferIdxOfRxAccessInfo Com_RxAccessInfo[111].TmpBufferOfRxAccessInfo Com_RxAccessInfo[111].TmpRxShdBufferArrayBasedTmpBufferEndIdxOfRxAccessInfo Com_RxAccessInfo[111].TmpRxShdBufferArrayBasedTmpBufferStartIdxOfRxAccessInfo Com_RxAccessInfo[112].ApplTypeOfRxAccessInfo Com_RxAccessInfo[112].BitLengthOfRxAccessInfo Com_RxAccessInfo[112].BitPositionOfRxAccessInfo Com_RxAccessInfo[112].BufferIdxOfRxAccessInfo Com_RxAccessInfo[112].BusAccOfRxAccessInfo Com_RxAccessInfo[112].ByteLengthOfRxAccessInfo Com_RxAccessInfo[112].ConstValueArrayBasedInitValueEndIdxOfRxAccessInfo Com_RxAccessInfo[112].ConstValueArrayBasedInitValueStartIdxOfRxAccessInfo Com_RxAccessInfo[112].DynSignalOfRxAccessInfo Com_RxAccessInfo[112].InitValueIdxOfRxAccessInfo Com_RxAccessInfo[112].InitValueOfRxAccessInfo Com_RxAccessInfo[112].InvValueIdxOfRxAccessInfo Com_RxAccessInfo[112].InvValueOfRxAccessInfo Com_RxAccessInfo[112].IsGroupSignalOfRxAccessInfo Com_RxAccessInfo[112].RxDataTimeoutSubstitutionValueIdxOfRxAccessInfo Com_RxAccessInfo[112].RxDataTimeoutSubstitutionValueOfRxAccessInfo Com_RxAccessInfo[112].RxPduInfoIdxOfRxAccessInfo Com_RxAccessInfo[112].RxSigBufferArrayBasedBufferEndIdxOfRxAccessInfo Com_RxAccessInfo[112].RxSigBufferArrayBasedBufferStartIdxOfRxAccessInfo Com_RxAccessInfo[112].RxSigBufferArrayBasedShdBufferEndIdxOfRxAccessInfo Com_RxAccessInfo[112].RxSigBufferArrayBasedShdBufferStartIdxOfRxAccessInfo Com_RxAccessInfo[112].RxTOutInfoIdxOfRxAccessInfo Com_RxAccessInfo[112].ShdBufferIdxOfRxAccessInfo Com_RxAccessInfo[112].SignalLengthInByteOfRxAccessInfo Com_RxAccessInfo[112].StartByteInPduPositionOfRxAccessInfo Com_RxAccessInfo[112].TmpBufferIdxOfRxAccessInfo Com_RxAccessInfo[112].TmpBufferOfRxAccessInfo Com_RxAccessInfo[112].TmpRxShdBufferArrayBasedTmpBufferEndIdxOfRxAccessInfo Com_RxAccessInfo[112].TmpRxShdBufferArrayBasedTmpBufferStartIdxOfRxAccessInfo Com_RxAccessInfo[113].ApplTypeOfRxAccessInfo Com_RxAccessInfo[113].BitLengthOfRxAccessInfo Com_RxAccessInfo[113].BitPositionOfRxAccessInfo Com_RxAccessInfo[113].BufferIdxOfRxAccessInfo Com_RxAccessInfo[113].BusAccOfRxAccessInfo Com_RxAccessInfo[113].ByteLengthOfRxAccessInfo Com_RxAccessInfo[113].ConstValueArrayBasedInitValueEndIdxOfRxAccessInfo Com_RxAccessInfo[113].ConstValueArrayBasedInitValueStartIdxOfRxAccessInfo Com_RxAccessInfo[113].DynSignalOfRxAccessInfo Com_RxAccessInfo[113].InitValueIdxOfRxAccessInfo Com_RxAccessInfo[113].InitValueOfRxAccessInfo Com_RxAccessInfo[113].InvValueIdxOfRxAccessInfo Com_RxAccessInfo[113].InvValueOfRxAccessInfo Com_RxAccessInfo[113].IsGroupSignalOfRxAccessInfo Com_RxAccessInfo[113].RxDataTimeoutSubstitutionValueIdxOfRxAccessInfo Com_RxAccessInfo[113].RxDataTimeoutSubstitutionValueOfRxAccessInfo Com_RxAccessInfo[113].RxPduInfoIdxOfRxAccessInfo Com_RxAccessInfo[113].RxSigBufferArrayBasedBufferEndIdxOfRxAccessInfo Com_RxAccessInfo[113].RxSigBufferArrayBasedBufferStartIdxOfRxAccessInfo Com_RxAccessInfo[113].RxSigBufferArrayBasedShdBufferEndIdxOfRxAccessInfo Com_RxAccessInfo[113].RxSigBufferArrayBasedShdBufferStartIdxOfRxAccessInfo Com_RxAccessInfo[113].RxTOutInfoIdxOfRxAccessInfo Com_RxAccessInfo[113].ShdBufferIdxOfRxAccessInfo Com_RxAccessInfo[113].SignalLengthInByteOfRxAccessInfo Com_RxAccessInfo[113].StartByteInPduPositionOfRxAccessInfo Com_RxAccessInfo[113].TmpBufferIdxOfRxAccessInfo Com_RxAccessInfo[113].TmpBufferOfRxAccessInfo Com_RxAccessInfo[113].TmpRxShdBufferArrayBasedTmpBufferEndIdxOfRxAccessInfo Com_RxAccessInfo[113].TmpRxShdBufferArrayBasedTmpBufferStartIdxOfRxAccessInfo Com_RxAccessInfo[114].ApplTypeOfRxAccessInfo Com_RxAccessInfo[114].BitLengthOfRxAccessInfo Com_RxAccessInfo[114].BitPositionOfRxAccessInfo Com_RxAccessInfo[114].BufferIdxOfRxAccessInfo Com_RxAccessInfo[114].BusAccOfRxAccessInfo Com_RxAccessInfo[114].ByteLengthOfRxAccessInfo Com_RxAccessInfo[114].ConstValueArrayBasedInitValueEndIdxOfRxAccessInfo Com_RxAccessInfo[114].ConstValueArrayBasedInitValueStartIdxOfRxAccessInfo Com_RxAccessInfo[114].DynSignalOfRxAccessInfo Com_RxAccessInfo[114].InitValueIdxOfRxAccessInfo Com_RxAccessInfo[114].InitValueOfRxAccessInfo Com_RxAccessInfo[114].InvValueIdxOfRxAccessInfo Com_RxAccessInfo[114].InvValueOfRxAccessInfo Com_RxAccessInfo[114].IsGroupSignalOfRxAccessInfo Com_RxAccessInfo[114].RxDataTimeoutSubstitutionValueIdxOfRxAccessInfo Com_RxAccessInfo[114].RxDataTimeoutSubstitutionValueOfRxAccessInfo Com_RxAccessInfo[114].RxPduInfoIdxOfRxAccessInfo Com_RxAccessInfo[114].RxSigBufferArrayBasedBufferEndIdxOfRxAccessInfo Com_RxAccessInfo[114].RxSigBufferArrayBasedBufferStartIdxOfRxAccessInfo Com_RxAccessInfo[114].RxSigBufferArrayBasedShdBufferEndIdxOfRxAccessInfo Com_RxAccessInfo[114].RxSigBufferArrayBasedShdBufferStartIdxOfRxAccessInfo Com_RxAccessInfo[114].RxTOutInfoIdxOfRxAccessInfo Com_RxAccessInfo[114].ShdBufferIdxOfRxAccessInfo Com_RxAccessInfo[114].SignalLengthInByteOfRxAccessInfo Com_RxAccessInfo[114].StartByteInPduPositionOfRxAccessInfo Com_RxAccessInfo[114].TmpBufferIdxOfRxAccessInfo Com_RxAccessInfo[114].TmpBufferOfRxAccessInfo Com_RxAccessInfo[114].TmpRxShdBufferArrayBasedTmpBufferEndIdxOfRxAccessInfo Com_RxAccessInfo[114].TmpRxShdBufferArrayBasedTmpBufferStartIdxOfRxAccessInfo Com_RxAccessInfo[115].ApplTypeOfRxAccessInfo Com_RxAccessInfo[115].BitLengthOfRxAccessInfo Com_RxAccessInfo[115].BitPositionOfRxAccessInfo Com_RxAccessInfo[115].BufferIdxOfRxAccessInfo Com_RxAccessInfo[115].BusAccOfRxAccessInfo Com_RxAccessInfo[115].ByteLengthOfRxAccessInfo Com_RxAccessInfo[115].ConstValueArrayBasedInitValueEndIdxOfRxAccessInfo Com_RxAccessInfo[115].ConstValueArrayBasedInitValueStartIdxOfRxAccessInfo Com_RxAccessInfo[115].DynSignalOfRxAccessInfo Com_RxAccessInfo[115].InitValueIdxOfRxAccessInfo Com_RxAccessInfo[115].InitValueOfRxAccessInfo Com_RxAccessInfo[115].InvValueIdxOfRxAccessInfo Com_RxAccessInfo[115].InvValueOfRxAccessInfo Com_RxAccessInfo[115].IsGroupSignalOfRxAccessInfo Com_RxAccessInfo[115].RxDataTimeoutSubstitutionValueIdxOfRxAccessInfo Com_RxAccessInfo[115].RxDataTimeoutSubstitutionValueOfRxAccessInfo Com_RxAccessInfo[115].RxPduInfoIdxOfRxAccessInfo Com_RxAccessInfo[115].RxSigBufferArrayBasedBufferEndIdxOfRxAccessInfo Com_RxAccessInfo[115].RxSigBufferArrayBasedBufferStartIdxOfRxAccessInfo Com_RxAccessInfo[115].RxSigBufferArrayBasedShdBufferEndIdxOfRxAccessInfo Com_RxAccessInfo[115].RxSigBufferArrayBasedShdBufferStartIdxOfRxAccessInfo Com_RxAccessInfo[115].RxTOutInfoIdxOfRxAccessInfo Com_RxAccessInfo[115].ShdBufferIdxOfRxAccessInfo Com_RxAccessInfo[115].SignalLengthInByteOfRxAccessInfo Com_RxAccessInfo[115].StartByteInPduPositionOfRxAccessInfo Com_RxAccessInfo[115].TmpBufferIdxOfRxAccessInfo Com_RxAccessInfo[115].TmpBufferOfRxAccessInfo Com_RxAccessInfo[115].TmpRxShdBufferArrayBasedTmpBufferEndIdxOfRxAccessInfo Com_RxAccessInfo[115].TmpRxShdBufferArrayBasedTmpBufferStartIdxOfRxAccessInfo Com_RxAccessInfo[116].ApplTypeOfRxAccessInfo Com_RxAccessInfo[116].BitLengthOfRxAccessInfo Com_RxAccessInfo[116].BitPositionOfRxAccessInfo Com_RxAccessInfo[116].BufferIdxOfRxAccessInfo Com_RxAccessInfo[116].BusAccOfRxAccessInfo Com_RxAccessInfo[116].ByteLengthOfRxAccessInfo Com_RxAccessInfo[116].ConstValueArrayBasedInitValueEndIdxOfRxAccessInfo Com_RxAccessInfo[116].ConstValueArrayBasedInitValueStartIdxOfRxAccessInfo Com_RxAccessInfo[116].DynSignalOfRxAccessInfo Com_RxAccessInfo[116].InitValueIdxOfRxAccessInfo Com_RxAccessInfo[116].InitValueOfRxAccessInfo Com_RxAccessInfo[116].InvValueIdxOfRxAccessInfo Com_RxAccessInfo[116].InvValueOfRxAccessInfo Com_RxAccessInfo[116].IsGroupSignalOfRxAccessInfo Com_RxAccessInfo[116].RxDataTimeoutSubstitutionValueIdxOfRxAccessInfo Com_RxAccessInfo[116].RxDataTimeoutSubstitutionValueOfRxAccessInfo Com_RxAccessInfo[116].RxPduInfoIdxOfRxAccessInfo Com_RxAccessInfo[116].RxSigBufferArrayBasedBufferEndIdxOfRxAccessInfo Com_RxAccessInfo[116].RxSigBufferArrayBasedBufferStartIdxOfRxAccessInfo Com_RxAccessInfo[116].RxSigBufferArrayBasedShdBufferEndIdxOfRxAccessInfo Com_RxAccessInfo[116].RxSigBufferArrayBasedShdBufferStartIdxOfRxAccessInfo Com_RxAccessInfo[116].RxTOutInfoIdxOfRxAccessInfo Com_RxAccessInfo[116].ShdBufferIdxOfRxAccessInfo Com_RxAccessInfo[116].SignalLengthInByteOfRxAccessInfo Com_RxAccessInfo[116].StartByteInPduPositionOfRxAccessInfo Com_RxAccessInfo[116].TmpBufferIdxOfRxAccessInfo Com_RxAccessInfo[116].TmpBufferOfRxAccessInfo Com_RxAccessInfo[116].TmpRxShdBufferArrayBasedTmpBufferEndIdxOfRxAccessInfo Com_RxAccessInfo[116].TmpRxShdBufferArrayBasedTmpBufferStartIdxOfRxAccessInfo Com_RxAccessInfo[117].ApplTypeOfRxAccessInfo Com_RxAccessInfo[117].BitLengthOfRxAccessInfo Com_RxAccessInfo[117].BitPositionOfRxAccessInfo Com_RxAccessInfo[117].BufferIdxOfRxAccessInfo Com_RxAccessInfo[117].BusAccOfRxAccessInfo Com_RxAccessInfo[117].ByteLengthOfRxAccessInfo Com_RxAccessInfo[117].ConstValueArrayBasedInitValueEndIdxOfRxAccessInfo Com_RxAccessInfo[117].ConstValueArrayBasedInitValueStartIdxOfRxAccessInfo Com_RxAccessInfo[117].DynSignalOfRxAccessInfo Com_RxAccessInfo[117].InitValueIdxOfRxAccessInfo Com_RxAccessInfo[117].InitValueOfRxAccessInfo Com_RxAccessInfo[117].InvValueIdxOfRxAccessInfo Com_RxAccessInfo[117].InvValueOfRxAccessInfo Com_RxAccessInfo[117].IsGroupSignalOfRxAccessInfo Com_RxAccessInfo[117].RxDataTimeoutSubstitutionValueIdxOfRxAccessInfo Com_RxAccessInfo[117].RxDataTimeoutSubstitutionValueOfRxAccessInfo Com_RxAccessInfo[117].RxPduInfoIdxOfRxAccessInfo Com_RxAccessInfo[117].RxSigBufferArrayBasedBufferEndIdxOfRxAccessInfo Com_RxAccessInfo[117].RxSigBufferArrayBasedBufferStartIdxOfRxAccessInfo Com_RxAccessInfo[117].RxSigBufferArrayBasedShdBufferEndIdxOfRxAccessInfo Com_RxAccessInfo[117].RxSigBufferArrayBasedShdBufferStartIdxOfRxAccessInfo Com_RxAccessInfo[117].RxTOutInfoIdxOfRxAccessInfo Com_RxAccessInfo[117].ShdBufferIdxOfRxAccessInfo Com_RxAccessInfo[117].SignalLengthInByteOfRxAccessInfo Com_RxAccessInfo[117].StartByteInPduPositionOfRxAccessInfo Com_RxAccessInfo[117].TmpBufferIdxOfRxAccessInfo Com_RxAccessInfo[117].TmpBufferOfRxAccessInfo Com_RxAccessInfo[117].TmpRxShdBufferArrayBasedTmpBufferEndIdxOfRxAccessInfo Com_RxAccessInfo[117].TmpRxShdBufferArrayBasedTmpBufferStartIdxOfRxAccessInfo Com_RxAccessInfo[118].ApplTypeOfRxAccessInfo Com_RxAccessInfo[118].BitLengthOfRxAccessInfo Com_RxAccessInfo[118].BitPositionOfRxAccessInfo Com_RxAccessInfo[118].BufferIdxOfRxAccessInfo Com_RxAccessInfo[118].BusAccOfRxAccessInfo Com_RxAccessInfo[118].ByteLengthOfRxAccessInfo Com_RxAccessInfo[118].ConstValueArrayBasedInitValueEndIdxOfRxAccessInfo Com_RxAccessInfo[118].ConstValueArrayBasedInitValueStartIdxOfRxAccessInfo Com_RxAccessInfo[118].DynSignalOfRxAccessInfo Com_RxAccessInfo[118].InitValueIdxOfRxAccessInfo Com_RxAccessInfo[118].InitValueOfRxAccessInfo Com_RxAccessInfo[118].InvValueIdxOfRxAccessInfo Com_RxAccessInfo[118].InvValueOfRxAccessInfo Com_RxAccessInfo[118].IsGroupSignalOfRxAccessInfo Com_RxAccessInfo[118].RxDataTimeoutSubstitutionValueIdxOfRxAccessInfo Com_RxAccessInfo[118].RxDataTimeoutSubstitutionValueOfRxAccessInfo Com_RxAccessInfo[118].RxPduInfoIdxOfRxAccessInfo Com_RxAccessInfo[118].RxSigBufferArrayBasedBufferEndIdxOfRxAccessInfo Com_RxAccessInfo[118].RxSigBufferArrayBasedBufferStartIdxOfRxAccessInfo Com_RxAccessInfo[118].RxSigBufferArrayBasedShdBufferEndIdxOfRxAccessInfo Com_RxAccessInfo[118].RxSigBufferArrayBasedShdBufferStartIdxOfRxAccessInfo Com_RxAccessInfo[118].RxTOutInfoIdxOfRxAccessInfo Com_RxAccessInfo[118].ShdBufferIdxOfRxAccessInfo Com_RxAccessInfo[118].SignalLengthInByteOfRxAccessInfo Com_RxAccessInfo[118].StartByteInPduPositionOfRxAccessInfo Com_RxAccessInfo[118].TmpBufferIdxOfRxAccessInfo Com_RxAccessInfo[118].TmpBufferOfRxAccessInfo Com_RxAccessInfo[118].TmpRxShdBufferArrayBasedTmpBufferEndIdxOfRxAccessInfo Com_RxAccessInfo[118].TmpRxShdBufferArrayBasedTmpBufferStartIdxOfRxAccessInfo Com_RxAccessInfo[119].ApplTypeOfRxAccessInfo Com_RxAccessInfo[119].BitLengthOfRxAccessInfo Com_RxAccessInfo[119].BitPositionOfRxAccessInfo Com_RxAccessInfo[119].BufferIdxOfRxAccessInfo Com_RxAccessInfo[119].BusAccOfRxAccessInfo Com_RxAccessInfo[119].ByteLengthOfRxAccessInfo Com_RxAccessInfo[119].ConstValueArrayBasedInitValueEndIdxOfRxAccessInfo Com_RxAccessInfo[119].ConstValueArrayBasedInitValueStartIdxOfRxAccessInfo Com_RxAccessInfo[119].DynSignalOfRxAccessInfo Com_RxAccessInfo[119].InitValueIdxOfRxAccessInfo Com_RxAccessInfo[119].InitValueOfRxAccessInfo Com_RxAccessInfo[119].InvValueIdxOfRxAccessInfo Com_RxAccessInfo[119].InvValueOfRxAccessInfo Com_RxAccessInfo[119].IsGroupSignalOfRxAccessInfo Com_RxAccessInfo[119].RxDataTimeoutSubstitutionValueIdxOfRxAccessInfo Com_RxAccessInfo[119].RxDataTimeoutSubstitutionValueOfRxAccessInfo Com_RxAccessInfo[119].RxPduInfoIdxOfRxAccessInfo Com_RxAccessInfo[119].RxSigBufferArrayBasedBufferEndIdxOfRxAccessInfo Com_RxAccessInfo[119].RxSigBufferArrayBasedBufferStartIdxOfRxAccessInfo Com_RxAccessInfo[119].RxSigBufferArrayBasedShdBufferEndIdxOfRxAccessInfo Com_RxAccessInfo[119].RxSigBufferArrayBasedShdBufferStartIdxOfRxAccessInfo Com_RxAccessInfo[119].RxTOutInfoIdxOfRxAccessInfo Com_RxAccessInfo[119].ShdBufferIdxOfRxAccessInfo Com_RxAccessInfo[119].SignalLengthInByteOfRxAccessInfo Com_RxAccessInfo[119].StartByteInPduPositionOfRxAccessInfo Com_RxAccessInfo[119].TmpBufferIdxOfRxAccessInfo Com_RxAccessInfo[119].TmpBufferOfRxAccessInfo Com_RxAccessInfo[119].TmpRxShdBufferArrayBasedTmpBufferEndIdxOfRxAccessInfo Com_RxAccessInfo[119].TmpRxShdBufferArrayBasedTmpBufferStartIdxOfRxAccessInfo Com_RxAccessInfo[11].ApplTypeOfRxAccessInfo Com_RxAccessInfo[11].BitLengthOfRxAccessInfo Com_RxAccessInfo[11].BitPositionOfRxAccessInfo Com_RxAccessInfo[11].BufferIdxOfRxAccessInfo Com_RxAccessInfo[11].BusAccOfRxAccessInfo Com_RxAccessInfo[11].ByteLengthOfRxAccessInfo Com_RxAccessInfo[11].ConstValueArrayBasedInitValueEndIdxOfRxAccessInfo Com_RxAccessInfo[11].ConstValueArrayBasedInitValueStartIdxOfRxAccessInfo Com_RxAccessInfo[11].DynSignalOfRxAccessInfo Com_RxAccessInfo[11].InitValueIdxOfRxAccessInfo Com_RxAccessInfo[11].InitValueOfRxAccessInfo Com_RxAccessInfo[11].InvValueIdxOfRxAccessInfo Com_RxAccessInfo[11].InvValueOfRxAccessInfo Com_RxAccessInfo[11].IsGroupSignalOfRxAccessInfo Com_RxAccessInfo[11].RxDataTimeoutSubstitutionValueIdxOfRxAccessInfo Com_RxAccessInfo[11].RxDataTimeoutSubstitutionValueOfRxAccessInfo Com_RxAccessInfo[11].RxPduInfoIdxOfRxAccessInfo Com_RxAccessInfo[11].RxSigBufferArrayBasedBufferEndIdxOfRxAccessInfo Com_RxAccessInfo[11].RxSigBufferArrayBasedBufferStartIdxOfRxAccessInfo Com_RxAccessInfo[11].RxSigBufferArrayBasedShdBufferEndIdxOfRxAccessInfo Com_RxAccessInfo[11].RxSigBufferArrayBasedShdBufferStartIdxOfRxAccessInfo Com_RxAccessInfo[11].RxTOutInfoIdxOfRxAccessInfo Com_RxAccessInfo[11].ShdBufferIdxOfRxAccessInfo Com_RxAccessInfo[11].SignalLengthInByteOfRxAccessInfo Com_RxAccessInfo[11].StartByteInPduPositionOfRxAccessInfo Com_RxAccessInfo[11].TmpBufferIdxOfRxAccessInfo Com_RxAccessInfo[11].TmpBufferOfRxAccessInfo Com_RxAccessInfo[11].TmpRxShdBufferArrayBasedTmpBufferEndIdxOfRxAccessInfo Com_RxAccessInfo[11].TmpRxShdBufferArrayBasedTmpBufferStartIdxOfRxAccessInfo Com_RxAccessInfo[120].ApplTypeOfRxAccessInfo Com_RxAccessInfo[120].BitLengthOfRxAccessInfo Com_RxAccessInfo[120].BitPositionOfRxAccessInfo Com_RxAccessInfo[120].BufferIdxOfRxAccessInfo Com_RxAccessInfo[120].BusAccOfRxAccessInfo Com_RxAccessInfo[120].ByteLengthOfRxAccessInfo /end REF_MEASUREMENT
/end GROUP
/end MODULE
/end PROJECT
