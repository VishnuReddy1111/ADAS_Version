ASAP2_VERSION 1 71
/begin PROJECT MICROSAR ""
/begin MODULE CPP ""
/begin MOD_COMMON "" BYTE_ORDER MSB_LAST ALIGNMENT_BYTE 1 ALIGNMENT_WORD 2 ALIGNMENT_LONG 4 ALIGNMENT_FLOAT16_IEEE 2 ALIGNMENT_FLOAT32_IEEE 4 ALIGNMENT_FLOAT64_IEEE 8 ALIGNMENT_INT64 8 /end MOD_COMMON
/begin MEASUREMENT Com_RxDefPduBuffer_UI2Sens01_CVN_XIX_BMC_CAN01_fe6b52fc_Rx "The element: UI2Sens01_CVN_XIX_BMC_CAN01_fe6b52fc_Rx of Com_RxDefPduBuffer" UBYTE NO_COMPU_METHOD 0 0 0 255 ECU_ADDRESS 0x0 MATRIX_DIM 8 SYMBOL_LINK "Com_RxDefPduBuffer.raw[657]" 0 /end MEASUREMENT
/begin MEASUREMENT Com_RxDefPduBuffer_UI2Sens02_CALID_01_XIX_BMC_CAN01_abd78ba8_Rx "The element: UI2Sens02_CALID_01_XIX_BMC_CAN01_abd78ba8_Rx of Com_RxDefPduBuffer" UBYTE NO_COMPU_METHOD 0 0 0 255 ECU_ADDRESS 0x0 MATRIX_DIM 8 SYMBOL_LINK "Com_RxDefPduBuffer.raw[665]" 0 /end MEASUREMENT
/begin MEASUREMENT Com_RxDefPduBuffer_UI2Sens02_CALID_02_XIX_BMC_CAN01_baaae1d1_Rx "The element: UI2Sens02_CALID_02_XIX_BMC_CAN01_baaae1d1_Rx of Com_RxDefPduBuffer" UBYTE NO_COMPU_METHOD 0 0 0 255 ECU_ADDRESS 0x0 MATRIX_DIM 8 SYMBOL_LINK "Com_RxDefPduBuffer.raw[673]" 0 /end MEASUREMENT
/begin MEASUREMENT Com_RxDefPduBuffer_UI2Sens02_CVN_XIX_BMC_CAN01_5d3dd455_Rx "The element: UI2Sens02_CVN_XIX_BMC_CAN01_5d3dd455_Rx of Com_RxDefPduBuffer" UBYTE NO_COMPU_METHOD 0 0 0 255 ECU_ADDRESS 0x0 MATRIX_DIM 8 SYMBOL_LINK "Com_RxDefPduBuffer.raw[681]" 0 /end MEASUREMENT
/begin MEASUREMENT Com_RxDefPduBuffer_UI2_01_XIX_BMC_CAN01_E2E_f7b0279f_Rx "The element: UI2_01_XIX_BMC_CAN01_E2E_f7b0279f_Rx of Com_RxDefPduBuffer" UBYTE NO_COMPU_METHOD 0 0 0 255 ECU_ADDRESS 0x0 MATRIX_DIM 8 SYMBOL_LINK "Com_RxDefPduBuffer.raw[689]" 0 /end MEASUREMENT
/begin MEASUREMENT Com_RxDefPduBuffer_UI2_02_XIX_BMC_CAN01_E2E_54e6a136_Rx "The element: UI2_02_XIX_BMC_CAN01_E2E_54e6a136_Rx of Com_RxDefPduBuffer" UBYTE NO_COMPU_METHOD 0 0 0 255 ECU_ADDRESS 0x0 MATRIX_DIM 8 SYMBOL_LINK "Com_RxDefPduBuffer.raw[697]" 0 /end MEASUREMENT
/begin MEASUREMENT Com_RxDefPduBuffer_UI2_03_XIX_BMC_CAN01_E2E_8304216e_Rx "The element: UI2_03_XIX_BMC_CAN01_E2E_8304216e_Rx of Com_RxDefPduBuffer" UBYTE NO_COMPU_METHOD 0 0 0 255 ECU_ADDRESS 0x0 MATRIX_DIM 8 SYMBOL_LINK "Com_RxDefPduBuffer.raw[705]" 0 /end MEASUREMENT
/begin MEASUREMENT Com_RxDefPduBuffer_UI2_04_XIX_BMC_CAN01_33f018a3_Rx "The element: UI2_04_XIX_BMC_CAN01_33f018a3_Rx of Com_RxDefPduBuffer" UBYTE NO_COMPU_METHOD 0 0 0 255 ECU_ADDRESS 0x0 MATRIX_DIM 8 SYMBOL_LINK "Com_RxDefPduBuffer.raw[713]" 0 /end MEASUREMENT
/begin MEASUREMENT Com_RxDefPduBuffer_UI2_Komponentenfehler_01_XIX_BMC_CAN01_6c666489_Rx "The element: UI2_Komponentenfehler_01_XIX_BMC_CAN01_6c666489_Rx of Com_RxDefPduBuffer" UBYTE NO_COMPU_METHOD 0 0 0 255 ECU_ADDRESS 0x0 MATRIX_DIM 8 SYMBOL_LINK "Com_RxDefPduBuffer.raw[721]" 0 /end MEASUREMENT
/begin MEASUREMENT Com_RxDefPduBuffer_UI2_Komponentenfehler_02_XIX_BMC_CAN01_7d1b0ef0_Rx "The element: UI2_Komponentenfehler_02_XIX_BMC_CAN01_7d1b0ef0_Rx of Com_RxDefPduBuffer" UBYTE NO_COMPU_METHOD 0 0 0 255 ECU_ADDRESS 0x0 MATRIX_DIM 8 SYMBOL_LINK "Com_RxDefPduBuffer.raw[729]" 0 /end MEASUREMENT
/begin MEASUREMENT Com_RxDefPduBuffer_VDSO_05_XIX_HCP5_CANFD01_48366f26_Rx "The element: VDSO_05_XIX_HCP5_CANFD01_48366f26_Rx of Com_RxDefPduBuffer" UBYTE NO_COMPU_METHOD 0 0 0 255 ECU_ADDRESS 0x0 MATRIX_DIM 8 SYMBOL_LINK "Com_RxDefPduBuffer.raw[737]" 0 /end MEASUREMENT
/begin MEASUREMENT Com_RxDefPduBuffer_WFS_02_XIX_HCP5_CANFD01_61136cb6_Rx "The element: WFS_02_XIX_HCP5_CANFD01_61136cb6_Rx of Com_RxDefPduBuffer" UBYTE NO_COMPU_METHOD 0 0 0 255 ECU_ADDRESS 0x0 MATRIX_DIM 28 SYMBOL_LINK "Com_RxDefPduBuffer.raw[745]" 0 /end MEASUREMENT
/begin MEASUREMENT Com_RxDefPduBuffer_ZeitMaster_01_XIX_HCP5_CANFD01_dad73d21_Rx "The element: ZeitMaster_01_XIX_HCP5_CANFD01_dad73d21_Rx of Com_RxDefPduBuffer" UBYTE NO_COMPU_METHOD 0 0 0 255 ECU_ADDRESS 0x0 MATRIX_DIM 8 SYMBOL_LINK "Com_RxDefPduBuffer.raw[773]" 0 /end MEASUREMENT
/begin MEASUREMENT Com_RxDefPduBuffer_Zeitmaster_05_XIX_HCP5_CANFD01_5eaa5a96_Rx "The element: Zeitmaster_05_XIX_HCP5_CANFD01_5eaa5a96_Rx of Com_RxDefPduBuffer" UBYTE NO_COMPU_METHOD 0 0 0 255 ECU_ADDRESS 0x0 MATRIX_DIM 8 SYMBOL_LINK "Com_RxDefPduBuffer.raw[781]" 0 /end MEASUREMENT
/begin MEASUREMENT Com_RxDeferredFctPtrCache "Cache for deferred Rx (invalid) notification." ULONG NO_COMPU_METHOD 0 0 0 4294967295 ECU_ADDRESS 0x0 SYMBOL_LINK "Com_RxDeferredFctPtrCache.raw" 0 /end MEASUREMENT
/begin MEASUREMENT Com_RxDeferredFctPtrCache_ComMainFunctionRx "The element: ComMainFunctionRx of Com_RxDeferredFctPtrCache" ULONG NO_COMPU_METHOD 0 0 0 4294967295 ECU_ADDRESS 0x0 SYMBOL_LINK "Com_RxDeferredFctPtrCache.raw[0]" 0 /end MEASUREMENT
/begin MEASUREMENT Com_RxIPduGroupISRLockCounter "" UWORD NO_COMPU_METHOD 0 0 0 65535 ECU_ADDRESS 0x0 SYMBOL_LINK "Com_RxIPduGroupISRLockCounter.raw" 0 /end MEASUREMENT
/begin MEASUREMENT Com_RxIPduGroupISRLockCounter_noPartition "The element: noPartition of Com_RxIPduGroupISRLockCounter" UWORD NO_COMPU_METHOD 0 0 0 65535 ECU_ADDRESS 0x0 SYMBOL_LINK "Com_RxIPduGroupISRLockCounter.raw[0]" 0 /end MEASUREMENT
/begin MEASUREMENT Com_RxMainFunctionProcessingISRLockCounter "" UWORD NO_COMPU_METHOD 0 0 0 65535 ECU_ADDRESS 0x0 SYMBOL_LINK "Com_RxMainFunctionProcessingISRLockCounter.raw" 0 /end MEASUREMENT
/begin MEASUREMENT Com_RxMainFunctionProcessingISRLockCounter_ComMainFunctionRx "The element: ComMainFunctionRx of Com_RxMainFunctionProcessingISRLockCounter" UWORD NO_COMPU_METHOD 0 0 0 65535 ECU_ADDRESS 0x0 SYMBOL_LINK "Com_RxMainFunctionProcessingISRLockCounter.raw[0]" 0 /end MEASUREMENT
/begin MEASUREMENT Com_RxPduDmState "Rx I-PDU based deadline monitoring state (started/stopped) of the corresponding I-PDU-Group." UBYTE Com_RxPduDmStateType 0 0 0 255 ECU_ADDRESS 0x0 /end MEASUREMENT
/begin MEASUREMENT Com_RxPduGrpActive "Rx I-PDU based state (started/stopped) of the corresponding I-PDU-Group." UBYTE Com_RxPduGrpActiveType 0 0 0 1 ECU_ADDRESS 0x0 MATRIX_DIM 66 /end MEASUREMENT
/begin MEASUREMENT Com_RxPduInfoInd "the indexes of the 1:1 sorted relation pointing to Com_RxPduInfo" UBYTE NO_COMPU_METHOD 0 0 0 255 ECU_ADDRESS 0x0 MATRIX_DIM 98 /end MEASUREMENT
/begin MEASUREMENT Com_RxPduInfo[0].HandleRxPduDeferredIdxOfRxPduInfo "" UBYTE Com_HandleRxPduDeferredIdxOfRxPduInfoType 0 0 0 255 ECU_ADDRESS 0x0 /end MEASUREMENT
/begin MEASUREMENT Com_RxPduInfo[0].IPduGroupInfoOfRxPduInfoIndEndIdxOfRxPduInfo "" UBYTE Com_IPduGroupInfoOfRxPduInfoIndEndIdxOfRxPduInfoType 0 0 0 255 ECU_ADDRESS 0x0 /end MEASUREMENT
/begin MEASUREMENT Com_RxPduInfo[0].IPduGroupInfoOfRxPduInfoIndStartIdxOfRxPduInfo "" UBYTE Com_IPduGroupInfoOfRxPduInfoIndStartIdxOfRxPduInfoType 0 0 0 255 ECU_ADDRESS 0x0 /end MEASUREMENT
/begin MEASUREMENT Com_RxPduInfo[0].MainFunctionRxStructIdxOfRxPduInfo "" UBYTE Com_MainFunctionRxStructIdxOfRxPduInfoType 0 0 0 255 ECU_ADDRESS 0x0 /end MEASUREMENT
/begin MEASUREMENT Com_RxPduInfo[0].RxAccessInfoIndEndIdxOfRxPduInfo "" UWORD Com_RxAccessInfoIndEndIdxOfRxPduInfoType 0 0 0 65535 ECU_ADDRESS 0x0 /end MEASUREMENT
/begin MEASUREMENT Com_RxPduInfo[0].RxAccessInfoIndStartIdxOfRxPduInfo "" UWORD Com_RxAccessInfoIndStartIdxOfRxPduInfoType 0 0 0 65535 ECU_ADDRESS 0x0 /end MEASUREMENT
/begin MEASUREMENT Com_RxPduInfo[0].RxDefPduBufferEndIdxOfRxPduInfo "" UWORD Com_RxDefPduBufferEndIdxOfRxPduInfoType 0 0 0 65535 ECU_ADDRESS 0x0 /end MEASUREMENT
/begin MEASUREMENT Com_RxPduInfo[0].RxDefPduBufferStartIdxOfRxPduInfo "" UWORD Com_RxDefPduBufferStartIdxOfRxPduInfoType 0 0 0 65535 ECU_ADDRESS 0x0 /end MEASUREMENT
/begin MEASUREMENT Com_RxPduInfo[0].RxPduCalloutFuncPtrIdxOfRxPduInfo "" UBYTE Com_RxPduCalloutFuncPtrIdxOfRxPduInfoType 0 0 0 255 ECU_ADDRESS 0x0 /end MEASUREMENT
/begin MEASUREMENT Com_RxPduInfo[0].RxSigGrpInfoIndEndIdxOfRxPduInfo "" UBYTE Com_RxSigGrpInfoIndEndIdxOfRxPduInfoType 0 0 0 255 ECU_ADDRESS 0x0 /end MEASUREMENT
/begin MEASUREMENT Com_RxPduInfo[0].RxSigGrpInfoIndStartIdxOfRxPduInfo "" UBYTE Com_RxSigGrpInfoIndStartIdxOfRxPduInfoType 0 0 0 255 ECU_ADDRESS 0x0 /end MEASUREMENT
/begin MEASUREMENT Com_RxPduInfo[0].RxSigInfoEndIdxOfRxPduInfo "" UWORD Com_RxSigInfoEndIdxOfRxPduInfoType 0 0 0 65535 ECU_ADDRESS 0x0 /end MEASUREMENT
/begin MEASUREMENT Com_RxPduInfo[0].RxSigInfoStartIdxOfRxPduInfo "" UWORD Com_RxSigInfoStartIdxOfRxPduInfoType 0 0 0 65535 ECU_ADDRESS 0x0 /end MEASUREMENT
/begin MEASUREMENT Com_RxPduInfo[0].RxTOutInfoIdxOfRxPduInfo "" UBYTE Com_RxTOutInfoIdxOfRxPduInfoType 0 0 0 255 ECU_ADDRESS 0x0 /end MEASUREMENT
/begin MEASUREMENT Com_RxPduInfo[0].RxTOutInfoIndEndIdxOfRxPduInfo "" UBYTE Com_RxTOutInfoIndEndIdxOfRxPduInfoType 0 0 0 255 ECU_ADDRESS 0x0 /end MEASUREMENT
/begin MEASUREMENT Com_RxPduInfo[0].RxTOutInfoIndStartIdxOfRxPduInfo "" UBYTE Com_RxTOutInfoIndStartIdxOfRxPduInfoType 0 0 0 255 ECU_ADDRESS 0x0 /end MEASUREMENT
/begin MEASUREMENT Com_RxPduInfo[10].HandleRxPduDeferredIdxOfRxPduInfo "" UBYTE Com_HandleRxPduDeferredIdxOfRxPduInfoType 0 0 0 255 ECU_ADDRESS 0x0 /end MEASUREMENT
/begin MEASUREMENT Com_RxPduInfo[10].IPduGroupInfoOfRxPduInfoIndEndIdxOfRxPduInfo "" UBYTE Com_IPduGroupInfoOfRxPduInfoIndEndIdxOfRxPduInfoType 0 0 0 255 ECU_ADDRESS 0x0 /end MEASUREMENT
/begin MEASUREMENT Com_RxPduInfo[10].IPduGroupInfoOfRxPduInfoIndStartIdxOfRxPduInfo "" UBYTE Com_IPduGroupInfoOfRxPduInfoIndStartIdxOfRxPduInfoType 0 0 0 255 ECU_ADDRESS 0x0 /end MEASUREMENT
/begin MEASUREMENT Com_RxPduInfo[10].MainFunctionRxStructIdxOfRxPduInfo "" UBYTE Com_MainFunctionRxStructIdxOfRxPduInfoType 0 0 0 255 ECU_ADDRESS 0x0 /end MEASUREMENT
/begin MEASUREMENT Com_RxPduInfo[10].RxAccessInfoIndEndIdxOfRxPduInfo "" UWORD Com_RxAccessInfoIndEndIdxOfRxPduInfoType 0 0 0 65535 ECU_ADDRESS 0x0 /end MEASUREMENT
/begin MEASUREMENT Com_RxPduInfo[10].RxAccessInfoIndStartIdxOfRxPduInfo "" UWORD Com_RxAccessInfoIndStartIdxOfRxPduInfoType 0 0 0 65535 ECU_ADDRESS 0x0 /end MEASUREMENT
/begin MEASUREMENT Com_RxPduInfo[10].RxDefPduBufferEndIdxOfRxPduInfo "" UWORD Com_RxDefPduBufferEndIdxOfRxPduInfoType 0 0 0 65535 ECU_ADDRESS 0x0 /end MEASUREMENT
/begin MEASUREMENT Com_RxPduInfo[10].RxDefPduBufferStartIdxOfRxPduInfo "" UWORD Com_RxDefPduBufferStartIdxOfRxPduInfoType 0 0 0 65535 ECU_ADDRESS 0x0 /end MEASUREMENT
/begin MEASUREMENT Com_RxPduInfo[10].RxPduCalloutFuncPtrIdxOfRxPduInfo "" UBYTE Com_RxPduCalloutFuncPtrIdxOfRxPduInfoType 0 0 0 255 ECU_ADDRESS 0x0 /end MEASUREMENT
/begin MEASUREMENT Com_RxPduInfo[10].RxSigGrpInfoIndEndIdxOfRxPduInfo "" UBYTE Com_RxSigGrpInfoIndEndIdxOfRxPduInfoType 0 0 0 255 ECU_ADDRESS 0x0 /end MEASUREMENT
/begin MEASUREMENT Com_RxPduInfo[10].RxSigGrpInfoIndStartIdxOfRxPduInfo "" UBYTE Com_RxSigGrpInfoIndStartIdxOfRxPduInfoType 0 0 0 255 ECU_ADDRESS 0x0 /end MEASUREMENT
/begin MEASUREMENT Com_RxPduInfo[10].RxSigInfoEndIdxOfRxPduInfo "" UWORD Com_RxSigInfoEndIdxOfRxPduInfoType 0 0 0 65535 ECU_ADDRESS 0x0 /end MEASUREMENT
/begin MEASUREMENT Com_RxPduInfo[10].RxSigInfoStartIdxOfRxPduInfo "" UWORD Com_RxSigInfoStartIdxOfRxPduInfoType 0 0 0 65535 ECU_ADDRESS 0x0 /end MEASUREMENT
/begin MEASUREMENT Com_RxPduInfo[10].RxTOutInfoIdxOfRxPduInfo "" UBYTE Com_RxTOutInfoIdxOfRxPduInfoType 0 0 0 255 ECU_ADDRESS 0x0 /end MEASUREMENT
/begin MEASUREMENT Com_RxPduInfo[10].RxTOutInfoIndEndIdxOfRxPduInfo "" UBYTE Com_RxTOutInfoIndEndIdxOfRxPduInfoType 0 0 0 255 ECU_ADDRESS 0x0 /end MEASUREMENT
/begin MEASUREMENT Com_RxPduInfo[10].RxTOutInfoIndStartIdxOfRxPduInfo "" UBYTE Com_RxTOutInfoIndStartIdxOfRxPduInfoType 0 0 0 255 ECU_ADDRESS 0x0 /end MEASUREMENT
/begin MEASUREMENT Com_RxPduInfo[11].HandleRxPduDeferredIdxOfRxPduInfo "" UBYTE Com_HandleRxPduDeferredIdxOfRxPduInfoType 0 0 0 255 ECU_ADDRESS 0x0 /end MEASUREMENT
/begin MEASUREMENT Com_RxPduInfo[11].IPduGroupInfoOfRxPduInfoIndEndIdxOfRxPduInfo "" UBYTE Com_IPduGroupInfoOfRxPduInfoIndEndIdxOfRxPduInfoType 0 0 0 255 ECU_ADDRESS 0x0 /end MEASUREMENT
/begin MEASUREMENT Com_RxPduInfo[11].IPduGroupInfoOfRxPduInfoIndStartIdxOfRxPduInfo "" UBYTE Com_IPduGroupInfoOfRxPduInfoIndStartIdxOfRxPduInfoType 0 0 0 255 ECU_ADDRESS 0x0 /end MEASUREMENT
/begin MEASUREMENT Com_RxPduInfo[11].MainFunctionRxStructIdxOfRxPduInfo "" UBYTE Com_MainFunctionRxStructIdxOfRxPduInfoType 0 0 0 255 ECU_ADDRESS 0x0 /end MEASUREMENT
/begin MEASUREMENT Com_RxPduInfo[11].RxAccessInfoIndEndIdxOfRxPduInfo "" UWORD Com_RxAccessInfoIndEndIdxOfRxPduInfoType 0 0 0 65535 ECU_ADDRESS 0x0 /end MEASUREMENT
/begin MEASUREMENT Com_RxPduInfo[11].RxAccessInfoIndStartIdxOfRxPduInfo "" UWORD Com_RxAccessInfoIndStartIdxOfRxPduInfoType 0 0 0 65535 ECU_ADDRESS 0x0 /end MEASUREMENT
/begin MEASUREMENT Com_RxPduInfo[11].RxDefPduBufferEndIdxOfRxPduInfo "" UWORD Com_RxDefPduBufferEndIdxOfRxPduInfoType 0 0 0 65535 ECU_ADDRESS 0x0 /end MEASUREMENT
/begin MEASUREMENT Com_RxPduInfo[11].RxDefPduBufferStartIdxOfRxPduInfo "" UWORD Com_RxDefPduBufferStartIdxOfRxPduInfoType 0 0 0 65535 ECU_ADDRESS 0x0 /end MEASUREMENT
/begin MEASUREMENT Com_RxPduInfo[11].RxPduCalloutFuncPtrIdxOfRxPduInfo "" UBYTE Com_RxPduCalloutFuncPtrIdxOfRxPduInfoType 0 0 0 255 ECU_ADDRESS 0x0 /end MEASUREMENT
/begin MEASUREMENT Com_RxPduInfo[11].RxSigGrpInfoIndEndIdxOfRxPduInfo "" UBYTE Com_RxSigGrpInfoIndEndIdxOfRxPduInfoType 0 0 0 255 ECU_ADDRESS 0x0 /end MEASUREMENT
/begin MEASUREMENT Com_RxPduInfo[11].RxSigGrpInfoIndStartIdxOfRxPduInfo "" UBYTE Com_RxSigGrpInfoIndStartIdxOfRxPduInfoType 0 0 0 255 ECU_ADDRESS 0x0 /end MEASUREMENT
/begin MEASUREMENT Com_RxPduInfo[11].RxSigInfoEndIdxOfRxPduInfo "" UWORD Com_RxSigInfoEndIdxOfRxPduInfoType 0 0 0 65535 ECU_ADDRESS 0x0 /end MEASUREMENT
/begin MEASUREMENT Com_RxPduInfo[11].RxSigInfoStartIdxOfRxPduInfo "" UWORD Com_RxSigInfoStartIdxOfRxPduInfoType 0 0 0 65535 ECU_ADDRESS 0x0 /end MEASUREMENT
/begin MEASUREMENT Com_RxPduInfo[11].RxTOutInfoIdxOfRxPduInfo "" UBYTE Com_RxTOutInfoIdxOfRxPduInfoType 0 0 0 255 ECU_ADDRESS 0x0 /end MEASUREMENT
/begin MEASUREMENT Com_RxPduInfo[11].RxTOutInfoIndEndIdxOfRxPduInfo "" UBYTE Com_RxTOutInfoIndEndIdxOfRxPduInfoType 0 0 0 255 ECU_ADDRESS 0x0 /end MEASUREMENT
/begin MEASUREMENT Com_RxPduInfo[11].RxTOutInfoIndStartIdxOfRxPduInfo "" UBYTE Com_RxTOutInfoIndStartIdxOfRxPduInfoType 0 0 0 255 ECU_ADDRESS 0x0 /end MEASUREMENT
/begin MEASUREMENT Com_RxPduInfo[12].HandleRxPduDeferredIdxOfRxPduInfo "" UBYTE Com_HandleRxPduDeferredIdxOfRxPduInfoType 0 0 0 255 ECU_ADDRESS 0x0 /end MEASUREMENT
/begin MEASUREMENT Com_RxPduInfo[12].IPduGroupInfoOfRxPduInfoIndEndIdxOfRxPduInfo "" UBYTE Com_IPduGroupInfoOfRxPduInfoIndEndIdxOfRxPduInfoType 0 0 0 255 ECU_ADDRESS 0x0 /end MEASUREMENT
/begin MEASUREMENT Com_RxPduInfo[12].IPduGroupInfoOfRxPduInfoIndStartIdxOfRxPduInfo "" UBYTE Com_IPduGroupInfoOfRxPduInfoIndStartIdxOfRxPduInfoType 0 0 0 255 ECU_ADDRESS 0x0 /end MEASUREMENT
/begin MEASUREMENT Com_RxPduInfo[12].MainFunctionRxStructIdxOfRxPduInfo "" UBYTE Com_MainFunctionRxStructIdxOfRxPduInfoType 0 0 0 255 ECU_ADDRESS 0x0 /end MEASUREMENT
/begin MEASUREMENT Com_RxPduInfo[12].RxAccessInfoIndEndIdxOfRxPduInfo "" UWORD Com_RxAccessInfoIndEndIdxOfRxPduInfoType 0 0 0 65535 ECU_ADDRESS 0x0 /end MEASUREMENT
/begin MEASUREMENT Com_RxPduInfo[12].RxAccessInfoIndStartIdxOfRxPduInfo "" UWORD Com_RxAccessInfoIndStartIdxOfRxPduInfoType 0 0 0 65535 ECU_ADDRESS 0x0 /end MEASUREMENT
/begin MEASUREMENT Com_RxPduInfo[12].RxDefPduBufferEndIdxOfRxPduInfo "" UWORD Com_RxDefPduBufferEndIdxOfRxPduInfoType 0 0 0 65535 ECU_ADDRESS 0x0 /end MEASUREMENT
/begin MEASUREMENT Com_RxPduInfo[12].RxDefPduBufferStartIdxOfRxPduInfo "" UWORD Com_RxDefPduBufferStartIdxOfRxPduInfoType 0 0 0 65535 ECU_ADDRESS 0x0 /end MEASUREMENT
/begin MEASUREMENT Com_RxPduInfo[12].RxPduCalloutFuncPtrIdxOfRxPduInfo "" UBYTE Com_RxPduCalloutFuncPtrIdxOfRxPduInfoType 0 0 0 255 ECU_ADDRESS 0x0 /end MEASUREMENT
/begin MEASUREMENT Com_RxPduInfo[12].RxSigGrpInfoIndEndIdxOfRxPduInfo "" UBYTE Com_RxSigGrpInfoIndEndIdxOfRxPduInfoType 0 0 0 255 ECU_ADDRESS 0x0 /end MEASUREMENT
/begin MEASUREMENT Com_RxPduInfo[12].RxSigGrpInfoIndStartIdxOfRxPduInfo "" UBYTE Com_RxSigGrpInfoIndStartIdxOfRxPduInfoType 0 0 0 255 ECU_ADDRESS 0x0 /end MEASUREMENT
/begin MEASUREMENT Com_RxPduInfo[12].RxSigInfoEndIdxOfRxPduInfo "" UWORD Com_RxSigInfoEndIdxOfRxPduInfoType 0 0 0 65535 ECU_ADDRESS 0x0 /end MEASUREMENT
/begin MEASUREMENT Com_RxPduInfo[12].RxSigInfoStartIdxOfRxPduInfo "" UWORD Com_RxSigInfoStartIdxOfRxPduInfoType 0 0 0 65535 ECU_ADDRESS 0x0 /end MEASUREMENT
/begin MEASUREMENT Com_RxPduInfo[12].RxTOutInfoIdxOfRxPduInfo "" UBYTE Com_RxTOutInfoIdxOfRxPduInfoType 0 0 0 255 ECU_ADDRESS 0x0 /end MEASUREMENT
/begin MEASUREMENT Com_RxPduInfo[12].RxTOutInfoIndEndIdxOfRxPduInfo "" UBYTE Com_RxTOutInfoIndEndIdxOfRxPduInfoType 0 0 0 255 ECU_ADDRESS 0x0 /end MEASUREMENT
/begin MEASUREMENT Com_RxPduInfo[12].RxTOutInfoIndStartIdxOfRxPduInfo "" UBYTE Com_RxTOutInfoIndStartIdxOfRxPduInfoType 0 0 0 255 ECU_ADDRESS 0x0 /end MEASUREMENT
/begin MEASUREMENT Com_RxPduInfo[13].HandleRxPduDeferredIdxOfRxPduInfo "" UBYTE Com_HandleRxPduDeferredIdxOfRxPduInfoType 0 0 0 255 ECU_ADDRESS 0x0 /end MEASUREMENT
/begin MEASUREMENT Com_RxPduInfo[13].IPduGroupInfoOfRxPduInfoIndEndIdxOfRxPduInfo "" UBYTE Com_IPduGroupInfoOfRxPduInfoIndEndIdxOfRxPduInfoType 0 0 0 255 ECU_ADDRESS 0x0 /end MEASUREMENT
/begin MEASUREMENT Com_RxPduInfo[13].IPduGroupInfoOfRxPduInfoIndStartIdxOfRxPduInfo "" UBYTE Com_IPduGroupInfoOfRxPduInfoIndStartIdxOfRxPduInfoType 0 0 0 255 ECU_ADDRESS 0x0 /end MEASUREMENT
/begin MEASUREMENT Com_RxPduInfo[13].MainFunctionRxStructIdxOfRxPduInfo "" UBYTE Com_MainFunctionRxStructIdxOfRxPduInfoType 0 0 0 255 ECU_ADDRESS 0x0 /end MEASUREMENT
/begin MEASUREMENT Com_RxPduInfo[13].RxAccessInfoIndEndIdxOfRxPduInfo "" UWORD Com_RxAccessInfoIndEndIdxOfRxPduInfoType 0 0 0 65535 ECU_ADDRESS 0x0 /end MEASUREMENT
/begin MEASUREMENT Com_RxPduInfo[13].RxAccessInfoIndStartIdxOfRxPduInfo "" UWORD Com_RxAccessInfoIndStartIdxOfRxPduInfoType 0 0 0 65535 ECU_ADDRESS 0x0 /end MEASUREMENT
/begin MEASUREMENT Com_RxPduInfo[13].RxDefPduBufferEndIdxOfRxPduInfo "" UWORD Com_RxDefPduBufferEndIdxOfRxPduInfoType 0 0 0 65535 ECU_ADDRESS 0x0 /end MEASUREMENT
/begin MEASUREMENT Com_RxPduInfo[13].RxDefPduBufferStartIdxOfRxPduInfo "" UWORD Com_RxDefPduBufferStartIdxOfRxPduInfoType 0 0 0 65535 ECU_ADDRESS 0x0 /end MEASUREMENT
/begin MEASUREMENT Com_RxPduInfo[13].RxPduCalloutFuncPtrIdxOfRxPduInfo "" UBYTE Com_RxPduCalloutFuncPtrIdxOfRxPduInfoType 0 0 0 255 ECU_ADDRESS 0x0 /end MEASUREMENT
/begin MEASUREMENT Com_RxPduInfo[13].RxSigGrpInfoIndEndIdxOfRxPduInfo "" UBYTE Com_RxSigGrpInfoIndEndIdxOfRxPduInfoType 0 0 0 255 ECU_ADDRESS 0x0 /end MEASUREMENT
/begin MEASUREMENT Com_RxPduInfo[13].RxSigGrpInfoIndStartIdxOfRxPduInfo "" UBYTE Com_RxSigGrpInfoIndStartIdxOfRxPduInfoType 0 0 0 255 ECU_ADDRESS 0x0 /end MEASUREMENT
/begin MEASUREMENT Com_RxPduInfo[13].RxSigInfoEndIdxOfRxPduInfo "" UWORD Com_RxSigInfoEndIdxOfRxPduInfoType 0 0 0 65535 ECU_ADDRESS 0x0 /end MEASUREMENT
/begin MEASUREMENT Com_RxPduInfo[13].RxSigInfoStartIdxOfRxPduInfo "" UWORD Com_RxSigInfoStartIdxOfRxPduInfoType 0 0 0 65535 ECU_ADDRESS 0x0 /end MEASUREMENT
/begin MEASUREMENT Com_RxPduInfo[13].RxTOutInfoIdxOfRxPduInfo "" UBYTE Com_RxTOutInfoIdxOfRxPduInfoType 0 0 0 255 ECU_ADDRESS 0x0 /end MEASUREMENT
/begin MEASUREMENT Com_RxPduInfo[13].RxTOutInfoIndEndIdxOfRxPduInfo "" UBYTE Com_RxTOutInfoIndEndIdxOfRxPduInfoType 0 0 0 255 ECU_ADDRESS 0x0 /end MEASUREMENT
/begin MEASUREMENT Com_RxPduInfo[13].RxTOutInfoIndStartIdxOfRxPduInfo "" UBYTE Com_RxTOutInfoIndStartIdxOfRxPduInfoType 0 0 0 255 ECU_ADDRESS 0x0 /end MEASUREMENT
/begin MEASUREMENT Com_RxPduInfo[14].HandleRxPduDeferredIdxOfRxPduInfo "" UBYTE Com_HandleRxPduDeferredIdxOfRxPduInfoType 0 0 0 255 ECU_ADDRESS 0x0 /end MEASUREMENT
/begin MEASUREMENT Com_RxPduInfo[14].IPduGroupInfoOfRxPduInfoIndEndIdxOfRxPduInfo "" UBYTE Com_IPduGroupInfoOfRxPduInfoIndEndIdxOfRxPduInfoType 0 0 0 255 ECU_ADDRESS 0x0 /end MEASUREMENT
/begin MEASUREMENT Com_RxPduInfo[14].IPduGroupInfoOfRxPduInfoIndStartIdxOfRxPduInfo "" UBYTE Com_IPduGroupInfoOfRxPduInfoIndStartIdxOfRxPduInfoType 0 0 0 255 ECU_ADDRESS 0x0 /end MEASUREMENT
/begin MEASUREMENT Com_RxPduInfo[14].MainFunctionRxStructIdxOfRxPduInfo "" UBYTE Com_MainFunctionRxStructIdxOfRxPduInfoType 0 0 0 255 ECU_ADDRESS 0x0 /end MEASUREMENT
/begin MEASUREMENT Com_RxPduInfo[14].RxAccessInfoIndEndIdxOfRxPduInfo "" UWORD Com_RxAccessInfoIndEndIdxOfRxPduInfoType 0 0 0 65535 ECU_ADDRESS 0x0 /end MEASUREMENT
/begin MEASUREMENT Com_RxPduInfo[14].RxAccessInfoIndStartIdxOfRxPduInfo "" UWORD Com_RxAccessInfoIndStartIdxOfRxPduInfoType 0 0 0 65535 ECU_ADDRESS 0x0 /end MEASUREMENT
/begin MEASUREMENT Com_RxPduInfo[14].RxDefPduBufferEndIdxOfRxPduInfo "" UWORD Com_RxDefPduBufferEndIdxOfRxPduInfoType 0 0 0 65535 ECU_ADDRESS 0x0 /end MEASUREMENT
/begin MEASUREMENT Com_RxPduInfo[14].RxDefPduBufferStartIdxOfRxPduInfo "" UWORD Com_RxDefPduBufferStartIdxOfRxPduInfoType 0 0 0 65535 ECU_ADDRESS 0x0 /end MEASUREMENT
/begin MEASUREMENT Com_RxPduInfo[14].RxPduCalloutFuncPtrIdxOfRxPduInfo "" UBYTE Com_RxPduCalloutFuncPtrIdxOfRxPduInfoType 0 0 0 255 ECU_ADDRESS 0x0 /end MEASUREMENT
/begin MEASUREMENT Com_RxPduInfo[14].RxSigGrpInfoIndEndIdxOfRxPduInfo "" UBYTE Com_RxSigGrpInfoIndEndIdxOfRxPduInfoType 0 0 0 255 ECU_ADDRESS 0x0 /end MEASUREMENT
/begin MEASUREMENT Com_RxPduInfo[14].RxSigGrpInfoIndStartIdxOfRxPduInfo "" UBYTE Com_RxSigGrpInfoIndStartIdxOfRxPduInfoType 0 0 0 255 ECU_ADDRESS 0x0 /end MEASUREMENT
/begin MEASUREMENT Com_RxPduInfo[14].RxSigInfoEndIdxOfRxPduInfo "" UWORD Com_RxSigInfoEndIdxOfRxPduInfoType 0 0 0 65535 ECU_ADDRESS 0x0 /end MEASUREMENT
/begin MEASUREMENT Com_RxPduInfo[14].RxSigInfoStartIdxOfRxPduInfo "" UWORD Com_RxSigInfoStartIdxOfRxPduInfoType 0 0 0 65535 ECU_ADDRESS 0x0 /end MEASUREMENT
/begin MEASUREMENT Com_RxPduInfo[14].RxTOutInfoIdxOfRxPduInfo "" UBYTE Com_RxTOutInfoIdxOfRxPduInfoType 0 0 0 255 ECU_ADDRESS 0x0 /end MEASUREMENT
/begin MEASUREMENT Com_RxPduInfo[14].RxTOutInfoIndEndIdxOfRxPduInfo "" UBYTE Com_RxTOutInfoIndEndIdxOfRxPduInfoType 0 0 0 255 ECU_ADDRESS 0x0 /end MEASUREMENT
/begin MEASUREMENT Com_RxPduInfo[14].RxTOutInfoIndStartIdxOfRxPduInfo "" UBYTE Com_RxTOutInfoIndStartIdxOfRxPduInfoType 0 0 0 255 ECU_ADDRESS 0x0 /end MEASUREMENT
/begin MEASUREMENT Com_RxPduInfo[15].HandleRxPduDeferredIdxOfRxPduInfo "" UBYTE Com_HandleRxPduDeferredIdxOfRxPduInfoType 0 0 0 255 ECU_ADDRESS 0x0 /end MEASUREMENT
/begin MEASUREMENT Com_RxPduInfo[15].IPduGroupInfoOfRxPduInfoIndEndIdxOfRxPduInfo "" UBYTE Com_IPduGroupInfoOfRxPduInfoIndEndIdxOfRxPduInfoType 0 0 0 255 ECU_ADDRESS 0x0 /end MEASUREMENT
/begin MEASUREMENT Com_RxPduInfo[15].IPduGroupInfoOfRxPduInfoIndStartIdxOfRxPduInfo "" UBYTE Com_IPduGroupInfoOfRxPduInfoIndStartIdxOfRxPduInfoType 0 0 0 255 ECU_ADDRESS 0x0 /end MEASUREMENT
/begin MEASUREMENT Com_RxPduInfo[15].MainFunctionRxStructIdxOfRxPduInfo "" UBYTE Com_MainFunctionRxStructIdxOfRxPduInfoType 0 0 0 255 ECU_ADDRESS 0x0 /end MEASUREMENT
/begin MEASUREMENT Com_RxPduInfo[15].RxAccessInfoIndEndIdxOfRxPduInfo "" UWORD Com_RxAccessInfoIndEndIdxOfRxPduInfoType 0 0 0 65535 ECU_ADDRESS 0x0 /end MEASUREMENT
/begin MEASUREMENT Com_RxPduInfo[15].RxAccessInfoIndStartIdxOfRxPduInfo "" UWORD Com_RxAccessInfoIndStartIdxOfRxPduInfoType 0 0 0 65535 ECU_ADDRESS 0x0 /end MEASUREMENT
/begin MEASUREMENT Com_RxPduInfo[15].RxDefPduBufferEndIdxOfRxPduInfo "" UWORD Com_RxDefPduBufferEndIdxOfRxPduInfoType 0 0 0 65535 ECU_ADDRESS 0x0 /end MEASUREMENT
/begin MEASUREMENT Com_RxPduInfo[15].RxDefPduBufferStartIdxOfRxPduInfo "" UWORD Com_RxDefPduBufferStartIdxOfRxPduInfoType 0 0 0 65535 ECU_ADDRESS 0x0 /end MEASUREMENT
/begin MEASUREMENT Com_RxPduInfo[15].RxPduCalloutFuncPtrIdxOfRxPduInfo "" UBYTE Com_RxPduCalloutFuncPtrIdxOfRxPduInfoType 0 0 0 255 ECU_ADDRESS 0x0 /end MEASUREMENT
/begin MEASUREMENT Com_RxPduInfo[15].RxSigGrpInfoIndEndIdxOfRxPduInfo "" UBYTE Com_RxSigGrpInfoIndEndIdxOfRxPduInfoType 0 0 0 255 ECU_ADDRESS 0x0 /end MEASUREMENT
/begin MEASUREMENT Com_RxPduInfo[15].RxSigGrpInfoIndStartIdxOfRxPduInfo "" UBYTE Com_RxSigGrpInfoIndStartIdxOfRxPduInfoType 0 0 0 255 ECU_ADDRESS 0x0 /end MEASUREMENT
/begin MEASUREMENT Com_RxPduInfo[15].RxSigInfoEndIdxOfRxPduInfo "" UWORD Com_RxSigInfoEndIdxOfRxPduInfoType 0 0 0 65535 ECU_ADDRESS 0x0 /end MEASUREMENT
/begin MEASUREMENT Com_RxPduInfo[15].RxSigInfoStartIdxOfRxPduInfo "" UWORD Com_RxSigInfoStartIdxOfRxPduInfoType 0 0 0 65535 ECU_ADDRESS 0x0 /end MEASUREMENT
/begin MEASUREMENT Com_RxPduInfo[15].RxTOutInfoIdxOfRxPduInfo "" UBYTE Com_RxTOutInfoIdxOfRxPduInfoType 0 0 0 255 ECU_ADDRESS 0x0 /end MEASUREMENT
/begin MEASUREMENT Com_RxPduInfo[15].RxTOutInfoIndEndIdxOfRxPduInfo "" UBYTE Com_RxTOutInfoIndEndIdxOfRxPduInfoType 0 0 0 255 ECU_ADDRESS 0x0 /end MEASUREMENT
/begin MEASUREMENT Com_RxPduInfo[15].RxTOutInfoIndStartIdxOfRxPduInfo "" UBYTE Com_RxTOutInfoIndStartIdxOfRxPduInfoType 0 0 0 255 ECU_ADDRESS 0x0 /end MEASUREMENT
/begin MEASUREMENT Com_RxPduInfo[16].HandleRxPduDeferredIdxOfRxPduInfo "" UBYTE Com_HandleRxPduDeferredIdxOfRxPduInfoType 0 0 0 255 ECU_ADDRESS 0x0 /end MEASUREMENT
/begin MEASUREMENT Com_RxPduInfo[16].IPduGroupInfoOfRxPduInfoIndEndIdxOfRxPduInfo "" UBYTE Com_IPduGroupInfoOfRxPduInfoIndEndIdxOfRxPduInfoType 0 0 0 255 ECU_ADDRESS 0x0 /end MEASUREMENT
/begin MEASUREMENT Com_RxPduInfo[16].IPduGroupInfoOfRxPduInfoIndStartIdxOfRxPduInfo "" UBYTE Com_IPduGroupInfoOfRxPduInfoIndStartIdxOfRxPduInfoType 0 0 0 255 ECU_ADDRESS 0x0 /end MEASUREMENT
/begin MEASUREMENT Com_RxPduInfo[16].MainFunctionRxStructIdxOfRxPduInfo "" UBYTE Com_MainFunctionRxStructIdxOfRxPduInfoType 0 0 0 255 ECU_ADDRESS 0x0 /end MEASUREMENT
/begin MEASUREMENT Com_RxPduInfo[16].RxAccessInfoIndEndIdxOfRxPduInfo "" UWORD Com_RxAccessInfoIndEndIdxOfRxPduInfoType 0 0 0 65535 ECU_ADDRESS 0x0 /end MEASUREMENT
/begin MEASUREMENT Com_RxPduInfo[16].RxAccessInfoIndStartIdxOfRxPduInfo "" UWORD Com_RxAccessInfoIndStartIdxOfRxPduInfoType 0 0 0 65535 ECU_ADDRESS 0x0 /end MEASUREMENT
/begin MEASUREMENT Com_RxPduInfo[16].RxDefPduBufferEndIdxOfRxPduInfo "" UWORD Com_RxDefPduBufferEndIdxOfRxPduInfoType 0 0 0 65535 ECU_ADDRESS 0x0 /end MEASUREMENT
/begin MEASUREMENT Com_RxPduInfo[16].RxDefPduBufferStartIdxOfRxPduInfo "" UWORD Com_RxDefPduBufferStartIdxOfRxPduInfoType 0 0 0 65535 ECU_ADDRESS 0x0 /end MEASUREMENT
/begin MEASUREMENT Com_RxPduInfo[16].RxPduCalloutFuncPtrIdxOfRxPduInfo "" UBYTE Com_RxPduCalloutFuncPtrIdxOfRxPduInfoType 0 0 0 255 ECU_ADDRESS 0x0 /end MEASUREMENT
/begin MEASUREMENT Com_RxPduInfo[16].RxSigGrpInfoIndEndIdxOfRxPduInfo "" UBYTE Com_RxSigGrpInfoIndEndIdxOfRxPduInfoType 0 0 0 255 ECU_ADDRESS 0x0 /end MEASUREMENT
/begin MEASUREMENT Com_RxPduInfo[16].RxSigGrpInfoIndStartIdxOfRxPduInfo "" UBYTE Com_RxSigGrpInfoIndStartIdxOfRxPduInfoType 0 0 0 255 ECU_ADDRESS 0x0 /end MEASUREMENT
/begin MEASUREMENT Com_RxPduInfo[16].RxSigInfoEndIdxOfRxPduInfo "" UWORD Com_RxSigInfoEndIdxOfRxPduInfoType 0 0 0 65535 ECU_ADDRESS 0x0 /end MEASUREMENT
/begin MEASUREMENT Com_RxPduInfo[16].RxSigInfoStartIdxOfRxPduInfo "" UWORD Com_RxSigInfoStartIdxOfRxPduInfoType 0 0 0 65535 ECU_ADDRESS 0x0 /end MEASUREMENT
/begin MEASUREMENT Com_RxPduInfo[16].RxTOutInfoIdxOfRxPduInfo "" UBYTE Com_RxTOutInfoIdxOfRxPduInfoType 0 0 0 255 ECU_ADDRESS 0x0 /end MEASUREMENT
/begin MEASUREMENT Com_RxPduInfo[16].RxTOutInfoIndEndIdxOfRxPduInfo "" UBYTE Com_RxTOutInfoIndEndIdxOfRxPduInfoType 0 0 0 255 ECU_ADDRESS 0x0 /end MEASUREMENT
/begin MEASUREMENT Com_RxPduInfo[16].RxTOutInfoIndStartIdxOfRxPduInfo "" UBYTE Com_RxTOutInfoIndStartIdxOfRxPduInfoType 0 0 0 255 ECU_ADDRESS 0x0 /end MEASUREMENT
/begin MEASUREMENT Com_RxPduInfo[17].HandleRxPduDeferredIdxOfRxPduInfo "" UBYTE Com_HandleRxPduDeferredIdxOfRxPduInfoType 0 0 0 255 ECU_ADDRESS 0x0 /end MEASUREMENT
/begin MEASUREMENT Com_RxPduInfo[17].IPduGroupInfoOfRxPduInfoIndEndIdxOfRxPduInfo "" UBYTE Com_IPduGroupInfoOfRxPduInfoIndEndIdxOfRxPduInfoType 0 0 0 255 ECU_ADDRESS 0x0 /end MEASUREMENT
/begin MEASUREMENT Com_RxPduInfo[17].IPduGroupInfoOfRxPduInfoIndStartIdxOfRxPduInfo "" UBYTE Com_IPduGroupInfoOfRxPduInfoIndStartIdxOfRxPduInfoType 0 0 0 255 ECU_ADDRESS 0x0 /end MEASUREMENT
/begin MEASUREMENT Com_RxPduInfo[17].MainFunctionRxStructIdxOfRxPduInfo "" UBYTE Com_MainFunctionRxStructIdxOfRxPduInfoType 0 0 0 255 ECU_ADDRESS 0x0 /end MEASUREMENT
/begin MEASUREMENT Com_RxPduInfo[17].RxAccessInfoIndEndIdxOfRxPduInfo "" UWORD Com_RxAccessInfoIndEndIdxOfRxPduInfoType 0 0 0 65535 ECU_ADDRESS 0x0 /end MEASUREMENT
/begin MEASUREMENT Com_RxPduInfo[17].RxAccessInfoIndStartIdxOfRxPduInfo "" UWORD Com_RxAccessInfoIndStartIdxOfRxPduInfoType 0 0 0 65535 ECU_ADDRESS 0x0 /end MEASUREMENT
/begin MEASUREMENT Com_RxPduInfo[17].RxDefPduBufferEndIdxOfRxPduInfo "" UWORD Com_RxDefPduBufferEndIdxOfRxPduInfoType 0 0 0 65535 ECU_ADDRESS 0x0 /end MEASUREMENT
/begin MEASUREMENT Com_RxPduInfo[17].RxDefPduBufferStartIdxOfRxPduInfo "" UWORD Com_RxDefPduBufferStartIdxOfRxPduInfoType 0 0 0 65535 ECU_ADDRESS 0x0 /end MEASUREMENT
/begin MEASUREMENT Com_RxPduInfo[17].RxPduCalloutFuncPtrIdxOfRxPduInfo "" UBYTE Com_RxPduCalloutFuncPtrIdxOfRxPduInfoType 0 0 0 255 ECU_ADDRESS 0x0 /end MEASUREMENT
/begin MEASUREMENT Com_RxPduInfo[17].RxSigGrpInfoIndEndIdxOfRxPduInfo "" UBYTE Com_RxSigGrpInfoIndEndIdxOfRxPduInfoType 0 0 0 255 ECU_ADDRESS 0x0 /end MEASUREMENT
/begin MEASUREMENT Com_RxPduInfo[17].RxSigGrpInfoIndStartIdxOfRxPduInfo "" UBYTE Com_RxSigGrpInfoIndStartIdxOfRxPduInfoType 0 0 0 255 ECU_ADDRESS 0x0 /end MEASUREMENT
/begin MEASUREMENT Com_RxPduInfo[17].RxSigInfoEndIdxOfRxPduInfo "" UWORD Com_RxSigInfoEndIdxOfRxPduInfoType 0 0 0 65535 ECU_ADDRESS 0x0 /end MEASUREMENT
/begin MEASUREMENT Com_RxPduInfo[17].RxSigInfoStartIdxOfRxPduInfo "" UWORD Com_RxSigInfoStartIdxOfRxPduInfoType 0 0 0 65535 ECU_ADDRESS 0x0 /end MEASUREMENT
/begin MEASUREMENT Com_RxPduInfo[17].RxTOutInfoIdxOfRxPduInfo "" UBYTE Com_RxTOutInfoIdxOfRxPduInfoType 0 0 0 255 ECU_ADDRESS 0x0 /end MEASUREMENT
/begin MEASUREMENT Com_RxPduInfo[17].RxTOutInfoIndEndIdxOfRxPduInfo "" UBYTE Com_RxTOutInfoIndEndIdxOfRxPduInfoType 0 0 0 255 ECU_ADDRESS 0x0 /end MEASUREMENT
/begin MEASUREMENT Com_RxPduInfo[17].RxTOutInfoIndStartIdxOfRxPduInfo "" UBYTE Com_RxTOutInfoIndStartIdxOfRxPduInfoType 0 0 0 255 ECU_ADDRESS 0x0 /end MEASUREMENT
/begin MEASUREMENT Com_RxPduInfo[18].HandleRxPduDeferredIdxOfRxPduInfo "" UBYTE Com_HandleRxPduDeferredIdxOfRxPduInfoType 0 0 0 255 ECU_ADDRESS 0x0 /end MEASUREMENT
/begin MEASUREMENT Com_RxPduInfo[18].IPduGroupInfoOfRxPduInfoIndEndIdxOfRxPduInfo "" UBYTE Com_IPduGroupInfoOfRxPduInfoIndEndIdxOfRxPduInfoType 0 0 0 255 ECU_ADDRESS 0x0 /end MEASUREMENT
/begin MEASUREMENT Com_RxPduInfo[18].IPduGroupInfoOfRxPduInfoIndStartIdxOfRxPduInfo "" UBYTE Com_IPduGroupInfoOfRxPduInfoIndStartIdxOfRxPduInfoType 0 0 0 255 ECU_ADDRESS 0x0 /end MEASUREMENT
/begin MEASUREMENT Com_RxPduInfo[18].MainFunctionRxStructIdxOfRxPduInfo "" UBYTE Com_MainFunctionRxStructIdxOfRxPduInfoType 0 0 0 255 ECU_ADDRESS 0x0 /end MEASUREMENT
/begin MEASUREMENT Com_RxPduInfo[18].RxAccessInfoIndEndIdxOfRxPduInfo "" UWORD Com_RxAccessInfoIndEndIdxOfRxPduInfoType 0 0 0 65535 ECU_ADDRESS 0x0 /end MEASUREMENT
/begin MEASUREMENT Com_RxPduInfo[18].RxAccessInfoIndStartIdxOfRxPduInfo "" UWORD Com_RxAccessInfoIndStartIdxOfRxPduInfoType 0 0 0 65535 ECU_ADDRESS 0x0 /end MEASUREMENT
/begin MEASUREMENT Com_RxPduInfo[18].RxDefPduBufferEndIdxOfRxPduInfo "" UWORD Com_RxDefPduBufferEndIdxOfRxPduInfoType 0 0 0 65535 ECU_ADDRESS 0x0 /end MEASUREMENT
/begin MEASUREMENT Com_RxPduInfo[18].RxDefPduBufferStartIdxOfRxPduInfo "" UWORD Com_RxDefPduBufferStartIdxOfRxPduInfoType 0 0 0 65535 ECU_ADDRESS 0x0 /end MEASUREMENT
/begin MEASUREMENT Com_RxPduInfo[18].RxPduCalloutFuncPtrIdxOfRxPduInfo "" UBYTE Com_RxPduCalloutFuncPtrIdxOfRxPduInfoType 0 0 0 255 ECU_ADDRESS 0x0 /end MEASUREMENT
/begin MEASUREMENT Com_RxPduInfo[18].RxSigGrpInfoIndEndIdxOfRxPduInfo "" UBYTE Com_RxSigGrpInfoIndEndIdxOfRxPduInfoType 0 0 0 255 ECU_ADDRESS 0x0 /end MEASUREMENT
/begin MEASUREMENT Com_RxPduInfo[18].RxSigGrpInfoIndStartIdxOfRxPduInfo "" UBYTE Com_RxSigGrpInfoIndStartIdxOfRxPduInfoType 0 0 0 255 ECU_ADDRESS 0x0 /end MEASUREMENT
/begin MEASUREMENT Com_RxPduInfo[18].RxSigInfoEndIdxOfRxPduInfo "" UWORD Com_RxSigInfoEndIdxOfRxPduInfoType 0 0 0 65535 ECU_ADDRESS 0x0 /end MEASUREMENT
/begin MEASUREMENT Com_RxPduInfo[18].RxSigInfoStartIdxOfRxPduInfo "" UWORD Com_RxSigInfoStartIdxOfRxPduInfoType 0 0 0 65535 ECU_ADDRESS 0x0 /end MEASUREMENT
/begin MEASUREMENT Com_RxPduInfo[18].RxTOutInfoIdxOfRxPduInfo "" UBYTE Com_RxTOutInfoIdxOfRxPduInfoType 0 0 0 255 ECU_ADDRESS 0x0 /end MEASUREMENT
/begin MEASUREMENT Com_RxPduInfo[18].RxTOutInfoIndEndIdxOfRxPduInfo "" UBYTE Com_RxTOutInfoIndEndIdxOfRxPduInfoType 0 0 0 255 ECU_ADDRESS 0x0 /end MEASUREMENT
/begin MEASUREMENT Com_RxPduInfo[18].RxTOutInfoIndStartIdxOfRxPduInfo "" UBYTE Com_RxTOutInfoIndStartIdxOfRxPduInfoType 0 0 0 255 ECU_ADDRESS 0x0 /end MEASUREMENT
/begin MEASUREMENT Com_RxPduInfo[19].HandleRxPduDeferredIdxOfRxPduInfo "" UBYTE Com_HandleRxPduDeferredIdxOfRxPduInfoType 0 0 0 255 ECU_ADDRESS 0x0 /end MEASUREMENT
/begin MEASUREMENT Com_RxPduInfo[19].IPduGroupInfoOfRxPduInfoIndEndIdxOfRxPduInfo "" UBYTE Com_IPduGroupInfoOfRxPduInfoIndEndIdxOfRxPduInfoType 0 0 0 255 ECU_ADDRESS 0x0 /end MEASUREMENT
/begin MEASUREMENT Com_RxPduInfo[19].IPduGroupInfoOfRxPduInfoIndStartIdxOfRxPduInfo "" UBYTE Com_IPduGroupInfoOfRxPduInfoIndStartIdxOfRxPduInfoType 0 0 0 255 ECU_ADDRESS 0x0 /end MEASUREMENT
/begin MEASUREMENT Com_RxPduInfo[19].MainFunctionRxStructIdxOfRxPduInfo "" UBYTE Com_MainFunctionRxStructIdxOfRxPduInfoType 0 0 0 255 ECU_ADDRESS 0x0 /end MEASUREMENT
/begin MEASUREMENT Com_RxPduInfo[19].RxAccessInfoIndEndIdxOfRxPduInfo "" UWORD Com_RxAccessInfoIndEndIdxOfRxPduInfoType 0 0 0 65535 ECU_ADDRESS 0x0 /end MEASUREMENT
/begin MEASUREMENT Com_RxPduInfo[19].RxAccessInfoIndStartIdxOfRxPduInfo "" UWORD Com_RxAccessInfoIndStartIdxOfRxPduInfoType 0 0 0 65535 ECU_ADDRESS 0x0 /end MEASUREMENT
/begin MEASUREMENT Com_RxPduInfo[19].RxDefPduBufferEndIdxOfRxPduInfo "" UWORD Com_RxDefPduBufferEndIdxOfRxPduInfoType 0 0 0 65535 ECU_ADDRESS 0x0 /end MEASUREMENT
/begin MEASUREMENT Com_RxPduInfo[19].RxDefPduBufferStartIdxOfRxPduInfo "" UWORD Com_RxDefPduBufferStartIdxOfRxPduInfoType 0 0 0 65535 ECU_ADDRESS 0x0 /end MEASUREMENT
/begin MEASUREMENT Com_RxPduInfo[19].RxPduCalloutFuncPtrIdxOfRxPduInfo "" UBYTE Com_RxPduCalloutFuncPtrIdxOfRxPduInfoType 0 0 0 255 ECU_ADDRESS 0x0 /end MEASUREMENT
/begin MEASUREMENT Com_RxPduInfo[19].RxSigGrpInfoIndEndIdxOfRxPduInfo "" UBYTE Com_RxSigGrpInfoIndEndIdxOfRxPduInfoType 0 0 0 255 ECU_ADDRESS 0x0 /end MEASUREMENT
/begin MEASUREMENT Com_RxPduInfo[19].RxSigGrpInfoIndStartIdxOfRxPduInfo "" UBYTE Com_RxSigGrpInfoIndStartIdxOfRxPduInfoType 0 0 0 255 ECU_ADDRESS 0x0 /end MEASUREMENT
/begin MEASUREMENT Com_RxPduInfo[19].RxSigInfoEndIdxOfRxPduInfo "" UWORD Com_RxSigInfoEndIdxOfRxPduInfoType 0 0 0 65535 ECU_ADDRESS 0x0 /end MEASUREMENT
/begin MEASUREMENT Com_RxPduInfo[19].RxSigInfoStartIdxOfRxPduInfo "" UWORD Com_RxSigInfoStartIdxOfRxPduInfoType 0 0 0 65535 ECU_ADDRESS 0x0 /end MEASUREMENT
/begin MEASUREMENT Com_RxPduInfo[19].RxTOutInfoIdxOfRxPduInfo "" UBYTE Com_RxTOutInfoIdxOfRxPduInfoType 0 0 0 255 ECU_ADDRESS 0x0 /end MEASUREMENT
/begin MEASUREMENT Com_RxPduInfo[19].RxTOutInfoIndEndIdxOfRxPduInfo "" UBYTE Com_RxTOutInfoIndEndIdxOfRxPduInfoType 0 0 0 255 ECU_ADDRESS 0x0 /end MEASUREMENT
/begin MEASUREMENT Com_RxPduInfo[19].RxTOutInfoIndStartIdxOfRxPduInfo "" UBYTE Com_RxTOutInfoIndStartIdxOfRxPduInfoType 0 0 0 255 ECU_ADDRESS 0x0 /end MEASUREMENT
/begin MEASUREMENT Com_RxPduInfo[1].HandleRxPduDeferredIdxOfRxPduInfo "" UBYTE Com_HandleRxPduDeferredIdxOfRxPduInfoType 0 0 0 255 ECU_ADDRESS 0x0 /end MEASUREMENT
/begin MEASUREMENT Com_RxPduInfo[1].IPduGroupInfoOfRxPduInfoIndEndIdxOfRxPduInfo "" UBYTE Com_IPduGroupInfoOfRxPduInfoIndEndIdxOfRxPduInfoType 0 0 0 255 ECU_ADDRESS 0x0 /end MEASUREMENT
/begin MEASUREMENT Com_RxPduInfo[1].IPduGroupInfoOfRxPduInfoIndStartIdxOfRxPduInfo "" UBYTE Com_IPduGroupInfoOfRxPduInfoIndStartIdxOfRxPduInfoType 0 0 0 255 ECU_ADDRESS 0x0 /end MEASUREMENT
/begin MEASUREMENT Com_RxPduInfo[1].MainFunctionRxStructIdxOfRxPduInfo "" UBYTE Com_MainFunctionRxStructIdxOfRxPduInfoType 0 0 0 255 ECU_ADDRESS 0x0 /end MEASUREMENT
/begin MEASUREMENT Com_RxPduInfo[1].RxAccessInfoIndEndIdxOfRxPduInfo "" UWORD Com_RxAccessInfoIndEndIdxOfRxPduInfoType 0 0 0 65535 ECU_ADDRESS 0x0 /end MEASUREMENT
/begin MEASUREMENT Com_RxPduInfo[1].RxAccessInfoIndStartIdxOfRxPduInfo "" UWORD Com_RxAccessInfoIndStartIdxOfRxPduInfoType 0 0 0 65535 ECU_ADDRESS 0x0 /end MEASUREMENT
/begin MEASUREMENT Com_RxPduInfo[1].RxDefPduBufferEndIdxOfRxPduInfo "" UWORD Com_RxDefPduBufferEndIdxOfRxPduInfoType 0 0 0 65535 ECU_ADDRESS 0x0 /end MEASUREMENT
/begin MEASUREMENT Com_RxPduInfo[1].RxDefPduBufferStartIdxOfRxPduInfo "" UWORD Com_RxDefPduBufferStartIdxOfRxPduInfoType 0 0 0 65535 ECU_ADDRESS 0x0 /end MEASUREMENT
/begin MEASUREMENT Com_RxPduInfo[1].RxPduCalloutFuncPtrIdxOfRxPduInfo "" UBYTE Com_RxPduCalloutFuncPtrIdxOfRxPduInfoType 0 0 0 255 ECU_ADDRESS 0x0 /end MEASUREMENT
/begin MEASUREMENT Com_RxPduInfo[1].RxSigGrpInfoIndEndIdxOfRxPduInfo "" UBYTE Com_RxSigGrpInfoIndEndIdxOfRxPduInfoType 0 0 0 255 ECU_ADDRESS 0x0 /end MEASUREMENT
/begin MEASUREMENT Com_RxPduInfo[1].RxSigGrpInfoIndStartIdxOfRxPduInfo "" UBYTE Com_RxSigGrpInfoIndStartIdxOfRxPduInfoType 0 0 0 255 ECU_ADDRESS 0x0 /end MEASUREMENT
/begin MEASUREMENT Com_RxPduInfo[1].RxSigInfoEndIdxOfRxPduInfo "" UWORD Com_RxSigInfoEndIdxOfRxPduInfoType 0 0 0 65535 ECU_ADDRESS 0x0 /end MEASUREMENT
/begin MEASUREMENT Com_RxPduInfo[1].RxSigInfoStartIdxOfRxPduInfo "" UWORD Com_RxSigInfoStartIdxOfRxPduInfoType 0 0 0 65535 ECU_ADDRESS 0x0 /end MEASUREMENT
/begin MEASUREMENT Com_RxPduInfo[1].RxTOutInfoIdxOfRxPduInfo "" UBYTE Com_RxTOutInfoIdxOfRxPduInfoType 0 0 0 255 ECU_ADDRESS 0x0 /end MEASUREMENT
/begin MEASUREMENT Com_RxPduInfo[1].RxTOutInfoIndEndIdxOfRxPduInfo "" UBYTE Com_RxTOutInfoIndEndIdxOfRxPduInfoType 0 0 0 255 ECU_ADDRESS 0x0 /end MEASUREMENT
/begin MEASUREMENT Com_RxPduInfo[1].RxTOutInfoIndStartIdxOfRxPduInfo "" UBYTE Com_RxTOutInfoIndStartIdxOfRxPduInfoType 0 0 0 255 ECU_ADDRESS 0x0 /end MEASUREMENT
/begin MEASUREMENT Com_RxPduInfo[20].HandleRxPduDeferredIdxOfRxPduInfo "" UBYTE Com_HandleRxPduDeferredIdxOfRxPduInfoType 0 0 0 255 ECU_ADDRESS 0x0 /end MEASUREMENT
/begin MEASUREMENT Com_RxPduInfo[20].IPduGroupInfoOfRxPduInfoIndEndIdxOfRxPduInfo "" UBYTE Com_IPduGroupInfoOfRxPduInfoIndEndIdxOfRxPduInfoType 0 0 0 255 ECU_ADDRESS 0x0 /end MEASUREMENT
/begin MEASUREMENT Com_RxPduInfo[20].IPduGroupInfoOfRxPduInfoIndStartIdxOfRxPduInfo "" UBYTE Com_IPduGroupInfoOfRxPduInfoIndStartIdxOfRxPduInfoType 0 0 0 255 ECU_ADDRESS 0x0 /end MEASUREMENT
/begin MEASUREMENT Com_RxPduInfo[20].MainFunctionRxStructIdxOfRxPduInfo "" UBYTE Com_MainFunctionRxStructIdxOfRxPduInfoType 0 0 0 255 ECU_ADDRESS 0x0 /end MEASUREMENT
/begin MEASUREMENT Com_RxPduInfo[20].RxAccessInfoIndEndIdxOfRxPduInfo "" UWORD Com_RxAccessInfoIndEndIdxOfRxPduInfoType 0 0 0 65535 ECU_ADDRESS 0x0 /end MEASUREMENT
/begin MEASUREMENT Com_RxPduInfo[20].RxAccessInfoIndStartIdxOfRxPduInfo "" UWORD Com_RxAccessInfoIndStartIdxOfRxPduInfoType 0 0 0 65535 ECU_ADDRESS 0x0 /end MEASUREMENT
/begin MEASUREMENT Com_RxPduInfo[20].RxDefPduBufferEndIdxOfRxPduInfo "" UWORD Com_RxDefPduBufferEndIdxOfRxPduInfoType 0 0 0 65535 ECU_ADDRESS 0x0 /end MEASUREMENT
/begin MEASUREMENT Com_RxPduInfo[20].RxDefPduBufferStartIdxOfRxPduInfo "" UWORD Com_RxDefPduBufferStartIdxOfRxPduInfoType 0 0 0 65535 ECU_ADDRESS 0x0 /end MEASUREMENT
/begin MEASUREMENT Com_RxPduInfo[20].RxPduCalloutFuncPtrIdxOfRxPduInfo "" UBYTE Com_RxPduCalloutFuncPtrIdxOfRxPduInfoType 0 0 0 255 ECU_ADDRESS 0x0 /end MEASUREMENT
/begin MEASUREMENT Com_RxPduInfo[20].RxSigGrpInfoIndEndIdxOfRxPduInfo "" UBYTE Com_RxSigGrpInfoIndEndIdxOfRxPduInfoType 0 0 0 255 ECU_ADDRESS 0x0 /end MEASUREMENT
/begin MEASUREMENT Com_RxPduInfo[20].RxSigGrpInfoIndStartIdxOfRxPduInfo "" UBYTE Com_RxSigGrpInfoIndStartIdxOfRxPduInfoType 0 0 0 255 ECU_ADDRESS 0x0 /end MEASUREMENT
/begin MEASUREMENT Com_RxPduInfo[20].RxSigInfoEndIdxOfRxPduInfo "" UWORD Com_RxSigInfoEndIdxOfRxPduInfoType 0 0 0 65535 ECU_ADDRESS 0x0 /end MEASUREMENT
/begin MEASUREMENT Com_RxPduInfo[20].RxSigInfoStartIdxOfRxPduInfo "" UWORD Com_RxSigInfoStartIdxOfRxPduInfoType 0 0 0 65535 ECU_ADDRESS 0x0 /end MEASUREMENT
/begin MEASUREMENT Com_RxPduInfo[20].RxTOutInfoIdxOfRxPduInfo "" UBYTE Com_RxTOutInfoIdxOfRxPduInfoType 0 0 0 255 ECU_ADDRESS 0x0 /end MEASUREMENT
/begin MEASUREMENT Com_RxPduInfo[20].RxTOutInfoIndEndIdxOfRxPduInfo "" UBYTE Com_RxTOutInfoIndEndIdxOfRxPduInfoType 0 0 0 255 ECU_ADDRESS 0x0 /end MEASUREMENT
/begin MEASUREMENT Com_RxPduInfo[20].RxTOutInfoIndStartIdxOfRxPduInfo "" UBYTE Com_RxTOutInfoIndStartIdxOfRxPduInfoType 0 0 0 255 ECU_ADDRESS 0x0 /end MEASUREMENT
/begin MEASUREMENT Com_RxPduInfo[21].HandleRxPduDeferredIdxOfRxPduInfo "" UBYTE Com_HandleRxPduDeferredIdxOfRxPduInfoType 0 0 0 255 ECU_ADDRESS 0x0 /end MEASUREMENT
/begin MEASUREMENT Com_RxPduInfo[21].IPduGroupInfoOfRxPduInfoIndEndIdxOfRxPduInfo "" UBYTE Com_IPduGroupInfoOfRxPduInfoIndEndIdxOfRxPduInfoType 0 0 0 255 ECU_ADDRESS 0x0 /end MEASUREMENT
/begin MEASUREMENT Com_RxPduInfo[21].IPduGroupInfoOfRxPduInfoIndStartIdxOfRxPduInfo "" UBYTE Com_IPduGroupInfoOfRxPduInfoIndStartIdxOfRxPduInfoType 0 0 0 255 ECU_ADDRESS 0x0 /end MEASUREMENT
/begin MEASUREMENT Com_RxPduInfo[21].MainFunctionRxStructIdxOfRxPduInfo "" UBYTE Com_MainFunctionRxStructIdxOfRxPduInfoType 0 0 0 255 ECU_ADDRESS 0x0 /end MEASUREMENT
/begin MEASUREMENT Com_RxPduInfo[21].RxAccessInfoIndEndIdxOfRxPduInfo "" UWORD Com_RxAccessInfoIndEndIdxOfRxPduInfoType 0 0 0 65535 ECU_ADDRESS 0x0 /end MEASUREMENT
/begin MEASUREMENT Com_RxPduInfo[21].RxAccessInfoIndStartIdxOfRxPduInfo "" UWORD Com_RxAccessInfoIndStartIdxOfRxPduInfoType 0 0 0 65535 ECU_ADDRESS 0x0 /end MEASUREMENT
/begin MEASUREMENT Com_RxPduInfo[21].RxDefPduBufferEndIdxOfRxPduInfo "" UWORD Com_RxDefPduBufferEndIdxOfRxPduInfoType 0 0 0 65535 ECU_ADDRESS 0x0 /end MEASUREMENT
/begin MEASUREMENT Com_RxPduInfo[21].RxDefPduBufferStartIdxOfRxPduInfo "" UWORD Com_RxDefPduBufferStartIdxOfRxPduInfoType 0 0 0 65535 ECU_ADDRESS 0x0 /end MEASUREMENT
/begin MEASUREMENT Com_RxPduInfo[21].RxPduCalloutFuncPtrIdxOfRxPduInfo "" UBYTE Com_RxPduCalloutFuncPtrIdxOfRxPduInfoType 0 0 0 255 ECU_ADDRESS 0x0 /end MEASUREMENT
/begin MEASUREMENT Com_RxPduInfo[21].RxSigGrpInfoIndEndIdxOfRxPduInfo "" UBYTE Com_RxSigGrpInfoIndEndIdxOfRxPduInfoType 0 0 0 255 ECU_ADDRESS 0x0 /end MEASUREMENT
/begin MEASUREMENT Com_RxPduInfo[21].RxSigGrpInfoIndStartIdxOfRxPduInfo "" UBYTE Com_RxSigGrpInfoIndStartIdxOfRxPduInfoType 0 0 0 255 ECU_ADDRESS 0x0 /end MEASUREMENT
/begin MEASUREMENT Com_RxPduInfo[21].RxSigInfoEndIdxOfRxPduInfo "" UWORD Com_RxSigInfoEndIdxOfRxPduInfoType 0 0 0 65535 ECU_ADDRESS 0x0 /end MEASUREMENT
/begin MEASUREMENT Com_RxPduInfo[21].RxSigInfoStartIdxOfRxPduInfo "" UWORD Com_RxSigInfoStartIdxOfRxPduInfoType 0 0 0 65535 ECU_ADDRESS 0x0 /end MEASUREMENT
/begin MEASUREMENT Com_RxPduInfo[21].RxTOutInfoIdxOfRxPduInfo "" UBYTE Com_RxTOutInfoIdxOfRxPduInfoType 0 0 0 255 ECU_ADDRESS 0x0 /end MEASUREMENT
/begin MEASUREMENT Com_RxPduInfo[21].RxTOutInfoIndEndIdxOfRxPduInfo "" UBYTE Com_RxTOutInfoIndEndIdxOfRxPduInfoType 0 0 0 255 ECU_ADDRESS 0x0 /end MEASUREMENT
/begin MEASUREMENT Com_RxPduInfo[21].RxTOutInfoIndStartIdxOfRxPduInfo "" UBYTE Com_RxTOutInfoIndStartIdxOfRxPduInfoType 0 0 0 255 ECU_ADDRESS 0x0 /end MEASUREMENT
/begin MEASUREMENT Com_RxPduInfo[22].HandleRxPduDeferredIdxOfRxPduInfo "" UBYTE Com_HandleRxPduDeferredIdxOfRxPduInfoType 0 0 0 255 ECU_ADDRESS 0x0 /end MEASUREMENT
/begin MEASUREMENT Com_RxPduInfo[22].IPduGroupInfoOfRxPduInfoIndEndIdxOfRxPduInfo "" UBYTE Com_IPduGroupInfoOfRxPduInfoIndEndIdxOfRxPduInfoType 0 0 0 255 ECU_ADDRESS 0x0 /end MEASUREMENT
/begin MEASUREMENT Com_RxPduInfo[22].IPduGroupInfoOfRxPduInfoIndStartIdxOfRxPduInfo "" UBYTE Com_IPduGroupInfoOfRxPduInfoIndStartIdxOfRxPduInfoType 0 0 0 255 ECU_ADDRESS 0x0 /end MEASUREMENT
/begin MEASUREMENT Com_RxPduInfo[22].MainFunctionRxStructIdxOfRxPduInfo "" UBYTE Com_MainFunctionRxStructIdxOfRxPduInfoType 0 0 0 255 ECU_ADDRESS 0x0 /end MEASUREMENT
/begin MEASUREMENT Com_RxPduInfo[22].RxAccessInfoIndEndIdxOfRxPduInfo "" UWORD Com_RxAccessInfoIndEndIdxOfRxPduInfoType 0 0 0 65535 ECU_ADDRESS 0x0 /end MEASUREMENT
/begin MEASUREMENT Com_RxPduInfo[22].RxAccessInfoIndStartIdxOfRxPduInfo "" UWORD Com_RxAccessInfoIndStartIdxOfRxPduInfoType 0 0 0 65535 ECU_ADDRESS 0x0 /end MEASUREMENT
/begin MEASUREMENT Com_RxPduInfo[22].RxDefPduBufferEndIdxOfRxPduInfo "" UWORD Com_RxDefPduBufferEndIdxOfRxPduInfoType 0 0 0 65535 ECU_ADDRESS 0x0 /end MEASUREMENT
/begin MEASUREMENT Com_RxPduInfo[22].RxDefPduBufferStartIdxOfRxPduInfo "" UWORD Com_RxDefPduBufferStartIdxOfRxPduInfoType 0 0 0 65535 ECU_ADDRESS 0x0 /end MEASUREMENT
/begin MEASUREMENT Com_RxPduInfo[22].RxPduCalloutFuncPtrIdxOfRxPduInfo "" UBYTE Com_RxPduCalloutFuncPtrIdxOfRxPduInfoType 0 0 0 255 ECU_ADDRESS 0x0 /end MEASUREMENT
/begin MEASUREMENT Com_RxPduInfo[22].RxSigGrpInfoIndEndIdxOfRxPduInfo "" UBYTE Com_RxSigGrpInfoIndEndIdxOfRxPduInfoType 0 0 0 255 ECU_ADDRESS 0x0 /end MEASUREMENT
/begin MEASUREMENT Com_RxPduInfo[22].RxSigGrpInfoIndStartIdxOfRxPduInfo "" UBYTE Com_RxSigGrpInfoIndStartIdxOfRxPduInfoType 0 0 0 255 ECU_ADDRESS 0x0 /end MEASUREMENT
/begin MEASUREMENT Com_RxPduInfo[22].RxSigInfoEndIdxOfRxPduInfo "" UWORD Com_RxSigInfoEndIdxOfRxPduInfoType 0 0 0 65535 ECU_ADDRESS 0x0 /end MEASUREMENT
/begin MEASUREMENT Com_RxPduInfo[22].RxSigInfoStartIdxOfRxPduInfo "" UWORD Com_RxSigInfoStartIdxOfRxPduInfoType 0 0 0 65535 ECU_ADDRESS 0x0 /end MEASUREMENT
/begin MEASUREMENT Com_RxPduInfo[22].RxTOutInfoIdxOfRxPduInfo "" UBYTE Com_RxTOutInfoIdxOfRxPduInfoType 0 0 0 255 ECU_ADDRESS 0x0 /end MEASUREMENT
/begin MEASUREMENT Com_RxPduInfo[22].RxTOutInfoIndEndIdxOfRxPduInfo "" UBYTE Com_RxTOutInfoIndEndIdxOfRxPduInfoType 0 0 0 255 ECU_ADDRESS 0x0 /end MEASUREMENT
/begin MEASUREMENT Com_RxPduInfo[22].RxTOutInfoIndStartIdxOfRxPduInfo "" UBYTE Com_RxTOutInfoIndStartIdxOfRxPduInfoType 0 0 0 255 ECU_ADDRESS 0x0 /end MEASUREMENT
/begin MEASUREMENT Com_RxPduInfo[23].HandleRxPduDeferredIdxOfRxPduInfo "" UBYTE Com_HandleRxPduDeferredIdxOfRxPduInfoType 0 0 0 255 ECU_ADDRESS 0x0 /end MEASUREMENT
/begin MEASUREMENT Com_RxPduInfo[23].IPduGroupInfoOfRxPduInfoIndEndIdxOfRxPduInfo "" UBYTE Com_IPduGroupInfoOfRxPduInfoIndEndIdxOfRxPduInfoType 0 0 0 255 ECU_ADDRESS 0x0 /end MEASUREMENT
/begin MEASUREMENT Com_RxPduInfo[23].IPduGroupInfoOfRxPduInfoIndStartIdxOfRxPduInfo "" UBYTE Com_IPduGroupInfoOfRxPduInfoIndStartIdxOfRxPduInfoType 0 0 0 255 ECU_ADDRESS 0x0 /end MEASUREMENT
/begin MEASUREMENT Com_RxPduInfo[23].MainFunctionRxStructIdxOfRxPduInfo "" UBYTE Com_MainFunctionRxStructIdxOfRxPduInfoType 0 0 0 255 ECU_ADDRESS 0x0 /end MEASUREMENT
/begin MEASUREMENT Com_RxPduInfo[23].RxAccessInfoIndEndIdxOfRxPduInfo "" UWORD Com_RxAccessInfoIndEndIdxOfRxPduInfoType 0 0 0 65535 ECU_ADDRESS 0x0 /end MEASUREMENT
/begin MEASUREMENT Com_RxPduInfo[23].RxAccessInfoIndStartIdxOfRxPduInfo "" UWORD Com_RxAccessInfoIndStartIdxOfRxPduInfoType 0 0 0 65535 ECU_ADDRESS 0x0 /end MEASUREMENT
/begin MEASUREMENT Com_RxPduInfo[23].RxDefPduBufferEndIdxOfRxPduInfo "" UWORD Com_RxDefPduBufferEndIdxOfRxPduInfoType 0 0 0 65535 ECU_ADDRESS 0x0 /end MEASUREMENT
/begin MEASUREMENT Com_RxPduInfo[23].RxDefPduBufferStartIdxOfRxPduInfo "" UWORD Com_RxDefPduBufferStartIdxOfRxPduInfoType 0 0 0 65535 ECU_ADDRESS 0x0 /end MEASUREMENT
/begin MEASUREMENT Com_RxPduInfo[23].RxPduCalloutFuncPtrIdxOfRxPduInfo "" UBYTE Com_RxPduCalloutFuncPtrIdxOfRxPduInfoType 0 0 0 255 ECU_ADDRESS 0x0 /end MEASUREMENT
/begin MEASUREMENT Com_RxPduInfo[23].RxSigGrpInfoIndEndIdxOfRxPduInfo "" UBYTE Com_RxSigGrpInfoIndEndIdxOfRxPduInfoType 0 0 0 255 ECU_ADDRESS 0x0 /end MEASUREMENT
/begin MEASUREMENT Com_RxPduInfo[23].RxSigGrpInfoIndStartIdxOfRxPduInfo "" UBYTE Com_RxSigGrpInfoIndStartIdxOfRxPduInfoType 0 0 0 255 ECU_ADDRESS 0x0 /end MEASUREMENT
/begin MEASUREMENT Com_RxPduInfo[23].RxSigInfoEndIdxOfRxPduInfo "" UWORD Com_RxSigInfoEndIdxOfRxPduInfoType 0 0 0 65535 ECU_ADDRESS 0x0 /end MEASUREMENT
/begin MEASUREMENT Com_RxPduInfo[23].RxSigInfoStartIdxOfRxPduInfo "" UWORD Com_RxSigInfoStartIdxOfRxPduInfoType 0 0 0 65535 ECU_ADDRESS 0x0 /end MEASUREMENT
/begin MEASUREMENT Com_RxPduInfo[23].RxTOutInfoIdxOfRxPduInfo "" UBYTE Com_RxTOutInfoIdxOfRxPduInfoType 0 0 0 255 ECU_ADDRESS 0x0 /end MEASUREMENT
/begin MEASUREMENT Com_RxPduInfo[23].RxTOutInfoIndEndIdxOfRxPduInfo "" UBYTE Com_RxTOutInfoIndEndIdxOfRxPduInfoType 0 0 0 255 ECU_ADDRESS 0x0 /end MEASUREMENT
/begin MEASUREMENT Com_RxPduInfo[23].RxTOutInfoIndStartIdxOfRxPduInfo "" UBYTE Com_RxTOutInfoIndStartIdxOfRxPduInfoType 0 0 0 255 ECU_ADDRESS 0x0 /end MEASUREMENT
/begin MEASUREMENT Com_RxPduInfo[24].HandleRxPduDeferredIdxOfRxPduInfo "" UBYTE Com_HandleRxPduDeferredIdxOfRxPduInfoType 0 0 0 255 ECU_ADDRESS 0x0 /end MEASUREMENT
/begin MEASUREMENT Com_RxPduInfo[24].IPduGroupInfoOfRxPduInfoIndEndIdxOfRxPduInfo "" UBYTE Com_IPduGroupInfoOfRxPduInfoIndEndIdxOfRxPduInfoType 0 0 0 255 ECU_ADDRESS 0x0 /end MEASUREMENT
/begin MEASUREMENT Com_RxPduInfo[24].IPduGroupInfoOfRxPduInfoIndStartIdxOfRxPduInfo "" UBYTE Com_IPduGroupInfoOfRxPduInfoIndStartIdxOfRxPduInfoType 0 0 0 255 ECU_ADDRESS 0x0 /end MEASUREMENT
/begin MEASUREMENT Com_RxPduInfo[24].MainFunctionRxStructIdxOfRxPduInfo "" UBYTE Com_MainFunctionRxStructIdxOfRxPduInfoType 0 0 0 255 ECU_ADDRESS 0x0 /end MEASUREMENT
/begin MEASUREMENT Com_RxPduInfo[24].RxAccessInfoIndEndIdxOfRxPduInfo "" UWORD Com_RxAccessInfoIndEndIdxOfRxPduInfoType 0 0 0 65535 ECU_ADDRESS 0x0 /end MEASUREMENT
/begin MEASUREMENT Com_RxPduInfo[24].RxAccessInfoIndStartIdxOfRxPduInfo "" UWORD Com_RxAccessInfoIndStartIdxOfRxPduInfoType 0 0 0 65535 ECU_ADDRESS 0x0 /end MEASUREMENT
/begin MEASUREMENT Com_RxPduInfo[24].RxDefPduBufferEndIdxOfRxPduInfo "" UWORD Com_RxDefPduBufferEndIdxOfRxPduInfoType 0 0 0 65535 ECU_ADDRESS 0x0 /end MEASUREMENT
/begin MEASUREMENT Com_RxPduInfo[24].RxDefPduBufferStartIdxOfRxPduInfo "" UWORD Com_RxDefPduBufferStartIdxOfRxPduInfoType 0 0 0 65535 ECU_ADDRESS 0x0 /end MEASUREMENT
/begin MEASUREMENT Com_RxPduInfo[24].RxPduCalloutFuncPtrIdxOfRxPduInfo "" UBYTE Com_RxPduCalloutFuncPtrIdxOfRxPduInfoType 0 0 0 255 ECU_ADDRESS 0x0 /end MEASUREMENT
/begin MEASUREMENT Com_RxPduInfo[24].RxSigGrpInfoIndEndIdxOfRxPduInfo "" UBYTE Com_RxSigGrpInfoIndEndIdxOfRxPduInfoType 0 0 0 255 ECU_ADDRESS 0x0 /end MEASUREMENT
/begin MEASUREMENT Com_RxPduInfo[24].RxSigGrpInfoIndStartIdxOfRxPduInfo "" UBYTE Com_RxSigGrpInfoIndStartIdxOfRxPduInfoType 0 0 0 255 ECU_ADDRESS 0x0 /end MEASUREMENT
/begin MEASUREMENT Com_RxPduInfo[24].RxSigInfoEndIdxOfRxPduInfo "" UWORD Com_RxSigInfoEndIdxOfRxPduInfoType 0 0 0 65535 ECU_ADDRESS 0x0 /end MEASUREMENT
/begin MEASUREMENT Com_RxPduInfo[24].RxSigInfoStartIdxOfRxPduInfo "" UWORD Com_RxSigInfoStartIdxOfRxPduInfoType 0 0 0 65535 ECU_ADDRESS 0x0 /end MEASUREMENT
/begin MEASUREMENT Com_RxPduInfo[24].RxTOutInfoIdxOfRxPduInfo "" UBYTE Com_RxTOutInfoIdxOfRxPduInfoType 0 0 0 255 ECU_ADDRESS 0x0 /end MEASUREMENT
/begin MEASUREMENT Com_RxPduInfo[24].RxTOutInfoIndEndIdxOfRxPduInfo "" UBYTE Com_RxTOutInfoIndEndIdxOfRxPduInfoType 0 0 0 255 ECU_ADDRESS 0x0 /end MEASUREMENT
/begin MEASUREMENT Com_RxPduInfo[24].RxTOutInfoIndStartIdxOfRxPduInfo "" UBYTE Com_RxTOutInfoIndStartIdxOfRxPduInfoType 0 0 0 255 ECU_ADDRESS 0x0 /end MEASUREMENT
/begin MEASUREMENT Com_RxPduInfo[25].HandleRxPduDeferredIdxOfRxPduInfo "" UBYTE Com_HandleRxPduDeferredIdxOfRxPduInfoType 0 0 0 255 ECU_ADDRESS 0x0 /end MEASUREMENT
/begin MEASUREMENT Com_RxPduInfo[25].IPduGroupInfoOfRxPduInfoIndEndIdxOfRxPduInfo "" UBYTE Com_IPduGroupInfoOfRxPduInfoIndEndIdxOfRxPduInfoType 0 0 0 255 ECU_ADDRESS 0x0 /end MEASUREMENT
/begin MEASUREMENT Com_RxPduInfo[25].IPduGroupInfoOfRxPduInfoIndStartIdxOfRxPduInfo "" UBYTE Com_IPduGroupInfoOfRxPduInfoIndStartIdxOfRxPduInfoType 0 0 0 255 ECU_ADDRESS 0x0 /end MEASUREMENT
/begin MEASUREMENT Com_RxPduInfo[25].MainFunctionRxStructIdxOfRxPduInfo "" UBYTE Com_MainFunctionRxStructIdxOfRxPduInfoType 0 0 0 255 ECU_ADDRESS 0x0 /end MEASUREMENT
/begin MEASUREMENT Com_RxPduInfo[25].RxAccessInfoIndEndIdxOfRxPduInfo "" UWORD Com_RxAccessInfoIndEndIdxOfRxPduInfoType 0 0 0 65535 ECU_ADDRESS 0x0 /end MEASUREMENT
/begin MEASUREMENT Com_RxPduInfo[25].RxAccessInfoIndStartIdxOfRxPduInfo "" UWORD Com_RxAccessInfoIndStartIdxOfRxPduInfoType 0 0 0 65535 ECU_ADDRESS 0x0 /end MEASUREMENT
/begin MEASUREMENT Com_RxPduInfo[25].RxDefPduBufferEndIdxOfRxPduInfo "" UWORD Com_RxDefPduBufferEndIdxOfRxPduInfoType 0 0 0 65535 ECU_ADDRESS 0x0 /end MEASUREMENT
/begin MEASUREMENT Com_RxPduInfo[25].RxDefPduBufferStartIdxOfRxPduInfo "" UWORD Com_RxDefPduBufferStartIdxOfRxPduInfoType 0 0 0 65535 ECU_ADDRESS 0x0 /end MEASUREMENT
/begin MEASUREMENT Com_RxPduInfo[25].RxPduCalloutFuncPtrIdxOfRxPduInfo "" UBYTE Com_RxPduCalloutFuncPtrIdxOfRxPduInfoType 0 0 0 255 ECU_ADDRESS 0x0 /end MEASUREMENT
/begin MEASUREMENT Com_RxPduInfo[25].RxSigGrpInfoIndEndIdxOfRxPduInfo "" UBYTE Com_RxSigGrpInfoIndEndIdxOfRxPduInfoType 0 0 0 255 ECU_ADDRESS 0x0 /end MEASUREMENT
/begin MEASUREMENT Com_RxPduInfo[25].RxSigGrpInfoIndStartIdxOfRxPduInfo "" UBYTE Com_RxSigGrpInfoIndStartIdxOfRxPduInfoType 0 0 0 255 ECU_ADDRESS 0x0 /end MEASUREMENT
/begin MEASUREMENT Com_RxPduInfo[25].RxSigInfoEndIdxOfRxPduInfo "" UWORD Com_RxSigInfoEndIdxOfRxPduInfoType 0 0 0 65535 ECU_ADDRESS 0x0 /end MEASUREMENT
/begin MEASUREMENT Com_RxPduInfo[25].RxSigInfoStartIdxOfRxPduInfo "" UWORD Com_RxSigInfoStartIdxOfRxPduInfoType 0 0 0 65535 ECU_ADDRESS 0x0 /end MEASUREMENT
/begin MEASUREMENT Com_RxPduInfo[25].RxTOutInfoIdxOfRxPduInfo "" UBYTE Com_RxTOutInfoIdxOfRxPduInfoType 0 0 0 255 ECU_ADDRESS 0x0 /end MEASUREMENT
/begin MEASUREMENT Com_RxPduInfo[25].RxTOutInfoIndEndIdxOfRxPduInfo "" UBYTE Com_RxTOutInfoIndEndIdxOfRxPduInfoType 0 0 0 255 ECU_ADDRESS 0x0 /end MEASUREMENT
/begin MEASUREMENT Com_RxPduInfo[25].RxTOutInfoIndStartIdxOfRxPduInfo "" UBYTE Com_RxTOutInfoIndStartIdxOfRxPduInfoType 0 0 0 255 ECU_ADDRESS 0x0 /end MEASUREMENT
/begin MEASUREMENT Com_RxPduInfo[26].HandleRxPduDeferredIdxOfRxPduInfo "" UBYTE Com_HandleRxPduDeferredIdxOfRxPduInfoType 0 0 0 255 ECU_ADDRESS 0x0 /end MEASUREMENT
/begin MEASUREMENT Com_RxPduInfo[26].IPduGroupInfoOfRxPduInfoIndEndIdxOfRxPduInfo "" UBYTE Com_IPduGroupInfoOfRxPduInfoIndEndIdxOfRxPduInfoType 0 0 0 255 ECU_ADDRESS 0x0 /end MEASUREMENT
/begin MEASUREMENT Com_RxPduInfo[26].IPduGroupInfoOfRxPduInfoIndStartIdxOfRxPduInfo "" UBYTE Com_IPduGroupInfoOfRxPduInfoIndStartIdxOfRxPduInfoType 0 0 0 255 ECU_ADDRESS 0x0 /end MEASUREMENT
/begin MEASUREMENT Com_RxPduInfo[26].MainFunctionRxStructIdxOfRxPduInfo "" UBYTE Com_MainFunctionRxStructIdxOfRxPduInfoType 0 0 0 255 ECU_ADDRESS 0x0 /end MEASUREMENT
/begin MEASUREMENT Com_RxPduInfo[26].RxAccessInfoIndEndIdxOfRxPduInfo "" UWORD Com_RxAccessInfoIndEndIdxOfRxPduInfoType 0 0 0 65535 ECU_ADDRESS 0x0 /end MEASUREMENT
/begin MEASUREMENT Com_RxPduInfo[26].RxAccessInfoIndStartIdxOfRxPduInfo "" UWORD Com_RxAccessInfoIndStartIdxOfRxPduInfoType 0 0 0 65535 ECU_ADDRESS 0x0 /end MEASUREMENT
/begin MEASUREMENT Com_RxPduInfo[26].RxDefPduBufferEndIdxOfRxPduInfo "" UWORD Com_RxDefPduBufferEndIdxOfRxPduInfoType 0 0 0 65535 ECU_ADDRESS 0x0 /end MEASUREMENT
/begin MEASUREMENT Com_RxPduInfo[26].RxDefPduBufferStartIdxOfRxPduInfo "" UWORD Com_RxDefPduBufferStartIdxOfRxPduInfoType 0 0 0 65535 ECU_ADDRESS 0x0 /end MEASUREMENT
/begin MEASUREMENT Com_RxPduInfo[26].RxPduCalloutFuncPtrIdxOfRxPduInfo "" UBYTE Com_RxPduCalloutFuncPtrIdxOfRxPduInfoType 0 0 0 255 ECU_ADDRESS 0x0 /end MEASUREMENT
/begin MEASUREMENT Com_RxPduInfo[26].RxSigGrpInfoIndEndIdxOfRxPduInfo "" UBYTE Com_RxSigGrpInfoIndEndIdxOfRxPduInfoType 0 0 0 255 ECU_ADDRESS 0x0 /end MEASUREMENT
/begin MEASUREMENT Com_RxPduInfo[26].RxSigGrpInfoIndStartIdxOfRxPduInfo "" UBYTE Com_RxSigGrpInfoIndStartIdxOfRxPduInfoType 0 0 0 255 ECU_ADDRESS 0x0 /end MEASUREMENT
/begin MEASUREMENT Com_RxPduInfo[26].RxSigInfoEndIdxOfRxPduInfo "" UWORD Com_RxSigInfoEndIdxOfRxPduInfoType 0 0 0 65535 ECU_ADDRESS 0x0 /end MEASUREMENT
/begin MEASUREMENT Com_RxPduInfo[26].RxSigInfoStartIdxOfRxPduInfo "" UWORD Com_RxSigInfoStartIdxOfRxPduInfoType 0 0 0 65535 ECU_ADDRESS 0x0 /end MEASUREMENT
/begin MEASUREMENT Com_RxPduInfo[26].RxTOutInfoIdxOfRxPduInfo "" UBYTE Com_RxTOutInfoIdxOfRxPduInfoType 0 0 0 255 ECU_ADDRESS 0x0 /end MEASUREMENT
/begin MEASUREMENT Com_RxPduInfo[26].RxTOutInfoIndEndIdxOfRxPduInfo "" UBYTE Com_RxTOutInfoIndEndIdxOfRxPduInfoType 0 0 0 255 ECU_ADDRESS 0x0 /end MEASUREMENT
/begin MEASUREMENT Com_RxPduInfo[26].RxTOutInfoIndStartIdxOfRxPduInfo "" UBYTE Com_RxTOutInfoIndStartIdxOfRxPduInfoType 0 0 0 255 ECU_ADDRESS 0x0 /end MEASUREMENT
/begin MEASUREMENT Com_RxPduInfo[27].HandleRxPduDeferredIdxOfRxPduInfo "" UBYTE Com_HandleRxPduDeferredIdxOfRxPduInfoType 0 0 0 255 ECU_ADDRESS 0x0 /end MEASUREMENT
/begin MEASUREMENT Com_RxPduInfo[27].IPduGroupInfoOfRxPduInfoIndEndIdxOfRxPduInfo "" UBYTE Com_IPduGroupInfoOfRxPduInfoIndEndIdxOfRxPduInfoType 0 0 0 255 ECU_ADDRESS 0x0 /end MEASUREMENT
/begin MEASUREMENT Com_RxPduInfo[27].IPduGroupInfoOfRxPduInfoIndStartIdxOfRxPduInfo "" UBYTE Com_IPduGroupInfoOfRxPduInfoIndStartIdxOfRxPduInfoType 0 0 0 255 ECU_ADDRESS 0x0 /end MEASUREMENT
/begin MEASUREMENT Com_RxPduInfo[27].MainFunctionRxStructIdxOfRxPduInfo "" UBYTE Com_MainFunctionRxStructIdxOfRxPduInfoType 0 0 0 255 ECU_ADDRESS 0x0 /end MEASUREMENT
/begin MEASUREMENT Com_RxPduInfo[27].RxAccessInfoIndEndIdxOfRxPduInfo "" UWORD Com_RxAccessInfoIndEndIdxOfRxPduInfoType 0 0 0 65535 ECU_ADDRESS 0x0 /end MEASUREMENT
/begin MEASUREMENT Com_RxPduInfo[27].RxAccessInfoIndStartIdxOfRxPduInfo "" UWORD Com_RxAccessInfoIndStartIdxOfRxPduInfoType 0 0 0 65535 ECU_ADDRESS 0x0 /end MEASUREMENT
/begin MEASUREMENT Com_RxPduInfo[27].RxDefPduBufferEndIdxOfRxPduInfo "" UWORD Com_RxDefPduBufferEndIdxOfRxPduInfoType 0 0 0 65535 ECU_ADDRESS 0x0 /end MEASUREMENT
/begin MEASUREMENT Com_RxPduInfo[27].RxDefPduBufferStartIdxOfRxPduInfo "" UWORD Com_RxDefPduBufferStartIdxOfRxPduInfoType 0 0 0 65535 ECU_ADDRESS 0x0 /end MEASUREMENT
/begin MEASUREMENT Com_RxPduInfo[27].RxPduCalloutFuncPtrIdxOfRxPduInfo "" UBYTE Com_RxPduCalloutFuncPtrIdxOfRxPduInfoType 0 0 0 255 ECU_ADDRESS 0x0 /end MEASUREMENT
/begin MEASUREMENT Com_RxPduInfo[27].RxSigGrpInfoIndEndIdxOfRxPduInfo "" UBYTE Com_RxSigGrpInfoIndEndIdxOfRxPduInfoType 0 0 0 255 ECU_ADDRESS 0x0 /end MEASUREMENT
/begin MEASUREMENT Com_RxPduInfo[27].RxSigGrpInfoIndStartIdxOfRxPduInfo "" UBYTE Com_RxSigGrpInfoIndStartIdxOfRxPduInfoType 0 0 0 255 ECU_ADDRESS 0x0 /end MEASUREMENT
/begin MEASUREMENT Com_RxPduInfo[27].RxSigInfoEndIdxOfRxPduInfo "" UWORD Com_RxSigInfoEndIdxOfRxPduInfoType 0 0 0 65535 ECU_ADDRESS 0x0 /end MEASUREMENT
/begin MEASUREMENT Com_RxPduInfo[27].RxSigInfoStartIdxOfRxPduInfo "" UWORD Com_RxSigInfoStartIdxOfRxPduInfoType 0 0 0 65535 ECU_ADDRESS 0x0 /end MEASUREMENT
/begin MEASUREMENT Com_RxPduInfo[27].RxTOutInfoIdxOfRxPduInfo "" UBYTE Com_RxTOutInfoIdxOfRxPduInfoType 0 0 0 255 ECU_ADDRESS 0x0 /end MEASUREMENT
/begin MEASUREMENT Com_RxPduInfo[27].RxTOutInfoIndEndIdxOfRxPduInfo "" UBYTE Com_RxTOutInfoIndEndIdxOfRxPduInfoType 0 0 0 255 ECU_ADDRESS 0x0 /end MEASUREMENT
/begin MEASUREMENT Com_RxPduInfo[27].RxTOutInfoIndStartIdxOfRxPduInfo "" UBYTE Com_RxTOutInfoIndStartIdxOfRxPduInfoType 0 0 0 255 ECU_ADDRESS 0x0 /end MEASUREMENT
/begin MEASUREMENT Com_RxPduInfo[28].HandleRxPduDeferredIdxOfRxPduInfo "" UBYTE Com_HandleRxPduDeferredIdxOfRxPduInfoType 0 0 0 255 ECU_ADDRESS 0x0 /end MEASUREMENT
/begin MEASUREMENT Com_RxPduInfo[28].IPduGroupInfoOfRxPduInfoIndEndIdxOfRxPduInfo "" UBYTE Com_IPduGroupInfoOfRxPduInfoIndEndIdxOfRxPduInfoType 0 0 0 255 ECU_ADDRESS 0x0 /end MEASUREMENT
/begin MEASUREMENT Com_RxPduInfo[28].IPduGroupInfoOfRxPduInfoIndStartIdxOfRxPduInfo "" UBYTE Com_IPduGroupInfoOfRxPduInfoIndStartIdxOfRxPduInfoType 0 0 0 255 ECU_ADDRESS 0x0 /end MEASUREMENT
/begin MEASUREMENT Com_RxPduInfo[28].MainFunctionRxStructIdxOfRxPduInfo "" UBYTE Com_MainFunctionRxStructIdxOfRxPduInfoType 0 0 0 255 ECU_ADDRESS 0x0 /end MEASUREMENT
/begin MEASUREMENT Com_RxPduInfo[28].RxAccessInfoIndEndIdxOfRxPduInfo "" UWORD Com_RxAccessInfoIndEndIdxOfRxPduInfoType 0 0 0 65535 ECU_ADDRESS 0x0 /end MEASUREMENT
/begin MEASUREMENT Com_RxPduInfo[28].RxAccessInfoIndStartIdxOfRxPduInfo "" UWORD Com_RxAccessInfoIndStartIdxOfRxPduInfoType 0 0 0 65535 ECU_ADDRESS 0x0 /end MEASUREMENT
/begin MEASUREMENT Com_RxPduInfo[28].RxDefPduBufferEndIdxOfRxPduInfo "" UWORD Com_RxDefPduBufferEndIdxOfRxPduInfoType 0 0 0 65535 ECU_ADDRESS 0x0 /end MEASUREMENT
/begin MEASUREMENT Com_RxPduInfo[28].RxDefPduBufferStartIdxOfRxPduInfo "" UWORD Com_RxDefPduBufferStartIdxOfRxPduInfoType 0 0 0 65535 ECU_ADDRESS 0x0 /end MEASUREMENT
/begin MEASUREMENT Com_RxPduInfo[28].RxPduCalloutFuncPtrIdxOfRxPduInfo "" UBYTE Com_RxPduCalloutFuncPtrIdxOfRxPduInfoType 0 0 0 255 ECU_ADDRESS 0x0 /end MEASUREMENT
/begin MEASUREMENT Com_RxPduInfo[28].RxSigGrpInfoIndEndIdxOfRxPduInfo "" UBYTE Com_RxSigGrpInfoIndEndIdxOfRxPduInfoType 0 0 0 255 ECU_ADDRESS 0x0 /end MEASUREMENT
/begin MEASUREMENT Com_RxPduInfo[28].RxSigGrpInfoIndStartIdxOfRxPduInfo "" UBYTE Com_RxSigGrpInfoIndStartIdxOfRxPduInfoType 0 0 0 255 ECU_ADDRESS 0x0 /end MEASUREMENT
/begin MEASUREMENT Com_RxPduInfo[28].RxSigInfoEndIdxOfRxPduInfo "" UWORD Com_RxSigInfoEndIdxOfRxPduInfoType 0 0 0 65535 ECU_ADDRESS 0x0 /end MEASUREMENT
/begin MEASUREMENT Com_RxPduInfo[28].RxSigInfoStartIdxOfRxPduInfo "" UWORD Com_RxSigInfoStartIdxOfRxPduInfoType 0 0 0 65535 ECU_ADDRESS 0x0 /end MEASUREMENT
/begin MEASUREMENT Com_RxPduInfo[28].RxTOutInfoIdxOfRxPduInfo "" UBYTE Com_RxTOutInfoIdxOfRxPduInfoType 0 0 0 255 ECU_ADDRESS 0x0 /end MEASUREMENT
/begin MEASUREMENT Com_RxPduInfo[28].RxTOutInfoIndEndIdxOfRxPduInfo "" UBYTE Com_RxTOutInfoIndEndIdxOfRxPduInfoType 0 0 0 255 ECU_ADDRESS 0x0 /end MEASUREMENT
/begin MEASUREMENT Com_RxPduInfo[28].RxTOutInfoIndStartIdxOfRxPduInfo "" UBYTE Com_RxTOutInfoIndStartIdxOfRxPduInfoType 0 0 0 255 ECU_ADDRESS 0x0 /end MEASUREMENT
/begin MEASUREMENT Com_RxPduInfo[29].HandleRxPduDeferredIdxOfRxPduInfo "" UBYTE Com_HandleRxPduDeferredIdxOfRxPduInfoType 0 0 0 255 ECU_ADDRESS 0x0 /end MEASUREMENT
/begin MEASUREMENT Com_RxPduInfo[29].IPduGroupInfoOfRxPduInfoIndEndIdxOfRxPduInfo "" UBYTE Com_IPduGroupInfoOfRxPduInfoIndEndIdxOfRxPduInfoType 0 0 0 255 ECU_ADDRESS 0x0 /end MEASUREMENT
/begin MEASUREMENT Com_RxPduInfo[29].IPduGroupInfoOfRxPduInfoIndStartIdxOfRxPduInfo "" UBYTE Com_IPduGroupInfoOfRxPduInfoIndStartIdxOfRxPduInfoType 0 0 0 255 ECU_ADDRESS 0x0 /end MEASUREMENT
/begin MEASUREMENT Com_RxPduInfo[29].MainFunctionRxStructIdxOfRxPduInfo "" UBYTE Com_MainFunctionRxStructIdxOfRxPduInfoType 0 0 0 255 ECU_ADDRESS 0x0 /end MEASUREMENT
/begin MEASUREMENT Com_RxPduInfo[29].RxAccessInfoIndEndIdxOfRxPduInfo "" UWORD Com_RxAccessInfoIndEndIdxOfRxPduInfoType 0 0 0 65535 ECU_ADDRESS 0x0 /end MEASUREMENT
/begin MEASUREMENT Com_RxPduInfo[29].RxAccessInfoIndStartIdxOfRxPduInfo "" UWORD Com_RxAccessInfoIndStartIdxOfRxPduInfoType 0 0 0 65535 ECU_ADDRESS 0x0 /end MEASUREMENT
/begin MEASUREMENT Com_RxPduInfo[29].RxDefPduBufferEndIdxOfRxPduInfo "" UWORD Com_RxDefPduBufferEndIdxOfRxPduInfoType 0 0 0 65535 ECU_ADDRESS 0x0 /end MEASUREMENT
/begin MEASUREMENT Com_RxPduInfo[29].RxDefPduBufferStartIdxOfRxPduInfo "" UWORD Com_RxDefPduBufferStartIdxOfRxPduInfoType 0 0 0 65535 ECU_ADDRESS 0x0 /end MEASUREMENT
/begin MEASUREMENT Com_RxPduInfo[29].RxPduCalloutFuncPtrIdxOfRxPduInfo "" UBYTE Com_RxPduCalloutFuncPtrIdxOfRxPduInfoType 0 0 0 255 ECU_ADDRESS 0x0 /end MEASUREMENT
/begin MEASUREMENT Com_RxPduInfo[29].RxSigGrpInfoIndEndIdxOfRxPduInfo "" UBYTE Com_RxSigGrpInfoIndEndIdxOfRxPduInfoType 0 0 0 255 ECU_ADDRESS 0x0 /end MEASUREMENT
/begin MEASUREMENT Com_RxPduInfo[29].RxSigGrpInfoIndStartIdxOfRxPduInfo "" UBYTE Com_RxSigGrpInfoIndStartIdxOfRxPduInfoType 0 0 0 255 ECU_ADDRESS 0x0 /end MEASUREMENT
/begin MEASUREMENT Com_RxPduInfo[29].RxSigInfoEndIdxOfRxPduInfo "" UWORD Com_RxSigInfoEndIdxOfRxPduInfoType 0 0 0 65535 ECU_ADDRESS 0x0 /end MEASUREMENT
/begin MEASUREMENT Com_RxPduInfo[29].RxSigInfoStartIdxOfRxPduInfo "" UWORD Com_RxSigInfoStartIdxOfRxPduInfoType 0 0 0 65535 ECU_ADDRESS 0x0 /end MEASUREMENT
/begin MEASUREMENT Com_RxPduInfo[29].RxTOutInfoIdxOfRxPduInfo "" UBYTE Com_RxTOutInfoIdxOfRxPduInfoType 0 0 0 255 ECU_ADDRESS 0x0 /end MEASUREMENT
/begin MEASUREMENT Com_RxPduInfo[29].RxTOutInfoIndEndIdxOfRxPduInfo "" UBYTE Com_RxTOutInfoIndEndIdxOfRxPduInfoType 0 0 0 255 ECU_ADDRESS 0x0 /end MEASUREMENT
/begin MEASUREMENT Com_RxPduInfo[29].RxTOutInfoIndStartIdxOfRxPduInfo "" UBYTE Com_RxTOutInfoIndStartIdxOfRxPduInfoType 0 0 0 255 ECU_ADDRESS 0x0 /end MEASUREMENT
/begin MEASUREMENT Com_RxPduInfo[2].HandleRxPduDeferredIdxOfRxPduInfo "" UBYTE Com_HandleRxPduDeferredIdxOfRxPduInfoType 0 0 0 255 ECU_ADDRESS 0x0 /end MEASUREMENT
/begin MEASUREMENT Com_RxPduInfo[2].IPduGroupInfoOfRxPduInfoIndEndIdxOfRxPduInfo "" UBYTE Com_IPduGroupInfoOfRxPduInfoIndEndIdxOfRxPduInfoType 0 0 0 255 ECU_ADDRESS 0x0 /end MEASUREMENT
/begin MEASUREMENT Com_RxPduInfo[2].IPduGroupInfoOfRxPduInfoIndStartIdxOfRxPduInfo "" UBYTE Com_IPduGroupInfoOfRxPduInfoIndStartIdxOfRxPduInfoType 0 0 0 255 ECU_ADDRESS 0x0 /end MEASUREMENT
/begin MEASUREMENT Com_RxPduInfo[2].MainFunctionRxStructIdxOfRxPduInfo "" UBYTE Com_MainFunctionRxStructIdxOfRxPduInfoType 0 0 0 255 ECU_ADDRESS 0x0 /end MEASUREMENT
/begin MEASUREMENT Com_RxPduInfo[2].RxAccessInfoIndEndIdxOfRxPduInfo "" UWORD Com_RxAccessInfoIndEndIdxOfRxPduInfoType 0 0 0 65535 ECU_ADDRESS 0x0 /end MEASUREMENT
/begin MEASUREMENT Com_RxPduInfo[2].RxAccessInfoIndStartIdxOfRxPduInfo "" UWORD Com_RxAccessInfoIndStartIdxOfRxPduInfoType 0 0 0 65535 ECU_ADDRESS 0x0 /end MEASUREMENT
/begin MEASUREMENT Com_RxPduInfo[2].RxDefPduBufferEndIdxOfRxPduInfo "" UWORD Com_RxDefPduBufferEndIdxOfRxPduInfoType 0 0 0 65535 ECU_ADDRESS 0x0 /end MEASUREMENT
/begin MEASUREMENT Com_RxPduInfo[2].RxDefPduBufferStartIdxOfRxPduInfo "" UWORD Com_RxDefPduBufferStartIdxOfRxPduInfoType 0 0 0 65535 ECU_ADDRESS 0x0 /end MEASUREMENT
/begin MEASUREMENT Com_RxPduInfo[2].RxPduCalloutFuncPtrIdxOfRxPduInfo "" UBYTE Com_RxPduCalloutFuncPtrIdxOfRxPduInfoType 0 0 0 255 ECU_ADDRESS 0x0 /end MEASUREMENT
/begin MEASUREMENT Com_RxPduInfo[2].RxSigGrpInfoIndEndIdxOfRxPduInfo "" UBYTE Com_RxSigGrpInfoIndEndIdxOfRxPduInfoType 0 0 0 255 ECU_ADDRESS 0x0 /end MEASUREMENT
/begin MEASUREMENT Com_RxPduInfo[2].RxSigGrpInfoIndStartIdxOfRxPduInfo "" UBYTE Com_RxSigGrpInfoIndStartIdxOfRxPduInfoType 0 0 0 255 ECU_ADDRESS 0x0 /end MEASUREMENT
/begin MEASUREMENT Com_RxPduInfo[2].RxSigInfoEndIdxOfRxPduInfo "" UWORD Com_RxSigInfoEndIdxOfRxPduInfoType 0 0 0 65535 ECU_ADDRESS 0x0 /end MEASUREMENT
/begin MEASUREMENT Com_RxPduInfo[2].RxSigInfoStartIdxOfRxPduInfo "" UWORD Com_RxSigInfoStartIdxOfRxPduInfoType 0 0 0 65535 ECU_ADDRESS 0x0 /end MEASUREMENT
/begin MEASUREMENT Com_RxPduInfo[2].RxTOutInfoIdxOfRxPduInfo "" UBYTE Com_RxTOutInfoIdxOfRxPduInfoType 0 0 0 255 ECU_ADDRESS 0x0 /end MEASUREMENT
/begin MEASUREMENT Com_RxPduInfo[2].RxTOutInfoIndEndIdxOfRxPduInfo "" UBYTE Com_RxTOutInfoIndEndIdxOfRxPduInfoType 0 0 0 255 ECU_ADDRESS 0x0 /end MEASUREMENT
/begin MEASUREMENT Com_RxPduInfo[2].RxTOutInfoIndStartIdxOfRxPduInfo "" UBYTE Com_RxTOutInfoIndStartIdxOfRxPduInfoType 0 0 0 255 ECU_ADDRESS 0x0 /end MEASUREMENT
/begin MEASUREMENT Com_RxPduInfo[30].HandleRxPduDeferredIdxOfRxPduInfo "" UBYTE Com_HandleRxPduDeferredIdxOfRxPduInfoType 0 0 0 255 ECU_ADDRESS 0x0 /end MEASUREMENT
/begin MEASUREMENT Com_RxPduInfo[30].IPduGroupInfoOfRxPduInfoIndEndIdxOfRxPduInfo "" UBYTE Com_IPduGroupInfoOfRxPduInfoIndEndIdxOfRxPduInfoType 0 0 0 255 ECU_ADDRESS 0x0 /end MEASUREMENT
/begin MEASUREMENT Com_RxPduInfo[30].IPduGroupInfoOfRxPduInfoIndStartIdxOfRxPduInfo "" UBYTE Com_IPduGroupInfoOfRxPduInfoIndStartIdxOfRxPduInfoType 0 0 0 255 ECU_ADDRESS 0x0 /end MEASUREMENT
/begin MEASUREMENT Com_RxPduInfo[30].MainFunctionRxStructIdxOfRxPduInfo "" UBYTE Com_MainFunctionRxStructIdxOfRxPduInfoType 0 0 0 255 ECU_ADDRESS 0x0 /end MEASUREMENT
/begin MEASUREMENT Com_RxPduInfo[30].RxAccessInfoIndEndIdxOfRxPduInfo "" UWORD Com_RxAccessInfoIndEndIdxOfRxPduInfoType 0 0 0 65535 ECU_ADDRESS 0x0 /end MEASUREMENT
/begin MEASUREMENT Com_RxPduInfo[30].RxAccessInfoIndStartIdxOfRxPduInfo "" UWORD Com_RxAccessInfoIndStartIdxOfRxPduInfoType 0 0 0 65535 ECU_ADDRESS 0x0 /end MEASUREMENT
/begin MEASUREMENT Com_RxPduInfo[30].RxDefPduBufferEndIdxOfRxPduInfo "" UWORD Com_RxDefPduBufferEndIdxOfRxPduInfoType 0 0 0 65535 ECU_ADDRESS 0x0 /end MEASUREMENT
/begin MEASUREMENT Com_RxPduInfo[30].RxDefPduBufferStartIdxOfRxPduInfo "" UWORD Com_RxDefPduBufferStartIdxOfRxPduInfoType 0 0 0 65535 ECU_ADDRESS 0x0 /end MEASUREMENT
/begin MEASUREMENT Com_RxPduInfo[30].RxPduCalloutFuncPtrIdxOfRxPduInfo "" UBYTE Com_RxPduCalloutFuncPtrIdxOfRxPduInfoType 0 0 0 255 ECU_ADDRESS 0x0 /end MEASUREMENT
/begin MEASUREMENT Com_RxPduInfo[30].RxSigGrpInfoIndEndIdxOfRxPduInfo "" UBYTE Com_RxSigGrpInfoIndEndIdxOfRxPduInfoType 0 0 0 255 ECU_ADDRESS 0x0 /end MEASUREMENT
/begin MEASUREMENT Com_RxPduInfo[30].RxSigGrpInfoIndStartIdxOfRxPduInfo "" UBYTE Com_RxSigGrpInfoIndStartIdxOfRxPduInfoType 0 0 0 255 ECU_ADDRESS 0x0 /end MEASUREMENT
/begin MEASUREMENT Com_RxPduInfo[30].RxSigInfoEndIdxOfRxPduInfo "" UWORD Com_RxSigInfoEndIdxOfRxPduInfoType 0 0 0 65535 ECU_ADDRESS 0x0 /end MEASUREMENT
/begin MEASUREMENT Com_RxPduInfo[30].RxSigInfoStartIdxOfRxPduInfo "" UWORD Com_RxSigInfoStartIdxOfRxPduInfoType 0 0 0 65535 ECU_ADDRESS 0x0 /end MEASUREMENT
/begin MEASUREMENT Com_RxPduInfo[30].RxTOutInfoIdxOfRxPduInfo "" UBYTE Com_RxTOutInfoIdxOfRxPduInfoType 0 0 0 255 ECU_ADDRESS 0x0 /end MEASUREMENT
/begin MEASUREMENT Com_RxPduInfo[30].RxTOutInfoIndEndIdxOfRxPduInfo "" UBYTE Com_RxTOutInfoIndEndIdxOfRxPduInfoType 0 0 0 255 ECU_ADDRESS 0x0 /end MEASUREMENT
/begin MEASUREMENT Com_RxPduInfo[30].RxTOutInfoIndStartIdxOfRxPduInfo "" UBYTE Com_RxTOutInfoIndStartIdxOfRxPduInfoType 0 0 0 255 ECU_ADDRESS 0x0 /end MEASUREMENT
/begin MEASUREMENT Com_RxPduInfo[31].HandleRxPduDeferredIdxOfRxPduInfo "" UBYTE Com_HandleRxPduDeferredIdxOfRxPduInfoType 0 0 0 255 ECU_ADDRESS 0x0 /end MEASUREMENT
/begin MEASUREMENT Com_RxPduInfo[31].IPduGroupInfoOfRxPduInfoIndEndIdxOfRxPduInfo "" UBYTE Com_IPduGroupInfoOfRxPduInfoIndEndIdxOfRxPduInfoType 0 0 0 255 ECU_ADDRESS 0x0 /end MEASUREMENT
/begin MEASUREMENT Com_RxPduInfo[31].IPduGroupInfoOfRxPduInfoIndStartIdxOfRxPduInfo "" UBYTE Com_IPduGroupInfoOfRxPduInfoIndStartIdxOfRxPduInfoType 0 0 0 255 ECU_ADDRESS 0x0 /end MEASUREMENT
/begin MEASUREMENT Com_RxPduInfo[31].MainFunctionRxStructIdxOfRxPduInfo "" UBYTE Com_MainFunctionRxStructIdxOfRxPduInfoType 0 0 0 255 ECU_ADDRESS 0x0 /end MEASUREMENT
/begin MEASUREMENT Com_RxPduInfo[31].RxAccessInfoIndEndIdxOfRxPduInfo "" UWORD Com_RxAccessInfoIndEndIdxOfRxPduInfoType 0 0 0 65535 ECU_ADDRESS 0x0 /end MEASUREMENT
/begin MEASUREMENT Com_RxPduInfo[31].RxAccessInfoIndStartIdxOfRxPduInfo "" UWORD Com_RxAccessInfoIndStartIdxOfRxPduInfoType 0 0 0 65535 ECU_ADDRESS 0x0 /end MEASUREMENT
/begin MEASUREMENT Com_RxPduInfo[31].RxDefPduBufferEndIdxOfRxPduInfo "" UWORD Com_RxDefPduBufferEndIdxOfRxPduInfoType 0 0 0 65535 ECU_ADDRESS 0x0 /end MEASUREMENT
/begin MEASUREMENT Com_RxPduInfo[31].RxDefPduBufferStartIdxOfRxPduInfo "" UWORD Com_RxDefPduBufferStartIdxOfRxPduInfoType 0 0 0 65535 ECU_ADDRESS 0x0 /end MEASUREMENT
/begin MEASUREMENT Com_RxPduInfo[31].RxPduCalloutFuncPtrIdxOfRxPduInfo "" UBYTE Com_RxPduCalloutFuncPtrIdxOfRxPduInfoType 0 0 0 255 ECU_ADDRESS 0x0 /end MEASUREMENT
/begin MEASUREMENT Com_RxPduInfo[31].RxSigGrpInfoIndEndIdxOfRxPduInfo "" UBYTE Com_RxSigGrpInfoIndEndIdxOfRxPduInfoType 0 0 0 255 ECU_ADDRESS 0x0 /end MEASUREMENT
/begin MEASUREMENT Com_RxPduInfo[31].RxSigGrpInfoIndStartIdxOfRxPduInfo "" UBYTE Com_RxSigGrpInfoIndStartIdxOfRxPduInfoType 0 0 0 255 ECU_ADDRESS 0x0 /end MEASUREMENT
/begin MEASUREMENT Com_RxPduInfo[31].RxSigInfoEndIdxOfRxPduInfo "" UWORD Com_RxSigInfoEndIdxOfRxPduInfoType 0 0 0 65535 ECU_ADDRESS 0x0 /end MEASUREMENT
/begin MEASUREMENT Com_RxPduInfo[31].RxSigInfoStartIdxOfRxPduInfo "" UWORD Com_RxSigInfoStartIdxOfRxPduInfoType 0 0 0 65535 ECU_ADDRESS 0x0 /end MEASUREMENT
/begin MEASUREMENT Com_RxPduInfo[31].RxTOutInfoIdxOfRxPduInfo "" UBYTE Com_RxTOutInfoIdxOfRxPduInfoType 0 0 0 255 ECU_ADDRESS 0x0 /end MEASUREMENT
/begin MEASUREMENT Com_RxPduInfo[31].RxTOutInfoIndEndIdxOfRxPduInfo "" UBYTE Com_RxTOutInfoIndEndIdxOfRxPduInfoType 0 0 0 255 ECU_ADDRESS 0x0 /end MEASUREMENT
/begin MEASUREMENT Com_RxPduInfo[31].RxTOutInfoIndStartIdxOfRxPduInfo "" UBYTE Com_RxTOutInfoIndStartIdxOfRxPduInfoType 0 0 0 255 ECU_ADDRESS 0x0 /end MEASUREMENT
/begin MEASUREMENT Com_RxPduInfo[32].HandleRxPduDeferredIdxOfRxPduInfo "" UBYTE Com_HandleRxPduDeferredIdxOfRxPduInfoType 0 0 0 255 ECU_ADDRESS 0x0 /end MEASUREMENT
/begin MEASUREMENT Com_RxPduInfo[32].IPduGroupInfoOfRxPduInfoIndEndIdxOfRxPduInfo "" UBYTE Com_IPduGroupInfoOfRxPduInfoIndEndIdxOfRxPduInfoType 0 0 0 255 ECU_ADDRESS 0x0 /end MEASUREMENT
/begin MEASUREMENT Com_RxPduInfo[32].IPduGroupInfoOfRxPduInfoIndStartIdxOfRxPduInfo "" UBYTE Com_IPduGroupInfoOfRxPduInfoIndStartIdxOfRxPduInfoType 0 0 0 255 ECU_ADDRESS 0x0 /end MEASUREMENT
/begin MEASUREMENT Com_RxPduInfo[32].MainFunctionRxStructIdxOfRxPduInfo "" UBYTE Com_MainFunctionRxStructIdxOfRxPduInfoType 0 0 0 255 ECU_ADDRESS 0x0 /end MEASUREMENT
/begin MEASUREMENT Com_RxPduInfo[32].RxAccessInfoIndEndIdxOfRxPduInfo "" UWORD Com_RxAccessInfoIndEndIdxOfRxPduInfoType 0 0 0 65535 ECU_ADDRESS 0x0 /end MEASUREMENT
/begin MEASUREMENT Com_RxPduInfo[32].RxAccessInfoIndStartIdxOfRxPduInfo "" UWORD Com_RxAccessInfoIndStartIdxOfRxPduInfoType 0 0 0 65535 ECU_ADDRESS 0x0 /end MEASUREMENT
/begin MEASUREMENT Com_RxPduInfo[32].RxDefPduBufferEndIdxOfRxPduInfo "" UWORD Com_RxDefPduBufferEndIdxOfRxPduInfoType 0 0 0 65535 ECU_ADDRESS 0x0 /end MEASUREMENT
/begin MEASUREMENT Com_RxPduInfo[32].RxDefPduBufferStartIdxOfRxPduInfo "" UWORD Com_RxDefPduBufferStartIdxOfRxPduInfoType 0 0 0 65535 ECU_ADDRESS 0x0 /end MEASUREMENT
/begin MEASUREMENT Com_RxPduInfo[32].RxPduCalloutFuncPtrIdxOfRxPduInfo "" UBYTE Com_RxPduCalloutFuncPtrIdxOfRxPduInfoType 0 0 0 255 ECU_ADDRESS 0x0 /end MEASUREMENT
/begin MEASUREMENT Com_RxPduInfo[32].RxSigGrpInfoIndEndIdxOfRxPduInfo "" UBYTE Com_RxSigGrpInfoIndEndIdxOfRxPduInfoType 0 0 0 255 ECU_ADDRESS 0x0 /end MEASUREMENT
/begin MEASUREMENT Com_RxPduInfo[32].RxSigGrpInfoIndStartIdxOfRxPduInfo "" UBYTE Com_RxSigGrpInfoIndStartIdxOfRxPduInfoType 0 0 0 255 ECU_ADDRESS 0x0 /end MEASUREMENT
/begin MEASUREMENT Com_RxPduInfo[32].RxSigInfoEndIdxOfRxPduInfo "" UWORD Com_RxSigInfoEndIdxOfRxPduInfoType 0 0 0 65535 ECU_ADDRESS 0x0 /end MEASUREMENT
/begin MEASUREMENT Com_RxPduInfo[32].RxSigInfoStartIdxOfRxPduInfo "" UWORD Com_RxSigInfoStartIdxOfRxPduInfoType 0 0 0 65535 ECU_ADDRESS 0x0 /end MEASUREMENT
/begin MEASUREMENT Com_RxPduInfo[32].RxTOutInfoIdxOfRxPduInfo "" UBYTE Com_RxTOutInfoIdxOfRxPduInfoType 0 0 0 255 ECU_ADDRESS 0x0 /end MEASUREMENT
/begin MEASUREMENT Com_RxPduInfo[32].RxTOutInfoIndEndIdxOfRxPduInfo "" UBYTE Com_RxTOutInfoIndEndIdxOfRxPduInfoType 0 0 0 255 ECU_ADDRESS 0x0 /end MEASUREMENT
/begin MEASUREMENT Com_RxPduInfo[32].RxTOutInfoIndStartIdxOfRxPduInfo "" UBYTE Com_RxTOutInfoIndStartIdxOfRxPduInfoType 0 0 0 255 ECU_ADDRESS 0x0 /end MEASUREMENT
/begin MEASUREMENT Com_RxPduInfo[33].HandleRxPduDeferredIdxOfRxPduInfo "" UBYTE Com_HandleRxPduDeferredIdxOfRxPduInfoType 0 0 0 255 ECU_ADDRESS 0x0 /end MEASUREMENT
/begin MEASUREMENT Com_RxPduInfo[33].IPduGroupInfoOfRxPduInfoIndEndIdxOfRxPduInfo "" UBYTE Com_IPduGroupInfoOfRxPduInfoIndEndIdxOfRxPduInfoType 0 0 0 255 ECU_ADDRESS 0x0 /end MEASUREMENT
/begin MEASUREMENT Com_RxPduInfo[33].IPduGroupInfoOfRxPduInfoIndStartIdxOfRxPduInfo "" UBYTE Com_IPduGroupInfoOfRxPduInfoIndStartIdxOfRxPduInfoType 0 0 0 255 ECU_ADDRESS 0x0 /end MEASUREMENT
/begin MEASUREMENT Com_RxPduInfo[33].MainFunctionRxStructIdxOfRxPduInfo "" UBYTE Com_MainFunctionRxStructIdxOfRxPduInfoType 0 0 0 255 ECU_ADDRESS 0x0 /end MEASUREMENT
/begin MEASUREMENT Com_RxPduInfo[33].RxAccessInfoIndEndIdxOfRxPduInfo "" UWORD Com_RxAccessInfoIndEndIdxOfRxPduInfoType 0 0 0 65535 ECU_ADDRESS 0x0 /end MEASUREMENT
/begin MEASUREMENT Com_RxPduInfo[33].RxAccessInfoIndStartIdxOfRxPduInfo "" UWORD Com_RxAccessInfoIndStartIdxOfRxPduInfoType 0 0 0 65535 ECU_ADDRESS 0x0 /end MEASUREMENT
/begin MEASUREMENT Com_RxPduInfo[33].RxDefPduBufferEndIdxOfRxPduInfo "" UWORD Com_RxDefPduBufferEndIdxOfRxPduInfoType 0 0 0 65535 ECU_ADDRESS 0x0 /end MEASUREMENT
/begin MEASUREMENT Com_RxPduInfo[33].RxDefPduBufferStartIdxOfRxPduInfo "" UWORD Com_RxDefPduBufferStartIdxOfRxPduInfoType 0 0 0 65535 ECU_ADDRESS 0x0 /end MEASUREMENT
/begin MEASUREMENT Com_RxPduInfo[33].RxPduCalloutFuncPtrIdxOfRxPduInfo "" UBYTE Com_RxPduCalloutFuncPtrIdxOfRxPduInfoType 0 0 0 255 ECU_ADDRESS 0x0 /end MEASUREMENT
/begin MEASUREMENT Com_RxPduInfo[33].RxSigGrpInfoIndEndIdxOfRxPduInfo "" UBYTE Com_RxSigGrpInfoIndEndIdxOfRxPduInfoType 0 0 0 255 ECU_ADDRESS 0x0 /end MEASUREMENT
/begin MEASUREMENT Com_RxPduInfo[33].RxSigGrpInfoIndStartIdxOfRxPduInfo "" UBYTE Com_RxSigGrpInfoIndStartIdxOfRxPduInfoType 0 0 0 255 ECU_ADDRESS 0x0 /end MEASUREMENT
/begin MEASUREMENT Com_RxPduInfo[33].RxSigInfoEndIdxOfRxPduInfo "" UWORD Com_RxSigInfoEndIdxOfRxPduInfoType 0 0 0 65535 ECU_ADDRESS 0x0 /end MEASUREMENT
/begin MEASUREMENT Com_RxPduInfo[33].RxSigInfoStartIdxOfRxPduInfo "" UWORD Com_RxSigInfoStartIdxOfRxPduInfoType 0 0 0 65535 ECU_ADDRESS 0x0 /end MEASUREMENT
/begin MEASUREMENT Com_RxPduInfo[33].RxTOutInfoIdxOfRxPduInfo "" UBYTE Com_RxTOutInfoIdxOfRxPduInfoType 0 0 0 255 ECU_ADDRESS 0x0 /end MEASUREMENT
/begin MEASUREMENT Com_RxPduInfo[33].RxTOutInfoIndEndIdxOfRxPduInfo "" UBYTE Com_RxTOutInfoIndEndIdxOfRxPduInfoType 0 0 0 255 ECU_ADDRESS 0x0 /end MEASUREMENT
/begin MEASUREMENT Com_RxPduInfo[33].RxTOutInfoIndStartIdxOfRxPduInfo "" UBYTE Com_RxTOutInfoIndStartIdxOfRxPduInfoType 0 0 0 255 ECU_ADDRESS 0x0 /end MEASUREMENT
/begin MEASUREMENT Com_RxPduInfo[34].HandleRxPduDeferredIdxOfRxPduInfo "" UBYTE Com_HandleRxPduDeferredIdxOfRxPduInfoType 0 0 0 255 ECU_ADDRESS 0x0 /end MEASUREMENT
/begin MEASUREMENT Com_RxPduInfo[34].IPduGroupInfoOfRxPduInfoIndEndIdxOfRxPduInfo "" UBYTE Com_IPduGroupInfoOfRxPduInfoIndEndIdxOfRxPduInfoType 0 0 0 255 ECU_ADDRESS 0x0 /end MEASUREMENT
/begin MEASUREMENT Com_RxPduInfo[34].IPduGroupInfoOfRxPduInfoIndStartIdxOfRxPduInfo "" UBYTE Com_IPduGroupInfoOfRxPduInfoIndStartIdxOfRxPduInfoType 0 0 0 255 ECU_ADDRESS 0x0 /end MEASUREMENT
/begin MEASUREMENT Com_RxPduInfo[34].MainFunctionRxStructIdxOfRxPduInfo "" UBYTE Com_MainFunctionRxStructIdxOfRxPduInfoType 0 0 0 255 ECU_ADDRESS 0x0 /end MEASUREMENT
/begin MEASUREMENT Com_RxPduInfo[34].RxAccessInfoIndEndIdxOfRxPduInfo "" UWORD Com_RxAccessInfoIndEndIdxOfRxPduInfoType 0 0 0 65535 ECU_ADDRESS 0x0 /end MEASUREMENT
/begin MEASUREMENT Com_RxPduInfo[34].RxAccessInfoIndStartIdxOfRxPduInfo "" UWORD Com_RxAccessInfoIndStartIdxOfRxPduInfoType 0 0 0 65535 ECU_ADDRESS 0x0 /end MEASUREMENT
/begin MEASUREMENT Com_RxPduInfo[34].RxDefPduBufferEndIdxOfRxPduInfo "" UWORD Com_RxDefPduBufferEndIdxOfRxPduInfoType 0 0 0 65535 ECU_ADDRESS 0x0 /end MEASUREMENT
/begin MEASUREMENT Com_RxPduInfo[34].RxDefPduBufferStartIdxOfRxPduInfo "" UWORD Com_RxDefPduBufferStartIdxOfRxPduInfoType 0 0 0 65535 ECU_ADDRESS 0x0 /end MEASUREMENT
/begin MEASUREMENT Com_RxPduInfo[34].RxPduCalloutFuncPtrIdxOfRxPduInfo "" UBYTE Com_RxPduCalloutFuncPtrIdxOfRxPduInfoType 0 0 0 255 ECU_ADDRESS 0x0 /end MEASUREMENT
/begin MEASUREMENT Com_RxPduInfo[34].RxSigGrpInfoIndEndIdxOfRxPduInfo "" UBYTE Com_RxSigGrpInfoIndEndIdxOfRxPduInfoType 0 0 0 255 ECU_ADDRESS 0x0 /end MEASUREMENT
/begin MEASUREMENT Com_RxPduInfo[34].RxSigGrpInfoIndStartIdxOfRxPduInfo "" UBYTE Com_RxSigGrpInfoIndStartIdxOfRxPduInfoType 0 0 0 255 ECU_ADDRESS 0x0 /end MEASUREMENT
/begin MEASUREMENT Com_RxPduInfo[34].RxSigInfoEndIdxOfRxPduInfo "" UWORD Com_RxSigInfoEndIdxOfRxPduInfoType 0 0 0 65535 ECU_ADDRESS 0x0 /end MEASUREMENT
/begin MEASUREMENT Com_RxPduInfo[34].RxSigInfoStartIdxOfRxPduInfo "" UWORD Com_RxSigInfoStartIdxOfRxPduInfoType 0 0 0 65535 ECU_ADDRESS 0x0 /end MEASUREMENT
/begin MEASUREMENT Com_RxPduInfo[34].RxTOutInfoIdxOfRxPduInfo "" UBYTE Com_RxTOutInfoIdxOfRxPduInfoType 0 0 0 255 ECU_ADDRESS 0x0 /end MEASUREMENT
/begin MEASUREMENT Com_RxPduInfo[34].RxTOutInfoIndEndIdxOfRxPduInfo "" UBYTE Com_RxTOutInfoIndEndIdxOfRxPduInfoType 0 0 0 255 ECU_ADDRESS 0x0 /end MEASUREMENT
/begin MEASUREMENT Com_RxPduInfo[34].RxTOutInfoIndStartIdxOfRxPduInfo "" UBYTE Com_RxTOutInfoIndStartIdxOfRxPduInfoType 0 0 0 255 ECU_ADDRESS 0x0 /end MEASUREMENT
/begin MEASUREMENT Com_RxPduInfo[35].HandleRxPduDeferredIdxOfRxPduInfo "" UBYTE Com_HandleRxPduDeferredIdxOfRxPduInfoType 0 0 0 255 ECU_ADDRESS 0x0 /end MEASUREMENT
/begin MEASUREMENT Com_RxPduInfo[35].IPduGroupInfoOfRxPduInfoIndEndIdxOfRxPduInfo "" UBYTE Com_IPduGroupInfoOfRxPduInfoIndEndIdxOfRxPduInfoType 0 0 0 255 ECU_ADDRESS 0x0 /end MEASUREMENT
/begin MEASUREMENT Com_RxPduInfo[35].IPduGroupInfoOfRxPduInfoIndStartIdxOfRxPduInfo "" UBYTE Com_IPduGroupInfoOfRxPduInfoIndStartIdxOfRxPduInfoType 0 0 0 255 ECU_ADDRESS 0x0 /end MEASUREMENT
/begin MEASUREMENT Com_RxPduInfo[35].MainFunctionRxStructIdxOfRxPduInfo "" UBYTE Com_MainFunctionRxStructIdxOfRxPduInfoType 0 0 0 255 ECU_ADDRESS 0x0 /end MEASUREMENT
/begin MEASUREMENT Com_RxPduInfo[35].RxAccessInfoIndEndIdxOfRxPduInfo "" UWORD Com_RxAccessInfoIndEndIdxOfRxPduInfoType 0 0 0 65535 ECU_ADDRESS 0x0 /end MEASUREMENT
/begin MEASUREMENT Com_RxPduInfo[35].RxAccessInfoIndStartIdxOfRxPduInfo "" UWORD Com_RxAccessInfoIndStartIdxOfRxPduInfoType 0 0 0 65535 ECU_ADDRESS 0x0 /end MEASUREMENT
/begin MEASUREMENT Com_RxPduInfo[35].RxDefPduBufferEndIdxOfRxPduInfo "" UWORD Com_RxDefPduBufferEndIdxOfRxPduInfoType 0 0 0 65535 ECU_ADDRESS 0x0 /end MEASUREMENT
/begin MEASUREMENT Com_RxPduInfo[35].RxDefPduBufferStartIdxOfRxPduInfo "" UWORD Com_RxDefPduBufferStartIdxOfRxPduInfoType 0 0 0 65535 ECU_ADDRESS 0x0 /end MEASUREMENT
/begin MEASUREMENT Com_RxPduInfo[35].RxPduCalloutFuncPtrIdxOfRxPduInfo "" UBYTE Com_RxPduCalloutFuncPtrIdxOfRxPduInfoType 0 0 0 255 ECU_ADDRESS 0x0 /end MEASUREMENT
/begin MEASUREMENT Com_RxPduInfo[35].RxSigGrpInfoIndEndIdxOfRxPduInfo "" UBYTE Com_RxSigGrpInfoIndEndIdxOfRxPduInfoType 0 0 0 255 ECU_ADDRESS 0x0 /end MEASUREMENT
/begin MEASUREMENT Com_RxPduInfo[35].RxSigGrpInfoIndStartIdxOfRxPduInfo "" UBYTE Com_RxSigGrpInfoIndStartIdxOfRxPduInfoType 0 0 0 255 ECU_ADDRESS 0x0 /end MEASUREMENT
/begin MEASUREMENT Com_RxPduInfo[35].RxSigInfoEndIdxOfRxPduInfo "" UWORD Com_RxSigInfoEndIdxOfRxPduInfoType 0 0 0 65535 ECU_ADDRESS 0x0 /end MEASUREMENT
/begin MEASUREMENT Com_RxPduInfo[35].RxSigInfoStartIdxOfRxPduInfo "" UWORD Com_RxSigInfoStartIdxOfRxPduInfoType 0 0 0 65535 ECU_ADDRESS 0x0 /end MEASUREMENT
/begin MEASUREMENT Com_RxPduInfo[35].RxTOutInfoIdxOfRxPduInfo "" UBYTE Com_RxTOutInfoIdxOfRxPduInfoType 0 0 0 255 ECU_ADDRESS 0x0 /end MEASUREMENT
/begin MEASUREMENT Com_RxPduInfo[35].RxTOutInfoIndEndIdxOfRxPduInfo "" UBYTE Com_RxTOutInfoIndEndIdxOfRxPduInfoType 0 0 0 255 ECU_ADDRESS 0x0 /end MEASUREMENT
/begin MEASUREMENT Com_RxPduInfo[35].RxTOutInfoIndStartIdxOfRxPduInfo "" UBYTE Com_RxTOutInfoIndStartIdxOfRxPduInfoType 0 0 0 255 ECU_ADDRESS 0x0 /end MEASUREMENT
/begin MEASUREMENT Com_RxPduInfo[36].HandleRxPduDeferredIdxOfRxPduInfo "" UBYTE Com_HandleRxPduDeferredIdxOfRxPduInfoType 0 0 0 255 ECU_ADDRESS 0x0 /end MEASUREMENT
/begin MEASUREMENT Com_RxPduInfo[36].IPduGroupInfoOfRxPduInfoIndEndIdxOfRxPduInfo "" UBYTE Com_IPduGroupInfoOfRxPduInfoIndEndIdxOfRxPduInfoType 0 0 0 255 ECU_ADDRESS 0x0 /end MEASUREMENT
/begin MEASUREMENT Com_RxPduInfo[36].IPduGroupInfoOfRxPduInfoIndStartIdxOfRxPduInfo "" UBYTE Com_IPduGroupInfoOfRxPduInfoIndStartIdxOfRxPduInfoType 0 0 0 255 ECU_ADDRESS 0x0 /end MEASUREMENT
/begin MEASUREMENT Com_RxPduInfo[36].MainFunctionRxStructIdxOfRxPduInfo "" UBYTE Com_MainFunctionRxStructIdxOfRxPduInfoType 0 0 0 255 ECU_ADDRESS 0x0 /end MEASUREMENT
/begin MEASUREMENT Com_RxPduInfo[36].RxAccessInfoIndEndIdxOfRxPduInfo "" UWORD Com_RxAccessInfoIndEndIdxOfRxPduInfoType 0 0 0 65535 ECU_ADDRESS 0x0 /end MEASUREMENT
/begin MEASUREMENT Com_RxPduInfo[36].RxAccessInfoIndStartIdxOfRxPduInfo "" UWORD Com_RxAccessInfoIndStartIdxOfRxPduInfoType 0 0 0 65535 ECU_ADDRESS 0x0 /end MEASUREMENT
/begin MEASUREMENT Com_RxPduInfo[36].RxDefPduBufferEndIdxOfRxPduInfo "" UWORD Com_RxDefPduBufferEndIdxOfRxPduInfoType 0 0 0 65535 ECU_ADDRESS 0x0 /end MEASUREMENT
/begin MEASUREMENT Com_RxPduInfo[36].RxDefPduBufferStartIdxOfRxPduInfo "" UWORD Com_RxDefPduBufferStartIdxOfRxPduInfoType 0 0 0 65535 ECU_ADDRESS 0x0 /end MEASUREMENT
/begin MEASUREMENT Com_RxPduInfo[36].RxPduCalloutFuncPtrIdxOfRxPduInfo "" UBYTE Com_RxPduCalloutFuncPtrIdxOfRxPduInfoType 0 0 0 255 ECU_ADDRESS 0x0 /end MEASUREMENT
/begin MEASUREMENT Com_RxPduInfo[36].RxSigGrpInfoIndEndIdxOfRxPduInfo "" UBYTE Com_RxSigGrpInfoIndEndIdxOfRxPduInfoType 0 0 0 255 ECU_ADDRESS 0x0 /end MEASUREMENT
/begin MEASUREMENT Com_RxPduInfo[36].RxSigGrpInfoIndStartIdxOfRxPduInfo "" UBYTE Com_RxSigGrpInfoIndStartIdxOfRxPduInfoType 0 0 0 255 ECU_ADDRESS 0x0 /end MEASUREMENT
/begin MEASUREMENT Com_RxPduInfo[36].RxSigInfoEndIdxOfRxPduInfo "" UWORD Com_RxSigInfoEndIdxOfRxPduInfoType 0 0 0 65535 ECU_ADDRESS 0x0 /end MEASUREMENT
/begin MEASUREMENT Com_RxPduInfo[36].RxSigInfoStartIdxOfRxPduInfo "" UWORD Com_RxSigInfoStartIdxOfRxPduInfoType 0 0 0 65535 ECU_ADDRESS 0x0 /end MEASUREMENT
/begin MEASUREMENT Com_RxPduInfo[36].RxTOutInfoIdxOfRxPduInfo "" UBYTE Com_RxTOutInfoIdxOfRxPduInfoType 0 0 0 255 ECU_ADDRESS 0x0 /end MEASUREMENT
/begin MEASUREMENT Com_RxPduInfo[36].RxTOutInfoIndEndIdxOfRxPduInfo "" UBYTE Com_RxTOutInfoIndEndIdxOfRxPduInfoType 0 0 0 255 ECU_ADDRESS 0x0 /end MEASUREMENT
/begin MEASUREMENT Com_RxPduInfo[36].RxTOutInfoIndStartIdxOfRxPduInfo "" UBYTE Com_RxTOutInfoIndStartIdxOfRxPduInfoType 0 0 0 255 ECU_ADDRESS 0x0 /end MEASUREMENT
/begin MEASUREMENT Com_RxPduInfo[37].HandleRxPduDeferredIdxOfRxPduInfo "" UBYTE Com_HandleRxPduDeferredIdxOfRxPduInfoType 0 0 0 255 ECU_ADDRESS 0x0 /end MEASUREMENT
/begin MEASUREMENT Com_RxPduInfo[37].IPduGroupInfoOfRxPduInfoIndEndIdxOfRxPduInfo "" UBYTE Com_IPduGroupInfoOfRxPduInfoIndEndIdxOfRxPduInfoType 0 0 0 255 ECU_ADDRESS 0x0 /end MEASUREMENT
/begin MEASUREMENT Com_RxPduInfo[37].IPduGroupInfoOfRxPduInfoIndStartIdxOfRxPduInfo "" UBYTE Com_IPduGroupInfoOfRxPduInfoIndStartIdxOfRxPduInfoType 0 0 0 255 ECU_ADDRESS 0x0 /end MEASUREMENT
/begin MEASUREMENT Com_RxPduInfo[37].MainFunctionRxStructIdxOfRxPduInfo "" UBYTE Com_MainFunctionRxStructIdxOfRxPduInfoType 0 0 0 255 ECU_ADDRESS 0x0 /end MEASUREMENT
/begin MEASUREMENT Com_RxPduInfo[37].RxAccessInfoIndEndIdxOfRxPduInfo "" UWORD Com_RxAccessInfoIndEndIdxOfRxPduInfoType 0 0 0 65535 ECU_ADDRESS 0x0 /end MEASUREMENT
/begin MEASUREMENT Com_RxPduInfo[37].RxAccessInfoIndStartIdxOfRxPduInfo "" UWORD Com_RxAccessInfoIndStartIdxOfRxPduInfoType 0 0 0 65535 ECU_ADDRESS 0x0 /end MEASUREMENT
/begin MEASUREMENT Com_RxPduInfo[37].RxDefPduBufferEndIdxOfRxPduInfo "" UWORD Com_RxDefPduBufferEndIdxOfRxPduInfoType 0 0 0 65535 ECU_ADDRESS 0x0 /end MEASUREMENT
/begin MEASUREMENT Com_RxPduInfo[37].RxDefPduBufferStartIdxOfRxPduInfo "" UWORD Com_RxDefPduBufferStartIdxOfRxPduInfoType 0 0 0 65535 ECU_ADDRESS 0x0 /end MEASUREMENT
/begin MEASUREMENT Com_RxPduInfo[37].RxPduCalloutFuncPtrIdxOfRxPduInfo "" UBYTE Com_RxPduCalloutFuncPtrIdxOfRxPduInfoType 0 0 0 255 ECU_ADDRESS 0x0 /end MEASUREMENT
/begin MEASUREMENT Com_RxPduInfo[37].RxSigGrpInfoIndEndIdxOfRxPduInfo "" UBYTE Com_RxSigGrpInfoIndEndIdxOfRxPduInfoType 0 0 0 255 ECU_ADDRESS 0x0 /end MEASUREMENT
/begin MEASUREMENT Com_RxPduInfo[37].RxSigGrpInfoIndStartIdxOfRxPduInfo "" UBYTE Com_RxSigGrpInfoIndStartIdxOfRxPduInfoType 0 0 0 255 ECU_ADDRESS 0x0 /end MEASUREMENT
/begin MEASUREMENT Com_RxPduInfo[37].RxSigInfoEndIdxOfRxPduInfo "" UWORD Com_RxSigInfoEndIdxOfRxPduInfoType 0 0 0 65535 ECU_ADDRESS 0x0 /end MEASUREMENT
/begin MEASUREMENT Com_RxPduInfo[37].RxSigInfoStartIdxOfRxPduInfo "" UWORD Com_RxSigInfoStartIdxOfRxPduInfoType 0 0 0 65535 ECU_ADDRESS 0x0 /end MEASUREMENT
/begin MEASUREMENT Com_RxPduInfo[37].RxTOutInfoIdxOfRxPduInfo "" UBYTE Com_RxTOutInfoIdxOfRxPduInfoType 0 0 0 255 ECU_ADDRESS 0x0 /end MEASUREMENT
/begin MEASUREMENT Com_RxPduInfo[37].RxTOutInfoIndEndIdxOfRxPduInfo "" UBYTE Com_RxTOutInfoIndEndIdxOfRxPduInfoType 0 0 0 255 ECU_ADDRESS 0x0 /end MEASUREMENT
/begin MEASUREMENT Com_RxPduInfo[37].RxTOutInfoIndStartIdxOfRxPduInfo "" UBYTE Com_RxTOutInfoIndStartIdxOfRxPduInfoType 0 0 0 255 ECU_ADDRESS 0x0 /end MEASUREMENT
/begin MEASUREMENT Com_RxPduInfo[38].HandleRxPduDeferredIdxOfRxPduInfo "" UBYTE Com_HandleRxPduDeferredIdxOfRxPduInfoType 0 0 0 255 ECU_ADDRESS 0x0 /end MEASUREMENT
/begin MEASUREMENT Com_RxPduInfo[38].IPduGroupInfoOfRxPduInfoIndEndIdxOfRxPduInfo "" UBYTE Com_IPduGroupInfoOfRxPduInfoIndEndIdxOfRxPduInfoType 0 0 0 255 ECU_ADDRESS 0x0 /end MEASUREMENT
/begin MEASUREMENT Com_RxPduInfo[38].IPduGroupInfoOfRxPduInfoIndStartIdxOfRxPduInfo "" UBYTE Com_IPduGroupInfoOfRxPduInfoIndStartIdxOfRxPduInfoType 0 0 0 255 ECU_ADDRESS 0x0 /end MEASUREMENT
/begin MEASUREMENT Com_RxPduInfo[38].MainFunctionRxStructIdxOfRxPduInfo "" UBYTE Com_MainFunctionRxStructIdxOfRxPduInfoType 0 0 0 255 ECU_ADDRESS 0x0 /end MEASUREMENT
/begin MEASUREMENT Com_RxPduInfo[38].RxAccessInfoIndEndIdxOfRxPduInfo "" UWORD Com_RxAccessInfoIndEndIdxOfRxPduInfoType 0 0 0 65535 ECU_ADDRESS 0x0 /end MEASUREMENT
/begin MEASUREMENT Com_RxPduInfo[38].RxAccessInfoIndStartIdxOfRxPduInfo "" UWORD Com_RxAccessInfoIndStartIdxOfRxPduInfoType 0 0 0 65535 ECU_ADDRESS 0x0 /end MEASUREMENT
/begin MEASUREMENT Com_RxPduInfo[38].RxDefPduBufferEndIdxOfRxPduInfo "" UWORD Com_RxDefPduBufferEndIdxOfRxPduInfoType 0 0 0 65535 ECU_ADDRESS 0x0 /end MEASUREMENT
/begin MEASUREMENT Com_RxPduInfo[38].RxDefPduBufferStartIdxOfRxPduInfo "" UWORD Com_RxDefPduBufferStartIdxOfRxPduInfoType 0 0 0 65535 ECU_ADDRESS 0x0 /end MEASUREMENT
/begin MEASUREMENT Com_RxPduInfo[38].RxPduCalloutFuncPtrIdxOfRxPduInfo "" UBYTE Com_RxPduCalloutFuncPtrIdxOfRxPduInfoType 0 0 0 255 ECU_ADDRESS 0x0 /end MEASUREMENT
/begin MEASUREMENT Com_RxPduInfo[38].RxSigGrpInfoIndEndIdxOfRxPduInfo "" UBYTE Com_RxSigGrpInfoIndEndIdxOfRxPduInfoType 0 0 0 255 ECU_ADDRESS 0x0 /end MEASUREMENT
/begin MEASUREMENT Com_RxPduInfo[38].RxSigGrpInfoIndStartIdxOfRxPduInfo "" UBYTE Com_RxSigGrpInfoIndStartIdxOfRxPduInfoType 0 0 0 255 ECU_ADDRESS 0x0 /end MEASUREMENT
/begin MEASUREMENT Com_RxPduInfo[38].RxSigInfoEndIdxOfRxPduInfo "" UWORD Com_RxSigInfoEndIdxOfRxPduInfoType 0 0 0 65535 ECU_ADDRESS 0x0 /end MEASUREMENT
/begin MEASUREMENT Com_RxPduInfo[38].RxSigInfoStartIdxOfRxPduInfo "" UWORD Com_RxSigInfoStartIdxOfRxPduInfoType 0 0 0 65535 ECU_ADDRESS 0x0 /end MEASUREMENT
/begin MEASUREMENT Com_RxPduInfo[38].RxTOutInfoIdxOfRxPduInfo "" UBYTE Com_RxTOutInfoIdxOfRxPduInfoType 0 0 0 255 ECU_ADDRESS 0x0 /end MEASUREMENT
/begin MEASUREMENT Com_RxPduInfo[38].RxTOutInfoIndEndIdxOfRxPduInfo "" UBYTE Com_RxTOutInfoIndEndIdxOfRxPduInfoType 0 0 0 255 ECU_ADDRESS 0x0 /end MEASUREMENT
/begin MEASUREMENT Com_RxPduInfo[38].RxTOutInfoIndStartIdxOfRxPduInfo "" UBYTE Com_RxTOutInfoIndStartIdxOfRxPduInfoType 0 0 0 255 ECU_ADDRESS 0x0 /end MEASUREMENT
/begin MEASUREMENT Com_RxPduInfo[39].HandleRxPduDeferredIdxOfRxPduInfo "" UBYTE Com_HandleRxPduDeferredIdxOfRxPduInfoType 0 0 0 255 ECU_ADDRESS 0x0 /end MEASUREMENT
/begin MEASUREMENT Com_RxPduInfo[39].IPduGroupInfoOfRxPduInfoIndEndIdxOfRxPduInfo "" UBYTE Com_IPduGroupInfoOfRxPduInfoIndEndIdxOfRxPduInfoType 0 0 0 255 ECU_ADDRESS 0x0 /end MEASUREMENT
/begin MEASUREMENT Com_RxPduInfo[39].IPduGroupInfoOfRxPduInfoIndStartIdxOfRxPduInfo "" UBYTE Com_IPduGroupInfoOfRxPduInfoIndStartIdxOfRxPduInfoType 0 0 0 255 ECU_ADDRESS 0x0 /end MEASUREMENT
/begin MEASUREMENT Com_RxPduInfo[39].MainFunctionRxStructIdxOfRxPduInfo "" UBYTE Com_MainFunctionRxStructIdxOfRxPduInfoType 0 0 0 255 ECU_ADDRESS 0x0 /end MEASUREMENT
/begin MEASUREMENT Com_RxPduInfo[39].RxAccessInfoIndEndIdxOfRxPduInfo "" UWORD Com_RxAccessInfoIndEndIdxOfRxPduInfoType 0 0 0 65535 ECU_ADDRESS 0x0 /end MEASUREMENT
/begin MEASUREMENT Com_RxPduInfo[39].RxAccessInfoIndStartIdxOfRxPduInfo "" UWORD Com_RxAccessInfoIndStartIdxOfRxPduInfoType 0 0 0 65535 ECU_ADDRESS 0x0 /end MEASUREMENT
/begin MEASUREMENT Com_RxPduInfo[39].RxDefPduBufferEndIdxOfRxPduInfo "" UWORD Com_RxDefPduBufferEndIdxOfRxPduInfoType 0 0 0 65535 ECU_ADDRESS 0x0 /end MEASUREMENT
/begin MEASUREMENT Com_RxPduInfo[39].RxDefPduBufferStartIdxOfRxPduInfo "" UWORD Com_RxDefPduBufferStartIdxOfRxPduInfoType 0 0 0 65535 ECU_ADDRESS 0x0 /end MEASUREMENT
/begin MEASUREMENT Com_RxPduInfo[39].RxPduCalloutFuncPtrIdxOfRxPduInfo "" UBYTE Com_RxPduCalloutFuncPtrIdxOfRxPduInfoType 0 0 0 255 ECU_ADDRESS 0x0 /end MEASUREMENT
/begin MEASUREMENT Com_RxPduInfo[39].RxSigGrpInfoIndEndIdxOfRxPduInfo "" UBYTE Com_RxSigGrpInfoIndEndIdxOfRxPduInfoType 0 0 0 255 ECU_ADDRESS 0x0 /end MEASUREMENT
/begin MEASUREMENT Com_RxPduInfo[39].RxSigGrpInfoIndStartIdxOfRxPduInfo "" UBYTE Com_RxSigGrpInfoIndStartIdxOfRxPduInfoType 0 0 0 255 ECU_ADDRESS 0x0 /end MEASUREMENT
/begin MEASUREMENT Com_RxPduInfo[39].RxSigInfoEndIdxOfRxPduInfo "" UWORD Com_RxSigInfoEndIdxOfRxPduInfoType 0 0 0 65535 ECU_ADDRESS 0x0 /end MEASUREMENT
/begin MEASUREMENT Com_RxPduInfo[39].RxSigInfoStartIdxOfRxPduInfo "" UWORD Com_RxSigInfoStartIdxOfRxPduInfoType 0 0 0 65535 ECU_ADDRESS 0x0 /end MEASUREMENT
/begin MEASUREMENT Com_RxPduInfo[39].RxTOutInfoIdxOfRxPduInfo "" UBYTE Com_RxTOutInfoIdxOfRxPduInfoType 0 0 0 255 ECU_ADDRESS 0x0 /end MEASUREMENT
/begin MEASUREMENT Com_RxPduInfo[39].RxTOutInfoIndEndIdxOfRxPduInfo "" UBYTE Com_RxTOutInfoIndEndIdxOfRxPduInfoType 0 0 0 255 ECU_ADDRESS 0x0 /end MEASUREMENT
/begin MEASUREMENT Com_RxPduInfo[39].RxTOutInfoIndStartIdxOfRxPduInfo "" UBYTE Com_RxTOutInfoIndStartIdxOfRxPduInfoType 0 0 0 255 ECU_ADDRESS 0x0 /end MEASUREMENT
/begin MEASUREMENT Com_RxPduInfo[3].HandleRxPduDeferredIdxOfRxPduInfo "" UBYTE Com_HandleRxPduDeferredIdxOfRxPduInfoType 0 0 0 255 ECU_ADDRESS 0x0 /end MEASUREMENT
/begin MEASUREMENT Com_RxPduInfo[3].IPduGroupInfoOfRxPduInfoIndEndIdxOfRxPduInfo "" UBYTE Com_IPduGroupInfoOfRxPduInfoIndEndIdxOfRxPduInfoType 0 0 0 255 ECU_ADDRESS 0x0 /end MEASUREMENT
/begin MEASUREMENT Com_RxPduInfo[3].IPduGroupInfoOfRxPduInfoIndStartIdxOfRxPduInfo "" UBYTE Com_IPduGroupInfoOfRxPduInfoIndStartIdxOfRxPduInfoType 0 0 0 255 ECU_ADDRESS 0x0 /end MEASUREMENT
/begin MEASUREMENT Com_RxPduInfo[3].MainFunctionRxStructIdxOfRxPduInfo "" UBYTE Com_MainFunctionRxStructIdxOfRxPduInfoType 0 0 0 255 ECU_ADDRESS 0x0 /end MEASUREMENT
/begin MEASUREMENT Com_RxPduInfo[3].RxAccessInfoIndEndIdxOfRxPduInfo "" UWORD Com_RxAccessInfoIndEndIdxOfRxPduInfoType 0 0 0 65535 ECU_ADDRESS 0x0 /end MEASUREMENT
/begin MEASUREMENT Com_RxPduInfo[3].RxAccessInfoIndStartIdxOfRxPduInfo "" UWORD Com_RxAccessInfoIndStartIdxOfRxPduInfoType 0 0 0 65535 ECU_ADDRESS 0x0 /end MEASUREMENT
/begin MEASUREMENT Com_RxPduInfo[3].RxDefPduBufferEndIdxOfRxPduInfo "" UWORD Com_RxDefPduBufferEndIdxOfRxPduInfoType 0 0 0 65535 ECU_ADDRESS 0x0 /end MEASUREMENT
/begin MEASUREMENT Com_RxPduInfo[3].RxDefPduBufferStartIdxOfRxPduInfo "" UWORD Com_RxDefPduBufferStartIdxOfRxPduInfoType 0 0 0 65535 ECU_ADDRESS 0x0 /end MEASUREMENT
/begin MEASUREMENT Com_RxPduInfo[3].RxPduCalloutFuncPtrIdxOfRxPduInfo "" UBYTE Com_RxPduCalloutFuncPtrIdxOfRxPduInfoType 0 0 0 255 ECU_ADDRESS 0x0 /end MEASUREMENT
/begin MEASUREMENT Com_RxPduInfo[3].RxSigGrpInfoIndEndIdxOfRxPduInfo "" UBYTE Com_RxSigGrpInfoIndEndIdxOfRxPduInfoType 0 0 0 255 ECU_ADDRESS 0x0 /end MEASUREMENT
/begin MEASUREMENT Com_RxPduInfo[3].RxSigGrpInfoIndStartIdxOfRxPduInfo "" UBYTE Com_RxSigGrpInfoIndStartIdxOfRxPduInfoType 0 0 0 255 ECU_ADDRESS 0x0 /end MEASUREMENT
/begin MEASUREMENT Com_RxPduInfo[3].RxSigInfoEndIdxOfRxPduInfo "" UWORD Com_RxSigInfoEndIdxOfRxPduInfoType 0 0 0 65535 ECU_ADDRESS 0x0 /end MEASUREMENT
/begin MEASUREMENT Com_RxPduInfo[3].RxSigInfoStartIdxOfRxPduInfo "" UWORD Com_RxSigInfoStartIdxOfRxPduInfoType 0 0 0 65535 ECU_ADDRESS 0x0 /end MEASUREMENT
/begin MEASUREMENT Com_RxPduInfo[3].RxTOutInfoIdxOfRxPduInfo "" UBYTE Com_RxTOutInfoIdxOfRxPduInfoType 0 0 0 255 ECU_ADDRESS 0x0 /end MEASUREMENT
/begin MEASUREMENT Com_RxPduInfo[3].RxTOutInfoIndEndIdxOfRxPduInfo "" UBYTE Com_RxTOutInfoIndEndIdxOfRxPduInfoType 0 0 0 255 ECU_ADDRESS 0x0 /end MEASUREMENT
/begin MEASUREMENT Com_RxPduInfo[3].RxTOutInfoIndStartIdxOfRxPduInfo "" UBYTE Com_RxTOutInfoIndStartIdxOfRxPduInfoType 0 0 0 255 ECU_ADDRESS 0x0 /end MEASUREMENT
/begin MEASUREMENT Com_RxPduInfo[40].HandleRxPduDeferredIdxOfRxPduInfo "" UBYTE Com_HandleRxPduDeferredIdxOfRxPduInfoType 0 0 0 255 ECU_ADDRESS 0x0 /end MEASUREMENT
/begin MEASUREMENT Com_RxPduInfo[40].IPduGroupInfoOfRxPduInfoIndEndIdxOfRxPduInfo "" UBYTE Com_IPduGroupInfoOfRxPduInfoIndEndIdxOfRxPduInfoType 0 0 0 255 ECU_ADDRESS 0x0 /end MEASUREMENT
/begin MEASUREMENT Com_RxPduInfo[40].IPduGroupInfoOfRxPduInfoIndStartIdxOfRxPduInfo "" UBYTE Com_IPduGroupInfoOfRxPduInfoIndStartIdxOfRxPduInfoType 0 0 0 255 ECU_ADDRESS 0x0 /end MEASUREMENT
/begin MEASUREMENT Com_RxPduInfo[40].MainFunctionRxStructIdxOfRxPduInfo "" UBYTE Com_MainFunctionRxStructIdxOfRxPduInfoType 0 0 0 255 ECU_ADDRESS 0x0 /end MEASUREMENT
/begin MEASUREMENT Com_RxPduInfo[40].RxAccessInfoIndEndIdxOfRxPduInfo "" UWORD Com_RxAccessInfoIndEndIdxOfRxPduInfoType 0 0 0 65535 ECU_ADDRESS 0x0 /end MEASUREMENT
/begin MEASUREMENT Com_RxPduInfo[40].RxAccessInfoIndStartIdxOfRxPduInfo "" UWORD Com_RxAccessInfoIndStartIdxOfRxPduInfoType 0 0 0 65535 ECU_ADDRESS 0x0 /end MEASUREMENT
/begin MEASUREMENT Com_RxPduInfo[40].RxDefPduBufferEndIdxOfRxPduInfo "" UWORD Com_RxDefPduBufferEndIdxOfRxPduInfoType 0 0 0 65535 ECU_ADDRESS 0x0 /end MEASUREMENT
/begin MEASUREMENT Com_RxPduInfo[40].RxDefPduBufferStartIdxOfRxPduInfo "" UWORD Com_RxDefPduBufferStartIdxOfRxPduInfoType 0 0 0 65535 ECU_ADDRESS 0x0 /end MEASUREMENT
/begin MEASUREMENT Com_RxPduInfo[40].RxPduCalloutFuncPtrIdxOfRxPduInfo "" UBYTE Com_RxPduCalloutFuncPtrIdxOfRxPduInfoType 0 0 0 255 ECU_ADDRESS 0x0 /end MEASUREMENT
/begin MEASUREMENT Com_RxPduInfo[40].RxSigGrpInfoIndEndIdxOfRxPduInfo "" UBYTE Com_RxSigGrpInfoIndEndIdxOfRxPduInfoType 0 0 0 255 ECU_ADDRESS 0x0 /end MEASUREMENT
/begin MEASUREMENT Com_RxPduInfo[40].RxSigGrpInfoIndStartIdxOfRxPduInfo "" UBYTE Com_RxSigGrpInfoIndStartIdxOfRxPduInfoType 0 0 0 255 ECU_ADDRESS 0x0 /end MEASUREMENT
/begin MEASUREMENT Com_RxPduInfo[40].RxSigInfoEndIdxOfRxPduInfo "" UWORD Com_RxSigInfoEndIdxOfRxPduInfoType 0 0 0 65535 ECU_ADDRESS 0x0 /end MEASUREMENT
/begin MEASUREMENT Com_RxPduInfo[40].RxSigInfoStartIdxOfRxPduInfo "" UWORD Com_RxSigInfoStartIdxOfRxPduInfoType 0 0 0 65535 ECU_ADDRESS 0x0 /end MEASUREMENT
/begin MEASUREMENT Com_RxPduInfo[40].RxTOutInfoIdxOfRxPduInfo "" UBYTE Com_RxTOutInfoIdxOfRxPduInfoType 0 0 0 255 ECU_ADDRESS 0x0 /end MEASUREMENT
/begin MEASUREMENT Com_RxPduInfo[40].RxTOutInfoIndEndIdxOfRxPduInfo "" UBYTE Com_RxTOutInfoIndEndIdxOfRxPduInfoType 0 0 0 255 ECU_ADDRESS 0x0 /end MEASUREMENT
/begin MEASUREMENT Com_RxPduInfo[40].RxTOutInfoIndStartIdxOfRxPduInfo "" UBYTE Com_RxTOutInfoIndStartIdxOfRxPduInfoType 0 0 0 255 ECU_ADDRESS 0x0 /end MEASUREMENT
/begin MEASUREMENT Com_RxPduInfo[41].HandleRxPduDeferredIdxOfRxPduInfo "" UBYTE Com_HandleRxPduDeferredIdxOfRxPduInfoType 0 0 0 255 ECU_ADDRESS 0x0 /end MEASUREMENT
/begin MEASUREMENT Com_RxPduInfo[41].IPduGroupInfoOfRxPduInfoIndEndIdxOfRxPduInfo "" UBYTE Com_IPduGroupInfoOfRxPduInfoIndEndIdxOfRxPduInfoType 0 0 0 255 ECU_ADDRESS 0x0 /end MEASUREMENT
/begin MEASUREMENT Com_RxPduInfo[41].IPduGroupInfoOfRxPduInfoIndStartIdxOfRxPduInfo "" UBYTE Com_IPduGroupInfoOfRxPduInfoIndStartIdxOfRxPduInfoType 0 0 0 255 ECU_ADDRESS 0x0 /end MEASUREMENT
/begin MEASUREMENT Com_RxPduInfo[41].MainFunctionRxStructIdxOfRxPduInfo "" UBYTE Com_MainFunctionRxStructIdxOfRxPduInfoType 0 0 0 255 ECU_ADDRESS 0x0 /end MEASUREMENT
/begin MEASUREMENT Com_RxPduInfo[41].RxAccessInfoIndEndIdxOfRxPduInfo "" UWORD Com_RxAccessInfoIndEndIdxOfRxPduInfoType 0 0 0 65535 ECU_ADDRESS 0x0 /end MEASUREMENT
/begin MEASUREMENT Com_RxPduInfo[41].RxAccessInfoIndStartIdxOfRxPduInfo "" UWORD Com_RxAccessInfoIndStartIdxOfRxPduInfoType 0 0 0 65535 ECU_ADDRESS 0x0 /end MEASUREMENT
/begin MEASUREMENT Com_RxPduInfo[41].RxDefPduBufferEndIdxOfRxPduInfo "" UWORD Com_RxDefPduBufferEndIdxOfRxPduInfoType 0 0 0 65535 ECU_ADDRESS 0x0 /end MEASUREMENT
/begin MEASUREMENT Com_RxPduInfo[41].RxDefPduBufferStartIdxOfRxPduInfo "" UWORD Com_RxDefPduBufferStartIdxOfRxPduInfoType 0 0 0 65535 ECU_ADDRESS 0x0 /end MEASUREMENT
/begin MEASUREMENT Com_RxPduInfo[41].RxPduCalloutFuncPtrIdxOfRxPduInfo "" UBYTE Com_RxPduCalloutFuncPtrIdxOfRxPduInfoType 0 0 0 255 ECU_ADDRESS 0x0 /end MEASUREMENT
/begin MEASUREMENT Com_RxPduInfo[41].RxSigGrpInfoIndEndIdxOfRxPduInfo "" UBYTE Com_RxSigGrpInfoIndEndIdxOfRxPduInfoType 0 0 0 255 ECU_ADDRESS 0x0 /end MEASUREMENT
/begin MEASUREMENT Com_RxPduInfo[41].RxSigGrpInfoIndStartIdxOfRxPduInfo "" UBYTE Com_RxSigGrpInfoIndStartIdxOfRxPduInfoType 0 0 0 255 ECU_ADDRESS 0x0 /end MEASUREMENT
/begin MEASUREMENT Com_RxPduInfo[41].RxSigInfoEndIdxOfRxPduInfo "" UWORD Com_RxSigInfoEndIdxOfRxPduInfoType 0 0 0 65535 ECU_ADDRESS 0x0 /end MEASUREMENT
/begin MEASUREMENT Com_RxPduInfo[41].RxSigInfoStartIdxOfRxPduInfo "" UWORD Com_RxSigInfoStartIdxOfRxPduInfoType 0 0 0 65535 ECU_ADDRESS 0x0 /end MEASUREMENT
/begin MEASUREMENT Com_RxPduInfo[41].RxTOutInfoIdxOfRxPduInfo "" UBYTE Com_RxTOutInfoIdxOfRxPduInfoType 0 0 0 255 ECU_ADDRESS 0x0 /end MEASUREMENT
/begin MEASUREMENT Com_RxPduInfo[41].RxTOutInfoIndEndIdxOfRxPduInfo "" UBYTE Com_RxTOutInfoIndEndIdxOfRxPduInfoType 0 0 0 255 ECU_ADDRESS 0x0 /end MEASUREMENT
/begin MEASUREMENT Com_RxPduInfo[41].RxTOutInfoIndStartIdxOfRxPduInfo "" UBYTE Com_RxTOutInfoIndStartIdxOfRxPduInfoType 0 0 0 255 ECU_ADDRESS 0x0 /end MEASUREMENT
/begin MEASUREMENT Com_RxPduInfo[42].HandleRxPduDeferredIdxOfRxPduInfo "" UBYTE Com_HandleRxPduDeferredIdxOfRxPduInfoType 0 0 0 255 ECU_ADDRESS 0x0 /end MEASUREMENT
/begin MEASUREMENT Com_RxPduInfo[42].IPduGroupInfoOfRxPduInfoIndEndIdxOfRxPduInfo "" UBYTE Com_IPduGroupInfoOfRxPduInfoIndEndIdxOfRxPduInfoType 0 0 0 255 ECU_ADDRESS 0x0 /end MEASUREMENT
/begin MEASUREMENT Com_RxPduInfo[42].IPduGroupInfoOfRxPduInfoIndStartIdxOfRxPduInfo "" UBYTE Com_IPduGroupInfoOfRxPduInfoIndStartIdxOfRxPduInfoType 0 0 0 255 ECU_ADDRESS 0x0 /end MEASUREMENT
/begin MEASUREMENT Com_RxPduInfo[42].MainFunctionRxStructIdxOfRxPduInfo "" UBYTE Com_MainFunctionRxStructIdxOfRxPduInfoType 0 0 0 255 ECU_ADDRESS 0x0 /end MEASUREMENT
/begin MEASUREMENT Com_RxPduInfo[42].RxAccessInfoIndEndIdxOfRxPduInfo "" UWORD Com_RxAccessInfoIndEndIdxOfRxPduInfoType 0 0 0 65535 ECU_ADDRESS 0x0 /end MEASUREMENT
/begin MEASUREMENT Com_RxPduInfo[42].RxAccessInfoIndStartIdxOfRxPduInfo "" UWORD Com_RxAccessInfoIndStartIdxOfRxPduInfoType 0 0 0 65535 ECU_ADDRESS 0x0 /end MEASUREMENT
/begin MEASUREMENT Com_RxPduInfo[42].RxDefPduBufferEndIdxOfRxPduInfo "" UWORD Com_RxDefPduBufferEndIdxOfRxPduInfoType 0 0 0 65535 ECU_ADDRESS 0x0 /end MEASUREMENT
/begin MEASUREMENT Com_RxPduInfo[42].RxDefPduBufferStartIdxOfRxPduInfo "" UWORD Com_RxDefPduBufferStartIdxOfRxPduInfoType 0 0 0 65535 ECU_ADDRESS 0x0 /end MEASUREMENT
/begin MEASUREMENT Com_RxPduInfo[42].RxPduCalloutFuncPtrIdxOfRxPduInfo "" UBYTE Com_RxPduCalloutFuncPtrIdxOfRxPduInfoType 0 0 0 255 ECU_ADDRESS 0x0 /end MEASUREMENT
/begin MEASUREMENT Com_RxPduInfo[42].RxSigGrpInfoIndEndIdxOfRxPduInfo "" UBYTE Com_RxSigGrpInfoIndEndIdxOfRxPduInfoType 0 0 0 255 ECU_ADDRESS 0x0 /end MEASUREMENT
/begin MEASUREMENT Com_RxPduInfo[42].RxSigGrpInfoIndStartIdxOfRxPduInfo "" UBYTE Com_RxSigGrpInfoIndStartIdxOfRxPduInfoType 0 0 0 255 ECU_ADDRESS 0x0 /end MEASUREMENT
/begin MEASUREMENT Com_RxPduInfo[42].RxSigInfoEndIdxOfRxPduInfo "" UWORD Com_RxSigInfoEndIdxOfRxPduInfoType 0 0 0 65535 ECU_ADDRESS 0x0 /end MEASUREMENT
/begin MEASUREMENT Com_RxPduInfo[42].RxSigInfoStartIdxOfRxPduInfo "" UWORD Com_RxSigInfoStartIdxOfRxPduInfoType 0 0 0 65535 ECU_ADDRESS 0x0 /end MEASUREMENT
/begin MEASUREMENT Com_RxPduInfo[42].RxTOutInfoIdxOfRxPduInfo "" UBYTE Com_RxTOutInfoIdxOfRxPduInfoType 0 0 0 255 ECU_ADDRESS 0x0 /end MEASUREMENT
/begin MEASUREMENT Com_RxPduInfo[42].RxTOutInfoIndEndIdxOfRxPduInfo "" UBYTE Com_RxTOutInfoIndEndIdxOfRxPduInfoType 0 0 0 255 ECU_ADDRESS 0x0 /end MEASUREMENT
/begin MEASUREMENT Com_RxPduInfo[42].RxTOutInfoIndStartIdxOfRxPduInfo "" UBYTE Com_RxTOutInfoIndStartIdxOfRxPduInfoType 0 0 0 255 ECU_ADDRESS 0x0 /end MEASUREMENT
/begin MEASUREMENT Com_RxPduInfo[43].HandleRxPduDeferredIdxOfRxPduInfo "" UBYTE Com_HandleRxPduDeferredIdxOfRxPduInfoType 0 0 0 255 ECU_ADDRESS 0x0 /end MEASUREMENT
/begin MEASUREMENT Com_RxPduInfo[43].IPduGroupInfoOfRxPduInfoIndEndIdxOfRxPduInfo "" UBYTE Com_IPduGroupInfoOfRxPduInfoIndEndIdxOfRxPduInfoType 0 0 0 255 ECU_ADDRESS 0x0 /end MEASUREMENT
/begin MEASUREMENT Com_RxPduInfo[43].IPduGroupInfoOfRxPduInfoIndStartIdxOfRxPduInfo "" UBYTE Com_IPduGroupInfoOfRxPduInfoIndStartIdxOfRxPduInfoType 0 0 0 255 ECU_ADDRESS 0x0 /end MEASUREMENT
/begin MEASUREMENT Com_RxPduInfo[43].MainFunctionRxStructIdxOfRxPduInfo "" UBYTE Com_MainFunctionRxStructIdxOfRxPduInfoType 0 0 0 255 ECU_ADDRESS 0x0 /end MEASUREMENT
/begin MEASUREMENT Com_RxPduInfo[43].RxAccessInfoIndEndIdxOfRxPduInfo "" UWORD Com_RxAccessInfoIndEndIdxOfRxPduInfoType 0 0 0 65535 ECU_ADDRESS 0x0 /end MEASUREMENT
/begin MEASUREMENT Com_RxPduInfo[43].RxAccessInfoIndStartIdxOfRxPduInfo "" UWORD Com_RxAccessInfoIndStartIdxOfRxPduInfoType 0 0 0 65535 ECU_ADDRESS 0x0 /end MEASUREMENT
/begin MEASUREMENT Com_RxPduInfo[43].RxDefPduBufferEndIdxOfRxPduInfo "" UWORD Com_RxDefPduBufferEndIdxOfRxPduInfoType 0 0 0 65535 ECU_ADDRESS 0x0 /end MEASUREMENT
/begin MEASUREMENT Com_RxPduInfo[43].RxDefPduBufferStartIdxOfRxPduInfo "" UWORD Com_RxDefPduBufferStartIdxOfRxPduInfoType 0 0 0 65535 ECU_ADDRESS 0x0 /end MEASUREMENT
/begin MEASUREMENT Com_RxPduInfo[43].RxPduCalloutFuncPtrIdxOfRxPduInfo "" UBYTE Com_RxPduCalloutFuncPtrIdxOfRxPduInfoType 0 0 0 255 ECU_ADDRESS 0x0 /end MEASUREMENT
/begin MEASUREMENT Com_RxPduInfo[43].RxSigGrpInfoIndEndIdxOfRxPduInfo "" UBYTE Com_RxSigGrpInfoIndEndIdxOfRxPduInfoType 0 0 0 255 ECU_ADDRESS 0x0 /end MEASUREMENT
/begin MEASUREMENT Com_RxPduInfo[43].RxSigGrpInfoIndStartIdxOfRxPduInfo "" UBYTE Com_RxSigGrpInfoIndStartIdxOfRxPduInfoType 0 0 0 255 ECU_ADDRESS 0x0 /end MEASUREMENT
/begin MEASUREMENT Com_RxPduInfo[43].RxSigInfoEndIdxOfRxPduInfo "" UWORD Com_RxSigInfoEndIdxOfRxPduInfoType 0 0 0 65535 ECU_ADDRESS 0x0 /end MEASUREMENT
/begin MEASUREMENT Com_RxPduInfo[43].RxSigInfoStartIdxOfRxPduInfo "" UWORD Com_RxSigInfoStartIdxOfRxPduInfoType 0 0 0 65535 ECU_ADDRESS 0x0 /end MEASUREMENT
/begin MEASUREMENT Com_RxPduInfo[43].RxTOutInfoIdxOfRxPduInfo "" UBYTE Com_RxTOutInfoIdxOfRxPduInfoType 0 0 0 255 ECU_ADDRESS 0x0 /end MEASUREMENT
/begin MEASUREMENT Com_RxPduInfo[43].RxTOutInfoIndEndIdxOfRxPduInfo "" UBYTE Com_RxTOutInfoIndEndIdxOfRxPduInfoType 0 0 0 255 ECU_ADDRESS 0x0 /end MEASUREMENT
/begin MEASUREMENT Com_RxPduInfo[43].RxTOutInfoIndStartIdxOfRxPduInfo "" UBYTE Com_RxTOutInfoIndStartIdxOfRxPduInfoType 0 0 0 255 ECU_ADDRESS 0x0 /end MEASUREMENT
/begin MEASUREMENT Com_RxPduInfo[44].HandleRxPduDeferredIdxOfRxPduInfo "" UBYTE Com_HandleRxPduDeferredIdxOfRxPduInfoType 0 0 0 255 ECU_ADDRESS 0x0 /end MEASUREMENT
/begin MEASUREMENT Com_RxPduInfo[44].IPduGroupInfoOfRxPduInfoIndEndIdxOfRxPduInfo "" UBYTE Com_IPduGroupInfoOfRxPduInfoIndEndIdxOfRxPduInfoType 0 0 0 255 ECU_ADDRESS 0x0 /end MEASUREMENT
/begin MEASUREMENT Com_RxPduInfo[44].IPduGroupInfoOfRxPduInfoIndStartIdxOfRxPduInfo "" UBYTE Com_IPduGroupInfoOfRxPduInfoIndStartIdxOfRxPduInfoType 0 0 0 255 ECU_ADDRESS 0x0 /end MEASUREMENT
/begin MEASUREMENT Com_RxPduInfo[44].MainFunctionRxStructIdxOfRxPduInfo "" UBYTE Com_MainFunctionRxStructIdxOfRxPduInfoType 0 0 0 255 ECU_ADDRESS 0x0 /end MEASUREMENT
/begin MEASUREMENT Com_RxPduInfo[44].RxAccessInfoIndEndIdxOfRxPduInfo "" UWORD Com_RxAccessInfoIndEndIdxOfRxPduInfoType 0 0 0 65535 ECU_ADDRESS 0x0 /end MEASUREMENT
/begin MEASUREMENT Com_RxPduInfo[44].RxAccessInfoIndStartIdxOfRxPduInfo "" UWORD Com_RxAccessInfoIndStartIdxOfRxPduInfoType 0 0 0 65535 ECU_ADDRESS 0x0 /end MEASUREMENT
/begin MEASUREMENT Com_RxPduInfo[44].RxDefPduBufferEndIdxOfRxPduInfo "" UWORD Com_RxDefPduBufferEndIdxOfRxPduInfoType 0 0 0 65535 ECU_ADDRESS 0x0 /end MEASUREMENT
/begin MEASUREMENT Com_RxPduInfo[44].RxDefPduBufferStartIdxOfRxPduInfo "" UWORD Com_RxDefPduBufferStartIdxOfRxPduInfoType 0 0 0 65535 ECU_ADDRESS 0x0 /end MEASUREMENT
/begin MEASUREMENT Com_RxPduInfo[44].RxPduCalloutFuncPtrIdxOfRxPduInfo "" UBYTE Com_RxPduCalloutFuncPtrIdxOfRxPduInfoType 0 0 0 255 ECU_ADDRESS 0x0 /end MEASUREMENT
/begin MEASUREMENT Com_RxPduInfo[44].RxSigGrpInfoIndEndIdxOfRxPduInfo "" UBYTE Com_RxSigGrpInfoIndEndIdxOfRxPduInfoType 0 0 0 255 ECU_ADDRESS 0x0 /end MEASUREMENT
/begin MEASUREMENT Com_RxPduInfo[44].RxSigGrpInfoIndStartIdxOfRxPduInfo "" UBYTE Com_RxSigGrpInfoIndStartIdxOfRxPduInfoType 0 0 0 255 ECU_ADDRESS 0x0 /end MEASUREMENT
/begin MEASUREMENT Com_RxPduInfo[44].RxSigInfoEndIdxOfRxPduInfo "" UWORD Com_RxSigInfoEndIdxOfRxPduInfoType 0 0 0 65535 ECU_ADDRESS 0x0 /end MEASUREMENT
/begin MEASUREMENT Com_RxPduInfo[44].RxSigInfoStartIdxOfRxPduInfo "" UWORD Com_RxSigInfoStartIdxOfRxPduInfoType 0 0 0 65535 ECU_ADDRESS 0x0 /end MEASUREMENT
/begin MEASUREMENT Com_RxPduInfo[44].RxTOutInfoIdxOfRxPduInfo "" UBYTE Com_RxTOutInfoIdxOfRxPduInfoType 0 0 0 255 ECU_ADDRESS 0x0 /end MEASUREMENT
/begin MEASUREMENT Com_RxPduInfo[44].RxTOutInfoIndEndIdxOfRxPduInfo "" UBYTE Com_RxTOutInfoIndEndIdxOfRxPduInfoType 0 0 0 255 ECU_ADDRESS 0x0 /end MEASUREMENT
/begin MEASUREMENT Com_RxPduInfo[44].RxTOutInfoIndStartIdxOfRxPduInfo "" UBYTE Com_RxTOutInfoIndStartIdxOfRxPduInfoType 0 0 0 255 ECU_ADDRESS 0x0 /end MEASUREMENT
/begin MEASUREMENT Com_RxPduInfo[45].HandleRxPduDeferredIdxOfRxPduInfo "" UBYTE Com_HandleRxPduDeferredIdxOfRxPduInfoType 0 0 0 255 ECU_ADDRESS 0x0 /end MEASUREMENT
/begin MEASUREMENT Com_RxPduInfo[45].IPduGroupInfoOfRxPduInfoIndEndIdxOfRxPduInfo "" UBYTE Com_IPduGroupInfoOfRxPduInfoIndEndIdxOfRxPduInfoType 0 0 0 255 ECU_ADDRESS 0x0 /end MEASUREMENT
/begin MEASUREMENT Com_RxPduInfo[45].IPduGroupInfoOfRxPduInfoIndStartIdxOfRxPduInfo "" UBYTE Com_IPduGroupInfoOfRxPduInfoIndStartIdxOfRxPduInfoType 0 0 0 255 ECU_ADDRESS 0x0 /end MEASUREMENT
/begin MEASUREMENT Com_RxPduInfo[45].MainFunctionRxStructIdxOfRxPduInfo "" UBYTE Com_MainFunctionRxStructIdxOfRxPduInfoType 0 0 0 255 ECU_ADDRESS 0x0 /end MEASUREMENT
/begin MEASUREMENT Com_RxPduInfo[45].RxAccessInfoIndEndIdxOfRxPduInfo "" UWORD Com_RxAccessInfoIndEndIdxOfRxPduInfoType 0 0 0 65535 ECU_ADDRESS 0x0 /end MEASUREMENT
/begin MEASUREMENT Com_RxPduInfo[45].RxAccessInfoIndStartIdxOfRxPduInfo "" UWORD Com_RxAccessInfoIndStartIdxOfRxPduInfoType 0 0 0 65535 ECU_ADDRESS 0x0 /end MEASUREMENT
/begin MEASUREMENT Com_RxPduInfo[45].RxDefPduBufferEndIdxOfRxPduInfo "" UWORD Com_RxDefPduBufferEndIdxOfRxPduInfoType 0 0 0 65535 ECU_ADDRESS 0x0 /end MEASUREMENT
/begin MEASUREMENT Com_RxPduInfo[45].RxDefPduBufferStartIdxOfRxPduInfo "" UWORD Com_RxDefPduBufferStartIdxOfRxPduInfoType 0 0 0 65535 ECU_ADDRESS 0x0 /end MEASUREMENT
/begin MEASUREMENT Com_RxPduInfo[45].RxPduCalloutFuncPtrIdxOfRxPduInfo "" UBYTE Com_RxPduCalloutFuncPtrIdxOfRxPduInfoType 0 0 0 255 ECU_ADDRESS 0x0 /end MEASUREMENT
/begin MEASUREMENT Com_RxPduInfo[45].RxSigGrpInfoIndEndIdxOfRxPduInfo "" UBYTE Com_RxSigGrpInfoIndEndIdxOfRxPduInfoType 0 0 0 255 ECU_ADDRESS 0x0 /end MEASUREMENT
/begin MEASUREMENT Com_RxPduInfo[45].RxSigGrpInfoIndStartIdxOfRxPduInfo "" UBYTE Com_RxSigGrpInfoIndStartIdxOfRxPduInfoType 0 0 0 255 ECU_ADDRESS 0x0 /end MEASUREMENT
/begin MEASUREMENT Com_RxPduInfo[45].RxSigInfoEndIdxOfRxPduInfo "" UWORD Com_RxSigInfoEndIdxOfRxPduInfoType 0 0 0 65535 ECU_ADDRESS 0x0 /end MEASUREMENT
/begin MEASUREMENT Com_RxPduInfo[45].RxSigInfoStartIdxOfRxPduInfo "" UWORD Com_RxSigInfoStartIdxOfRxPduInfoType 0 0 0 65535 ECU_ADDRESS 0x0 /end MEASUREMENT
/begin MEASUREMENT Com_RxPduInfo[45].RxTOutInfoIdxOfRxPduInfo "" UBYTE Com_RxTOutInfoIdxOfRxPduInfoType 0 0 0 255 ECU_ADDRESS 0x0 /end MEASUREMENT
/begin MEASUREMENT Com_RxPduInfo[45].RxTOutInfoIndEndIdxOfRxPduInfo "" UBYTE Com_RxTOutInfoIndEndIdxOfRxPduInfoType 0 0 0 255 ECU_ADDRESS 0x0 /end MEASUREMENT
/begin MEASUREMENT Com_RxPduInfo[45].RxTOutInfoIndStartIdxOfRxPduInfo "" UBYTE Com_RxTOutInfoIndStartIdxOfRxPduInfoType 0 0 0 255 ECU_ADDRESS 0x0 /end MEASUREMENT
/begin MEASUREMENT Com_RxPduInfo[46].HandleRxPduDeferredIdxOfRxPduInfo "" UBYTE Com_HandleRxPduDeferredIdxOfRxPduInfoType 0 0 0 255 ECU_ADDRESS 0x0 /end MEASUREMENT
/begin MEASUREMENT Com_RxPduInfo[46].IPduGroupInfoOfRxPduInfoIndEndIdxOfRxPduInfo "" UBYTE Com_IPduGroupInfoOfRxPduInfoIndEndIdxOfRxPduInfoType 0 0 0 255 ECU_ADDRESS 0x0 /end MEASUREMENT
/begin MEASUREMENT Com_RxPduInfo[46].IPduGroupInfoOfRxPduInfoIndStartIdxOfRxPduInfo "" UBYTE Com_IPduGroupInfoOfRxPduInfoIndStartIdxOfRxPduInfoType 0 0 0 255 ECU_ADDRESS 0x0 /end MEASUREMENT
/begin MEASUREMENT Com_RxPduInfo[46].MainFunctionRxStructIdxOfRxPduInfo "" UBYTE Com_MainFunctionRxStructIdxOfRxPduInfoType 0 0 0 255 ECU_ADDRESS 0x0 /end MEASUREMENT
/begin MEASUREMENT Com_RxPduInfo[46].RxAccessInfoIndEndIdxOfRxPduInfo "" UWORD Com_RxAccessInfoIndEndIdxOfRxPduInfoType 0 0 0 65535 ECU_ADDRESS 0x0 /end MEASUREMENT
/begin MEASUREMENT Com_RxPduInfo[46].RxAccessInfoIndStartIdxOfRxPduInfo "" UWORD Com_RxAccessInfoIndStartIdxOfRxPduInfoType 0 0 0 65535 ECU_ADDRESS 0x0 /end MEASUREMENT
/begin MEASUREMENT Com_RxPduInfo[46].RxDefPduBufferEndIdxOfRxPduInfo "" UWORD Com_RxDefPduBufferEndIdxOfRxPduInfoType 0 0 0 65535 ECU_ADDRESS 0x0 /end MEASUREMENT
/begin MEASUREMENT Com_RxPduInfo[46].RxDefPduBufferStartIdxOfRxPduInfo "" UWORD Com_RxDefPduBufferStartIdxOfRxPduInfoType 0 0 0 65535 ECU_ADDRESS 0x0 /end MEASUREMENT
/begin MEASUREMENT Com_RxPduInfo[46].RxPduCalloutFuncPtrIdxOfRxPduInfo "" UBYTE Com_RxPduCalloutFuncPtrIdxOfRxPduInfoType 0 0 0 255 ECU_ADDRESS 0x0 /end MEASUREMENT
/begin MEASUREMENT Com_RxPduInfo[46].RxSigGrpInfoIndEndIdxOfRxPduInfo "" UBYTE Com_RxSigGrpInfoIndEndIdxOfRxPduInfoType 0 0 0 255 ECU_ADDRESS 0x0 /end MEASUREMENT
/begin MEASUREMENT Com_RxPduInfo[46].RxSigGrpInfoIndStartIdxOfRxPduInfo "" UBYTE Com_RxSigGrpInfoIndStartIdxOfRxPduInfoType 0 0 0 255 ECU_ADDRESS 0x0 /end MEASUREMENT
/begin MEASUREMENT Com_RxPduInfo[46].RxSigInfoEndIdxOfRxPduInfo "" UWORD Com_RxSigInfoEndIdxOfRxPduInfoType 0 0 0 65535 ECU_ADDRESS 0x0 /end MEASUREMENT
/begin MEASUREMENT Com_RxPduInfo[46].RxSigInfoStartIdxOfRxPduInfo "" UWORD Com_RxSigInfoStartIdxOfRxPduInfoType 0 0 0 65535 ECU_ADDRESS 0x0 /end MEASUREMENT
/begin MEASUREMENT Com_RxPduInfo[46].RxTOutInfoIdxOfRxPduInfo "" UBYTE Com_RxTOutInfoIdxOfRxPduInfoType 0 0 0 255 ECU_ADDRESS 0x0 /end MEASUREMENT
/begin MEASUREMENT Com_RxPduInfo[46].RxTOutInfoIndEndIdxOfRxPduInfo "" UBYTE Com_RxTOutInfoIndEndIdxOfRxPduInfoType 0 0 0 255 ECU_ADDRESS 0x0 /end MEASUREMENT
/begin MEASUREMENT Com_RxPduInfo[46].RxTOutInfoIndStartIdxOfRxPduInfo "" UBYTE Com_RxTOutInfoIndStartIdxOfRxPduInfoType 0 0 0 255 ECU_ADDRESS 0x0 /end MEASUREMENT
/begin MEASUREMENT Com_RxPduInfo[47].HandleRxPduDeferredIdxOfRxPduInfo "" UBYTE Com_HandleRxPduDeferredIdxOfRxPduInfoType 0 0 0 255 ECU_ADDRESS 0x0 /end MEASUREMENT
/begin MEASUREMENT Com_RxPduInfo[47].IPduGroupInfoOfRxPduInfoIndEndIdxOfRxPduInfo "" UBYTE Com_IPduGroupInfoOfRxPduInfoIndEndIdxOfRxPduInfoType 0 0 0 255 ECU_ADDRESS 0x0 /end MEASUREMENT
/begin MEASUREMENT Com_RxPduInfo[47].IPduGroupInfoOfRxPduInfoIndStartIdxOfRxPduInfo "" UBYTE Com_IPduGroupInfoOfRxPduInfoIndStartIdxOfRxPduInfoType 0 0 0 255 ECU_ADDRESS 0x0 /end MEASUREMENT
/begin MEASUREMENT Com_RxPduInfo[47].MainFunctionRxStructIdxOfRxPduInfo "" UBYTE Com_MainFunctionRxStructIdxOfRxPduInfoType 0 0 0 255 ECU_ADDRESS 0x0 /end MEASUREMENT
/begin MEASUREMENT Com_RxPduInfo[47].RxAccessInfoIndEndIdxOfRxPduInfo "" UWORD Com_RxAccessInfoIndEndIdxOfRxPduInfoType 0 0 0 65535 ECU_ADDRESS 0x0 /end MEASUREMENT
/begin MEASUREMENT Com_RxPduInfo[47].RxAccessInfoIndStartIdxOfRxPduInfo "" UWORD Com_RxAccessInfoIndStartIdxOfRxPduInfoType 0 0 0 65535 ECU_ADDRESS 0x0 /end MEASUREMENT
/begin MEASUREMENT Com_RxPduInfo[47].RxDefPduBufferEndIdxOfRxPduInfo "" UWORD Com_RxDefPduBufferEndIdxOfRxPduInfoType 0 0 0 65535 ECU_ADDRESS 0x0 /end MEASUREMENT
/begin MEASUREMENT Com_RxPduInfo[47].RxDefPduBufferStartIdxOfRxPduInfo "" UWORD Com_RxDefPduBufferStartIdxOfRxPduInfoType 0 0 0 65535 ECU_ADDRESS 0x0 /end MEASUREMENT
/begin MEASUREMENT Com_RxPduInfo[47].RxPduCalloutFuncPtrIdxOfRxPduInfo "" UBYTE Com_RxPduCalloutFuncPtrIdxOfRxPduInfoType 0 0 0 255 ECU_ADDRESS 0x0 /end MEASUREMENT
/begin MEASUREMENT Com_RxPduInfo[47].RxSigGrpInfoIndEndIdxOfRxPduInfo "" UBYTE Com_RxSigGrpInfoIndEndIdxOfRxPduInfoType 0 0 0 255 ECU_ADDRESS 0x0 /end MEASUREMENT
/begin MEASUREMENT Com_RxPduInfo[47].RxSigGrpInfoIndStartIdxOfRxPduInfo "" UBYTE Com_RxSigGrpInfoIndStartIdxOfRxPduInfoType 0 0 0 255 ECU_ADDRESS 0x0 /end MEASUREMENT
/begin MEASUREMENT Com_RxPduInfo[47].RxSigInfoEndIdxOfRxPduInfo "" UWORD Com_RxSigInfoEndIdxOfRxPduInfoType 0 0 0 65535 ECU_ADDRESS 0x0 /end MEASUREMENT
/begin MEASUREMENT Com_RxPduInfo[47].RxSigInfoStartIdxOfRxPduInfo "" UWORD Com_RxSigInfoStartIdxOfRxPduInfoType 0 0 0 65535 ECU_ADDRESS 0x0 /end MEASUREMENT
/begin MEASUREMENT Com_RxPduInfo[47].RxTOutInfoIdxOfRxPduInfo "" UBYTE Com_RxTOutInfoIdxOfRxPduInfoType 0 0 0 255 ECU_ADDRESS 0x0 /end MEASUREMENT
/begin MEASUREMENT Com_RxPduInfo[47].RxTOutInfoIndEndIdxOfRxPduInfo "" UBYTE Com_RxTOutInfoIndEndIdxOfRxPduInfoType 0 0 0 255 ECU_ADDRESS 0x0 /end MEASUREMENT
/begin MEASUREMENT Com_RxPduInfo[47].RxTOutInfoIndStartIdxOfRxPduInfo "" UBYTE Com_RxTOutInfoIndStartIdxOfRxPduInfoType 0 0 0 255 ECU_ADDRESS 0x0 /end MEASUREMENT
/begin MEASUREMENT Com_RxPduInfo[48].HandleRxPduDeferredIdxOfRxPduInfo "" UBYTE Com_HandleRxPduDeferredIdxOfRxPduInfoType 0 0 0 255 ECU_ADDRESS 0x0 /end MEASUREMENT
/begin MEASUREMENT Com_RxPduInfo[48].IPduGroupInfoOfRxPduInfoIndEndIdxOfRxPduInfo "" UBYTE Com_IPduGroupInfoOfRxPduInfoIndEndIdxOfRxPduInfoType 0 0 0 255 ECU_ADDRESS 0x0 /end MEASUREMENT
/begin MEASUREMENT Com_RxPduInfo[48].IPduGroupInfoOfRxPduInfoIndStartIdxOfRxPduInfo "" UBYTE Com_IPduGroupInfoOfRxPduInfoIndStartIdxOfRxPduInfoType 0 0 0 255 ECU_ADDRESS 0x0 /end MEASUREMENT
/begin MEASUREMENT Com_RxPduInfo[48].MainFunctionRxStructIdxOfRxPduInfo "" UBYTE Com_MainFunctionRxStructIdxOfRxPduInfoType 0 0 0 255 ECU_ADDRESS 0x0 /end MEASUREMENT
/begin MEASUREMENT Com_RxPduInfo[48].RxAccessInfoIndEndIdxOfRxPduInfo "" UWORD Com_RxAccessInfoIndEndIdxOfRxPduInfoType 0 0 0 65535 ECU_ADDRESS 0x0 /end MEASUREMENT
/begin MEASUREMENT Com_RxPduInfo[48].RxAccessInfoIndStartIdxOfRxPduInfo "" UWORD Com_RxAccessInfoIndStartIdxOfRxPduInfoType 0 0 0 65535 ECU_ADDRESS 0x0 /end MEASUREMENT
/begin MEASUREMENT Com_RxPduInfo[48].RxDefPduBufferEndIdxOfRxPduInfo "" UWORD Com_RxDefPduBufferEndIdxOfRxPduInfoType 0 0 0 65535 ECU_ADDRESS 0x0 /end MEASUREMENT
/begin MEASUREMENT Com_RxPduInfo[48].RxDefPduBufferStartIdxOfRxPduInfo "" UWORD Com_RxDefPduBufferStartIdxOfRxPduInfoType 0 0 0 65535 ECU_ADDRESS 0x0 /end MEASUREMENT
/begin MEASUREMENT Com_RxPduInfo[48].RxPduCalloutFuncPtrIdxOfRxPduInfo "" UBYTE Com_RxPduCalloutFuncPtrIdxOfRxPduInfoType 0 0 0 255 ECU_ADDRESS 0x0 /end MEASUREMENT
/begin MEASUREMENT Com_RxPduInfo[48].RxSigGrpInfoIndEndIdxOfRxPduInfo "" UBYTE Com_RxSigGrpInfoIndEndIdxOfRxPduInfoType 0 0 0 255 ECU_ADDRESS 0x0 /end MEASUREMENT
/begin MEASUREMENT Com_RxPduInfo[48].RxSigGrpInfoIndStartIdxOfRxPduInfo "" UBYTE Com_RxSigGrpInfoIndStartIdxOfRxPduInfoType 0 0 0 255 ECU_ADDRESS 0x0 /end MEASUREMENT
/begin MEASUREMENT Com_RxPduInfo[48].RxSigInfoEndIdxOfRxPduInfo "" UWORD Com_RxSigInfoEndIdxOfRxPduInfoType 0 0 0 65535 ECU_ADDRESS 0x0 /end MEASUREMENT
/begin MEASUREMENT Com_RxPduInfo[48].RxSigInfoStartIdxOfRxPduInfo "" UWORD Com_RxSigInfoStartIdxOfRxPduInfoType 0 0 0 65535 ECU_ADDRESS 0x0 /end MEASUREMENT
/begin MEASUREMENT Com_RxPduInfo[48].RxTOutInfoIdxOfRxPduInfo "" UBYTE Com_RxTOutInfoIdxOfRxPduInfoType 0 0 0 255 ECU_ADDRESS 0x0 /end MEASUREMENT
/begin MEASUREMENT Com_RxPduInfo[48].RxTOutInfoIndEndIdxOfRxPduInfo "" UBYTE Com_RxTOutInfoIndEndIdxOfRxPduInfoType 0 0 0 255 ECU_ADDRESS 0x0 /end MEASUREMENT
/begin MEASUREMENT Com_RxPduInfo[48].RxTOutInfoIndStartIdxOfRxPduInfo "" UBYTE Com_RxTOutInfoIndStartIdxOfRxPduInfoType 0 0 0 255 ECU_ADDRESS 0x0 /end MEASUREMENT
/begin MEASUREMENT Com_RxPduInfo[49].HandleRxPduDeferredIdxOfRxPduInfo "" UBYTE Com_HandleRxPduDeferredIdxOfRxPduInfoType 0 0 0 255 ECU_ADDRESS 0x0 /end MEASUREMENT
/begin MEASUREMENT Com_RxPduInfo[49].IPduGroupInfoOfRxPduInfoIndEndIdxOfRxPduInfo "" UBYTE Com_IPduGroupInfoOfRxPduInfoIndEndIdxOfRxPduInfoType 0 0 0 255 ECU_ADDRESS 0x0 /end MEASUREMENT
/begin MEASUREMENT Com_RxPduInfo[49].IPduGroupInfoOfRxPduInfoIndStartIdxOfRxPduInfo "" UBYTE Com_IPduGroupInfoOfRxPduInfoIndStartIdxOfRxPduInfoType 0 0 0 255 ECU_ADDRESS 0x0 /end MEASUREMENT
/begin MEASUREMENT Com_RxPduInfo[49].MainFunctionRxStructIdxOfRxPduInfo "" UBYTE Com_MainFunctionRxStructIdxOfRxPduInfoType 0 0 0 255 ECU_ADDRESS 0x0 /end MEASUREMENT
/begin MEASUREMENT Com_RxPduInfo[49].RxAccessInfoIndEndIdxOfRxPduInfo "" UWORD Com_RxAccessInfoIndEndIdxOfRxPduInfoType 0 0 0 65535 ECU_ADDRESS 0x0 /end MEASUREMENT
/begin MEASUREMENT Com_RxPduInfo[49].RxAccessInfoIndStartIdxOfRxPduInfo "" UWORD Com_RxAccessInfoIndStartIdxOfRxPduInfoType 0 0 0 65535 ECU_ADDRESS 0x0 /end MEASUREMENT
/begin MEASUREMENT Com_RxPduInfo[49].RxDefPduBufferEndIdxOfRxPduInfo "" UWORD Com_RxDefPduBufferEndIdxOfRxPduInfoType 0 0 0 65535 ECU_ADDRESS 0x0 /end MEASUREMENT
/begin MEASUREMENT Com_RxPduInfo[49].RxDefPduBufferStartIdxOfRxPduInfo "" UWORD Com_RxDefPduBufferStartIdxOfRxPduInfoType 0 0 0 65535 ECU_ADDRESS 0x0 /end MEASUREMENT
/begin MEASUREMENT Com_RxPduInfo[49].RxPduCalloutFuncPtrIdxOfRxPduInfo "" UBYTE Com_RxPduCalloutFuncPtrIdxOfRxPduInfoType 0 0 0 255 ECU_ADDRESS 0x0 /end MEASUREMENT
/begin MEASUREMENT Com_RxPduInfo[49].RxSigGrpInfoIndEndIdxOfRxPduInfo "" UBYTE Com_RxSigGrpInfoIndEndIdxOfRxPduInfoType 0 0 0 255 ECU_ADDRESS 0x0 /end MEASUREMENT
/begin MEASUREMENT Com_RxPduInfo[49].RxSigGrpInfoIndStartIdxOfRxPduInfo "" UBYTE Com_RxSigGrpInfoIndStartIdxOfRxPduInfoType 0 0 0 255 ECU_ADDRESS 0x0 /end MEASUREMENT
/begin MEASUREMENT Com_RxPduInfo[49].RxSigInfoEndIdxOfRxPduInfo "" UWORD Com_RxSigInfoEndIdxOfRxPduInfoType 0 0 0 65535 ECU_ADDRESS 0x0 /end MEASUREMENT
/begin MEASUREMENT Com_RxPduInfo[49].RxSigInfoStartIdxOfRxPduInfo "" UWORD Com_RxSigInfoStartIdxOfRxPduInfoType 0 0 0 65535 ECU_ADDRESS 0x0 /end MEASUREMENT
/begin MEASUREMENT Com_RxPduInfo[49].RxTOutInfoIdxOfRxPduInfo "" UBYTE Com_RxTOutInfoIdxOfRxPduInfoType 0 0 0 255 ECU_ADDRESS 0x0 /end MEASUREMENT
/begin MEASUREMENT Com_RxPduInfo[49].RxTOutInfoIndEndIdxOfRxPduInfo "" UBYTE Com_RxTOutInfoIndEndIdxOfRxPduInfoType 0 0 0 255 ECU_ADDRESS 0x0 /end MEASUREMENT
/begin MEASUREMENT Com_RxPduInfo[49].RxTOutInfoIndStartIdxOfRxPduInfo "" UBYTE Com_RxTOutInfoIndStartIdxOfRxPduInfoType 0 0 0 255 ECU_ADDRESS 0x0 /end MEASUREMENT
/begin MEASUREMENT Com_RxPduInfo[4].HandleRxPduDeferredIdxOfRxPduInfo "" UBYTE Com_HandleRxPduDeferredIdxOfRxPduInfoType 0 0 0 255 ECU_ADDRESS 0x0 /end MEASUREMENT
/begin MEASUREMENT Com_RxPduInfo[4].IPduGroupInfoOfRxPduInfoIndEndIdxOfRxPduInfo "" UBYTE Com_IPduGroupInfoOfRxPduInfoIndEndIdxOfRxPduInfoType 0 0 0 255 ECU_ADDRESS 0x0 /end MEASUREMENT
/begin MEASUREMENT Com_RxPduInfo[4].IPduGroupInfoOfRxPduInfoIndStartIdxOfRxPduInfo "" UBYTE Com_IPduGroupInfoOfRxPduInfoIndStartIdxOfRxPduInfoType 0 0 0 255 ECU_ADDRESS 0x0 /end MEASUREMENT
/begin MEASUREMENT Com_RxPduInfo[4].MainFunctionRxStructIdxOfRxPduInfo "" UBYTE Com_MainFunctionRxStructIdxOfRxPduInfoType 0 0 0 255 ECU_ADDRESS 0x0 /end MEASUREMENT
/begin MEASUREMENT Com_RxPduInfo[4].RxAccessInfoIndEndIdxOfRxPduInfo "" UWORD Com_RxAccessInfoIndEndIdxOfRxPduInfoType 0 0 0 65535 ECU_ADDRESS 0x0 /end MEASUREMENT
/begin MEASUREMENT Com_RxPduInfo[4].RxAccessInfoIndStartIdxOfRxPduInfo "" UWORD Com_RxAccessInfoIndStartIdxOfRxPduInfoType 0 0 0 65535 ECU_ADDRESS 0x0 /end MEASUREMENT
/begin MEASUREMENT Com_RxPduInfo[4].RxDefPduBufferEndIdxOfRxPduInfo "" UWORD Com_RxDefPduBufferEndIdxOfRxPduInfoType 0 0 0 65535 ECU_ADDRESS 0x0 /end MEASUREMENT
/begin MEASUREMENT Com_RxPduInfo[4].RxDefPduBufferStartIdxOfRxPduInfo "" UWORD Com_RxDefPduBufferStartIdxOfRxPduInfoType 0 0 0 65535 ECU_ADDRESS 0x0 /end MEASUREMENT
/begin MEASUREMENT Com_RxPduInfo[4].RxPduCalloutFuncPtrIdxOfRxPduInfo "" UBYTE Com_RxPduCalloutFuncPtrIdxOfRxPduInfoType 0 0 0 255 ECU_ADDRESS 0x0 /end MEASUREMENT
/begin MEASUREMENT Com_RxPduInfo[4].RxSigGrpInfoIndEndIdxOfRxPduInfo "" UBYTE Com_RxSigGrpInfoIndEndIdxOfRxPduInfoType 0 0 0 255 ECU_ADDRESS 0x0 /end MEASUREMENT
/begin MEASUREMENT Com_RxPduInfo[4].RxSigGrpInfoIndStartIdxOfRxPduInfo "" UBYTE Com_RxSigGrpInfoIndStartIdxOfRxPduInfoType 0 0 0 255 ECU_ADDRESS 0x0 /end MEASUREMENT
/begin MEASUREMENT Com_RxPduInfo[4].RxSigInfoEndIdxOfRxPduInfo "" UWORD Com_RxSigInfoEndIdxOfRxPduInfoType 0 0 0 65535 ECU_ADDRESS 0x0 /end MEASUREMENT
/begin MEASUREMENT Com_RxPduInfo[4].RxSigInfoStartIdxOfRxPduInfo "" UWORD Com_RxSigInfoStartIdxOfRxPduInfoType 0 0 0 65535 ECU_ADDRESS 0x0 /end MEASUREMENT
/begin MEASUREMENT Com_RxPduInfo[4].RxTOutInfoIdxOfRxPduInfo "" UBYTE Com_RxTOutInfoIdxOfRxPduInfoType 0 0 0 255 ECU_ADDRESS 0x0 /end MEASUREMENT
/begin MEASUREMENT Com_RxPduInfo[4].RxTOutInfoIndEndIdxOfRxPduInfo "" UBYTE Com_RxTOutInfoIndEndIdxOfRxPduInfoType 0 0 0 255 ECU_ADDRESS 0x0 /end MEASUREMENT
/begin MEASUREMENT Com_RxPduInfo[4].RxTOutInfoIndStartIdxOfRxPduInfo "" UBYTE Com_RxTOutInfoIndStartIdxOfRxPduInfoType 0 0 0 255 ECU_ADDRESS 0x0 /end MEASUREMENT
/begin MEASUREMENT Com_RxPduInfo[50].HandleRxPduDeferredIdxOfRxPduInfo "" UBYTE Com_HandleRxPduDeferredIdxOfRxPduInfoType 0 0 0 255 ECU_ADDRESS 0x0 /end MEASUREMENT
/begin MEASUREMENT Com_RxPduInfo[50].IPduGroupInfoOfRxPduInfoIndEndIdxOfRxPduInfo "" UBYTE Com_IPduGroupInfoOfRxPduInfoIndEndIdxOfRxPduInfoType 0 0 0 255 ECU_ADDRESS 0x0 /end MEASUREMENT
/begin MEASUREMENT Com_RxPduInfo[50].IPduGroupInfoOfRxPduInfoIndStartIdxOfRxPduInfo "" UBYTE Com_IPduGroupInfoOfRxPduInfoIndStartIdxOfRxPduInfoType 0 0 0 255 ECU_ADDRESS 0x0 /end MEASUREMENT
/begin MEASUREMENT Com_RxPduInfo[50].MainFunctionRxStructIdxOfRxPduInfo "" UBYTE Com_MainFunctionRxStructIdxOfRxPduInfoType 0 0 0 255 ECU_ADDRESS 0x0 /end MEASUREMENT
/begin MEASUREMENT Com_RxPduInfo[50].RxAccessInfoIndEndIdxOfRxPduInfo "" UWORD Com_RxAccessInfoIndEndIdxOfRxPduInfoType 0 0 0 65535 ECU_ADDRESS 0x0 /end MEASUREMENT
/begin MEASUREMENT Com_RxPduInfo[50].RxAccessInfoIndStartIdxOfRxPduInfo "" UWORD Com_RxAccessInfoIndStartIdxOfRxPduInfoType 0 0 0 65535 ECU_ADDRESS 0x0 /end MEASUREMENT
/begin MEASUREMENT Com_RxPduInfo[50].RxDefPduBufferEndIdxOfRxPduInfo "" UWORD Com_RxDefPduBufferEndIdxOfRxPduInfoType 0 0 0 65535 ECU_ADDRESS 0x0 /end MEASUREMENT
/begin MEASUREMENT Com_RxPduInfo[50].RxDefPduBufferStartIdxOfRxPduInfo "" UWORD Com_RxDefPduBufferStartIdxOfRxPduInfoType 0 0 0 65535 ECU_ADDRESS 0x0 /end MEASUREMENT
/begin MEASUREMENT Com_RxPduInfo[50].RxPduCalloutFuncPtrIdxOfRxPduInfo "" UBYTE Com_RxPduCalloutFuncPtrIdxOfRxPduInfoType 0 0 0 255 ECU_ADDRESS 0x0 /end MEASUREMENT
/begin MEASUREMENT Com_RxPduInfo[50].RxSigGrpInfoIndEndIdxOfRxPduInfo "" UBYTE Com_RxSigGrpInfoIndEndIdxOfRxPduInfoType 0 0 0 255 ECU_ADDRESS 0x0 /end MEASUREMENT
/begin MEASUREMENT Com_RxPduInfo[50].RxSigGrpInfoIndStartIdxOfRxPduInfo "" UBYTE Com_RxSigGrpInfoIndStartIdxOfRxPduInfoType 0 0 0 255 ECU_ADDRESS 0x0 /end MEASUREMENT
/begin MEASUREMENT Com_RxPduInfo[50].RxSigInfoEndIdxOfRxPduInfo "" UWORD Com_RxSigInfoEndIdxOfRxPduInfoType 0 0 0 65535 ECU_ADDRESS 0x0 /end MEASUREMENT
/begin MEASUREMENT Com_RxPduInfo[50].RxSigInfoStartIdxOfRxPduInfo "" UWORD Com_RxSigInfoStartIdxOfRxPduInfoType 0 0 0 65535 ECU_ADDRESS 0x0 /end MEASUREMENT
/begin MEASUREMENT Com_RxPduInfo[50].RxTOutInfoIdxOfRxPduInfo "" UBYTE Com_RxTOutInfoIdxOfRxPduInfoType 0 0 0 255 ECU_ADDRESS 0x0 /end MEASUREMENT
/begin MEASUREMENT Com_RxPduInfo[50].RxTOutInfoIndEndIdxOfRxPduInfo "" UBYTE Com_RxTOutInfoIndEndIdxOfRxPduInfoType 0 0 0 255 ECU_ADDRESS 0x0 /end MEASUREMENT
/begin MEASUREMENT Com_RxPduInfo[50].RxTOutInfoIndStartIdxOfRxPduInfo "" UBYTE Com_RxTOutInfoIndStartIdxOfRxPduInfoType 0 0 0 255 ECU_ADDRESS 0x0 /end MEASUREMENT
/begin MEASUREMENT Com_RxPduInfo[51].HandleRxPduDeferredIdxOfRxPduInfo "" UBYTE Com_HandleRxPduDeferredIdxOfRxPduInfoType 0 0 0 255 ECU_ADDRESS 0x0 /end MEASUREMENT
/begin MEASUREMENT Com_RxPduInfo[51].IPduGroupInfoOfRxPduInfoIndEndIdxOfRxPduInfo "" UBYTE Com_IPduGroupInfoOfRxPduInfoIndEndIdxOfRxPduInfoType 0 0 0 255 ECU_ADDRESS 0x0 /end MEASUREMENT
/begin MEASUREMENT Com_RxPduInfo[51].IPduGroupInfoOfRxPduInfoIndStartIdxOfRxPduInfo "" UBYTE Com_IPduGroupInfoOfRxPduInfoIndStartIdxOfRxPduInfoType 0 0 0 255 ECU_ADDRESS 0x0 /end MEASUREMENT
/begin MEASUREMENT Com_RxPduInfo[51].MainFunctionRxStructIdxOfRxPduInfo "" UBYTE Com_MainFunctionRxStructIdxOfRxPduInfoType 0 0 0 255 ECU_ADDRESS 0x0 /end MEASUREMENT
/begin MEASUREMENT Com_RxPduInfo[51].RxAccessInfoIndEndIdxOfRxPduInfo "" UWORD Com_RxAccessInfoIndEndIdxOfRxPduInfoType 0 0 0 65535 ECU_ADDRESS 0x0 /end MEASUREMENT
/begin MEASUREMENT Com_RxPduInfo[51].RxAccessInfoIndStartIdxOfRxPduInfo "" UWORD Com_RxAccessInfoIndStartIdxOfRxPduInfoType 0 0 0 65535 ECU_ADDRESS 0x0 /end MEASUREMENT
/begin MEASUREMENT Com_RxPduInfo[51].RxDefPduBufferEndIdxOfRxPduInfo "" UWORD Com_RxDefPduBufferEndIdxOfRxPduInfoType 0 0 0 65535 ECU_ADDRESS 0x0 /end MEASUREMENT
/begin MEASUREMENT Com_RxPduInfo[51].RxDefPduBufferStartIdxOfRxPduInfo "" UWORD Com_RxDefPduBufferStartIdxOfRxPduInfoType 0 0 0 65535 ECU_ADDRESS 0x0 /end MEASUREMENT
/begin MEASUREMENT Com_RxPduInfo[51].RxPduCalloutFuncPtrIdxOfRxPduInfo "" UBYTE Com_RxPduCalloutFuncPtrIdxOfRxPduInfoType 0 0 0 255 ECU_ADDRESS 0x0 /end MEASUREMENT
/begin MEASUREMENT Com_RxPduInfo[51].RxSigGrpInfoIndEndIdxOfRxPduInfo "" UBYTE Com_RxSigGrpInfoIndEndIdxOfRxPduInfoType 0 0 0 255 ECU_ADDRESS 0x0 /end MEASUREMENT
/begin MEASUREMENT Com_RxPduInfo[51].RxSigGrpInfoIndStartIdxOfRxPduInfo "" UBYTE Com_RxSigGrpInfoIndStartIdxOfRxPduInfoType 0 0 0 255 ECU_ADDRESS 0x0 /end MEASUREMENT
/begin MEASUREMENT Com_RxPduInfo[51].RxSigInfoEndIdxOfRxPduInfo "" UWORD Com_RxSigInfoEndIdxOfRxPduInfoType 0 0 0 65535 ECU_ADDRESS 0x0 /end MEASUREMENT
/begin MEASUREMENT Com_RxPduInfo[51].RxSigInfoStartIdxOfRxPduInfo "" UWORD Com_RxSigInfoStartIdxOfRxPduInfoType 0 0 0 65535 ECU_ADDRESS 0x0 /end MEASUREMENT
/begin MEASUREMENT Com_RxPduInfo[51].RxTOutInfoIdxOfRxPduInfo "" UBYTE Com_RxTOutInfoIdxOfRxPduInfoType 0 0 0 255 ECU_ADDRESS 0x0 /end MEASUREMENT
/begin MEASUREMENT Com_RxPduInfo[51].RxTOutInfoIndEndIdxOfRxPduInfo "" UBYTE Com_RxTOutInfoIndEndIdxOfRxPduInfoType 0 0 0 255 ECU_ADDRESS 0x0 /end MEASUREMENT
/begin MEASUREMENT Com_RxPduInfo[51].RxTOutInfoIndStartIdxOfRxPduInfo "" UBYTE Com_RxTOutInfoIndStartIdxOfRxPduInfoType 0 0 0 255 ECU_ADDRESS 0x0 /end MEASUREMENT
/begin MEASUREMENT Com_RxPduInfo[52].HandleRxPduDeferredIdxOfRxPduInfo "" UBYTE Com_HandleRxPduDeferredIdxOfRxPduInfoType 0 0 0 255 ECU_ADDRESS 0x0 /end MEASUREMENT
/begin MEASUREMENT Com_RxPduInfo[52].IPduGroupInfoOfRxPduInfoIndEndIdxOfRxPduInfo "" UBYTE Com_IPduGroupInfoOfRxPduInfoIndEndIdxOfRxPduInfoType 0 0 0 255 ECU_ADDRESS 0x0 /end MEASUREMENT
/begin MEASUREMENT Com_RxPduInfo[52].IPduGroupInfoOfRxPduInfoIndStartIdxOfRxPduInfo "" UBYTE Com_IPduGroupInfoOfRxPduInfoIndStartIdxOfRxPduInfoType 0 0 0 255 ECU_ADDRESS 0x0 /end MEASUREMENT
/begin MEASUREMENT Com_RxPduInfo[52].MainFunctionRxStructIdxOfRxPduInfo "" UBYTE Com_MainFunctionRxStructIdxOfRxPduInfoType 0 0 0 255 ECU_ADDRESS 0x0 /end MEASUREMENT
/begin MEASUREMENT Com_RxPduInfo[52].RxAccessInfoIndEndIdxOfRxPduInfo "" UWORD Com_RxAccessInfoIndEndIdxOfRxPduInfoType 0 0 0 65535 ECU_ADDRESS 0x0 /end MEASUREMENT
/begin MEASUREMENT Com_RxPduInfo[52].RxAccessInfoIndStartIdxOfRxPduInfo "" UWORD Com_RxAccessInfoIndStartIdxOfRxPduInfoType 0 0 0 65535 ECU_ADDRESS 0x0 /end MEASUREMENT
/begin MEASUREMENT Com_RxPduInfo[52].RxDefPduBufferEndIdxOfRxPduInfo "" UWORD Com_RxDefPduBufferEndIdxOfRxPduInfoType 0 0 0 65535 ECU_ADDRESS 0x0 /end MEASUREMENT
/begin MEASUREMENT Com_RxPduInfo[52].RxDefPduBufferStartIdxOfRxPduInfo "" UWORD Com_RxDefPduBufferStartIdxOfRxPduInfoType 0 0 0 65535 ECU_ADDRESS 0x0 /end MEASUREMENT
/begin MEASUREMENT Com_RxPduInfo[52].RxPduCalloutFuncPtrIdxOfRxPduInfo "" UBYTE Com_RxPduCalloutFuncPtrIdxOfRxPduInfoType 0 0 0 255 ECU_ADDRESS 0x0 /end MEASUREMENT
/begin MEASUREMENT Com_RxPduInfo[52].RxSigGrpInfoIndEndIdxOfRxPduInfo "" UBYTE Com_RxSigGrpInfoIndEndIdxOfRxPduInfoType 0 0 0 255 ECU_ADDRESS 0x0 /end MEASUREMENT
/begin MEASUREMENT Com_RxPduInfo[52].RxSigGrpInfoIndStartIdxOfRxPduInfo "" UBYTE Com_RxSigGrpInfoIndStartIdxOfRxPduInfoType 0 0 0 255 ECU_ADDRESS 0x0 /end MEASUREMENT
/begin MEASUREMENT Com_RxPduInfo[52].RxSigInfoEndIdxOfRxPduInfo "" UWORD Com_RxSigInfoEndIdxOfRxPduInfoType 0 0 0 65535 ECU_ADDRESS 0x0 /end MEASUREMENT
/begin MEASUREMENT Com_RxPduInfo[52].RxSigInfoStartIdxOfRxPduInfo "" UWORD Com_RxSigInfoStartIdxOfRxPduInfoType 0 0 0 65535 ECU_ADDRESS 0x0 /end MEASUREMENT
/begin MEASUREMENT Com_RxPduInfo[52].RxTOutInfoIdxOfRxPduInfo "" UBYTE Com_RxTOutInfoIdxOfRxPduInfoType 0 0 0 255 ECU_ADDRESS 0x0 /end MEASUREMENT
/begin MEASUREMENT Com_RxPduInfo[52].RxTOutInfoIndEndIdxOfRxPduInfo "" UBYTE Com_RxTOutInfoIndEndIdxOfRxPduInfoType 0 0 0 255 ECU_ADDRESS 0x0 /end MEASUREMENT
/begin MEASUREMENT Com_RxPduInfo[52].RxTOutInfoIndStartIdxOfRxPduInfo "" UBYTE Com_RxTOutInfoIndStartIdxOfRxPduInfoType 0 0 0 255 ECU_ADDRESS 0x0 /end MEASUREMENT
/begin MEASUREMENT Com_RxPduInfo[53].HandleRxPduDeferredIdxOfRxPduInfo "" UBYTE Com_HandleRxPduDeferredIdxOfRxPduInfoType 0 0 0 255 ECU_ADDRESS 0x0 /end MEASUREMENT
/begin MEASUREMENT Com_RxPduInfo[53].IPduGroupInfoOfRxPduInfoIndEndIdxOfRxPduInfo "" UBYTE Com_IPduGroupInfoOfRxPduInfoIndEndIdxOfRxPduInfoType 0 0 0 255 ECU_ADDRESS 0x0 /end MEASUREMENT
/begin MEASUREMENT Com_RxPduInfo[53].IPduGroupInfoOfRxPduInfoIndStartIdxOfRxPduInfo "" UBYTE Com_IPduGroupInfoOfRxPduInfoIndStartIdxOfRxPduInfoType 0 0 0 255 ECU_ADDRESS 0x0 /end MEASUREMENT
/begin MEASUREMENT Com_RxPduInfo[53].MainFunctionRxStructIdxOfRxPduInfo "" UBYTE Com_MainFunctionRxStructIdxOfRxPduInfoType 0 0 0 255 ECU_ADDRESS 0x0 /end MEASUREMENT
/begin MEASUREMENT Com_RxPduInfo[53].RxAccessInfoIndEndIdxOfRxPduInfo "" UWORD Com_RxAccessInfoIndEndIdxOfRxPduInfoType 0 0 0 65535 ECU_ADDRESS 0x0 /end MEASUREMENT
/begin MEASUREMENT Com_RxPduInfo[53].RxAccessInfoIndStartIdxOfRxPduInfo "" UWORD Com_RxAccessInfoIndStartIdxOfRxPduInfoType 0 0 0 65535 ECU_ADDRESS 0x0 /end MEASUREMENT
/begin MEASUREMENT Com_RxPduInfo[53].RxDefPduBufferEndIdxOfRxPduInfo "" UWORD Com_RxDefPduBufferEndIdxOfRxPduInfoType 0 0 0 65535 ECU_ADDRESS 0x0 /end MEASUREMENT
/begin MEASUREMENT Com_RxPduInfo[53].RxDefPduBufferStartIdxOfRxPduInfo "" UWORD Com_RxDefPduBufferStartIdxOfRxPduInfoType 0 0 0 65535 ECU_ADDRESS 0x0 /end MEASUREMENT
/begin MEASUREMENT Com_RxPduInfo[53].RxPduCalloutFuncPtrIdxOfRxPduInfo "" UBYTE Com_RxPduCalloutFuncPtrIdxOfRxPduInfoType 0 0 0 255 ECU_ADDRESS 0x0 /end MEASUREMENT
/begin MEASUREMENT Com_RxPduInfo[53].RxSigGrpInfoIndEndIdxOfRxPduInfo "" UBYTE Com_RxSigGrpInfoIndEndIdxOfRxPduInfoType 0 0 0 255 ECU_ADDRESS 0x0 /end MEASUREMENT
/begin MEASUREMENT Com_RxPduInfo[53].RxSigGrpInfoIndStartIdxOfRxPduInfo "" UBYTE Com_RxSigGrpInfoIndStartIdxOfRxPduInfoType 0 0 0 255 ECU_ADDRESS 0x0 /end MEASUREMENT
/begin MEASUREMENT Com_RxPduInfo[53].RxSigInfoEndIdxOfRxPduInfo "" UWORD Com_RxSigInfoEndIdxOfRxPduInfoType 0 0 0 65535 ECU_ADDRESS 0x0 /end MEASUREMENT
/begin MEASUREMENT Com_RxPduInfo[53].RxSigInfoStartIdxOfRxPduInfo "" UWORD Com_RxSigInfoStartIdxOfRxPduInfoType 0 0 0 65535 ECU_ADDRESS 0x0 /end MEASUREMENT
/begin MEASUREMENT Com_RxPduInfo[53].RxTOutInfoIdxOfRxPduInfo "" UBYTE Com_RxTOutInfoIdxOfRxPduInfoType 0 0 0 255 ECU_ADDRESS 0x0 /end MEASUREMENT
/begin MEASUREMENT Com_RxPduInfo[53].RxTOutInfoIndEndIdxOfRxPduInfo "" UBYTE Com_RxTOutInfoIndEndIdxOfRxPduInfoType 0 0 0 255 ECU_ADDRESS 0x0 /end MEASUREMENT
/begin MEASUREMENT Com_RxPduInfo[53].RxTOutInfoIndStartIdxOfRxPduInfo "" UBYTE Com_RxTOutInfoIndStartIdxOfRxPduInfoType 0 0 0 255 ECU_ADDRESS 0x0 /end MEASUREMENT
/begin MEASUREMENT Com_RxPduInfo[54].HandleRxPduDeferredIdxOfRxPduInfo "" UBYTE Com_HandleRxPduDeferredIdxOfRxPduInfoType 0 0 0 255 ECU_ADDRESS 0x0 /end MEASUREMENT
/begin MEASUREMENT Com_RxPduInfo[54].IPduGroupInfoOfRxPduInfoIndEndIdxOfRxPduInfo "" UBYTE Com_IPduGroupInfoOfRxPduInfoIndEndIdxOfRxPduInfoType 0 0 0 255 ECU_ADDRESS 0x0 /end MEASUREMENT
/begin MEASUREMENT Com_RxPduInfo[54].IPduGroupInfoOfRxPduInfoIndStartIdxOfRxPduInfo "" UBYTE Com_IPduGroupInfoOfRxPduInfoIndStartIdxOfRxPduInfoType 0 0 0 255 ECU_ADDRESS 0x0 /end MEASUREMENT
/begin MEASUREMENT Com_RxPduInfo[54].MainFunctionRxStructIdxOfRxPduInfo "" UBYTE Com_MainFunctionRxStructIdxOfRxPduInfoType 0 0 0 255 ECU_ADDRESS 0x0 /end MEASUREMENT
/begin MEASUREMENT Com_RxPduInfo[54].RxAccessInfoIndEndIdxOfRxPduInfo "" UWORD Com_RxAccessInfoIndEndIdxOfRxPduInfoType 0 0 0 65535 ECU_ADDRESS 0x0 /end MEASUREMENT
/begin MEASUREMENT Com_RxPduInfo[54].RxAccessInfoIndStartIdxOfRxPduInfo "" UWORD Com_RxAccessInfoIndStartIdxOfRxPduInfoType 0 0 0 65535 ECU_ADDRESS 0x0 /end MEASUREMENT
/begin MEASUREMENT Com_RxPduInfo[54].RxDefPduBufferEndIdxOfRxPduInfo "" UWORD Com_RxDefPduBufferEndIdxOfRxPduInfoType 0 0 0 65535 ECU_ADDRESS 0x0 /end MEASUREMENT
/begin MEASUREMENT Com_RxPduInfo[54].RxDefPduBufferStartIdxOfRxPduInfo "" UWORD Com_RxDefPduBufferStartIdxOfRxPduInfoType 0 0 0 65535 ECU_ADDRESS 0x0 /end MEASUREMENT
/begin MEASUREMENT Com_RxPduInfo[54].RxPduCalloutFuncPtrIdxOfRxPduInfo "" UBYTE Com_RxPduCalloutFuncPtrIdxOfRxPduInfoType 0 0 0 255 ECU_ADDRESS 0x0 /end MEASUREMENT
/begin MEASUREMENT Com_RxPduInfo[54].RxSigGrpInfoIndEndIdxOfRxPduInfo "" UBYTE Com_RxSigGrpInfoIndEndIdxOfRxPduInfoType 0 0 0 255 ECU_ADDRESS 0x0 /end MEASUREMENT
/begin MEASUREMENT Com_RxPduInfo[54].RxSigGrpInfoIndStartIdxOfRxPduInfo "" UBYTE Com_RxSigGrpInfoIndStartIdxOfRxPduInfoType 0 0 0 255 ECU_ADDRESS 0x0 /end MEASUREMENT
/begin MEASUREMENT Com_RxPduInfo[54].RxSigInfoEndIdxOfRxPduInfo "" UWORD Com_RxSigInfoEndIdxOfRxPduInfoType 0 0 0 65535 ECU_ADDRESS 0x0 /end MEASUREMENT
/begin MEASUREMENT Com_RxPduInfo[54].RxSigInfoStartIdxOfRxPduInfo "" UWORD Com_RxSigInfoStartIdxOfRxPduInfoType 0 0 0 65535 ECU_ADDRESS 0x0 /end MEASUREMENT
/begin MEASUREMENT Com_RxPduInfo[54].RxTOutInfoIdxOfRxPduInfo "" UBYTE Com_RxTOutInfoIdxOfRxPduInfoType 0 0 0 255 ECU_ADDRESS 0x0 /end MEASUREMENT
/begin MEASUREMENT Com_RxPduInfo[54].RxTOutInfoIndEndIdxOfRxPduInfo "" UBYTE Com_RxTOutInfoIndEndIdxOfRxPduInfoType 0 0 0 255 ECU_ADDRESS 0x0 /end MEASUREMENT
/begin MEASUREMENT Com_RxPduInfo[54].RxTOutInfoIndStartIdxOfRxPduInfo "" UBYTE Com_RxTOutInfoIndStartIdxOfRxPduInfoType 0 0 0 255 ECU_ADDRESS 0x0 /end MEASUREMENT
/begin MEASUREMENT Com_RxPduInfo[55].HandleRxPduDeferredIdxOfRxPduInfo "" UBYTE Com_HandleRxPduDeferredIdxOfRxPduInfoType 0 0 0 255 ECU_ADDRESS 0x0 /end MEASUREMENT
/begin MEASUREMENT Com_RxPduInfo[55].IPduGroupInfoOfRxPduInfoIndEndIdxOfRxPduInfo "" UBYTE Com_IPduGroupInfoOfRxPduInfoIndEndIdxOfRxPduInfoType 0 0 0 255 ECU_ADDRESS 0x0 /end MEASUREMENT
/begin MEASUREMENT Com_RxPduInfo[55].IPduGroupInfoOfRxPduInfoIndStartIdxOfRxPduInfo "" UBYTE Com_IPduGroupInfoOfRxPduInfoIndStartIdxOfRxPduInfoType 0 0 0 255 ECU_ADDRESS 0x0 /end MEASUREMENT
/begin MEASUREMENT Com_RxPduInfo[55].MainFunctionRxStructIdxOfRxPduInfo "" UBYTE Com_MainFunctionRxStructIdxOfRxPduInfoType 0 0 0 255 ECU_ADDRESS 0x0 /end MEASUREMENT
/begin MEASUREMENT Com_RxPduInfo[55].RxAccessInfoIndEndIdxOfRxPduInfo "" UWORD Com_RxAccessInfoIndEndIdxOfRxPduInfoType 0 0 0 65535 ECU_ADDRESS 0x0 /end MEASUREMENT
/begin MEASUREMENT Com_RxPduInfo[55].RxAccessInfoIndStartIdxOfRxPduInfo "" UWORD Com_RxAccessInfoIndStartIdxOfRxPduInfoType 0 0 0 65535 ECU_ADDRESS 0x0 /end MEASUREMENT
/begin MEASUREMENT Com_RxPduInfo[55].RxDefPduBufferEndIdxOfRxPduInfo "" UWORD Com_RxDefPduBufferEndIdxOfRxPduInfoType 0 0 0 65535 ECU_ADDRESS 0x0 /end MEASUREMENT
/begin MEASUREMENT Com_RxPduInfo[55].RxDefPduBufferStartIdxOfRxPduInfo "" UWORD Com_RxDefPduBufferStartIdxOfRxPduInfoType 0 0 0 65535 ECU_ADDRESS 0x0 /end MEASUREMENT
/begin MEASUREMENT Com_RxPduInfo[55].RxPduCalloutFuncPtrIdxOfRxPduInfo "" UBYTE Com_RxPduCalloutFuncPtrIdxOfRxPduInfoType 0 0 0 255 ECU_ADDRESS 0x0 /end MEASUREMENT
/begin MEASUREMENT Com_RxPduInfo[55].RxSigGrpInfoIndEndIdxOfRxPduInfo "" UBYTE Com_RxSigGrpInfoIndEndIdxOfRxPduInfoType 0 0 0 255 ECU_ADDRESS 0x0 /end MEASUREMENT
/begin MEASUREMENT Com_RxPduInfo[55].RxSigGrpInfoIndStartIdxOfRxPduInfo "" UBYTE Com_RxSigGrpInfoIndStartIdxOfRxPduInfoType 0 0 0 255 ECU_ADDRESS 0x0 /end MEASUREMENT
/begin MEASUREMENT Com_RxPduInfo[55].RxSigInfoEndIdxOfRxPduInfo "" UWORD Com_RxSigInfoEndIdxOfRxPduInfoType 0 0 0 65535 ECU_ADDRESS 0x0 /end MEASUREMENT
/begin MEASUREMENT Com_RxPduInfo[55].RxSigInfoStartIdxOfRxPduInfo "" UWORD Com_RxSigInfoStartIdxOfRxPduInfoType 0 0 0 65535 ECU_ADDRESS 0x0 /end MEASUREMENT
/begin MEASUREMENT Com_RxPduInfo[55].RxTOutInfoIdxOfRxPduInfo "" UBYTE Com_RxTOutInfoIdxOfRxPduInfoType 0 0 0 255 ECU_ADDRESS 0x0 /end MEASUREMENT
/begin MEASUREMENT Com_RxPduInfo[55].RxTOutInfoIndEndIdxOfRxPduInfo "" UBYTE Com_RxTOutInfoIndEndIdxOfRxPduInfoType 0 0 0 255 ECU_ADDRESS 0x0 /end MEASUREMENT
/begin MEASUREMENT Com_RxPduInfo[55].RxTOutInfoIndStartIdxOfRxPduInfo "" UBYTE Com_RxTOutInfoIndStartIdxOfRxPduInfoType 0 0 0 255 ECU_ADDRESS 0x0 /end MEASUREMENT
/begin MEASUREMENT Com_RxPduInfo[56].HandleRxPduDeferredIdxOfRxPduInfo "" UBYTE Com_HandleRxPduDeferredIdxOfRxPduInfoType 0 0 0 255 ECU_ADDRESS 0x0 /end MEASUREMENT
/begin MEASUREMENT Com_RxPduInfo[56].IPduGroupInfoOfRxPduInfoIndEndIdxOfRxPduInfo "" UBYTE Com_IPduGroupInfoOfRxPduInfoIndEndIdxOfRxPduInfoType 0 0 0 255 ECU_ADDRESS 0x0 /end MEASUREMENT
/begin MEASUREMENT Com_RxPduInfo[56].IPduGroupInfoOfRxPduInfoIndStartIdxOfRxPduInfo "" UBYTE Com_IPduGroupInfoOfRxPduInfoIndStartIdxOfRxPduInfoType 0 0 0 255 ECU_ADDRESS 0x0 /end MEASUREMENT
/begin MEASUREMENT Com_RxPduInfo[56].MainFunctionRxStructIdxOfRxPduInfo "" UBYTE Com_MainFunctionRxStructIdxOfRxPduInfoType 0 0 0 255 ECU_ADDRESS 0x0 /end MEASUREMENT
/begin MEASUREMENT Com_RxPduInfo[56].RxAccessInfoIndEndIdxOfRxPduInfo "" UWORD Com_RxAccessInfoIndEndIdxOfRxPduInfoType 0 0 0 65535 ECU_ADDRESS 0x0 /end MEASUREMENT
/begin MEASUREMENT Com_RxPduInfo[56].RxAccessInfoIndStartIdxOfRxPduInfo "" UWORD Com_RxAccessInfoIndStartIdxOfRxPduInfoType 0 0 0 65535 ECU_ADDRESS 0x0 /end MEASUREMENT
/begin MEASUREMENT Com_RxPduInfo[56].RxDefPduBufferEndIdxOfRxPduInfo "" UWORD Com_RxDefPduBufferEndIdxOfRxPduInfoType 0 0 0 65535 ECU_ADDRESS 0x0 /end MEASUREMENT
/begin MEASUREMENT Com_RxPduInfo[56].RxDefPduBufferStartIdxOfRxPduInfo "" UWORD Com_RxDefPduBufferStartIdxOfRxPduInfoType 0 0 0 65535 ECU_ADDRESS 0x0 /end MEASUREMENT
/begin MEASUREMENT Com_RxPduInfo[56].RxPduCalloutFuncPtrIdxOfRxPduInfo "" UBYTE Com_RxPduCalloutFuncPtrIdxOfRxPduInfoType 0 0 0 255 ECU_ADDRESS 0x0 /end MEASUREMENT
/begin MEASUREMENT Com_RxPduInfo[56].RxSigGrpInfoIndEndIdxOfRxPduInfo "" UBYTE Com_RxSigGrpInfoIndEndIdxOfRxPduInfoType 0 0 0 255 ECU_ADDRESS 0x0 /end MEASUREMENT
/begin MEASUREMENT Com_RxPduInfo[56].RxSigGrpInfoIndStartIdxOfRxPduInfo "" UBYTE Com_RxSigGrpInfoIndStartIdxOfRxPduInfoType 0 0 0 255 ECU_ADDRESS 0x0 /end MEASUREMENT
/begin MEASUREMENT Com_RxPduInfo[56].RxSigInfoEndIdxOfRxPduInfo "" UWORD Com_RxSigInfoEndIdxOfRxPduInfoType 0 0 0 65535 ECU_ADDRESS 0x0 /end MEASUREMENT
/begin MEASUREMENT Com_RxPduInfo[56].RxSigInfoStartIdxOfRxPduInfo "" UWORD Com_RxSigInfoStartIdxOfRxPduInfoType 0 0 0 65535 ECU_ADDRESS 0x0 /end MEASUREMENT
/begin MEASUREMENT Com_RxPduInfo[56].RxTOutInfoIdxOfRxPduInfo "" UBYTE Com_RxTOutInfoIdxOfRxPduInfoType 0 0 0 255 ECU_ADDRESS 0x0 /end MEASUREMENT
/begin MEASUREMENT Com_RxPduInfo[56].RxTOutInfoIndEndIdxOfRxPduInfo "" UBYTE Com_RxTOutInfoIndEndIdxOfRxPduInfoType 0 0 0 255 ECU_ADDRESS 0x0 /end MEASUREMENT
/begin MEASUREMENT Com_RxPduInfo[56].RxTOutInfoIndStartIdxOfRxPduInfo "" UBYTE Com_RxTOutInfoIndStartIdxOfRxPduInfoType 0 0 0 255 ECU_ADDRESS 0x0 /end MEASUREMENT
/begin MEASUREMENT Com_RxPduInfo[57].HandleRxPduDeferredIdxOfRxPduInfo "" UBYTE Com_HandleRxPduDeferredIdxOfRxPduInfoType 0 0 0 255 ECU_ADDRESS 0x0 /end MEASUREMENT
/begin MEASUREMENT Com_RxPduInfo[57].IPduGroupInfoOfRxPduInfoIndEndIdxOfRxPduInfo "" UBYTE Com_IPduGroupInfoOfRxPduInfoIndEndIdxOfRxPduInfoType 0 0 0 255 ECU_ADDRESS 0x0 /end MEASUREMENT
/begin MEASUREMENT Com_RxPduInfo[57].IPduGroupInfoOfRxPduInfoIndStartIdxOfRxPduInfo "" UBYTE Com_IPduGroupInfoOfRxPduInfoIndStartIdxOfRxPduInfoType 0 0 0 255 ECU_ADDRESS 0x0 /end MEASUREMENT
/begin MEASUREMENT Com_RxPduInfo[57].MainFunctionRxStructIdxOfRxPduInfo "" UBYTE Com_MainFunctionRxStructIdxOfRxPduInfoType 0 0 0 255 ECU_ADDRESS 0x0 /end MEASUREMENT
/begin MEASUREMENT Com_RxPduInfo[57].RxAccessInfoIndEndIdxOfRxPduInfo "" UWORD Com_RxAccessInfoIndEndIdxOfRxPduInfoType 0 0 0 65535 ECU_ADDRESS 0x0 /end MEASUREMENT
/begin MEASUREMENT Com_RxPduInfo[57].RxAccessInfoIndStartIdxOfRxPduInfo "" UWORD Com_RxAccessInfoIndStartIdxOfRxPduInfoType 0 0 0 65535 ECU_ADDRESS 0x0 /end MEASUREMENT
/begin MEASUREMENT Com_RxPduInfo[57].RxDefPduBufferEndIdxOfRxPduInfo "" UWORD Com_RxDefPduBufferEndIdxOfRxPduInfoType 0 0 0 65535 ECU_ADDRESS 0x0 /end MEASUREMENT
/begin COMPU_METHOD Com_HandleRxPduDeferredIdxOfRxPduInfoType "" TAB_VERB "%10.1" "" COMPU_TAB_REF Com_HandleRxPduDeferredIdxOfRxPduInfoType /end COMPU_METHOD
/begin COMPU_METHOD Com_IPduGroupInfoOfRxPduInfoIndEndIdxOfRxPduInfoType "" TAB_VERB "%10.1" "" COMPU_TAB_REF Com_IPduGroupInfoOfRxPduInfoIndEndIdxOfRxPduInfoType /end COMPU_METHOD
/begin COMPU_METHOD Com_IPduGroupInfoOfRxPduInfoIndStartIdxOfRxPduInfoType "" TAB_VERB "%10.1" "" COMPU_TAB_REF Com_IPduGroupInfoOfRxPduInfoIndStartIdxOfRxPduInfoType /end COMPU_METHOD
/begin COMPU_METHOD Com_MainFunctionRxStructIdxOfRxPduInfoType "" TAB_VERB "%10.1" "" COMPU_TAB_REF Com_MainFunctionRxStructIdxOfRxPduInfoType /end COMPU_METHOD
/begin COMPU_METHOD Com_RxAccessInfoIndEndIdxOfRxPduInfoType "" TAB_VERB "%10.1" "" COMPU_TAB_REF Com_RxAccessInfoIndEndIdxOfRxPduInfoType /end COMPU_METHOD
/begin COMPU_METHOD Com_RxAccessInfoIndStartIdxOfRxPduInfoType "" TAB_VERB "%10.1" "" COMPU_TAB_REF Com_RxAccessInfoIndStartIdxOfRxPduInfoType /end COMPU_METHOD
/begin COMPU_METHOD Com_RxDefPduBufferEndIdxOfRxPduInfoType "" TAB_VERB "%10.1" "" COMPU_TAB_REF Com_RxDefPduBufferEndIdxOfRxPduInfoType /end COMPU_METHOD
/begin COMPU_METHOD Com_RxDefPduBufferStartIdxOfRxPduInfoType "" TAB_VERB "%10.1" "" COMPU_TAB_REF Com_RxDefPduBufferStartIdxOfRxPduInfoType /end COMPU_METHOD
/begin COMPU_METHOD Com_RxPduCalloutFuncPtrIdxOfRxPduInfoType "" TAB_VERB "%10.1" "" COMPU_TAB_REF Com_RxPduCalloutFuncPtrIdxOfRxPduInfoType /end COMPU_METHOD
/begin COMPU_METHOD Com_RxPduDmStateType "" TAB_VERB "%10.1" "" COMPU_TAB_REF Com_RxPduDmStateType /end COMPU_METHOD
/begin COMPU_METHOD Com_RxPduGrpActiveType "" TAB_VERB "%10.1" "" COMPU_TAB_REF Com_RxPduGrpActiveType /end COMPU_METHOD
/begin COMPU_METHOD Com_RxSigGrpInfoIndEndIdxOfRxPduInfoType "" TAB_VERB "%10.1" "" COMPU_TAB_REF Com_RxSigGrpInfoIndEndIdxOfRxPduInfoType /end COMPU_METHOD
/begin COMPU_METHOD Com_RxSigGrpInfoIndStartIdxOfRxPduInfoType "" TAB_VERB "%10.1" "" COMPU_TAB_REF Com_RxSigGrpInfoIndStartIdxOfRxPduInfoType /end COMPU_METHOD
/begin COMPU_METHOD Com_RxSigInfoEndIdxOfRxPduInfoType "" TAB_VERB "%10.1" "" COMPU_TAB_REF Com_RxSigInfoEndIdxOfRxPduInfoType /end COMPU_METHOD
/begin COMPU_METHOD Com_RxSigInfoStartIdxOfRxPduInfoType "" TAB_VERB "%10.1" "" COMPU_TAB_REF Com_RxSigInfoStartIdxOfRxPduInfoType /end COMPU_METHOD
/begin COMPU_METHOD Com_RxTOutInfoIdxOfRxPduInfoType "" TAB_VERB "%10.1" "" COMPU_TAB_REF Com_RxTOutInfoIdxOfRxPduInfoType /end COMPU_METHOD
/begin COMPU_METHOD Com_RxTOutInfoIndEndIdxOfRxPduInfoType "" TAB_VERB "%10.1" "" COMPU_TAB_REF Com_RxTOutInfoIndEndIdxOfRxPduInfoType /end COMPU_METHOD
/begin COMPU_METHOD Com_RxTOutInfoIndStartIdxOfRxPduInfoType "" TAB_VERB "%10.1" "" COMPU_TAB_REF Com_RxTOutInfoIndStartIdxOfRxPduInfoType /end COMPU_METHOD
/begin COMPU_VTAB Com_HandleRxPduDeferredIdxOfRxPduInfoType "" TAB_VERB 1 255 "COM_NO_HANDLERXPDUDEFERREDIDXOFRXPDUINFO" /end COMPU_VTAB
/begin COMPU_VTAB Com_IPduGroupInfoOfRxPduInfoIndEndIdxOfRxPduInfoType "" TAB_VERB 1 255 "COM_NO_IPDUGROUPINFOOFRXPDUINFOINDENDIDXOFRXPDUINFO" /end COMPU_VTAB
/begin COMPU_VTAB Com_IPduGroupInfoOfRxPduInfoIndStartIdxOfRxPduInfoType "" TAB_VERB 1 255 "COM_NO_IPDUGROUPINFOOFRXPDUINFOINDSTARTIDXOFRXPDUINFO" /end COMPU_VTAB
/begin COMPU_VTAB Com_MainFunctionRxStructIdxOfRxPduInfoType "" TAB_VERB 1 255 "COM_NO_MAINFUNCTIONRXSTRUCTIDXOFRXPDUINFO" /end COMPU_VTAB
/begin COMPU_VTAB Com_RxAccessInfoIndEndIdxOfRxPduInfoType "" TAB_VERB 1 65535 "COM_NO_RXACCESSINFOINDENDIDXOFRXPDUINFO" /end COMPU_VTAB
/begin COMPU_VTAB Com_RxAccessInfoIndStartIdxOfRxPduInfoType "" TAB_VERB 1 65535 "COM_NO_RXACCESSINFOINDSTARTIDXOFRXPDUINFO" /end COMPU_VTAB
/begin COMPU_VTAB Com_RxDefPduBufferEndIdxOfRxPduInfoType "" TAB_VERB 1 65535 "COM_NO_RXDEFPDUBUFFERENDIDXOFRXPDUINFO" /end COMPU_VTAB
/begin COMPU_VTAB Com_RxDefPduBufferStartIdxOfRxPduInfoType "" TAB_VERB 1 65535 "COM_NO_RXDEFPDUBUFFERSTARTIDXOFRXPDUINFO" /end COMPU_VTAB
/begin COMPU_VTAB Com_RxPduCalloutFuncPtrIdxOfRxPduInfoType "" TAB_VERB 1 255 "COM_NO_RXPDUCALLOUTFUNCPTRIDXOFRXPDUINFO" /end COMPU_VTAB
/begin COMPU_VTAB Com_RxPduDmStateType "" TAB_VERB 6 0 "COM_INACTIVE_RXPDUDMSTATE" 1 "COM_ACTIVE_RXPDUDMSTATE" 1 "COM_PURE_DM_STATE_MASK_RXPDUDMSTATE" 2 "COM_OCCURRED_FLAG_RXPDUDMSTATE" 3 "COM_OCCURRED_RXPDUDMSTATE" 253 "COM_CLEAR_OCCURRED_FLAG_RXPDUDMSTATE" /end COMPU_VTAB
/begin COMPU_VTAB_RANGE Com_RxPduGrpActiveType "" 2 0 0 "FALSE" 1 255 "TRUE" /end COMPU_VTAB_RANGE
/begin COMPU_VTAB Com_RxSigGrpInfoIndEndIdxOfRxPduInfoType "" TAB_VERB 1 255 "COM_NO_RXSIGGRPINFOINDENDIDXOFRXPDUINFO" /end COMPU_VTAB
/begin COMPU_VTAB Com_RxSigGrpInfoIndStartIdxOfRxPduInfoType "" TAB_VERB 1 255 "COM_NO_RXSIGGRPINFOINDSTARTIDXOFRXPDUINFO" /end COMPU_VTAB
/begin COMPU_VTAB Com_RxSigInfoEndIdxOfRxPduInfoType "" TAB_VERB 1 65535 "COM_NO_RXSIGINFOENDIDXOFRXPDUINFO" /end COMPU_VTAB
/begin COMPU_VTAB Com_RxSigInfoStartIdxOfRxPduInfoType "" TAB_VERB 1 65535 "COM_NO_RXSIGINFOSTARTIDXOFRXPDUINFO" /end COMPU_VTAB
/begin COMPU_VTAB Com_RxTOutInfoIdxOfRxPduInfoType "" TAB_VERB 1 255 "COM_NO_RXTOUTINFOIDXOFRXPDUINFO" /end COMPU_VTAB
/begin COMPU_VTAB Com_RxTOutInfoIndEndIdxOfRxPduInfoType "" TAB_VERB 1 255 "COM_NO_RXTOUTINFOINDENDIDXOFRXPDUINFO" /end COMPU_VTAB
/begin COMPU_VTAB Com_RxTOutInfoIndStartIdxOfRxPduInfoType "" TAB_VERB 1 255 "COM_NO_RXTOUTINFOINDSTARTIDXOFRXPDUINFO" /end COMPU_VTAB
/begin GROUP Com ""
 /begin REF_MEASUREMENT Com_RxDefPduBuffer_UI2Sens01_CVN_XIX_BMC_CAN01_fe6b52fc_Rx Com_RxDefPduBuffer_UI2Sens02_CALID_01_XIX_BMC_CAN01_abd78ba8_Rx Com_RxDefPduBuffer_UI2Sens02_CALID_02_XIX_BMC_CAN01_baaae1d1_Rx Com_RxDefPduBuffer_UI2Sens02_CVN_XIX_BMC_CAN01_5d3dd455_Rx Com_RxDefPduBuffer_UI2_01_XIX_BMC_CAN01_E2E_f7b0279f_Rx Com_RxDefPduBuffer_UI2_02_XIX_BMC_CAN01_E2E_54e6a136_Rx Com_RxDefPduBuffer_UI2_03_XIX_BMC_CAN01_E2E_8304216e_Rx Com_RxDefPduBuffer_UI2_04_XIX_BMC_CAN01_33f018a3_Rx Com_RxDefPduBuffer_UI2_Komponentenfehler_01_XIX_BMC_CAN01_6c666489_Rx Com_RxDefPduBuffer_UI2_Komponentenfehler_02_XIX_BMC_CAN01_7d1b0ef0_Rx Com_RxDefPduBuffer_VDSO_05_XIX_HCP5_CANFD01_48366f26_Rx Com_RxDefPduBuffer_WFS_02_XIX_HCP5_CANFD01_61136cb6_Rx Com_RxDefPduBuffer_ZeitMaster_01_XIX_HCP5_CANFD01_dad73d21_Rx Com_RxDefPduBuffer_Zeitmaster_05_XIX_HCP5_CANFD01_5eaa5a96_Rx Com_RxDeferredFctPtrCache Com_RxDeferredFctPtrCache_ComMainFunctionRx Com_RxIPduGroupISRLockCounter Com_RxIPduGroupISRLockCounter_noPartition Com_RxMainFunctionProcessingISRLockCounter Com_RxMainFunctionProcessingISRLockCounter_ComMainFunctionRx Com_RxPduDmState Com_RxPduGrpActive Com_RxPduInfoInd Com_RxPduInfo[0].HandleRxPduDeferredIdxOfRxPduInfo Com_RxPduInfo[0].IPduGroupInfoOfRxPduInfoIndEndIdxOfRxPduInfo Com_RxPduInfo[0].IPduGroupInfoOfRxPduInfoIndStartIdxOfRxPduInfo Com_RxPduInfo[0].MainFunctionRxStructIdxOfRxPduInfo Com_RxPduInfo[0].RxAccessInfoIndEndIdxOfRxPduInfo Com_RxPduInfo[0].RxAccessInfoIndStartIdxOfRxPduInfo Com_RxPduInfo[0].RxDefPduBufferEndIdxOfRxPduInfo Com_RxPduInfo[0].RxDefPduBufferStartIdxOfRxPduInfo Com_RxPduInfo[0].RxPduCalloutFuncPtrIdxOfRxPduInfo Com_RxPduInfo[0].RxSigGrpInfoIndEndIdxOfRxPduInfo Com_RxPduInfo[0].RxSigGrpInfoIndStartIdxOfRxPduInfo Com_RxPduInfo[0].RxSigInfoEndIdxOfRxPduInfo Com_RxPduInfo[0].RxSigInfoStartIdxOfRxPduInfo Com_RxPduInfo[0].RxTOutInfoIdxOfRxPduInfo Com_RxPduInfo[0].RxTOutInfoIndEndIdxOfRxPduInfo Com_RxPduInfo[0].RxTOutInfoIndStartIdxOfRxPduInfo Com_RxPduInfo[10].HandleRxPduDeferredIdxOfRxPduInfo Com_RxPduInfo[10].IPduGroupInfoOfRxPduInfoIndEndIdxOfRxPduInfo Com_RxPduInfo[10].IPduGroupInfoOfRxPduInfoIndStartIdxOfRxPduInfo Com_RxPduInfo[10].MainFunctionRxStructIdxOfRxPduInfo Com_RxPduInfo[10].RxAccessInfoIndEndIdxOfRxPduInfo Com_RxPduInfo[10].RxAccessInfoIndStartIdxOfRxPduInfo Com_RxPduInfo[10].RxDefPduBufferEndIdxOfRxPduInfo Com_RxPduInfo[10].RxDefPduBufferStartIdxOfRxPduInfo Com_RxPduInfo[10].RxPduCalloutFuncPtrIdxOfRxPduInfo Com_RxPduInfo[10].RxSigGrpInfoIndEndIdxOfRxPduInfo Com_RxPduInfo[10].RxSigGrpInfoIndStartIdxOfRxPduInfo Com_RxPduInfo[10].RxSigInfoEndIdxOfRxPduInfo Com_RxPduInfo[10].RxSigInfoStartIdxOfRxPduInfo Com_RxPduInfo[10].RxTOutInfoIdxOfRxPduInfo Com_RxPduInfo[10].RxTOutInfoIndEndIdxOfRxPduInfo Com_RxPduInfo[10].RxTOutInfoIndStartIdxOfRxPduInfo Com_RxPduInfo[11].HandleRxPduDeferredIdxOfRxPduInfo Com_RxPduInfo[11].IPduGroupInfoOfRxPduInfoIndEndIdxOfRxPduInfo Com_RxPduInfo[11].IPduGroupInfoOfRxPduInfoIndStartIdxOfRxPduInfo Com_RxPduInfo[11].MainFunctionRxStructIdxOfRxPduInfo Com_RxPduInfo[11].RxAccessInfoIndEndIdxOfRxPduInfo Com_RxPduInfo[11].RxAccessInfoIndStartIdxOfRxPduInfo Com_RxPduInfo[11].RxDefPduBufferEndIdxOfRxPduInfo Com_RxPduInfo[11].RxDefPduBufferStartIdxOfRxPduInfo Com_RxPduInfo[11].RxPduCalloutFuncPtrIdxOfRxPduInfo Com_RxPduInfo[11].RxSigGrpInfoIndEndIdxOfRxPduInfo Com_RxPduInfo[11].RxSigGrpInfoIndStartIdxOfRxPduInfo Com_RxPduInfo[11].RxSigInfoEndIdxOfRxPduInfo Com_RxPduInfo[11].RxSigInfoStartIdxOfRxPduInfo Com_RxPduInfo[11].RxTOutInfoIdxOfRxPduInfo Com_RxPduInfo[11].RxTOutInfoIndEndIdxOfRxPduInfo Com_RxPduInfo[11].RxTOutInfoIndStartIdxOfRxPduInfo Com_RxPduInfo[12].HandleRxPduDeferredIdxOfRxPduInfo Com_RxPduInfo[12].IPduGroupInfoOfRxPduInfoIndEndIdxOfRxPduInfo Com_RxPduInfo[12].IPduGroupInfoOfRxPduInfoIndStartIdxOfRxPduInfo Com_RxPduInfo[12].MainFunctionRxStructIdxOfRxPduInfo Com_RxPduInfo[12].RxAccessInfoIndEndIdxOfRxPduInfo Com_RxPduInfo[12].RxAccessInfoIndStartIdxOfRxPduInfo Com_RxPduInfo[12].RxDefPduBufferEndIdxOfRxPduInfo Com_RxPduInfo[12].RxDefPduBufferStartIdxOfRxPduInfo Com_RxPduInfo[12].RxPduCalloutFuncPtrIdxOfRxPduInfo Com_RxPduInfo[12].RxSigGrpInfoIndEndIdxOfRxPduInfo Com_RxPduInfo[12].RxSigGrpInfoIndStartIdxOfRxPduInfo Com_RxPduInfo[12].RxSigInfoEndIdxOfRxPduInfo Com_RxPduInfo[12].RxSigInfoStartIdxOfRxPduInfo Com_RxPduInfo[12].RxTOutInfoIdxOfRxPduInfo Com_RxPduInfo[12].RxTOutInfoIndEndIdxOfRxPduInfo Com_RxPduInfo[12].RxTOutInfoIndStartIdxOfRxPduInfo Com_RxPduInfo[13].HandleRxPduDeferredIdxOfRxPduInfo Com_RxPduInfo[13].IPduGroupInfoOfRxPduInfoIndEndIdxOfRxPduInfo Com_RxPduInfo[13].IPduGroupInfoOfRxPduInfoIndStartIdxOfRxPduInfo Com_RxPduInfo[13].MainFunctionRxStructIdxOfRxPduInfo Com_RxPduInfo[13].RxAccessInfoIndEndIdxOfRxPduInfo Com_RxPduInfo[13].RxAccessInfoIndStartIdxOfRxPduInfo Com_RxPduInfo[13].RxDefPduBufferEndIdxOfRxPduInfo Com_RxPduInfo[13].RxDefPduBufferStartIdxOfRxPduInfo Com_RxPduInfo[13].RxPduCalloutFuncPtrIdxOfRxPduInfo Com_RxPduInfo[13].RxSigGrpInfoIndEndIdxOfRxPduInfo Com_RxPduInfo[13].RxSigGrpInfoIndStartIdxOfRxPduInfo Com_RxPduInfo[13].RxSigInfoEndIdxOfRxPduInfo Com_RxPduInfo[13].RxSigInfoStartIdxOfRxPduInfo Com_RxPduInfo[13].RxTOutInfoIdxOfRxPduInfo Com_RxPduInfo[13].RxTOutInfoIndEndIdxOfRxPduInfo Com_RxPduInfo[13].RxTOutInfoIndStartIdxOfRxPduInfo Com_RxPduInfo[14].HandleRxPduDeferredIdxOfRxPduInfo Com_RxPduInfo[14].IPduGroupInfoOfRxPduInfoIndEndIdxOfRxPduInfo Com_RxPduInfo[14].IPduGroupInfoOfRxPduInfoIndStartIdxOfRxPduInfo Com_RxPduInfo[14].MainFunctionRxStructIdxOfRxPduInfo Com_RxPduInfo[14].RxAccessInfoIndEndIdxOfRxPduInfo Com_RxPduInfo[14].RxAccessInfoIndStartIdxOfRxPduInfo Com_RxPduInfo[14].RxDefPduBufferEndIdxOfRxPduInfo Com_RxPduInfo[14].RxDefPduBufferStartIdxOfRxPduInfo Com_RxPduInfo[14].RxPduCalloutFuncPtrIdxOfRxPduInfo Com_RxPduInfo[14].RxSigGrpInfoIndEndIdxOfRxPduInfo Com_RxPduInfo[14].RxSigGrpInfoIndStartIdxOfRxPduInfo Com_RxPduInfo[14].RxSigInfoEndIdxOfRxPduInfo Com_RxPduInfo[14].RxSigInfoStartIdxOfRxPduInfo Com_RxPduInfo[14].RxTOutInfoIdxOfRxPduInfo Com_RxPduInfo[14].RxTOutInfoIndEndIdxOfRxPduInfo Com_RxPduInfo[14].RxTOutInfoIndStartIdxOfRxPduInfo Com_RxPduInfo[15].HandleRxPduDeferredIdxOfRxPduInfo Com_RxPduInfo[15].IPduGroupInfoOfRxPduInfoIndEndIdxOfRxPduInfo Com_RxPduInfo[15].IPduGroupInfoOfRxPduInfoIndStartIdxOfRxPduInfo Com_RxPduInfo[15].MainFunctionRxStructIdxOfRxPduInfo Com_RxPduInfo[15].RxAccessInfoIndEndIdxOfRxPduInfo Com_RxPduInfo[15].RxAccessInfoIndStartIdxOfRxPduInfo Com_RxPduInfo[15].RxDefPduBufferEndIdxOfRxPduInfo Com_RxPduInfo[15].RxDefPduBufferStartIdxOfRxPduInfo Com_RxPduInfo[15].RxPduCalloutFuncPtrIdxOfRxPduInfo Com_RxPduInfo[15].RxSigGrpInfoIndEndIdxOfRxPduInfo Com_RxPduInfo[15].RxSigGrpInfoIndStartIdxOfRxPduInfo Com_RxPduInfo[15].RxSigInfoEndIdxOfRxPduInfo Com_RxPduInfo[15].RxSigInfoStartIdxOfRxPduInfo Com_RxPduInfo[15].RxTOutInfoIdxOfRxPduInfo Com_RxPduInfo[15].RxTOutInfoIndEndIdxOfRxPduInfo Com_RxPduInfo[15].RxTOutInfoIndStartIdxOfRxPduInfo Com_RxPduInfo[16].HandleRxPduDeferredIdxOfRxPduInfo Com_RxPduInfo[16].IPduGroupInfoOfRxPduInfoIndEndIdxOfRxPduInfo Com_RxPduInfo[16].IPduGroupInfoOfRxPduInfoIndStartIdxOfRxPduInfo Com_RxPduInfo[16].MainFunctionRxStructIdxOfRxPduInfo Com_RxPduInfo[16].RxAccessInfoIndEndIdxOfRxPduInfo Com_RxPduInfo[16].RxAccessInfoIndStartIdxOfRxPduInfo Com_RxPduInfo[16].RxDefPduBufferEndIdxOfRxPduInfo Com_RxPduInfo[16].RxDefPduBufferStartIdxOfRxPduInfo Com_RxPduInfo[16].RxPduCalloutFuncPtrIdxOfRxPduInfo Com_RxPduInfo[16].RxSigGrpInfoIndEndIdxOfRxPduInfo Com_RxPduInfo[16].RxSigGrpInfoIndStartIdxOfRxPduInfo Com_RxPduInfo[16].RxSigInfoEndIdxOfRxPduInfo Com_RxPduInfo[16].RxSigInfoStartIdxOfRxPduInfo Com_RxPduInfo[16].RxTOutInfoIdxOfRxPduInfo Com_RxPduInfo[16].RxTOutInfoIndEndIdxOfRxPduInfo Com_RxPduInfo[16].RxTOutInfoIndStartIdxOfRxPduInfo Com_RxPduInfo[17].HandleRxPduDeferredIdxOfRxPduInfo Com_RxPduInfo[17].IPduGroupInfoOfRxPduInfoIndEndIdxOfRxPduInfo Com_RxPduInfo[17].IPduGroupInfoOfRxPduInfoIndStartIdxOfRxPduInfo Com_RxPduInfo[17].MainFunctionRxStructIdxOfRxPduInfo Com_RxPduInfo[17].RxAccessInfoIndEndIdxOfRxPduInfo Com_RxPduInfo[17].RxAccessInfoIndStartIdxOfRxPduInfo Com_RxPduInfo[17].RxDefPduBufferEndIdxOfRxPduInfo Com_RxPduInfo[17].RxDefPduBufferStartIdxOfRxPduInfo Com_RxPduInfo[17].RxPduCalloutFuncPtrIdxOfRxPduInfo Com_RxPduInfo[17].RxSigGrpInfoIndEndIdxOfRxPduInfo Com_RxPduInfo[17].RxSigGrpInfoIndStartIdxOfRxPduInfo Com_RxPduInfo[17].RxSigInfoEndIdxOfRxPduInfo Com_RxPduInfo[17].RxSigInfoStartIdxOfRxPduInfo Com_RxPduInfo[17].RxTOutInfoIdxOfRxPduInfo Com_RxPduInfo[17].RxTOutInfoIndEndIdxOfRxPduInfo Com_RxPduInfo[17].RxTOutInfoIndStartIdxOfRxPduInfo Com_RxPduInfo[18].HandleRxPduDeferredIdxOfRxPduInfo Com_RxPduInfo[18].IPduGroupInfoOfRxPduInfoIndEndIdxOfRxPduInfo Com_RxPduInfo[18].IPduGroupInfoOfRxPduInfoIndStartIdxOfRxPduInfo Com_RxPduInfo[18].MainFunctionRxStructIdxOfRxPduInfo Com_RxPduInfo[18].RxAccessInfoIndEndIdxOfRxPduInfo Com_RxPduInfo[18].RxAccessInfoIndStartIdxOfRxPduInfo Com_RxPduInfo[18].RxDefPduBufferEndIdxOfRxPduInfo Com_RxPduInfo[18].RxDefPduBufferStartIdxOfRxPduInfo Com_RxPduInfo[18].RxPduCalloutFuncPtrIdxOfRxPduInfo Com_RxPduInfo[18].RxSigGrpInfoIndEndIdxOfRxPduInfo Com_RxPduInfo[18].RxSigGrpInfoIndStartIdxOfRxPduInfo Com_RxPduInfo[18].RxSigInfoEndIdxOfRxPduInfo Com_RxPduInfo[18].RxSigInfoStartIdxOfRxPduInfo Com_RxPduInfo[18].RxTOutInfoIdxOfRxPduInfo Com_RxPduInfo[18].RxTOutInfoIndEndIdxOfRxPduInfo Com_RxPduInfo[18].RxTOutInfoIndStartIdxOfRxPduInfo Com_RxPduInfo[19].HandleRxPduDeferredIdxOfRxPduInfo Com_RxPduInfo[19].IPduGroupInfoOfRxPduInfoIndEndIdxOfRxPduInfo Com_RxPduInfo[19].IPduGroupInfoOfRxPduInfoIndStartIdxOfRxPduInfo Com_RxPduInfo[19].MainFunctionRxStructIdxOfRxPduInfo Com_RxPduInfo[19].RxAccessInfoIndEndIdxOfRxPduInfo Com_RxPduInfo[19].RxAccessInfoIndStartIdxOfRxPduInfo Com_RxPduInfo[19].RxDefPduBufferEndIdxOfRxPduInfo Com_RxPduInfo[19].RxDefPduBufferStartIdxOfRxPduInfo Com_RxPduInfo[19].RxPduCalloutFuncPtrIdxOfRxPduInfo Com_RxPduInfo[19].RxSigGrpInfoIndEndIdxOfRxPduInfo Com_RxPduInfo[19].RxSigGrpInfoIndStartIdxOfRxPduInfo Com_RxPduInfo[19].RxSigInfoEndIdxOfRxPduInfo Com_RxPduInfo[19].RxSigInfoStartIdxOfRxPduInfo Com_RxPduInfo[19].RxTOutInfoIdxOfRxPduInfo Com_RxPduInfo[19].RxTOutInfoIndEndIdxOfRxPduInfo Com_RxPduInfo[19].RxTOutInfoIndStartIdxOfRxPduInfo Com_RxPduInfo[1].HandleRxPduDeferredIdxOfRxPduInfo Com_RxPduInfo[1].IPduGroupInfoOfRxPduInfoIndEndIdxOfRxPduInfo Com_RxPduInfo[1].IPduGroupInfoOfRxPduInfoIndStartIdxOfRxPduInfo Com_RxPduInfo[1].MainFunctionRxStructIdxOfRxPduInfo Com_RxPduInfo[1].RxAccessInfoIndEndIdxOfRxPduInfo Com_RxPduInfo[1].RxAccessInfoIndStartIdxOfRxPduInfo Com_RxPduInfo[1].RxDefPduBufferEndIdxOfRxPduInfo Com_RxPduInfo[1].RxDefPduBufferStartIdxOfRxPduInfo Com_RxPduInfo[1].RxPduCalloutFuncPtrIdxOfRxPduInfo Com_RxPduInfo[1].RxSigGrpInfoIndEndIdxOfRxPduInfo Com_RxPduInfo[1].RxSigGrpInfoIndStartIdxOfRxPduInfo Com_RxPduInfo[1].RxSigInfoEndIdxOfRxPduInfo Com_RxPduInfo[1].RxSigInfoStartIdxOfRxPduInfo Com_RxPduInfo[1].RxTOutInfoIdxOfRxPduInfo Com_RxPduInfo[1].RxTOutInfoIndEndIdxOfRxPduInfo Com_RxPduInfo[1].RxTOutInfoIndStartIdxOfRxPduInfo Com_RxPduInfo[20].HandleRxPduDeferredIdxOfRxPduInfo Com_RxPduInfo[20].IPduGroupInfoOfRxPduInfoIndEndIdxOfRxPduInfo Com_RxPduInfo[20].IPduGroupInfoOfRxPduInfoIndStartIdxOfRxPduInfo Com_RxPduInfo[20].MainFunctionRxStructIdxOfRxPduInfo Com_RxPduInfo[20].RxAccessInfoIndEndIdxOfRxPduInfo Com_RxPduInfo[20].RxAccessInfoIndStartIdxOfRxPduInfo Com_RxPduInfo[20].RxDefPduBufferEndIdxOfRxPduInfo Com_RxPduInfo[20].RxDefPduBufferStartIdxOfRxPduInfo Com_RxPduInfo[20].RxPduCalloutFuncPtrIdxOfRxPduInfo Com_RxPduInfo[20].RxSigGrpInfoIndEndIdxOfRxPduInfo Com_RxPduInfo[20].RxSigGrpInfoIndStartIdxOfRxPduInfo Com_RxPduInfo[20].RxSigInfoEndIdxOfRxPduInfo Com_RxPduInfo[20].RxSigInfoStartIdxOfRxPduInfo Com_RxPduInfo[20].RxTOutInfoIdxOfRxPduInfo Com_RxPduInfo[20].RxTOutInfoIndEndIdxOfRxPduInfo Com_RxPduInfo[20].RxTOutInfoIndStartIdxOfRxPduInfo Com_RxPduInfo[21].HandleRxPduDeferredIdxOfRxPduInfo Com_RxPduInfo[21].IPduGroupInfoOfRxPduInfoIndEndIdxOfRxPduInfo Com_RxPduInfo[21].IPduGroupInfoOfRxPduInfoIndStartIdxOfRxPduInfo Com_RxPduInfo[21].MainFunctionRxStructIdxOfRxPduInfo Com_RxPduInfo[21].RxAccessInfoIndEndIdxOfRxPduInfo Com_RxPduInfo[21].RxAccessInfoIndStartIdxOfRxPduInfo Com_RxPduInfo[21].RxDefPduBufferEndIdxOfRxPduInfo Com_RxPduInfo[21].RxDefPduBufferStartIdxOfRxPduInfo Com_RxPduInfo[21].RxPduCalloutFuncPtrIdxOfRxPduInfo Com_RxPduInfo[21].RxSigGrpInfoIndEndIdxOfRxPduInfo Com_RxPduInfo[21].RxSigGrpInfoIndStartIdxOfRxPduInfo Com_RxPduInfo[21].RxSigInfoEndIdxOfRxPduInfo Com_RxPduInfo[21].RxSigInfoStartIdxOfRxPduInfo Com_RxPduInfo[21].RxTOutInfoIdxOfRxPduInfo Com_RxPduInfo[21].RxTOutInfoIndEndIdxOfRxPduInfo Com_RxPduInfo[21].RxTOutInfoIndStartIdxOfRxPduInfo Com_RxPduInfo[22].HandleRxPduDeferredIdxOfRxPduInfo Com_RxPduInfo[22].IPduGroupInfoOfRxPduInfoIndEndIdxOfRxPduInfo Com_RxPduInfo[22].IPduGroupInfoOfRxPduInfoIndStartIdxOfRxPduInfo Com_RxPduInfo[22].MainFunctionRxStructIdxOfRxPduInfo Com_RxPduInfo[22].RxAccessInfoIndEndIdxOfRxPduInfo Com_RxPduInfo[22].RxAccessInfoIndStartIdxOfRxPduInfo Com_RxPduInfo[22].RxDefPduBufferEndIdxOfRxPduInfo Com_RxPduInfo[22].RxDefPduBufferStartIdxOfRxPduInfo Com_RxPduInfo[22].RxPduCalloutFuncPtrIdxOfRxPduInfo Com_RxPduInfo[22].RxSigGrpInfoIndEndIdxOfRxPduInfo Com_RxPduInfo[22].RxSigGrpInfoIndStartIdxOfRxPduInfo Com_RxPduInfo[22].RxSigInfoEndIdxOfRxPduInfo Com_RxPduInfo[22].RxSigInfoStartIdxOfRxPduInfo Com_RxPduInfo[22].RxTOutInfoIdxOfRxPduInfo Com_RxPduInfo[22].RxTOutInfoIndEndIdxOfRxPduInfo Com_RxPduInfo[22].RxTOutInfoIndStartIdxOfRxPduInfo Com_RxPduInfo[23].HandleRxPduDeferredIdxOfRxPduInfo Com_RxPduInfo[23].IPduGroupInfoOfRxPduInfoIndEndIdxOfRxPduInfo Com_RxPduInfo[23].IPduGroupInfoOfRxPduInfoIndStartIdxOfRxPduInfo Com_RxPduInfo[23].MainFunctionRxStructIdxOfRxPduInfo Com_RxPduInfo[23].RxAccessInfoIndEndIdxOfRxPduInfo Com_RxPduInfo[23].RxAccessInfoIndStartIdxOfRxPduInfo Com_RxPduInfo[23].RxDefPduBufferEndIdxOfRxPduInfo Com_RxPduInfo[23].RxDefPduBufferStartIdxOfRxPduInfo Com_RxPduInfo[23].RxPduCalloutFuncPtrIdxOfRxPduInfo Com_RxPduInfo[23].RxSigGrpInfoIndEndIdxOfRxPduInfo Com_RxPduInfo[23].RxSigGrpInfoIndStartIdxOfRxPduInfo Com_RxPduInfo[23].RxSigInfoEndIdxOfRxPduInfo Com_RxPduInfo[23].RxSigInfoStartIdxOfRxPduInfo Com_RxPduInfo[23].RxTOutInfoIdxOfRxPduInfo Com_RxPduInfo[23].RxTOutInfoIndEndIdxOfRxPduInfo Com_RxPduInfo[23].RxTOutInfoIndStartIdxOfRxPduInfo Com_RxPduInfo[24].HandleRxPduDeferredIdxOfRxPduInfo Com_RxPduInfo[24].IPduGroupInfoOfRxPduInfoIndEndIdxOfRxPduInfo Com_RxPduInfo[24].IPduGroupInfoOfRxPduInfoIndStartIdxOfRxPduInfo Com_RxPduInfo[24].MainFunctionRxStructIdxOfRxPduInfo Com_RxPduInfo[24].RxAccessInfoIndEndIdxOfRxPduInfo Com_RxPduInfo[24].RxAccessInfoIndStartIdxOfRxPduInfo Com_RxPduInfo[24].RxDefPduBufferEndIdxOfRxPduInfo Com_RxPduInfo[24].RxDefPduBufferStartIdxOfRxPduInfo Com_RxPduInfo[24].RxPduCalloutFuncPtrIdxOfRxPduInfo Com_RxPduInfo[24].RxSigGrpInfoIndEndIdxOfRxPduInfo Com_RxPduInfo[24].RxSigGrpInfoIndStartIdxOfRxPduInfo Com_RxPduInfo[24].RxSigInfoEndIdxOfRxPduInfo Com_RxPduInfo[24].RxSigInfoStartIdxOfRxPduInfo Com_RxPduInfo[24].RxTOutInfoIdxOfRxPduInfo Com_RxPduInfo[24].RxTOutInfoIndEndIdxOfRxPduInfo Com_RxPduInfo[24].RxTOutInfoIndStartIdxOfRxPduInfo Com_RxPduInfo[25].HandleRxPduDeferredIdxOfRxPduInfo Com_RxPduInfo[25].IPduGroupInfoOfRxPduInfoIndEndIdxOfRxPduInfo Com_RxPduInfo[25].IPduGroupInfoOfRxPduInfoIndStartIdxOfRxPduInfo Com_RxPduInfo[25].MainFunctionRxStructIdxOfRxPduInfo Com_RxPduInfo[25].RxAccessInfoIndEndIdxOfRxPduInfo Com_RxPduInfo[25].RxAccessInfoIndStartIdxOfRxPduInfo Com_RxPduInfo[25].RxDefPduBufferEndIdxOfRxPduInfo Com_RxPduInfo[25].RxDefPduBufferStartIdxOfRxPduInfo Com_RxPduInfo[25].RxPduCalloutFuncPtrIdxOfRxPduInfo Com_RxPduInfo[25].RxSigGrpInfoIndEndIdxOfRxPduInfo Com_RxPduInfo[25].RxSigGrpInfoIndStartIdxOfRxPduInfo Com_RxPduInfo[25].RxSigInfoEndIdxOfRxPduInfo Com_RxPduInfo[25].RxSigInfoStartIdxOfRxPduInfo Com_RxPduInfo[25].RxTOutInfoIdxOfRxPduInfo Com_RxPduInfo[25].RxTOutInfoIndEndIdxOfRxPduInfo Com_RxPduInfo[25].RxTOutInfoIndStartIdxOfRxPduInfo Com_RxPduInfo[26].HandleRxPduDeferredIdxOfRxPduInfo Com_RxPduInfo[26].IPduGroupInfoOfRxPduInfoIndEndIdxOfRxPduInfo Com_RxPduInfo[26].IPduGroupInfoOfRxPduInfoIndStartIdxOfRxPduInfo Com_RxPduInfo[26].MainFunctionRxStructIdxOfRxPduInfo Com_RxPduInfo[26].RxAccessInfoIndEndIdxOfRxPduInfo Com_RxPduInfo[26].RxAccessInfoIndStartIdxOfRxPduInfo Com_RxPduInfo[26].RxDefPduBufferEndIdxOfRxPduInfo Com_RxPduInfo[26].RxDefPduBufferStartIdxOfRxPduInfo Com_RxPduInfo[26].RxPduCalloutFuncPtrIdxOfRxPduInfo Com_RxPduInfo[26].RxSigGrpInfoIndEndIdxOfRxPduInfo Com_RxPduInfo[26].RxSigGrpInfoIndStartIdxOfRxPduInfo Com_RxPduInfo[26].RxSigInfoEndIdxOfRxPduInfo Com_RxPduInfo[26].RxSigInfoStartIdxOfRxPduInfo Com_RxPduInfo[26].RxTOutInfoIdxOfRxPduInfo Com_RxPduInfo[26].RxTOutInfoIndEndIdxOfRxPduInfo Com_RxPduInfo[26].RxTOutInfoIndStartIdxOfRxPduInfo Com_RxPduInfo[27].HandleRxPduDeferredIdxOfRxPduInfo Com_RxPduInfo[27].IPduGroupInfoOfRxPduInfoIndEndIdxOfRxPduInfo Com_RxPduInfo[27].IPduGroupInfoOfRxPduInfoIndStartIdxOfRxPduInfo Com_RxPduInfo[27].MainFunctionRxStructIdxOfRxPduInfo Com_RxPduInfo[27].RxAccessInfoIndEndIdxOfRxPduInfo Com_RxPduInfo[27].RxAccessInfoIndStartIdxOfRxPduInfo Com_RxPduInfo[27].RxDefPduBufferEndIdxOfRxPduInfo Com_RxPduInfo[27].RxDefPduBufferStartIdxOfRxPduInfo Com_RxPduInfo[27].RxPduCalloutFuncPtrIdxOfRxPduInfo Com_RxPduInfo[27].RxSigGrpInfoIndEndIdxOfRxPduInfo Com_RxPduInfo[27].RxSigGrpInfoIndStartIdxOfRxPduInfo Com_RxPduInfo[27].RxSigInfoEndIdxOfRxPduInfo Com_RxPduInfo[27].RxSigInfoStartIdxOfRxPduInfo Com_RxPduInfo[27].RxTOutInfoIdxOfRxPduInfo Com_RxPduInfo[27].RxTOutInfoIndEndIdxOfRxPduInfo Com_RxPduInfo[27].RxTOutInfoIndStartIdxOfRxPduInfo Com_RxPduInfo[28].HandleRxPduDeferredIdxOfRxPduInfo Com_RxPduInfo[28].IPduGroupInfoOfRxPduInfoIndEndIdxOfRxPduInfo Com_RxPduInfo[28].IPduGroupInfoOfRxPduInfoIndStartIdxOfRxPduInfo Com_RxPduInfo[28].MainFunctionRxStructIdxOfRxPduInfo Com_RxPduInfo[28].RxAccessInfoIndEndIdxOfRxPduInfo Com_RxPduInfo[28].RxAccessInfoIndStartIdxOfRxPduInfo Com_RxPduInfo[28].RxDefPduBufferEndIdxOfRxPduInfo Com_RxPduInfo[28].RxDefPduBufferStartIdxOfRxPduInfo Com_RxPduInfo[28].RxPduCalloutFuncPtrIdxOfRxPduInfo Com_RxPduInfo[28].RxSigGrpInfoIndEndIdxOfRxPduInfo Com_RxPduInfo[28].RxSigGrpInfoIndStartIdxOfRxPduInfo Com_RxPduInfo[28].RxSigInfoEndIdxOfRxPduInfo Com_RxPduInfo[28].RxSigInfoStartIdxOfRxPduInfo Com_RxPduInfo[28].RxTOutInfoIdxOfRxPduInfo Com_RxPduInfo[28].RxTOutInfoIndEndIdxOfRxPduInfo Com_RxPduInfo[28].RxTOutInfoIndStartIdxOfRxPduInfo Com_RxPduInfo[29].HandleRxPduDeferredIdxOfRxPduInfo Com_RxPduInfo[29].IPduGroupInfoOfRxPduInfoIndEndIdxOfRxPduInfo Com_RxPduInfo[29].IPduGroupInfoOfRxPduInfoIndStartIdxOfRxPduInfo Com_RxPduInfo[29].MainFunctionRxStructIdxOfRxPduInfo Com_RxPduInfo[29].RxAccessInfoIndEndIdxOfRxPduInfo Com_RxPduInfo[29].RxAccessInfoIndStartIdxOfRxPduInfo Com_RxPduInfo[29].RxDefPduBufferEndIdxOfRxPduInfo Com_RxPduInfo[29].RxDefPduBufferStartIdxOfRxPduInfo Com_RxPduInfo[29].RxPduCalloutFuncPtrIdxOfRxPduInfo Com_RxPduInfo[29].RxSigGrpInfoIndEndIdxOfRxPduInfo Com_RxPduInfo[29].RxSigGrpInfoIndStartIdxOfRxPduInfo Com_RxPduInfo[29].RxSigInfoEndIdxOfRxPduInfo Com_RxPduInfo[29].RxSigInfoStartIdxOfRxPduInfo Com_RxPduInfo[29].RxTOutInfoIdxOfRxPduInfo Com_RxPduInfo[29].RxTOutInfoIndEndIdxOfRxPduInfo Com_RxPduInfo[29].RxTOutInfoIndStartIdxOfRxPduInfo Com_RxPduInfo[2].HandleRxPduDeferredIdxOfRxPduInfo Com_RxPduInfo[2].IPduGroupInfoOfRxPduInfoIndEndIdxOfRxPduInfo Com_RxPduInfo[2].IPduGroupInfoOfRxPduInfoIndStartIdxOfRxPduInfo Com_RxPduInfo[2].MainFunctionRxStructIdxOfRxPduInfo Com_RxPduInfo[2].RxAccessInfoIndEndIdxOfRxPduInfo Com_RxPduInfo[2].RxAccessInfoIndStartIdxOfRxPduInfo Com_RxPduInfo[2].RxDefPduBufferEndIdxOfRxPduInfo Com_RxPduInfo[2].RxDefPduBufferStartIdxOfRxPduInfo Com_RxPduInfo[2].RxPduCalloutFuncPtrIdxOfRxPduInfo Com_RxPduInfo[2].RxSigGrpInfoIndEndIdxOfRxPduInfo Com_RxPduInfo[2].RxSigGrpInfoIndStartIdxOfRxPduInfo Com_RxPduInfo[2].RxSigInfoEndIdxOfRxPduInfo Com_RxPduInfo[2].RxSigInfoStartIdxOfRxPduInfo Com_RxPduInfo[2].RxTOutInfoIdxOfRxPduInfo Com_RxPduInfo[2].RxTOutInfoIndEndIdxOfRxPduInfo Com_RxPduInfo[2].RxTOutInfoIndStartIdxOfRxPduInfo Com_RxPduInfo[30].HandleRxPduDeferredIdxOfRxPduInfo Com_RxPduInfo[30].IPduGroupInfoOfRxPduInfoIndEndIdxOfRxPduInfo Com_RxPduInfo[30].IPduGroupInfoOfRxPduInfoIndStartIdxOfRxPduInfo Com_RxPduInfo[30].MainFunctionRxStructIdxOfRxPduInfo Com_RxPduInfo[30].RxAccessInfoIndEndIdxOfRxPduInfo Com_RxPduInfo[30].RxAccessInfoIndStartIdxOfRxPduInfo Com_RxPduInfo[30].RxDefPduBufferEndIdxOfRxPduInfo Com_RxPduInfo[30].RxDefPduBufferStartIdxOfRxPduInfo Com_RxPduInfo[30].RxPduCalloutFuncPtrIdxOfRxPduInfo Com_RxPduInfo[30].RxSigGrpInfoIndEndIdxOfRxPduInfo Com_RxPduInfo[30].RxSigGrpInfoIndStartIdxOfRxPduInfo Com_RxPduInfo[30].RxSigInfoEndIdxOfRxPduInfo Com_RxPduInfo[30].RxSigInfoStartIdxOfRxPduInfo Com_RxPduInfo[30].RxTOutInfoIdxOfRxPduInfo Com_RxPduInfo[30].RxTOutInfoIndEndIdxOfRxPduInfo Com_RxPduInfo[30].RxTOutInfoIndStartIdxOfRxPduInfo Com_RxPduInfo[31].HandleRxPduDeferredIdxOfRxPduInfo Com_RxPduInfo[31].IPduGroupInfoOfRxPduInfoIndEndIdxOfRxPduInfo Com_RxPduInfo[31].IPduGroupInfoOfRxPduInfoIndStartIdxOfRxPduInfo Com_RxPduInfo[31].MainFunctionRxStructIdxOfRxPduInfo Com_RxPduInfo[31].RxAccessInfoIndEndIdxOfRxPduInfo Com_RxPduInfo[31].RxAccessInfoIndStartIdxOfRxPduInfo Com_RxPduInfo[31].RxDefPduBufferEndIdxOfRxPduInfo Com_RxPduInfo[31].RxDefPduBufferStartIdxOfRxPduInfo Com_RxPduInfo[31].RxPduCalloutFuncPtrIdxOfRxPduInfo Com_RxPduInfo[31].RxSigGrpInfoIndEndIdxOfRxPduInfo Com_RxPduInfo[31].RxSigGrpInfoIndStartIdxOfRxPduInfo Com_RxPduInfo[31].RxSigInfoEndIdxOfRxPduInfo Com_RxPduInfo[31].RxSigInfoStartIdxOfRxPduInfo Com_RxPduInfo[31].RxTOutInfoIdxOfRxPduInfo Com_RxPduInfo[31].RxTOutInfoIndEndIdxOfRxPduInfo Com_RxPduInfo[31].RxTOutInfoIndStartIdxOfRxPduInfo Com_RxPduInfo[32].HandleRxPduDeferredIdxOfRxPduInfo Com_RxPduInfo[32].IPduGroupInfoOfRxPduInfoIndEndIdxOfRxPduInfo Com_RxPduInfo[32].IPduGroupInfoOfRxPduInfoIndStartIdxOfRxPduInfo Com_RxPduInfo[32].MainFunctionRxStructIdxOfRxPduInfo Com_RxPduInfo[32].RxAccessInfoIndEndIdxOfRxPduInfo Com_RxPduInfo[32].RxAccessInfoIndStartIdxOfRxPduInfo Com_RxPduInfo[32].RxDefPduBufferEndIdxOfRxPduInfo Com_RxPduInfo[32].RxDefPduBufferStartIdxOfRxPduInfo Com_RxPduInfo[32].RxPduCalloutFuncPtrIdxOfRxPduInfo Com_RxPduInfo[32].RxSigGrpInfoIndEndIdxOfRxPduInfo Com_RxPduInfo[32].RxSigGrpInfoIndStartIdxOfRxPduInfo Com_RxPduInfo[32].RxSigInfoEndIdxOfRxPduInfo Com_RxPduInfo[32].RxSigInfoStartIdxOfRxPduInfo Com_RxPduInfo[32].RxTOutInfoIdxOfRxPduInfo Com_RxPduInfo[32].RxTOutInfoIndEndIdxOfRxPduInfo Com_RxPduInfo[32].RxTOutInfoIndStartIdxOfRxPduInfo Com_RxPduInfo[33].HandleRxPduDeferredIdxOfRxPduInfo Com_RxPduInfo[33].IPduGroupInfoOfRxPduInfoIndEndIdxOfRxPduInfo Com_RxPduInfo[33].IPduGroupInfoOfRxPduInfoIndStartIdxOfRxPduInfo Com_RxPduInfo[33].MainFunctionRxStructIdxOfRxPduInfo Com_RxPduInfo[33].RxAccessInfoIndEndIdxOfRxPduInfo Com_RxPduInfo[33].RxAccessInfoIndStartIdxOfRxPduInfo Com_RxPduInfo[33].RxDefPduBufferEndIdxOfRxPduInfo Com_RxPduInfo[33].RxDefPduBufferStartIdxOfRxPduInfo Com_RxPduInfo[33].RxPduCalloutFuncPtrIdxOfRxPduInfo Com_RxPduInfo[33].RxSigGrpInfoIndEndIdxOfRxPduInfo Com_RxPduInfo[33].RxSigGrpInfoIndStartIdxOfRxPduInfo Com_RxPduInfo[33].RxSigInfoEndIdxOfRxPduInfo Com_RxPduInfo[33].RxSigInfoStartIdxOfRxPduInfo Com_RxPduInfo[33].RxTOutInfoIdxOfRxPduInfo Com_RxPduInfo[33].RxTOutInfoIndEndIdxOfRxPduInfo Com_RxPduInfo[33].RxTOutInfoIndStartIdxOfRxPduInfo Com_RxPduInfo[34].HandleRxPduDeferredIdxOfRxPduInfo Com_RxPduInfo[34].IPduGroupInfoOfRxPduInfoIndEndIdxOfRxPduInfo Com_RxPduInfo[34].IPduGroupInfoOfRxPduInfoIndStartIdxOfRxPduInfo Com_RxPduInfo[34].MainFunctionRxStructIdxOfRxPduInfo Com_RxPduInfo[34].RxAccessInfoIndEndIdxOfRxPduInfo Com_RxPduInfo[34].RxAccessInfoIndStartIdxOfRxPduInfo Com_RxPduInfo[34].RxDefPduBufferEndIdxOfRxPduInfo Com_RxPduInfo[34].RxDefPduBufferStartIdxOfRxPduInfo Com_RxPduInfo[34].RxPduCalloutFuncPtrIdxOfRxPduInfo Com_RxPduInfo[34].RxSigGrpInfoIndEndIdxOfRxPduInfo Com_RxPduInfo[34].RxSigGrpInfoIndStartIdxOfRxPduInfo Com_RxPduInfo[34].RxSigInfoEndIdxOfRxPduInfo Com_RxPduInfo[34].RxSigInfoStartIdxOfRxPduInfo Com_RxPduInfo[34].RxTOutInfoIdxOfRxPduInfo Com_RxPduInfo[34].RxTOutInfoIndEndIdxOfRxPduInfo Com_RxPduInfo[34].RxTOutInfoIndStartIdxOfRxPduInfo Com_RxPduInfo[35].HandleRxPduDeferredIdxOfRxPduInfo Com_RxPduInfo[35].IPduGroupInfoOfRxPduInfoIndEndIdxOfRxPduInfo Com_RxPduInfo[35].IPduGroupInfoOfRxPduInfoIndStartIdxOfRxPduInfo Com_RxPduInfo[35].MainFunctionRxStructIdxOfRxPduInfo Com_RxPduInfo[35].RxAccessInfoIndEndIdxOfRxPduInfo Com_RxPduInfo[35].RxAccessInfoIndStartIdxOfRxPduInfo Com_RxPduInfo[35].RxDefPduBufferEndIdxOfRxPduInfo Com_RxPduInfo[35].RxDefPduBufferStartIdxOfRxPduInfo Com_RxPduInfo[35].RxPduCalloutFuncPtrIdxOfRxPduInfo Com_RxPduInfo[35].RxSigGrpInfoIndEndIdxOfRxPduInfo Com_RxPduInfo[35].RxSigGrpInfoIndStartIdxOfRxPduInfo Com_RxPduInfo[35].RxSigInfoEndIdxOfRxPduInfo Com_RxPduInfo[35].RxSigInfoStartIdxOfRxPduInfo Com_RxPduInfo[35].RxTOutInfoIdxOfRxPduInfo Com_RxPduInfo[35].RxTOutInfoIndEndIdxOfRxPduInfo Com_RxPduInfo[35].RxTOutInfoIndStartIdxOfRxPduInfo Com_RxPduInfo[36].HandleRxPduDeferredIdxOfRxPduInfo Com_RxPduInfo[36].IPduGroupInfoOfRxPduInfoIndEndIdxOfRxPduInfo Com_RxPduInfo[36].IPduGroupInfoOfRxPduInfoIndStartIdxOfRxPduInfo Com_RxPduInfo[36].MainFunctionRxStructIdxOfRxPduInfo Com_RxPduInfo[36].RxAccessInfoIndEndIdxOfRxPduInfo Com_RxPduInfo[36].RxAccessInfoIndStartIdxOfRxPduInfo Com_RxPduInfo[36].RxDefPduBufferEndIdxOfRxPduInfo Com_RxPduInfo[36].RxDefPduBufferStartIdxOfRxPduInfo Com_RxPduInfo[36].RxPduCalloutFuncPtrIdxOfRxPduInfo Com_RxPduInfo[36].RxSigGrpInfoIndEndIdxOfRxPduInfo Com_RxPduInfo[36].RxSigGrpInfoIndStartIdxOfRxPduInfo Com_RxPduInfo[36].RxSigInfoEndIdxOfRxPduInfo Com_RxPduInfo[36].RxSigInfoStartIdxOfRxPduInfo Com_RxPduInfo[36].RxTOutInfoIdxOfRxPduInfo Com_RxPduInfo[36].RxTOutInfoIndEndIdxOfRxPduInfo Com_RxPduInfo[36].RxTOutInfoIndStartIdxOfRxPduInfo Com_RxPduInfo[37].HandleRxPduDeferredIdxOfRxPduInfo Com_RxPduInfo[37].IPduGroupInfoOfRxPduInfoIndEndIdxOfRxPduInfo Com_RxPduInfo[37].IPduGroupInfoOfRxPduInfoIndStartIdxOfRxPduInfo Com_RxPduInfo[37].MainFunctionRxStructIdxOfRxPduInfo Com_RxPduInfo[37].RxAccessInfoIndEndIdxOfRxPduInfo Com_RxPduInfo[37].RxAccessInfoIndStartIdxOfRxPduInfo Com_RxPduInfo[37].RxDefPduBufferEndIdxOfRxPduInfo Com_RxPduInfo[37].RxDefPduBufferStartIdxOfRxPduInfo Com_RxPduInfo[37].RxPduCalloutFuncPtrIdxOfRxPduInfo Com_RxPduInfo[37].RxSigGrpInfoIndEndIdxOfRxPduInfo Com_RxPduInfo[37].RxSigGrpInfoIndStartIdxOfRxPduInfo Com_RxPduInfo[37].RxSigInfoEndIdxOfRxPduInfo Com_RxPduInfo[37].RxSigInfoStartIdxOfRxPduInfo Com_RxPduInfo[37].RxTOutInfoIdxOfRxPduInfo Com_RxPduInfo[37].RxTOutInfoIndEndIdxOfRxPduInfo Com_RxPduInfo[37].RxTOutInfoIndStartIdxOfRxPduInfo Com_RxPduInfo[38].HandleRxPduDeferredIdxOfRxPduInfo Com_RxPduInfo[38].IPduGroupInfoOfRxPduInfoIndEndIdxOfRxPduInfo Com_RxPduInfo[38].IPduGroupInfoOfRxPduInfoIndStartIdxOfRxPduInfo Com_RxPduInfo[38].MainFunctionRxStructIdxOfRxPduInfo Com_RxPduInfo[38].RxAccessInfoIndEndIdxOfRxPduInfo Com_RxPduInfo[38].RxAccessInfoIndStartIdxOfRxPduInfo Com_RxPduInfo[38].RxDefPduBufferEndIdxOfRxPduInfo Com_RxPduInfo[38].RxDefPduBufferStartIdxOfRxPduInfo Com_RxPduInfo[38].RxPduCalloutFuncPtrIdxOfRxPduInfo Com_RxPduInfo[38].RxSigGrpInfoIndEndIdxOfRxPduInfo Com_RxPduInfo[38].RxSigGrpInfoIndStartIdxOfRxPduInfo Com_RxPduInfo[38].RxSigInfoEndIdxOfRxPduInfo Com_RxPduInfo[38].RxSigInfoStartIdxOfRxPduInfo Com_RxPduInfo[38].RxTOutInfoIdxOfRxPduInfo Com_RxPduInfo[38].RxTOutInfoIndEndIdxOfRxPduInfo Com_RxPduInfo[38].RxTOutInfoIndStartIdxOfRxPduInfo Com_RxPduInfo[39].HandleRxPduDeferredIdxOfRxPduInfo Com_RxPduInfo[39].IPduGroupInfoOfRxPduInfoIndEndIdxOfRxPduInfo Com_RxPduInfo[39].IPduGroupInfoOfRxPduInfoIndStartIdxOfRxPduInfo Com_RxPduInfo[39].MainFunctionRxStructIdxOfRxPduInfo Com_RxPduInfo[39].RxAccessInfoIndEndIdxOfRxPduInfo Com_RxPduInfo[39].RxAccessInfoIndStartIdxOfRxPduInfo Com_RxPduInfo[39].RxDefPduBufferEndIdxOfRxPduInfo Com_RxPduInfo[39].RxDefPduBufferStartIdxOfRxPduInfo Com_RxPduInfo[39].RxPduCalloutFuncPtrIdxOfRxPduInfo Com_RxPduInfo[39].RxSigGrpInfoIndEndIdxOfRxPduInfo Com_RxPduInfo[39].RxSigGrpInfoIndStartIdxOfRxPduInfo Com_RxPduInfo[39].RxSigInfoEndIdxOfRxPduInfo Com_RxPduInfo[39].RxSigInfoStartIdxOfRxPduInfo Com_RxPduInfo[39].RxTOutInfoIdxOfRxPduInfo Com_RxPduInfo[39].RxTOutInfoIndEndIdxOfRxPduInfo Com_RxPduInfo[39].RxTOutInfoIndStartIdxOfRxPduInfo Com_RxPduInfo[3].HandleRxPduDeferredIdxOfRxPduInfo Com_RxPduInfo[3].IPduGroupInfoOfRxPduInfoIndEndIdxOfRxPduInfo Com_RxPduInfo[3].IPduGroupInfoOfRxPduInfoIndStartIdxOfRxPduInfo Com_RxPduInfo[3].MainFunctionRxStructIdxOfRxPduInfo Com_RxPduInfo[3].RxAccessInfoIndEndIdxOfRxPduInfo Com_RxPduInfo[3].RxAccessInfoIndStartIdxOfRxPduInfo Com_RxPduInfo[3].RxDefPduBufferEndIdxOfRxPduInfo Com_RxPduInfo[3].RxDefPduBufferStartIdxOfRxPduInfo Com_RxPduInfo[3].RxPduCalloutFuncPtrIdxOfRxPduInfo Com_RxPduInfo[3].RxSigGrpInfoIndEndIdxOfRxPduInfo Com_RxPduInfo[3].RxSigGrpInfoIndStartIdxOfRxPduInfo Com_RxPduInfo[3].RxSigInfoEndIdxOfRxPduInfo Com_RxPduInfo[3].RxSigInfoStartIdxOfRxPduInfo Com_RxPduInfo[3].RxTOutInfoIdxOfRxPduInfo Com_RxPduInfo[3].RxTOutInfoIndEndIdxOfRxPduInfo Com_RxPduInfo[3].RxTOutInfoIndStartIdxOfRxPduInfo Com_RxPduInfo[40].HandleRxPduDeferredIdxOfRxPduInfo Com_RxPduInfo[40].IPduGroupInfoOfRxPduInfoIndEndIdxOfRxPduInfo Com_RxPduInfo[40].IPduGroupInfoOfRxPduInfoIndStartIdxOfRxPduInfo Com_RxPduInfo[40].MainFunctionRxStructIdxOfRxPduInfo Com_RxPduInfo[40].RxAccessInfoIndEndIdxOfRxPduInfo Com_RxPduInfo[40].RxAccessInfoIndStartIdxOfRxPduInfo Com_RxPduInfo[40].RxDefPduBufferEndIdxOfRxPduInfo Com_RxPduInfo[40].RxDefPduBufferStartIdxOfRxPduInfo Com_RxPduInfo[40].RxPduCalloutFuncPtrIdxOfRxPduInfo Com_RxPduInfo[40].RxSigGrpInfoIndEndIdxOfRxPduInfo Com_RxPduInfo[40].RxSigGrpInfoIndStartIdxOfRxPduInfo Com_RxPduInfo[40].RxSigInfoEndIdxOfRxPduInfo Com_RxPduInfo[40].RxSigInfoStartIdxOfRxPduInfo Com_RxPduInfo[40].RxTOutInfoIdxOfRxPduInfo Com_RxPduInfo[40].RxTOutInfoIndEndIdxOfRxPduInfo Com_RxPduInfo[40].RxTOutInfoIndStartIdxOfRxPduInfo Com_RxPduInfo[41].HandleRxPduDeferredIdxOfRxPduInfo Com_RxPduInfo[41].IPduGroupInfoOfRxPduInfoIndEndIdxOfRxPduInfo Com_RxPduInfo[41].IPduGroupInfoOfRxPduInfoIndStartIdxOfRxPduInfo Com_RxPduInfo[41].MainFunctionRxStructIdxOfRxPduInfo Com_RxPduInfo[41].RxAccessInfoIndEndIdxOfRxPduInfo Com_RxPduInfo[41].RxAccessInfoIndStartIdxOfRxPduInfo Com_RxPduInfo[41].RxDefPduBufferEndIdxOfRxPduInfo Com_RxPduInfo[41].RxDefPduBufferStartIdxOfRxPduInfo Com_RxPduInfo[41].RxPduCalloutFuncPtrIdxOfRxPduInfo Com_RxPduInfo[41].RxSigGrpInfoIndEndIdxOfRxPduInfo Com_RxPduInfo[41].RxSigGrpInfoIndStartIdxOfRxPduInfo Com_RxPduInfo[41].RxSigInfoEndIdxOfRxPduInfo Com_RxPduInfo[41].RxSigInfoStartIdxOfRxPduInfo Com_RxPduInfo[41].RxTOutInfoIdxOfRxPduInfo Com_RxPduInfo[41].RxTOutInfoIndEndIdxOfRxPduInfo Com_RxPduInfo[41].RxTOutInfoIndStartIdxOfRxPduInfo Com_RxPduInfo[42].HandleRxPduDeferredIdxOfRxPduInfo Com_RxPduInfo[42].IPduGroupInfoOfRxPduInfoIndEndIdxOfRxPduInfo Com_RxPduInfo[42].IPduGroupInfoOfRxPduInfoIndStartIdxOfRxPduInfo Com_RxPduInfo[42].MainFunctionRxStructIdxOfRxPduInfo Com_RxPduInfo[42].RxAccessInfoIndEndIdxOfRxPduInfo Com_RxPduInfo[42].RxAccessInfoIndStartIdxOfRxPduInfo Com_RxPduInfo[42].RxDefPduBufferEndIdxOfRxPduInfo Com_RxPduInfo[42].RxDefPduBufferStartIdxOfRxPduInfo Com_RxPduInfo[42].RxPduCalloutFuncPtrIdxOfRxPduInfo Com_RxPduInfo[42].RxSigGrpInfoIndEndIdxOfRxPduInfo Com_RxPduInfo[42].RxSigGrpInfoIndStartIdxOfRxPduInfo Com_RxPduInfo[42].RxSigInfoEndIdxOfRxPduInfo Com_RxPduInfo[42].RxSigInfoStartIdxOfRxPduInfo Com_RxPduInfo[42].RxTOutInfoIdxOfRxPduInfo Com_RxPduInfo[42].RxTOutInfoIndEndIdxOfRxPduInfo Com_RxPduInfo[42].RxTOutInfoIndStartIdxOfRxPduInfo Com_RxPduInfo[43].HandleRxPduDeferredIdxOfRxPduInfo Com_RxPduInfo[43].IPduGroupInfoOfRxPduInfoIndEndIdxOfRxPduInfo Com_RxPduInfo[43].IPduGroupInfoOfRxPduInfoIndStartIdxOfRxPduInfo Com_RxPduInfo[43].MainFunctionRxStructIdxOfRxPduInfo Com_RxPduInfo[43].RxAccessInfoIndEndIdxOfRxPduInfo Com_RxPduInfo[43].RxAccessInfoIndStartIdxOfRxPduInfo Com_RxPduInfo[43].RxDefPduBufferEndIdxOfRxPduInfo Com_RxPduInfo[43].RxDefPduBufferStartIdxOfRxPduInfo Com_RxPduInfo[43].RxPduCalloutFuncPtrIdxOfRxPduInfo Com_RxPduInfo[43].RxSigGrpInfoIndEndIdxOfRxPduInfo Com_RxPduInfo[43].RxSigGrpInfoIndStartIdxOfRxPduInfo Com_RxPduInfo[43].RxSigInfoEndIdxOfRxPduInfo Com_RxPduInfo[43].RxSigInfoStartIdxOfRxPduInfo Com_RxPduInfo[43].RxTOutInfoIdxOfRxPduInfo Com_RxPduInfo[43].RxTOutInfoIndEndIdxOfRxPduInfo Com_RxPduInfo[43].RxTOutInfoIndStartIdxOfRxPduInfo Com_RxPduInfo[44].HandleRxPduDeferredIdxOfRxPduInfo Com_RxPduInfo[44].IPduGroupInfoOfRxPduInfoIndEndIdxOfRxPduInfo Com_RxPduInfo[44].IPduGroupInfoOfRxPduInfoIndStartIdxOfRxPduInfo Com_RxPduInfo[44].MainFunctionRxStructIdxOfRxPduInfo Com_RxPduInfo[44].RxAccessInfoIndEndIdxOfRxPduInfo Com_RxPduInfo[44].RxAccessInfoIndStartIdxOfRxPduInfo Com_RxPduInfo[44].RxDefPduBufferEndIdxOfRxPduInfo Com_RxPduInfo[44].RxDefPduBufferStartIdxOfRxPduInfo Com_RxPduInfo[44].RxPduCalloutFuncPtrIdxOfRxPduInfo Com_RxPduInfo[44].RxSigGrpInfoIndEndIdxOfRxPduInfo Com_RxPduInfo[44].RxSigGrpInfoIndStartIdxOfRxPduInfo Com_RxPduInfo[44].RxSigInfoEndIdxOfRxPduInfo Com_RxPduInfo[44].RxSigInfoStartIdxOfRxPduInfo Com_RxPduInfo[44].RxTOutInfoIdxOfRxPduInfo Com_RxPduInfo[44].RxTOutInfoIndEndIdxOfRxPduInfo Com_RxPduInfo[44].RxTOutInfoIndStartIdxOfRxPduInfo Com_RxPduInfo[45].HandleRxPduDeferredIdxOfRxPduInfo Com_RxPduInfo[45].IPduGroupInfoOfRxPduInfoIndEndIdxOfRxPduInfo Com_RxPduInfo[45].IPduGroupInfoOfRxPduInfoIndStartIdxOfRxPduInfo Com_RxPduInfo[45].MainFunctionRxStructIdxOfRxPduInfo Com_RxPduInfo[45].RxAccessInfoIndEndIdxOfRxPduInfo Com_RxPduInfo[45].RxAccessInfoIndStartIdxOfRxPduInfo Com_RxPduInfo[45].RxDefPduBufferEndIdxOfRxPduInfo Com_RxPduInfo[45].RxDefPduBufferStartIdxOfRxPduInfo Com_RxPduInfo[45].RxPduCalloutFuncPtrIdxOfRxPduInfo Com_RxPduInfo[45].RxSigGrpInfoIndEndIdxOfRxPduInfo Com_RxPduInfo[45].RxSigGrpInfoIndStartIdxOfRxPduInfo Com_RxPduInfo[45].RxSigInfoEndIdxOfRxPduInfo Com_RxPduInfo[45].RxSigInfoStartIdxOfRxPduInfo Com_RxPduInfo[45].RxTOutInfoIdxOfRxPduInfo Com_RxPduInfo[45].RxTOutInfoIndEndIdxOfRxPduInfo Com_RxPduInfo[45].RxTOutInfoIndStartIdxOfRxPduInfo Com_RxPduInfo[46].HandleRxPduDeferredIdxOfRxPduInfo Com_RxPduInfo[46].IPduGroupInfoOfRxPduInfoIndEndIdxOfRxPduInfo Com_RxPduInfo[46].IPduGroupInfoOfRxPduInfoIndStartIdxOfRxPduInfo Com_RxPduInfo[46].MainFunctionRxStructIdxOfRxPduInfo Com_RxPduInfo[46].RxAccessInfoIndEndIdxOfRxPduInfo Com_RxPduInfo[46].RxAccessInfoIndStartIdxOfRxPduInfo Com_RxPduInfo[46].RxDefPduBufferEndIdxOfRxPduInfo Com_RxPduInfo[46].RxDefPduBufferStartIdxOfRxPduInfo Com_RxPduInfo[46].RxPduCalloutFuncPtrIdxOfRxPduInfo Com_RxPduInfo[46].RxSigGrpInfoIndEndIdxOfRxPduInfo Com_RxPduInfo[46].RxSigGrpInfoIndStartIdxOfRxPduInfo Com_RxPduInfo[46].RxSigInfoEndIdxOfRxPduInfo Com_RxPduInfo[46].RxSigInfoStartIdxOfRxPduInfo Com_RxPduInfo[46].RxTOutInfoIdxOfRxPduInfo Com_RxPduInfo[46].RxTOutInfoIndEndIdxOfRxPduInfo Com_RxPduInfo[46].RxTOutInfoIndStartIdxOfRxPduInfo Com_RxPduInfo[47].HandleRxPduDeferredIdxOfRxPduInfo Com_RxPduInfo[47].IPduGroupInfoOfRxPduInfoIndEndIdxOfRxPduInfo Com_RxPduInfo[47].IPduGroupInfoOfRxPduInfoIndStartIdxOfRxPduInfo Com_RxPduInfo[47].MainFunctionRxStructIdxOfRxPduInfo Com_RxPduInfo[47].RxAccessInfoIndEndIdxOfRxPduInfo Com_RxPduInfo[47].RxAccessInfoIndStartIdxOfRxPduInfo Com_RxPduInfo[47].RxDefPduBufferEndIdxOfRxPduInfo Com_RxPduInfo[47].RxDefPduBufferStartIdxOfRxPduInfo Com_RxPduInfo[47].RxPduCalloutFuncPtrIdxOfRxPduInfo Com_RxPduInfo[47].RxSigGrpInfoIndEndIdxOfRxPduInfo Com_RxPduInfo[47].RxSigGrpInfoIndStartIdxOfRxPduInfo Com_RxPduInfo[47].RxSigInfoEndIdxOfRxPduInfo Com_RxPduInfo[47].RxSigInfoStartIdxOfRxPduInfo Com_RxPduInfo[47].RxTOutInfoIdxOfRxPduInfo Com_RxPduInfo[47].RxTOutInfoIndEndIdxOfRxPduInfo Com_RxPduInfo[47].RxTOutInfoIndStartIdxOfRxPduInfo Com_RxPduInfo[48].HandleRxPduDeferredIdxOfRxPduInfo Com_RxPduInfo[48].IPduGroupInfoOfRxPduInfoIndEndIdxOfRxPduInfo Com_RxPduInfo[48].IPduGroupInfoOfRxPduInfoIndStartIdxOfRxPduInfo Com_RxPduInfo[48].MainFunctionRxStructIdxOfRxPduInfo Com_RxPduInfo[48].RxAccessInfoIndEndIdxOfRxPduInfo Com_RxPduInfo[48].RxAccessInfoIndStartIdxOfRxPduInfo Com_RxPduInfo[48].RxDefPduBufferEndIdxOfRxPduInfo Com_RxPduInfo[48].RxDefPduBufferStartIdxOfRxPduInfo Com_RxPduInfo[48].RxPduCalloutFuncPtrIdxOfRxPduInfo Com_RxPduInfo[48].RxSigGrpInfoIndEndIdxOfRxPduInfo Com_RxPduInfo[48].RxSigGrpInfoIndStartIdxOfRxPduInfo Com_RxPduInfo[48].RxSigInfoEndIdxOfRxPduInfo Com_RxPduInfo[48].RxSigInfoStartIdxOfRxPduInfo Com_RxPduInfo[48].RxTOutInfoIdxOfRxPduInfo Com_RxPduInfo[48].RxTOutInfoIndEndIdxOfRxPduInfo Com_RxPduInfo[48].RxTOutInfoIndStartIdxOfRxPduInfo Com_RxPduInfo[49].HandleRxPduDeferredIdxOfRxPduInfo Com_RxPduInfo[49].IPduGroupInfoOfRxPduInfoIndEndIdxOfRxPduInfo Com_RxPduInfo[49].IPduGroupInfoOfRxPduInfoIndStartIdxOfRxPduInfo Com_RxPduInfo[49].MainFunctionRxStructIdxOfRxPduInfo Com_RxPduInfo[49].RxAccessInfoIndEndIdxOfRxPduInfo Com_RxPduInfo[49].RxAccessInfoIndStartIdxOfRxPduInfo Com_RxPduInfo[49].RxDefPduBufferEndIdxOfRxPduInfo Com_RxPduInfo[49].RxDefPduBufferStartIdxOfRxPduInfo Com_RxPduInfo[49].RxPduCalloutFuncPtrIdxOfRxPduInfo Com_RxPduInfo[49].RxSigGrpInfoIndEndIdxOfRxPduInfo Com_RxPduInfo[49].RxSigGrpInfoIndStartIdxOfRxPduInfo Com_RxPduInfo[49].RxSigInfoEndIdxOfRxPduInfo Com_RxPduInfo[49].RxSigInfoStartIdxOfRxPduInfo Com_RxPduInfo[49].RxTOutInfoIdxOfRxPduInfo Com_RxPduInfo[49].RxTOutInfoIndEndIdxOfRxPduInfo Com_RxPduInfo[49].RxTOutInfoIndStartIdxOfRxPduInfo Com_RxPduInfo[4].HandleRxPduDeferredIdxOfRxPduInfo Com_RxPduInfo[4].IPduGroupInfoOfRxPduInfoIndEndIdxOfRxPduInfo Com_RxPduInfo[4].IPduGroupInfoOfRxPduInfoIndStartIdxOfRxPduInfo Com_RxPduInfo[4].MainFunctionRxStructIdxOfRxPduInfo Com_RxPduInfo[4].RxAccessInfoIndEndIdxOfRxPduInfo Com_RxPduInfo[4].RxAccessInfoIndStartIdxOfRxPduInfo Com_RxPduInfo[4].RxDefPduBufferEndIdxOfRxPduInfo Com_RxPduInfo[4].RxDefPduBufferStartIdxOfRxPduInfo Com_RxPduInfo[4].RxPduCalloutFuncPtrIdxOfRxPduInfo Com_RxPduInfo[4].RxSigGrpInfoIndEndIdxOfRxPduInfo Com_RxPduInfo[4].RxSigGrpInfoIndStartIdxOfRxPduInfo Com_RxPduInfo[4].RxSigInfoEndIdxOfRxPduInfo Com_RxPduInfo[4].RxSigInfoStartIdxOfRxPduInfo Com_RxPduInfo[4].RxTOutInfoIdxOfRxPduInfo Com_RxPduInfo[4].RxTOutInfoIndEndIdxOfRxPduInfo Com_RxPduInfo[4].RxTOutInfoIndStartIdxOfRxPduInfo Com_RxPduInfo[50].HandleRxPduDeferredIdxOfRxPduInfo Com_RxPduInfo[50].IPduGroupInfoOfRxPduInfoIndEndIdxOfRxPduInfo Com_RxPduInfo[50].IPduGroupInfoOfRxPduInfoIndStartIdxOfRxPduInfo Com_RxPduInfo[50].MainFunctionRxStructIdxOfRxPduInfo Com_RxPduInfo[50].RxAccessInfoIndEndIdxOfRxPduInfo Com_RxPduInfo[50].RxAccessInfoIndStartIdxOfRxPduInfo Com_RxPduInfo[50].RxDefPduBufferEndIdxOfRxPduInfo Com_RxPduInfo[50].RxDefPduBufferStartIdxOfRxPduInfo Com_RxPduInfo[50].RxPduCalloutFuncPtrIdxOfRxPduInfo Com_RxPduInfo[50].RxSigGrpInfoIndEndIdxOfRxPduInfo Com_RxPduInfo[50].RxSigGrpInfoIndStartIdxOfRxPduInfo Com_RxPduInfo[50].RxSigInfoEndIdxOfRxPduInfo Com_RxPduInfo[50].RxSigInfoStartIdxOfRxPduInfo Com_RxPduInfo[50].RxTOutInfoIdxOfRxPduInfo Com_RxPduInfo[50].RxTOutInfoIndEndIdxOfRxPduInfo Com_RxPduInfo[50].RxTOutInfoIndStartIdxOfRxPduInfo Com_RxPduInfo[51].HandleRxPduDeferredIdxOfRxPduInfo Com_RxPduInfo[51].IPduGroupInfoOfRxPduInfoIndEndIdxOfRxPduInfo Com_RxPduInfo[51].IPduGroupInfoOfRxPduInfoIndStartIdxOfRxPduInfo Com_RxPduInfo[51].MainFunctionRxStructIdxOfRxPduInfo Com_RxPduInfo[51].RxAccessInfoIndEndIdxOfRxPduInfo Com_RxPduInfo[51].RxAccessInfoIndStartIdxOfRxPduInfo Com_RxPduInfo[51].RxDefPduBufferEndIdxOfRxPduInfo Com_RxPduInfo[51].RxDefPduBufferStartIdxOfRxPduInfo Com_RxPduInfo[51].RxPduCalloutFuncPtrIdxOfRxPduInfo Com_RxPduInfo[51].RxSigGrpInfoIndEndIdxOfRxPduInfo Com_RxPduInfo[51].RxSigGrpInfoIndStartIdxOfRxPduInfo Com_RxPduInfo[51].RxSigInfoEndIdxOfRxPduInfo Com_RxPduInfo[51].RxSigInfoStartIdxOfRxPduInfo Com_RxPduInfo[51].RxTOutInfoIdxOfRxPduInfo Com_RxPduInfo[51].RxTOutInfoIndEndIdxOfRxPduInfo Com_RxPduInfo[51].RxTOutInfoIndStartIdxOfRxPduInfo Com_RxPduInfo[52].HandleRxPduDeferredIdxOfRxPduInfo Com_RxPduInfo[52].IPduGroupInfoOfRxPduInfoIndEndIdxOfRxPduInfo Com_RxPduInfo[52].IPduGroupInfoOfRxPduInfoIndStartIdxOfRxPduInfo Com_RxPduInfo[52].MainFunctionRxStructIdxOfRxPduInfo Com_RxPduInfo[52].RxAccessInfoIndEndIdxOfRxPduInfo Com_RxPduInfo[52].RxAccessInfoIndStartIdxOfRxPduInfo Com_RxPduInfo[52].RxDefPduBufferEndIdxOfRxPduInfo Com_RxPduInfo[52].RxDefPduBufferStartIdxOfRxPduInfo Com_RxPduInfo[52].RxPduCalloutFuncPtrIdxOfRxPduInfo Com_RxPduInfo[52].RxSigGrpInfoIndEndIdxOfRxPduInfo Com_RxPduInfo[52].RxSigGrpInfoIndStartIdxOfRxPduInfo Com_RxPduInfo[52].RxSigInfoEndIdxOfRxPduInfo Com_RxPduInfo[52].RxSigInfoStartIdxOfRxPduInfo Com_RxPduInfo[52].RxTOutInfoIdxOfRxPduInfo Com_RxPduInfo[52].RxTOutInfoIndEndIdxOfRxPduInfo Com_RxPduInfo[52].RxTOutInfoIndStartIdxOfRxPduInfo Com_RxPduInfo[53].HandleRxPduDeferredIdxOfRxPduInfo Com_RxPduInfo[53].IPduGroupInfoOfRxPduInfoIndEndIdxOfRxPduInfo Com_RxPduInfo[53].IPduGroupInfoOfRxPduInfoIndStartIdxOfRxPduInfo Com_RxPduInfo[53].MainFunctionRxStructIdxOfRxPduInfo Com_RxPduInfo[53].RxAccessInfoIndEndIdxOfRxPduInfo Com_RxPduInfo[53].RxAccessInfoIndStartIdxOfRxPduInfo Com_RxPduInfo[53].RxDefPduBufferEndIdxOfRxPduInfo Com_RxPduInfo[53].RxDefPduBufferStartIdxOfRxPduInfo Com_RxPduInfo[53].RxPduCalloutFuncPtrIdxOfRxPduInfo Com_RxPduInfo[53].RxSigGrpInfoIndEndIdxOfRxPduInfo Com_RxPduInfo[53].RxSigGrpInfoIndStartIdxOfRxPduInfo Com_RxPduInfo[53].RxSigInfoEndIdxOfRxPduInfo Com_RxPduInfo[53].RxSigInfoStartIdxOfRxPduInfo Com_RxPduInfo[53].RxTOutInfoIdxOfRxPduInfo Com_RxPduInfo[53].RxTOutInfoIndEndIdxOfRxPduInfo Com_RxPduInfo[53].RxTOutInfoIndStartIdxOfRxPduInfo Com_RxPduInfo[54].HandleRxPduDeferredIdxOfRxPduInfo Com_RxPduInfo[54].IPduGroupInfoOfRxPduInfoIndEndIdxOfRxPduInfo Com_RxPduInfo[54].IPduGroupInfoOfRxPduInfoIndStartIdxOfRxPduInfo Com_RxPduInfo[54].MainFunctionRxStructIdxOfRxPduInfo Com_RxPduInfo[54].RxAccessInfoIndEndIdxOfRxPduInfo Com_RxPduInfo[54].RxAccessInfoIndStartIdxOfRxPduInfo Com_RxPduInfo[54].RxDefPduBufferEndIdxOfRxPduInfo Com_RxPduInfo[54].RxDefPduBufferStartIdxOfRxPduInfo Com_RxPduInfo[54].RxPduCalloutFuncPtrIdxOfRxPduInfo Com_RxPduInfo[54].RxSigGrpInfoIndEndIdxOfRxPduInfo Com_RxPduInfo[54].RxSigGrpInfoIndStartIdxOfRxPduInfo Com_RxPduInfo[54].RxSigInfoEndIdxOfRxPduInfo Com_RxPduInfo[54].RxSigInfoStartIdxOfRxPduInfo Com_RxPduInfo[54].RxTOutInfoIdxOfRxPduInfo Com_RxPduInfo[54].RxTOutInfoIndEndIdxOfRxPduInfo Com_RxPduInfo[54].RxTOutInfoIndStartIdxOfRxPduInfo Com_RxPduInfo[55].HandleRxPduDeferredIdxOfRxPduInfo Com_RxPduInfo[55].IPduGroupInfoOfRxPduInfoIndEndIdxOfRxPduInfo Com_RxPduInfo[55].IPduGroupInfoOfRxPduInfoIndStartIdxOfRxPduInfo Com_RxPduInfo[55].MainFunctionRxStructIdxOfRxPduInfo Com_RxPduInfo[55].RxAccessInfoIndEndIdxOfRxPduInfo Com_RxPduInfo[55].RxAccessInfoIndStartIdxOfRxPduInfo Com_RxPduInfo[55].RxDefPduBufferEndIdxOfRxPduInfo Com_RxPduInfo[55].RxDefPduBufferStartIdxOfRxPduInfo Com_RxPduInfo[55].RxPduCalloutFuncPtrIdxOfRxPduInfo Com_RxPduInfo[55].RxSigGrpInfoIndEndIdxOfRxPduInfo Com_RxPduInfo[55].RxSigGrpInfoIndStartIdxOfRxPduInfo Com_RxPduInfo[55].RxSigInfoEndIdxOfRxPduInfo Com_RxPduInfo[55].RxSigInfoStartIdxOfRxPduInfo Com_RxPduInfo[55].RxTOutInfoIdxOfRxPduInfo Com_RxPduInfo[55].RxTOutInfoIndEndIdxOfRxPduInfo Com_RxPduInfo[55].RxTOutInfoIndStartIdxOfRxPduInfo Com_RxPduInfo[56].HandleRxPduDeferredIdxOfRxPduInfo Com_RxPduInfo[56].IPduGroupInfoOfRxPduInfoIndEndIdxOfRxPduInfo Com_RxPduInfo[56].IPduGroupInfoOfRxPduInfoIndStartIdxOfRxPduInfo Com_RxPduInfo[56].MainFunctionRxStructIdxOfRxPduInfo Com_RxPduInfo[56].RxAccessInfoIndEndIdxOfRxPduInfo Com_RxPduInfo[56].RxAccessInfoIndStartIdxOfRxPduInfo Com_RxPduInfo[56].RxDefPduBufferEndIdxOfRxPduInfo Com_RxPduInfo[56].RxDefPduBufferStartIdxOfRxPduInfo Com_RxPduInfo[56].RxPduCalloutFuncPtrIdxOfRxPduInfo Com_RxPduInfo[56].RxSigGrpInfoIndEndIdxOfRxPduInfo Com_RxPduInfo[56].RxSigGrpInfoIndStartIdxOfRxPduInfo Com_RxPduInfo[56].RxSigInfoEndIdxOfRxPduInfo Com_RxPduInfo[56].RxSigInfoStartIdxOfRxPduInfo Com_RxPduInfo[56].RxTOutInfoIdxOfRxPduInfo Com_RxPduInfo[56].RxTOutInfoIndEndIdxOfRxPduInfo Com_RxPduInfo[56].RxTOutInfoIndStartIdxOfRxPduInfo Com_RxPduInfo[57].HandleRxPduDeferredIdxOfRxPduInfo Com_RxPduInfo[57].IPduGroupInfoOfRxPduInfoIndEndIdxOfRxPduInfo Com_RxPduInfo[57].IPduGroupInfoOfRxPduInfoIndStartIdxOfRxPduInfo Com_RxPduInfo[57].MainFunctionRxStructIdxOfRxPduInfo Com_RxPduInfo[57].RxAccessInfoIndEndIdxOfRxPduInfo Com_RxPduInfo[57].RxAccessInfoIndStartIdxOfRxPduInfo Com_RxPduInfo[57].RxDefPduBufferEndIdxOfRxPduInfo /end REF_MEASUREMENT
/end GROUP
/end MODULE
/end PROJECT
