ASAP2_VERSION 1 71
/begin PROJECT MICROSAR ""
/begin MODULE CPP ""
/begin MOD_COMMON "" BYTE_ORDER MSB_LAST ALIGNMENT_BYTE 1 ALIGNMENT_WORD 2 ALIGNMENT_LONG 4 ALIGNMENT_FLOAT16_IEEE 2 ALIGNMENT_FLOAT32_IEEE 4 ALIGNMENT_FLOAT64_IEEE 8 ALIGNMENT_INT64 8 /end MOD_COMMON
/begin MEASUREMENT Com_TxGrpSigInfo[42].InvValueIdxOfTxGrpSigInfo "" UBYTE Com_InvValueIdxOfTxGrpSigInfoType 0 0 0 255 ECU_ADDRESS 0x0 /end MEASUREMENT
/begin MEASUREMENT Com_TxGrpSigInfo[42].InvValueOfTxGrpSigInfo "" UBYTE Com_InvValueOfTxGrpSigInfoType 0 0 0 255 ECU_ADDRESS 0x0 /end MEASUREMENT
/begin MEASUREMENT Com_TxGrpSigInfo[42].StartByteInPduPositionOfTxGrpSigInfo "" UBYTE NO_COMPU_METHOD 0 0 0 255 ECU_ADDRESS 0x0 /end MEASUREMENT
/begin MEASUREMENT Com_TxGrpSigInfo[42].TxBufferEndIdxOfTxGrpSigInfo "" UWORD Com_TxBufferEndIdxOfTxGrpSigInfoType 0 0 0 65535 ECU_ADDRESS 0x0 /end MEASUREMENT
/begin MEASUREMENT Com_TxGrpSigInfo[42].TxBufferStartIdxOfTxGrpSigInfo "" UWORD Com_TxBufferStartIdxOfTxGrpSigInfoType 0 0 0 65535 ECU_ADDRESS 0x0 /end MEASUREMENT
/begin MEASUREMENT Com_TxGrpSigInfo[42].TxPduInfoIdxOfTxGrpSigInfo "" UBYTE NO_COMPU_METHOD 0 0 0 255 ECU_ADDRESS 0x0 /end MEASUREMENT
/begin MEASUREMENT Com_TxGrpSigInfo[42].TxSigGrpInfoIdxOfTxGrpSigInfo "" UBYTE NO_COMPU_METHOD 0 0 0 255 ECU_ADDRESS 0x0 /end MEASUREMENT
/begin MEASUREMENT Com_TxGrpSigInfo[42].WithoutRepOfTxGrpSigInfo "" UBYTE Com_WithoutRepOfTxGrpSigInfoType 0 0 0 1 ECU_ADDRESS 0x0 /end MEASUREMENT
/begin MEASUREMENT Com_TxGrpSigInfo[43].ApplTypeOfTxGrpSigInfo "" UBYTE Com_ApplTypeOfTxGrpSigInfoType 0 0 0 255 ECU_ADDRESS 0x0 /end MEASUREMENT
/begin MEASUREMENT Com_TxGrpSigInfo[43].BitLengthOfTxGrpSigInfo "" UBYTE NO_COMPU_METHOD 0 0 0 255 ECU_ADDRESS 0x0 /end MEASUREMENT
/begin MEASUREMENT Com_TxGrpSigInfo[43].BitPositionOfTxGrpSigInfo "" UWORD NO_COMPU_METHOD 0 0 0 65535 ECU_ADDRESS 0x0 /end MEASUREMENT
/begin MEASUREMENT Com_TxGrpSigInfo[43].BusAccOfTxGrpSigInfo "" UBYTE Com_BusAccOfTxGrpSigInfoType 0 0 0 255 ECU_ADDRESS 0x0 /end MEASUREMENT
/begin MEASUREMENT Com_TxGrpSigInfo[43].ByteLengthOfTxGrpSigInfo "" UBYTE NO_COMPU_METHOD 0 0 0 255 ECU_ADDRESS 0x0 /end MEASUREMENT
/begin MEASUREMENT Com_TxGrpSigInfo[43].DynSignalOfTxGrpSigInfo "" UBYTE Com_DynSignalOfTxGrpSigInfoType 0 0 0 1 ECU_ADDRESS 0x0 /end MEASUREMENT
/begin MEASUREMENT Com_TxGrpSigInfo[43].InvValueIdxOfTxGrpSigInfo "" UBYTE Com_InvValueIdxOfTxGrpSigInfoType 0 0 0 255 ECU_ADDRESS 0x0 /end MEASUREMENT
/begin MEASUREMENT Com_TxGrpSigInfo[43].InvValueOfTxGrpSigInfo "" UBYTE Com_InvValueOfTxGrpSigInfoType 0 0 0 255 ECU_ADDRESS 0x0 /end MEASUREMENT
/begin MEASUREMENT Com_TxGrpSigInfo[43].StartByteInPduPositionOfTxGrpSigInfo "" UBYTE NO_COMPU_METHOD 0 0 0 255 ECU_ADDRESS 0x0 /end MEASUREMENT
/begin MEASUREMENT Com_TxGrpSigInfo[43].TxBufferEndIdxOfTxGrpSigInfo "" UWORD Com_TxBufferEndIdxOfTxGrpSigInfoType 0 0 0 65535 ECU_ADDRESS 0x0 /end MEASUREMENT
/begin MEASUREMENT Com_TxGrpSigInfo[43].TxBufferStartIdxOfTxGrpSigInfo "" UWORD Com_TxBufferStartIdxOfTxGrpSigInfoType 0 0 0 65535 ECU_ADDRESS 0x0 /end MEASUREMENT
/begin MEASUREMENT Com_TxGrpSigInfo[43].TxPduInfoIdxOfTxGrpSigInfo "" UBYTE NO_COMPU_METHOD 0 0 0 255 ECU_ADDRESS 0x0 /end MEASUREMENT
/begin MEASUREMENT Com_TxGrpSigInfo[43].TxSigGrpInfoIdxOfTxGrpSigInfo "" UBYTE NO_COMPU_METHOD 0 0 0 255 ECU_ADDRESS 0x0 /end MEASUREMENT
/begin MEASUREMENT Com_TxGrpSigInfo[43].WithoutRepOfTxGrpSigInfo "" UBYTE Com_WithoutRepOfTxGrpSigInfoType 0 0 0 1 ECU_ADDRESS 0x0 /end MEASUREMENT
/begin MEASUREMENT Com_TxGrpSigInfo[44].ApplTypeOfTxGrpSigInfo "" UBYTE Com_ApplTypeOfTxGrpSigInfoType 0 0 0 255 ECU_ADDRESS 0x0 /end MEASUREMENT
/begin MEASUREMENT Com_TxGrpSigInfo[44].BitLengthOfTxGrpSigInfo "" UBYTE NO_COMPU_METHOD 0 0 0 255 ECU_ADDRESS 0x0 /end MEASUREMENT
/begin MEASUREMENT Com_TxGrpSigInfo[44].BitPositionOfTxGrpSigInfo "" UWORD NO_COMPU_METHOD 0 0 0 65535 ECU_ADDRESS 0x0 /end MEASUREMENT
/begin MEASUREMENT Com_TxGrpSigInfo[44].BusAccOfTxGrpSigInfo "" UBYTE Com_BusAccOfTxGrpSigInfoType 0 0 0 255 ECU_ADDRESS 0x0 /end MEASUREMENT
/begin MEASUREMENT Com_TxGrpSigInfo[44].ByteLengthOfTxGrpSigInfo "" UBYTE NO_COMPU_METHOD 0 0 0 255 ECU_ADDRESS 0x0 /end MEASUREMENT
/begin MEASUREMENT Com_TxGrpSigInfo[44].DynSignalOfTxGrpSigInfo "" UBYTE Com_DynSignalOfTxGrpSigInfoType 0 0 0 1 ECU_ADDRESS 0x0 /end MEASUREMENT
/begin MEASUREMENT Com_TxGrpSigInfo[44].InvValueIdxOfTxGrpSigInfo "" UBYTE Com_InvValueIdxOfTxGrpSigInfoType 0 0 0 255 ECU_ADDRESS 0x0 /end MEASUREMENT
/begin MEASUREMENT Com_TxGrpSigInfo[44].InvValueOfTxGrpSigInfo "" UBYTE Com_InvValueOfTxGrpSigInfoType 0 0 0 255 ECU_ADDRESS 0x0 /end MEASUREMENT
/begin MEASUREMENT Com_TxGrpSigInfo[44].StartByteInPduPositionOfTxGrpSigInfo "" UBYTE NO_COMPU_METHOD 0 0 0 255 ECU_ADDRESS 0x0 /end MEASUREMENT
/begin MEASUREMENT Com_TxGrpSigInfo[44].TxBufferEndIdxOfTxGrpSigInfo "" UWORD Com_TxBufferEndIdxOfTxGrpSigInfoType 0 0 0 65535 ECU_ADDRESS 0x0 /end MEASUREMENT
/begin MEASUREMENT Com_TxGrpSigInfo[44].TxBufferStartIdxOfTxGrpSigInfo "" UWORD Com_TxBufferStartIdxOfTxGrpSigInfoType 0 0 0 65535 ECU_ADDRESS 0x0 /end MEASUREMENT
/begin MEASUREMENT Com_TxGrpSigInfo[44].TxPduInfoIdxOfTxGrpSigInfo "" UBYTE NO_COMPU_METHOD 0 0 0 255 ECU_ADDRESS 0x0 /end MEASUREMENT
/begin MEASUREMENT Com_TxGrpSigInfo[44].TxSigGrpInfoIdxOfTxGrpSigInfo "" UBYTE NO_COMPU_METHOD 0 0 0 255 ECU_ADDRESS 0x0 /end MEASUREMENT
/begin MEASUREMENT Com_TxGrpSigInfo[44].WithoutRepOfTxGrpSigInfo "" UBYTE Com_WithoutRepOfTxGrpSigInfoType 0 0 0 1 ECU_ADDRESS 0x0 /end MEASUREMENT
/begin MEASUREMENT Com_TxGrpSigInfo[45].ApplTypeOfTxGrpSigInfo "" UBYTE Com_ApplTypeOfTxGrpSigInfoType 0 0 0 255 ECU_ADDRESS 0x0 /end MEASUREMENT
/begin MEASUREMENT Com_TxGrpSigInfo[45].BitLengthOfTxGrpSigInfo "" UBYTE NO_COMPU_METHOD 0 0 0 255 ECU_ADDRESS 0x0 /end MEASUREMENT
/begin MEASUREMENT Com_TxGrpSigInfo[45].BitPositionOfTxGrpSigInfo "" UWORD NO_COMPU_METHOD 0 0 0 65535 ECU_ADDRESS 0x0 /end MEASUREMENT
/begin MEASUREMENT Com_TxGrpSigInfo[45].BusAccOfTxGrpSigInfo "" UBYTE Com_BusAccOfTxGrpSigInfoType 0 0 0 255 ECU_ADDRESS 0x0 /end MEASUREMENT
/begin MEASUREMENT Com_TxGrpSigInfo[45].ByteLengthOfTxGrpSigInfo "" UBYTE NO_COMPU_METHOD 0 0 0 255 ECU_ADDRESS 0x0 /end MEASUREMENT
/begin MEASUREMENT Com_TxGrpSigInfo[45].DynSignalOfTxGrpSigInfo "" UBYTE Com_DynSignalOfTxGrpSigInfoType 0 0 0 1 ECU_ADDRESS 0x0 /end MEASUREMENT
/begin MEASUREMENT Com_TxGrpSigInfo[45].InvValueIdxOfTxGrpSigInfo "" UBYTE Com_InvValueIdxOfTxGrpSigInfoType 0 0 0 255 ECU_ADDRESS 0x0 /end MEASUREMENT
/begin MEASUREMENT Com_TxGrpSigInfo[45].InvValueOfTxGrpSigInfo "" UBYTE Com_InvValueOfTxGrpSigInfoType 0 0 0 255 ECU_ADDRESS 0x0 /end MEASUREMENT
/begin MEASUREMENT Com_TxGrpSigInfo[45].StartByteInPduPositionOfTxGrpSigInfo "" UBYTE NO_COMPU_METHOD 0 0 0 255 ECU_ADDRESS 0x0 /end MEASUREMENT
/begin MEASUREMENT Com_TxGrpSigInfo[45].TxBufferEndIdxOfTxGrpSigInfo "" UWORD Com_TxBufferEndIdxOfTxGrpSigInfoType 0 0 0 65535 ECU_ADDRESS 0x0 /end MEASUREMENT
/begin MEASUREMENT Com_TxGrpSigInfo[45].TxBufferStartIdxOfTxGrpSigInfo "" UWORD Com_TxBufferStartIdxOfTxGrpSigInfoType 0 0 0 65535 ECU_ADDRESS 0x0 /end MEASUREMENT
/begin MEASUREMENT Com_TxGrpSigInfo[45].TxPduInfoIdxOfTxGrpSigInfo "" UBYTE NO_COMPU_METHOD 0 0 0 255 ECU_ADDRESS 0x0 /end MEASUREMENT
/begin MEASUREMENT Com_TxGrpSigInfo[45].TxSigGrpInfoIdxOfTxGrpSigInfo "" UBYTE NO_COMPU_METHOD 0 0 0 255 ECU_ADDRESS 0x0 /end MEASUREMENT
/begin MEASUREMENT Com_TxGrpSigInfo[45].WithoutRepOfTxGrpSigInfo "" UBYTE Com_WithoutRepOfTxGrpSigInfoType 0 0 0 1 ECU_ADDRESS 0x0 /end MEASUREMENT
/begin MEASUREMENT Com_TxGrpSigInfo[46].ApplTypeOfTxGrpSigInfo "" UBYTE Com_ApplTypeOfTxGrpSigInfoType 0 0 0 255 ECU_ADDRESS 0x0 /end MEASUREMENT
/begin MEASUREMENT Com_TxGrpSigInfo[46].BitLengthOfTxGrpSigInfo "" UBYTE NO_COMPU_METHOD 0 0 0 255 ECU_ADDRESS 0x0 /end MEASUREMENT
/begin MEASUREMENT Com_TxGrpSigInfo[46].BitPositionOfTxGrpSigInfo "" UWORD NO_COMPU_METHOD 0 0 0 65535 ECU_ADDRESS 0x0 /end MEASUREMENT
/begin MEASUREMENT Com_TxGrpSigInfo[46].BusAccOfTxGrpSigInfo "" UBYTE Com_BusAccOfTxGrpSigInfoType 0 0 0 255 ECU_ADDRESS 0x0 /end MEASUREMENT
/begin MEASUREMENT Com_TxGrpSigInfo[46].ByteLengthOfTxGrpSigInfo "" UBYTE NO_COMPU_METHOD 0 0 0 255 ECU_ADDRESS 0x0 /end MEASUREMENT
/begin MEASUREMENT Com_TxGrpSigInfo[46].DynSignalOfTxGrpSigInfo "" UBYTE Com_DynSignalOfTxGrpSigInfoType 0 0 0 1 ECU_ADDRESS 0x0 /end MEASUREMENT
/begin MEASUREMENT Com_TxGrpSigInfo[46].InvValueIdxOfTxGrpSigInfo "" UBYTE Com_InvValueIdxOfTxGrpSigInfoType 0 0 0 255 ECU_ADDRESS 0x0 /end MEASUREMENT
/begin MEASUREMENT Com_TxGrpSigInfo[46].InvValueOfTxGrpSigInfo "" UBYTE Com_InvValueOfTxGrpSigInfoType 0 0 0 255 ECU_ADDRESS 0x0 /end MEASUREMENT
/begin MEASUREMENT Com_TxGrpSigInfo[46].StartByteInPduPositionOfTxGrpSigInfo "" UBYTE NO_COMPU_METHOD 0 0 0 255 ECU_ADDRESS 0x0 /end MEASUREMENT
/begin MEASUREMENT Com_TxGrpSigInfo[46].TxBufferEndIdxOfTxGrpSigInfo "" UWORD Com_TxBufferEndIdxOfTxGrpSigInfoType 0 0 0 65535 ECU_ADDRESS 0x0 /end MEASUREMENT
/begin MEASUREMENT Com_TxGrpSigInfo[46].TxBufferStartIdxOfTxGrpSigInfo "" UWORD Com_TxBufferStartIdxOfTxGrpSigInfoType 0 0 0 65535 ECU_ADDRESS 0x0 /end MEASUREMENT
/begin MEASUREMENT Com_TxGrpSigInfo[46].TxPduInfoIdxOfTxGrpSigInfo "" UBYTE NO_COMPU_METHOD 0 0 0 255 ECU_ADDRESS 0x0 /end MEASUREMENT
/begin MEASUREMENT Com_TxGrpSigInfo[46].TxSigGrpInfoIdxOfTxGrpSigInfo "" UBYTE NO_COMPU_METHOD 0 0 0 255 ECU_ADDRESS 0x0 /end MEASUREMENT
/begin MEASUREMENT Com_TxGrpSigInfo[46].WithoutRepOfTxGrpSigInfo "" UBYTE Com_WithoutRepOfTxGrpSigInfoType 0 0 0 1 ECU_ADDRESS 0x0 /end MEASUREMENT
/begin MEASUREMENT Com_TxGrpSigInfo[47].ApplTypeOfTxGrpSigInfo "" UBYTE Com_ApplTypeOfTxGrpSigInfoType 0 0 0 255 ECU_ADDRESS 0x0 /end MEASUREMENT
/begin MEASUREMENT Com_TxGrpSigInfo[47].BitLengthOfTxGrpSigInfo "" UBYTE NO_COMPU_METHOD 0 0 0 255 ECU_ADDRESS 0x0 /end MEASUREMENT
/begin MEASUREMENT Com_TxGrpSigInfo[47].BitPositionOfTxGrpSigInfo "" UWORD NO_COMPU_METHOD 0 0 0 65535 ECU_ADDRESS 0x0 /end MEASUREMENT
/begin MEASUREMENT Com_TxGrpSigInfo[47].BusAccOfTxGrpSigInfo "" UBYTE Com_BusAccOfTxGrpSigInfoType 0 0 0 255 ECU_ADDRESS 0x0 /end MEASUREMENT
/begin MEASUREMENT Com_TxGrpSigInfo[47].ByteLengthOfTxGrpSigInfo "" UBYTE NO_COMPU_METHOD 0 0 0 255 ECU_ADDRESS 0x0 /end MEASUREMENT
/begin MEASUREMENT Com_TxGrpSigInfo[47].DynSignalOfTxGrpSigInfo "" UBYTE Com_DynSignalOfTxGrpSigInfoType 0 0 0 1 ECU_ADDRESS 0x0 /end MEASUREMENT
/begin MEASUREMENT Com_TxGrpSigInfo[47].InvValueIdxOfTxGrpSigInfo "" UBYTE Com_InvValueIdxOfTxGrpSigInfoType 0 0 0 255 ECU_ADDRESS 0x0 /end MEASUREMENT
/begin MEASUREMENT Com_TxGrpSigInfo[47].InvValueOfTxGrpSigInfo "" UBYTE Com_InvValueOfTxGrpSigInfoType 0 0 0 255 ECU_ADDRESS 0x0 /end MEASUREMENT
/begin MEASUREMENT Com_TxGrpSigInfo[47].StartByteInPduPositionOfTxGrpSigInfo "" UBYTE NO_COMPU_METHOD 0 0 0 255 ECU_ADDRESS 0x0 /end MEASUREMENT
/begin MEASUREMENT Com_TxGrpSigInfo[47].TxBufferEndIdxOfTxGrpSigInfo "" UWORD Com_TxBufferEndIdxOfTxGrpSigInfoType 0 0 0 65535 ECU_ADDRESS 0x0 /end MEASUREMENT
/begin MEASUREMENT Com_TxGrpSigInfo[47].TxBufferStartIdxOfTxGrpSigInfo "" UWORD Com_TxBufferStartIdxOfTxGrpSigInfoType 0 0 0 65535 ECU_ADDRESS 0x0 /end MEASUREMENT
/begin MEASUREMENT Com_TxGrpSigInfo[47].TxPduInfoIdxOfTxGrpSigInfo "" UBYTE NO_COMPU_METHOD 0 0 0 255 ECU_ADDRESS 0x0 /end MEASUREMENT
/begin MEASUREMENT Com_TxGrpSigInfo[47].TxSigGrpInfoIdxOfTxGrpSigInfo "" UBYTE NO_COMPU_METHOD 0 0 0 255 ECU_ADDRESS 0x0 /end MEASUREMENT
/begin MEASUREMENT Com_TxGrpSigInfo[47].WithoutRepOfTxGrpSigInfo "" UBYTE Com_WithoutRepOfTxGrpSigInfoType 0 0 0 1 ECU_ADDRESS 0x0 /end MEASUREMENT
/begin MEASUREMENT Com_TxGrpSigInfo[48].ApplTypeOfTxGrpSigInfo "" UBYTE Com_ApplTypeOfTxGrpSigInfoType 0 0 0 255 ECU_ADDRESS 0x0 /end MEASUREMENT
/begin MEASUREMENT Com_TxGrpSigInfo[48].BitLengthOfTxGrpSigInfo "" UBYTE NO_COMPU_METHOD 0 0 0 255 ECU_ADDRESS 0x0 /end MEASUREMENT
/begin MEASUREMENT Com_TxGrpSigInfo[48].BitPositionOfTxGrpSigInfo "" UWORD NO_COMPU_METHOD 0 0 0 65535 ECU_ADDRESS 0x0 /end MEASUREMENT
/begin MEASUREMENT Com_TxGrpSigInfo[48].BusAccOfTxGrpSigInfo "" UBYTE Com_BusAccOfTxGrpSigInfoType 0 0 0 255 ECU_ADDRESS 0x0 /end MEASUREMENT
/begin MEASUREMENT Com_TxGrpSigInfo[48].ByteLengthOfTxGrpSigInfo "" UBYTE NO_COMPU_METHOD 0 0 0 255 ECU_ADDRESS 0x0 /end MEASUREMENT
/begin MEASUREMENT Com_TxGrpSigInfo[48].DynSignalOfTxGrpSigInfo "" UBYTE Com_DynSignalOfTxGrpSigInfoType 0 0 0 1 ECU_ADDRESS 0x0 /end MEASUREMENT
/begin MEASUREMENT Com_TxGrpSigInfo[48].InvValueIdxOfTxGrpSigInfo "" UBYTE Com_InvValueIdxOfTxGrpSigInfoType 0 0 0 255 ECU_ADDRESS 0x0 /end MEASUREMENT
/begin MEASUREMENT Com_TxGrpSigInfo[48].InvValueOfTxGrpSigInfo "" UBYTE Com_InvValueOfTxGrpSigInfoType 0 0 0 255 ECU_ADDRESS 0x0 /end MEASUREMENT
/begin MEASUREMENT Com_TxGrpSigInfo[48].StartByteInPduPositionOfTxGrpSigInfo "" UBYTE NO_COMPU_METHOD 0 0 0 255 ECU_ADDRESS 0x0 /end MEASUREMENT
/begin MEASUREMENT Com_TxGrpSigInfo[48].TxBufferEndIdxOfTxGrpSigInfo "" UWORD Com_TxBufferEndIdxOfTxGrpSigInfoType 0 0 0 65535 ECU_ADDRESS 0x0 /end MEASUREMENT
/begin MEASUREMENT Com_TxGrpSigInfo[48].TxBufferStartIdxOfTxGrpSigInfo "" UWORD Com_TxBufferStartIdxOfTxGrpSigInfoType 0 0 0 65535 ECU_ADDRESS 0x0 /end MEASUREMENT
/begin MEASUREMENT Com_TxGrpSigInfo[48].TxPduInfoIdxOfTxGrpSigInfo "" UBYTE NO_COMPU_METHOD 0 0 0 255 ECU_ADDRESS 0x0 /end MEASUREMENT
/begin MEASUREMENT Com_TxGrpSigInfo[48].TxSigGrpInfoIdxOfTxGrpSigInfo "" UBYTE NO_COMPU_METHOD 0 0 0 255 ECU_ADDRESS 0x0 /end MEASUREMENT
/begin MEASUREMENT Com_TxGrpSigInfo[48].WithoutRepOfTxGrpSigInfo "" UBYTE Com_WithoutRepOfTxGrpSigInfoType 0 0 0 1 ECU_ADDRESS 0x0 /end MEASUREMENT
/begin MEASUREMENT Com_TxGrpSigInfo[49].ApplTypeOfTxGrpSigInfo "" UBYTE Com_ApplTypeOfTxGrpSigInfoType 0 0 0 255 ECU_ADDRESS 0x0 /end MEASUREMENT
/begin MEASUREMENT Com_TxGrpSigInfo[49].BitLengthOfTxGrpSigInfo "" UBYTE NO_COMPU_METHOD 0 0 0 255 ECU_ADDRESS 0x0 /end MEASUREMENT
/begin MEASUREMENT Com_TxGrpSigInfo[49].BitPositionOfTxGrpSigInfo "" UWORD NO_COMPU_METHOD 0 0 0 65535 ECU_ADDRESS 0x0 /end MEASUREMENT
/begin MEASUREMENT Com_TxGrpSigInfo[49].BusAccOfTxGrpSigInfo "" UBYTE Com_BusAccOfTxGrpSigInfoType 0 0 0 255 ECU_ADDRESS 0x0 /end MEASUREMENT
/begin MEASUREMENT Com_TxGrpSigInfo[49].ByteLengthOfTxGrpSigInfo "" UBYTE NO_COMPU_METHOD 0 0 0 255 ECU_ADDRESS 0x0 /end MEASUREMENT
/begin MEASUREMENT Com_TxGrpSigInfo[49].DynSignalOfTxGrpSigInfo "" UBYTE Com_DynSignalOfTxGrpSigInfoType 0 0 0 1 ECU_ADDRESS 0x0 /end MEASUREMENT
/begin MEASUREMENT Com_TxGrpSigInfo[49].InvValueIdxOfTxGrpSigInfo "" UBYTE Com_InvValueIdxOfTxGrpSigInfoType 0 0 0 255 ECU_ADDRESS 0x0 /end MEASUREMENT
/begin MEASUREMENT Com_TxGrpSigInfo[49].InvValueOfTxGrpSigInfo "" UBYTE Com_InvValueOfTxGrpSigInfoType 0 0 0 255 ECU_ADDRESS 0x0 /end MEASUREMENT
/begin MEASUREMENT Com_TxGrpSigInfo[49].StartByteInPduPositionOfTxGrpSigInfo "" UBYTE NO_COMPU_METHOD 0 0 0 255 ECU_ADDRESS 0x0 /end MEASUREMENT
/begin MEASUREMENT Com_TxGrpSigInfo[49].TxBufferEndIdxOfTxGrpSigInfo "" UWORD Com_TxBufferEndIdxOfTxGrpSigInfoType 0 0 0 65535 ECU_ADDRESS 0x0 /end MEASUREMENT
/begin MEASUREMENT Com_TxGrpSigInfo[49].TxBufferStartIdxOfTxGrpSigInfo "" UWORD Com_TxBufferStartIdxOfTxGrpSigInfoType 0 0 0 65535 ECU_ADDRESS 0x0 /end MEASUREMENT
/begin MEASUREMENT Com_TxGrpSigInfo[49].TxPduInfoIdxOfTxGrpSigInfo "" UBYTE NO_COMPU_METHOD 0 0 0 255 ECU_ADDRESS 0x0 /end MEASUREMENT
/begin MEASUREMENT Com_TxGrpSigInfo[49].TxSigGrpInfoIdxOfTxGrpSigInfo "" UBYTE NO_COMPU_METHOD 0 0 0 255 ECU_ADDRESS 0x0 /end MEASUREMENT
/begin MEASUREMENT Com_TxGrpSigInfo[49].WithoutRepOfTxGrpSigInfo "" UBYTE Com_WithoutRepOfTxGrpSigInfoType 0 0 0 1 ECU_ADDRESS 0x0 /end MEASUREMENT
/begin MEASUREMENT Com_TxGrpSigInfo[4].ApplTypeOfTxGrpSigInfo "" UBYTE Com_ApplTypeOfTxGrpSigInfoType 0 0 0 255 ECU_ADDRESS 0x0 /end MEASUREMENT
/begin MEASUREMENT Com_TxGrpSigInfo[4].BitLengthOfTxGrpSigInfo "" UBYTE NO_COMPU_METHOD 0 0 0 255 ECU_ADDRESS 0x0 /end MEASUREMENT
/begin MEASUREMENT Com_TxGrpSigInfo[4].BitPositionOfTxGrpSigInfo "" UWORD NO_COMPU_METHOD 0 0 0 65535 ECU_ADDRESS 0x0 /end MEASUREMENT
/begin MEASUREMENT Com_TxGrpSigInfo[4].BusAccOfTxGrpSigInfo "" UBYTE Com_BusAccOfTxGrpSigInfoType 0 0 0 255 ECU_ADDRESS 0x0 /end MEASUREMENT
/begin MEASUREMENT Com_TxGrpSigInfo[4].ByteLengthOfTxGrpSigInfo "" UBYTE NO_COMPU_METHOD 0 0 0 255 ECU_ADDRESS 0x0 /end MEASUREMENT
/begin MEASUREMENT Com_TxGrpSigInfo[4].DynSignalOfTxGrpSigInfo "" UBYTE Com_DynSignalOfTxGrpSigInfoType 0 0 0 1 ECU_ADDRESS 0x0 /end MEASUREMENT
/begin MEASUREMENT Com_TxGrpSigInfo[4].InvValueIdxOfTxGrpSigInfo "" UBYTE Com_InvValueIdxOfTxGrpSigInfoType 0 0 0 255 ECU_ADDRESS 0x0 /end MEASUREMENT
/begin MEASUREMENT Com_TxGrpSigInfo[4].InvValueOfTxGrpSigInfo "" UBYTE Com_InvValueOfTxGrpSigInfoType 0 0 0 255 ECU_ADDRESS 0x0 /end MEASUREMENT
/begin MEASUREMENT Com_TxGrpSigInfo[4].StartByteInPduPositionOfTxGrpSigInfo "" UBYTE NO_COMPU_METHOD 0 0 0 255 ECU_ADDRESS 0x0 /end MEASUREMENT
/begin MEASUREMENT Com_TxGrpSigInfo[4].TxBufferEndIdxOfTxGrpSigInfo "" UWORD Com_TxBufferEndIdxOfTxGrpSigInfoType 0 0 0 65535 ECU_ADDRESS 0x0 /end MEASUREMENT
/begin MEASUREMENT Com_TxGrpSigInfo[4].TxBufferStartIdxOfTxGrpSigInfo "" UWORD Com_TxBufferStartIdxOfTxGrpSigInfoType 0 0 0 65535 ECU_ADDRESS 0x0 /end MEASUREMENT
/begin MEASUREMENT Com_TxGrpSigInfo[4].TxPduInfoIdxOfTxGrpSigInfo "" UBYTE NO_COMPU_METHOD 0 0 0 255 ECU_ADDRESS 0x0 /end MEASUREMENT
/begin MEASUREMENT Com_TxGrpSigInfo[4].TxSigGrpInfoIdxOfTxGrpSigInfo "" UBYTE NO_COMPU_METHOD 0 0 0 255 ECU_ADDRESS 0x0 /end MEASUREMENT
/begin MEASUREMENT Com_TxGrpSigInfo[4].WithoutRepOfTxGrpSigInfo "" UBYTE Com_WithoutRepOfTxGrpSigInfoType 0 0 0 1 ECU_ADDRESS 0x0 /end MEASUREMENT
/begin MEASUREMENT Com_TxGrpSigInfo[50].ApplTypeOfTxGrpSigInfo "" UBYTE Com_ApplTypeOfTxGrpSigInfoType 0 0 0 255 ECU_ADDRESS 0x0 /end MEASUREMENT
/begin MEASUREMENT Com_TxGrpSigInfo[50].BitLengthOfTxGrpSigInfo "" UBYTE NO_COMPU_METHOD 0 0 0 255 ECU_ADDRESS 0x0 /end MEASUREMENT
/begin MEASUREMENT Com_TxGrpSigInfo[50].BitPositionOfTxGrpSigInfo "" UWORD NO_COMPU_METHOD 0 0 0 65535 ECU_ADDRESS 0x0 /end MEASUREMENT
/begin MEASUREMENT Com_TxGrpSigInfo[50].BusAccOfTxGrpSigInfo "" UBYTE Com_BusAccOfTxGrpSigInfoType 0 0 0 255 ECU_ADDRESS 0x0 /end MEASUREMENT
/begin MEASUREMENT Com_TxGrpSigInfo[50].ByteLengthOfTxGrpSigInfo "" UBYTE NO_COMPU_METHOD 0 0 0 255 ECU_ADDRESS 0x0 /end MEASUREMENT
/begin MEASUREMENT Com_TxGrpSigInfo[50].DynSignalOfTxGrpSigInfo "" UBYTE Com_DynSignalOfTxGrpSigInfoType 0 0 0 1 ECU_ADDRESS 0x0 /end MEASUREMENT
/begin MEASUREMENT Com_TxGrpSigInfo[50].InvValueIdxOfTxGrpSigInfo "" UBYTE Com_InvValueIdxOfTxGrpSigInfoType 0 0 0 255 ECU_ADDRESS 0x0 /end MEASUREMENT
/begin MEASUREMENT Com_TxGrpSigInfo[50].InvValueOfTxGrpSigInfo "" UBYTE Com_InvValueOfTxGrpSigInfoType 0 0 0 255 ECU_ADDRESS 0x0 /end MEASUREMENT
/begin MEASUREMENT Com_TxGrpSigInfo[50].StartByteInPduPositionOfTxGrpSigInfo "" UBYTE NO_COMPU_METHOD 0 0 0 255 ECU_ADDRESS 0x0 /end MEASUREMENT
/begin MEASUREMENT Com_TxGrpSigInfo[50].TxBufferEndIdxOfTxGrpSigInfo "" UWORD Com_TxBufferEndIdxOfTxGrpSigInfoType 0 0 0 65535 ECU_ADDRESS 0x0 /end MEASUREMENT
/begin MEASUREMENT Com_TxGrpSigInfo[50].TxBufferStartIdxOfTxGrpSigInfo "" UWORD Com_TxBufferStartIdxOfTxGrpSigInfoType 0 0 0 65535 ECU_ADDRESS 0x0 /end MEASUREMENT
/begin MEASUREMENT Com_TxGrpSigInfo[50].TxPduInfoIdxOfTxGrpSigInfo "" UBYTE NO_COMPU_METHOD 0 0 0 255 ECU_ADDRESS 0x0 /end MEASUREMENT
/begin MEASUREMENT Com_TxGrpSigInfo[50].TxSigGrpInfoIdxOfTxGrpSigInfo "" UBYTE NO_COMPU_METHOD 0 0 0 255 ECU_ADDRESS 0x0 /end MEASUREMENT
/begin MEASUREMENT Com_TxGrpSigInfo[50].WithoutRepOfTxGrpSigInfo "" UBYTE Com_WithoutRepOfTxGrpSigInfoType 0 0 0 1 ECU_ADDRESS 0x0 /end MEASUREMENT
/begin MEASUREMENT Com_TxGrpSigInfo[51].ApplTypeOfTxGrpSigInfo "" UBYTE Com_ApplTypeOfTxGrpSigInfoType 0 0 0 255 ECU_ADDRESS 0x0 /end MEASUREMENT
/begin MEASUREMENT Com_TxGrpSigInfo[51].BitLengthOfTxGrpSigInfo "" UBYTE NO_COMPU_METHOD 0 0 0 255 ECU_ADDRESS 0x0 /end MEASUREMENT
/begin MEASUREMENT Com_TxGrpSigInfo[51].BitPositionOfTxGrpSigInfo "" UWORD NO_COMPU_METHOD 0 0 0 65535 ECU_ADDRESS 0x0 /end MEASUREMENT
/begin MEASUREMENT Com_TxGrpSigInfo[51].BusAccOfTxGrpSigInfo "" UBYTE Com_BusAccOfTxGrpSigInfoType 0 0 0 255 ECU_ADDRESS 0x0 /end MEASUREMENT
/begin MEASUREMENT Com_TxGrpSigInfo[51].ByteLengthOfTxGrpSigInfo "" UBYTE NO_COMPU_METHOD 0 0 0 255 ECU_ADDRESS 0x0 /end MEASUREMENT
/begin MEASUREMENT Com_TxGrpSigInfo[51].DynSignalOfTxGrpSigInfo "" UBYTE Com_DynSignalOfTxGrpSigInfoType 0 0 0 1 ECU_ADDRESS 0x0 /end MEASUREMENT
/begin MEASUREMENT Com_TxGrpSigInfo[51].InvValueIdxOfTxGrpSigInfo "" UBYTE Com_InvValueIdxOfTxGrpSigInfoType 0 0 0 255 ECU_ADDRESS 0x0 /end MEASUREMENT
/begin MEASUREMENT Com_TxGrpSigInfo[51].InvValueOfTxGrpSigInfo "" UBYTE Com_InvValueOfTxGrpSigInfoType 0 0 0 255 ECU_ADDRESS 0x0 /end MEASUREMENT
/begin MEASUREMENT Com_TxGrpSigInfo[51].StartByteInPduPositionOfTxGrpSigInfo "" UBYTE NO_COMPU_METHOD 0 0 0 255 ECU_ADDRESS 0x0 /end MEASUREMENT
/begin MEASUREMENT Com_TxGrpSigInfo[51].TxBufferEndIdxOfTxGrpSigInfo "" UWORD Com_TxBufferEndIdxOfTxGrpSigInfoType 0 0 0 65535 ECU_ADDRESS 0x0 /end MEASUREMENT
/begin MEASUREMENT Com_TxGrpSigInfo[51].TxBufferStartIdxOfTxGrpSigInfo "" UWORD Com_TxBufferStartIdxOfTxGrpSigInfoType 0 0 0 65535 ECU_ADDRESS 0x0 /end MEASUREMENT
/begin MEASUREMENT Com_TxGrpSigInfo[51].TxPduInfoIdxOfTxGrpSigInfo "" UBYTE NO_COMPU_METHOD 0 0 0 255 ECU_ADDRESS 0x0 /end MEASUREMENT
/begin MEASUREMENT Com_TxGrpSigInfo[51].TxSigGrpInfoIdxOfTxGrpSigInfo "" UBYTE NO_COMPU_METHOD 0 0 0 255 ECU_ADDRESS 0x0 /end MEASUREMENT
/begin MEASUREMENT Com_TxGrpSigInfo[51].WithoutRepOfTxGrpSigInfo "" UBYTE Com_WithoutRepOfTxGrpSigInfoType 0 0 0 1 ECU_ADDRESS 0x0 /end MEASUREMENT
/begin MEASUREMENT Com_TxGrpSigInfo[52].ApplTypeOfTxGrpSigInfo "" UBYTE Com_ApplTypeOfTxGrpSigInfoType 0 0 0 255 ECU_ADDRESS 0x0 /end MEASUREMENT
/begin MEASUREMENT Com_TxGrpSigInfo[52].BitLengthOfTxGrpSigInfo "" UBYTE NO_COMPU_METHOD 0 0 0 255 ECU_ADDRESS 0x0 /end MEASUREMENT
/begin MEASUREMENT Com_TxGrpSigInfo[52].BitPositionOfTxGrpSigInfo "" UWORD NO_COMPU_METHOD 0 0 0 65535 ECU_ADDRESS 0x0 /end MEASUREMENT
/begin MEASUREMENT Com_TxGrpSigInfo[52].BusAccOfTxGrpSigInfo "" UBYTE Com_BusAccOfTxGrpSigInfoType 0 0 0 255 ECU_ADDRESS 0x0 /end MEASUREMENT
/begin MEASUREMENT Com_TxGrpSigInfo[52].ByteLengthOfTxGrpSigInfo "" UBYTE NO_COMPU_METHOD 0 0 0 255 ECU_ADDRESS 0x0 /end MEASUREMENT
/begin MEASUREMENT Com_TxGrpSigInfo[52].DynSignalOfTxGrpSigInfo "" UBYTE Com_DynSignalOfTxGrpSigInfoType 0 0 0 1 ECU_ADDRESS 0x0 /end MEASUREMENT
/begin MEASUREMENT Com_TxGrpSigInfo[52].InvValueIdxOfTxGrpSigInfo "" UBYTE Com_InvValueIdxOfTxGrpSigInfoType 0 0 0 255 ECU_ADDRESS 0x0 /end MEASUREMENT
/begin MEASUREMENT Com_TxGrpSigInfo[52].InvValueOfTxGrpSigInfo "" UBYTE Com_InvValueOfTxGrpSigInfoType 0 0 0 255 ECU_ADDRESS 0x0 /end MEASUREMENT
/begin MEASUREMENT Com_TxGrpSigInfo[52].StartByteInPduPositionOfTxGrpSigInfo "" UBYTE NO_COMPU_METHOD 0 0 0 255 ECU_ADDRESS 0x0 /end MEASUREMENT
/begin MEASUREMENT Com_TxGrpSigInfo[52].TxBufferEndIdxOfTxGrpSigInfo "" UWORD Com_TxBufferEndIdxOfTxGrpSigInfoType 0 0 0 65535 ECU_ADDRESS 0x0 /end MEASUREMENT
/begin MEASUREMENT Com_TxGrpSigInfo[52].TxBufferStartIdxOfTxGrpSigInfo "" UWORD Com_TxBufferStartIdxOfTxGrpSigInfoType 0 0 0 65535 ECU_ADDRESS 0x0 /end MEASUREMENT
/begin MEASUREMENT Com_TxGrpSigInfo[52].TxPduInfoIdxOfTxGrpSigInfo "" UBYTE NO_COMPU_METHOD 0 0 0 255 ECU_ADDRESS 0x0 /end MEASUREMENT
/begin MEASUREMENT Com_TxGrpSigInfo[52].TxSigGrpInfoIdxOfTxGrpSigInfo "" UBYTE NO_COMPU_METHOD 0 0 0 255 ECU_ADDRESS 0x0 /end MEASUREMENT
/begin MEASUREMENT Com_TxGrpSigInfo[52].WithoutRepOfTxGrpSigInfo "" UBYTE Com_WithoutRepOfTxGrpSigInfoType 0 0 0 1 ECU_ADDRESS 0x0 /end MEASUREMENT
/begin MEASUREMENT Com_TxGrpSigInfo[53].ApplTypeOfTxGrpSigInfo "" UBYTE Com_ApplTypeOfTxGrpSigInfoType 0 0 0 255 ECU_ADDRESS 0x0 /end MEASUREMENT
/begin MEASUREMENT Com_TxGrpSigInfo[53].BitLengthOfTxGrpSigInfo "" UBYTE NO_COMPU_METHOD 0 0 0 255 ECU_ADDRESS 0x0 /end MEASUREMENT
/begin MEASUREMENT Com_TxGrpSigInfo[53].BitPositionOfTxGrpSigInfo "" UWORD NO_COMPU_METHOD 0 0 0 65535 ECU_ADDRESS 0x0 /end MEASUREMENT
/begin MEASUREMENT Com_TxGrpSigInfo[53].BusAccOfTxGrpSigInfo "" UBYTE Com_BusAccOfTxGrpSigInfoType 0 0 0 255 ECU_ADDRESS 0x0 /end MEASUREMENT
/begin MEASUREMENT Com_TxGrpSigInfo[53].ByteLengthOfTxGrpSigInfo "" UBYTE NO_COMPU_METHOD 0 0 0 255 ECU_ADDRESS 0x0 /end MEASUREMENT
/begin MEASUREMENT Com_TxGrpSigInfo[53].DynSignalOfTxGrpSigInfo "" UBYTE Com_DynSignalOfTxGrpSigInfoType 0 0 0 1 ECU_ADDRESS 0x0 /end MEASUREMENT
/begin MEASUREMENT Com_TxGrpSigInfo[53].InvValueIdxOfTxGrpSigInfo "" UBYTE Com_InvValueIdxOfTxGrpSigInfoType 0 0 0 255 ECU_ADDRESS 0x0 /end MEASUREMENT
/begin MEASUREMENT Com_TxGrpSigInfo[53].InvValueOfTxGrpSigInfo "" UBYTE Com_InvValueOfTxGrpSigInfoType 0 0 0 255 ECU_ADDRESS 0x0 /end MEASUREMENT
/begin MEASUREMENT Com_TxGrpSigInfo[53].StartByteInPduPositionOfTxGrpSigInfo "" UBYTE NO_COMPU_METHOD 0 0 0 255 ECU_ADDRESS 0x0 /end MEASUREMENT
/begin MEASUREMENT Com_TxGrpSigInfo[53].TxBufferEndIdxOfTxGrpSigInfo "" UWORD Com_TxBufferEndIdxOfTxGrpSigInfoType 0 0 0 65535 ECU_ADDRESS 0x0 /end MEASUREMENT
/begin MEASUREMENT Com_TxGrpSigInfo[53].TxBufferStartIdxOfTxGrpSigInfo "" UWORD Com_TxBufferStartIdxOfTxGrpSigInfoType 0 0 0 65535 ECU_ADDRESS 0x0 /end MEASUREMENT
/begin MEASUREMENT Com_TxGrpSigInfo[53].TxPduInfoIdxOfTxGrpSigInfo "" UBYTE NO_COMPU_METHOD 0 0 0 255 ECU_ADDRESS 0x0 /end MEASUREMENT
/begin MEASUREMENT Com_TxGrpSigInfo[53].TxSigGrpInfoIdxOfTxGrpSigInfo "" UBYTE NO_COMPU_METHOD 0 0 0 255 ECU_ADDRESS 0x0 /end MEASUREMENT
/begin MEASUREMENT Com_TxGrpSigInfo[53].WithoutRepOfTxGrpSigInfo "" UBYTE Com_WithoutRepOfTxGrpSigInfoType 0 0 0 1 ECU_ADDRESS 0x0 /end MEASUREMENT
/begin MEASUREMENT Com_TxGrpSigInfo[54].ApplTypeOfTxGrpSigInfo "" UBYTE Com_ApplTypeOfTxGrpSigInfoType 0 0 0 255 ECU_ADDRESS 0x0 /end MEASUREMENT
/begin MEASUREMENT Com_TxGrpSigInfo[54].BitLengthOfTxGrpSigInfo "" UBYTE NO_COMPU_METHOD 0 0 0 255 ECU_ADDRESS 0x0 /end MEASUREMENT
/begin MEASUREMENT Com_TxGrpSigInfo[54].BitPositionOfTxGrpSigInfo "" UWORD NO_COMPU_METHOD 0 0 0 65535 ECU_ADDRESS 0x0 /end MEASUREMENT
/begin MEASUREMENT Com_TxGrpSigInfo[54].BusAccOfTxGrpSigInfo "" UBYTE Com_BusAccOfTxGrpSigInfoType 0 0 0 255 ECU_ADDRESS 0x0 /end MEASUREMENT
/begin MEASUREMENT Com_TxGrpSigInfo[54].ByteLengthOfTxGrpSigInfo "" UBYTE NO_COMPU_METHOD 0 0 0 255 ECU_ADDRESS 0x0 /end MEASUREMENT
/begin MEASUREMENT Com_TxGrpSigInfo[54].DynSignalOfTxGrpSigInfo "" UBYTE Com_DynSignalOfTxGrpSigInfoType 0 0 0 1 ECU_ADDRESS 0x0 /end MEASUREMENT
/begin MEASUREMENT Com_TxGrpSigInfo[54].InvValueIdxOfTxGrpSigInfo "" UBYTE Com_InvValueIdxOfTxGrpSigInfoType 0 0 0 255 ECU_ADDRESS 0x0 /end MEASUREMENT
/begin MEASUREMENT Com_TxGrpSigInfo[54].InvValueOfTxGrpSigInfo "" UBYTE Com_InvValueOfTxGrpSigInfoType 0 0 0 255 ECU_ADDRESS 0x0 /end MEASUREMENT
/begin MEASUREMENT Com_TxGrpSigInfo[54].StartByteInPduPositionOfTxGrpSigInfo "" UBYTE NO_COMPU_METHOD 0 0 0 255 ECU_ADDRESS 0x0 /end MEASUREMENT
/begin MEASUREMENT Com_TxGrpSigInfo[54].TxBufferEndIdxOfTxGrpSigInfo "" UWORD Com_TxBufferEndIdxOfTxGrpSigInfoType 0 0 0 65535 ECU_ADDRESS 0x0 /end MEASUREMENT
/begin MEASUREMENT Com_TxGrpSigInfo[54].TxBufferStartIdxOfTxGrpSigInfo "" UWORD Com_TxBufferStartIdxOfTxGrpSigInfoType 0 0 0 65535 ECU_ADDRESS 0x0 /end MEASUREMENT
/begin MEASUREMENT Com_TxGrpSigInfo[54].TxPduInfoIdxOfTxGrpSigInfo "" UBYTE NO_COMPU_METHOD 0 0 0 255 ECU_ADDRESS 0x0 /end MEASUREMENT
/begin MEASUREMENT Com_TxGrpSigInfo[54].TxSigGrpInfoIdxOfTxGrpSigInfo "" UBYTE NO_COMPU_METHOD 0 0 0 255 ECU_ADDRESS 0x0 /end MEASUREMENT
/begin MEASUREMENT Com_TxGrpSigInfo[54].WithoutRepOfTxGrpSigInfo "" UBYTE Com_WithoutRepOfTxGrpSigInfoType 0 0 0 1 ECU_ADDRESS 0x0 /end MEASUREMENT
/begin MEASUREMENT Com_TxGrpSigInfo[55].ApplTypeOfTxGrpSigInfo "" UBYTE Com_ApplTypeOfTxGrpSigInfoType 0 0 0 255 ECU_ADDRESS 0x0 /end MEASUREMENT
/begin MEASUREMENT Com_TxGrpSigInfo[55].BitLengthOfTxGrpSigInfo "" UBYTE NO_COMPU_METHOD 0 0 0 255 ECU_ADDRESS 0x0 /end MEASUREMENT
/begin MEASUREMENT Com_TxGrpSigInfo[55].BitPositionOfTxGrpSigInfo "" UWORD NO_COMPU_METHOD 0 0 0 65535 ECU_ADDRESS 0x0 /end MEASUREMENT
/begin MEASUREMENT Com_TxGrpSigInfo[55].BusAccOfTxGrpSigInfo "" UBYTE Com_BusAccOfTxGrpSigInfoType 0 0 0 255 ECU_ADDRESS 0x0 /end MEASUREMENT
/begin MEASUREMENT Com_TxGrpSigInfo[55].ByteLengthOfTxGrpSigInfo "" UBYTE NO_COMPU_METHOD 0 0 0 255 ECU_ADDRESS 0x0 /end MEASUREMENT
/begin MEASUREMENT Com_TxGrpSigInfo[55].DynSignalOfTxGrpSigInfo "" UBYTE Com_DynSignalOfTxGrpSigInfoType 0 0 0 1 ECU_ADDRESS 0x0 /end MEASUREMENT
/begin MEASUREMENT Com_TxGrpSigInfo[55].InvValueIdxOfTxGrpSigInfo "" UBYTE Com_InvValueIdxOfTxGrpSigInfoType 0 0 0 255 ECU_ADDRESS 0x0 /end MEASUREMENT
/begin MEASUREMENT Com_TxGrpSigInfo[55].InvValueOfTxGrpSigInfo "" UBYTE Com_InvValueOfTxGrpSigInfoType 0 0 0 255 ECU_ADDRESS 0x0 /end MEASUREMENT
/begin MEASUREMENT Com_TxGrpSigInfo[55].StartByteInPduPositionOfTxGrpSigInfo "" UBYTE NO_COMPU_METHOD 0 0 0 255 ECU_ADDRESS 0x0 /end MEASUREMENT
/begin MEASUREMENT Com_TxGrpSigInfo[55].TxBufferEndIdxOfTxGrpSigInfo "" UWORD Com_TxBufferEndIdxOfTxGrpSigInfoType 0 0 0 65535 ECU_ADDRESS 0x0 /end MEASUREMENT
/begin MEASUREMENT Com_TxGrpSigInfo[55].TxBufferStartIdxOfTxGrpSigInfo "" UWORD Com_TxBufferStartIdxOfTxGrpSigInfoType 0 0 0 65535 ECU_ADDRESS 0x0 /end MEASUREMENT
/begin MEASUREMENT Com_TxGrpSigInfo[55].TxPduInfoIdxOfTxGrpSigInfo "" UBYTE NO_COMPU_METHOD 0 0 0 255 ECU_ADDRESS 0x0 /end MEASUREMENT
/begin MEASUREMENT Com_TxGrpSigInfo[55].TxSigGrpInfoIdxOfTxGrpSigInfo "" UBYTE NO_COMPU_METHOD 0 0 0 255 ECU_ADDRESS 0x0 /end MEASUREMENT
/begin MEASUREMENT Com_TxGrpSigInfo[55].WithoutRepOfTxGrpSigInfo "" UBYTE Com_WithoutRepOfTxGrpSigInfoType 0 0 0 1 ECU_ADDRESS 0x0 /end MEASUREMENT
/begin MEASUREMENT Com_TxGrpSigInfo[56].ApplTypeOfTxGrpSigInfo "" UBYTE Com_ApplTypeOfTxGrpSigInfoType 0 0 0 255 ECU_ADDRESS 0x0 /end MEASUREMENT
/begin MEASUREMENT Com_TxGrpSigInfo[56].BitLengthOfTxGrpSigInfo "" UBYTE NO_COMPU_METHOD 0 0 0 255 ECU_ADDRESS 0x0 /end MEASUREMENT
/begin MEASUREMENT Com_TxGrpSigInfo[56].BitPositionOfTxGrpSigInfo "" UWORD NO_COMPU_METHOD 0 0 0 65535 ECU_ADDRESS 0x0 /end MEASUREMENT
/begin MEASUREMENT Com_TxGrpSigInfo[56].BusAccOfTxGrpSigInfo "" UBYTE Com_BusAccOfTxGrpSigInfoType 0 0 0 255 ECU_ADDRESS 0x0 /end MEASUREMENT
/begin MEASUREMENT Com_TxGrpSigInfo[56].ByteLengthOfTxGrpSigInfo "" UBYTE NO_COMPU_METHOD 0 0 0 255 ECU_ADDRESS 0x0 /end MEASUREMENT
/begin MEASUREMENT Com_TxGrpSigInfo[56].DynSignalOfTxGrpSigInfo "" UBYTE Com_DynSignalOfTxGrpSigInfoType 0 0 0 1 ECU_ADDRESS 0x0 /end MEASUREMENT
/begin MEASUREMENT Com_TxGrpSigInfo[56].InvValueIdxOfTxGrpSigInfo "" UBYTE Com_InvValueIdxOfTxGrpSigInfoType 0 0 0 255 ECU_ADDRESS 0x0 /end MEASUREMENT
/begin MEASUREMENT Com_TxGrpSigInfo[56].InvValueOfTxGrpSigInfo "" UBYTE Com_InvValueOfTxGrpSigInfoType 0 0 0 255 ECU_ADDRESS 0x0 /end MEASUREMENT
/begin MEASUREMENT Com_TxGrpSigInfo[56].StartByteInPduPositionOfTxGrpSigInfo "" UBYTE NO_COMPU_METHOD 0 0 0 255 ECU_ADDRESS 0x0 /end MEASUREMENT
/begin MEASUREMENT Com_TxGrpSigInfo[56].TxBufferEndIdxOfTxGrpSigInfo "" UWORD Com_TxBufferEndIdxOfTxGrpSigInfoType 0 0 0 65535 ECU_ADDRESS 0x0 /end MEASUREMENT
/begin MEASUREMENT Com_TxGrpSigInfo[56].TxBufferStartIdxOfTxGrpSigInfo "" UWORD Com_TxBufferStartIdxOfTxGrpSigInfoType 0 0 0 65535 ECU_ADDRESS 0x0 /end MEASUREMENT
/begin MEASUREMENT Com_TxGrpSigInfo[56].TxPduInfoIdxOfTxGrpSigInfo "" UBYTE NO_COMPU_METHOD 0 0 0 255 ECU_ADDRESS 0x0 /end MEASUREMENT
/begin MEASUREMENT Com_TxGrpSigInfo[56].TxSigGrpInfoIdxOfTxGrpSigInfo "" UBYTE NO_COMPU_METHOD 0 0 0 255 ECU_ADDRESS 0x0 /end MEASUREMENT
/begin MEASUREMENT Com_TxGrpSigInfo[56].WithoutRepOfTxGrpSigInfo "" UBYTE Com_WithoutRepOfTxGrpSigInfoType 0 0 0 1 ECU_ADDRESS 0x0 /end MEASUREMENT
/begin MEASUREMENT Com_TxGrpSigInfo[57].ApplTypeOfTxGrpSigInfo "" UBYTE Com_ApplTypeOfTxGrpSigInfoType 0 0 0 255 ECU_ADDRESS 0x0 /end MEASUREMENT
/begin MEASUREMENT Com_TxGrpSigInfo[57].BitLengthOfTxGrpSigInfo "" UBYTE NO_COMPU_METHOD 0 0 0 255 ECU_ADDRESS 0x0 /end MEASUREMENT
/begin MEASUREMENT Com_TxGrpSigInfo[57].BitPositionOfTxGrpSigInfo "" UWORD NO_COMPU_METHOD 0 0 0 65535 ECU_ADDRESS 0x0 /end MEASUREMENT
/begin MEASUREMENT Com_TxGrpSigInfo[57].BusAccOfTxGrpSigInfo "" UBYTE Com_BusAccOfTxGrpSigInfoType 0 0 0 255 ECU_ADDRESS 0x0 /end MEASUREMENT
/begin MEASUREMENT Com_TxGrpSigInfo[57].ByteLengthOfTxGrpSigInfo "" UBYTE NO_COMPU_METHOD 0 0 0 255 ECU_ADDRESS 0x0 /end MEASUREMENT
/begin MEASUREMENT Com_TxGrpSigInfo[57].DynSignalOfTxGrpSigInfo "" UBYTE Com_DynSignalOfTxGrpSigInfoType 0 0 0 1 ECU_ADDRESS 0x0 /end MEASUREMENT
/begin MEASUREMENT Com_TxGrpSigInfo[57].InvValueIdxOfTxGrpSigInfo "" UBYTE Com_InvValueIdxOfTxGrpSigInfoType 0 0 0 255 ECU_ADDRESS 0x0 /end MEASUREMENT
/begin MEASUREMENT Com_TxGrpSigInfo[57].InvValueOfTxGrpSigInfo "" UBYTE Com_InvValueOfTxGrpSigInfoType 0 0 0 255 ECU_ADDRESS 0x0 /end MEASUREMENT
/begin MEASUREMENT Com_TxGrpSigInfo[57].StartByteInPduPositionOfTxGrpSigInfo "" UBYTE NO_COMPU_METHOD 0 0 0 255 ECU_ADDRESS 0x0 /end MEASUREMENT
/begin MEASUREMENT Com_TxGrpSigInfo[57].TxBufferEndIdxOfTxGrpSigInfo "" UWORD Com_TxBufferEndIdxOfTxGrpSigInfoType 0 0 0 65535 ECU_ADDRESS 0x0 /end MEASUREMENT
/begin MEASUREMENT Com_TxGrpSigInfo[57].TxBufferStartIdxOfTxGrpSigInfo "" UWORD Com_TxBufferStartIdxOfTxGrpSigInfoType 0 0 0 65535 ECU_ADDRESS 0x0 /end MEASUREMENT
/begin MEASUREMENT Com_TxGrpSigInfo[57].TxPduInfoIdxOfTxGrpSigInfo "" UBYTE NO_COMPU_METHOD 0 0 0 255 ECU_ADDRESS 0x0 /end MEASUREMENT
/begin MEASUREMENT Com_TxGrpSigInfo[57].TxSigGrpInfoIdxOfTxGrpSigInfo "" UBYTE NO_COMPU_METHOD 0 0 0 255 ECU_ADDRESS 0x0 /end MEASUREMENT
/begin MEASUREMENT Com_TxGrpSigInfo[57].WithoutRepOfTxGrpSigInfo "" UBYTE Com_WithoutRepOfTxGrpSigInfoType 0 0 0 1 ECU_ADDRESS 0x0 /end MEASUREMENT
/begin MEASUREMENT Com_TxGrpSigInfo[58].ApplTypeOfTxGrpSigInfo "" UBYTE Com_ApplTypeOfTxGrpSigInfoType 0 0 0 255 ECU_ADDRESS 0x0 /end MEASUREMENT
/begin MEASUREMENT Com_TxGrpSigInfo[58].BitLengthOfTxGrpSigInfo "" UBYTE NO_COMPU_METHOD 0 0 0 255 ECU_ADDRESS 0x0 /end MEASUREMENT
/begin MEASUREMENT Com_TxGrpSigInfo[58].BitPositionOfTxGrpSigInfo "" UWORD NO_COMPU_METHOD 0 0 0 65535 ECU_ADDRESS 0x0 /end MEASUREMENT
/begin MEASUREMENT Com_TxGrpSigInfo[58].BusAccOfTxGrpSigInfo "" UBYTE Com_BusAccOfTxGrpSigInfoType 0 0 0 255 ECU_ADDRESS 0x0 /end MEASUREMENT
/begin MEASUREMENT Com_TxGrpSigInfo[58].ByteLengthOfTxGrpSigInfo "" UBYTE NO_COMPU_METHOD 0 0 0 255 ECU_ADDRESS 0x0 /end MEASUREMENT
/begin MEASUREMENT Com_TxGrpSigInfo[58].DynSignalOfTxGrpSigInfo "" UBYTE Com_DynSignalOfTxGrpSigInfoType 0 0 0 1 ECU_ADDRESS 0x0 /end MEASUREMENT
/begin MEASUREMENT Com_TxGrpSigInfo[58].InvValueIdxOfTxGrpSigInfo "" UBYTE Com_InvValueIdxOfTxGrpSigInfoType 0 0 0 255 ECU_ADDRESS 0x0 /end MEASUREMENT
/begin MEASUREMENT Com_TxGrpSigInfo[58].InvValueOfTxGrpSigInfo "" UBYTE Com_InvValueOfTxGrpSigInfoType 0 0 0 255 ECU_ADDRESS 0x0 /end MEASUREMENT
/begin MEASUREMENT Com_TxGrpSigInfo[58].StartByteInPduPositionOfTxGrpSigInfo "" UBYTE NO_COMPU_METHOD 0 0 0 255 ECU_ADDRESS 0x0 /end MEASUREMENT
/begin MEASUREMENT Com_TxGrpSigInfo[58].TxBufferEndIdxOfTxGrpSigInfo "" UWORD Com_TxBufferEndIdxOfTxGrpSigInfoType 0 0 0 65535 ECU_ADDRESS 0x0 /end MEASUREMENT
/begin MEASUREMENT Com_TxGrpSigInfo[58].TxBufferStartIdxOfTxGrpSigInfo "" UWORD Com_TxBufferStartIdxOfTxGrpSigInfoType 0 0 0 65535 ECU_ADDRESS 0x0 /end MEASUREMENT
/begin MEASUREMENT Com_TxGrpSigInfo[58].TxPduInfoIdxOfTxGrpSigInfo "" UBYTE NO_COMPU_METHOD 0 0 0 255 ECU_ADDRESS 0x0 /end MEASUREMENT
/begin MEASUREMENT Com_TxGrpSigInfo[58].TxSigGrpInfoIdxOfTxGrpSigInfo "" UBYTE NO_COMPU_METHOD 0 0 0 255 ECU_ADDRESS 0x0 /end MEASUREMENT
/begin MEASUREMENT Com_TxGrpSigInfo[58].WithoutRepOfTxGrpSigInfo "" UBYTE Com_WithoutRepOfTxGrpSigInfoType 0 0 0 1 ECU_ADDRESS 0x0 /end MEASUREMENT
/begin MEASUREMENT Com_TxGrpSigInfo[59].ApplTypeOfTxGrpSigInfo "" UBYTE Com_ApplTypeOfTxGrpSigInfoType 0 0 0 255 ECU_ADDRESS 0x0 /end MEASUREMENT
/begin MEASUREMENT Com_TxGrpSigInfo[59].BitLengthOfTxGrpSigInfo "" UBYTE NO_COMPU_METHOD 0 0 0 255 ECU_ADDRESS 0x0 /end MEASUREMENT
/begin MEASUREMENT Com_TxGrpSigInfo[59].BitPositionOfTxGrpSigInfo "" UWORD NO_COMPU_METHOD 0 0 0 65535 ECU_ADDRESS 0x0 /end MEASUREMENT
/begin MEASUREMENT Com_TxGrpSigInfo[59].BusAccOfTxGrpSigInfo "" UBYTE Com_BusAccOfTxGrpSigInfoType 0 0 0 255 ECU_ADDRESS 0x0 /end MEASUREMENT
/begin MEASUREMENT Com_TxGrpSigInfo[59].ByteLengthOfTxGrpSigInfo "" UBYTE NO_COMPU_METHOD 0 0 0 255 ECU_ADDRESS 0x0 /end MEASUREMENT
/begin MEASUREMENT Com_TxGrpSigInfo[59].DynSignalOfTxGrpSigInfo "" UBYTE Com_DynSignalOfTxGrpSigInfoType 0 0 0 1 ECU_ADDRESS 0x0 /end MEASUREMENT
/begin MEASUREMENT Com_TxGrpSigInfo[59].InvValueIdxOfTxGrpSigInfo "" UBYTE Com_InvValueIdxOfTxGrpSigInfoType 0 0 0 255 ECU_ADDRESS 0x0 /end MEASUREMENT
/begin MEASUREMENT Com_TxGrpSigInfo[59].InvValueOfTxGrpSigInfo "" UBYTE Com_InvValueOfTxGrpSigInfoType 0 0 0 255 ECU_ADDRESS 0x0 /end MEASUREMENT
/begin MEASUREMENT Com_TxGrpSigInfo[59].StartByteInPduPositionOfTxGrpSigInfo "" UBYTE NO_COMPU_METHOD 0 0 0 255 ECU_ADDRESS 0x0 /end MEASUREMENT
/begin MEASUREMENT Com_TxGrpSigInfo[59].TxBufferEndIdxOfTxGrpSigInfo "" UWORD Com_TxBufferEndIdxOfTxGrpSigInfoType 0 0 0 65535 ECU_ADDRESS 0x0 /end MEASUREMENT
/begin MEASUREMENT Com_TxGrpSigInfo[59].TxBufferStartIdxOfTxGrpSigInfo "" UWORD Com_TxBufferStartIdxOfTxGrpSigInfoType 0 0 0 65535 ECU_ADDRESS 0x0 /end MEASUREMENT
/begin MEASUREMENT Com_TxGrpSigInfo[59].TxPduInfoIdxOfTxGrpSigInfo "" UBYTE NO_COMPU_METHOD 0 0 0 255 ECU_ADDRESS 0x0 /end MEASUREMENT
/begin MEASUREMENT Com_TxGrpSigInfo[59].TxSigGrpInfoIdxOfTxGrpSigInfo "" UBYTE NO_COMPU_METHOD 0 0 0 255 ECU_ADDRESS 0x0 /end MEASUREMENT
/begin MEASUREMENT Com_TxGrpSigInfo[59].WithoutRepOfTxGrpSigInfo "" UBYTE Com_WithoutRepOfTxGrpSigInfoType 0 0 0 1 ECU_ADDRESS 0x0 /end MEASUREMENT
/begin MEASUREMENT Com_TxGrpSigInfo[5].ApplTypeOfTxGrpSigInfo "" UBYTE Com_ApplTypeOfTxGrpSigInfoType 0 0 0 255 ECU_ADDRESS 0x0 /end MEASUREMENT
/begin MEASUREMENT Com_TxGrpSigInfo[5].BitLengthOfTxGrpSigInfo "" UBYTE NO_COMPU_METHOD 0 0 0 255 ECU_ADDRESS 0x0 /end MEASUREMENT
/begin MEASUREMENT Com_TxGrpSigInfo[5].BitPositionOfTxGrpSigInfo "" UWORD NO_COMPU_METHOD 0 0 0 65535 ECU_ADDRESS 0x0 /end MEASUREMENT
/begin MEASUREMENT Com_TxGrpSigInfo[5].BusAccOfTxGrpSigInfo "" UBYTE Com_BusAccOfTxGrpSigInfoType 0 0 0 255 ECU_ADDRESS 0x0 /end MEASUREMENT
/begin MEASUREMENT Com_TxGrpSigInfo[5].ByteLengthOfTxGrpSigInfo "" UBYTE NO_COMPU_METHOD 0 0 0 255 ECU_ADDRESS 0x0 /end MEASUREMENT
/begin MEASUREMENT Com_TxGrpSigInfo[5].DynSignalOfTxGrpSigInfo "" UBYTE Com_DynSignalOfTxGrpSigInfoType 0 0 0 1 ECU_ADDRESS 0x0 /end MEASUREMENT
/begin MEASUREMENT Com_TxGrpSigInfo[5].InvValueIdxOfTxGrpSigInfo "" UBYTE Com_InvValueIdxOfTxGrpSigInfoType 0 0 0 255 ECU_ADDRESS 0x0 /end MEASUREMENT
/begin MEASUREMENT Com_TxGrpSigInfo[5].InvValueOfTxGrpSigInfo "" UBYTE Com_InvValueOfTxGrpSigInfoType 0 0 0 255 ECU_ADDRESS 0x0 /end MEASUREMENT
/begin MEASUREMENT Com_TxGrpSigInfo[5].StartByteInPduPositionOfTxGrpSigInfo "" UBYTE NO_COMPU_METHOD 0 0 0 255 ECU_ADDRESS 0x0 /end MEASUREMENT
/begin MEASUREMENT Com_TxGrpSigInfo[5].TxBufferEndIdxOfTxGrpSigInfo "" UWORD Com_TxBufferEndIdxOfTxGrpSigInfoType 0 0 0 65535 ECU_ADDRESS 0x0 /end MEASUREMENT
/begin MEASUREMENT Com_TxGrpSigInfo[5].TxBufferStartIdxOfTxGrpSigInfo "" UWORD Com_TxBufferStartIdxOfTxGrpSigInfoType 0 0 0 65535 ECU_ADDRESS 0x0 /end MEASUREMENT
/begin MEASUREMENT Com_TxGrpSigInfo[5].TxPduInfoIdxOfTxGrpSigInfo "" UBYTE NO_COMPU_METHOD 0 0 0 255 ECU_ADDRESS 0x0 /end MEASUREMENT
/begin MEASUREMENT Com_TxGrpSigInfo[5].TxSigGrpInfoIdxOfTxGrpSigInfo "" UBYTE NO_COMPU_METHOD 0 0 0 255 ECU_ADDRESS 0x0 /end MEASUREMENT
/begin MEASUREMENT Com_TxGrpSigInfo[5].WithoutRepOfTxGrpSigInfo "" UBYTE Com_WithoutRepOfTxGrpSigInfoType 0 0 0 1 ECU_ADDRESS 0x0 /end MEASUREMENT
/begin MEASUREMENT Com_TxGrpSigInfo[60].ApplTypeOfTxGrpSigInfo "" UBYTE Com_ApplTypeOfTxGrpSigInfoType 0 0 0 255 ECU_ADDRESS 0x0 /end MEASUREMENT
/begin MEASUREMENT Com_TxGrpSigInfo[60].BitLengthOfTxGrpSigInfo "" UBYTE NO_COMPU_METHOD 0 0 0 255 ECU_ADDRESS 0x0 /end MEASUREMENT
/begin MEASUREMENT Com_TxGrpSigInfo[60].BitPositionOfTxGrpSigInfo "" UWORD NO_COMPU_METHOD 0 0 0 65535 ECU_ADDRESS 0x0 /end MEASUREMENT
/begin MEASUREMENT Com_TxGrpSigInfo[60].BusAccOfTxGrpSigInfo "" UBYTE Com_BusAccOfTxGrpSigInfoType 0 0 0 255 ECU_ADDRESS 0x0 /end MEASUREMENT
/begin MEASUREMENT Com_TxGrpSigInfo[60].ByteLengthOfTxGrpSigInfo "" UBYTE NO_COMPU_METHOD 0 0 0 255 ECU_ADDRESS 0x0 /end MEASUREMENT
/begin MEASUREMENT Com_TxGrpSigInfo[60].DynSignalOfTxGrpSigInfo "" UBYTE Com_DynSignalOfTxGrpSigInfoType 0 0 0 1 ECU_ADDRESS 0x0 /end MEASUREMENT
/begin MEASUREMENT Com_TxGrpSigInfo[60].InvValueIdxOfTxGrpSigInfo "" UBYTE Com_InvValueIdxOfTxGrpSigInfoType 0 0 0 255 ECU_ADDRESS 0x0 /end MEASUREMENT
/begin MEASUREMENT Com_TxGrpSigInfo[60].InvValueOfTxGrpSigInfo "" UBYTE Com_InvValueOfTxGrpSigInfoType 0 0 0 255 ECU_ADDRESS 0x0 /end MEASUREMENT
/begin MEASUREMENT Com_TxGrpSigInfo[60].StartByteInPduPositionOfTxGrpSigInfo "" UBYTE NO_COMPU_METHOD 0 0 0 255 ECU_ADDRESS 0x0 /end MEASUREMENT
/begin MEASUREMENT Com_TxGrpSigInfo[60].TxBufferEndIdxOfTxGrpSigInfo "" UWORD Com_TxBufferEndIdxOfTxGrpSigInfoType 0 0 0 65535 ECU_ADDRESS 0x0 /end MEASUREMENT
/begin MEASUREMENT Com_TxGrpSigInfo[60].TxBufferStartIdxOfTxGrpSigInfo "" UWORD Com_TxBufferStartIdxOfTxGrpSigInfoType 0 0 0 65535 ECU_ADDRESS 0x0 /end MEASUREMENT
/begin MEASUREMENT Com_TxGrpSigInfo[60].TxPduInfoIdxOfTxGrpSigInfo "" UBYTE NO_COMPU_METHOD 0 0 0 255 ECU_ADDRESS 0x0 /end MEASUREMENT
/begin MEASUREMENT Com_TxGrpSigInfo[60].TxSigGrpInfoIdxOfTxGrpSigInfo "" UBYTE NO_COMPU_METHOD 0 0 0 255 ECU_ADDRESS 0x0 /end MEASUREMENT
/begin MEASUREMENT Com_TxGrpSigInfo[60].WithoutRepOfTxGrpSigInfo "" UBYTE Com_WithoutRepOfTxGrpSigInfoType 0 0 0 1 ECU_ADDRESS 0x0 /end MEASUREMENT
/begin MEASUREMENT Com_TxGrpSigInfo[61].ApplTypeOfTxGrpSigInfo "" UBYTE Com_ApplTypeOfTxGrpSigInfoType 0 0 0 255 ECU_ADDRESS 0x0 /end MEASUREMENT
/begin MEASUREMENT Com_TxGrpSigInfo[61].BitLengthOfTxGrpSigInfo "" UBYTE NO_COMPU_METHOD 0 0 0 255 ECU_ADDRESS 0x0 /end MEASUREMENT
/begin MEASUREMENT Com_TxGrpSigInfo[61].BitPositionOfTxGrpSigInfo "" UWORD NO_COMPU_METHOD 0 0 0 65535 ECU_ADDRESS 0x0 /end MEASUREMENT
/begin MEASUREMENT Com_TxGrpSigInfo[61].BusAccOfTxGrpSigInfo "" UBYTE Com_BusAccOfTxGrpSigInfoType 0 0 0 255 ECU_ADDRESS 0x0 /end MEASUREMENT
/begin MEASUREMENT Com_TxGrpSigInfo[61].ByteLengthOfTxGrpSigInfo "" UBYTE NO_COMPU_METHOD 0 0 0 255 ECU_ADDRESS 0x0 /end MEASUREMENT
/begin MEASUREMENT Com_TxGrpSigInfo[61].DynSignalOfTxGrpSigInfo "" UBYTE Com_DynSignalOfTxGrpSigInfoType 0 0 0 1 ECU_ADDRESS 0x0 /end MEASUREMENT
/begin MEASUREMENT Com_TxGrpSigInfo[61].InvValueIdxOfTxGrpSigInfo "" UBYTE Com_InvValueIdxOfTxGrpSigInfoType 0 0 0 255 ECU_ADDRESS 0x0 /end MEASUREMENT
/begin MEASUREMENT Com_TxGrpSigInfo[61].InvValueOfTxGrpSigInfo "" UBYTE Com_InvValueOfTxGrpSigInfoType 0 0 0 255 ECU_ADDRESS 0x0 /end MEASUREMENT
/begin MEASUREMENT Com_TxGrpSigInfo[61].StartByteInPduPositionOfTxGrpSigInfo "" UBYTE NO_COMPU_METHOD 0 0 0 255 ECU_ADDRESS 0x0 /end MEASUREMENT
/begin MEASUREMENT Com_TxGrpSigInfo[61].TxBufferEndIdxOfTxGrpSigInfo "" UWORD Com_TxBufferEndIdxOfTxGrpSigInfoType 0 0 0 65535 ECU_ADDRESS 0x0 /end MEASUREMENT
/begin MEASUREMENT Com_TxGrpSigInfo[61].TxBufferStartIdxOfTxGrpSigInfo "" UWORD Com_TxBufferStartIdxOfTxGrpSigInfoType 0 0 0 65535 ECU_ADDRESS 0x0 /end MEASUREMENT
/begin MEASUREMENT Com_TxGrpSigInfo[61].TxPduInfoIdxOfTxGrpSigInfo "" UBYTE NO_COMPU_METHOD 0 0 0 255 ECU_ADDRESS 0x0 /end MEASUREMENT
/begin MEASUREMENT Com_TxGrpSigInfo[61].TxSigGrpInfoIdxOfTxGrpSigInfo "" UBYTE NO_COMPU_METHOD 0 0 0 255 ECU_ADDRESS 0x0 /end MEASUREMENT
/begin MEASUREMENT Com_TxGrpSigInfo[61].WithoutRepOfTxGrpSigInfo "" UBYTE Com_WithoutRepOfTxGrpSigInfoType 0 0 0 1 ECU_ADDRESS 0x0 /end MEASUREMENT
/begin MEASUREMENT Com_TxGrpSigInfo[62].ApplTypeOfTxGrpSigInfo "" UBYTE Com_ApplTypeOfTxGrpSigInfoType 0 0 0 255 ECU_ADDRESS 0x0 /end MEASUREMENT
/begin MEASUREMENT Com_TxGrpSigInfo[62].BitLengthOfTxGrpSigInfo "" UBYTE NO_COMPU_METHOD 0 0 0 255 ECU_ADDRESS 0x0 /end MEASUREMENT
/begin MEASUREMENT Com_TxGrpSigInfo[62].BitPositionOfTxGrpSigInfo "" UWORD NO_COMPU_METHOD 0 0 0 65535 ECU_ADDRESS 0x0 /end MEASUREMENT
/begin MEASUREMENT Com_TxGrpSigInfo[62].BusAccOfTxGrpSigInfo "" UBYTE Com_BusAccOfTxGrpSigInfoType 0 0 0 255 ECU_ADDRESS 0x0 /end MEASUREMENT
/begin MEASUREMENT Com_TxGrpSigInfo[62].ByteLengthOfTxGrpSigInfo "" UBYTE NO_COMPU_METHOD 0 0 0 255 ECU_ADDRESS 0x0 /end MEASUREMENT
/begin MEASUREMENT Com_TxGrpSigInfo[62].DynSignalOfTxGrpSigInfo "" UBYTE Com_DynSignalOfTxGrpSigInfoType 0 0 0 1 ECU_ADDRESS 0x0 /end MEASUREMENT
/begin MEASUREMENT Com_TxGrpSigInfo[62].InvValueIdxOfTxGrpSigInfo "" UBYTE Com_InvValueIdxOfTxGrpSigInfoType 0 0 0 255 ECU_ADDRESS 0x0 /end MEASUREMENT
/begin MEASUREMENT Com_TxGrpSigInfo[62].InvValueOfTxGrpSigInfo "" UBYTE Com_InvValueOfTxGrpSigInfoType 0 0 0 255 ECU_ADDRESS 0x0 /end MEASUREMENT
/begin MEASUREMENT Com_TxGrpSigInfo[62].StartByteInPduPositionOfTxGrpSigInfo "" UBYTE NO_COMPU_METHOD 0 0 0 255 ECU_ADDRESS 0x0 /end MEASUREMENT
/begin MEASUREMENT Com_TxGrpSigInfo[62].TxBufferEndIdxOfTxGrpSigInfo "" UWORD Com_TxBufferEndIdxOfTxGrpSigInfoType 0 0 0 65535 ECU_ADDRESS 0x0 /end MEASUREMENT
/begin MEASUREMENT Com_TxGrpSigInfo[62].TxBufferStartIdxOfTxGrpSigInfo "" UWORD Com_TxBufferStartIdxOfTxGrpSigInfoType 0 0 0 65535 ECU_ADDRESS 0x0 /end MEASUREMENT
/begin MEASUREMENT Com_TxGrpSigInfo[62].TxPduInfoIdxOfTxGrpSigInfo "" UBYTE NO_COMPU_METHOD 0 0 0 255 ECU_ADDRESS 0x0 /end MEASUREMENT
/begin MEASUREMENT Com_TxGrpSigInfo[62].TxSigGrpInfoIdxOfTxGrpSigInfo "" UBYTE NO_COMPU_METHOD 0 0 0 255 ECU_ADDRESS 0x0 /end MEASUREMENT
/begin MEASUREMENT Com_TxGrpSigInfo[62].WithoutRepOfTxGrpSigInfo "" UBYTE Com_WithoutRepOfTxGrpSigInfoType 0 0 0 1 ECU_ADDRESS 0x0 /end MEASUREMENT
/begin MEASUREMENT Com_TxGrpSigInfo[63].ApplTypeOfTxGrpSigInfo "" UBYTE Com_ApplTypeOfTxGrpSigInfoType 0 0 0 255 ECU_ADDRESS 0x0 /end MEASUREMENT
/begin MEASUREMENT Com_TxGrpSigInfo[63].BitLengthOfTxGrpSigInfo "" UBYTE NO_COMPU_METHOD 0 0 0 255 ECU_ADDRESS 0x0 /end MEASUREMENT
/begin MEASUREMENT Com_TxGrpSigInfo[63].BitPositionOfTxGrpSigInfo "" UWORD NO_COMPU_METHOD 0 0 0 65535 ECU_ADDRESS 0x0 /end MEASUREMENT
/begin MEASUREMENT Com_TxGrpSigInfo[63].BusAccOfTxGrpSigInfo "" UBYTE Com_BusAccOfTxGrpSigInfoType 0 0 0 255 ECU_ADDRESS 0x0 /end MEASUREMENT
/begin MEASUREMENT Com_TxGrpSigInfo[63].ByteLengthOfTxGrpSigInfo "" UBYTE NO_COMPU_METHOD 0 0 0 255 ECU_ADDRESS 0x0 /end MEASUREMENT
/begin MEASUREMENT Com_TxGrpSigInfo[63].DynSignalOfTxGrpSigInfo "" UBYTE Com_DynSignalOfTxGrpSigInfoType 0 0 0 1 ECU_ADDRESS 0x0 /end MEASUREMENT
/begin MEASUREMENT Com_TxGrpSigInfo[63].InvValueIdxOfTxGrpSigInfo "" UBYTE Com_InvValueIdxOfTxGrpSigInfoType 0 0 0 255 ECU_ADDRESS 0x0 /end MEASUREMENT
/begin MEASUREMENT Com_TxGrpSigInfo[63].InvValueOfTxGrpSigInfo "" UBYTE Com_InvValueOfTxGrpSigInfoType 0 0 0 255 ECU_ADDRESS 0x0 /end MEASUREMENT
/begin MEASUREMENT Com_TxGrpSigInfo[63].StartByteInPduPositionOfTxGrpSigInfo "" UBYTE NO_COMPU_METHOD 0 0 0 255 ECU_ADDRESS 0x0 /end MEASUREMENT
/begin MEASUREMENT Com_TxGrpSigInfo[63].TxBufferEndIdxOfTxGrpSigInfo "" UWORD Com_TxBufferEndIdxOfTxGrpSigInfoType 0 0 0 65535 ECU_ADDRESS 0x0 /end MEASUREMENT
/begin MEASUREMENT Com_TxGrpSigInfo[63].TxBufferStartIdxOfTxGrpSigInfo "" UWORD Com_TxBufferStartIdxOfTxGrpSigInfoType 0 0 0 65535 ECU_ADDRESS 0x0 /end MEASUREMENT
/begin MEASUREMENT Com_TxGrpSigInfo[63].TxPduInfoIdxOfTxGrpSigInfo "" UBYTE NO_COMPU_METHOD 0 0 0 255 ECU_ADDRESS 0x0 /end MEASUREMENT
/begin MEASUREMENT Com_TxGrpSigInfo[63].TxSigGrpInfoIdxOfTxGrpSigInfo "" UBYTE NO_COMPU_METHOD 0 0 0 255 ECU_ADDRESS 0x0 /end MEASUREMENT
/begin MEASUREMENT Com_TxGrpSigInfo[63].WithoutRepOfTxGrpSigInfo "" UBYTE Com_WithoutRepOfTxGrpSigInfoType 0 0 0 1 ECU_ADDRESS 0x0 /end MEASUREMENT
/begin MEASUREMENT Com_TxGrpSigInfo[64].ApplTypeOfTxGrpSigInfo "" UBYTE Com_ApplTypeOfTxGrpSigInfoType 0 0 0 255 ECU_ADDRESS 0x0 /end MEASUREMENT
/begin MEASUREMENT Com_TxGrpSigInfo[64].BitLengthOfTxGrpSigInfo "" UBYTE NO_COMPU_METHOD 0 0 0 255 ECU_ADDRESS 0x0 /end MEASUREMENT
/begin MEASUREMENT Com_TxGrpSigInfo[64].BitPositionOfTxGrpSigInfo "" UWORD NO_COMPU_METHOD 0 0 0 65535 ECU_ADDRESS 0x0 /end MEASUREMENT
/begin MEASUREMENT Com_TxGrpSigInfo[64].BusAccOfTxGrpSigInfo "" UBYTE Com_BusAccOfTxGrpSigInfoType 0 0 0 255 ECU_ADDRESS 0x0 /end MEASUREMENT
/begin MEASUREMENT Com_TxGrpSigInfo[64].ByteLengthOfTxGrpSigInfo "" UBYTE NO_COMPU_METHOD 0 0 0 255 ECU_ADDRESS 0x0 /end MEASUREMENT
/begin MEASUREMENT Com_TxGrpSigInfo[64].DynSignalOfTxGrpSigInfo "" UBYTE Com_DynSignalOfTxGrpSigInfoType 0 0 0 1 ECU_ADDRESS 0x0 /end MEASUREMENT
/begin MEASUREMENT Com_TxGrpSigInfo[64].InvValueIdxOfTxGrpSigInfo "" UBYTE Com_InvValueIdxOfTxGrpSigInfoType 0 0 0 255 ECU_ADDRESS 0x0 /end MEASUREMENT
/begin MEASUREMENT Com_TxGrpSigInfo[64].InvValueOfTxGrpSigInfo "" UBYTE Com_InvValueOfTxGrpSigInfoType 0 0 0 255 ECU_ADDRESS 0x0 /end MEASUREMENT
/begin MEASUREMENT Com_TxGrpSigInfo[64].StartByteInPduPositionOfTxGrpSigInfo "" UBYTE NO_COMPU_METHOD 0 0 0 255 ECU_ADDRESS 0x0 /end MEASUREMENT
/begin MEASUREMENT Com_TxGrpSigInfo[64].TxBufferEndIdxOfTxGrpSigInfo "" UWORD Com_TxBufferEndIdxOfTxGrpSigInfoType 0 0 0 65535 ECU_ADDRESS 0x0 /end MEASUREMENT
/begin MEASUREMENT Com_TxGrpSigInfo[64].TxBufferStartIdxOfTxGrpSigInfo "" UWORD Com_TxBufferStartIdxOfTxGrpSigInfoType 0 0 0 65535 ECU_ADDRESS 0x0 /end MEASUREMENT
/begin MEASUREMENT Com_TxGrpSigInfo[64].TxPduInfoIdxOfTxGrpSigInfo "" UBYTE NO_COMPU_METHOD 0 0 0 255 ECU_ADDRESS 0x0 /end MEASUREMENT
/begin MEASUREMENT Com_TxGrpSigInfo[64].TxSigGrpInfoIdxOfTxGrpSigInfo "" UBYTE NO_COMPU_METHOD 0 0 0 255 ECU_ADDRESS 0x0 /end MEASUREMENT
/begin MEASUREMENT Com_TxGrpSigInfo[64].WithoutRepOfTxGrpSigInfo "" UBYTE Com_WithoutRepOfTxGrpSigInfoType 0 0 0 1 ECU_ADDRESS 0x0 /end MEASUREMENT
/begin MEASUREMENT Com_TxGrpSigInfo[65].ApplTypeOfTxGrpSigInfo "" UBYTE Com_ApplTypeOfTxGrpSigInfoType 0 0 0 255 ECU_ADDRESS 0x0 /end MEASUREMENT
/begin MEASUREMENT Com_TxGrpSigInfo[65].BitLengthOfTxGrpSigInfo "" UBYTE NO_COMPU_METHOD 0 0 0 255 ECU_ADDRESS 0x0 /end MEASUREMENT
/begin MEASUREMENT Com_TxGrpSigInfo[65].BitPositionOfTxGrpSigInfo "" UWORD NO_COMPU_METHOD 0 0 0 65535 ECU_ADDRESS 0x0 /end MEASUREMENT
/begin MEASUREMENT Com_TxGrpSigInfo[65].BusAccOfTxGrpSigInfo "" UBYTE Com_BusAccOfTxGrpSigInfoType 0 0 0 255 ECU_ADDRESS 0x0 /end MEASUREMENT
/begin MEASUREMENT Com_TxGrpSigInfo[65].ByteLengthOfTxGrpSigInfo "" UBYTE NO_COMPU_METHOD 0 0 0 255 ECU_ADDRESS 0x0 /end MEASUREMENT
/begin MEASUREMENT Com_TxGrpSigInfo[65].DynSignalOfTxGrpSigInfo "" UBYTE Com_DynSignalOfTxGrpSigInfoType 0 0 0 1 ECU_ADDRESS 0x0 /end MEASUREMENT
/begin MEASUREMENT Com_TxGrpSigInfo[65].InvValueIdxOfTxGrpSigInfo "" UBYTE Com_InvValueIdxOfTxGrpSigInfoType 0 0 0 255 ECU_ADDRESS 0x0 /end MEASUREMENT
/begin MEASUREMENT Com_TxGrpSigInfo[65].InvValueOfTxGrpSigInfo "" UBYTE Com_InvValueOfTxGrpSigInfoType 0 0 0 255 ECU_ADDRESS 0x0 /end MEASUREMENT
/begin MEASUREMENT Com_TxGrpSigInfo[65].StartByteInPduPositionOfTxGrpSigInfo "" UBYTE NO_COMPU_METHOD 0 0 0 255 ECU_ADDRESS 0x0 /end MEASUREMENT
/begin MEASUREMENT Com_TxGrpSigInfo[65].TxBufferEndIdxOfTxGrpSigInfo "" UWORD Com_TxBufferEndIdxOfTxGrpSigInfoType 0 0 0 65535 ECU_ADDRESS 0x0 /end MEASUREMENT
/begin MEASUREMENT Com_TxGrpSigInfo[65].TxBufferStartIdxOfTxGrpSigInfo "" UWORD Com_TxBufferStartIdxOfTxGrpSigInfoType 0 0 0 65535 ECU_ADDRESS 0x0 /end MEASUREMENT
/begin MEASUREMENT Com_TxGrpSigInfo[65].TxPduInfoIdxOfTxGrpSigInfo "" UBYTE NO_COMPU_METHOD 0 0 0 255 ECU_ADDRESS 0x0 /end MEASUREMENT
/begin MEASUREMENT Com_TxGrpSigInfo[65].TxSigGrpInfoIdxOfTxGrpSigInfo "" UBYTE NO_COMPU_METHOD 0 0 0 255 ECU_ADDRESS 0x0 /end MEASUREMENT
/begin MEASUREMENT Com_TxGrpSigInfo[65].WithoutRepOfTxGrpSigInfo "" UBYTE Com_WithoutRepOfTxGrpSigInfoType 0 0 0 1 ECU_ADDRESS 0x0 /end MEASUREMENT
/begin MEASUREMENT Com_TxGrpSigInfo[66].ApplTypeOfTxGrpSigInfo "" UBYTE Com_ApplTypeOfTxGrpSigInfoType 0 0 0 255 ECU_ADDRESS 0x0 /end MEASUREMENT
/begin MEASUREMENT Com_TxGrpSigInfo[66].BitLengthOfTxGrpSigInfo "" UBYTE NO_COMPU_METHOD 0 0 0 255 ECU_ADDRESS 0x0 /end MEASUREMENT
/begin MEASUREMENT Com_TxGrpSigInfo[66].BitPositionOfTxGrpSigInfo "" UWORD NO_COMPU_METHOD 0 0 0 65535 ECU_ADDRESS 0x0 /end MEASUREMENT
/begin MEASUREMENT Com_TxGrpSigInfo[66].BusAccOfTxGrpSigInfo "" UBYTE Com_BusAccOfTxGrpSigInfoType 0 0 0 255 ECU_ADDRESS 0x0 /end MEASUREMENT
/begin MEASUREMENT Com_TxGrpSigInfo[66].ByteLengthOfTxGrpSigInfo "" UBYTE NO_COMPU_METHOD 0 0 0 255 ECU_ADDRESS 0x0 /end MEASUREMENT
/begin MEASUREMENT Com_TxGrpSigInfo[66].DynSignalOfTxGrpSigInfo "" UBYTE Com_DynSignalOfTxGrpSigInfoType 0 0 0 1 ECU_ADDRESS 0x0 /end MEASUREMENT
/begin MEASUREMENT Com_TxGrpSigInfo[66].InvValueIdxOfTxGrpSigInfo "" UBYTE Com_InvValueIdxOfTxGrpSigInfoType 0 0 0 255 ECU_ADDRESS 0x0 /end MEASUREMENT
/begin MEASUREMENT Com_TxGrpSigInfo[66].InvValueOfTxGrpSigInfo "" UBYTE Com_InvValueOfTxGrpSigInfoType 0 0 0 255 ECU_ADDRESS 0x0 /end MEASUREMENT
/begin MEASUREMENT Com_TxGrpSigInfo[66].StartByteInPduPositionOfTxGrpSigInfo "" UBYTE NO_COMPU_METHOD 0 0 0 255 ECU_ADDRESS 0x0 /end MEASUREMENT
/begin MEASUREMENT Com_TxGrpSigInfo[66].TxBufferEndIdxOfTxGrpSigInfo "" UWORD Com_TxBufferEndIdxOfTxGrpSigInfoType 0 0 0 65535 ECU_ADDRESS 0x0 /end MEASUREMENT
/begin MEASUREMENT Com_TxGrpSigInfo[66].TxBufferStartIdxOfTxGrpSigInfo "" UWORD Com_TxBufferStartIdxOfTxGrpSigInfoType 0 0 0 65535 ECU_ADDRESS 0x0 /end MEASUREMENT
/begin MEASUREMENT Com_TxGrpSigInfo[66].TxPduInfoIdxOfTxGrpSigInfo "" UBYTE NO_COMPU_METHOD 0 0 0 255 ECU_ADDRESS 0x0 /end MEASUREMENT
/begin MEASUREMENT Com_TxGrpSigInfo[66].TxSigGrpInfoIdxOfTxGrpSigInfo "" UBYTE NO_COMPU_METHOD 0 0 0 255 ECU_ADDRESS 0x0 /end MEASUREMENT
/begin MEASUREMENT Com_TxGrpSigInfo[66].WithoutRepOfTxGrpSigInfo "" UBYTE Com_WithoutRepOfTxGrpSigInfoType 0 0 0 1 ECU_ADDRESS 0x0 /end MEASUREMENT
/begin MEASUREMENT Com_TxGrpSigInfo[67].ApplTypeOfTxGrpSigInfo "" UBYTE Com_ApplTypeOfTxGrpSigInfoType 0 0 0 255 ECU_ADDRESS 0x0 /end MEASUREMENT
/begin MEASUREMENT Com_TxGrpSigInfo[67].BitLengthOfTxGrpSigInfo "" UBYTE NO_COMPU_METHOD 0 0 0 255 ECU_ADDRESS 0x0 /end MEASUREMENT
/begin MEASUREMENT Com_TxGrpSigInfo[67].BitPositionOfTxGrpSigInfo "" UWORD NO_COMPU_METHOD 0 0 0 65535 ECU_ADDRESS 0x0 /end MEASUREMENT
/begin MEASUREMENT Com_TxGrpSigInfo[67].BusAccOfTxGrpSigInfo "" UBYTE Com_BusAccOfTxGrpSigInfoType 0 0 0 255 ECU_ADDRESS 0x0 /end MEASUREMENT
/begin MEASUREMENT Com_TxGrpSigInfo[67].ByteLengthOfTxGrpSigInfo "" UBYTE NO_COMPU_METHOD 0 0 0 255 ECU_ADDRESS 0x0 /end MEASUREMENT
/begin MEASUREMENT Com_TxGrpSigInfo[67].DynSignalOfTxGrpSigInfo "" UBYTE Com_DynSignalOfTxGrpSigInfoType 0 0 0 1 ECU_ADDRESS 0x0 /end MEASUREMENT
/begin MEASUREMENT Com_TxGrpSigInfo[67].InvValueIdxOfTxGrpSigInfo "" UBYTE Com_InvValueIdxOfTxGrpSigInfoType 0 0 0 255 ECU_ADDRESS 0x0 /end MEASUREMENT
/begin MEASUREMENT Com_TxGrpSigInfo[67].InvValueOfTxGrpSigInfo "" UBYTE Com_InvValueOfTxGrpSigInfoType 0 0 0 255 ECU_ADDRESS 0x0 /end MEASUREMENT
/begin MEASUREMENT Com_TxGrpSigInfo[67].StartByteInPduPositionOfTxGrpSigInfo "" UBYTE NO_COMPU_METHOD 0 0 0 255 ECU_ADDRESS 0x0 /end MEASUREMENT
/begin MEASUREMENT Com_TxGrpSigInfo[67].TxBufferEndIdxOfTxGrpSigInfo "" UWORD Com_TxBufferEndIdxOfTxGrpSigInfoType 0 0 0 65535 ECU_ADDRESS 0x0 /end MEASUREMENT
/begin MEASUREMENT Com_TxGrpSigInfo[67].TxBufferStartIdxOfTxGrpSigInfo "" UWORD Com_TxBufferStartIdxOfTxGrpSigInfoType 0 0 0 65535 ECU_ADDRESS 0x0 /end MEASUREMENT
/begin MEASUREMENT Com_TxGrpSigInfo[67].TxPduInfoIdxOfTxGrpSigInfo "" UBYTE NO_COMPU_METHOD 0 0 0 255 ECU_ADDRESS 0x0 /end MEASUREMENT
/begin MEASUREMENT Com_TxGrpSigInfo[67].TxSigGrpInfoIdxOfTxGrpSigInfo "" UBYTE NO_COMPU_METHOD 0 0 0 255 ECU_ADDRESS 0x0 /end MEASUREMENT
/begin MEASUREMENT Com_TxGrpSigInfo[67].WithoutRepOfTxGrpSigInfo "" UBYTE Com_WithoutRepOfTxGrpSigInfoType 0 0 0 1 ECU_ADDRESS 0x0 /end MEASUREMENT
/begin MEASUREMENT Com_TxGrpSigInfo[68].ApplTypeOfTxGrpSigInfo "" UBYTE Com_ApplTypeOfTxGrpSigInfoType 0 0 0 255 ECU_ADDRESS 0x0 /end MEASUREMENT
/begin MEASUREMENT Com_TxGrpSigInfo[68].BitLengthOfTxGrpSigInfo "" UBYTE NO_COMPU_METHOD 0 0 0 255 ECU_ADDRESS 0x0 /end MEASUREMENT
/begin MEASUREMENT Com_TxGrpSigInfo[68].BitPositionOfTxGrpSigInfo "" UWORD NO_COMPU_METHOD 0 0 0 65535 ECU_ADDRESS 0x0 /end MEASUREMENT
/begin MEASUREMENT Com_TxGrpSigInfo[68].BusAccOfTxGrpSigInfo "" UBYTE Com_BusAccOfTxGrpSigInfoType 0 0 0 255 ECU_ADDRESS 0x0 /end MEASUREMENT
/begin MEASUREMENT Com_TxGrpSigInfo[68].ByteLengthOfTxGrpSigInfo "" UBYTE NO_COMPU_METHOD 0 0 0 255 ECU_ADDRESS 0x0 /end MEASUREMENT
/begin MEASUREMENT Com_TxGrpSigInfo[68].DynSignalOfTxGrpSigInfo "" UBYTE Com_DynSignalOfTxGrpSigInfoType 0 0 0 1 ECU_ADDRESS 0x0 /end MEASUREMENT
/begin MEASUREMENT Com_TxGrpSigInfo[68].InvValueIdxOfTxGrpSigInfo "" UBYTE Com_InvValueIdxOfTxGrpSigInfoType 0 0 0 255 ECU_ADDRESS 0x0 /end MEASUREMENT
/begin MEASUREMENT Com_TxGrpSigInfo[68].InvValueOfTxGrpSigInfo "" UBYTE Com_InvValueOfTxGrpSigInfoType 0 0 0 255 ECU_ADDRESS 0x0 /end MEASUREMENT
/begin MEASUREMENT Com_TxGrpSigInfo[68].StartByteInPduPositionOfTxGrpSigInfo "" UBYTE NO_COMPU_METHOD 0 0 0 255 ECU_ADDRESS 0x0 /end MEASUREMENT
/begin MEASUREMENT Com_TxGrpSigInfo[68].TxBufferEndIdxOfTxGrpSigInfo "" UWORD Com_TxBufferEndIdxOfTxGrpSigInfoType 0 0 0 65535 ECU_ADDRESS 0x0 /end MEASUREMENT
/begin MEASUREMENT Com_TxGrpSigInfo[68].TxBufferStartIdxOfTxGrpSigInfo "" UWORD Com_TxBufferStartIdxOfTxGrpSigInfoType 0 0 0 65535 ECU_ADDRESS 0x0 /end MEASUREMENT
/begin MEASUREMENT Com_TxGrpSigInfo[68].TxPduInfoIdxOfTxGrpSigInfo "" UBYTE NO_COMPU_METHOD 0 0 0 255 ECU_ADDRESS 0x0 /end MEASUREMENT
/begin MEASUREMENT Com_TxGrpSigInfo[68].TxSigGrpInfoIdxOfTxGrpSigInfo "" UBYTE NO_COMPU_METHOD 0 0 0 255 ECU_ADDRESS 0x0 /end MEASUREMENT
/begin MEASUREMENT Com_TxGrpSigInfo[68].WithoutRepOfTxGrpSigInfo "" UBYTE Com_WithoutRepOfTxGrpSigInfoType 0 0 0 1 ECU_ADDRESS 0x0 /end MEASUREMENT
/begin MEASUREMENT Com_TxGrpSigInfo[69].ApplTypeOfTxGrpSigInfo "" UBYTE Com_ApplTypeOfTxGrpSigInfoType 0 0 0 255 ECU_ADDRESS 0x0 /end MEASUREMENT
/begin MEASUREMENT Com_TxGrpSigInfo[69].BitLengthOfTxGrpSigInfo "" UBYTE NO_COMPU_METHOD 0 0 0 255 ECU_ADDRESS 0x0 /end MEASUREMENT
/begin MEASUREMENT Com_TxGrpSigInfo[69].BitPositionOfTxGrpSigInfo "" UWORD NO_COMPU_METHOD 0 0 0 65535 ECU_ADDRESS 0x0 /end MEASUREMENT
/begin MEASUREMENT Com_TxGrpSigInfo[69].BusAccOfTxGrpSigInfo "" UBYTE Com_BusAccOfTxGrpSigInfoType 0 0 0 255 ECU_ADDRESS 0x0 /end MEASUREMENT
/begin MEASUREMENT Com_TxGrpSigInfo[69].ByteLengthOfTxGrpSigInfo "" UBYTE NO_COMPU_METHOD 0 0 0 255 ECU_ADDRESS 0x0 /end MEASUREMENT
/begin MEASUREMENT Com_TxGrpSigInfo[69].DynSignalOfTxGrpSigInfo "" UBYTE Com_DynSignalOfTxGrpSigInfoType 0 0 0 1 ECU_ADDRESS 0x0 /end MEASUREMENT
/begin MEASUREMENT Com_TxGrpSigInfo[69].InvValueIdxOfTxGrpSigInfo "" UBYTE Com_InvValueIdxOfTxGrpSigInfoType 0 0 0 255 ECU_ADDRESS 0x0 /end MEASUREMENT
/begin MEASUREMENT Com_TxGrpSigInfo[69].InvValueOfTxGrpSigInfo "" UBYTE Com_InvValueOfTxGrpSigInfoType 0 0 0 255 ECU_ADDRESS 0x0 /end MEASUREMENT
/begin MEASUREMENT Com_TxGrpSigInfo[69].StartByteInPduPositionOfTxGrpSigInfo "" UBYTE NO_COMPU_METHOD 0 0 0 255 ECU_ADDRESS 0x0 /end MEASUREMENT
/begin MEASUREMENT Com_TxGrpSigInfo[69].TxBufferEndIdxOfTxGrpSigInfo "" UWORD Com_TxBufferEndIdxOfTxGrpSigInfoType 0 0 0 65535 ECU_ADDRESS 0x0 /end MEASUREMENT
/begin MEASUREMENT Com_TxGrpSigInfo[69].TxBufferStartIdxOfTxGrpSigInfo "" UWORD Com_TxBufferStartIdxOfTxGrpSigInfoType 0 0 0 65535 ECU_ADDRESS 0x0 /end MEASUREMENT
/begin MEASUREMENT Com_TxGrpSigInfo[69].TxPduInfoIdxOfTxGrpSigInfo "" UBYTE NO_COMPU_METHOD 0 0 0 255 ECU_ADDRESS 0x0 /end MEASUREMENT
/begin MEASUREMENT Com_TxGrpSigInfo[69].TxSigGrpInfoIdxOfTxGrpSigInfo "" UBYTE NO_COMPU_METHOD 0 0 0 255 ECU_ADDRESS 0x0 /end MEASUREMENT
/begin MEASUREMENT Com_TxGrpSigInfo[69].WithoutRepOfTxGrpSigInfo "" UBYTE Com_WithoutRepOfTxGrpSigInfoType 0 0 0 1 ECU_ADDRESS 0x0 /end MEASUREMENT
/begin MEASUREMENT Com_TxGrpSigInfo[6].ApplTypeOfTxGrpSigInfo "" UBYTE Com_ApplTypeOfTxGrpSigInfoType 0 0 0 255 ECU_ADDRESS 0x0 /end MEASUREMENT
/begin MEASUREMENT Com_TxGrpSigInfo[6].BitLengthOfTxGrpSigInfo "" UBYTE NO_COMPU_METHOD 0 0 0 255 ECU_ADDRESS 0x0 /end MEASUREMENT
/begin MEASUREMENT Com_TxGrpSigInfo[6].BitPositionOfTxGrpSigInfo "" UWORD NO_COMPU_METHOD 0 0 0 65535 ECU_ADDRESS 0x0 /end MEASUREMENT
/begin MEASUREMENT Com_TxGrpSigInfo[6].BusAccOfTxGrpSigInfo "" UBYTE Com_BusAccOfTxGrpSigInfoType 0 0 0 255 ECU_ADDRESS 0x0 /end MEASUREMENT
/begin MEASUREMENT Com_TxGrpSigInfo[6].ByteLengthOfTxGrpSigInfo "" UBYTE NO_COMPU_METHOD 0 0 0 255 ECU_ADDRESS 0x0 /end MEASUREMENT
/begin MEASUREMENT Com_TxGrpSigInfo[6].DynSignalOfTxGrpSigInfo "" UBYTE Com_DynSignalOfTxGrpSigInfoType 0 0 0 1 ECU_ADDRESS 0x0 /end MEASUREMENT
/begin MEASUREMENT Com_TxGrpSigInfo[6].InvValueIdxOfTxGrpSigInfo "" UBYTE Com_InvValueIdxOfTxGrpSigInfoType 0 0 0 255 ECU_ADDRESS 0x0 /end MEASUREMENT
/begin MEASUREMENT Com_TxGrpSigInfo[6].InvValueOfTxGrpSigInfo "" UBYTE Com_InvValueOfTxGrpSigInfoType 0 0 0 255 ECU_ADDRESS 0x0 /end MEASUREMENT
/begin MEASUREMENT Com_TxGrpSigInfo[6].StartByteInPduPositionOfTxGrpSigInfo "" UBYTE NO_COMPU_METHOD 0 0 0 255 ECU_ADDRESS 0x0 /end MEASUREMENT
/begin MEASUREMENT Com_TxGrpSigInfo[6].TxBufferEndIdxOfTxGrpSigInfo "" UWORD Com_TxBufferEndIdxOfTxGrpSigInfoType 0 0 0 65535 ECU_ADDRESS 0x0 /end MEASUREMENT
/begin MEASUREMENT Com_TxGrpSigInfo[6].TxBufferStartIdxOfTxGrpSigInfo "" UWORD Com_TxBufferStartIdxOfTxGrpSigInfoType 0 0 0 65535 ECU_ADDRESS 0x0 /end MEASUREMENT
/begin MEASUREMENT Com_TxGrpSigInfo[6].TxPduInfoIdxOfTxGrpSigInfo "" UBYTE NO_COMPU_METHOD 0 0 0 255 ECU_ADDRESS 0x0 /end MEASUREMENT
/begin MEASUREMENT Com_TxGrpSigInfo[6].TxSigGrpInfoIdxOfTxGrpSigInfo "" UBYTE NO_COMPU_METHOD 0 0 0 255 ECU_ADDRESS 0x0 /end MEASUREMENT
/begin MEASUREMENT Com_TxGrpSigInfo[6].WithoutRepOfTxGrpSigInfo "" UBYTE Com_WithoutRepOfTxGrpSigInfoType 0 0 0 1 ECU_ADDRESS 0x0 /end MEASUREMENT
/begin MEASUREMENT Com_TxGrpSigInfo[70].ApplTypeOfTxGrpSigInfo "" UBYTE Com_ApplTypeOfTxGrpSigInfoType 0 0 0 255 ECU_ADDRESS 0x0 /end MEASUREMENT
/begin MEASUREMENT Com_TxGrpSigInfo[70].BitLengthOfTxGrpSigInfo "" UBYTE NO_COMPU_METHOD 0 0 0 255 ECU_ADDRESS 0x0 /end MEASUREMENT
/begin MEASUREMENT Com_TxGrpSigInfo[70].BitPositionOfTxGrpSigInfo "" UWORD NO_COMPU_METHOD 0 0 0 65535 ECU_ADDRESS 0x0 /end MEASUREMENT
/begin MEASUREMENT Com_TxGrpSigInfo[70].BusAccOfTxGrpSigInfo "" UBYTE Com_BusAccOfTxGrpSigInfoType 0 0 0 255 ECU_ADDRESS 0x0 /end MEASUREMENT
/begin MEASUREMENT Com_TxGrpSigInfo[70].ByteLengthOfTxGrpSigInfo "" UBYTE NO_COMPU_METHOD 0 0 0 255 ECU_ADDRESS 0x0 /end MEASUREMENT
/begin MEASUREMENT Com_TxGrpSigInfo[70].DynSignalOfTxGrpSigInfo "" UBYTE Com_DynSignalOfTxGrpSigInfoType 0 0 0 1 ECU_ADDRESS 0x0 /end MEASUREMENT
/begin MEASUREMENT Com_TxGrpSigInfo[70].InvValueIdxOfTxGrpSigInfo "" UBYTE Com_InvValueIdxOfTxGrpSigInfoType 0 0 0 255 ECU_ADDRESS 0x0 /end MEASUREMENT
/begin MEASUREMENT Com_TxGrpSigInfo[70].InvValueOfTxGrpSigInfo "" UBYTE Com_InvValueOfTxGrpSigInfoType 0 0 0 255 ECU_ADDRESS 0x0 /end MEASUREMENT
/begin MEASUREMENT Com_TxGrpSigInfo[70].StartByteInPduPositionOfTxGrpSigInfo "" UBYTE NO_COMPU_METHOD 0 0 0 255 ECU_ADDRESS 0x0 /end MEASUREMENT
/begin MEASUREMENT Com_TxGrpSigInfo[70].TxBufferEndIdxOfTxGrpSigInfo "" UWORD Com_TxBufferEndIdxOfTxGrpSigInfoType 0 0 0 65535 ECU_ADDRESS 0x0 /end MEASUREMENT
/begin MEASUREMENT Com_TxGrpSigInfo[70].TxBufferStartIdxOfTxGrpSigInfo "" UWORD Com_TxBufferStartIdxOfTxGrpSigInfoType 0 0 0 65535 ECU_ADDRESS 0x0 /end MEASUREMENT
/begin MEASUREMENT Com_TxGrpSigInfo[70].TxPduInfoIdxOfTxGrpSigInfo "" UBYTE NO_COMPU_METHOD 0 0 0 255 ECU_ADDRESS 0x0 /end MEASUREMENT
/begin MEASUREMENT Com_TxGrpSigInfo[70].TxSigGrpInfoIdxOfTxGrpSigInfo "" UBYTE NO_COMPU_METHOD 0 0 0 255 ECU_ADDRESS 0x0 /end MEASUREMENT
/begin MEASUREMENT Com_TxGrpSigInfo[70].WithoutRepOfTxGrpSigInfo "" UBYTE Com_WithoutRepOfTxGrpSigInfoType 0 0 0 1 ECU_ADDRESS 0x0 /end MEASUREMENT
/begin MEASUREMENT Com_TxGrpSigInfo[71].ApplTypeOfTxGrpSigInfo "" UBYTE Com_ApplTypeOfTxGrpSigInfoType 0 0 0 255 ECU_ADDRESS 0x0 /end MEASUREMENT
/begin MEASUREMENT Com_TxGrpSigInfo[71].BitLengthOfTxGrpSigInfo "" UBYTE NO_COMPU_METHOD 0 0 0 255 ECU_ADDRESS 0x0 /end MEASUREMENT
/begin MEASUREMENT Com_TxGrpSigInfo[71].BitPositionOfTxGrpSigInfo "" UWORD NO_COMPU_METHOD 0 0 0 65535 ECU_ADDRESS 0x0 /end MEASUREMENT
/begin MEASUREMENT Com_TxGrpSigInfo[71].BusAccOfTxGrpSigInfo "" UBYTE Com_BusAccOfTxGrpSigInfoType 0 0 0 255 ECU_ADDRESS 0x0 /end MEASUREMENT
/begin MEASUREMENT Com_TxGrpSigInfo[71].ByteLengthOfTxGrpSigInfo "" UBYTE NO_COMPU_METHOD 0 0 0 255 ECU_ADDRESS 0x0 /end MEASUREMENT
/begin MEASUREMENT Com_TxGrpSigInfo[71].DynSignalOfTxGrpSigInfo "" UBYTE Com_DynSignalOfTxGrpSigInfoType 0 0 0 1 ECU_ADDRESS 0x0 /end MEASUREMENT
/begin MEASUREMENT Com_TxGrpSigInfo[71].InvValueIdxOfTxGrpSigInfo "" UBYTE Com_InvValueIdxOfTxGrpSigInfoType 0 0 0 255 ECU_ADDRESS 0x0 /end MEASUREMENT
/begin MEASUREMENT Com_TxGrpSigInfo[71].InvValueOfTxGrpSigInfo "" UBYTE Com_InvValueOfTxGrpSigInfoType 0 0 0 255 ECU_ADDRESS 0x0 /end MEASUREMENT
/begin MEASUREMENT Com_TxGrpSigInfo[71].StartByteInPduPositionOfTxGrpSigInfo "" UBYTE NO_COMPU_METHOD 0 0 0 255 ECU_ADDRESS 0x0 /end MEASUREMENT
/begin MEASUREMENT Com_TxGrpSigInfo[71].TxBufferEndIdxOfTxGrpSigInfo "" UWORD Com_TxBufferEndIdxOfTxGrpSigInfoType 0 0 0 65535 ECU_ADDRESS 0x0 /end MEASUREMENT
/begin MEASUREMENT Com_TxGrpSigInfo[71].TxBufferStartIdxOfTxGrpSigInfo "" UWORD Com_TxBufferStartIdxOfTxGrpSigInfoType 0 0 0 65535 ECU_ADDRESS 0x0 /end MEASUREMENT
/begin MEASUREMENT Com_TxGrpSigInfo[71].TxPduInfoIdxOfTxGrpSigInfo "" UBYTE NO_COMPU_METHOD 0 0 0 255 ECU_ADDRESS 0x0 /end MEASUREMENT
/begin MEASUREMENT Com_TxGrpSigInfo[71].TxSigGrpInfoIdxOfTxGrpSigInfo "" UBYTE NO_COMPU_METHOD 0 0 0 255 ECU_ADDRESS 0x0 /end MEASUREMENT
/begin MEASUREMENT Com_TxGrpSigInfo[71].WithoutRepOfTxGrpSigInfo "" UBYTE Com_WithoutRepOfTxGrpSigInfoType 0 0 0 1 ECU_ADDRESS 0x0 /end MEASUREMENT
/begin MEASUREMENT Com_TxGrpSigInfo[72].ApplTypeOfTxGrpSigInfo "" UBYTE Com_ApplTypeOfTxGrpSigInfoType 0 0 0 255 ECU_ADDRESS 0x0 /end MEASUREMENT
/begin MEASUREMENT Com_TxGrpSigInfo[72].BitLengthOfTxGrpSigInfo "" UBYTE NO_COMPU_METHOD 0 0 0 255 ECU_ADDRESS 0x0 /end MEASUREMENT
/begin MEASUREMENT Com_TxGrpSigInfo[72].BitPositionOfTxGrpSigInfo "" UWORD NO_COMPU_METHOD 0 0 0 65535 ECU_ADDRESS 0x0 /end MEASUREMENT
/begin MEASUREMENT Com_TxGrpSigInfo[72].BusAccOfTxGrpSigInfo "" UBYTE Com_BusAccOfTxGrpSigInfoType 0 0 0 255 ECU_ADDRESS 0x0 /end MEASUREMENT
/begin MEASUREMENT Com_TxGrpSigInfo[72].ByteLengthOfTxGrpSigInfo "" UBYTE NO_COMPU_METHOD 0 0 0 255 ECU_ADDRESS 0x0 /end MEASUREMENT
/begin MEASUREMENT Com_TxGrpSigInfo[72].DynSignalOfTxGrpSigInfo "" UBYTE Com_DynSignalOfTxGrpSigInfoType 0 0 0 1 ECU_ADDRESS 0x0 /end MEASUREMENT
/begin MEASUREMENT Com_TxGrpSigInfo[72].InvValueIdxOfTxGrpSigInfo "" UBYTE Com_InvValueIdxOfTxGrpSigInfoType 0 0 0 255 ECU_ADDRESS 0x0 /end MEASUREMENT
/begin MEASUREMENT Com_TxGrpSigInfo[72].InvValueOfTxGrpSigInfo "" UBYTE Com_InvValueOfTxGrpSigInfoType 0 0 0 255 ECU_ADDRESS 0x0 /end MEASUREMENT
/begin MEASUREMENT Com_TxGrpSigInfo[72].StartByteInPduPositionOfTxGrpSigInfo "" UBYTE NO_COMPU_METHOD 0 0 0 255 ECU_ADDRESS 0x0 /end MEASUREMENT
/begin MEASUREMENT Com_TxGrpSigInfo[72].TxBufferEndIdxOfTxGrpSigInfo "" UWORD Com_TxBufferEndIdxOfTxGrpSigInfoType 0 0 0 65535 ECU_ADDRESS 0x0 /end MEASUREMENT
/begin MEASUREMENT Com_TxGrpSigInfo[72].TxBufferStartIdxOfTxGrpSigInfo "" UWORD Com_TxBufferStartIdxOfTxGrpSigInfoType 0 0 0 65535 ECU_ADDRESS 0x0 /end MEASUREMENT
/begin MEASUREMENT Com_TxGrpSigInfo[72].TxPduInfoIdxOfTxGrpSigInfo "" UBYTE NO_COMPU_METHOD 0 0 0 255 ECU_ADDRESS 0x0 /end MEASUREMENT
/begin MEASUREMENT Com_TxGrpSigInfo[72].TxSigGrpInfoIdxOfTxGrpSigInfo "" UBYTE NO_COMPU_METHOD 0 0 0 255 ECU_ADDRESS 0x0 /end MEASUREMENT
/begin MEASUREMENT Com_TxGrpSigInfo[72].WithoutRepOfTxGrpSigInfo "" UBYTE Com_WithoutRepOfTxGrpSigInfoType 0 0 0 1 ECU_ADDRESS 0x0 /end MEASUREMENT
/begin MEASUREMENT Com_TxGrpSigInfo[73].ApplTypeOfTxGrpSigInfo "" UBYTE Com_ApplTypeOfTxGrpSigInfoType 0 0 0 255 ECU_ADDRESS 0x0 /end MEASUREMENT
/begin MEASUREMENT Com_TxGrpSigInfo[73].BitLengthOfTxGrpSigInfo "" UBYTE NO_COMPU_METHOD 0 0 0 255 ECU_ADDRESS 0x0 /end MEASUREMENT
/begin MEASUREMENT Com_TxGrpSigInfo[73].BitPositionOfTxGrpSigInfo "" UWORD NO_COMPU_METHOD 0 0 0 65535 ECU_ADDRESS 0x0 /end MEASUREMENT
/begin MEASUREMENT Com_TxGrpSigInfo[73].BusAccOfTxGrpSigInfo "" UBYTE Com_BusAccOfTxGrpSigInfoType 0 0 0 255 ECU_ADDRESS 0x0 /end MEASUREMENT
/begin MEASUREMENT Com_TxGrpSigInfo[73].ByteLengthOfTxGrpSigInfo "" UBYTE NO_COMPU_METHOD 0 0 0 255 ECU_ADDRESS 0x0 /end MEASUREMENT
/begin MEASUREMENT Com_TxGrpSigInfo[73].DynSignalOfTxGrpSigInfo "" UBYTE Com_DynSignalOfTxGrpSigInfoType 0 0 0 1 ECU_ADDRESS 0x0 /end MEASUREMENT
/begin MEASUREMENT Com_TxGrpSigInfo[73].InvValueIdxOfTxGrpSigInfo "" UBYTE Com_InvValueIdxOfTxGrpSigInfoType 0 0 0 255 ECU_ADDRESS 0x0 /end MEASUREMENT
/begin MEASUREMENT Com_TxGrpSigInfo[73].InvValueOfTxGrpSigInfo "" UBYTE Com_InvValueOfTxGrpSigInfoType 0 0 0 255 ECU_ADDRESS 0x0 /end MEASUREMENT
/begin MEASUREMENT Com_TxGrpSigInfo[73].StartByteInPduPositionOfTxGrpSigInfo "" UBYTE NO_COMPU_METHOD 0 0 0 255 ECU_ADDRESS 0x0 /end MEASUREMENT
/begin MEASUREMENT Com_TxGrpSigInfo[73].TxBufferEndIdxOfTxGrpSigInfo "" UWORD Com_TxBufferEndIdxOfTxGrpSigInfoType 0 0 0 65535 ECU_ADDRESS 0x0 /end MEASUREMENT
/begin MEASUREMENT Com_TxGrpSigInfo[73].TxBufferStartIdxOfTxGrpSigInfo "" UWORD Com_TxBufferStartIdxOfTxGrpSigInfoType 0 0 0 65535 ECU_ADDRESS 0x0 /end MEASUREMENT
/begin MEASUREMENT Com_TxGrpSigInfo[73].TxPduInfoIdxOfTxGrpSigInfo "" UBYTE NO_COMPU_METHOD 0 0 0 255 ECU_ADDRESS 0x0 /end MEASUREMENT
/begin MEASUREMENT Com_TxGrpSigInfo[73].TxSigGrpInfoIdxOfTxGrpSigInfo "" UBYTE NO_COMPU_METHOD 0 0 0 255 ECU_ADDRESS 0x0 /end MEASUREMENT
/begin MEASUREMENT Com_TxGrpSigInfo[73].WithoutRepOfTxGrpSigInfo "" UBYTE Com_WithoutRepOfTxGrpSigInfoType 0 0 0 1 ECU_ADDRESS 0x0 /end MEASUREMENT
/begin MEASUREMENT Com_TxGrpSigInfo[74].ApplTypeOfTxGrpSigInfo "" UBYTE Com_ApplTypeOfTxGrpSigInfoType 0 0 0 255 ECU_ADDRESS 0x0 /end MEASUREMENT
/begin MEASUREMENT Com_TxGrpSigInfo[74].BitLengthOfTxGrpSigInfo "" UBYTE NO_COMPU_METHOD 0 0 0 255 ECU_ADDRESS 0x0 /end MEASUREMENT
/begin MEASUREMENT Com_TxGrpSigInfo[74].BitPositionOfTxGrpSigInfo "" UWORD NO_COMPU_METHOD 0 0 0 65535 ECU_ADDRESS 0x0 /end MEASUREMENT
/begin MEASUREMENT Com_TxGrpSigInfo[74].BusAccOfTxGrpSigInfo "" UBYTE Com_BusAccOfTxGrpSigInfoType 0 0 0 255 ECU_ADDRESS 0x0 /end MEASUREMENT
/begin MEASUREMENT Com_TxGrpSigInfo[74].ByteLengthOfTxGrpSigInfo "" UBYTE NO_COMPU_METHOD 0 0 0 255 ECU_ADDRESS 0x0 /end MEASUREMENT
/begin MEASUREMENT Com_TxGrpSigInfo[74].DynSignalOfTxGrpSigInfo "" UBYTE Com_DynSignalOfTxGrpSigInfoType 0 0 0 1 ECU_ADDRESS 0x0 /end MEASUREMENT
/begin MEASUREMENT Com_TxGrpSigInfo[74].InvValueIdxOfTxGrpSigInfo "" UBYTE Com_InvValueIdxOfTxGrpSigInfoType 0 0 0 255 ECU_ADDRESS 0x0 /end MEASUREMENT
/begin MEASUREMENT Com_TxGrpSigInfo[74].InvValueOfTxGrpSigInfo "" UBYTE Com_InvValueOfTxGrpSigInfoType 0 0 0 255 ECU_ADDRESS 0x0 /end MEASUREMENT
/begin MEASUREMENT Com_TxGrpSigInfo[74].StartByteInPduPositionOfTxGrpSigInfo "" UBYTE NO_COMPU_METHOD 0 0 0 255 ECU_ADDRESS 0x0 /end MEASUREMENT
/begin MEASUREMENT Com_TxGrpSigInfo[74].TxBufferEndIdxOfTxGrpSigInfo "" UWORD Com_TxBufferEndIdxOfTxGrpSigInfoType 0 0 0 65535 ECU_ADDRESS 0x0 /end MEASUREMENT
/begin MEASUREMENT Com_TxGrpSigInfo[74].TxBufferStartIdxOfTxGrpSigInfo "" UWORD Com_TxBufferStartIdxOfTxGrpSigInfoType 0 0 0 65535 ECU_ADDRESS 0x0 /end MEASUREMENT
/begin MEASUREMENT Com_TxGrpSigInfo[74].TxPduInfoIdxOfTxGrpSigInfo "" UBYTE NO_COMPU_METHOD 0 0 0 255 ECU_ADDRESS 0x0 /end MEASUREMENT
/begin MEASUREMENT Com_TxGrpSigInfo[74].TxSigGrpInfoIdxOfTxGrpSigInfo "" UBYTE NO_COMPU_METHOD 0 0 0 255 ECU_ADDRESS 0x0 /end MEASUREMENT
/begin MEASUREMENT Com_TxGrpSigInfo[74].WithoutRepOfTxGrpSigInfo "" UBYTE Com_WithoutRepOfTxGrpSigInfoType 0 0 0 1 ECU_ADDRESS 0x0 /end MEASUREMENT
/begin MEASUREMENT Com_TxGrpSigInfo[75].ApplTypeOfTxGrpSigInfo "" UBYTE Com_ApplTypeOfTxGrpSigInfoType 0 0 0 255 ECU_ADDRESS 0x0 /end MEASUREMENT
/begin MEASUREMENT Com_TxGrpSigInfo[75].BitLengthOfTxGrpSigInfo "" UBYTE NO_COMPU_METHOD 0 0 0 255 ECU_ADDRESS 0x0 /end MEASUREMENT
/begin MEASUREMENT Com_TxGrpSigInfo[75].BitPositionOfTxGrpSigInfo "" UWORD NO_COMPU_METHOD 0 0 0 65535 ECU_ADDRESS 0x0 /end MEASUREMENT
/begin MEASUREMENT Com_TxGrpSigInfo[75].BusAccOfTxGrpSigInfo "" UBYTE Com_BusAccOfTxGrpSigInfoType 0 0 0 255 ECU_ADDRESS 0x0 /end MEASUREMENT
/begin MEASUREMENT Com_TxGrpSigInfo[75].ByteLengthOfTxGrpSigInfo "" UBYTE NO_COMPU_METHOD 0 0 0 255 ECU_ADDRESS 0x0 /end MEASUREMENT
/begin MEASUREMENT Com_TxGrpSigInfo[75].DynSignalOfTxGrpSigInfo "" UBYTE Com_DynSignalOfTxGrpSigInfoType 0 0 0 1 ECU_ADDRESS 0x0 /end MEASUREMENT
/begin MEASUREMENT Com_TxGrpSigInfo[75].InvValueIdxOfTxGrpSigInfo "" UBYTE Com_InvValueIdxOfTxGrpSigInfoType 0 0 0 255 ECU_ADDRESS 0x0 /end MEASUREMENT
/begin MEASUREMENT Com_TxGrpSigInfo[75].InvValueOfTxGrpSigInfo "" UBYTE Com_InvValueOfTxGrpSigInfoType 0 0 0 255 ECU_ADDRESS 0x0 /end MEASUREMENT
/begin MEASUREMENT Com_TxGrpSigInfo[75].StartByteInPduPositionOfTxGrpSigInfo "" UBYTE NO_COMPU_METHOD 0 0 0 255 ECU_ADDRESS 0x0 /end MEASUREMENT
/begin MEASUREMENT Com_TxGrpSigInfo[75].TxBufferEndIdxOfTxGrpSigInfo "" UWORD Com_TxBufferEndIdxOfTxGrpSigInfoType 0 0 0 65535 ECU_ADDRESS 0x0 /end MEASUREMENT
/begin MEASUREMENT Com_TxGrpSigInfo[75].TxBufferStartIdxOfTxGrpSigInfo "" UWORD Com_TxBufferStartIdxOfTxGrpSigInfoType 0 0 0 65535 ECU_ADDRESS 0x0 /end MEASUREMENT
/begin MEASUREMENT Com_TxGrpSigInfo[75].TxPduInfoIdxOfTxGrpSigInfo "" UBYTE NO_COMPU_METHOD 0 0 0 255 ECU_ADDRESS 0x0 /end MEASUREMENT
/begin MEASUREMENT Com_TxGrpSigInfo[75].TxSigGrpInfoIdxOfTxGrpSigInfo "" UBYTE NO_COMPU_METHOD 0 0 0 255 ECU_ADDRESS 0x0 /end MEASUREMENT
/begin MEASUREMENT Com_TxGrpSigInfo[75].WithoutRepOfTxGrpSigInfo "" UBYTE Com_WithoutRepOfTxGrpSigInfoType 0 0 0 1 ECU_ADDRESS 0x0 /end MEASUREMENT
/begin MEASUREMENT Com_TxGrpSigInfo[76].ApplTypeOfTxGrpSigInfo "" UBYTE Com_ApplTypeOfTxGrpSigInfoType 0 0 0 255 ECU_ADDRESS 0x0 /end MEASUREMENT
/begin MEASUREMENT Com_TxGrpSigInfo[76].BitLengthOfTxGrpSigInfo "" UBYTE NO_COMPU_METHOD 0 0 0 255 ECU_ADDRESS 0x0 /end MEASUREMENT
/begin MEASUREMENT Com_TxGrpSigInfo[76].BitPositionOfTxGrpSigInfo "" UWORD NO_COMPU_METHOD 0 0 0 65535 ECU_ADDRESS 0x0 /end MEASUREMENT
/begin MEASUREMENT Com_TxGrpSigInfo[76].BusAccOfTxGrpSigInfo "" UBYTE Com_BusAccOfTxGrpSigInfoType 0 0 0 255 ECU_ADDRESS 0x0 /end MEASUREMENT
/begin MEASUREMENT Com_TxGrpSigInfo[76].ByteLengthOfTxGrpSigInfo "" UBYTE NO_COMPU_METHOD 0 0 0 255 ECU_ADDRESS 0x0 /end MEASUREMENT
/begin MEASUREMENT Com_TxGrpSigInfo[76].DynSignalOfTxGrpSigInfo "" UBYTE Com_DynSignalOfTxGrpSigInfoType 0 0 0 1 ECU_ADDRESS 0x0 /end MEASUREMENT
/begin MEASUREMENT Com_TxGrpSigInfo[76].InvValueIdxOfTxGrpSigInfo "" UBYTE Com_InvValueIdxOfTxGrpSigInfoType 0 0 0 255 ECU_ADDRESS 0x0 /end MEASUREMENT
/begin MEASUREMENT Com_TxGrpSigInfo[76].InvValueOfTxGrpSigInfo "" UBYTE Com_InvValueOfTxGrpSigInfoType 0 0 0 255 ECU_ADDRESS 0x0 /end MEASUREMENT
/begin MEASUREMENT Com_TxGrpSigInfo[76].StartByteInPduPositionOfTxGrpSigInfo "" UBYTE NO_COMPU_METHOD 0 0 0 255 ECU_ADDRESS 0x0 /end MEASUREMENT
/begin MEASUREMENT Com_TxGrpSigInfo[76].TxBufferEndIdxOfTxGrpSigInfo "" UWORD Com_TxBufferEndIdxOfTxGrpSigInfoType 0 0 0 65535 ECU_ADDRESS 0x0 /end MEASUREMENT
/begin MEASUREMENT Com_TxGrpSigInfo[76].TxBufferStartIdxOfTxGrpSigInfo "" UWORD Com_TxBufferStartIdxOfTxGrpSigInfoType 0 0 0 65535 ECU_ADDRESS 0x0 /end MEASUREMENT
/begin MEASUREMENT Com_TxGrpSigInfo[76].TxPduInfoIdxOfTxGrpSigInfo "" UBYTE NO_COMPU_METHOD 0 0 0 255 ECU_ADDRESS 0x0 /end MEASUREMENT
/begin MEASUREMENT Com_TxGrpSigInfo[76].TxSigGrpInfoIdxOfTxGrpSigInfo "" UBYTE NO_COMPU_METHOD 0 0 0 255 ECU_ADDRESS 0x0 /end MEASUREMENT
/begin MEASUREMENT Com_TxGrpSigInfo[76].WithoutRepOfTxGrpSigInfo "" UBYTE Com_WithoutRepOfTxGrpSigInfoType 0 0 0 1 ECU_ADDRESS 0x0 /end MEASUREMENT
/begin MEASUREMENT Com_TxGrpSigInfo[77].ApplTypeOfTxGrpSigInfo "" UBYTE Com_ApplTypeOfTxGrpSigInfoType 0 0 0 255 ECU_ADDRESS 0x0 /end MEASUREMENT
/begin MEASUREMENT Com_TxGrpSigInfo[77].BitLengthOfTxGrpSigInfo "" UBYTE NO_COMPU_METHOD 0 0 0 255 ECU_ADDRESS 0x0 /end MEASUREMENT
/begin MEASUREMENT Com_TxGrpSigInfo[77].BitPositionOfTxGrpSigInfo "" UWORD NO_COMPU_METHOD 0 0 0 65535 ECU_ADDRESS 0x0 /end MEASUREMENT
/begin MEASUREMENT Com_TxGrpSigInfo[77].BusAccOfTxGrpSigInfo "" UBYTE Com_BusAccOfTxGrpSigInfoType 0 0 0 255 ECU_ADDRESS 0x0 /end MEASUREMENT
/begin MEASUREMENT Com_TxGrpSigInfo[77].ByteLengthOfTxGrpSigInfo "" UBYTE NO_COMPU_METHOD 0 0 0 255 ECU_ADDRESS 0x0 /end MEASUREMENT
/begin MEASUREMENT Com_TxGrpSigInfo[77].DynSignalOfTxGrpSigInfo "" UBYTE Com_DynSignalOfTxGrpSigInfoType 0 0 0 1 ECU_ADDRESS 0x0 /end MEASUREMENT
/begin MEASUREMENT Com_TxGrpSigInfo[77].InvValueIdxOfTxGrpSigInfo "" UBYTE Com_InvValueIdxOfTxGrpSigInfoType 0 0 0 255 ECU_ADDRESS 0x0 /end MEASUREMENT
/begin MEASUREMENT Com_TxGrpSigInfo[77].InvValueOfTxGrpSigInfo "" UBYTE Com_InvValueOfTxGrpSigInfoType 0 0 0 255 ECU_ADDRESS 0x0 /end MEASUREMENT
/begin MEASUREMENT Com_TxGrpSigInfo[77].StartByteInPduPositionOfTxGrpSigInfo "" UBYTE NO_COMPU_METHOD 0 0 0 255 ECU_ADDRESS 0x0 /end MEASUREMENT
/begin MEASUREMENT Com_TxGrpSigInfo[77].TxBufferEndIdxOfTxGrpSigInfo "" UWORD Com_TxBufferEndIdxOfTxGrpSigInfoType 0 0 0 65535 ECU_ADDRESS 0x0 /end MEASUREMENT
/begin MEASUREMENT Com_TxGrpSigInfo[77].TxBufferStartIdxOfTxGrpSigInfo "" UWORD Com_TxBufferStartIdxOfTxGrpSigInfoType 0 0 0 65535 ECU_ADDRESS 0x0 /end MEASUREMENT
/begin MEASUREMENT Com_TxGrpSigInfo[77].TxPduInfoIdxOfTxGrpSigInfo "" UBYTE NO_COMPU_METHOD 0 0 0 255 ECU_ADDRESS 0x0 /end MEASUREMENT
/begin MEASUREMENT Com_TxGrpSigInfo[77].TxSigGrpInfoIdxOfTxGrpSigInfo "" UBYTE NO_COMPU_METHOD 0 0 0 255 ECU_ADDRESS 0x0 /end MEASUREMENT
/begin MEASUREMENT Com_TxGrpSigInfo[77].WithoutRepOfTxGrpSigInfo "" UBYTE Com_WithoutRepOfTxGrpSigInfoType 0 0 0 1 ECU_ADDRESS 0x0 /end MEASUREMENT
/begin MEASUREMENT Com_TxGrpSigInfo[78].ApplTypeOfTxGrpSigInfo "" UBYTE Com_ApplTypeOfTxGrpSigInfoType 0 0 0 255 ECU_ADDRESS 0x0 /end MEASUREMENT
/begin MEASUREMENT Com_TxGrpSigInfo[78].BitLengthOfTxGrpSigInfo "" UBYTE NO_COMPU_METHOD 0 0 0 255 ECU_ADDRESS 0x0 /end MEASUREMENT
/begin MEASUREMENT Com_TxGrpSigInfo[78].BitPositionOfTxGrpSigInfo "" UWORD NO_COMPU_METHOD 0 0 0 65535 ECU_ADDRESS 0x0 /end MEASUREMENT
/begin MEASUREMENT Com_TxGrpSigInfo[78].BusAccOfTxGrpSigInfo "" UBYTE Com_BusAccOfTxGrpSigInfoType 0 0 0 255 ECU_ADDRESS 0x0 /end MEASUREMENT
/begin MEASUREMENT Com_TxGrpSigInfo[78].ByteLengthOfTxGrpSigInfo "" UBYTE NO_COMPU_METHOD 0 0 0 255 ECU_ADDRESS 0x0 /end MEASUREMENT
/begin MEASUREMENT Com_TxGrpSigInfo[78].DynSignalOfTxGrpSigInfo "" UBYTE Com_DynSignalOfTxGrpSigInfoType 0 0 0 1 ECU_ADDRESS 0x0 /end MEASUREMENT
/begin MEASUREMENT Com_TxGrpSigInfo[78].InvValueIdxOfTxGrpSigInfo "" UBYTE Com_InvValueIdxOfTxGrpSigInfoType 0 0 0 255 ECU_ADDRESS 0x0 /end MEASUREMENT
/begin MEASUREMENT Com_TxGrpSigInfo[78].InvValueOfTxGrpSigInfo "" UBYTE Com_InvValueOfTxGrpSigInfoType 0 0 0 255 ECU_ADDRESS 0x0 /end MEASUREMENT
/begin MEASUREMENT Com_TxGrpSigInfo[78].StartByteInPduPositionOfTxGrpSigInfo "" UBYTE NO_COMPU_METHOD 0 0 0 255 ECU_ADDRESS 0x0 /end MEASUREMENT
/begin MEASUREMENT Com_TxGrpSigInfo[78].TxBufferEndIdxOfTxGrpSigInfo "" UWORD Com_TxBufferEndIdxOfTxGrpSigInfoType 0 0 0 65535 ECU_ADDRESS 0x0 /end MEASUREMENT
/begin MEASUREMENT Com_TxGrpSigInfo[78].TxBufferStartIdxOfTxGrpSigInfo "" UWORD Com_TxBufferStartIdxOfTxGrpSigInfoType 0 0 0 65535 ECU_ADDRESS 0x0 /end MEASUREMENT
/begin MEASUREMENT Com_TxGrpSigInfo[78].TxPduInfoIdxOfTxGrpSigInfo "" UBYTE NO_COMPU_METHOD 0 0 0 255 ECU_ADDRESS 0x0 /end MEASUREMENT
/begin MEASUREMENT Com_TxGrpSigInfo[78].TxSigGrpInfoIdxOfTxGrpSigInfo "" UBYTE NO_COMPU_METHOD 0 0 0 255 ECU_ADDRESS 0x0 /end MEASUREMENT
/begin MEASUREMENT Com_TxGrpSigInfo[78].WithoutRepOfTxGrpSigInfo "" UBYTE Com_WithoutRepOfTxGrpSigInfoType 0 0 0 1 ECU_ADDRESS 0x0 /end MEASUREMENT
/begin MEASUREMENT Com_TxGrpSigInfo[79].ApplTypeOfTxGrpSigInfo "" UBYTE Com_ApplTypeOfTxGrpSigInfoType 0 0 0 255 ECU_ADDRESS 0x0 /end MEASUREMENT
/begin MEASUREMENT Com_TxGrpSigInfo[79].BitLengthOfTxGrpSigInfo "" UBYTE NO_COMPU_METHOD 0 0 0 255 ECU_ADDRESS 0x0 /end MEASUREMENT
/begin MEASUREMENT Com_TxGrpSigInfo[79].BitPositionOfTxGrpSigInfo "" UWORD NO_COMPU_METHOD 0 0 0 65535 ECU_ADDRESS 0x0 /end MEASUREMENT
/begin MEASUREMENT Com_TxGrpSigInfo[79].BusAccOfTxGrpSigInfo "" UBYTE Com_BusAccOfTxGrpSigInfoType 0 0 0 255 ECU_ADDRESS 0x0 /end MEASUREMENT
/begin MEASUREMENT Com_TxGrpSigInfo[79].ByteLengthOfTxGrpSigInfo "" UBYTE NO_COMPU_METHOD 0 0 0 255 ECU_ADDRESS 0x0 /end MEASUREMENT
/begin MEASUREMENT Com_TxGrpSigInfo[79].DynSignalOfTxGrpSigInfo "" UBYTE Com_DynSignalOfTxGrpSigInfoType 0 0 0 1 ECU_ADDRESS 0x0 /end MEASUREMENT
/begin MEASUREMENT Com_TxGrpSigInfo[79].InvValueIdxOfTxGrpSigInfo "" UBYTE Com_InvValueIdxOfTxGrpSigInfoType 0 0 0 255 ECU_ADDRESS 0x0 /end MEASUREMENT
/begin MEASUREMENT Com_TxGrpSigInfo[79].InvValueOfTxGrpSigInfo "" UBYTE Com_InvValueOfTxGrpSigInfoType 0 0 0 255 ECU_ADDRESS 0x0 /end MEASUREMENT
/begin MEASUREMENT Com_TxGrpSigInfo[79].StartByteInPduPositionOfTxGrpSigInfo "" UBYTE NO_COMPU_METHOD 0 0 0 255 ECU_ADDRESS 0x0 /end MEASUREMENT
/begin MEASUREMENT Com_TxGrpSigInfo[79].TxBufferEndIdxOfTxGrpSigInfo "" UWORD Com_TxBufferEndIdxOfTxGrpSigInfoType 0 0 0 65535 ECU_ADDRESS 0x0 /end MEASUREMENT
/begin MEASUREMENT Com_TxGrpSigInfo[79].TxBufferStartIdxOfTxGrpSigInfo "" UWORD Com_TxBufferStartIdxOfTxGrpSigInfoType 0 0 0 65535 ECU_ADDRESS 0x0 /end MEASUREMENT
/begin MEASUREMENT Com_TxGrpSigInfo[79].TxPduInfoIdxOfTxGrpSigInfo "" UBYTE NO_COMPU_METHOD 0 0 0 255 ECU_ADDRESS 0x0 /end MEASUREMENT
/begin MEASUREMENT Com_TxGrpSigInfo[79].TxSigGrpInfoIdxOfTxGrpSigInfo "" UBYTE NO_COMPU_METHOD 0 0 0 255 ECU_ADDRESS 0x0 /end MEASUREMENT
/begin MEASUREMENT Com_TxGrpSigInfo[79].WithoutRepOfTxGrpSigInfo "" UBYTE Com_WithoutRepOfTxGrpSigInfoType 0 0 0 1 ECU_ADDRESS 0x0 /end MEASUREMENT
/begin MEASUREMENT Com_TxGrpSigInfo[7].ApplTypeOfTxGrpSigInfo "" UBYTE Com_ApplTypeOfTxGrpSigInfoType 0 0 0 255 ECU_ADDRESS 0x0 /end MEASUREMENT
/begin MEASUREMENT Com_TxGrpSigInfo[7].BitLengthOfTxGrpSigInfo "" UBYTE NO_COMPU_METHOD 0 0 0 255 ECU_ADDRESS 0x0 /end MEASUREMENT
/begin MEASUREMENT Com_TxGrpSigInfo[7].BitPositionOfTxGrpSigInfo "" UWORD NO_COMPU_METHOD 0 0 0 65535 ECU_ADDRESS 0x0 /end MEASUREMENT
/begin MEASUREMENT Com_TxGrpSigInfo[7].BusAccOfTxGrpSigInfo "" UBYTE Com_BusAccOfTxGrpSigInfoType 0 0 0 255 ECU_ADDRESS 0x0 /end MEASUREMENT
/begin MEASUREMENT Com_TxGrpSigInfo[7].ByteLengthOfTxGrpSigInfo "" UBYTE NO_COMPU_METHOD 0 0 0 255 ECU_ADDRESS 0x0 /end MEASUREMENT
/begin MEASUREMENT Com_TxGrpSigInfo[7].DynSignalOfTxGrpSigInfo "" UBYTE Com_DynSignalOfTxGrpSigInfoType 0 0 0 1 ECU_ADDRESS 0x0 /end MEASUREMENT
/begin MEASUREMENT Com_TxGrpSigInfo[7].InvValueIdxOfTxGrpSigInfo "" UBYTE Com_InvValueIdxOfTxGrpSigInfoType 0 0 0 255 ECU_ADDRESS 0x0 /end MEASUREMENT
/begin MEASUREMENT Com_TxGrpSigInfo[7].InvValueOfTxGrpSigInfo "" UBYTE Com_InvValueOfTxGrpSigInfoType 0 0 0 255 ECU_ADDRESS 0x0 /end MEASUREMENT
/begin MEASUREMENT Com_TxGrpSigInfo[7].StartByteInPduPositionOfTxGrpSigInfo "" UBYTE NO_COMPU_METHOD 0 0 0 255 ECU_ADDRESS 0x0 /end MEASUREMENT
/begin MEASUREMENT Com_TxGrpSigInfo[7].TxBufferEndIdxOfTxGrpSigInfo "" UWORD Com_TxBufferEndIdxOfTxGrpSigInfoType 0 0 0 65535 ECU_ADDRESS 0x0 /end MEASUREMENT
/begin MEASUREMENT Com_TxGrpSigInfo[7].TxBufferStartIdxOfTxGrpSigInfo "" UWORD Com_TxBufferStartIdxOfTxGrpSigInfoType 0 0 0 65535 ECU_ADDRESS 0x0 /end MEASUREMENT
/begin MEASUREMENT Com_TxGrpSigInfo[7].TxPduInfoIdxOfTxGrpSigInfo "" UBYTE NO_COMPU_METHOD 0 0 0 255 ECU_ADDRESS 0x0 /end MEASUREMENT
/begin MEASUREMENT Com_TxGrpSigInfo[7].TxSigGrpInfoIdxOfTxGrpSigInfo "" UBYTE NO_COMPU_METHOD 0 0 0 255 ECU_ADDRESS 0x0 /end MEASUREMENT
/begin MEASUREMENT Com_TxGrpSigInfo[7].WithoutRepOfTxGrpSigInfo "" UBYTE Com_WithoutRepOfTxGrpSigInfoType 0 0 0 1 ECU_ADDRESS 0x0 /end MEASUREMENT
/begin MEASUREMENT Com_TxGrpSigInfo[80].ApplTypeOfTxGrpSigInfo "" UBYTE Com_ApplTypeOfTxGrpSigInfoType 0 0 0 255 ECU_ADDRESS 0x0 /end MEASUREMENT
/begin MEASUREMENT Com_TxGrpSigInfo[80].BitLengthOfTxGrpSigInfo "" UBYTE NO_COMPU_METHOD 0 0 0 255 ECU_ADDRESS 0x0 /end MEASUREMENT
/begin MEASUREMENT Com_TxGrpSigInfo[80].BitPositionOfTxGrpSigInfo "" UWORD NO_COMPU_METHOD 0 0 0 65535 ECU_ADDRESS 0x0 /end MEASUREMENT
/begin MEASUREMENT Com_TxGrpSigInfo[80].BusAccOfTxGrpSigInfo "" UBYTE Com_BusAccOfTxGrpSigInfoType 0 0 0 255 ECU_ADDRESS 0x0 /end MEASUREMENT
/begin MEASUREMENT Com_TxGrpSigInfo[80].ByteLengthOfTxGrpSigInfo "" UBYTE NO_COMPU_METHOD 0 0 0 255 ECU_ADDRESS 0x0 /end MEASUREMENT
/begin MEASUREMENT Com_TxGrpSigInfo[80].DynSignalOfTxGrpSigInfo "" UBYTE Com_DynSignalOfTxGrpSigInfoType 0 0 0 1 ECU_ADDRESS 0x0 /end MEASUREMENT
/begin MEASUREMENT Com_TxGrpSigInfo[80].InvValueIdxOfTxGrpSigInfo "" UBYTE Com_InvValueIdxOfTxGrpSigInfoType 0 0 0 255 ECU_ADDRESS 0x0 /end MEASUREMENT
/begin MEASUREMENT Com_TxGrpSigInfo[80].InvValueOfTxGrpSigInfo "" UBYTE Com_InvValueOfTxGrpSigInfoType 0 0 0 255 ECU_ADDRESS 0x0 /end MEASUREMENT
/begin MEASUREMENT Com_TxGrpSigInfo[80].StartByteInPduPositionOfTxGrpSigInfo "" UBYTE NO_COMPU_METHOD 0 0 0 255 ECU_ADDRESS 0x0 /end MEASUREMENT
/begin MEASUREMENT Com_TxGrpSigInfo[80].TxBufferEndIdxOfTxGrpSigInfo "" UWORD Com_TxBufferEndIdxOfTxGrpSigInfoType 0 0 0 65535 ECU_ADDRESS 0x0 /end MEASUREMENT
/begin MEASUREMENT Com_TxGrpSigInfo[80].TxBufferStartIdxOfTxGrpSigInfo "" UWORD Com_TxBufferStartIdxOfTxGrpSigInfoType 0 0 0 65535 ECU_ADDRESS 0x0 /end MEASUREMENT
/begin MEASUREMENT Com_TxGrpSigInfo[80].TxPduInfoIdxOfTxGrpSigInfo "" UBYTE NO_COMPU_METHOD 0 0 0 255 ECU_ADDRESS 0x0 /end MEASUREMENT
/begin MEASUREMENT Com_TxGrpSigInfo[80].TxSigGrpInfoIdxOfTxGrpSigInfo "" UBYTE NO_COMPU_METHOD 0 0 0 255 ECU_ADDRESS 0x0 /end MEASUREMENT
/begin MEASUREMENT Com_TxGrpSigInfo[80].WithoutRepOfTxGrpSigInfo "" UBYTE Com_WithoutRepOfTxGrpSigInfoType 0 0 0 1 ECU_ADDRESS 0x0 /end MEASUREMENT
/begin MEASUREMENT Com_TxGrpSigInfo[81].ApplTypeOfTxGrpSigInfo "" UBYTE Com_ApplTypeOfTxGrpSigInfoType 0 0 0 255 ECU_ADDRESS 0x0 /end MEASUREMENT
/begin MEASUREMENT Com_TxGrpSigInfo[81].BitLengthOfTxGrpSigInfo "" UBYTE NO_COMPU_METHOD 0 0 0 255 ECU_ADDRESS 0x0 /end MEASUREMENT
/begin MEASUREMENT Com_TxGrpSigInfo[81].BitPositionOfTxGrpSigInfo "" UWORD NO_COMPU_METHOD 0 0 0 65535 ECU_ADDRESS 0x0 /end MEASUREMENT
/begin MEASUREMENT Com_TxGrpSigInfo[81].BusAccOfTxGrpSigInfo "" UBYTE Com_BusAccOfTxGrpSigInfoType 0 0 0 255 ECU_ADDRESS 0x0 /end MEASUREMENT
/begin MEASUREMENT Com_TxGrpSigInfo[81].ByteLengthOfTxGrpSigInfo "" UBYTE NO_COMPU_METHOD 0 0 0 255 ECU_ADDRESS 0x0 /end MEASUREMENT
/begin MEASUREMENT Com_TxGrpSigInfo[81].DynSignalOfTxGrpSigInfo "" UBYTE Com_DynSignalOfTxGrpSigInfoType 0 0 0 1 ECU_ADDRESS 0x0 /end MEASUREMENT
/begin MEASUREMENT Com_TxGrpSigInfo[81].InvValueIdxOfTxGrpSigInfo "" UBYTE Com_InvValueIdxOfTxGrpSigInfoType 0 0 0 255 ECU_ADDRESS 0x0 /end MEASUREMENT
/begin MEASUREMENT Com_TxGrpSigInfo[81].InvValueOfTxGrpSigInfo "" UBYTE Com_InvValueOfTxGrpSigInfoType 0 0 0 255 ECU_ADDRESS 0x0 /end MEASUREMENT
/begin MEASUREMENT Com_TxGrpSigInfo[81].StartByteInPduPositionOfTxGrpSigInfo "" UBYTE NO_COMPU_METHOD 0 0 0 255 ECU_ADDRESS 0x0 /end MEASUREMENT
/begin MEASUREMENT Com_TxGrpSigInfo[81].TxBufferEndIdxOfTxGrpSigInfo "" UWORD Com_TxBufferEndIdxOfTxGrpSigInfoType 0 0 0 65535 ECU_ADDRESS 0x0 /end MEASUREMENT
/begin MEASUREMENT Com_TxGrpSigInfo[81].TxBufferStartIdxOfTxGrpSigInfo "" UWORD Com_TxBufferStartIdxOfTxGrpSigInfoType 0 0 0 65535 ECU_ADDRESS 0x0 /end MEASUREMENT
/begin MEASUREMENT Com_TxGrpSigInfo[81].TxPduInfoIdxOfTxGrpSigInfo "" UBYTE NO_COMPU_METHOD 0 0 0 255 ECU_ADDRESS 0x0 /end MEASUREMENT
/begin MEASUREMENT Com_TxGrpSigInfo[81].TxSigGrpInfoIdxOfTxGrpSigInfo "" UBYTE NO_COMPU_METHOD 0 0 0 255 ECU_ADDRESS 0x0 /end MEASUREMENT
/begin MEASUREMENT Com_TxGrpSigInfo[81].WithoutRepOfTxGrpSigInfo "" UBYTE Com_WithoutRepOfTxGrpSigInfoType 0 0 0 1 ECU_ADDRESS 0x0 /end MEASUREMENT
/begin MEASUREMENT Com_TxGrpSigInfo[82].ApplTypeOfTxGrpSigInfo "" UBYTE Com_ApplTypeOfTxGrpSigInfoType 0 0 0 255 ECU_ADDRESS 0x0 /end MEASUREMENT
/begin MEASUREMENT Com_TxGrpSigInfo[82].BitLengthOfTxGrpSigInfo "" UBYTE NO_COMPU_METHOD 0 0 0 255 ECU_ADDRESS 0x0 /end MEASUREMENT
/begin MEASUREMENT Com_TxGrpSigInfo[82].BitPositionOfTxGrpSigInfo "" UWORD NO_COMPU_METHOD 0 0 0 65535 ECU_ADDRESS 0x0 /end MEASUREMENT
/begin MEASUREMENT Com_TxGrpSigInfo[82].BusAccOfTxGrpSigInfo "" UBYTE Com_BusAccOfTxGrpSigInfoType 0 0 0 255 ECU_ADDRESS 0x0 /end MEASUREMENT
/begin MEASUREMENT Com_TxGrpSigInfo[82].ByteLengthOfTxGrpSigInfo "" UBYTE NO_COMPU_METHOD 0 0 0 255 ECU_ADDRESS 0x0 /end MEASUREMENT
/begin MEASUREMENT Com_TxGrpSigInfo[82].DynSignalOfTxGrpSigInfo "" UBYTE Com_DynSignalOfTxGrpSigInfoType 0 0 0 1 ECU_ADDRESS 0x0 /end MEASUREMENT
/begin MEASUREMENT Com_TxGrpSigInfo[82].InvValueIdxOfTxGrpSigInfo "" UBYTE Com_InvValueIdxOfTxGrpSigInfoType 0 0 0 255 ECU_ADDRESS 0x0 /end MEASUREMENT
/begin MEASUREMENT Com_TxGrpSigInfo[82].InvValueOfTxGrpSigInfo "" UBYTE Com_InvValueOfTxGrpSigInfoType 0 0 0 255 ECU_ADDRESS 0x0 /end MEASUREMENT
/begin MEASUREMENT Com_TxGrpSigInfo[82].StartByteInPduPositionOfTxGrpSigInfo "" UBYTE NO_COMPU_METHOD 0 0 0 255 ECU_ADDRESS 0x0 /end MEASUREMENT
/begin MEASUREMENT Com_TxGrpSigInfo[82].TxBufferEndIdxOfTxGrpSigInfo "" UWORD Com_TxBufferEndIdxOfTxGrpSigInfoType 0 0 0 65535 ECU_ADDRESS 0x0 /end MEASUREMENT
/begin MEASUREMENT Com_TxGrpSigInfo[82].TxBufferStartIdxOfTxGrpSigInfo "" UWORD Com_TxBufferStartIdxOfTxGrpSigInfoType 0 0 0 65535 ECU_ADDRESS 0x0 /end MEASUREMENT
/begin MEASUREMENT Com_TxGrpSigInfo[82].TxPduInfoIdxOfTxGrpSigInfo "" UBYTE NO_COMPU_METHOD 0 0 0 255 ECU_ADDRESS 0x0 /end MEASUREMENT
/begin MEASUREMENT Com_TxGrpSigInfo[82].TxSigGrpInfoIdxOfTxGrpSigInfo "" UBYTE NO_COMPU_METHOD 0 0 0 255 ECU_ADDRESS 0x0 /end MEASUREMENT
/begin MEASUREMENT Com_TxGrpSigInfo[82].WithoutRepOfTxGrpSigInfo "" UBYTE Com_WithoutRepOfTxGrpSigInfoType 0 0 0 1 ECU_ADDRESS 0x0 /end MEASUREMENT
/begin MEASUREMENT Com_TxGrpSigInfo[83].ApplTypeOfTxGrpSigInfo "" UBYTE Com_ApplTypeOfTxGrpSigInfoType 0 0 0 255 ECU_ADDRESS 0x0 /end MEASUREMENT
/begin MEASUREMENT Com_TxGrpSigInfo[83].BitLengthOfTxGrpSigInfo "" UBYTE NO_COMPU_METHOD 0 0 0 255 ECU_ADDRESS 0x0 /end MEASUREMENT
/begin MEASUREMENT Com_TxGrpSigInfo[83].BitPositionOfTxGrpSigInfo "" UWORD NO_COMPU_METHOD 0 0 0 65535 ECU_ADDRESS 0x0 /end MEASUREMENT
/begin MEASUREMENT Com_TxGrpSigInfo[83].BusAccOfTxGrpSigInfo "" UBYTE Com_BusAccOfTxGrpSigInfoType 0 0 0 255 ECU_ADDRESS 0x0 /end MEASUREMENT
/begin MEASUREMENT Com_TxGrpSigInfo[83].ByteLengthOfTxGrpSigInfo "" UBYTE NO_COMPU_METHOD 0 0 0 255 ECU_ADDRESS 0x0 /end MEASUREMENT
/begin MEASUREMENT Com_TxGrpSigInfo[83].DynSignalOfTxGrpSigInfo "" UBYTE Com_DynSignalOfTxGrpSigInfoType 0 0 0 1 ECU_ADDRESS 0x0 /end MEASUREMENT
/begin MEASUREMENT Com_TxGrpSigInfo[83].InvValueIdxOfTxGrpSigInfo "" UBYTE Com_InvValueIdxOfTxGrpSigInfoType 0 0 0 255 ECU_ADDRESS 0x0 /end MEASUREMENT
/begin MEASUREMENT Com_TxGrpSigInfo[83].InvValueOfTxGrpSigInfo "" UBYTE Com_InvValueOfTxGrpSigInfoType 0 0 0 255 ECU_ADDRESS 0x0 /end MEASUREMENT
/begin MEASUREMENT Com_TxGrpSigInfo[83].StartByteInPduPositionOfTxGrpSigInfo "" UBYTE NO_COMPU_METHOD 0 0 0 255 ECU_ADDRESS 0x0 /end MEASUREMENT
/begin MEASUREMENT Com_TxGrpSigInfo[83].TxBufferEndIdxOfTxGrpSigInfo "" UWORD Com_TxBufferEndIdxOfTxGrpSigInfoType 0 0 0 65535 ECU_ADDRESS 0x0 /end MEASUREMENT
/begin MEASUREMENT Com_TxGrpSigInfo[83].TxBufferStartIdxOfTxGrpSigInfo "" UWORD Com_TxBufferStartIdxOfTxGrpSigInfoType 0 0 0 65535 ECU_ADDRESS 0x0 /end MEASUREMENT
/begin MEASUREMENT Com_TxGrpSigInfo[83].TxPduInfoIdxOfTxGrpSigInfo "" UBYTE NO_COMPU_METHOD 0 0 0 255 ECU_ADDRESS 0x0 /end MEASUREMENT
/begin MEASUREMENT Com_TxGrpSigInfo[83].TxSigGrpInfoIdxOfTxGrpSigInfo "" UBYTE NO_COMPU_METHOD 0 0 0 255 ECU_ADDRESS 0x0 /end MEASUREMENT
/begin MEASUREMENT Com_TxGrpSigInfo[83].WithoutRepOfTxGrpSigInfo "" UBYTE Com_WithoutRepOfTxGrpSigInfoType 0 0 0 1 ECU_ADDRESS 0x0 /end MEASUREMENT
/begin MEASUREMENT Com_TxGrpSigInfo[84].ApplTypeOfTxGrpSigInfo "" UBYTE Com_ApplTypeOfTxGrpSigInfoType 0 0 0 255 ECU_ADDRESS 0x0 /end MEASUREMENT
/begin MEASUREMENT Com_TxGrpSigInfo[84].BitLengthOfTxGrpSigInfo "" UBYTE NO_COMPU_METHOD 0 0 0 255 ECU_ADDRESS 0x0 /end MEASUREMENT
/begin MEASUREMENT Com_TxGrpSigInfo[84].BitPositionOfTxGrpSigInfo "" UWORD NO_COMPU_METHOD 0 0 0 65535 ECU_ADDRESS 0x0 /end MEASUREMENT
/begin MEASUREMENT Com_TxGrpSigInfo[84].BusAccOfTxGrpSigInfo "" UBYTE Com_BusAccOfTxGrpSigInfoType 0 0 0 255 ECU_ADDRESS 0x0 /end MEASUREMENT
/begin MEASUREMENT Com_TxGrpSigInfo[84].ByteLengthOfTxGrpSigInfo "" UBYTE NO_COMPU_METHOD 0 0 0 255 ECU_ADDRESS 0x0 /end MEASUREMENT
/begin MEASUREMENT Com_TxGrpSigInfo[84].DynSignalOfTxGrpSigInfo "" UBYTE Com_DynSignalOfTxGrpSigInfoType 0 0 0 1 ECU_ADDRESS 0x0 /end MEASUREMENT
/begin MEASUREMENT Com_TxGrpSigInfo[84].InvValueIdxOfTxGrpSigInfo "" UBYTE Com_InvValueIdxOfTxGrpSigInfoType 0 0 0 255 ECU_ADDRESS 0x0 /end MEASUREMENT
/begin MEASUREMENT Com_TxGrpSigInfo[84].InvValueOfTxGrpSigInfo "" UBYTE Com_InvValueOfTxGrpSigInfoType 0 0 0 255 ECU_ADDRESS 0x0 /end MEASUREMENT
/begin MEASUREMENT Com_TxGrpSigInfo[84].StartByteInPduPositionOfTxGrpSigInfo "" UBYTE NO_COMPU_METHOD 0 0 0 255 ECU_ADDRESS 0x0 /end MEASUREMENT
/begin MEASUREMENT Com_TxGrpSigInfo[84].TxBufferEndIdxOfTxGrpSigInfo "" UWORD Com_TxBufferEndIdxOfTxGrpSigInfoType 0 0 0 65535 ECU_ADDRESS 0x0 /end MEASUREMENT
/begin MEASUREMENT Com_TxGrpSigInfo[84].TxBufferStartIdxOfTxGrpSigInfo "" UWORD Com_TxBufferStartIdxOfTxGrpSigInfoType 0 0 0 65535 ECU_ADDRESS 0x0 /end MEASUREMENT
/begin MEASUREMENT Com_TxGrpSigInfo[84].TxPduInfoIdxOfTxGrpSigInfo "" UBYTE NO_COMPU_METHOD 0 0 0 255 ECU_ADDRESS 0x0 /end MEASUREMENT
/begin MEASUREMENT Com_TxGrpSigInfo[84].TxSigGrpInfoIdxOfTxGrpSigInfo "" UBYTE NO_COMPU_METHOD 0 0 0 255 ECU_ADDRESS 0x0 /end MEASUREMENT
/begin MEASUREMENT Com_TxGrpSigInfo[84].WithoutRepOfTxGrpSigInfo "" UBYTE Com_WithoutRepOfTxGrpSigInfoType 0 0 0 1 ECU_ADDRESS 0x0 /end MEASUREMENT
/begin MEASUREMENT Com_TxGrpSigInfo[85].ApplTypeOfTxGrpSigInfo "" UBYTE Com_ApplTypeOfTxGrpSigInfoType 0 0 0 255 ECU_ADDRESS 0x0 /end MEASUREMENT
/begin MEASUREMENT Com_TxGrpSigInfo[85].BitLengthOfTxGrpSigInfo "" UBYTE NO_COMPU_METHOD 0 0 0 255 ECU_ADDRESS 0x0 /end MEASUREMENT
/begin MEASUREMENT Com_TxGrpSigInfo[85].BitPositionOfTxGrpSigInfo "" UWORD NO_COMPU_METHOD 0 0 0 65535 ECU_ADDRESS 0x0 /end MEASUREMENT
/begin MEASUREMENT Com_TxGrpSigInfo[85].BusAccOfTxGrpSigInfo "" UBYTE Com_BusAccOfTxGrpSigInfoType 0 0 0 255 ECU_ADDRESS 0x0 /end MEASUREMENT
/begin MEASUREMENT Com_TxGrpSigInfo[85].ByteLengthOfTxGrpSigInfo "" UBYTE NO_COMPU_METHOD 0 0 0 255 ECU_ADDRESS 0x0 /end MEASUREMENT
/begin MEASUREMENT Com_TxGrpSigInfo[85].DynSignalOfTxGrpSigInfo "" UBYTE Com_DynSignalOfTxGrpSigInfoType 0 0 0 1 ECU_ADDRESS 0x0 /end MEASUREMENT
/begin MEASUREMENT Com_TxGrpSigInfo[85].InvValueIdxOfTxGrpSigInfo "" UBYTE Com_InvValueIdxOfTxGrpSigInfoType 0 0 0 255 ECU_ADDRESS 0x0 /end MEASUREMENT
/begin MEASUREMENT Com_TxGrpSigInfo[85].InvValueOfTxGrpSigInfo "" UBYTE Com_InvValueOfTxGrpSigInfoType 0 0 0 255 ECU_ADDRESS 0x0 /end MEASUREMENT
/begin MEASUREMENT Com_TxGrpSigInfo[85].StartByteInPduPositionOfTxGrpSigInfo "" UBYTE NO_COMPU_METHOD 0 0 0 255 ECU_ADDRESS 0x0 /end MEASUREMENT
/begin MEASUREMENT Com_TxGrpSigInfo[85].TxBufferEndIdxOfTxGrpSigInfo "" UWORD Com_TxBufferEndIdxOfTxGrpSigInfoType 0 0 0 65535 ECU_ADDRESS 0x0 /end MEASUREMENT
/begin MEASUREMENT Com_TxGrpSigInfo[85].TxBufferStartIdxOfTxGrpSigInfo "" UWORD Com_TxBufferStartIdxOfTxGrpSigInfoType 0 0 0 65535 ECU_ADDRESS 0x0 /end MEASUREMENT
/begin MEASUREMENT Com_TxGrpSigInfo[85].TxPduInfoIdxOfTxGrpSigInfo "" UBYTE NO_COMPU_METHOD 0 0 0 255 ECU_ADDRESS 0x0 /end MEASUREMENT
/begin MEASUREMENT Com_TxGrpSigInfo[85].TxSigGrpInfoIdxOfTxGrpSigInfo "" UBYTE NO_COMPU_METHOD 0 0 0 255 ECU_ADDRESS 0x0 /end MEASUREMENT
/begin MEASUREMENT Com_TxGrpSigInfo[85].WithoutRepOfTxGrpSigInfo "" UBYTE Com_WithoutRepOfTxGrpSigInfoType 0 0 0 1 ECU_ADDRESS 0x0 /end MEASUREMENT
/begin MEASUREMENT Com_TxGrpSigInfo[86].ApplTypeOfTxGrpSigInfo "" UBYTE Com_ApplTypeOfTxGrpSigInfoType 0 0 0 255 ECU_ADDRESS 0x0 /end MEASUREMENT
/begin MEASUREMENT Com_TxGrpSigInfo[86].BitLengthOfTxGrpSigInfo "" UBYTE NO_COMPU_METHOD 0 0 0 255 ECU_ADDRESS 0x0 /end MEASUREMENT
/begin MEASUREMENT Com_TxGrpSigInfo[86].BitPositionOfTxGrpSigInfo "" UWORD NO_COMPU_METHOD 0 0 0 65535 ECU_ADDRESS 0x0 /end MEASUREMENT
/begin MEASUREMENT Com_TxGrpSigInfo[86].BusAccOfTxGrpSigInfo "" UBYTE Com_BusAccOfTxGrpSigInfoType 0 0 0 255 ECU_ADDRESS 0x0 /end MEASUREMENT
/begin MEASUREMENT Com_TxGrpSigInfo[86].ByteLengthOfTxGrpSigInfo "" UBYTE NO_COMPU_METHOD 0 0 0 255 ECU_ADDRESS 0x0 /end MEASUREMENT
/begin MEASUREMENT Com_TxGrpSigInfo[86].DynSignalOfTxGrpSigInfo "" UBYTE Com_DynSignalOfTxGrpSigInfoType 0 0 0 1 ECU_ADDRESS 0x0 /end MEASUREMENT
/begin MEASUREMENT Com_TxGrpSigInfo[86].InvValueIdxOfTxGrpSigInfo "" UBYTE Com_InvValueIdxOfTxGrpSigInfoType 0 0 0 255 ECU_ADDRESS 0x0 /end MEASUREMENT
/begin MEASUREMENT Com_TxGrpSigInfo[86].InvValueOfTxGrpSigInfo "" UBYTE Com_InvValueOfTxGrpSigInfoType 0 0 0 255 ECU_ADDRESS 0x0 /end MEASUREMENT
/begin MEASUREMENT Com_TxGrpSigInfo[86].StartByteInPduPositionOfTxGrpSigInfo "" UBYTE NO_COMPU_METHOD 0 0 0 255 ECU_ADDRESS 0x0 /end MEASUREMENT
/begin MEASUREMENT Com_TxGrpSigInfo[86].TxBufferEndIdxOfTxGrpSigInfo "" UWORD Com_TxBufferEndIdxOfTxGrpSigInfoType 0 0 0 65535 ECU_ADDRESS 0x0 /end MEASUREMENT
/begin MEASUREMENT Com_TxGrpSigInfo[86].TxBufferStartIdxOfTxGrpSigInfo "" UWORD Com_TxBufferStartIdxOfTxGrpSigInfoType 0 0 0 65535 ECU_ADDRESS 0x0 /end MEASUREMENT
/begin MEASUREMENT Com_TxGrpSigInfo[86].TxPduInfoIdxOfTxGrpSigInfo "" UBYTE NO_COMPU_METHOD 0 0 0 255 ECU_ADDRESS 0x0 /end MEASUREMENT
/begin MEASUREMENT Com_TxGrpSigInfo[86].TxSigGrpInfoIdxOfTxGrpSigInfo "" UBYTE NO_COMPU_METHOD 0 0 0 255 ECU_ADDRESS 0x0 /end MEASUREMENT
/begin MEASUREMENT Com_TxGrpSigInfo[86].WithoutRepOfTxGrpSigInfo "" UBYTE Com_WithoutRepOfTxGrpSigInfoType 0 0 0 1 ECU_ADDRESS 0x0 /end MEASUREMENT
/begin MEASUREMENT Com_TxGrpSigInfo[87].ApplTypeOfTxGrpSigInfo "" UBYTE Com_ApplTypeOfTxGrpSigInfoType 0 0 0 255 ECU_ADDRESS 0x0 /end MEASUREMENT
/begin MEASUREMENT Com_TxGrpSigInfo[87].BitLengthOfTxGrpSigInfo "" UBYTE NO_COMPU_METHOD 0 0 0 255 ECU_ADDRESS 0x0 /end MEASUREMENT
/begin MEASUREMENT Com_TxGrpSigInfo[87].BitPositionOfTxGrpSigInfo "" UWORD NO_COMPU_METHOD 0 0 0 65535 ECU_ADDRESS 0x0 /end MEASUREMENT
/begin MEASUREMENT Com_TxGrpSigInfo[87].BusAccOfTxGrpSigInfo "" UBYTE Com_BusAccOfTxGrpSigInfoType 0 0 0 255 ECU_ADDRESS 0x0 /end MEASUREMENT
/begin MEASUREMENT Com_TxGrpSigInfo[87].ByteLengthOfTxGrpSigInfo "" UBYTE NO_COMPU_METHOD 0 0 0 255 ECU_ADDRESS 0x0 /end MEASUREMENT
/begin MEASUREMENT Com_TxGrpSigInfo[87].DynSignalOfTxGrpSigInfo "" UBYTE Com_DynSignalOfTxGrpSigInfoType 0 0 0 1 ECU_ADDRESS 0x0 /end MEASUREMENT
/begin MEASUREMENT Com_TxGrpSigInfo[87].InvValueIdxOfTxGrpSigInfo "" UBYTE Com_InvValueIdxOfTxGrpSigInfoType 0 0 0 255 ECU_ADDRESS 0x0 /end MEASUREMENT
/begin MEASUREMENT Com_TxGrpSigInfo[87].InvValueOfTxGrpSigInfo "" UBYTE Com_InvValueOfTxGrpSigInfoType 0 0 0 255 ECU_ADDRESS 0x0 /end MEASUREMENT
/begin MEASUREMENT Com_TxGrpSigInfo[87].StartByteInPduPositionOfTxGrpSigInfo "" UBYTE NO_COMPU_METHOD 0 0 0 255 ECU_ADDRESS 0x0 /end MEASUREMENT
/begin MEASUREMENT Com_TxGrpSigInfo[87].TxBufferEndIdxOfTxGrpSigInfo "" UWORD Com_TxBufferEndIdxOfTxGrpSigInfoType 0 0 0 65535 ECU_ADDRESS 0x0 /end MEASUREMENT
/begin MEASUREMENT Com_TxGrpSigInfo[87].TxBufferStartIdxOfTxGrpSigInfo "" UWORD Com_TxBufferStartIdxOfTxGrpSigInfoType 0 0 0 65535 ECU_ADDRESS 0x0 /end MEASUREMENT
/begin MEASUREMENT Com_TxGrpSigInfo[87].TxPduInfoIdxOfTxGrpSigInfo "" UBYTE NO_COMPU_METHOD 0 0 0 255 ECU_ADDRESS 0x0 /end MEASUREMENT
/begin MEASUREMENT Com_TxGrpSigInfo[87].TxSigGrpInfoIdxOfTxGrpSigInfo "" UBYTE NO_COMPU_METHOD 0 0 0 255 ECU_ADDRESS 0x0 /end MEASUREMENT
/begin MEASUREMENT Com_TxGrpSigInfo[87].WithoutRepOfTxGrpSigInfo "" UBYTE Com_WithoutRepOfTxGrpSigInfoType 0 0 0 1 ECU_ADDRESS 0x0 /end MEASUREMENT
/begin MEASUREMENT Com_TxGrpSigInfo[88].ApplTypeOfTxGrpSigInfo "" UBYTE Com_ApplTypeOfTxGrpSigInfoType 0 0 0 255 ECU_ADDRESS 0x0 /end MEASUREMENT
/begin MEASUREMENT Com_TxGrpSigInfo[88].BitLengthOfTxGrpSigInfo "" UBYTE NO_COMPU_METHOD 0 0 0 255 ECU_ADDRESS 0x0 /end MEASUREMENT
/begin MEASUREMENT Com_TxGrpSigInfo[88].BitPositionOfTxGrpSigInfo "" UWORD NO_COMPU_METHOD 0 0 0 65535 ECU_ADDRESS 0x0 /end MEASUREMENT
/begin MEASUREMENT Com_TxGrpSigInfo[88].BusAccOfTxGrpSigInfo "" UBYTE Com_BusAccOfTxGrpSigInfoType 0 0 0 255 ECU_ADDRESS 0x0 /end MEASUREMENT
/begin MEASUREMENT Com_TxGrpSigInfo[88].ByteLengthOfTxGrpSigInfo "" UBYTE NO_COMPU_METHOD 0 0 0 255 ECU_ADDRESS 0x0 /end MEASUREMENT
/begin MEASUREMENT Com_TxGrpSigInfo[88].DynSignalOfTxGrpSigInfo "" UBYTE Com_DynSignalOfTxGrpSigInfoType 0 0 0 1 ECU_ADDRESS 0x0 /end MEASUREMENT
/begin MEASUREMENT Com_TxGrpSigInfo[88].InvValueIdxOfTxGrpSigInfo "" UBYTE Com_InvValueIdxOfTxGrpSigInfoType 0 0 0 255 ECU_ADDRESS 0x0 /end MEASUREMENT
/begin MEASUREMENT Com_TxGrpSigInfo[88].InvValueOfTxGrpSigInfo "" UBYTE Com_InvValueOfTxGrpSigInfoType 0 0 0 255 ECU_ADDRESS 0x0 /end MEASUREMENT
/begin MEASUREMENT Com_TxGrpSigInfo[88].StartByteInPduPositionOfTxGrpSigInfo "" UBYTE NO_COMPU_METHOD 0 0 0 255 ECU_ADDRESS 0x0 /end MEASUREMENT
/begin MEASUREMENT Com_TxGrpSigInfo[88].TxBufferEndIdxOfTxGrpSigInfo "" UWORD Com_TxBufferEndIdxOfTxGrpSigInfoType 0 0 0 65535 ECU_ADDRESS 0x0 /end MEASUREMENT
/begin MEASUREMENT Com_TxGrpSigInfo[88].TxBufferStartIdxOfTxGrpSigInfo "" UWORD Com_TxBufferStartIdxOfTxGrpSigInfoType 0 0 0 65535 ECU_ADDRESS 0x0 /end MEASUREMENT
/begin MEASUREMENT Com_TxGrpSigInfo[88].TxPduInfoIdxOfTxGrpSigInfo "" UBYTE NO_COMPU_METHOD 0 0 0 255 ECU_ADDRESS 0x0 /end MEASUREMENT
/begin MEASUREMENT Com_TxGrpSigInfo[88].TxSigGrpInfoIdxOfTxGrpSigInfo "" UBYTE NO_COMPU_METHOD 0 0 0 255 ECU_ADDRESS 0x0 /end MEASUREMENT
/begin MEASUREMENT Com_TxGrpSigInfo[88].WithoutRepOfTxGrpSigInfo "" UBYTE Com_WithoutRepOfTxGrpSigInfoType 0 0 0 1 ECU_ADDRESS 0x0 /end MEASUREMENT
/begin MEASUREMENT Com_TxGrpSigInfo[89].ApplTypeOfTxGrpSigInfo "" UBYTE Com_ApplTypeOfTxGrpSigInfoType 0 0 0 255 ECU_ADDRESS 0x0 /end MEASUREMENT
/begin MEASUREMENT Com_TxGrpSigInfo[89].BitLengthOfTxGrpSigInfo "" UBYTE NO_COMPU_METHOD 0 0 0 255 ECU_ADDRESS 0x0 /end MEASUREMENT
/begin MEASUREMENT Com_TxGrpSigInfo[89].BitPositionOfTxGrpSigInfo "" UWORD NO_COMPU_METHOD 0 0 0 65535 ECU_ADDRESS 0x0 /end MEASUREMENT
/begin MEASUREMENT Com_TxGrpSigInfo[89].BusAccOfTxGrpSigInfo "" UBYTE Com_BusAccOfTxGrpSigInfoType 0 0 0 255 ECU_ADDRESS 0x0 /end MEASUREMENT
/begin MEASUREMENT Com_TxGrpSigInfo[89].ByteLengthOfTxGrpSigInfo "" UBYTE NO_COMPU_METHOD 0 0 0 255 ECU_ADDRESS 0x0 /end MEASUREMENT
/begin MEASUREMENT Com_TxGrpSigInfo[89].DynSignalOfTxGrpSigInfo "" UBYTE Com_DynSignalOfTxGrpSigInfoType 0 0 0 1 ECU_ADDRESS 0x0 /end MEASUREMENT
/begin MEASUREMENT Com_TxGrpSigInfo[89].InvValueIdxOfTxGrpSigInfo "" UBYTE Com_InvValueIdxOfTxGrpSigInfoType 0 0 0 255 ECU_ADDRESS 0x0 /end MEASUREMENT
/begin MEASUREMENT Com_TxGrpSigInfo[89].InvValueOfTxGrpSigInfo "" UBYTE Com_InvValueOfTxGrpSigInfoType 0 0 0 255 ECU_ADDRESS 0x0 /end MEASUREMENT
/begin MEASUREMENT Com_TxGrpSigInfo[89].StartByteInPduPositionOfTxGrpSigInfo "" UBYTE NO_COMPU_METHOD 0 0 0 255 ECU_ADDRESS 0x0 /end MEASUREMENT
/begin MEASUREMENT Com_TxGrpSigInfo[89].TxBufferEndIdxOfTxGrpSigInfo "" UWORD Com_TxBufferEndIdxOfTxGrpSigInfoType 0 0 0 65535 ECU_ADDRESS 0x0 /end MEASUREMENT
/begin MEASUREMENT Com_TxGrpSigInfo[89].TxBufferStartIdxOfTxGrpSigInfo "" UWORD Com_TxBufferStartIdxOfTxGrpSigInfoType 0 0 0 65535 ECU_ADDRESS 0x0 /end MEASUREMENT
/begin MEASUREMENT Com_TxGrpSigInfo[89].TxPduInfoIdxOfTxGrpSigInfo "" UBYTE NO_COMPU_METHOD 0 0 0 255 ECU_ADDRESS 0x0 /end MEASUREMENT
/begin MEASUREMENT Com_TxGrpSigInfo[89].TxSigGrpInfoIdxOfTxGrpSigInfo "" UBYTE NO_COMPU_METHOD 0 0 0 255 ECU_ADDRESS 0x0 /end MEASUREMENT
/begin MEASUREMENT Com_TxGrpSigInfo[89].WithoutRepOfTxGrpSigInfo "" UBYTE Com_WithoutRepOfTxGrpSigInfoType 0 0 0 1 ECU_ADDRESS 0x0 /end MEASUREMENT
/begin MEASUREMENT Com_TxGrpSigInfo[8].ApplTypeOfTxGrpSigInfo "" UBYTE Com_ApplTypeOfTxGrpSigInfoType 0 0 0 255 ECU_ADDRESS 0x0 /end MEASUREMENT
/begin MEASUREMENT Com_TxGrpSigInfo[8].BitLengthOfTxGrpSigInfo "" UBYTE NO_COMPU_METHOD 0 0 0 255 ECU_ADDRESS 0x0 /end MEASUREMENT
/begin MEASUREMENT Com_TxGrpSigInfo[8].BitPositionOfTxGrpSigInfo "" UWORD NO_COMPU_METHOD 0 0 0 65535 ECU_ADDRESS 0x0 /end MEASUREMENT
/begin MEASUREMENT Com_TxGrpSigInfo[8].BusAccOfTxGrpSigInfo "" UBYTE Com_BusAccOfTxGrpSigInfoType 0 0 0 255 ECU_ADDRESS 0x0 /end MEASUREMENT
/begin MEASUREMENT Com_TxGrpSigInfo[8].ByteLengthOfTxGrpSigInfo "" UBYTE NO_COMPU_METHOD 0 0 0 255 ECU_ADDRESS 0x0 /end MEASUREMENT
/begin MEASUREMENT Com_TxGrpSigInfo[8].DynSignalOfTxGrpSigInfo "" UBYTE Com_DynSignalOfTxGrpSigInfoType 0 0 0 1 ECU_ADDRESS 0x0 /end MEASUREMENT
/begin MEASUREMENT Com_TxGrpSigInfo[8].InvValueIdxOfTxGrpSigInfo "" UBYTE Com_InvValueIdxOfTxGrpSigInfoType 0 0 0 255 ECU_ADDRESS 0x0 /end MEASUREMENT
/begin MEASUREMENT Com_TxGrpSigInfo[8].InvValueOfTxGrpSigInfo "" UBYTE Com_InvValueOfTxGrpSigInfoType 0 0 0 255 ECU_ADDRESS 0x0 /end MEASUREMENT
/begin MEASUREMENT Com_TxGrpSigInfo[8].StartByteInPduPositionOfTxGrpSigInfo "" UBYTE NO_COMPU_METHOD 0 0 0 255 ECU_ADDRESS 0x0 /end MEASUREMENT
/begin MEASUREMENT Com_TxGrpSigInfo[8].TxBufferEndIdxOfTxGrpSigInfo "" UWORD Com_TxBufferEndIdxOfTxGrpSigInfoType 0 0 0 65535 ECU_ADDRESS 0x0 /end MEASUREMENT
/begin MEASUREMENT Com_TxGrpSigInfo[8].TxBufferStartIdxOfTxGrpSigInfo "" UWORD Com_TxBufferStartIdxOfTxGrpSigInfoType 0 0 0 65535 ECU_ADDRESS 0x0 /end MEASUREMENT
/begin MEASUREMENT Com_TxGrpSigInfo[8].TxPduInfoIdxOfTxGrpSigInfo "" UBYTE NO_COMPU_METHOD 0 0 0 255 ECU_ADDRESS 0x0 /end MEASUREMENT
/begin MEASUREMENT Com_TxGrpSigInfo[8].TxSigGrpInfoIdxOfTxGrpSigInfo "" UBYTE NO_COMPU_METHOD 0 0 0 255 ECU_ADDRESS 0x0 /end MEASUREMENT
/begin MEASUREMENT Com_TxGrpSigInfo[8].WithoutRepOfTxGrpSigInfo "" UBYTE Com_WithoutRepOfTxGrpSigInfoType 0 0 0 1 ECU_ADDRESS 0x0 /end MEASUREMENT
/begin MEASUREMENT Com_TxGrpSigInfo[90].ApplTypeOfTxGrpSigInfo "" UBYTE Com_ApplTypeOfTxGrpSigInfoType 0 0 0 255 ECU_ADDRESS 0x0 /end MEASUREMENT
/begin MEASUREMENT Com_TxGrpSigInfo[90].BitLengthOfTxGrpSigInfo "" UBYTE NO_COMPU_METHOD 0 0 0 255 ECU_ADDRESS 0x0 /end MEASUREMENT
/begin MEASUREMENT Com_TxGrpSigInfo[90].BitPositionOfTxGrpSigInfo "" UWORD NO_COMPU_METHOD 0 0 0 65535 ECU_ADDRESS 0x0 /end MEASUREMENT
/begin MEASUREMENT Com_TxGrpSigInfo[90].BusAccOfTxGrpSigInfo "" UBYTE Com_BusAccOfTxGrpSigInfoType 0 0 0 255 ECU_ADDRESS 0x0 /end MEASUREMENT
/begin MEASUREMENT Com_TxGrpSigInfo[90].ByteLengthOfTxGrpSigInfo "" UBYTE NO_COMPU_METHOD 0 0 0 255 ECU_ADDRESS 0x0 /end MEASUREMENT
/begin MEASUREMENT Com_TxGrpSigInfo[90].DynSignalOfTxGrpSigInfo "" UBYTE Com_DynSignalOfTxGrpSigInfoType 0 0 0 1 ECU_ADDRESS 0x0 /end MEASUREMENT
/begin MEASUREMENT Com_TxGrpSigInfo[90].InvValueIdxOfTxGrpSigInfo "" UBYTE Com_InvValueIdxOfTxGrpSigInfoType 0 0 0 255 ECU_ADDRESS 0x0 /end MEASUREMENT
/begin MEASUREMENT Com_TxGrpSigInfo[90].InvValueOfTxGrpSigInfo "" UBYTE Com_InvValueOfTxGrpSigInfoType 0 0 0 255 ECU_ADDRESS 0x0 /end MEASUREMENT
/begin MEASUREMENT Com_TxGrpSigInfo[90].StartByteInPduPositionOfTxGrpSigInfo "" UBYTE NO_COMPU_METHOD 0 0 0 255 ECU_ADDRESS 0x0 /end MEASUREMENT
/begin MEASUREMENT Com_TxGrpSigInfo[90].TxBufferEndIdxOfTxGrpSigInfo "" UWORD Com_TxBufferEndIdxOfTxGrpSigInfoType 0 0 0 65535 ECU_ADDRESS 0x0 /end MEASUREMENT
/begin MEASUREMENT Com_TxGrpSigInfo[90].TxBufferStartIdxOfTxGrpSigInfo "" UWORD Com_TxBufferStartIdxOfTxGrpSigInfoType 0 0 0 65535 ECU_ADDRESS 0x0 /end MEASUREMENT
/begin MEASUREMENT Com_TxGrpSigInfo[90].TxPduInfoIdxOfTxGrpSigInfo "" UBYTE NO_COMPU_METHOD 0 0 0 255 ECU_ADDRESS 0x0 /end MEASUREMENT
/begin MEASUREMENT Com_TxGrpSigInfo[90].TxSigGrpInfoIdxOfTxGrpSigInfo "" UBYTE NO_COMPU_METHOD 0 0 0 255 ECU_ADDRESS 0x0 /end MEASUREMENT
/begin MEASUREMENT Com_TxGrpSigInfo[90].WithoutRepOfTxGrpSigInfo "" UBYTE Com_WithoutRepOfTxGrpSigInfoType 0 0 0 1 ECU_ADDRESS 0x0 /end MEASUREMENT
/begin MEASUREMENT Com_TxGrpSigInfo[91].ApplTypeOfTxGrpSigInfo "" UBYTE Com_ApplTypeOfTxGrpSigInfoType 0 0 0 255 ECU_ADDRESS 0x0 /end MEASUREMENT
/begin MEASUREMENT Com_TxGrpSigInfo[91].BitLengthOfTxGrpSigInfo "" UBYTE NO_COMPU_METHOD 0 0 0 255 ECU_ADDRESS 0x0 /end MEASUREMENT
/begin MEASUREMENT Com_TxGrpSigInfo[91].BitPositionOfTxGrpSigInfo "" UWORD NO_COMPU_METHOD 0 0 0 65535 ECU_ADDRESS 0x0 /end MEASUREMENT
/begin MEASUREMENT Com_TxGrpSigInfo[91].BusAccOfTxGrpSigInfo "" UBYTE Com_BusAccOfTxGrpSigInfoType 0 0 0 255 ECU_ADDRESS 0x0 /end MEASUREMENT
/begin MEASUREMENT Com_TxGrpSigInfo[91].ByteLengthOfTxGrpSigInfo "" UBYTE NO_COMPU_METHOD 0 0 0 255 ECU_ADDRESS 0x0 /end MEASUREMENT
/begin MEASUREMENT Com_TxGrpSigInfo[91].DynSignalOfTxGrpSigInfo "" UBYTE Com_DynSignalOfTxGrpSigInfoType 0 0 0 1 ECU_ADDRESS 0x0 /end MEASUREMENT
/begin MEASUREMENT Com_TxGrpSigInfo[91].InvValueIdxOfTxGrpSigInfo "" UBYTE Com_InvValueIdxOfTxGrpSigInfoType 0 0 0 255 ECU_ADDRESS 0x0 /end MEASUREMENT
/begin MEASUREMENT Com_TxGrpSigInfo[91].InvValueOfTxGrpSigInfo "" UBYTE Com_InvValueOfTxGrpSigInfoType 0 0 0 255 ECU_ADDRESS 0x0 /end MEASUREMENT
/begin MEASUREMENT Com_TxGrpSigInfo[91].StartByteInPduPositionOfTxGrpSigInfo "" UBYTE NO_COMPU_METHOD 0 0 0 255 ECU_ADDRESS 0x0 /end MEASUREMENT
/begin MEASUREMENT Com_TxGrpSigInfo[91].TxBufferEndIdxOfTxGrpSigInfo "" UWORD Com_TxBufferEndIdxOfTxGrpSigInfoType 0 0 0 65535 ECU_ADDRESS 0x0 /end MEASUREMENT
/begin MEASUREMENT Com_TxGrpSigInfo[91].TxBufferStartIdxOfTxGrpSigInfo "" UWORD Com_TxBufferStartIdxOfTxGrpSigInfoType 0 0 0 65535 ECU_ADDRESS 0x0 /end MEASUREMENT
/begin MEASUREMENT Com_TxGrpSigInfo[91].TxPduInfoIdxOfTxGrpSigInfo "" UBYTE NO_COMPU_METHOD 0 0 0 255 ECU_ADDRESS 0x0 /end MEASUREMENT
/begin MEASUREMENT Com_TxGrpSigInfo[91].TxSigGrpInfoIdxOfTxGrpSigInfo "" UBYTE NO_COMPU_METHOD 0 0 0 255 ECU_ADDRESS 0x0 /end MEASUREMENT
/begin MEASUREMENT Com_TxGrpSigInfo[91].WithoutRepOfTxGrpSigInfo "" UBYTE Com_WithoutRepOfTxGrpSigInfoType 0 0 0 1 ECU_ADDRESS 0x0 /end MEASUREMENT
/begin MEASUREMENT Com_TxGrpSigInfo[92].ApplTypeOfTxGrpSigInfo "" UBYTE Com_ApplTypeOfTxGrpSigInfoType 0 0 0 255 ECU_ADDRESS 0x0 /end MEASUREMENT
/begin MEASUREMENT Com_TxGrpSigInfo[92].BitLengthOfTxGrpSigInfo "" UBYTE NO_COMPU_METHOD 0 0 0 255 ECU_ADDRESS 0x0 /end MEASUREMENT
/begin MEASUREMENT Com_TxGrpSigInfo[92].BitPositionOfTxGrpSigInfo "" UWORD NO_COMPU_METHOD 0 0 0 65535 ECU_ADDRESS 0x0 /end MEASUREMENT
/begin MEASUREMENT Com_TxGrpSigInfo[92].BusAccOfTxGrpSigInfo "" UBYTE Com_BusAccOfTxGrpSigInfoType 0 0 0 255 ECU_ADDRESS 0x0 /end MEASUREMENT
/begin MEASUREMENT Com_TxGrpSigInfo[92].ByteLengthOfTxGrpSigInfo "" UBYTE NO_COMPU_METHOD 0 0 0 255 ECU_ADDRESS 0x0 /end MEASUREMENT
/begin MEASUREMENT Com_TxGrpSigInfo[92].DynSignalOfTxGrpSigInfo "" UBYTE Com_DynSignalOfTxGrpSigInfoType 0 0 0 1 ECU_ADDRESS 0x0 /end MEASUREMENT
/begin MEASUREMENT Com_TxGrpSigInfo[92].InvValueIdxOfTxGrpSigInfo "" UBYTE Com_InvValueIdxOfTxGrpSigInfoType 0 0 0 255 ECU_ADDRESS 0x0 /end MEASUREMENT
/begin MEASUREMENT Com_TxGrpSigInfo[92].InvValueOfTxGrpSigInfo "" UBYTE Com_InvValueOfTxGrpSigInfoType 0 0 0 255 ECU_ADDRESS 0x0 /end MEASUREMENT
/begin MEASUREMENT Com_TxGrpSigInfo[92].StartByteInPduPositionOfTxGrpSigInfo "" UBYTE NO_COMPU_METHOD 0 0 0 255 ECU_ADDRESS 0x0 /end MEASUREMENT
/begin MEASUREMENT Com_TxGrpSigInfo[92].TxBufferEndIdxOfTxGrpSigInfo "" UWORD Com_TxBufferEndIdxOfTxGrpSigInfoType 0 0 0 65535 ECU_ADDRESS 0x0 /end MEASUREMENT
/begin MEASUREMENT Com_TxGrpSigInfo[92].TxBufferStartIdxOfTxGrpSigInfo "" UWORD Com_TxBufferStartIdxOfTxGrpSigInfoType 0 0 0 65535 ECU_ADDRESS 0x0 /end MEASUREMENT
/begin MEASUREMENT Com_TxGrpSigInfo[92].TxPduInfoIdxOfTxGrpSigInfo "" UBYTE NO_COMPU_METHOD 0 0 0 255 ECU_ADDRESS 0x0 /end MEASUREMENT
/begin MEASUREMENT Com_TxGrpSigInfo[92].TxSigGrpInfoIdxOfTxGrpSigInfo "" UBYTE NO_COMPU_METHOD 0 0 0 255 ECU_ADDRESS 0x0 /end MEASUREMENT
/begin MEASUREMENT Com_TxGrpSigInfo[92].WithoutRepOfTxGrpSigInfo "" UBYTE Com_WithoutRepOfTxGrpSigInfoType 0 0 0 1 ECU_ADDRESS 0x0 /end MEASUREMENT
/begin MEASUREMENT Com_TxGrpSigInfo[93].ApplTypeOfTxGrpSigInfo "" UBYTE Com_ApplTypeOfTxGrpSigInfoType 0 0 0 255 ECU_ADDRESS 0x0 /end MEASUREMENT
/begin MEASUREMENT Com_TxGrpSigInfo[93].BitLengthOfTxGrpSigInfo "" UBYTE NO_COMPU_METHOD 0 0 0 255 ECU_ADDRESS 0x0 /end MEASUREMENT
/begin MEASUREMENT Com_TxGrpSigInfo[93].BitPositionOfTxGrpSigInfo "" UWORD NO_COMPU_METHOD 0 0 0 65535 ECU_ADDRESS 0x0 /end MEASUREMENT
/begin MEASUREMENT Com_TxGrpSigInfo[93].BusAccOfTxGrpSigInfo "" UBYTE Com_BusAccOfTxGrpSigInfoType 0 0 0 255 ECU_ADDRESS 0x0 /end MEASUREMENT
/begin MEASUREMENT Com_TxGrpSigInfo[93].ByteLengthOfTxGrpSigInfo "" UBYTE NO_COMPU_METHOD 0 0 0 255 ECU_ADDRESS 0x0 /end MEASUREMENT
/begin MEASUREMENT Com_TxGrpSigInfo[93].DynSignalOfTxGrpSigInfo "" UBYTE Com_DynSignalOfTxGrpSigInfoType 0 0 0 1 ECU_ADDRESS 0x0 /end MEASUREMENT
/begin MEASUREMENT Com_TxGrpSigInfo[93].InvValueIdxOfTxGrpSigInfo "" UBYTE Com_InvValueIdxOfTxGrpSigInfoType 0 0 0 255 ECU_ADDRESS 0x0 /end MEASUREMENT
/begin MEASUREMENT Com_TxGrpSigInfo[93].InvValueOfTxGrpSigInfo "" UBYTE Com_InvValueOfTxGrpSigInfoType 0 0 0 255 ECU_ADDRESS 0x0 /end MEASUREMENT
/begin MEASUREMENT Com_TxGrpSigInfo[93].StartByteInPduPositionOfTxGrpSigInfo "" UBYTE NO_COMPU_METHOD 0 0 0 255 ECU_ADDRESS 0x0 /end MEASUREMENT
/begin MEASUREMENT Com_TxGrpSigInfo[93].TxBufferEndIdxOfTxGrpSigInfo "" UWORD Com_TxBufferEndIdxOfTxGrpSigInfoType 0 0 0 65535 ECU_ADDRESS 0x0 /end MEASUREMENT
/begin MEASUREMENT Com_TxGrpSigInfo[93].TxBufferStartIdxOfTxGrpSigInfo "" UWORD Com_TxBufferStartIdxOfTxGrpSigInfoType 0 0 0 65535 ECU_ADDRESS 0x0 /end MEASUREMENT
/begin MEASUREMENT Com_TxGrpSigInfo[93].TxPduInfoIdxOfTxGrpSigInfo "" UBYTE NO_COMPU_METHOD 0 0 0 255 ECU_ADDRESS 0x0 /end MEASUREMENT
/begin MEASUREMENT Com_TxGrpSigInfo[93].TxSigGrpInfoIdxOfTxGrpSigInfo "" UBYTE NO_COMPU_METHOD 0 0 0 255 ECU_ADDRESS 0x0 /end MEASUREMENT
/begin MEASUREMENT Com_TxGrpSigInfo[93].WithoutRepOfTxGrpSigInfo "" UBYTE Com_WithoutRepOfTxGrpSigInfoType 0 0 0 1 ECU_ADDRESS 0x0 /end MEASUREMENT
/begin MEASUREMENT Com_TxGrpSigInfo[94].ApplTypeOfTxGrpSigInfo "" UBYTE Com_ApplTypeOfTxGrpSigInfoType 0 0 0 255 ECU_ADDRESS 0x0 /end MEASUREMENT
/begin MEASUREMENT Com_TxGrpSigInfo[94].BitLengthOfTxGrpSigInfo "" UBYTE NO_COMPU_METHOD 0 0 0 255 ECU_ADDRESS 0x0 /end MEASUREMENT
/begin MEASUREMENT Com_TxGrpSigInfo[94].BitPositionOfTxGrpSigInfo "" UWORD NO_COMPU_METHOD 0 0 0 65535 ECU_ADDRESS 0x0 /end MEASUREMENT
/begin MEASUREMENT Com_TxGrpSigInfo[94].BusAccOfTxGrpSigInfo "" UBYTE Com_BusAccOfTxGrpSigInfoType 0 0 0 255 ECU_ADDRESS 0x0 /end MEASUREMENT
/begin MEASUREMENT Com_TxGrpSigInfo[94].ByteLengthOfTxGrpSigInfo "" UBYTE NO_COMPU_METHOD 0 0 0 255 ECU_ADDRESS 0x0 /end MEASUREMENT
/begin MEASUREMENT Com_TxGrpSigInfo[94].DynSignalOfTxGrpSigInfo "" UBYTE Com_DynSignalOfTxGrpSigInfoType 0 0 0 1 ECU_ADDRESS 0x0 /end MEASUREMENT
/begin MEASUREMENT Com_TxGrpSigInfo[94].InvValueIdxOfTxGrpSigInfo "" UBYTE Com_InvValueIdxOfTxGrpSigInfoType 0 0 0 255 ECU_ADDRESS 0x0 /end MEASUREMENT
/begin MEASUREMENT Com_TxGrpSigInfo[94].InvValueOfTxGrpSigInfo "" UBYTE Com_InvValueOfTxGrpSigInfoType 0 0 0 255 ECU_ADDRESS 0x0 /end MEASUREMENT
/begin MEASUREMENT Com_TxGrpSigInfo[94].StartByteInPduPositionOfTxGrpSigInfo "" UBYTE NO_COMPU_METHOD 0 0 0 255 ECU_ADDRESS 0x0 /end MEASUREMENT
/begin MEASUREMENT Com_TxGrpSigInfo[94].TxBufferEndIdxOfTxGrpSigInfo "" UWORD Com_TxBufferEndIdxOfTxGrpSigInfoType 0 0 0 65535 ECU_ADDRESS 0x0 /end MEASUREMENT
/begin MEASUREMENT Com_TxGrpSigInfo[94].TxBufferStartIdxOfTxGrpSigInfo "" UWORD Com_TxBufferStartIdxOfTxGrpSigInfoType 0 0 0 65535 ECU_ADDRESS 0x0 /end MEASUREMENT
/begin MEASUREMENT Com_TxGrpSigInfo[94].TxPduInfoIdxOfTxGrpSigInfo "" UBYTE NO_COMPU_METHOD 0 0 0 255 ECU_ADDRESS 0x0 /end MEASUREMENT
/begin MEASUREMENT Com_TxGrpSigInfo[94].TxSigGrpInfoIdxOfTxGrpSigInfo "" UBYTE NO_COMPU_METHOD 0 0 0 255 ECU_ADDRESS 0x0 /end MEASUREMENT
/begin MEASUREMENT Com_TxGrpSigInfo[94].WithoutRepOfTxGrpSigInfo "" UBYTE Com_WithoutRepOfTxGrpSigInfoType 0 0 0 1 ECU_ADDRESS 0x0 /end MEASUREMENT
/begin MEASUREMENT Com_TxGrpSigInfo[95].ApplTypeOfTxGrpSigInfo "" UBYTE Com_ApplTypeOfTxGrpSigInfoType 0 0 0 255 ECU_ADDRESS 0x0 /end MEASUREMENT
/begin MEASUREMENT Com_TxGrpSigInfo[95].BitLengthOfTxGrpSigInfo "" UBYTE NO_COMPU_METHOD 0 0 0 255 ECU_ADDRESS 0x0 /end MEASUREMENT
/begin MEASUREMENT Com_TxGrpSigInfo[95].BitPositionOfTxGrpSigInfo "" UWORD NO_COMPU_METHOD 0 0 0 65535 ECU_ADDRESS 0x0 /end MEASUREMENT
/begin MEASUREMENT Com_TxGrpSigInfo[95].BusAccOfTxGrpSigInfo "" UBYTE Com_BusAccOfTxGrpSigInfoType 0 0 0 255 ECU_ADDRESS 0x0 /end MEASUREMENT
/begin MEASUREMENT Com_TxGrpSigInfo[95].ByteLengthOfTxGrpSigInfo "" UBYTE NO_COMPU_METHOD 0 0 0 255 ECU_ADDRESS 0x0 /end MEASUREMENT
/begin MEASUREMENT Com_TxGrpSigInfo[95].DynSignalOfTxGrpSigInfo "" UBYTE Com_DynSignalOfTxGrpSigInfoType 0 0 0 1 ECU_ADDRESS 0x0 /end MEASUREMENT
/begin MEASUREMENT Com_TxGrpSigInfo[95].InvValueIdxOfTxGrpSigInfo "" UBYTE Com_InvValueIdxOfTxGrpSigInfoType 0 0 0 255 ECU_ADDRESS 0x0 /end MEASUREMENT
/begin MEASUREMENT Com_TxGrpSigInfo[95].InvValueOfTxGrpSigInfo "" UBYTE Com_InvValueOfTxGrpSigInfoType 0 0 0 255 ECU_ADDRESS 0x0 /end MEASUREMENT
/begin MEASUREMENT Com_TxGrpSigInfo[95].StartByteInPduPositionOfTxGrpSigInfo "" UBYTE NO_COMPU_METHOD 0 0 0 255 ECU_ADDRESS 0x0 /end MEASUREMENT
/begin MEASUREMENT Com_TxGrpSigInfo[95].TxBufferEndIdxOfTxGrpSigInfo "" UWORD Com_TxBufferEndIdxOfTxGrpSigInfoType 0 0 0 65535 ECU_ADDRESS 0x0 /end MEASUREMENT
/begin MEASUREMENT Com_TxGrpSigInfo[95].TxBufferStartIdxOfTxGrpSigInfo "" UWORD Com_TxBufferStartIdxOfTxGrpSigInfoType 0 0 0 65535 ECU_ADDRESS 0x0 /end MEASUREMENT
/begin MEASUREMENT Com_TxGrpSigInfo[95].TxPduInfoIdxOfTxGrpSigInfo "" UBYTE NO_COMPU_METHOD 0 0 0 255 ECU_ADDRESS 0x0 /end MEASUREMENT
/begin MEASUREMENT Com_TxGrpSigInfo[95].TxSigGrpInfoIdxOfTxGrpSigInfo "" UBYTE NO_COMPU_METHOD 0 0 0 255 ECU_ADDRESS 0x0 /end MEASUREMENT
/begin MEASUREMENT Com_TxGrpSigInfo[95].WithoutRepOfTxGrpSigInfo "" UBYTE Com_WithoutRepOfTxGrpSigInfoType 0 0 0 1 ECU_ADDRESS 0x0 /end MEASUREMENT
/begin MEASUREMENT Com_TxGrpSigInfo[96].ApplTypeOfTxGrpSigInfo "" UBYTE Com_ApplTypeOfTxGrpSigInfoType 0 0 0 255 ECU_ADDRESS 0x0 /end MEASUREMENT
/begin MEASUREMENT Com_TxGrpSigInfo[96].BitLengthOfTxGrpSigInfo "" UBYTE NO_COMPU_METHOD 0 0 0 255 ECU_ADDRESS 0x0 /end MEASUREMENT
/begin MEASUREMENT Com_TxGrpSigInfo[96].BitPositionOfTxGrpSigInfo "" UWORD NO_COMPU_METHOD 0 0 0 65535 ECU_ADDRESS 0x0 /end MEASUREMENT
/begin MEASUREMENT Com_TxGrpSigInfo[96].BusAccOfTxGrpSigInfo "" UBYTE Com_BusAccOfTxGrpSigInfoType 0 0 0 255 ECU_ADDRESS 0x0 /end MEASUREMENT
/begin MEASUREMENT Com_TxGrpSigInfo[96].ByteLengthOfTxGrpSigInfo "" UBYTE NO_COMPU_METHOD 0 0 0 255 ECU_ADDRESS 0x0 /end MEASUREMENT
/begin MEASUREMENT Com_TxGrpSigInfo[96].DynSignalOfTxGrpSigInfo "" UBYTE Com_DynSignalOfTxGrpSigInfoType 0 0 0 1 ECU_ADDRESS 0x0 /end MEASUREMENT
/begin MEASUREMENT Com_TxGrpSigInfo[96].InvValueIdxOfTxGrpSigInfo "" UBYTE Com_InvValueIdxOfTxGrpSigInfoType 0 0 0 255 ECU_ADDRESS 0x0 /end MEASUREMENT
/begin MEASUREMENT Com_TxGrpSigInfo[96].InvValueOfTxGrpSigInfo "" UBYTE Com_InvValueOfTxGrpSigInfoType 0 0 0 255 ECU_ADDRESS 0x0 /end MEASUREMENT
/begin MEASUREMENT Com_TxGrpSigInfo[96].StartByteInPduPositionOfTxGrpSigInfo "" UBYTE NO_COMPU_METHOD 0 0 0 255 ECU_ADDRESS 0x0 /end MEASUREMENT
/begin MEASUREMENT Com_TxGrpSigInfo[96].TxBufferEndIdxOfTxGrpSigInfo "" UWORD Com_TxBufferEndIdxOfTxGrpSigInfoType 0 0 0 65535 ECU_ADDRESS 0x0 /end MEASUREMENT
/begin MEASUREMENT Com_TxGrpSigInfo[96].TxBufferStartIdxOfTxGrpSigInfo "" UWORD Com_TxBufferStartIdxOfTxGrpSigInfoType 0 0 0 65535 ECU_ADDRESS 0x0 /end MEASUREMENT
/begin MEASUREMENT Com_TxGrpSigInfo[96].TxPduInfoIdxOfTxGrpSigInfo "" UBYTE NO_COMPU_METHOD 0 0 0 255 ECU_ADDRESS 0x0 /end MEASUREMENT
/begin MEASUREMENT Com_TxGrpSigInfo[96].TxSigGrpInfoIdxOfTxGrpSigInfo "" UBYTE NO_COMPU_METHOD 0 0 0 255 ECU_ADDRESS 0x0 /end MEASUREMENT
/begin MEASUREMENT Com_TxGrpSigInfo[96].WithoutRepOfTxGrpSigInfo "" UBYTE Com_WithoutRepOfTxGrpSigInfoType 0 0 0 1 ECU_ADDRESS 0x0 /end MEASUREMENT
/begin MEASUREMENT Com_TxGrpSigInfo[97].ApplTypeOfTxGrpSigInfo "" UBYTE Com_ApplTypeOfTxGrpSigInfoType 0 0 0 255 ECU_ADDRESS 0x0 /end MEASUREMENT
/begin MEASUREMENT Com_TxGrpSigInfo[97].BitLengthOfTxGrpSigInfo "" UBYTE NO_COMPU_METHOD 0 0 0 255 ECU_ADDRESS 0x0 /end MEASUREMENT
/begin MEASUREMENT Com_TxGrpSigInfo[97].BitPositionOfTxGrpSigInfo "" UWORD NO_COMPU_METHOD 0 0 0 65535 ECU_ADDRESS 0x0 /end MEASUREMENT
/begin MEASUREMENT Com_TxGrpSigInfo[97].BusAccOfTxGrpSigInfo "" UBYTE Com_BusAccOfTxGrpSigInfoType 0 0 0 255 ECU_ADDRESS 0x0 /end MEASUREMENT
/begin MEASUREMENT Com_TxGrpSigInfo[97].ByteLengthOfTxGrpSigInfo "" UBYTE NO_COMPU_METHOD 0 0 0 255 ECU_ADDRESS 0x0 /end MEASUREMENT
/begin MEASUREMENT Com_TxGrpSigInfo[97].DynSignalOfTxGrpSigInfo "" UBYTE Com_DynSignalOfTxGrpSigInfoType 0 0 0 1 ECU_ADDRESS 0x0 /end MEASUREMENT
/begin MEASUREMENT Com_TxGrpSigInfo[97].InvValueIdxOfTxGrpSigInfo "" UBYTE Com_InvValueIdxOfTxGrpSigInfoType 0 0 0 255 ECU_ADDRESS 0x0 /end MEASUREMENT
/begin MEASUREMENT Com_TxGrpSigInfo[97].InvValueOfTxGrpSigInfo "" UBYTE Com_InvValueOfTxGrpSigInfoType 0 0 0 255 ECU_ADDRESS 0x0 /end MEASUREMENT
/begin MEASUREMENT Com_TxGrpSigInfo[97].StartByteInPduPositionOfTxGrpSigInfo "" UBYTE NO_COMPU_METHOD 0 0 0 255 ECU_ADDRESS 0x0 /end MEASUREMENT
/begin MEASUREMENT Com_TxGrpSigInfo[97].TxBufferEndIdxOfTxGrpSigInfo "" UWORD Com_TxBufferEndIdxOfTxGrpSigInfoType 0 0 0 65535 ECU_ADDRESS 0x0 /end MEASUREMENT
/begin MEASUREMENT Com_TxGrpSigInfo[97].TxBufferStartIdxOfTxGrpSigInfo "" UWORD Com_TxBufferStartIdxOfTxGrpSigInfoType 0 0 0 65535 ECU_ADDRESS 0x0 /end MEASUREMENT
/begin MEASUREMENT Com_TxGrpSigInfo[97].TxPduInfoIdxOfTxGrpSigInfo "" UBYTE NO_COMPU_METHOD 0 0 0 255 ECU_ADDRESS 0x0 /end MEASUREMENT
/begin MEASUREMENT Com_TxGrpSigInfo[97].TxSigGrpInfoIdxOfTxGrpSigInfo "" UBYTE NO_COMPU_METHOD 0 0 0 255 ECU_ADDRESS 0x0 /end MEASUREMENT
/begin MEASUREMENT Com_TxGrpSigInfo[97].WithoutRepOfTxGrpSigInfo "" UBYTE Com_WithoutRepOfTxGrpSigInfoType 0 0 0 1 ECU_ADDRESS 0x0 /end MEASUREMENT
/begin MEASUREMENT Com_TxGrpSigInfo[98].ApplTypeOfTxGrpSigInfo "" UBYTE Com_ApplTypeOfTxGrpSigInfoType 0 0 0 255 ECU_ADDRESS 0x0 /end MEASUREMENT
/begin MEASUREMENT Com_TxGrpSigInfo[98].BitLengthOfTxGrpSigInfo "" UBYTE NO_COMPU_METHOD 0 0 0 255 ECU_ADDRESS 0x0 /end MEASUREMENT
/begin MEASUREMENT Com_TxGrpSigInfo[98].BitPositionOfTxGrpSigInfo "" UWORD NO_COMPU_METHOD 0 0 0 65535 ECU_ADDRESS 0x0 /end MEASUREMENT
/begin MEASUREMENT Com_TxGrpSigInfo[98].BusAccOfTxGrpSigInfo "" UBYTE Com_BusAccOfTxGrpSigInfoType 0 0 0 255 ECU_ADDRESS 0x0 /end MEASUREMENT
/begin MEASUREMENT Com_TxGrpSigInfo[98].ByteLengthOfTxGrpSigInfo "" UBYTE NO_COMPU_METHOD 0 0 0 255 ECU_ADDRESS 0x0 /end MEASUREMENT
/begin MEASUREMENT Com_TxGrpSigInfo[98].DynSignalOfTxGrpSigInfo "" UBYTE Com_DynSignalOfTxGrpSigInfoType 0 0 0 1 ECU_ADDRESS 0x0 /end MEASUREMENT
/begin MEASUREMENT Com_TxGrpSigInfo[98].InvValueIdxOfTxGrpSigInfo "" UBYTE Com_InvValueIdxOfTxGrpSigInfoType 0 0 0 255 ECU_ADDRESS 0x0 /end MEASUREMENT
/begin MEASUREMENT Com_TxGrpSigInfo[98].InvValueOfTxGrpSigInfo "" UBYTE Com_InvValueOfTxGrpSigInfoType 0 0 0 255 ECU_ADDRESS 0x0 /end MEASUREMENT
/begin MEASUREMENT Com_TxGrpSigInfo[98].StartByteInPduPositionOfTxGrpSigInfo "" UBYTE NO_COMPU_METHOD 0 0 0 255 ECU_ADDRESS 0x0 /end MEASUREMENT
/begin MEASUREMENT Com_TxGrpSigInfo[98].TxBufferEndIdxOfTxGrpSigInfo "" UWORD Com_TxBufferEndIdxOfTxGrpSigInfoType 0 0 0 65535 ECU_ADDRESS 0x0 /end MEASUREMENT
/begin MEASUREMENT Com_TxGrpSigInfo[98].TxBufferStartIdxOfTxGrpSigInfo "" UWORD Com_TxBufferStartIdxOfTxGrpSigInfoType 0 0 0 65535 ECU_ADDRESS 0x0 /end MEASUREMENT
/begin MEASUREMENT Com_TxGrpSigInfo[98].TxPduInfoIdxOfTxGrpSigInfo "" UBYTE NO_COMPU_METHOD 0 0 0 255 ECU_ADDRESS 0x0 /end MEASUREMENT
/begin MEASUREMENT Com_TxGrpSigInfo[98].TxSigGrpInfoIdxOfTxGrpSigInfo "" UBYTE NO_COMPU_METHOD 0 0 0 255 ECU_ADDRESS 0x0 /end MEASUREMENT
/begin MEASUREMENT Com_TxGrpSigInfo[98].WithoutRepOfTxGrpSigInfo "" UBYTE Com_WithoutRepOfTxGrpSigInfoType 0 0 0 1 ECU_ADDRESS 0x0 /end MEASUREMENT
/begin MEASUREMENT Com_TxGrpSigInfo[99].ApplTypeOfTxGrpSigInfo "" UBYTE Com_ApplTypeOfTxGrpSigInfoType 0 0 0 255 ECU_ADDRESS 0x0 /end MEASUREMENT
/begin MEASUREMENT Com_TxGrpSigInfo[99].BitLengthOfTxGrpSigInfo "" UBYTE NO_COMPU_METHOD 0 0 0 255 ECU_ADDRESS 0x0 /end MEASUREMENT
/begin MEASUREMENT Com_TxGrpSigInfo[99].BitPositionOfTxGrpSigInfo "" UWORD NO_COMPU_METHOD 0 0 0 65535 ECU_ADDRESS 0x0 /end MEASUREMENT
/begin MEASUREMENT Com_TxGrpSigInfo[99].BusAccOfTxGrpSigInfo "" UBYTE Com_BusAccOfTxGrpSigInfoType 0 0 0 255 ECU_ADDRESS 0x0 /end MEASUREMENT
/begin MEASUREMENT Com_TxGrpSigInfo[99].ByteLengthOfTxGrpSigInfo "" UBYTE NO_COMPU_METHOD 0 0 0 255 ECU_ADDRESS 0x0 /end MEASUREMENT
/begin MEASUREMENT Com_TxGrpSigInfo[99].DynSignalOfTxGrpSigInfo "" UBYTE Com_DynSignalOfTxGrpSigInfoType 0 0 0 1 ECU_ADDRESS 0x0 /end MEASUREMENT
/begin MEASUREMENT Com_TxGrpSigInfo[99].InvValueIdxOfTxGrpSigInfo "" UBYTE Com_InvValueIdxOfTxGrpSigInfoType 0 0 0 255 ECU_ADDRESS 0x0 /end MEASUREMENT
/begin MEASUREMENT Com_TxGrpSigInfo[99].InvValueOfTxGrpSigInfo "" UBYTE Com_InvValueOfTxGrpSigInfoType 0 0 0 255 ECU_ADDRESS 0x0 /end MEASUREMENT
/begin MEASUREMENT Com_TxGrpSigInfo[99].StartByteInPduPositionOfTxGrpSigInfo "" UBYTE NO_COMPU_METHOD 0 0 0 255 ECU_ADDRESS 0x0 /end MEASUREMENT
/begin MEASUREMENT Com_TxGrpSigInfo[99].TxBufferEndIdxOfTxGrpSigInfo "" UWORD Com_TxBufferEndIdxOfTxGrpSigInfoType 0 0 0 65535 ECU_ADDRESS 0x0 /end MEASUREMENT
/begin MEASUREMENT Com_TxGrpSigInfo[99].TxBufferStartIdxOfTxGrpSigInfo "" UWORD Com_TxBufferStartIdxOfTxGrpSigInfoType 0 0 0 65535 ECU_ADDRESS 0x0 /end MEASUREMENT
/begin MEASUREMENT Com_TxGrpSigInfo[99].TxPduInfoIdxOfTxGrpSigInfo "" UBYTE NO_COMPU_METHOD 0 0 0 255 ECU_ADDRESS 0x0 /end MEASUREMENT
/begin MEASUREMENT Com_TxGrpSigInfo[99].TxSigGrpInfoIdxOfTxGrpSigInfo "" UBYTE NO_COMPU_METHOD 0 0 0 255 ECU_ADDRESS 0x0 /end MEASUREMENT
/begin MEASUREMENT Com_TxGrpSigInfo[99].WithoutRepOfTxGrpSigInfo "" UBYTE Com_WithoutRepOfTxGrpSigInfoType 0 0 0 1 ECU_ADDRESS 0x0 /end MEASUREMENT
/begin MEASUREMENT Com_TxGrpSigInfo[9].ApplTypeOfTxGrpSigInfo "" UBYTE Com_ApplTypeOfTxGrpSigInfoType 0 0 0 255 ECU_ADDRESS 0x0 /end MEASUREMENT
/begin MEASUREMENT Com_TxGrpSigInfo[9].BitLengthOfTxGrpSigInfo "" UBYTE NO_COMPU_METHOD 0 0 0 255 ECU_ADDRESS 0x0 /end MEASUREMENT
/begin MEASUREMENT Com_TxGrpSigInfo[9].BitPositionOfTxGrpSigInfo "" UWORD NO_COMPU_METHOD 0 0 0 65535 ECU_ADDRESS 0x0 /end MEASUREMENT
/begin MEASUREMENT Com_TxGrpSigInfo[9].BusAccOfTxGrpSigInfo "" UBYTE Com_BusAccOfTxGrpSigInfoType 0 0 0 255 ECU_ADDRESS 0x0 /end MEASUREMENT
/begin MEASUREMENT Com_TxGrpSigInfo[9].ByteLengthOfTxGrpSigInfo "" UBYTE NO_COMPU_METHOD 0 0 0 255 ECU_ADDRESS 0x0 /end MEASUREMENT
/begin MEASUREMENT Com_TxGrpSigInfo[9].DynSignalOfTxGrpSigInfo "" UBYTE Com_DynSignalOfTxGrpSigInfoType 0 0 0 1 ECU_ADDRESS 0x0 /end MEASUREMENT
/begin MEASUREMENT Com_TxGrpSigInfo[9].InvValueIdxOfTxGrpSigInfo "" UBYTE Com_InvValueIdxOfTxGrpSigInfoType 0 0 0 255 ECU_ADDRESS 0x0 /end MEASUREMENT
/begin MEASUREMENT Com_TxGrpSigInfo[9].InvValueOfTxGrpSigInfo "" UBYTE Com_InvValueOfTxGrpSigInfoType 0 0 0 255 ECU_ADDRESS 0x0 /end MEASUREMENT
/begin MEASUREMENT Com_TxGrpSigInfo[9].StartByteInPduPositionOfTxGrpSigInfo "" UBYTE NO_COMPU_METHOD 0 0 0 255 ECU_ADDRESS 0x0 /end MEASUREMENT
/begin MEASUREMENT Com_TxGrpSigInfo[9].TxBufferEndIdxOfTxGrpSigInfo "" UWORD Com_TxBufferEndIdxOfTxGrpSigInfoType 0 0 0 65535 ECU_ADDRESS 0x0 /end MEASUREMENT
/begin MEASUREMENT Com_TxGrpSigInfo[9].TxBufferStartIdxOfTxGrpSigInfo "" UWORD Com_TxBufferStartIdxOfTxGrpSigInfoType 0 0 0 65535 ECU_ADDRESS 0x0 /end MEASUREMENT
/begin MEASUREMENT Com_TxGrpSigInfo[9].TxPduInfoIdxOfTxGrpSigInfo "" UBYTE NO_COMPU_METHOD 0 0 0 255 ECU_ADDRESS 0x0 /end MEASUREMENT
/begin MEASUREMENT Com_TxGrpSigInfo[9].TxSigGrpInfoIdxOfTxGrpSigInfo "" UBYTE NO_COMPU_METHOD 0 0 0 255 ECU_ADDRESS 0x0 /end MEASUREMENT
/begin MEASUREMENT Com_TxGrpSigInfo[9].WithoutRepOfTxGrpSigInfo "" UBYTE Com_WithoutRepOfTxGrpSigInfoType 0 0 0 1 ECU_ADDRESS 0x0 /end MEASUREMENT
/begin MEASUREMENT Com_TxIPduGroupISRLockCounter "" UWORD NO_COMPU_METHOD 0 0 0 65535 ECU_ADDRESS 0x0 SYMBOL_LINK "Com_TxIPduGroupISRLockCounter.raw" 0 /end MEASUREMENT
/begin MEASUREMENT Com_TxIPduGroupISRLockCounter_noPartition "The element: noPartition of Com_TxIPduGroupISRLockCounter" UWORD NO_COMPU_METHOD 0 0 0 65535 ECU_ADDRESS 0x0 SYMBOL_LINK "Com_TxIPduGroupISRLockCounter.raw[0]" 0 /end MEASUREMENT
/begin MEASUREMENT Com_TxModeInfo[0].InitModeOfTxModeInfo "" UBYTE Com_InitModeOfTxModeInfoType 0 0 0 1 ECU_ADDRESS 0x0 /end MEASUREMENT
/begin MEASUREMENT Com_TxModeInfo[0].MinimumDelayOfTxModeInfo "" UBYTE NO_COMPU_METHOD 0 0 0 255 ECU_ADDRESS 0x0 /end MEASUREMENT
/begin MEASUREMENT Com_TxModeInfo[0].TxModeTrueIdxOfTxModeInfo "" UBYTE NO_COMPU_METHOD 0 0 0 255 ECU_ADDRESS 0x0 /end MEASUREMENT
/begin MEASUREMENT Com_TxModeInfo[0].TxSigInfoFilterInitValueIndEndIdxOfTxModeInfo "" UBYTE Com_TxSigInfoFilterInitValueIndEndIdxOfTxModeInfoType 0 0 0 255 ECU_ADDRESS 0x0 /end MEASUREMENT
/begin MEASUREMENT Com_TxModeInfo[0].TxSigInfoFilterInitValueIndStartIdxOfTxModeInfo "" UBYTE Com_TxSigInfoFilterInitValueIndStartIdxOfTxModeInfoType 0 0 0 255 ECU_ADDRESS 0x0 /end MEASUREMENT
/begin MEASUREMENT Com_TxModeInfo[10].InitModeOfTxModeInfo "" UBYTE Com_InitModeOfTxModeInfoType 0 0 0 1 ECU_ADDRESS 0x0 /end MEASUREMENT
/begin MEASUREMENT Com_TxModeInfo[10].MinimumDelayOfTxModeInfo "" UBYTE NO_COMPU_METHOD 0 0 0 255 ECU_ADDRESS 0x0 /end MEASUREMENT
/begin MEASUREMENT Com_TxModeInfo[10].TxModeTrueIdxOfTxModeInfo "" UBYTE NO_COMPU_METHOD 0 0 0 255 ECU_ADDRESS 0x0 /end MEASUREMENT
/begin MEASUREMENT Com_TxModeInfo[10].TxSigInfoFilterInitValueIndEndIdxOfTxModeInfo "" UBYTE Com_TxSigInfoFilterInitValueIndEndIdxOfTxModeInfoType 0 0 0 255 ECU_ADDRESS 0x0 /end MEASUREMENT
/begin MEASUREMENT Com_TxModeInfo[10].TxSigInfoFilterInitValueIndStartIdxOfTxModeInfo "" UBYTE Com_TxSigInfoFilterInitValueIndStartIdxOfTxModeInfoType 0 0 0 255 ECU_ADDRESS 0x0 /end MEASUREMENT
/begin MEASUREMENT Com_TxModeInfo[11].InitModeOfTxModeInfo "" UBYTE Com_InitModeOfTxModeInfoType 0 0 0 1 ECU_ADDRESS 0x0 /end MEASUREMENT
/begin MEASUREMENT Com_TxModeInfo[11].MinimumDelayOfTxModeInfo "" UBYTE NO_COMPU_METHOD 0 0 0 255 ECU_ADDRESS 0x0 /end MEASUREMENT
/begin MEASUREMENT Com_TxModeInfo[11].TxModeTrueIdxOfTxModeInfo "" UBYTE NO_COMPU_METHOD 0 0 0 255 ECU_ADDRESS 0x0 /end MEASUREMENT
/begin MEASUREMENT Com_TxModeInfo[11].TxSigInfoFilterInitValueIndEndIdxOfTxModeInfo "" UBYTE Com_TxSigInfoFilterInitValueIndEndIdxOfTxModeInfoType 0 0 0 255 ECU_ADDRESS 0x0 /end MEASUREMENT
/begin MEASUREMENT Com_TxModeInfo[11].TxSigInfoFilterInitValueIndStartIdxOfTxModeInfo "" UBYTE Com_TxSigInfoFilterInitValueIndStartIdxOfTxModeInfoType 0 0 0 255 ECU_ADDRESS 0x0 /end MEASUREMENT
/begin MEASUREMENT Com_TxModeInfo[12].InitModeOfTxModeInfo "" UBYTE Com_InitModeOfTxModeInfoType 0 0 0 1 ECU_ADDRESS 0x0 /end MEASUREMENT
/begin MEASUREMENT Com_TxModeInfo[12].MinimumDelayOfTxModeInfo "" UBYTE NO_COMPU_METHOD 0 0 0 255 ECU_ADDRESS 0x0 /end MEASUREMENT
/begin MEASUREMENT Com_TxModeInfo[12].TxModeTrueIdxOfTxModeInfo "" UBYTE NO_COMPU_METHOD 0 0 0 255 ECU_ADDRESS 0x0 /end MEASUREMENT
/begin MEASUREMENT Com_TxModeInfo[12].TxSigInfoFilterInitValueIndEndIdxOfTxModeInfo "" UBYTE Com_TxSigInfoFilterInitValueIndEndIdxOfTxModeInfoType 0 0 0 255 ECU_ADDRESS 0x0 /end MEASUREMENT
/begin MEASUREMENT Com_TxModeInfo[12].TxSigInfoFilterInitValueIndStartIdxOfTxModeInfo "" UBYTE Com_TxSigInfoFilterInitValueIndStartIdxOfTxModeInfoType 0 0 0 255 ECU_ADDRESS 0x0 /end MEASUREMENT
/begin MEASUREMENT Com_TxModeInfo[13].InitModeOfTxModeInfo "" UBYTE Com_InitModeOfTxModeInfoType 0 0 0 1 ECU_ADDRESS 0x0 /end MEASUREMENT
/begin MEASUREMENT Com_TxModeInfo[13].MinimumDelayOfTxModeInfo "" UBYTE NO_COMPU_METHOD 0 0 0 255 ECU_ADDRESS 0x0 /end MEASUREMENT
/begin MEASUREMENT Com_TxModeInfo[13].TxModeTrueIdxOfTxModeInfo "" UBYTE NO_COMPU_METHOD 0 0 0 255 ECU_ADDRESS 0x0 /end MEASUREMENT
/begin MEASUREMENT Com_TxModeInfo[13].TxSigInfoFilterInitValueIndEndIdxOfTxModeInfo "" UBYTE Com_TxSigInfoFilterInitValueIndEndIdxOfTxModeInfoType 0 0 0 255 ECU_ADDRESS 0x0 /end MEASUREMENT
/begin MEASUREMENT Com_TxModeInfo[13].TxSigInfoFilterInitValueIndStartIdxOfTxModeInfo "" UBYTE Com_TxSigInfoFilterInitValueIndStartIdxOfTxModeInfoType 0 0 0 255 ECU_ADDRESS 0x0 /end MEASUREMENT
/begin MEASUREMENT Com_TxModeInfo[14].InitModeOfTxModeInfo "" UBYTE Com_InitModeOfTxModeInfoType 0 0 0 1 ECU_ADDRESS 0x0 /end MEASUREMENT
/begin MEASUREMENT Com_TxModeInfo[14].MinimumDelayOfTxModeInfo "" UBYTE NO_COMPU_METHOD 0 0 0 255 ECU_ADDRESS 0x0 /end MEASUREMENT
/begin MEASUREMENT Com_TxModeInfo[14].TxModeTrueIdxOfTxModeInfo "" UBYTE NO_COMPU_METHOD 0 0 0 255 ECU_ADDRESS 0x0 /end MEASUREMENT
/begin MEASUREMENT Com_TxModeInfo[14].TxSigInfoFilterInitValueIndEndIdxOfTxModeInfo "" UBYTE Com_TxSigInfoFilterInitValueIndEndIdxOfTxModeInfoType 0 0 0 255 ECU_ADDRESS 0x0 /end MEASUREMENT
/begin MEASUREMENT Com_TxModeInfo[14].TxSigInfoFilterInitValueIndStartIdxOfTxModeInfo "" UBYTE Com_TxSigInfoFilterInitValueIndStartIdxOfTxModeInfoType 0 0 0 255 ECU_ADDRESS 0x0 /end MEASUREMENT
/begin MEASUREMENT Com_TxModeInfo[15].InitModeOfTxModeInfo "" UBYTE Com_InitModeOfTxModeInfoType 0 0 0 1 ECU_ADDRESS 0x0 /end MEASUREMENT
/begin MEASUREMENT Com_TxModeInfo[15].MinimumDelayOfTxModeInfo "" UBYTE NO_COMPU_METHOD 0 0 0 255 ECU_ADDRESS 0x0 /end MEASUREMENT
/begin MEASUREMENT Com_TxModeInfo[15].TxModeTrueIdxOfTxModeInfo "" UBYTE NO_COMPU_METHOD 0 0 0 255 ECU_ADDRESS 0x0 /end MEASUREMENT
/begin MEASUREMENT Com_TxModeInfo[15].TxSigInfoFilterInitValueIndEndIdxOfTxModeInfo "" UBYTE Com_TxSigInfoFilterInitValueIndEndIdxOfTxModeInfoType 0 0 0 255 ECU_ADDRESS 0x0 /end MEASUREMENT
/begin MEASUREMENT Com_TxModeInfo[15].TxSigInfoFilterInitValueIndStartIdxOfTxModeInfo "" UBYTE Com_TxSigInfoFilterInitValueIndStartIdxOfTxModeInfoType 0 0 0 255 ECU_ADDRESS 0x0 /end MEASUREMENT
/begin MEASUREMENT Com_TxModeInfo[16].InitModeOfTxModeInfo "" UBYTE Com_InitModeOfTxModeInfoType 0 0 0 1 ECU_ADDRESS 0x0 /end MEASUREMENT
/begin MEASUREMENT Com_TxModeInfo[16].MinimumDelayOfTxModeInfo "" UBYTE NO_COMPU_METHOD 0 0 0 255 ECU_ADDRESS 0x0 /end MEASUREMENT
/begin MEASUREMENT Com_TxModeInfo[16].TxModeTrueIdxOfTxModeInfo "" UBYTE NO_COMPU_METHOD 0 0 0 255 ECU_ADDRESS 0x0 /end MEASUREMENT
/begin MEASUREMENT Com_TxModeInfo[16].TxSigInfoFilterInitValueIndEndIdxOfTxModeInfo "" UBYTE Com_TxSigInfoFilterInitValueIndEndIdxOfTxModeInfoType 0 0 0 255 ECU_ADDRESS 0x0 /end MEASUREMENT
/begin MEASUREMENT Com_TxModeInfo[16].TxSigInfoFilterInitValueIndStartIdxOfTxModeInfo "" UBYTE Com_TxSigInfoFilterInitValueIndStartIdxOfTxModeInfoType 0 0 0 255 ECU_ADDRESS 0x0 /end MEASUREMENT
/begin MEASUREMENT Com_TxModeInfo[17].InitModeOfTxModeInfo "" UBYTE Com_InitModeOfTxModeInfoType 0 0 0 1 ECU_ADDRESS 0x0 /end MEASUREMENT
/begin MEASUREMENT Com_TxModeInfo[17].MinimumDelayOfTxModeInfo "" UBYTE NO_COMPU_METHOD 0 0 0 255 ECU_ADDRESS 0x0 /end MEASUREMENT
/begin MEASUREMENT Com_TxModeInfo[17].TxModeTrueIdxOfTxModeInfo "" UBYTE NO_COMPU_METHOD 0 0 0 255 ECU_ADDRESS 0x0 /end MEASUREMENT
/begin MEASUREMENT Com_TxModeInfo[17].TxSigInfoFilterInitValueIndEndIdxOfTxModeInfo "" UBYTE Com_TxSigInfoFilterInitValueIndEndIdxOfTxModeInfoType 0 0 0 255 ECU_ADDRESS 0x0 /end MEASUREMENT
/begin MEASUREMENT Com_TxModeInfo[17].TxSigInfoFilterInitValueIndStartIdxOfTxModeInfo "" UBYTE Com_TxSigInfoFilterInitValueIndStartIdxOfTxModeInfoType 0 0 0 255 ECU_ADDRESS 0x0 /end MEASUREMENT
/begin MEASUREMENT Com_TxModeInfo[18].InitModeOfTxModeInfo "" UBYTE Com_InitModeOfTxModeInfoType 0 0 0 1 ECU_ADDRESS 0x0 /end MEASUREMENT
/begin MEASUREMENT Com_TxModeInfo[18].MinimumDelayOfTxModeInfo "" UBYTE NO_COMPU_METHOD 0 0 0 255 ECU_ADDRESS 0x0 /end MEASUREMENT
/begin MEASUREMENT Com_TxModeInfo[18].TxModeTrueIdxOfTxModeInfo "" UBYTE NO_COMPU_METHOD 0 0 0 255 ECU_ADDRESS 0x0 /end MEASUREMENT
/begin MEASUREMENT Com_TxModeInfo[18].TxSigInfoFilterInitValueIndEndIdxOfTxModeInfo "" UBYTE Com_TxSigInfoFilterInitValueIndEndIdxOfTxModeInfoType 0 0 0 255 ECU_ADDRESS 0x0 /end MEASUREMENT
/begin MEASUREMENT Com_TxModeInfo[18].TxSigInfoFilterInitValueIndStartIdxOfTxModeInfo "" UBYTE Com_TxSigInfoFilterInitValueIndStartIdxOfTxModeInfoType 0 0 0 255 ECU_ADDRESS 0x0 /end MEASUREMENT
/begin MEASUREMENT Com_TxModeInfo[19].InitModeOfTxModeInfo "" UBYTE Com_InitModeOfTxModeInfoType 0 0 0 1 ECU_ADDRESS 0x0 /end MEASUREMENT
/begin MEASUREMENT Com_TxModeInfo[19].MinimumDelayOfTxModeInfo "" UBYTE NO_COMPU_METHOD 0 0 0 255 ECU_ADDRESS 0x0 /end MEASUREMENT
/begin MEASUREMENT Com_TxModeInfo[19].TxModeTrueIdxOfTxModeInfo "" UBYTE NO_COMPU_METHOD 0 0 0 255 ECU_ADDRESS 0x0 /end MEASUREMENT
/begin MEASUREMENT Com_TxModeInfo[19].TxSigInfoFilterInitValueIndEndIdxOfTxModeInfo "" UBYTE Com_TxSigInfoFilterInitValueIndEndIdxOfTxModeInfoType 0 0 0 255 ECU_ADDRESS 0x0 /end MEASUREMENT
/begin MEASUREMENT Com_TxModeInfo[19].TxSigInfoFilterInitValueIndStartIdxOfTxModeInfo "" UBYTE Com_TxSigInfoFilterInitValueIndStartIdxOfTxModeInfoType 0 0 0 255 ECU_ADDRESS 0x0 /end MEASUREMENT
/begin MEASUREMENT Com_TxModeInfo[1].InitModeOfTxModeInfo "" UBYTE Com_InitModeOfTxModeInfoType 0 0 0 1 ECU_ADDRESS 0x0 /end MEASUREMENT
/begin MEASUREMENT Com_TxModeInfo[1].MinimumDelayOfTxModeInfo "" UBYTE NO_COMPU_METHOD 0 0 0 255 ECU_ADDRESS 0x0 /end MEASUREMENT
/begin MEASUREMENT Com_TxModeInfo[1].TxModeTrueIdxOfTxModeInfo "" UBYTE NO_COMPU_METHOD 0 0 0 255 ECU_ADDRESS 0x0 /end MEASUREMENT
/begin MEASUREMENT Com_TxModeInfo[1].TxSigInfoFilterInitValueIndEndIdxOfTxModeInfo "" UBYTE Com_TxSigInfoFilterInitValueIndEndIdxOfTxModeInfoType 0 0 0 255 ECU_ADDRESS 0x0 /end MEASUREMENT
/begin MEASUREMENT Com_TxModeInfo[1].TxSigInfoFilterInitValueIndStartIdxOfTxModeInfo "" UBYTE Com_TxSigInfoFilterInitValueIndStartIdxOfTxModeInfoType 0 0 0 255 ECU_ADDRESS 0x0 /end MEASUREMENT
/begin MEASUREMENT Com_TxModeInfo[20].InitModeOfTxModeInfo "" UBYTE Com_InitModeOfTxModeInfoType 0 0 0 1 ECU_ADDRESS 0x0 /end MEASUREMENT
/begin MEASUREMENT Com_TxModeInfo[20].MinimumDelayOfTxModeInfo "" UBYTE NO_COMPU_METHOD 0 0 0 255 ECU_ADDRESS 0x0 /end MEASUREMENT
/begin MEASUREMENT Com_TxModeInfo[20].TxModeTrueIdxOfTxModeInfo "" UBYTE NO_COMPU_METHOD 0 0 0 255 ECU_ADDRESS 0x0 /end MEASUREMENT
/begin MEASUREMENT Com_TxModeInfo[20].TxSigInfoFilterInitValueIndEndIdxOfTxModeInfo "" UBYTE Com_TxSigInfoFilterInitValueIndEndIdxOfTxModeInfoType 0 0 0 255 ECU_ADDRESS 0x0 /end MEASUREMENT
/begin MEASUREMENT Com_TxModeInfo[20].TxSigInfoFilterInitValueIndStartIdxOfTxModeInfo "" UBYTE Com_TxSigInfoFilterInitValueIndStartIdxOfTxModeInfoType 0 0 0 255 ECU_ADDRESS 0x0 /end MEASUREMENT
/begin MEASUREMENT Com_TxModeInfo[21].InitModeOfTxModeInfo "" UBYTE Com_InitModeOfTxModeInfoType 0 0 0 1 ECU_ADDRESS 0x0 /end MEASUREMENT
/begin MEASUREMENT Com_TxModeInfo[21].MinimumDelayOfTxModeInfo "" UBYTE NO_COMPU_METHOD 0 0 0 255 ECU_ADDRESS 0x0 /end MEASUREMENT
/begin MEASUREMENT Com_TxModeInfo[21].TxModeTrueIdxOfTxModeInfo "" UBYTE NO_COMPU_METHOD 0 0 0 255 ECU_ADDRESS 0x0 /end MEASUREMENT
/begin MEASUREMENT Com_TxModeInfo[21].TxSigInfoFilterInitValueIndEndIdxOfTxModeInfo "" UBYTE Com_TxSigInfoFilterInitValueIndEndIdxOfTxModeInfoType 0 0 0 255 ECU_ADDRESS 0x0 /end MEASUREMENT
/begin MEASUREMENT Com_TxModeInfo[21].TxSigInfoFilterInitValueIndStartIdxOfTxModeInfo "" UBYTE Com_TxSigInfoFilterInitValueIndStartIdxOfTxModeInfoType 0 0 0 255 ECU_ADDRESS 0x0 /end MEASUREMENT
/begin MEASUREMENT Com_TxModeInfo[22].InitModeOfTxModeInfo "" UBYTE Com_InitModeOfTxModeInfoType 0 0 0 1 ECU_ADDRESS 0x0 /end MEASUREMENT
/begin MEASUREMENT Com_TxModeInfo[22].MinimumDelayOfTxModeInfo "" UBYTE NO_COMPU_METHOD 0 0 0 255 ECU_ADDRESS 0x0 /end MEASUREMENT
/begin MEASUREMENT Com_TxModeInfo[22].TxModeTrueIdxOfTxModeInfo "" UBYTE NO_COMPU_METHOD 0 0 0 255 ECU_ADDRESS 0x0 /end MEASUREMENT
/begin MEASUREMENT Com_TxModeInfo[22].TxSigInfoFilterInitValueIndEndIdxOfTxModeInfo "" UBYTE Com_TxSigInfoFilterInitValueIndEndIdxOfTxModeInfoType 0 0 0 255 ECU_ADDRESS 0x0 /end MEASUREMENT
/begin MEASUREMENT Com_TxModeInfo[22].TxSigInfoFilterInitValueIndStartIdxOfTxModeInfo "" UBYTE Com_TxSigInfoFilterInitValueIndStartIdxOfTxModeInfoType 0 0 0 255 ECU_ADDRESS 0x0 /end MEASUREMENT
/begin MEASUREMENT Com_TxModeInfo[23].InitModeOfTxModeInfo "" UBYTE Com_InitModeOfTxModeInfoType 0 0 0 1 ECU_ADDRESS 0x0 /end MEASUREMENT
/begin MEASUREMENT Com_TxModeInfo[23].MinimumDelayOfTxModeInfo "" UBYTE NO_COMPU_METHOD 0 0 0 255 ECU_ADDRESS 0x0 /end MEASUREMENT
/begin MEASUREMENT Com_TxModeInfo[23].TxModeTrueIdxOfTxModeInfo "" UBYTE NO_COMPU_METHOD 0 0 0 255 ECU_ADDRESS 0x0 /end MEASUREMENT
/begin MEASUREMENT Com_TxModeInfo[23].TxSigInfoFilterInitValueIndEndIdxOfTxModeInfo "" UBYTE Com_TxSigInfoFilterInitValueIndEndIdxOfTxModeInfoType 0 0 0 255 ECU_ADDRESS 0x0 /end MEASUREMENT
/begin MEASUREMENT Com_TxModeInfo[23].TxSigInfoFilterInitValueIndStartIdxOfTxModeInfo "" UBYTE Com_TxSigInfoFilterInitValueIndStartIdxOfTxModeInfoType 0 0 0 255 ECU_ADDRESS 0x0 /end MEASUREMENT
/begin MEASUREMENT Com_TxModeInfo[24].InitModeOfTxModeInfo "" UBYTE Com_InitModeOfTxModeInfoType 0 0 0 1 ECU_ADDRESS 0x0 /end MEASUREMENT
/begin MEASUREMENT Com_TxModeInfo[24].MinimumDelayOfTxModeInfo "" UBYTE NO_COMPU_METHOD 0 0 0 255 ECU_ADDRESS 0x0 /end MEASUREMENT
/begin MEASUREMENT Com_TxModeInfo[24].TxModeTrueIdxOfTxModeInfo "" UBYTE NO_COMPU_METHOD 0 0 0 255 ECU_ADDRESS 0x0 /end MEASUREMENT
/begin MEASUREMENT Com_TxModeInfo[24].TxSigInfoFilterInitValueIndEndIdxOfTxModeInfo "" UBYTE Com_TxSigInfoFilterInitValueIndEndIdxOfTxModeInfoType 0 0 0 255 ECU_ADDRESS 0x0 /end MEASUREMENT
/begin MEASUREMENT Com_TxModeInfo[24].TxSigInfoFilterInitValueIndStartIdxOfTxModeInfo "" UBYTE Com_TxSigInfoFilterInitValueIndStartIdxOfTxModeInfoType 0 0 0 255 ECU_ADDRESS 0x0 /end MEASUREMENT
/begin MEASUREMENT Com_TxModeInfo[25].InitModeOfTxModeInfo "" UBYTE Com_InitModeOfTxModeInfoType 0 0 0 1 ECU_ADDRESS 0x0 /end MEASUREMENT
/begin MEASUREMENT Com_TxModeInfo[25].MinimumDelayOfTxModeInfo "" UBYTE NO_COMPU_METHOD 0 0 0 255 ECU_ADDRESS 0x0 /end MEASUREMENT
/begin MEASUREMENT Com_TxModeInfo[25].TxModeTrueIdxOfTxModeInfo "" UBYTE NO_COMPU_METHOD 0 0 0 255 ECU_ADDRESS 0x0 /end MEASUREMENT
/begin MEASUREMENT Com_TxModeInfo[25].TxSigInfoFilterInitValueIndEndIdxOfTxModeInfo "" UBYTE Com_TxSigInfoFilterInitValueIndEndIdxOfTxModeInfoType 0 0 0 255 ECU_ADDRESS 0x0 /end MEASUREMENT
/begin MEASUREMENT Com_TxModeInfo[25].TxSigInfoFilterInitValueIndStartIdxOfTxModeInfo "" UBYTE Com_TxSigInfoFilterInitValueIndStartIdxOfTxModeInfoType 0 0 0 255 ECU_ADDRESS 0x0 /end MEASUREMENT
/begin MEASUREMENT Com_TxModeInfo[26].InitModeOfTxModeInfo "" UBYTE Com_InitModeOfTxModeInfoType 0 0 0 1 ECU_ADDRESS 0x0 /end MEASUREMENT
/begin MEASUREMENT Com_TxModeInfo[26].MinimumDelayOfTxModeInfo "" UBYTE NO_COMPU_METHOD 0 0 0 255 ECU_ADDRESS 0x0 /end MEASUREMENT
/begin MEASUREMENT Com_TxModeInfo[26].TxModeTrueIdxOfTxModeInfo "" UBYTE NO_COMPU_METHOD 0 0 0 255 ECU_ADDRESS 0x0 /end MEASUREMENT
/begin MEASUREMENT Com_TxModeInfo[26].TxSigInfoFilterInitValueIndEndIdxOfTxModeInfo "" UBYTE Com_TxSigInfoFilterInitValueIndEndIdxOfTxModeInfoType 0 0 0 255 ECU_ADDRESS 0x0 /end MEASUREMENT
/begin MEASUREMENT Com_TxModeInfo[26].TxSigInfoFilterInitValueIndStartIdxOfTxModeInfo "" UBYTE Com_TxSigInfoFilterInitValueIndStartIdxOfTxModeInfoType 0 0 0 255 ECU_ADDRESS 0x0 /end MEASUREMENT
/begin MEASUREMENT Com_TxModeInfo[27].InitModeOfTxModeInfo "" UBYTE Com_InitModeOfTxModeInfoType 0 0 0 1 ECU_ADDRESS 0x0 /end MEASUREMENT
/begin COMPU_METHOD Com_ApplTypeOfTxGrpSigInfoType "" TAB_VERB "%10.1" "" COMPU_TAB_REF Com_ApplTypeOfTxGrpSigInfoType /end COMPU_METHOD
/begin COMPU_METHOD Com_BusAccOfTxGrpSigInfoType "" TAB_VERB "%10.1" "" COMPU_TAB_REF Com_BusAccOfTxGrpSigInfoType /end COMPU_METHOD
/begin COMPU_METHOD Com_DynSignalOfTxGrpSigInfoType "" TAB_VERB "%10.1" "" COMPU_TAB_REF Com_DynSignalOfTxGrpSigInfoType /end COMPU_METHOD
/begin COMPU_METHOD Com_InitModeOfTxModeInfoType "" TAB_VERB "%10.1" "" COMPU_TAB_REF Com_InitModeOfTxModeInfoType /end COMPU_METHOD
/begin COMPU_METHOD Com_InvValueIdxOfTxGrpSigInfoType "" TAB_VERB "%10.1" "" COMPU_TAB_REF Com_InvValueIdxOfTxGrpSigInfoType /end COMPU_METHOD
/begin COMPU_METHOD Com_InvValueOfTxGrpSigInfoType "" TAB_VERB "%10.1" "" COMPU_TAB_REF Com_InvValueOfTxGrpSigInfoType /end COMPU_METHOD
/begin COMPU_METHOD Com_TxBufferEndIdxOfTxGrpSigInfoType "" TAB_VERB "%10.1" "" COMPU_TAB_REF Com_TxBufferEndIdxOfTxGrpSigInfoType /end COMPU_METHOD
/begin COMPU_METHOD Com_TxBufferStartIdxOfTxGrpSigInfoType "" TAB_VERB "%10.1" "" COMPU_TAB_REF Com_TxBufferStartIdxOfTxGrpSigInfoType /end COMPU_METHOD
/begin COMPU_METHOD Com_TxSigInfoFilterInitValueIndEndIdxOfTxModeInfoType "" TAB_VERB "%10.1" "" COMPU_TAB_REF Com_TxSigInfoFilterInitValueIndEndIdxOfTxModeInfoType /end COMPU_METHOD
/begin COMPU_METHOD Com_TxSigInfoFilterInitValueIndStartIdxOfTxModeInfoType "" TAB_VERB "%10.1" "" COMPU_TAB_REF Com_TxSigInfoFilterInitValueIndStartIdxOfTxModeInfoType /end COMPU_METHOD
/begin COMPU_METHOD Com_WithoutRepOfTxGrpSigInfoType "" TAB_VERB "%10.1" "" COMPU_TAB_REF Com_WithoutRepOfTxGrpSigInfoType /end COMPU_METHOD
/begin COMPU_VTAB Com_ApplTypeOfTxGrpSigInfoType "" TAB_VERB 4 0 "COM_UINT8_APPLTYPEOFTXGRPSIGINFO" 2 "COM_UINT16_APPLTYPEOFTXGRPSIGINFO" 4 "COM_UINT32_APPLTYPEOFTXGRPSIGINFO" 8 "COM_UINT8_N_APPLTYPEOFTXGRPSIGINFO" /end COMPU_VTAB
/begin COMPU_VTAB Com_BusAccOfTxGrpSigInfoType "" TAB_VERB 5 0 "COM_NBIT_BUSACCOFTXGRPSIGINFO" 1 "COM_BYTE_BUSACCOFTXGRPSIGINFO" 2 "COM_NBYTE_BUSACCOFTXGRPSIGINFO" 4 "COM_NBITNBYTE_BUSACCOFTXGRPSIGINFO" 6 "COM_ARRAY_BASED_BUSACCOFTXGRPSIGINFO" /end COMPU_VTAB
/begin COMPU_VTAB_RANGE Com_DynSignalOfTxGrpSigInfoType "" 2 0 0 "FALSE" 1 255 "TRUE" /end COMPU_VTAB_RANGE
/begin COMPU_VTAB_RANGE Com_InitModeOfTxModeInfoType "" 2 0 0 "FALSE" 1 255 "TRUE" /end COMPU_VTAB_RANGE
/begin COMPU_VTAB Com_InvValueIdxOfTxGrpSigInfoType "" TAB_VERB 1 255 "COM_NO_INVVALUEIDXOFTXGRPSIGINFO" /end COMPU_VTAB
/begin COMPU_VTAB Com_InvValueOfTxGrpSigInfoType "" TAB_VERB 4 0 "COM_CONSTVALUEUINT8_INVVALUEOFTXGRPSIGINFO" 1 "COM_CONSTVALUEUINT16_INVVALUEOFTXGRPSIGINFO" 2 "COM_CONSTVALUEUINT32_INVVALUEOFTXGRPSIGINFO" 255 "COM_NO_INVVALUEOFTXGRPSIGINFO" /end COMPU_VTAB
/begin COMPU_VTAB Com_TxBufferEndIdxOfTxGrpSigInfoType "" TAB_VERB 1 65535 "COM_NO_TXBUFFERENDIDXOFTXGRPSIGINFO" /end COMPU_VTAB
/begin COMPU_VTAB Com_TxBufferStartIdxOfTxGrpSigInfoType "" TAB_VERB 1 65535 "COM_NO_TXBUFFERSTARTIDXOFTXGRPSIGINFO" /end COMPU_VTAB
/begin COMPU_VTAB Com_TxSigInfoFilterInitValueIndEndIdxOfTxModeInfoType "" TAB_VERB 1 255 "COM_NO_TXSIGINFOFILTERINITVALUEINDENDIDXOFTXMODEINFO" /end COMPU_VTAB
/begin COMPU_VTAB Com_TxSigInfoFilterInitValueIndStartIdxOfTxModeInfoType "" TAB_VERB 1 255 "COM_NO_TXSIGINFOFILTERINITVALUEINDSTARTIDXOFTXMODEINFO" /end COMPU_VTAB
/begin COMPU_VTAB_RANGE Com_WithoutRepOfTxGrpSigInfoType "" 2 0 0 "FALSE" 1 255 "TRUE" /end COMPU_VTAB_RANGE
/begin GROUP Com ""
 /begin REF_MEASUREMENT Com_TxGrpSigInfo[42].InvValueIdxOfTxGrpSigInfo Com_TxGrpSigInfo[42].InvValueOfTxGrpSigInfo Com_TxGrpSigInfo[42].StartByteInPduPositionOfTxGrpSigInfo Com_TxGrpSigInfo[42].TxBufferEndIdxOfTxGrpSigInfo Com_TxGrpSigInfo[42].TxBufferStartIdxOfTxGrpSigInfo Com_TxGrpSigInfo[42].TxPduInfoIdxOfTxGrpSigInfo Com_TxGrpSigInfo[42].TxSigGrpInfoIdxOfTxGrpSigInfo Com_TxGrpSigInfo[42].WithoutRepOfTxGrpSigInfo Com_TxGrpSigInfo[43].ApplTypeOfTxGrpSigInfo Com_TxGrpSigInfo[43].BitLengthOfTxGrpSigInfo Com_TxGrpSigInfo[43].BitPositionOfTxGrpSigInfo Com_TxGrpSigInfo[43].BusAccOfTxGrpSigInfo Com_TxGrpSigInfo[43].ByteLengthOfTxGrpSigInfo Com_TxGrpSigInfo[43].DynSignalOfTxGrpSigInfo Com_TxGrpSigInfo[43].InvValueIdxOfTxGrpSigInfo Com_TxGrpSigInfo[43].InvValueOfTxGrpSigInfo Com_TxGrpSigInfo[43].StartByteInPduPositionOfTxGrpSigInfo Com_TxGrpSigInfo[43].TxBufferEndIdxOfTxGrpSigInfo Com_TxGrpSigInfo[43].TxBufferStartIdxOfTxGrpSigInfo Com_TxGrpSigInfo[43].TxPduInfoIdxOfTxGrpSigInfo Com_TxGrpSigInfo[43].TxSigGrpInfoIdxOfTxGrpSigInfo Com_TxGrpSigInfo[43].WithoutRepOfTxGrpSigInfo Com_TxGrpSigInfo[44].ApplTypeOfTxGrpSigInfo Com_TxGrpSigInfo[44].BitLengthOfTxGrpSigInfo Com_TxGrpSigInfo[44].BitPositionOfTxGrpSigInfo Com_TxGrpSigInfo[44].BusAccOfTxGrpSigInfo Com_TxGrpSigInfo[44].ByteLengthOfTxGrpSigInfo Com_TxGrpSigInfo[44].DynSignalOfTxGrpSigInfo Com_TxGrpSigInfo[44].InvValueIdxOfTxGrpSigInfo Com_TxGrpSigInfo[44].InvValueOfTxGrpSigInfo Com_TxGrpSigInfo[44].StartByteInPduPositionOfTxGrpSigInfo Com_TxGrpSigInfo[44].TxBufferEndIdxOfTxGrpSigInfo Com_TxGrpSigInfo[44].TxBufferStartIdxOfTxGrpSigInfo Com_TxGrpSigInfo[44].TxPduInfoIdxOfTxGrpSigInfo Com_TxGrpSigInfo[44].TxSigGrpInfoIdxOfTxGrpSigInfo Com_TxGrpSigInfo[44].WithoutRepOfTxGrpSigInfo Com_TxGrpSigInfo[45].ApplTypeOfTxGrpSigInfo Com_TxGrpSigInfo[45].BitLengthOfTxGrpSigInfo Com_TxGrpSigInfo[45].BitPositionOfTxGrpSigInfo Com_TxGrpSigInfo[45].BusAccOfTxGrpSigInfo Com_TxGrpSigInfo[45].ByteLengthOfTxGrpSigInfo Com_TxGrpSigInfo[45].DynSignalOfTxGrpSigInfo Com_TxGrpSigInfo[45].InvValueIdxOfTxGrpSigInfo Com_TxGrpSigInfo[45].InvValueOfTxGrpSigInfo Com_TxGrpSigInfo[45].StartByteInPduPositionOfTxGrpSigInfo Com_TxGrpSigInfo[45].TxBufferEndIdxOfTxGrpSigInfo Com_TxGrpSigInfo[45].TxBufferStartIdxOfTxGrpSigInfo Com_TxGrpSigInfo[45].TxPduInfoIdxOfTxGrpSigInfo Com_TxGrpSigInfo[45].TxSigGrpInfoIdxOfTxGrpSigInfo Com_TxGrpSigInfo[45].WithoutRepOfTxGrpSigInfo Com_TxGrpSigInfo[46].ApplTypeOfTxGrpSigInfo Com_TxGrpSigInfo[46].BitLengthOfTxGrpSigInfo Com_TxGrpSigInfo[46].BitPositionOfTxGrpSigInfo Com_TxGrpSigInfo[46].BusAccOfTxGrpSigInfo Com_TxGrpSigInfo[46].ByteLengthOfTxGrpSigInfo Com_TxGrpSigInfo[46].DynSignalOfTxGrpSigInfo Com_TxGrpSigInfo[46].InvValueIdxOfTxGrpSigInfo Com_TxGrpSigInfo[46].InvValueOfTxGrpSigInfo Com_TxGrpSigInfo[46].StartByteInPduPositionOfTxGrpSigInfo Com_TxGrpSigInfo[46].TxBufferEndIdxOfTxGrpSigInfo Com_TxGrpSigInfo[46].TxBufferStartIdxOfTxGrpSigInfo Com_TxGrpSigInfo[46].TxPduInfoIdxOfTxGrpSigInfo Com_TxGrpSigInfo[46].TxSigGrpInfoIdxOfTxGrpSigInfo Com_TxGrpSigInfo[46].WithoutRepOfTxGrpSigInfo Com_TxGrpSigInfo[47].ApplTypeOfTxGrpSigInfo Com_TxGrpSigInfo[47].BitLengthOfTxGrpSigInfo Com_TxGrpSigInfo[47].BitPositionOfTxGrpSigInfo Com_TxGrpSigInfo[47].BusAccOfTxGrpSigInfo Com_TxGrpSigInfo[47].ByteLengthOfTxGrpSigInfo Com_TxGrpSigInfo[47].DynSignalOfTxGrpSigInfo Com_TxGrpSigInfo[47].InvValueIdxOfTxGrpSigInfo Com_TxGrpSigInfo[47].InvValueOfTxGrpSigInfo Com_TxGrpSigInfo[47].StartByteInPduPositionOfTxGrpSigInfo Com_TxGrpSigInfo[47].TxBufferEndIdxOfTxGrpSigInfo Com_TxGrpSigInfo[47].TxBufferStartIdxOfTxGrpSigInfo Com_TxGrpSigInfo[47].TxPduInfoIdxOfTxGrpSigInfo Com_TxGrpSigInfo[47].TxSigGrpInfoIdxOfTxGrpSigInfo Com_TxGrpSigInfo[47].WithoutRepOfTxGrpSigInfo Com_TxGrpSigInfo[48].ApplTypeOfTxGrpSigInfo Com_TxGrpSigInfo[48].BitLengthOfTxGrpSigInfo Com_TxGrpSigInfo[48].BitPositionOfTxGrpSigInfo Com_TxGrpSigInfo[48].BusAccOfTxGrpSigInfo Com_TxGrpSigInfo[48].ByteLengthOfTxGrpSigInfo Com_TxGrpSigInfo[48].DynSignalOfTxGrpSigInfo Com_TxGrpSigInfo[48].InvValueIdxOfTxGrpSigInfo Com_TxGrpSigInfo[48].InvValueOfTxGrpSigInfo Com_TxGrpSigInfo[48].StartByteInPduPositionOfTxGrpSigInfo Com_TxGrpSigInfo[48].TxBufferEndIdxOfTxGrpSigInfo Com_TxGrpSigInfo[48].TxBufferStartIdxOfTxGrpSigInfo Com_TxGrpSigInfo[48].TxPduInfoIdxOfTxGrpSigInfo Com_TxGrpSigInfo[48].TxSigGrpInfoIdxOfTxGrpSigInfo Com_TxGrpSigInfo[48].WithoutRepOfTxGrpSigInfo Com_TxGrpSigInfo[49].ApplTypeOfTxGrpSigInfo Com_TxGrpSigInfo[49].BitLengthOfTxGrpSigInfo Com_TxGrpSigInfo[49].BitPositionOfTxGrpSigInfo Com_TxGrpSigInfo[49].BusAccOfTxGrpSigInfo Com_TxGrpSigInfo[49].ByteLengthOfTxGrpSigInfo Com_TxGrpSigInfo[49].DynSignalOfTxGrpSigInfo Com_TxGrpSigInfo[49].InvValueIdxOfTxGrpSigInfo Com_TxGrpSigInfo[49].InvValueOfTxGrpSigInfo Com_TxGrpSigInfo[49].StartByteInPduPositionOfTxGrpSigInfo Com_TxGrpSigInfo[49].TxBufferEndIdxOfTxGrpSigInfo Com_TxGrpSigInfo[49].TxBufferStartIdxOfTxGrpSigInfo Com_TxGrpSigInfo[49].TxPduInfoIdxOfTxGrpSigInfo Com_TxGrpSigInfo[49].TxSigGrpInfoIdxOfTxGrpSigInfo Com_TxGrpSigInfo[49].WithoutRepOfTxGrpSigInfo Com_TxGrpSigInfo[4].ApplTypeOfTxGrpSigInfo Com_TxGrpSigInfo[4].BitLengthOfTxGrpSigInfo Com_TxGrpSigInfo[4].BitPositionOfTxGrpSigInfo Com_TxGrpSigInfo[4].BusAccOfTxGrpSigInfo Com_TxGrpSigInfo[4].ByteLengthOfTxGrpSigInfo Com_TxGrpSigInfo[4].DynSignalOfTxGrpSigInfo Com_TxGrpSigInfo[4].InvValueIdxOfTxGrpSigInfo Com_TxGrpSigInfo[4].InvValueOfTxGrpSigInfo Com_TxGrpSigInfo[4].StartByteInPduPositionOfTxGrpSigInfo Com_TxGrpSigInfo[4].TxBufferEndIdxOfTxGrpSigInfo Com_TxGrpSigInfo[4].TxBufferStartIdxOfTxGrpSigInfo Com_TxGrpSigInfo[4].TxPduInfoIdxOfTxGrpSigInfo Com_TxGrpSigInfo[4].TxSigGrpInfoIdxOfTxGrpSigInfo Com_TxGrpSigInfo[4].WithoutRepOfTxGrpSigInfo Com_TxGrpSigInfo[50].ApplTypeOfTxGrpSigInfo Com_TxGrpSigInfo[50].BitLengthOfTxGrpSigInfo Com_TxGrpSigInfo[50].BitPositionOfTxGrpSigInfo Com_TxGrpSigInfo[50].BusAccOfTxGrpSigInfo Com_TxGrpSigInfo[50].ByteLengthOfTxGrpSigInfo Com_TxGrpSigInfo[50].DynSignalOfTxGrpSigInfo Com_TxGrpSigInfo[50].InvValueIdxOfTxGrpSigInfo Com_TxGrpSigInfo[50].InvValueOfTxGrpSigInfo Com_TxGrpSigInfo[50].StartByteInPduPositionOfTxGrpSigInfo Com_TxGrpSigInfo[50].TxBufferEndIdxOfTxGrpSigInfo Com_TxGrpSigInfo[50].TxBufferStartIdxOfTxGrpSigInfo Com_TxGrpSigInfo[50].TxPduInfoIdxOfTxGrpSigInfo Com_TxGrpSigInfo[50].TxSigGrpInfoIdxOfTxGrpSigInfo Com_TxGrpSigInfo[50].WithoutRepOfTxGrpSigInfo Com_TxGrpSigInfo[51].ApplTypeOfTxGrpSigInfo Com_TxGrpSigInfo[51].BitLengthOfTxGrpSigInfo Com_TxGrpSigInfo[51].BitPositionOfTxGrpSigInfo Com_TxGrpSigInfo[51].BusAccOfTxGrpSigInfo Com_TxGrpSigInfo[51].ByteLengthOfTxGrpSigInfo Com_TxGrpSigInfo[51].DynSignalOfTxGrpSigInfo Com_TxGrpSigInfo[51].InvValueIdxOfTxGrpSigInfo Com_TxGrpSigInfo[51].InvValueOfTxGrpSigInfo Com_TxGrpSigInfo[51].StartByteInPduPositionOfTxGrpSigInfo Com_TxGrpSigInfo[51].TxBufferEndIdxOfTxGrpSigInfo Com_TxGrpSigInfo[51].TxBufferStartIdxOfTxGrpSigInfo Com_TxGrpSigInfo[51].TxPduInfoIdxOfTxGrpSigInfo Com_TxGrpSigInfo[51].TxSigGrpInfoIdxOfTxGrpSigInfo Com_TxGrpSigInfo[51].WithoutRepOfTxGrpSigInfo Com_TxGrpSigInfo[52].ApplTypeOfTxGrpSigInfo Com_TxGrpSigInfo[52].BitLengthOfTxGrpSigInfo Com_TxGrpSigInfo[52].BitPositionOfTxGrpSigInfo Com_TxGrpSigInfo[52].BusAccOfTxGrpSigInfo Com_TxGrpSigInfo[52].ByteLengthOfTxGrpSigInfo Com_TxGrpSigInfo[52].DynSignalOfTxGrpSigInfo Com_TxGrpSigInfo[52].InvValueIdxOfTxGrpSigInfo Com_TxGrpSigInfo[52].InvValueOfTxGrpSigInfo Com_TxGrpSigInfo[52].StartByteInPduPositionOfTxGrpSigInfo Com_TxGrpSigInfo[52].TxBufferEndIdxOfTxGrpSigInfo Com_TxGrpSigInfo[52].TxBufferStartIdxOfTxGrpSigInfo Com_TxGrpSigInfo[52].TxPduInfoIdxOfTxGrpSigInfo Com_TxGrpSigInfo[52].TxSigGrpInfoIdxOfTxGrpSigInfo Com_TxGrpSigInfo[52].WithoutRepOfTxGrpSigInfo Com_TxGrpSigInfo[53].ApplTypeOfTxGrpSigInfo Com_TxGrpSigInfo[53].BitLengthOfTxGrpSigInfo Com_TxGrpSigInfo[53].BitPositionOfTxGrpSigInfo Com_TxGrpSigInfo[53].BusAccOfTxGrpSigInfo Com_TxGrpSigInfo[53].ByteLengthOfTxGrpSigInfo Com_TxGrpSigInfo[53].DynSignalOfTxGrpSigInfo Com_TxGrpSigInfo[53].InvValueIdxOfTxGrpSigInfo Com_TxGrpSigInfo[53].InvValueOfTxGrpSigInfo Com_TxGrpSigInfo[53].StartByteInPduPositionOfTxGrpSigInfo Com_TxGrpSigInfo[53].TxBufferEndIdxOfTxGrpSigInfo Com_TxGrpSigInfo[53].TxBufferStartIdxOfTxGrpSigInfo Com_TxGrpSigInfo[53].TxPduInfoIdxOfTxGrpSigInfo Com_TxGrpSigInfo[53].TxSigGrpInfoIdxOfTxGrpSigInfo Com_TxGrpSigInfo[53].WithoutRepOfTxGrpSigInfo Com_TxGrpSigInfo[54].ApplTypeOfTxGrpSigInfo Com_TxGrpSigInfo[54].BitLengthOfTxGrpSigInfo Com_TxGrpSigInfo[54].BitPositionOfTxGrpSigInfo Com_TxGrpSigInfo[54].BusAccOfTxGrpSigInfo Com_TxGrpSigInfo[54].ByteLengthOfTxGrpSigInfo Com_TxGrpSigInfo[54].DynSignalOfTxGrpSigInfo Com_TxGrpSigInfo[54].InvValueIdxOfTxGrpSigInfo Com_TxGrpSigInfo[54].InvValueOfTxGrpSigInfo Com_TxGrpSigInfo[54].StartByteInPduPositionOfTxGrpSigInfo Com_TxGrpSigInfo[54].TxBufferEndIdxOfTxGrpSigInfo Com_TxGrpSigInfo[54].TxBufferStartIdxOfTxGrpSigInfo Com_TxGrpSigInfo[54].TxPduInfoIdxOfTxGrpSigInfo Com_TxGrpSigInfo[54].TxSigGrpInfoIdxOfTxGrpSigInfo Com_TxGrpSigInfo[54].WithoutRepOfTxGrpSigInfo Com_TxGrpSigInfo[55].ApplTypeOfTxGrpSigInfo Com_TxGrpSigInfo[55].BitLengthOfTxGrpSigInfo Com_TxGrpSigInfo[55].BitPositionOfTxGrpSigInfo Com_TxGrpSigInfo[55].BusAccOfTxGrpSigInfo Com_TxGrpSigInfo[55].ByteLengthOfTxGrpSigInfo Com_TxGrpSigInfo[55].DynSignalOfTxGrpSigInfo Com_TxGrpSigInfo[55].InvValueIdxOfTxGrpSigInfo Com_TxGrpSigInfo[55].InvValueOfTxGrpSigInfo Com_TxGrpSigInfo[55].StartByteInPduPositionOfTxGrpSigInfo Com_TxGrpSigInfo[55].TxBufferEndIdxOfTxGrpSigInfo Com_TxGrpSigInfo[55].TxBufferStartIdxOfTxGrpSigInfo Com_TxGrpSigInfo[55].TxPduInfoIdxOfTxGrpSigInfo Com_TxGrpSigInfo[55].TxSigGrpInfoIdxOfTxGrpSigInfo Com_TxGrpSigInfo[55].WithoutRepOfTxGrpSigInfo Com_TxGrpSigInfo[56].ApplTypeOfTxGrpSigInfo Com_TxGrpSigInfo[56].BitLengthOfTxGrpSigInfo Com_TxGrpSigInfo[56].BitPositionOfTxGrpSigInfo Com_TxGrpSigInfo[56].BusAccOfTxGrpSigInfo Com_TxGrpSigInfo[56].ByteLengthOfTxGrpSigInfo Com_TxGrpSigInfo[56].DynSignalOfTxGrpSigInfo Com_TxGrpSigInfo[56].InvValueIdxOfTxGrpSigInfo Com_TxGrpSigInfo[56].InvValueOfTxGrpSigInfo Com_TxGrpSigInfo[56].StartByteInPduPositionOfTxGrpSigInfo Com_TxGrpSigInfo[56].TxBufferEndIdxOfTxGrpSigInfo Com_TxGrpSigInfo[56].TxBufferStartIdxOfTxGrpSigInfo Com_TxGrpSigInfo[56].TxPduInfoIdxOfTxGrpSigInfo Com_TxGrpSigInfo[56].TxSigGrpInfoIdxOfTxGrpSigInfo Com_TxGrpSigInfo[56].WithoutRepOfTxGrpSigInfo Com_TxGrpSigInfo[57].ApplTypeOfTxGrpSigInfo Com_TxGrpSigInfo[57].BitLengthOfTxGrpSigInfo Com_TxGrpSigInfo[57].BitPositionOfTxGrpSigInfo Com_TxGrpSigInfo[57].BusAccOfTxGrpSigInfo Com_TxGrpSigInfo[57].ByteLengthOfTxGrpSigInfo Com_TxGrpSigInfo[57].DynSignalOfTxGrpSigInfo Com_TxGrpSigInfo[57].InvValueIdxOfTxGrpSigInfo Com_TxGrpSigInfo[57].InvValueOfTxGrpSigInfo Com_TxGrpSigInfo[57].StartByteInPduPositionOfTxGrpSigInfo Com_TxGrpSigInfo[57].TxBufferEndIdxOfTxGrpSigInfo Com_TxGrpSigInfo[57].TxBufferStartIdxOfTxGrpSigInfo Com_TxGrpSigInfo[57].TxPduInfoIdxOfTxGrpSigInfo Com_TxGrpSigInfo[57].TxSigGrpInfoIdxOfTxGrpSigInfo Com_TxGrpSigInfo[57].WithoutRepOfTxGrpSigInfo Com_TxGrpSigInfo[58].ApplTypeOfTxGrpSigInfo Com_TxGrpSigInfo[58].BitLengthOfTxGrpSigInfo Com_TxGrpSigInfo[58].BitPositionOfTxGrpSigInfo Com_TxGrpSigInfo[58].BusAccOfTxGrpSigInfo Com_TxGrpSigInfo[58].ByteLengthOfTxGrpSigInfo Com_TxGrpSigInfo[58].DynSignalOfTxGrpSigInfo Com_TxGrpSigInfo[58].InvValueIdxOfTxGrpSigInfo Com_TxGrpSigInfo[58].InvValueOfTxGrpSigInfo Com_TxGrpSigInfo[58].StartByteInPduPositionOfTxGrpSigInfo Com_TxGrpSigInfo[58].TxBufferEndIdxOfTxGrpSigInfo Com_TxGrpSigInfo[58].TxBufferStartIdxOfTxGrpSigInfo Com_TxGrpSigInfo[58].TxPduInfoIdxOfTxGrpSigInfo Com_TxGrpSigInfo[58].TxSigGrpInfoIdxOfTxGrpSigInfo Com_TxGrpSigInfo[58].WithoutRepOfTxGrpSigInfo Com_TxGrpSigInfo[59].ApplTypeOfTxGrpSigInfo Com_TxGrpSigInfo[59].BitLengthOfTxGrpSigInfo Com_TxGrpSigInfo[59].BitPositionOfTxGrpSigInfo Com_TxGrpSigInfo[59].BusAccOfTxGrpSigInfo Com_TxGrpSigInfo[59].ByteLengthOfTxGrpSigInfo Com_TxGrpSigInfo[59].DynSignalOfTxGrpSigInfo Com_TxGrpSigInfo[59].InvValueIdxOfTxGrpSigInfo Com_TxGrpSigInfo[59].InvValueOfTxGrpSigInfo Com_TxGrpSigInfo[59].StartByteInPduPositionOfTxGrpSigInfo Com_TxGrpSigInfo[59].TxBufferEndIdxOfTxGrpSigInfo Com_TxGrpSigInfo[59].TxBufferStartIdxOfTxGrpSigInfo Com_TxGrpSigInfo[59].TxPduInfoIdxOfTxGrpSigInfo Com_TxGrpSigInfo[59].TxSigGrpInfoIdxOfTxGrpSigInfo Com_TxGrpSigInfo[59].WithoutRepOfTxGrpSigInfo Com_TxGrpSigInfo[5].ApplTypeOfTxGrpSigInfo Com_TxGrpSigInfo[5].BitLengthOfTxGrpSigInfo Com_TxGrpSigInfo[5].BitPositionOfTxGrpSigInfo Com_TxGrpSigInfo[5].BusAccOfTxGrpSigInfo Com_TxGrpSigInfo[5].ByteLengthOfTxGrpSigInfo Com_TxGrpSigInfo[5].DynSignalOfTxGrpSigInfo Com_TxGrpSigInfo[5].InvValueIdxOfTxGrpSigInfo Com_TxGrpSigInfo[5].InvValueOfTxGrpSigInfo Com_TxGrpSigInfo[5].StartByteInPduPositionOfTxGrpSigInfo Com_TxGrpSigInfo[5].TxBufferEndIdxOfTxGrpSigInfo Com_TxGrpSigInfo[5].TxBufferStartIdxOfTxGrpSigInfo Com_TxGrpSigInfo[5].TxPduInfoIdxOfTxGrpSigInfo Com_TxGrpSigInfo[5].TxSigGrpInfoIdxOfTxGrpSigInfo Com_TxGrpSigInfo[5].WithoutRepOfTxGrpSigInfo Com_TxGrpSigInfo[60].ApplTypeOfTxGrpSigInfo Com_TxGrpSigInfo[60].BitLengthOfTxGrpSigInfo Com_TxGrpSigInfo[60].BitPositionOfTxGrpSigInfo Com_TxGrpSigInfo[60].BusAccOfTxGrpSigInfo Com_TxGrpSigInfo[60].ByteLengthOfTxGrpSigInfo Com_TxGrpSigInfo[60].DynSignalOfTxGrpSigInfo Com_TxGrpSigInfo[60].InvValueIdxOfTxGrpSigInfo Com_TxGrpSigInfo[60].InvValueOfTxGrpSigInfo Com_TxGrpSigInfo[60].StartByteInPduPositionOfTxGrpSigInfo Com_TxGrpSigInfo[60].TxBufferEndIdxOfTxGrpSigInfo Com_TxGrpSigInfo[60].TxBufferStartIdxOfTxGrpSigInfo Com_TxGrpSigInfo[60].TxPduInfoIdxOfTxGrpSigInfo Com_TxGrpSigInfo[60].TxSigGrpInfoIdxOfTxGrpSigInfo Com_TxGrpSigInfo[60].WithoutRepOfTxGrpSigInfo Com_TxGrpSigInfo[61].ApplTypeOfTxGrpSigInfo Com_TxGrpSigInfo[61].BitLengthOfTxGrpSigInfo Com_TxGrpSigInfo[61].BitPositionOfTxGrpSigInfo Com_TxGrpSigInfo[61].BusAccOfTxGrpSigInfo Com_TxGrpSigInfo[61].ByteLengthOfTxGrpSigInfo Com_TxGrpSigInfo[61].DynSignalOfTxGrpSigInfo Com_TxGrpSigInfo[61].InvValueIdxOfTxGrpSigInfo Com_TxGrpSigInfo[61].InvValueOfTxGrpSigInfo Com_TxGrpSigInfo[61].StartByteInPduPositionOfTxGrpSigInfo Com_TxGrpSigInfo[61].TxBufferEndIdxOfTxGrpSigInfo Com_TxGrpSigInfo[61].TxBufferStartIdxOfTxGrpSigInfo Com_TxGrpSigInfo[61].TxPduInfoIdxOfTxGrpSigInfo Com_TxGrpSigInfo[61].TxSigGrpInfoIdxOfTxGrpSigInfo Com_TxGrpSigInfo[61].WithoutRepOfTxGrpSigInfo Com_TxGrpSigInfo[62].ApplTypeOfTxGrpSigInfo Com_TxGrpSigInfo[62].BitLengthOfTxGrpSigInfo Com_TxGrpSigInfo[62].BitPositionOfTxGrpSigInfo Com_TxGrpSigInfo[62].BusAccOfTxGrpSigInfo Com_TxGrpSigInfo[62].ByteLengthOfTxGrpSigInfo Com_TxGrpSigInfo[62].DynSignalOfTxGrpSigInfo Com_TxGrpSigInfo[62].InvValueIdxOfTxGrpSigInfo Com_TxGrpSigInfo[62].InvValueOfTxGrpSigInfo Com_TxGrpSigInfo[62].StartByteInPduPositionOfTxGrpSigInfo Com_TxGrpSigInfo[62].TxBufferEndIdxOfTxGrpSigInfo Com_TxGrpSigInfo[62].TxBufferStartIdxOfTxGrpSigInfo Com_TxGrpSigInfo[62].TxPduInfoIdxOfTxGrpSigInfo Com_TxGrpSigInfo[62].TxSigGrpInfoIdxOfTxGrpSigInfo Com_TxGrpSigInfo[62].WithoutRepOfTxGrpSigInfo Com_TxGrpSigInfo[63].ApplTypeOfTxGrpSigInfo Com_TxGrpSigInfo[63].BitLengthOfTxGrpSigInfo Com_TxGrpSigInfo[63].BitPositionOfTxGrpSigInfo Com_TxGrpSigInfo[63].BusAccOfTxGrpSigInfo Com_TxGrpSigInfo[63].ByteLengthOfTxGrpSigInfo Com_TxGrpSigInfo[63].DynSignalOfTxGrpSigInfo Com_TxGrpSigInfo[63].InvValueIdxOfTxGrpSigInfo Com_TxGrpSigInfo[63].InvValueOfTxGrpSigInfo Com_TxGrpSigInfo[63].StartByteInPduPositionOfTxGrpSigInfo Com_TxGrpSigInfo[63].TxBufferEndIdxOfTxGrpSigInfo Com_TxGrpSigInfo[63].TxBufferStartIdxOfTxGrpSigInfo Com_TxGrpSigInfo[63].TxPduInfoIdxOfTxGrpSigInfo Com_TxGrpSigInfo[63].TxSigGrpInfoIdxOfTxGrpSigInfo Com_TxGrpSigInfo[63].WithoutRepOfTxGrpSigInfo Com_TxGrpSigInfo[64].ApplTypeOfTxGrpSigInfo Com_TxGrpSigInfo[64].BitLengthOfTxGrpSigInfo Com_TxGrpSigInfo[64].BitPositionOfTxGrpSigInfo Com_TxGrpSigInfo[64].BusAccOfTxGrpSigInfo Com_TxGrpSigInfo[64].ByteLengthOfTxGrpSigInfo Com_TxGrpSigInfo[64].DynSignalOfTxGrpSigInfo Com_TxGrpSigInfo[64].InvValueIdxOfTxGrpSigInfo Com_TxGrpSigInfo[64].InvValueOfTxGrpSigInfo Com_TxGrpSigInfo[64].StartByteInPduPositionOfTxGrpSigInfo Com_TxGrpSigInfo[64].TxBufferEndIdxOfTxGrpSigInfo Com_TxGrpSigInfo[64].TxBufferStartIdxOfTxGrpSigInfo Com_TxGrpSigInfo[64].TxPduInfoIdxOfTxGrpSigInfo Com_TxGrpSigInfo[64].TxSigGrpInfoIdxOfTxGrpSigInfo Com_TxGrpSigInfo[64].WithoutRepOfTxGrpSigInfo Com_TxGrpSigInfo[65].ApplTypeOfTxGrpSigInfo Com_TxGrpSigInfo[65].BitLengthOfTxGrpSigInfo Com_TxGrpSigInfo[65].BitPositionOfTxGrpSigInfo Com_TxGrpSigInfo[65].BusAccOfTxGrpSigInfo Com_TxGrpSigInfo[65].ByteLengthOfTxGrpSigInfo Com_TxGrpSigInfo[65].DynSignalOfTxGrpSigInfo Com_TxGrpSigInfo[65].InvValueIdxOfTxGrpSigInfo Com_TxGrpSigInfo[65].InvValueOfTxGrpSigInfo Com_TxGrpSigInfo[65].StartByteInPduPositionOfTxGrpSigInfo Com_TxGrpSigInfo[65].TxBufferEndIdxOfTxGrpSigInfo Com_TxGrpSigInfo[65].TxBufferStartIdxOfTxGrpSigInfo Com_TxGrpSigInfo[65].TxPduInfoIdxOfTxGrpSigInfo Com_TxGrpSigInfo[65].TxSigGrpInfoIdxOfTxGrpSigInfo Com_TxGrpSigInfo[65].WithoutRepOfTxGrpSigInfo Com_TxGrpSigInfo[66].ApplTypeOfTxGrpSigInfo Com_TxGrpSigInfo[66].BitLengthOfTxGrpSigInfo Com_TxGrpSigInfo[66].BitPositionOfTxGrpSigInfo Com_TxGrpSigInfo[66].BusAccOfTxGrpSigInfo Com_TxGrpSigInfo[66].ByteLengthOfTxGrpSigInfo Com_TxGrpSigInfo[66].DynSignalOfTxGrpSigInfo Com_TxGrpSigInfo[66].InvValueIdxOfTxGrpSigInfo Com_TxGrpSigInfo[66].InvValueOfTxGrpSigInfo Com_TxGrpSigInfo[66].StartByteInPduPositionOfTxGrpSigInfo Com_TxGrpSigInfo[66].TxBufferEndIdxOfTxGrpSigInfo Com_TxGrpSigInfo[66].TxBufferStartIdxOfTxGrpSigInfo Com_TxGrpSigInfo[66].TxPduInfoIdxOfTxGrpSigInfo Com_TxGrpSigInfo[66].TxSigGrpInfoIdxOfTxGrpSigInfo Com_TxGrpSigInfo[66].WithoutRepOfTxGrpSigInfo Com_TxGrpSigInfo[67].ApplTypeOfTxGrpSigInfo Com_TxGrpSigInfo[67].BitLengthOfTxGrpSigInfo Com_TxGrpSigInfo[67].BitPositionOfTxGrpSigInfo Com_TxGrpSigInfo[67].BusAccOfTxGrpSigInfo Com_TxGrpSigInfo[67].ByteLengthOfTxGrpSigInfo Com_TxGrpSigInfo[67].DynSignalOfTxGrpSigInfo Com_TxGrpSigInfo[67].InvValueIdxOfTxGrpSigInfo Com_TxGrpSigInfo[67].InvValueOfTxGrpSigInfo Com_TxGrpSigInfo[67].StartByteInPduPositionOfTxGrpSigInfo Com_TxGrpSigInfo[67].TxBufferEndIdxOfTxGrpSigInfo Com_TxGrpSigInfo[67].TxBufferStartIdxOfTxGrpSigInfo Com_TxGrpSigInfo[67].TxPduInfoIdxOfTxGrpSigInfo Com_TxGrpSigInfo[67].TxSigGrpInfoIdxOfTxGrpSigInfo Com_TxGrpSigInfo[67].WithoutRepOfTxGrpSigInfo Com_TxGrpSigInfo[68].ApplTypeOfTxGrpSigInfo Com_TxGrpSigInfo[68].BitLengthOfTxGrpSigInfo Com_TxGrpSigInfo[68].BitPositionOfTxGrpSigInfo Com_TxGrpSigInfo[68].BusAccOfTxGrpSigInfo Com_TxGrpSigInfo[68].ByteLengthOfTxGrpSigInfo Com_TxGrpSigInfo[68].DynSignalOfTxGrpSigInfo Com_TxGrpSigInfo[68].InvValueIdxOfTxGrpSigInfo Com_TxGrpSigInfo[68].InvValueOfTxGrpSigInfo Com_TxGrpSigInfo[68].StartByteInPduPositionOfTxGrpSigInfo Com_TxGrpSigInfo[68].TxBufferEndIdxOfTxGrpSigInfo Com_TxGrpSigInfo[68].TxBufferStartIdxOfTxGrpSigInfo Com_TxGrpSigInfo[68].TxPduInfoIdxOfTxGrpSigInfo Com_TxGrpSigInfo[68].TxSigGrpInfoIdxOfTxGrpSigInfo Com_TxGrpSigInfo[68].WithoutRepOfTxGrpSigInfo Com_TxGrpSigInfo[69].ApplTypeOfTxGrpSigInfo Com_TxGrpSigInfo[69].BitLengthOfTxGrpSigInfo Com_TxGrpSigInfo[69].BitPositionOfTxGrpSigInfo Com_TxGrpSigInfo[69].BusAccOfTxGrpSigInfo Com_TxGrpSigInfo[69].ByteLengthOfTxGrpSigInfo Com_TxGrpSigInfo[69].DynSignalOfTxGrpSigInfo Com_TxGrpSigInfo[69].InvValueIdxOfTxGrpSigInfo Com_TxGrpSigInfo[69].InvValueOfTxGrpSigInfo Com_TxGrpSigInfo[69].StartByteInPduPositionOfTxGrpSigInfo Com_TxGrpSigInfo[69].TxBufferEndIdxOfTxGrpSigInfo Com_TxGrpSigInfo[69].TxBufferStartIdxOfTxGrpSigInfo Com_TxGrpSigInfo[69].TxPduInfoIdxOfTxGrpSigInfo Com_TxGrpSigInfo[69].TxSigGrpInfoIdxOfTxGrpSigInfo Com_TxGrpSigInfo[69].WithoutRepOfTxGrpSigInfo Com_TxGrpSigInfo[6].ApplTypeOfTxGrpSigInfo Com_TxGrpSigInfo[6].BitLengthOfTxGrpSigInfo Com_TxGrpSigInfo[6].BitPositionOfTxGrpSigInfo Com_TxGrpSigInfo[6].BusAccOfTxGrpSigInfo Com_TxGrpSigInfo[6].ByteLengthOfTxGrpSigInfo Com_TxGrpSigInfo[6].DynSignalOfTxGrpSigInfo Com_TxGrpSigInfo[6].InvValueIdxOfTxGrpSigInfo Com_TxGrpSigInfo[6].InvValueOfTxGrpSigInfo Com_TxGrpSigInfo[6].StartByteInPduPositionOfTxGrpSigInfo Com_TxGrpSigInfo[6].TxBufferEndIdxOfTxGrpSigInfo Com_TxGrpSigInfo[6].TxBufferStartIdxOfTxGrpSigInfo Com_TxGrpSigInfo[6].TxPduInfoIdxOfTxGrpSigInfo Com_TxGrpSigInfo[6].TxSigGrpInfoIdxOfTxGrpSigInfo Com_TxGrpSigInfo[6].WithoutRepOfTxGrpSigInfo Com_TxGrpSigInfo[70].ApplTypeOfTxGrpSigInfo Com_TxGrpSigInfo[70].BitLengthOfTxGrpSigInfo Com_TxGrpSigInfo[70].BitPositionOfTxGrpSigInfo Com_TxGrpSigInfo[70].BusAccOfTxGrpSigInfo Com_TxGrpSigInfo[70].ByteLengthOfTxGrpSigInfo Com_TxGrpSigInfo[70].DynSignalOfTxGrpSigInfo Com_TxGrpSigInfo[70].InvValueIdxOfTxGrpSigInfo Com_TxGrpSigInfo[70].InvValueOfTxGrpSigInfo Com_TxGrpSigInfo[70].StartByteInPduPositionOfTxGrpSigInfo Com_TxGrpSigInfo[70].TxBufferEndIdxOfTxGrpSigInfo Com_TxGrpSigInfo[70].TxBufferStartIdxOfTxGrpSigInfo Com_TxGrpSigInfo[70].TxPduInfoIdxOfTxGrpSigInfo Com_TxGrpSigInfo[70].TxSigGrpInfoIdxOfTxGrpSigInfo Com_TxGrpSigInfo[70].WithoutRepOfTxGrpSigInfo Com_TxGrpSigInfo[71].ApplTypeOfTxGrpSigInfo Com_TxGrpSigInfo[71].BitLengthOfTxGrpSigInfo Com_TxGrpSigInfo[71].BitPositionOfTxGrpSigInfo Com_TxGrpSigInfo[71].BusAccOfTxGrpSigInfo Com_TxGrpSigInfo[71].ByteLengthOfTxGrpSigInfo Com_TxGrpSigInfo[71].DynSignalOfTxGrpSigInfo Com_TxGrpSigInfo[71].InvValueIdxOfTxGrpSigInfo Com_TxGrpSigInfo[71].InvValueOfTxGrpSigInfo Com_TxGrpSigInfo[71].StartByteInPduPositionOfTxGrpSigInfo Com_TxGrpSigInfo[71].TxBufferEndIdxOfTxGrpSigInfo Com_TxGrpSigInfo[71].TxBufferStartIdxOfTxGrpSigInfo Com_TxGrpSigInfo[71].TxPduInfoIdxOfTxGrpSigInfo Com_TxGrpSigInfo[71].TxSigGrpInfoIdxOfTxGrpSigInfo Com_TxGrpSigInfo[71].WithoutRepOfTxGrpSigInfo Com_TxGrpSigInfo[72].ApplTypeOfTxGrpSigInfo Com_TxGrpSigInfo[72].BitLengthOfTxGrpSigInfo Com_TxGrpSigInfo[72].BitPositionOfTxGrpSigInfo Com_TxGrpSigInfo[72].BusAccOfTxGrpSigInfo Com_TxGrpSigInfo[72].ByteLengthOfTxGrpSigInfo Com_TxGrpSigInfo[72].DynSignalOfTxGrpSigInfo Com_TxGrpSigInfo[72].InvValueIdxOfTxGrpSigInfo Com_TxGrpSigInfo[72].InvValueOfTxGrpSigInfo Com_TxGrpSigInfo[72].StartByteInPduPositionOfTxGrpSigInfo Com_TxGrpSigInfo[72].TxBufferEndIdxOfTxGrpSigInfo Com_TxGrpSigInfo[72].TxBufferStartIdxOfTxGrpSigInfo Com_TxGrpSigInfo[72].TxPduInfoIdxOfTxGrpSigInfo Com_TxGrpSigInfo[72].TxSigGrpInfoIdxOfTxGrpSigInfo Com_TxGrpSigInfo[72].WithoutRepOfTxGrpSigInfo Com_TxGrpSigInfo[73].ApplTypeOfTxGrpSigInfo Com_TxGrpSigInfo[73].BitLengthOfTxGrpSigInfo Com_TxGrpSigInfo[73].BitPositionOfTxGrpSigInfo Com_TxGrpSigInfo[73].BusAccOfTxGrpSigInfo Com_TxGrpSigInfo[73].ByteLengthOfTxGrpSigInfo Com_TxGrpSigInfo[73].DynSignalOfTxGrpSigInfo Com_TxGrpSigInfo[73].InvValueIdxOfTxGrpSigInfo Com_TxGrpSigInfo[73].InvValueOfTxGrpSigInfo Com_TxGrpSigInfo[73].StartByteInPduPositionOfTxGrpSigInfo Com_TxGrpSigInfo[73].TxBufferEndIdxOfTxGrpSigInfo Com_TxGrpSigInfo[73].TxBufferStartIdxOfTxGrpSigInfo Com_TxGrpSigInfo[73].TxPduInfoIdxOfTxGrpSigInfo Com_TxGrpSigInfo[73].TxSigGrpInfoIdxOfTxGrpSigInfo Com_TxGrpSigInfo[73].WithoutRepOfTxGrpSigInfo Com_TxGrpSigInfo[74].ApplTypeOfTxGrpSigInfo Com_TxGrpSigInfo[74].BitLengthOfTxGrpSigInfo Com_TxGrpSigInfo[74].BitPositionOfTxGrpSigInfo Com_TxGrpSigInfo[74].BusAccOfTxGrpSigInfo Com_TxGrpSigInfo[74].ByteLengthOfTxGrpSigInfo Com_TxGrpSigInfo[74].DynSignalOfTxGrpSigInfo Com_TxGrpSigInfo[74].InvValueIdxOfTxGrpSigInfo Com_TxGrpSigInfo[74].InvValueOfTxGrpSigInfo Com_TxGrpSigInfo[74].StartByteInPduPositionOfTxGrpSigInfo Com_TxGrpSigInfo[74].TxBufferEndIdxOfTxGrpSigInfo Com_TxGrpSigInfo[74].TxBufferStartIdxOfTxGrpSigInfo Com_TxGrpSigInfo[74].TxPduInfoIdxOfTxGrpSigInfo Com_TxGrpSigInfo[74].TxSigGrpInfoIdxOfTxGrpSigInfo Com_TxGrpSigInfo[74].WithoutRepOfTxGrpSigInfo Com_TxGrpSigInfo[75].ApplTypeOfTxGrpSigInfo Com_TxGrpSigInfo[75].BitLengthOfTxGrpSigInfo Com_TxGrpSigInfo[75].BitPositionOfTxGrpSigInfo Com_TxGrpSigInfo[75].BusAccOfTxGrpSigInfo Com_TxGrpSigInfo[75].ByteLengthOfTxGrpSigInfo Com_TxGrpSigInfo[75].DynSignalOfTxGrpSigInfo Com_TxGrpSigInfo[75].InvValueIdxOfTxGrpSigInfo Com_TxGrpSigInfo[75].InvValueOfTxGrpSigInfo Com_TxGrpSigInfo[75].StartByteInPduPositionOfTxGrpSigInfo Com_TxGrpSigInfo[75].TxBufferEndIdxOfTxGrpSigInfo Com_TxGrpSigInfo[75].TxBufferStartIdxOfTxGrpSigInfo Com_TxGrpSigInfo[75].TxPduInfoIdxOfTxGrpSigInfo Com_TxGrpSigInfo[75].TxSigGrpInfoIdxOfTxGrpSigInfo Com_TxGrpSigInfo[75].WithoutRepOfTxGrpSigInfo Com_TxGrpSigInfo[76].ApplTypeOfTxGrpSigInfo Com_TxGrpSigInfo[76].BitLengthOfTxGrpSigInfo Com_TxGrpSigInfo[76].BitPositionOfTxGrpSigInfo Com_TxGrpSigInfo[76].BusAccOfTxGrpSigInfo Com_TxGrpSigInfo[76].ByteLengthOfTxGrpSigInfo Com_TxGrpSigInfo[76].DynSignalOfTxGrpSigInfo Com_TxGrpSigInfo[76].InvValueIdxOfTxGrpSigInfo Com_TxGrpSigInfo[76].InvValueOfTxGrpSigInfo Com_TxGrpSigInfo[76].StartByteInPduPositionOfTxGrpSigInfo Com_TxGrpSigInfo[76].TxBufferEndIdxOfTxGrpSigInfo Com_TxGrpSigInfo[76].TxBufferStartIdxOfTxGrpSigInfo Com_TxGrpSigInfo[76].TxPduInfoIdxOfTxGrpSigInfo Com_TxGrpSigInfo[76].TxSigGrpInfoIdxOfTxGrpSigInfo Com_TxGrpSigInfo[76].WithoutRepOfTxGrpSigInfo Com_TxGrpSigInfo[77].ApplTypeOfTxGrpSigInfo Com_TxGrpSigInfo[77].BitLengthOfTxGrpSigInfo Com_TxGrpSigInfo[77].BitPositionOfTxGrpSigInfo Com_TxGrpSigInfo[77].BusAccOfTxGrpSigInfo Com_TxGrpSigInfo[77].ByteLengthOfTxGrpSigInfo Com_TxGrpSigInfo[77].DynSignalOfTxGrpSigInfo Com_TxGrpSigInfo[77].InvValueIdxOfTxGrpSigInfo Com_TxGrpSigInfo[77].InvValueOfTxGrpSigInfo Com_TxGrpSigInfo[77].StartByteInPduPositionOfTxGrpSigInfo Com_TxGrpSigInfo[77].TxBufferEndIdxOfTxGrpSigInfo Com_TxGrpSigInfo[77].TxBufferStartIdxOfTxGrpSigInfo Com_TxGrpSigInfo[77].TxPduInfoIdxOfTxGrpSigInfo Com_TxGrpSigInfo[77].TxSigGrpInfoIdxOfTxGrpSigInfo Com_TxGrpSigInfo[77].WithoutRepOfTxGrpSigInfo Com_TxGrpSigInfo[78].ApplTypeOfTxGrpSigInfo Com_TxGrpSigInfo[78].BitLengthOfTxGrpSigInfo Com_TxGrpSigInfo[78].BitPositionOfTxGrpSigInfo Com_TxGrpSigInfo[78].BusAccOfTxGrpSigInfo Com_TxGrpSigInfo[78].ByteLengthOfTxGrpSigInfo Com_TxGrpSigInfo[78].DynSignalOfTxGrpSigInfo Com_TxGrpSigInfo[78].InvValueIdxOfTxGrpSigInfo Com_TxGrpSigInfo[78].InvValueOfTxGrpSigInfo Com_TxGrpSigInfo[78].StartByteInPduPositionOfTxGrpSigInfo Com_TxGrpSigInfo[78].TxBufferEndIdxOfTxGrpSigInfo Com_TxGrpSigInfo[78].TxBufferStartIdxOfTxGrpSigInfo Com_TxGrpSigInfo[78].TxPduInfoIdxOfTxGrpSigInfo Com_TxGrpSigInfo[78].TxSigGrpInfoIdxOfTxGrpSigInfo Com_TxGrpSigInfo[78].WithoutRepOfTxGrpSigInfo Com_TxGrpSigInfo[79].ApplTypeOfTxGrpSigInfo Com_TxGrpSigInfo[79].BitLengthOfTxGrpSigInfo Com_TxGrpSigInfo[79].BitPositionOfTxGrpSigInfo Com_TxGrpSigInfo[79].BusAccOfTxGrpSigInfo Com_TxGrpSigInfo[79].ByteLengthOfTxGrpSigInfo Com_TxGrpSigInfo[79].DynSignalOfTxGrpSigInfo Com_TxGrpSigInfo[79].InvValueIdxOfTxGrpSigInfo Com_TxGrpSigInfo[79].InvValueOfTxGrpSigInfo Com_TxGrpSigInfo[79].StartByteInPduPositionOfTxGrpSigInfo Com_TxGrpSigInfo[79].TxBufferEndIdxOfTxGrpSigInfo Com_TxGrpSigInfo[79].TxBufferStartIdxOfTxGrpSigInfo Com_TxGrpSigInfo[79].TxPduInfoIdxOfTxGrpSigInfo Com_TxGrpSigInfo[79].TxSigGrpInfoIdxOfTxGrpSigInfo Com_TxGrpSigInfo[79].WithoutRepOfTxGrpSigInfo Com_TxGrpSigInfo[7].ApplTypeOfTxGrpSigInfo Com_TxGrpSigInfo[7].BitLengthOfTxGrpSigInfo Com_TxGrpSigInfo[7].BitPositionOfTxGrpSigInfo Com_TxGrpSigInfo[7].BusAccOfTxGrpSigInfo Com_TxGrpSigInfo[7].ByteLengthOfTxGrpSigInfo Com_TxGrpSigInfo[7].DynSignalOfTxGrpSigInfo Com_TxGrpSigInfo[7].InvValueIdxOfTxGrpSigInfo Com_TxGrpSigInfo[7].InvValueOfTxGrpSigInfo Com_TxGrpSigInfo[7].StartByteInPduPositionOfTxGrpSigInfo Com_TxGrpSigInfo[7].TxBufferEndIdxOfTxGrpSigInfo Com_TxGrpSigInfo[7].TxBufferStartIdxOfTxGrpSigInfo Com_TxGrpSigInfo[7].TxPduInfoIdxOfTxGrpSigInfo Com_TxGrpSigInfo[7].TxSigGrpInfoIdxOfTxGrpSigInfo Com_TxGrpSigInfo[7].WithoutRepOfTxGrpSigInfo Com_TxGrpSigInfo[80].ApplTypeOfTxGrpSigInfo Com_TxGrpSigInfo[80].BitLengthOfTxGrpSigInfo Com_TxGrpSigInfo[80].BitPositionOfTxGrpSigInfo Com_TxGrpSigInfo[80].BusAccOfTxGrpSigInfo Com_TxGrpSigInfo[80].ByteLengthOfTxGrpSigInfo Com_TxGrpSigInfo[80].DynSignalOfTxGrpSigInfo Com_TxGrpSigInfo[80].InvValueIdxOfTxGrpSigInfo Com_TxGrpSigInfo[80].InvValueOfTxGrpSigInfo Com_TxGrpSigInfo[80].StartByteInPduPositionOfTxGrpSigInfo Com_TxGrpSigInfo[80].TxBufferEndIdxOfTxGrpSigInfo Com_TxGrpSigInfo[80].TxBufferStartIdxOfTxGrpSigInfo Com_TxGrpSigInfo[80].TxPduInfoIdxOfTxGrpSigInfo Com_TxGrpSigInfo[80].TxSigGrpInfoIdxOfTxGrpSigInfo Com_TxGrpSigInfo[80].WithoutRepOfTxGrpSigInfo Com_TxGrpSigInfo[81].ApplTypeOfTxGrpSigInfo Com_TxGrpSigInfo[81].BitLengthOfTxGrpSigInfo Com_TxGrpSigInfo[81].BitPositionOfTxGrpSigInfo Com_TxGrpSigInfo[81].BusAccOfTxGrpSigInfo Com_TxGrpSigInfo[81].ByteLengthOfTxGrpSigInfo Com_TxGrpSigInfo[81].DynSignalOfTxGrpSigInfo Com_TxGrpSigInfo[81].InvValueIdxOfTxGrpSigInfo Com_TxGrpSigInfo[81].InvValueOfTxGrpSigInfo Com_TxGrpSigInfo[81].StartByteInPduPositionOfTxGrpSigInfo Com_TxGrpSigInfo[81].TxBufferEndIdxOfTxGrpSigInfo Com_TxGrpSigInfo[81].TxBufferStartIdxOfTxGrpSigInfo Com_TxGrpSigInfo[81].TxPduInfoIdxOfTxGrpSigInfo Com_TxGrpSigInfo[81].TxSigGrpInfoIdxOfTxGrpSigInfo Com_TxGrpSigInfo[81].WithoutRepOfTxGrpSigInfo Com_TxGrpSigInfo[82].ApplTypeOfTxGrpSigInfo Com_TxGrpSigInfo[82].BitLengthOfTxGrpSigInfo Com_TxGrpSigInfo[82].BitPositionOfTxGrpSigInfo Com_TxGrpSigInfo[82].BusAccOfTxGrpSigInfo Com_TxGrpSigInfo[82].ByteLengthOfTxGrpSigInfo Com_TxGrpSigInfo[82].DynSignalOfTxGrpSigInfo Com_TxGrpSigInfo[82].InvValueIdxOfTxGrpSigInfo Com_TxGrpSigInfo[82].InvValueOfTxGrpSigInfo Com_TxGrpSigInfo[82].StartByteInPduPositionOfTxGrpSigInfo Com_TxGrpSigInfo[82].TxBufferEndIdxOfTxGrpSigInfo Com_TxGrpSigInfo[82].TxBufferStartIdxOfTxGrpSigInfo Com_TxGrpSigInfo[82].TxPduInfoIdxOfTxGrpSigInfo Com_TxGrpSigInfo[82].TxSigGrpInfoIdxOfTxGrpSigInfo Com_TxGrpSigInfo[82].WithoutRepOfTxGrpSigInfo Com_TxGrpSigInfo[83].ApplTypeOfTxGrpSigInfo Com_TxGrpSigInfo[83].BitLengthOfTxGrpSigInfo Com_TxGrpSigInfo[83].BitPositionOfTxGrpSigInfo Com_TxGrpSigInfo[83].BusAccOfTxGrpSigInfo Com_TxGrpSigInfo[83].ByteLengthOfTxGrpSigInfo Com_TxGrpSigInfo[83].DynSignalOfTxGrpSigInfo Com_TxGrpSigInfo[83].InvValueIdxOfTxGrpSigInfo Com_TxGrpSigInfo[83].InvValueOfTxGrpSigInfo Com_TxGrpSigInfo[83].StartByteInPduPositionOfTxGrpSigInfo Com_TxGrpSigInfo[83].TxBufferEndIdxOfTxGrpSigInfo Com_TxGrpSigInfo[83].TxBufferStartIdxOfTxGrpSigInfo Com_TxGrpSigInfo[83].TxPduInfoIdxOfTxGrpSigInfo Com_TxGrpSigInfo[83].TxSigGrpInfoIdxOfTxGrpSigInfo Com_TxGrpSigInfo[83].WithoutRepOfTxGrpSigInfo Com_TxGrpSigInfo[84].ApplTypeOfTxGrpSigInfo Com_TxGrpSigInfo[84].BitLengthOfTxGrpSigInfo Com_TxGrpSigInfo[84].BitPositionOfTxGrpSigInfo Com_TxGrpSigInfo[84].BusAccOfTxGrpSigInfo Com_TxGrpSigInfo[84].ByteLengthOfTxGrpSigInfo Com_TxGrpSigInfo[84].DynSignalOfTxGrpSigInfo Com_TxGrpSigInfo[84].InvValueIdxOfTxGrpSigInfo Com_TxGrpSigInfo[84].InvValueOfTxGrpSigInfo Com_TxGrpSigInfo[84].StartByteInPduPositionOfTxGrpSigInfo Com_TxGrpSigInfo[84].TxBufferEndIdxOfTxGrpSigInfo Com_TxGrpSigInfo[84].TxBufferStartIdxOfTxGrpSigInfo Com_TxGrpSigInfo[84].TxPduInfoIdxOfTxGrpSigInfo Com_TxGrpSigInfo[84].TxSigGrpInfoIdxOfTxGrpSigInfo Com_TxGrpSigInfo[84].WithoutRepOfTxGrpSigInfo Com_TxGrpSigInfo[85].ApplTypeOfTxGrpSigInfo Com_TxGrpSigInfo[85].BitLengthOfTxGrpSigInfo Com_TxGrpSigInfo[85].BitPositionOfTxGrpSigInfo Com_TxGrpSigInfo[85].BusAccOfTxGrpSigInfo Com_TxGrpSigInfo[85].ByteLengthOfTxGrpSigInfo Com_TxGrpSigInfo[85].DynSignalOfTxGrpSigInfo Com_TxGrpSigInfo[85].InvValueIdxOfTxGrpSigInfo Com_TxGrpSigInfo[85].InvValueOfTxGrpSigInfo Com_TxGrpSigInfo[85].StartByteInPduPositionOfTxGrpSigInfo Com_TxGrpSigInfo[85].TxBufferEndIdxOfTxGrpSigInfo Com_TxGrpSigInfo[85].TxBufferStartIdxOfTxGrpSigInfo Com_TxGrpSigInfo[85].TxPduInfoIdxOfTxGrpSigInfo Com_TxGrpSigInfo[85].TxSigGrpInfoIdxOfTxGrpSigInfo Com_TxGrpSigInfo[85].WithoutRepOfTxGrpSigInfo Com_TxGrpSigInfo[86].ApplTypeOfTxGrpSigInfo Com_TxGrpSigInfo[86].BitLengthOfTxGrpSigInfo Com_TxGrpSigInfo[86].BitPositionOfTxGrpSigInfo Com_TxGrpSigInfo[86].BusAccOfTxGrpSigInfo Com_TxGrpSigInfo[86].ByteLengthOfTxGrpSigInfo Com_TxGrpSigInfo[86].DynSignalOfTxGrpSigInfo Com_TxGrpSigInfo[86].InvValueIdxOfTxGrpSigInfo Com_TxGrpSigInfo[86].InvValueOfTxGrpSigInfo Com_TxGrpSigInfo[86].StartByteInPduPositionOfTxGrpSigInfo Com_TxGrpSigInfo[86].TxBufferEndIdxOfTxGrpSigInfo Com_TxGrpSigInfo[86].TxBufferStartIdxOfTxGrpSigInfo Com_TxGrpSigInfo[86].TxPduInfoIdxOfTxGrpSigInfo Com_TxGrpSigInfo[86].TxSigGrpInfoIdxOfTxGrpSigInfo Com_TxGrpSigInfo[86].WithoutRepOfTxGrpSigInfo Com_TxGrpSigInfo[87].ApplTypeOfTxGrpSigInfo Com_TxGrpSigInfo[87].BitLengthOfTxGrpSigInfo Com_TxGrpSigInfo[87].BitPositionOfTxGrpSigInfo Com_TxGrpSigInfo[87].BusAccOfTxGrpSigInfo Com_TxGrpSigInfo[87].ByteLengthOfTxGrpSigInfo Com_TxGrpSigInfo[87].DynSignalOfTxGrpSigInfo Com_TxGrpSigInfo[87].InvValueIdxOfTxGrpSigInfo Com_TxGrpSigInfo[87].InvValueOfTxGrpSigInfo Com_TxGrpSigInfo[87].StartByteInPduPositionOfTxGrpSigInfo Com_TxGrpSigInfo[87].TxBufferEndIdxOfTxGrpSigInfo Com_TxGrpSigInfo[87].TxBufferStartIdxOfTxGrpSigInfo Com_TxGrpSigInfo[87].TxPduInfoIdxOfTxGrpSigInfo Com_TxGrpSigInfo[87].TxSigGrpInfoIdxOfTxGrpSigInfo Com_TxGrpSigInfo[87].WithoutRepOfTxGrpSigInfo Com_TxGrpSigInfo[88].ApplTypeOfTxGrpSigInfo Com_TxGrpSigInfo[88].BitLengthOfTxGrpSigInfo Com_TxGrpSigInfo[88].BitPositionOfTxGrpSigInfo Com_TxGrpSigInfo[88].BusAccOfTxGrpSigInfo Com_TxGrpSigInfo[88].ByteLengthOfTxGrpSigInfo Com_TxGrpSigInfo[88].DynSignalOfTxGrpSigInfo Com_TxGrpSigInfo[88].InvValueIdxOfTxGrpSigInfo Com_TxGrpSigInfo[88].InvValueOfTxGrpSigInfo Com_TxGrpSigInfo[88].StartByteInPduPositionOfTxGrpSigInfo Com_TxGrpSigInfo[88].TxBufferEndIdxOfTxGrpSigInfo Com_TxGrpSigInfo[88].TxBufferStartIdxOfTxGrpSigInfo Com_TxGrpSigInfo[88].TxPduInfoIdxOfTxGrpSigInfo Com_TxGrpSigInfo[88].TxSigGrpInfoIdxOfTxGrpSigInfo Com_TxGrpSigInfo[88].WithoutRepOfTxGrpSigInfo Com_TxGrpSigInfo[89].ApplTypeOfTxGrpSigInfo Com_TxGrpSigInfo[89].BitLengthOfTxGrpSigInfo Com_TxGrpSigInfo[89].BitPositionOfTxGrpSigInfo Com_TxGrpSigInfo[89].BusAccOfTxGrpSigInfo Com_TxGrpSigInfo[89].ByteLengthOfTxGrpSigInfo Com_TxGrpSigInfo[89].DynSignalOfTxGrpSigInfo Com_TxGrpSigInfo[89].InvValueIdxOfTxGrpSigInfo Com_TxGrpSigInfo[89].InvValueOfTxGrpSigInfo Com_TxGrpSigInfo[89].StartByteInPduPositionOfTxGrpSigInfo Com_TxGrpSigInfo[89].TxBufferEndIdxOfTxGrpSigInfo Com_TxGrpSigInfo[89].TxBufferStartIdxOfTxGrpSigInfo Com_TxGrpSigInfo[89].TxPduInfoIdxOfTxGrpSigInfo Com_TxGrpSigInfo[89].TxSigGrpInfoIdxOfTxGrpSigInfo Com_TxGrpSigInfo[89].WithoutRepOfTxGrpSigInfo Com_TxGrpSigInfo[8].ApplTypeOfTxGrpSigInfo Com_TxGrpSigInfo[8].BitLengthOfTxGrpSigInfo Com_TxGrpSigInfo[8].BitPositionOfTxGrpSigInfo Com_TxGrpSigInfo[8].BusAccOfTxGrpSigInfo Com_TxGrpSigInfo[8].ByteLengthOfTxGrpSigInfo Com_TxGrpSigInfo[8].DynSignalOfTxGrpSigInfo Com_TxGrpSigInfo[8].InvValueIdxOfTxGrpSigInfo Com_TxGrpSigInfo[8].InvValueOfTxGrpSigInfo Com_TxGrpSigInfo[8].StartByteInPduPositionOfTxGrpSigInfo Com_TxGrpSigInfo[8].TxBufferEndIdxOfTxGrpSigInfo Com_TxGrpSigInfo[8].TxBufferStartIdxOfTxGrpSigInfo Com_TxGrpSigInfo[8].TxPduInfoIdxOfTxGrpSigInfo Com_TxGrpSigInfo[8].TxSigGrpInfoIdxOfTxGrpSigInfo Com_TxGrpSigInfo[8].WithoutRepOfTxGrpSigInfo Com_TxGrpSigInfo[90].ApplTypeOfTxGrpSigInfo Com_TxGrpSigInfo[90].BitLengthOfTxGrpSigInfo Com_TxGrpSigInfo[90].BitPositionOfTxGrpSigInfo Com_TxGrpSigInfo[90].BusAccOfTxGrpSigInfo Com_TxGrpSigInfo[90].ByteLengthOfTxGrpSigInfo Com_TxGrpSigInfo[90].DynSignalOfTxGrpSigInfo Com_TxGrpSigInfo[90].InvValueIdxOfTxGrpSigInfo Com_TxGrpSigInfo[90].InvValueOfTxGrpSigInfo Com_TxGrpSigInfo[90].StartByteInPduPositionOfTxGrpSigInfo Com_TxGrpSigInfo[90].TxBufferEndIdxOfTxGrpSigInfo Com_TxGrpSigInfo[90].TxBufferStartIdxOfTxGrpSigInfo Com_TxGrpSigInfo[90].TxPduInfoIdxOfTxGrpSigInfo Com_TxGrpSigInfo[90].TxSigGrpInfoIdxOfTxGrpSigInfo Com_TxGrpSigInfo[90].WithoutRepOfTxGrpSigInfo Com_TxGrpSigInfo[91].ApplTypeOfTxGrpSigInfo Com_TxGrpSigInfo[91].BitLengthOfTxGrpSigInfo Com_TxGrpSigInfo[91].BitPositionOfTxGrpSigInfo Com_TxGrpSigInfo[91].BusAccOfTxGrpSigInfo Com_TxGrpSigInfo[91].ByteLengthOfTxGrpSigInfo Com_TxGrpSigInfo[91].DynSignalOfTxGrpSigInfo Com_TxGrpSigInfo[91].InvValueIdxOfTxGrpSigInfo Com_TxGrpSigInfo[91].InvValueOfTxGrpSigInfo Com_TxGrpSigInfo[91].StartByteInPduPositionOfTxGrpSigInfo Com_TxGrpSigInfo[91].TxBufferEndIdxOfTxGrpSigInfo Com_TxGrpSigInfo[91].TxBufferStartIdxOfTxGrpSigInfo Com_TxGrpSigInfo[91].TxPduInfoIdxOfTxGrpSigInfo Com_TxGrpSigInfo[91].TxSigGrpInfoIdxOfTxGrpSigInfo Com_TxGrpSigInfo[91].WithoutRepOfTxGrpSigInfo Com_TxGrpSigInfo[92].ApplTypeOfTxGrpSigInfo Com_TxGrpSigInfo[92].BitLengthOfTxGrpSigInfo Com_TxGrpSigInfo[92].BitPositionOfTxGrpSigInfo Com_TxGrpSigInfo[92].BusAccOfTxGrpSigInfo Com_TxGrpSigInfo[92].ByteLengthOfTxGrpSigInfo Com_TxGrpSigInfo[92].DynSignalOfTxGrpSigInfo Com_TxGrpSigInfo[92].InvValueIdxOfTxGrpSigInfo Com_TxGrpSigInfo[92].InvValueOfTxGrpSigInfo Com_TxGrpSigInfo[92].StartByteInPduPositionOfTxGrpSigInfo Com_TxGrpSigInfo[92].TxBufferEndIdxOfTxGrpSigInfo Com_TxGrpSigInfo[92].TxBufferStartIdxOfTxGrpSigInfo Com_TxGrpSigInfo[92].TxPduInfoIdxOfTxGrpSigInfo Com_TxGrpSigInfo[92].TxSigGrpInfoIdxOfTxGrpSigInfo Com_TxGrpSigInfo[92].WithoutRepOfTxGrpSigInfo Com_TxGrpSigInfo[93].ApplTypeOfTxGrpSigInfo Com_TxGrpSigInfo[93].BitLengthOfTxGrpSigInfo Com_TxGrpSigInfo[93].BitPositionOfTxGrpSigInfo Com_TxGrpSigInfo[93].BusAccOfTxGrpSigInfo Com_TxGrpSigInfo[93].ByteLengthOfTxGrpSigInfo Com_TxGrpSigInfo[93].DynSignalOfTxGrpSigInfo Com_TxGrpSigInfo[93].InvValueIdxOfTxGrpSigInfo Com_TxGrpSigInfo[93].InvValueOfTxGrpSigInfo Com_TxGrpSigInfo[93].StartByteInPduPositionOfTxGrpSigInfo Com_TxGrpSigInfo[93].TxBufferEndIdxOfTxGrpSigInfo Com_TxGrpSigInfo[93].TxBufferStartIdxOfTxGrpSigInfo Com_TxGrpSigInfo[93].TxPduInfoIdxOfTxGrpSigInfo Com_TxGrpSigInfo[93].TxSigGrpInfoIdxOfTxGrpSigInfo Com_TxGrpSigInfo[93].WithoutRepOfTxGrpSigInfo Com_TxGrpSigInfo[94].ApplTypeOfTxGrpSigInfo Com_TxGrpSigInfo[94].BitLengthOfTxGrpSigInfo Com_TxGrpSigInfo[94].BitPositionOfTxGrpSigInfo Com_TxGrpSigInfo[94].BusAccOfTxGrpSigInfo Com_TxGrpSigInfo[94].ByteLengthOfTxGrpSigInfo Com_TxGrpSigInfo[94].DynSignalOfTxGrpSigInfo Com_TxGrpSigInfo[94].InvValueIdxOfTxGrpSigInfo Com_TxGrpSigInfo[94].InvValueOfTxGrpSigInfo Com_TxGrpSigInfo[94].StartByteInPduPositionOfTxGrpSigInfo Com_TxGrpSigInfo[94].TxBufferEndIdxOfTxGrpSigInfo Com_TxGrpSigInfo[94].TxBufferStartIdxOfTxGrpSigInfo Com_TxGrpSigInfo[94].TxPduInfoIdxOfTxGrpSigInfo Com_TxGrpSigInfo[94].TxSigGrpInfoIdxOfTxGrpSigInfo Com_TxGrpSigInfo[94].WithoutRepOfTxGrpSigInfo Com_TxGrpSigInfo[95].ApplTypeOfTxGrpSigInfo Com_TxGrpSigInfo[95].BitLengthOfTxGrpSigInfo Com_TxGrpSigInfo[95].BitPositionOfTxGrpSigInfo Com_TxGrpSigInfo[95].BusAccOfTxGrpSigInfo Com_TxGrpSigInfo[95].ByteLengthOfTxGrpSigInfo Com_TxGrpSigInfo[95].DynSignalOfTxGrpSigInfo Com_TxGrpSigInfo[95].InvValueIdxOfTxGrpSigInfo Com_TxGrpSigInfo[95].InvValueOfTxGrpSigInfo Com_TxGrpSigInfo[95].StartByteInPduPositionOfTxGrpSigInfo Com_TxGrpSigInfo[95].TxBufferEndIdxOfTxGrpSigInfo Com_TxGrpSigInfo[95].TxBufferStartIdxOfTxGrpSigInfo Com_TxGrpSigInfo[95].TxPduInfoIdxOfTxGrpSigInfo Com_TxGrpSigInfo[95].TxSigGrpInfoIdxOfTxGrpSigInfo Com_TxGrpSigInfo[95].WithoutRepOfTxGrpSigInfo Com_TxGrpSigInfo[96].ApplTypeOfTxGrpSigInfo Com_TxGrpSigInfo[96].BitLengthOfTxGrpSigInfo Com_TxGrpSigInfo[96].BitPositionOfTxGrpSigInfo Com_TxGrpSigInfo[96].BusAccOfTxGrpSigInfo Com_TxGrpSigInfo[96].ByteLengthOfTxGrpSigInfo Com_TxGrpSigInfo[96].DynSignalOfTxGrpSigInfo Com_TxGrpSigInfo[96].InvValueIdxOfTxGrpSigInfo Com_TxGrpSigInfo[96].InvValueOfTxGrpSigInfo Com_TxGrpSigInfo[96].StartByteInPduPositionOfTxGrpSigInfo Com_TxGrpSigInfo[96].TxBufferEndIdxOfTxGrpSigInfo Com_TxGrpSigInfo[96].TxBufferStartIdxOfTxGrpSigInfo Com_TxGrpSigInfo[96].TxPduInfoIdxOfTxGrpSigInfo Com_TxGrpSigInfo[96].TxSigGrpInfoIdxOfTxGrpSigInfo Com_TxGrpSigInfo[96].WithoutRepOfTxGrpSigInfo Com_TxGrpSigInfo[97].ApplTypeOfTxGrpSigInfo Com_TxGrpSigInfo[97].BitLengthOfTxGrpSigInfo Com_TxGrpSigInfo[97].BitPositionOfTxGrpSigInfo Com_TxGrpSigInfo[97].BusAccOfTxGrpSigInfo Com_TxGrpSigInfo[97].ByteLengthOfTxGrpSigInfo Com_TxGrpSigInfo[97].DynSignalOfTxGrpSigInfo Com_TxGrpSigInfo[97].InvValueIdxOfTxGrpSigInfo Com_TxGrpSigInfo[97].InvValueOfTxGrpSigInfo Com_TxGrpSigInfo[97].StartByteInPduPositionOfTxGrpSigInfo Com_TxGrpSigInfo[97].TxBufferEndIdxOfTxGrpSigInfo Com_TxGrpSigInfo[97].TxBufferStartIdxOfTxGrpSigInfo Com_TxGrpSigInfo[97].TxPduInfoIdxOfTxGrpSigInfo Com_TxGrpSigInfo[97].TxSigGrpInfoIdxOfTxGrpSigInfo Com_TxGrpSigInfo[97].WithoutRepOfTxGrpSigInfo Com_TxGrpSigInfo[98].ApplTypeOfTxGrpSigInfo Com_TxGrpSigInfo[98].BitLengthOfTxGrpSigInfo Com_TxGrpSigInfo[98].BitPositionOfTxGrpSigInfo Com_TxGrpSigInfo[98].BusAccOfTxGrpSigInfo Com_TxGrpSigInfo[98].ByteLengthOfTxGrpSigInfo Com_TxGrpSigInfo[98].DynSignalOfTxGrpSigInfo Com_TxGrpSigInfo[98].InvValueIdxOfTxGrpSigInfo Com_TxGrpSigInfo[98].InvValueOfTxGrpSigInfo Com_TxGrpSigInfo[98].StartByteInPduPositionOfTxGrpSigInfo Com_TxGrpSigInfo[98].TxBufferEndIdxOfTxGrpSigInfo Com_TxGrpSigInfo[98].TxBufferStartIdxOfTxGrpSigInfo Com_TxGrpSigInfo[98].TxPduInfoIdxOfTxGrpSigInfo Com_TxGrpSigInfo[98].TxSigGrpInfoIdxOfTxGrpSigInfo Com_TxGrpSigInfo[98].WithoutRepOfTxGrpSigInfo Com_TxGrpSigInfo[99].ApplTypeOfTxGrpSigInfo Com_TxGrpSigInfo[99].BitLengthOfTxGrpSigInfo Com_TxGrpSigInfo[99].BitPositionOfTxGrpSigInfo Com_TxGrpSigInfo[99].BusAccOfTxGrpSigInfo Com_TxGrpSigInfo[99].ByteLengthOfTxGrpSigInfo Com_TxGrpSigInfo[99].DynSignalOfTxGrpSigInfo Com_TxGrpSigInfo[99].InvValueIdxOfTxGrpSigInfo Com_TxGrpSigInfo[99].InvValueOfTxGrpSigInfo Com_TxGrpSigInfo[99].StartByteInPduPositionOfTxGrpSigInfo Com_TxGrpSigInfo[99].TxBufferEndIdxOfTxGrpSigInfo Com_TxGrpSigInfo[99].TxBufferStartIdxOfTxGrpSigInfo Com_TxGrpSigInfo[99].TxPduInfoIdxOfTxGrpSigInfo Com_TxGrpSigInfo[99].TxSigGrpInfoIdxOfTxGrpSigInfo Com_TxGrpSigInfo[99].WithoutRepOfTxGrpSigInfo Com_TxGrpSigInfo[9].ApplTypeOfTxGrpSigInfo Com_TxGrpSigInfo[9].BitLengthOfTxGrpSigInfo Com_TxGrpSigInfo[9].BitPositionOfTxGrpSigInfo Com_TxGrpSigInfo[9].BusAccOfTxGrpSigInfo Com_TxGrpSigInfo[9].ByteLengthOfTxGrpSigInfo Com_TxGrpSigInfo[9].DynSignalOfTxGrpSigInfo Com_TxGrpSigInfo[9].InvValueIdxOfTxGrpSigInfo Com_TxGrpSigInfo[9].InvValueOfTxGrpSigInfo Com_TxGrpSigInfo[9].StartByteInPduPositionOfTxGrpSigInfo Com_TxGrpSigInfo[9].TxBufferEndIdxOfTxGrpSigInfo Com_TxGrpSigInfo[9].TxBufferStartIdxOfTxGrpSigInfo Com_TxGrpSigInfo[9].TxPduInfoIdxOfTxGrpSigInfo Com_TxGrpSigInfo[9].TxSigGrpInfoIdxOfTxGrpSigInfo Com_TxGrpSigInfo[9].WithoutRepOfTxGrpSigInfo Com_TxIPduGroupISRLockCounter Com_TxIPduGroupISRLockCounter_noPartition Com_TxModeInfo[0].InitModeOfTxModeInfo Com_TxModeInfo[0].MinimumDelayOfTxModeInfo Com_TxModeInfo[0].TxModeTrueIdxOfTxModeInfo Com_TxModeInfo[0].TxSigInfoFilterInitValueIndEndIdxOfTxModeInfo Com_TxModeInfo[0].TxSigInfoFilterInitValueIndStartIdxOfTxModeInfo Com_TxModeInfo[10].InitModeOfTxModeInfo Com_TxModeInfo[10].MinimumDelayOfTxModeInfo Com_TxModeInfo[10].TxModeTrueIdxOfTxModeInfo Com_TxModeInfo[10].TxSigInfoFilterInitValueIndEndIdxOfTxModeInfo Com_TxModeInfo[10].TxSigInfoFilterInitValueIndStartIdxOfTxModeInfo Com_TxModeInfo[11].InitModeOfTxModeInfo Com_TxModeInfo[11].MinimumDelayOfTxModeInfo Com_TxModeInfo[11].TxModeTrueIdxOfTxModeInfo Com_TxModeInfo[11].TxSigInfoFilterInitValueIndEndIdxOfTxModeInfo Com_TxModeInfo[11].TxSigInfoFilterInitValueIndStartIdxOfTxModeInfo Com_TxModeInfo[12].InitModeOfTxModeInfo Com_TxModeInfo[12].MinimumDelayOfTxModeInfo Com_TxModeInfo[12].TxModeTrueIdxOfTxModeInfo Com_TxModeInfo[12].TxSigInfoFilterInitValueIndEndIdxOfTxModeInfo Com_TxModeInfo[12].TxSigInfoFilterInitValueIndStartIdxOfTxModeInfo Com_TxModeInfo[13].InitModeOfTxModeInfo Com_TxModeInfo[13].MinimumDelayOfTxModeInfo Com_TxModeInfo[13].TxModeTrueIdxOfTxModeInfo Com_TxModeInfo[13].TxSigInfoFilterInitValueIndEndIdxOfTxModeInfo Com_TxModeInfo[13].TxSigInfoFilterInitValueIndStartIdxOfTxModeInfo Com_TxModeInfo[14].InitModeOfTxModeInfo Com_TxModeInfo[14].MinimumDelayOfTxModeInfo Com_TxModeInfo[14].TxModeTrueIdxOfTxModeInfo Com_TxModeInfo[14].TxSigInfoFilterInitValueIndEndIdxOfTxModeInfo Com_TxModeInfo[14].TxSigInfoFilterInitValueIndStartIdxOfTxModeInfo Com_TxModeInfo[15].InitModeOfTxModeInfo Com_TxModeInfo[15].MinimumDelayOfTxModeInfo Com_TxModeInfo[15].TxModeTrueIdxOfTxModeInfo Com_TxModeInfo[15].TxSigInfoFilterInitValueIndEndIdxOfTxModeInfo Com_TxModeInfo[15].TxSigInfoFilterInitValueIndStartIdxOfTxModeInfo Com_TxModeInfo[16].InitModeOfTxModeInfo Com_TxModeInfo[16].MinimumDelayOfTxModeInfo Com_TxModeInfo[16].TxModeTrueIdxOfTxModeInfo Com_TxModeInfo[16].TxSigInfoFilterInitValueIndEndIdxOfTxModeInfo Com_TxModeInfo[16].TxSigInfoFilterInitValueIndStartIdxOfTxModeInfo Com_TxModeInfo[17].InitModeOfTxModeInfo Com_TxModeInfo[17].MinimumDelayOfTxModeInfo Com_TxModeInfo[17].TxModeTrueIdxOfTxModeInfo Com_TxModeInfo[17].TxSigInfoFilterInitValueIndEndIdxOfTxModeInfo Com_TxModeInfo[17].TxSigInfoFilterInitValueIndStartIdxOfTxModeInfo Com_TxModeInfo[18].InitModeOfTxModeInfo Com_TxModeInfo[18].MinimumDelayOfTxModeInfo Com_TxModeInfo[18].TxModeTrueIdxOfTxModeInfo Com_TxModeInfo[18].TxSigInfoFilterInitValueIndEndIdxOfTxModeInfo Com_TxModeInfo[18].TxSigInfoFilterInitValueIndStartIdxOfTxModeInfo Com_TxModeInfo[19].InitModeOfTxModeInfo Com_TxModeInfo[19].MinimumDelayOfTxModeInfo Com_TxModeInfo[19].TxModeTrueIdxOfTxModeInfo Com_TxModeInfo[19].TxSigInfoFilterInitValueIndEndIdxOfTxModeInfo Com_TxModeInfo[19].TxSigInfoFilterInitValueIndStartIdxOfTxModeInfo Com_TxModeInfo[1].InitModeOfTxModeInfo Com_TxModeInfo[1].MinimumDelayOfTxModeInfo Com_TxModeInfo[1].TxModeTrueIdxOfTxModeInfo Com_TxModeInfo[1].TxSigInfoFilterInitValueIndEndIdxOfTxModeInfo Com_TxModeInfo[1].TxSigInfoFilterInitValueIndStartIdxOfTxModeInfo Com_TxModeInfo[20].InitModeOfTxModeInfo Com_TxModeInfo[20].MinimumDelayOfTxModeInfo Com_TxModeInfo[20].TxModeTrueIdxOfTxModeInfo Com_TxModeInfo[20].TxSigInfoFilterInitValueIndEndIdxOfTxModeInfo Com_TxModeInfo[20].TxSigInfoFilterInitValueIndStartIdxOfTxModeInfo Com_TxModeInfo[21].InitModeOfTxModeInfo Com_TxModeInfo[21].MinimumDelayOfTxModeInfo Com_TxModeInfo[21].TxModeTrueIdxOfTxModeInfo Com_TxModeInfo[21].TxSigInfoFilterInitValueIndEndIdxOfTxModeInfo Com_TxModeInfo[21].TxSigInfoFilterInitValueIndStartIdxOfTxModeInfo Com_TxModeInfo[22].InitModeOfTxModeInfo Com_TxModeInfo[22].MinimumDelayOfTxModeInfo Com_TxModeInfo[22].TxModeTrueIdxOfTxModeInfo Com_TxModeInfo[22].TxSigInfoFilterInitValueIndEndIdxOfTxModeInfo Com_TxModeInfo[22].TxSigInfoFilterInitValueIndStartIdxOfTxModeInfo Com_TxModeInfo[23].InitModeOfTxModeInfo Com_TxModeInfo[23].MinimumDelayOfTxModeInfo Com_TxModeInfo[23].TxModeTrueIdxOfTxModeInfo Com_TxModeInfo[23].TxSigInfoFilterInitValueIndEndIdxOfTxModeInfo Com_TxModeInfo[23].TxSigInfoFilterInitValueIndStartIdxOfTxModeInfo Com_TxModeInfo[24].InitModeOfTxModeInfo Com_TxModeInfo[24].MinimumDelayOfTxModeInfo Com_TxModeInfo[24].TxModeTrueIdxOfTxModeInfo Com_TxModeInfo[24].TxSigInfoFilterInitValueIndEndIdxOfTxModeInfo Com_TxModeInfo[24].TxSigInfoFilterInitValueIndStartIdxOfTxModeInfo Com_TxModeInfo[25].InitModeOfTxModeInfo Com_TxModeInfo[25].MinimumDelayOfTxModeInfo Com_TxModeInfo[25].TxModeTrueIdxOfTxModeInfo Com_TxModeInfo[25].TxSigInfoFilterInitValueIndEndIdxOfTxModeInfo Com_TxModeInfo[25].TxSigInfoFilterInitValueIndStartIdxOfTxModeInfo Com_TxModeInfo[26].InitModeOfTxModeInfo Com_TxModeInfo[26].MinimumDelayOfTxModeInfo Com_TxModeInfo[26].TxModeTrueIdxOfTxModeInfo Com_TxModeInfo[26].TxSigInfoFilterInitValueIndEndIdxOfTxModeInfo Com_TxModeInfo[26].TxSigInfoFilterInitValueIndStartIdxOfTxModeInfo Com_TxModeInfo[27].InitModeOfTxModeInfo /end REF_MEASUREMENT
/end GROUP
/end MODULE
/end PROJECT
