ASAP2_VERSION 1 71
/begin PROJECT MICROSAR ""
/begin MODULE CPP ""
/begin MOD_COMMON "" BYTE_ORDER MSB_LAST ALIGNMENT_BYTE 1 ALIGNMENT_WORD 2 ALIGNMENT_LONG 4 ALIGNMENT_FLOAT16_IEEE 2 ALIGNMENT_FLOAT32_IEEE 4 ALIGNMENT_FLOAT64_IEEE 8 ALIGNMENT_INT64 8 /end MOD_COMMON
/begin MEASUREMENT ComM_UserByteMask[27].ClearMaskOfUserByteMask "" UBYTE NO_COMPU_METHOD 0 0 0 255 ECU_ADDRESS 0x0 /end MEASUREMENT
/begin MEASUREMENT ComM_UserByteMask[27].SetMaskOfUserByteMask "" UBYTE NO_COMPU_METHOD 0 0 0 255 ECU_ADDRESS 0x0 /end MEASUREMENT
/begin MEASUREMENT ComM_UserByteMask[27].UserReqFullComIdxOfUserByteMask "" UBYTE NO_COMPU_METHOD 0 0 0 255 ECU_ADDRESS 0x0 /end MEASUREMENT
/begin MEASUREMENT ComM_UserByteMask[28].ChannelOfUserByteMask "" UBYTE NO_COMPU_METHOD 0 0 0 255 ECU_ADDRESS 0x0 /end MEASUREMENT
/begin MEASUREMENT ComM_UserByteMask[28].ClearMaskOfUserByteMask "" UBYTE NO_COMPU_METHOD 0 0 0 255 ECU_ADDRESS 0x0 /end MEASUREMENT
/begin MEASUREMENT ComM_UserByteMask[28].SetMaskOfUserByteMask "" UBYTE NO_COMPU_METHOD 0 0 0 255 ECU_ADDRESS 0x0 /end MEASUREMENT
/begin MEASUREMENT ComM_UserByteMask[28].UserReqFullComIdxOfUserByteMask "" UBYTE NO_COMPU_METHOD 0 0 0 255 ECU_ADDRESS 0x0 /end MEASUREMENT
/begin MEASUREMENT ComM_UserByteMask[29].ChannelOfUserByteMask "" UBYTE NO_COMPU_METHOD 0 0 0 255 ECU_ADDRESS 0x0 /end MEASUREMENT
/begin MEASUREMENT ComM_UserByteMask[29].ClearMaskOfUserByteMask "" UBYTE NO_COMPU_METHOD 0 0 0 255 ECU_ADDRESS 0x0 /end MEASUREMENT
/begin MEASUREMENT ComM_UserByteMask[29].SetMaskOfUserByteMask "" UBYTE NO_COMPU_METHOD 0 0 0 255 ECU_ADDRESS 0x0 /end MEASUREMENT
/begin MEASUREMENT ComM_UserByteMask[29].UserReqFullComIdxOfUserByteMask "" UBYTE NO_COMPU_METHOD 0 0 0 255 ECU_ADDRESS 0x0 /end MEASUREMENT
/begin MEASUREMENT ComM_UserByteMask[2].ChannelOfUserByteMask "" UBYTE NO_COMPU_METHOD 0 0 0 255 ECU_ADDRESS 0x0 /end MEASUREMENT
/begin MEASUREMENT ComM_UserByteMask[2].ClearMaskOfUserByteMask "" UBYTE NO_COMPU_METHOD 0 0 0 255 ECU_ADDRESS 0x0 /end MEASUREMENT
/begin MEASUREMENT ComM_UserByteMask[2].SetMaskOfUserByteMask "" UBYTE NO_COMPU_METHOD 0 0 0 255 ECU_ADDRESS 0x0 /end MEASUREMENT
/begin MEASUREMENT ComM_UserByteMask[2].UserReqFullComIdxOfUserByteMask "" UBYTE NO_COMPU_METHOD 0 0 0 255 ECU_ADDRESS 0x0 /end MEASUREMENT
/begin MEASUREMENT ComM_UserByteMask[30].ChannelOfUserByteMask "" UBYTE NO_COMPU_METHOD 0 0 0 255 ECU_ADDRESS 0x0 /end MEASUREMENT
/begin MEASUREMENT ComM_UserByteMask[30].ClearMaskOfUserByteMask "" UBYTE NO_COMPU_METHOD 0 0 0 255 ECU_ADDRESS 0x0 /end MEASUREMENT
/begin MEASUREMENT ComM_UserByteMask[30].SetMaskOfUserByteMask "" UBYTE NO_COMPU_METHOD 0 0 0 255 ECU_ADDRESS 0x0 /end MEASUREMENT
/begin MEASUREMENT ComM_UserByteMask[30].UserReqFullComIdxOfUserByteMask "" UBYTE NO_COMPU_METHOD 0 0 0 255 ECU_ADDRESS 0x0 /end MEASUREMENT
/begin MEASUREMENT ComM_UserByteMask[31].ChannelOfUserByteMask "" UBYTE NO_COMPU_METHOD 0 0 0 255 ECU_ADDRESS 0x0 /end MEASUREMENT
/begin MEASUREMENT ComM_UserByteMask[31].ClearMaskOfUserByteMask "" UBYTE NO_COMPU_METHOD 0 0 0 255 ECU_ADDRESS 0x0 /end MEASUREMENT
/begin MEASUREMENT ComM_UserByteMask[31].SetMaskOfUserByteMask "" UBYTE NO_COMPU_METHOD 0 0 0 255 ECU_ADDRESS 0x0 /end MEASUREMENT
/begin MEASUREMENT ComM_UserByteMask[31].UserReqFullComIdxOfUserByteMask "" UBYTE NO_COMPU_METHOD 0 0 0 255 ECU_ADDRESS 0x0 /end MEASUREMENT
/begin MEASUREMENT ComM_UserByteMask[32].ChannelOfUserByteMask "" UBYTE NO_COMPU_METHOD 0 0 0 255 ECU_ADDRESS 0x0 /end MEASUREMENT
/begin MEASUREMENT ComM_UserByteMask[32].ClearMaskOfUserByteMask "" UBYTE NO_COMPU_METHOD 0 0 0 255 ECU_ADDRESS 0x0 /end MEASUREMENT
/begin MEASUREMENT ComM_UserByteMask[32].SetMaskOfUserByteMask "" UBYTE NO_COMPU_METHOD 0 0 0 255 ECU_ADDRESS 0x0 /end MEASUREMENT
/begin MEASUREMENT ComM_UserByteMask[32].UserReqFullComIdxOfUserByteMask "" UBYTE NO_COMPU_METHOD 0 0 0 255 ECU_ADDRESS 0x0 /end MEASUREMENT
/begin MEASUREMENT ComM_UserByteMask[33].ChannelOfUserByteMask "" UBYTE NO_COMPU_METHOD 0 0 0 255 ECU_ADDRESS 0x0 /end MEASUREMENT
/begin MEASUREMENT ComM_UserByteMask[33].ClearMaskOfUserByteMask "" UBYTE NO_COMPU_METHOD 0 0 0 255 ECU_ADDRESS 0x0 /end MEASUREMENT
/begin MEASUREMENT ComM_UserByteMask[33].SetMaskOfUserByteMask "" UBYTE NO_COMPU_METHOD 0 0 0 255 ECU_ADDRESS 0x0 /end MEASUREMENT
/begin MEASUREMENT ComM_UserByteMask[33].UserReqFullComIdxOfUserByteMask "" UBYTE NO_COMPU_METHOD 0 0 0 255 ECU_ADDRESS 0x0 /end MEASUREMENT
/begin MEASUREMENT ComM_UserByteMask[34].ChannelOfUserByteMask "" UBYTE NO_COMPU_METHOD 0 0 0 255 ECU_ADDRESS 0x0 /end MEASUREMENT
/begin MEASUREMENT ComM_UserByteMask[34].ClearMaskOfUserByteMask "" UBYTE NO_COMPU_METHOD 0 0 0 255 ECU_ADDRESS 0x0 /end MEASUREMENT
/begin MEASUREMENT ComM_UserByteMask[34].SetMaskOfUserByteMask "" UBYTE NO_COMPU_METHOD 0 0 0 255 ECU_ADDRESS 0x0 /end MEASUREMENT
/begin MEASUREMENT ComM_UserByteMask[34].UserReqFullComIdxOfUserByteMask "" UBYTE NO_COMPU_METHOD 0 0 0 255 ECU_ADDRESS 0x0 /end MEASUREMENT
/begin MEASUREMENT ComM_UserByteMask[35].ChannelOfUserByteMask "" UBYTE NO_COMPU_METHOD 0 0 0 255 ECU_ADDRESS 0x0 /end MEASUREMENT
/begin MEASUREMENT ComM_UserByteMask[35].ClearMaskOfUserByteMask "" UBYTE NO_COMPU_METHOD 0 0 0 255 ECU_ADDRESS 0x0 /end MEASUREMENT
/begin MEASUREMENT ComM_UserByteMask[35].SetMaskOfUserByteMask "" UBYTE NO_COMPU_METHOD 0 0 0 255 ECU_ADDRESS 0x0 /end MEASUREMENT
/begin MEASUREMENT ComM_UserByteMask[35].UserReqFullComIdxOfUserByteMask "" UBYTE NO_COMPU_METHOD 0 0 0 255 ECU_ADDRESS 0x0 /end MEASUREMENT
/begin MEASUREMENT ComM_UserByteMask[36].ChannelOfUserByteMask "" UBYTE NO_COMPU_METHOD 0 0 0 255 ECU_ADDRESS 0x0 /end MEASUREMENT
/begin MEASUREMENT ComM_UserByteMask[36].ClearMaskOfUserByteMask "" UBYTE NO_COMPU_METHOD 0 0 0 255 ECU_ADDRESS 0x0 /end MEASUREMENT
/begin MEASUREMENT ComM_UserByteMask[36].SetMaskOfUserByteMask "" UBYTE NO_COMPU_METHOD 0 0 0 255 ECU_ADDRESS 0x0 /end MEASUREMENT
/begin MEASUREMENT ComM_UserByteMask[36].UserReqFullComIdxOfUserByteMask "" UBYTE NO_COMPU_METHOD 0 0 0 255 ECU_ADDRESS 0x0 /end MEASUREMENT
/begin MEASUREMENT ComM_UserByteMask[37].ChannelOfUserByteMask "" UBYTE NO_COMPU_METHOD 0 0 0 255 ECU_ADDRESS 0x0 /end MEASUREMENT
/begin MEASUREMENT ComM_UserByteMask[37].ClearMaskOfUserByteMask "" UBYTE NO_COMPU_METHOD 0 0 0 255 ECU_ADDRESS 0x0 /end MEASUREMENT
/begin MEASUREMENT ComM_UserByteMask[37].SetMaskOfUserByteMask "" UBYTE NO_COMPU_METHOD 0 0 0 255 ECU_ADDRESS 0x0 /end MEASUREMENT
/begin MEASUREMENT ComM_UserByteMask[37].UserReqFullComIdxOfUserByteMask "" UBYTE NO_COMPU_METHOD 0 0 0 255 ECU_ADDRESS 0x0 /end MEASUREMENT
/begin MEASUREMENT ComM_UserByteMask[38].ChannelOfUserByteMask "" UBYTE NO_COMPU_METHOD 0 0 0 255 ECU_ADDRESS 0x0 /end MEASUREMENT
/begin MEASUREMENT ComM_UserByteMask[38].ClearMaskOfUserByteMask "" UBYTE NO_COMPU_METHOD 0 0 0 255 ECU_ADDRESS 0x0 /end MEASUREMENT
/begin MEASUREMENT ComM_UserByteMask[38].SetMaskOfUserByteMask "" UBYTE NO_COMPU_METHOD 0 0 0 255 ECU_ADDRESS 0x0 /end MEASUREMENT
/begin MEASUREMENT ComM_UserByteMask[38].UserReqFullComIdxOfUserByteMask "" UBYTE NO_COMPU_METHOD 0 0 0 255 ECU_ADDRESS 0x0 /end MEASUREMENT
/begin MEASUREMENT ComM_UserByteMask[39].ChannelOfUserByteMask "" UBYTE NO_COMPU_METHOD 0 0 0 255 ECU_ADDRESS 0x0 /end MEASUREMENT
/begin MEASUREMENT ComM_UserByteMask[39].ClearMaskOfUserByteMask "" UBYTE NO_COMPU_METHOD 0 0 0 255 ECU_ADDRESS 0x0 /end MEASUREMENT
/begin MEASUREMENT ComM_UserByteMask[39].SetMaskOfUserByteMask "" UBYTE NO_COMPU_METHOD 0 0 0 255 ECU_ADDRESS 0x0 /end MEASUREMENT
/begin MEASUREMENT ComM_UserByteMask[39].UserReqFullComIdxOfUserByteMask "" UBYTE NO_COMPU_METHOD 0 0 0 255 ECU_ADDRESS 0x0 /end MEASUREMENT
/begin MEASUREMENT ComM_UserByteMask[3].ChannelOfUserByteMask "" UBYTE NO_COMPU_METHOD 0 0 0 255 ECU_ADDRESS 0x0 /end MEASUREMENT
/begin MEASUREMENT ComM_UserByteMask[3].ClearMaskOfUserByteMask "" UBYTE NO_COMPU_METHOD 0 0 0 255 ECU_ADDRESS 0x0 /end MEASUREMENT
/begin MEASUREMENT ComM_UserByteMask[3].SetMaskOfUserByteMask "" UBYTE NO_COMPU_METHOD 0 0 0 255 ECU_ADDRESS 0x0 /end MEASUREMENT
/begin MEASUREMENT ComM_UserByteMask[3].UserReqFullComIdxOfUserByteMask "" UBYTE NO_COMPU_METHOD 0 0 0 255 ECU_ADDRESS 0x0 /end MEASUREMENT
/begin MEASUREMENT ComM_UserByteMask[40].ChannelOfUserByteMask "" UBYTE NO_COMPU_METHOD 0 0 0 255 ECU_ADDRESS 0x0 /end MEASUREMENT
/begin MEASUREMENT ComM_UserByteMask[40].ClearMaskOfUserByteMask "" UBYTE NO_COMPU_METHOD 0 0 0 255 ECU_ADDRESS 0x0 /end MEASUREMENT
/begin MEASUREMENT ComM_UserByteMask[40].SetMaskOfUserByteMask "" UBYTE NO_COMPU_METHOD 0 0 0 255 ECU_ADDRESS 0x0 /end MEASUREMENT
/begin MEASUREMENT ComM_UserByteMask[40].UserReqFullComIdxOfUserByteMask "" UBYTE NO_COMPU_METHOD 0 0 0 255 ECU_ADDRESS 0x0 /end MEASUREMENT
/begin MEASUREMENT ComM_UserByteMask[41].ChannelOfUserByteMask "" UBYTE NO_COMPU_METHOD 0 0 0 255 ECU_ADDRESS 0x0 /end MEASUREMENT
/begin MEASUREMENT ComM_UserByteMask[41].ClearMaskOfUserByteMask "" UBYTE NO_COMPU_METHOD 0 0 0 255 ECU_ADDRESS 0x0 /end MEASUREMENT
/begin MEASUREMENT ComM_UserByteMask[41].SetMaskOfUserByteMask "" UBYTE NO_COMPU_METHOD 0 0 0 255 ECU_ADDRESS 0x0 /end MEASUREMENT
/begin MEASUREMENT ComM_UserByteMask[41].UserReqFullComIdxOfUserByteMask "" UBYTE NO_COMPU_METHOD 0 0 0 255 ECU_ADDRESS 0x0 /end MEASUREMENT
/begin MEASUREMENT ComM_UserByteMask[42].ChannelOfUserByteMask "" UBYTE NO_COMPU_METHOD 0 0 0 255 ECU_ADDRESS 0x0 /end MEASUREMENT
/begin MEASUREMENT ComM_UserByteMask[42].ClearMaskOfUserByteMask "" UBYTE NO_COMPU_METHOD 0 0 0 255 ECU_ADDRESS 0x0 /end MEASUREMENT
/begin MEASUREMENT ComM_UserByteMask[42].SetMaskOfUserByteMask "" UBYTE NO_COMPU_METHOD 0 0 0 255 ECU_ADDRESS 0x0 /end MEASUREMENT
/begin MEASUREMENT ComM_UserByteMask[42].UserReqFullComIdxOfUserByteMask "" UBYTE NO_COMPU_METHOD 0 0 0 255 ECU_ADDRESS 0x0 /end MEASUREMENT
/begin MEASUREMENT ComM_UserByteMask[43].ChannelOfUserByteMask "" UBYTE NO_COMPU_METHOD 0 0 0 255 ECU_ADDRESS 0x0 /end MEASUREMENT
/begin MEASUREMENT ComM_UserByteMask[43].ClearMaskOfUserByteMask "" UBYTE NO_COMPU_METHOD 0 0 0 255 ECU_ADDRESS 0x0 /end MEASUREMENT
/begin MEASUREMENT ComM_UserByteMask[43].SetMaskOfUserByteMask "" UBYTE NO_COMPU_METHOD 0 0 0 255 ECU_ADDRESS 0x0 /end MEASUREMENT
/begin MEASUREMENT ComM_UserByteMask[43].UserReqFullComIdxOfUserByteMask "" UBYTE NO_COMPU_METHOD 0 0 0 255 ECU_ADDRESS 0x0 /end MEASUREMENT
/begin MEASUREMENT ComM_UserByteMask[44].ChannelOfUserByteMask "" UBYTE NO_COMPU_METHOD 0 0 0 255 ECU_ADDRESS 0x0 /end MEASUREMENT
/begin MEASUREMENT ComM_UserByteMask[44].ClearMaskOfUserByteMask "" UBYTE NO_COMPU_METHOD 0 0 0 255 ECU_ADDRESS 0x0 /end MEASUREMENT
/begin MEASUREMENT ComM_UserByteMask[44].SetMaskOfUserByteMask "" UBYTE NO_COMPU_METHOD 0 0 0 255 ECU_ADDRESS 0x0 /end MEASUREMENT
/begin MEASUREMENT ComM_UserByteMask[44].UserReqFullComIdxOfUserByteMask "" UBYTE NO_COMPU_METHOD 0 0 0 255 ECU_ADDRESS 0x0 /end MEASUREMENT
/begin MEASUREMENT ComM_UserByteMask[45].ChannelOfUserByteMask "" UBYTE NO_COMPU_METHOD 0 0 0 255 ECU_ADDRESS 0x0 /end MEASUREMENT
/begin MEASUREMENT ComM_UserByteMask[45].ClearMaskOfUserByteMask "" UBYTE NO_COMPU_METHOD 0 0 0 255 ECU_ADDRESS 0x0 /end MEASUREMENT
/begin MEASUREMENT ComM_UserByteMask[45].SetMaskOfUserByteMask "" UBYTE NO_COMPU_METHOD 0 0 0 255 ECU_ADDRESS 0x0 /end MEASUREMENT
/begin MEASUREMENT ComM_UserByteMask[45].UserReqFullComIdxOfUserByteMask "" UBYTE NO_COMPU_METHOD 0 0 0 255 ECU_ADDRESS 0x0 /end MEASUREMENT
/begin MEASUREMENT ComM_UserByteMask[46].ChannelOfUserByteMask "" UBYTE NO_COMPU_METHOD 0 0 0 255 ECU_ADDRESS 0x0 /end MEASUREMENT
/begin MEASUREMENT ComM_UserByteMask[46].ClearMaskOfUserByteMask "" UBYTE NO_COMPU_METHOD 0 0 0 255 ECU_ADDRESS 0x0 /end MEASUREMENT
/begin MEASUREMENT ComM_UserByteMask[46].SetMaskOfUserByteMask "" UBYTE NO_COMPU_METHOD 0 0 0 255 ECU_ADDRESS 0x0 /end MEASUREMENT
/begin MEASUREMENT ComM_UserByteMask[46].UserReqFullComIdxOfUserByteMask "" UBYTE NO_COMPU_METHOD 0 0 0 255 ECU_ADDRESS 0x0 /end MEASUREMENT
/begin MEASUREMENT ComM_UserByteMask[47].ChannelOfUserByteMask "" UBYTE NO_COMPU_METHOD 0 0 0 255 ECU_ADDRESS 0x0 /end MEASUREMENT
/begin MEASUREMENT ComM_UserByteMask[47].ClearMaskOfUserByteMask "" UBYTE NO_COMPU_METHOD 0 0 0 255 ECU_ADDRESS 0x0 /end MEASUREMENT
/begin MEASUREMENT ComM_UserByteMask[47].SetMaskOfUserByteMask "" UBYTE NO_COMPU_METHOD 0 0 0 255 ECU_ADDRESS 0x0 /end MEASUREMENT
/begin MEASUREMENT ComM_UserByteMask[47].UserReqFullComIdxOfUserByteMask "" UBYTE NO_COMPU_METHOD 0 0 0 255 ECU_ADDRESS 0x0 /end MEASUREMENT
/begin MEASUREMENT ComM_UserByteMask[48].ChannelOfUserByteMask "" UBYTE NO_COMPU_METHOD 0 0 0 255 ECU_ADDRESS 0x0 /end MEASUREMENT
/begin MEASUREMENT ComM_UserByteMask[48].ClearMaskOfUserByteMask "" UBYTE NO_COMPU_METHOD 0 0 0 255 ECU_ADDRESS 0x0 /end MEASUREMENT
/begin MEASUREMENT ComM_UserByteMask[48].SetMaskOfUserByteMask "" UBYTE NO_COMPU_METHOD 0 0 0 255 ECU_ADDRESS 0x0 /end MEASUREMENT
/begin MEASUREMENT ComM_UserByteMask[48].UserReqFullComIdxOfUserByteMask "" UBYTE NO_COMPU_METHOD 0 0 0 255 ECU_ADDRESS 0x0 /end MEASUREMENT
/begin MEASUREMENT ComM_UserByteMask[49].ChannelOfUserByteMask "" UBYTE NO_COMPU_METHOD 0 0 0 255 ECU_ADDRESS 0x0 /end MEASUREMENT
/begin MEASUREMENT ComM_UserByteMask[49].ClearMaskOfUserByteMask "" UBYTE NO_COMPU_METHOD 0 0 0 255 ECU_ADDRESS 0x0 /end MEASUREMENT
/begin MEASUREMENT ComM_UserByteMask[49].SetMaskOfUserByteMask "" UBYTE NO_COMPU_METHOD 0 0 0 255 ECU_ADDRESS 0x0 /end MEASUREMENT
/begin MEASUREMENT ComM_UserByteMask[49].UserReqFullComIdxOfUserByteMask "" UBYTE NO_COMPU_METHOD 0 0 0 255 ECU_ADDRESS 0x0 /end MEASUREMENT
/begin MEASUREMENT ComM_UserByteMask[4].ChannelOfUserByteMask "" UBYTE NO_COMPU_METHOD 0 0 0 255 ECU_ADDRESS 0x0 /end MEASUREMENT
/begin MEASUREMENT ComM_UserByteMask[4].ClearMaskOfUserByteMask "" UBYTE NO_COMPU_METHOD 0 0 0 255 ECU_ADDRESS 0x0 /end MEASUREMENT
/begin MEASUREMENT ComM_UserByteMask[4].SetMaskOfUserByteMask "" UBYTE NO_COMPU_METHOD 0 0 0 255 ECU_ADDRESS 0x0 /end MEASUREMENT
/begin MEASUREMENT ComM_UserByteMask[4].UserReqFullComIdxOfUserByteMask "" UBYTE NO_COMPU_METHOD 0 0 0 255 ECU_ADDRESS 0x0 /end MEASUREMENT
/begin MEASUREMENT ComM_UserByteMask[5].ChannelOfUserByteMask "" UBYTE NO_COMPU_METHOD 0 0 0 255 ECU_ADDRESS 0x0 /end MEASUREMENT
/begin MEASUREMENT ComM_UserByteMask[5].ClearMaskOfUserByteMask "" UBYTE NO_COMPU_METHOD 0 0 0 255 ECU_ADDRESS 0x0 /end MEASUREMENT
/begin MEASUREMENT ComM_UserByteMask[5].SetMaskOfUserByteMask "" UBYTE NO_COMPU_METHOD 0 0 0 255 ECU_ADDRESS 0x0 /end MEASUREMENT
/begin MEASUREMENT ComM_UserByteMask[5].UserReqFullComIdxOfUserByteMask "" UBYTE NO_COMPU_METHOD 0 0 0 255 ECU_ADDRESS 0x0 /end MEASUREMENT
/begin MEASUREMENT ComM_UserByteMask[6].ChannelOfUserByteMask "" UBYTE NO_COMPU_METHOD 0 0 0 255 ECU_ADDRESS 0x0 /end MEASUREMENT
/begin MEASUREMENT ComM_UserByteMask[6].ClearMaskOfUserByteMask "" UBYTE NO_COMPU_METHOD 0 0 0 255 ECU_ADDRESS 0x0 /end MEASUREMENT
/begin MEASUREMENT ComM_UserByteMask[6].SetMaskOfUserByteMask "" UBYTE NO_COMPU_METHOD 0 0 0 255 ECU_ADDRESS 0x0 /end MEASUREMENT
/begin MEASUREMENT ComM_UserByteMask[6].UserReqFullComIdxOfUserByteMask "" UBYTE NO_COMPU_METHOD 0 0 0 255 ECU_ADDRESS 0x0 /end MEASUREMENT
/begin MEASUREMENT ComM_UserByteMask[7].ChannelOfUserByteMask "" UBYTE NO_COMPU_METHOD 0 0 0 255 ECU_ADDRESS 0x0 /end MEASUREMENT
/begin MEASUREMENT ComM_UserByteMask[7].ClearMaskOfUserByteMask "" UBYTE NO_COMPU_METHOD 0 0 0 255 ECU_ADDRESS 0x0 /end MEASUREMENT
/begin MEASUREMENT ComM_UserByteMask[7].SetMaskOfUserByteMask "" UBYTE NO_COMPU_METHOD 0 0 0 255 ECU_ADDRESS 0x0 /end MEASUREMENT
/begin MEASUREMENT ComM_UserByteMask[7].UserReqFullComIdxOfUserByteMask "" UBYTE NO_COMPU_METHOD 0 0 0 255 ECU_ADDRESS 0x0 /end MEASUREMENT
/begin MEASUREMENT ComM_UserByteMask[8].ChannelOfUserByteMask "" UBYTE NO_COMPU_METHOD 0 0 0 255 ECU_ADDRESS 0x0 /end MEASUREMENT
/begin MEASUREMENT ComM_UserByteMask[8].ClearMaskOfUserByteMask "" UBYTE NO_COMPU_METHOD 0 0 0 255 ECU_ADDRESS 0x0 /end MEASUREMENT
/begin MEASUREMENT ComM_UserByteMask[8].SetMaskOfUserByteMask "" UBYTE NO_COMPU_METHOD 0 0 0 255 ECU_ADDRESS 0x0 /end MEASUREMENT
/begin MEASUREMENT ComM_UserByteMask[8].UserReqFullComIdxOfUserByteMask "" UBYTE NO_COMPU_METHOD 0 0 0 255 ECU_ADDRESS 0x0 /end MEASUREMENT
/begin MEASUREMENT ComM_UserByteMask[9].ChannelOfUserByteMask "" UBYTE NO_COMPU_METHOD 0 0 0 255 ECU_ADDRESS 0x0 /end MEASUREMENT
/begin MEASUREMENT ComM_UserByteMask[9].ClearMaskOfUserByteMask "" UBYTE NO_COMPU_METHOD 0 0 0 255 ECU_ADDRESS 0x0 /end MEASUREMENT
/begin MEASUREMENT ComM_UserByteMask[9].SetMaskOfUserByteMask "" UBYTE NO_COMPU_METHOD 0 0 0 255 ECU_ADDRESS 0x0 /end MEASUREMENT
/begin MEASUREMENT ComM_UserByteMask[9].UserReqFullComIdxOfUserByteMask "" UBYTE NO_COMPU_METHOD 0 0 0 255 ECU_ADDRESS 0x0 /end MEASUREMENT
/begin MEASUREMENT ComM_UserPncByteMask[0].PncIDOfUserPncByteMask "" UBYTE NO_COMPU_METHOD 0 0 0 255 ECU_ADDRESS 0x0 /end MEASUREMENT
/begin MEASUREMENT ComM_UserPncByteMask[0].PncIdxOfUserPncByteMask "" UBYTE NO_COMPU_METHOD 0 0 0 255 ECU_ADDRESS 0x0 /end MEASUREMENT
/begin MEASUREMENT ComM_UserPncByteMask[0].UserReqPncFullComIdxOfUserPncByteMask "" UBYTE NO_COMPU_METHOD 0 0 0 255 ECU_ADDRESS 0x0 /end MEASUREMENT
/begin MEASUREMENT ComM_UserPncByteMask[10].PncIDOfUserPncByteMask "" UBYTE NO_COMPU_METHOD 0 0 0 255 ECU_ADDRESS 0x0 /end MEASUREMENT
/begin MEASUREMENT ComM_UserPncByteMask[10].PncIdxOfUserPncByteMask "" UBYTE NO_COMPU_METHOD 0 0 0 255 ECU_ADDRESS 0x0 /end MEASUREMENT
/begin MEASUREMENT ComM_UserPncByteMask[10].UserReqPncFullComIdxOfUserPncByteMask "" UBYTE NO_COMPU_METHOD 0 0 0 255 ECU_ADDRESS 0x0 /end MEASUREMENT
/begin MEASUREMENT ComM_UserPncByteMask[11].PncIDOfUserPncByteMask "" UBYTE NO_COMPU_METHOD 0 0 0 255 ECU_ADDRESS 0x0 /end MEASUREMENT
/begin MEASUREMENT ComM_UserPncByteMask[11].PncIdxOfUserPncByteMask "" UBYTE NO_COMPU_METHOD 0 0 0 255 ECU_ADDRESS 0x0 /end MEASUREMENT
/begin MEASUREMENT ComM_UserPncByteMask[11].UserReqPncFullComIdxOfUserPncByteMask "" UBYTE NO_COMPU_METHOD 0 0 0 255 ECU_ADDRESS 0x0 /end MEASUREMENT
/begin MEASUREMENT ComM_UserPncByteMask[12].PncIDOfUserPncByteMask "" UBYTE NO_COMPU_METHOD 0 0 0 255 ECU_ADDRESS 0x0 /end MEASUREMENT
/begin MEASUREMENT ComM_UserPncByteMask[12].PncIdxOfUserPncByteMask "" UBYTE NO_COMPU_METHOD 0 0 0 255 ECU_ADDRESS 0x0 /end MEASUREMENT
/begin MEASUREMENT ComM_UserPncByteMask[12].UserReqPncFullComIdxOfUserPncByteMask "" UBYTE NO_COMPU_METHOD 0 0 0 255 ECU_ADDRESS 0x0 /end MEASUREMENT
/begin MEASUREMENT ComM_UserPncByteMask[13].PncIDOfUserPncByteMask "" UBYTE NO_COMPU_METHOD 0 0 0 255 ECU_ADDRESS 0x0 /end MEASUREMENT
/begin MEASUREMENT ComM_UserPncByteMask[13].PncIdxOfUserPncByteMask "" UBYTE NO_COMPU_METHOD 0 0 0 255 ECU_ADDRESS 0x0 /end MEASUREMENT
/begin MEASUREMENT ComM_UserPncByteMask[13].UserReqPncFullComIdxOfUserPncByteMask "" UBYTE NO_COMPU_METHOD 0 0 0 255 ECU_ADDRESS 0x0 /end MEASUREMENT
/begin MEASUREMENT ComM_UserPncByteMask[14].PncIDOfUserPncByteMask "" UBYTE NO_COMPU_METHOD 0 0 0 255 ECU_ADDRESS 0x0 /end MEASUREMENT
/begin MEASUREMENT ComM_UserPncByteMask[14].PncIdxOfUserPncByteMask "" UBYTE NO_COMPU_METHOD 0 0 0 255 ECU_ADDRESS 0x0 /end MEASUREMENT
/begin MEASUREMENT ComM_UserPncByteMask[14].UserReqPncFullComIdxOfUserPncByteMask "" UBYTE NO_COMPU_METHOD 0 0 0 255 ECU_ADDRESS 0x0 /end MEASUREMENT
/begin MEASUREMENT ComM_UserPncByteMask[15].PncIDOfUserPncByteMask "" UBYTE NO_COMPU_METHOD 0 0 0 255 ECU_ADDRESS 0x0 /end MEASUREMENT
/begin MEASUREMENT ComM_UserPncByteMask[15].PncIdxOfUserPncByteMask "" UBYTE NO_COMPU_METHOD 0 0 0 255 ECU_ADDRESS 0x0 /end MEASUREMENT
/begin MEASUREMENT ComM_UserPncByteMask[15].UserReqPncFullComIdxOfUserPncByteMask "" UBYTE NO_COMPU_METHOD 0 0 0 255 ECU_ADDRESS 0x0 /end MEASUREMENT
/begin MEASUREMENT ComM_UserPncByteMask[16].PncIDOfUserPncByteMask "" UBYTE NO_COMPU_METHOD 0 0 0 255 ECU_ADDRESS 0x0 /end MEASUREMENT
/begin MEASUREMENT ComM_UserPncByteMask[16].PncIdxOfUserPncByteMask "" UBYTE NO_COMPU_METHOD 0 0 0 255 ECU_ADDRESS 0x0 /end MEASUREMENT
/begin MEASUREMENT ComM_UserPncByteMask[16].UserReqPncFullComIdxOfUserPncByteMask "" UBYTE NO_COMPU_METHOD 0 0 0 255 ECU_ADDRESS 0x0 /end MEASUREMENT
/begin MEASUREMENT ComM_UserPncByteMask[17].PncIDOfUserPncByteMask "" UBYTE NO_COMPU_METHOD 0 0 0 255 ECU_ADDRESS 0x0 /end MEASUREMENT
/begin MEASUREMENT ComM_UserPncByteMask[17].PncIdxOfUserPncByteMask "" UBYTE NO_COMPU_METHOD 0 0 0 255 ECU_ADDRESS 0x0 /end MEASUREMENT
/begin MEASUREMENT ComM_UserPncByteMask[17].UserReqPncFullComIdxOfUserPncByteMask "" UBYTE NO_COMPU_METHOD 0 0 0 255 ECU_ADDRESS 0x0 /end MEASUREMENT
/begin MEASUREMENT ComM_UserPncByteMask[18].PncIDOfUserPncByteMask "" UBYTE NO_COMPU_METHOD 0 0 0 255 ECU_ADDRESS 0x0 /end MEASUREMENT
/begin MEASUREMENT ComM_UserPncByteMask[18].PncIdxOfUserPncByteMask "" UBYTE NO_COMPU_METHOD 0 0 0 255 ECU_ADDRESS 0x0 /end MEASUREMENT
/begin MEASUREMENT ComM_UserPncByteMask[18].UserReqPncFullComIdxOfUserPncByteMask "" UBYTE NO_COMPU_METHOD 0 0 0 255 ECU_ADDRESS 0x0 /end MEASUREMENT
/begin MEASUREMENT ComM_UserPncByteMask[19].PncIDOfUserPncByteMask "" UBYTE NO_COMPU_METHOD 0 0 0 255 ECU_ADDRESS 0x0 /end MEASUREMENT
/begin MEASUREMENT ComM_UserPncByteMask[19].PncIdxOfUserPncByteMask "" UBYTE NO_COMPU_METHOD 0 0 0 255 ECU_ADDRESS 0x0 /end MEASUREMENT
/begin MEASUREMENT ComM_UserPncByteMask[19].UserReqPncFullComIdxOfUserPncByteMask "" UBYTE NO_COMPU_METHOD 0 0 0 255 ECU_ADDRESS 0x0 /end MEASUREMENT
/begin MEASUREMENT ComM_UserPncByteMask[1].PncIDOfUserPncByteMask "" UBYTE NO_COMPU_METHOD 0 0 0 255 ECU_ADDRESS 0x0 /end MEASUREMENT
/begin MEASUREMENT ComM_UserPncByteMask[1].PncIdxOfUserPncByteMask "" UBYTE NO_COMPU_METHOD 0 0 0 255 ECU_ADDRESS 0x0 /end MEASUREMENT
/begin MEASUREMENT ComM_UserPncByteMask[1].UserReqPncFullComIdxOfUserPncByteMask "" UBYTE NO_COMPU_METHOD 0 0 0 255 ECU_ADDRESS 0x0 /end MEASUREMENT
/begin MEASUREMENT ComM_UserPncByteMask[20].PncIDOfUserPncByteMask "" UBYTE NO_COMPU_METHOD 0 0 0 255 ECU_ADDRESS 0x0 /end MEASUREMENT
/begin MEASUREMENT ComM_UserPncByteMask[20].PncIdxOfUserPncByteMask "" UBYTE NO_COMPU_METHOD 0 0 0 255 ECU_ADDRESS 0x0 /end MEASUREMENT
/begin MEASUREMENT ComM_UserPncByteMask[20].UserReqPncFullComIdxOfUserPncByteMask "" UBYTE NO_COMPU_METHOD 0 0 0 255 ECU_ADDRESS 0x0 /end MEASUREMENT
/begin MEASUREMENT ComM_UserPncByteMask[21].PncIDOfUserPncByteMask "" UBYTE NO_COMPU_METHOD 0 0 0 255 ECU_ADDRESS 0x0 /end MEASUREMENT
/begin MEASUREMENT ComM_UserPncByteMask[21].PncIdxOfUserPncByteMask "" UBYTE NO_COMPU_METHOD 0 0 0 255 ECU_ADDRESS 0x0 /end MEASUREMENT
/begin MEASUREMENT ComM_UserPncByteMask[21].UserReqPncFullComIdxOfUserPncByteMask "" UBYTE NO_COMPU_METHOD 0 0 0 255 ECU_ADDRESS 0x0 /end MEASUREMENT
/begin MEASUREMENT ComM_UserPncByteMask[22].PncIDOfUserPncByteMask "" UBYTE NO_COMPU_METHOD 0 0 0 255 ECU_ADDRESS 0x0 /end MEASUREMENT
/begin MEASUREMENT ComM_UserPncByteMask[22].PncIdxOfUserPncByteMask "" UBYTE NO_COMPU_METHOD 0 0 0 255 ECU_ADDRESS 0x0 /end MEASUREMENT
/begin MEASUREMENT ComM_UserPncByteMask[22].UserReqPncFullComIdxOfUserPncByteMask "" UBYTE NO_COMPU_METHOD 0 0 0 255 ECU_ADDRESS 0x0 /end MEASUREMENT
/begin MEASUREMENT ComM_UserPncByteMask[23].PncIDOfUserPncByteMask "" UBYTE NO_COMPU_METHOD 0 0 0 255 ECU_ADDRESS 0x0 /end MEASUREMENT
/begin MEASUREMENT ComM_UserPncByteMask[23].PncIdxOfUserPncByteMask "" UBYTE NO_COMPU_METHOD 0 0 0 255 ECU_ADDRESS 0x0 /end MEASUREMENT
/begin MEASUREMENT ComM_UserPncByteMask[23].UserReqPncFullComIdxOfUserPncByteMask "" UBYTE NO_COMPU_METHOD 0 0 0 255 ECU_ADDRESS 0x0 /end MEASUREMENT
/begin MEASUREMENT ComM_UserPncByteMask[24].PncIDOfUserPncByteMask "" UBYTE NO_COMPU_METHOD 0 0 0 255 ECU_ADDRESS 0x0 /end MEASUREMENT
/begin MEASUREMENT ComM_UserPncByteMask[24].PncIdxOfUserPncByteMask "" UBYTE NO_COMPU_METHOD 0 0 0 255 ECU_ADDRESS 0x0 /end MEASUREMENT
/begin MEASUREMENT ComM_UserPncByteMask[24].UserReqPncFullComIdxOfUserPncByteMask "" UBYTE NO_COMPU_METHOD 0 0 0 255 ECU_ADDRESS 0x0 /end MEASUREMENT
/begin MEASUREMENT ComM_UserPncByteMask[25].PncIDOfUserPncByteMask "" UBYTE NO_COMPU_METHOD 0 0 0 255 ECU_ADDRESS 0x0 /end MEASUREMENT
/begin MEASUREMENT ComM_UserPncByteMask[25].PncIdxOfUserPncByteMask "" UBYTE NO_COMPU_METHOD 0 0 0 255 ECU_ADDRESS 0x0 /end MEASUREMENT
/begin MEASUREMENT ComM_UserPncByteMask[25].UserReqPncFullComIdxOfUserPncByteMask "" UBYTE NO_COMPU_METHOD 0 0 0 255 ECU_ADDRESS 0x0 /end MEASUREMENT
/begin MEASUREMENT ComM_UserPncByteMask[26].PncIDOfUserPncByteMask "" UBYTE NO_COMPU_METHOD 0 0 0 255 ECU_ADDRESS 0x0 /end MEASUREMENT
/begin MEASUREMENT ComM_UserPncByteMask[26].PncIdxOfUserPncByteMask "" UBYTE NO_COMPU_METHOD 0 0 0 255 ECU_ADDRESS 0x0 /end MEASUREMENT
/begin MEASUREMENT ComM_UserPncByteMask[26].UserReqPncFullComIdxOfUserPncByteMask "" UBYTE NO_COMPU_METHOD 0 0 0 255 ECU_ADDRESS 0x0 /end MEASUREMENT
/begin MEASUREMENT ComM_UserPncByteMask[27].PncIDOfUserPncByteMask "" UBYTE NO_COMPU_METHOD 0 0 0 255 ECU_ADDRESS 0x0 /end MEASUREMENT
/begin MEASUREMENT ComM_UserPncByteMask[27].PncIdxOfUserPncByteMask "" UBYTE NO_COMPU_METHOD 0 0 0 255 ECU_ADDRESS 0x0 /end MEASUREMENT
/begin MEASUREMENT ComM_UserPncByteMask[27].UserReqPncFullComIdxOfUserPncByteMask "" UBYTE NO_COMPU_METHOD 0 0 0 255 ECU_ADDRESS 0x0 /end MEASUREMENT
/begin MEASUREMENT ComM_UserPncByteMask[28].PncIDOfUserPncByteMask "" UBYTE NO_COMPU_METHOD 0 0 0 255 ECU_ADDRESS 0x0 /end MEASUREMENT
/begin MEASUREMENT ComM_UserPncByteMask[28].PncIdxOfUserPncByteMask "" UBYTE NO_COMPU_METHOD 0 0 0 255 ECU_ADDRESS 0x0 /end MEASUREMENT
/begin MEASUREMENT ComM_UserPncByteMask[28].UserReqPncFullComIdxOfUserPncByteMask "" UBYTE NO_COMPU_METHOD 0 0 0 255 ECU_ADDRESS 0x0 /end MEASUREMENT
/begin MEASUREMENT ComM_UserPncByteMask[29].PncIDOfUserPncByteMask "" UBYTE NO_COMPU_METHOD 0 0 0 255 ECU_ADDRESS 0x0 /end MEASUREMENT
/begin MEASUREMENT ComM_UserPncByteMask[29].PncIdxOfUserPncByteMask "" UBYTE NO_COMPU_METHOD 0 0 0 255 ECU_ADDRESS 0x0 /end MEASUREMENT
/begin MEASUREMENT ComM_UserPncByteMask[29].UserReqPncFullComIdxOfUserPncByteMask "" UBYTE NO_COMPU_METHOD 0 0 0 255 ECU_ADDRESS 0x0 /end MEASUREMENT
/begin MEASUREMENT ComM_UserPncByteMask[2].PncIDOfUserPncByteMask "" UBYTE NO_COMPU_METHOD 0 0 0 255 ECU_ADDRESS 0x0 /end MEASUREMENT
/begin MEASUREMENT ComM_UserPncByteMask[2].PncIdxOfUserPncByteMask "" UBYTE NO_COMPU_METHOD 0 0 0 255 ECU_ADDRESS 0x0 /end MEASUREMENT
/begin MEASUREMENT ComM_UserPncByteMask[2].UserReqPncFullComIdxOfUserPncByteMask "" UBYTE NO_COMPU_METHOD 0 0 0 255 ECU_ADDRESS 0x0 /end MEASUREMENT
/begin MEASUREMENT ComM_UserPncByteMask[30].PncIDOfUserPncByteMask "" UBYTE NO_COMPU_METHOD 0 0 0 255 ECU_ADDRESS 0x0 /end MEASUREMENT
/begin MEASUREMENT ComM_UserPncByteMask[30].PncIdxOfUserPncByteMask "" UBYTE NO_COMPU_METHOD 0 0 0 255 ECU_ADDRESS 0x0 /end MEASUREMENT
/begin MEASUREMENT ComM_UserPncByteMask[30].UserReqPncFullComIdxOfUserPncByteMask "" UBYTE NO_COMPU_METHOD 0 0 0 255 ECU_ADDRESS 0x0 /end MEASUREMENT
/begin MEASUREMENT ComM_UserPncByteMask[31].PncIDOfUserPncByteMask "" UBYTE NO_COMPU_METHOD 0 0 0 255 ECU_ADDRESS 0x0 /end MEASUREMENT
/begin MEASUREMENT ComM_UserPncByteMask[31].PncIdxOfUserPncByteMask "" UBYTE NO_COMPU_METHOD 0 0 0 255 ECU_ADDRESS 0x0 /end MEASUREMENT
/begin MEASUREMENT ComM_UserPncByteMask[31].UserReqPncFullComIdxOfUserPncByteMask "" UBYTE NO_COMPU_METHOD 0 0 0 255 ECU_ADDRESS 0x0 /end MEASUREMENT
/begin MEASUREMENT ComM_UserPncByteMask[32].PncIDOfUserPncByteMask "" UBYTE NO_COMPU_METHOD 0 0 0 255 ECU_ADDRESS 0x0 /end MEASUREMENT
/begin MEASUREMENT ComM_UserPncByteMask[32].PncIdxOfUserPncByteMask "" UBYTE NO_COMPU_METHOD 0 0 0 255 ECU_ADDRESS 0x0 /end MEASUREMENT
/begin MEASUREMENT ComM_UserPncByteMask[32].UserReqPncFullComIdxOfUserPncByteMask "" UBYTE NO_COMPU_METHOD 0 0 0 255 ECU_ADDRESS 0x0 /end MEASUREMENT
/begin MEASUREMENT ComM_UserPncByteMask[33].PncIDOfUserPncByteMask "" UBYTE NO_COMPU_METHOD 0 0 0 255 ECU_ADDRESS 0x0 /end MEASUREMENT
/begin MEASUREMENT ComM_UserPncByteMask[33].PncIdxOfUserPncByteMask "" UBYTE NO_COMPU_METHOD 0 0 0 255 ECU_ADDRESS 0x0 /end MEASUREMENT
/begin MEASUREMENT ComM_UserPncByteMask[33].UserReqPncFullComIdxOfUserPncByteMask "" UBYTE NO_COMPU_METHOD 0 0 0 255 ECU_ADDRESS 0x0 /end MEASUREMENT
/begin MEASUREMENT ComM_UserPncByteMask[34].PncIDOfUserPncByteMask "" UBYTE NO_COMPU_METHOD 0 0 0 255 ECU_ADDRESS 0x0 /end MEASUREMENT
/begin MEASUREMENT ComM_UserPncByteMask[34].PncIdxOfUserPncByteMask "" UBYTE NO_COMPU_METHOD 0 0 0 255 ECU_ADDRESS 0x0 /end MEASUREMENT
/begin MEASUREMENT ComM_UserPncByteMask[34].UserReqPncFullComIdxOfUserPncByteMask "" UBYTE NO_COMPU_METHOD 0 0 0 255 ECU_ADDRESS 0x0 /end MEASUREMENT
/begin MEASUREMENT ComM_UserPncByteMask[35].PncIDOfUserPncByteMask "" UBYTE NO_COMPU_METHOD 0 0 0 255 ECU_ADDRESS 0x0 /end MEASUREMENT
/begin MEASUREMENT ComM_UserPncByteMask[35].PncIdxOfUserPncByteMask "" UBYTE NO_COMPU_METHOD 0 0 0 255 ECU_ADDRESS 0x0 /end MEASUREMENT
/begin MEASUREMENT ComM_UserPncByteMask[35].UserReqPncFullComIdxOfUserPncByteMask "" UBYTE NO_COMPU_METHOD 0 0 0 255 ECU_ADDRESS 0x0 /end MEASUREMENT
/begin MEASUREMENT ComM_UserPncByteMask[36].PncIDOfUserPncByteMask "" UBYTE NO_COMPU_METHOD 0 0 0 255 ECU_ADDRESS 0x0 /end MEASUREMENT
/begin MEASUREMENT ComM_UserPncByteMask[36].PncIdxOfUserPncByteMask "" UBYTE NO_COMPU_METHOD 0 0 0 255 ECU_ADDRESS 0x0 /end MEASUREMENT
/begin MEASUREMENT ComM_UserPncByteMask[36].UserReqPncFullComIdxOfUserPncByteMask "" UBYTE NO_COMPU_METHOD 0 0 0 255 ECU_ADDRESS 0x0 /end MEASUREMENT
/begin MEASUREMENT ComM_UserPncByteMask[37].PncIDOfUserPncByteMask "" UBYTE NO_COMPU_METHOD 0 0 0 255 ECU_ADDRESS 0x0 /end MEASUREMENT
/begin MEASUREMENT ComM_UserPncByteMask[37].PncIdxOfUserPncByteMask "" UBYTE NO_COMPU_METHOD 0 0 0 255 ECU_ADDRESS 0x0 /end MEASUREMENT
/begin MEASUREMENT ComM_UserPncByteMask[37].UserReqPncFullComIdxOfUserPncByteMask "" UBYTE NO_COMPU_METHOD 0 0 0 255 ECU_ADDRESS 0x0 /end MEASUREMENT
/begin MEASUREMENT ComM_UserPncByteMask[38].PncIDOfUserPncByteMask "" UBYTE NO_COMPU_METHOD 0 0 0 255 ECU_ADDRESS 0x0 /end MEASUREMENT
/begin MEASUREMENT ComM_UserPncByteMask[38].PncIdxOfUserPncByteMask "" UBYTE NO_COMPU_METHOD 0 0 0 255 ECU_ADDRESS 0x0 /end MEASUREMENT
/begin MEASUREMENT ComM_UserPncByteMask[38].UserReqPncFullComIdxOfUserPncByteMask "" UBYTE NO_COMPU_METHOD 0 0 0 255 ECU_ADDRESS 0x0 /end MEASUREMENT
/begin MEASUREMENT ComM_UserPncByteMask[39].PncIDOfUserPncByteMask "" UBYTE NO_COMPU_METHOD 0 0 0 255 ECU_ADDRESS 0x0 /end MEASUREMENT
/begin MEASUREMENT ComM_UserPncByteMask[39].PncIdxOfUserPncByteMask "" UBYTE NO_COMPU_METHOD 0 0 0 255 ECU_ADDRESS 0x0 /end MEASUREMENT
/begin MEASUREMENT ComM_UserPncByteMask[39].UserReqPncFullComIdxOfUserPncByteMask "" UBYTE NO_COMPU_METHOD 0 0 0 255 ECU_ADDRESS 0x0 /end MEASUREMENT
/begin MEASUREMENT ComM_UserPncByteMask[3].PncIDOfUserPncByteMask "" UBYTE NO_COMPU_METHOD 0 0 0 255 ECU_ADDRESS 0x0 /end MEASUREMENT
/begin MEASUREMENT ComM_UserPncByteMask[3].PncIdxOfUserPncByteMask "" UBYTE NO_COMPU_METHOD 0 0 0 255 ECU_ADDRESS 0x0 /end MEASUREMENT
/begin MEASUREMENT ComM_UserPncByteMask[3].UserReqPncFullComIdxOfUserPncByteMask "" UBYTE NO_COMPU_METHOD 0 0 0 255 ECU_ADDRESS 0x0 /end MEASUREMENT
/begin MEASUREMENT ComM_UserPncByteMask[40].PncIDOfUserPncByteMask "" UBYTE NO_COMPU_METHOD 0 0 0 255 ECU_ADDRESS 0x0 /end MEASUREMENT
/begin MEASUREMENT ComM_UserPncByteMask[40].PncIdxOfUserPncByteMask "" UBYTE NO_COMPU_METHOD 0 0 0 255 ECU_ADDRESS 0x0 /end MEASUREMENT
/begin MEASUREMENT ComM_UserPncByteMask[40].UserReqPncFullComIdxOfUserPncByteMask "" UBYTE NO_COMPU_METHOD 0 0 0 255 ECU_ADDRESS 0x0 /end MEASUREMENT
/begin MEASUREMENT ComM_UserPncByteMask[41].PncIDOfUserPncByteMask "" UBYTE NO_COMPU_METHOD 0 0 0 255 ECU_ADDRESS 0x0 /end MEASUREMENT
/begin MEASUREMENT ComM_UserPncByteMask[41].PncIdxOfUserPncByteMask "" UBYTE NO_COMPU_METHOD 0 0 0 255 ECU_ADDRESS 0x0 /end MEASUREMENT
/begin MEASUREMENT ComM_UserPncByteMask[41].UserReqPncFullComIdxOfUserPncByteMask "" UBYTE NO_COMPU_METHOD 0 0 0 255 ECU_ADDRESS 0x0 /end MEASUREMENT
/begin MEASUREMENT ComM_UserPncByteMask[42].PncIDOfUserPncByteMask "" UBYTE NO_COMPU_METHOD 0 0 0 255 ECU_ADDRESS 0x0 /end MEASUREMENT
/begin MEASUREMENT ComM_UserPncByteMask[42].PncIdxOfUserPncByteMask "" UBYTE NO_COMPU_METHOD 0 0 0 255 ECU_ADDRESS 0x0 /end MEASUREMENT
/begin MEASUREMENT ComM_UserPncByteMask[42].UserReqPncFullComIdxOfUserPncByteMask "" UBYTE NO_COMPU_METHOD 0 0 0 255 ECU_ADDRESS 0x0 /end MEASUREMENT
/begin MEASUREMENT ComM_UserPncByteMask[43].PncIDOfUserPncByteMask "" UBYTE NO_COMPU_METHOD 0 0 0 255 ECU_ADDRESS 0x0 /end MEASUREMENT
/begin MEASUREMENT ComM_UserPncByteMask[43].PncIdxOfUserPncByteMask "" UBYTE NO_COMPU_METHOD 0 0 0 255 ECU_ADDRESS 0x0 /end MEASUREMENT
/begin MEASUREMENT ComM_UserPncByteMask[43].UserReqPncFullComIdxOfUserPncByteMask "" UBYTE NO_COMPU_METHOD 0 0 0 255 ECU_ADDRESS 0x0 /end MEASUREMENT
/begin MEASUREMENT ComM_UserPncByteMask[44].PncIDOfUserPncByteMask "" UBYTE NO_COMPU_METHOD 0 0 0 255 ECU_ADDRESS 0x0 /end MEASUREMENT
/begin MEASUREMENT ComM_UserPncByteMask[44].PncIdxOfUserPncByteMask "" UBYTE NO_COMPU_METHOD 0 0 0 255 ECU_ADDRESS 0x0 /end MEASUREMENT
/begin MEASUREMENT ComM_UserPncByteMask[44].UserReqPncFullComIdxOfUserPncByteMask "" UBYTE NO_COMPU_METHOD 0 0 0 255 ECU_ADDRESS 0x0 /end MEASUREMENT
/begin MEASUREMENT ComM_UserPncByteMask[45].PncIDOfUserPncByteMask "" UBYTE NO_COMPU_METHOD 0 0 0 255 ECU_ADDRESS 0x0 /end MEASUREMENT
/begin MEASUREMENT ComM_UserPncByteMask[45].PncIdxOfUserPncByteMask "" UBYTE NO_COMPU_METHOD 0 0 0 255 ECU_ADDRESS 0x0 /end MEASUREMENT
/begin MEASUREMENT ComM_UserPncByteMask[45].UserReqPncFullComIdxOfUserPncByteMask "" UBYTE NO_COMPU_METHOD 0 0 0 255 ECU_ADDRESS 0x0 /end MEASUREMENT
/begin MEASUREMENT ComM_UserPncByteMask[46].PncIDOfUserPncByteMask "" UBYTE NO_COMPU_METHOD 0 0 0 255 ECU_ADDRESS 0x0 /end MEASUREMENT
/begin MEASUREMENT ComM_UserPncByteMask[46].PncIdxOfUserPncByteMask "" UBYTE NO_COMPU_METHOD 0 0 0 255 ECU_ADDRESS 0x0 /end MEASUREMENT
/begin MEASUREMENT ComM_UserPncByteMask[46].UserReqPncFullComIdxOfUserPncByteMask "" UBYTE NO_COMPU_METHOD 0 0 0 255 ECU_ADDRESS 0x0 /end MEASUREMENT
/begin MEASUREMENT ComM_UserPncByteMask[47].PncIDOfUserPncByteMask "" UBYTE NO_COMPU_METHOD 0 0 0 255 ECU_ADDRESS 0x0 /end MEASUREMENT
/begin MEASUREMENT ComM_UserPncByteMask[47].PncIdxOfUserPncByteMask "" UBYTE NO_COMPU_METHOD 0 0 0 255 ECU_ADDRESS 0x0 /end MEASUREMENT
/begin MEASUREMENT ComM_UserPncByteMask[47].UserReqPncFullComIdxOfUserPncByteMask "" UBYTE NO_COMPU_METHOD 0 0 0 255 ECU_ADDRESS 0x0 /end MEASUREMENT
/begin MEASUREMENT ComM_UserPncByteMask[4].PncIDOfUserPncByteMask "" UBYTE NO_COMPU_METHOD 0 0 0 255 ECU_ADDRESS 0x0 /end MEASUREMENT
/begin MEASUREMENT ComM_UserPncByteMask[4].PncIdxOfUserPncByteMask "" UBYTE NO_COMPU_METHOD 0 0 0 255 ECU_ADDRESS 0x0 /end MEASUREMENT
/begin MEASUREMENT ComM_UserPncByteMask[4].UserReqPncFullComIdxOfUserPncByteMask "" UBYTE NO_COMPU_METHOD 0 0 0 255 ECU_ADDRESS 0x0 /end MEASUREMENT
/begin MEASUREMENT ComM_UserPncByteMask[5].PncIDOfUserPncByteMask "" UBYTE NO_COMPU_METHOD 0 0 0 255 ECU_ADDRESS 0x0 /end MEASUREMENT
/begin MEASUREMENT ComM_UserPncByteMask[5].PncIdxOfUserPncByteMask "" UBYTE NO_COMPU_METHOD 0 0 0 255 ECU_ADDRESS 0x0 /end MEASUREMENT
/begin MEASUREMENT ComM_UserPncByteMask[5].UserReqPncFullComIdxOfUserPncByteMask "" UBYTE NO_COMPU_METHOD 0 0 0 255 ECU_ADDRESS 0x0 /end MEASUREMENT
/begin MEASUREMENT ComM_UserPncByteMask[6].PncIDOfUserPncByteMask "" UBYTE NO_COMPU_METHOD 0 0 0 255 ECU_ADDRESS 0x0 /end MEASUREMENT
/begin MEASUREMENT ComM_UserPncByteMask[6].PncIdxOfUserPncByteMask "" UBYTE NO_COMPU_METHOD 0 0 0 255 ECU_ADDRESS 0x0 /end MEASUREMENT
/begin MEASUREMENT ComM_UserPncByteMask[6].UserReqPncFullComIdxOfUserPncByteMask "" UBYTE NO_COMPU_METHOD 0 0 0 255 ECU_ADDRESS 0x0 /end MEASUREMENT
/begin MEASUREMENT ComM_UserPncByteMask[7].PncIDOfUserPncByteMask "" UBYTE NO_COMPU_METHOD 0 0 0 255 ECU_ADDRESS 0x0 /end MEASUREMENT
/begin MEASUREMENT ComM_UserPncByteMask[7].PncIdxOfUserPncByteMask "" UBYTE NO_COMPU_METHOD 0 0 0 255 ECU_ADDRESS 0x0 /end MEASUREMENT
/begin MEASUREMENT ComM_UserPncByteMask[7].UserReqPncFullComIdxOfUserPncByteMask "" UBYTE NO_COMPU_METHOD 0 0 0 255 ECU_ADDRESS 0x0 /end MEASUREMENT
/begin MEASUREMENT ComM_UserPncByteMask[8].PncIDOfUserPncByteMask "" UBYTE NO_COMPU_METHOD 0 0 0 255 ECU_ADDRESS 0x0 /end MEASUREMENT
/begin MEASUREMENT ComM_UserPncByteMask[8].PncIdxOfUserPncByteMask "" UBYTE NO_COMPU_METHOD 0 0 0 255 ECU_ADDRESS 0x0 /end MEASUREMENT
/begin MEASUREMENT ComM_UserPncByteMask[8].UserReqPncFullComIdxOfUserPncByteMask "" UBYTE NO_COMPU_METHOD 0 0 0 255 ECU_ADDRESS 0x0 /end MEASUREMENT
/begin MEASUREMENT ComM_UserPncByteMask[9].PncIDOfUserPncByteMask "" UBYTE NO_COMPU_METHOD 0 0 0 255 ECU_ADDRESS 0x0 /end MEASUREMENT
/begin MEASUREMENT ComM_UserPncByteMask[9].PncIdxOfUserPncByteMask "" UBYTE NO_COMPU_METHOD 0 0 0 255 ECU_ADDRESS 0x0 /end MEASUREMENT
/begin MEASUREMENT ComM_UserPncByteMask[9].UserReqPncFullComIdxOfUserPncByteMask "" UBYTE NO_COMPU_METHOD 0 0 0 255 ECU_ADDRESS 0x0 /end MEASUREMENT
/begin MEASUREMENT ComM_UserReqFullCom "RAM array used to store user requests for channels as bitmasks. Each channel \'owns\' 1..n bytes in this array, depending on the number of users assigned to it." UBYTE NO_COMPU_METHOD 0 0 0 255 ECU_ADDRESS 0x0 MATRIX_DIM 8 /end MEASUREMENT
/begin MEASUREMENT ComM_UserReqPncFullCom "RAM array used to store user requests for PNCs as bitmasks. Each PNC \'owns\' 1..n bytes in this array, depending on the number of users assigned to it." UBYTE NO_COMPU_METHOD 0 0 0 255 ECU_ADDRESS 0x0 MATRIX_DIM 48 /end MEASUREMENT
/begin MEASUREMENT ComM_User[0].PncUserOfUser "" UBYTE ComM_PncUserOfUserType 0 0 0 1 ECU_ADDRESS 0x0 /end MEASUREMENT
/begin MEASUREMENT ComM_User[0].UserByteMaskEndIdxOfUser "" UBYTE ComM_UserByteMaskEndIdxOfUserType 0 0 0 255 ECU_ADDRESS 0x0 /end MEASUREMENT
/begin MEASUREMENT ComM_User[0].UserByteMaskStartIdxOfUser "" UBYTE ComM_UserByteMaskStartIdxOfUserType 0 0 0 255 ECU_ADDRESS 0x0 /end MEASUREMENT
/begin MEASUREMENT ComM_User[0].UserPncByteMaskEndIdxOfUser "" UBYTE ComM_UserPncByteMaskEndIdxOfUserType 0 0 0 255 ECU_ADDRESS 0x0 /end MEASUREMENT
/begin MEASUREMENT ComM_User[0].UserPncByteMaskLengthOfUser "" UBYTE NO_COMPU_METHOD 0 0 0 255 ECU_ADDRESS 0x0 /end MEASUREMENT
/begin MEASUREMENT ComM_User[0].UserPncByteMaskStartIdxOfUser "" UBYTE ComM_UserPncByteMaskStartIdxOfUserType 0 0 0 255 ECU_ADDRESS 0x0 /end MEASUREMENT
/begin MEASUREMENT ComM_User[10].PncUserOfUser "" UBYTE ComM_PncUserOfUserType 0 0 0 1 ECU_ADDRESS 0x0 /end MEASUREMENT
/begin MEASUREMENT ComM_User[10].UserByteMaskEndIdxOfUser "" UBYTE ComM_UserByteMaskEndIdxOfUserType 0 0 0 255 ECU_ADDRESS 0x0 /end MEASUREMENT
/begin MEASUREMENT ComM_User[10].UserByteMaskStartIdxOfUser "" UBYTE ComM_UserByteMaskStartIdxOfUserType 0 0 0 255 ECU_ADDRESS 0x0 /end MEASUREMENT
/begin MEASUREMENT ComM_User[10].UserPncByteMaskEndIdxOfUser "" UBYTE ComM_UserPncByteMaskEndIdxOfUserType 0 0 0 255 ECU_ADDRESS 0x0 /end MEASUREMENT
/begin MEASUREMENT ComM_User[10].UserPncByteMaskLengthOfUser "" UBYTE NO_COMPU_METHOD 0 0 0 255 ECU_ADDRESS 0x0 /end MEASUREMENT
/begin MEASUREMENT ComM_User[10].UserPncByteMaskStartIdxOfUser "" UBYTE ComM_UserPncByteMaskStartIdxOfUserType 0 0 0 255 ECU_ADDRESS 0x0 /end MEASUREMENT
/begin MEASUREMENT ComM_User[11].PncUserOfUser "" UBYTE ComM_PncUserOfUserType 0 0 0 1 ECU_ADDRESS 0x0 /end MEASUREMENT
/begin MEASUREMENT ComM_User[11].UserByteMaskEndIdxOfUser "" UBYTE ComM_UserByteMaskEndIdxOfUserType 0 0 0 255 ECU_ADDRESS 0x0 /end MEASUREMENT
/begin MEASUREMENT ComM_User[11].UserByteMaskStartIdxOfUser "" UBYTE ComM_UserByteMaskStartIdxOfUserType 0 0 0 255 ECU_ADDRESS 0x0 /end MEASUREMENT
/begin MEASUREMENT ComM_User[11].UserPncByteMaskEndIdxOfUser "" UBYTE ComM_UserPncByteMaskEndIdxOfUserType 0 0 0 255 ECU_ADDRESS 0x0 /end MEASUREMENT
/begin MEASUREMENT ComM_User[11].UserPncByteMaskLengthOfUser "" UBYTE NO_COMPU_METHOD 0 0 0 255 ECU_ADDRESS 0x0 /end MEASUREMENT
/begin MEASUREMENT ComM_User[11].UserPncByteMaskStartIdxOfUser "" UBYTE ComM_UserPncByteMaskStartIdxOfUserType 0 0 0 255 ECU_ADDRESS 0x0 /end MEASUREMENT
/begin MEASUREMENT ComM_User[12].PncUserOfUser "" UBYTE ComM_PncUserOfUserType 0 0 0 1 ECU_ADDRESS 0x0 /end MEASUREMENT
/begin MEASUREMENT ComM_User[12].UserByteMaskEndIdxOfUser "" UBYTE ComM_UserByteMaskEndIdxOfUserType 0 0 0 255 ECU_ADDRESS 0x0 /end MEASUREMENT
/begin MEASUREMENT ComM_User[12].UserByteMaskStartIdxOfUser "" UBYTE ComM_UserByteMaskStartIdxOfUserType 0 0 0 255 ECU_ADDRESS 0x0 /end MEASUREMENT
/begin MEASUREMENT ComM_User[12].UserPncByteMaskEndIdxOfUser "" UBYTE ComM_UserPncByteMaskEndIdxOfUserType 0 0 0 255 ECU_ADDRESS 0x0 /end MEASUREMENT
/begin MEASUREMENT ComM_User[12].UserPncByteMaskLengthOfUser "" UBYTE NO_COMPU_METHOD 0 0 0 255 ECU_ADDRESS 0x0 /end MEASUREMENT
/begin MEASUREMENT ComM_User[12].UserPncByteMaskStartIdxOfUser "" UBYTE ComM_UserPncByteMaskStartIdxOfUserType 0 0 0 255 ECU_ADDRESS 0x0 /end MEASUREMENT
/begin MEASUREMENT ComM_User[13].PncUserOfUser "" UBYTE ComM_PncUserOfUserType 0 0 0 1 ECU_ADDRESS 0x0 /end MEASUREMENT
/begin MEASUREMENT ComM_User[13].UserByteMaskEndIdxOfUser "" UBYTE ComM_UserByteMaskEndIdxOfUserType 0 0 0 255 ECU_ADDRESS 0x0 /end MEASUREMENT
/begin MEASUREMENT ComM_User[13].UserByteMaskStartIdxOfUser "" UBYTE ComM_UserByteMaskStartIdxOfUserType 0 0 0 255 ECU_ADDRESS 0x0 /end MEASUREMENT
/begin MEASUREMENT ComM_User[13].UserPncByteMaskEndIdxOfUser "" UBYTE ComM_UserPncByteMaskEndIdxOfUserType 0 0 0 255 ECU_ADDRESS 0x0 /end MEASUREMENT
/begin MEASUREMENT ComM_User[13].UserPncByteMaskLengthOfUser "" UBYTE NO_COMPU_METHOD 0 0 0 255 ECU_ADDRESS 0x0 /end MEASUREMENT
/begin MEASUREMENT ComM_User[13].UserPncByteMaskStartIdxOfUser "" UBYTE ComM_UserPncByteMaskStartIdxOfUserType 0 0 0 255 ECU_ADDRESS 0x0 /end MEASUREMENT
/begin MEASUREMENT ComM_User[14].PncUserOfUser "" UBYTE ComM_PncUserOfUserType 0 0 0 1 ECU_ADDRESS 0x0 /end MEASUREMENT
/begin MEASUREMENT ComM_User[14].UserByteMaskEndIdxOfUser "" UBYTE ComM_UserByteMaskEndIdxOfUserType 0 0 0 255 ECU_ADDRESS 0x0 /end MEASUREMENT
/begin MEASUREMENT ComM_User[14].UserByteMaskStartIdxOfUser "" UBYTE ComM_UserByteMaskStartIdxOfUserType 0 0 0 255 ECU_ADDRESS 0x0 /end MEASUREMENT
/begin MEASUREMENT ComM_User[14].UserPncByteMaskEndIdxOfUser "" UBYTE ComM_UserPncByteMaskEndIdxOfUserType 0 0 0 255 ECU_ADDRESS 0x0 /end MEASUREMENT
/begin MEASUREMENT ComM_User[14].UserPncByteMaskLengthOfUser "" UBYTE NO_COMPU_METHOD 0 0 0 255 ECU_ADDRESS 0x0 /end MEASUREMENT
/begin MEASUREMENT ComM_User[14].UserPncByteMaskStartIdxOfUser "" UBYTE ComM_UserPncByteMaskStartIdxOfUserType 0 0 0 255 ECU_ADDRESS 0x0 /end MEASUREMENT
/begin MEASUREMENT ComM_User[15].PncUserOfUser "" UBYTE ComM_PncUserOfUserType 0 0 0 1 ECU_ADDRESS 0x0 /end MEASUREMENT
/begin MEASUREMENT ComM_User[15].UserByteMaskEndIdxOfUser "" UBYTE ComM_UserByteMaskEndIdxOfUserType 0 0 0 255 ECU_ADDRESS 0x0 /end MEASUREMENT
/begin MEASUREMENT ComM_User[15].UserByteMaskStartIdxOfUser "" UBYTE ComM_UserByteMaskStartIdxOfUserType 0 0 0 255 ECU_ADDRESS 0x0 /end MEASUREMENT
/begin MEASUREMENT ComM_User[15].UserPncByteMaskEndIdxOfUser "" UBYTE ComM_UserPncByteMaskEndIdxOfUserType 0 0 0 255 ECU_ADDRESS 0x0 /end MEASUREMENT
/begin MEASUREMENT ComM_User[15].UserPncByteMaskLengthOfUser "" UBYTE NO_COMPU_METHOD 0 0 0 255 ECU_ADDRESS 0x0 /end MEASUREMENT
/begin MEASUREMENT ComM_User[15].UserPncByteMaskStartIdxOfUser "" UBYTE ComM_UserPncByteMaskStartIdxOfUserType 0 0 0 255 ECU_ADDRESS 0x0 /end MEASUREMENT
/begin MEASUREMENT ComM_User[16].PncUserOfUser "" UBYTE ComM_PncUserOfUserType 0 0 0 1 ECU_ADDRESS 0x0 /end MEASUREMENT
/begin MEASUREMENT ComM_User[16].UserByteMaskEndIdxOfUser "" UBYTE ComM_UserByteMaskEndIdxOfUserType 0 0 0 255 ECU_ADDRESS 0x0 /end MEASUREMENT
/begin MEASUREMENT ComM_User[16].UserByteMaskStartIdxOfUser "" UBYTE ComM_UserByteMaskStartIdxOfUserType 0 0 0 255 ECU_ADDRESS 0x0 /end MEASUREMENT
/begin MEASUREMENT ComM_User[16].UserPncByteMaskEndIdxOfUser "" UBYTE ComM_UserPncByteMaskEndIdxOfUserType 0 0 0 255 ECU_ADDRESS 0x0 /end MEASUREMENT
/begin MEASUREMENT ComM_User[16].UserPncByteMaskLengthOfUser "" UBYTE NO_COMPU_METHOD 0 0 0 255 ECU_ADDRESS 0x0 /end MEASUREMENT
/begin MEASUREMENT ComM_User[16].UserPncByteMaskStartIdxOfUser "" UBYTE ComM_UserPncByteMaskStartIdxOfUserType 0 0 0 255 ECU_ADDRESS 0x0 /end MEASUREMENT
/begin MEASUREMENT ComM_User[17].PncUserOfUser "" UBYTE ComM_PncUserOfUserType 0 0 0 1 ECU_ADDRESS 0x0 /end MEASUREMENT
/begin MEASUREMENT ComM_User[17].UserByteMaskEndIdxOfUser "" UBYTE ComM_UserByteMaskEndIdxOfUserType 0 0 0 255 ECU_ADDRESS 0x0 /end MEASUREMENT
/begin MEASUREMENT ComM_User[17].UserByteMaskStartIdxOfUser "" UBYTE ComM_UserByteMaskStartIdxOfUserType 0 0 0 255 ECU_ADDRESS 0x0 /end MEASUREMENT
/begin MEASUREMENT ComM_User[17].UserPncByteMaskEndIdxOfUser "" UBYTE ComM_UserPncByteMaskEndIdxOfUserType 0 0 0 255 ECU_ADDRESS 0x0 /end MEASUREMENT
/begin MEASUREMENT ComM_User[17].UserPncByteMaskLengthOfUser "" UBYTE NO_COMPU_METHOD 0 0 0 255 ECU_ADDRESS 0x0 /end MEASUREMENT
/begin MEASUREMENT ComM_User[17].UserPncByteMaskStartIdxOfUser "" UBYTE ComM_UserPncByteMaskStartIdxOfUserType 0 0 0 255 ECU_ADDRESS 0x0 /end MEASUREMENT
/begin MEASUREMENT ComM_User[18].PncUserOfUser "" UBYTE ComM_PncUserOfUserType 0 0 0 1 ECU_ADDRESS 0x0 /end MEASUREMENT
/begin MEASUREMENT ComM_User[18].UserByteMaskEndIdxOfUser "" UBYTE ComM_UserByteMaskEndIdxOfUserType 0 0 0 255 ECU_ADDRESS 0x0 /end MEASUREMENT
/begin MEASUREMENT ComM_User[18].UserByteMaskStartIdxOfUser "" UBYTE ComM_UserByteMaskStartIdxOfUserType 0 0 0 255 ECU_ADDRESS 0x0 /end MEASUREMENT
/begin MEASUREMENT ComM_User[18].UserPncByteMaskEndIdxOfUser "" UBYTE ComM_UserPncByteMaskEndIdxOfUserType 0 0 0 255 ECU_ADDRESS 0x0 /end MEASUREMENT
/begin MEASUREMENT ComM_User[18].UserPncByteMaskLengthOfUser "" UBYTE NO_COMPU_METHOD 0 0 0 255 ECU_ADDRESS 0x0 /end MEASUREMENT
/begin MEASUREMENT ComM_User[18].UserPncByteMaskStartIdxOfUser "" UBYTE ComM_UserPncByteMaskStartIdxOfUserType 0 0 0 255 ECU_ADDRESS 0x0 /end MEASUREMENT
/begin MEASUREMENT ComM_User[19].PncUserOfUser "" UBYTE ComM_PncUserOfUserType 0 0 0 1 ECU_ADDRESS 0x0 /end MEASUREMENT
/begin MEASUREMENT ComM_User[19].UserByteMaskEndIdxOfUser "" UBYTE ComM_UserByteMaskEndIdxOfUserType 0 0 0 255 ECU_ADDRESS 0x0 /end MEASUREMENT
/begin MEASUREMENT ComM_User[19].UserByteMaskStartIdxOfUser "" UBYTE ComM_UserByteMaskStartIdxOfUserType 0 0 0 255 ECU_ADDRESS 0x0 /end MEASUREMENT
/begin MEASUREMENT ComM_User[19].UserPncByteMaskEndIdxOfUser "" UBYTE ComM_UserPncByteMaskEndIdxOfUserType 0 0 0 255 ECU_ADDRESS 0x0 /end MEASUREMENT
/begin MEASUREMENT ComM_User[19].UserPncByteMaskLengthOfUser "" UBYTE NO_COMPU_METHOD 0 0 0 255 ECU_ADDRESS 0x0 /end MEASUREMENT
/begin MEASUREMENT ComM_User[19].UserPncByteMaskStartIdxOfUser "" UBYTE ComM_UserPncByteMaskStartIdxOfUserType 0 0 0 255 ECU_ADDRESS 0x0 /end MEASUREMENT
/begin MEASUREMENT ComM_User[1].PncUserOfUser "" UBYTE ComM_PncUserOfUserType 0 0 0 1 ECU_ADDRESS 0x0 /end MEASUREMENT
/begin MEASUREMENT ComM_User[1].UserByteMaskEndIdxOfUser "" UBYTE ComM_UserByteMaskEndIdxOfUserType 0 0 0 255 ECU_ADDRESS 0x0 /end MEASUREMENT
/begin MEASUREMENT ComM_User[1].UserByteMaskStartIdxOfUser "" UBYTE ComM_UserByteMaskStartIdxOfUserType 0 0 0 255 ECU_ADDRESS 0x0 /end MEASUREMENT
/begin MEASUREMENT ComM_User[1].UserPncByteMaskEndIdxOfUser "" UBYTE ComM_UserPncByteMaskEndIdxOfUserType 0 0 0 255 ECU_ADDRESS 0x0 /end MEASUREMENT
/begin MEASUREMENT ComM_User[1].UserPncByteMaskLengthOfUser "" UBYTE NO_COMPU_METHOD 0 0 0 255 ECU_ADDRESS 0x0 /end MEASUREMENT
/begin MEASUREMENT ComM_User[1].UserPncByteMaskStartIdxOfUser "" UBYTE ComM_UserPncByteMaskStartIdxOfUserType 0 0 0 255 ECU_ADDRESS 0x0 /end MEASUREMENT
/begin MEASUREMENT ComM_User[20].PncUserOfUser "" UBYTE ComM_PncUserOfUserType 0 0 0 1 ECU_ADDRESS 0x0 /end MEASUREMENT
/begin MEASUREMENT ComM_User[20].UserByteMaskEndIdxOfUser "" UBYTE ComM_UserByteMaskEndIdxOfUserType 0 0 0 255 ECU_ADDRESS 0x0 /end MEASUREMENT
/begin MEASUREMENT ComM_User[20].UserByteMaskStartIdxOfUser "" UBYTE ComM_UserByteMaskStartIdxOfUserType 0 0 0 255 ECU_ADDRESS 0x0 /end MEASUREMENT
/begin MEASUREMENT ComM_User[20].UserPncByteMaskEndIdxOfUser "" UBYTE ComM_UserPncByteMaskEndIdxOfUserType 0 0 0 255 ECU_ADDRESS 0x0 /end MEASUREMENT
/begin MEASUREMENT ComM_User[20].UserPncByteMaskLengthOfUser "" UBYTE NO_COMPU_METHOD 0 0 0 255 ECU_ADDRESS 0x0 /end MEASUREMENT
/begin MEASUREMENT ComM_User[20].UserPncByteMaskStartIdxOfUser "" UBYTE ComM_UserPncByteMaskStartIdxOfUserType 0 0 0 255 ECU_ADDRESS 0x0 /end MEASUREMENT
/begin MEASUREMENT ComM_User[21].PncUserOfUser "" UBYTE ComM_PncUserOfUserType 0 0 0 1 ECU_ADDRESS 0x0 /end MEASUREMENT
/begin MEASUREMENT ComM_User[21].UserByteMaskEndIdxOfUser "" UBYTE ComM_UserByteMaskEndIdxOfUserType 0 0 0 255 ECU_ADDRESS 0x0 /end MEASUREMENT
/begin MEASUREMENT ComM_User[21].UserByteMaskStartIdxOfUser "" UBYTE ComM_UserByteMaskStartIdxOfUserType 0 0 0 255 ECU_ADDRESS 0x0 /end MEASUREMENT
/begin MEASUREMENT ComM_User[21].UserPncByteMaskEndIdxOfUser "" UBYTE ComM_UserPncByteMaskEndIdxOfUserType 0 0 0 255 ECU_ADDRESS 0x0 /end MEASUREMENT
/begin MEASUREMENT ComM_User[21].UserPncByteMaskLengthOfUser "" UBYTE NO_COMPU_METHOD 0 0 0 255 ECU_ADDRESS 0x0 /end MEASUREMENT
/begin MEASUREMENT ComM_User[21].UserPncByteMaskStartIdxOfUser "" UBYTE ComM_UserPncByteMaskStartIdxOfUserType 0 0 0 255 ECU_ADDRESS 0x0 /end MEASUREMENT
/begin MEASUREMENT ComM_User[22].PncUserOfUser "" UBYTE ComM_PncUserOfUserType 0 0 0 1 ECU_ADDRESS 0x0 /end MEASUREMENT
/begin MEASUREMENT ComM_User[22].UserByteMaskEndIdxOfUser "" UBYTE ComM_UserByteMaskEndIdxOfUserType 0 0 0 255 ECU_ADDRESS 0x0 /end MEASUREMENT
/begin MEASUREMENT ComM_User[22].UserByteMaskStartIdxOfUser "" UBYTE ComM_UserByteMaskStartIdxOfUserType 0 0 0 255 ECU_ADDRESS 0x0 /end MEASUREMENT
/begin MEASUREMENT ComM_User[22].UserPncByteMaskEndIdxOfUser "" UBYTE ComM_UserPncByteMaskEndIdxOfUserType 0 0 0 255 ECU_ADDRESS 0x0 /end MEASUREMENT
/begin MEASUREMENT ComM_User[22].UserPncByteMaskLengthOfUser "" UBYTE NO_COMPU_METHOD 0 0 0 255 ECU_ADDRESS 0x0 /end MEASUREMENT
/begin MEASUREMENT ComM_User[22].UserPncByteMaskStartIdxOfUser "" UBYTE ComM_UserPncByteMaskStartIdxOfUserType 0 0 0 255 ECU_ADDRESS 0x0 /end MEASUREMENT
/begin MEASUREMENT ComM_User[23].PncUserOfUser "" UBYTE ComM_PncUserOfUserType 0 0 0 1 ECU_ADDRESS 0x0 /end MEASUREMENT
/begin MEASUREMENT ComM_User[23].UserByteMaskEndIdxOfUser "" UBYTE ComM_UserByteMaskEndIdxOfUserType 0 0 0 255 ECU_ADDRESS 0x0 /end MEASUREMENT
/begin MEASUREMENT ComM_User[23].UserByteMaskStartIdxOfUser "" UBYTE ComM_UserByteMaskStartIdxOfUserType 0 0 0 255 ECU_ADDRESS 0x0 /end MEASUREMENT
/begin MEASUREMENT ComM_User[23].UserPncByteMaskEndIdxOfUser "" UBYTE ComM_UserPncByteMaskEndIdxOfUserType 0 0 0 255 ECU_ADDRESS 0x0 /end MEASUREMENT
/begin MEASUREMENT ComM_User[23].UserPncByteMaskLengthOfUser "" UBYTE NO_COMPU_METHOD 0 0 0 255 ECU_ADDRESS 0x0 /end MEASUREMENT
/begin MEASUREMENT ComM_User[23].UserPncByteMaskStartIdxOfUser "" UBYTE ComM_UserPncByteMaskStartIdxOfUserType 0 0 0 255 ECU_ADDRESS 0x0 /end MEASUREMENT
/begin MEASUREMENT ComM_User[24].PncUserOfUser "" UBYTE ComM_PncUserOfUserType 0 0 0 1 ECU_ADDRESS 0x0 /end MEASUREMENT
/begin MEASUREMENT ComM_User[24].UserByteMaskEndIdxOfUser "" UBYTE ComM_UserByteMaskEndIdxOfUserType 0 0 0 255 ECU_ADDRESS 0x0 /end MEASUREMENT
/begin MEASUREMENT ComM_User[24].UserByteMaskStartIdxOfUser "" UBYTE ComM_UserByteMaskStartIdxOfUserType 0 0 0 255 ECU_ADDRESS 0x0 /end MEASUREMENT
/begin MEASUREMENT ComM_User[24].UserPncByteMaskEndIdxOfUser "" UBYTE ComM_UserPncByteMaskEndIdxOfUserType 0 0 0 255 ECU_ADDRESS 0x0 /end MEASUREMENT
/begin MEASUREMENT ComM_User[24].UserPncByteMaskLengthOfUser "" UBYTE NO_COMPU_METHOD 0 0 0 255 ECU_ADDRESS 0x0 /end MEASUREMENT
/begin MEASUREMENT ComM_User[24].UserPncByteMaskStartIdxOfUser "" UBYTE ComM_UserPncByteMaskStartIdxOfUserType 0 0 0 255 ECU_ADDRESS 0x0 /end MEASUREMENT
/begin MEASUREMENT ComM_User[25].PncUserOfUser "" UBYTE ComM_PncUserOfUserType 0 0 0 1 ECU_ADDRESS 0x0 /end MEASUREMENT
/begin MEASUREMENT ComM_User[25].UserByteMaskEndIdxOfUser "" UBYTE ComM_UserByteMaskEndIdxOfUserType 0 0 0 255 ECU_ADDRESS 0x0 /end MEASUREMENT
/begin MEASUREMENT ComM_User[25].UserByteMaskStartIdxOfUser "" UBYTE ComM_UserByteMaskStartIdxOfUserType 0 0 0 255 ECU_ADDRESS 0x0 /end MEASUREMENT
/begin MEASUREMENT ComM_User[25].UserPncByteMaskEndIdxOfUser "" UBYTE ComM_UserPncByteMaskEndIdxOfUserType 0 0 0 255 ECU_ADDRESS 0x0 /end MEASUREMENT
/begin MEASUREMENT ComM_User[25].UserPncByteMaskLengthOfUser "" UBYTE NO_COMPU_METHOD 0 0 0 255 ECU_ADDRESS 0x0 /end MEASUREMENT
/begin MEASUREMENT ComM_User[25].UserPncByteMaskStartIdxOfUser "" UBYTE ComM_UserPncByteMaskStartIdxOfUserType 0 0 0 255 ECU_ADDRESS 0x0 /end MEASUREMENT
/begin MEASUREMENT ComM_User[26].PncUserOfUser "" UBYTE ComM_PncUserOfUserType 0 0 0 1 ECU_ADDRESS 0x0 /end MEASUREMENT
/begin MEASUREMENT ComM_User[26].UserByteMaskEndIdxOfUser "" UBYTE ComM_UserByteMaskEndIdxOfUserType 0 0 0 255 ECU_ADDRESS 0x0 /end MEASUREMENT
/begin MEASUREMENT ComM_User[26].UserByteMaskStartIdxOfUser "" UBYTE ComM_UserByteMaskStartIdxOfUserType 0 0 0 255 ECU_ADDRESS 0x0 /end MEASUREMENT
/begin MEASUREMENT ComM_User[26].UserPncByteMaskEndIdxOfUser "" UBYTE ComM_UserPncByteMaskEndIdxOfUserType 0 0 0 255 ECU_ADDRESS 0x0 /end MEASUREMENT
/begin MEASUREMENT ComM_User[26].UserPncByteMaskLengthOfUser "" UBYTE NO_COMPU_METHOD 0 0 0 255 ECU_ADDRESS 0x0 /end MEASUREMENT
/begin MEASUREMENT ComM_User[26].UserPncByteMaskStartIdxOfUser "" UBYTE ComM_UserPncByteMaskStartIdxOfUserType 0 0 0 255 ECU_ADDRESS 0x0 /end MEASUREMENT
/begin MEASUREMENT ComM_User[27].PncUserOfUser "" UBYTE ComM_PncUserOfUserType 0 0 0 1 ECU_ADDRESS 0x0 /end MEASUREMENT
/begin MEASUREMENT ComM_User[27].UserByteMaskEndIdxOfUser "" UBYTE ComM_UserByteMaskEndIdxOfUserType 0 0 0 255 ECU_ADDRESS 0x0 /end MEASUREMENT
/begin MEASUREMENT ComM_User[27].UserByteMaskStartIdxOfUser "" UBYTE ComM_UserByteMaskStartIdxOfUserType 0 0 0 255 ECU_ADDRESS 0x0 /end MEASUREMENT
/begin MEASUREMENT ComM_User[27].UserPncByteMaskEndIdxOfUser "" UBYTE ComM_UserPncByteMaskEndIdxOfUserType 0 0 0 255 ECU_ADDRESS 0x0 /end MEASUREMENT
/begin MEASUREMENT ComM_User[27].UserPncByteMaskLengthOfUser "" UBYTE NO_COMPU_METHOD 0 0 0 255 ECU_ADDRESS 0x0 /end MEASUREMENT
/begin MEASUREMENT ComM_User[27].UserPncByteMaskStartIdxOfUser "" UBYTE ComM_UserPncByteMaskStartIdxOfUserType 0 0 0 255 ECU_ADDRESS 0x0 /end MEASUREMENT
/begin MEASUREMENT ComM_User[28].PncUserOfUser "" UBYTE ComM_PncUserOfUserType 0 0 0 1 ECU_ADDRESS 0x0 /end MEASUREMENT
/begin MEASUREMENT ComM_User[28].UserByteMaskEndIdxOfUser "" UBYTE ComM_UserByteMaskEndIdxOfUserType 0 0 0 255 ECU_ADDRESS 0x0 /end MEASUREMENT
/begin MEASUREMENT ComM_User[28].UserByteMaskStartIdxOfUser "" UBYTE ComM_UserByteMaskStartIdxOfUserType 0 0 0 255 ECU_ADDRESS 0x0 /end MEASUREMENT
/begin MEASUREMENT ComM_User[28].UserPncByteMaskEndIdxOfUser "" UBYTE ComM_UserPncByteMaskEndIdxOfUserType 0 0 0 255 ECU_ADDRESS 0x0 /end MEASUREMENT
/begin MEASUREMENT ComM_User[28].UserPncByteMaskLengthOfUser "" UBYTE NO_COMPU_METHOD 0 0 0 255 ECU_ADDRESS 0x0 /end MEASUREMENT
/begin MEASUREMENT ComM_User[28].UserPncByteMaskStartIdxOfUser "" UBYTE ComM_UserPncByteMaskStartIdxOfUserType 0 0 0 255 ECU_ADDRESS 0x0 /end MEASUREMENT
/begin MEASUREMENT ComM_User[29].PncUserOfUser "" UBYTE ComM_PncUserOfUserType 0 0 0 1 ECU_ADDRESS 0x0 /end MEASUREMENT
/begin MEASUREMENT ComM_User[29].UserByteMaskEndIdxOfUser "" UBYTE ComM_UserByteMaskEndIdxOfUserType 0 0 0 255 ECU_ADDRESS 0x0 /end MEASUREMENT
/begin MEASUREMENT ComM_User[29].UserByteMaskStartIdxOfUser "" UBYTE ComM_UserByteMaskStartIdxOfUserType 0 0 0 255 ECU_ADDRESS 0x0 /end MEASUREMENT
/begin MEASUREMENT ComM_User[29].UserPncByteMaskEndIdxOfUser "" UBYTE ComM_UserPncByteMaskEndIdxOfUserType 0 0 0 255 ECU_ADDRESS 0x0 /end MEASUREMENT
/begin MEASUREMENT ComM_User[29].UserPncByteMaskLengthOfUser "" UBYTE NO_COMPU_METHOD 0 0 0 255 ECU_ADDRESS 0x0 /end MEASUREMENT
/begin MEASUREMENT ComM_User[29].UserPncByteMaskStartIdxOfUser "" UBYTE ComM_UserPncByteMaskStartIdxOfUserType 0 0 0 255 ECU_ADDRESS 0x0 /end MEASUREMENT
/begin MEASUREMENT ComM_User[2].PncUserOfUser "" UBYTE ComM_PncUserOfUserType 0 0 0 1 ECU_ADDRESS 0x0 /end MEASUREMENT
/begin MEASUREMENT ComM_User[2].UserByteMaskEndIdxOfUser "" UBYTE ComM_UserByteMaskEndIdxOfUserType 0 0 0 255 ECU_ADDRESS 0x0 /end MEASUREMENT
/begin MEASUREMENT ComM_User[2].UserByteMaskStartIdxOfUser "" UBYTE ComM_UserByteMaskStartIdxOfUserType 0 0 0 255 ECU_ADDRESS 0x0 /end MEASUREMENT
/begin MEASUREMENT ComM_User[2].UserPncByteMaskEndIdxOfUser "" UBYTE ComM_UserPncByteMaskEndIdxOfUserType 0 0 0 255 ECU_ADDRESS 0x0 /end MEASUREMENT
/begin MEASUREMENT ComM_User[2].UserPncByteMaskLengthOfUser "" UBYTE NO_COMPU_METHOD 0 0 0 255 ECU_ADDRESS 0x0 /end MEASUREMENT
/begin MEASUREMENT ComM_User[2].UserPncByteMaskStartIdxOfUser "" UBYTE ComM_UserPncByteMaskStartIdxOfUserType 0 0 0 255 ECU_ADDRESS 0x0 /end MEASUREMENT
/begin MEASUREMENT ComM_User[30].PncUserOfUser "" UBYTE ComM_PncUserOfUserType 0 0 0 1 ECU_ADDRESS 0x0 /end MEASUREMENT
/begin MEASUREMENT ComM_User[30].UserByteMaskEndIdxOfUser "" UBYTE ComM_UserByteMaskEndIdxOfUserType 0 0 0 255 ECU_ADDRESS 0x0 /end MEASUREMENT
/begin MEASUREMENT ComM_User[30].UserByteMaskStartIdxOfUser "" UBYTE ComM_UserByteMaskStartIdxOfUserType 0 0 0 255 ECU_ADDRESS 0x0 /end MEASUREMENT
/begin MEASUREMENT ComM_User[30].UserPncByteMaskEndIdxOfUser "" UBYTE ComM_UserPncByteMaskEndIdxOfUserType 0 0 0 255 ECU_ADDRESS 0x0 /end MEASUREMENT
/begin MEASUREMENT ComM_User[30].UserPncByteMaskLengthOfUser "" UBYTE NO_COMPU_METHOD 0 0 0 255 ECU_ADDRESS 0x0 /end MEASUREMENT
/begin MEASUREMENT ComM_User[30].UserPncByteMaskStartIdxOfUser "" UBYTE ComM_UserPncByteMaskStartIdxOfUserType 0 0 0 255 ECU_ADDRESS 0x0 /end MEASUREMENT
/begin MEASUREMENT ComM_User[31].PncUserOfUser "" UBYTE ComM_PncUserOfUserType 0 0 0 1 ECU_ADDRESS 0x0 /end MEASUREMENT
/begin MEASUREMENT ComM_User[31].UserByteMaskEndIdxOfUser "" UBYTE ComM_UserByteMaskEndIdxOfUserType 0 0 0 255 ECU_ADDRESS 0x0 /end MEASUREMENT
/begin MEASUREMENT ComM_User[31].UserByteMaskStartIdxOfUser "" UBYTE ComM_UserByteMaskStartIdxOfUserType 0 0 0 255 ECU_ADDRESS 0x0 /end MEASUREMENT
/begin MEASUREMENT ComM_User[31].UserPncByteMaskEndIdxOfUser "" UBYTE ComM_UserPncByteMaskEndIdxOfUserType 0 0 0 255 ECU_ADDRESS 0x0 /end MEASUREMENT
/begin MEASUREMENT ComM_User[31].UserPncByteMaskLengthOfUser "" UBYTE NO_COMPU_METHOD 0 0 0 255 ECU_ADDRESS 0x0 /end MEASUREMENT
/begin MEASUREMENT ComM_User[31].UserPncByteMaskStartIdxOfUser "" UBYTE ComM_UserPncByteMaskStartIdxOfUserType 0 0 0 255 ECU_ADDRESS 0x0 /end MEASUREMENT
/begin MEASUREMENT ComM_User[32].PncUserOfUser "" UBYTE ComM_PncUserOfUserType 0 0 0 1 ECU_ADDRESS 0x0 /end MEASUREMENT
/begin MEASUREMENT ComM_User[32].UserByteMaskEndIdxOfUser "" UBYTE ComM_UserByteMaskEndIdxOfUserType 0 0 0 255 ECU_ADDRESS 0x0 /end MEASUREMENT
/begin MEASUREMENT ComM_User[32].UserByteMaskStartIdxOfUser "" UBYTE ComM_UserByteMaskStartIdxOfUserType 0 0 0 255 ECU_ADDRESS 0x0 /end MEASUREMENT
/begin MEASUREMENT ComM_User[32].UserPncByteMaskEndIdxOfUser "" UBYTE ComM_UserPncByteMaskEndIdxOfUserType 0 0 0 255 ECU_ADDRESS 0x0 /end MEASUREMENT
/begin MEASUREMENT ComM_User[32].UserPncByteMaskLengthOfUser "" UBYTE NO_COMPU_METHOD 0 0 0 255 ECU_ADDRESS 0x0 /end MEASUREMENT
/begin MEASUREMENT ComM_User[32].UserPncByteMaskStartIdxOfUser "" UBYTE ComM_UserPncByteMaskStartIdxOfUserType 0 0 0 255 ECU_ADDRESS 0x0 /end MEASUREMENT
/begin MEASUREMENT ComM_User[33].PncUserOfUser "" UBYTE ComM_PncUserOfUserType 0 0 0 1 ECU_ADDRESS 0x0 /end MEASUREMENT
/begin MEASUREMENT ComM_User[33].UserByteMaskEndIdxOfUser "" UBYTE ComM_UserByteMaskEndIdxOfUserType 0 0 0 255 ECU_ADDRESS 0x0 /end MEASUREMENT
/begin MEASUREMENT ComM_User[33].UserByteMaskStartIdxOfUser "" UBYTE ComM_UserByteMaskStartIdxOfUserType 0 0 0 255 ECU_ADDRESS 0x0 /end MEASUREMENT
/begin MEASUREMENT ComM_User[33].UserPncByteMaskEndIdxOfUser "" UBYTE ComM_UserPncByteMaskEndIdxOfUserType 0 0 0 255 ECU_ADDRESS 0x0 /end MEASUREMENT
/begin MEASUREMENT ComM_User[33].UserPncByteMaskLengthOfUser "" UBYTE NO_COMPU_METHOD 0 0 0 255 ECU_ADDRESS 0x0 /end MEASUREMENT
/begin MEASUREMENT ComM_User[33].UserPncByteMaskStartIdxOfUser "" UBYTE ComM_UserPncByteMaskStartIdxOfUserType 0 0 0 255 ECU_ADDRESS 0x0 /end MEASUREMENT
/begin MEASUREMENT ComM_User[34].PncUserOfUser "" UBYTE ComM_PncUserOfUserType 0 0 0 1 ECU_ADDRESS 0x0 /end MEASUREMENT
/begin MEASUREMENT ComM_User[34].UserByteMaskEndIdxOfUser "" UBYTE ComM_UserByteMaskEndIdxOfUserType 0 0 0 255 ECU_ADDRESS 0x0 /end MEASUREMENT
/begin MEASUREMENT ComM_User[34].UserByteMaskStartIdxOfUser "" UBYTE ComM_UserByteMaskStartIdxOfUserType 0 0 0 255 ECU_ADDRESS 0x0 /end MEASUREMENT
/begin MEASUREMENT ComM_User[34].UserPncByteMaskEndIdxOfUser "" UBYTE ComM_UserPncByteMaskEndIdxOfUserType 0 0 0 255 ECU_ADDRESS 0x0 /end MEASUREMENT
/begin MEASUREMENT ComM_User[34].UserPncByteMaskLengthOfUser "" UBYTE NO_COMPU_METHOD 0 0 0 255 ECU_ADDRESS 0x0 /end MEASUREMENT
/begin MEASUREMENT ComM_User[34].UserPncByteMaskStartIdxOfUser "" UBYTE ComM_UserPncByteMaskStartIdxOfUserType 0 0 0 255 ECU_ADDRESS 0x0 /end MEASUREMENT
/begin MEASUREMENT ComM_User[35].PncUserOfUser "" UBYTE ComM_PncUserOfUserType 0 0 0 1 ECU_ADDRESS 0x0 /end MEASUREMENT
/begin MEASUREMENT ComM_User[35].UserByteMaskEndIdxOfUser "" UBYTE ComM_UserByteMaskEndIdxOfUserType 0 0 0 255 ECU_ADDRESS 0x0 /end MEASUREMENT
/begin MEASUREMENT ComM_User[35].UserByteMaskStartIdxOfUser "" UBYTE ComM_UserByteMaskStartIdxOfUserType 0 0 0 255 ECU_ADDRESS 0x0 /end MEASUREMENT
/begin MEASUREMENT ComM_User[35].UserPncByteMaskEndIdxOfUser "" UBYTE ComM_UserPncByteMaskEndIdxOfUserType 0 0 0 255 ECU_ADDRESS 0x0 /end MEASUREMENT
/begin MEASUREMENT ComM_User[35].UserPncByteMaskLengthOfUser "" UBYTE NO_COMPU_METHOD 0 0 0 255 ECU_ADDRESS 0x0 /end MEASUREMENT
/begin MEASUREMENT ComM_User[35].UserPncByteMaskStartIdxOfUser "" UBYTE ComM_UserPncByteMaskStartIdxOfUserType 0 0 0 255 ECU_ADDRESS 0x0 /end MEASUREMENT
/begin MEASUREMENT ComM_User[36].PncUserOfUser "" UBYTE ComM_PncUserOfUserType 0 0 0 1 ECU_ADDRESS 0x0 /end MEASUREMENT
/begin MEASUREMENT ComM_User[36].UserByteMaskEndIdxOfUser "" UBYTE ComM_UserByteMaskEndIdxOfUserType 0 0 0 255 ECU_ADDRESS 0x0 /end MEASUREMENT
/begin MEASUREMENT ComM_User[36].UserByteMaskStartIdxOfUser "" UBYTE ComM_UserByteMaskStartIdxOfUserType 0 0 0 255 ECU_ADDRESS 0x0 /end MEASUREMENT
/begin MEASUREMENT ComM_User[36].UserPncByteMaskEndIdxOfUser "" UBYTE ComM_UserPncByteMaskEndIdxOfUserType 0 0 0 255 ECU_ADDRESS 0x0 /end MEASUREMENT
/begin MEASUREMENT ComM_User[36].UserPncByteMaskLengthOfUser "" UBYTE NO_COMPU_METHOD 0 0 0 255 ECU_ADDRESS 0x0 /end MEASUREMENT
/begin MEASUREMENT ComM_User[36].UserPncByteMaskStartIdxOfUser "" UBYTE ComM_UserPncByteMaskStartIdxOfUserType 0 0 0 255 ECU_ADDRESS 0x0 /end MEASUREMENT
/begin MEASUREMENT ComM_User[37].PncUserOfUser "" UBYTE ComM_PncUserOfUserType 0 0 0 1 ECU_ADDRESS 0x0 /end MEASUREMENT
/begin MEASUREMENT ComM_User[37].UserByteMaskEndIdxOfUser "" UBYTE ComM_UserByteMaskEndIdxOfUserType 0 0 0 255 ECU_ADDRESS 0x0 /end MEASUREMENT
/begin MEASUREMENT ComM_User[37].UserByteMaskStartIdxOfUser "" UBYTE ComM_UserByteMaskStartIdxOfUserType 0 0 0 255 ECU_ADDRESS 0x0 /end MEASUREMENT
/begin MEASUREMENT ComM_User[37].UserPncByteMaskEndIdxOfUser "" UBYTE ComM_UserPncByteMaskEndIdxOfUserType 0 0 0 255 ECU_ADDRESS 0x0 /end MEASUREMENT
/begin MEASUREMENT ComM_User[37].UserPncByteMaskLengthOfUser "" UBYTE NO_COMPU_METHOD 0 0 0 255 ECU_ADDRESS 0x0 /end MEASUREMENT
/begin MEASUREMENT ComM_User[37].UserPncByteMaskStartIdxOfUser "" UBYTE ComM_UserPncByteMaskStartIdxOfUserType 0 0 0 255 ECU_ADDRESS 0x0 /end MEASUREMENT
/begin MEASUREMENT ComM_User[38].PncUserOfUser "" UBYTE ComM_PncUserOfUserType 0 0 0 1 ECU_ADDRESS 0x0 /end MEASUREMENT
/begin MEASUREMENT ComM_User[38].UserByteMaskEndIdxOfUser "" UBYTE ComM_UserByteMaskEndIdxOfUserType 0 0 0 255 ECU_ADDRESS 0x0 /end MEASUREMENT
/begin MEASUREMENT ComM_User[38].UserByteMaskStartIdxOfUser "" UBYTE ComM_UserByteMaskStartIdxOfUserType 0 0 0 255 ECU_ADDRESS 0x0 /end MEASUREMENT
/begin MEASUREMENT ComM_User[38].UserPncByteMaskEndIdxOfUser "" UBYTE ComM_UserPncByteMaskEndIdxOfUserType 0 0 0 255 ECU_ADDRESS 0x0 /end MEASUREMENT
/begin MEASUREMENT ComM_User[38].UserPncByteMaskLengthOfUser "" UBYTE NO_COMPU_METHOD 0 0 0 255 ECU_ADDRESS 0x0 /end MEASUREMENT
/begin MEASUREMENT ComM_User[38].UserPncByteMaskStartIdxOfUser "" UBYTE ComM_UserPncByteMaskStartIdxOfUserType 0 0 0 255 ECU_ADDRESS 0x0 /end MEASUREMENT
/begin MEASUREMENT ComM_User[39].PncUserOfUser "" UBYTE ComM_PncUserOfUserType 0 0 0 1 ECU_ADDRESS 0x0 /end MEASUREMENT
/begin MEASUREMENT ComM_User[39].UserByteMaskEndIdxOfUser "" UBYTE ComM_UserByteMaskEndIdxOfUserType 0 0 0 255 ECU_ADDRESS 0x0 /end MEASUREMENT
/begin MEASUREMENT ComM_User[39].UserByteMaskStartIdxOfUser "" UBYTE ComM_UserByteMaskStartIdxOfUserType 0 0 0 255 ECU_ADDRESS 0x0 /end MEASUREMENT
/begin MEASUREMENT ComM_User[39].UserPncByteMaskEndIdxOfUser "" UBYTE ComM_UserPncByteMaskEndIdxOfUserType 0 0 0 255 ECU_ADDRESS 0x0 /end MEASUREMENT
/begin MEASUREMENT ComM_User[39].UserPncByteMaskLengthOfUser "" UBYTE NO_COMPU_METHOD 0 0 0 255 ECU_ADDRESS 0x0 /end MEASUREMENT
/begin MEASUREMENT ComM_User[39].UserPncByteMaskStartIdxOfUser "" UBYTE ComM_UserPncByteMaskStartIdxOfUserType 0 0 0 255 ECU_ADDRESS 0x0 /end MEASUREMENT
/begin MEASUREMENT ComM_User[3].PncUserOfUser "" UBYTE ComM_PncUserOfUserType 0 0 0 1 ECU_ADDRESS 0x0 /end MEASUREMENT
/begin MEASUREMENT ComM_User[3].UserByteMaskEndIdxOfUser "" UBYTE ComM_UserByteMaskEndIdxOfUserType 0 0 0 255 ECU_ADDRESS 0x0 /end MEASUREMENT
/begin MEASUREMENT ComM_User[3].UserByteMaskStartIdxOfUser "" UBYTE ComM_UserByteMaskStartIdxOfUserType 0 0 0 255 ECU_ADDRESS 0x0 /end MEASUREMENT
/begin MEASUREMENT ComM_User[3].UserPncByteMaskEndIdxOfUser "" UBYTE ComM_UserPncByteMaskEndIdxOfUserType 0 0 0 255 ECU_ADDRESS 0x0 /end MEASUREMENT
/begin MEASUREMENT ComM_User[3].UserPncByteMaskLengthOfUser "" UBYTE NO_COMPU_METHOD 0 0 0 255 ECU_ADDRESS 0x0 /end MEASUREMENT
/begin MEASUREMENT ComM_User[3].UserPncByteMaskStartIdxOfUser "" UBYTE ComM_UserPncByteMaskStartIdxOfUserType 0 0 0 255 ECU_ADDRESS 0x0 /end MEASUREMENT
/begin MEASUREMENT ComM_User[40].PncUserOfUser "" UBYTE ComM_PncUserOfUserType 0 0 0 1 ECU_ADDRESS 0x0 /end MEASUREMENT
/begin MEASUREMENT ComM_User[40].UserByteMaskEndIdxOfUser "" UBYTE ComM_UserByteMaskEndIdxOfUserType 0 0 0 255 ECU_ADDRESS 0x0 /end MEASUREMENT
/begin MEASUREMENT ComM_User[40].UserByteMaskStartIdxOfUser "" UBYTE ComM_UserByteMaskStartIdxOfUserType 0 0 0 255 ECU_ADDRESS 0x0 /end MEASUREMENT
/begin MEASUREMENT ComM_User[40].UserPncByteMaskEndIdxOfUser "" UBYTE ComM_UserPncByteMaskEndIdxOfUserType 0 0 0 255 ECU_ADDRESS 0x0 /end MEASUREMENT
/begin MEASUREMENT ComM_User[40].UserPncByteMaskLengthOfUser "" UBYTE NO_COMPU_METHOD 0 0 0 255 ECU_ADDRESS 0x0 /end MEASUREMENT
/begin MEASUREMENT ComM_User[40].UserPncByteMaskStartIdxOfUser "" UBYTE ComM_UserPncByteMaskStartIdxOfUserType 0 0 0 255 ECU_ADDRESS 0x0 /end MEASUREMENT
/begin MEASUREMENT ComM_User[41].PncUserOfUser "" UBYTE ComM_PncUserOfUserType 0 0 0 1 ECU_ADDRESS 0x0 /end MEASUREMENT
/begin MEASUREMENT ComM_User[41].UserByteMaskEndIdxOfUser "" UBYTE ComM_UserByteMaskEndIdxOfUserType 0 0 0 255 ECU_ADDRESS 0x0 /end MEASUREMENT
/begin MEASUREMENT ComM_User[41].UserByteMaskStartIdxOfUser "" UBYTE ComM_UserByteMaskStartIdxOfUserType 0 0 0 255 ECU_ADDRESS 0x0 /end MEASUREMENT
/begin MEASUREMENT ComM_User[41].UserPncByteMaskEndIdxOfUser "" UBYTE ComM_UserPncByteMaskEndIdxOfUserType 0 0 0 255 ECU_ADDRESS 0x0 /end MEASUREMENT
/begin MEASUREMENT ComM_User[41].UserPncByteMaskLengthOfUser "" UBYTE NO_COMPU_METHOD 0 0 0 255 ECU_ADDRESS 0x0 /end MEASUREMENT
/begin MEASUREMENT ComM_User[41].UserPncByteMaskStartIdxOfUser "" UBYTE ComM_UserPncByteMaskStartIdxOfUserType 0 0 0 255 ECU_ADDRESS 0x0 /end MEASUREMENT
/begin MEASUREMENT ComM_User[42].PncUserOfUser "" UBYTE ComM_PncUserOfUserType 0 0 0 1 ECU_ADDRESS 0x0 /end MEASUREMENT
/begin MEASUREMENT ComM_User[42].UserByteMaskEndIdxOfUser "" UBYTE ComM_UserByteMaskEndIdxOfUserType 0 0 0 255 ECU_ADDRESS 0x0 /end MEASUREMENT
/begin MEASUREMENT ComM_User[42].UserByteMaskStartIdxOfUser "" UBYTE ComM_UserByteMaskStartIdxOfUserType 0 0 0 255 ECU_ADDRESS 0x0 /end MEASUREMENT
/begin MEASUREMENT ComM_User[42].UserPncByteMaskEndIdxOfUser "" UBYTE ComM_UserPncByteMaskEndIdxOfUserType 0 0 0 255 ECU_ADDRESS 0x0 /end MEASUREMENT
/begin MEASUREMENT ComM_User[42].UserPncByteMaskLengthOfUser "" UBYTE NO_COMPU_METHOD 0 0 0 255 ECU_ADDRESS 0x0 /end MEASUREMENT
/begin MEASUREMENT ComM_User[42].UserPncByteMaskStartIdxOfUser "" UBYTE ComM_UserPncByteMaskStartIdxOfUserType 0 0 0 255 ECU_ADDRESS 0x0 /end MEASUREMENT
/begin MEASUREMENT ComM_User[43].PncUserOfUser "" UBYTE ComM_PncUserOfUserType 0 0 0 1 ECU_ADDRESS 0x0 /end MEASUREMENT
/begin MEASUREMENT ComM_User[43].UserByteMaskEndIdxOfUser "" UBYTE ComM_UserByteMaskEndIdxOfUserType 0 0 0 255 ECU_ADDRESS 0x0 /end MEASUREMENT
/begin MEASUREMENT ComM_User[43].UserByteMaskStartIdxOfUser "" UBYTE ComM_UserByteMaskStartIdxOfUserType 0 0 0 255 ECU_ADDRESS 0x0 /end MEASUREMENT
/begin MEASUREMENT ComM_User[43].UserPncByteMaskEndIdxOfUser "" UBYTE ComM_UserPncByteMaskEndIdxOfUserType 0 0 0 255 ECU_ADDRESS 0x0 /end MEASUREMENT
/begin MEASUREMENT ComM_User[43].UserPncByteMaskLengthOfUser "" UBYTE NO_COMPU_METHOD 0 0 0 255 ECU_ADDRESS 0x0 /end MEASUREMENT
/begin MEASUREMENT ComM_User[43].UserPncByteMaskStartIdxOfUser "" UBYTE ComM_UserPncByteMaskStartIdxOfUserType 0 0 0 255 ECU_ADDRESS 0x0 /end MEASUREMENT
/begin MEASUREMENT ComM_User[44].PncUserOfUser "" UBYTE ComM_PncUserOfUserType 0 0 0 1 ECU_ADDRESS 0x0 /end MEASUREMENT
/begin MEASUREMENT ComM_User[44].UserByteMaskEndIdxOfUser "" UBYTE ComM_UserByteMaskEndIdxOfUserType 0 0 0 255 ECU_ADDRESS 0x0 /end MEASUREMENT
/begin MEASUREMENT ComM_User[44].UserByteMaskStartIdxOfUser "" UBYTE ComM_UserByteMaskStartIdxOfUserType 0 0 0 255 ECU_ADDRESS 0x0 /end MEASUREMENT
/begin MEASUREMENT ComM_User[44].UserPncByteMaskEndIdxOfUser "" UBYTE ComM_UserPncByteMaskEndIdxOfUserType 0 0 0 255 ECU_ADDRESS 0x0 /end MEASUREMENT
/begin MEASUREMENT ComM_User[44].UserPncByteMaskLengthOfUser "" UBYTE NO_COMPU_METHOD 0 0 0 255 ECU_ADDRESS 0x0 /end MEASUREMENT
/begin MEASUREMENT ComM_User[44].UserPncByteMaskStartIdxOfUser "" UBYTE ComM_UserPncByteMaskStartIdxOfUserType 0 0 0 255 ECU_ADDRESS 0x0 /end MEASUREMENT
/begin MEASUREMENT ComM_User[45].PncUserOfUser "" UBYTE ComM_PncUserOfUserType 0 0 0 1 ECU_ADDRESS 0x0 /end MEASUREMENT
/begin MEASUREMENT ComM_User[45].UserByteMaskEndIdxOfUser "" UBYTE ComM_UserByteMaskEndIdxOfUserType 0 0 0 255 ECU_ADDRESS 0x0 /end MEASUREMENT
/begin MEASUREMENT ComM_User[45].UserByteMaskStartIdxOfUser "" UBYTE ComM_UserByteMaskStartIdxOfUserType 0 0 0 255 ECU_ADDRESS 0x0 /end MEASUREMENT
/begin MEASUREMENT ComM_User[45].UserPncByteMaskEndIdxOfUser "" UBYTE ComM_UserPncByteMaskEndIdxOfUserType 0 0 0 255 ECU_ADDRESS 0x0 /end MEASUREMENT
/begin MEASUREMENT ComM_User[45].UserPncByteMaskLengthOfUser "" UBYTE NO_COMPU_METHOD 0 0 0 255 ECU_ADDRESS 0x0 /end MEASUREMENT
/begin MEASUREMENT ComM_User[45].UserPncByteMaskStartIdxOfUser "" UBYTE ComM_UserPncByteMaskStartIdxOfUserType 0 0 0 255 ECU_ADDRESS 0x0 /end MEASUREMENT
/begin MEASUREMENT ComM_User[46].PncUserOfUser "" UBYTE ComM_PncUserOfUserType 0 0 0 1 ECU_ADDRESS 0x0 /end MEASUREMENT
/begin MEASUREMENT ComM_User[46].UserByteMaskEndIdxOfUser "" UBYTE ComM_UserByteMaskEndIdxOfUserType 0 0 0 255 ECU_ADDRESS 0x0 /end MEASUREMENT
/begin MEASUREMENT ComM_User[46].UserByteMaskStartIdxOfUser "" UBYTE ComM_UserByteMaskStartIdxOfUserType 0 0 0 255 ECU_ADDRESS 0x0 /end MEASUREMENT
/begin MEASUREMENT ComM_User[46].UserPncByteMaskEndIdxOfUser "" UBYTE ComM_UserPncByteMaskEndIdxOfUserType 0 0 0 255 ECU_ADDRESS 0x0 /end MEASUREMENT
/begin MEASUREMENT ComM_User[46].UserPncByteMaskLengthOfUser "" UBYTE NO_COMPU_METHOD 0 0 0 255 ECU_ADDRESS 0x0 /end MEASUREMENT
/begin MEASUREMENT ComM_User[46].UserPncByteMaskStartIdxOfUser "" UBYTE ComM_UserPncByteMaskStartIdxOfUserType 0 0 0 255 ECU_ADDRESS 0x0 /end MEASUREMENT
/begin MEASUREMENT ComM_User[47].PncUserOfUser "" UBYTE ComM_PncUserOfUserType 0 0 0 1 ECU_ADDRESS 0x0 /end MEASUREMENT
/begin MEASUREMENT ComM_User[47].UserByteMaskEndIdxOfUser "" UBYTE ComM_UserByteMaskEndIdxOfUserType 0 0 0 255 ECU_ADDRESS 0x0 /end MEASUREMENT
/begin MEASUREMENT ComM_User[47].UserByteMaskStartIdxOfUser "" UBYTE ComM_UserByteMaskStartIdxOfUserType 0 0 0 255 ECU_ADDRESS 0x0 /end MEASUREMENT
/begin MEASUREMENT ComM_User[47].UserPncByteMaskEndIdxOfUser "" UBYTE ComM_UserPncByteMaskEndIdxOfUserType 0 0 0 255 ECU_ADDRESS 0x0 /end MEASUREMENT
/begin MEASUREMENT ComM_User[47].UserPncByteMaskLengthOfUser "" UBYTE NO_COMPU_METHOD 0 0 0 255 ECU_ADDRESS 0x0 /end MEASUREMENT
/begin MEASUREMENT ComM_User[47].UserPncByteMaskStartIdxOfUser "" UBYTE ComM_UserPncByteMaskStartIdxOfUserType 0 0 0 255 ECU_ADDRESS 0x0 /end MEASUREMENT
/begin MEASUREMENT ComM_User[48].PncUserOfUser "" UBYTE ComM_PncUserOfUserType 0 0 0 1 ECU_ADDRESS 0x0 /end MEASUREMENT
/begin MEASUREMENT ComM_User[48].UserByteMaskEndIdxOfUser "" UBYTE ComM_UserByteMaskEndIdxOfUserType 0 0 0 255 ECU_ADDRESS 0x0 /end MEASUREMENT
/begin MEASUREMENT ComM_User[48].UserByteMaskStartIdxOfUser "" UBYTE ComM_UserByteMaskStartIdxOfUserType 0 0 0 255 ECU_ADDRESS 0x0 /end MEASUREMENT
/begin MEASUREMENT ComM_User[48].UserPncByteMaskEndIdxOfUser "" UBYTE ComM_UserPncByteMaskEndIdxOfUserType 0 0 0 255 ECU_ADDRESS 0x0 /end MEASUREMENT
/begin MEASUREMENT ComM_User[48].UserPncByteMaskLengthOfUser "" UBYTE NO_COMPU_METHOD 0 0 0 255 ECU_ADDRESS 0x0 /end MEASUREMENT
/begin MEASUREMENT ComM_User[48].UserPncByteMaskStartIdxOfUser "" UBYTE ComM_UserPncByteMaskStartIdxOfUserType 0 0 0 255 ECU_ADDRESS 0x0 /end MEASUREMENT
/begin MEASUREMENT ComM_User[49].PncUserOfUser "" UBYTE ComM_PncUserOfUserType 0 0 0 1 ECU_ADDRESS 0x0 /end MEASUREMENT
/begin MEASUREMENT ComM_User[49].UserByteMaskEndIdxOfUser "" UBYTE ComM_UserByteMaskEndIdxOfUserType 0 0 0 255 ECU_ADDRESS 0x0 /end MEASUREMENT
/begin MEASUREMENT ComM_User[49].UserByteMaskStartIdxOfUser "" UBYTE ComM_UserByteMaskStartIdxOfUserType 0 0 0 255 ECU_ADDRESS 0x0 /end MEASUREMENT
/begin MEASUREMENT ComM_User[49].UserPncByteMaskEndIdxOfUser "" UBYTE ComM_UserPncByteMaskEndIdxOfUserType 0 0 0 255 ECU_ADDRESS 0x0 /end MEASUREMENT
/begin MEASUREMENT ComM_User[49].UserPncByteMaskLengthOfUser "" UBYTE NO_COMPU_METHOD 0 0 0 255 ECU_ADDRESS 0x0 /end MEASUREMENT
/begin MEASUREMENT ComM_User[49].UserPncByteMaskStartIdxOfUser "" UBYTE ComM_UserPncByteMaskStartIdxOfUserType 0 0 0 255 ECU_ADDRESS 0x0 /end MEASUREMENT
/begin MEASUREMENT ComM_User[4].PncUserOfUser "" UBYTE ComM_PncUserOfUserType 0 0 0 1 ECU_ADDRESS 0x0 /end MEASUREMENT
/begin MEASUREMENT ComM_User[4].UserByteMaskEndIdxOfUser "" UBYTE ComM_UserByteMaskEndIdxOfUserType 0 0 0 255 ECU_ADDRESS 0x0 /end MEASUREMENT
/begin MEASUREMENT ComM_User[4].UserByteMaskStartIdxOfUser "" UBYTE ComM_UserByteMaskStartIdxOfUserType 0 0 0 255 ECU_ADDRESS 0x0 /end MEASUREMENT
/begin MEASUREMENT ComM_User[4].UserPncByteMaskEndIdxOfUser "" UBYTE ComM_UserPncByteMaskEndIdxOfUserType 0 0 0 255 ECU_ADDRESS 0x0 /end MEASUREMENT
/begin MEASUREMENT ComM_User[4].UserPncByteMaskLengthOfUser "" UBYTE NO_COMPU_METHOD 0 0 0 255 ECU_ADDRESS 0x0 /end MEASUREMENT
/begin MEASUREMENT ComM_User[4].UserPncByteMaskStartIdxOfUser "" UBYTE ComM_UserPncByteMaskStartIdxOfUserType 0 0 0 255 ECU_ADDRESS 0x0 /end MEASUREMENT
/begin MEASUREMENT ComM_User[5].PncUserOfUser "" UBYTE ComM_PncUserOfUserType 0 0 0 1 ECU_ADDRESS 0x0 /end MEASUREMENT
/begin MEASUREMENT ComM_User[5].UserByteMaskEndIdxOfUser "" UBYTE ComM_UserByteMaskEndIdxOfUserType 0 0 0 255 ECU_ADDRESS 0x0 /end MEASUREMENT
/begin MEASUREMENT ComM_User[5].UserByteMaskStartIdxOfUser "" UBYTE ComM_UserByteMaskStartIdxOfUserType 0 0 0 255 ECU_ADDRESS 0x0 /end MEASUREMENT
/begin MEASUREMENT ComM_User[5].UserPncByteMaskEndIdxOfUser "" UBYTE ComM_UserPncByteMaskEndIdxOfUserType 0 0 0 255 ECU_ADDRESS 0x0 /end MEASUREMENT
/begin MEASUREMENT ComM_User[5].UserPncByteMaskLengthOfUser "" UBYTE NO_COMPU_METHOD 0 0 0 255 ECU_ADDRESS 0x0 /end MEASUREMENT
/begin MEASUREMENT ComM_User[5].UserPncByteMaskStartIdxOfUser "" UBYTE ComM_UserPncByteMaskStartIdxOfUserType 0 0 0 255 ECU_ADDRESS 0x0 /end MEASUREMENT
/begin MEASUREMENT ComM_User[6].PncUserOfUser "" UBYTE ComM_PncUserOfUserType 0 0 0 1 ECU_ADDRESS 0x0 /end MEASUREMENT
/begin MEASUREMENT ComM_User[6].UserByteMaskEndIdxOfUser "" UBYTE ComM_UserByteMaskEndIdxOfUserType 0 0 0 255 ECU_ADDRESS 0x0 /end MEASUREMENT
/begin MEASUREMENT ComM_User[6].UserByteMaskStartIdxOfUser "" UBYTE ComM_UserByteMaskStartIdxOfUserType 0 0 0 255 ECU_ADDRESS 0x0 /end MEASUREMENT
/begin MEASUREMENT ComM_User[6].UserPncByteMaskEndIdxOfUser "" UBYTE ComM_UserPncByteMaskEndIdxOfUserType 0 0 0 255 ECU_ADDRESS 0x0 /end MEASUREMENT
/begin MEASUREMENT ComM_User[6].UserPncByteMaskLengthOfUser "" UBYTE NO_COMPU_METHOD 0 0 0 255 ECU_ADDRESS 0x0 /end MEASUREMENT
/begin MEASUREMENT ComM_User[6].UserPncByteMaskStartIdxOfUser "" UBYTE ComM_UserPncByteMaskStartIdxOfUserType 0 0 0 255 ECU_ADDRESS 0x0 /end MEASUREMENT
/begin MEASUREMENT ComM_User[7].PncUserOfUser "" UBYTE ComM_PncUserOfUserType 0 0 0 1 ECU_ADDRESS 0x0 /end MEASUREMENT
/begin MEASUREMENT ComM_User[7].UserByteMaskEndIdxOfUser "" UBYTE ComM_UserByteMaskEndIdxOfUserType 0 0 0 255 ECU_ADDRESS 0x0 /end MEASUREMENT
/begin MEASUREMENT ComM_User[7].UserByteMaskStartIdxOfUser "" UBYTE ComM_UserByteMaskStartIdxOfUserType 0 0 0 255 ECU_ADDRESS 0x0 /end MEASUREMENT
/begin MEASUREMENT ComM_User[7].UserPncByteMaskEndIdxOfUser "" UBYTE ComM_UserPncByteMaskEndIdxOfUserType 0 0 0 255 ECU_ADDRESS 0x0 /end MEASUREMENT
/begin MEASUREMENT ComM_User[7].UserPncByteMaskLengthOfUser "" UBYTE NO_COMPU_METHOD 0 0 0 255 ECU_ADDRESS 0x0 /end MEASUREMENT
/begin MEASUREMENT ComM_User[7].UserPncByteMaskStartIdxOfUser "" UBYTE ComM_UserPncByteMaskStartIdxOfUserType 0 0 0 255 ECU_ADDRESS 0x0 /end MEASUREMENT
/begin MEASUREMENT ComM_User[8].PncUserOfUser "" UBYTE ComM_PncUserOfUserType 0 0 0 1 ECU_ADDRESS 0x0 /end MEASUREMENT
/begin MEASUREMENT ComM_User[8].UserByteMaskEndIdxOfUser "" UBYTE ComM_UserByteMaskEndIdxOfUserType 0 0 0 255 ECU_ADDRESS 0x0 /end MEASUREMENT
/begin MEASUREMENT ComM_User[8].UserByteMaskStartIdxOfUser "" UBYTE ComM_UserByteMaskStartIdxOfUserType 0 0 0 255 ECU_ADDRESS 0x0 /end MEASUREMENT
/begin MEASUREMENT ComM_User[8].UserPncByteMaskEndIdxOfUser "" UBYTE ComM_UserPncByteMaskEndIdxOfUserType 0 0 0 255 ECU_ADDRESS 0x0 /end MEASUREMENT
/begin MEASUREMENT ComM_User[8].UserPncByteMaskLengthOfUser "" UBYTE NO_COMPU_METHOD 0 0 0 255 ECU_ADDRESS 0x0 /end MEASUREMENT
/begin MEASUREMENT ComM_User[8].UserPncByteMaskStartIdxOfUser "" UBYTE ComM_UserPncByteMaskStartIdxOfUserType 0 0 0 255 ECU_ADDRESS 0x0 /end MEASUREMENT
/begin MEASUREMENT ComM_User[9].PncUserOfUser "" UBYTE ComM_PncUserOfUserType 0 0 0 1 ECU_ADDRESS 0x0 /end MEASUREMENT
/begin MEASUREMENT ComM_User[9].UserByteMaskEndIdxOfUser "" UBYTE ComM_UserByteMaskEndIdxOfUserType 0 0 0 255 ECU_ADDRESS 0x0 /end MEASUREMENT
/begin MEASUREMENT ComM_User[9].UserByteMaskStartIdxOfUser "" UBYTE ComM_UserByteMaskStartIdxOfUserType 0 0 0 255 ECU_ADDRESS 0x0 /end MEASUREMENT
/begin MEASUREMENT ComM_User[9].UserPncByteMaskEndIdxOfUser "" UBYTE ComM_UserPncByteMaskEndIdxOfUserType 0 0 0 255 ECU_ADDRESS 0x0 /end MEASUREMENT
/begin MEASUREMENT ComM_User[9].UserPncByteMaskLengthOfUser "" UBYTE NO_COMPU_METHOD 0 0 0 255 ECU_ADDRESS 0x0 /end MEASUREMENT
/begin MEASUREMENT ComM_User[9].UserPncByteMaskStartIdxOfUser "" UBYTE ComM_UserPncByteMaskStartIdxOfUserType 0 0 0 255 ECU_ADDRESS 0x0 /end MEASUREMENT
/begin MEASUREMENT Dbg_BswBackgroundTask.Activation "" UBYTE Dbg_cmBoolean 0 0 0 1 ECU_ADDRESS 0x0 /end MEASUREMENT
/begin MEASUREMENT Dbg_BswBackgroundTask.CollectionFrequency "" UWORD NO_COMPU_METHOD 0 0 0 65535 ECU_ADDRESS 0x0 /end MEASUREMENT
/begin MEASUREMENT Dbg_BswBackgroundTask.dbgosGetStackUsage "" ULONG NO_COMPU_METHOD 0 0 0 4294967295 ECU_ADDRESS 0x0 /end MEASUREMENT
/begin MEASUREMENT Dbg_CounterIsr_SystemTimer.Activation "" UBYTE Dbg_cmBoolean 0 0 0 1 ECU_ADDRESS 0x0 /end MEASUREMENT
/begin MEASUREMENT Dbg_CounterIsr_SystemTimer.CollectionFrequency "" UWORD NO_COMPU_METHOD 0 0 0 65535 ECU_ADDRESS 0x0 /end MEASUREMENT
/begin MEASUREMENT Dbg_CounterIsr_SystemTimer.dbgDbgStaticDIDData "" ULONG NO_COMPU_METHOD 0 0 0 4294967295 ECU_ADDRESS 0x0 /end MEASUREMENT
/begin MEASUREMENT Dbg_Default_Appl_Init_Task.Activation "" UBYTE Dbg_cmBoolean 0 0 0 1 ECU_ADDRESS 0x0 /end MEASUREMENT
/begin MEASUREMENT Dbg_Default_Appl_Init_Task.CollectionFrequency "" UWORD NO_COMPU_METHOD 0 0 0 65535 ECU_ADDRESS 0x0 /end MEASUREMENT
/begin MEASUREMENT Dbg_Default_Appl_Init_Task.dbgosGetStackUsage "" ULONG NO_COMPU_METHOD 0 0 0 4294967295 ECU_ADDRESS 0x0 /end MEASUREMENT
/begin MEASUREMENT Dbg_Default_Appl_Task.Activation "" UBYTE Dbg_cmBoolean 0 0 0 1 ECU_ADDRESS 0x0 /end MEASUREMENT
/begin MEASUREMENT Dbg_Default_Appl_Task.CollectionFrequency "" UWORD NO_COMPU_METHOD 0 0 0 65535 ECU_ADDRESS 0x0 /end MEASUREMENT
/begin MEASUREMENT Dbg_Default_Appl_Task.dbgosGetStackUsage "" ULONG NO_COMPU_METHOD 0 0 0 4294967295 ECU_ADDRESS 0x0 /end MEASUREMENT
/begin MEASUREMENT Dbg_Default_BSW_Async_Task.Activation "" UBYTE Dbg_cmBoolean 0 0 0 1 ECU_ADDRESS 0x0 /end MEASUREMENT
/begin MEASUREMENT Dbg_Default_BSW_Async_Task.CollectionFrequency "" UWORD NO_COMPU_METHOD 0 0 0 65535 ECU_ADDRESS 0x0 /end MEASUREMENT
/begin MEASUREMENT Dbg_Default_BSW_Async_Task.dbgosGetStackUsage "" ULONG NO_COMPU_METHOD 0 0 0 4294967295 ECU_ADDRESS 0x0 /end MEASUREMENT
/begin MEASUREMENT Dbg_Default_BSW_Sync_Task.Activation "" UBYTE Dbg_cmBoolean 0 0 0 1 ECU_ADDRESS 0x0 /end MEASUREMENT
/begin MEASUREMENT Dbg_Default_BSW_Sync_Task.CollectionFrequency "" UWORD NO_COMPU_METHOD 0 0 0 65535 ECU_ADDRESS 0x0 /end MEASUREMENT
/begin MEASUREMENT Dbg_Default_BSW_Sync_Task.dbgosGetStackUsage "" ULONG NO_COMPU_METHOD 0 0 0 4294967295 ECU_ADDRESS 0x0 /end MEASUREMENT
/begin MEASUREMENT Dbg_Default_Init_Task.Activation "" UBYTE Dbg_cmBoolean 0 0 0 1 ECU_ADDRESS 0x0 /end MEASUREMENT
/begin MEASUREMENT Dbg_Default_Init_Task.CollectionFrequency "" UWORD NO_COMPU_METHOD 0 0 0 65535 ECU_ADDRESS 0x0 /end MEASUREMENT
/begin MEASUREMENT Dbg_Default_Init_Task.dbgosGetStackUsage "" ULONG NO_COMPU_METHOD 0 0 0 4294967295 ECU_ADDRESS 0x0 /end MEASUREMENT
/begin MEASUREMENT Dbg_Default_RTE_Mode_switch_Task.Activation "" UBYTE Dbg_cmBoolean 0 0 0 1 ECU_ADDRESS 0x0 /end MEASUREMENT
/begin MEASUREMENT Dbg_Default_RTE_Mode_switch_Task.CollectionFrequency "" UWORD NO_COMPU_METHOD 0 0 0 65535 ECU_ADDRESS 0x0 /end MEASUREMENT
/begin MEASUREMENT Dbg_Default_RTE_Mode_switch_Task.dbgosGetStackUsage "" ULONG NO_COMPU_METHOD 0 0 0 4294967295 ECU_ADDRESS 0x0 /end MEASUREMENT
/begin MEASUREMENT Dbg_IdleTask_OsCore0.Activation "" UBYTE Dbg_cmBoolean 0 0 0 1 ECU_ADDRESS 0x0 /end MEASUREMENT
/begin MEASUREMENT Dbg_IdleTask_OsCore0.CollectionFrequency "" UWORD NO_COMPU_METHOD 0 0 0 65535 ECU_ADDRESS 0x0 /end MEASUREMENT
/begin MEASUREMENT Dbg_IdleTask_OsCore0.dbgosGetStackUsage "" ULONG NO_COMPU_METHOD 0 0 0 4294967295 ECU_ADDRESS 0x0 /end MEASUREMENT
/begin MEASUREMENT Dbg_StartApplication_Appl_Init_Task.Activation "" UBYTE Dbg_cmBoolean 0 0 0 1 ECU_ADDRESS 0x0 /end MEASUREMENT
/begin MEASUREMENT Dbg_StartApplication_Appl_Init_Task.CollectionFrequency "" UWORD NO_COMPU_METHOD 0 0 0 65535 ECU_ADDRESS 0x0 /end MEASUREMENT
/begin MEASUREMENT Dbg_StartApplication_Appl_Init_Task.dbgosGetStackUsage "" ULONG NO_COMPU_METHOD 0 0 0 4294967295 ECU_ADDRESS 0x0 /end MEASUREMENT
/begin MEASUREMENT Dbg_StartApplication_Appl_Task.Activation "" UBYTE Dbg_cmBoolean 0 0 0 1 ECU_ADDRESS 0x0 /end MEASUREMENT
/begin MEASUREMENT Dbg_StartApplication_Appl_Task.CollectionFrequency "" UWORD NO_COMPU_METHOD 0 0 0 65535 ECU_ADDRESS 0x0 /end MEASUREMENT
/begin MEASUREMENT Dbg_StartApplication_Appl_Task.dbgosGetStackUsage "" ULONG NO_COMPU_METHOD 0 0 0 4294967295 ECU_ADDRESS 0x0 /end MEASUREMENT
/begin MEASUREMENT Dbg_StartApplication_NoSwc_Appl_Task.Activation "" UBYTE Dbg_cmBoolean 0 0 0 1 ECU_ADDRESS 0x0 /end MEASUREMENT
/begin MEASUREMENT Dbg_StartApplication_NoSwc_Appl_Task.CollectionFrequency "" UWORD NO_COMPU_METHOD 0 0 0 65535 ECU_ADDRESS 0x0 /end MEASUREMENT
/begin MEASUREMENT Dbg_StartApplication_NoSwc_Appl_Task.dbgosGetStackUsage "" ULONG NO_COMPU_METHOD 0 0 0 4294967295 ECU_ADDRESS 0x0 /end MEASUREMENT
/begin MEASUREMENT Dbg_StartApplication_NoSwc_Init_Task.Activation "" UBYTE Dbg_cmBoolean 0 0 0 1 ECU_ADDRESS 0x0 /end MEASUREMENT
/begin MEASUREMENT Dbg_StartApplication_NoSwc_Init_Task.CollectionFrequency "" UWORD NO_COMPU_METHOD 0 0 0 65535 ECU_ADDRESS 0x0 /end MEASUREMENT
/begin MEASUREMENT Dbg_StartApplication_NoSwc_Init_Task.dbgosGetStackUsage "" ULONG NO_COMPU_METHOD 0 0 0 4294967295 ECU_ADDRESS 0x0 /end MEASUREMENT
/begin MEASUREMENT EcuM_ComMChannelRefs[0].ChannelOfComMChannelRefs "" UBYTE NO_COMPU_METHOD 0 0 0 255 ECU_ADDRESS 0x0 /end MEASUREMENT
/begin MEASUREMENT EcuM_ComMChannelRefs[1].ChannelOfComMChannelRefs "" UBYTE NO_COMPU_METHOD 0 0 0 255 ECU_ADDRESS 0x0 /end MEASUREMENT
/begin MEASUREMENT EcuM_CurrentBootTarget "EcuM current boot target" UBYTE CompuMethod_EcuM_CurrentBootTarget_Values 0 0 0 255 ECU_ADDRESS 0x0 /end MEASUREMENT
/begin MEASUREMENT EcuM_CurrentShutdownMode "EcuM current shutdown mode " UBYTE NO_COMPU_METHOD 0 0 0 255 ECU_ADDRESS 0x0 /end MEASUREMENT
/begin MEASUREMENT EcuM_CurrentShutdownTarget "EcuM current shutdown target" UBYTE CompuMethod_EcuM_ModuleState_Values 0 0 0 255 ECU_ADDRESS 0x0 /end MEASUREMENT
/begin MEASUREMENT EcuM_ExpiredWakeups "EcuM expired wakeups" ULONG NO_COMPU_METHOD 0 0 0 4294967295 ECU_ADDRESS 0x0 /end MEASUREMENT
/begin MEASUREMENT EcuM_LastShutdownMode "EcuM last shutdown mode " UBYTE NO_COMPU_METHOD 0 0 0 255 ECU_ADDRESS 0x0 /end MEASUREMENT
/begin MEASUREMENT EcuM_LastShutdownTarget "EcuM last shutdown target" UBYTE CompuMethod_EcuM_ModuleState_Values 0 0 0 255 ECU_ADDRESS 0x0 /end MEASUREMENT
/begin MEASUREMENT EcuM_ModuleState "EcuM module state" UBYTE CompuMethod_EcuM_ModuleState_Values 0 0 0 255 ECU_ADDRESS 0x0 /end MEASUREMENT
/begin MEASUREMENT EcuM_PartitionData[0].ApplicationOfPartitionData "" UBYTE NO_COMPU_METHOD 0 0 0 255 ECU_ADDRESS 0x0 /end MEASUREMENT
/begin MEASUREMENT EcuM_PartitionData[1].ApplicationOfPartitionData "" UBYTE NO_COMPU_METHOD 0 0 0 255 ECU_ADDRESS 0x0 /end MEASUREMENT
/begin MEASUREMENT EcuM_PendingCheckWakeups "EcuM pending check-wakeups" ULONG NO_COMPU_METHOD 0 0 0 4294967295 ECU_ADDRESS 0x0 /end MEASUREMENT
/begin MEASUREMENT EcuM_PendingWakeups "EcuM pending wakeups" ULONG NO_COMPU_METHOD 0 0 0 4294967295 ECU_ADDRESS 0x0 /end MEASUREMENT
/begin MEASUREMENT EcuM_PostRunRequestCounter "" UBYTE NO_COMPU_METHOD 0 0 0 255 ECU_ADDRESS 0x0 /end MEASUREMENT
/begin MEASUREMENT EcuM_RunRequestCounter "" UBYTE NO_COMPU_METHOD 0 0 0 255 ECU_ADDRESS 0x0 /end MEASUREMENT
/begin MEASUREMENT EcuM_ShutdownCause "EcuM shutdown cause " UBYTE NO_COMPU_METHOD 0 0 0 255 ECU_ADDRESS 0x0 /end MEASUREMENT
/begin MEASUREMENT EcuM_ValidatedWakeups "EcuM validated wakeups" ULONG NO_COMPU_METHOD 0 0 0 4294967295 ECU_ADDRESS 0x0 /end MEASUREMENT
/begin MEASUREMENT EcuM_WakeupSourceList[0].ComMChannelRefsEndIdxOfWakeupSourceList "" UBYTE EcuM_ComMChannelRefsEndIdxOfWakeupSourceListType 0 0 0 255 ECU_ADDRESS 0x0 /end MEASUREMENT
/begin MEASUREMENT EcuM_WakeupSourceList[0].ComMChannelRefsStartIdxOfWakeupSourceList "" UBYTE EcuM_ComMChannelRefsStartIdxOfWakeupSourceListType 0 0 0 255 ECU_ADDRESS 0x0 /end MEASUREMENT
/begin MEASUREMENT EcuM_WakeupSourceList[1].ComMChannelRefsEndIdxOfWakeupSourceList "" UBYTE EcuM_ComMChannelRefsEndIdxOfWakeupSourceListType 0 0 0 255 ECU_ADDRESS 0x0 /end MEASUREMENT
/begin MEASUREMENT EcuM_WakeupSourceList[1].ComMChannelRefsStartIdxOfWakeupSourceList "" UBYTE EcuM_ComMChannelRefsStartIdxOfWakeupSourceListType 0 0 0 255 ECU_ADDRESS 0x0 /end MEASUREMENT
/begin MEASUREMENT EcuM_WakeupSourceList[2].ComMChannelRefsEndIdxOfWakeupSourceList "" UBYTE EcuM_ComMChannelRefsEndIdxOfWakeupSourceListType 0 0 0 255 ECU_ADDRESS 0x0 /end MEASUREMENT
/begin MEASUREMENT EcuM_WakeupSourceList[2].ComMChannelRefsStartIdxOfWakeupSourceList "" UBYTE EcuM_ComMChannelRefsStartIdxOfWakeupSourceListType 0 0 0 255 ECU_ADDRESS 0x0 /end MEASUREMENT
/begin MEASUREMENT EcuM_WakeupSourceList[3].ComMChannelRefsEndIdxOfWakeupSourceList "" UBYTE EcuM_ComMChannelRefsEndIdxOfWakeupSourceListType 0 0 0 255 ECU_ADDRESS 0x0 /end MEASUREMENT
/begin MEASUREMENT EcuM_WakeupSourceList[3].ComMChannelRefsStartIdxOfWakeupSourceList "" UBYTE EcuM_ComMChannelRefsStartIdxOfWakeupSourceListType 0 0 0 255 ECU_ADDRESS 0x0 /end MEASUREMENT
/begin MEASUREMENT EcuM_WakeupSourceList[4].ComMChannelRefsEndIdxOfWakeupSourceList "" UBYTE EcuM_ComMChannelRefsEndIdxOfWakeupSourceListType 0 0 0 255 ECU_ADDRESS 0x0 /end MEASUREMENT
/begin MEASUREMENT EcuM_WakeupSourceList[4].ComMChannelRefsStartIdxOfWakeupSourceList "" UBYTE EcuM_ComMChannelRefsStartIdxOfWakeupSourceListType 0 0 0 255 ECU_ADDRESS 0x0 /end MEASUREMENT
/begin MEASUREMENT EcuM_WakeupSourceList[5].ComMChannelRefsEndIdxOfWakeupSourceList "" UBYTE EcuM_ComMChannelRefsEndIdxOfWakeupSourceListType 0 0 0 255 ECU_ADDRESS 0x0 /end MEASUREMENT
/begin MEASUREMENT EcuM_WakeupSourceList[5].ComMChannelRefsStartIdxOfWakeupSourceList "" UBYTE EcuM_ComMChannelRefsStartIdxOfWakeupSourceListType 0 0 0 255 ECU_ADDRESS 0x0 /end MEASUREMENT
/begin MEASUREMENT EcuM_WakeupSourceList[6].ComMChannelRefsEndIdxOfWakeupSourceList "" UBYTE EcuM_ComMChannelRefsEndIdxOfWakeupSourceListType 0 0 0 255 ECU_ADDRESS 0x0 /end MEASUREMENT
/begin MEASUREMENT EcuM_WakeupSourceList[6].ComMChannelRefsStartIdxOfWakeupSourceList "" UBYTE EcuM_ComMChannelRefsStartIdxOfWakeupSourceListType 0 0 0 255 ECU_ADDRESS 0x0 /end MEASUREMENT
/begin COMPU_METHOD CM_BMC_Max_Ladestrom "" TAB_INTP "%10.1" "Unit_Amper" COMPU_TAB_REF CM_BMC_Max_Ladestrom STATUS_STRING_REF CM_BMC_Max_Ladestrom.StatusText /end COMPU_METHOD
/begin COMPU_METHOD CM_BMC_Max_Ladestrom_02 "" TAB_INTP "%10.1" "Unit_Amper" COMPU_TAB_REF CM_BMC_Max_Ladestrom_02 STATUS_STRING_REF CM_BMC_Max_Ladestrom_02.StatusText /end COMPU_METHOD
/begin COMPU_METHOD CM_BMC_Max_Spannung "" TAB_INTP "%10.1" "Unit_Volt" COMPU_TAB_REF CM_BMC_Max_Spannung STATUS_STRING_REF CM_BMC_Max_Spannung.StatusText /end COMPU_METHOD
/begin COMPU_METHOD CM_BMC_MinDyn_Entladespannung "" TAB_INTP "%10.1" "Unit_None" COMPU_TAB_REF CM_BMC_MinDyn_Entladespannung STATUS_STRING_REF CM_BMC_MinDyn_Entladespannung.StatusText /end COMPU_METHOD
/begin COMPU_METHOD CM_BMC_MinDyn_Ladespannung "" TAB_INTP "%10.1" "Unit_Volt" COMPU_TAB_REF CM_BMC_MinDyn_Ladespannung STATUS_STRING_REF CM_BMC_MinDyn_Ladespannung.StatusText /end COMPU_METHOD
/begin COMPU_METHOD CM_BMC_Min_Spannung "" TAB_INTP "%10.1" "Unit_Volt" COMPU_TAB_REF CM_BMC_Min_Spannung STATUS_STRING_REF CM_BMC_Min_Spannung.StatusText /end COMPU_METHOD
/begin COMPU_METHOD CM_BMC_Modus "" TAB_VERB "%10.1" "" COMPU_TAB_REF CM_BMC_Modus /end COMPU_METHOD
/begin COMPU_METHOD CM_BMC_NutzbareKapazitaet "" TAB_INTP "%10.1" "Unit_AmperHour" COMPU_TAB_REF CM_BMC_NutzbareKapazitaet STATUS_STRING_REF CM_BMC_NutzbareKapazitaet.StatusText /end COMPU_METHOD
/begin COMPU_METHOD CM_BMC_NutzbarerSOC "" TAB_INTP "%10.1" "Unit_PerCent" COMPU_TAB_REF CM_BMC_NutzbarerSOC STATUS_STRING_REF CM_BMC_NutzbarerSOC.StatusText /end COMPU_METHOD
/begin COMPU_METHOD CM_BMC_PerfInd_Entladen "" TAB_INTP "%10.1" "Unit_PerCent" COMPU_TAB_REF CM_BMC_PerfInd_Entladen STATUS_STRING_REF CM_BMC_PerfInd_Entladen.StatusText /end COMPU_METHOD
/begin COMPU_METHOD CM_BMC_PerfInd_Laden "" TAB_INTP "%10.1" "Unit_PerCent" COMPU_TAB_REF CM_BMC_PerfInd_Laden STATUS_STRING_REF CM_BMC_PerfInd_Laden.StatusText /end COMPU_METHOD
/begin COMPU_METHOD CM_BMC_PredLeistung_StuetzungNV "" TAB_INTP "%10.1" "Unit_Watt" COMPU_TAB_REF CM_BMC_PredLeistung_StuetzungNV STATUS_STRING_REF CM_BMC_PredLeistung_StuetzungNV.StatusText /end COMPU_METHOD
/begin COMPU_METHOD CM_BMC_Range_Indikator "" TAB_INTP "%10.1" "Unit_PerCent" COMPU_TAB_REF CM_BMC_Range_Indikator STATUS_STRING_REF CM_BMC_Range_Indikator.StatusText /end COMPU_METHOD
/begin COMPU_METHOD CM_BMC_Rekuperation "" TAB_INTP "%10.1" "Unit_WattSecond" COMPU_TAB_REF CM_BMC_Rekuperation /end COMPU_METHOD
/begin COMPU_METHOD CM_BMC_RuecklaufTemperatur "" TAB_INTP "%10.1" "Unit_DegreCelsi" COMPU_TAB_REF CM_BMC_RuecklaufTemperatur STATUS_STRING_REF CM_BMC_RuecklaufTemperatur.StatusText /end COMPU_METHOD
/begin COMPU_METHOD CM_BMC_Spannung "" TAB_INTP "%10.1" "Unit_Volt" COMPU_TAB_REF CM_BMC_Spannung STATUS_STRING_REF CM_BMC_Spannung.StatusText /end COMPU_METHOD
/begin COMPU_METHOD CM_BMC_Spannung_DC_Ladesaeule "" TAB_INTP "%10.1" "Unit_Volt" COMPU_TAB_REF CM_BMC_Spannung_DC_Ladesaeule STATUS_STRING_REF CM_BMC_Spannung_DC_Ladesaeule.StatusText /end COMPU_METHOD
/begin COMPU_METHOD CM_BMC_Spannung_Messzeit "" TAB_INTP "%10.1" "Unit_None" COMPU_TAB_REF CM_BMC_Spannung_Messzeit STATUS_STRING_REF CM_BMC_Spannung_Messzeit.StatusText /end COMPU_METHOD
/begin COMPU_METHOD CM_BMC_Spannung_ZwischenKreis "" TAB_INTP "%10.1" "Unit_Volt" COMPU_TAB_REF CM_BMC_Spannung_ZwischenKreis STATUS_STRING_REF CM_BMC_Spannung_ZwischenKreis.StatusText /end COMPU_METHOD
/begin COMPU_METHOD CM_BMC_Spannung_ZwischenKreis_2 "" TAB_INTP "%10.1" "Unit_Volt" COMPU_TAB_REF CM_BMC_Spannung_ZwischenKreis_2 STATUS_STRING_REF CM_BMC_Spannung_ZwischenKreis_2.StatusText /end COMPU_METHOD
/begin COMPU_METHOD CM_BMC_Sperrung_Ueberspannung "" TAB_VERB "%10.1" "" COMPU_TAB_REF CM_BMC_Sperrung_Ueberspannung /end COMPU_METHOD
/begin COMPU_METHOD CM_BMC_Sperrung_Uebertemperatur "" TAB_VERB "%10.1" "" COMPU_TAB_REF CM_BMC_Sperrung_Uebertemperatur /end COMPU_METHOD
/begin COMPU_METHOD CM_BMC_Sperrung_Unterspannung "" TAB_VERB "%10.1" "" COMPU_TAB_REF CM_BMC_Sperrung_Unterspannung /end COMPU_METHOD
/begin COMPU_METHOD CM_BMC_Status_DCLS "" TAB_VERB "%10.1" "" COMPU_TAB_REF CM_BMC_Status_DCLS /end COMPU_METHOD
/begin COMPU_METHOD CM_BMC_Status_HV_Spannungssensorik "" TAB_VERB "%10.1" "" COMPU_TAB_REF CM_BMC_Status_HV_Spannungssensorik /end COMPU_METHOD
/begin COMPU_METHOD CM_BMC_Status_Spgfreiheit "" TAB_VERB "%10.1" "" COMPU_TAB_REF CM_BMC_Status_Spgfreiheit /end COMPU_METHOD
/begin COMPU_METHOD CM_BMC_Status_Trennelemente "" TAB_VERB "%10.1" "" COMPU_TAB_REF CM_BMC_Status_Trennelemente /end COMPU_METHOD
/begin COMPU_METHOD CM_BMC_Strom "" TAB_INTP "%10.1" "Unit_Amper" COMPU_TAB_REF CM_BMC_Strom STATUS_STRING_REF CM_BMC_Strom.StatusText /end COMPU_METHOD
/begin COMPU_METHOD CM_BMC_Strom_02 "" TAB_INTP "%10.1" "Unit_Amper" COMPU_TAB_REF CM_BMC_Strom_02 STATUS_STRING_REF CM_BMC_Strom_02.StatusText /end COMPU_METHOD
/begin COMPU_METHOD CM_BMC_Strom_Messzeit "" TAB_INTP "%10.1" "Unit_None" COMPU_TAB_REF CM_BMC_Strom_Messzeit STATUS_STRING_REF CM_BMC_Strom_Messzeit.StatusText /end COMPU_METHOD
/begin COMPU_METHOD CM_BMC_TechnischerSOC "" TAB_INTP "%10.1" "Unit_PerCent" COMPU_TAB_REF CM_BMC_TechnischerSOC STATUS_STRING_REF CM_BMC_TechnischerSOC.StatusText /end COMPU_METHOD
/begin COMPU_METHOD CM_BMC_Temperatur "" TAB_INTP "%10.1" "Unit_DegreCelsi" COMPU_TAB_REF CM_BMC_Temperatur STATUS_STRING_REF CM_BMC_Temperatur.StatusText /end COMPU_METHOD
/begin COMPU_METHOD CM_BMC_Temperatur_hoechste "" TAB_INTP "%10.1" "Unit_DegreCelsi" COMPU_TAB_REF CM_BMC_Temperatur_hoechste STATUS_STRING_REF CM_BMC_Temperatur_hoechste.StatusText /end COMPU_METHOD
/begin COMPU_METHOD CM_BMC_Temperatur_niedrigste "" TAB_INTP "%10.1" "Unit_DegreCelsi" COMPU_TAB_REF CM_BMC_Temperatur_niedrigste STATUS_STRING_REF CM_BMC_Temperatur_niedrigste.StatusText /end COMPU_METHOD
/begin COMPU_METHOD CM_BMC_ThermAuslastung "" TAB_INTP "%10.1" "Unit_PerCent" COMPU_TAB_REF CM_BMC_ThermAuslastung STATUS_STRING_REF CM_BMC_ThermAuslastung.StatusText /end COMPU_METHOD
/begin COMPU_METHOD CM_BMC_ThermSpreizung "" TAB_INTP "%10.1" "Unit_PerCent" COMPU_TAB_REF CM_BMC_ThermSpreizung STATUS_STRING_REF CM_BMC_ThermSpreizung.StatusText /end COMPU_METHOD
/begin COMPU_METHOD CM_BMC_UBE_Indik_last_update_km "" TAB_INTP "%10.1" "Unit_KiloMeter" COMPU_TAB_REF CM_BMC_UBE_Indik_last_update_km STATUS_STRING_REF CM_BMC_UBE_Indik_last_update_km.StatusText /end COMPU_METHOD
/begin COMPU_METHOD CM_BMC_UBE_Indikator "" TAB_INTP "%10.1" "Unit_PerCent" COMPU_TAB_REF CM_BMC_UBE_Indikator STATUS_STRING_REF CM_BMC_UBE_Indikator.StatusText /end COMPU_METHOD
/begin COMPU_METHOD CM_BMC_UI1_Spannung1_Schalt_Anf "" TAB_VERB "%10.1" "" COMPU_TAB_REF CM_BMC_UI1_Spannung1_Schalt_Anf /end COMPU_METHOD
/begin COMPU_METHOD CM_BMC_UI1_Spannung2_Schalt_Anf "" TAB_VERB "%10.1" "" COMPU_TAB_REF CM_BMC_UI1_Spannung2_Schalt_Anf /end COMPU_METHOD
/begin COMPU_METHOD CM_BMC_UI2_Spannung1_Schalt_Anf "" TAB_VERB "%10.1" "" COMPU_TAB_REF CM_BMC_UI2_Spannung1_Schalt_Anf /end COMPU_METHOD
/begin COMPU_METHOD CM_BMC_UI2_Spannung2_Schalt_Anf "" TAB_VERB "%10.1" "" COMPU_TAB_REF CM_BMC_UI2_Spannung2_Schalt_Anf /end COMPU_METHOD
/begin COMPU_METHOD CM_BMC_Ueberspannungszaehler_CMC01 "" TAB_INTP "%10.1" "Unit_None" COMPU_TAB_REF CM_BMC_Ueberspannungszaehler_CMC01 STATUS_STRING_REF CM_BMC_Ueberspannungszaehler_CMC01.StatusText /end COMPU_METHOD
/begin COMPU_METHOD CM_BMC_Ueberspannungszaehler_CMC02 "" TAB_INTP "%10.1" "Unit_None" COMPU_TAB_REF CM_BMC_Ueberspannungszaehler_CMC02 STATUS_STRING_REF CM_BMC_Ueberspannungszaehler_CMC02.StatusText /end COMPU_METHOD
/begin COMPU_METHOD CM_BMC_Ueberspannungszaehler_CMC03 "" TAB_INTP "%10.1" "Unit_None" COMPU_TAB_REF CM_BMC_Ueberspannungszaehler_CMC03 STATUS_STRING_REF CM_BMC_Ueberspannungszaehler_CMC03.StatusText /end COMPU_METHOD
/begin COMPU_METHOD CM_BMC_Ueberspannungszaehler_CMC04 "" TAB_INTP "%10.1" "Unit_None" COMPU_TAB_REF CM_BMC_Ueberspannungszaehler_CMC04 STATUS_STRING_REF CM_BMC_Ueberspannungszaehler_CMC04.StatusText /end COMPU_METHOD
/begin COMPU_METHOD CM_BMC_Uebertemperaturzaehler_CMC01 "" TAB_INTP "%10.1" "Unit_None" COMPU_TAB_REF CM_BMC_Uebertemperaturzaehler_CMC01 STATUS_STRING_REF CM_BMC_Uebertemperaturzaehler_CMC01.StatusText /end COMPU_METHOD
/begin COMPU_METHOD CM_BMC_Uebertemperaturzaehler_CMC02 "" TAB_INTP "%10.1" "Unit_None" COMPU_TAB_REF CM_BMC_Uebertemperaturzaehler_CMC02 STATUS_STRING_REF CM_BMC_Uebertemperaturzaehler_CMC02.StatusText /end COMPU_METHOD
/begin COMPU_METHOD CM_BMC_Uebertemperaturzaehler_CMC03 "" TAB_INTP "%10.1" "Unit_Ohm" COMPU_TAB_REF CM_BMC_Uebertemperaturzaehler_CMC03 STATUS_STRING_REF CM_BMC_Uebertemperaturzaehler_CMC03.StatusText /end COMPU_METHOD
/begin COMPU_METHOD CM_BMC_Uebertemperaturzaehler_CMC04 "" TAB_INTP "%10.1" "Unit_None" COMPU_TAB_REF CM_BMC_Uebertemperaturzaehler_CMC04 STATUS_STRING_REF CM_BMC_Uebertemperaturzaehler_CMC04.StatusText /end COMPU_METHOD
/begin COMPU_METHOD CM_BMC_Unterboden_Warnung "" TAB_VERB "%10.1" "" COMPU_TAB_REF CM_BMC_Unterboden_Warnung /end COMPU_METHOD
/begin COMPU_METHOD CM_BMC_Unterspannungszaehler_CMC01 "" TAB_INTP "%10.1" "Unit_None" COMPU_TAB_REF CM_BMC_Unterspannungszaehler_CMC01 STATUS_STRING_REF CM_BMC_Unterspannungszaehler_CMC01.StatusText /end COMPU_METHOD
/begin COMPU_METHOD CM_BMC_Unterspannungszaehler_CMC02 "" TAB_INTP "%10.1" "Unit_None" COMPU_TAB_REF CM_BMC_Unterspannungszaehler_CMC02 STATUS_STRING_REF CM_BMC_Unterspannungszaehler_CMC02.StatusText /end COMPU_METHOD
/begin COMPU_METHOD CM_BMC_Unterspannungszaehler_CMC03 "" TAB_INTP "%10.1" "Unit_None" COMPU_TAB_REF CM_BMC_Unterspannungszaehler_CMC03 STATUS_STRING_REF CM_BMC_Unterspannungszaehler_CMC03.StatusText /end COMPU_METHOD
/begin COMPU_METHOD CM_BMC_Unterspannungszaehler_CMC04 "" TAB_INTP "%10.1" "Unit_None" COMPU_TAB_REF CM_BMC_Unterspannungszaehler_CMC04 STATUS_STRING_REF CM_BMC_Unterspannungszaehler_CMC04.StatusText /end COMPU_METHOD
/begin COMPU_METHOD CM_BMC_Verbauinfo_ACSchuetz "" TAB_VERB "%10.1" "" COMPU_TAB_REF CM_BMC_Verbauinfo_ACSchuetz /end COMPU_METHOD
/begin COMPU_METHOD CM_BMC_Verbauinfo_Bank "" TAB_VERB "%10.1" "" COMPU_TAB_REF CM_BMC_Verbauinfo_Bank /end COMPU_METHOD
/begin COMPU_METHOD CM_BMC_Verbrauch "" TAB_INTP "%10.1" "Unit_WattSecond" COMPU_TAB_REF CM_BMC_Verbrauch /end COMPU_METHOD
/begin COMPU_METHOD CM_BMC_VerlustEnergie "" TAB_INTP "%10.1" "Unit_WattHour" COMPU_TAB_REF CM_BMC_VerlustEnergie STATUS_STRING_REF CM_BMC_VerlustEnergie.StatusText /end COMPU_METHOD
/begin COMPU_METHOD CM_BMC_Vorlade_Zielspannung "" TAB_INTP "%10.1" "Unit_Volt" COMPU_TAB_REF CM_BMC_Vorlade_Zielspannung STATUS_STRING_REF CM_BMC_Vorlade_Zielspannung.StatusText /end COMPU_METHOD
/begin COMPU_METHOD CM_BMC_VorlaufTemperatur "" TAB_INTP "%10.1" "Unit_DegreCelsi" COMPU_TAB_REF CM_BMC_VorlaufTemperatur STATUS_STRING_REF CM_BMC_VorlaufTemperatur.StatusText /end COMPU_METHOD
/begin COMPU_METHOD CM_BMC_ZellTemp_virtuell_max "" TAB_INTP "%10.1" "Unit_DegreCelsi" COMPU_TAB_REF CM_BMC_ZellTemp_virtuell_max STATUS_STRING_REF CM_BMC_ZellTemp_virtuell_max.StatusText /end COMPU_METHOD
/begin COMPU_METHOD CM_BMC_ZellTemp_virtuell_min "" TAB_INTP "%10.1" "Unit_DegreCelsi" COMPU_TAB_REF CM_BMC_ZellTemp_virtuell_min STATUS_STRING_REF CM_BMC_ZellTemp_virtuell_min.StatusText /end COMPU_METHOD
/begin COMPU_METHOD CM_CHA_ReqPrgBms "" TAB_VERB "%10.1" "" COMPU_TAB_REF CM_CHA_ReqPrgBms /end COMPU_METHOD
/begin COMPU_METHOD CM_DCDC_NV_CALID_Index_01 "" TAB_INTP "%10.1" "" COMPU_TAB_REF CM_DCDC_NV_CALID_Index_01 /end COMPU_METHOD
/begin COMPU_METHOD CM_DCDC_NV_CALID_Index_02 "" TAB_INTP "%10.1" "" COMPU_TAB_REF CM_DCDC_NV_CALID_Index_02 /end COMPU_METHOD
/begin COMPU_METHOD CM_DCDC_NV_CALID_Index_03 "" TAB_INTP "%10.1" "" COMPU_TAB_REF CM_DCDC_NV_CALID_Index_03 /end COMPU_METHOD
/begin COMPU_METHOD CM_DCDC_NV_CALID_Index_04 "" TAB_INTP "%10.1" "" COMPU_TAB_REF CM_DCDC_NV_CALID_Index_04 /end COMPU_METHOD
/begin COMPU_METHOD CM_DCDC_NV_CALID_Index_05 "" TAB_INTP "%10.1" "" COMPU_TAB_REF CM_DCDC_NV_CALID_Index_05 /end COMPU_METHOD
/begin COMPU_METHOD CM_DCDC_NV_CALID_Index_06 "" TAB_INTP "%10.1" "" COMPU_TAB_REF CM_DCDC_NV_CALID_Index_06 /end COMPU_METHOD
/begin COMPU_METHOD CM_DCDC_NV_CALID_Index_07 "" TAB_INTP "%10.1" "" COMPU_TAB_REF CM_DCDC_NV_CALID_Index_07 /end COMPU_METHOD
/begin COMPU_METHOD CM_DCDC_NV_CALID_Index_08 "" TAB_INTP "%10.1" "" COMPU_TAB_REF CM_DCDC_NV_CALID_Index_08 /end COMPU_METHOD
/begin COMPU_METHOD CM_DCDC_NV_CALID_Index_09 "" TAB_INTP "%10.1" "" COMPU_TAB_REF CM_DCDC_NV_CALID_Index_09 /end COMPU_METHOD
/begin COMPU_METHOD CM_DCDC_NV_CALID_Index_10 "" TAB_INTP "%10.1" "" COMPU_TAB_REF CM_DCDC_NV_CALID_Index_10 /end COMPU_METHOD
/begin COMPU_METHOD CM_DCDC_NV_CALID_Index_11 "" TAB_INTP "%10.1" "" COMPU_TAB_REF CM_DCDC_NV_CALID_Index_11 /end COMPU_METHOD
/begin COMPU_METHOD CM_DCDC_NV_CALID_Index_12 "" TAB_INTP "%10.1" "" COMPU_TAB_REF CM_DCDC_NV_CALID_Index_12 /end COMPU_METHOD
/begin COMPU_METHOD CM_DCDC_NV_CALID_Index_13 "" TAB_INTP "%10.1" "" COMPU_TAB_REF CM_DCDC_NV_CALID_Index_13 /end COMPU_METHOD
/begin COMPU_METHOD CM_DCDC_NV_CALID_Index_14 "" TAB_INTP "%10.1" "" COMPU_TAB_REF CM_DCDC_NV_CALID_Index_14 /end COMPU_METHOD
/begin COMPU_METHOD CM_DCDC_NV_CALID_Index_15 "" TAB_INTP "%10.1" "" COMPU_TAB_REF CM_DCDC_NV_CALID_Index_15 /end COMPU_METHOD
/begin COMPU_METHOD CM_DCDC_NV_CALID_Index_16 "" TAB_INTP "%10.1" "" COMPU_TAB_REF CM_DCDC_NV_CALID_Index_16 /end COMPU_METHOD
/begin COMPU_METHOD CM_DCDC_NV_CVN_Byte_1 "" TAB_INTP "%10.1" "" COMPU_TAB_REF CM_DCDC_NV_CVN_Byte_1 /end COMPU_METHOD
/begin COMPU_METHOD CM_DCDC_NV_CVN_Byte_2 "" TAB_INTP "%10.1" "" COMPU_TAB_REF CM_DCDC_NV_CVN_Byte_2 /end COMPU_METHOD
/begin COMPU_METHOD CM_DCDC_NV_CVN_Byte_3 "" TAB_INTP "%10.1" "" COMPU_TAB_REF CM_DCDC_NV_CVN_Byte_3 /end COMPU_METHOD
/begin COMPU_METHOD CM_DCDC_NV_CVN_Byte_4 "" TAB_INTP "%10.1" "" COMPU_TAB_REF CM_DCDC_NV_CVN_Byte_4 /end COMPU_METHOD
/begin COMPU_METHOD CM_DCDC_NV_CVN_VLD "" TAB_VERB "%10.1" "" COMPU_TAB_REF CM_DCDC_NV_CVN_VLD /end COMPU_METHOD
/begin COMPU_METHOD CM_DCDC_NV_Komponentenfehler_01 "" TAB_VERB "%10.1" "" COMPU_TAB_REF CM_DCDC_NV_Komponentenfehler_01 /end COMPU_METHOD
/begin COMPU_METHOD CM_DCDC_NV_Komponentenfehler_02 "" TAB_VERB "%10.1" "" COMPU_TAB_REF CM_DCDC_NV_Komponentenfehler_02 /end COMPU_METHOD
/begin COMPU_METHOD CM_DCDC_NV_Komponentenfehler_03 "" TAB_VERB "%10.1" "" COMPU_TAB_REF CM_DCDC_NV_Komponentenfehler_03 /end COMPU_METHOD
/begin COMPU_METHOD CM_DCDC_NV_Komponentenfehler_04 "" TAB_VERB "%10.1" "" COMPU_TAB_REF CM_DCDC_NV_Komponentenfehler_04 /end COMPU_METHOD
/begin COMPU_METHOD CM_DCDC_NV_Komponentenfehler_05 "" TAB_VERB "%10.1" "" COMPU_TAB_REF CM_DCDC_NV_Komponentenfehler_05 /end COMPU_METHOD
/begin COMPU_METHOD CM_DCDC_NV_Komponentenfehler_06 "" TAB_VERB "%10.1" "" COMPU_TAB_REF CM_DCDC_NV_Komponentenfehler_06 /end COMPU_METHOD
/begin COMPU_METHOD CM_DCDC_NV_Komponentenfehler_07 "" TAB_VERB "%10.1" "" COMPU_TAB_REF CM_DCDC_NV_Komponentenfehler_07 /end COMPU_METHOD
/begin COMPU_METHOD CM_DCDC_NV_Komponentenfehler_08 "" TAB_VERB "%10.1" "" COMPU_TAB_REF CM_DCDC_NV_Komponentenfehler_08 /end COMPU_METHOD
/begin COMPU_METHOD CM_DCDC_NV_Komponentenfehler_09 "" TAB_VERB "%10.1" "" COMPU_TAB_REF CM_DCDC_NV_Komponentenfehler_09 /end COMPU_METHOD
/begin COMPU_METHOD CM_DCDC_NV_Komponentenfehler_10 "" TAB_VERB "%10.1" "" COMPU_TAB_REF CM_DCDC_NV_Komponentenfehler_10 /end COMPU_METHOD
/begin COMPU_METHOD CM_DCDC_NV_Komponentenfehler_11 "" TAB_VERB "%10.1" "" COMPU_TAB_REF CM_DCDC_NV_Komponentenfehler_11 /end COMPU_METHOD
/begin COMPU_METHOD CM_DCDC_NV_Komponentenfehler_12 "" TAB_VERB "%10.1" "" COMPU_TAB_REF CM_DCDC_NV_Komponentenfehler_12 /end COMPU_METHOD
/begin COMPU_METHOD CM_DCDC_NV_Komponentenfehler_13 "" TAB_VERB "%10.1" "" COMPU_TAB_REF CM_DCDC_NV_Komponentenfehler_13 /end COMPU_METHOD
/begin COMPU_METHOD CM_DCDC_NV_Komponentenfehler_14 "" TAB_VERB "%10.1" "" COMPU_TAB_REF CM_DCDC_NV_Komponentenfehler_14 /end COMPU_METHOD
/begin COMPU_METHOD CM_DCDC_NV_Komponentenfehler_15 "" TAB_VERB "%10.1" "" COMPU_TAB_REF CM_DCDC_NV_Komponentenfehler_15 /end COMPU_METHOD
/begin COMPU_METHOD CM_DCDC_NV_Komponentenfehler_16 "" TAB_VERB "%10.1" "" COMPU_TAB_REF CM_DCDC_NV_Komponentenfehler_16 /end COMPU_METHOD
/begin COMPU_METHOD CM_DCDC_NV_Komponentenfehler_17 "" TAB_VERB "%10.1" "" COMPU_TAB_REF CM_DCDC_NV_Komponentenfehler_17 /end COMPU_METHOD
/begin COMPU_METHOD CM_DCDC_NV_Komponentenfehler_18 "" TAB_VERB "%10.1" "" COMPU_TAB_REF CM_DCDC_NV_Komponentenfehler_18 /end COMPU_METHOD
/begin COMPU_METHOD CM_DCDC_NV_Komponentenfehler_19 "" TAB_VERB "%10.1" "" COMPU_TAB_REF CM_DCDC_NV_Komponentenfehler_19 /end COMPU_METHOD
/begin COMPU_METHOD CM_DCDC_NV_Komponentenfehler_20 "" TAB_VERB "%10.1" "" COMPU_TAB_REF CM_DCDC_NV_Komponentenfehler_20 /end COMPU_METHOD
/begin COMPU_METHOD CM_DCDC_NV_Komponentenfehler_21 "" TAB_VERB "%10.1" "" COMPU_TAB_REF CM_DCDC_NV_Komponentenfehler_21 /end COMPU_METHOD
/begin COMPU_METHOD CM_DCDC_NV_Komponentenfehler_22 "" TAB_VERB "%10.1" "" COMPU_TAB_REF CM_DCDC_NV_Komponentenfehler_22 /end COMPU_METHOD
/begin COMPU_METHOD CM_DCDC_NV_Komponentenfehler_23 "" TAB_VERB "%10.1" "" COMPU_TAB_REF CM_DCDC_NV_Komponentenfehler_23 /end COMPU_METHOD
/begin COMPU_METHOD CM_DCDC_NV_Komponentenfehler_24 "" TAB_VERB "%10.1" "" COMPU_TAB_REF CM_DCDC_NV_Komponentenfehler_24 /end COMPU_METHOD
/begin COMPU_METHOD CM_DCDC_NV_Komponentenfehler_25 "" TAB_VERB "%10.1" "" COMPU_TAB_REF CM_DCDC_NV_Komponentenfehler_25 /end COMPU_METHOD
/begin COMPU_METHOD CM_DCDC_NV_Komponentenfehler_26 "" TAB_VERB "%10.1" "" COMPU_TAB_REF CM_DCDC_NV_Komponentenfehler_26 /end COMPU_METHOD
/begin COMPU_METHOD CM_DCDC_NV_Komponentenfehler_27 "" TAB_VERB "%10.1" "" COMPU_TAB_REF CM_DCDC_NV_Komponentenfehler_27 /end COMPU_METHOD
/begin COMPU_METHOD CM_DCDC_NV_Komponentenfehler_28 "" TAB_VERB "%10.1" "" COMPU_TAB_REF CM_DCDC_NV_Komponentenfehler_28 /end COMPU_METHOD
/begin COMPU_METHOD CM_DCDC_NV_Komponentenfehler_29 "" TAB_VERB "%10.1" "" COMPU_TAB_REF CM_DCDC_NV_Komponentenfehler_29 /end COMPU_METHOD
/begin COMPU_METHOD CM_DCDC_NV_Komponentenfehler_30 "" TAB_VERB "%10.1" "" COMPU_TAB_REF CM_DCDC_NV_Komponentenfehler_30 /end COMPU_METHOD
/begin COMPU_METHOD CM_DCDC_NV_Komponentenfehler_31 "" TAB_VERB "%10.1" "" COMPU_TAB_REF CM_DCDC_NV_Komponentenfehler_31 /end COMPU_METHOD
/begin COMPU_METHOD CM_DCDC_NV_Komponentenfehler_32 "" TAB_VERB "%10.1" "" COMPU_TAB_REF CM_DCDC_NV_Komponentenfehler_32 /end COMPU_METHOD
/begin COMPU_METHOD CM_DCDC_NV_Komponentenfehler_33 "" TAB_VERB "%10.1" "" COMPU_TAB_REF CM_DCDC_NV_Komponentenfehler_33 /end COMPU_METHOD
/begin COMPU_METHOD CM_DCDC_NV_Komponentenfehler_34 "" TAB_VERB "%10.1" "" COMPU_TAB_REF CM_DCDC_NV_Komponentenfehler_34 /end COMPU_METHOD
/begin COMPU_METHOD CM_DCDC_NV_Komponentenfehler_35 "" TAB_VERB "%10.1" "" COMPU_TAB_REF CM_DCDC_NV_Komponentenfehler_35 /end COMPU_METHOD
/begin COMPU_METHOD CM_DCDC_NV_Komponentenfehler_36 "" TAB_VERB "%10.1" "" COMPU_TAB_REF CM_DCDC_NV_Komponentenfehler_36 /end COMPU_METHOD
/begin COMPU_METHOD CM_DCDC_NV_Komponentenfehler_37 "" TAB_VERB "%10.1" "" COMPU_TAB_REF CM_DCDC_NV_Komponentenfehler_37 /end COMPU_METHOD
/begin COMPU_METHOD CM_DCDC_NV_Komponentenfehler_38 "" TAB_VERB "%10.1" "" COMPU_TAB_REF CM_DCDC_NV_Komponentenfehler_38 /end COMPU_METHOD
/begin COMPU_METHOD CM_DCDC_NV_Komponentenfehler_39 "" TAB_VERB "%10.1" "" COMPU_TAB_REF CM_DCDC_NV_Komponentenfehler_39 /end COMPU_METHOD
/begin COMPU_METHOD CM_DCDC_NV_Komponentenfehler_3_1 "" TAB_VERB "%10.1" "" COMPU_TAB_REF CM_DCDC_NV_Komponentenfehler_3_1 /end COMPU_METHOD
/begin COMPU_METHOD CM_DCDC_NV_Komponentenfehler_3_10 "" TAB_VERB "%10.1" "" COMPU_TAB_REF CM_DCDC_NV_Komponentenfehler_3_10 /end COMPU_METHOD
/begin COMPU_METHOD CM_DCDC_NV_Komponentenfehler_3_11 "" TAB_VERB "%10.1" "" COMPU_TAB_REF CM_DCDC_NV_Komponentenfehler_3_11 /end COMPU_METHOD
/begin COMPU_METHOD CM_DCDC_NV_Komponentenfehler_3_12 "" TAB_VERB "%10.1" "" COMPU_TAB_REF CM_DCDC_NV_Komponentenfehler_3_12 /end COMPU_METHOD
/begin COMPU_METHOD CM_DCDC_NV_Komponentenfehler_3_13 "" TAB_VERB "%10.1" "" COMPU_TAB_REF CM_DCDC_NV_Komponentenfehler_3_13 /end COMPU_METHOD
/begin COMPU_METHOD CM_DCDC_NV_Komponentenfehler_3_14 "" TAB_VERB "%10.1" "" COMPU_TAB_REF CM_DCDC_NV_Komponentenfehler_3_14 /end COMPU_METHOD
/begin COMPU_METHOD CM_DCDC_NV_Komponentenfehler_3_15 "" TAB_VERB "%10.1" "" COMPU_TAB_REF CM_DCDC_NV_Komponentenfehler_3_15 /end COMPU_METHOD
/begin COMPU_METHOD CM_DCDC_NV_Komponentenfehler_3_16 "" TAB_VERB "%10.1" "" COMPU_TAB_REF CM_DCDC_NV_Komponentenfehler_3_16 /end COMPU_METHOD
/begin COMPU_METHOD CM_DCDC_NV_Komponentenfehler_3_2 "" TAB_VERB "%10.1" "" COMPU_TAB_REF CM_DCDC_NV_Komponentenfehler_3_2 /end COMPU_METHOD
/begin COMPU_METHOD CM_DCDC_NV_Komponentenfehler_3_3 "" TAB_VERB "%10.1" "" COMPU_TAB_REF CM_DCDC_NV_Komponentenfehler_3_3 /end COMPU_METHOD
/begin COMPU_METHOD CM_DCDC_NV_Komponentenfehler_3_4 "" TAB_VERB "%10.1" "" COMPU_TAB_REF CM_DCDC_NV_Komponentenfehler_3_4 /end COMPU_METHOD
/begin COMPU_METHOD CM_DCDC_NV_Komponentenfehler_3_5 "" TAB_VERB "%10.1" "" COMPU_TAB_REF CM_DCDC_NV_Komponentenfehler_3_5 /end COMPU_METHOD
/begin COMPU_METHOD CM_DCDC_NV_Komponentenfehler_3_6 "" TAB_VERB "%10.1" "" COMPU_TAB_REF CM_DCDC_NV_Komponentenfehler_3_6 /end COMPU_METHOD
/begin COMPU_METHOD CM_DCDC_NV_Komponentenfehler_3_7 "" TAB_VERB "%10.1" "" COMPU_TAB_REF CM_DCDC_NV_Komponentenfehler_3_7 /end COMPU_METHOD
/begin COMPU_METHOD CM_DCDC_NV_Komponentenfehler_3_8 "" TAB_VERB "%10.1" "" COMPU_TAB_REF CM_DCDC_NV_Komponentenfehler_3_8 /end COMPU_METHOD
/begin COMPU_METHOD CM_DCDC_NV_Komponentenfehler_3_9 "" TAB_VERB "%10.1" "" COMPU_TAB_REF CM_DCDC_NV_Komponentenfehler_3_9 /end COMPU_METHOD
/begin COMPU_METHOD CM_DCDC_NV_Komponentenfehler_40 "" TAB_VERB "%10.1" "" COMPU_TAB_REF CM_DCDC_NV_Komponentenfehler_40 /end COMPU_METHOD
/begin COMPU_METHOD CM_DCDC_NV_Komponentenfehler_41 "" TAB_VERB "%10.1" "" COMPU_TAB_REF CM_DCDC_NV_Komponentenfehler_41 /end COMPU_METHOD
/begin COMPU_METHOD CM_DCDC_NV_Komponentenfehler_42 "" TAB_VERB "%10.1" "" COMPU_TAB_REF CM_DCDC_NV_Komponentenfehler_42 /end COMPU_METHOD
/begin COMPU_METHOD CM_DCDC_NV_Komponentenfehler_43 "" TAB_VERB "%10.1" "" COMPU_TAB_REF CM_DCDC_NV_Komponentenfehler_43 /end COMPU_METHOD
/begin COMPU_METHOD CM_DCDC_NV_Komponentenfehler_44 "" TAB_VERB "%10.1" "" COMPU_TAB_REF CM_DCDC_NV_Komponentenfehler_44 /end COMPU_METHOD
/begin COMPU_METHOD CM_DCDC_NV_Komponentenfehler_45 "" TAB_VERB "%10.1" "" COMPU_TAB_REF CM_DCDC_NV_Komponentenfehler_45 /end COMPU_METHOD
/begin COMPU_METHOD CM_DCDC_NV_Komponentenfehler_46 "" TAB_VERB "%10.1" "" COMPU_TAB_REF CM_DCDC_NV_Komponentenfehler_46 /end COMPU_METHOD
/begin COMPU_METHOD CM_DCDC_NV_Komponentenfehler_47 "" TAB_VERB "%10.1" "" COMPU_TAB_REF CM_DCDC_NV_Komponentenfehler_47 /end COMPU_METHOD
/begin COMPU_METHOD CM_DCDC_NV_Komponentenfehler_48 "" TAB_VERB "%10.1" "" COMPU_TAB_REF CM_DCDC_NV_Komponentenfehler_48 /end COMPU_METHOD
/begin COMPU_METHOD CM_DCDC_NV_Komponentenfehler_49 "" TAB_VERB "%10.1" "" COMPU_TAB_REF CM_DCDC_NV_Komponentenfehler_49 /end COMPU_METHOD
/begin COMPU_METHOD CM_DCDC_NV_Komponentenfehler_50 "" TAB_VERB "%10.1" "" COMPU_TAB_REF CM_DCDC_NV_Komponentenfehler_50 /end COMPU_METHOD
/begin COMPU_METHOD CM_DCDC_NV_Komponentenfehler_51 "" TAB_VERB "%10.1" "" COMPU_TAB_REF CM_DCDC_NV_Komponentenfehler_51 /end COMPU_METHOD
/begin COMPU_METHOD CM_DCDC_NV_Komponentenfehler_52 "" TAB_VERB "%10.1" "" COMPU_TAB_REF CM_DCDC_NV_Komponentenfehler_52 /end COMPU_METHOD
/begin COMPU_METHOD CM_DCDC_NV_Komponentenfehler_53 "" TAB_VERB "%10.1" "" COMPU_TAB_REF CM_DCDC_NV_Komponentenfehler_53 /end COMPU_METHOD
/begin COMPU_METHOD CM_DCDC_NV_Komponentenfehler_54 "" TAB_VERB "%10.1" "" COMPU_TAB_REF CM_DCDC_NV_Komponentenfehler_54 /end COMPU_METHOD
/begin COMPU_METHOD CM_DCDC_NV_Komponentenfehler_55 "" TAB_VERB "%10.1" "" COMPU_TAB_REF CM_DCDC_NV_Komponentenfehler_55 /end COMPU_METHOD
/begin COMPU_METHOD CM_DCDC_NV_Komponentenfehler_56 "" TAB_VERB "%10.1" "" COMPU_TAB_REF CM_DCDC_NV_Komponentenfehler_56 /end COMPU_METHOD
/begin COMPU_METHOD CM_DCDC_NV_Komponentenfehler_57 "" TAB_VERB "%10.1" "" COMPU_TAB_REF CM_DCDC_NV_Komponentenfehler_57 /end COMPU_METHOD
/begin COMPU_METHOD CM_DCDC_NV_Komponentenfehler_58 "" TAB_VERB "%10.1" "" COMPU_TAB_REF CM_DCDC_NV_Komponentenfehler_58 /end COMPU_METHOD
/begin COMPU_METHOD CM_DCDC_NV_Komponentenfehler_59 "" TAB_VERB "%10.1" "" COMPU_TAB_REF CM_DCDC_NV_Komponentenfehler_59 /end COMPU_METHOD
/begin COMPU_METHOD ComM_PncUserOfUserType "" TAB_VERB "%10.1" "" COMPU_TAB_REF ComM_PncUserOfUserType /end COMPU_METHOD
/begin COMPU_METHOD ComM_UserByteMaskEndIdxOfUserType "" TAB_VERB "%10.1" "" COMPU_TAB_REF ComM_UserByteMaskEndIdxOfUserType /end COMPU_METHOD
/begin COMPU_METHOD ComM_UserByteMaskStartIdxOfUserType "" TAB_VERB "%10.1" "" COMPU_TAB_REF ComM_UserByteMaskStartIdxOfUserType /end COMPU_METHOD
/begin COMPU_METHOD ComM_UserPncByteMaskEndIdxOfUserType "" TAB_VERB "%10.1" "" COMPU_TAB_REF ComM_UserPncByteMaskEndIdxOfUserType /end COMPU_METHOD
/begin COMPU_METHOD ComM_UserPncByteMaskStartIdxOfUserType "" TAB_VERB "%10.1" "" COMPU_TAB_REF ComM_UserPncByteMaskStartIdxOfUserType /end COMPU_METHOD
/begin COMPU_METHOD CompuMethod_EcuM_CurrentBootTarget_Values "" TAB_VERB "%10.1" "" COMPU_TAB_REF CompuMethod_EcuM_CurrentBootTarget_Values /end COMPU_METHOD
/begin COMPU_METHOD CompuMethod_EcuM_ModuleState_Values "" TAB_VERB "%10.1" "" COMPU_TAB_REF CompuMethod_EcuM_ModuleState_Values /end COMPU_METHOD
/begin COMPU_METHOD Dbg_cmBoolean "" TAB_VERB "%10.1" "" COMPU_TAB_REF Dbg_cmBoolean /end COMPU_METHOD
/begin COMPU_METHOD EcuM_ComMChannelRefsEndIdxOfWakeupSourceListType "" TAB_VERB "%10.1" "" COMPU_TAB_REF EcuM_ComMChannelRefsEndIdxOfWakeupSourceListType /end COMPU_METHOD
/begin COMPU_METHOD EcuM_ComMChannelRefsStartIdxOfWakeupSourceListType "" TAB_VERB "%10.1" "" COMPU_TAB_REF EcuM_ComMChannelRefsStartIdxOfWakeupSourceListType /end COMPU_METHOD
/begin COMPU_TAB CM_BMC_Max_Ladestrom "" TAB_INTP 2 0 0 8189 1637.8000000000002 /end COMPU_TAB
/begin COMPU_VTAB CM_BMC_Max_Ladestrom.StatusText "" TAB_VERB 2 8190 "CM_BMC_Max_Ladestrom_Cx1ffe_Init" 8191 "CM_BMC_Max_Ladestrom_Cx1fff_Fehler" /end COMPU_VTAB
/begin COMPU_TAB CM_BMC_Max_Ladestrom_02 "" TAB_INTP 2 0 0 16250 3250 /end COMPU_TAB
/begin COMPU_VTAB CM_BMC_Max_Ladestrom_02.StatusText "" TAB_VERB 2 16382 "CM_BMC_Max_Ladestrom_02_Cx3ffe_Init" 16383 "CM_BMC_Max_Ladestrom_02_Cx3fff_Fehler" /end COMPU_VTAB
/begin COMPU_TAB CM_BMC_Max_Spannung "" TAB_INTP 2 0 0 1021 1021 /end COMPU_TAB
/begin COMPU_VTAB CM_BMC_Max_Spannung.StatusText "" TAB_VERB 2 1022 "CM_BMC_Max_Spannung_Cx3fe_Init" 1023 "CM_BMC_Max_Spannung_Cx3ff_Fehler" /end COMPU_VTAB
/begin COMPU_TAB CM_BMC_MinDyn_Entladespannung "" TAB_INTP 2 0 0 1021 1021 /end COMPU_TAB
/begin COMPU_VTAB CM_BMC_MinDyn_Entladespannung.StatusText "" TAB_VERB 2 1022 "CM_BMC_MinDyn_Entladespannung_Cx3fe_Init" 1023 "CM_BMC_MinDyn_Entladespannung_Cx3ff_Fehler" /end COMPU_VTAB
/begin COMPU_TAB CM_BMC_MinDyn_Ladespannung "" TAB_INTP 2 0 0 1021 1021 /end COMPU_TAB
/begin COMPU_VTAB CM_BMC_MinDyn_Ladespannung.StatusText "" TAB_VERB 2 1022 "CM_BMC_MinDyn_Ladespannung_Cx3fe_Init" 1023 "CM_BMC_MinDyn_Ladespannung_Cx3ff_Fehler" /end COMPU_VTAB
/begin COMPU_TAB CM_BMC_Min_Spannung "" TAB_INTP 2 0 0 1021 1021 /end COMPU_TAB
/begin COMPU_VTAB CM_BMC_Min_Spannung.StatusText "" TAB_VERB 2 1022 "CM_BMC_Min_Spannung_Cx3fe_Init" 1023 "CM_BMC_Min_Spannung_Cx3ff_Fehler" /end COMPU_VTAB
/begin COMPU_VTAB CM_BMC_Modus "" TAB_VERB 6 0 "CM_BMC_Modus_Cx0_HV_inaktiv" 1 "CM_BMC_Modus_Cx1_HV_aktiv" 4 "CM_BMC_Modus_Cx4_AC_Laden" 5 "CM_BMC_Modus_Cx5_Error_Batt" 6 "CM_BMC_Modus_Cx6_DC_Laden" 15 "CM_BMC_Modus_Cxf_Init" /end COMPU_VTAB
/begin COMPU_TAB CM_BMC_NutzbareKapazitaet "" TAB_INTP 2 0 0 4093 511.625 /end COMPU_TAB
/begin COMPU_VTAB CM_BMC_NutzbareKapazitaet.StatusText "" TAB_VERB 2 4094 "CM_BMC_NutzbareKapazitaet_Cxffe_Init" 4095 "CM_BMC_NutzbareKapazitaet_Cxfff_Fehler" /end COMPU_VTAB
/begin COMPU_TAB CM_BMC_NutzbarerSOC "" TAB_INTP 2 0 -20 4093 184.65000000000001 /end COMPU_TAB
/begin COMPU_VTAB CM_BMC_NutzbarerSOC.StatusText "" TAB_VERB 2 4094 "CM_BMC_NutzbarerSOC_Cxffe_Init" 4095 "CM_BMC_NutzbarerSOC_Cxfff_Fehler" /end COMPU_VTAB
/begin COMPU_TAB CM_BMC_PerfInd_Entladen "" TAB_INTP 2 0 0 1021 204.20000000000002 /end COMPU_TAB
/begin COMPU_VTAB CM_BMC_PerfInd_Entladen.StatusText "" TAB_VERB 2 1022 "CM_BMC_PerfInd_Entladen_Cx3fe_Init" 1023 "CM_BMC_PerfInd_Entladen_Cx3ff_Fehler" /end COMPU_VTAB
/begin COMPU_TAB CM_BMC_PerfInd_Laden "" TAB_INTP 2 0 0 1021 204.20000000000002 /end COMPU_TAB
/begin COMPU_VTAB CM_BMC_PerfInd_Laden.StatusText "" TAB_VERB 2 1022 "CM_BMC_PerfInd_Laden_Cx3fe_Init" 1023 "CM_BMC_PerfInd_Laden_Cx3ff_Fehler" /end COMPU_VTAB
/begin COMPU_TAB CM_BMC_PredLeistung_StuetzungNV "" TAB_INTP 2 0 0 4092 818400 /end COMPU_TAB
/begin COMPU_VTAB CM_BMC_PredLeistung_StuetzungNV.StatusText "" TAB_VERB 3 4093 "CM_BMC_PredLeistung_StuetzungNV_Cxffd_keine_Berechnung" 4094 "CM_BMC_PredLeistung_StuetzungNV_Cxffe_Init" 4095 "CM_BMC_PredLeistung_StuetzungNV_Cxfff_Fehler" /end COMPU_VTAB
/begin COMPU_TAB CM_BMC_Range_Indikator "" TAB_INTP 2 0 0 2000 100 /end COMPU_TAB
/begin COMPU_VTAB CM_BMC_Range_Indikator.StatusText "" TAB_VERB 6 2042 "CM_BMC_Range_Indikator_Cx7fa_Funktion_nicht_umgesetzt" 2043 "CM_BMC_Range_Indikator_Cx7fb_kleiner_0" 2044 "CM_BMC_Range_Indikator_Cx7fc_groesser_100" 2045 "CM_BMC_Range_Indikator_Cx7fd_nicht_angelernt" 2046 "CM_BMC_Range_Indikator_Cx7fe_Init" 2047 "CM_BMC_Range_Indikator_Cx7ff_Fehler" /end COMPU_VTAB
/begin COMPU_TAB CM_BMC_Rekuperation "" TAB_INTP 2 0 0 65535 655350 /end COMPU_TAB
/begin COMPU_TAB CM_BMC_RuecklaufTemperatur "" TAB_INTP 2 0 -40 1020 87.5 /end COMPU_TAB
/begin COMPU_VTAB CM_BMC_RuecklaufTemperatur.StatusText "" TAB_VERB 3 1021 "CM_BMC_RuecklaufTemperatur_Cx3fd_Nicht_verbaut" 1022 "CM_BMC_RuecklaufTemperatur_Cx3fe_Init" 1023 "CM_BMC_RuecklaufTemperatur_Cx3ff_Fehler" /end COMPU_VTAB
/begin COMPU_TAB CM_BMC_Spannung "" TAB_INTP 2 0 0 16380 1023.75 /end COMPU_TAB
/begin COMPU_VTAB CM_BMC_Spannung.StatusText "" TAB_VERB 3 16381 "CM_BMC_Spannung_Cx3ffd_Null_Bank" 16382 "CM_BMC_Spannung_Cx3ffe_Init" 16383 "CM_BMC_Spannung_Cx3fff_Fehler" /end COMPU_VTAB
/begin COMPU_TAB CM_BMC_Spannung_DC_Ladesaeule "" TAB_INTP 2 0 -1023 32764 1024.75 /end COMPU_TAB
/begin COMPU_VTAB CM_BMC_Spannung_DC_Ladesaeule.StatusText "" TAB_VERB 3 32765 "CM_BMC_Spannung_DC_Ladesaeule_Cx7ffd_nicht_messbar" 32766 "CM_BMC_Spannung_DC_Ladesaeule_Cx7ffe_Init" 32767 "CM_BMC_Spannung_DC_Ladesaeule_Cx7fff_Fehler" /end COMPU_VTAB
/begin COMPU_TAB CM_BMC_Spannung_Messzeit "" TAB_INTP 2 0 0 253 253 /end COMPU_TAB
/begin COMPU_VTAB CM_BMC_Spannung_Messzeit.StatusText "" TAB_VERB 2 254 "CM_BMC_Spannung_Messzeit_Cxfe_Init" 255 "CM_BMC_Spannung_Messzeit_Cxff_Fehler" /end COMPU_VTAB
/begin COMPU_TAB CM_BMC_Spannung_ZwischenKreis "" TAB_INTP 2 0 0 16380 1023.75 /end COMPU_TAB
/begin COMPU_VTAB CM_BMC_Spannung_ZwischenKreis.StatusText "" TAB_VERB 3 16381 "CM_BMC_Spannung_ZwischenKreis_Cx3ffd_nicht_messbar" 16382 "CM_BMC_Spannung_ZwischenKreis_Cx3ffe_Init" 16383 "CM_BMC_Spannung_ZwischenKreis_Cx3fff_Fehler" /end COMPU_VTAB
/begin COMPU_TAB CM_BMC_Spannung_ZwischenKreis_2 "" TAB_INTP 2 0 0 16380 1023.75 /end COMPU_TAB
/begin COMPU_VTAB CM_BMC_Spannung_ZwischenKreis_2.StatusText "" TAB_VERB 3 16381 "CM_BMC_Spannung_ZwischenKreis_2_Cx3ffd_nicht_messbar" 16382 "CM_BMC_Spannung_ZwischenKreis_2_Cx3ffe_Init" 16383 "CM_BMC_Spannung_ZwischenKreis_2_Cx3fff_Fehler" /end COMPU_VTAB
/begin COMPU_VTAB CM_BMC_Sperrung_Ueberspannung "" TAB_VERB 4 0 "CM_BMC_Sperrung_Ueberspannung_Cx0_keine_Sperrung" 1 "CM_BMC_Sperrung_Ueberspannung_Cx1_Sperrung" 2 "CM_BMC_Sperrung_Ueberspannung_Cx2_InitWert" 3 "CM_BMC_Sperrung_Ueberspannung_Cx3_Fehler" /end COMPU_VTAB
/begin COMPU_VTAB CM_BMC_Sperrung_Uebertemperatur "" TAB_VERB 4 0 "CM_BMC_Sperrung_Uebertemperatur_Cx0_keine_Sperrung" 1 "CM_BMC_Sperrung_Uebertemperatur_Cx1_Sperrung" 2 "CM_BMC_Sperrung_Uebertemperatur_Cx2_InitWert" 3 "CM_BMC_Sperrung_Uebertemperatur_Cx3_Fehler" /end COMPU_VTAB
/begin COMPU_VTAB CM_BMC_Sperrung_Unterspannung "" TAB_VERB 4 0 "CM_BMC_Sperrung_Unterspannung_Cx0_keine_Sperrung" 1 "CM_BMC_Sperrung_Unterspannung_Cx1_Sperrung" 2 "CM_BMC_Sperrung_Unterspannung_Cx2_InitWert" 3 "CM_BMC_Sperrung_Unterspannung_Cx3_Fehler" /end COMPU_VTAB
/begin COMPU_VTAB CM_BMC_Status_DCLS "" TAB_VERB 4 0 "CM_BMC_Status_DCLS_Cx0_inaktiv" 1 "CM_BMC_Status_DCLS_Cx1_i_O" 2 "CM_BMC_Status_DCLS_Cx2_n_i_O" 3 "CM_BMC_Status_DCLS_Cx3_aktiv" /end COMPU_VTAB
/begin COMPU_VTAB CM_BMC_Status_HV_Spannungssensorik "" TAB_VERB 2 0 "CM_BMC_Status_HV_Spannungssensorik_Cx0_InitWert_kein_Fehler" 1 "CM_BMC_Status_HV_Spannungssensorik_Cx1_Fehler" /end COMPU_VTAB
/begin COMPU_VTAB CM_BMC_Status_Spgfreiheit "" TAB_VERB 4 0 "CM_BMC_Status_Spgfreiheit_Cx0_Init" 1 "CM_BMC_Status_Spgfreiheit_Cx1_HV_Komponente_spannungsfrei" 2 "CM_BMC_Status_Spgfreiheit_Cx2_HV_Komp_nicht_spannungsfrei" 3 "CM_BMC_Status_Spgfreiheit_Cx3_Fehler_nicht_spannungsfrei" /end COMPU_VTAB
/begin COMPU_VTAB CM_BMC_Status_Trennelemente "" TAB_VERB 6 0 "CM_BMC_Status_Trennelemente_Cx0_kein_Fehler" 1 "CM_BMC_Status_Trennelemente_Cx1_Haupt_TrEl_klemmt_geschl" 2 "CM_BMC_Status_Trennelemente_Cx2_AC_TrEl_klemmt_geschl" 3 "CM_BMC_Status_Trennelemente_Cx3_Haupt_und_AC_TrEl_klemmt_geschl" 6 "CM_BMC_Status_Trennelemente_Cx6_InitWert" 7 "CM_BMC_Status_Trennelemente_Cx7_Fehler" /end COMPU_VTAB
/begin COMPU_TAB CM_BMC_Strom "" TAB_INTP 2 0 -2047 65533 2048.8125 /end COMPU_TAB
/begin COMPU_VTAB CM_BMC_Strom.StatusText "" TAB_VERB 2 65534 "CM_BMC_Strom_Cxfffe_Init" 65535 "CM_BMC_Strom_Cxffff_Fehler" /end COMPU_VTAB
/begin COMPU_TAB CM_BMC_Strom_02 "" TAB_INTP 2 0 -3250 104000 3250 /end COMPU_TAB
/begin COMPU_VTAB CM_BMC_Strom_02.StatusText "" TAB_VERB 2 131070 "CM_BMC_Strom_02_Cx1fffe_InitWert" 131071 "CM_BMC_Strom_02_Cx1ffff_Fehler" /end COMPU_VTAB
/begin COMPU_TAB CM_BMC_Strom_Messzeit "" TAB_INTP 2 0 0 253 253 /end COMPU_TAB
/begin COMPU_VTAB CM_BMC_Strom_Messzeit.StatusText "" TAB_VERB 2 254 "CM_BMC_Strom_Messzeit_Cxfe_Init" 255 "CM_BMC_Strom_Messzeit_Cxff_Fehler" /end COMPU_VTAB
/begin COMPU_TAB CM_BMC_TechnischerSOC "" TAB_INTP 2 0 0 2000 100 /end COMPU_TAB
/begin COMPU_VTAB CM_BMC_TechnischerSOC.StatusText "" TAB_VERB 2 2046 "CM_BMC_TechnischerSOC_Cx7fe_Init" 2047 "CM_BMC_TechnischerSOC_Cx7ff_Fehler" /end COMPU_VTAB
/begin COMPU_TAB CM_BMC_Temperatur "" TAB_INTP 2 0 -40 1021 87.625 /end COMPU_TAB
/begin COMPU_VTAB CM_BMC_Temperatur.StatusText "" TAB_VERB 2 1022 "CM_BMC_Temperatur_Cx3fe_Init" 1023 "CM_BMC_Temperatur_Cx3ff_Fehler" /end COMPU_VTAB
/begin COMPU_TAB CM_BMC_Temperatur_hoechste "" TAB_INTP 2 0 -40 1021 87.625 /end COMPU_TAB
/begin COMPU_VTAB CM_BMC_Temperatur_hoechste.StatusText "" TAB_VERB 2 1022 "CM_BMC_Temperatur_hoechste_Cx3fe_Init" 1023 "CM_BMC_Temperatur_hoechste_Cx3ff_Fehler" /end COMPU_VTAB
/begin COMPU_TAB CM_BMC_Temperatur_niedrigste "" TAB_INTP 2 0 -40 1021 87.625 /end COMPU_TAB
/begin COMPU_VTAB CM_BMC_Temperatur_niedrigste.StatusText "" TAB_VERB 2 1022 "CM_BMC_Temperatur_niedrigste_Cx3fe_Init" 1023 "CM_BMC_Temperatur_niedrigste_Cx3ff_Fehler" /end COMPU_VTAB
/begin COMPU_TAB CM_BMC_ThermAuslastung "" TAB_INTP 2 0 0 100 100 /end COMPU_TAB
/begin COMPU_VTAB CM_BMC_ThermAuslastung.StatusText "" TAB_VERB 3 101 "CM_BMC_ThermAuslastung_Cx65_Notfallkuehlung" 126 "CM_BMC_ThermAuslastung_Cx7e_Init" 127 "CM_BMC_ThermAuslastung_Cx7f_Fehler" /end COMPU_VTAB
/begin COMPU_TAB CM_BMC_ThermSpreizung "" TAB_INTP 2 0 0 10 100 /end COMPU_TAB
/begin COMPU_VTAB CM_BMC_ThermSpreizung.StatusText "" TAB_VERB 2 14 "CM_BMC_ThermSpreizung_Cxe_Init" 15 "CM_BMC_ThermSpreizung_Cxf_Fehler" /end COMPU_VTAB
/begin COMPU_TAB CM_BMC_UBE_Indik_last_update_km "" TAB_INTP 2 0 0 1048573 1048573 /end COMPU_TAB
/begin COMPU_VTAB CM_BMC_UBE_Indik_last_update_km.StatusText "" TAB_VERB 2 1048574 "CM_BMC_UBE_Indik_last_update_km_Cxffffe_Init" 1048575 "CM_BMC_UBE_Indik_last_update_km_Cxfffff_Fehler" /end COMPU_VTAB
/begin COMPU_TAB CM_BMC_UBE_Indikator "" TAB_INTP 2 0 0 1000 100 /end COMPU_TAB
/begin COMPU_VTAB CM_BMC_UBE_Indikator.StatusText "" TAB_VERB 5 2043 "CM_BMC_UBE_Indikator_Cx7fb_kleiner_0" 2044 "CM_BMC_UBE_Indikator_Cx7fc_groesser_100" 2045 "CM_BMC_UBE_Indikator_Cx7fd_nicht_angelernt" 2046 "CM_BMC_UBE_Indikator_Cx7fe_Init" 2047 "CM_BMC_UBE_Indikator_Cx7ff_Fehler" /end COMPU_VTAB
/begin COMPU_VTAB CM_BMC_UI1_Spannung1_Schalt_Anf "" TAB_VERB 2 0 "CM_BMC_UI1_Spannung1_Schalt_Anf_Cx0_aus" 1 "CM_BMC_UI1_Spannung1_Schalt_Anf_Cx1_ein" /end COMPU_VTAB
/begin COMPU_VTAB CM_BMC_UI1_Spannung2_Schalt_Anf "" TAB_VERB 2 0 "CM_BMC_UI1_Spannung2_Schalt_Anf_Cx0_aus" 1 "CM_BMC_UI1_Spannung2_Schalt_Anf_Cx1_ein" /end COMPU_VTAB
/begin COMPU_VTAB CM_BMC_UI2_Spannung1_Schalt_Anf "" TAB_VERB 2 0 "CM_BMC_UI2_Spannung1_Schalt_Anf_Cx0_aus" 1 "CM_BMC_UI2_Spannung1_Schalt_Anf_Cx1_ein" /end COMPU_VTAB
/begin COMPU_VTAB CM_BMC_UI2_Spannung2_Schalt_Anf "" TAB_VERB 2 0 "CM_BMC_UI2_Spannung2_Schalt_Anf_Cx0_aus" 1 "CM_BMC_UI2_Spannung2_Schalt_Anf_Cx1_ein" /end COMPU_VTAB
/begin COMPU_TAB CM_BMC_Ueberspannungszaehler_CMC01 "" TAB_INTP 2 0 0 400 400 /end COMPU_TAB
/begin COMPU_VTAB CM_BMC_Ueberspannungszaehler_CMC01.StatusText "" TAB_VERB 2 510 "CM_BMC_Ueberspannungszaehler_CMC01_Cx1fe_InitWert" 511 "CM_BMC_Ueberspannungszaehler_CMC01_Cx1ff_Fehler" /end COMPU_VTAB
/begin COMPU_TAB CM_BMC_Ueberspannungszaehler_CMC02 "" TAB_INTP 2 0 0 400 400 /end COMPU_TAB
/begin COMPU_VTAB CM_BMC_Ueberspannungszaehler_CMC02.StatusText "" TAB_VERB 2 510 "CM_BMC_Ueberspannungszaehler_CMC02_Cx1fe_InitWert" 511 "CM_BMC_Ueberspannungszaehler_CMC02_Cx1ff_Fehler" /end COMPU_VTAB
/begin COMPU_TAB CM_BMC_Ueberspannungszaehler_CMC03 "" TAB_INTP 2 0 0 400 400 /end COMPU_TAB
/begin COMPU_VTAB CM_BMC_Ueberspannungszaehler_CMC03.StatusText "" TAB_VERB 2 510 "CM_BMC_Ueberspannungszaehler_CMC03_Cx1fe_InitWert" 511 "CM_BMC_Ueberspannungszaehler_CMC03_Cx1ff_Fehler" /end COMPU_VTAB
/begin COMPU_TAB CM_BMC_Ueberspannungszaehler_CMC04 "" TAB_INTP 2 0 0 400 400 /end COMPU_TAB
/begin COMPU_VTAB CM_BMC_Ueberspannungszaehler_CMC04.StatusText "" TAB_VERB 2 510 "CM_BMC_Ueberspannungszaehler_CMC04_Cx1fe_InitWert" 511 "CM_BMC_Ueberspannungszaehler_CMC04_Cx1ff_Fehler" /end COMPU_VTAB
/begin COMPU_TAB CM_BMC_Uebertemperaturzaehler_CMC01 "" TAB_INTP 2 0 0 60480 604800 /end COMPU_TAB
/begin COMPU_VTAB CM_BMC_Uebertemperaturzaehler_CMC01.StatusText "" TAB_VERB 2 65534 "CM_BMC_Uebertemperaturzaehler_CMC01_Cxfffe_InitWert" 65535 "CM_BMC_Uebertemperaturzaehler_CMC01_Cxffff_Fehler" /end COMPU_VTAB
/begin COMPU_TAB CM_BMC_Uebertemperaturzaehler_CMC02 "" TAB_INTP 2 0 0 60480 604800 /end COMPU_TAB
/begin COMPU_VTAB CM_BMC_Uebertemperaturzaehler_CMC02.StatusText "" TAB_VERB 2 65534 "CM_BMC_Uebertemperaturzaehler_CMC02_Cxfffe_InitWert" 65535 "CM_BMC_Uebertemperaturzaehler_CMC02_Cxffff_Fehler" /end COMPU_VTAB
/begin COMPU_TAB CM_BMC_Uebertemperaturzaehler_CMC03 "" TAB_INTP 2 0 0 60480 604800 /end COMPU_TAB
/begin COMPU_VTAB CM_BMC_Uebertemperaturzaehler_CMC03.StatusText "" TAB_VERB 2 65534 "CM_BMC_Uebertemperaturzaehler_CMC03_Cxfffe_InitWert" 65535 "CM_BMC_Uebertemperaturzaehler_CMC03_Cxffff_Fehler" /end COMPU_VTAB
/begin COMPU_TAB CM_BMC_Uebertemperaturzaehler_CMC04 "" TAB_INTP 2 0 0 60480 604800 /end COMPU_TAB
/begin COMPU_VTAB CM_BMC_Uebertemperaturzaehler_CMC04.StatusText "" TAB_VERB 2 65534 "CM_BMC_Uebertemperaturzaehler_CMC04_Cxfffe_InitWert" 65535 "CM_BMC_Uebertemperaturzaehler_CMC04_Cxffff_Fehler" /end COMPU_VTAB
/begin COMPU_VTAB CM_BMC_Unterboden_Warnung "" TAB_VERB 8 0 "CM_BMC_Unterboden_Warnung_Cx0_BMC_Unterboden_Warnung_keine_Warnung" 1 "CM_BMC_Unterboden_Warnung_Cx1_BMC_Unterboden_Warnung_1" 2 "CM_BMC_Unterboden_Warnung_Cx2_BMC_Unterboden_Warnung_2" 3 "CM_BMC_Unterboden_Warnung_Cx3_BMC_Unterboden_Warnung_3" 4 "CM_BMC_Unterboden_Warnung_Cx4_BMC_Unterboden_Warnung_4" 5 "CM_BMC_Unterboden_Warnung_Cx5_BMC_Unterboden_Warnung_5" 6 "CM_BMC_Unterboden_Warnung_Cx6_BMC_Unterboden_Warnung_6" 7 "CM_BMC_Unterboden_Warnung_Cx7_Fehler" /end COMPU_VTAB
/begin COMPU_TAB CM_BMC_Unterspannungszaehler_CMC01 "" TAB_INTP 2 0 0 400 400 /end COMPU_TAB
/begin COMPU_VTAB CM_BMC_Unterspannungszaehler_CMC01.StatusText "" TAB_VERB 2 510 "CM_BMC_Unterspannungszaehler_CMC01_Cx1fe_InitWert" 511 "CM_BMC_Unterspannungszaehler_CMC01_Cx1ff_Fehler" /end COMPU_VTAB
/begin COMPU_TAB CM_BMC_Unterspannungszaehler_CMC02 "" TAB_INTP 2 0 0 400 400 /end COMPU_TAB
/begin COMPU_VTAB CM_BMC_Unterspannungszaehler_CMC02.StatusText "" TAB_VERB 2 510 "CM_BMC_Unterspannungszaehler_CMC02_Cx1fe_InitWert" 511 "CM_BMC_Unterspannungszaehler_CMC02_Cx1ff_Fehler" /end COMPU_VTAB
/begin COMPU_TAB CM_BMC_Unterspannungszaehler_CMC03 "" TAB_INTP 2 0 0 400 400 /end COMPU_TAB
/begin COMPU_VTAB CM_BMC_Unterspannungszaehler_CMC03.StatusText "" TAB_VERB 2 510 "CM_BMC_Unterspannungszaehler_CMC03_Cx1fe_InitWert" 511 "CM_BMC_Unterspannungszaehler_CMC03_Cx1ff_Fehler" /end COMPU_VTAB
/begin COMPU_TAB CM_BMC_Unterspannungszaehler_CMC04 "" TAB_INTP 2 0 0 400 400 /end COMPU_TAB
/begin COMPU_VTAB CM_BMC_Unterspannungszaehler_CMC04.StatusText "" TAB_VERB 2 510 "CM_BMC_Unterspannungszaehler_CMC04_Cx1fe_InitWert" 511 "CM_BMC_Unterspannungszaehler_CMC04_Cx1ff_Fehler" /end COMPU_VTAB
/begin COMPU_VTAB CM_BMC_Verbauinfo_ACSchuetz "" TAB_VERB 3 0 "CM_BMC_Verbauinfo_ACSchuetz_Cx0_Init" 1 "CM_BMC_Verbauinfo_ACSchuetz_Cx1_nicht_verbaut" 2 "CM_BMC_Verbauinfo_ACSchuetz_Cx2_verbaut" /end COMPU_VTAB
/begin COMPU_VTAB CM_BMC_Verbauinfo_Bank "" TAB_VERB 3 0 "CM_BMC_Verbauinfo_Bank_Cx0_Init" 1 "CM_BMC_Verbauinfo_Bank_Cx1_nicht_verbaut" 2 "CM_BMC_Verbauinfo_Bank_Cx2_verbaut" /end COMPU_VTAB
/begin COMPU_TAB CM_BMC_Verbrauch "" TAB_INTP 2 0 0 65535 655350 /end COMPU_TAB
/begin COMPU_TAB CM_BMC_VerlustEnergie "" TAB_INTP 2 0 0 8189 32756 /end COMPU_TAB
/begin COMPU_VTAB CM_BMC_VerlustEnergie.StatusText "" TAB_VERB 2 8190 "CM_BMC_VerlustEnergie_Cx1ffe_Init" 8191 "CM_BMC_VerlustEnergie_Cx1fff_Fehler" /end COMPU_VTAB
/begin COMPU_TAB CM_BMC_Vorlade_Zielspannung "" TAB_INTP 2 0 0 1021 1021 /end COMPU_TAB
/begin COMPU_VTAB CM_BMC_Vorlade_Zielspannung.StatusText "" TAB_VERB 2 1022 "CM_BMC_Vorlade_Zielspannung_Cx3fe_Init" 1023 "CM_BMC_Vorlade_Zielspannung_Cx3ff_Fehler" /end COMPU_VTAB
/begin COMPU_TAB CM_BMC_VorlaufTemperatur "" TAB_INTP 2 0 -40 1020 87.5 /end COMPU_TAB
/begin COMPU_VTAB CM_BMC_VorlaufTemperatur.StatusText "" TAB_VERB 3 1021 "CM_BMC_VorlaufTemperatur_Cx3fd_Nicht_verbaut" 1022 "CM_BMC_VorlaufTemperatur_Cx3fe_Init" 1023 "CM_BMC_VorlaufTemperatur_Cx3ff_Fehler" /end COMPU_VTAB
/begin COMPU_TAB CM_BMC_ZellTemp_virtuell_max "" TAB_INTP 2 0 -40 1020 87.5 /end COMPU_TAB
/begin COMPU_VTAB CM_BMC_ZellTemp_virtuell_max.StatusText "" TAB_VERB 3 1021 "CM_BMC_ZellTemp_virtuell_max_Cx3fd_Nicht_verfuegbar" 1022 "CM_BMC_ZellTemp_virtuell_max_Cx3fe_Init" 1023 "CM_BMC_ZellTemp_virtuell_max_Cx3ff_Fehler" /end COMPU_VTAB
/begin COMPU_TAB CM_BMC_ZellTemp_virtuell_min "" TAB_INTP 2 0 -40 1020 87.5 /end COMPU_TAB
/begin COMPU_VTAB CM_BMC_ZellTemp_virtuell_min.StatusText "" TAB_VERB 3 1021 "CM_BMC_ZellTemp_virtuell_min_Cx3fd_Nicht_verfuegbar" 1022 "CM_BMC_ZellTemp_virtuell_min_Cx3fe_Init" 1023 "CM_BMC_ZellTemp_virtuell_min_Cx3ff_Fehler" /end COMPU_VTAB
/begin COMPU_VTAB CM_CHA_ReqPrgBms "" TAB_VERB 16 0 "CM_CHA_ReqPrgBms_Cx0_no_program" 1 "CM_CHA_ReqPrgBms_Cx1_program_1" 2 "CM_CHA_ReqPrgBms_Cx2_program_2" 3 "CM_CHA_ReqPrgBms_Cx3_program_3" 4 "CM_CHA_ReqPrgBms_Cx4_program_4" 5 "CM_CHA_ReqPrgBms_Cx5_program_5" 6 "CM_CHA_ReqPrgBms_Cx6_program_6" 7 "CM_CHA_ReqPrgBms_Cx7_program_7" 8 "CM_CHA_ReqPrgBms_Cx8_program_8" 9 "CM_CHA_ReqPrgBms_Cx9_program_9" 10 "CM_CHA_ReqPrgBms_Cxa_program_10" 11 "CM_CHA_ReqPrgBms_Cxb_program_11" 12 "CM_CHA_ReqPrgBms_Cxc_program_12" 13 "CM_CHA_ReqPrgBms_Cxd_program_13" 14 "CM_CHA_ReqPrgBms_Cxe_program_14" 15 "CM_CHA_ReqPrgBms_Cxf_program_15" /end COMPU_VTAB
/begin COMPU_TAB CM_DCDC_NV_CALID_Index_01 "" TAB_INTP 2 0 0 255 255 /end COMPU_TAB
/begin COMPU_TAB CM_DCDC_NV_CALID_Index_02 "" TAB_INTP 2 0 0 255 255 /end COMPU_TAB
/begin COMPU_TAB CM_DCDC_NV_CALID_Index_03 "" TAB_INTP 2 0 0 255 255 /end COMPU_TAB
/begin COMPU_TAB CM_DCDC_NV_CALID_Index_04 "" TAB_INTP 2 0 0 255 255 /end COMPU_TAB
/begin COMPU_TAB CM_DCDC_NV_CALID_Index_05 "" TAB_INTP 2 0 0 255 255 /end COMPU_TAB
/begin COMPU_TAB CM_DCDC_NV_CALID_Index_06 "" TAB_INTP 2 0 0 255 255 /end COMPU_TAB
/begin COMPU_TAB CM_DCDC_NV_CALID_Index_07 "" TAB_INTP 2 0 0 255 255 /end COMPU_TAB
/begin COMPU_TAB CM_DCDC_NV_CALID_Index_08 "" TAB_INTP 2 0 0 255 255 /end COMPU_TAB
/begin COMPU_TAB CM_DCDC_NV_CALID_Index_09 "" TAB_INTP 2 0 0 255 255 /end COMPU_TAB
/begin COMPU_TAB CM_DCDC_NV_CALID_Index_10 "" TAB_INTP 2 0 0 255 255 /end COMPU_TAB
/begin COMPU_TAB CM_DCDC_NV_CALID_Index_11 "" TAB_INTP 2 0 0 255 255 /end COMPU_TAB
/begin COMPU_TAB CM_DCDC_NV_CALID_Index_12 "" TAB_INTP 2 0 0 255 255 /end COMPU_TAB
/begin COMPU_TAB CM_DCDC_NV_CALID_Index_13 "" TAB_INTP 2 0 0 255 255 /end COMPU_TAB
/begin COMPU_TAB CM_DCDC_NV_CALID_Index_14 "" TAB_INTP 2 0 0 255 255 /end COMPU_TAB
/begin COMPU_TAB CM_DCDC_NV_CALID_Index_15 "" TAB_INTP 2 0 0 255 255 /end COMPU_TAB
/begin COMPU_TAB CM_DCDC_NV_CALID_Index_16 "" TAB_INTP 2 0 0 255 255 /end COMPU_TAB
/begin COMPU_TAB CM_DCDC_NV_CVN_Byte_1 "" TAB_INTP 2 0 0 255 255 /end COMPU_TAB
/begin COMPU_TAB CM_DCDC_NV_CVN_Byte_2 "" TAB_INTP 2 0 0 255 255 /end COMPU_TAB
/begin COMPU_TAB CM_DCDC_NV_CVN_Byte_3 "" TAB_INTP 2 0 0 255 255 /end COMPU_TAB
/begin COMPU_TAB CM_DCDC_NV_CVN_Byte_4 "" TAB_INTP 2 0 0 255 255 /end COMPU_TAB
/begin COMPU_VTAB CM_DCDC_NV_CVN_VLD "" TAB_VERB 2 0 "CM_DCDC_NV_CVN_VLD_Cx0_Ungueltig" 1 "CM_DCDC_NV_CVN_VLD_Cx1_Gueltig" /end COMPU_VTAB
/begin COMPU_VTAB CM_DCDC_NV_Komponentenfehler_01 "" TAB_VERB 4 0 "CM_DCDC_NV_Komponentenfehler_01_Cx0_TstNotComplThisOpCycle_Init" 1 "CM_DCDC_NV_Komponentenfehler_01_Cx1_TstComplThisOpCycle_Pass" 2 "CM_DCDC_NV_Komponentenfehler_01_Cx2_TstCmplThisCycle_Pass_TimeElapse" 3 "CM_DCDC_NV_Komponentenfehler_01_Cx3_TstComplThisOpCycle_FAIL" /end COMPU_VTAB
/begin COMPU_VTAB CM_DCDC_NV_Komponentenfehler_02 "" TAB_VERB 4 0 "CM_DCDC_NV_Komponentenfehler_02_Cx0_TstNotComplThisOpCycle_Init" 1 "CM_DCDC_NV_Komponentenfehler_02_Cx1_TstComplThisOpCycle_Pass" 2 "CM_DCDC_NV_Komponentenfehler_02_Cx2_TstCmplThisCycle_Pass_TimeElapse" 3 "CM_DCDC_NV_Komponentenfehler_02_Cx3_TstComplThisOpCycle_FAIL" /end COMPU_VTAB
/begin COMPU_VTAB CM_DCDC_NV_Komponentenfehler_03 "" TAB_VERB 4 0 "CM_DCDC_NV_Komponentenfehler_03_Cx0_TstNotComplThisOpCycle_Init" 1 "CM_DCDC_NV_Komponentenfehler_03_Cx1_TstComplThisOpCycle_Pass" 2 "CM_DCDC_NV_Komponentenfehler_03_Cx2_TstCmplThisCycle_Pass_TimeElapse" 3 "CM_DCDC_NV_Komponentenfehler_03_Cx3_TstComplThisOpCycle_FAIL" /end COMPU_VTAB
/begin COMPU_VTAB CM_DCDC_NV_Komponentenfehler_04 "" TAB_VERB 4 0 "CM_DCDC_NV_Komponentenfehler_04_Cx0_TstNotComplThisOpCycle_Init" 1 "CM_DCDC_NV_Komponentenfehler_04_Cx1_TstComplThisOpCycle_Pass" 2 "CM_DCDC_NV_Komponentenfehler_04_Cx2_TstCmplThisCycle_Pass_TimeElapse" 3 "CM_DCDC_NV_Komponentenfehler_04_Cx3_TstComplThisOpCycle_FAIL" /end COMPU_VTAB
/begin COMPU_VTAB CM_DCDC_NV_Komponentenfehler_05 "" TAB_VERB 4 0 "CM_DCDC_NV_Komponentenfehler_05_Cx0_TstNotComplThisOpCycle_Init" 1 "CM_DCDC_NV_Komponentenfehler_05_Cx1_TstComplThisOpCycle_Pass" 2 "CM_DCDC_NV_Komponentenfehler_05_Cx2_TstCmplThisCycle_Pass_TimeElapse" 3 "CM_DCDC_NV_Komponentenfehler_05_Cx3_TstComplThisOpCycle_FAIL" /end COMPU_VTAB
/begin COMPU_VTAB CM_DCDC_NV_Komponentenfehler_06 "" TAB_VERB 4 0 "CM_DCDC_NV_Komponentenfehler_06_Cx0_TstNotComplThisOpCycle_Init" 1 "CM_DCDC_NV_Komponentenfehler_06_Cx1_TstComplThisOpCycle_Pass" 2 "CM_DCDC_NV_Komponentenfehler_06_Cx2_TstCmplThisCycle_Pass_TimeElapse" 3 "CM_DCDC_NV_Komponentenfehler_06_Cx3_TstComplThisOpCycle_FAIL" /end COMPU_VTAB
/begin COMPU_VTAB CM_DCDC_NV_Komponentenfehler_07 "" TAB_VERB 4 0 "CM_DCDC_NV_Komponentenfehler_07_Cx0_TstNotComplThisOpCycle_Init" 1 "CM_DCDC_NV_Komponentenfehler_07_Cx1_TstComplThisOpCycle_Pass" 2 "CM_DCDC_NV_Komponentenfehler_07_Cx2_TstCmplThisCycle_Pass_TimeElapse" 3 "CM_DCDC_NV_Komponentenfehler_07_Cx3_TstComplThisOpCycle_FAIL" /end COMPU_VTAB
/begin COMPU_VTAB CM_DCDC_NV_Komponentenfehler_08 "" TAB_VERB 4 0 "CM_DCDC_NV_Komponentenfehler_08_Cx0_TstNotComplThisOpCycle_Init" 1 "CM_DCDC_NV_Komponentenfehler_08_Cx1_TstComplThisOpCycle_Pass" 2 "CM_DCDC_NV_Komponentenfehler_08_Cx2_TstCmplThisCycle_Pass_TimeElapse" 3 "CM_DCDC_NV_Komponentenfehler_08_Cx3_TstComplThisOpCycle_FAIL" /end COMPU_VTAB
/begin COMPU_VTAB CM_DCDC_NV_Komponentenfehler_09 "" TAB_VERB 4 0 "CM_DCDC_NV_Komponentenfehler_09_Cx0_TstNotComplThisOpCycle_Init" 1 "CM_DCDC_NV_Komponentenfehler_09_Cx1_TstComplThisOpCycle_Pass" 2 "CM_DCDC_NV_Komponentenfehler_09_Cx2_TstCmplThisCycle_Pass_TimeElapse" 3 "CM_DCDC_NV_Komponentenfehler_09_Cx3_TstComplThisOpCycle_FAIL" /end COMPU_VTAB
/begin COMPU_VTAB CM_DCDC_NV_Komponentenfehler_10 "" TAB_VERB 4 0 "CM_DCDC_NV_Komponentenfehler_10_Cx0_TstNotComplThisOpCycle_Init" 1 "CM_DCDC_NV_Komponentenfehler_10_Cx1_TstComplThisOpCycle_Pass" 2 "CM_DCDC_NV_Komponentenfehler_10_Cx2_TstCmplThisCycle_Pass_TimeElapse" 3 "CM_DCDC_NV_Komponentenfehler_10_Cx3_TstComplThisOpCycle_FAIL" /end COMPU_VTAB
/begin COMPU_VTAB CM_DCDC_NV_Komponentenfehler_11 "" TAB_VERB 4 0 "CM_DCDC_NV_Komponentenfehler_11_Cx0_TstNotComplThisOpCycle_Init" 1 "CM_DCDC_NV_Komponentenfehler_11_Cx1_TstComplThisOpCycle_Pass" 2 "CM_DCDC_NV_Komponentenfehler_11_Cx2_TstCmplThisCycle_Pass_TimeElapse" 3 "CM_DCDC_NV_Komponentenfehler_11_Cx3_TstComplThisOpCycle_FAIL" /end COMPU_VTAB
/begin COMPU_VTAB CM_DCDC_NV_Komponentenfehler_12 "" TAB_VERB 4 0 "CM_DCDC_NV_Komponentenfehler_12_Cx0_TstNotComplThisOpCycle_Init" 1 "CM_DCDC_NV_Komponentenfehler_12_Cx1_TstComplThisOpCycle_Pass" 2 "CM_DCDC_NV_Komponentenfehler_12_Cx2_TstCmplThisCycle_Pass_TimeElapse" 3 "CM_DCDC_NV_Komponentenfehler_12_Cx3_TstComplThisOpCycle_FAIL" /end COMPU_VTAB
/begin COMPU_VTAB CM_DCDC_NV_Komponentenfehler_13 "" TAB_VERB 4 0 "CM_DCDC_NV_Komponentenfehler_13_Cx0_TstNotComplThisOpCycle_Init" 1 "CM_DCDC_NV_Komponentenfehler_13_Cx1_TstComplThisOpCycle_Pass" 2 "CM_DCDC_NV_Komponentenfehler_13_Cx2_TstCmplThisCycle_Pass_TimeElapse" 3 "CM_DCDC_NV_Komponentenfehler_13_Cx3_TstComplThisOpCycle_FAIL" /end COMPU_VTAB
/begin COMPU_VTAB CM_DCDC_NV_Komponentenfehler_14 "" TAB_VERB 4 0 "CM_DCDC_NV_Komponentenfehler_14_Cx0_TstNotComplThisOpCycle_Init" 1 "CM_DCDC_NV_Komponentenfehler_14_Cx1_TstComplThisOpCycle_Pass" 2 "CM_DCDC_NV_Komponentenfehler_14_Cx2_TstCmplThisCycle_Pass_TimeElapse" 3 "CM_DCDC_NV_Komponentenfehler_14_Cx3_TstComplThisOpCycle_FAIL" /end COMPU_VTAB
/begin COMPU_VTAB CM_DCDC_NV_Komponentenfehler_15 "" TAB_VERB 4 0 "CM_DCDC_NV_Komponentenfehler_15_Cx0_TstNotComplThisOpCycle_Init" 1 "CM_DCDC_NV_Komponentenfehler_15_Cx1_TstComplThisOpCycle_Pass" 2 "CM_DCDC_NV_Komponentenfehler_15_Cx2_TstCmplThisCycle_Pass_TimeElapse" 3 "CM_DCDC_NV_Komponentenfehler_15_Cx3_TstComplThisOpCycle_FAIL" /end COMPU_VTAB
/begin COMPU_VTAB CM_DCDC_NV_Komponentenfehler_16 "" TAB_VERB 4 0 "CM_DCDC_NV_Komponentenfehler_16_Cx0_TstNotComplThisOpCycle_Init" 1 "CM_DCDC_NV_Komponentenfehler_16_Cx1_TstComplThisOpCycle_Pass" 2 "CM_DCDC_NV_Komponentenfehler_16_Cx2_TstCmplThisCycle_Pass_TimeElapse" 3 "CM_DCDC_NV_Komponentenfehler_16_Cx3_TstComplThisOpCycle_FAIL" /end COMPU_VTAB
/begin COMPU_VTAB CM_DCDC_NV_Komponentenfehler_17 "" TAB_VERB 4 0 "CM_DCDC_NV_Komponentenfehler_17_Cx0_TstNotComplThisOpCycle_Init" 1 "CM_DCDC_NV_Komponentenfehler_17_Cx1_TstComplThisOpCycle_Pass" 2 "CM_DCDC_NV_Komponentenfehler_17_Cx2_TstCmplThisCycle_Pass_TimeElapse" 3 "CM_DCDC_NV_Komponentenfehler_17_Cx3_TstComplThisOpCycle_FAIL" /end COMPU_VTAB
/begin COMPU_VTAB CM_DCDC_NV_Komponentenfehler_18 "" TAB_VERB 4 0 "CM_DCDC_NV_Komponentenfehler_18_Cx0_TstNotComplThisOpCycle_Init" 1 "CM_DCDC_NV_Komponentenfehler_18_Cx1_TstComplThisOpCycle_Pass" 2 "CM_DCDC_NV_Komponentenfehler_18_Cx2_TstCmplThisCycle_Pass_TimeElapse" 3 "CM_DCDC_NV_Komponentenfehler_18_Cx3_TstComplThisOpCycle_FAIL" /end COMPU_VTAB
/begin COMPU_VTAB CM_DCDC_NV_Komponentenfehler_19 "" TAB_VERB 4 0 "CM_DCDC_NV_Komponentenfehler_19_Cx0_TstNotComplThisOpCycle_Init" 1 "CM_DCDC_NV_Komponentenfehler_19_Cx1_TstComplThisOpCycle_Pass" 2 "CM_DCDC_NV_Komponentenfehler_19_Cx2_TstCmplThisCycle_Pass_TimeElapse" 3 "CM_DCDC_NV_Komponentenfehler_19_Cx3_TstComplThisOpCycle_FAIL" /end COMPU_VTAB
/begin COMPU_VTAB CM_DCDC_NV_Komponentenfehler_20 "" TAB_VERB 4 0 "CM_DCDC_NV_Komponentenfehler_20_Cx0_TstNotComplThisOpCycle_Init" 1 "CM_DCDC_NV_Komponentenfehler_20_Cx1_TstComplThisOpCycle_Pass" 2 "CM_DCDC_NV_Komponentenfehler_20_Cx2_TstCmplThisCycle_Pass_TimeElapse" 3 "CM_DCDC_NV_Komponentenfehler_20_Cx3_TstComplThisOpCycle_FAIL" /end COMPU_VTAB
/begin COMPU_VTAB CM_DCDC_NV_Komponentenfehler_21 "" TAB_VERB 4 0 "CM_DCDC_NV_Komponentenfehler_21_Cx0_TstNotComplThisOpCycle_Init" 1 "CM_DCDC_NV_Komponentenfehler_21_Cx1_TstComplThisOpCycle_Pass" 2 "CM_DCDC_NV_Komponentenfehler_21_Cx2_TstCmplThisCycle_Pass_TimeElapse" 3 "CM_DCDC_NV_Komponentenfehler_21_Cx3_TstComplThisOpCycle_FAIL" /end COMPU_VTAB
/begin COMPU_VTAB CM_DCDC_NV_Komponentenfehler_22 "" TAB_VERB 4 0 "CM_DCDC_NV_Komponentenfehler_22_Cx0_TstNotComplThisOpCycle_Init" 1 "CM_DCDC_NV_Komponentenfehler_22_Cx1_TstComplThisOpCycle_Pass" 2 "CM_DCDC_NV_Komponentenfehler_22_Cx2_TstCmplThisCycle_Pass_TimeElapse" 3 "CM_DCDC_NV_Komponentenfehler_22_Cx3_TstComplThisOpCycle_FAIL" /end COMPU_VTAB
/begin COMPU_VTAB CM_DCDC_NV_Komponentenfehler_23 "" TAB_VERB 4 0 "CM_DCDC_NV_Komponentenfehler_23_Cx0_TstNotComplThisOpCycle_Init" 1 "CM_DCDC_NV_Komponentenfehler_23_Cx1_TstComplThisOpCycle_Pass" 2 "CM_DCDC_NV_Komponentenfehler_23_Cx2_TstCmplThisCycle_Pass_TimeElapse" 3 "CM_DCDC_NV_Komponentenfehler_23_Cx3_TstComplThisOpCycle_FAIL" /end COMPU_VTAB
/begin COMPU_VTAB CM_DCDC_NV_Komponentenfehler_24 "" TAB_VERB 4 0 "CM_DCDC_NV_Komponentenfehler_24_Cx0_TstNotComplThisOpCycle_Init" 1 "CM_DCDC_NV_Komponentenfehler_24_Cx1_TstComplThisOpCycle_Pass" 2 "CM_DCDC_NV_Komponentenfehler_24_Cx2_TstCmplThisCycle_Pass_TimeElapse" 3 "CM_DCDC_NV_Komponentenfehler_24_Cx3_TstComplThisOpCycle_FAIL" /end COMPU_VTAB
/begin COMPU_VTAB CM_DCDC_NV_Komponentenfehler_25 "" TAB_VERB 4 0 "CM_DCDC_NV_Komponentenfehler_25_Cx0_TstNotComplThisOpCycle_Init" 1 "CM_DCDC_NV_Komponentenfehler_25_Cx1_TstComplThisOpCycle_Pass" 2 "CM_DCDC_NV_Komponentenfehler_25_Cx2_TstCmplThisCycle_Pass_TimeElapse" 3 "CM_DCDC_NV_Komponentenfehler_25_Cx3_TstComplThisOpCycle_FAIL" /end COMPU_VTAB
/begin COMPU_VTAB CM_DCDC_NV_Komponentenfehler_26 "" TAB_VERB 4 0 "CM_DCDC_NV_Komponentenfehler_26_Cx0_TstNotComplThisOpCycle_Init" 1 "CM_DCDC_NV_Komponentenfehler_26_Cx1_TstComplThisOpCycle_Pass" 2 "CM_DCDC_NV_Komponentenfehler_26_Cx2_TstCmplThisCycle_Pass_TimeElapse" 3 "CM_DCDC_NV_Komponentenfehler_26_Cx3_TstComplThisOpCycle_FAIL" /end COMPU_VTAB
/begin COMPU_VTAB CM_DCDC_NV_Komponentenfehler_27 "" TAB_VERB 4 0 "CM_DCDC_NV_Komponentenfehler_27_Cx0_TstNotComplThisOpCycle_Init" 1 "CM_DCDC_NV_Komponentenfehler_27_Cx1_TstComplThisOpCycle_Pass" 2 "CM_DCDC_NV_Komponentenfehler_27_Cx2_TstCmplThisCycle_Pass_TimeElapse" 3 "CM_DCDC_NV_Komponentenfehler_27_Cx3_TstComplThisOpCycle_FAIL" /end COMPU_VTAB
/begin COMPU_VTAB CM_DCDC_NV_Komponentenfehler_28 "" TAB_VERB 4 0 "CM_DCDC_NV_Komponentenfehler_28_Cx0_TstNotComplThisOpCycle_Init" 1 "CM_DCDC_NV_Komponentenfehler_28_Cx1_TstComplThisOpCycle_Pass" 2 "CM_DCDC_NV_Komponentenfehler_28_Cx2_TstCmplThisCycle_Pass_TimeElapse" 3 "CM_DCDC_NV_Komponentenfehler_28_Cx3_TstComplThisOpCycle_FAIL" /end COMPU_VTAB
/begin COMPU_VTAB CM_DCDC_NV_Komponentenfehler_29 "" TAB_VERB 4 0 "CM_DCDC_NV_Komponentenfehler_29_Cx0_TstNotComplThisOpCycle_Init" 1 "CM_DCDC_NV_Komponentenfehler_29_Cx1_TstComplThisOpCycle_Pass" 2 "CM_DCDC_NV_Komponentenfehler_29_Cx2_TstCmplThisCycle_Pass_TimeElapse" 3 "CM_DCDC_NV_Komponentenfehler_29_Cx3_TstComplThisOpCycle_FAIL" /end COMPU_VTAB
/begin COMPU_VTAB CM_DCDC_NV_Komponentenfehler_30 "" TAB_VERB 4 0 "CM_DCDC_NV_Komponentenfehler_30_Cx0_TstNotComplThisOpCycle_Init" 1 "CM_DCDC_NV_Komponentenfehler_30_Cx1_TstComplThisOpCycle_Pass" 2 "CM_DCDC_NV_Komponentenfehler_30_Cx2_TstCmplThisCycle_Pass_TimeElapse" 3 "CM_DCDC_NV_Komponentenfehler_30_Cx3_TstComplThisOpCycle_FAIL" /end COMPU_VTAB
/begin COMPU_VTAB CM_DCDC_NV_Komponentenfehler_31 "" TAB_VERB 4 0 "CM_DCDC_NV_Komponentenfehler_31_Cx0_TstNotComplThisOpCycle_Init" 1 "CM_DCDC_NV_Komponentenfehler_31_Cx1_TstComplThisOpCycle_Pass" 2 "CM_DCDC_NV_Komponentenfehler_31_Cx2_TstCmplThisCycle_Pass_TimeElapse" 3 "CM_DCDC_NV_Komponentenfehler_31_Cx3_TstComplThisOpCycle_FAIL" /end COMPU_VTAB
/begin COMPU_VTAB CM_DCDC_NV_Komponentenfehler_32 "" TAB_VERB 4 0 "CM_DCDC_NV_Komponentenfehler_32_Cx0_TstNotComplThisOpCycle_Init" 1 "CM_DCDC_NV_Komponentenfehler_32_Cx1_TstComplThisOpCycle_Pass" 2 "CM_DCDC_NV_Komponentenfehler_32_Cx2_TstCmplThisCycle_Pass_TimeElapse" 3 "CM_DCDC_NV_Komponentenfehler_32_Cx3_TstComplThisOpCycle_FAIL" /end COMPU_VTAB
/begin COMPU_VTAB CM_DCDC_NV_Komponentenfehler_33 "" TAB_VERB 4 0 "CM_DCDC_NV_Komponentenfehler_33_Cx0_TstNotComplThisOpCycle_Init" 1 "CM_DCDC_NV_Komponentenfehler_33_Cx1_TstComplThisOpCycle_Pass" 2 "CM_DCDC_NV_Komponentenfehler_33_Cx2_TstCmplThisCycle_Pass_TimeElapse" 3 "CM_DCDC_NV_Komponentenfehler_33_Cx3_TstComplThisOpCycle_FAIL" /end COMPU_VTAB
/begin COMPU_VTAB CM_DCDC_NV_Komponentenfehler_34 "" TAB_VERB 4 0 "CM_DCDC_NV_Komponentenfehler_34_Cx0_TstNotComplThisOpCycle_Init" 1 "CM_DCDC_NV_Komponentenfehler_34_Cx1_TstComplThisOpCycle_Pass" 2 "CM_DCDC_NV_Komponentenfehler_34_Cx2_TstCmplThisCycle_Pass_TimeElapse" 3 "CM_DCDC_NV_Komponentenfehler_34_Cx3_TstComplThisOpCycle_FAIL" /end COMPU_VTAB
/begin COMPU_VTAB CM_DCDC_NV_Komponentenfehler_35 "" TAB_VERB 4 0 "CM_DCDC_NV_Komponentenfehler_35_Cx0_TstNotComplThisOpCycle_Init" 1 "CM_DCDC_NV_Komponentenfehler_35_Cx1_TstComplThisOpCycle_Pass" 2 "CM_DCDC_NV_Komponentenfehler_35_Cx2_TstCmplThisCycle_Pass_TimeElapse" 3 "CM_DCDC_NV_Komponentenfehler_35_Cx3_TstComplThisOpCycle_FAIL" /end COMPU_VTAB
/begin COMPU_VTAB CM_DCDC_NV_Komponentenfehler_36 "" TAB_VERB 4 0 "CM_DCDC_NV_Komponentenfehler_36_Cx0_TstNotComplThisOpCycle_Init" 1 "CM_DCDC_NV_Komponentenfehler_36_Cx1_TstComplThisOpCycle_Pass" 2 "CM_DCDC_NV_Komponentenfehler_36_Cx2_TstCmplThisCycle_Pass_TimeElapse" 3 "CM_DCDC_NV_Komponentenfehler_36_Cx3_TstComplThisOpCycle_FAIL" /end COMPU_VTAB
/begin COMPU_VTAB CM_DCDC_NV_Komponentenfehler_37 "" TAB_VERB 4 0 "CM_DCDC_NV_Komponentenfehler_37_Cx0_TstNotComplThisOpCycle_Init" 1 "CM_DCDC_NV_Komponentenfehler_37_Cx1_TstComplThisOpCycle_Pass" 2 "CM_DCDC_NV_Komponentenfehler_37_Cx2_TstCmplThisCycle_Pass_TimeElapse" 3 "CM_DCDC_NV_Komponentenfehler_37_Cx3_TstComplThisOpCycle_FAIL" /end COMPU_VTAB
/begin COMPU_VTAB CM_DCDC_NV_Komponentenfehler_38 "" TAB_VERB 4 0 "CM_DCDC_NV_Komponentenfehler_38_Cx0_TstNotComplThisOpCycle_Init" 1 "CM_DCDC_NV_Komponentenfehler_38_Cx1_TstComplThisOpCycle_Pass" 2 "CM_DCDC_NV_Komponentenfehler_38_Cx2_TstCmplThisCycle_Pass_TimeElapse" 3 "CM_DCDC_NV_Komponentenfehler_38_Cx3_TstComplThisOpCycle_FAIL" /end COMPU_VTAB
/begin COMPU_VTAB CM_DCDC_NV_Komponentenfehler_39 "" TAB_VERB 4 0 "CM_DCDC_NV_Komponentenfehler_39_Cx0_TstNotComplThisOpCycle_Init" 1 "CM_DCDC_NV_Komponentenfehler_39_Cx1_TstComplThisOpCycle_Pass" 2 "CM_DCDC_NV_Komponentenfehler_39_Cx2_TstCmplThisCycle_Pass_TimeElapse" 3 "CM_DCDC_NV_Komponentenfehler_39_Cx3_TstComplThisOpCycle_FAIL" /end COMPU_VTAB
/begin COMPU_VTAB CM_DCDC_NV_Komponentenfehler_3_1 "" TAB_VERB 8 0 "CM_DCDC_NV_Komponentenfehler_3_1_Cx0_TNCTOC" 1 "CM_DCDC_NV_Komponentenfehler_3_1_Cx1_TP_TC" 2 "CM_DCDC_NV_Komponentenfehler_3_1_Cx2_TP_TC_WCMTL" 3 "CM_DCDC_NV_Komponentenfehler_3_1_Cx3_TF_TC_Error_1" 4 "CM_DCDC_NV_Komponentenfehler_3_1_Cx4_TF_TC_Error_2" 5 "CM_DCDC_NV_Komponentenfehler_3_1_Cx5_TF_TC_Error_3" 6 "CM_DCDC_NV_Komponentenfehler_3_1_Cx6_TF_TC_Error_4" 7 "CM_DCDC_NV_Komponentenfehler_3_1_Cx7_TF_TC_Error_5" /end COMPU_VTAB
/begin COMPU_VTAB CM_DCDC_NV_Komponentenfehler_3_10 "" TAB_VERB 8 0 "CM_DCDC_NV_Komponentenfehler_3_10_Cx0_TNCTOC" 1 "CM_DCDC_NV_Komponentenfehler_3_10_Cx1_TP_TC" 2 "CM_DCDC_NV_Komponentenfehler_3_10_Cx2_TP_TC_WCMTL" 3 "CM_DCDC_NV_Komponentenfehler_3_10_Cx3_TF_TC_Error_1" 4 "CM_DCDC_NV_Komponentenfehler_3_10_Cx4_TF_TC_Error_2" 5 "CM_DCDC_NV_Komponentenfehler_3_10_Cx5_TF_TC_Error_3" 6 "CM_DCDC_NV_Komponentenfehler_3_10_Cx6_TF_TC_Error_4" 7 "CM_DCDC_NV_Komponentenfehler_3_10_Cx7_TF_TC_Error_5" /end COMPU_VTAB
/begin COMPU_VTAB CM_DCDC_NV_Komponentenfehler_3_11 "" TAB_VERB 8 0 "CM_DCDC_NV_Komponentenfehler_3_11_Cx0_TNCTOC" 1 "CM_DCDC_NV_Komponentenfehler_3_11_Cx1_TP_TC" 2 "CM_DCDC_NV_Komponentenfehler_3_11_Cx2_TP_TC_WCMTL" 3 "CM_DCDC_NV_Komponentenfehler_3_11_Cx3_TF_TC_Error_1" 4 "CM_DCDC_NV_Komponentenfehler_3_11_Cx4_TF_TC_Error_2" 5 "CM_DCDC_NV_Komponentenfehler_3_11_Cx5_TF_TC_Error_3" 6 "CM_DCDC_NV_Komponentenfehler_3_11_Cx6_TF_TC_Error_4" 7 "CM_DCDC_NV_Komponentenfehler_3_11_Cx7_TF_TC_Error_5" /end COMPU_VTAB
/begin COMPU_VTAB CM_DCDC_NV_Komponentenfehler_3_12 "" TAB_VERB 8 0 "CM_DCDC_NV_Komponentenfehler_3_12_Cx0_TNCTOC" 1 "CM_DCDC_NV_Komponentenfehler_3_12_Cx1_TP_TC" 2 "CM_DCDC_NV_Komponentenfehler_3_12_Cx2_TP_TC_WCMTL" 3 "CM_DCDC_NV_Komponentenfehler_3_12_Cx3_TF_TC_Error_1" 4 "CM_DCDC_NV_Komponentenfehler_3_12_Cx4_TF_TC_Error_2" 5 "CM_DCDC_NV_Komponentenfehler_3_12_Cx5_TF_TC_Error_3" 6 "CM_DCDC_NV_Komponentenfehler_3_12_Cx6_TF_TC_Error_4" 7 "CM_DCDC_NV_Komponentenfehler_3_12_Cx7_TF_TC_Error_5" /end COMPU_VTAB
/begin COMPU_VTAB CM_DCDC_NV_Komponentenfehler_3_13 "" TAB_VERB 8 0 "CM_DCDC_NV_Komponentenfehler_3_13_Cx0_TNCTOC" 1 "CM_DCDC_NV_Komponentenfehler_3_13_Cx1_TP_TC" 2 "CM_DCDC_NV_Komponentenfehler_3_13_Cx2_TP_TC_WCMTL" 3 "CM_DCDC_NV_Komponentenfehler_3_13_Cx3_TF_TC_Error_1" 4 "CM_DCDC_NV_Komponentenfehler_3_13_Cx4_TF_TC_Error_2" 5 "CM_DCDC_NV_Komponentenfehler_3_13_Cx5_TF_TC_Error_3" 6 "CM_DCDC_NV_Komponentenfehler_3_13_Cx6_TF_TC_Error_4" 7 "CM_DCDC_NV_Komponentenfehler_3_13_Cx7_TF_TC_Error_5" /end COMPU_VTAB
/begin COMPU_VTAB CM_DCDC_NV_Komponentenfehler_3_14 "" TAB_VERB 8 0 "CM_DCDC_NV_Komponentenfehler_3_14_Cx0_TNCTOC" 1 "CM_DCDC_NV_Komponentenfehler_3_14_Cx1_TP_TC" 2 "CM_DCDC_NV_Komponentenfehler_3_14_Cx2_TP_TC_WCMTL" 3 "CM_DCDC_NV_Komponentenfehler_3_14_Cx3_TF_TC_Error_1" 4 "CM_DCDC_NV_Komponentenfehler_3_14_Cx4_TF_TC_Error_2" 5 "CM_DCDC_NV_Komponentenfehler_3_14_Cx5_TF_TC_Error_3" 6 "CM_DCDC_NV_Komponentenfehler_3_14_Cx6_TF_TC_Error_4" 7 "CM_DCDC_NV_Komponentenfehler_3_14_Cx7_TF_TC_Error_5" /end COMPU_VTAB
/begin COMPU_VTAB CM_DCDC_NV_Komponentenfehler_3_15 "" TAB_VERB 8 0 "CM_DCDC_NV_Komponentenfehler_3_15_Cx0_TNCTOC" 1 "CM_DCDC_NV_Komponentenfehler_3_15_Cx1_TP_TC" 2 "CM_DCDC_NV_Komponentenfehler_3_15_Cx2_TP_TC_WCMTL" 3 "CM_DCDC_NV_Komponentenfehler_3_15_Cx3_TF_TC_Error_1" 4 "CM_DCDC_NV_Komponentenfehler_3_15_Cx4_TF_TC_Error_2" 5 "CM_DCDC_NV_Komponentenfehler_3_15_Cx5_TF_TC_Error_3" 6 "CM_DCDC_NV_Komponentenfehler_3_15_Cx6_TF_TC_Error_4" 7 "CM_DCDC_NV_Komponentenfehler_3_15_Cx7_TF_TC_Error_5" /end COMPU_VTAB
/begin COMPU_VTAB CM_DCDC_NV_Komponentenfehler_3_16 "" TAB_VERB 8 0 "CM_DCDC_NV_Komponentenfehler_3_16_Cx0_TNCTOC" 1 "CM_DCDC_NV_Komponentenfehler_3_16_Cx1_TP_TC" 2 "CM_DCDC_NV_Komponentenfehler_3_16_Cx2_TP_TC_WCMTL" 3 "CM_DCDC_NV_Komponentenfehler_3_16_Cx3_TF_TC_Error_1" 4 "CM_DCDC_NV_Komponentenfehler_3_16_Cx4_TF_TC_Error_2" 5 "CM_DCDC_NV_Komponentenfehler_3_16_Cx5_TF_TC_Error_3" 6 "CM_DCDC_NV_Komponentenfehler_3_16_Cx6_TF_TC_Error_4" 7 "CM_DCDC_NV_Komponentenfehler_3_16_Cx7_TF_TC_Error_5" /end COMPU_VTAB
/begin COMPU_VTAB CM_DCDC_NV_Komponentenfehler_3_2 "" TAB_VERB 8 0 "CM_DCDC_NV_Komponentenfehler_3_2_Cx0_TNCTOC" 1 "CM_DCDC_NV_Komponentenfehler_3_2_Cx1_TP_TC" 2 "CM_DCDC_NV_Komponentenfehler_3_2_Cx2_TP_TC_WCMTL" 3 "CM_DCDC_NV_Komponentenfehler_3_2_Cx3_TF_TC_Error_1" 4 "CM_DCDC_NV_Komponentenfehler_3_2_Cx4_TF_TC_Error_2" 5 "CM_DCDC_NV_Komponentenfehler_3_2_Cx5_TF_TC_Error_3" 6 "CM_DCDC_NV_Komponentenfehler_3_2_Cx6_TF_TC_Error_4" 7 "CM_DCDC_NV_Komponentenfehler_3_2_Cx7_TF_TC_Error_5" /end COMPU_VTAB
/begin COMPU_VTAB CM_DCDC_NV_Komponentenfehler_3_3 "" TAB_VERB 8 0 "CM_DCDC_NV_Komponentenfehler_3_3_Cx0_TNCTOC" 1 "CM_DCDC_NV_Komponentenfehler_3_3_Cx1_TP_TC" 2 "CM_DCDC_NV_Komponentenfehler_3_3_Cx2_TP_TC_WCMTL" 3 "CM_DCDC_NV_Komponentenfehler_3_3_Cx3_TF_TC_Error_1" 4 "CM_DCDC_NV_Komponentenfehler_3_3_Cx4_TF_TC_Error_2" 5 "CM_DCDC_NV_Komponentenfehler_3_3_Cx5_TF_TC_Error_3" 6 "CM_DCDC_NV_Komponentenfehler_3_3_Cx6_TF_TC_Error_4" 7 "CM_DCDC_NV_Komponentenfehler_3_3_Cx7_TF_TC_Error_5" /end COMPU_VTAB
/begin COMPU_VTAB CM_DCDC_NV_Komponentenfehler_3_4 "" TAB_VERB 8 0 "CM_DCDC_NV_Komponentenfehler_3_4_Cx0_TNCTOC" 1 "CM_DCDC_NV_Komponentenfehler_3_4_Cx1_TP_TC" 2 "CM_DCDC_NV_Komponentenfehler_3_4_Cx2_TP_TC_WCMTL" 3 "CM_DCDC_NV_Komponentenfehler_3_4_Cx3_TF_TC_Error_1" 4 "CM_DCDC_NV_Komponentenfehler_3_4_Cx4_TF_TC_Error_2" 5 "CM_DCDC_NV_Komponentenfehler_3_4_Cx5_TF_TC_Error_3" 6 "CM_DCDC_NV_Komponentenfehler_3_4_Cx6_TF_TC_Error_4" 7 "CM_DCDC_NV_Komponentenfehler_3_4_Cx7_TF_TC_Error_5" /end COMPU_VTAB
/begin COMPU_VTAB CM_DCDC_NV_Komponentenfehler_3_5 "" TAB_VERB 8 0 "CM_DCDC_NV_Komponentenfehler_3_5_Cx0_TNCTOC" 1 "CM_DCDC_NV_Komponentenfehler_3_5_Cx1_TP_TC" 2 "CM_DCDC_NV_Komponentenfehler_3_5_Cx2_TP_TC_WCMTL" 3 "CM_DCDC_NV_Komponentenfehler_3_5_Cx3_TF_TC_Error_1" 4 "CM_DCDC_NV_Komponentenfehler_3_5_Cx4_TF_TC_Error_2" 5 "CM_DCDC_NV_Komponentenfehler_3_5_Cx5_TF_TC_Error_3" 6 "CM_DCDC_NV_Komponentenfehler_3_5_Cx6_TF_TC_Error_4" 7 "CM_DCDC_NV_Komponentenfehler_3_5_Cx7_TF_TC_Error_5" /end COMPU_VTAB
/begin COMPU_VTAB CM_DCDC_NV_Komponentenfehler_3_6 "" TAB_VERB 8 0 "CM_DCDC_NV_Komponentenfehler_3_6_Cx0_TNCTOC" 1 "CM_DCDC_NV_Komponentenfehler_3_6_Cx1_TP_TC" 2 "CM_DCDC_NV_Komponentenfehler_3_6_Cx2_TP_TC_WCMTL" 3 "CM_DCDC_NV_Komponentenfehler_3_6_Cx3_TF_TC_Error_1" 4 "CM_DCDC_NV_Komponentenfehler_3_6_Cx4_TF_TC_Error_2" 5 "CM_DCDC_NV_Komponentenfehler_3_6_Cx5_TF_TC_Error_3" 6 "CM_DCDC_NV_Komponentenfehler_3_6_Cx6_TF_TC_Error_4" 7 "CM_DCDC_NV_Komponentenfehler_3_6_Cx7_TF_TC_Error_5" /end COMPU_VTAB
/begin COMPU_VTAB CM_DCDC_NV_Komponentenfehler_3_7 "" TAB_VERB 8 0 "CM_DCDC_NV_Komponentenfehler_3_7_Cx0_TNCTOC" 1 "CM_DCDC_NV_Komponentenfehler_3_7_Cx1_TP_TC" 2 "CM_DCDC_NV_Komponentenfehler_3_7_Cx2_TP_TC_WCMTL" 3 "CM_DCDC_NV_Komponentenfehler_3_7_Cx3_TF_TC_Error_1" 4 "CM_DCDC_NV_Komponentenfehler_3_7_Cx4_TF_TC_Error_2" 5 "CM_DCDC_NV_Komponentenfehler_3_7_Cx5_TF_TC_Error_3" 6 "CM_DCDC_NV_Komponentenfehler_3_7_Cx6_TF_TC_Error_4" 7 "CM_DCDC_NV_Komponentenfehler_3_7_Cx7_TF_TC_Error_5" /end COMPU_VTAB
/begin COMPU_VTAB CM_DCDC_NV_Komponentenfehler_3_8 "" TAB_VERB 8 0 "CM_DCDC_NV_Komponentenfehler_3_8_Cx0_TNCTOC" 1 "CM_DCDC_NV_Komponentenfehler_3_8_Cx1_TP_TC" 2 "CM_DCDC_NV_Komponentenfehler_3_8_Cx2_TP_TC_WCMTL" 3 "CM_DCDC_NV_Komponentenfehler_3_8_Cx3_TF_TC_Error_1" 4 "CM_DCDC_NV_Komponentenfehler_3_8_Cx4_TF_TC_Error_2" 5 "CM_DCDC_NV_Komponentenfehler_3_8_Cx5_TF_TC_Error_3" 6 "CM_DCDC_NV_Komponentenfehler_3_8_Cx6_TF_TC_Error_4" 7 "CM_DCDC_NV_Komponentenfehler_3_8_Cx7_TF_TC_Error_5" /end COMPU_VTAB
/begin COMPU_VTAB CM_DCDC_NV_Komponentenfehler_3_9 "" TAB_VERB 8 0 "CM_DCDC_NV_Komponentenfehler_3_9_Cx0_TNCTOC" 1 "CM_DCDC_NV_Komponentenfehler_3_9_Cx1_TP_TC" 2 "CM_DCDC_NV_Komponentenfehler_3_9_Cx2_TP_TC_WCMTL" 3 "CM_DCDC_NV_Komponentenfehler_3_9_Cx3_TF_TC_Error_1" 4 "CM_DCDC_NV_Komponentenfehler_3_9_Cx4_TF_TC_Error_2" 5 "CM_DCDC_NV_Komponentenfehler_3_9_Cx5_TF_TC_Error_3" 6 "CM_DCDC_NV_Komponentenfehler_3_9_Cx6_TF_TC_Error_4" 7 "CM_DCDC_NV_Komponentenfehler_3_9_Cx7_TF_TC_Error_5" /end COMPU_VTAB
/begin COMPU_VTAB CM_DCDC_NV_Komponentenfehler_40 "" TAB_VERB 4 0 "CM_DCDC_NV_Komponentenfehler_40_Cx0_TstNotComplThisOpCycle_Init" 1 "CM_DCDC_NV_Komponentenfehler_40_Cx1_TstComplThisOpCycle_Pass" 2 "CM_DCDC_NV_Komponentenfehler_40_Cx2_TstCmplThisCycle_Pass_TimeElapse" 3 "CM_DCDC_NV_Komponentenfehler_40_Cx3_TstComplThisOpCycle_FAIL" /end COMPU_VTAB
/begin COMPU_VTAB CM_DCDC_NV_Komponentenfehler_41 "" TAB_VERB 4 0 "CM_DCDC_NV_Komponentenfehler_41_Cx0_TstNotComplThisOpCycle_Init" 1 "CM_DCDC_NV_Komponentenfehler_41_Cx1_TstComplThisOpCycle_Pass" 2 "CM_DCDC_NV_Komponentenfehler_41_Cx2_TstCmplThisCycle_Pass_TimeElapse" 3 "CM_DCDC_NV_Komponentenfehler_41_Cx3_TstComplThisOpCycle_FAIL" /end COMPU_VTAB
/begin COMPU_VTAB CM_DCDC_NV_Komponentenfehler_42 "" TAB_VERB 4 0 "CM_DCDC_NV_Komponentenfehler_42_Cx0_TstNotComplThisOpCycle_Init" 1 "CM_DCDC_NV_Komponentenfehler_42_Cx1_TstComplThisOpCycle_Pass" 2 "CM_DCDC_NV_Komponentenfehler_42_Cx2_TstCmplThisCycle_Pass_TimeElapse" 3 "CM_DCDC_NV_Komponentenfehler_42_Cx3_TstComplThisOpCycle_FAIL" /end COMPU_VTAB
/begin COMPU_VTAB CM_DCDC_NV_Komponentenfehler_43 "" TAB_VERB 4 0 "CM_DCDC_NV_Komponentenfehler_43_Cx0_TstNotComplThisOpCycle_Init" 1 "CM_DCDC_NV_Komponentenfehler_43_Cx1_TstComplThisOpCycle_Pass" 2 "CM_DCDC_NV_Komponentenfehler_43_Cx2_TstCmplThisCycle_Pass_TimeElapse" 3 "CM_DCDC_NV_Komponentenfehler_43_Cx3_TstComplThisOpCycle_FAIL" /end COMPU_VTAB
/begin COMPU_VTAB CM_DCDC_NV_Komponentenfehler_44 "" TAB_VERB 4 0 "CM_DCDC_NV_Komponentenfehler_44_Cx0_TstNotComplThisOpCycle_Init" 1 "CM_DCDC_NV_Komponentenfehler_44_Cx1_TstComplThisOpCycle_Pass" 2 "CM_DCDC_NV_Komponentenfehler_44_Cx2_TstCmplThisCycle_Pass_TimeElapse" 3 "CM_DCDC_NV_Komponentenfehler_44_Cx3_TstComplThisOpCycle_FAIL" /end COMPU_VTAB
/begin COMPU_VTAB CM_DCDC_NV_Komponentenfehler_45 "" TAB_VERB 4 0 "CM_DCDC_NV_Komponentenfehler_45_Cx0_TstNotComplThisOpCycle_Init" 1 "CM_DCDC_NV_Komponentenfehler_45_Cx1_TstComplThisOpCycle_Pass" 2 "CM_DCDC_NV_Komponentenfehler_45_Cx2_TstCmplThisCycle_Pass_TimeElapse" 3 "CM_DCDC_NV_Komponentenfehler_45_Cx3_TstComplThisOpCycle_FAIL" /end COMPU_VTAB
/begin COMPU_VTAB CM_DCDC_NV_Komponentenfehler_46 "" TAB_VERB 4 0 "CM_DCDC_NV_Komponentenfehler_46_Cx0_TstNotComplThisOpCycle_Init" 1 "CM_DCDC_NV_Komponentenfehler_46_Cx1_TstComplThisOpCycle_Pass" 2 "CM_DCDC_NV_Komponentenfehler_46_Cx2_TstCmplThisCycle_Pass_TimeElapse" 3 "CM_DCDC_NV_Komponentenfehler_46_Cx3_TstComplThisOpCycle_FAIL" /end COMPU_VTAB
/begin COMPU_VTAB CM_DCDC_NV_Komponentenfehler_47 "" TAB_VERB 4 0 "CM_DCDC_NV_Komponentenfehler_47_Cx0_TstNotComplThisOpCycle_Init" 1 "CM_DCDC_NV_Komponentenfehler_47_Cx1_TstComplThisOpCycle_Pass" 2 "CM_DCDC_NV_Komponentenfehler_47_Cx2_TstCmplThisCycle_Pass_TimeElapse" 3 "CM_DCDC_NV_Komponentenfehler_47_Cx3_TstComplThisOpCycle_FAIL" /end COMPU_VTAB
/begin COMPU_VTAB CM_DCDC_NV_Komponentenfehler_48 "" TAB_VERB 4 0 "CM_DCDC_NV_Komponentenfehler_48_Cx0_TstNotComplThisOpCycle_Init" 1 "CM_DCDC_NV_Komponentenfehler_48_Cx1_TstComplThisOpCycle_Pass" 2 "CM_DCDC_NV_Komponentenfehler_48_Cx2_TstCmplThisCycle_Pass_TimeElapse" 3 "CM_DCDC_NV_Komponentenfehler_48_Cx3_TstComplThisOpCycle_FAIL" /end COMPU_VTAB
/begin COMPU_VTAB CM_DCDC_NV_Komponentenfehler_49 "" TAB_VERB 4 0 "CM_DCDC_NV_Komponentenfehler_49_Cx0_TstNotComplThisOpCycle_Init" 1 "CM_DCDC_NV_Komponentenfehler_49_Cx1_TstComplThisOpCycle_Pass" 2 "CM_DCDC_NV_Komponentenfehler_49_Cx2_TstCmplThisCycle_Pass_TimeElapse" 3 "CM_DCDC_NV_Komponentenfehler_49_Cx3_TstComplThisOpCycle_FAIL" /end COMPU_VTAB
/begin COMPU_VTAB CM_DCDC_NV_Komponentenfehler_50 "" TAB_VERB 4 0 "CM_DCDC_NV_Komponentenfehler_50_Cx0_TstNotComplThisOpCycle_Init" 1 "CM_DCDC_NV_Komponentenfehler_50_Cx1_TstComplThisOpCycle_Pass" 2 "CM_DCDC_NV_Komponentenfehler_50_Cx2_TstCmplThisCycle_Pass_TimeElapse" 3 "CM_DCDC_NV_Komponentenfehler_50_Cx3_TstComplThisOpCycle_FAIL" /end COMPU_VTAB
/begin COMPU_VTAB CM_DCDC_NV_Komponentenfehler_51 "" TAB_VERB 4 0 "CM_DCDC_NV_Komponentenfehler_51_Cx0_TstNotComplThisOpCycle_Init" 1 "CM_DCDC_NV_Komponentenfehler_51_Cx1_TstComplThisOpCycle_Pass" 2 "CM_DCDC_NV_Komponentenfehler_51_Cx2_TstCmplThisCycle_Pass_TimeElapse" 3 "CM_DCDC_NV_Komponentenfehler_51_Cx3_TstComplThisOpCycle_FAIL" /end COMPU_VTAB
/begin COMPU_VTAB CM_DCDC_NV_Komponentenfehler_52 "" TAB_VERB 4 0 "CM_DCDC_NV_Komponentenfehler_52_Cx0_TstNotComplThisOpCycle_Init" 1 "CM_DCDC_NV_Komponentenfehler_52_Cx1_TstComplThisOpCycle_Pass" 2 "CM_DCDC_NV_Komponentenfehler_52_Cx2_TstCmplThisCycle_Pass_TimeElapse" 3 "CM_DCDC_NV_Komponentenfehler_52_Cx3_TstComplThisOpCycle_FAIL" /end COMPU_VTAB
/begin COMPU_VTAB CM_DCDC_NV_Komponentenfehler_53 "" TAB_VERB 4 0 "CM_DCDC_NV_Komponentenfehler_53_Cx0_TstNotComplThisOpCycle_Init" 1 "CM_DCDC_NV_Komponentenfehler_53_Cx1_TstComplThisOpCycle_Pass" 2 "CM_DCDC_NV_Komponentenfehler_53_Cx2_TstCmplThisCycle_Pass_TimeElapse" 3 "CM_DCDC_NV_Komponentenfehler_53_Cx3_TstComplThisOpCycle_FAIL" /end COMPU_VTAB
/begin COMPU_VTAB CM_DCDC_NV_Komponentenfehler_54 "" TAB_VERB 4 0 "CM_DCDC_NV_Komponentenfehler_54_Cx0_TstNotComplThisOpCycle_Init" 1 "CM_DCDC_NV_Komponentenfehler_54_Cx1_TstComplThisOpCycle_Pass" 2 "CM_DCDC_NV_Komponentenfehler_54_Cx2_TstCmplThisCycle_Pass_TimeElapse" 3 "CM_DCDC_NV_Komponentenfehler_54_Cx3_TstComplThisOpCycle_FAIL" /end COMPU_VTAB
/begin COMPU_VTAB CM_DCDC_NV_Komponentenfehler_55 "" TAB_VERB 4 0 "CM_DCDC_NV_Komponentenfehler_55_Cx0_TstNotComplThisOpCycle_Init" 1 "CM_DCDC_NV_Komponentenfehler_55_Cx1_TstComplThisOpCycle_Pass" 2 "CM_DCDC_NV_Komponentenfehler_55_Cx2_TstCmplThisCycle_Pass_TimeElapse" 3 "CM_DCDC_NV_Komponentenfehler_55_Cx3_TstComplThisOpCycle_FAIL" /end COMPU_VTAB
/begin COMPU_VTAB CM_DCDC_NV_Komponentenfehler_56 "" TAB_VERB 4 0 "CM_DCDC_NV_Komponentenfehler_56_Cx0_TstNotComplThisOpCycle_Init" 1 "CM_DCDC_NV_Komponentenfehler_56_Cx1_TstComplThisOpCycle_Pass" 2 "CM_DCDC_NV_Komponentenfehler_56_Cx2_TstCmplThisCycle_Pass_TimeElapse" 3 "CM_DCDC_NV_Komponentenfehler_56_Cx3_TstComplThisOpCycle_FAIL" /end COMPU_VTAB
/begin COMPU_VTAB CM_DCDC_NV_Komponentenfehler_57 "" TAB_VERB 4 0 "CM_DCDC_NV_Komponentenfehler_57_Cx0_TstNotComplThisOpCycle_Init" 1 "CM_DCDC_NV_Komponentenfehler_57_Cx1_TstComplThisOpCycle_Pass" 2 "CM_DCDC_NV_Komponentenfehler_57_Cx2_TstCmplThisCycle_Pass_TimeElapse" 3 "CM_DCDC_NV_Komponentenfehler_57_Cx3_TstComplThisOpCycle_FAIL" /end COMPU_VTAB
/begin COMPU_VTAB CM_DCDC_NV_Komponentenfehler_58 "" TAB_VERB 4 0 "CM_DCDC_NV_Komponentenfehler_58_Cx0_TstNotComplThisOpCycle_Init" 1 "CM_DCDC_NV_Komponentenfehler_58_Cx1_TstComplThisOpCycle_Pass" 2 "CM_DCDC_NV_Komponentenfehler_58_Cx2_TstCmplThisCycle_Pass_TimeElapse" 3 "CM_DCDC_NV_Komponentenfehler_58_Cx3_TstComplThisOpCycle_FAIL" /end COMPU_VTAB
/begin COMPU_VTAB CM_DCDC_NV_Komponentenfehler_59 "" TAB_VERB 4 0 "CM_DCDC_NV_Komponentenfehler_59_Cx0_TstNotComplThisOpCycle_Init" 1 "CM_DCDC_NV_Komponentenfehler_59_Cx1_TstComplThisOpCycle_Pass" 2 "CM_DCDC_NV_Komponentenfehler_59_Cx2_TstCmplThisCycle_Pass_TimeElapse" 3 "CM_DCDC_NV_Komponentenfehler_59_Cx3_TstComplThisOpCycle_FAIL" /end COMPU_VTAB
/begin COMPU_VTAB_RANGE ComM_PncUserOfUserType "" 2 0 0 "FALSE" 1 255 "TRUE" /end COMPU_VTAB_RANGE
/begin COMPU_VTAB ComM_UserByteMaskEndIdxOfUserType "" TAB_VERB 1 255 "COMM_NO_USERBYTEMASKENDIDXOFUSER" /end COMPU_VTAB
/begin COMPU_VTAB ComM_UserByteMaskStartIdxOfUserType "" TAB_VERB 1 255 "COMM_NO_USERBYTEMASKSTARTIDXOFUSER" /end COMPU_VTAB
/begin COMPU_VTAB ComM_UserPncByteMaskEndIdxOfUserType "" TAB_VERB 1 255 "COMM_NO_USERPNCBYTEMASKENDIDXOFUSER" /end COMPU_VTAB
/begin COMPU_VTAB ComM_UserPncByteMaskStartIdxOfUserType "" TAB_VERB 1 255 "COMM_NO_USERPNCBYTEMASKSTARTIDXOFUSER" /end COMPU_VTAB
/begin COMPU_VTAB CompuMethod_EcuM_CurrentBootTarget_Values "" TAB_VERB 3 0 "ECUM_BOOT_TARGET_APP" 1 "ECUM_BOOT_TARGET_OEM_BOOTLOADER" 2 "ECUM_BOOT_TARGET_SYS_BOOTLOADER" /end COMPU_VTAB
/begin COMPU_VTAB CompuMethod_EcuM_ModuleState_Values "" TAB_VERB 22 16 "ECUM_STATE_STARTUP" 17 "ECUM_STATE_STARTUP_ONE" 18 "ECUM_STATE_STARTUP_TWO" 32 "ECUM_STATE_WAKEUP" 33 "ECUM_STATE_WAKEUP_ONE" 34 "ECUM_STATE_WAKEUP_VALIDATION" 35 "ECUM_STATE_WAKEUP_REACTION" 36 "ECUM_STATE_WAKEUP_TWO" 37 "ECUM_STATE_WAKEUP_WAKESLEEP" 38 "ECUM_STATE_WAKEUP_TTII" 48 "ECUM_STATE_RUN" 50 "ECUM_STATE_APP_RUN" 51 "ECUM_STATE_APP_POST_RUN" 64 "ECUM_STATE_SHUTDOWN" 68 "ECUM_STATE_PREP_SHUTDOWN" 73 "ECUM_STATE_GO_SLEEP" 77 "ECUM_STATE_GO_OFF_ONE" 78 "ECUM_STATE_GO_OFF_TWO" 80 "ECUM_STATE_SLEEP" 128 "ECUM_STATE_OFF" 144 "ECUM_STATE_RESET" 255 "ECUM_STATE_ERROR" /end COMPU_VTAB
/begin COMPU_VTAB Dbg_cmBoolean "" TAB_VERB 2 0 "FALSE" 1 "TRUE" /end COMPU_VTAB
/begin COMPU_VTAB EcuM_ComMChannelRefsEndIdxOfWakeupSourceListType "" TAB_VERB 1 255 "ECUM_NO_COMMCHANNELREFSENDIDXOFWAKEUPSOURCELIST" /end COMPU_VTAB
/begin COMPU_VTAB EcuM_ComMChannelRefsStartIdxOfWakeupSourceListType "" TAB_VERB 1 255 "ECUM_NO_COMMCHANNELREFSSTARTIDXOFWAKEUPSOURCELIST" /end COMPU_VTAB
/begin GROUP ComM ""
 /begin REF_MEASUREMENT ComM_UserByteMask[27].ClearMaskOfUserByteMask ComM_UserByteMask[27].SetMaskOfUserByteMask ComM_UserByteMask[27].UserReqFullComIdxOfUserByteMask ComM_UserByteMask[28].ChannelOfUserByteMask ComM_UserByteMask[28].ClearMaskOfUserByteMask ComM_UserByteMask[28].SetMaskOfUserByteMask ComM_UserByteMask[28].UserReqFullComIdxOfUserByteMask ComM_UserByteMask[29].ChannelOfUserByteMask ComM_UserByteMask[29].ClearMaskOfUserByteMask ComM_UserByteMask[29].SetMaskOfUserByteMask ComM_UserByteMask[29].UserReqFullComIdxOfUserByteMask ComM_UserByteMask[2].ChannelOfUserByteMask ComM_UserByteMask[2].ClearMaskOfUserByteMask ComM_UserByteMask[2].SetMaskOfUserByteMask ComM_UserByteMask[2].UserReqFullComIdxOfUserByteMask ComM_UserByteMask[30].ChannelOfUserByteMask ComM_UserByteMask[30].ClearMaskOfUserByteMask ComM_UserByteMask[30].SetMaskOfUserByteMask ComM_UserByteMask[30].UserReqFullComIdxOfUserByteMask ComM_UserByteMask[31].ChannelOfUserByteMask ComM_UserByteMask[31].ClearMaskOfUserByteMask ComM_UserByteMask[31].SetMaskOfUserByteMask ComM_UserByteMask[31].UserReqFullComIdxOfUserByteMask ComM_UserByteMask[32].ChannelOfUserByteMask ComM_UserByteMask[32].ClearMaskOfUserByteMask ComM_UserByteMask[32].SetMaskOfUserByteMask ComM_UserByteMask[32].UserReqFullComIdxOfUserByteMask ComM_UserByteMask[33].ChannelOfUserByteMask ComM_UserByteMask[33].ClearMaskOfUserByteMask ComM_UserByteMask[33].SetMaskOfUserByteMask ComM_UserByteMask[33].UserReqFullComIdxOfUserByteMask ComM_UserByteMask[34].ChannelOfUserByteMask ComM_UserByteMask[34].ClearMaskOfUserByteMask ComM_UserByteMask[34].SetMaskOfUserByteMask ComM_UserByteMask[34].UserReqFullComIdxOfUserByteMask ComM_UserByteMask[35].ChannelOfUserByteMask ComM_UserByteMask[35].ClearMaskOfUserByteMask ComM_UserByteMask[35].SetMaskOfUserByteMask ComM_UserByteMask[35].UserReqFullComIdxOfUserByteMask ComM_UserByteMask[36].ChannelOfUserByteMask ComM_UserByteMask[36].ClearMaskOfUserByteMask ComM_UserByteMask[36].SetMaskOfUserByteMask ComM_UserByteMask[36].UserReqFullComIdxOfUserByteMask ComM_UserByteMask[37].ChannelOfUserByteMask ComM_UserByteMask[37].ClearMaskOfUserByteMask ComM_UserByteMask[37].SetMaskOfUserByteMask ComM_UserByteMask[37].UserReqFullComIdxOfUserByteMask ComM_UserByteMask[38].ChannelOfUserByteMask ComM_UserByteMask[38].ClearMaskOfUserByteMask ComM_UserByteMask[38].SetMaskOfUserByteMask ComM_UserByteMask[38].UserReqFullComIdxOfUserByteMask ComM_UserByteMask[39].ChannelOfUserByteMask ComM_UserByteMask[39].ClearMaskOfUserByteMask ComM_UserByteMask[39].SetMaskOfUserByteMask ComM_UserByteMask[39].UserReqFullComIdxOfUserByteMask ComM_UserByteMask[3].ChannelOfUserByteMask ComM_UserByteMask[3].ClearMaskOfUserByteMask ComM_UserByteMask[3].SetMaskOfUserByteMask ComM_UserByteMask[3].UserReqFullComIdxOfUserByteMask ComM_UserByteMask[40].ChannelOfUserByteMask ComM_UserByteMask[40].ClearMaskOfUserByteMask ComM_UserByteMask[40].SetMaskOfUserByteMask ComM_UserByteMask[40].UserReqFullComIdxOfUserByteMask ComM_UserByteMask[41].ChannelOfUserByteMask ComM_UserByteMask[41].ClearMaskOfUserByteMask ComM_UserByteMask[41].SetMaskOfUserByteMask ComM_UserByteMask[41].UserReqFullComIdxOfUserByteMask ComM_UserByteMask[42].ChannelOfUserByteMask ComM_UserByteMask[42].ClearMaskOfUserByteMask ComM_UserByteMask[42].SetMaskOfUserByteMask ComM_UserByteMask[42].UserReqFullComIdxOfUserByteMask ComM_UserByteMask[43].ChannelOfUserByteMask ComM_UserByteMask[43].ClearMaskOfUserByteMask ComM_UserByteMask[43].SetMaskOfUserByteMask ComM_UserByteMask[43].UserReqFullComIdxOfUserByteMask ComM_UserByteMask[44].ChannelOfUserByteMask ComM_UserByteMask[44].ClearMaskOfUserByteMask ComM_UserByteMask[44].SetMaskOfUserByteMask ComM_UserByteMask[44].UserReqFullComIdxOfUserByteMask ComM_UserByteMask[45].ChannelOfUserByteMask ComM_UserByteMask[45].ClearMaskOfUserByteMask ComM_UserByteMask[45].SetMaskOfUserByteMask ComM_UserByteMask[45].UserReqFullComIdxOfUserByteMask ComM_UserByteMask[46].ChannelOfUserByteMask ComM_UserByteMask[46].ClearMaskOfUserByteMask ComM_UserByteMask[46].SetMaskOfUserByteMask ComM_UserByteMask[46].UserReqFullComIdxOfUserByteMask ComM_UserByteMask[47].ChannelOfUserByteMask ComM_UserByteMask[47].ClearMaskOfUserByteMask ComM_UserByteMask[47].SetMaskOfUserByteMask ComM_UserByteMask[47].UserReqFullComIdxOfUserByteMask ComM_UserByteMask[48].ChannelOfUserByteMask ComM_UserByteMask[48].ClearMaskOfUserByteMask ComM_UserByteMask[48].SetMaskOfUserByteMask ComM_UserByteMask[48].UserReqFullComIdxOfUserByteMask ComM_UserByteMask[49].ChannelOfUserByteMask ComM_UserByteMask[49].ClearMaskOfUserByteMask ComM_UserByteMask[49].SetMaskOfUserByteMask ComM_UserByteMask[49].UserReqFullComIdxOfUserByteMask ComM_UserByteMask[4].ChannelOfUserByteMask ComM_UserByteMask[4].ClearMaskOfUserByteMask ComM_UserByteMask[4].SetMaskOfUserByteMask ComM_UserByteMask[4].UserReqFullComIdxOfUserByteMask ComM_UserByteMask[5].ChannelOfUserByteMask ComM_UserByteMask[5].ClearMaskOfUserByteMask ComM_UserByteMask[5].SetMaskOfUserByteMask ComM_UserByteMask[5].UserReqFullComIdxOfUserByteMask ComM_UserByteMask[6].ChannelOfUserByteMask ComM_UserByteMask[6].ClearMaskOfUserByteMask ComM_UserByteMask[6].SetMaskOfUserByteMask ComM_UserByteMask[6].UserReqFullComIdxOfUserByteMask ComM_UserByteMask[7].ChannelOfUserByteMask ComM_UserByteMask[7].ClearMaskOfUserByteMask ComM_UserByteMask[7].SetMaskOfUserByteMask ComM_UserByteMask[7].UserReqFullComIdxOfUserByteMask ComM_UserByteMask[8].ChannelOfUserByteMask ComM_UserByteMask[8].ClearMaskOfUserByteMask ComM_UserByteMask[8].SetMaskOfUserByteMask ComM_UserByteMask[8].UserReqFullComIdxOfUserByteMask ComM_UserByteMask[9].ChannelOfUserByteMask ComM_UserByteMask[9].ClearMaskOfUserByteMask ComM_UserByteMask[9].SetMaskOfUserByteMask ComM_UserByteMask[9].UserReqFullComIdxOfUserByteMask ComM_UserPncByteMask[0].PncIDOfUserPncByteMask ComM_UserPncByteMask[0].PncIdxOfUserPncByteMask ComM_UserPncByteMask[0].UserReqPncFullComIdxOfUserPncByteMask ComM_UserPncByteMask[10].PncIDOfUserPncByteMask ComM_UserPncByteMask[10].PncIdxOfUserPncByteMask ComM_UserPncByteMask[10].UserReqPncFullComIdxOfUserPncByteMask ComM_UserPncByteMask[11].PncIDOfUserPncByteMask ComM_UserPncByteMask[11].PncIdxOfUserPncByteMask ComM_UserPncByteMask[11].UserReqPncFullComIdxOfUserPncByteMask ComM_UserPncByteMask[12].PncIDOfUserPncByteMask ComM_UserPncByteMask[12].PncIdxOfUserPncByteMask ComM_UserPncByteMask[12].UserReqPncFullComIdxOfUserPncByteMask ComM_UserPncByteMask[13].PncIDOfUserPncByteMask ComM_UserPncByteMask[13].PncIdxOfUserPncByteMask ComM_UserPncByteMask[13].UserReqPncFullComIdxOfUserPncByteMask ComM_UserPncByteMask[14].PncIDOfUserPncByteMask ComM_UserPncByteMask[14].PncIdxOfUserPncByteMask ComM_UserPncByteMask[14].UserReqPncFullComIdxOfUserPncByteMask ComM_UserPncByteMask[15].PncIDOfUserPncByteMask ComM_UserPncByteMask[15].PncIdxOfUserPncByteMask ComM_UserPncByteMask[15].UserReqPncFullComIdxOfUserPncByteMask ComM_UserPncByteMask[16].PncIDOfUserPncByteMask ComM_UserPncByteMask[16].PncIdxOfUserPncByteMask ComM_UserPncByteMask[16].UserReqPncFullComIdxOfUserPncByteMask ComM_UserPncByteMask[17].PncIDOfUserPncByteMask ComM_UserPncByteMask[17].PncIdxOfUserPncByteMask ComM_UserPncByteMask[17].UserReqPncFullComIdxOfUserPncByteMask ComM_UserPncByteMask[18].PncIDOfUserPncByteMask ComM_UserPncByteMask[18].PncIdxOfUserPncByteMask ComM_UserPncByteMask[18].UserReqPncFullComIdxOfUserPncByteMask ComM_UserPncByteMask[19].PncIDOfUserPncByteMask ComM_UserPncByteMask[19].PncIdxOfUserPncByteMask ComM_UserPncByteMask[19].UserReqPncFullComIdxOfUserPncByteMask ComM_UserPncByteMask[1].PncIDOfUserPncByteMask ComM_UserPncByteMask[1].PncIdxOfUserPncByteMask ComM_UserPncByteMask[1].UserReqPncFullComIdxOfUserPncByteMask ComM_UserPncByteMask[20].PncIDOfUserPncByteMask ComM_UserPncByteMask[20].PncIdxOfUserPncByteMask ComM_UserPncByteMask[20].UserReqPncFullComIdxOfUserPncByteMask ComM_UserPncByteMask[21].PncIDOfUserPncByteMask ComM_UserPncByteMask[21].PncIdxOfUserPncByteMask ComM_UserPncByteMask[21].UserReqPncFullComIdxOfUserPncByteMask ComM_UserPncByteMask[22].PncIDOfUserPncByteMask ComM_UserPncByteMask[22].PncIdxOfUserPncByteMask ComM_UserPncByteMask[22].UserReqPncFullComIdxOfUserPncByteMask ComM_UserPncByteMask[23].PncIDOfUserPncByteMask ComM_UserPncByteMask[23].PncIdxOfUserPncByteMask ComM_UserPncByteMask[23].UserReqPncFullComIdxOfUserPncByteMask ComM_UserPncByteMask[24].PncIDOfUserPncByteMask ComM_UserPncByteMask[24].PncIdxOfUserPncByteMask ComM_UserPncByteMask[24].UserReqPncFullComIdxOfUserPncByteMask ComM_UserPncByteMask[25].PncIDOfUserPncByteMask ComM_UserPncByteMask[25].PncIdxOfUserPncByteMask ComM_UserPncByteMask[25].UserReqPncFullComIdxOfUserPncByteMask ComM_UserPncByteMask[26].PncIDOfUserPncByteMask ComM_UserPncByteMask[26].PncIdxOfUserPncByteMask ComM_UserPncByteMask[26].UserReqPncFullComIdxOfUserPncByteMask ComM_UserPncByteMask[27].PncIDOfUserPncByteMask ComM_UserPncByteMask[27].PncIdxOfUserPncByteMask ComM_UserPncByteMask[27].UserReqPncFullComIdxOfUserPncByteMask ComM_UserPncByteMask[28].PncIDOfUserPncByteMask ComM_UserPncByteMask[28].PncIdxOfUserPncByteMask ComM_UserPncByteMask[28].UserReqPncFullComIdxOfUserPncByteMask ComM_UserPncByteMask[29].PncIDOfUserPncByteMask ComM_UserPncByteMask[29].PncIdxOfUserPncByteMask ComM_UserPncByteMask[29].UserReqPncFullComIdxOfUserPncByteMask ComM_UserPncByteMask[2].PncIDOfUserPncByteMask ComM_UserPncByteMask[2].PncIdxOfUserPncByteMask ComM_UserPncByteMask[2].UserReqPncFullComIdxOfUserPncByteMask ComM_UserPncByteMask[30].PncIDOfUserPncByteMask ComM_UserPncByteMask[30].PncIdxOfUserPncByteMask ComM_UserPncByteMask[30].UserReqPncFullComIdxOfUserPncByteMask ComM_UserPncByteMask[31].PncIDOfUserPncByteMask ComM_UserPncByteMask[31].PncIdxOfUserPncByteMask ComM_UserPncByteMask[31].UserReqPncFullComIdxOfUserPncByteMask ComM_UserPncByteMask[32].PncIDOfUserPncByteMask ComM_UserPncByteMask[32].PncIdxOfUserPncByteMask ComM_UserPncByteMask[32].UserReqPncFullComIdxOfUserPncByteMask ComM_UserPncByteMask[33].PncIDOfUserPncByteMask ComM_UserPncByteMask[33].PncIdxOfUserPncByteMask ComM_UserPncByteMask[33].UserReqPncFullComIdxOfUserPncByteMask ComM_UserPncByteMask[34].PncIDOfUserPncByteMask ComM_UserPncByteMask[34].PncIdxOfUserPncByteMask ComM_UserPncByteMask[34].UserReqPncFullComIdxOfUserPncByteMask ComM_UserPncByteMask[35].PncIDOfUserPncByteMask ComM_UserPncByteMask[35].PncIdxOfUserPncByteMask ComM_UserPncByteMask[35].UserReqPncFullComIdxOfUserPncByteMask ComM_UserPncByteMask[36].PncIDOfUserPncByteMask ComM_UserPncByteMask[36].PncIdxOfUserPncByteMask ComM_UserPncByteMask[36].UserReqPncFullComIdxOfUserPncByteMask ComM_UserPncByteMask[37].PncIDOfUserPncByteMask ComM_UserPncByteMask[37].PncIdxOfUserPncByteMask ComM_UserPncByteMask[37].UserReqPncFullComIdxOfUserPncByteMask ComM_UserPncByteMask[38].PncIDOfUserPncByteMask ComM_UserPncByteMask[38].PncIdxOfUserPncByteMask ComM_UserPncByteMask[38].UserReqPncFullComIdxOfUserPncByteMask ComM_UserPncByteMask[39].PncIDOfUserPncByteMask ComM_UserPncByteMask[39].PncIdxOfUserPncByteMask ComM_UserPncByteMask[39].UserReqPncFullComIdxOfUserPncByteMask ComM_UserPncByteMask[3].PncIDOfUserPncByteMask ComM_UserPncByteMask[3].PncIdxOfUserPncByteMask ComM_UserPncByteMask[3].UserReqPncFullComIdxOfUserPncByteMask ComM_UserPncByteMask[40].PncIDOfUserPncByteMask ComM_UserPncByteMask[40].PncIdxOfUserPncByteMask ComM_UserPncByteMask[40].UserReqPncFullComIdxOfUserPncByteMask ComM_UserPncByteMask[41].PncIDOfUserPncByteMask ComM_UserPncByteMask[41].PncIdxOfUserPncByteMask ComM_UserPncByteMask[41].UserReqPncFullComIdxOfUserPncByteMask ComM_UserPncByteMask[42].PncIDOfUserPncByteMask ComM_UserPncByteMask[42].PncIdxOfUserPncByteMask ComM_UserPncByteMask[42].UserReqPncFullComIdxOfUserPncByteMask ComM_UserPncByteMask[43].PncIDOfUserPncByteMask ComM_UserPncByteMask[43].PncIdxOfUserPncByteMask ComM_UserPncByteMask[43].UserReqPncFullComIdxOfUserPncByteMask ComM_UserPncByteMask[44].PncIDOfUserPncByteMask ComM_UserPncByteMask[44].PncIdxOfUserPncByteMask ComM_UserPncByteMask[44].UserReqPncFullComIdxOfUserPncByteMask ComM_UserPncByteMask[45].PncIDOfUserPncByteMask ComM_UserPncByteMask[45].PncIdxOfUserPncByteMask ComM_UserPncByteMask[45].UserReqPncFullComIdxOfUserPncByteMask ComM_UserPncByteMask[46].PncIDOfUserPncByteMask ComM_UserPncByteMask[46].PncIdxOfUserPncByteMask ComM_UserPncByteMask[46].UserReqPncFullComIdxOfUserPncByteMask ComM_UserPncByteMask[47].PncIDOfUserPncByteMask ComM_UserPncByteMask[47].PncIdxOfUserPncByteMask ComM_UserPncByteMask[47].UserReqPncFullComIdxOfUserPncByteMask ComM_UserPncByteMask[4].PncIDOfUserPncByteMask ComM_UserPncByteMask[4].PncIdxOfUserPncByteMask ComM_UserPncByteMask[4].UserReqPncFullComIdxOfUserPncByteMask ComM_UserPncByteMask[5].PncIDOfUserPncByteMask ComM_UserPncByteMask[5].PncIdxOfUserPncByteMask ComM_UserPncByteMask[5].UserReqPncFullComIdxOfUserPncByteMask ComM_UserPncByteMask[6].PncIDOfUserPncByteMask ComM_UserPncByteMask[6].PncIdxOfUserPncByteMask ComM_UserPncByteMask[6].UserReqPncFullComIdxOfUserPncByteMask ComM_UserPncByteMask[7].PncIDOfUserPncByteMask ComM_UserPncByteMask[7].PncIdxOfUserPncByteMask ComM_UserPncByteMask[7].UserReqPncFullComIdxOfUserPncByteMask ComM_UserPncByteMask[8].PncIDOfUserPncByteMask ComM_UserPncByteMask[8].PncIdxOfUserPncByteMask ComM_UserPncByteMask[8].UserReqPncFullComIdxOfUserPncByteMask ComM_UserPncByteMask[9].PncIDOfUserPncByteMask ComM_UserPncByteMask[9].PncIdxOfUserPncByteMask ComM_UserPncByteMask[9].UserReqPncFullComIdxOfUserPncByteMask ComM_UserReqFullCom ComM_UserReqPncFullCom ComM_User[0].PncUserOfUser ComM_User[0].UserByteMaskEndIdxOfUser ComM_User[0].UserByteMaskStartIdxOfUser ComM_User[0].UserPncByteMaskEndIdxOfUser ComM_User[0].UserPncByteMaskLengthOfUser ComM_User[0].UserPncByteMaskStartIdxOfUser ComM_User[10].PncUserOfUser ComM_User[10].UserByteMaskEndIdxOfUser ComM_User[10].UserByteMaskStartIdxOfUser ComM_User[10].UserPncByteMaskEndIdxOfUser ComM_User[10].UserPncByteMaskLengthOfUser ComM_User[10].UserPncByteMaskStartIdxOfUser ComM_User[11].PncUserOfUser ComM_User[11].UserByteMaskEndIdxOfUser ComM_User[11].UserByteMaskStartIdxOfUser ComM_User[11].UserPncByteMaskEndIdxOfUser ComM_User[11].UserPncByteMaskLengthOfUser ComM_User[11].UserPncByteMaskStartIdxOfUser ComM_User[12].PncUserOfUser ComM_User[12].UserByteMaskEndIdxOfUser ComM_User[12].UserByteMaskStartIdxOfUser ComM_User[12].UserPncByteMaskEndIdxOfUser ComM_User[12].UserPncByteMaskLengthOfUser ComM_User[12].UserPncByteMaskStartIdxOfUser ComM_User[13].PncUserOfUser ComM_User[13].UserByteMaskEndIdxOfUser ComM_User[13].UserByteMaskStartIdxOfUser ComM_User[13].UserPncByteMaskEndIdxOfUser ComM_User[13].UserPncByteMaskLengthOfUser ComM_User[13].UserPncByteMaskStartIdxOfUser ComM_User[14].PncUserOfUser ComM_User[14].UserByteMaskEndIdxOfUser ComM_User[14].UserByteMaskStartIdxOfUser ComM_User[14].UserPncByteMaskEndIdxOfUser ComM_User[14].UserPncByteMaskLengthOfUser ComM_User[14].UserPncByteMaskStartIdxOfUser ComM_User[15].PncUserOfUser ComM_User[15].UserByteMaskEndIdxOfUser ComM_User[15].UserByteMaskStartIdxOfUser ComM_User[15].UserPncByteMaskEndIdxOfUser ComM_User[15].UserPncByteMaskLengthOfUser ComM_User[15].UserPncByteMaskStartIdxOfUser ComM_User[16].PncUserOfUser ComM_User[16].UserByteMaskEndIdxOfUser ComM_User[16].UserByteMaskStartIdxOfUser ComM_User[16].UserPncByteMaskEndIdxOfUser ComM_User[16].UserPncByteMaskLengthOfUser ComM_User[16].UserPncByteMaskStartIdxOfUser ComM_User[17].PncUserOfUser ComM_User[17].UserByteMaskEndIdxOfUser ComM_User[17].UserByteMaskStartIdxOfUser ComM_User[17].UserPncByteMaskEndIdxOfUser ComM_User[17].UserPncByteMaskLengthOfUser ComM_User[17].UserPncByteMaskStartIdxOfUser ComM_User[18].PncUserOfUser ComM_User[18].UserByteMaskEndIdxOfUser ComM_User[18].UserByteMaskStartIdxOfUser ComM_User[18].UserPncByteMaskEndIdxOfUser ComM_User[18].UserPncByteMaskLengthOfUser ComM_User[18].UserPncByteMaskStartIdxOfUser ComM_User[19].PncUserOfUser ComM_User[19].UserByteMaskEndIdxOfUser ComM_User[19].UserByteMaskStartIdxOfUser ComM_User[19].UserPncByteMaskEndIdxOfUser ComM_User[19].UserPncByteMaskLengthOfUser ComM_User[19].UserPncByteMaskStartIdxOfUser ComM_User[1].PncUserOfUser ComM_User[1].UserByteMaskEndIdxOfUser ComM_User[1].UserByteMaskStartIdxOfUser ComM_User[1].UserPncByteMaskEndIdxOfUser ComM_User[1].UserPncByteMaskLengthOfUser ComM_User[1].UserPncByteMaskStartIdxOfUser ComM_User[20].PncUserOfUser ComM_User[20].UserByteMaskEndIdxOfUser ComM_User[20].UserByteMaskStartIdxOfUser ComM_User[20].UserPncByteMaskEndIdxOfUser ComM_User[20].UserPncByteMaskLengthOfUser ComM_User[20].UserPncByteMaskStartIdxOfUser ComM_User[21].PncUserOfUser ComM_User[21].UserByteMaskEndIdxOfUser ComM_User[21].UserByteMaskStartIdxOfUser ComM_User[21].UserPncByteMaskEndIdxOfUser ComM_User[21].UserPncByteMaskLengthOfUser ComM_User[21].UserPncByteMaskStartIdxOfUser ComM_User[22].PncUserOfUser ComM_User[22].UserByteMaskEndIdxOfUser ComM_User[22].UserByteMaskStartIdxOfUser ComM_User[22].UserPncByteMaskEndIdxOfUser ComM_User[22].UserPncByteMaskLengthOfUser ComM_User[22].UserPncByteMaskStartIdxOfUser ComM_User[23].PncUserOfUser ComM_User[23].UserByteMaskEndIdxOfUser ComM_User[23].UserByteMaskStartIdxOfUser ComM_User[23].UserPncByteMaskEndIdxOfUser ComM_User[23].UserPncByteMaskLengthOfUser ComM_User[23].UserPncByteMaskStartIdxOfUser ComM_User[24].PncUserOfUser ComM_User[24].UserByteMaskEndIdxOfUser ComM_User[24].UserByteMaskStartIdxOfUser ComM_User[24].UserPncByteMaskEndIdxOfUser ComM_User[24].UserPncByteMaskLengthOfUser ComM_User[24].UserPncByteMaskStartIdxOfUser ComM_User[25].PncUserOfUser ComM_User[25].UserByteMaskEndIdxOfUser ComM_User[25].UserByteMaskStartIdxOfUser ComM_User[25].UserPncByteMaskEndIdxOfUser ComM_User[25].UserPncByteMaskLengthOfUser ComM_User[25].UserPncByteMaskStartIdxOfUser ComM_User[26].PncUserOfUser ComM_User[26].UserByteMaskEndIdxOfUser ComM_User[26].UserByteMaskStartIdxOfUser ComM_User[26].UserPncByteMaskEndIdxOfUser ComM_User[26].UserPncByteMaskLengthOfUser ComM_User[26].UserPncByteMaskStartIdxOfUser ComM_User[27].PncUserOfUser ComM_User[27].UserByteMaskEndIdxOfUser ComM_User[27].UserByteMaskStartIdxOfUser ComM_User[27].UserPncByteMaskEndIdxOfUser ComM_User[27].UserPncByteMaskLengthOfUser ComM_User[27].UserPncByteMaskStartIdxOfUser ComM_User[28].PncUserOfUser ComM_User[28].UserByteMaskEndIdxOfUser ComM_User[28].UserByteMaskStartIdxOfUser ComM_User[28].UserPncByteMaskEndIdxOfUser ComM_User[28].UserPncByteMaskLengthOfUser ComM_User[28].UserPncByteMaskStartIdxOfUser ComM_User[29].PncUserOfUser ComM_User[29].UserByteMaskEndIdxOfUser ComM_User[29].UserByteMaskStartIdxOfUser ComM_User[29].UserPncByteMaskEndIdxOfUser ComM_User[29].UserPncByteMaskLengthOfUser ComM_User[29].UserPncByteMaskStartIdxOfUser ComM_User[2].PncUserOfUser ComM_User[2].UserByteMaskEndIdxOfUser ComM_User[2].UserByteMaskStartIdxOfUser ComM_User[2].UserPncByteMaskEndIdxOfUser ComM_User[2].UserPncByteMaskLengthOfUser ComM_User[2].UserPncByteMaskStartIdxOfUser ComM_User[30].PncUserOfUser ComM_User[30].UserByteMaskEndIdxOfUser ComM_User[30].UserByteMaskStartIdxOfUser ComM_User[30].UserPncByteMaskEndIdxOfUser ComM_User[30].UserPncByteMaskLengthOfUser ComM_User[30].UserPncByteMaskStartIdxOfUser ComM_User[31].PncUserOfUser ComM_User[31].UserByteMaskEndIdxOfUser ComM_User[31].UserByteMaskStartIdxOfUser ComM_User[31].UserPncByteMaskEndIdxOfUser ComM_User[31].UserPncByteMaskLengthOfUser ComM_User[31].UserPncByteMaskStartIdxOfUser ComM_User[32].PncUserOfUser ComM_User[32].UserByteMaskEndIdxOfUser ComM_User[32].UserByteMaskStartIdxOfUser ComM_User[32].UserPncByteMaskEndIdxOfUser ComM_User[32].UserPncByteMaskLengthOfUser ComM_User[32].UserPncByteMaskStartIdxOfUser ComM_User[33].PncUserOfUser ComM_User[33].UserByteMaskEndIdxOfUser ComM_User[33].UserByteMaskStartIdxOfUser ComM_User[33].UserPncByteMaskEndIdxOfUser ComM_User[33].UserPncByteMaskLengthOfUser ComM_User[33].UserPncByteMaskStartIdxOfUser ComM_User[34].PncUserOfUser ComM_User[34].UserByteMaskEndIdxOfUser ComM_User[34].UserByteMaskStartIdxOfUser ComM_User[34].UserPncByteMaskEndIdxOfUser ComM_User[34].UserPncByteMaskLengthOfUser ComM_User[34].UserPncByteMaskStartIdxOfUser ComM_User[35].PncUserOfUser ComM_User[35].UserByteMaskEndIdxOfUser ComM_User[35].UserByteMaskStartIdxOfUser ComM_User[35].UserPncByteMaskEndIdxOfUser ComM_User[35].UserPncByteMaskLengthOfUser ComM_User[35].UserPncByteMaskStartIdxOfUser ComM_User[36].PncUserOfUser ComM_User[36].UserByteMaskEndIdxOfUser ComM_User[36].UserByteMaskStartIdxOfUser ComM_User[36].UserPncByteMaskEndIdxOfUser ComM_User[36].UserPncByteMaskLengthOfUser ComM_User[36].UserPncByteMaskStartIdxOfUser ComM_User[37].PncUserOfUser ComM_User[37].UserByteMaskEndIdxOfUser ComM_User[37].UserByteMaskStartIdxOfUser ComM_User[37].UserPncByteMaskEndIdxOfUser ComM_User[37].UserPncByteMaskLengthOfUser ComM_User[37].UserPncByteMaskStartIdxOfUser ComM_User[38].PncUserOfUser ComM_User[38].UserByteMaskEndIdxOfUser ComM_User[38].UserByteMaskStartIdxOfUser ComM_User[38].UserPncByteMaskEndIdxOfUser ComM_User[38].UserPncByteMaskLengthOfUser ComM_User[38].UserPncByteMaskStartIdxOfUser ComM_User[39].PncUserOfUser ComM_User[39].UserByteMaskEndIdxOfUser ComM_User[39].UserByteMaskStartIdxOfUser ComM_User[39].UserPncByteMaskEndIdxOfUser ComM_User[39].UserPncByteMaskLengthOfUser ComM_User[39].UserPncByteMaskStartIdxOfUser ComM_User[3].PncUserOfUser ComM_User[3].UserByteMaskEndIdxOfUser ComM_User[3].UserByteMaskStartIdxOfUser ComM_User[3].UserPncByteMaskEndIdxOfUser ComM_User[3].UserPncByteMaskLengthOfUser ComM_User[3].UserPncByteMaskStartIdxOfUser ComM_User[40].PncUserOfUser ComM_User[40].UserByteMaskEndIdxOfUser ComM_User[40].UserByteMaskStartIdxOfUser ComM_User[40].UserPncByteMaskEndIdxOfUser ComM_User[40].UserPncByteMaskLengthOfUser ComM_User[40].UserPncByteMaskStartIdxOfUser ComM_User[41].PncUserOfUser ComM_User[41].UserByteMaskEndIdxOfUser ComM_User[41].UserByteMaskStartIdxOfUser ComM_User[41].UserPncByteMaskEndIdxOfUser ComM_User[41].UserPncByteMaskLengthOfUser ComM_User[41].UserPncByteMaskStartIdxOfUser ComM_User[42].PncUserOfUser ComM_User[42].UserByteMaskEndIdxOfUser ComM_User[42].UserByteMaskStartIdxOfUser ComM_User[42].UserPncByteMaskEndIdxOfUser ComM_User[42].UserPncByteMaskLengthOfUser ComM_User[42].UserPncByteMaskStartIdxOfUser ComM_User[43].PncUserOfUser ComM_User[43].UserByteMaskEndIdxOfUser ComM_User[43].UserByteMaskStartIdxOfUser ComM_User[43].UserPncByteMaskEndIdxOfUser ComM_User[43].UserPncByteMaskLengthOfUser ComM_User[43].UserPncByteMaskStartIdxOfUser ComM_User[44].PncUserOfUser ComM_User[44].UserByteMaskEndIdxOfUser ComM_User[44].UserByteMaskStartIdxOfUser ComM_User[44].UserPncByteMaskEndIdxOfUser ComM_User[44].UserPncByteMaskLengthOfUser ComM_User[44].UserPncByteMaskStartIdxOfUser ComM_User[45].PncUserOfUser ComM_User[45].UserByteMaskEndIdxOfUser ComM_User[45].UserByteMaskStartIdxOfUser ComM_User[45].UserPncByteMaskEndIdxOfUser ComM_User[45].UserPncByteMaskLengthOfUser ComM_User[45].UserPncByteMaskStartIdxOfUser ComM_User[46].PncUserOfUser ComM_User[46].UserByteMaskEndIdxOfUser ComM_User[46].UserByteMaskStartIdxOfUser ComM_User[46].UserPncByteMaskEndIdxOfUser ComM_User[46].UserPncByteMaskLengthOfUser ComM_User[46].UserPncByteMaskStartIdxOfUser ComM_User[47].PncUserOfUser ComM_User[47].UserByteMaskEndIdxOfUser ComM_User[47].UserByteMaskStartIdxOfUser ComM_User[47].UserPncByteMaskEndIdxOfUser ComM_User[47].UserPncByteMaskLengthOfUser ComM_User[47].UserPncByteMaskStartIdxOfUser ComM_User[48].PncUserOfUser ComM_User[48].UserByteMaskEndIdxOfUser ComM_User[48].UserByteMaskStartIdxOfUser ComM_User[48].UserPncByteMaskEndIdxOfUser ComM_User[48].UserPncByteMaskLengthOfUser ComM_User[48].UserPncByteMaskStartIdxOfUser ComM_User[49].PncUserOfUser ComM_User[49].UserByteMaskEndIdxOfUser ComM_User[49].UserByteMaskStartIdxOfUser ComM_User[49].UserPncByteMaskEndIdxOfUser ComM_User[49].UserPncByteMaskLengthOfUser ComM_User[49].UserPncByteMaskStartIdxOfUser ComM_User[4].PncUserOfUser ComM_User[4].UserByteMaskEndIdxOfUser ComM_User[4].UserByteMaskStartIdxOfUser ComM_User[4].UserPncByteMaskEndIdxOfUser ComM_User[4].UserPncByteMaskLengthOfUser ComM_User[4].UserPncByteMaskStartIdxOfUser ComM_User[5].PncUserOfUser ComM_User[5].UserByteMaskEndIdxOfUser ComM_User[5].UserByteMaskStartIdxOfUser ComM_User[5].UserPncByteMaskEndIdxOfUser ComM_User[5].UserPncByteMaskLengthOfUser ComM_User[5].UserPncByteMaskStartIdxOfUser ComM_User[6].PncUserOfUser ComM_User[6].UserByteMaskEndIdxOfUser ComM_User[6].UserByteMaskStartIdxOfUser ComM_User[6].UserPncByteMaskEndIdxOfUser ComM_User[6].UserPncByteMaskLengthOfUser ComM_User[6].UserPncByteMaskStartIdxOfUser ComM_User[7].PncUserOfUser ComM_User[7].UserByteMaskEndIdxOfUser ComM_User[7].UserByteMaskStartIdxOfUser ComM_User[7].UserPncByteMaskEndIdxOfUser ComM_User[7].UserPncByteMaskLengthOfUser ComM_User[7].UserPncByteMaskStartIdxOfUser ComM_User[8].PncUserOfUser ComM_User[8].UserByteMaskEndIdxOfUser ComM_User[8].UserByteMaskStartIdxOfUser ComM_User[8].UserPncByteMaskEndIdxOfUser ComM_User[8].UserPncByteMaskLengthOfUser ComM_User[8].UserPncByteMaskStartIdxOfUser ComM_User[9].PncUserOfUser ComM_User[9].UserByteMaskEndIdxOfUser ComM_User[9].UserByteMaskStartIdxOfUser ComM_User[9].UserPncByteMaskEndIdxOfUser ComM_User[9].UserPncByteMaskLengthOfUser ComM_User[9].UserPncByteMaskStartIdxOfUser /end REF_MEASUREMENT
/end GROUP
/begin GROUP Dbg ""
 /begin REF_MEASUREMENT Dbg_BswBackgroundTask.Activation Dbg_BswBackgroundTask.CollectionFrequency Dbg_BswBackgroundTask.dbgosGetStackUsage Dbg_CounterIsr_SystemTimer.Activation Dbg_CounterIsr_SystemTimer.CollectionFrequency Dbg_CounterIsr_SystemTimer.dbgDbgStaticDIDData Dbg_Default_Appl_Init_Task.Activation Dbg_Default_Appl_Init_Task.CollectionFrequency Dbg_Default_Appl_Init_Task.dbgosGetStackUsage Dbg_Default_Appl_Task.Activation Dbg_Default_Appl_Task.CollectionFrequency Dbg_Default_Appl_Task.dbgosGetStackUsage Dbg_Default_BSW_Async_Task.Activation Dbg_Default_BSW_Async_Task.CollectionFrequency Dbg_Default_BSW_Async_Task.dbgosGetStackUsage Dbg_Default_BSW_Sync_Task.Activation Dbg_Default_BSW_Sync_Task.CollectionFrequency Dbg_Default_BSW_Sync_Task.dbgosGetStackUsage Dbg_Default_Init_Task.Activation Dbg_Default_Init_Task.CollectionFrequency Dbg_Default_Init_Task.dbgosGetStackUsage Dbg_Default_RTE_Mode_switch_Task.Activation Dbg_Default_RTE_Mode_switch_Task.CollectionFrequency Dbg_Default_RTE_Mode_switch_Task.dbgosGetStackUsage Dbg_IdleTask_OsCore0.Activation Dbg_IdleTask_OsCore0.CollectionFrequency Dbg_IdleTask_OsCore0.dbgosGetStackUsage Dbg_StartApplication_Appl_Init_Task.Activation Dbg_StartApplication_Appl_Init_Task.CollectionFrequency Dbg_StartApplication_Appl_Init_Task.dbgosGetStackUsage Dbg_StartApplication_Appl_Task.Activation Dbg_StartApplication_Appl_Task.CollectionFrequency Dbg_StartApplication_Appl_Task.dbgosGetStackUsage Dbg_StartApplication_NoSwc_Appl_Task.Activation Dbg_StartApplication_NoSwc_Appl_Task.CollectionFrequency Dbg_StartApplication_NoSwc_Appl_Task.dbgosGetStackUsage Dbg_StartApplication_NoSwc_Init_Task.Activation Dbg_StartApplication_NoSwc_Init_Task.CollectionFrequency Dbg_StartApplication_NoSwc_Init_Task.dbgosGetStackUsage /end REF_MEASUREMENT
/end GROUP
/begin GROUP EcuM ""
 /begin REF_MEASUREMENT EcuM_ComMChannelRefs[0].ChannelOfComMChannelRefs EcuM_ComMChannelRefs[1].ChannelOfComMChannelRefs EcuM_CurrentBootTarget EcuM_CurrentShutdownMode EcuM_CurrentShutdownTarget EcuM_ExpiredWakeups EcuM_LastShutdownMode EcuM_LastShutdownTarget EcuM_ModuleState EcuM_PartitionData[0].ApplicationOfPartitionData EcuM_PartitionData[1].ApplicationOfPartitionData EcuM_PendingCheckWakeups EcuM_PendingWakeups EcuM_PostRunRequestCounter EcuM_RunRequestCounter EcuM_ShutdownCause EcuM_ValidatedWakeups EcuM_WakeupSourceList[0].ComMChannelRefsEndIdxOfWakeupSourceList EcuM_WakeupSourceList[0].ComMChannelRefsStartIdxOfWakeupSourceList EcuM_WakeupSourceList[1].ComMChannelRefsEndIdxOfWakeupSourceList EcuM_WakeupSourceList[1].ComMChannelRefsStartIdxOfWakeupSourceList EcuM_WakeupSourceList[2].ComMChannelRefsEndIdxOfWakeupSourceList EcuM_WakeupSourceList[2].ComMChannelRefsStartIdxOfWakeupSourceList EcuM_WakeupSourceList[3].ComMChannelRefsEndIdxOfWakeupSourceList EcuM_WakeupSourceList[3].ComMChannelRefsStartIdxOfWakeupSourceList EcuM_WakeupSourceList[4].ComMChannelRefsEndIdxOfWakeupSourceList EcuM_WakeupSourceList[4].ComMChannelRefsStartIdxOfWakeupSourceList EcuM_WakeupSourceList[5].ComMChannelRefsEndIdxOfWakeupSourceList EcuM_WakeupSourceList[5].ComMChannelRefsStartIdxOfWakeupSourceList EcuM_WakeupSourceList[6].ComMChannelRefsEndIdxOfWakeupSourceList EcuM_WakeupSourceList[6].ComMChannelRefsStartIdxOfWakeupSourceList /end REF_MEASUREMENT
/end GROUP
/end MODULE
/end PROJECT
