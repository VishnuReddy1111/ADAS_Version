ASAP2_VERSION 1 71
/begin PROJECT MICROSAR ""
/begin MODULE CPP ""
/begin MOD_COMMON "" BYTE_ORDER MSB_LAST ALIGNMENT_BYTE 1 ALIGNMENT_WORD 2 ALIGNMENT_LONG 4 ALIGNMENT_FLOAT16_IEEE 2 ALIGNMENT_FLOAT32_IEEE 4 ALIGNMENT_FLOAT64_IEEE 8 ALIGNMENT_INT64 8 /end MOD_COMMON
/begin MEASUREMENT Com_RxPduInfo[57].RxDefPduBufferStartIdxOfRxPduInfo "" UWORD Com_RxDefPduBufferStartIdxOfRxPduInfoType 0 0 0 65535 ECU_ADDRESS 0x0 /end MEASUREMENT
/begin MEASUREMENT Com_RxPduInfo[57].RxPduCalloutFuncPtrIdxOfRxPduInfo "" UBYTE Com_RxPduCalloutFuncPtrIdxOfRxPduInfoType 0 0 0 255 ECU_ADDRESS 0x0 /end MEASUREMENT
/begin MEASUREMENT Com_RxPduInfo[57].RxSigGrpInfoIndEndIdxOfRxPduInfo "" UBYTE Com_RxSigGrpInfoIndEndIdxOfRxPduInfoType 0 0 0 255 ECU_ADDRESS 0x0 /end MEASUREMENT
/begin MEASUREMENT Com_RxPduInfo[57].RxSigGrpInfoIndStartIdxOfRxPduInfo "" UBYTE Com_RxSigGrpInfoIndStartIdxOfRxPduInfoType 0 0 0 255 ECU_ADDRESS 0x0 /end MEASUREMENT
/begin MEASUREMENT Com_RxPduInfo[57].RxSigInfoEndIdxOfRxPduInfo "" UWORD Com_RxSigInfoEndIdxOfRxPduInfoType 0 0 0 65535 ECU_ADDRESS 0x0 /end MEASUREMENT
/begin MEASUREMENT Com_RxPduInfo[57].RxSigInfoStartIdxOfRxPduInfo "" UWORD Com_RxSigInfoStartIdxOfRxPduInfoType 0 0 0 65535 ECU_ADDRESS 0x0 /end MEASUREMENT
/begin MEASUREMENT Com_RxPduInfo[57].RxTOutInfoIdxOfRxPduInfo "" UBYTE Com_RxTOutInfoIdxOfRxPduInfoType 0 0 0 255 ECU_ADDRESS 0x0 /end MEASUREMENT
/begin MEASUREMENT Com_RxPduInfo[57].RxTOutInfoIndEndIdxOfRxPduInfo "" UBYTE Com_RxTOutInfoIndEndIdxOfRxPduInfoType 0 0 0 255 ECU_ADDRESS 0x0 /end MEASUREMENT
/begin MEASUREMENT Com_RxPduInfo[57].RxTOutInfoIndStartIdxOfRxPduInfo "" UBYTE Com_RxTOutInfoIndStartIdxOfRxPduInfoType 0 0 0 255 ECU_ADDRESS 0x0 /end MEASUREMENT
/begin MEASUREMENT Com_RxPduInfo[58].HandleRxPduDeferredIdxOfRxPduInfo "" UBYTE Com_HandleRxPduDeferredIdxOfRxPduInfoType 0 0 0 255 ECU_ADDRESS 0x0 /end MEASUREMENT
/begin MEASUREMENT Com_RxPduInfo[58].IPduGroupInfoOfRxPduInfoIndEndIdxOfRxPduInfo "" UBYTE Com_IPduGroupInfoOfRxPduInfoIndEndIdxOfRxPduInfoType 0 0 0 255 ECU_ADDRESS 0x0 /end MEASUREMENT
/begin MEASUREMENT Com_RxPduInfo[58].IPduGroupInfoOfRxPduInfoIndStartIdxOfRxPduInfo "" UBYTE Com_IPduGroupInfoOfRxPduInfoIndStartIdxOfRxPduInfoType 0 0 0 255 ECU_ADDRESS 0x0 /end MEASUREMENT
/begin MEASUREMENT Com_RxPduInfo[58].MainFunctionRxStructIdxOfRxPduInfo "" UBYTE Com_MainFunctionRxStructIdxOfRxPduInfoType 0 0 0 255 ECU_ADDRESS 0x0 /end MEASUREMENT
/begin MEASUREMENT Com_RxPduInfo[58].RxAccessInfoIndEndIdxOfRxPduInfo "" UWORD Com_RxAccessInfoIndEndIdxOfRxPduInfoType 0 0 0 65535 ECU_ADDRESS 0x0 /end MEASUREMENT
/begin MEASUREMENT Com_RxPduInfo[58].RxAccessInfoIndStartIdxOfRxPduInfo "" UWORD Com_RxAccessInfoIndStartIdxOfRxPduInfoType 0 0 0 65535 ECU_ADDRESS 0x0 /end MEASUREMENT
/begin MEASUREMENT Com_RxPduInfo[58].RxDefPduBufferEndIdxOfRxPduInfo "" UWORD Com_RxDefPduBufferEndIdxOfRxPduInfoType 0 0 0 65535 ECU_ADDRESS 0x0 /end MEASUREMENT
/begin MEASUREMENT Com_RxPduInfo[58].RxDefPduBufferStartIdxOfRxPduInfo "" UWORD Com_RxDefPduBufferStartIdxOfRxPduInfoType 0 0 0 65535 ECU_ADDRESS 0x0 /end MEASUREMENT
/begin MEASUREMENT Com_RxPduInfo[58].RxPduCalloutFuncPtrIdxOfRxPduInfo "" UBYTE Com_RxPduCalloutFuncPtrIdxOfRxPduInfoType 0 0 0 255 ECU_ADDRESS 0x0 /end MEASUREMENT
/begin MEASUREMENT Com_RxPduInfo[58].RxSigGrpInfoIndEndIdxOfRxPduInfo "" UBYTE Com_RxSigGrpInfoIndEndIdxOfRxPduInfoType 0 0 0 255 ECU_ADDRESS 0x0 /end MEASUREMENT
/begin MEASUREMENT Com_RxPduInfo[58].RxSigGrpInfoIndStartIdxOfRxPduInfo "" UBYTE Com_RxSigGrpInfoIndStartIdxOfRxPduInfoType 0 0 0 255 ECU_ADDRESS 0x0 /end MEASUREMENT
/begin MEASUREMENT Com_RxPduInfo[58].RxSigInfoEndIdxOfRxPduInfo "" UWORD Com_RxSigInfoEndIdxOfRxPduInfoType 0 0 0 65535 ECU_ADDRESS 0x0 /end MEASUREMENT
/begin MEASUREMENT Com_RxPduInfo[58].RxSigInfoStartIdxOfRxPduInfo "" UWORD Com_RxSigInfoStartIdxOfRxPduInfoType 0 0 0 65535 ECU_ADDRESS 0x0 /end MEASUREMENT
/begin MEASUREMENT Com_RxPduInfo[58].RxTOutInfoIdxOfRxPduInfo "" UBYTE Com_RxTOutInfoIdxOfRxPduInfoType 0 0 0 255 ECU_ADDRESS 0x0 /end MEASUREMENT
/begin MEASUREMENT Com_RxPduInfo[58].RxTOutInfoIndEndIdxOfRxPduInfo "" UBYTE Com_RxTOutInfoIndEndIdxOfRxPduInfoType 0 0 0 255 ECU_ADDRESS 0x0 /end MEASUREMENT
/begin MEASUREMENT Com_RxPduInfo[58].RxTOutInfoIndStartIdxOfRxPduInfo "" UBYTE Com_RxTOutInfoIndStartIdxOfRxPduInfoType 0 0 0 255 ECU_ADDRESS 0x0 /end MEASUREMENT
/begin MEASUREMENT Com_RxPduInfo[59].HandleRxPduDeferredIdxOfRxPduInfo "" UBYTE Com_HandleRxPduDeferredIdxOfRxPduInfoType 0 0 0 255 ECU_ADDRESS 0x0 /end MEASUREMENT
/begin MEASUREMENT Com_RxPduInfo[59].IPduGroupInfoOfRxPduInfoIndEndIdxOfRxPduInfo "" UBYTE Com_IPduGroupInfoOfRxPduInfoIndEndIdxOfRxPduInfoType 0 0 0 255 ECU_ADDRESS 0x0 /end MEASUREMENT
/begin MEASUREMENT Com_RxPduInfo[59].IPduGroupInfoOfRxPduInfoIndStartIdxOfRxPduInfo "" UBYTE Com_IPduGroupInfoOfRxPduInfoIndStartIdxOfRxPduInfoType 0 0 0 255 ECU_ADDRESS 0x0 /end MEASUREMENT
/begin MEASUREMENT Com_RxPduInfo[59].MainFunctionRxStructIdxOfRxPduInfo "" UBYTE Com_MainFunctionRxStructIdxOfRxPduInfoType 0 0 0 255 ECU_ADDRESS 0x0 /end MEASUREMENT
/begin MEASUREMENT Com_RxPduInfo[59].RxAccessInfoIndEndIdxOfRxPduInfo "" UWORD Com_RxAccessInfoIndEndIdxOfRxPduInfoType 0 0 0 65535 ECU_ADDRESS 0x0 /end MEASUREMENT
/begin MEASUREMENT Com_RxPduInfo[59].RxAccessInfoIndStartIdxOfRxPduInfo "" UWORD Com_RxAccessInfoIndStartIdxOfRxPduInfoType 0 0 0 65535 ECU_ADDRESS 0x0 /end MEASUREMENT
/begin MEASUREMENT Com_RxPduInfo[59].RxDefPduBufferEndIdxOfRxPduInfo "" UWORD Com_RxDefPduBufferEndIdxOfRxPduInfoType 0 0 0 65535 ECU_ADDRESS 0x0 /end MEASUREMENT
/begin MEASUREMENT Com_RxPduInfo[59].RxDefPduBufferStartIdxOfRxPduInfo "" UWORD Com_RxDefPduBufferStartIdxOfRxPduInfoType 0 0 0 65535 ECU_ADDRESS 0x0 /end MEASUREMENT
/begin MEASUREMENT Com_RxPduInfo[59].RxPduCalloutFuncPtrIdxOfRxPduInfo "" UBYTE Com_RxPduCalloutFuncPtrIdxOfRxPduInfoType 0 0 0 255 ECU_ADDRESS 0x0 /end MEASUREMENT
/begin MEASUREMENT Com_RxPduInfo[59].RxSigGrpInfoIndEndIdxOfRxPduInfo "" UBYTE Com_RxSigGrpInfoIndEndIdxOfRxPduInfoType 0 0 0 255 ECU_ADDRESS 0x0 /end MEASUREMENT
/begin MEASUREMENT Com_RxPduInfo[59].RxSigGrpInfoIndStartIdxOfRxPduInfo "" UBYTE Com_RxSigGrpInfoIndStartIdxOfRxPduInfoType 0 0 0 255 ECU_ADDRESS 0x0 /end MEASUREMENT
/begin MEASUREMENT Com_RxPduInfo[59].RxSigInfoEndIdxOfRxPduInfo "" UWORD Com_RxSigInfoEndIdxOfRxPduInfoType 0 0 0 65535 ECU_ADDRESS 0x0 /end MEASUREMENT
/begin MEASUREMENT Com_RxPduInfo[59].RxSigInfoStartIdxOfRxPduInfo "" UWORD Com_RxSigInfoStartIdxOfRxPduInfoType 0 0 0 65535 ECU_ADDRESS 0x0 /end MEASUREMENT
/begin MEASUREMENT Com_RxPduInfo[59].RxTOutInfoIdxOfRxPduInfo "" UBYTE Com_RxTOutInfoIdxOfRxPduInfoType 0 0 0 255 ECU_ADDRESS 0x0 /end MEASUREMENT
/begin MEASUREMENT Com_RxPduInfo[59].RxTOutInfoIndEndIdxOfRxPduInfo "" UBYTE Com_RxTOutInfoIndEndIdxOfRxPduInfoType 0 0 0 255 ECU_ADDRESS 0x0 /end MEASUREMENT
/begin MEASUREMENT Com_RxPduInfo[59].RxTOutInfoIndStartIdxOfRxPduInfo "" UBYTE Com_RxTOutInfoIndStartIdxOfRxPduInfoType 0 0 0 255 ECU_ADDRESS 0x0 /end MEASUREMENT
/begin MEASUREMENT Com_RxPduInfo[5].HandleRxPduDeferredIdxOfRxPduInfo "" UBYTE Com_HandleRxPduDeferredIdxOfRxPduInfoType 0 0 0 255 ECU_ADDRESS 0x0 /end MEASUREMENT
/begin MEASUREMENT Com_RxPduInfo[5].IPduGroupInfoOfRxPduInfoIndEndIdxOfRxPduInfo "" UBYTE Com_IPduGroupInfoOfRxPduInfoIndEndIdxOfRxPduInfoType 0 0 0 255 ECU_ADDRESS 0x0 /end MEASUREMENT
/begin MEASUREMENT Com_RxPduInfo[5].IPduGroupInfoOfRxPduInfoIndStartIdxOfRxPduInfo "" UBYTE Com_IPduGroupInfoOfRxPduInfoIndStartIdxOfRxPduInfoType 0 0 0 255 ECU_ADDRESS 0x0 /end MEASUREMENT
/begin MEASUREMENT Com_RxPduInfo[5].MainFunctionRxStructIdxOfRxPduInfo "" UBYTE Com_MainFunctionRxStructIdxOfRxPduInfoType 0 0 0 255 ECU_ADDRESS 0x0 /end MEASUREMENT
/begin MEASUREMENT Com_RxPduInfo[5].RxAccessInfoIndEndIdxOfRxPduInfo "" UWORD Com_RxAccessInfoIndEndIdxOfRxPduInfoType 0 0 0 65535 ECU_ADDRESS 0x0 /end MEASUREMENT
/begin MEASUREMENT Com_RxPduInfo[5].RxAccessInfoIndStartIdxOfRxPduInfo "" UWORD Com_RxAccessInfoIndStartIdxOfRxPduInfoType 0 0 0 65535 ECU_ADDRESS 0x0 /end MEASUREMENT
/begin MEASUREMENT Com_RxPduInfo[5].RxDefPduBufferEndIdxOfRxPduInfo "" UWORD Com_RxDefPduBufferEndIdxOfRxPduInfoType 0 0 0 65535 ECU_ADDRESS 0x0 /end MEASUREMENT
/begin MEASUREMENT Com_RxPduInfo[5].RxDefPduBufferStartIdxOfRxPduInfo "" UWORD Com_RxDefPduBufferStartIdxOfRxPduInfoType 0 0 0 65535 ECU_ADDRESS 0x0 /end MEASUREMENT
/begin MEASUREMENT Com_RxPduInfo[5].RxPduCalloutFuncPtrIdxOfRxPduInfo "" UBYTE Com_RxPduCalloutFuncPtrIdxOfRxPduInfoType 0 0 0 255 ECU_ADDRESS 0x0 /end MEASUREMENT
/begin MEASUREMENT Com_RxPduInfo[5].RxSigGrpInfoIndEndIdxOfRxPduInfo "" UBYTE Com_RxSigGrpInfoIndEndIdxOfRxPduInfoType 0 0 0 255 ECU_ADDRESS 0x0 /end MEASUREMENT
/begin MEASUREMENT Com_RxPduInfo[5].RxSigGrpInfoIndStartIdxOfRxPduInfo "" UBYTE Com_RxSigGrpInfoIndStartIdxOfRxPduInfoType 0 0 0 255 ECU_ADDRESS 0x0 /end MEASUREMENT
/begin MEASUREMENT Com_RxPduInfo[5].RxSigInfoEndIdxOfRxPduInfo "" UWORD Com_RxSigInfoEndIdxOfRxPduInfoType 0 0 0 65535 ECU_ADDRESS 0x0 /end MEASUREMENT
/begin MEASUREMENT Com_RxPduInfo[5].RxSigInfoStartIdxOfRxPduInfo "" UWORD Com_RxSigInfoStartIdxOfRxPduInfoType 0 0 0 65535 ECU_ADDRESS 0x0 /end MEASUREMENT
/begin MEASUREMENT Com_RxPduInfo[5].RxTOutInfoIdxOfRxPduInfo "" UBYTE Com_RxTOutInfoIdxOfRxPduInfoType 0 0 0 255 ECU_ADDRESS 0x0 /end MEASUREMENT
/begin MEASUREMENT Com_RxPduInfo[5].RxTOutInfoIndEndIdxOfRxPduInfo "" UBYTE Com_RxTOutInfoIndEndIdxOfRxPduInfoType 0 0 0 255 ECU_ADDRESS 0x0 /end MEASUREMENT
/begin MEASUREMENT Com_RxPduInfo[5].RxTOutInfoIndStartIdxOfRxPduInfo "" UBYTE Com_RxTOutInfoIndStartIdxOfRxPduInfoType 0 0 0 255 ECU_ADDRESS 0x0 /end MEASUREMENT
/begin MEASUREMENT Com_RxPduInfo[60].HandleRxPduDeferredIdxOfRxPduInfo "" UBYTE Com_HandleRxPduDeferredIdxOfRxPduInfoType 0 0 0 255 ECU_ADDRESS 0x0 /end MEASUREMENT
/begin MEASUREMENT Com_RxPduInfo[60].IPduGroupInfoOfRxPduInfoIndEndIdxOfRxPduInfo "" UBYTE Com_IPduGroupInfoOfRxPduInfoIndEndIdxOfRxPduInfoType 0 0 0 255 ECU_ADDRESS 0x0 /end MEASUREMENT
/begin MEASUREMENT Com_RxPduInfo[60].IPduGroupInfoOfRxPduInfoIndStartIdxOfRxPduInfo "" UBYTE Com_IPduGroupInfoOfRxPduInfoIndStartIdxOfRxPduInfoType 0 0 0 255 ECU_ADDRESS 0x0 /end MEASUREMENT
/begin MEASUREMENT Com_RxPduInfo[60].MainFunctionRxStructIdxOfRxPduInfo "" UBYTE Com_MainFunctionRxStructIdxOfRxPduInfoType 0 0 0 255 ECU_ADDRESS 0x0 /end MEASUREMENT
/begin MEASUREMENT Com_RxPduInfo[60].RxAccessInfoIndEndIdxOfRxPduInfo "" UWORD Com_RxAccessInfoIndEndIdxOfRxPduInfoType 0 0 0 65535 ECU_ADDRESS 0x0 /end MEASUREMENT
/begin MEASUREMENT Com_RxPduInfo[60].RxAccessInfoIndStartIdxOfRxPduInfo "" UWORD Com_RxAccessInfoIndStartIdxOfRxPduInfoType 0 0 0 65535 ECU_ADDRESS 0x0 /end MEASUREMENT
/begin MEASUREMENT Com_RxPduInfo[60].RxDefPduBufferEndIdxOfRxPduInfo "" UWORD Com_RxDefPduBufferEndIdxOfRxPduInfoType 0 0 0 65535 ECU_ADDRESS 0x0 /end MEASUREMENT
/begin MEASUREMENT Com_RxPduInfo[60].RxDefPduBufferStartIdxOfRxPduInfo "" UWORD Com_RxDefPduBufferStartIdxOfRxPduInfoType 0 0 0 65535 ECU_ADDRESS 0x0 /end MEASUREMENT
/begin MEASUREMENT Com_RxPduInfo[60].RxPduCalloutFuncPtrIdxOfRxPduInfo "" UBYTE Com_RxPduCalloutFuncPtrIdxOfRxPduInfoType 0 0 0 255 ECU_ADDRESS 0x0 /end MEASUREMENT
/begin MEASUREMENT Com_RxPduInfo[60].RxSigGrpInfoIndEndIdxOfRxPduInfo "" UBYTE Com_RxSigGrpInfoIndEndIdxOfRxPduInfoType 0 0 0 255 ECU_ADDRESS 0x0 /end MEASUREMENT
/begin MEASUREMENT Com_RxPduInfo[60].RxSigGrpInfoIndStartIdxOfRxPduInfo "" UBYTE Com_RxSigGrpInfoIndStartIdxOfRxPduInfoType 0 0 0 255 ECU_ADDRESS 0x0 /end MEASUREMENT
/begin MEASUREMENT Com_RxPduInfo[60].RxSigInfoEndIdxOfRxPduInfo "" UWORD Com_RxSigInfoEndIdxOfRxPduInfoType 0 0 0 65535 ECU_ADDRESS 0x0 /end MEASUREMENT
/begin MEASUREMENT Com_RxPduInfo[60].RxSigInfoStartIdxOfRxPduInfo "" UWORD Com_RxSigInfoStartIdxOfRxPduInfoType 0 0 0 65535 ECU_ADDRESS 0x0 /end MEASUREMENT
/begin MEASUREMENT Com_RxPduInfo[60].RxTOutInfoIdxOfRxPduInfo "" UBYTE Com_RxTOutInfoIdxOfRxPduInfoType 0 0 0 255 ECU_ADDRESS 0x0 /end MEASUREMENT
/begin MEASUREMENT Com_RxPduInfo[60].RxTOutInfoIndEndIdxOfRxPduInfo "" UBYTE Com_RxTOutInfoIndEndIdxOfRxPduInfoType 0 0 0 255 ECU_ADDRESS 0x0 /end MEASUREMENT
/begin MEASUREMENT Com_RxPduInfo[60].RxTOutInfoIndStartIdxOfRxPduInfo "" UBYTE Com_RxTOutInfoIndStartIdxOfRxPduInfoType 0 0 0 255 ECU_ADDRESS 0x0 /end MEASUREMENT
/begin MEASUREMENT Com_RxPduInfo[61].HandleRxPduDeferredIdxOfRxPduInfo "" UBYTE Com_HandleRxPduDeferredIdxOfRxPduInfoType 0 0 0 255 ECU_ADDRESS 0x0 /end MEASUREMENT
/begin MEASUREMENT Com_RxPduInfo[61].IPduGroupInfoOfRxPduInfoIndEndIdxOfRxPduInfo "" UBYTE Com_IPduGroupInfoOfRxPduInfoIndEndIdxOfRxPduInfoType 0 0 0 255 ECU_ADDRESS 0x0 /end MEASUREMENT
/begin MEASUREMENT Com_RxPduInfo[61].IPduGroupInfoOfRxPduInfoIndStartIdxOfRxPduInfo "" UBYTE Com_IPduGroupInfoOfRxPduInfoIndStartIdxOfRxPduInfoType 0 0 0 255 ECU_ADDRESS 0x0 /end MEASUREMENT
/begin MEASUREMENT Com_RxPduInfo[61].MainFunctionRxStructIdxOfRxPduInfo "" UBYTE Com_MainFunctionRxStructIdxOfRxPduInfoType 0 0 0 255 ECU_ADDRESS 0x0 /end MEASUREMENT
/begin MEASUREMENT Com_RxPduInfo[61].RxAccessInfoIndEndIdxOfRxPduInfo "" UWORD Com_RxAccessInfoIndEndIdxOfRxPduInfoType 0 0 0 65535 ECU_ADDRESS 0x0 /end MEASUREMENT
/begin MEASUREMENT Com_RxPduInfo[61].RxAccessInfoIndStartIdxOfRxPduInfo "" UWORD Com_RxAccessInfoIndStartIdxOfRxPduInfoType 0 0 0 65535 ECU_ADDRESS 0x0 /end MEASUREMENT
/begin MEASUREMENT Com_RxPduInfo[61].RxDefPduBufferEndIdxOfRxPduInfo "" UWORD Com_RxDefPduBufferEndIdxOfRxPduInfoType 0 0 0 65535 ECU_ADDRESS 0x0 /end MEASUREMENT
/begin MEASUREMENT Com_RxPduInfo[61].RxDefPduBufferStartIdxOfRxPduInfo "" UWORD Com_RxDefPduBufferStartIdxOfRxPduInfoType 0 0 0 65535 ECU_ADDRESS 0x0 /end MEASUREMENT
/begin MEASUREMENT Com_RxPduInfo[61].RxPduCalloutFuncPtrIdxOfRxPduInfo "" UBYTE Com_RxPduCalloutFuncPtrIdxOfRxPduInfoType 0 0 0 255 ECU_ADDRESS 0x0 /end MEASUREMENT
/begin MEASUREMENT Com_RxPduInfo[61].RxSigGrpInfoIndEndIdxOfRxPduInfo "" UBYTE Com_RxSigGrpInfoIndEndIdxOfRxPduInfoType 0 0 0 255 ECU_ADDRESS 0x0 /end MEASUREMENT
/begin MEASUREMENT Com_RxPduInfo[61].RxSigGrpInfoIndStartIdxOfRxPduInfo "" UBYTE Com_RxSigGrpInfoIndStartIdxOfRxPduInfoType 0 0 0 255 ECU_ADDRESS 0x0 /end MEASUREMENT
/begin MEASUREMENT Com_RxPduInfo[61].RxSigInfoEndIdxOfRxPduInfo "" UWORD Com_RxSigInfoEndIdxOfRxPduInfoType 0 0 0 65535 ECU_ADDRESS 0x0 /end MEASUREMENT
/begin MEASUREMENT Com_RxPduInfo[61].RxSigInfoStartIdxOfRxPduInfo "" UWORD Com_RxSigInfoStartIdxOfRxPduInfoType 0 0 0 65535 ECU_ADDRESS 0x0 /end MEASUREMENT
/begin MEASUREMENT Com_RxPduInfo[61].RxTOutInfoIdxOfRxPduInfo "" UBYTE Com_RxTOutInfoIdxOfRxPduInfoType 0 0 0 255 ECU_ADDRESS 0x0 /end MEASUREMENT
/begin MEASUREMENT Com_RxPduInfo[61].RxTOutInfoIndEndIdxOfRxPduInfo "" UBYTE Com_RxTOutInfoIndEndIdxOfRxPduInfoType 0 0 0 255 ECU_ADDRESS 0x0 /end MEASUREMENT
/begin MEASUREMENT Com_RxPduInfo[61].RxTOutInfoIndStartIdxOfRxPduInfo "" UBYTE Com_RxTOutInfoIndStartIdxOfRxPduInfoType 0 0 0 255 ECU_ADDRESS 0x0 /end MEASUREMENT
/begin MEASUREMENT Com_RxPduInfo[62].HandleRxPduDeferredIdxOfRxPduInfo "" UBYTE Com_HandleRxPduDeferredIdxOfRxPduInfoType 0 0 0 255 ECU_ADDRESS 0x0 /end MEASUREMENT
/begin MEASUREMENT Com_RxPduInfo[62].IPduGroupInfoOfRxPduInfoIndEndIdxOfRxPduInfo "" UBYTE Com_IPduGroupInfoOfRxPduInfoIndEndIdxOfRxPduInfoType 0 0 0 255 ECU_ADDRESS 0x0 /end MEASUREMENT
/begin MEASUREMENT Com_RxPduInfo[62].IPduGroupInfoOfRxPduInfoIndStartIdxOfRxPduInfo "" UBYTE Com_IPduGroupInfoOfRxPduInfoIndStartIdxOfRxPduInfoType 0 0 0 255 ECU_ADDRESS 0x0 /end MEASUREMENT
/begin MEASUREMENT Com_RxPduInfo[62].MainFunctionRxStructIdxOfRxPduInfo "" UBYTE Com_MainFunctionRxStructIdxOfRxPduInfoType 0 0 0 255 ECU_ADDRESS 0x0 /end MEASUREMENT
/begin MEASUREMENT Com_RxPduInfo[62].RxAccessInfoIndEndIdxOfRxPduInfo "" UWORD Com_RxAccessInfoIndEndIdxOfRxPduInfoType 0 0 0 65535 ECU_ADDRESS 0x0 /end MEASUREMENT
/begin MEASUREMENT Com_RxPduInfo[62].RxAccessInfoIndStartIdxOfRxPduInfo "" UWORD Com_RxAccessInfoIndStartIdxOfRxPduInfoType 0 0 0 65535 ECU_ADDRESS 0x0 /end MEASUREMENT
/begin MEASUREMENT Com_RxPduInfo[62].RxDefPduBufferEndIdxOfRxPduInfo "" UWORD Com_RxDefPduBufferEndIdxOfRxPduInfoType 0 0 0 65535 ECU_ADDRESS 0x0 /end MEASUREMENT
/begin MEASUREMENT Com_RxPduInfo[62].RxDefPduBufferStartIdxOfRxPduInfo "" UWORD Com_RxDefPduBufferStartIdxOfRxPduInfoType 0 0 0 65535 ECU_ADDRESS 0x0 /end MEASUREMENT
/begin MEASUREMENT Com_RxPduInfo[62].RxPduCalloutFuncPtrIdxOfRxPduInfo "" UBYTE Com_RxPduCalloutFuncPtrIdxOfRxPduInfoType 0 0 0 255 ECU_ADDRESS 0x0 /end MEASUREMENT
/begin MEASUREMENT Com_RxPduInfo[62].RxSigGrpInfoIndEndIdxOfRxPduInfo "" UBYTE Com_RxSigGrpInfoIndEndIdxOfRxPduInfoType 0 0 0 255 ECU_ADDRESS 0x0 /end MEASUREMENT
/begin MEASUREMENT Com_RxPduInfo[62].RxSigGrpInfoIndStartIdxOfRxPduInfo "" UBYTE Com_RxSigGrpInfoIndStartIdxOfRxPduInfoType 0 0 0 255 ECU_ADDRESS 0x0 /end MEASUREMENT
/begin MEASUREMENT Com_RxPduInfo[62].RxSigInfoEndIdxOfRxPduInfo "" UWORD Com_RxSigInfoEndIdxOfRxPduInfoType 0 0 0 65535 ECU_ADDRESS 0x0 /end MEASUREMENT
/begin MEASUREMENT Com_RxPduInfo[62].RxSigInfoStartIdxOfRxPduInfo "" UWORD Com_RxSigInfoStartIdxOfRxPduInfoType 0 0 0 65535 ECU_ADDRESS 0x0 /end MEASUREMENT
/begin MEASUREMENT Com_RxPduInfo[62].RxTOutInfoIdxOfRxPduInfo "" UBYTE Com_RxTOutInfoIdxOfRxPduInfoType 0 0 0 255 ECU_ADDRESS 0x0 /end MEASUREMENT
/begin MEASUREMENT Com_RxPduInfo[62].RxTOutInfoIndEndIdxOfRxPduInfo "" UBYTE Com_RxTOutInfoIndEndIdxOfRxPduInfoType 0 0 0 255 ECU_ADDRESS 0x0 /end MEASUREMENT
/begin MEASUREMENT Com_RxPduInfo[62].RxTOutInfoIndStartIdxOfRxPduInfo "" UBYTE Com_RxTOutInfoIndStartIdxOfRxPduInfoType 0 0 0 255 ECU_ADDRESS 0x0 /end MEASUREMENT
/begin MEASUREMENT Com_RxPduInfo[63].HandleRxPduDeferredIdxOfRxPduInfo "" UBYTE Com_HandleRxPduDeferredIdxOfRxPduInfoType 0 0 0 255 ECU_ADDRESS 0x0 /end MEASUREMENT
/begin MEASUREMENT Com_RxPduInfo[63].IPduGroupInfoOfRxPduInfoIndEndIdxOfRxPduInfo "" UBYTE Com_IPduGroupInfoOfRxPduInfoIndEndIdxOfRxPduInfoType 0 0 0 255 ECU_ADDRESS 0x0 /end MEASUREMENT
/begin MEASUREMENT Com_RxPduInfo[63].IPduGroupInfoOfRxPduInfoIndStartIdxOfRxPduInfo "" UBYTE Com_IPduGroupInfoOfRxPduInfoIndStartIdxOfRxPduInfoType 0 0 0 255 ECU_ADDRESS 0x0 /end MEASUREMENT
/begin MEASUREMENT Com_RxPduInfo[63].MainFunctionRxStructIdxOfRxPduInfo "" UBYTE Com_MainFunctionRxStructIdxOfRxPduInfoType 0 0 0 255 ECU_ADDRESS 0x0 /end MEASUREMENT
/begin MEASUREMENT Com_RxPduInfo[63].RxAccessInfoIndEndIdxOfRxPduInfo "" UWORD Com_RxAccessInfoIndEndIdxOfRxPduInfoType 0 0 0 65535 ECU_ADDRESS 0x0 /end MEASUREMENT
/begin MEASUREMENT Com_RxPduInfo[63].RxAccessInfoIndStartIdxOfRxPduInfo "" UWORD Com_RxAccessInfoIndStartIdxOfRxPduInfoType 0 0 0 65535 ECU_ADDRESS 0x0 /end MEASUREMENT
/begin MEASUREMENT Com_RxPduInfo[63].RxDefPduBufferEndIdxOfRxPduInfo "" UWORD Com_RxDefPduBufferEndIdxOfRxPduInfoType 0 0 0 65535 ECU_ADDRESS 0x0 /end MEASUREMENT
/begin MEASUREMENT Com_RxPduInfo[63].RxDefPduBufferStartIdxOfRxPduInfo "" UWORD Com_RxDefPduBufferStartIdxOfRxPduInfoType 0 0 0 65535 ECU_ADDRESS 0x0 /end MEASUREMENT
/begin MEASUREMENT Com_RxPduInfo[63].RxPduCalloutFuncPtrIdxOfRxPduInfo "" UBYTE Com_RxPduCalloutFuncPtrIdxOfRxPduInfoType 0 0 0 255 ECU_ADDRESS 0x0 /end MEASUREMENT
/begin MEASUREMENT Com_RxPduInfo[63].RxSigGrpInfoIndEndIdxOfRxPduInfo "" UBYTE Com_RxSigGrpInfoIndEndIdxOfRxPduInfoType 0 0 0 255 ECU_ADDRESS 0x0 /end MEASUREMENT
/begin MEASUREMENT Com_RxPduInfo[63].RxSigGrpInfoIndStartIdxOfRxPduInfo "" UBYTE Com_RxSigGrpInfoIndStartIdxOfRxPduInfoType 0 0 0 255 ECU_ADDRESS 0x0 /end MEASUREMENT
/begin MEASUREMENT Com_RxPduInfo[63].RxSigInfoEndIdxOfRxPduInfo "" UWORD Com_RxSigInfoEndIdxOfRxPduInfoType 0 0 0 65535 ECU_ADDRESS 0x0 /end MEASUREMENT
/begin MEASUREMENT Com_RxPduInfo[63].RxSigInfoStartIdxOfRxPduInfo "" UWORD Com_RxSigInfoStartIdxOfRxPduInfoType 0 0 0 65535 ECU_ADDRESS 0x0 /end MEASUREMENT
/begin MEASUREMENT Com_RxPduInfo[63].RxTOutInfoIdxOfRxPduInfo "" UBYTE Com_RxTOutInfoIdxOfRxPduInfoType 0 0 0 255 ECU_ADDRESS 0x0 /end MEASUREMENT
/begin MEASUREMENT Com_RxPduInfo[63].RxTOutInfoIndEndIdxOfRxPduInfo "" UBYTE Com_RxTOutInfoIndEndIdxOfRxPduInfoType 0 0 0 255 ECU_ADDRESS 0x0 /end MEASUREMENT
/begin MEASUREMENT Com_RxPduInfo[63].RxTOutInfoIndStartIdxOfRxPduInfo "" UBYTE Com_RxTOutInfoIndStartIdxOfRxPduInfoType 0 0 0 255 ECU_ADDRESS 0x0 /end MEASUREMENT
/begin MEASUREMENT Com_RxPduInfo[64].HandleRxPduDeferredIdxOfRxPduInfo "" UBYTE Com_HandleRxPduDeferredIdxOfRxPduInfoType 0 0 0 255 ECU_ADDRESS 0x0 /end MEASUREMENT
/begin MEASUREMENT Com_RxPduInfo[64].IPduGroupInfoOfRxPduInfoIndEndIdxOfRxPduInfo "" UBYTE Com_IPduGroupInfoOfRxPduInfoIndEndIdxOfRxPduInfoType 0 0 0 255 ECU_ADDRESS 0x0 /end MEASUREMENT
/begin MEASUREMENT Com_RxPduInfo[64].IPduGroupInfoOfRxPduInfoIndStartIdxOfRxPduInfo "" UBYTE Com_IPduGroupInfoOfRxPduInfoIndStartIdxOfRxPduInfoType 0 0 0 255 ECU_ADDRESS 0x0 /end MEASUREMENT
/begin MEASUREMENT Com_RxPduInfo[64].MainFunctionRxStructIdxOfRxPduInfo "" UBYTE Com_MainFunctionRxStructIdxOfRxPduInfoType 0 0 0 255 ECU_ADDRESS 0x0 /end MEASUREMENT
/begin MEASUREMENT Com_RxPduInfo[64].RxAccessInfoIndEndIdxOfRxPduInfo "" UWORD Com_RxAccessInfoIndEndIdxOfRxPduInfoType 0 0 0 65535 ECU_ADDRESS 0x0 /end MEASUREMENT
/begin MEASUREMENT Com_RxPduInfo[64].RxAccessInfoIndStartIdxOfRxPduInfo "" UWORD Com_RxAccessInfoIndStartIdxOfRxPduInfoType 0 0 0 65535 ECU_ADDRESS 0x0 /end MEASUREMENT
/begin MEASUREMENT Com_RxPduInfo[64].RxDefPduBufferEndIdxOfRxPduInfo "" UWORD Com_RxDefPduBufferEndIdxOfRxPduInfoType 0 0 0 65535 ECU_ADDRESS 0x0 /end MEASUREMENT
/begin MEASUREMENT Com_RxPduInfo[64].RxDefPduBufferStartIdxOfRxPduInfo "" UWORD Com_RxDefPduBufferStartIdxOfRxPduInfoType 0 0 0 65535 ECU_ADDRESS 0x0 /end MEASUREMENT
/begin MEASUREMENT Com_RxPduInfo[64].RxPduCalloutFuncPtrIdxOfRxPduInfo "" UBYTE Com_RxPduCalloutFuncPtrIdxOfRxPduInfoType 0 0 0 255 ECU_ADDRESS 0x0 /end MEASUREMENT
/begin MEASUREMENT Com_RxPduInfo[64].RxSigGrpInfoIndEndIdxOfRxPduInfo "" UBYTE Com_RxSigGrpInfoIndEndIdxOfRxPduInfoType 0 0 0 255 ECU_ADDRESS 0x0 /end MEASUREMENT
/begin MEASUREMENT Com_RxPduInfo[64].RxSigGrpInfoIndStartIdxOfRxPduInfo "" UBYTE Com_RxSigGrpInfoIndStartIdxOfRxPduInfoType 0 0 0 255 ECU_ADDRESS 0x0 /end MEASUREMENT
/begin MEASUREMENT Com_RxPduInfo[64].RxSigInfoEndIdxOfRxPduInfo "" UWORD Com_RxSigInfoEndIdxOfRxPduInfoType 0 0 0 65535 ECU_ADDRESS 0x0 /end MEASUREMENT
/begin MEASUREMENT Com_RxPduInfo[64].RxSigInfoStartIdxOfRxPduInfo "" UWORD Com_RxSigInfoStartIdxOfRxPduInfoType 0 0 0 65535 ECU_ADDRESS 0x0 /end MEASUREMENT
/begin MEASUREMENT Com_RxPduInfo[64].RxTOutInfoIdxOfRxPduInfo "" UBYTE Com_RxTOutInfoIdxOfRxPduInfoType 0 0 0 255 ECU_ADDRESS 0x0 /end MEASUREMENT
/begin MEASUREMENT Com_RxPduInfo[64].RxTOutInfoIndEndIdxOfRxPduInfo "" UBYTE Com_RxTOutInfoIndEndIdxOfRxPduInfoType 0 0 0 255 ECU_ADDRESS 0x0 /end MEASUREMENT
/begin MEASUREMENT Com_RxPduInfo[64].RxTOutInfoIndStartIdxOfRxPduInfo "" UBYTE Com_RxTOutInfoIndStartIdxOfRxPduInfoType 0 0 0 255 ECU_ADDRESS 0x0 /end MEASUREMENT
/begin MEASUREMENT Com_RxPduInfo[65].HandleRxPduDeferredIdxOfRxPduInfo "" UBYTE Com_HandleRxPduDeferredIdxOfRxPduInfoType 0 0 0 255 ECU_ADDRESS 0x0 /end MEASUREMENT
/begin MEASUREMENT Com_RxPduInfo[65].IPduGroupInfoOfRxPduInfoIndEndIdxOfRxPduInfo "" UBYTE Com_IPduGroupInfoOfRxPduInfoIndEndIdxOfRxPduInfoType 0 0 0 255 ECU_ADDRESS 0x0 /end MEASUREMENT
/begin MEASUREMENT Com_RxPduInfo[65].IPduGroupInfoOfRxPduInfoIndStartIdxOfRxPduInfo "" UBYTE Com_IPduGroupInfoOfRxPduInfoIndStartIdxOfRxPduInfoType 0 0 0 255 ECU_ADDRESS 0x0 /end MEASUREMENT
/begin MEASUREMENT Com_RxPduInfo[65].MainFunctionRxStructIdxOfRxPduInfo "" UBYTE Com_MainFunctionRxStructIdxOfRxPduInfoType 0 0 0 255 ECU_ADDRESS 0x0 /end MEASUREMENT
/begin MEASUREMENT Com_RxPduInfo[65].RxAccessInfoIndEndIdxOfRxPduInfo "" UWORD Com_RxAccessInfoIndEndIdxOfRxPduInfoType 0 0 0 65535 ECU_ADDRESS 0x0 /end MEASUREMENT
/begin MEASUREMENT Com_RxPduInfo[65].RxAccessInfoIndStartIdxOfRxPduInfo "" UWORD Com_RxAccessInfoIndStartIdxOfRxPduInfoType 0 0 0 65535 ECU_ADDRESS 0x0 /end MEASUREMENT
/begin MEASUREMENT Com_RxPduInfo[65].RxDefPduBufferEndIdxOfRxPduInfo "" UWORD Com_RxDefPduBufferEndIdxOfRxPduInfoType 0 0 0 65535 ECU_ADDRESS 0x0 /end MEASUREMENT
/begin MEASUREMENT Com_RxPduInfo[65].RxDefPduBufferStartIdxOfRxPduInfo "" UWORD Com_RxDefPduBufferStartIdxOfRxPduInfoType 0 0 0 65535 ECU_ADDRESS 0x0 /end MEASUREMENT
/begin MEASUREMENT Com_RxPduInfo[65].RxPduCalloutFuncPtrIdxOfRxPduInfo "" UBYTE Com_RxPduCalloutFuncPtrIdxOfRxPduInfoType 0 0 0 255 ECU_ADDRESS 0x0 /end MEASUREMENT
/begin MEASUREMENT Com_RxPduInfo[65].RxSigGrpInfoIndEndIdxOfRxPduInfo "" UBYTE Com_RxSigGrpInfoIndEndIdxOfRxPduInfoType 0 0 0 255 ECU_ADDRESS 0x0 /end MEASUREMENT
/begin MEASUREMENT Com_RxPduInfo[65].RxSigGrpInfoIndStartIdxOfRxPduInfo "" UBYTE Com_RxSigGrpInfoIndStartIdxOfRxPduInfoType 0 0 0 255 ECU_ADDRESS 0x0 /end MEASUREMENT
/begin MEASUREMENT Com_RxPduInfo[65].RxSigInfoEndIdxOfRxPduInfo "" UWORD Com_RxSigInfoEndIdxOfRxPduInfoType 0 0 0 65535 ECU_ADDRESS 0x0 /end MEASUREMENT
/begin MEASUREMENT Com_RxPduInfo[65].RxSigInfoStartIdxOfRxPduInfo "" UWORD Com_RxSigInfoStartIdxOfRxPduInfoType 0 0 0 65535 ECU_ADDRESS 0x0 /end MEASUREMENT
/begin MEASUREMENT Com_RxPduInfo[65].RxTOutInfoIdxOfRxPduInfo "" UBYTE Com_RxTOutInfoIdxOfRxPduInfoType 0 0 0 255 ECU_ADDRESS 0x0 /end MEASUREMENT
/begin MEASUREMENT Com_RxPduInfo[65].RxTOutInfoIndEndIdxOfRxPduInfo "" UBYTE Com_RxTOutInfoIndEndIdxOfRxPduInfoType 0 0 0 255 ECU_ADDRESS 0x0 /end MEASUREMENT
/begin MEASUREMENT Com_RxPduInfo[65].RxTOutInfoIndStartIdxOfRxPduInfo "" UBYTE Com_RxTOutInfoIndStartIdxOfRxPduInfoType 0 0 0 255 ECU_ADDRESS 0x0 /end MEASUREMENT
/begin MEASUREMENT Com_RxPduInfo[6].HandleRxPduDeferredIdxOfRxPduInfo "" UBYTE Com_HandleRxPduDeferredIdxOfRxPduInfoType 0 0 0 255 ECU_ADDRESS 0x0 /end MEASUREMENT
/begin MEASUREMENT Com_RxPduInfo[6].IPduGroupInfoOfRxPduInfoIndEndIdxOfRxPduInfo "" UBYTE Com_IPduGroupInfoOfRxPduInfoIndEndIdxOfRxPduInfoType 0 0 0 255 ECU_ADDRESS 0x0 /end MEASUREMENT
/begin MEASUREMENT Com_RxPduInfo[6].IPduGroupInfoOfRxPduInfoIndStartIdxOfRxPduInfo "" UBYTE Com_IPduGroupInfoOfRxPduInfoIndStartIdxOfRxPduInfoType 0 0 0 255 ECU_ADDRESS 0x0 /end MEASUREMENT
/begin MEASUREMENT Com_RxPduInfo[6].MainFunctionRxStructIdxOfRxPduInfo "" UBYTE Com_MainFunctionRxStructIdxOfRxPduInfoType 0 0 0 255 ECU_ADDRESS 0x0 /end MEASUREMENT
/begin MEASUREMENT Com_RxPduInfo[6].RxAccessInfoIndEndIdxOfRxPduInfo "" UWORD Com_RxAccessInfoIndEndIdxOfRxPduInfoType 0 0 0 65535 ECU_ADDRESS 0x0 /end MEASUREMENT
/begin MEASUREMENT Com_RxPduInfo[6].RxAccessInfoIndStartIdxOfRxPduInfo "" UWORD Com_RxAccessInfoIndStartIdxOfRxPduInfoType 0 0 0 65535 ECU_ADDRESS 0x0 /end MEASUREMENT
/begin MEASUREMENT Com_RxPduInfo[6].RxDefPduBufferEndIdxOfRxPduInfo "" UWORD Com_RxDefPduBufferEndIdxOfRxPduInfoType 0 0 0 65535 ECU_ADDRESS 0x0 /end MEASUREMENT
/begin MEASUREMENT Com_RxPduInfo[6].RxDefPduBufferStartIdxOfRxPduInfo "" UWORD Com_RxDefPduBufferStartIdxOfRxPduInfoType 0 0 0 65535 ECU_ADDRESS 0x0 /end MEASUREMENT
/begin MEASUREMENT Com_RxPduInfo[6].RxPduCalloutFuncPtrIdxOfRxPduInfo "" UBYTE Com_RxPduCalloutFuncPtrIdxOfRxPduInfoType 0 0 0 255 ECU_ADDRESS 0x0 /end MEASUREMENT
/begin MEASUREMENT Com_RxPduInfo[6].RxSigGrpInfoIndEndIdxOfRxPduInfo "" UBYTE Com_RxSigGrpInfoIndEndIdxOfRxPduInfoType 0 0 0 255 ECU_ADDRESS 0x0 /end MEASUREMENT
/begin MEASUREMENT Com_RxPduInfo[6].RxSigGrpInfoIndStartIdxOfRxPduInfo "" UBYTE Com_RxSigGrpInfoIndStartIdxOfRxPduInfoType 0 0 0 255 ECU_ADDRESS 0x0 /end MEASUREMENT
/begin MEASUREMENT Com_RxPduInfo[6].RxSigInfoEndIdxOfRxPduInfo "" UWORD Com_RxSigInfoEndIdxOfRxPduInfoType 0 0 0 65535 ECU_ADDRESS 0x0 /end MEASUREMENT
/begin MEASUREMENT Com_RxPduInfo[6].RxSigInfoStartIdxOfRxPduInfo "" UWORD Com_RxSigInfoStartIdxOfRxPduInfoType 0 0 0 65535 ECU_ADDRESS 0x0 /end MEASUREMENT
/begin MEASUREMENT Com_RxPduInfo[6].RxTOutInfoIdxOfRxPduInfo "" UBYTE Com_RxTOutInfoIdxOfRxPduInfoType 0 0 0 255 ECU_ADDRESS 0x0 /end MEASUREMENT
/begin MEASUREMENT Com_RxPduInfo[6].RxTOutInfoIndEndIdxOfRxPduInfo "" UBYTE Com_RxTOutInfoIndEndIdxOfRxPduInfoType 0 0 0 255 ECU_ADDRESS 0x0 /end MEASUREMENT
/begin MEASUREMENT Com_RxPduInfo[6].RxTOutInfoIndStartIdxOfRxPduInfo "" UBYTE Com_RxTOutInfoIndStartIdxOfRxPduInfoType 0 0 0 255 ECU_ADDRESS 0x0 /end MEASUREMENT
/begin MEASUREMENT Com_RxPduInfo[7].HandleRxPduDeferredIdxOfRxPduInfo "" UBYTE Com_HandleRxPduDeferredIdxOfRxPduInfoType 0 0 0 255 ECU_ADDRESS 0x0 /end MEASUREMENT
/begin MEASUREMENT Com_RxPduInfo[7].IPduGroupInfoOfRxPduInfoIndEndIdxOfRxPduInfo "" UBYTE Com_IPduGroupInfoOfRxPduInfoIndEndIdxOfRxPduInfoType 0 0 0 255 ECU_ADDRESS 0x0 /end MEASUREMENT
/begin MEASUREMENT Com_RxPduInfo[7].IPduGroupInfoOfRxPduInfoIndStartIdxOfRxPduInfo "" UBYTE Com_IPduGroupInfoOfRxPduInfoIndStartIdxOfRxPduInfoType 0 0 0 255 ECU_ADDRESS 0x0 /end MEASUREMENT
/begin MEASUREMENT Com_RxPduInfo[7].MainFunctionRxStructIdxOfRxPduInfo "" UBYTE Com_MainFunctionRxStructIdxOfRxPduInfoType 0 0 0 255 ECU_ADDRESS 0x0 /end MEASUREMENT
/begin MEASUREMENT Com_RxPduInfo[7].RxAccessInfoIndEndIdxOfRxPduInfo "" UWORD Com_RxAccessInfoIndEndIdxOfRxPduInfoType 0 0 0 65535 ECU_ADDRESS 0x0 /end MEASUREMENT
/begin MEASUREMENT Com_RxPduInfo[7].RxAccessInfoIndStartIdxOfRxPduInfo "" UWORD Com_RxAccessInfoIndStartIdxOfRxPduInfoType 0 0 0 65535 ECU_ADDRESS 0x0 /end MEASUREMENT
/begin MEASUREMENT Com_RxPduInfo[7].RxDefPduBufferEndIdxOfRxPduInfo "" UWORD Com_RxDefPduBufferEndIdxOfRxPduInfoType 0 0 0 65535 ECU_ADDRESS 0x0 /end MEASUREMENT
/begin MEASUREMENT Com_RxPduInfo[7].RxDefPduBufferStartIdxOfRxPduInfo "" UWORD Com_RxDefPduBufferStartIdxOfRxPduInfoType 0 0 0 65535 ECU_ADDRESS 0x0 /end MEASUREMENT
/begin MEASUREMENT Com_RxPduInfo[7].RxPduCalloutFuncPtrIdxOfRxPduInfo "" UBYTE Com_RxPduCalloutFuncPtrIdxOfRxPduInfoType 0 0 0 255 ECU_ADDRESS 0x0 /end MEASUREMENT
/begin MEASUREMENT Com_RxPduInfo[7].RxSigGrpInfoIndEndIdxOfRxPduInfo "" UBYTE Com_RxSigGrpInfoIndEndIdxOfRxPduInfoType 0 0 0 255 ECU_ADDRESS 0x0 /end MEASUREMENT
/begin MEASUREMENT Com_RxPduInfo[7].RxSigGrpInfoIndStartIdxOfRxPduInfo "" UBYTE Com_RxSigGrpInfoIndStartIdxOfRxPduInfoType 0 0 0 255 ECU_ADDRESS 0x0 /end MEASUREMENT
/begin MEASUREMENT Com_RxPduInfo[7].RxSigInfoEndIdxOfRxPduInfo "" UWORD Com_RxSigInfoEndIdxOfRxPduInfoType 0 0 0 65535 ECU_ADDRESS 0x0 /end MEASUREMENT
/begin MEASUREMENT Com_RxPduInfo[7].RxSigInfoStartIdxOfRxPduInfo "" UWORD Com_RxSigInfoStartIdxOfRxPduInfoType 0 0 0 65535 ECU_ADDRESS 0x0 /end MEASUREMENT
/begin MEASUREMENT Com_RxPduInfo[7].RxTOutInfoIdxOfRxPduInfo "" UBYTE Com_RxTOutInfoIdxOfRxPduInfoType 0 0 0 255 ECU_ADDRESS 0x0 /end MEASUREMENT
/begin MEASUREMENT Com_RxPduInfo[7].RxTOutInfoIndEndIdxOfRxPduInfo "" UBYTE Com_RxTOutInfoIndEndIdxOfRxPduInfoType 0 0 0 255 ECU_ADDRESS 0x0 /end MEASUREMENT
/begin MEASUREMENT Com_RxPduInfo[7].RxTOutInfoIndStartIdxOfRxPduInfo "" UBYTE Com_RxTOutInfoIndStartIdxOfRxPduInfoType 0 0 0 255 ECU_ADDRESS 0x0 /end MEASUREMENT
/begin MEASUREMENT Com_RxPduInfo[8].HandleRxPduDeferredIdxOfRxPduInfo "" UBYTE Com_HandleRxPduDeferredIdxOfRxPduInfoType 0 0 0 255 ECU_ADDRESS 0x0 /end MEASUREMENT
/begin MEASUREMENT Com_RxPduInfo[8].IPduGroupInfoOfRxPduInfoIndEndIdxOfRxPduInfo "" UBYTE Com_IPduGroupInfoOfRxPduInfoIndEndIdxOfRxPduInfoType 0 0 0 255 ECU_ADDRESS 0x0 /end MEASUREMENT
/begin MEASUREMENT Com_RxPduInfo[8].IPduGroupInfoOfRxPduInfoIndStartIdxOfRxPduInfo "" UBYTE Com_IPduGroupInfoOfRxPduInfoIndStartIdxOfRxPduInfoType 0 0 0 255 ECU_ADDRESS 0x0 /end MEASUREMENT
/begin MEASUREMENT Com_RxPduInfo[8].MainFunctionRxStructIdxOfRxPduInfo "" UBYTE Com_MainFunctionRxStructIdxOfRxPduInfoType 0 0 0 255 ECU_ADDRESS 0x0 /end MEASUREMENT
/begin MEASUREMENT Com_RxPduInfo[8].RxAccessInfoIndEndIdxOfRxPduInfo "" UWORD Com_RxAccessInfoIndEndIdxOfRxPduInfoType 0 0 0 65535 ECU_ADDRESS 0x0 /end MEASUREMENT
/begin MEASUREMENT Com_RxPduInfo[8].RxAccessInfoIndStartIdxOfRxPduInfo "" UWORD Com_RxAccessInfoIndStartIdxOfRxPduInfoType 0 0 0 65535 ECU_ADDRESS 0x0 /end MEASUREMENT
/begin MEASUREMENT Com_RxPduInfo[8].RxDefPduBufferEndIdxOfRxPduInfo "" UWORD Com_RxDefPduBufferEndIdxOfRxPduInfoType 0 0 0 65535 ECU_ADDRESS 0x0 /end MEASUREMENT
/begin MEASUREMENT Com_RxPduInfo[8].RxDefPduBufferStartIdxOfRxPduInfo "" UWORD Com_RxDefPduBufferStartIdxOfRxPduInfoType 0 0 0 65535 ECU_ADDRESS 0x0 /end MEASUREMENT
/begin MEASUREMENT Com_RxPduInfo[8].RxPduCalloutFuncPtrIdxOfRxPduInfo "" UBYTE Com_RxPduCalloutFuncPtrIdxOfRxPduInfoType 0 0 0 255 ECU_ADDRESS 0x0 /end MEASUREMENT
/begin MEASUREMENT Com_RxPduInfo[8].RxSigGrpInfoIndEndIdxOfRxPduInfo "" UBYTE Com_RxSigGrpInfoIndEndIdxOfRxPduInfoType 0 0 0 255 ECU_ADDRESS 0x0 /end MEASUREMENT
/begin MEASUREMENT Com_RxPduInfo[8].RxSigGrpInfoIndStartIdxOfRxPduInfo "" UBYTE Com_RxSigGrpInfoIndStartIdxOfRxPduInfoType 0 0 0 255 ECU_ADDRESS 0x0 /end MEASUREMENT
/begin MEASUREMENT Com_RxPduInfo[8].RxSigInfoEndIdxOfRxPduInfo "" UWORD Com_RxSigInfoEndIdxOfRxPduInfoType 0 0 0 65535 ECU_ADDRESS 0x0 /end MEASUREMENT
/begin MEASUREMENT Com_RxPduInfo[8].RxSigInfoStartIdxOfRxPduInfo "" UWORD Com_RxSigInfoStartIdxOfRxPduInfoType 0 0 0 65535 ECU_ADDRESS 0x0 /end MEASUREMENT
/begin MEASUREMENT Com_RxPduInfo[8].RxTOutInfoIdxOfRxPduInfo "" UBYTE Com_RxTOutInfoIdxOfRxPduInfoType 0 0 0 255 ECU_ADDRESS 0x0 /end MEASUREMENT
/begin MEASUREMENT Com_RxPduInfo[8].RxTOutInfoIndEndIdxOfRxPduInfo "" UBYTE Com_RxTOutInfoIndEndIdxOfRxPduInfoType 0 0 0 255 ECU_ADDRESS 0x0 /end MEASUREMENT
/begin MEASUREMENT Com_RxPduInfo[8].RxTOutInfoIndStartIdxOfRxPduInfo "" UBYTE Com_RxTOutInfoIndStartIdxOfRxPduInfoType 0 0 0 255 ECU_ADDRESS 0x0 /end MEASUREMENT
/begin MEASUREMENT Com_RxPduInfo[9].HandleRxPduDeferredIdxOfRxPduInfo "" UBYTE Com_HandleRxPduDeferredIdxOfRxPduInfoType 0 0 0 255 ECU_ADDRESS 0x0 /end MEASUREMENT
/begin MEASUREMENT Com_RxPduInfo[9].IPduGroupInfoOfRxPduInfoIndEndIdxOfRxPduInfo "" UBYTE Com_IPduGroupInfoOfRxPduInfoIndEndIdxOfRxPduInfoType 0 0 0 255 ECU_ADDRESS 0x0 /end MEASUREMENT
/begin MEASUREMENT Com_RxPduInfo[9].IPduGroupInfoOfRxPduInfoIndStartIdxOfRxPduInfo "" UBYTE Com_IPduGroupInfoOfRxPduInfoIndStartIdxOfRxPduInfoType 0 0 0 255 ECU_ADDRESS 0x0 /end MEASUREMENT
/begin MEASUREMENT Com_RxPduInfo[9].MainFunctionRxStructIdxOfRxPduInfo "" UBYTE Com_MainFunctionRxStructIdxOfRxPduInfoType 0 0 0 255 ECU_ADDRESS 0x0 /end MEASUREMENT
/begin MEASUREMENT Com_RxPduInfo[9].RxAccessInfoIndEndIdxOfRxPduInfo "" UWORD Com_RxAccessInfoIndEndIdxOfRxPduInfoType 0 0 0 65535 ECU_ADDRESS 0x0 /end MEASUREMENT
/begin MEASUREMENT Com_RxPduInfo[9].RxAccessInfoIndStartIdxOfRxPduInfo "" UWORD Com_RxAccessInfoIndStartIdxOfRxPduInfoType 0 0 0 65535 ECU_ADDRESS 0x0 /end MEASUREMENT
/begin MEASUREMENT Com_RxPduInfo[9].RxDefPduBufferEndIdxOfRxPduInfo "" UWORD Com_RxDefPduBufferEndIdxOfRxPduInfoType 0 0 0 65535 ECU_ADDRESS 0x0 /end MEASUREMENT
/begin MEASUREMENT Com_RxPduInfo[9].RxDefPduBufferStartIdxOfRxPduInfo "" UWORD Com_RxDefPduBufferStartIdxOfRxPduInfoType 0 0 0 65535 ECU_ADDRESS 0x0 /end MEASUREMENT
/begin MEASUREMENT Com_RxPduInfo[9].RxPduCalloutFuncPtrIdxOfRxPduInfo "" UBYTE Com_RxPduCalloutFuncPtrIdxOfRxPduInfoType 0 0 0 255 ECU_ADDRESS 0x0 /end MEASUREMENT
/begin MEASUREMENT Com_RxPduInfo[9].RxSigGrpInfoIndEndIdxOfRxPduInfo "" UBYTE Com_RxSigGrpInfoIndEndIdxOfRxPduInfoType 0 0 0 255 ECU_ADDRESS 0x0 /end MEASUREMENT
/begin MEASUREMENT Com_RxPduInfo[9].RxSigGrpInfoIndStartIdxOfRxPduInfo "" UBYTE Com_RxSigGrpInfoIndStartIdxOfRxPduInfoType 0 0 0 255 ECU_ADDRESS 0x0 /end MEASUREMENT
/begin MEASUREMENT Com_RxPduInfo[9].RxSigInfoEndIdxOfRxPduInfo "" UWORD Com_RxSigInfoEndIdxOfRxPduInfoType 0 0 0 65535 ECU_ADDRESS 0x0 /end MEASUREMENT
/begin MEASUREMENT Com_RxPduInfo[9].RxSigInfoStartIdxOfRxPduInfo "" UWORD Com_RxSigInfoStartIdxOfRxPduInfoType 0 0 0 65535 ECU_ADDRESS 0x0 /end MEASUREMENT
/begin MEASUREMENT Com_RxPduInfo[9].RxTOutInfoIdxOfRxPduInfo "" UBYTE Com_RxTOutInfoIdxOfRxPduInfoType 0 0 0 255 ECU_ADDRESS 0x0 /end MEASUREMENT
/begin MEASUREMENT Com_RxPduInfo[9].RxTOutInfoIndEndIdxOfRxPduInfo "" UBYTE Com_RxTOutInfoIndEndIdxOfRxPduInfoType 0 0 0 255 ECU_ADDRESS 0x0 /end MEASUREMENT
/begin MEASUREMENT Com_RxPduInfo[9].RxTOutInfoIndStartIdxOfRxPduInfo "" UBYTE Com_RxTOutInfoIndStartIdxOfRxPduInfoType 0 0 0 255 ECU_ADDRESS 0x0 /end MEASUREMENT
/begin MEASUREMENT Com_RxSigBufferArrayBased "Rx Signal and Group Signal Buffer. (UINT8_N, UINT8_DYN)" UBYTE NO_COMPU_METHOD 0 0 0 255 ECU_ADDRESS 0x0 MATRIX_DIM 117 /end MEASUREMENT
/begin MEASUREMENT Com_RxSigBufferUInt16 "Rx Signal and Group Signal Buffer. (UINT16)" UWORD NO_COMPU_METHOD 0 0 0 65535 ECU_ADDRESS 0x0 MATRIX_DIM 68 /end MEASUREMENT
/begin MEASUREMENT Com_RxSigBufferUInt32 "Rx Signal and Group Signal Buffer. (UINT32)" ULONG NO_COMPU_METHOD 0 0 0 4294967295 ECU_ADDRESS 0x0 MATRIX_DIM 7 /end MEASUREMENT
/begin MEASUREMENT Com_RxSigBufferUInt8 "Rx Signal and Group Signal Buffer. (BOOLEAN, UINT8)" UBYTE NO_COMPU_METHOD 0 0 0 255 ECU_ADDRESS 0x0 MATRIX_DIM 580 /end MEASUREMENT
/begin MEASUREMENT Com_RxSigGrpInfo[0].RxAccessInfoGrpSigIndEndIdxOfRxSigGrpInfo "" UBYTE Com_RxAccessInfoGrpSigIndEndIdxOfRxSigGrpInfoType 0 0 0 255 ECU_ADDRESS 0x0 /end MEASUREMENT
/begin MEASUREMENT Com_RxSigGrpInfo[0].RxAccessInfoGrpSigIndStartIdxOfRxSigGrpInfo "" UBYTE Com_RxAccessInfoGrpSigIndStartIdxOfRxSigGrpInfoType 0 0 0 255 ECU_ADDRESS 0x0 /end MEASUREMENT
/begin MEASUREMENT Com_RxSigGrpInfo[0].RxCbkFuncPtrAckIdxOfRxSigGrpInfo "" UBYTE Com_RxCbkFuncPtrAckIdxOfRxSigGrpInfoType 0 0 0 255 ECU_ADDRESS 0x0 /end MEASUREMENT
/begin MEASUREMENT Com_RxSigGrpInfo[0].RxCbkFuncPtrInvAckIdxOfRxSigGrpInfo "" UBYTE Com_RxCbkFuncPtrInvAckIdxOfRxSigGrpInfoType 0 0 0 255 ECU_ADDRESS 0x0 /end MEASUREMENT
/begin MEASUREMENT Com_RxSigGrpInfo[0].RxPduInfoIdxOfRxSigGrpInfo "" UBYTE NO_COMPU_METHOD 0 0 0 255 ECU_ADDRESS 0x0 /end MEASUREMENT
/begin MEASUREMENT Com_RxSigGrpInfo[0].RxTOutInfoIdxOfRxSigGrpInfo "" UBYTE Com_RxTOutInfoIdxOfRxSigGrpInfoType 0 0 0 255 ECU_ADDRESS 0x0 /end MEASUREMENT
/begin MEASUREMENT Com_RxSigGrpInfo[0].ShdBufferRequiredOfRxSigGrpInfo "" UBYTE Com_ShdBufferRequiredOfRxSigGrpInfoType 0 0 0 1 ECU_ADDRESS 0x0 /end MEASUREMENT
/begin MEASUREMENT Com_RxSigGrpInfo[0].StartBytePositionOfRxSigGrpInfo "" UBYTE NO_COMPU_METHOD 0 0 0 255 ECU_ADDRESS 0x0 /end MEASUREMENT
/begin MEASUREMENT Com_RxSigGrpInfo[0].ValidDlcOfRxSigGrpInfo "" UBYTE NO_COMPU_METHOD 0 0 0 255 ECU_ADDRESS 0x0 /end MEASUREMENT
/begin MEASUREMENT Com_RxSigGrpInfo[10].RxAccessInfoGrpSigIndEndIdxOfRxSigGrpInfo "" UBYTE Com_RxAccessInfoGrpSigIndEndIdxOfRxSigGrpInfoType 0 0 0 255 ECU_ADDRESS 0x0 /end MEASUREMENT
/begin MEASUREMENT Com_RxSigGrpInfo[10].RxAccessInfoGrpSigIndStartIdxOfRxSigGrpInfo "" UBYTE Com_RxAccessInfoGrpSigIndStartIdxOfRxSigGrpInfoType 0 0 0 255 ECU_ADDRESS 0x0 /end MEASUREMENT
/begin MEASUREMENT Com_RxSigGrpInfo[10].RxCbkFuncPtrAckIdxOfRxSigGrpInfo "" UBYTE Com_RxCbkFuncPtrAckIdxOfRxSigGrpInfoType 0 0 0 255 ECU_ADDRESS 0x0 /end MEASUREMENT
/begin MEASUREMENT Com_RxSigGrpInfo[10].RxCbkFuncPtrInvAckIdxOfRxSigGrpInfo "" UBYTE Com_RxCbkFuncPtrInvAckIdxOfRxSigGrpInfoType 0 0 0 255 ECU_ADDRESS 0x0 /end MEASUREMENT
/begin MEASUREMENT Com_RxSigGrpInfo[10].RxPduInfoIdxOfRxSigGrpInfo "" UBYTE NO_COMPU_METHOD 0 0 0 255 ECU_ADDRESS 0x0 /end MEASUREMENT
/begin MEASUREMENT Com_RxSigGrpInfo[10].RxTOutInfoIdxOfRxSigGrpInfo "" UBYTE Com_RxTOutInfoIdxOfRxSigGrpInfoType 0 0 0 255 ECU_ADDRESS 0x0 /end MEASUREMENT
/begin MEASUREMENT Com_RxSigGrpInfo[10].ShdBufferRequiredOfRxSigGrpInfo "" UBYTE Com_ShdBufferRequiredOfRxSigGrpInfoType 0 0 0 1 ECU_ADDRESS 0x0 /end MEASUREMENT
/begin MEASUREMENT Com_RxSigGrpInfo[10].StartBytePositionOfRxSigGrpInfo "" UBYTE NO_COMPU_METHOD 0 0 0 255 ECU_ADDRESS 0x0 /end MEASUREMENT
/begin MEASUREMENT Com_RxSigGrpInfo[10].ValidDlcOfRxSigGrpInfo "" UBYTE NO_COMPU_METHOD 0 0 0 255 ECU_ADDRESS 0x0 /end MEASUREMENT
/begin MEASUREMENT Com_RxSigGrpInfo[11].RxAccessInfoGrpSigIndEndIdxOfRxSigGrpInfo "" UBYTE Com_RxAccessInfoGrpSigIndEndIdxOfRxSigGrpInfoType 0 0 0 255 ECU_ADDRESS 0x0 /end MEASUREMENT
/begin MEASUREMENT Com_RxSigGrpInfo[11].RxAccessInfoGrpSigIndStartIdxOfRxSigGrpInfo "" UBYTE Com_RxAccessInfoGrpSigIndStartIdxOfRxSigGrpInfoType 0 0 0 255 ECU_ADDRESS 0x0 /end MEASUREMENT
/begin MEASUREMENT Com_RxSigGrpInfo[11].RxCbkFuncPtrAckIdxOfRxSigGrpInfo "" UBYTE Com_RxCbkFuncPtrAckIdxOfRxSigGrpInfoType 0 0 0 255 ECU_ADDRESS 0x0 /end MEASUREMENT
/begin MEASUREMENT Com_RxSigGrpInfo[11].RxCbkFuncPtrInvAckIdxOfRxSigGrpInfo "" UBYTE Com_RxCbkFuncPtrInvAckIdxOfRxSigGrpInfoType 0 0 0 255 ECU_ADDRESS 0x0 /end MEASUREMENT
/begin MEASUREMENT Com_RxSigGrpInfo[11].RxPduInfoIdxOfRxSigGrpInfo "" UBYTE NO_COMPU_METHOD 0 0 0 255 ECU_ADDRESS 0x0 /end MEASUREMENT
/begin MEASUREMENT Com_RxSigGrpInfo[11].RxTOutInfoIdxOfRxSigGrpInfo "" UBYTE Com_RxTOutInfoIdxOfRxSigGrpInfoType 0 0 0 255 ECU_ADDRESS 0x0 /end MEASUREMENT
/begin MEASUREMENT Com_RxSigGrpInfo[11].ShdBufferRequiredOfRxSigGrpInfo "" UBYTE Com_ShdBufferRequiredOfRxSigGrpInfoType 0 0 0 1 ECU_ADDRESS 0x0 /end MEASUREMENT
/begin MEASUREMENT Com_RxSigGrpInfo[11].StartBytePositionOfRxSigGrpInfo "" UBYTE NO_COMPU_METHOD 0 0 0 255 ECU_ADDRESS 0x0 /end MEASUREMENT
/begin MEASUREMENT Com_RxSigGrpInfo[11].ValidDlcOfRxSigGrpInfo "" UBYTE NO_COMPU_METHOD 0 0 0 255 ECU_ADDRESS 0x0 /end MEASUREMENT
/begin MEASUREMENT Com_RxSigGrpInfo[12].RxAccessInfoGrpSigIndEndIdxOfRxSigGrpInfo "" UBYTE Com_RxAccessInfoGrpSigIndEndIdxOfRxSigGrpInfoType 0 0 0 255 ECU_ADDRESS 0x0 /end MEASUREMENT
/begin MEASUREMENT Com_RxSigGrpInfo[12].RxAccessInfoGrpSigIndStartIdxOfRxSigGrpInfo "" UBYTE Com_RxAccessInfoGrpSigIndStartIdxOfRxSigGrpInfoType 0 0 0 255 ECU_ADDRESS 0x0 /end MEASUREMENT
/begin MEASUREMENT Com_RxSigGrpInfo[12].RxCbkFuncPtrAckIdxOfRxSigGrpInfo "" UBYTE Com_RxCbkFuncPtrAckIdxOfRxSigGrpInfoType 0 0 0 255 ECU_ADDRESS 0x0 /end MEASUREMENT
/begin MEASUREMENT Com_RxSigGrpInfo[12].RxCbkFuncPtrInvAckIdxOfRxSigGrpInfo "" UBYTE Com_RxCbkFuncPtrInvAckIdxOfRxSigGrpInfoType 0 0 0 255 ECU_ADDRESS 0x0 /end MEASUREMENT
/begin MEASUREMENT Com_RxSigGrpInfo[12].RxPduInfoIdxOfRxSigGrpInfo "" UBYTE NO_COMPU_METHOD 0 0 0 255 ECU_ADDRESS 0x0 /end MEASUREMENT
/begin MEASUREMENT Com_RxSigGrpInfo[12].RxTOutInfoIdxOfRxSigGrpInfo "" UBYTE Com_RxTOutInfoIdxOfRxSigGrpInfoType 0 0 0 255 ECU_ADDRESS 0x0 /end MEASUREMENT
/begin MEASUREMENT Com_RxSigGrpInfo[12].ShdBufferRequiredOfRxSigGrpInfo "" UBYTE Com_ShdBufferRequiredOfRxSigGrpInfoType 0 0 0 1 ECU_ADDRESS 0x0 /end MEASUREMENT
/begin MEASUREMENT Com_RxSigGrpInfo[12].StartBytePositionOfRxSigGrpInfo "" UBYTE NO_COMPU_METHOD 0 0 0 255 ECU_ADDRESS 0x0 /end MEASUREMENT
/begin MEASUREMENT Com_RxSigGrpInfo[12].ValidDlcOfRxSigGrpInfo "" UBYTE NO_COMPU_METHOD 0 0 0 255 ECU_ADDRESS 0x0 /end MEASUREMENT
/begin MEASUREMENT Com_RxSigGrpInfo[13].RxAccessInfoGrpSigIndEndIdxOfRxSigGrpInfo "" UBYTE Com_RxAccessInfoGrpSigIndEndIdxOfRxSigGrpInfoType 0 0 0 255 ECU_ADDRESS 0x0 /end MEASUREMENT
/begin MEASUREMENT Com_RxSigGrpInfo[13].RxAccessInfoGrpSigIndStartIdxOfRxSigGrpInfo "" UBYTE Com_RxAccessInfoGrpSigIndStartIdxOfRxSigGrpInfoType 0 0 0 255 ECU_ADDRESS 0x0 /end MEASUREMENT
/begin MEASUREMENT Com_RxSigGrpInfo[13].RxCbkFuncPtrAckIdxOfRxSigGrpInfo "" UBYTE Com_RxCbkFuncPtrAckIdxOfRxSigGrpInfoType 0 0 0 255 ECU_ADDRESS 0x0 /end MEASUREMENT
/begin MEASUREMENT Com_RxSigGrpInfo[13].RxCbkFuncPtrInvAckIdxOfRxSigGrpInfo "" UBYTE Com_RxCbkFuncPtrInvAckIdxOfRxSigGrpInfoType 0 0 0 255 ECU_ADDRESS 0x0 /end MEASUREMENT
/begin MEASUREMENT Com_RxSigGrpInfo[13].RxPduInfoIdxOfRxSigGrpInfo "" UBYTE NO_COMPU_METHOD 0 0 0 255 ECU_ADDRESS 0x0 /end MEASUREMENT
/begin MEASUREMENT Com_RxSigGrpInfo[13].RxTOutInfoIdxOfRxSigGrpInfo "" UBYTE Com_RxTOutInfoIdxOfRxSigGrpInfoType 0 0 0 255 ECU_ADDRESS 0x0 /end MEASUREMENT
/begin MEASUREMENT Com_RxSigGrpInfo[13].ShdBufferRequiredOfRxSigGrpInfo "" UBYTE Com_ShdBufferRequiredOfRxSigGrpInfoType 0 0 0 1 ECU_ADDRESS 0x0 /end MEASUREMENT
/begin MEASUREMENT Com_RxSigGrpInfo[13].StartBytePositionOfRxSigGrpInfo "" UBYTE NO_COMPU_METHOD 0 0 0 255 ECU_ADDRESS 0x0 /end MEASUREMENT
/begin MEASUREMENT Com_RxSigGrpInfo[13].ValidDlcOfRxSigGrpInfo "" UBYTE NO_COMPU_METHOD 0 0 0 255 ECU_ADDRESS 0x0 /end MEASUREMENT
/begin MEASUREMENT Com_RxSigGrpInfo[14].RxAccessInfoGrpSigIndEndIdxOfRxSigGrpInfo "" UBYTE Com_RxAccessInfoGrpSigIndEndIdxOfRxSigGrpInfoType 0 0 0 255 ECU_ADDRESS 0x0 /end MEASUREMENT
/begin MEASUREMENT Com_RxSigGrpInfo[14].RxAccessInfoGrpSigIndStartIdxOfRxSigGrpInfo "" UBYTE Com_RxAccessInfoGrpSigIndStartIdxOfRxSigGrpInfoType 0 0 0 255 ECU_ADDRESS 0x0 /end MEASUREMENT
/begin MEASUREMENT Com_RxSigGrpInfo[14].RxCbkFuncPtrAckIdxOfRxSigGrpInfo "" UBYTE Com_RxCbkFuncPtrAckIdxOfRxSigGrpInfoType 0 0 0 255 ECU_ADDRESS 0x0 /end MEASUREMENT
/begin MEASUREMENT Com_RxSigGrpInfo[14].RxCbkFuncPtrInvAckIdxOfRxSigGrpInfo "" UBYTE Com_RxCbkFuncPtrInvAckIdxOfRxSigGrpInfoType 0 0 0 255 ECU_ADDRESS 0x0 /end MEASUREMENT
/begin MEASUREMENT Com_RxSigGrpInfo[14].RxPduInfoIdxOfRxSigGrpInfo "" UBYTE NO_COMPU_METHOD 0 0 0 255 ECU_ADDRESS 0x0 /end MEASUREMENT
/begin MEASUREMENT Com_RxSigGrpInfo[14].RxTOutInfoIdxOfRxSigGrpInfo "" UBYTE Com_RxTOutInfoIdxOfRxSigGrpInfoType 0 0 0 255 ECU_ADDRESS 0x0 /end MEASUREMENT
/begin MEASUREMENT Com_RxSigGrpInfo[14].ShdBufferRequiredOfRxSigGrpInfo "" UBYTE Com_ShdBufferRequiredOfRxSigGrpInfoType 0 0 0 1 ECU_ADDRESS 0x0 /end MEASUREMENT
/begin MEASUREMENT Com_RxSigGrpInfo[14].StartBytePositionOfRxSigGrpInfo "" UBYTE NO_COMPU_METHOD 0 0 0 255 ECU_ADDRESS 0x0 /end MEASUREMENT
/begin MEASUREMENT Com_RxSigGrpInfo[14].ValidDlcOfRxSigGrpInfo "" UBYTE NO_COMPU_METHOD 0 0 0 255 ECU_ADDRESS 0x0 /end MEASUREMENT
/begin MEASUREMENT Com_RxSigGrpInfo[15].RxAccessInfoGrpSigIndEndIdxOfRxSigGrpInfo "" UBYTE Com_RxAccessInfoGrpSigIndEndIdxOfRxSigGrpInfoType 0 0 0 255 ECU_ADDRESS 0x0 /end MEASUREMENT
/begin MEASUREMENT Com_RxSigGrpInfo[15].RxAccessInfoGrpSigIndStartIdxOfRxSigGrpInfo "" UBYTE Com_RxAccessInfoGrpSigIndStartIdxOfRxSigGrpInfoType 0 0 0 255 ECU_ADDRESS 0x0 /end MEASUREMENT
/begin MEASUREMENT Com_RxSigGrpInfo[15].RxCbkFuncPtrAckIdxOfRxSigGrpInfo "" UBYTE Com_RxCbkFuncPtrAckIdxOfRxSigGrpInfoType 0 0 0 255 ECU_ADDRESS 0x0 /end MEASUREMENT
/begin MEASUREMENT Com_RxSigGrpInfo[15].RxCbkFuncPtrInvAckIdxOfRxSigGrpInfo "" UBYTE Com_RxCbkFuncPtrInvAckIdxOfRxSigGrpInfoType 0 0 0 255 ECU_ADDRESS 0x0 /end MEASUREMENT
/begin MEASUREMENT Com_RxSigGrpInfo[15].RxPduInfoIdxOfRxSigGrpInfo "" UBYTE NO_COMPU_METHOD 0 0 0 255 ECU_ADDRESS 0x0 /end MEASUREMENT
/begin MEASUREMENT Com_RxSigGrpInfo[15].RxTOutInfoIdxOfRxSigGrpInfo "" UBYTE Com_RxTOutInfoIdxOfRxSigGrpInfoType 0 0 0 255 ECU_ADDRESS 0x0 /end MEASUREMENT
/begin MEASUREMENT Com_RxSigGrpInfo[15].ShdBufferRequiredOfRxSigGrpInfo "" UBYTE Com_ShdBufferRequiredOfRxSigGrpInfoType 0 0 0 1 ECU_ADDRESS 0x0 /end MEASUREMENT
/begin MEASUREMENT Com_RxSigGrpInfo[15].StartBytePositionOfRxSigGrpInfo "" UBYTE NO_COMPU_METHOD 0 0 0 255 ECU_ADDRESS 0x0 /end MEASUREMENT
/begin MEASUREMENT Com_RxSigGrpInfo[15].ValidDlcOfRxSigGrpInfo "" UBYTE NO_COMPU_METHOD 0 0 0 255 ECU_ADDRESS 0x0 /end MEASUREMENT
/begin MEASUREMENT Com_RxSigGrpInfo[1].RxAccessInfoGrpSigIndEndIdxOfRxSigGrpInfo "" UBYTE Com_RxAccessInfoGrpSigIndEndIdxOfRxSigGrpInfoType 0 0 0 255 ECU_ADDRESS 0x0 /end MEASUREMENT
/begin MEASUREMENT Com_RxSigGrpInfo[1].RxAccessInfoGrpSigIndStartIdxOfRxSigGrpInfo "" UBYTE Com_RxAccessInfoGrpSigIndStartIdxOfRxSigGrpInfoType 0 0 0 255 ECU_ADDRESS 0x0 /end MEASUREMENT
/begin MEASUREMENT Com_RxSigGrpInfo[1].RxCbkFuncPtrAckIdxOfRxSigGrpInfo "" UBYTE Com_RxCbkFuncPtrAckIdxOfRxSigGrpInfoType 0 0 0 255 ECU_ADDRESS 0x0 /end MEASUREMENT
/begin MEASUREMENT Com_RxSigGrpInfo[1].RxCbkFuncPtrInvAckIdxOfRxSigGrpInfo "" UBYTE Com_RxCbkFuncPtrInvAckIdxOfRxSigGrpInfoType 0 0 0 255 ECU_ADDRESS 0x0 /end MEASUREMENT
/begin MEASUREMENT Com_RxSigGrpInfo[1].RxPduInfoIdxOfRxSigGrpInfo "" UBYTE NO_COMPU_METHOD 0 0 0 255 ECU_ADDRESS 0x0 /end MEASUREMENT
/begin MEASUREMENT Com_RxSigGrpInfo[1].RxTOutInfoIdxOfRxSigGrpInfo "" UBYTE Com_RxTOutInfoIdxOfRxSigGrpInfoType 0 0 0 255 ECU_ADDRESS 0x0 /end MEASUREMENT
/begin MEASUREMENT Com_RxSigGrpInfo[1].ShdBufferRequiredOfRxSigGrpInfo "" UBYTE Com_ShdBufferRequiredOfRxSigGrpInfoType 0 0 0 1 ECU_ADDRESS 0x0 /end MEASUREMENT
/begin MEASUREMENT Com_RxSigGrpInfo[1].StartBytePositionOfRxSigGrpInfo "" UBYTE NO_COMPU_METHOD 0 0 0 255 ECU_ADDRESS 0x0 /end MEASUREMENT
/begin MEASUREMENT Com_RxSigGrpInfo[1].ValidDlcOfRxSigGrpInfo "" UBYTE NO_COMPU_METHOD 0 0 0 255 ECU_ADDRESS 0x0 /end MEASUREMENT
/begin MEASUREMENT Com_RxSigGrpInfo[2].RxAccessInfoGrpSigIndEndIdxOfRxSigGrpInfo "" UBYTE Com_RxAccessInfoGrpSigIndEndIdxOfRxSigGrpInfoType 0 0 0 255 ECU_ADDRESS 0x0 /end MEASUREMENT
/begin MEASUREMENT Com_RxSigGrpInfo[2].RxAccessInfoGrpSigIndStartIdxOfRxSigGrpInfo "" UBYTE Com_RxAccessInfoGrpSigIndStartIdxOfRxSigGrpInfoType 0 0 0 255 ECU_ADDRESS 0x0 /end MEASUREMENT
/begin MEASUREMENT Com_RxSigGrpInfo[2].RxCbkFuncPtrAckIdxOfRxSigGrpInfo "" UBYTE Com_RxCbkFuncPtrAckIdxOfRxSigGrpInfoType 0 0 0 255 ECU_ADDRESS 0x0 /end MEASUREMENT
/begin MEASUREMENT Com_RxSigGrpInfo[2].RxCbkFuncPtrInvAckIdxOfRxSigGrpInfo "" UBYTE Com_RxCbkFuncPtrInvAckIdxOfRxSigGrpInfoType 0 0 0 255 ECU_ADDRESS 0x0 /end MEASUREMENT
/begin MEASUREMENT Com_RxSigGrpInfo[2].RxPduInfoIdxOfRxSigGrpInfo "" UBYTE NO_COMPU_METHOD 0 0 0 255 ECU_ADDRESS 0x0 /end MEASUREMENT
/begin MEASUREMENT Com_RxSigGrpInfo[2].RxTOutInfoIdxOfRxSigGrpInfo "" UBYTE Com_RxTOutInfoIdxOfRxSigGrpInfoType 0 0 0 255 ECU_ADDRESS 0x0 /end MEASUREMENT
/begin MEASUREMENT Com_RxSigGrpInfo[2].ShdBufferRequiredOfRxSigGrpInfo "" UBYTE Com_ShdBufferRequiredOfRxSigGrpInfoType 0 0 0 1 ECU_ADDRESS 0x0 /end MEASUREMENT
/begin MEASUREMENT Com_RxSigGrpInfo[2].StartBytePositionOfRxSigGrpInfo "" UBYTE NO_COMPU_METHOD 0 0 0 255 ECU_ADDRESS 0x0 /end MEASUREMENT
/begin MEASUREMENT Com_RxSigGrpInfo[2].ValidDlcOfRxSigGrpInfo "" UBYTE NO_COMPU_METHOD 0 0 0 255 ECU_ADDRESS 0x0 /end MEASUREMENT
/begin MEASUREMENT Com_RxSigGrpInfo[3].RxAccessInfoGrpSigIndEndIdxOfRxSigGrpInfo "" UBYTE Com_RxAccessInfoGrpSigIndEndIdxOfRxSigGrpInfoType 0 0 0 255 ECU_ADDRESS 0x0 /end MEASUREMENT
/begin MEASUREMENT Com_RxSigGrpInfo[3].RxAccessInfoGrpSigIndStartIdxOfRxSigGrpInfo "" UBYTE Com_RxAccessInfoGrpSigIndStartIdxOfRxSigGrpInfoType 0 0 0 255 ECU_ADDRESS 0x0 /end MEASUREMENT
/begin MEASUREMENT Com_RxSigGrpInfo[3].RxCbkFuncPtrAckIdxOfRxSigGrpInfo "" UBYTE Com_RxCbkFuncPtrAckIdxOfRxSigGrpInfoType 0 0 0 255 ECU_ADDRESS 0x0 /end MEASUREMENT
/begin MEASUREMENT Com_RxSigGrpInfo[3].RxCbkFuncPtrInvAckIdxOfRxSigGrpInfo "" UBYTE Com_RxCbkFuncPtrInvAckIdxOfRxSigGrpInfoType 0 0 0 255 ECU_ADDRESS 0x0 /end MEASUREMENT
/begin MEASUREMENT Com_RxSigGrpInfo[3].RxPduInfoIdxOfRxSigGrpInfo "" UBYTE NO_COMPU_METHOD 0 0 0 255 ECU_ADDRESS 0x0 /end MEASUREMENT
/begin MEASUREMENT Com_RxSigGrpInfo[3].RxTOutInfoIdxOfRxSigGrpInfo "" UBYTE Com_RxTOutInfoIdxOfRxSigGrpInfoType 0 0 0 255 ECU_ADDRESS 0x0 /end MEASUREMENT
/begin MEASUREMENT Com_RxSigGrpInfo[3].ShdBufferRequiredOfRxSigGrpInfo "" UBYTE Com_ShdBufferRequiredOfRxSigGrpInfoType 0 0 0 1 ECU_ADDRESS 0x0 /end MEASUREMENT
/begin MEASUREMENT Com_RxSigGrpInfo[3].StartBytePositionOfRxSigGrpInfo "" UBYTE NO_COMPU_METHOD 0 0 0 255 ECU_ADDRESS 0x0 /end MEASUREMENT
/begin MEASUREMENT Com_RxSigGrpInfo[3].ValidDlcOfRxSigGrpInfo "" UBYTE NO_COMPU_METHOD 0 0 0 255 ECU_ADDRESS 0x0 /end MEASUREMENT
/begin MEASUREMENT Com_RxSigGrpInfo[4].RxAccessInfoGrpSigIndEndIdxOfRxSigGrpInfo "" UBYTE Com_RxAccessInfoGrpSigIndEndIdxOfRxSigGrpInfoType 0 0 0 255 ECU_ADDRESS 0x0 /end MEASUREMENT
/begin MEASUREMENT Com_RxSigGrpInfo[4].RxAccessInfoGrpSigIndStartIdxOfRxSigGrpInfo "" UBYTE Com_RxAccessInfoGrpSigIndStartIdxOfRxSigGrpInfoType 0 0 0 255 ECU_ADDRESS 0x0 /end MEASUREMENT
/begin MEASUREMENT Com_RxSigGrpInfo[4].RxCbkFuncPtrAckIdxOfRxSigGrpInfo "" UBYTE Com_RxCbkFuncPtrAckIdxOfRxSigGrpInfoType 0 0 0 255 ECU_ADDRESS 0x0 /end MEASUREMENT
/begin MEASUREMENT Com_RxSigGrpInfo[4].RxCbkFuncPtrInvAckIdxOfRxSigGrpInfo "" UBYTE Com_RxCbkFuncPtrInvAckIdxOfRxSigGrpInfoType 0 0 0 255 ECU_ADDRESS 0x0 /end MEASUREMENT
/begin MEASUREMENT Com_RxSigGrpInfo[4].RxPduInfoIdxOfRxSigGrpInfo "" UBYTE NO_COMPU_METHOD 0 0 0 255 ECU_ADDRESS 0x0 /end MEASUREMENT
/begin MEASUREMENT Com_RxSigGrpInfo[4].RxTOutInfoIdxOfRxSigGrpInfo "" UBYTE Com_RxTOutInfoIdxOfRxSigGrpInfoType 0 0 0 255 ECU_ADDRESS 0x0 /end MEASUREMENT
/begin MEASUREMENT Com_RxSigGrpInfo[4].ShdBufferRequiredOfRxSigGrpInfo "" UBYTE Com_ShdBufferRequiredOfRxSigGrpInfoType 0 0 0 1 ECU_ADDRESS 0x0 /end MEASUREMENT
/begin MEASUREMENT Com_RxSigGrpInfo[4].StartBytePositionOfRxSigGrpInfo "" UBYTE NO_COMPU_METHOD 0 0 0 255 ECU_ADDRESS 0x0 /end MEASUREMENT
/begin MEASUREMENT Com_RxSigGrpInfo[4].ValidDlcOfRxSigGrpInfo "" UBYTE NO_COMPU_METHOD 0 0 0 255 ECU_ADDRESS 0x0 /end MEASUREMENT
/begin MEASUREMENT Com_RxSigGrpInfo[5].RxAccessInfoGrpSigIndEndIdxOfRxSigGrpInfo "" UBYTE Com_RxAccessInfoGrpSigIndEndIdxOfRxSigGrpInfoType 0 0 0 255 ECU_ADDRESS 0x0 /end MEASUREMENT
/begin MEASUREMENT Com_RxSigGrpInfo[5].RxAccessInfoGrpSigIndStartIdxOfRxSigGrpInfo "" UBYTE Com_RxAccessInfoGrpSigIndStartIdxOfRxSigGrpInfoType 0 0 0 255 ECU_ADDRESS 0x0 /end MEASUREMENT
/begin MEASUREMENT Com_RxSigGrpInfo[5].RxCbkFuncPtrAckIdxOfRxSigGrpInfo "" UBYTE Com_RxCbkFuncPtrAckIdxOfRxSigGrpInfoType 0 0 0 255 ECU_ADDRESS 0x0 /end MEASUREMENT
/begin MEASUREMENT Com_RxSigGrpInfo[5].RxCbkFuncPtrInvAckIdxOfRxSigGrpInfo "" UBYTE Com_RxCbkFuncPtrInvAckIdxOfRxSigGrpInfoType 0 0 0 255 ECU_ADDRESS 0x0 /end MEASUREMENT
/begin MEASUREMENT Com_RxSigGrpInfo[5].RxPduInfoIdxOfRxSigGrpInfo "" UBYTE NO_COMPU_METHOD 0 0 0 255 ECU_ADDRESS 0x0 /end MEASUREMENT
/begin MEASUREMENT Com_RxSigGrpInfo[5].RxTOutInfoIdxOfRxSigGrpInfo "" UBYTE Com_RxTOutInfoIdxOfRxSigGrpInfoType 0 0 0 255 ECU_ADDRESS 0x0 /end MEASUREMENT
/begin MEASUREMENT Com_RxSigGrpInfo[5].ShdBufferRequiredOfRxSigGrpInfo "" UBYTE Com_ShdBufferRequiredOfRxSigGrpInfoType 0 0 0 1 ECU_ADDRESS 0x0 /end MEASUREMENT
/begin MEASUREMENT Com_RxSigGrpInfo[5].StartBytePositionOfRxSigGrpInfo "" UBYTE NO_COMPU_METHOD 0 0 0 255 ECU_ADDRESS 0x0 /end MEASUREMENT
/begin MEASUREMENT Com_RxSigGrpInfo[5].ValidDlcOfRxSigGrpInfo "" UBYTE NO_COMPU_METHOD 0 0 0 255 ECU_ADDRESS 0x0 /end MEASUREMENT
/begin MEASUREMENT Com_RxSigGrpInfo[6].RxAccessInfoGrpSigIndEndIdxOfRxSigGrpInfo "" UBYTE Com_RxAccessInfoGrpSigIndEndIdxOfRxSigGrpInfoType 0 0 0 255 ECU_ADDRESS 0x0 /end MEASUREMENT
/begin MEASUREMENT Com_RxSigGrpInfo[6].RxAccessInfoGrpSigIndStartIdxOfRxSigGrpInfo "" UBYTE Com_RxAccessInfoGrpSigIndStartIdxOfRxSigGrpInfoType 0 0 0 255 ECU_ADDRESS 0x0 /end MEASUREMENT
/begin MEASUREMENT Com_RxSigGrpInfo[6].RxCbkFuncPtrAckIdxOfRxSigGrpInfo "" UBYTE Com_RxCbkFuncPtrAckIdxOfRxSigGrpInfoType 0 0 0 255 ECU_ADDRESS 0x0 /end MEASUREMENT
/begin MEASUREMENT Com_RxSigGrpInfo[6].RxCbkFuncPtrInvAckIdxOfRxSigGrpInfo "" UBYTE Com_RxCbkFuncPtrInvAckIdxOfRxSigGrpInfoType 0 0 0 255 ECU_ADDRESS 0x0 /end MEASUREMENT
/begin MEASUREMENT Com_RxSigGrpInfo[6].RxPduInfoIdxOfRxSigGrpInfo "" UBYTE NO_COMPU_METHOD 0 0 0 255 ECU_ADDRESS 0x0 /end MEASUREMENT
/begin MEASUREMENT Com_RxSigGrpInfo[6].RxTOutInfoIdxOfRxSigGrpInfo "" UBYTE Com_RxTOutInfoIdxOfRxSigGrpInfoType 0 0 0 255 ECU_ADDRESS 0x0 /end MEASUREMENT
/begin MEASUREMENT Com_RxSigGrpInfo[6].ShdBufferRequiredOfRxSigGrpInfo "" UBYTE Com_ShdBufferRequiredOfRxSigGrpInfoType 0 0 0 1 ECU_ADDRESS 0x0 /end MEASUREMENT
/begin MEASUREMENT Com_RxSigGrpInfo[6].StartBytePositionOfRxSigGrpInfo "" UBYTE NO_COMPU_METHOD 0 0 0 255 ECU_ADDRESS 0x0 /end MEASUREMENT
/begin MEASUREMENT Com_RxSigGrpInfo[6].ValidDlcOfRxSigGrpInfo "" UBYTE NO_COMPU_METHOD 0 0 0 255 ECU_ADDRESS 0x0 /end MEASUREMENT
/begin MEASUREMENT Com_RxSigGrpInfo[7].RxAccessInfoGrpSigIndEndIdxOfRxSigGrpInfo "" UBYTE Com_RxAccessInfoGrpSigIndEndIdxOfRxSigGrpInfoType 0 0 0 255 ECU_ADDRESS 0x0 /end MEASUREMENT
/begin MEASUREMENT Com_RxSigGrpInfo[7].RxAccessInfoGrpSigIndStartIdxOfRxSigGrpInfo "" UBYTE Com_RxAccessInfoGrpSigIndStartIdxOfRxSigGrpInfoType 0 0 0 255 ECU_ADDRESS 0x0 /end MEASUREMENT
/begin MEASUREMENT Com_RxSigGrpInfo[7].RxCbkFuncPtrAckIdxOfRxSigGrpInfo "" UBYTE Com_RxCbkFuncPtrAckIdxOfRxSigGrpInfoType 0 0 0 255 ECU_ADDRESS 0x0 /end MEASUREMENT
/begin MEASUREMENT Com_RxSigGrpInfo[7].RxCbkFuncPtrInvAckIdxOfRxSigGrpInfo "" UBYTE Com_RxCbkFuncPtrInvAckIdxOfRxSigGrpInfoType 0 0 0 255 ECU_ADDRESS 0x0 /end MEASUREMENT
/begin MEASUREMENT Com_RxSigGrpInfo[7].RxPduInfoIdxOfRxSigGrpInfo "" UBYTE NO_COMPU_METHOD 0 0 0 255 ECU_ADDRESS 0x0 /end MEASUREMENT
/begin MEASUREMENT Com_RxSigGrpInfo[7].RxTOutInfoIdxOfRxSigGrpInfo "" UBYTE Com_RxTOutInfoIdxOfRxSigGrpInfoType 0 0 0 255 ECU_ADDRESS 0x0 /end MEASUREMENT
/begin MEASUREMENT Com_RxSigGrpInfo[7].ShdBufferRequiredOfRxSigGrpInfo "" UBYTE Com_ShdBufferRequiredOfRxSigGrpInfoType 0 0 0 1 ECU_ADDRESS 0x0 /end MEASUREMENT
/begin MEASUREMENT Com_RxSigGrpInfo[7].StartBytePositionOfRxSigGrpInfo "" UBYTE NO_COMPU_METHOD 0 0 0 255 ECU_ADDRESS 0x0 /end MEASUREMENT
/begin MEASUREMENT Com_RxSigGrpInfo[7].ValidDlcOfRxSigGrpInfo "" UBYTE NO_COMPU_METHOD 0 0 0 255 ECU_ADDRESS 0x0 /end MEASUREMENT
/begin MEASUREMENT Com_RxSigGrpInfo[8].RxAccessInfoGrpSigIndEndIdxOfRxSigGrpInfo "" UBYTE Com_RxAccessInfoGrpSigIndEndIdxOfRxSigGrpInfoType 0 0 0 255 ECU_ADDRESS 0x0 /end MEASUREMENT
/begin MEASUREMENT Com_RxSigGrpInfo[8].RxAccessInfoGrpSigIndStartIdxOfRxSigGrpInfo "" UBYTE Com_RxAccessInfoGrpSigIndStartIdxOfRxSigGrpInfoType 0 0 0 255 ECU_ADDRESS 0x0 /end MEASUREMENT
/begin MEASUREMENT Com_RxSigGrpInfo[8].RxCbkFuncPtrAckIdxOfRxSigGrpInfo "" UBYTE Com_RxCbkFuncPtrAckIdxOfRxSigGrpInfoType 0 0 0 255 ECU_ADDRESS 0x0 /end MEASUREMENT
/begin MEASUREMENT Com_RxSigGrpInfo[8].RxCbkFuncPtrInvAckIdxOfRxSigGrpInfo "" UBYTE Com_RxCbkFuncPtrInvAckIdxOfRxSigGrpInfoType 0 0 0 255 ECU_ADDRESS 0x0 /end MEASUREMENT
/begin MEASUREMENT Com_RxSigGrpInfo[8].RxPduInfoIdxOfRxSigGrpInfo "" UBYTE NO_COMPU_METHOD 0 0 0 255 ECU_ADDRESS 0x0 /end MEASUREMENT
/begin MEASUREMENT Com_RxSigGrpInfo[8].RxTOutInfoIdxOfRxSigGrpInfo "" UBYTE Com_RxTOutInfoIdxOfRxSigGrpInfoType 0 0 0 255 ECU_ADDRESS 0x0 /end MEASUREMENT
/begin MEASUREMENT Com_RxSigGrpInfo[8].ShdBufferRequiredOfRxSigGrpInfo "" UBYTE Com_ShdBufferRequiredOfRxSigGrpInfoType 0 0 0 1 ECU_ADDRESS 0x0 /end MEASUREMENT
/begin MEASUREMENT Com_RxSigGrpInfo[8].StartBytePositionOfRxSigGrpInfo "" UBYTE NO_COMPU_METHOD 0 0 0 255 ECU_ADDRESS 0x0 /end MEASUREMENT
/begin MEASUREMENT Com_RxSigGrpInfo[8].ValidDlcOfRxSigGrpInfo "" UBYTE NO_COMPU_METHOD 0 0 0 255 ECU_ADDRESS 0x0 /end MEASUREMENT
/begin MEASUREMENT Com_RxSigGrpInfo[9].RxAccessInfoGrpSigIndEndIdxOfRxSigGrpInfo "" UBYTE Com_RxAccessInfoGrpSigIndEndIdxOfRxSigGrpInfoType 0 0 0 255 ECU_ADDRESS 0x0 /end MEASUREMENT
/begin MEASUREMENT Com_RxSigGrpInfo[9].RxAccessInfoGrpSigIndStartIdxOfRxSigGrpInfo "" UBYTE Com_RxAccessInfoGrpSigIndStartIdxOfRxSigGrpInfoType 0 0 0 255 ECU_ADDRESS 0x0 /end MEASUREMENT
/begin MEASUREMENT Com_RxSigGrpInfo[9].RxCbkFuncPtrAckIdxOfRxSigGrpInfo "" UBYTE Com_RxCbkFuncPtrAckIdxOfRxSigGrpInfoType 0 0 0 255 ECU_ADDRESS 0x0 /end MEASUREMENT
/begin MEASUREMENT Com_RxSigGrpInfo[9].RxCbkFuncPtrInvAckIdxOfRxSigGrpInfo "" UBYTE Com_RxCbkFuncPtrInvAckIdxOfRxSigGrpInfoType 0 0 0 255 ECU_ADDRESS 0x0 /end MEASUREMENT
/begin MEASUREMENT Com_RxSigGrpInfo[9].RxPduInfoIdxOfRxSigGrpInfo "" UBYTE NO_COMPU_METHOD 0 0 0 255 ECU_ADDRESS 0x0 /end MEASUREMENT
/begin MEASUREMENT Com_RxSigGrpInfo[9].RxTOutInfoIdxOfRxSigGrpInfo "" UBYTE Com_RxTOutInfoIdxOfRxSigGrpInfoType 0 0 0 255 ECU_ADDRESS 0x0 /end MEASUREMENT
/begin MEASUREMENT Com_RxSigGrpInfo[9].ShdBufferRequiredOfRxSigGrpInfo "" UBYTE Com_ShdBufferRequiredOfRxSigGrpInfoType 0 0 0 1 ECU_ADDRESS 0x0 /end MEASUREMENT
/begin MEASUREMENT Com_RxSigGrpInfo[9].StartBytePositionOfRxSigGrpInfo "" UBYTE NO_COMPU_METHOD 0 0 0 255 ECU_ADDRESS 0x0 /end MEASUREMENT
/begin MEASUREMENT Com_RxSigGrpInfo[9].ValidDlcOfRxSigGrpInfo "" UBYTE NO_COMPU_METHOD 0 0 0 255 ECU_ADDRESS 0x0 /end MEASUREMENT
/begin MEASUREMENT Com_RxSigInfo[0].RxAccessInfoIdxOfRxSigInfo "" UWORD NO_COMPU_METHOD 0 0 0 65535 ECU_ADDRESS 0x0 /end MEASUREMENT
/begin MEASUREMENT Com_RxSigInfo[0].RxCbkFuncPtrAckIdxOfRxSigInfo "" UBYTE Com_RxCbkFuncPtrAckIdxOfRxSigInfoType 0 0 0 255 ECU_ADDRESS 0x0 /end MEASUREMENT
/begin MEASUREMENT Com_RxSigInfo[0].SignalProcessingOfRxSigInfo "" UBYTE Com_SignalProcessingOfRxSigInfoType 0 0 0 255 ECU_ADDRESS 0x0 /end MEASUREMENT
/begin MEASUREMENT Com_RxSigInfo[0].ValidDlcOfRxSigInfo "" UBYTE NO_COMPU_METHOD 0 0 0 255 ECU_ADDRESS 0x0 /end MEASUREMENT
/begin MEASUREMENT Com_RxSigInfo[100].RxAccessInfoIdxOfRxSigInfo "" UWORD NO_COMPU_METHOD 0 0 0 65535 ECU_ADDRESS 0x0 /end MEASUREMENT
/begin MEASUREMENT Com_RxSigInfo[100].RxCbkFuncPtrAckIdxOfRxSigInfo "" UBYTE Com_RxCbkFuncPtrAckIdxOfRxSigInfoType 0 0 0 255 ECU_ADDRESS 0x0 /end MEASUREMENT
/begin MEASUREMENT Com_RxSigInfo[100].SignalProcessingOfRxSigInfo "" UBYTE Com_SignalProcessingOfRxSigInfoType 0 0 0 255 ECU_ADDRESS 0x0 /end MEASUREMENT
/begin MEASUREMENT Com_RxSigInfo[100].ValidDlcOfRxSigInfo "" UBYTE NO_COMPU_METHOD 0 0 0 255 ECU_ADDRESS 0x0 /end MEASUREMENT
/begin MEASUREMENT Com_RxSigInfo[101].RxAccessInfoIdxOfRxSigInfo "" UWORD NO_COMPU_METHOD 0 0 0 65535 ECU_ADDRESS 0x0 /end MEASUREMENT
/begin MEASUREMENT Com_RxSigInfo[101].RxCbkFuncPtrAckIdxOfRxSigInfo "" UBYTE Com_RxCbkFuncPtrAckIdxOfRxSigInfoType 0 0 0 255 ECU_ADDRESS 0x0 /end MEASUREMENT
/begin MEASUREMENT Com_RxSigInfo[101].SignalProcessingOfRxSigInfo "" UBYTE Com_SignalProcessingOfRxSigInfoType 0 0 0 255 ECU_ADDRESS 0x0 /end MEASUREMENT
/begin MEASUREMENT Com_RxSigInfo[101].ValidDlcOfRxSigInfo "" UBYTE NO_COMPU_METHOD 0 0 0 255 ECU_ADDRESS 0x0 /end MEASUREMENT
/begin MEASUREMENT Com_RxSigInfo[102].RxAccessInfoIdxOfRxSigInfo "" UWORD NO_COMPU_METHOD 0 0 0 65535 ECU_ADDRESS 0x0 /end MEASUREMENT
/begin MEASUREMENT Com_RxSigInfo[102].RxCbkFuncPtrAckIdxOfRxSigInfo "" UBYTE Com_RxCbkFuncPtrAckIdxOfRxSigInfoType 0 0 0 255 ECU_ADDRESS 0x0 /end MEASUREMENT
/begin MEASUREMENT Com_RxSigInfo[102].SignalProcessingOfRxSigInfo "" UBYTE Com_SignalProcessingOfRxSigInfoType 0 0 0 255 ECU_ADDRESS 0x0 /end MEASUREMENT
/begin MEASUREMENT Com_RxSigInfo[102].ValidDlcOfRxSigInfo "" UBYTE NO_COMPU_METHOD 0 0 0 255 ECU_ADDRESS 0x0 /end MEASUREMENT
/begin MEASUREMENT Com_RxSigInfo[103].RxAccessInfoIdxOfRxSigInfo "" UWORD NO_COMPU_METHOD 0 0 0 65535 ECU_ADDRESS 0x0 /end MEASUREMENT
/begin MEASUREMENT Com_RxSigInfo[103].RxCbkFuncPtrAckIdxOfRxSigInfo "" UBYTE Com_RxCbkFuncPtrAckIdxOfRxSigInfoType 0 0 0 255 ECU_ADDRESS 0x0 /end MEASUREMENT
/begin MEASUREMENT Com_RxSigInfo[103].SignalProcessingOfRxSigInfo "" UBYTE Com_SignalProcessingOfRxSigInfoType 0 0 0 255 ECU_ADDRESS 0x0 /end MEASUREMENT
/begin MEASUREMENT Com_RxSigInfo[103].ValidDlcOfRxSigInfo "" UBYTE NO_COMPU_METHOD 0 0 0 255 ECU_ADDRESS 0x0 /end MEASUREMENT
/begin MEASUREMENT Com_RxSigInfo[104].RxAccessInfoIdxOfRxSigInfo "" UWORD NO_COMPU_METHOD 0 0 0 65535 ECU_ADDRESS 0x0 /end MEASUREMENT
/begin MEASUREMENT Com_RxSigInfo[104].RxCbkFuncPtrAckIdxOfRxSigInfo "" UBYTE Com_RxCbkFuncPtrAckIdxOfRxSigInfoType 0 0 0 255 ECU_ADDRESS 0x0 /end MEASUREMENT
/begin MEASUREMENT Com_RxSigInfo[104].SignalProcessingOfRxSigInfo "" UBYTE Com_SignalProcessingOfRxSigInfoType 0 0 0 255 ECU_ADDRESS 0x0 /end MEASUREMENT
/begin MEASUREMENT Com_RxSigInfo[104].ValidDlcOfRxSigInfo "" UBYTE NO_COMPU_METHOD 0 0 0 255 ECU_ADDRESS 0x0 /end MEASUREMENT
/begin MEASUREMENT Com_RxSigInfo[105].RxAccessInfoIdxOfRxSigInfo "" UWORD NO_COMPU_METHOD 0 0 0 65535 ECU_ADDRESS 0x0 /end MEASUREMENT
/begin MEASUREMENT Com_RxSigInfo[105].RxCbkFuncPtrAckIdxOfRxSigInfo "" UBYTE Com_RxCbkFuncPtrAckIdxOfRxSigInfoType 0 0 0 255 ECU_ADDRESS 0x0 /end MEASUREMENT
/begin MEASUREMENT Com_RxSigInfo[105].SignalProcessingOfRxSigInfo "" UBYTE Com_SignalProcessingOfRxSigInfoType 0 0 0 255 ECU_ADDRESS 0x0 /end MEASUREMENT
/begin MEASUREMENT Com_RxSigInfo[105].ValidDlcOfRxSigInfo "" UBYTE NO_COMPU_METHOD 0 0 0 255 ECU_ADDRESS 0x0 /end MEASUREMENT
/begin MEASUREMENT Com_RxSigInfo[106].RxAccessInfoIdxOfRxSigInfo "" UWORD NO_COMPU_METHOD 0 0 0 65535 ECU_ADDRESS 0x0 /end MEASUREMENT
/begin MEASUREMENT Com_RxSigInfo[106].RxCbkFuncPtrAckIdxOfRxSigInfo "" UBYTE Com_RxCbkFuncPtrAckIdxOfRxSigInfoType 0 0 0 255 ECU_ADDRESS 0x0 /end MEASUREMENT
/begin MEASUREMENT Com_RxSigInfo[106].SignalProcessingOfRxSigInfo "" UBYTE Com_SignalProcessingOfRxSigInfoType 0 0 0 255 ECU_ADDRESS 0x0 /end MEASUREMENT
/begin MEASUREMENT Com_RxSigInfo[106].ValidDlcOfRxSigInfo "" UBYTE NO_COMPU_METHOD 0 0 0 255 ECU_ADDRESS 0x0 /end MEASUREMENT
/begin MEASUREMENT Com_RxSigInfo[107].RxAccessInfoIdxOfRxSigInfo "" UWORD NO_COMPU_METHOD 0 0 0 65535 ECU_ADDRESS 0x0 /end MEASUREMENT
/begin MEASUREMENT Com_RxSigInfo[107].RxCbkFuncPtrAckIdxOfRxSigInfo "" UBYTE Com_RxCbkFuncPtrAckIdxOfRxSigInfoType 0 0 0 255 ECU_ADDRESS 0x0 /end MEASUREMENT
/begin MEASUREMENT Com_RxSigInfo[107].SignalProcessingOfRxSigInfo "" UBYTE Com_SignalProcessingOfRxSigInfoType 0 0 0 255 ECU_ADDRESS 0x0 /end MEASUREMENT
/begin MEASUREMENT Com_RxSigInfo[107].ValidDlcOfRxSigInfo "" UBYTE NO_COMPU_METHOD 0 0 0 255 ECU_ADDRESS 0x0 /end MEASUREMENT
/begin MEASUREMENT Com_RxSigInfo[108].RxAccessInfoIdxOfRxSigInfo "" UWORD NO_COMPU_METHOD 0 0 0 65535 ECU_ADDRESS 0x0 /end MEASUREMENT
/begin MEASUREMENT Com_RxSigInfo[108].RxCbkFuncPtrAckIdxOfRxSigInfo "" UBYTE Com_RxCbkFuncPtrAckIdxOfRxSigInfoType 0 0 0 255 ECU_ADDRESS 0x0 /end MEASUREMENT
/begin MEASUREMENT Com_RxSigInfo[108].SignalProcessingOfRxSigInfo "" UBYTE Com_SignalProcessingOfRxSigInfoType 0 0 0 255 ECU_ADDRESS 0x0 /end MEASUREMENT
/begin MEASUREMENT Com_RxSigInfo[108].ValidDlcOfRxSigInfo "" UBYTE NO_COMPU_METHOD 0 0 0 255 ECU_ADDRESS 0x0 /end MEASUREMENT
/begin MEASUREMENT Com_RxSigInfo[109].RxAccessInfoIdxOfRxSigInfo "" UWORD NO_COMPU_METHOD 0 0 0 65535 ECU_ADDRESS 0x0 /end MEASUREMENT
/begin MEASUREMENT Com_RxSigInfo[109].RxCbkFuncPtrAckIdxOfRxSigInfo "" UBYTE Com_RxCbkFuncPtrAckIdxOfRxSigInfoType 0 0 0 255 ECU_ADDRESS 0x0 /end MEASUREMENT
/begin MEASUREMENT Com_RxSigInfo[109].SignalProcessingOfRxSigInfo "" UBYTE Com_SignalProcessingOfRxSigInfoType 0 0 0 255 ECU_ADDRESS 0x0 /end MEASUREMENT
/begin MEASUREMENT Com_RxSigInfo[109].ValidDlcOfRxSigInfo "" UBYTE NO_COMPU_METHOD 0 0 0 255 ECU_ADDRESS 0x0 /end MEASUREMENT
/begin MEASUREMENT Com_RxSigInfo[10].RxAccessInfoIdxOfRxSigInfo "" UWORD NO_COMPU_METHOD 0 0 0 65535 ECU_ADDRESS 0x0 /end MEASUREMENT
/begin MEASUREMENT Com_RxSigInfo[10].RxCbkFuncPtrAckIdxOfRxSigInfo "" UBYTE Com_RxCbkFuncPtrAckIdxOfRxSigInfoType 0 0 0 255 ECU_ADDRESS 0x0 /end MEASUREMENT
/begin MEASUREMENT Com_RxSigInfo[10].SignalProcessingOfRxSigInfo "" UBYTE Com_SignalProcessingOfRxSigInfoType 0 0 0 255 ECU_ADDRESS 0x0 /end MEASUREMENT
/begin MEASUREMENT Com_RxSigInfo[10].ValidDlcOfRxSigInfo "" UBYTE NO_COMPU_METHOD 0 0 0 255 ECU_ADDRESS 0x0 /end MEASUREMENT
/begin MEASUREMENT Com_RxSigInfo[110].RxAccessInfoIdxOfRxSigInfo "" UWORD NO_COMPU_METHOD 0 0 0 65535 ECU_ADDRESS 0x0 /end MEASUREMENT
/begin MEASUREMENT Com_RxSigInfo[110].RxCbkFuncPtrAckIdxOfRxSigInfo "" UBYTE Com_RxCbkFuncPtrAckIdxOfRxSigInfoType 0 0 0 255 ECU_ADDRESS 0x0 /end MEASUREMENT
/begin MEASUREMENT Com_RxSigInfo[110].SignalProcessingOfRxSigInfo "" UBYTE Com_SignalProcessingOfRxSigInfoType 0 0 0 255 ECU_ADDRESS 0x0 /end MEASUREMENT
/begin MEASUREMENT Com_RxSigInfo[110].ValidDlcOfRxSigInfo "" UBYTE NO_COMPU_METHOD 0 0 0 255 ECU_ADDRESS 0x0 /end MEASUREMENT
/begin MEASUREMENT Com_RxSigInfo[111].RxAccessInfoIdxOfRxSigInfo "" UWORD NO_COMPU_METHOD 0 0 0 65535 ECU_ADDRESS 0x0 /end MEASUREMENT
/begin MEASUREMENT Com_RxSigInfo[111].RxCbkFuncPtrAckIdxOfRxSigInfo "" UBYTE Com_RxCbkFuncPtrAckIdxOfRxSigInfoType 0 0 0 255 ECU_ADDRESS 0x0 /end MEASUREMENT
/begin MEASUREMENT Com_RxSigInfo[111].SignalProcessingOfRxSigInfo "" UBYTE Com_SignalProcessingOfRxSigInfoType 0 0 0 255 ECU_ADDRESS 0x0 /end MEASUREMENT
/begin MEASUREMENT Com_RxSigInfo[111].ValidDlcOfRxSigInfo "" UBYTE NO_COMPU_METHOD 0 0 0 255 ECU_ADDRESS 0x0 /end MEASUREMENT
/begin MEASUREMENT Com_RxSigInfo[112].RxAccessInfoIdxOfRxSigInfo "" UWORD NO_COMPU_METHOD 0 0 0 65535 ECU_ADDRESS 0x0 /end MEASUREMENT
/begin MEASUREMENT Com_RxSigInfo[112].RxCbkFuncPtrAckIdxOfRxSigInfo "" UBYTE Com_RxCbkFuncPtrAckIdxOfRxSigInfoType 0 0 0 255 ECU_ADDRESS 0x0 /end MEASUREMENT
/begin MEASUREMENT Com_RxSigInfo[112].SignalProcessingOfRxSigInfo "" UBYTE Com_SignalProcessingOfRxSigInfoType 0 0 0 255 ECU_ADDRESS 0x0 /end MEASUREMENT
/begin MEASUREMENT Com_RxSigInfo[112].ValidDlcOfRxSigInfo "" UBYTE NO_COMPU_METHOD 0 0 0 255 ECU_ADDRESS 0x0 /end MEASUREMENT
/begin MEASUREMENT Com_RxSigInfo[113].RxAccessInfoIdxOfRxSigInfo "" UWORD NO_COMPU_METHOD 0 0 0 65535 ECU_ADDRESS 0x0 /end MEASUREMENT
/begin MEASUREMENT Com_RxSigInfo[113].RxCbkFuncPtrAckIdxOfRxSigInfo "" UBYTE Com_RxCbkFuncPtrAckIdxOfRxSigInfoType 0 0 0 255 ECU_ADDRESS 0x0 /end MEASUREMENT
/begin MEASUREMENT Com_RxSigInfo[113].SignalProcessingOfRxSigInfo "" UBYTE Com_SignalProcessingOfRxSigInfoType 0 0 0 255 ECU_ADDRESS 0x0 /end MEASUREMENT
/begin MEASUREMENT Com_RxSigInfo[113].ValidDlcOfRxSigInfo "" UBYTE NO_COMPU_METHOD 0 0 0 255 ECU_ADDRESS 0x0 /end MEASUREMENT
/begin MEASUREMENT Com_RxSigInfo[114].RxAccessInfoIdxOfRxSigInfo "" UWORD NO_COMPU_METHOD 0 0 0 65535 ECU_ADDRESS 0x0 /end MEASUREMENT
/begin MEASUREMENT Com_RxSigInfo[114].RxCbkFuncPtrAckIdxOfRxSigInfo "" UBYTE Com_RxCbkFuncPtrAckIdxOfRxSigInfoType 0 0 0 255 ECU_ADDRESS 0x0 /end MEASUREMENT
/begin MEASUREMENT Com_RxSigInfo[114].SignalProcessingOfRxSigInfo "" UBYTE Com_SignalProcessingOfRxSigInfoType 0 0 0 255 ECU_ADDRESS 0x0 /end MEASUREMENT
/begin MEASUREMENT Com_RxSigInfo[114].ValidDlcOfRxSigInfo "" UBYTE NO_COMPU_METHOD 0 0 0 255 ECU_ADDRESS 0x0 /end MEASUREMENT
/begin MEASUREMENT Com_RxSigInfo[115].RxAccessInfoIdxOfRxSigInfo "" UWORD NO_COMPU_METHOD 0 0 0 65535 ECU_ADDRESS 0x0 /end MEASUREMENT
/begin MEASUREMENT Com_RxSigInfo[115].RxCbkFuncPtrAckIdxOfRxSigInfo "" UBYTE Com_RxCbkFuncPtrAckIdxOfRxSigInfoType 0 0 0 255 ECU_ADDRESS 0x0 /end MEASUREMENT
/begin MEASUREMENT Com_RxSigInfo[115].SignalProcessingOfRxSigInfo "" UBYTE Com_SignalProcessingOfRxSigInfoType 0 0 0 255 ECU_ADDRESS 0x0 /end MEASUREMENT
/begin MEASUREMENT Com_RxSigInfo[115].ValidDlcOfRxSigInfo "" UBYTE NO_COMPU_METHOD 0 0 0 255 ECU_ADDRESS 0x0 /end MEASUREMENT
/begin MEASUREMENT Com_RxSigInfo[116].RxAccessInfoIdxOfRxSigInfo "" UWORD NO_COMPU_METHOD 0 0 0 65535 ECU_ADDRESS 0x0 /end MEASUREMENT
/begin MEASUREMENT Com_RxSigInfo[116].RxCbkFuncPtrAckIdxOfRxSigInfo "" UBYTE Com_RxCbkFuncPtrAckIdxOfRxSigInfoType 0 0 0 255 ECU_ADDRESS 0x0 /end MEASUREMENT
/begin MEASUREMENT Com_RxSigInfo[116].SignalProcessingOfRxSigInfo "" UBYTE Com_SignalProcessingOfRxSigInfoType 0 0 0 255 ECU_ADDRESS 0x0 /end MEASUREMENT
/begin MEASUREMENT Com_RxSigInfo[116].ValidDlcOfRxSigInfo "" UBYTE NO_COMPU_METHOD 0 0 0 255 ECU_ADDRESS 0x0 /end MEASUREMENT
/begin MEASUREMENT Com_RxSigInfo[117].RxAccessInfoIdxOfRxSigInfo "" UWORD NO_COMPU_METHOD 0 0 0 65535 ECU_ADDRESS 0x0 /end MEASUREMENT
/begin MEASUREMENT Com_RxSigInfo[117].RxCbkFuncPtrAckIdxOfRxSigInfo "" UBYTE Com_RxCbkFuncPtrAckIdxOfRxSigInfoType 0 0 0 255 ECU_ADDRESS 0x0 /end MEASUREMENT
/begin MEASUREMENT Com_RxSigInfo[117].SignalProcessingOfRxSigInfo "" UBYTE Com_SignalProcessingOfRxSigInfoType 0 0 0 255 ECU_ADDRESS 0x0 /end MEASUREMENT
/begin MEASUREMENT Com_RxSigInfo[117].ValidDlcOfRxSigInfo "" UBYTE NO_COMPU_METHOD 0 0 0 255 ECU_ADDRESS 0x0 /end MEASUREMENT
/begin MEASUREMENT Com_RxSigInfo[118].RxAccessInfoIdxOfRxSigInfo "" UWORD NO_COMPU_METHOD 0 0 0 65535 ECU_ADDRESS 0x0 /end MEASUREMENT
/begin MEASUREMENT Com_RxSigInfo[118].RxCbkFuncPtrAckIdxOfRxSigInfo "" UBYTE Com_RxCbkFuncPtrAckIdxOfRxSigInfoType 0 0 0 255 ECU_ADDRESS 0x0 /end MEASUREMENT
/begin MEASUREMENT Com_RxSigInfo[118].SignalProcessingOfRxSigInfo "" UBYTE Com_SignalProcessingOfRxSigInfoType 0 0 0 255 ECU_ADDRESS 0x0 /end MEASUREMENT
/begin MEASUREMENT Com_RxSigInfo[118].ValidDlcOfRxSigInfo "" UBYTE NO_COMPU_METHOD 0 0 0 255 ECU_ADDRESS 0x0 /end MEASUREMENT
/begin MEASUREMENT Com_RxSigInfo[119].RxAccessInfoIdxOfRxSigInfo "" UWORD NO_COMPU_METHOD 0 0 0 65535 ECU_ADDRESS 0x0 /end MEASUREMENT
/begin MEASUREMENT Com_RxSigInfo[119].RxCbkFuncPtrAckIdxOfRxSigInfo "" UBYTE Com_RxCbkFuncPtrAckIdxOfRxSigInfoType 0 0 0 255 ECU_ADDRESS 0x0 /end MEASUREMENT
/begin MEASUREMENT Com_RxSigInfo[119].SignalProcessingOfRxSigInfo "" UBYTE Com_SignalProcessingOfRxSigInfoType 0 0 0 255 ECU_ADDRESS 0x0 /end MEASUREMENT
/begin MEASUREMENT Com_RxSigInfo[119].ValidDlcOfRxSigInfo "" UBYTE NO_COMPU_METHOD 0 0 0 255 ECU_ADDRESS 0x0 /end MEASUREMENT
/begin MEASUREMENT Com_RxSigInfo[11].RxAccessInfoIdxOfRxSigInfo "" UWORD NO_COMPU_METHOD 0 0 0 65535 ECU_ADDRESS 0x0 /end MEASUREMENT
/begin MEASUREMENT Com_RxSigInfo[11].RxCbkFuncPtrAckIdxOfRxSigInfo "" UBYTE Com_RxCbkFuncPtrAckIdxOfRxSigInfoType 0 0 0 255 ECU_ADDRESS 0x0 /end MEASUREMENT
/begin MEASUREMENT Com_RxSigInfo[11].SignalProcessingOfRxSigInfo "" UBYTE Com_SignalProcessingOfRxSigInfoType 0 0 0 255 ECU_ADDRESS 0x0 /end MEASUREMENT
/begin MEASUREMENT Com_RxSigInfo[11].ValidDlcOfRxSigInfo "" UBYTE NO_COMPU_METHOD 0 0 0 255 ECU_ADDRESS 0x0 /end MEASUREMENT
/begin MEASUREMENT Com_RxSigInfo[120].RxAccessInfoIdxOfRxSigInfo "" UWORD NO_COMPU_METHOD 0 0 0 65535 ECU_ADDRESS 0x0 /end MEASUREMENT
/begin MEASUREMENT Com_RxSigInfo[120].RxCbkFuncPtrAckIdxOfRxSigInfo "" UBYTE Com_RxCbkFuncPtrAckIdxOfRxSigInfoType 0 0 0 255 ECU_ADDRESS 0x0 /end MEASUREMENT
/begin MEASUREMENT Com_RxSigInfo[120].SignalProcessingOfRxSigInfo "" UBYTE Com_SignalProcessingOfRxSigInfoType 0 0 0 255 ECU_ADDRESS 0x0 /end MEASUREMENT
/begin MEASUREMENT Com_RxSigInfo[120].ValidDlcOfRxSigInfo "" UBYTE NO_COMPU_METHOD 0 0 0 255 ECU_ADDRESS 0x0 /end MEASUREMENT
/begin MEASUREMENT Com_RxSigInfo[121].RxAccessInfoIdxOfRxSigInfo "" UWORD NO_COMPU_METHOD 0 0 0 65535 ECU_ADDRESS 0x0 /end MEASUREMENT
/begin MEASUREMENT Com_RxSigInfo[121].RxCbkFuncPtrAckIdxOfRxSigInfo "" UBYTE Com_RxCbkFuncPtrAckIdxOfRxSigInfoType 0 0 0 255 ECU_ADDRESS 0x0 /end MEASUREMENT
/begin MEASUREMENT Com_RxSigInfo[121].SignalProcessingOfRxSigInfo "" UBYTE Com_SignalProcessingOfRxSigInfoType 0 0 0 255 ECU_ADDRESS 0x0 /end MEASUREMENT
/begin MEASUREMENT Com_RxSigInfo[121].ValidDlcOfRxSigInfo "" UBYTE NO_COMPU_METHOD 0 0 0 255 ECU_ADDRESS 0x0 /end MEASUREMENT
/begin MEASUREMENT Com_RxSigInfo[122].RxAccessInfoIdxOfRxSigInfo "" UWORD NO_COMPU_METHOD 0 0 0 65535 ECU_ADDRESS 0x0 /end MEASUREMENT
/begin MEASUREMENT Com_RxSigInfo[122].RxCbkFuncPtrAckIdxOfRxSigInfo "" UBYTE Com_RxCbkFuncPtrAckIdxOfRxSigInfoType 0 0 0 255 ECU_ADDRESS 0x0 /end MEASUREMENT
/begin MEASUREMENT Com_RxSigInfo[122].SignalProcessingOfRxSigInfo "" UBYTE Com_SignalProcessingOfRxSigInfoType 0 0 0 255 ECU_ADDRESS 0x0 /end MEASUREMENT
/begin MEASUREMENT Com_RxSigInfo[122].ValidDlcOfRxSigInfo "" UBYTE NO_COMPU_METHOD 0 0 0 255 ECU_ADDRESS 0x0 /end MEASUREMENT
/begin MEASUREMENT Com_RxSigInfo[123].RxAccessInfoIdxOfRxSigInfo "" UWORD NO_COMPU_METHOD 0 0 0 65535 ECU_ADDRESS 0x0 /end MEASUREMENT
/begin MEASUREMENT Com_RxSigInfo[123].RxCbkFuncPtrAckIdxOfRxSigInfo "" UBYTE Com_RxCbkFuncPtrAckIdxOfRxSigInfoType 0 0 0 255 ECU_ADDRESS 0x0 /end MEASUREMENT
/begin MEASUREMENT Com_RxSigInfo[123].SignalProcessingOfRxSigInfo "" UBYTE Com_SignalProcessingOfRxSigInfoType 0 0 0 255 ECU_ADDRESS 0x0 /end MEASUREMENT
/begin MEASUREMENT Com_RxSigInfo[123].ValidDlcOfRxSigInfo "" UBYTE NO_COMPU_METHOD 0 0 0 255 ECU_ADDRESS 0x0 /end MEASUREMENT
/begin MEASUREMENT Com_RxSigInfo[124].RxAccessInfoIdxOfRxSigInfo "" UWORD NO_COMPU_METHOD 0 0 0 65535 ECU_ADDRESS 0x0 /end MEASUREMENT
/begin MEASUREMENT Com_RxSigInfo[124].RxCbkFuncPtrAckIdxOfRxSigInfo "" UBYTE Com_RxCbkFuncPtrAckIdxOfRxSigInfoType 0 0 0 255 ECU_ADDRESS 0x0 /end MEASUREMENT
/begin MEASUREMENT Com_RxSigInfo[124].SignalProcessingOfRxSigInfo "" UBYTE Com_SignalProcessingOfRxSigInfoType 0 0 0 255 ECU_ADDRESS 0x0 /end MEASUREMENT
/begin MEASUREMENT Com_RxSigInfo[124].ValidDlcOfRxSigInfo "" UBYTE NO_COMPU_METHOD 0 0 0 255 ECU_ADDRESS 0x0 /end MEASUREMENT
/begin MEASUREMENT Com_RxSigInfo[125].RxAccessInfoIdxOfRxSigInfo "" UWORD NO_COMPU_METHOD 0 0 0 65535 ECU_ADDRESS 0x0 /end MEASUREMENT
/begin MEASUREMENT Com_RxSigInfo[125].RxCbkFuncPtrAckIdxOfRxSigInfo "" UBYTE Com_RxCbkFuncPtrAckIdxOfRxSigInfoType 0 0 0 255 ECU_ADDRESS 0x0 /end MEASUREMENT
/begin MEASUREMENT Com_RxSigInfo[125].SignalProcessingOfRxSigInfo "" UBYTE Com_SignalProcessingOfRxSigInfoType 0 0 0 255 ECU_ADDRESS 0x0 /end MEASUREMENT
/begin MEASUREMENT Com_RxSigInfo[125].ValidDlcOfRxSigInfo "" UBYTE NO_COMPU_METHOD 0 0 0 255 ECU_ADDRESS 0x0 /end MEASUREMENT
/begin MEASUREMENT Com_RxSigInfo[126].RxAccessInfoIdxOfRxSigInfo "" UWORD NO_COMPU_METHOD 0 0 0 65535 ECU_ADDRESS 0x0 /end MEASUREMENT
/begin MEASUREMENT Com_RxSigInfo[126].RxCbkFuncPtrAckIdxOfRxSigInfo "" UBYTE Com_RxCbkFuncPtrAckIdxOfRxSigInfoType 0 0 0 255 ECU_ADDRESS 0x0 /end MEASUREMENT
/begin MEASUREMENT Com_RxSigInfo[126].SignalProcessingOfRxSigInfo "" UBYTE Com_SignalProcessingOfRxSigInfoType 0 0 0 255 ECU_ADDRESS 0x0 /end MEASUREMENT
/begin MEASUREMENT Com_RxSigInfo[126].ValidDlcOfRxSigInfo "" UBYTE NO_COMPU_METHOD 0 0 0 255 ECU_ADDRESS 0x0 /end MEASUREMENT
/begin MEASUREMENT Com_RxSigInfo[127].RxAccessInfoIdxOfRxSigInfo "" UWORD NO_COMPU_METHOD 0 0 0 65535 ECU_ADDRESS 0x0 /end MEASUREMENT
/begin MEASUREMENT Com_RxSigInfo[127].RxCbkFuncPtrAckIdxOfRxSigInfo "" UBYTE Com_RxCbkFuncPtrAckIdxOfRxSigInfoType 0 0 0 255 ECU_ADDRESS 0x0 /end MEASUREMENT
/begin MEASUREMENT Com_RxSigInfo[127].SignalProcessingOfRxSigInfo "" UBYTE Com_SignalProcessingOfRxSigInfoType 0 0 0 255 ECU_ADDRESS 0x0 /end MEASUREMENT
/begin MEASUREMENT Com_RxSigInfo[127].ValidDlcOfRxSigInfo "" UBYTE NO_COMPU_METHOD 0 0 0 255 ECU_ADDRESS 0x0 /end MEASUREMENT
/begin MEASUREMENT Com_RxSigInfo[128].RxAccessInfoIdxOfRxSigInfo "" UWORD NO_COMPU_METHOD 0 0 0 65535 ECU_ADDRESS 0x0 /end MEASUREMENT
/begin MEASUREMENT Com_RxSigInfo[128].RxCbkFuncPtrAckIdxOfRxSigInfo "" UBYTE Com_RxCbkFuncPtrAckIdxOfRxSigInfoType 0 0 0 255 ECU_ADDRESS 0x0 /end MEASUREMENT
/begin MEASUREMENT Com_RxSigInfo[128].SignalProcessingOfRxSigInfo "" UBYTE Com_SignalProcessingOfRxSigInfoType 0 0 0 255 ECU_ADDRESS 0x0 /end MEASUREMENT
/begin MEASUREMENT Com_RxSigInfo[128].ValidDlcOfRxSigInfo "" UBYTE NO_COMPU_METHOD 0 0 0 255 ECU_ADDRESS 0x0 /end MEASUREMENT
/begin MEASUREMENT Com_RxSigInfo[129].RxAccessInfoIdxOfRxSigInfo "" UWORD NO_COMPU_METHOD 0 0 0 65535 ECU_ADDRESS 0x0 /end MEASUREMENT
/begin MEASUREMENT Com_RxSigInfo[129].RxCbkFuncPtrAckIdxOfRxSigInfo "" UBYTE Com_RxCbkFuncPtrAckIdxOfRxSigInfoType 0 0 0 255 ECU_ADDRESS 0x0 /end MEASUREMENT
/begin MEASUREMENT Com_RxSigInfo[129].SignalProcessingOfRxSigInfo "" UBYTE Com_SignalProcessingOfRxSigInfoType 0 0 0 255 ECU_ADDRESS 0x0 /end MEASUREMENT
/begin MEASUREMENT Com_RxSigInfo[129].ValidDlcOfRxSigInfo "" UBYTE NO_COMPU_METHOD 0 0 0 255 ECU_ADDRESS 0x0 /end MEASUREMENT
/begin MEASUREMENT Com_RxSigInfo[12].RxAccessInfoIdxOfRxSigInfo "" UWORD NO_COMPU_METHOD 0 0 0 65535 ECU_ADDRESS 0x0 /end MEASUREMENT
/begin MEASUREMENT Com_RxSigInfo[12].RxCbkFuncPtrAckIdxOfRxSigInfo "" UBYTE Com_RxCbkFuncPtrAckIdxOfRxSigInfoType 0 0 0 255 ECU_ADDRESS 0x0 /end MEASUREMENT
/begin MEASUREMENT Com_RxSigInfo[12].SignalProcessingOfRxSigInfo "" UBYTE Com_SignalProcessingOfRxSigInfoType 0 0 0 255 ECU_ADDRESS 0x0 /end MEASUREMENT
/begin MEASUREMENT Com_RxSigInfo[12].ValidDlcOfRxSigInfo "" UBYTE NO_COMPU_METHOD 0 0 0 255 ECU_ADDRESS 0x0 /end MEASUREMENT
/begin MEASUREMENT Com_RxSigInfo[130].RxAccessInfoIdxOfRxSigInfo "" UWORD NO_COMPU_METHOD 0 0 0 65535 ECU_ADDRESS 0x0 /end MEASUREMENT
/begin MEASUREMENT Com_RxSigInfo[130].RxCbkFuncPtrAckIdxOfRxSigInfo "" UBYTE Com_RxCbkFuncPtrAckIdxOfRxSigInfoType 0 0 0 255 ECU_ADDRESS 0x0 /end MEASUREMENT
/begin MEASUREMENT Com_RxSigInfo[130].SignalProcessingOfRxSigInfo "" UBYTE Com_SignalProcessingOfRxSigInfoType 0 0 0 255 ECU_ADDRESS 0x0 /end MEASUREMENT
/begin MEASUREMENT Com_RxSigInfo[130].ValidDlcOfRxSigInfo "" UBYTE NO_COMPU_METHOD 0 0 0 255 ECU_ADDRESS 0x0 /end MEASUREMENT
/begin MEASUREMENT Com_RxSigInfo[131].RxAccessInfoIdxOfRxSigInfo "" UWORD NO_COMPU_METHOD 0 0 0 65535 ECU_ADDRESS 0x0 /end MEASUREMENT
/begin MEASUREMENT Com_RxSigInfo[131].RxCbkFuncPtrAckIdxOfRxSigInfo "" UBYTE Com_RxCbkFuncPtrAckIdxOfRxSigInfoType 0 0 0 255 ECU_ADDRESS 0x0 /end MEASUREMENT
/begin MEASUREMENT Com_RxSigInfo[131].SignalProcessingOfRxSigInfo "" UBYTE Com_SignalProcessingOfRxSigInfoType 0 0 0 255 ECU_ADDRESS 0x0 /end MEASUREMENT
/begin MEASUREMENT Com_RxSigInfo[131].ValidDlcOfRxSigInfo "" UBYTE NO_COMPU_METHOD 0 0 0 255 ECU_ADDRESS 0x0 /end MEASUREMENT
/begin MEASUREMENT Com_RxSigInfo[132].RxAccessInfoIdxOfRxSigInfo "" UWORD NO_COMPU_METHOD 0 0 0 65535 ECU_ADDRESS 0x0 /end MEASUREMENT
/begin MEASUREMENT Com_RxSigInfo[132].RxCbkFuncPtrAckIdxOfRxSigInfo "" UBYTE Com_RxCbkFuncPtrAckIdxOfRxSigInfoType 0 0 0 255 ECU_ADDRESS 0x0 /end MEASUREMENT
/begin MEASUREMENT Com_RxSigInfo[132].SignalProcessingOfRxSigInfo "" UBYTE Com_SignalProcessingOfRxSigInfoType 0 0 0 255 ECU_ADDRESS 0x0 /end MEASUREMENT
/begin MEASUREMENT Com_RxSigInfo[132].ValidDlcOfRxSigInfo "" UBYTE NO_COMPU_METHOD 0 0 0 255 ECU_ADDRESS 0x0 /end MEASUREMENT
/begin MEASUREMENT Com_RxSigInfo[133].RxAccessInfoIdxOfRxSigInfo "" UWORD NO_COMPU_METHOD 0 0 0 65535 ECU_ADDRESS 0x0 /end MEASUREMENT
/begin MEASUREMENT Com_RxSigInfo[133].RxCbkFuncPtrAckIdxOfRxSigInfo "" UBYTE Com_RxCbkFuncPtrAckIdxOfRxSigInfoType 0 0 0 255 ECU_ADDRESS 0x0 /end MEASUREMENT
/begin MEASUREMENT Com_RxSigInfo[133].SignalProcessingOfRxSigInfo "" UBYTE Com_SignalProcessingOfRxSigInfoType 0 0 0 255 ECU_ADDRESS 0x0 /end MEASUREMENT
/begin MEASUREMENT Com_RxSigInfo[133].ValidDlcOfRxSigInfo "" UBYTE NO_COMPU_METHOD 0 0 0 255 ECU_ADDRESS 0x0 /end MEASUREMENT
/begin MEASUREMENT Com_RxSigInfo[134].RxAccessInfoIdxOfRxSigInfo "" UWORD NO_COMPU_METHOD 0 0 0 65535 ECU_ADDRESS 0x0 /end MEASUREMENT
/begin MEASUREMENT Com_RxSigInfo[134].RxCbkFuncPtrAckIdxOfRxSigInfo "" UBYTE Com_RxCbkFuncPtrAckIdxOfRxSigInfoType 0 0 0 255 ECU_ADDRESS 0x0 /end MEASUREMENT
/begin MEASUREMENT Com_RxSigInfo[134].SignalProcessingOfRxSigInfo "" UBYTE Com_SignalProcessingOfRxSigInfoType 0 0 0 255 ECU_ADDRESS 0x0 /end MEASUREMENT
/begin MEASUREMENT Com_RxSigInfo[134].ValidDlcOfRxSigInfo "" UBYTE NO_COMPU_METHOD 0 0 0 255 ECU_ADDRESS 0x0 /end MEASUREMENT
/begin MEASUREMENT Com_RxSigInfo[135].RxAccessInfoIdxOfRxSigInfo "" UWORD NO_COMPU_METHOD 0 0 0 65535 ECU_ADDRESS 0x0 /end MEASUREMENT
/begin MEASUREMENT Com_RxSigInfo[135].RxCbkFuncPtrAckIdxOfRxSigInfo "" UBYTE Com_RxCbkFuncPtrAckIdxOfRxSigInfoType 0 0 0 255 ECU_ADDRESS 0x0 /end MEASUREMENT
/begin MEASUREMENT Com_RxSigInfo[135].SignalProcessingOfRxSigInfo "" UBYTE Com_SignalProcessingOfRxSigInfoType 0 0 0 255 ECU_ADDRESS 0x0 /end MEASUREMENT
/begin MEASUREMENT Com_RxSigInfo[135].ValidDlcOfRxSigInfo "" UBYTE NO_COMPU_METHOD 0 0 0 255 ECU_ADDRESS 0x0 /end MEASUREMENT
/begin MEASUREMENT Com_RxSigInfo[136].RxAccessInfoIdxOfRxSigInfo "" UWORD NO_COMPU_METHOD 0 0 0 65535 ECU_ADDRESS 0x0 /end MEASUREMENT
/begin MEASUREMENT Com_RxSigInfo[136].RxCbkFuncPtrAckIdxOfRxSigInfo "" UBYTE Com_RxCbkFuncPtrAckIdxOfRxSigInfoType 0 0 0 255 ECU_ADDRESS 0x0 /end MEASUREMENT
/begin MEASUREMENT Com_RxSigInfo[136].SignalProcessingOfRxSigInfo "" UBYTE Com_SignalProcessingOfRxSigInfoType 0 0 0 255 ECU_ADDRESS 0x0 /end MEASUREMENT
/begin MEASUREMENT Com_RxSigInfo[136].ValidDlcOfRxSigInfo "" UBYTE NO_COMPU_METHOD 0 0 0 255 ECU_ADDRESS 0x0 /end MEASUREMENT
/begin MEASUREMENT Com_RxSigInfo[137].RxAccessInfoIdxOfRxSigInfo "" UWORD NO_COMPU_METHOD 0 0 0 65535 ECU_ADDRESS 0x0 /end MEASUREMENT
/begin MEASUREMENT Com_RxSigInfo[137].RxCbkFuncPtrAckIdxOfRxSigInfo "" UBYTE Com_RxCbkFuncPtrAckIdxOfRxSigInfoType 0 0 0 255 ECU_ADDRESS 0x0 /end MEASUREMENT
/begin MEASUREMENT Com_RxSigInfo[137].SignalProcessingOfRxSigInfo "" UBYTE Com_SignalProcessingOfRxSigInfoType 0 0 0 255 ECU_ADDRESS 0x0 /end MEASUREMENT
/begin MEASUREMENT Com_RxSigInfo[137].ValidDlcOfRxSigInfo "" UBYTE NO_COMPU_METHOD 0 0 0 255 ECU_ADDRESS 0x0 /end MEASUREMENT
/begin MEASUREMENT Com_RxSigInfo[138].RxAccessInfoIdxOfRxSigInfo "" UWORD NO_COMPU_METHOD 0 0 0 65535 ECU_ADDRESS 0x0 /end MEASUREMENT
/begin MEASUREMENT Com_RxSigInfo[138].RxCbkFuncPtrAckIdxOfRxSigInfo "" UBYTE Com_RxCbkFuncPtrAckIdxOfRxSigInfoType 0 0 0 255 ECU_ADDRESS 0x0 /end MEASUREMENT
/begin MEASUREMENT Com_RxSigInfo[138].SignalProcessingOfRxSigInfo "" UBYTE Com_SignalProcessingOfRxSigInfoType 0 0 0 255 ECU_ADDRESS 0x0 /end MEASUREMENT
/begin MEASUREMENT Com_RxSigInfo[138].ValidDlcOfRxSigInfo "" UBYTE NO_COMPU_METHOD 0 0 0 255 ECU_ADDRESS 0x0 /end MEASUREMENT
/begin MEASUREMENT Com_RxSigInfo[139].RxAccessInfoIdxOfRxSigInfo "" UWORD NO_COMPU_METHOD 0 0 0 65535 ECU_ADDRESS 0x0 /end MEASUREMENT
/begin MEASUREMENT Com_RxSigInfo[139].RxCbkFuncPtrAckIdxOfRxSigInfo "" UBYTE Com_RxCbkFuncPtrAckIdxOfRxSigInfoType 0 0 0 255 ECU_ADDRESS 0x0 /end MEASUREMENT
/begin MEASUREMENT Com_RxSigInfo[139].SignalProcessingOfRxSigInfo "" UBYTE Com_SignalProcessingOfRxSigInfoType 0 0 0 255 ECU_ADDRESS 0x0 /end MEASUREMENT
/begin MEASUREMENT Com_RxSigInfo[139].ValidDlcOfRxSigInfo "" UBYTE NO_COMPU_METHOD 0 0 0 255 ECU_ADDRESS 0x0 /end MEASUREMENT
/begin MEASUREMENT Com_RxSigInfo[13].RxAccessInfoIdxOfRxSigInfo "" UWORD NO_COMPU_METHOD 0 0 0 65535 ECU_ADDRESS 0x0 /end MEASUREMENT
/begin MEASUREMENT Com_RxSigInfo[13].RxCbkFuncPtrAckIdxOfRxSigInfo "" UBYTE Com_RxCbkFuncPtrAckIdxOfRxSigInfoType 0 0 0 255 ECU_ADDRESS 0x0 /end MEASUREMENT
/begin MEASUREMENT Com_RxSigInfo[13].SignalProcessingOfRxSigInfo "" UBYTE Com_SignalProcessingOfRxSigInfoType 0 0 0 255 ECU_ADDRESS 0x0 /end MEASUREMENT
/begin MEASUREMENT Com_RxSigInfo[13].ValidDlcOfRxSigInfo "" UBYTE NO_COMPU_METHOD 0 0 0 255 ECU_ADDRESS 0x0 /end MEASUREMENT
/begin MEASUREMENT Com_RxSigInfo[140].RxAccessInfoIdxOfRxSigInfo "" UWORD NO_COMPU_METHOD 0 0 0 65535 ECU_ADDRESS 0x0 /end MEASUREMENT
/begin MEASUREMENT Com_RxSigInfo[140].RxCbkFuncPtrAckIdxOfRxSigInfo "" UBYTE Com_RxCbkFuncPtrAckIdxOfRxSigInfoType 0 0 0 255 ECU_ADDRESS 0x0 /end MEASUREMENT
/begin MEASUREMENT Com_RxSigInfo[140].SignalProcessingOfRxSigInfo "" UBYTE Com_SignalProcessingOfRxSigInfoType 0 0 0 255 ECU_ADDRESS 0x0 /end MEASUREMENT
/begin MEASUREMENT Com_RxSigInfo[140].ValidDlcOfRxSigInfo "" UBYTE NO_COMPU_METHOD 0 0 0 255 ECU_ADDRESS 0x0 /end MEASUREMENT
/begin MEASUREMENT Com_RxSigInfo[141].RxAccessInfoIdxOfRxSigInfo "" UWORD NO_COMPU_METHOD 0 0 0 65535 ECU_ADDRESS 0x0 /end MEASUREMENT
/begin MEASUREMENT Com_RxSigInfo[141].RxCbkFuncPtrAckIdxOfRxSigInfo "" UBYTE Com_RxCbkFuncPtrAckIdxOfRxSigInfoType 0 0 0 255 ECU_ADDRESS 0x0 /end MEASUREMENT
/begin MEASUREMENT Com_RxSigInfo[141].SignalProcessingOfRxSigInfo "" UBYTE Com_SignalProcessingOfRxSigInfoType 0 0 0 255 ECU_ADDRESS 0x0 /end MEASUREMENT
/begin MEASUREMENT Com_RxSigInfo[141].ValidDlcOfRxSigInfo "" UBYTE NO_COMPU_METHOD 0 0 0 255 ECU_ADDRESS 0x0 /end MEASUREMENT
/begin MEASUREMENT Com_RxSigInfo[142].RxAccessInfoIdxOfRxSigInfo "" UWORD NO_COMPU_METHOD 0 0 0 65535 ECU_ADDRESS 0x0 /end MEASUREMENT
/begin MEASUREMENT Com_RxSigInfo[142].RxCbkFuncPtrAckIdxOfRxSigInfo "" UBYTE Com_RxCbkFuncPtrAckIdxOfRxSigInfoType 0 0 0 255 ECU_ADDRESS 0x0 /end MEASUREMENT
/begin MEASUREMENT Com_RxSigInfo[142].SignalProcessingOfRxSigInfo "" UBYTE Com_SignalProcessingOfRxSigInfoType 0 0 0 255 ECU_ADDRESS 0x0 /end MEASUREMENT
/begin MEASUREMENT Com_RxSigInfo[142].ValidDlcOfRxSigInfo "" UBYTE NO_COMPU_METHOD 0 0 0 255 ECU_ADDRESS 0x0 /end MEASUREMENT
/begin MEASUREMENT Com_RxSigInfo[143].RxAccessInfoIdxOfRxSigInfo "" UWORD NO_COMPU_METHOD 0 0 0 65535 ECU_ADDRESS 0x0 /end MEASUREMENT
/begin MEASUREMENT Com_RxSigInfo[143].RxCbkFuncPtrAckIdxOfRxSigInfo "" UBYTE Com_RxCbkFuncPtrAckIdxOfRxSigInfoType 0 0 0 255 ECU_ADDRESS 0x0 /end MEASUREMENT
/begin MEASUREMENT Com_RxSigInfo[143].SignalProcessingOfRxSigInfo "" UBYTE Com_SignalProcessingOfRxSigInfoType 0 0 0 255 ECU_ADDRESS 0x0 /end MEASUREMENT
/begin MEASUREMENT Com_RxSigInfo[143].ValidDlcOfRxSigInfo "" UBYTE NO_COMPU_METHOD 0 0 0 255 ECU_ADDRESS 0x0 /end MEASUREMENT
/begin MEASUREMENT Com_RxSigInfo[144].RxAccessInfoIdxOfRxSigInfo "" UWORD NO_COMPU_METHOD 0 0 0 65535 ECU_ADDRESS 0x0 /end MEASUREMENT
/begin MEASUREMENT Com_RxSigInfo[144].RxCbkFuncPtrAckIdxOfRxSigInfo "" UBYTE Com_RxCbkFuncPtrAckIdxOfRxSigInfoType 0 0 0 255 ECU_ADDRESS 0x0 /end MEASUREMENT
/begin MEASUREMENT Com_RxSigInfo[144].SignalProcessingOfRxSigInfo "" UBYTE Com_SignalProcessingOfRxSigInfoType 0 0 0 255 ECU_ADDRESS 0x0 /end MEASUREMENT
/begin MEASUREMENT Com_RxSigInfo[144].ValidDlcOfRxSigInfo "" UBYTE NO_COMPU_METHOD 0 0 0 255 ECU_ADDRESS 0x0 /end MEASUREMENT
/begin MEASUREMENT Com_RxSigInfo[145].RxAccessInfoIdxOfRxSigInfo "" UWORD NO_COMPU_METHOD 0 0 0 65535 ECU_ADDRESS 0x0 /end MEASUREMENT
/begin MEASUREMENT Com_RxSigInfo[145].RxCbkFuncPtrAckIdxOfRxSigInfo "" UBYTE Com_RxCbkFuncPtrAckIdxOfRxSigInfoType 0 0 0 255 ECU_ADDRESS 0x0 /end MEASUREMENT
/begin MEASUREMENT Com_RxSigInfo[145].SignalProcessingOfRxSigInfo "" UBYTE Com_SignalProcessingOfRxSigInfoType 0 0 0 255 ECU_ADDRESS 0x0 /end MEASUREMENT
/begin MEASUREMENT Com_RxSigInfo[145].ValidDlcOfRxSigInfo "" UBYTE NO_COMPU_METHOD 0 0 0 255 ECU_ADDRESS 0x0 /end MEASUREMENT
/begin MEASUREMENT Com_RxSigInfo[146].RxAccessInfoIdxOfRxSigInfo "" UWORD NO_COMPU_METHOD 0 0 0 65535 ECU_ADDRESS 0x0 /end MEASUREMENT
/begin MEASUREMENT Com_RxSigInfo[146].RxCbkFuncPtrAckIdxOfRxSigInfo "" UBYTE Com_RxCbkFuncPtrAckIdxOfRxSigInfoType 0 0 0 255 ECU_ADDRESS 0x0 /end MEASUREMENT
/begin MEASUREMENT Com_RxSigInfo[146].SignalProcessingOfRxSigInfo "" UBYTE Com_SignalProcessingOfRxSigInfoType 0 0 0 255 ECU_ADDRESS 0x0 /end MEASUREMENT
/begin MEASUREMENT Com_RxSigInfo[146].ValidDlcOfRxSigInfo "" UBYTE NO_COMPU_METHOD 0 0 0 255 ECU_ADDRESS 0x0 /end MEASUREMENT
/begin MEASUREMENT Com_RxSigInfo[147].RxAccessInfoIdxOfRxSigInfo "" UWORD NO_COMPU_METHOD 0 0 0 65535 ECU_ADDRESS 0x0 /end MEASUREMENT
/begin MEASUREMENT Com_RxSigInfo[147].RxCbkFuncPtrAckIdxOfRxSigInfo "" UBYTE Com_RxCbkFuncPtrAckIdxOfRxSigInfoType 0 0 0 255 ECU_ADDRESS 0x0 /end MEASUREMENT
/begin MEASUREMENT Com_RxSigInfo[147].SignalProcessingOfRxSigInfo "" UBYTE Com_SignalProcessingOfRxSigInfoType 0 0 0 255 ECU_ADDRESS 0x0 /end MEASUREMENT
/begin MEASUREMENT Com_RxSigInfo[147].ValidDlcOfRxSigInfo "" UBYTE NO_COMPU_METHOD 0 0 0 255 ECU_ADDRESS 0x0 /end MEASUREMENT
/begin MEASUREMENT Com_RxSigInfo[148].RxAccessInfoIdxOfRxSigInfo "" UWORD NO_COMPU_METHOD 0 0 0 65535 ECU_ADDRESS 0x0 /end MEASUREMENT
/begin MEASUREMENT Com_RxSigInfo[148].RxCbkFuncPtrAckIdxOfRxSigInfo "" UBYTE Com_RxCbkFuncPtrAckIdxOfRxSigInfoType 0 0 0 255 ECU_ADDRESS 0x0 /end MEASUREMENT
/begin MEASUREMENT Com_RxSigInfo[148].SignalProcessingOfRxSigInfo "" UBYTE Com_SignalProcessingOfRxSigInfoType 0 0 0 255 ECU_ADDRESS 0x0 /end MEASUREMENT
/begin MEASUREMENT Com_RxSigInfo[148].ValidDlcOfRxSigInfo "" UBYTE NO_COMPU_METHOD 0 0 0 255 ECU_ADDRESS 0x0 /end MEASUREMENT
/begin MEASUREMENT Com_RxSigInfo[149].RxAccessInfoIdxOfRxSigInfo "" UWORD NO_COMPU_METHOD 0 0 0 65535 ECU_ADDRESS 0x0 /end MEASUREMENT
/begin MEASUREMENT Com_RxSigInfo[149].RxCbkFuncPtrAckIdxOfRxSigInfo "" UBYTE Com_RxCbkFuncPtrAckIdxOfRxSigInfoType 0 0 0 255 ECU_ADDRESS 0x0 /end MEASUREMENT
/begin MEASUREMENT Com_RxSigInfo[149].SignalProcessingOfRxSigInfo "" UBYTE Com_SignalProcessingOfRxSigInfoType 0 0 0 255 ECU_ADDRESS 0x0 /end MEASUREMENT
/begin MEASUREMENT Com_RxSigInfo[149].ValidDlcOfRxSigInfo "" UBYTE NO_COMPU_METHOD 0 0 0 255 ECU_ADDRESS 0x0 /end MEASUREMENT
/begin MEASUREMENT Com_RxSigInfo[14].RxAccessInfoIdxOfRxSigInfo "" UWORD NO_COMPU_METHOD 0 0 0 65535 ECU_ADDRESS 0x0 /end MEASUREMENT
/begin MEASUREMENT Com_RxSigInfo[14].RxCbkFuncPtrAckIdxOfRxSigInfo "" UBYTE Com_RxCbkFuncPtrAckIdxOfRxSigInfoType 0 0 0 255 ECU_ADDRESS 0x0 /end MEASUREMENT
/begin MEASUREMENT Com_RxSigInfo[14].SignalProcessingOfRxSigInfo "" UBYTE Com_SignalProcessingOfRxSigInfoType 0 0 0 255 ECU_ADDRESS 0x0 /end MEASUREMENT
/begin MEASUREMENT Com_RxSigInfo[14].ValidDlcOfRxSigInfo "" UBYTE NO_COMPU_METHOD 0 0 0 255 ECU_ADDRESS 0x0 /end MEASUREMENT
/begin MEASUREMENT Com_RxSigInfo[150].RxAccessInfoIdxOfRxSigInfo "" UWORD NO_COMPU_METHOD 0 0 0 65535 ECU_ADDRESS 0x0 /end MEASUREMENT
/begin MEASUREMENT Com_RxSigInfo[150].RxCbkFuncPtrAckIdxOfRxSigInfo "" UBYTE Com_RxCbkFuncPtrAckIdxOfRxSigInfoType 0 0 0 255 ECU_ADDRESS 0x0 /end MEASUREMENT
/begin MEASUREMENT Com_RxSigInfo[150].SignalProcessingOfRxSigInfo "" UBYTE Com_SignalProcessingOfRxSigInfoType 0 0 0 255 ECU_ADDRESS 0x0 /end MEASUREMENT
/begin MEASUREMENT Com_RxSigInfo[150].ValidDlcOfRxSigInfo "" UBYTE NO_COMPU_METHOD 0 0 0 255 ECU_ADDRESS 0x0 /end MEASUREMENT
/begin MEASUREMENT Com_RxSigInfo[151].RxAccessInfoIdxOfRxSigInfo "" UWORD NO_COMPU_METHOD 0 0 0 65535 ECU_ADDRESS 0x0 /end MEASUREMENT
/begin MEASUREMENT Com_RxSigInfo[151].RxCbkFuncPtrAckIdxOfRxSigInfo "" UBYTE Com_RxCbkFuncPtrAckIdxOfRxSigInfoType 0 0 0 255 ECU_ADDRESS 0x0 /end MEASUREMENT
/begin MEASUREMENT Com_RxSigInfo[151].SignalProcessingOfRxSigInfo "" UBYTE Com_SignalProcessingOfRxSigInfoType 0 0 0 255 ECU_ADDRESS 0x0 /end MEASUREMENT
/begin MEASUREMENT Com_RxSigInfo[151].ValidDlcOfRxSigInfo "" UBYTE NO_COMPU_METHOD 0 0 0 255 ECU_ADDRESS 0x0 /end MEASUREMENT
/begin MEASUREMENT Com_RxSigInfo[152].RxAccessInfoIdxOfRxSigInfo "" UWORD NO_COMPU_METHOD 0 0 0 65535 ECU_ADDRESS 0x0 /end MEASUREMENT
/begin MEASUREMENT Com_RxSigInfo[152].RxCbkFuncPtrAckIdxOfRxSigInfo "" UBYTE Com_RxCbkFuncPtrAckIdxOfRxSigInfoType 0 0 0 255 ECU_ADDRESS 0x0 /end MEASUREMENT
/begin MEASUREMENT Com_RxSigInfo[152].SignalProcessingOfRxSigInfo "" UBYTE Com_SignalProcessingOfRxSigInfoType 0 0 0 255 ECU_ADDRESS 0x0 /end MEASUREMENT
/begin MEASUREMENT Com_RxSigInfo[152].ValidDlcOfRxSigInfo "" UBYTE NO_COMPU_METHOD 0 0 0 255 ECU_ADDRESS 0x0 /end MEASUREMENT
/begin MEASUREMENT Com_RxSigInfo[153].RxAccessInfoIdxOfRxSigInfo "" UWORD NO_COMPU_METHOD 0 0 0 65535 ECU_ADDRESS 0x0 /end MEASUREMENT
/begin MEASUREMENT Com_RxSigInfo[153].RxCbkFuncPtrAckIdxOfRxSigInfo "" UBYTE Com_RxCbkFuncPtrAckIdxOfRxSigInfoType 0 0 0 255 ECU_ADDRESS 0x0 /end MEASUREMENT
/begin MEASUREMENT Com_RxSigInfo[153].SignalProcessingOfRxSigInfo "" UBYTE Com_SignalProcessingOfRxSigInfoType 0 0 0 255 ECU_ADDRESS 0x0 /end MEASUREMENT
/begin MEASUREMENT Com_RxSigInfo[153].ValidDlcOfRxSigInfo "" UBYTE NO_COMPU_METHOD 0 0 0 255 ECU_ADDRESS 0x0 /end MEASUREMENT
/begin MEASUREMENT Com_RxSigInfo[154].RxAccessInfoIdxOfRxSigInfo "" UWORD NO_COMPU_METHOD 0 0 0 65535 ECU_ADDRESS 0x0 /end MEASUREMENT
/begin MEASUREMENT Com_RxSigInfo[154].RxCbkFuncPtrAckIdxOfRxSigInfo "" UBYTE Com_RxCbkFuncPtrAckIdxOfRxSigInfoType 0 0 0 255 ECU_ADDRESS 0x0 /end MEASUREMENT
/begin MEASUREMENT Com_RxSigInfo[154].SignalProcessingOfRxSigInfo "" UBYTE Com_SignalProcessingOfRxSigInfoType 0 0 0 255 ECU_ADDRESS 0x0 /end MEASUREMENT
/begin MEASUREMENT Com_RxSigInfo[154].ValidDlcOfRxSigInfo "" UBYTE NO_COMPU_METHOD 0 0 0 255 ECU_ADDRESS 0x0 /end MEASUREMENT
/begin MEASUREMENT Com_RxSigInfo[155].RxAccessInfoIdxOfRxSigInfo "" UWORD NO_COMPU_METHOD 0 0 0 65535 ECU_ADDRESS 0x0 /end MEASUREMENT
/begin MEASUREMENT Com_RxSigInfo[155].RxCbkFuncPtrAckIdxOfRxSigInfo "" UBYTE Com_RxCbkFuncPtrAckIdxOfRxSigInfoType 0 0 0 255 ECU_ADDRESS 0x0 /end MEASUREMENT
/begin MEASUREMENT Com_RxSigInfo[155].SignalProcessingOfRxSigInfo "" UBYTE Com_SignalProcessingOfRxSigInfoType 0 0 0 255 ECU_ADDRESS 0x0 /end MEASUREMENT
/begin MEASUREMENT Com_RxSigInfo[155].ValidDlcOfRxSigInfo "" UBYTE NO_COMPU_METHOD 0 0 0 255 ECU_ADDRESS 0x0 /end MEASUREMENT
/begin MEASUREMENT Com_RxSigInfo[156].RxAccessInfoIdxOfRxSigInfo "" UWORD NO_COMPU_METHOD 0 0 0 65535 ECU_ADDRESS 0x0 /end MEASUREMENT
/begin MEASUREMENT Com_RxSigInfo[156].RxCbkFuncPtrAckIdxOfRxSigInfo "" UBYTE Com_RxCbkFuncPtrAckIdxOfRxSigInfoType 0 0 0 255 ECU_ADDRESS 0x0 /end MEASUREMENT
/begin MEASUREMENT Com_RxSigInfo[156].SignalProcessingOfRxSigInfo "" UBYTE Com_SignalProcessingOfRxSigInfoType 0 0 0 255 ECU_ADDRESS 0x0 /end MEASUREMENT
/begin MEASUREMENT Com_RxSigInfo[156].ValidDlcOfRxSigInfo "" UBYTE NO_COMPU_METHOD 0 0 0 255 ECU_ADDRESS 0x0 /end MEASUREMENT
/begin MEASUREMENT Com_RxSigInfo[157].RxAccessInfoIdxOfRxSigInfo "" UWORD NO_COMPU_METHOD 0 0 0 65535 ECU_ADDRESS 0x0 /end MEASUREMENT
/begin MEASUREMENT Com_RxSigInfo[157].RxCbkFuncPtrAckIdxOfRxSigInfo "" UBYTE Com_RxCbkFuncPtrAckIdxOfRxSigInfoType 0 0 0 255 ECU_ADDRESS 0x0 /end MEASUREMENT
/begin MEASUREMENT Com_RxSigInfo[157].SignalProcessingOfRxSigInfo "" UBYTE Com_SignalProcessingOfRxSigInfoType 0 0 0 255 ECU_ADDRESS 0x0 /end MEASUREMENT
/begin MEASUREMENT Com_RxSigInfo[157].ValidDlcOfRxSigInfo "" UBYTE NO_COMPU_METHOD 0 0 0 255 ECU_ADDRESS 0x0 /end MEASUREMENT
/begin MEASUREMENT Com_RxSigInfo[158].RxAccessInfoIdxOfRxSigInfo "" UWORD NO_COMPU_METHOD 0 0 0 65535 ECU_ADDRESS 0x0 /end MEASUREMENT
/begin MEASUREMENT Com_RxSigInfo[158].RxCbkFuncPtrAckIdxOfRxSigInfo "" UBYTE Com_RxCbkFuncPtrAckIdxOfRxSigInfoType 0 0 0 255 ECU_ADDRESS 0x0 /end MEASUREMENT
/begin MEASUREMENT Com_RxSigInfo[158].SignalProcessingOfRxSigInfo "" UBYTE Com_SignalProcessingOfRxSigInfoType 0 0 0 255 ECU_ADDRESS 0x0 /end MEASUREMENT
/begin MEASUREMENT Com_RxSigInfo[158].ValidDlcOfRxSigInfo "" UBYTE NO_COMPU_METHOD 0 0 0 255 ECU_ADDRESS 0x0 /end MEASUREMENT
/begin MEASUREMENT Com_RxSigInfo[159].RxAccessInfoIdxOfRxSigInfo "" UWORD NO_COMPU_METHOD 0 0 0 65535 ECU_ADDRESS 0x0 /end MEASUREMENT
/begin MEASUREMENT Com_RxSigInfo[159].RxCbkFuncPtrAckIdxOfRxSigInfo "" UBYTE Com_RxCbkFuncPtrAckIdxOfRxSigInfoType 0 0 0 255 ECU_ADDRESS 0x0 /end MEASUREMENT
/begin MEASUREMENT Com_RxSigInfo[159].SignalProcessingOfRxSigInfo "" UBYTE Com_SignalProcessingOfRxSigInfoType 0 0 0 255 ECU_ADDRESS 0x0 /end MEASUREMENT
/begin MEASUREMENT Com_RxSigInfo[159].ValidDlcOfRxSigInfo "" UBYTE NO_COMPU_METHOD 0 0 0 255 ECU_ADDRESS 0x0 /end MEASUREMENT
/begin MEASUREMENT Com_RxSigInfo[15].RxAccessInfoIdxOfRxSigInfo "" UWORD NO_COMPU_METHOD 0 0 0 65535 ECU_ADDRESS 0x0 /end MEASUREMENT
/begin MEASUREMENT Com_RxSigInfo[15].RxCbkFuncPtrAckIdxOfRxSigInfo "" UBYTE Com_RxCbkFuncPtrAckIdxOfRxSigInfoType 0 0 0 255 ECU_ADDRESS 0x0 /end MEASUREMENT
/begin MEASUREMENT Com_RxSigInfo[15].SignalProcessingOfRxSigInfo "" UBYTE Com_SignalProcessingOfRxSigInfoType 0 0 0 255 ECU_ADDRESS 0x0 /end MEASUREMENT
/begin MEASUREMENT Com_RxSigInfo[15].ValidDlcOfRxSigInfo "" UBYTE NO_COMPU_METHOD 0 0 0 255 ECU_ADDRESS 0x0 /end MEASUREMENT
/begin MEASUREMENT Com_RxSigInfo[160].RxAccessInfoIdxOfRxSigInfo "" UWORD NO_COMPU_METHOD 0 0 0 65535 ECU_ADDRESS 0x0 /end MEASUREMENT
/begin MEASUREMENT Com_RxSigInfo[160].RxCbkFuncPtrAckIdxOfRxSigInfo "" UBYTE Com_RxCbkFuncPtrAckIdxOfRxSigInfoType 0 0 0 255 ECU_ADDRESS 0x0 /end MEASUREMENT
/begin MEASUREMENT Com_RxSigInfo[160].SignalProcessingOfRxSigInfo "" UBYTE Com_SignalProcessingOfRxSigInfoType 0 0 0 255 ECU_ADDRESS 0x0 /end MEASUREMENT
/begin MEASUREMENT Com_RxSigInfo[160].ValidDlcOfRxSigInfo "" UBYTE NO_COMPU_METHOD 0 0 0 255 ECU_ADDRESS 0x0 /end MEASUREMENT
/begin MEASUREMENT Com_RxSigInfo[161].RxAccessInfoIdxOfRxSigInfo "" UWORD NO_COMPU_METHOD 0 0 0 65535 ECU_ADDRESS 0x0 /end MEASUREMENT
/begin MEASUREMENT Com_RxSigInfo[161].RxCbkFuncPtrAckIdxOfRxSigInfo "" UBYTE Com_RxCbkFuncPtrAckIdxOfRxSigInfoType 0 0 0 255 ECU_ADDRESS 0x0 /end MEASUREMENT
/begin MEASUREMENT Com_RxSigInfo[161].SignalProcessingOfRxSigInfo "" UBYTE Com_SignalProcessingOfRxSigInfoType 0 0 0 255 ECU_ADDRESS 0x0 /end MEASUREMENT
/begin MEASUREMENT Com_RxSigInfo[161].ValidDlcOfRxSigInfo "" UBYTE NO_COMPU_METHOD 0 0 0 255 ECU_ADDRESS 0x0 /end MEASUREMENT
/begin MEASUREMENT Com_RxSigInfo[162].RxAccessInfoIdxOfRxSigInfo "" UWORD NO_COMPU_METHOD 0 0 0 65535 ECU_ADDRESS 0x0 /end MEASUREMENT
/begin MEASUREMENT Com_RxSigInfo[162].RxCbkFuncPtrAckIdxOfRxSigInfo "" UBYTE Com_RxCbkFuncPtrAckIdxOfRxSigInfoType 0 0 0 255 ECU_ADDRESS 0x0 /end MEASUREMENT
/begin MEASUREMENT Com_RxSigInfo[162].SignalProcessingOfRxSigInfo "" UBYTE Com_SignalProcessingOfRxSigInfoType 0 0 0 255 ECU_ADDRESS 0x0 /end MEASUREMENT
/begin MEASUREMENT Com_RxSigInfo[162].ValidDlcOfRxSigInfo "" UBYTE NO_COMPU_METHOD 0 0 0 255 ECU_ADDRESS 0x0 /end MEASUREMENT
/begin MEASUREMENT Com_RxSigInfo[163].RxAccessInfoIdxOfRxSigInfo "" UWORD NO_COMPU_METHOD 0 0 0 65535 ECU_ADDRESS 0x0 /end MEASUREMENT
/begin MEASUREMENT Com_RxSigInfo[163].RxCbkFuncPtrAckIdxOfRxSigInfo "" UBYTE Com_RxCbkFuncPtrAckIdxOfRxSigInfoType 0 0 0 255 ECU_ADDRESS 0x0 /end MEASUREMENT
/begin MEASUREMENT Com_RxSigInfo[163].SignalProcessingOfRxSigInfo "" UBYTE Com_SignalProcessingOfRxSigInfoType 0 0 0 255 ECU_ADDRESS 0x0 /end MEASUREMENT
/begin MEASUREMENT Com_RxSigInfo[163].ValidDlcOfRxSigInfo "" UBYTE NO_COMPU_METHOD 0 0 0 255 ECU_ADDRESS 0x0 /end MEASUREMENT
/begin MEASUREMENT Com_RxSigInfo[164].RxAccessInfoIdxOfRxSigInfo "" UWORD NO_COMPU_METHOD 0 0 0 65535 ECU_ADDRESS 0x0 /end MEASUREMENT
/begin MEASUREMENT Com_RxSigInfo[164].RxCbkFuncPtrAckIdxOfRxSigInfo "" UBYTE Com_RxCbkFuncPtrAckIdxOfRxSigInfoType 0 0 0 255 ECU_ADDRESS 0x0 /end MEASUREMENT
/begin MEASUREMENT Com_RxSigInfo[164].SignalProcessingOfRxSigInfo "" UBYTE Com_SignalProcessingOfRxSigInfoType 0 0 0 255 ECU_ADDRESS 0x0 /end MEASUREMENT
/begin MEASUREMENT Com_RxSigInfo[164].ValidDlcOfRxSigInfo "" UBYTE NO_COMPU_METHOD 0 0 0 255 ECU_ADDRESS 0x0 /end MEASUREMENT
/begin MEASUREMENT Com_RxSigInfo[165].RxAccessInfoIdxOfRxSigInfo "" UWORD NO_COMPU_METHOD 0 0 0 65535 ECU_ADDRESS 0x0 /end MEASUREMENT
/begin MEASUREMENT Com_RxSigInfo[165].RxCbkFuncPtrAckIdxOfRxSigInfo "" UBYTE Com_RxCbkFuncPtrAckIdxOfRxSigInfoType 0 0 0 255 ECU_ADDRESS 0x0 /end MEASUREMENT
/begin MEASUREMENT Com_RxSigInfo[165].SignalProcessingOfRxSigInfo "" UBYTE Com_SignalProcessingOfRxSigInfoType 0 0 0 255 ECU_ADDRESS 0x0 /end MEASUREMENT
/begin MEASUREMENT Com_RxSigInfo[165].ValidDlcOfRxSigInfo "" UBYTE NO_COMPU_METHOD 0 0 0 255 ECU_ADDRESS 0x0 /end MEASUREMENT
/begin MEASUREMENT Com_RxSigInfo[166].RxAccessInfoIdxOfRxSigInfo "" UWORD NO_COMPU_METHOD 0 0 0 65535 ECU_ADDRESS 0x0 /end MEASUREMENT
/begin MEASUREMENT Com_RxSigInfo[166].RxCbkFuncPtrAckIdxOfRxSigInfo "" UBYTE Com_RxCbkFuncPtrAckIdxOfRxSigInfoType 0 0 0 255 ECU_ADDRESS 0x0 /end MEASUREMENT
/begin MEASUREMENT Com_RxSigInfo[166].SignalProcessingOfRxSigInfo "" UBYTE Com_SignalProcessingOfRxSigInfoType 0 0 0 255 ECU_ADDRESS 0x0 /end MEASUREMENT
/begin MEASUREMENT Com_RxSigInfo[166].ValidDlcOfRxSigInfo "" UBYTE NO_COMPU_METHOD 0 0 0 255 ECU_ADDRESS 0x0 /end MEASUREMENT
/begin MEASUREMENT Com_RxSigInfo[167].RxAccessInfoIdxOfRxSigInfo "" UWORD NO_COMPU_METHOD 0 0 0 65535 ECU_ADDRESS 0x0 /end MEASUREMENT
/begin MEASUREMENT Com_RxSigInfo[167].RxCbkFuncPtrAckIdxOfRxSigInfo "" UBYTE Com_RxCbkFuncPtrAckIdxOfRxSigInfoType 0 0 0 255 ECU_ADDRESS 0x0 /end MEASUREMENT
/begin MEASUREMENT Com_RxSigInfo[167].SignalProcessingOfRxSigInfo "" UBYTE Com_SignalProcessingOfRxSigInfoType 0 0 0 255 ECU_ADDRESS 0x0 /end MEASUREMENT
/begin MEASUREMENT Com_RxSigInfo[167].ValidDlcOfRxSigInfo "" UBYTE NO_COMPU_METHOD 0 0 0 255 ECU_ADDRESS 0x0 /end MEASUREMENT
/begin MEASUREMENT Com_RxSigInfo[168].RxAccessInfoIdxOfRxSigInfo "" UWORD NO_COMPU_METHOD 0 0 0 65535 ECU_ADDRESS 0x0 /end MEASUREMENT
/begin MEASUREMENT Com_RxSigInfo[168].RxCbkFuncPtrAckIdxOfRxSigInfo "" UBYTE Com_RxCbkFuncPtrAckIdxOfRxSigInfoType 0 0 0 255 ECU_ADDRESS 0x0 /end MEASUREMENT
/begin MEASUREMENT Com_RxSigInfo[168].SignalProcessingOfRxSigInfo "" UBYTE Com_SignalProcessingOfRxSigInfoType 0 0 0 255 ECU_ADDRESS 0x0 /end MEASUREMENT
/begin MEASUREMENT Com_RxSigInfo[168].ValidDlcOfRxSigInfo "" UBYTE NO_COMPU_METHOD 0 0 0 255 ECU_ADDRESS 0x0 /end MEASUREMENT
/begin MEASUREMENT Com_RxSigInfo[169].RxAccessInfoIdxOfRxSigInfo "" UWORD NO_COMPU_METHOD 0 0 0 65535 ECU_ADDRESS 0x0 /end MEASUREMENT
/begin MEASUREMENT Com_RxSigInfo[169].RxCbkFuncPtrAckIdxOfRxSigInfo "" UBYTE Com_RxCbkFuncPtrAckIdxOfRxSigInfoType 0 0 0 255 ECU_ADDRESS 0x0 /end MEASUREMENT
/begin MEASUREMENT Com_RxSigInfo[169].SignalProcessingOfRxSigInfo "" UBYTE Com_SignalProcessingOfRxSigInfoType 0 0 0 255 ECU_ADDRESS 0x0 /end MEASUREMENT
/begin MEASUREMENT Com_RxSigInfo[169].ValidDlcOfRxSigInfo "" UBYTE NO_COMPU_METHOD 0 0 0 255 ECU_ADDRESS 0x0 /end MEASUREMENT
/begin MEASUREMENT Com_RxSigInfo[16].RxAccessInfoIdxOfRxSigInfo "" UWORD NO_COMPU_METHOD 0 0 0 65535 ECU_ADDRESS 0x0 /end MEASUREMENT
/begin MEASUREMENT Com_RxSigInfo[16].RxCbkFuncPtrAckIdxOfRxSigInfo "" UBYTE Com_RxCbkFuncPtrAckIdxOfRxSigInfoType 0 0 0 255 ECU_ADDRESS 0x0 /end MEASUREMENT
/begin MEASUREMENT Com_RxSigInfo[16].SignalProcessingOfRxSigInfo "" UBYTE Com_SignalProcessingOfRxSigInfoType 0 0 0 255 ECU_ADDRESS 0x0 /end MEASUREMENT
/begin MEASUREMENT Com_RxSigInfo[16].ValidDlcOfRxSigInfo "" UBYTE NO_COMPU_METHOD 0 0 0 255 ECU_ADDRESS 0x0 /end MEASUREMENT
/begin MEASUREMENT Com_RxSigInfo[170].RxAccessInfoIdxOfRxSigInfo "" UWORD NO_COMPU_METHOD 0 0 0 65535 ECU_ADDRESS 0x0 /end MEASUREMENT
/begin MEASUREMENT Com_RxSigInfo[170].RxCbkFuncPtrAckIdxOfRxSigInfo "" UBYTE Com_RxCbkFuncPtrAckIdxOfRxSigInfoType 0 0 0 255 ECU_ADDRESS 0x0 /end MEASUREMENT
/begin MEASUREMENT Com_RxSigInfo[170].SignalProcessingOfRxSigInfo "" UBYTE Com_SignalProcessingOfRxSigInfoType 0 0 0 255 ECU_ADDRESS 0x0 /end MEASUREMENT
/begin MEASUREMENT Com_RxSigInfo[170].ValidDlcOfRxSigInfo "" UBYTE NO_COMPU_METHOD 0 0 0 255 ECU_ADDRESS 0x0 /end MEASUREMENT
/begin MEASUREMENT Com_RxSigInfo[171].RxAccessInfoIdxOfRxSigInfo "" UWORD NO_COMPU_METHOD 0 0 0 65535 ECU_ADDRESS 0x0 /end MEASUREMENT
/begin MEASUREMENT Com_RxSigInfo[171].RxCbkFuncPtrAckIdxOfRxSigInfo "" UBYTE Com_RxCbkFuncPtrAckIdxOfRxSigInfoType 0 0 0 255 ECU_ADDRESS 0x0 /end MEASUREMENT
/begin MEASUREMENT Com_RxSigInfo[171].SignalProcessingOfRxSigInfo "" UBYTE Com_SignalProcessingOfRxSigInfoType 0 0 0 255 ECU_ADDRESS 0x0 /end MEASUREMENT
/begin MEASUREMENT Com_RxSigInfo[171].ValidDlcOfRxSigInfo "" UBYTE NO_COMPU_METHOD 0 0 0 255 ECU_ADDRESS 0x0 /end MEASUREMENT
/begin MEASUREMENT Com_RxSigInfo[172].RxAccessInfoIdxOfRxSigInfo "" UWORD NO_COMPU_METHOD 0 0 0 65535 ECU_ADDRESS 0x0 /end MEASUREMENT
/begin MEASUREMENT Com_RxSigInfo[172].RxCbkFuncPtrAckIdxOfRxSigInfo "" UBYTE Com_RxCbkFuncPtrAckIdxOfRxSigInfoType 0 0 0 255 ECU_ADDRESS 0x0 /end MEASUREMENT
/begin MEASUREMENT Com_RxSigInfo[172].SignalProcessingOfRxSigInfo "" UBYTE Com_SignalProcessingOfRxSigInfoType 0 0 0 255 ECU_ADDRESS 0x0 /end MEASUREMENT
/begin MEASUREMENT Com_RxSigInfo[172].ValidDlcOfRxSigInfo "" UBYTE NO_COMPU_METHOD 0 0 0 255 ECU_ADDRESS 0x0 /end MEASUREMENT
/begin MEASUREMENT Com_RxSigInfo[173].RxAccessInfoIdxOfRxSigInfo "" UWORD NO_COMPU_METHOD 0 0 0 65535 ECU_ADDRESS 0x0 /end MEASUREMENT
/begin MEASUREMENT Com_RxSigInfo[173].RxCbkFuncPtrAckIdxOfRxSigInfo "" UBYTE Com_RxCbkFuncPtrAckIdxOfRxSigInfoType 0 0 0 255 ECU_ADDRESS 0x0 /end MEASUREMENT
/begin MEASUREMENT Com_RxSigInfo[173].SignalProcessingOfRxSigInfo "" UBYTE Com_SignalProcessingOfRxSigInfoType 0 0 0 255 ECU_ADDRESS 0x0 /end MEASUREMENT
/begin MEASUREMENT Com_RxSigInfo[173].ValidDlcOfRxSigInfo "" UBYTE NO_COMPU_METHOD 0 0 0 255 ECU_ADDRESS 0x0 /end MEASUREMENT
/begin MEASUREMENT Com_RxSigInfo[174].RxAccessInfoIdxOfRxSigInfo "" UWORD NO_COMPU_METHOD 0 0 0 65535 ECU_ADDRESS 0x0 /end MEASUREMENT
/begin MEASUREMENT Com_RxSigInfo[174].RxCbkFuncPtrAckIdxOfRxSigInfo "" UBYTE Com_RxCbkFuncPtrAckIdxOfRxSigInfoType 0 0 0 255 ECU_ADDRESS 0x0 /end MEASUREMENT
/begin MEASUREMENT Com_RxSigInfo[174].SignalProcessingOfRxSigInfo "" UBYTE Com_SignalProcessingOfRxSigInfoType 0 0 0 255 ECU_ADDRESS 0x0 /end MEASUREMENT
/begin MEASUREMENT Com_RxSigInfo[174].ValidDlcOfRxSigInfo "" UBYTE NO_COMPU_METHOD 0 0 0 255 ECU_ADDRESS 0x0 /end MEASUREMENT
/begin MEASUREMENT Com_RxSigInfo[175].RxAccessInfoIdxOfRxSigInfo "" UWORD NO_COMPU_METHOD 0 0 0 65535 ECU_ADDRESS 0x0 /end MEASUREMENT
/begin MEASUREMENT Com_RxSigInfo[175].RxCbkFuncPtrAckIdxOfRxSigInfo "" UBYTE Com_RxCbkFuncPtrAckIdxOfRxSigInfoType 0 0 0 255 ECU_ADDRESS 0x0 /end MEASUREMENT
/begin MEASUREMENT Com_RxSigInfo[175].SignalProcessingOfRxSigInfo "" UBYTE Com_SignalProcessingOfRxSigInfoType 0 0 0 255 ECU_ADDRESS 0x0 /end MEASUREMENT
/begin MEASUREMENT Com_RxSigInfo[175].ValidDlcOfRxSigInfo "" UBYTE NO_COMPU_METHOD 0 0 0 255 ECU_ADDRESS 0x0 /end MEASUREMENT
/begin MEASUREMENT Com_RxSigInfo[176].RxAccessInfoIdxOfRxSigInfo "" UWORD NO_COMPU_METHOD 0 0 0 65535 ECU_ADDRESS 0x0 /end MEASUREMENT
/begin MEASUREMENT Com_RxSigInfo[176].RxCbkFuncPtrAckIdxOfRxSigInfo "" UBYTE Com_RxCbkFuncPtrAckIdxOfRxSigInfoType 0 0 0 255 ECU_ADDRESS 0x0 /end MEASUREMENT
/begin MEASUREMENT Com_RxSigInfo[176].SignalProcessingOfRxSigInfo "" UBYTE Com_SignalProcessingOfRxSigInfoType 0 0 0 255 ECU_ADDRESS 0x0 /end MEASUREMENT
/begin MEASUREMENT Com_RxSigInfo[176].ValidDlcOfRxSigInfo "" UBYTE NO_COMPU_METHOD 0 0 0 255 ECU_ADDRESS 0x0 /end MEASUREMENT
/begin MEASUREMENT Com_RxSigInfo[177].RxAccessInfoIdxOfRxSigInfo "" UWORD NO_COMPU_METHOD 0 0 0 65535 ECU_ADDRESS 0x0 /end MEASUREMENT
/begin MEASUREMENT Com_RxSigInfo[177].RxCbkFuncPtrAckIdxOfRxSigInfo "" UBYTE Com_RxCbkFuncPtrAckIdxOfRxSigInfoType 0 0 0 255 ECU_ADDRESS 0x0 /end MEASUREMENT
/begin MEASUREMENT Com_RxSigInfo[177].SignalProcessingOfRxSigInfo "" UBYTE Com_SignalProcessingOfRxSigInfoType 0 0 0 255 ECU_ADDRESS 0x0 /end MEASUREMENT
/begin MEASUREMENT Com_RxSigInfo[177].ValidDlcOfRxSigInfo "" UBYTE NO_COMPU_METHOD 0 0 0 255 ECU_ADDRESS 0x0 /end MEASUREMENT
/begin MEASUREMENT Com_RxSigInfo[178].RxAccessInfoIdxOfRxSigInfo "" UWORD NO_COMPU_METHOD 0 0 0 65535 ECU_ADDRESS 0x0 /end MEASUREMENT
/begin MEASUREMENT Com_RxSigInfo[178].RxCbkFuncPtrAckIdxOfRxSigInfo "" UBYTE Com_RxCbkFuncPtrAckIdxOfRxSigInfoType 0 0 0 255 ECU_ADDRESS 0x0 /end MEASUREMENT
/begin MEASUREMENT Com_RxSigInfo[178].SignalProcessingOfRxSigInfo "" UBYTE Com_SignalProcessingOfRxSigInfoType 0 0 0 255 ECU_ADDRESS 0x0 /end MEASUREMENT
/begin MEASUREMENT Com_RxSigInfo[178].ValidDlcOfRxSigInfo "" UBYTE NO_COMPU_METHOD 0 0 0 255 ECU_ADDRESS 0x0 /end MEASUREMENT
/begin MEASUREMENT Com_RxSigInfo[179].RxAccessInfoIdxOfRxSigInfo "" UWORD NO_COMPU_METHOD 0 0 0 65535 ECU_ADDRESS 0x0 /end MEASUREMENT
/begin MEASUREMENT Com_RxSigInfo[179].RxCbkFuncPtrAckIdxOfRxSigInfo "" UBYTE Com_RxCbkFuncPtrAckIdxOfRxSigInfoType 0 0 0 255 ECU_ADDRESS 0x0 /end MEASUREMENT
/begin MEASUREMENT Com_RxSigInfo[179].SignalProcessingOfRxSigInfo "" UBYTE Com_SignalProcessingOfRxSigInfoType 0 0 0 255 ECU_ADDRESS 0x0 /end MEASUREMENT
/begin MEASUREMENT Com_RxSigInfo[179].ValidDlcOfRxSigInfo "" UBYTE NO_COMPU_METHOD 0 0 0 255 ECU_ADDRESS 0x0 /end MEASUREMENT
/begin MEASUREMENT Com_RxSigInfo[17].RxAccessInfoIdxOfRxSigInfo "" UWORD NO_COMPU_METHOD 0 0 0 65535 ECU_ADDRESS 0x0 /end MEASUREMENT
/begin MEASUREMENT Com_RxSigInfo[17].RxCbkFuncPtrAckIdxOfRxSigInfo "" UBYTE Com_RxCbkFuncPtrAckIdxOfRxSigInfoType 0 0 0 255 ECU_ADDRESS 0x0 /end MEASUREMENT
/begin MEASUREMENT Com_RxSigInfo[17].SignalProcessingOfRxSigInfo "" UBYTE Com_SignalProcessingOfRxSigInfoType 0 0 0 255 ECU_ADDRESS 0x0 /end MEASUREMENT
/begin MEASUREMENT Com_RxSigInfo[17].ValidDlcOfRxSigInfo "" UBYTE NO_COMPU_METHOD 0 0 0 255 ECU_ADDRESS 0x0 /end MEASUREMENT
/begin MEASUREMENT Com_RxSigInfo[180].RxAccessInfoIdxOfRxSigInfo "" UWORD NO_COMPU_METHOD 0 0 0 65535 ECU_ADDRESS 0x0 /end MEASUREMENT
/begin MEASUREMENT Com_RxSigInfo[180].RxCbkFuncPtrAckIdxOfRxSigInfo "" UBYTE Com_RxCbkFuncPtrAckIdxOfRxSigInfoType 0 0 0 255 ECU_ADDRESS 0x0 /end MEASUREMENT
/begin MEASUREMENT Com_RxSigInfo[180].SignalProcessingOfRxSigInfo "" UBYTE Com_SignalProcessingOfRxSigInfoType 0 0 0 255 ECU_ADDRESS 0x0 /end MEASUREMENT
/begin MEASUREMENT Com_RxSigInfo[180].ValidDlcOfRxSigInfo "" UBYTE NO_COMPU_METHOD 0 0 0 255 ECU_ADDRESS 0x0 /end MEASUREMENT
/begin MEASUREMENT Com_RxSigInfo[181].RxAccessInfoIdxOfRxSigInfo "" UWORD NO_COMPU_METHOD 0 0 0 65535 ECU_ADDRESS 0x0 /end MEASUREMENT
/begin MEASUREMENT Com_RxSigInfo[181].RxCbkFuncPtrAckIdxOfRxSigInfo "" UBYTE Com_RxCbkFuncPtrAckIdxOfRxSigInfoType 0 0 0 255 ECU_ADDRESS 0x0 /end MEASUREMENT
/begin MEASUREMENT Com_RxSigInfo[181].SignalProcessingOfRxSigInfo "" UBYTE Com_SignalProcessingOfRxSigInfoType 0 0 0 255 ECU_ADDRESS 0x0 /end MEASUREMENT
/begin MEASUREMENT Com_RxSigInfo[181].ValidDlcOfRxSigInfo "" UBYTE NO_COMPU_METHOD 0 0 0 255 ECU_ADDRESS 0x0 /end MEASUREMENT
/begin MEASUREMENT Com_RxSigInfo[182].RxAccessInfoIdxOfRxSigInfo "" UWORD NO_COMPU_METHOD 0 0 0 65535 ECU_ADDRESS 0x0 /end MEASUREMENT
/begin MEASUREMENT Com_RxSigInfo[182].RxCbkFuncPtrAckIdxOfRxSigInfo "" UBYTE Com_RxCbkFuncPtrAckIdxOfRxSigInfoType 0 0 0 255 ECU_ADDRESS 0x0 /end MEASUREMENT
/begin MEASUREMENT Com_RxSigInfo[182].SignalProcessingOfRxSigInfo "" UBYTE Com_SignalProcessingOfRxSigInfoType 0 0 0 255 ECU_ADDRESS 0x0 /end MEASUREMENT
/begin MEASUREMENT Com_RxSigInfo[182].ValidDlcOfRxSigInfo "" UBYTE NO_COMPU_METHOD 0 0 0 255 ECU_ADDRESS 0x0 /end MEASUREMENT
/begin MEASUREMENT Com_RxSigInfo[183].RxAccessInfoIdxOfRxSigInfo "" UWORD NO_COMPU_METHOD 0 0 0 65535 ECU_ADDRESS 0x0 /end MEASUREMENT
/begin MEASUREMENT Com_RxSigInfo[183].RxCbkFuncPtrAckIdxOfRxSigInfo "" UBYTE Com_RxCbkFuncPtrAckIdxOfRxSigInfoType 0 0 0 255 ECU_ADDRESS 0x0 /end MEASUREMENT
/begin MEASUREMENT Com_RxSigInfo[183].SignalProcessingOfRxSigInfo "" UBYTE Com_SignalProcessingOfRxSigInfoType 0 0 0 255 ECU_ADDRESS 0x0 /end MEASUREMENT
/begin MEASUREMENT Com_RxSigInfo[183].ValidDlcOfRxSigInfo "" UBYTE NO_COMPU_METHOD 0 0 0 255 ECU_ADDRESS 0x0 /end MEASUREMENT
/begin MEASUREMENT Com_RxSigInfo[184].RxAccessInfoIdxOfRxSigInfo "" UWORD NO_COMPU_METHOD 0 0 0 65535 ECU_ADDRESS 0x0 /end MEASUREMENT
/begin MEASUREMENT Com_RxSigInfo[184].RxCbkFuncPtrAckIdxOfRxSigInfo "" UBYTE Com_RxCbkFuncPtrAckIdxOfRxSigInfoType 0 0 0 255 ECU_ADDRESS 0x0 /end MEASUREMENT
/begin MEASUREMENT Com_RxSigInfo[184].SignalProcessingOfRxSigInfo "" UBYTE Com_SignalProcessingOfRxSigInfoType 0 0 0 255 ECU_ADDRESS 0x0 /end MEASUREMENT
/begin MEASUREMENT Com_RxSigInfo[184].ValidDlcOfRxSigInfo "" UBYTE NO_COMPU_METHOD 0 0 0 255 ECU_ADDRESS 0x0 /end MEASUREMENT
/begin MEASUREMENT Com_RxSigInfo[185].RxAccessInfoIdxOfRxSigInfo "" UWORD NO_COMPU_METHOD 0 0 0 65535 ECU_ADDRESS 0x0 /end MEASUREMENT
/begin MEASUREMENT Com_RxSigInfo[185].RxCbkFuncPtrAckIdxOfRxSigInfo "" UBYTE Com_RxCbkFuncPtrAckIdxOfRxSigInfoType 0 0 0 255 ECU_ADDRESS 0x0 /end MEASUREMENT
/begin MEASUREMENT Com_RxSigInfo[185].SignalProcessingOfRxSigInfo "" UBYTE Com_SignalProcessingOfRxSigInfoType 0 0 0 255 ECU_ADDRESS 0x0 /end MEASUREMENT
/begin MEASUREMENT Com_RxSigInfo[185].ValidDlcOfRxSigInfo "" UBYTE NO_COMPU_METHOD 0 0 0 255 ECU_ADDRESS 0x0 /end MEASUREMENT
/begin MEASUREMENT Com_RxSigInfo[186].RxAccessInfoIdxOfRxSigInfo "" UWORD NO_COMPU_METHOD 0 0 0 65535 ECU_ADDRESS 0x0 /end MEASUREMENT
/begin MEASUREMENT Com_RxSigInfo[186].RxCbkFuncPtrAckIdxOfRxSigInfo "" UBYTE Com_RxCbkFuncPtrAckIdxOfRxSigInfoType 0 0 0 255 ECU_ADDRESS 0x0 /end MEASUREMENT
/begin MEASUREMENT Com_RxSigInfo[186].SignalProcessingOfRxSigInfo "" UBYTE Com_SignalProcessingOfRxSigInfoType 0 0 0 255 ECU_ADDRESS 0x0 /end MEASUREMENT
/begin MEASUREMENT Com_RxSigInfo[186].ValidDlcOfRxSigInfo "" UBYTE NO_COMPU_METHOD 0 0 0 255 ECU_ADDRESS 0x0 /end MEASUREMENT
/begin MEASUREMENT Com_RxSigInfo[187].RxAccessInfoIdxOfRxSigInfo "" UWORD NO_COMPU_METHOD 0 0 0 65535 ECU_ADDRESS 0x0 /end MEASUREMENT
/begin MEASUREMENT Com_RxSigInfo[187].RxCbkFuncPtrAckIdxOfRxSigInfo "" UBYTE Com_RxCbkFuncPtrAckIdxOfRxSigInfoType 0 0 0 255 ECU_ADDRESS 0x0 /end MEASUREMENT
/begin MEASUREMENT Com_RxSigInfo[187].SignalProcessingOfRxSigInfo "" UBYTE Com_SignalProcessingOfRxSigInfoType 0 0 0 255 ECU_ADDRESS 0x0 /end MEASUREMENT
/begin MEASUREMENT Com_RxSigInfo[187].ValidDlcOfRxSigInfo "" UBYTE NO_COMPU_METHOD 0 0 0 255 ECU_ADDRESS 0x0 /end MEASUREMENT
/begin MEASUREMENT Com_RxSigInfo[188].RxAccessInfoIdxOfRxSigInfo "" UWORD NO_COMPU_METHOD 0 0 0 65535 ECU_ADDRESS 0x0 /end MEASUREMENT
/begin MEASUREMENT Com_RxSigInfo[188].RxCbkFuncPtrAckIdxOfRxSigInfo "" UBYTE Com_RxCbkFuncPtrAckIdxOfRxSigInfoType 0 0 0 255 ECU_ADDRESS 0x0 /end MEASUREMENT
/begin MEASUREMENT Com_RxSigInfo[188].SignalProcessingOfRxSigInfo "" UBYTE Com_SignalProcessingOfRxSigInfoType 0 0 0 255 ECU_ADDRESS 0x0 /end MEASUREMENT
/begin MEASUREMENT Com_RxSigInfo[188].ValidDlcOfRxSigInfo "" UBYTE NO_COMPU_METHOD 0 0 0 255 ECU_ADDRESS 0x0 /end MEASUREMENT
/begin MEASUREMENT Com_RxSigInfo[189].RxAccessInfoIdxOfRxSigInfo "" UWORD NO_COMPU_METHOD 0 0 0 65535 ECU_ADDRESS 0x0 /end MEASUREMENT
/begin MEASUREMENT Com_RxSigInfo[189].RxCbkFuncPtrAckIdxOfRxSigInfo "" UBYTE Com_RxCbkFuncPtrAckIdxOfRxSigInfoType 0 0 0 255 ECU_ADDRESS 0x0 /end MEASUREMENT
/begin MEASUREMENT Com_RxSigInfo[189].SignalProcessingOfRxSigInfo "" UBYTE Com_SignalProcessingOfRxSigInfoType 0 0 0 255 ECU_ADDRESS 0x0 /end MEASUREMENT
/begin MEASUREMENT Com_RxSigInfo[189].ValidDlcOfRxSigInfo "" UBYTE NO_COMPU_METHOD 0 0 0 255 ECU_ADDRESS 0x0 /end MEASUREMENT
/begin MEASUREMENT Com_RxSigInfo[18].RxAccessInfoIdxOfRxSigInfo "" UWORD NO_COMPU_METHOD 0 0 0 65535 ECU_ADDRESS 0x0 /end MEASUREMENT
/begin MEASUREMENT Com_RxSigInfo[18].RxCbkFuncPtrAckIdxOfRxSigInfo "" UBYTE Com_RxCbkFuncPtrAckIdxOfRxSigInfoType 0 0 0 255 ECU_ADDRESS 0x0 /end MEASUREMENT
/begin MEASUREMENT Com_RxSigInfo[18].SignalProcessingOfRxSigInfo "" UBYTE Com_SignalProcessingOfRxSigInfoType 0 0 0 255 ECU_ADDRESS 0x0 /end MEASUREMENT
/begin MEASUREMENT Com_RxSigInfo[18].ValidDlcOfRxSigInfo "" UBYTE NO_COMPU_METHOD 0 0 0 255 ECU_ADDRESS 0x0 /end MEASUREMENT
/begin MEASUREMENT Com_RxSigInfo[190].RxAccessInfoIdxOfRxSigInfo "" UWORD NO_COMPU_METHOD 0 0 0 65535 ECU_ADDRESS 0x0 /end MEASUREMENT
/begin MEASUREMENT Com_RxSigInfo[190].RxCbkFuncPtrAckIdxOfRxSigInfo "" UBYTE Com_RxCbkFuncPtrAckIdxOfRxSigInfoType 0 0 0 255 ECU_ADDRESS 0x0 /end MEASUREMENT
/begin MEASUREMENT Com_RxSigInfo[190].SignalProcessingOfRxSigInfo "" UBYTE Com_SignalProcessingOfRxSigInfoType 0 0 0 255 ECU_ADDRESS 0x0 /end MEASUREMENT
/begin MEASUREMENT Com_RxSigInfo[190].ValidDlcOfRxSigInfo "" UBYTE NO_COMPU_METHOD 0 0 0 255 ECU_ADDRESS 0x0 /end MEASUREMENT
/begin MEASUREMENT Com_RxSigInfo[191].RxAccessInfoIdxOfRxSigInfo "" UWORD NO_COMPU_METHOD 0 0 0 65535 ECU_ADDRESS 0x0 /end MEASUREMENT
/begin MEASUREMENT Com_RxSigInfo[191].RxCbkFuncPtrAckIdxOfRxSigInfo "" UBYTE Com_RxCbkFuncPtrAckIdxOfRxSigInfoType 0 0 0 255 ECU_ADDRESS 0x0 /end MEASUREMENT
/begin MEASUREMENT Com_RxSigInfo[191].SignalProcessingOfRxSigInfo "" UBYTE Com_SignalProcessingOfRxSigInfoType 0 0 0 255 ECU_ADDRESS 0x0 /end MEASUREMENT
/begin MEASUREMENT Com_RxSigInfo[191].ValidDlcOfRxSigInfo "" UBYTE NO_COMPU_METHOD 0 0 0 255 ECU_ADDRESS 0x0 /end MEASUREMENT
/begin MEASUREMENT Com_RxSigInfo[192].RxAccessInfoIdxOfRxSigInfo "" UWORD NO_COMPU_METHOD 0 0 0 65535 ECU_ADDRESS 0x0 /end MEASUREMENT
/begin MEASUREMENT Com_RxSigInfo[192].RxCbkFuncPtrAckIdxOfRxSigInfo "" UBYTE Com_RxCbkFuncPtrAckIdxOfRxSigInfoType 0 0 0 255 ECU_ADDRESS 0x0 /end MEASUREMENT
/begin MEASUREMENT Com_RxSigInfo[192].SignalProcessingOfRxSigInfo "" UBYTE Com_SignalProcessingOfRxSigInfoType 0 0 0 255 ECU_ADDRESS 0x0 /end MEASUREMENT
/begin MEASUREMENT Com_RxSigInfo[192].ValidDlcOfRxSigInfo "" UBYTE NO_COMPU_METHOD 0 0 0 255 ECU_ADDRESS 0x0 /end MEASUREMENT
/begin MEASUREMENT Com_RxSigInfo[193].RxAccessInfoIdxOfRxSigInfo "" UWORD NO_COMPU_METHOD 0 0 0 65535 ECU_ADDRESS 0x0 /end MEASUREMENT
/begin MEASUREMENT Com_RxSigInfo[193].RxCbkFuncPtrAckIdxOfRxSigInfo "" UBYTE Com_RxCbkFuncPtrAckIdxOfRxSigInfoType 0 0 0 255 ECU_ADDRESS 0x0 /end MEASUREMENT
/begin MEASUREMENT Com_RxSigInfo[193].SignalProcessingOfRxSigInfo "" UBYTE Com_SignalProcessingOfRxSigInfoType 0 0 0 255 ECU_ADDRESS 0x0 /end MEASUREMENT
/begin MEASUREMENT Com_RxSigInfo[193].ValidDlcOfRxSigInfo "" UBYTE NO_COMPU_METHOD 0 0 0 255 ECU_ADDRESS 0x0 /end MEASUREMENT
/begin MEASUREMENT Com_RxSigInfo[194].RxAccessInfoIdxOfRxSigInfo "" UWORD NO_COMPU_METHOD 0 0 0 65535 ECU_ADDRESS 0x0 /end MEASUREMENT
/begin MEASUREMENT Com_RxSigInfo[194].RxCbkFuncPtrAckIdxOfRxSigInfo "" UBYTE Com_RxCbkFuncPtrAckIdxOfRxSigInfoType 0 0 0 255 ECU_ADDRESS 0x0 /end MEASUREMENT
/begin MEASUREMENT Com_RxSigInfo[194].SignalProcessingOfRxSigInfo "" UBYTE Com_SignalProcessingOfRxSigInfoType 0 0 0 255 ECU_ADDRESS 0x0 /end MEASUREMENT
/begin MEASUREMENT Com_RxSigInfo[194].ValidDlcOfRxSigInfo "" UBYTE NO_COMPU_METHOD 0 0 0 255 ECU_ADDRESS 0x0 /end MEASUREMENT
/begin MEASUREMENT Com_RxSigInfo[195].RxAccessInfoIdxOfRxSigInfo "" UWORD NO_COMPU_METHOD 0 0 0 65535 ECU_ADDRESS 0x0 /end MEASUREMENT
/begin MEASUREMENT Com_RxSigInfo[195].RxCbkFuncPtrAckIdxOfRxSigInfo "" UBYTE Com_RxCbkFuncPtrAckIdxOfRxSigInfoType 0 0 0 255 ECU_ADDRESS 0x0 /end MEASUREMENT
/begin MEASUREMENT Com_RxSigInfo[195].SignalProcessingOfRxSigInfo "" UBYTE Com_SignalProcessingOfRxSigInfoType 0 0 0 255 ECU_ADDRESS 0x0 /end MEASUREMENT
/begin MEASUREMENT Com_RxSigInfo[195].ValidDlcOfRxSigInfo "" UBYTE NO_COMPU_METHOD 0 0 0 255 ECU_ADDRESS 0x0 /end MEASUREMENT
/begin MEASUREMENT Com_RxSigInfo[196].RxAccessInfoIdxOfRxSigInfo "" UWORD NO_COMPU_METHOD 0 0 0 65535 ECU_ADDRESS 0x0 /end MEASUREMENT
/begin MEASUREMENT Com_RxSigInfo[196].RxCbkFuncPtrAckIdxOfRxSigInfo "" UBYTE Com_RxCbkFuncPtrAckIdxOfRxSigInfoType 0 0 0 255 ECU_ADDRESS 0x0 /end MEASUREMENT
/begin MEASUREMENT Com_RxSigInfo[196].SignalProcessingOfRxSigInfo "" UBYTE Com_SignalProcessingOfRxSigInfoType 0 0 0 255 ECU_ADDRESS 0x0 /end MEASUREMENT
/begin MEASUREMENT Com_RxSigInfo[196].ValidDlcOfRxSigInfo "" UBYTE NO_COMPU_METHOD 0 0 0 255 ECU_ADDRESS 0x0 /end MEASUREMENT
/begin MEASUREMENT Com_RxSigInfo[197].RxAccessInfoIdxOfRxSigInfo "" UWORD NO_COMPU_METHOD 0 0 0 65535 ECU_ADDRESS 0x0 /end MEASUREMENT
/begin MEASUREMENT Com_RxSigInfo[197].RxCbkFuncPtrAckIdxOfRxSigInfo "" UBYTE Com_RxCbkFuncPtrAckIdxOfRxSigInfoType 0 0 0 255 ECU_ADDRESS 0x0 /end MEASUREMENT
/begin MEASUREMENT Com_RxSigInfo[197].SignalProcessingOfRxSigInfo "" UBYTE Com_SignalProcessingOfRxSigInfoType 0 0 0 255 ECU_ADDRESS 0x0 /end MEASUREMENT
/begin MEASUREMENT Com_RxSigInfo[197].ValidDlcOfRxSigInfo "" UBYTE NO_COMPU_METHOD 0 0 0 255 ECU_ADDRESS 0x0 /end MEASUREMENT
/begin MEASUREMENT Com_RxSigInfo[198].RxAccessInfoIdxOfRxSigInfo "" UWORD NO_COMPU_METHOD 0 0 0 65535 ECU_ADDRESS 0x0 /end MEASUREMENT
/begin MEASUREMENT Com_RxSigInfo[198].RxCbkFuncPtrAckIdxOfRxSigInfo "" UBYTE Com_RxCbkFuncPtrAckIdxOfRxSigInfoType 0 0 0 255 ECU_ADDRESS 0x0 /end MEASUREMENT
/begin MEASUREMENT Com_RxSigInfo[198].SignalProcessingOfRxSigInfo "" UBYTE Com_SignalProcessingOfRxSigInfoType 0 0 0 255 ECU_ADDRESS 0x0 /end MEASUREMENT
/begin MEASUREMENT Com_RxSigInfo[198].ValidDlcOfRxSigInfo "" UBYTE NO_COMPU_METHOD 0 0 0 255 ECU_ADDRESS 0x0 /end MEASUREMENT
/begin MEASUREMENT Com_RxSigInfo[199].RxAccessInfoIdxOfRxSigInfo "" UWORD NO_COMPU_METHOD 0 0 0 65535 ECU_ADDRESS 0x0 /end MEASUREMENT
/begin MEASUREMENT Com_RxSigInfo[199].RxCbkFuncPtrAckIdxOfRxSigInfo "" UBYTE Com_RxCbkFuncPtrAckIdxOfRxSigInfoType 0 0 0 255 ECU_ADDRESS 0x0 /end MEASUREMENT
/begin MEASUREMENT Com_RxSigInfo[199].SignalProcessingOfRxSigInfo "" UBYTE Com_SignalProcessingOfRxSigInfoType 0 0 0 255 ECU_ADDRESS 0x0 /end MEASUREMENT
/begin MEASUREMENT Com_RxSigInfo[199].ValidDlcOfRxSigInfo "" UBYTE NO_COMPU_METHOD 0 0 0 255 ECU_ADDRESS 0x0 /end MEASUREMENT
/begin MEASUREMENT Com_RxSigInfo[19].RxAccessInfoIdxOfRxSigInfo "" UWORD NO_COMPU_METHOD 0 0 0 65535 ECU_ADDRESS 0x0 /end MEASUREMENT
/begin MEASUREMENT Com_RxSigInfo[19].RxCbkFuncPtrAckIdxOfRxSigInfo "" UBYTE Com_RxCbkFuncPtrAckIdxOfRxSigInfoType 0 0 0 255 ECU_ADDRESS 0x0 /end MEASUREMENT
/begin MEASUREMENT Com_RxSigInfo[19].SignalProcessingOfRxSigInfo "" UBYTE Com_SignalProcessingOfRxSigInfoType 0 0 0 255 ECU_ADDRESS 0x0 /end MEASUREMENT
/begin MEASUREMENT Com_RxSigInfo[19].ValidDlcOfRxSigInfo "" UBYTE NO_COMPU_METHOD 0 0 0 255 ECU_ADDRESS 0x0 /end MEASUREMENT
/begin MEASUREMENT Com_RxSigInfo[1].RxAccessInfoIdxOfRxSigInfo "" UWORD NO_COMPU_METHOD 0 0 0 65535 ECU_ADDRESS 0x0 /end MEASUREMENT
/begin MEASUREMENT Com_RxSigInfo[1].RxCbkFuncPtrAckIdxOfRxSigInfo "" UBYTE Com_RxCbkFuncPtrAckIdxOfRxSigInfoType 0 0 0 255 ECU_ADDRESS 0x0 /end MEASUREMENT
/begin MEASUREMENT Com_RxSigInfo[1].SignalProcessingOfRxSigInfo "" UBYTE Com_SignalProcessingOfRxSigInfoType 0 0 0 255 ECU_ADDRESS 0x0 /end MEASUREMENT
/begin MEASUREMENT Com_RxSigInfo[1].ValidDlcOfRxSigInfo "" UBYTE NO_COMPU_METHOD 0 0 0 255 ECU_ADDRESS 0x0 /end MEASUREMENT
/begin MEASUREMENT Com_RxSigInfo[200].RxAccessInfoIdxOfRxSigInfo "" UWORD NO_COMPU_METHOD 0 0 0 65535 ECU_ADDRESS 0x0 /end MEASUREMENT
/begin MEASUREMENT Com_RxSigInfo[200].RxCbkFuncPtrAckIdxOfRxSigInfo "" UBYTE Com_RxCbkFuncPtrAckIdxOfRxSigInfoType 0 0 0 255 ECU_ADDRESS 0x0 /end MEASUREMENT
/begin MEASUREMENT Com_RxSigInfo[200].SignalProcessingOfRxSigInfo "" UBYTE Com_SignalProcessingOfRxSigInfoType 0 0 0 255 ECU_ADDRESS 0x0 /end MEASUREMENT
/begin MEASUREMENT Com_RxSigInfo[200].ValidDlcOfRxSigInfo "" UBYTE NO_COMPU_METHOD 0 0 0 255 ECU_ADDRESS 0x0 /end MEASUREMENT
/begin MEASUREMENT Com_RxSigInfo[201].RxAccessInfoIdxOfRxSigInfo "" UWORD NO_COMPU_METHOD 0 0 0 65535 ECU_ADDRESS 0x0 /end MEASUREMENT
/begin MEASUREMENT Com_RxSigInfo[201].RxCbkFuncPtrAckIdxOfRxSigInfo "" UBYTE Com_RxCbkFuncPtrAckIdxOfRxSigInfoType 0 0 0 255 ECU_ADDRESS 0x0 /end MEASUREMENT
/begin MEASUREMENT Com_RxSigInfo[201].SignalProcessingOfRxSigInfo "" UBYTE Com_SignalProcessingOfRxSigInfoType 0 0 0 255 ECU_ADDRESS 0x0 /end MEASUREMENT
/begin MEASUREMENT Com_RxSigInfo[201].ValidDlcOfRxSigInfo "" UBYTE NO_COMPU_METHOD 0 0 0 255 ECU_ADDRESS 0x0 /end MEASUREMENT
/begin MEASUREMENT Com_RxSigInfo[202].RxAccessInfoIdxOfRxSigInfo "" UWORD NO_COMPU_METHOD 0 0 0 65535 ECU_ADDRESS 0x0 /end MEASUREMENT
/begin MEASUREMENT Com_RxSigInfo[202].RxCbkFuncPtrAckIdxOfRxSigInfo "" UBYTE Com_RxCbkFuncPtrAckIdxOfRxSigInfoType 0 0 0 255 ECU_ADDRESS 0x0 /end MEASUREMENT
/begin MEASUREMENT Com_RxSigInfo[202].SignalProcessingOfRxSigInfo "" UBYTE Com_SignalProcessingOfRxSigInfoType 0 0 0 255 ECU_ADDRESS 0x0 /end MEASUREMENT
/begin MEASUREMENT Com_RxSigInfo[202].ValidDlcOfRxSigInfo "" UBYTE NO_COMPU_METHOD 0 0 0 255 ECU_ADDRESS 0x0 /end MEASUREMENT
/begin MEASUREMENT Com_RxSigInfo[203].RxAccessInfoIdxOfRxSigInfo "" UWORD NO_COMPU_METHOD 0 0 0 65535 ECU_ADDRESS 0x0 /end MEASUREMENT
/begin MEASUREMENT Com_RxSigInfo[203].RxCbkFuncPtrAckIdxOfRxSigInfo "" UBYTE Com_RxCbkFuncPtrAckIdxOfRxSigInfoType 0 0 0 255 ECU_ADDRESS 0x0 /end MEASUREMENT
/begin MEASUREMENT Com_RxSigInfo[203].SignalProcessingOfRxSigInfo "" UBYTE Com_SignalProcessingOfRxSigInfoType 0 0 0 255 ECU_ADDRESS 0x0 /end MEASUREMENT
/begin MEASUREMENT Com_RxSigInfo[203].ValidDlcOfRxSigInfo "" UBYTE NO_COMPU_METHOD 0 0 0 255 ECU_ADDRESS 0x0 /end MEASUREMENT
/begin MEASUREMENT Com_RxSigInfo[204].RxAccessInfoIdxOfRxSigInfo "" UWORD NO_COMPU_METHOD 0 0 0 65535 ECU_ADDRESS 0x0 /end MEASUREMENT
/begin MEASUREMENT Com_RxSigInfo[204].RxCbkFuncPtrAckIdxOfRxSigInfo "" UBYTE Com_RxCbkFuncPtrAckIdxOfRxSigInfoType 0 0 0 255 ECU_ADDRESS 0x0 /end MEASUREMENT
/begin MEASUREMENT Com_RxSigInfo[204].SignalProcessingOfRxSigInfo "" UBYTE Com_SignalProcessingOfRxSigInfoType 0 0 0 255 ECU_ADDRESS 0x0 /end MEASUREMENT
/begin MEASUREMENT Com_RxSigInfo[204].ValidDlcOfRxSigInfo "" UBYTE NO_COMPU_METHOD 0 0 0 255 ECU_ADDRESS 0x0 /end MEASUREMENT
/begin MEASUREMENT Com_RxSigInfo[205].RxAccessInfoIdxOfRxSigInfo "" UWORD NO_COMPU_METHOD 0 0 0 65535 ECU_ADDRESS 0x0 /end MEASUREMENT
/begin MEASUREMENT Com_RxSigInfo[205].RxCbkFuncPtrAckIdxOfRxSigInfo "" UBYTE Com_RxCbkFuncPtrAckIdxOfRxSigInfoType 0 0 0 255 ECU_ADDRESS 0x0 /end MEASUREMENT
/begin MEASUREMENT Com_RxSigInfo[205].SignalProcessingOfRxSigInfo "" UBYTE Com_SignalProcessingOfRxSigInfoType 0 0 0 255 ECU_ADDRESS 0x0 /end MEASUREMENT
/begin MEASUREMENT Com_RxSigInfo[205].ValidDlcOfRxSigInfo "" UBYTE NO_COMPU_METHOD 0 0 0 255 ECU_ADDRESS 0x0 /end MEASUREMENT
/begin MEASUREMENT Com_RxSigInfo[206].RxAccessInfoIdxOfRxSigInfo "" UWORD NO_COMPU_METHOD 0 0 0 65535 ECU_ADDRESS 0x0 /end MEASUREMENT
/begin MEASUREMENT Com_RxSigInfo[206].RxCbkFuncPtrAckIdxOfRxSigInfo "" UBYTE Com_RxCbkFuncPtrAckIdxOfRxSigInfoType 0 0 0 255 ECU_ADDRESS 0x0 /end MEASUREMENT
/begin MEASUREMENT Com_RxSigInfo[206].SignalProcessingOfRxSigInfo "" UBYTE Com_SignalProcessingOfRxSigInfoType 0 0 0 255 ECU_ADDRESS 0x0 /end MEASUREMENT
/begin MEASUREMENT Com_RxSigInfo[206].ValidDlcOfRxSigInfo "" UBYTE NO_COMPU_METHOD 0 0 0 255 ECU_ADDRESS 0x0 /end MEASUREMENT
/begin MEASUREMENT Com_RxSigInfo[207].RxAccessInfoIdxOfRxSigInfo "" UWORD NO_COMPU_METHOD 0 0 0 65535 ECU_ADDRESS 0x0 /end MEASUREMENT
/begin MEASUREMENT Com_RxSigInfo[207].RxCbkFuncPtrAckIdxOfRxSigInfo "" UBYTE Com_RxCbkFuncPtrAckIdxOfRxSigInfoType 0 0 0 255 ECU_ADDRESS 0x0 /end MEASUREMENT
/begin MEASUREMENT Com_RxSigInfo[207].SignalProcessingOfRxSigInfo "" UBYTE Com_SignalProcessingOfRxSigInfoType 0 0 0 255 ECU_ADDRESS 0x0 /end MEASUREMENT
/begin MEASUREMENT Com_RxSigInfo[207].ValidDlcOfRxSigInfo "" UBYTE NO_COMPU_METHOD 0 0 0 255 ECU_ADDRESS 0x0 /end MEASUREMENT
/begin MEASUREMENT Com_RxSigInfo[208].RxAccessInfoIdxOfRxSigInfo "" UWORD NO_COMPU_METHOD 0 0 0 65535 ECU_ADDRESS 0x0 /end MEASUREMENT
/begin MEASUREMENT Com_RxSigInfo[208].RxCbkFuncPtrAckIdxOfRxSigInfo "" UBYTE Com_RxCbkFuncPtrAckIdxOfRxSigInfoType 0 0 0 255 ECU_ADDRESS 0x0 /end MEASUREMENT
/begin MEASUREMENT Com_RxSigInfo[208].SignalProcessingOfRxSigInfo "" UBYTE Com_SignalProcessingOfRxSigInfoType 0 0 0 255 ECU_ADDRESS 0x0 /end MEASUREMENT
/begin MEASUREMENT Com_RxSigInfo[208].ValidDlcOfRxSigInfo "" UBYTE NO_COMPU_METHOD 0 0 0 255 ECU_ADDRESS 0x0 /end MEASUREMENT
/begin MEASUREMENT Com_RxSigInfo[209].RxAccessInfoIdxOfRxSigInfo "" UWORD NO_COMPU_METHOD 0 0 0 65535 ECU_ADDRESS 0x0 /end MEASUREMENT
/begin MEASUREMENT Com_RxSigInfo[209].RxCbkFuncPtrAckIdxOfRxSigInfo "" UBYTE Com_RxCbkFuncPtrAckIdxOfRxSigInfoType 0 0 0 255 ECU_ADDRESS 0x0 /end MEASUREMENT
/begin MEASUREMENT Com_RxSigInfo[209].SignalProcessingOfRxSigInfo "" UBYTE Com_SignalProcessingOfRxSigInfoType 0 0 0 255 ECU_ADDRESS 0x0 /end MEASUREMENT
/begin MEASUREMENT Com_RxSigInfo[209].ValidDlcOfRxSigInfo "" UBYTE NO_COMPU_METHOD 0 0 0 255 ECU_ADDRESS 0x0 /end MEASUREMENT
/begin MEASUREMENT Com_RxSigInfo[20].RxAccessInfoIdxOfRxSigInfo "" UWORD NO_COMPU_METHOD 0 0 0 65535 ECU_ADDRESS 0x0 /end MEASUREMENT
/begin MEASUREMENT Com_RxSigInfo[20].RxCbkFuncPtrAckIdxOfRxSigInfo "" UBYTE Com_RxCbkFuncPtrAckIdxOfRxSigInfoType 0 0 0 255 ECU_ADDRESS 0x0 /end MEASUREMENT
/begin MEASUREMENT Com_RxSigInfo[20].SignalProcessingOfRxSigInfo "" UBYTE Com_SignalProcessingOfRxSigInfoType 0 0 0 255 ECU_ADDRESS 0x0 /end MEASUREMENT
/begin MEASUREMENT Com_RxSigInfo[20].ValidDlcOfRxSigInfo "" UBYTE NO_COMPU_METHOD 0 0 0 255 ECU_ADDRESS 0x0 /end MEASUREMENT
/begin MEASUREMENT Com_RxSigInfo[210].RxAccessInfoIdxOfRxSigInfo "" UWORD NO_COMPU_METHOD 0 0 0 65535 ECU_ADDRESS 0x0 /end MEASUREMENT
/begin MEASUREMENT Com_RxSigInfo[210].RxCbkFuncPtrAckIdxOfRxSigInfo "" UBYTE Com_RxCbkFuncPtrAckIdxOfRxSigInfoType 0 0 0 255 ECU_ADDRESS 0x0 /end MEASUREMENT
/begin MEASUREMENT Com_RxSigInfo[210].SignalProcessingOfRxSigInfo "" UBYTE Com_SignalProcessingOfRxSigInfoType 0 0 0 255 ECU_ADDRESS 0x0 /end MEASUREMENT
/begin MEASUREMENT Com_RxSigInfo[210].ValidDlcOfRxSigInfo "" UBYTE NO_COMPU_METHOD 0 0 0 255 ECU_ADDRESS 0x0 /end MEASUREMENT
/begin MEASUREMENT Com_RxSigInfo[211].RxAccessInfoIdxOfRxSigInfo "" UWORD NO_COMPU_METHOD 0 0 0 65535 ECU_ADDRESS 0x0 /end MEASUREMENT
/begin MEASUREMENT Com_RxSigInfo[211].RxCbkFuncPtrAckIdxOfRxSigInfo "" UBYTE Com_RxCbkFuncPtrAckIdxOfRxSigInfoType 0 0 0 255 ECU_ADDRESS 0x0 /end MEASUREMENT
/begin MEASUREMENT Com_RxSigInfo[211].SignalProcessingOfRxSigInfo "" UBYTE Com_SignalProcessingOfRxSigInfoType 0 0 0 255 ECU_ADDRESS 0x0 /end MEASUREMENT
/begin MEASUREMENT Com_RxSigInfo[211].ValidDlcOfRxSigInfo "" UBYTE NO_COMPU_METHOD 0 0 0 255 ECU_ADDRESS 0x0 /end MEASUREMENT
/begin MEASUREMENT Com_RxSigInfo[212].RxAccessInfoIdxOfRxSigInfo "" UWORD NO_COMPU_METHOD 0 0 0 65535 ECU_ADDRESS 0x0 /end MEASUREMENT
/begin MEASUREMENT Com_RxSigInfo[212].RxCbkFuncPtrAckIdxOfRxSigInfo "" UBYTE Com_RxCbkFuncPtrAckIdxOfRxSigInfoType 0 0 0 255 ECU_ADDRESS 0x0 /end MEASUREMENT
/begin MEASUREMENT Com_RxSigInfo[212].SignalProcessingOfRxSigInfo "" UBYTE Com_SignalProcessingOfRxSigInfoType 0 0 0 255 ECU_ADDRESS 0x0 /end MEASUREMENT
/begin MEASUREMENT Com_RxSigInfo[212].ValidDlcOfRxSigInfo "" UBYTE NO_COMPU_METHOD 0 0 0 255 ECU_ADDRESS 0x0 /end MEASUREMENT
/begin MEASUREMENT Com_RxSigInfo[213].RxAccessInfoIdxOfRxSigInfo "" UWORD NO_COMPU_METHOD 0 0 0 65535 ECU_ADDRESS 0x0 /end MEASUREMENT
/begin MEASUREMENT Com_RxSigInfo[213].RxCbkFuncPtrAckIdxOfRxSigInfo "" UBYTE Com_RxCbkFuncPtrAckIdxOfRxSigInfoType 0 0 0 255 ECU_ADDRESS 0x0 /end MEASUREMENT
/begin MEASUREMENT Com_RxSigInfo[213].SignalProcessingOfRxSigInfo "" UBYTE Com_SignalProcessingOfRxSigInfoType 0 0 0 255 ECU_ADDRESS 0x0 /end MEASUREMENT
/begin MEASUREMENT Com_RxSigInfo[213].ValidDlcOfRxSigInfo "" UBYTE NO_COMPU_METHOD 0 0 0 255 ECU_ADDRESS 0x0 /end MEASUREMENT
/begin MEASUREMENT Com_RxSigInfo[214].RxAccessInfoIdxOfRxSigInfo "" UWORD NO_COMPU_METHOD 0 0 0 65535 ECU_ADDRESS 0x0 /end MEASUREMENT
/begin MEASUREMENT Com_RxSigInfo[214].RxCbkFuncPtrAckIdxOfRxSigInfo "" UBYTE Com_RxCbkFuncPtrAckIdxOfRxSigInfoType 0 0 0 255 ECU_ADDRESS 0x0 /end MEASUREMENT
/begin MEASUREMENT Com_RxSigInfo[214].SignalProcessingOfRxSigInfo "" UBYTE Com_SignalProcessingOfRxSigInfoType 0 0 0 255 ECU_ADDRESS 0x0 /end MEASUREMENT
/begin MEASUREMENT Com_RxSigInfo[214].ValidDlcOfRxSigInfo "" UBYTE NO_COMPU_METHOD 0 0 0 255 ECU_ADDRESS 0x0 /end MEASUREMENT
/begin MEASUREMENT Com_RxSigInfo[215].RxAccessInfoIdxOfRxSigInfo "" UWORD NO_COMPU_METHOD 0 0 0 65535 ECU_ADDRESS 0x0 /end MEASUREMENT
/begin MEASUREMENT Com_RxSigInfo[215].RxCbkFuncPtrAckIdxOfRxSigInfo "" UBYTE Com_RxCbkFuncPtrAckIdxOfRxSigInfoType 0 0 0 255 ECU_ADDRESS 0x0 /end MEASUREMENT
/begin MEASUREMENT Com_RxSigInfo[215].SignalProcessingOfRxSigInfo "" UBYTE Com_SignalProcessingOfRxSigInfoType 0 0 0 255 ECU_ADDRESS 0x0 /end MEASUREMENT
/begin MEASUREMENT Com_RxSigInfo[215].ValidDlcOfRxSigInfo "" UBYTE NO_COMPU_METHOD 0 0 0 255 ECU_ADDRESS 0x0 /end MEASUREMENT
/begin MEASUREMENT Com_RxSigInfo[216].RxAccessInfoIdxOfRxSigInfo "" UWORD NO_COMPU_METHOD 0 0 0 65535 ECU_ADDRESS 0x0 /end MEASUREMENT
/begin MEASUREMENT Com_RxSigInfo[216].RxCbkFuncPtrAckIdxOfRxSigInfo "" UBYTE Com_RxCbkFuncPtrAckIdxOfRxSigInfoType 0 0 0 255 ECU_ADDRESS 0x0 /end MEASUREMENT
/begin MEASUREMENT Com_RxSigInfo[216].SignalProcessingOfRxSigInfo "" UBYTE Com_SignalProcessingOfRxSigInfoType 0 0 0 255 ECU_ADDRESS 0x0 /end MEASUREMENT
/begin MEASUREMENT Com_RxSigInfo[216].ValidDlcOfRxSigInfo "" UBYTE NO_COMPU_METHOD 0 0 0 255 ECU_ADDRESS 0x0 /end MEASUREMENT
/begin MEASUREMENT Com_RxSigInfo[217].RxAccessInfoIdxOfRxSigInfo "" UWORD NO_COMPU_METHOD 0 0 0 65535 ECU_ADDRESS 0x0 /end MEASUREMENT
/begin MEASUREMENT Com_RxSigInfo[217].RxCbkFuncPtrAckIdxOfRxSigInfo "" UBYTE Com_RxCbkFuncPtrAckIdxOfRxSigInfoType 0 0 0 255 ECU_ADDRESS 0x0 /end MEASUREMENT
/begin MEASUREMENT Com_RxSigInfo[217].SignalProcessingOfRxSigInfo "" UBYTE Com_SignalProcessingOfRxSigInfoType 0 0 0 255 ECU_ADDRESS 0x0 /end MEASUREMENT
/begin MEASUREMENT Com_RxSigInfo[217].ValidDlcOfRxSigInfo "" UBYTE NO_COMPU_METHOD 0 0 0 255 ECU_ADDRESS 0x0 /end MEASUREMENT
/begin MEASUREMENT Com_RxSigInfo[218].RxAccessInfoIdxOfRxSigInfo "" UWORD NO_COMPU_METHOD 0 0 0 65535 ECU_ADDRESS 0x0 /end MEASUREMENT
/begin MEASUREMENT Com_RxSigInfo[218].RxCbkFuncPtrAckIdxOfRxSigInfo "" UBYTE Com_RxCbkFuncPtrAckIdxOfRxSigInfoType 0 0 0 255 ECU_ADDRESS 0x0 /end MEASUREMENT
/begin MEASUREMENT Com_RxSigInfo[218].SignalProcessingOfRxSigInfo "" UBYTE Com_SignalProcessingOfRxSigInfoType 0 0 0 255 ECU_ADDRESS 0x0 /end MEASUREMENT
/begin MEASUREMENT Com_RxSigInfo[218].ValidDlcOfRxSigInfo "" UBYTE NO_COMPU_METHOD 0 0 0 255 ECU_ADDRESS 0x0 /end MEASUREMENT
/begin MEASUREMENT Com_RxSigInfo[219].RxAccessInfoIdxOfRxSigInfo "" UWORD NO_COMPU_METHOD 0 0 0 65535 ECU_ADDRESS 0x0 /end MEASUREMENT
/begin MEASUREMENT Com_RxSigInfo[219].RxCbkFuncPtrAckIdxOfRxSigInfo "" UBYTE Com_RxCbkFuncPtrAckIdxOfRxSigInfoType 0 0 0 255 ECU_ADDRESS 0x0 /end MEASUREMENT
/begin MEASUREMENT Com_RxSigInfo[219].SignalProcessingOfRxSigInfo "" UBYTE Com_SignalProcessingOfRxSigInfoType 0 0 0 255 ECU_ADDRESS 0x0 /end MEASUREMENT
/begin MEASUREMENT Com_RxSigInfo[219].ValidDlcOfRxSigInfo "" UBYTE NO_COMPU_METHOD 0 0 0 255 ECU_ADDRESS 0x0 /end MEASUREMENT
/begin MEASUREMENT Com_RxSigInfo[21].RxAccessInfoIdxOfRxSigInfo "" UWORD NO_COMPU_METHOD 0 0 0 65535 ECU_ADDRESS 0x0 /end MEASUREMENT
/begin MEASUREMENT Com_RxSigInfo[21].RxCbkFuncPtrAckIdxOfRxSigInfo "" UBYTE Com_RxCbkFuncPtrAckIdxOfRxSigInfoType 0 0 0 255 ECU_ADDRESS 0x0 /end MEASUREMENT
/begin MEASUREMENT Com_RxSigInfo[21].SignalProcessingOfRxSigInfo "" UBYTE Com_SignalProcessingOfRxSigInfoType 0 0 0 255 ECU_ADDRESS 0x0 /end MEASUREMENT
/begin MEASUREMENT Com_RxSigInfo[21].ValidDlcOfRxSigInfo "" UBYTE NO_COMPU_METHOD 0 0 0 255 ECU_ADDRESS 0x0 /end MEASUREMENT
/begin MEASUREMENT Com_RxSigInfo[220].RxAccessInfoIdxOfRxSigInfo "" UWORD NO_COMPU_METHOD 0 0 0 65535 ECU_ADDRESS 0x0 /end MEASUREMENT
/begin MEASUREMENT Com_RxSigInfo[220].RxCbkFuncPtrAckIdxOfRxSigInfo "" UBYTE Com_RxCbkFuncPtrAckIdxOfRxSigInfoType 0 0 0 255 ECU_ADDRESS 0x0 /end MEASUREMENT
/begin MEASUREMENT Com_RxSigInfo[220].SignalProcessingOfRxSigInfo "" UBYTE Com_SignalProcessingOfRxSigInfoType 0 0 0 255 ECU_ADDRESS 0x0 /end MEASUREMENT
/begin MEASUREMENT Com_RxSigInfo[220].ValidDlcOfRxSigInfo "" UBYTE NO_COMPU_METHOD 0 0 0 255 ECU_ADDRESS 0x0 /end MEASUREMENT
/begin MEASUREMENT Com_RxSigInfo[221].RxAccessInfoIdxOfRxSigInfo "" UWORD NO_COMPU_METHOD 0 0 0 65535 ECU_ADDRESS 0x0 /end MEASUREMENT
/begin MEASUREMENT Com_RxSigInfo[221].RxCbkFuncPtrAckIdxOfRxSigInfo "" UBYTE Com_RxCbkFuncPtrAckIdxOfRxSigInfoType 0 0 0 255 ECU_ADDRESS 0x0 /end MEASUREMENT
/begin MEASUREMENT Com_RxSigInfo[221].SignalProcessingOfRxSigInfo "" UBYTE Com_SignalProcessingOfRxSigInfoType 0 0 0 255 ECU_ADDRESS 0x0 /end MEASUREMENT
/begin MEASUREMENT Com_RxSigInfo[221].ValidDlcOfRxSigInfo "" UBYTE NO_COMPU_METHOD 0 0 0 255 ECU_ADDRESS 0x0 /end MEASUREMENT
/begin MEASUREMENT Com_RxSigInfo[222].RxAccessInfoIdxOfRxSigInfo "" UWORD NO_COMPU_METHOD 0 0 0 65535 ECU_ADDRESS 0x0 /end MEASUREMENT
/begin MEASUREMENT Com_RxSigInfo[222].RxCbkFuncPtrAckIdxOfRxSigInfo "" UBYTE Com_RxCbkFuncPtrAckIdxOfRxSigInfoType 0 0 0 255 ECU_ADDRESS 0x0 /end MEASUREMENT
/begin MEASUREMENT Com_RxSigInfo[222].SignalProcessingOfRxSigInfo "" UBYTE Com_SignalProcessingOfRxSigInfoType 0 0 0 255 ECU_ADDRESS 0x0 /end MEASUREMENT
/begin MEASUREMENT Com_RxSigInfo[222].ValidDlcOfRxSigInfo "" UBYTE NO_COMPU_METHOD 0 0 0 255 ECU_ADDRESS 0x0 /end MEASUREMENT
/begin MEASUREMENT Com_RxSigInfo[223].RxAccessInfoIdxOfRxSigInfo "" UWORD NO_COMPU_METHOD 0 0 0 65535 ECU_ADDRESS 0x0 /end MEASUREMENT
/begin MEASUREMENT Com_RxSigInfo[223].RxCbkFuncPtrAckIdxOfRxSigInfo "" UBYTE Com_RxCbkFuncPtrAckIdxOfRxSigInfoType 0 0 0 255 ECU_ADDRESS 0x0 /end MEASUREMENT
/begin MEASUREMENT Com_RxSigInfo[223].SignalProcessingOfRxSigInfo "" UBYTE Com_SignalProcessingOfRxSigInfoType 0 0 0 255 ECU_ADDRESS 0x0 /end MEASUREMENT
/begin MEASUREMENT Com_RxSigInfo[223].ValidDlcOfRxSigInfo "" UBYTE NO_COMPU_METHOD 0 0 0 255 ECU_ADDRESS 0x0 /end MEASUREMENT
/begin MEASUREMENT Com_RxSigInfo[224].RxAccessInfoIdxOfRxSigInfo "" UWORD NO_COMPU_METHOD 0 0 0 65535 ECU_ADDRESS 0x0 /end MEASUREMENT
/begin MEASUREMENT Com_RxSigInfo[224].RxCbkFuncPtrAckIdxOfRxSigInfo "" UBYTE Com_RxCbkFuncPtrAckIdxOfRxSigInfoType 0 0 0 255 ECU_ADDRESS 0x0 /end MEASUREMENT
/begin MEASUREMENT Com_RxSigInfo[224].SignalProcessingOfRxSigInfo "" UBYTE Com_SignalProcessingOfRxSigInfoType 0 0 0 255 ECU_ADDRESS 0x0 /end MEASUREMENT
/begin MEASUREMENT Com_RxSigInfo[224].ValidDlcOfRxSigInfo "" UBYTE NO_COMPU_METHOD 0 0 0 255 ECU_ADDRESS 0x0 /end MEASUREMENT
/begin MEASUREMENT Com_RxSigInfo[225].RxAccessInfoIdxOfRxSigInfo "" UWORD NO_COMPU_METHOD 0 0 0 65535 ECU_ADDRESS 0x0 /end MEASUREMENT
/begin MEASUREMENT Com_RxSigInfo[225].RxCbkFuncPtrAckIdxOfRxSigInfo "" UBYTE Com_RxCbkFuncPtrAckIdxOfRxSigInfoType 0 0 0 255 ECU_ADDRESS 0x0 /end MEASUREMENT
/begin MEASUREMENT Com_RxSigInfo[225].SignalProcessingOfRxSigInfo "" UBYTE Com_SignalProcessingOfRxSigInfoType 0 0 0 255 ECU_ADDRESS 0x0 /end MEASUREMENT
/begin MEASUREMENT Com_RxSigInfo[225].ValidDlcOfRxSigInfo "" UBYTE NO_COMPU_METHOD 0 0 0 255 ECU_ADDRESS 0x0 /end MEASUREMENT
/begin MEASUREMENT Com_RxSigInfo[226].RxAccessInfoIdxOfRxSigInfo "" UWORD NO_COMPU_METHOD 0 0 0 65535 ECU_ADDRESS 0x0 /end MEASUREMENT
/begin MEASUREMENT Com_RxSigInfo[226].RxCbkFuncPtrAckIdxOfRxSigInfo "" UBYTE Com_RxCbkFuncPtrAckIdxOfRxSigInfoType 0 0 0 255 ECU_ADDRESS 0x0 /end MEASUREMENT
/begin MEASUREMENT Com_RxSigInfo[226].SignalProcessingOfRxSigInfo "" UBYTE Com_SignalProcessingOfRxSigInfoType 0 0 0 255 ECU_ADDRESS 0x0 /end MEASUREMENT
/begin MEASUREMENT Com_RxSigInfo[226].ValidDlcOfRxSigInfo "" UBYTE NO_COMPU_METHOD 0 0 0 255 ECU_ADDRESS 0x0 /end MEASUREMENT
/begin MEASUREMENT Com_RxSigInfo[227].RxAccessInfoIdxOfRxSigInfo "" UWORD NO_COMPU_METHOD 0 0 0 65535 ECU_ADDRESS 0x0 /end MEASUREMENT
/begin MEASUREMENT Com_RxSigInfo[227].RxCbkFuncPtrAckIdxOfRxSigInfo "" UBYTE Com_RxCbkFuncPtrAckIdxOfRxSigInfoType 0 0 0 255 ECU_ADDRESS 0x0 /end MEASUREMENT
/begin MEASUREMENT Com_RxSigInfo[227].SignalProcessingOfRxSigInfo "" UBYTE Com_SignalProcessingOfRxSigInfoType 0 0 0 255 ECU_ADDRESS 0x0 /end MEASUREMENT
/begin MEASUREMENT Com_RxSigInfo[227].ValidDlcOfRxSigInfo "" UBYTE NO_COMPU_METHOD 0 0 0 255 ECU_ADDRESS 0x0 /end MEASUREMENT
/begin MEASUREMENT Com_RxSigInfo[228].RxAccessInfoIdxOfRxSigInfo "" UWORD NO_COMPU_METHOD 0 0 0 65535 ECU_ADDRESS 0x0 /end MEASUREMENT
/begin MEASUREMENT Com_RxSigInfo[228].RxCbkFuncPtrAckIdxOfRxSigInfo "" UBYTE Com_RxCbkFuncPtrAckIdxOfRxSigInfoType 0 0 0 255 ECU_ADDRESS 0x0 /end MEASUREMENT
/begin MEASUREMENT Com_RxSigInfo[228].SignalProcessingOfRxSigInfo "" UBYTE Com_SignalProcessingOfRxSigInfoType 0 0 0 255 ECU_ADDRESS 0x0 /end MEASUREMENT
/begin MEASUREMENT Com_RxSigInfo[228].ValidDlcOfRxSigInfo "" UBYTE NO_COMPU_METHOD 0 0 0 255 ECU_ADDRESS 0x0 /end MEASUREMENT
/begin MEASUREMENT Com_RxSigInfo[229].RxAccessInfoIdxOfRxSigInfo "" UWORD NO_COMPU_METHOD 0 0 0 65535 ECU_ADDRESS 0x0 /end MEASUREMENT
/begin MEASUREMENT Com_RxSigInfo[229].RxCbkFuncPtrAckIdxOfRxSigInfo "" UBYTE Com_RxCbkFuncPtrAckIdxOfRxSigInfoType 0 0 0 255 ECU_ADDRESS 0x0 /end MEASUREMENT
/begin MEASUREMENT Com_RxSigInfo[229].SignalProcessingOfRxSigInfo "" UBYTE Com_SignalProcessingOfRxSigInfoType 0 0 0 255 ECU_ADDRESS 0x0 /end MEASUREMENT
/begin MEASUREMENT Com_RxSigInfo[229].ValidDlcOfRxSigInfo "" UBYTE NO_COMPU_METHOD 0 0 0 255 ECU_ADDRESS 0x0 /end MEASUREMENT
/begin MEASUREMENT Com_RxSigInfo[22].RxAccessInfoIdxOfRxSigInfo "" UWORD NO_COMPU_METHOD 0 0 0 65535 ECU_ADDRESS 0x0 /end MEASUREMENT
/begin MEASUREMENT Com_RxSigInfo[22].RxCbkFuncPtrAckIdxOfRxSigInfo "" UBYTE Com_RxCbkFuncPtrAckIdxOfRxSigInfoType 0 0 0 255 ECU_ADDRESS 0x0 /end MEASUREMENT
/begin MEASUREMENT Com_RxSigInfo[22].SignalProcessingOfRxSigInfo "" UBYTE Com_SignalProcessingOfRxSigInfoType 0 0 0 255 ECU_ADDRESS 0x0 /end MEASUREMENT
/begin MEASUREMENT Com_RxSigInfo[22].ValidDlcOfRxSigInfo "" UBYTE NO_COMPU_METHOD 0 0 0 255 ECU_ADDRESS 0x0 /end MEASUREMENT
/begin MEASUREMENT Com_RxSigInfo[230].RxAccessInfoIdxOfRxSigInfo "" UWORD NO_COMPU_METHOD 0 0 0 65535 ECU_ADDRESS 0x0 /end MEASUREMENT
/begin COMPU_METHOD Com_HandleRxPduDeferredIdxOfRxPduInfoType "" TAB_VERB "%10.1" "" COMPU_TAB_REF Com_HandleRxPduDeferredIdxOfRxPduInfoType /end COMPU_METHOD
/begin COMPU_METHOD Com_IPduGroupInfoOfRxPduInfoIndEndIdxOfRxPduInfoType "" TAB_VERB "%10.1" "" COMPU_TAB_REF Com_IPduGroupInfoOfRxPduInfoIndEndIdxOfRxPduInfoType /end COMPU_METHOD
/begin COMPU_METHOD Com_IPduGroupInfoOfRxPduInfoIndStartIdxOfRxPduInfoType "" TAB_VERB "%10.1" "" COMPU_TAB_REF Com_IPduGroupInfoOfRxPduInfoIndStartIdxOfRxPduInfoType /end COMPU_METHOD
/begin COMPU_METHOD Com_MainFunctionRxStructIdxOfRxPduInfoType "" TAB_VERB "%10.1" "" COMPU_TAB_REF Com_MainFunctionRxStructIdxOfRxPduInfoType /end COMPU_METHOD
/begin COMPU_METHOD Com_RxAccessInfoGrpSigIndEndIdxOfRxSigGrpInfoType "" TAB_VERB "%10.1" "" COMPU_TAB_REF Com_RxAccessInfoGrpSigIndEndIdxOfRxSigGrpInfoType /end COMPU_METHOD
/begin COMPU_METHOD Com_RxAccessInfoGrpSigIndStartIdxOfRxSigGrpInfoType "" TAB_VERB "%10.1" "" COMPU_TAB_REF Com_RxAccessInfoGrpSigIndStartIdxOfRxSigGrpInfoType /end COMPU_METHOD
/begin COMPU_METHOD Com_RxAccessInfoIndEndIdxOfRxPduInfoType "" TAB_VERB "%10.1" "" COMPU_TAB_REF Com_RxAccessInfoIndEndIdxOfRxPduInfoType /end COMPU_METHOD
/begin COMPU_METHOD Com_RxAccessInfoIndStartIdxOfRxPduInfoType "" TAB_VERB "%10.1" "" COMPU_TAB_REF Com_RxAccessInfoIndStartIdxOfRxPduInfoType /end COMPU_METHOD
/begin COMPU_METHOD Com_RxCbkFuncPtrAckIdxOfRxSigGrpInfoType "" TAB_VERB "%10.1" "" COMPU_TAB_REF Com_RxCbkFuncPtrAckIdxOfRxSigGrpInfoType /end COMPU_METHOD
/begin COMPU_METHOD Com_RxCbkFuncPtrAckIdxOfRxSigInfoType "" TAB_VERB "%10.1" "" COMPU_TAB_REF Com_RxCbkFuncPtrAckIdxOfRxSigInfoType /end COMPU_METHOD
/begin COMPU_METHOD Com_RxCbkFuncPtrInvAckIdxOfRxSigGrpInfoType "" TAB_VERB "%10.1" "" COMPU_TAB_REF Com_RxCbkFuncPtrInvAckIdxOfRxSigGrpInfoType /end COMPU_METHOD
/begin COMPU_METHOD Com_RxDefPduBufferEndIdxOfRxPduInfoType "" TAB_VERB "%10.1" "" COMPU_TAB_REF Com_RxDefPduBufferEndIdxOfRxPduInfoType /end COMPU_METHOD
/begin COMPU_METHOD Com_RxDefPduBufferStartIdxOfRxPduInfoType "" TAB_VERB "%10.1" "" COMPU_TAB_REF Com_RxDefPduBufferStartIdxOfRxPduInfoType /end COMPU_METHOD
/begin COMPU_METHOD Com_RxPduCalloutFuncPtrIdxOfRxPduInfoType "" TAB_VERB "%10.1" "" COMPU_TAB_REF Com_RxPduCalloutFuncPtrIdxOfRxPduInfoType /end COMPU_METHOD
/begin COMPU_METHOD Com_RxSigGrpInfoIndEndIdxOfRxPduInfoType "" TAB_VERB "%10.1" "" COMPU_TAB_REF Com_RxSigGrpInfoIndEndIdxOfRxPduInfoType /end COMPU_METHOD
/begin COMPU_METHOD Com_RxSigGrpInfoIndStartIdxOfRxPduInfoType "" TAB_VERB "%10.1" "" COMPU_TAB_REF Com_RxSigGrpInfoIndStartIdxOfRxPduInfoType /end COMPU_METHOD
/begin COMPU_METHOD Com_RxSigInfoEndIdxOfRxPduInfoType "" TAB_VERB "%10.1" "" COMPU_TAB_REF Com_RxSigInfoEndIdxOfRxPduInfoType /end COMPU_METHOD
/begin COMPU_METHOD Com_RxSigInfoStartIdxOfRxPduInfoType "" TAB_VERB "%10.1" "" COMPU_TAB_REF Com_RxSigInfoStartIdxOfRxPduInfoType /end COMPU_METHOD
/begin COMPU_METHOD Com_RxTOutInfoIdxOfRxPduInfoType "" TAB_VERB "%10.1" "" COMPU_TAB_REF Com_RxTOutInfoIdxOfRxPduInfoType /end COMPU_METHOD
/begin COMPU_METHOD Com_RxTOutInfoIdxOfRxSigGrpInfoType "" TAB_VERB "%10.1" "" COMPU_TAB_REF Com_RxTOutInfoIdxOfRxSigGrpInfoType /end COMPU_METHOD
/begin COMPU_METHOD Com_RxTOutInfoIndEndIdxOfRxPduInfoType "" TAB_VERB "%10.1" "" COMPU_TAB_REF Com_RxTOutInfoIndEndIdxOfRxPduInfoType /end COMPU_METHOD
/begin COMPU_METHOD Com_RxTOutInfoIndStartIdxOfRxPduInfoType "" TAB_VERB "%10.1" "" COMPU_TAB_REF Com_RxTOutInfoIndStartIdxOfRxPduInfoType /end COMPU_METHOD
/begin COMPU_METHOD Com_ShdBufferRequiredOfRxSigGrpInfoType "" TAB_VERB "%10.1" "" COMPU_TAB_REF Com_ShdBufferRequiredOfRxSigGrpInfoType /end COMPU_METHOD
/begin COMPU_METHOD Com_SignalProcessingOfRxSigInfoType "" TAB_VERB "%10.1" "" COMPU_TAB_REF Com_SignalProcessingOfRxSigInfoType /end COMPU_METHOD
/begin COMPU_VTAB Com_HandleRxPduDeferredIdxOfRxPduInfoType "" TAB_VERB 1 255 "COM_NO_HANDLERXPDUDEFERREDIDXOFRXPDUINFO" /end COMPU_VTAB
/begin COMPU_VTAB Com_IPduGroupInfoOfRxPduInfoIndEndIdxOfRxPduInfoType "" TAB_VERB 1 255 "COM_NO_IPDUGROUPINFOOFRXPDUINFOINDENDIDXOFRXPDUINFO" /end COMPU_VTAB
/begin COMPU_VTAB Com_IPduGroupInfoOfRxPduInfoIndStartIdxOfRxPduInfoType "" TAB_VERB 1 255 "COM_NO_IPDUGROUPINFOOFRXPDUINFOINDSTARTIDXOFRXPDUINFO" /end COMPU_VTAB
/begin COMPU_VTAB Com_MainFunctionRxStructIdxOfRxPduInfoType "" TAB_VERB 1 255 "COM_NO_MAINFUNCTIONRXSTRUCTIDXOFRXPDUINFO" /end COMPU_VTAB
/begin COMPU_VTAB Com_RxAccessInfoGrpSigIndEndIdxOfRxSigGrpInfoType "" TAB_VERB 1 255 "COM_NO_RXACCESSINFOGRPSIGINDENDIDXOFRXSIGGRPINFO" /end COMPU_VTAB
/begin COMPU_VTAB Com_RxAccessInfoGrpSigIndStartIdxOfRxSigGrpInfoType "" TAB_VERB 1 255 "COM_NO_RXACCESSINFOGRPSIGINDSTARTIDXOFRXSIGGRPINFO" /end COMPU_VTAB
/begin COMPU_VTAB Com_RxAccessInfoIndEndIdxOfRxPduInfoType "" TAB_VERB 1 65535 "COM_NO_RXACCESSINFOINDENDIDXOFRXPDUINFO" /end COMPU_VTAB
/begin COMPU_VTAB Com_RxAccessInfoIndStartIdxOfRxPduInfoType "" TAB_VERB 1 65535 "COM_NO_RXACCESSINFOINDSTARTIDXOFRXPDUINFO" /end COMPU_VTAB
/begin COMPU_VTAB Com_RxCbkFuncPtrAckIdxOfRxSigGrpInfoType "" TAB_VERB 1 255 "COM_NO_RXCBKFUNCPTRACKIDXOFRXSIGGRPINFO" /end COMPU_VTAB
/begin COMPU_VTAB Com_RxCbkFuncPtrAckIdxOfRxSigInfoType "" TAB_VERB 1 255 "COM_NO_RXCBKFUNCPTRACKIDXOFRXSIGINFO" /end COMPU_VTAB
/begin COMPU_VTAB Com_RxCbkFuncPtrInvAckIdxOfRxSigGrpInfoType "" TAB_VERB 1 255 "COM_NO_RXCBKFUNCPTRINVACKIDXOFRXSIGGRPINFO" /end COMPU_VTAB
/begin COMPU_VTAB Com_RxDefPduBufferEndIdxOfRxPduInfoType "" TAB_VERB 1 65535 "COM_NO_RXDEFPDUBUFFERENDIDXOFRXPDUINFO" /end COMPU_VTAB
/begin COMPU_VTAB Com_RxDefPduBufferStartIdxOfRxPduInfoType "" TAB_VERB 1 65535 "COM_NO_RXDEFPDUBUFFERSTARTIDXOFRXPDUINFO" /end COMPU_VTAB
/begin COMPU_VTAB Com_RxPduCalloutFuncPtrIdxOfRxPduInfoType "" TAB_VERB 1 255 "COM_NO_RXPDUCALLOUTFUNCPTRIDXOFRXPDUINFO" /end COMPU_VTAB
/begin COMPU_VTAB Com_RxSigGrpInfoIndEndIdxOfRxPduInfoType "" TAB_VERB 1 255 "COM_NO_RXSIGGRPINFOINDENDIDXOFRXPDUINFO" /end COMPU_VTAB
/begin COMPU_VTAB Com_RxSigGrpInfoIndStartIdxOfRxPduInfoType "" TAB_VERB 1 255 "COM_NO_RXSIGGRPINFOINDSTARTIDXOFRXPDUINFO" /end COMPU_VTAB
/begin COMPU_VTAB Com_RxSigInfoEndIdxOfRxPduInfoType "" TAB_VERB 1 65535 "COM_NO_RXSIGINFOENDIDXOFRXPDUINFO" /end COMPU_VTAB
/begin COMPU_VTAB Com_RxSigInfoStartIdxOfRxPduInfoType "" TAB_VERB 1 65535 "COM_NO_RXSIGINFOSTARTIDXOFRXPDUINFO" /end COMPU_VTAB
/begin COMPU_VTAB Com_RxTOutInfoIdxOfRxPduInfoType "" TAB_VERB 1 255 "COM_NO_RXTOUTINFOIDXOFRXPDUINFO" /end COMPU_VTAB
/begin COMPU_VTAB Com_RxTOutInfoIdxOfRxSigGrpInfoType "" TAB_VERB 1 255 "COM_NO_RXTOUTINFOIDXOFRXSIGGRPINFO" /end COMPU_VTAB
/begin COMPU_VTAB Com_RxTOutInfoIndEndIdxOfRxPduInfoType "" TAB_VERB 1 255 "COM_NO_RXTOUTINFOINDENDIDXOFRXPDUINFO" /end COMPU_VTAB
/begin COMPU_VTAB Com_RxTOutInfoIndStartIdxOfRxPduInfoType "" TAB_VERB 1 255 "COM_NO_RXTOUTINFOINDSTARTIDXOFRXPDUINFO" /end COMPU_VTAB
/begin COMPU_VTAB_RANGE Com_ShdBufferRequiredOfRxSigGrpInfoType "" 2 0 0 "FALSE" 1 255 "TRUE" /end COMPU_VTAB_RANGE
/begin COMPU_VTAB Com_SignalProcessingOfRxSigInfoType "" TAB_VERB 1 0 "COM_DEFERRED_SIGNALPROCESSINGOFRXSIGINFO" /end COMPU_VTAB
/begin GROUP Com ""
 /begin REF_MEASUREMENT Com_RxPduInfo[57].RxDefPduBufferStartIdxOfRxPduInfo Com_RxPduInfo[57].RxPduCalloutFuncPtrIdxOfRxPduInfo Com_RxPduInfo[57].RxSigGrpInfoIndEndIdxOfRxPduInfo Com_RxPduInfo[57].RxSigGrpInfoIndStartIdxOfRxPduInfo Com_RxPduInfo[57].RxSigInfoEndIdxOfRxPduInfo Com_RxPduInfo[57].RxSigInfoStartIdxOfRxPduInfo Com_RxPduInfo[57].RxTOutInfoIdxOfRxPduInfo Com_RxPduInfo[57].RxTOutInfoIndEndIdxOfRxPduInfo Com_RxPduInfo[57].RxTOutInfoIndStartIdxOfRxPduInfo Com_RxPduInfo[58].HandleRxPduDeferredIdxOfRxPduInfo Com_RxPduInfo[58].IPduGroupInfoOfRxPduInfoIndEndIdxOfRxPduInfo Com_RxPduInfo[58].IPduGroupInfoOfRxPduInfoIndStartIdxOfRxPduInfo Com_RxPduInfo[58].MainFunctionRxStructIdxOfRxPduInfo Com_RxPduInfo[58].RxAccessInfoIndEndIdxOfRxPduInfo Com_RxPduInfo[58].RxAccessInfoIndStartIdxOfRxPduInfo Com_RxPduInfo[58].RxDefPduBufferEndIdxOfRxPduInfo Com_RxPduInfo[58].RxDefPduBufferStartIdxOfRxPduInfo Com_RxPduInfo[58].RxPduCalloutFuncPtrIdxOfRxPduInfo Com_RxPduInfo[58].RxSigGrpInfoIndEndIdxOfRxPduInfo Com_RxPduInfo[58].RxSigGrpInfoIndStartIdxOfRxPduInfo Com_RxPduInfo[58].RxSigInfoEndIdxOfRxPduInfo Com_RxPduInfo[58].RxSigInfoStartIdxOfRxPduInfo Com_RxPduInfo[58].RxTOutInfoIdxOfRxPduInfo Com_RxPduInfo[58].RxTOutInfoIndEndIdxOfRxPduInfo Com_RxPduInfo[58].RxTOutInfoIndStartIdxOfRxPduInfo Com_RxPduInfo[59].HandleRxPduDeferredIdxOfRxPduInfo Com_RxPduInfo[59].IPduGroupInfoOfRxPduInfoIndEndIdxOfRxPduInfo Com_RxPduInfo[59].IPduGroupInfoOfRxPduInfoIndStartIdxOfRxPduInfo Com_RxPduInfo[59].MainFunctionRxStructIdxOfRxPduInfo Com_RxPduInfo[59].RxAccessInfoIndEndIdxOfRxPduInfo Com_RxPduInfo[59].RxAccessInfoIndStartIdxOfRxPduInfo Com_RxPduInfo[59].RxDefPduBufferEndIdxOfRxPduInfo Com_RxPduInfo[59].RxDefPduBufferStartIdxOfRxPduInfo Com_RxPduInfo[59].RxPduCalloutFuncPtrIdxOfRxPduInfo Com_RxPduInfo[59].RxSigGrpInfoIndEndIdxOfRxPduInfo Com_RxPduInfo[59].RxSigGrpInfoIndStartIdxOfRxPduInfo Com_RxPduInfo[59].RxSigInfoEndIdxOfRxPduInfo Com_RxPduInfo[59].RxSigInfoStartIdxOfRxPduInfo Com_RxPduInfo[59].RxTOutInfoIdxOfRxPduInfo Com_RxPduInfo[59].RxTOutInfoIndEndIdxOfRxPduInfo Com_RxPduInfo[59].RxTOutInfoIndStartIdxOfRxPduInfo Com_RxPduInfo[5].HandleRxPduDeferredIdxOfRxPduInfo Com_RxPduInfo[5].IPduGroupInfoOfRxPduInfoIndEndIdxOfRxPduInfo Com_RxPduInfo[5].IPduGroupInfoOfRxPduInfoIndStartIdxOfRxPduInfo Com_RxPduInfo[5].MainFunctionRxStructIdxOfRxPduInfo Com_RxPduInfo[5].RxAccessInfoIndEndIdxOfRxPduInfo Com_RxPduInfo[5].RxAccessInfoIndStartIdxOfRxPduInfo Com_RxPduInfo[5].RxDefPduBufferEndIdxOfRxPduInfo Com_RxPduInfo[5].RxDefPduBufferStartIdxOfRxPduInfo Com_RxPduInfo[5].RxPduCalloutFuncPtrIdxOfRxPduInfo Com_RxPduInfo[5].RxSigGrpInfoIndEndIdxOfRxPduInfo Com_RxPduInfo[5].RxSigGrpInfoIndStartIdxOfRxPduInfo Com_RxPduInfo[5].RxSigInfoEndIdxOfRxPduInfo Com_RxPduInfo[5].RxSigInfoStartIdxOfRxPduInfo Com_RxPduInfo[5].RxTOutInfoIdxOfRxPduInfo Com_RxPduInfo[5].RxTOutInfoIndEndIdxOfRxPduInfo Com_RxPduInfo[5].RxTOutInfoIndStartIdxOfRxPduInfo Com_RxPduInfo[60].HandleRxPduDeferredIdxOfRxPduInfo Com_RxPduInfo[60].IPduGroupInfoOfRxPduInfoIndEndIdxOfRxPduInfo Com_RxPduInfo[60].IPduGroupInfoOfRxPduInfoIndStartIdxOfRxPduInfo Com_RxPduInfo[60].MainFunctionRxStructIdxOfRxPduInfo Com_RxPduInfo[60].RxAccessInfoIndEndIdxOfRxPduInfo Com_RxPduInfo[60].RxAccessInfoIndStartIdxOfRxPduInfo Com_RxPduInfo[60].RxDefPduBufferEndIdxOfRxPduInfo Com_RxPduInfo[60].RxDefPduBufferStartIdxOfRxPduInfo Com_RxPduInfo[60].RxPduCalloutFuncPtrIdxOfRxPduInfo Com_RxPduInfo[60].RxSigGrpInfoIndEndIdxOfRxPduInfo Com_RxPduInfo[60].RxSigGrpInfoIndStartIdxOfRxPduInfo Com_RxPduInfo[60].RxSigInfoEndIdxOfRxPduInfo Com_RxPduInfo[60].RxSigInfoStartIdxOfRxPduInfo Com_RxPduInfo[60].RxTOutInfoIdxOfRxPduInfo Com_RxPduInfo[60].RxTOutInfoIndEndIdxOfRxPduInfo Com_RxPduInfo[60].RxTOutInfoIndStartIdxOfRxPduInfo Com_RxPduInfo[61].HandleRxPduDeferredIdxOfRxPduInfo Com_RxPduInfo[61].IPduGroupInfoOfRxPduInfoIndEndIdxOfRxPduInfo Com_RxPduInfo[61].IPduGroupInfoOfRxPduInfoIndStartIdxOfRxPduInfo Com_RxPduInfo[61].MainFunctionRxStructIdxOfRxPduInfo Com_RxPduInfo[61].RxAccessInfoIndEndIdxOfRxPduInfo Com_RxPduInfo[61].RxAccessInfoIndStartIdxOfRxPduInfo Com_RxPduInfo[61].RxDefPduBufferEndIdxOfRxPduInfo Com_RxPduInfo[61].RxDefPduBufferStartIdxOfRxPduInfo Com_RxPduInfo[61].RxPduCalloutFuncPtrIdxOfRxPduInfo Com_RxPduInfo[61].RxSigGrpInfoIndEndIdxOfRxPduInfo Com_RxPduInfo[61].RxSigGrpInfoIndStartIdxOfRxPduInfo Com_RxPduInfo[61].RxSigInfoEndIdxOfRxPduInfo Com_RxPduInfo[61].RxSigInfoStartIdxOfRxPduInfo Com_RxPduInfo[61].RxTOutInfoIdxOfRxPduInfo Com_RxPduInfo[61].RxTOutInfoIndEndIdxOfRxPduInfo Com_RxPduInfo[61].RxTOutInfoIndStartIdxOfRxPduInfo Com_RxPduInfo[62].HandleRxPduDeferredIdxOfRxPduInfo Com_RxPduInfo[62].IPduGroupInfoOfRxPduInfoIndEndIdxOfRxPduInfo Com_RxPduInfo[62].IPduGroupInfoOfRxPduInfoIndStartIdxOfRxPduInfo Com_RxPduInfo[62].MainFunctionRxStructIdxOfRxPduInfo Com_RxPduInfo[62].RxAccessInfoIndEndIdxOfRxPduInfo Com_RxPduInfo[62].RxAccessInfoIndStartIdxOfRxPduInfo Com_RxPduInfo[62].RxDefPduBufferEndIdxOfRxPduInfo Com_RxPduInfo[62].RxDefPduBufferStartIdxOfRxPduInfo Com_RxPduInfo[62].RxPduCalloutFuncPtrIdxOfRxPduInfo Com_RxPduInfo[62].RxSigGrpInfoIndEndIdxOfRxPduInfo Com_RxPduInfo[62].RxSigGrpInfoIndStartIdxOfRxPduInfo Com_RxPduInfo[62].RxSigInfoEndIdxOfRxPduInfo Com_RxPduInfo[62].RxSigInfoStartIdxOfRxPduInfo Com_RxPduInfo[62].RxTOutInfoIdxOfRxPduInfo Com_RxPduInfo[62].RxTOutInfoIndEndIdxOfRxPduInfo Com_RxPduInfo[62].RxTOutInfoIndStartIdxOfRxPduInfo Com_RxPduInfo[63].HandleRxPduDeferredIdxOfRxPduInfo Com_RxPduInfo[63].IPduGroupInfoOfRxPduInfoIndEndIdxOfRxPduInfo Com_RxPduInfo[63].IPduGroupInfoOfRxPduInfoIndStartIdxOfRxPduInfo Com_RxPduInfo[63].MainFunctionRxStructIdxOfRxPduInfo Com_RxPduInfo[63].RxAccessInfoIndEndIdxOfRxPduInfo Com_RxPduInfo[63].RxAccessInfoIndStartIdxOfRxPduInfo Com_RxPduInfo[63].RxDefPduBufferEndIdxOfRxPduInfo Com_RxPduInfo[63].RxDefPduBufferStartIdxOfRxPduInfo Com_RxPduInfo[63].RxPduCalloutFuncPtrIdxOfRxPduInfo Com_RxPduInfo[63].RxSigGrpInfoIndEndIdxOfRxPduInfo Com_RxPduInfo[63].RxSigGrpInfoIndStartIdxOfRxPduInfo Com_RxPduInfo[63].RxSigInfoEndIdxOfRxPduInfo Com_RxPduInfo[63].RxSigInfoStartIdxOfRxPduInfo Com_RxPduInfo[63].RxTOutInfoIdxOfRxPduInfo Com_RxPduInfo[63].RxTOutInfoIndEndIdxOfRxPduInfo Com_RxPduInfo[63].RxTOutInfoIndStartIdxOfRxPduInfo Com_RxPduInfo[64].HandleRxPduDeferredIdxOfRxPduInfo Com_RxPduInfo[64].IPduGroupInfoOfRxPduInfoIndEndIdxOfRxPduInfo Com_RxPduInfo[64].IPduGroupInfoOfRxPduInfoIndStartIdxOfRxPduInfo Com_RxPduInfo[64].MainFunctionRxStructIdxOfRxPduInfo Com_RxPduInfo[64].RxAccessInfoIndEndIdxOfRxPduInfo Com_RxPduInfo[64].RxAccessInfoIndStartIdxOfRxPduInfo Com_RxPduInfo[64].RxDefPduBufferEndIdxOfRxPduInfo Com_RxPduInfo[64].RxDefPduBufferStartIdxOfRxPduInfo Com_RxPduInfo[64].RxPduCalloutFuncPtrIdxOfRxPduInfo Com_RxPduInfo[64].RxSigGrpInfoIndEndIdxOfRxPduInfo Com_RxPduInfo[64].RxSigGrpInfoIndStartIdxOfRxPduInfo Com_RxPduInfo[64].RxSigInfoEndIdxOfRxPduInfo Com_RxPduInfo[64].RxSigInfoStartIdxOfRxPduInfo Com_RxPduInfo[64].RxTOutInfoIdxOfRxPduInfo Com_RxPduInfo[64].RxTOutInfoIndEndIdxOfRxPduInfo Com_RxPduInfo[64].RxTOutInfoIndStartIdxOfRxPduInfo Com_RxPduInfo[65].HandleRxPduDeferredIdxOfRxPduInfo Com_RxPduInfo[65].IPduGroupInfoOfRxPduInfoIndEndIdxOfRxPduInfo Com_RxPduInfo[65].IPduGroupInfoOfRxPduInfoIndStartIdxOfRxPduInfo Com_RxPduInfo[65].MainFunctionRxStructIdxOfRxPduInfo Com_RxPduInfo[65].RxAccessInfoIndEndIdxOfRxPduInfo Com_RxPduInfo[65].RxAccessInfoIndStartIdxOfRxPduInfo Com_RxPduInfo[65].RxDefPduBufferEndIdxOfRxPduInfo Com_RxPduInfo[65].RxDefPduBufferStartIdxOfRxPduInfo Com_RxPduInfo[65].RxPduCalloutFuncPtrIdxOfRxPduInfo Com_RxPduInfo[65].RxSigGrpInfoIndEndIdxOfRxPduInfo Com_RxPduInfo[65].RxSigGrpInfoIndStartIdxOfRxPduInfo Com_RxPduInfo[65].RxSigInfoEndIdxOfRxPduInfo Com_RxPduInfo[65].RxSigInfoStartIdxOfRxPduInfo Com_RxPduInfo[65].RxTOutInfoIdxOfRxPduInfo Com_RxPduInfo[65].RxTOutInfoIndEndIdxOfRxPduInfo Com_RxPduInfo[65].RxTOutInfoIndStartIdxOfRxPduInfo Com_RxPduInfo[6].HandleRxPduDeferredIdxOfRxPduInfo Com_RxPduInfo[6].IPduGroupInfoOfRxPduInfoIndEndIdxOfRxPduInfo Com_RxPduInfo[6].IPduGroupInfoOfRxPduInfoIndStartIdxOfRxPduInfo Com_RxPduInfo[6].MainFunctionRxStructIdxOfRxPduInfo Com_RxPduInfo[6].RxAccessInfoIndEndIdxOfRxPduInfo Com_RxPduInfo[6].RxAccessInfoIndStartIdxOfRxPduInfo Com_RxPduInfo[6].RxDefPduBufferEndIdxOfRxPduInfo Com_RxPduInfo[6].RxDefPduBufferStartIdxOfRxPduInfo Com_RxPduInfo[6].RxPduCalloutFuncPtrIdxOfRxPduInfo Com_RxPduInfo[6].RxSigGrpInfoIndEndIdxOfRxPduInfo Com_RxPduInfo[6].RxSigGrpInfoIndStartIdxOfRxPduInfo Com_RxPduInfo[6].RxSigInfoEndIdxOfRxPduInfo Com_RxPduInfo[6].RxSigInfoStartIdxOfRxPduInfo Com_RxPduInfo[6].RxTOutInfoIdxOfRxPduInfo Com_RxPduInfo[6].RxTOutInfoIndEndIdxOfRxPduInfo Com_RxPduInfo[6].RxTOutInfoIndStartIdxOfRxPduInfo Com_RxPduInfo[7].HandleRxPduDeferredIdxOfRxPduInfo Com_RxPduInfo[7].IPduGroupInfoOfRxPduInfoIndEndIdxOfRxPduInfo Com_RxPduInfo[7].IPduGroupInfoOfRxPduInfoIndStartIdxOfRxPduInfo Com_RxPduInfo[7].MainFunctionRxStructIdxOfRxPduInfo Com_RxPduInfo[7].RxAccessInfoIndEndIdxOfRxPduInfo Com_RxPduInfo[7].RxAccessInfoIndStartIdxOfRxPduInfo Com_RxPduInfo[7].RxDefPduBufferEndIdxOfRxPduInfo Com_RxPduInfo[7].RxDefPduBufferStartIdxOfRxPduInfo Com_RxPduInfo[7].RxPduCalloutFuncPtrIdxOfRxPduInfo Com_RxPduInfo[7].RxSigGrpInfoIndEndIdxOfRxPduInfo Com_RxPduInfo[7].RxSigGrpInfoIndStartIdxOfRxPduInfo Com_RxPduInfo[7].RxSigInfoEndIdxOfRxPduInfo Com_RxPduInfo[7].RxSigInfoStartIdxOfRxPduInfo Com_RxPduInfo[7].RxTOutInfoIdxOfRxPduInfo Com_RxPduInfo[7].RxTOutInfoIndEndIdxOfRxPduInfo Com_RxPduInfo[7].RxTOutInfoIndStartIdxOfRxPduInfo Com_RxPduInfo[8].HandleRxPduDeferredIdxOfRxPduInfo Com_RxPduInfo[8].IPduGroupInfoOfRxPduInfoIndEndIdxOfRxPduInfo Com_RxPduInfo[8].IPduGroupInfoOfRxPduInfoIndStartIdxOfRxPduInfo Com_RxPduInfo[8].MainFunctionRxStructIdxOfRxPduInfo Com_RxPduInfo[8].RxAccessInfoIndEndIdxOfRxPduInfo Com_RxPduInfo[8].RxAccessInfoIndStartIdxOfRxPduInfo Com_RxPduInfo[8].RxDefPduBufferEndIdxOfRxPduInfo Com_RxPduInfo[8].RxDefPduBufferStartIdxOfRxPduInfo Com_RxPduInfo[8].RxPduCalloutFuncPtrIdxOfRxPduInfo Com_RxPduInfo[8].RxSigGrpInfoIndEndIdxOfRxPduInfo Com_RxPduInfo[8].RxSigGrpInfoIndStartIdxOfRxPduInfo Com_RxPduInfo[8].RxSigInfoEndIdxOfRxPduInfo Com_RxPduInfo[8].RxSigInfoStartIdxOfRxPduInfo Com_RxPduInfo[8].RxTOutInfoIdxOfRxPduInfo Com_RxPduInfo[8].RxTOutInfoIndEndIdxOfRxPduInfo Com_RxPduInfo[8].RxTOutInfoIndStartIdxOfRxPduInfo Com_RxPduInfo[9].HandleRxPduDeferredIdxOfRxPduInfo Com_RxPduInfo[9].IPduGroupInfoOfRxPduInfoIndEndIdxOfRxPduInfo Com_RxPduInfo[9].IPduGroupInfoOfRxPduInfoIndStartIdxOfRxPduInfo Com_RxPduInfo[9].MainFunctionRxStructIdxOfRxPduInfo Com_RxPduInfo[9].RxAccessInfoIndEndIdxOfRxPduInfo Com_RxPduInfo[9].RxAccessInfoIndStartIdxOfRxPduInfo Com_RxPduInfo[9].RxDefPduBufferEndIdxOfRxPduInfo Com_RxPduInfo[9].RxDefPduBufferStartIdxOfRxPduInfo Com_RxPduInfo[9].RxPduCalloutFuncPtrIdxOfRxPduInfo Com_RxPduInfo[9].RxSigGrpInfoIndEndIdxOfRxPduInfo Com_RxPduInfo[9].RxSigGrpInfoIndStartIdxOfRxPduInfo Com_RxPduInfo[9].RxSigInfoEndIdxOfRxPduInfo Com_RxPduInfo[9].RxSigInfoStartIdxOfRxPduInfo Com_RxPduInfo[9].RxTOutInfoIdxOfRxPduInfo Com_RxPduInfo[9].RxTOutInfoIndEndIdxOfRxPduInfo Com_RxPduInfo[9].RxTOutInfoIndStartIdxOfRxPduInfo Com_RxSigBufferArrayBased Com_RxSigBufferUInt16 Com_RxSigBufferUInt32 Com_RxSigBufferUInt8 Com_RxSigGrpInfo[0].RxAccessInfoGrpSigIndEndIdxOfRxSigGrpInfo Com_RxSigGrpInfo[0].RxAccessInfoGrpSigIndStartIdxOfRxSigGrpInfo Com_RxSigGrpInfo[0].RxCbkFuncPtrAckIdxOfRxSigGrpInfo Com_RxSigGrpInfo[0].RxCbkFuncPtrInvAckIdxOfRxSigGrpInfo Com_RxSigGrpInfo[0].RxPduInfoIdxOfRxSigGrpInfo Com_RxSigGrpInfo[0].RxTOutInfoIdxOfRxSigGrpInfo Com_RxSigGrpInfo[0].ShdBufferRequiredOfRxSigGrpInfo Com_RxSigGrpInfo[0].StartBytePositionOfRxSigGrpInfo Com_RxSigGrpInfo[0].ValidDlcOfRxSigGrpInfo Com_RxSigGrpInfo[10].RxAccessInfoGrpSigIndEndIdxOfRxSigGrpInfo Com_RxSigGrpInfo[10].RxAccessInfoGrpSigIndStartIdxOfRxSigGrpInfo Com_RxSigGrpInfo[10].RxCbkFuncPtrAckIdxOfRxSigGrpInfo Com_RxSigGrpInfo[10].RxCbkFuncPtrInvAckIdxOfRxSigGrpInfo Com_RxSigGrpInfo[10].RxPduInfoIdxOfRxSigGrpInfo Com_RxSigGrpInfo[10].RxTOutInfoIdxOfRxSigGrpInfo Com_RxSigGrpInfo[10].ShdBufferRequiredOfRxSigGrpInfo Com_RxSigGrpInfo[10].StartBytePositionOfRxSigGrpInfo Com_RxSigGrpInfo[10].ValidDlcOfRxSigGrpInfo Com_RxSigGrpInfo[11].RxAccessInfoGrpSigIndEndIdxOfRxSigGrpInfo Com_RxSigGrpInfo[11].RxAccessInfoGrpSigIndStartIdxOfRxSigGrpInfo Com_RxSigGrpInfo[11].RxCbkFuncPtrAckIdxOfRxSigGrpInfo Com_RxSigGrpInfo[11].RxCbkFuncPtrInvAckIdxOfRxSigGrpInfo Com_RxSigGrpInfo[11].RxPduInfoIdxOfRxSigGrpInfo Com_RxSigGrpInfo[11].RxTOutInfoIdxOfRxSigGrpInfo Com_RxSigGrpInfo[11].ShdBufferRequiredOfRxSigGrpInfo Com_RxSigGrpInfo[11].StartBytePositionOfRxSigGrpInfo Com_RxSigGrpInfo[11].ValidDlcOfRxSigGrpInfo Com_RxSigGrpInfo[12].RxAccessInfoGrpSigIndEndIdxOfRxSigGrpInfo Com_RxSigGrpInfo[12].RxAccessInfoGrpSigIndStartIdxOfRxSigGrpInfo Com_RxSigGrpInfo[12].RxCbkFuncPtrAckIdxOfRxSigGrpInfo Com_RxSigGrpInfo[12].RxCbkFuncPtrInvAckIdxOfRxSigGrpInfo Com_RxSigGrpInfo[12].RxPduInfoIdxOfRxSigGrpInfo Com_RxSigGrpInfo[12].RxTOutInfoIdxOfRxSigGrpInfo Com_RxSigGrpInfo[12].ShdBufferRequiredOfRxSigGrpInfo Com_RxSigGrpInfo[12].StartBytePositionOfRxSigGrpInfo Com_RxSigGrpInfo[12].ValidDlcOfRxSigGrpInfo Com_RxSigGrpInfo[13].RxAccessInfoGrpSigIndEndIdxOfRxSigGrpInfo Com_RxSigGrpInfo[13].RxAccessInfoGrpSigIndStartIdxOfRxSigGrpInfo Com_RxSigGrpInfo[13].RxCbkFuncPtrAckIdxOfRxSigGrpInfo Com_RxSigGrpInfo[13].RxCbkFuncPtrInvAckIdxOfRxSigGrpInfo Com_RxSigGrpInfo[13].RxPduInfoIdxOfRxSigGrpInfo Com_RxSigGrpInfo[13].RxTOutInfoIdxOfRxSigGrpInfo Com_RxSigGrpInfo[13].ShdBufferRequiredOfRxSigGrpInfo Com_RxSigGrpInfo[13].StartBytePositionOfRxSigGrpInfo Com_RxSigGrpInfo[13].ValidDlcOfRxSigGrpInfo Com_RxSigGrpInfo[14].RxAccessInfoGrpSigIndEndIdxOfRxSigGrpInfo Com_RxSigGrpInfo[14].RxAccessInfoGrpSigIndStartIdxOfRxSigGrpInfo Com_RxSigGrpInfo[14].RxCbkFuncPtrAckIdxOfRxSigGrpInfo Com_RxSigGrpInfo[14].RxCbkFuncPtrInvAckIdxOfRxSigGrpInfo Com_RxSigGrpInfo[14].RxPduInfoIdxOfRxSigGrpInfo Com_RxSigGrpInfo[14].RxTOutInfoIdxOfRxSigGrpInfo Com_RxSigGrpInfo[14].ShdBufferRequiredOfRxSigGrpInfo Com_RxSigGrpInfo[14].StartBytePositionOfRxSigGrpInfo Com_RxSigGrpInfo[14].ValidDlcOfRxSigGrpInfo Com_RxSigGrpInfo[15].RxAccessInfoGrpSigIndEndIdxOfRxSigGrpInfo Com_RxSigGrpInfo[15].RxAccessInfoGrpSigIndStartIdxOfRxSigGrpInfo Com_RxSigGrpInfo[15].RxCbkFuncPtrAckIdxOfRxSigGrpInfo Com_RxSigGrpInfo[15].RxCbkFuncPtrInvAckIdxOfRxSigGrpInfo Com_RxSigGrpInfo[15].RxPduInfoIdxOfRxSigGrpInfo Com_RxSigGrpInfo[15].RxTOutInfoIdxOfRxSigGrpInfo Com_RxSigGrpInfo[15].ShdBufferRequiredOfRxSigGrpInfo Com_RxSigGrpInfo[15].StartBytePositionOfRxSigGrpInfo Com_RxSigGrpInfo[15].ValidDlcOfRxSigGrpInfo Com_RxSigGrpInfo[1].RxAccessInfoGrpSigIndEndIdxOfRxSigGrpInfo Com_RxSigGrpInfo[1].RxAccessInfoGrpSigIndStartIdxOfRxSigGrpInfo Com_RxSigGrpInfo[1].RxCbkFuncPtrAckIdxOfRxSigGrpInfo Com_RxSigGrpInfo[1].RxCbkFuncPtrInvAckIdxOfRxSigGrpInfo Com_RxSigGrpInfo[1].RxPduInfoIdxOfRxSigGrpInfo Com_RxSigGrpInfo[1].RxTOutInfoIdxOfRxSigGrpInfo Com_RxSigGrpInfo[1].ShdBufferRequiredOfRxSigGrpInfo Com_RxSigGrpInfo[1].StartBytePositionOfRxSigGrpInfo Com_RxSigGrpInfo[1].ValidDlcOfRxSigGrpInfo Com_RxSigGrpInfo[2].RxAccessInfoGrpSigIndEndIdxOfRxSigGrpInfo Com_RxSigGrpInfo[2].RxAccessInfoGrpSigIndStartIdxOfRxSigGrpInfo Com_RxSigGrpInfo[2].RxCbkFuncPtrAckIdxOfRxSigGrpInfo Com_RxSigGrpInfo[2].RxCbkFuncPtrInvAckIdxOfRxSigGrpInfo Com_RxSigGrpInfo[2].RxPduInfoIdxOfRxSigGrpInfo Com_RxSigGrpInfo[2].RxTOutInfoIdxOfRxSigGrpInfo Com_RxSigGrpInfo[2].ShdBufferRequiredOfRxSigGrpInfo Com_RxSigGrpInfo[2].StartBytePositionOfRxSigGrpInfo Com_RxSigGrpInfo[2].ValidDlcOfRxSigGrpInfo Com_RxSigGrpInfo[3].RxAccessInfoGrpSigIndEndIdxOfRxSigGrpInfo Com_RxSigGrpInfo[3].RxAccessInfoGrpSigIndStartIdxOfRxSigGrpInfo Com_RxSigGrpInfo[3].RxCbkFuncPtrAckIdxOfRxSigGrpInfo Com_RxSigGrpInfo[3].RxCbkFuncPtrInvAckIdxOfRxSigGrpInfo Com_RxSigGrpInfo[3].RxPduInfoIdxOfRxSigGrpInfo Com_RxSigGrpInfo[3].RxTOutInfoIdxOfRxSigGrpInfo Com_RxSigGrpInfo[3].ShdBufferRequiredOfRxSigGrpInfo Com_RxSigGrpInfo[3].StartBytePositionOfRxSigGrpInfo Com_RxSigGrpInfo[3].ValidDlcOfRxSigGrpInfo Com_RxSigGrpInfo[4].RxAccessInfoGrpSigIndEndIdxOfRxSigGrpInfo Com_RxSigGrpInfo[4].RxAccessInfoGrpSigIndStartIdxOfRxSigGrpInfo Com_RxSigGrpInfo[4].RxCbkFuncPtrAckIdxOfRxSigGrpInfo Com_RxSigGrpInfo[4].RxCbkFuncPtrInvAckIdxOfRxSigGrpInfo Com_RxSigGrpInfo[4].RxPduInfoIdxOfRxSigGrpInfo Com_RxSigGrpInfo[4].RxTOutInfoIdxOfRxSigGrpInfo Com_RxSigGrpInfo[4].ShdBufferRequiredOfRxSigGrpInfo Com_RxSigGrpInfo[4].StartBytePositionOfRxSigGrpInfo Com_RxSigGrpInfo[4].ValidDlcOfRxSigGrpInfo Com_RxSigGrpInfo[5].RxAccessInfoGrpSigIndEndIdxOfRxSigGrpInfo Com_RxSigGrpInfo[5].RxAccessInfoGrpSigIndStartIdxOfRxSigGrpInfo Com_RxSigGrpInfo[5].RxCbkFuncPtrAckIdxOfRxSigGrpInfo Com_RxSigGrpInfo[5].RxCbkFuncPtrInvAckIdxOfRxSigGrpInfo Com_RxSigGrpInfo[5].RxPduInfoIdxOfRxSigGrpInfo Com_RxSigGrpInfo[5].RxTOutInfoIdxOfRxSigGrpInfo Com_RxSigGrpInfo[5].ShdBufferRequiredOfRxSigGrpInfo Com_RxSigGrpInfo[5].StartBytePositionOfRxSigGrpInfo Com_RxSigGrpInfo[5].ValidDlcOfRxSigGrpInfo Com_RxSigGrpInfo[6].RxAccessInfoGrpSigIndEndIdxOfRxSigGrpInfo Com_RxSigGrpInfo[6].RxAccessInfoGrpSigIndStartIdxOfRxSigGrpInfo Com_RxSigGrpInfo[6].RxCbkFuncPtrAckIdxOfRxSigGrpInfo Com_RxSigGrpInfo[6].RxCbkFuncPtrInvAckIdxOfRxSigGrpInfo Com_RxSigGrpInfo[6].RxPduInfoIdxOfRxSigGrpInfo Com_RxSigGrpInfo[6].RxTOutInfoIdxOfRxSigGrpInfo Com_RxSigGrpInfo[6].ShdBufferRequiredOfRxSigGrpInfo Com_RxSigGrpInfo[6].StartBytePositionOfRxSigGrpInfo Com_RxSigGrpInfo[6].ValidDlcOfRxSigGrpInfo Com_RxSigGrpInfo[7].RxAccessInfoGrpSigIndEndIdxOfRxSigGrpInfo Com_RxSigGrpInfo[7].RxAccessInfoGrpSigIndStartIdxOfRxSigGrpInfo Com_RxSigGrpInfo[7].RxCbkFuncPtrAckIdxOfRxSigGrpInfo Com_RxSigGrpInfo[7].RxCbkFuncPtrInvAckIdxOfRxSigGrpInfo Com_RxSigGrpInfo[7].RxPduInfoIdxOfRxSigGrpInfo Com_RxSigGrpInfo[7].RxTOutInfoIdxOfRxSigGrpInfo Com_RxSigGrpInfo[7].ShdBufferRequiredOfRxSigGrpInfo Com_RxSigGrpInfo[7].StartBytePositionOfRxSigGrpInfo Com_RxSigGrpInfo[7].ValidDlcOfRxSigGrpInfo Com_RxSigGrpInfo[8].RxAccessInfoGrpSigIndEndIdxOfRxSigGrpInfo Com_RxSigGrpInfo[8].RxAccessInfoGrpSigIndStartIdxOfRxSigGrpInfo Com_RxSigGrpInfo[8].RxCbkFuncPtrAckIdxOfRxSigGrpInfo Com_RxSigGrpInfo[8].RxCbkFuncPtrInvAckIdxOfRxSigGrpInfo Com_RxSigGrpInfo[8].RxPduInfoIdxOfRxSigGrpInfo Com_RxSigGrpInfo[8].RxTOutInfoIdxOfRxSigGrpInfo Com_RxSigGrpInfo[8].ShdBufferRequiredOfRxSigGrpInfo Com_RxSigGrpInfo[8].StartBytePositionOfRxSigGrpInfo Com_RxSigGrpInfo[8].ValidDlcOfRxSigGrpInfo Com_RxSigGrpInfo[9].RxAccessInfoGrpSigIndEndIdxOfRxSigGrpInfo Com_RxSigGrpInfo[9].RxAccessInfoGrpSigIndStartIdxOfRxSigGrpInfo Com_RxSigGrpInfo[9].RxCbkFuncPtrAckIdxOfRxSigGrpInfo Com_RxSigGrpInfo[9].RxCbkFuncPtrInvAckIdxOfRxSigGrpInfo Com_RxSigGrpInfo[9].RxPduInfoIdxOfRxSigGrpInfo Com_RxSigGrpInfo[9].RxTOutInfoIdxOfRxSigGrpInfo Com_RxSigGrpInfo[9].ShdBufferRequiredOfRxSigGrpInfo Com_RxSigGrpInfo[9].StartBytePositionOfRxSigGrpInfo Com_RxSigGrpInfo[9].ValidDlcOfRxSigGrpInfo Com_RxSigInfo[0].RxAccessInfoIdxOfRxSigInfo Com_RxSigInfo[0].RxCbkFuncPtrAckIdxOfRxSigInfo Com_RxSigInfo[0].SignalProcessingOfRxSigInfo Com_RxSigInfo[0].ValidDlcOfRxSigInfo Com_RxSigInfo[100].RxAccessInfoIdxOfRxSigInfo Com_RxSigInfo[100].RxCbkFuncPtrAckIdxOfRxSigInfo Com_RxSigInfo[100].SignalProcessingOfRxSigInfo Com_RxSigInfo[100].ValidDlcOfRxSigInfo Com_RxSigInfo[101].RxAccessInfoIdxOfRxSigInfo Com_RxSigInfo[101].RxCbkFuncPtrAckIdxOfRxSigInfo Com_RxSigInfo[101].SignalProcessingOfRxSigInfo Com_RxSigInfo[101].ValidDlcOfRxSigInfo Com_RxSigInfo[102].RxAccessInfoIdxOfRxSigInfo Com_RxSigInfo[102].RxCbkFuncPtrAckIdxOfRxSigInfo Com_RxSigInfo[102].SignalProcessingOfRxSigInfo Com_RxSigInfo[102].ValidDlcOfRxSigInfo Com_RxSigInfo[103].RxAccessInfoIdxOfRxSigInfo Com_RxSigInfo[103].RxCbkFuncPtrAckIdxOfRxSigInfo Com_RxSigInfo[103].SignalProcessingOfRxSigInfo Com_RxSigInfo[103].ValidDlcOfRxSigInfo Com_RxSigInfo[104].RxAccessInfoIdxOfRxSigInfo Com_RxSigInfo[104].RxCbkFuncPtrAckIdxOfRxSigInfo Com_RxSigInfo[104].SignalProcessingOfRxSigInfo Com_RxSigInfo[104].ValidDlcOfRxSigInfo Com_RxSigInfo[105].RxAccessInfoIdxOfRxSigInfo Com_RxSigInfo[105].RxCbkFuncPtrAckIdxOfRxSigInfo Com_RxSigInfo[105].SignalProcessingOfRxSigInfo Com_RxSigInfo[105].ValidDlcOfRxSigInfo Com_RxSigInfo[106].RxAccessInfoIdxOfRxSigInfo Com_RxSigInfo[106].RxCbkFuncPtrAckIdxOfRxSigInfo Com_RxSigInfo[106].SignalProcessingOfRxSigInfo Com_RxSigInfo[106].ValidDlcOfRxSigInfo Com_RxSigInfo[107].RxAccessInfoIdxOfRxSigInfo Com_RxSigInfo[107].RxCbkFuncPtrAckIdxOfRxSigInfo Com_RxSigInfo[107].SignalProcessingOfRxSigInfo Com_RxSigInfo[107].ValidDlcOfRxSigInfo Com_RxSigInfo[108].RxAccessInfoIdxOfRxSigInfo Com_RxSigInfo[108].RxCbkFuncPtrAckIdxOfRxSigInfo Com_RxSigInfo[108].SignalProcessingOfRxSigInfo Com_RxSigInfo[108].ValidDlcOfRxSigInfo Com_RxSigInfo[109].RxAccessInfoIdxOfRxSigInfo Com_RxSigInfo[109].RxCbkFuncPtrAckIdxOfRxSigInfo Com_RxSigInfo[109].SignalProcessingOfRxSigInfo Com_RxSigInfo[109].ValidDlcOfRxSigInfo Com_RxSigInfo[10].RxAccessInfoIdxOfRxSigInfo Com_RxSigInfo[10].RxCbkFuncPtrAckIdxOfRxSigInfo Com_RxSigInfo[10].SignalProcessingOfRxSigInfo Com_RxSigInfo[10].ValidDlcOfRxSigInfo Com_RxSigInfo[110].RxAccessInfoIdxOfRxSigInfo Com_RxSigInfo[110].RxCbkFuncPtrAckIdxOfRxSigInfo Com_RxSigInfo[110].SignalProcessingOfRxSigInfo Com_RxSigInfo[110].ValidDlcOfRxSigInfo Com_RxSigInfo[111].RxAccessInfoIdxOfRxSigInfo Com_RxSigInfo[111].RxCbkFuncPtrAckIdxOfRxSigInfo Com_RxSigInfo[111].SignalProcessingOfRxSigInfo Com_RxSigInfo[111].ValidDlcOfRxSigInfo Com_RxSigInfo[112].RxAccessInfoIdxOfRxSigInfo Com_RxSigInfo[112].RxCbkFuncPtrAckIdxOfRxSigInfo Com_RxSigInfo[112].SignalProcessingOfRxSigInfo Com_RxSigInfo[112].ValidDlcOfRxSigInfo Com_RxSigInfo[113].RxAccessInfoIdxOfRxSigInfo Com_RxSigInfo[113].RxCbkFuncPtrAckIdxOfRxSigInfo Com_RxSigInfo[113].SignalProcessingOfRxSigInfo Com_RxSigInfo[113].ValidDlcOfRxSigInfo Com_RxSigInfo[114].RxAccessInfoIdxOfRxSigInfo Com_RxSigInfo[114].RxCbkFuncPtrAckIdxOfRxSigInfo Com_RxSigInfo[114].SignalProcessingOfRxSigInfo Com_RxSigInfo[114].ValidDlcOfRxSigInfo Com_RxSigInfo[115].RxAccessInfoIdxOfRxSigInfo Com_RxSigInfo[115].RxCbkFuncPtrAckIdxOfRxSigInfo Com_RxSigInfo[115].SignalProcessingOfRxSigInfo Com_RxSigInfo[115].ValidDlcOfRxSigInfo Com_RxSigInfo[116].RxAccessInfoIdxOfRxSigInfo Com_RxSigInfo[116].RxCbkFuncPtrAckIdxOfRxSigInfo Com_RxSigInfo[116].SignalProcessingOfRxSigInfo Com_RxSigInfo[116].ValidDlcOfRxSigInfo Com_RxSigInfo[117].RxAccessInfoIdxOfRxSigInfo Com_RxSigInfo[117].RxCbkFuncPtrAckIdxOfRxSigInfo Com_RxSigInfo[117].SignalProcessingOfRxSigInfo Com_RxSigInfo[117].ValidDlcOfRxSigInfo Com_RxSigInfo[118].RxAccessInfoIdxOfRxSigInfo Com_RxSigInfo[118].RxCbkFuncPtrAckIdxOfRxSigInfo Com_RxSigInfo[118].SignalProcessingOfRxSigInfo Com_RxSigInfo[118].ValidDlcOfRxSigInfo Com_RxSigInfo[119].RxAccessInfoIdxOfRxSigInfo Com_RxSigInfo[119].RxCbkFuncPtrAckIdxOfRxSigInfo Com_RxSigInfo[119].SignalProcessingOfRxSigInfo Com_RxSigInfo[119].ValidDlcOfRxSigInfo Com_RxSigInfo[11].RxAccessInfoIdxOfRxSigInfo Com_RxSigInfo[11].RxCbkFuncPtrAckIdxOfRxSigInfo Com_RxSigInfo[11].SignalProcessingOfRxSigInfo Com_RxSigInfo[11].ValidDlcOfRxSigInfo Com_RxSigInfo[120].RxAccessInfoIdxOfRxSigInfo Com_RxSigInfo[120].RxCbkFuncPtrAckIdxOfRxSigInfo Com_RxSigInfo[120].SignalProcessingOfRxSigInfo Com_RxSigInfo[120].ValidDlcOfRxSigInfo Com_RxSigInfo[121].RxAccessInfoIdxOfRxSigInfo Com_RxSigInfo[121].RxCbkFuncPtrAckIdxOfRxSigInfo Com_RxSigInfo[121].SignalProcessingOfRxSigInfo Com_RxSigInfo[121].ValidDlcOfRxSigInfo Com_RxSigInfo[122].RxAccessInfoIdxOfRxSigInfo Com_RxSigInfo[122].RxCbkFuncPtrAckIdxOfRxSigInfo Com_RxSigInfo[122].SignalProcessingOfRxSigInfo Com_RxSigInfo[122].ValidDlcOfRxSigInfo Com_RxSigInfo[123].RxAccessInfoIdxOfRxSigInfo Com_RxSigInfo[123].RxCbkFuncPtrAckIdxOfRxSigInfo Com_RxSigInfo[123].SignalProcessingOfRxSigInfo Com_RxSigInfo[123].ValidDlcOfRxSigInfo Com_RxSigInfo[124].RxAccessInfoIdxOfRxSigInfo Com_RxSigInfo[124].RxCbkFuncPtrAckIdxOfRxSigInfo Com_RxSigInfo[124].SignalProcessingOfRxSigInfo Com_RxSigInfo[124].ValidDlcOfRxSigInfo Com_RxSigInfo[125].RxAccessInfoIdxOfRxSigInfo Com_RxSigInfo[125].RxCbkFuncPtrAckIdxOfRxSigInfo Com_RxSigInfo[125].SignalProcessingOfRxSigInfo Com_RxSigInfo[125].ValidDlcOfRxSigInfo Com_RxSigInfo[126].RxAccessInfoIdxOfRxSigInfo Com_RxSigInfo[126].RxCbkFuncPtrAckIdxOfRxSigInfo Com_RxSigInfo[126].SignalProcessingOfRxSigInfo Com_RxSigInfo[126].ValidDlcOfRxSigInfo Com_RxSigInfo[127].RxAccessInfoIdxOfRxSigInfo Com_RxSigInfo[127].RxCbkFuncPtrAckIdxOfRxSigInfo Com_RxSigInfo[127].SignalProcessingOfRxSigInfo Com_RxSigInfo[127].ValidDlcOfRxSigInfo Com_RxSigInfo[128].RxAccessInfoIdxOfRxSigInfo Com_RxSigInfo[128].RxCbkFuncPtrAckIdxOfRxSigInfo Com_RxSigInfo[128].SignalProcessingOfRxSigInfo Com_RxSigInfo[128].ValidDlcOfRxSigInfo Com_RxSigInfo[129].RxAccessInfoIdxOfRxSigInfo Com_RxSigInfo[129].RxCbkFuncPtrAckIdxOfRxSigInfo Com_RxSigInfo[129].SignalProcessingOfRxSigInfo Com_RxSigInfo[129].ValidDlcOfRxSigInfo Com_RxSigInfo[12].RxAccessInfoIdxOfRxSigInfo Com_RxSigInfo[12].RxCbkFuncPtrAckIdxOfRxSigInfo Com_RxSigInfo[12].SignalProcessingOfRxSigInfo Com_RxSigInfo[12].ValidDlcOfRxSigInfo Com_RxSigInfo[130].RxAccessInfoIdxOfRxSigInfo Com_RxSigInfo[130].RxCbkFuncPtrAckIdxOfRxSigInfo Com_RxSigInfo[130].SignalProcessingOfRxSigInfo Com_RxSigInfo[130].ValidDlcOfRxSigInfo Com_RxSigInfo[131].RxAccessInfoIdxOfRxSigInfo Com_RxSigInfo[131].RxCbkFuncPtrAckIdxOfRxSigInfo Com_RxSigInfo[131].SignalProcessingOfRxSigInfo Com_RxSigInfo[131].ValidDlcOfRxSigInfo Com_RxSigInfo[132].RxAccessInfoIdxOfRxSigInfo Com_RxSigInfo[132].RxCbkFuncPtrAckIdxOfRxSigInfo Com_RxSigInfo[132].SignalProcessingOfRxSigInfo Com_RxSigInfo[132].ValidDlcOfRxSigInfo Com_RxSigInfo[133].RxAccessInfoIdxOfRxSigInfo Com_RxSigInfo[133].RxCbkFuncPtrAckIdxOfRxSigInfo Com_RxSigInfo[133].SignalProcessingOfRxSigInfo Com_RxSigInfo[133].ValidDlcOfRxSigInfo Com_RxSigInfo[134].RxAccessInfoIdxOfRxSigInfo Com_RxSigInfo[134].RxCbkFuncPtrAckIdxOfRxSigInfo Com_RxSigInfo[134].SignalProcessingOfRxSigInfo Com_RxSigInfo[134].ValidDlcOfRxSigInfo Com_RxSigInfo[135].RxAccessInfoIdxOfRxSigInfo Com_RxSigInfo[135].RxCbkFuncPtrAckIdxOfRxSigInfo Com_RxSigInfo[135].SignalProcessingOfRxSigInfo Com_RxSigInfo[135].ValidDlcOfRxSigInfo Com_RxSigInfo[136].RxAccessInfoIdxOfRxSigInfo Com_RxSigInfo[136].RxCbkFuncPtrAckIdxOfRxSigInfo Com_RxSigInfo[136].SignalProcessingOfRxSigInfo Com_RxSigInfo[136].ValidDlcOfRxSigInfo Com_RxSigInfo[137].RxAccessInfoIdxOfRxSigInfo Com_RxSigInfo[137].RxCbkFuncPtrAckIdxOfRxSigInfo Com_RxSigInfo[137].SignalProcessingOfRxSigInfo Com_RxSigInfo[137].ValidDlcOfRxSigInfo Com_RxSigInfo[138].RxAccessInfoIdxOfRxSigInfo Com_RxSigInfo[138].RxCbkFuncPtrAckIdxOfRxSigInfo Com_RxSigInfo[138].SignalProcessingOfRxSigInfo Com_RxSigInfo[138].ValidDlcOfRxSigInfo Com_RxSigInfo[139].RxAccessInfoIdxOfRxSigInfo Com_RxSigInfo[139].RxCbkFuncPtrAckIdxOfRxSigInfo Com_RxSigInfo[139].SignalProcessingOfRxSigInfo Com_RxSigInfo[139].ValidDlcOfRxSigInfo Com_RxSigInfo[13].RxAccessInfoIdxOfRxSigInfo Com_RxSigInfo[13].RxCbkFuncPtrAckIdxOfRxSigInfo Com_RxSigInfo[13].SignalProcessingOfRxSigInfo Com_RxSigInfo[13].ValidDlcOfRxSigInfo Com_RxSigInfo[140].RxAccessInfoIdxOfRxSigInfo Com_RxSigInfo[140].RxCbkFuncPtrAckIdxOfRxSigInfo Com_RxSigInfo[140].SignalProcessingOfRxSigInfo Com_RxSigInfo[140].ValidDlcOfRxSigInfo Com_RxSigInfo[141].RxAccessInfoIdxOfRxSigInfo Com_RxSigInfo[141].RxCbkFuncPtrAckIdxOfRxSigInfo Com_RxSigInfo[141].SignalProcessingOfRxSigInfo Com_RxSigInfo[141].ValidDlcOfRxSigInfo Com_RxSigInfo[142].RxAccessInfoIdxOfRxSigInfo Com_RxSigInfo[142].RxCbkFuncPtrAckIdxOfRxSigInfo Com_RxSigInfo[142].SignalProcessingOfRxSigInfo Com_RxSigInfo[142].ValidDlcOfRxSigInfo Com_RxSigInfo[143].RxAccessInfoIdxOfRxSigInfo Com_RxSigInfo[143].RxCbkFuncPtrAckIdxOfRxSigInfo Com_RxSigInfo[143].SignalProcessingOfRxSigInfo Com_RxSigInfo[143].ValidDlcOfRxSigInfo Com_RxSigInfo[144].RxAccessInfoIdxOfRxSigInfo Com_RxSigInfo[144].RxCbkFuncPtrAckIdxOfRxSigInfo Com_RxSigInfo[144].SignalProcessingOfRxSigInfo Com_RxSigInfo[144].ValidDlcOfRxSigInfo Com_RxSigInfo[145].RxAccessInfoIdxOfRxSigInfo Com_RxSigInfo[145].RxCbkFuncPtrAckIdxOfRxSigInfo Com_RxSigInfo[145].SignalProcessingOfRxSigInfo Com_RxSigInfo[145].ValidDlcOfRxSigInfo Com_RxSigInfo[146].RxAccessInfoIdxOfRxSigInfo Com_RxSigInfo[146].RxCbkFuncPtrAckIdxOfRxSigInfo Com_RxSigInfo[146].SignalProcessingOfRxSigInfo Com_RxSigInfo[146].ValidDlcOfRxSigInfo Com_RxSigInfo[147].RxAccessInfoIdxOfRxSigInfo Com_RxSigInfo[147].RxCbkFuncPtrAckIdxOfRxSigInfo Com_RxSigInfo[147].SignalProcessingOfRxSigInfo Com_RxSigInfo[147].ValidDlcOfRxSigInfo Com_RxSigInfo[148].RxAccessInfoIdxOfRxSigInfo Com_RxSigInfo[148].RxCbkFuncPtrAckIdxOfRxSigInfo Com_RxSigInfo[148].SignalProcessingOfRxSigInfo Com_RxSigInfo[148].ValidDlcOfRxSigInfo Com_RxSigInfo[149].RxAccessInfoIdxOfRxSigInfo Com_RxSigInfo[149].RxCbkFuncPtrAckIdxOfRxSigInfo Com_RxSigInfo[149].SignalProcessingOfRxSigInfo Com_RxSigInfo[149].ValidDlcOfRxSigInfo Com_RxSigInfo[14].RxAccessInfoIdxOfRxSigInfo Com_RxSigInfo[14].RxCbkFuncPtrAckIdxOfRxSigInfo Com_RxSigInfo[14].SignalProcessingOfRxSigInfo Com_RxSigInfo[14].ValidDlcOfRxSigInfo Com_RxSigInfo[150].RxAccessInfoIdxOfRxSigInfo Com_RxSigInfo[150].RxCbkFuncPtrAckIdxOfRxSigInfo Com_RxSigInfo[150].SignalProcessingOfRxSigInfo Com_RxSigInfo[150].ValidDlcOfRxSigInfo Com_RxSigInfo[151].RxAccessInfoIdxOfRxSigInfo Com_RxSigInfo[151].RxCbkFuncPtrAckIdxOfRxSigInfo Com_RxSigInfo[151].SignalProcessingOfRxSigInfo Com_RxSigInfo[151].ValidDlcOfRxSigInfo Com_RxSigInfo[152].RxAccessInfoIdxOfRxSigInfo Com_RxSigInfo[152].RxCbkFuncPtrAckIdxOfRxSigInfo Com_RxSigInfo[152].SignalProcessingOfRxSigInfo Com_RxSigInfo[152].ValidDlcOfRxSigInfo Com_RxSigInfo[153].RxAccessInfoIdxOfRxSigInfo Com_RxSigInfo[153].RxCbkFuncPtrAckIdxOfRxSigInfo Com_RxSigInfo[153].SignalProcessingOfRxSigInfo Com_RxSigInfo[153].ValidDlcOfRxSigInfo Com_RxSigInfo[154].RxAccessInfoIdxOfRxSigInfo Com_RxSigInfo[154].RxCbkFuncPtrAckIdxOfRxSigInfo Com_RxSigInfo[154].SignalProcessingOfRxSigInfo Com_RxSigInfo[154].ValidDlcOfRxSigInfo Com_RxSigInfo[155].RxAccessInfoIdxOfRxSigInfo Com_RxSigInfo[155].RxCbkFuncPtrAckIdxOfRxSigInfo Com_RxSigInfo[155].SignalProcessingOfRxSigInfo Com_RxSigInfo[155].ValidDlcOfRxSigInfo Com_RxSigInfo[156].RxAccessInfoIdxOfRxSigInfo Com_RxSigInfo[156].RxCbkFuncPtrAckIdxOfRxSigInfo Com_RxSigInfo[156].SignalProcessingOfRxSigInfo Com_RxSigInfo[156].ValidDlcOfRxSigInfo Com_RxSigInfo[157].RxAccessInfoIdxOfRxSigInfo Com_RxSigInfo[157].RxCbkFuncPtrAckIdxOfRxSigInfo Com_RxSigInfo[157].SignalProcessingOfRxSigInfo Com_RxSigInfo[157].ValidDlcOfRxSigInfo Com_RxSigInfo[158].RxAccessInfoIdxOfRxSigInfo Com_RxSigInfo[158].RxCbkFuncPtrAckIdxOfRxSigInfo Com_RxSigInfo[158].SignalProcessingOfRxSigInfo Com_RxSigInfo[158].ValidDlcOfRxSigInfo Com_RxSigInfo[159].RxAccessInfoIdxOfRxSigInfo Com_RxSigInfo[159].RxCbkFuncPtrAckIdxOfRxSigInfo Com_RxSigInfo[159].SignalProcessingOfRxSigInfo Com_RxSigInfo[159].ValidDlcOfRxSigInfo Com_RxSigInfo[15].RxAccessInfoIdxOfRxSigInfo Com_RxSigInfo[15].RxCbkFuncPtrAckIdxOfRxSigInfo Com_RxSigInfo[15].SignalProcessingOfRxSigInfo Com_RxSigInfo[15].ValidDlcOfRxSigInfo Com_RxSigInfo[160].RxAccessInfoIdxOfRxSigInfo Com_RxSigInfo[160].RxCbkFuncPtrAckIdxOfRxSigInfo Com_RxSigInfo[160].SignalProcessingOfRxSigInfo Com_RxSigInfo[160].ValidDlcOfRxSigInfo Com_RxSigInfo[161].RxAccessInfoIdxOfRxSigInfo Com_RxSigInfo[161].RxCbkFuncPtrAckIdxOfRxSigInfo Com_RxSigInfo[161].SignalProcessingOfRxSigInfo Com_RxSigInfo[161].ValidDlcOfRxSigInfo Com_RxSigInfo[162].RxAccessInfoIdxOfRxSigInfo Com_RxSigInfo[162].RxCbkFuncPtrAckIdxOfRxSigInfo Com_RxSigInfo[162].SignalProcessingOfRxSigInfo Com_RxSigInfo[162].ValidDlcOfRxSigInfo Com_RxSigInfo[163].RxAccessInfoIdxOfRxSigInfo Com_RxSigInfo[163].RxCbkFuncPtrAckIdxOfRxSigInfo Com_RxSigInfo[163].SignalProcessingOfRxSigInfo Com_RxSigInfo[163].ValidDlcOfRxSigInfo Com_RxSigInfo[164].RxAccessInfoIdxOfRxSigInfo Com_RxSigInfo[164].RxCbkFuncPtrAckIdxOfRxSigInfo Com_RxSigInfo[164].SignalProcessingOfRxSigInfo Com_RxSigInfo[164].ValidDlcOfRxSigInfo Com_RxSigInfo[165].RxAccessInfoIdxOfRxSigInfo Com_RxSigInfo[165].RxCbkFuncPtrAckIdxOfRxSigInfo Com_RxSigInfo[165].SignalProcessingOfRxSigInfo Com_RxSigInfo[165].ValidDlcOfRxSigInfo Com_RxSigInfo[166].RxAccessInfoIdxOfRxSigInfo Com_RxSigInfo[166].RxCbkFuncPtrAckIdxOfRxSigInfo Com_RxSigInfo[166].SignalProcessingOfRxSigInfo Com_RxSigInfo[166].ValidDlcOfRxSigInfo Com_RxSigInfo[167].RxAccessInfoIdxOfRxSigInfo Com_RxSigInfo[167].RxCbkFuncPtrAckIdxOfRxSigInfo Com_RxSigInfo[167].SignalProcessingOfRxSigInfo Com_RxSigInfo[167].ValidDlcOfRxSigInfo Com_RxSigInfo[168].RxAccessInfoIdxOfRxSigInfo Com_RxSigInfo[168].RxCbkFuncPtrAckIdxOfRxSigInfo Com_RxSigInfo[168].SignalProcessingOfRxSigInfo Com_RxSigInfo[168].ValidDlcOfRxSigInfo Com_RxSigInfo[169].RxAccessInfoIdxOfRxSigInfo Com_RxSigInfo[169].RxCbkFuncPtrAckIdxOfRxSigInfo Com_RxSigInfo[169].SignalProcessingOfRxSigInfo Com_RxSigInfo[169].ValidDlcOfRxSigInfo Com_RxSigInfo[16].RxAccessInfoIdxOfRxSigInfo Com_RxSigInfo[16].RxCbkFuncPtrAckIdxOfRxSigInfo Com_RxSigInfo[16].SignalProcessingOfRxSigInfo Com_RxSigInfo[16].ValidDlcOfRxSigInfo Com_RxSigInfo[170].RxAccessInfoIdxOfRxSigInfo Com_RxSigInfo[170].RxCbkFuncPtrAckIdxOfRxSigInfo Com_RxSigInfo[170].SignalProcessingOfRxSigInfo Com_RxSigInfo[170].ValidDlcOfRxSigInfo Com_RxSigInfo[171].RxAccessInfoIdxOfRxSigInfo Com_RxSigInfo[171].RxCbkFuncPtrAckIdxOfRxSigInfo Com_RxSigInfo[171].SignalProcessingOfRxSigInfo Com_RxSigInfo[171].ValidDlcOfRxSigInfo Com_RxSigInfo[172].RxAccessInfoIdxOfRxSigInfo Com_RxSigInfo[172].RxCbkFuncPtrAckIdxOfRxSigInfo Com_RxSigInfo[172].SignalProcessingOfRxSigInfo Com_RxSigInfo[172].ValidDlcOfRxSigInfo Com_RxSigInfo[173].RxAccessInfoIdxOfRxSigInfo Com_RxSigInfo[173].RxCbkFuncPtrAckIdxOfRxSigInfo Com_RxSigInfo[173].SignalProcessingOfRxSigInfo Com_RxSigInfo[173].ValidDlcOfRxSigInfo Com_RxSigInfo[174].RxAccessInfoIdxOfRxSigInfo Com_RxSigInfo[174].RxCbkFuncPtrAckIdxOfRxSigInfo Com_RxSigInfo[174].SignalProcessingOfRxSigInfo Com_RxSigInfo[174].ValidDlcOfRxSigInfo Com_RxSigInfo[175].RxAccessInfoIdxOfRxSigInfo Com_RxSigInfo[175].RxCbkFuncPtrAckIdxOfRxSigInfo Com_RxSigInfo[175].SignalProcessingOfRxSigInfo Com_RxSigInfo[175].ValidDlcOfRxSigInfo Com_RxSigInfo[176].RxAccessInfoIdxOfRxSigInfo Com_RxSigInfo[176].RxCbkFuncPtrAckIdxOfRxSigInfo Com_RxSigInfo[176].SignalProcessingOfRxSigInfo Com_RxSigInfo[176].ValidDlcOfRxSigInfo Com_RxSigInfo[177].RxAccessInfoIdxOfRxSigInfo Com_RxSigInfo[177].RxCbkFuncPtrAckIdxOfRxSigInfo Com_RxSigInfo[177].SignalProcessingOfRxSigInfo Com_RxSigInfo[177].ValidDlcOfRxSigInfo Com_RxSigInfo[178].RxAccessInfoIdxOfRxSigInfo Com_RxSigInfo[178].RxCbkFuncPtrAckIdxOfRxSigInfo Com_RxSigInfo[178].SignalProcessingOfRxSigInfo Com_RxSigInfo[178].ValidDlcOfRxSigInfo Com_RxSigInfo[179].RxAccessInfoIdxOfRxSigInfo Com_RxSigInfo[179].RxCbkFuncPtrAckIdxOfRxSigInfo Com_RxSigInfo[179].SignalProcessingOfRxSigInfo Com_RxSigInfo[179].ValidDlcOfRxSigInfo Com_RxSigInfo[17].RxAccessInfoIdxOfRxSigInfo Com_RxSigInfo[17].RxCbkFuncPtrAckIdxOfRxSigInfo Com_RxSigInfo[17].SignalProcessingOfRxSigInfo Com_RxSigInfo[17].ValidDlcOfRxSigInfo Com_RxSigInfo[180].RxAccessInfoIdxOfRxSigInfo Com_RxSigInfo[180].RxCbkFuncPtrAckIdxOfRxSigInfo Com_RxSigInfo[180].SignalProcessingOfRxSigInfo Com_RxSigInfo[180].ValidDlcOfRxSigInfo Com_RxSigInfo[181].RxAccessInfoIdxOfRxSigInfo Com_RxSigInfo[181].RxCbkFuncPtrAckIdxOfRxSigInfo Com_RxSigInfo[181].SignalProcessingOfRxSigInfo Com_RxSigInfo[181].ValidDlcOfRxSigInfo Com_RxSigInfo[182].RxAccessInfoIdxOfRxSigInfo Com_RxSigInfo[182].RxCbkFuncPtrAckIdxOfRxSigInfo Com_RxSigInfo[182].SignalProcessingOfRxSigInfo Com_RxSigInfo[182].ValidDlcOfRxSigInfo Com_RxSigInfo[183].RxAccessInfoIdxOfRxSigInfo Com_RxSigInfo[183].RxCbkFuncPtrAckIdxOfRxSigInfo Com_RxSigInfo[183].SignalProcessingOfRxSigInfo Com_RxSigInfo[183].ValidDlcOfRxSigInfo Com_RxSigInfo[184].RxAccessInfoIdxOfRxSigInfo Com_RxSigInfo[184].RxCbkFuncPtrAckIdxOfRxSigInfo Com_RxSigInfo[184].SignalProcessingOfRxSigInfo Com_RxSigInfo[184].ValidDlcOfRxSigInfo Com_RxSigInfo[185].RxAccessInfoIdxOfRxSigInfo Com_RxSigInfo[185].RxCbkFuncPtrAckIdxOfRxSigInfo Com_RxSigInfo[185].SignalProcessingOfRxSigInfo Com_RxSigInfo[185].ValidDlcOfRxSigInfo Com_RxSigInfo[186].RxAccessInfoIdxOfRxSigInfo Com_RxSigInfo[186].RxCbkFuncPtrAckIdxOfRxSigInfo Com_RxSigInfo[186].SignalProcessingOfRxSigInfo Com_RxSigInfo[186].ValidDlcOfRxSigInfo Com_RxSigInfo[187].RxAccessInfoIdxOfRxSigInfo Com_RxSigInfo[187].RxCbkFuncPtrAckIdxOfRxSigInfo Com_RxSigInfo[187].SignalProcessingOfRxSigInfo Com_RxSigInfo[187].ValidDlcOfRxSigInfo Com_RxSigInfo[188].RxAccessInfoIdxOfRxSigInfo Com_RxSigInfo[188].RxCbkFuncPtrAckIdxOfRxSigInfo Com_RxSigInfo[188].SignalProcessingOfRxSigInfo Com_RxSigInfo[188].ValidDlcOfRxSigInfo Com_RxSigInfo[189].RxAccessInfoIdxOfRxSigInfo Com_RxSigInfo[189].RxCbkFuncPtrAckIdxOfRxSigInfo Com_RxSigInfo[189].SignalProcessingOfRxSigInfo Com_RxSigInfo[189].ValidDlcOfRxSigInfo Com_RxSigInfo[18].RxAccessInfoIdxOfRxSigInfo Com_RxSigInfo[18].RxCbkFuncPtrAckIdxOfRxSigInfo Com_RxSigInfo[18].SignalProcessingOfRxSigInfo Com_RxSigInfo[18].ValidDlcOfRxSigInfo Com_RxSigInfo[190].RxAccessInfoIdxOfRxSigInfo Com_RxSigInfo[190].RxCbkFuncPtrAckIdxOfRxSigInfo Com_RxSigInfo[190].SignalProcessingOfRxSigInfo Com_RxSigInfo[190].ValidDlcOfRxSigInfo Com_RxSigInfo[191].RxAccessInfoIdxOfRxSigInfo Com_RxSigInfo[191].RxCbkFuncPtrAckIdxOfRxSigInfo Com_RxSigInfo[191].SignalProcessingOfRxSigInfo Com_RxSigInfo[191].ValidDlcOfRxSigInfo Com_RxSigInfo[192].RxAccessInfoIdxOfRxSigInfo Com_RxSigInfo[192].RxCbkFuncPtrAckIdxOfRxSigInfo Com_RxSigInfo[192].SignalProcessingOfRxSigInfo Com_RxSigInfo[192].ValidDlcOfRxSigInfo Com_RxSigInfo[193].RxAccessInfoIdxOfRxSigInfo Com_RxSigInfo[193].RxCbkFuncPtrAckIdxOfRxSigInfo Com_RxSigInfo[193].SignalProcessingOfRxSigInfo Com_RxSigInfo[193].ValidDlcOfRxSigInfo Com_RxSigInfo[194].RxAccessInfoIdxOfRxSigInfo Com_RxSigInfo[194].RxCbkFuncPtrAckIdxOfRxSigInfo Com_RxSigInfo[194].SignalProcessingOfRxSigInfo Com_RxSigInfo[194].ValidDlcOfRxSigInfo Com_RxSigInfo[195].RxAccessInfoIdxOfRxSigInfo Com_RxSigInfo[195].RxCbkFuncPtrAckIdxOfRxSigInfo Com_RxSigInfo[195].SignalProcessingOfRxSigInfo Com_RxSigInfo[195].ValidDlcOfRxSigInfo Com_RxSigInfo[196].RxAccessInfoIdxOfRxSigInfo Com_RxSigInfo[196].RxCbkFuncPtrAckIdxOfRxSigInfo Com_RxSigInfo[196].SignalProcessingOfRxSigInfo Com_RxSigInfo[196].ValidDlcOfRxSigInfo Com_RxSigInfo[197].RxAccessInfoIdxOfRxSigInfo Com_RxSigInfo[197].RxCbkFuncPtrAckIdxOfRxSigInfo Com_RxSigInfo[197].SignalProcessingOfRxSigInfo Com_RxSigInfo[197].ValidDlcOfRxSigInfo Com_RxSigInfo[198].RxAccessInfoIdxOfRxSigInfo Com_RxSigInfo[198].RxCbkFuncPtrAckIdxOfRxSigInfo Com_RxSigInfo[198].SignalProcessingOfRxSigInfo Com_RxSigInfo[198].ValidDlcOfRxSigInfo Com_RxSigInfo[199].RxAccessInfoIdxOfRxSigInfo Com_RxSigInfo[199].RxCbkFuncPtrAckIdxOfRxSigInfo Com_RxSigInfo[199].SignalProcessingOfRxSigInfo Com_RxSigInfo[199].ValidDlcOfRxSigInfo Com_RxSigInfo[19].RxAccessInfoIdxOfRxSigInfo Com_RxSigInfo[19].RxCbkFuncPtrAckIdxOfRxSigInfo Com_RxSigInfo[19].SignalProcessingOfRxSigInfo Com_RxSigInfo[19].ValidDlcOfRxSigInfo Com_RxSigInfo[1].RxAccessInfoIdxOfRxSigInfo Com_RxSigInfo[1].RxCbkFuncPtrAckIdxOfRxSigInfo Com_RxSigInfo[1].SignalProcessingOfRxSigInfo Com_RxSigInfo[1].ValidDlcOfRxSigInfo Com_RxSigInfo[200].RxAccessInfoIdxOfRxSigInfo Com_RxSigInfo[200].RxCbkFuncPtrAckIdxOfRxSigInfo Com_RxSigInfo[200].SignalProcessingOfRxSigInfo Com_RxSigInfo[200].ValidDlcOfRxSigInfo Com_RxSigInfo[201].RxAccessInfoIdxOfRxSigInfo Com_RxSigInfo[201].RxCbkFuncPtrAckIdxOfRxSigInfo Com_RxSigInfo[201].SignalProcessingOfRxSigInfo Com_RxSigInfo[201].ValidDlcOfRxSigInfo Com_RxSigInfo[202].RxAccessInfoIdxOfRxSigInfo Com_RxSigInfo[202].RxCbkFuncPtrAckIdxOfRxSigInfo Com_RxSigInfo[202].SignalProcessingOfRxSigInfo Com_RxSigInfo[202].ValidDlcOfRxSigInfo Com_RxSigInfo[203].RxAccessInfoIdxOfRxSigInfo Com_RxSigInfo[203].RxCbkFuncPtrAckIdxOfRxSigInfo Com_RxSigInfo[203].SignalProcessingOfRxSigInfo Com_RxSigInfo[203].ValidDlcOfRxSigInfo Com_RxSigInfo[204].RxAccessInfoIdxOfRxSigInfo Com_RxSigInfo[204].RxCbkFuncPtrAckIdxOfRxSigInfo Com_RxSigInfo[204].SignalProcessingOfRxSigInfo Com_RxSigInfo[204].ValidDlcOfRxSigInfo Com_RxSigInfo[205].RxAccessInfoIdxOfRxSigInfo Com_RxSigInfo[205].RxCbkFuncPtrAckIdxOfRxSigInfo Com_RxSigInfo[205].SignalProcessingOfRxSigInfo Com_RxSigInfo[205].ValidDlcOfRxSigInfo Com_RxSigInfo[206].RxAccessInfoIdxOfRxSigInfo Com_RxSigInfo[206].RxCbkFuncPtrAckIdxOfRxSigInfo Com_RxSigInfo[206].SignalProcessingOfRxSigInfo Com_RxSigInfo[206].ValidDlcOfRxSigInfo Com_RxSigInfo[207].RxAccessInfoIdxOfRxSigInfo Com_RxSigInfo[207].RxCbkFuncPtrAckIdxOfRxSigInfo Com_RxSigInfo[207].SignalProcessingOfRxSigInfo Com_RxSigInfo[207].ValidDlcOfRxSigInfo Com_RxSigInfo[208].RxAccessInfoIdxOfRxSigInfo Com_RxSigInfo[208].RxCbkFuncPtrAckIdxOfRxSigInfo Com_RxSigInfo[208].SignalProcessingOfRxSigInfo Com_RxSigInfo[208].ValidDlcOfRxSigInfo Com_RxSigInfo[209].RxAccessInfoIdxOfRxSigInfo Com_RxSigInfo[209].RxCbkFuncPtrAckIdxOfRxSigInfo Com_RxSigInfo[209].SignalProcessingOfRxSigInfo Com_RxSigInfo[209].ValidDlcOfRxSigInfo Com_RxSigInfo[20].RxAccessInfoIdxOfRxSigInfo Com_RxSigInfo[20].RxCbkFuncPtrAckIdxOfRxSigInfo Com_RxSigInfo[20].SignalProcessingOfRxSigInfo Com_RxSigInfo[20].ValidDlcOfRxSigInfo Com_RxSigInfo[210].RxAccessInfoIdxOfRxSigInfo Com_RxSigInfo[210].RxCbkFuncPtrAckIdxOfRxSigInfo Com_RxSigInfo[210].SignalProcessingOfRxSigInfo Com_RxSigInfo[210].ValidDlcOfRxSigInfo Com_RxSigInfo[211].RxAccessInfoIdxOfRxSigInfo Com_RxSigInfo[211].RxCbkFuncPtrAckIdxOfRxSigInfo Com_RxSigInfo[211].SignalProcessingOfRxSigInfo Com_RxSigInfo[211].ValidDlcOfRxSigInfo Com_RxSigInfo[212].RxAccessInfoIdxOfRxSigInfo Com_RxSigInfo[212].RxCbkFuncPtrAckIdxOfRxSigInfo Com_RxSigInfo[212].SignalProcessingOfRxSigInfo Com_RxSigInfo[212].ValidDlcOfRxSigInfo Com_RxSigInfo[213].RxAccessInfoIdxOfRxSigInfo Com_RxSigInfo[213].RxCbkFuncPtrAckIdxOfRxSigInfo Com_RxSigInfo[213].SignalProcessingOfRxSigInfo Com_RxSigInfo[213].ValidDlcOfRxSigInfo Com_RxSigInfo[214].RxAccessInfoIdxOfRxSigInfo Com_RxSigInfo[214].RxCbkFuncPtrAckIdxOfRxSigInfo Com_RxSigInfo[214].SignalProcessingOfRxSigInfo Com_RxSigInfo[214].ValidDlcOfRxSigInfo Com_RxSigInfo[215].RxAccessInfoIdxOfRxSigInfo Com_RxSigInfo[215].RxCbkFuncPtrAckIdxOfRxSigInfo Com_RxSigInfo[215].SignalProcessingOfRxSigInfo Com_RxSigInfo[215].ValidDlcOfRxSigInfo Com_RxSigInfo[216].RxAccessInfoIdxOfRxSigInfo Com_RxSigInfo[216].RxCbkFuncPtrAckIdxOfRxSigInfo Com_RxSigInfo[216].SignalProcessingOfRxSigInfo Com_RxSigInfo[216].ValidDlcOfRxSigInfo Com_RxSigInfo[217].RxAccessInfoIdxOfRxSigInfo Com_RxSigInfo[217].RxCbkFuncPtrAckIdxOfRxSigInfo Com_RxSigInfo[217].SignalProcessingOfRxSigInfo Com_RxSigInfo[217].ValidDlcOfRxSigInfo Com_RxSigInfo[218].RxAccessInfoIdxOfRxSigInfo Com_RxSigInfo[218].RxCbkFuncPtrAckIdxOfRxSigInfo Com_RxSigInfo[218].SignalProcessingOfRxSigInfo Com_RxSigInfo[218].ValidDlcOfRxSigInfo Com_RxSigInfo[219].RxAccessInfoIdxOfRxSigInfo Com_RxSigInfo[219].RxCbkFuncPtrAckIdxOfRxSigInfo Com_RxSigInfo[219].SignalProcessingOfRxSigInfo Com_RxSigInfo[219].ValidDlcOfRxSigInfo Com_RxSigInfo[21].RxAccessInfoIdxOfRxSigInfo Com_RxSigInfo[21].RxCbkFuncPtrAckIdxOfRxSigInfo Com_RxSigInfo[21].SignalProcessingOfRxSigInfo Com_RxSigInfo[21].ValidDlcOfRxSigInfo Com_RxSigInfo[220].RxAccessInfoIdxOfRxSigInfo Com_RxSigInfo[220].RxCbkFuncPtrAckIdxOfRxSigInfo Com_RxSigInfo[220].SignalProcessingOfRxSigInfo Com_RxSigInfo[220].ValidDlcOfRxSigInfo Com_RxSigInfo[221].RxAccessInfoIdxOfRxSigInfo Com_RxSigInfo[221].RxCbkFuncPtrAckIdxOfRxSigInfo Com_RxSigInfo[221].SignalProcessingOfRxSigInfo Com_RxSigInfo[221].ValidDlcOfRxSigInfo Com_RxSigInfo[222].RxAccessInfoIdxOfRxSigInfo Com_RxSigInfo[222].RxCbkFuncPtrAckIdxOfRxSigInfo Com_RxSigInfo[222].SignalProcessingOfRxSigInfo Com_RxSigInfo[222].ValidDlcOfRxSigInfo Com_RxSigInfo[223].RxAccessInfoIdxOfRxSigInfo Com_RxSigInfo[223].RxCbkFuncPtrAckIdxOfRxSigInfo Com_RxSigInfo[223].SignalProcessingOfRxSigInfo Com_RxSigInfo[223].ValidDlcOfRxSigInfo Com_RxSigInfo[224].RxAccessInfoIdxOfRxSigInfo Com_RxSigInfo[224].RxCbkFuncPtrAckIdxOfRxSigInfo Com_RxSigInfo[224].SignalProcessingOfRxSigInfo Com_RxSigInfo[224].ValidDlcOfRxSigInfo Com_RxSigInfo[225].RxAccessInfoIdxOfRxSigInfo Com_RxSigInfo[225].RxCbkFuncPtrAckIdxOfRxSigInfo Com_RxSigInfo[225].SignalProcessingOfRxSigInfo Com_RxSigInfo[225].ValidDlcOfRxSigInfo Com_RxSigInfo[226].RxAccessInfoIdxOfRxSigInfo Com_RxSigInfo[226].RxCbkFuncPtrAckIdxOfRxSigInfo Com_RxSigInfo[226].SignalProcessingOfRxSigInfo Com_RxSigInfo[226].ValidDlcOfRxSigInfo Com_RxSigInfo[227].RxAccessInfoIdxOfRxSigInfo Com_RxSigInfo[227].RxCbkFuncPtrAckIdxOfRxSigInfo Com_RxSigInfo[227].SignalProcessingOfRxSigInfo Com_RxSigInfo[227].ValidDlcOfRxSigInfo Com_RxSigInfo[228].RxAccessInfoIdxOfRxSigInfo Com_RxSigInfo[228].RxCbkFuncPtrAckIdxOfRxSigInfo Com_RxSigInfo[228].SignalProcessingOfRxSigInfo Com_RxSigInfo[228].ValidDlcOfRxSigInfo Com_RxSigInfo[229].RxAccessInfoIdxOfRxSigInfo Com_RxSigInfo[229].RxCbkFuncPtrAckIdxOfRxSigInfo Com_RxSigInfo[229].SignalProcessingOfRxSigInfo Com_RxSigInfo[229].ValidDlcOfRxSigInfo Com_RxSigInfo[22].RxAccessInfoIdxOfRxSigInfo Com_RxSigInfo[22].RxCbkFuncPtrAckIdxOfRxSigInfo Com_RxSigInfo[22].SignalProcessingOfRxSigInfo Com_RxSigInfo[22].ValidDlcOfRxSigInfo Com_RxSigInfo[230].RxAccessInfoIdxOfRxSigInfo /end REF_MEASUREMENT
/end GROUP
/end MODULE
/end PROJECT
