ASAP2_VERSION 1 71
/begin PROJECT MICROSAR ""
/begin MODULE CPP ""
/begin MOD_COMMON "" BYTE_ORDER MSB_LAST ALIGNMENT_BYTE 1 ALIGNMENT_WORD 2 ALIGNMENT_LONG 4 ALIGNMENT_FLOAT16_IEEE 2 ALIGNMENT_FLOAT32_IEEE 4 ALIGNMENT_FLOAT64_IEEE 8 ALIGNMENT_INT64 8 /end MOD_COMMON
/begin MEASUREMENT Com_TxSigInfo[111].TxFilterInitValueArrayBasedFilterInitValueEndIdxOfTxSigInfo "" UBYTE Com_TxFilterInitValueArrayBasedFilterInitValueEndIdxOfTxSigInfoType 0 0 0 255 ECU_ADDRESS 0x0 /end MEASUREMENT
/begin MEASUREMENT Com_TxSigInfo[111].TxFilterInitValueArrayBasedFilterInitValueStartIdxOfTxSigInfo "" UBYTE Com_TxFilterInitValueArrayBasedFilterInitValueStartIdxOfTxSigInfoType 0 0 0 255 ECU_ADDRESS 0x0 /end MEASUREMENT
/begin MEASUREMENT Com_TxSigInfo[111].TxPduInfoIdxOfTxSigInfo "" UBYTE NO_COMPU_METHOD 0 0 0 255 ECU_ADDRESS 0x0 /end MEASUREMENT
/begin MEASUREMENT Com_TxSigInfo[112].ApplTypeOfTxSigInfo "" UBYTE Com_ApplTypeOfTxSigInfoType 0 0 0 255 ECU_ADDRESS 0x0 /end MEASUREMENT
/begin MEASUREMENT Com_TxSigInfo[112].BitLengthOfTxSigInfo "" UWORD NO_COMPU_METHOD 0 0 0 65535 ECU_ADDRESS 0x0 /end MEASUREMENT
/begin MEASUREMENT Com_TxSigInfo[112].BitPositionOfTxSigInfo "" UWORD NO_COMPU_METHOD 0 0 0 65535 ECU_ADDRESS 0x0 /end MEASUREMENT
/begin MEASUREMENT Com_TxSigInfo[112].BusAccOfTxSigInfo "" UBYTE Com_BusAccOfTxSigInfoType 0 0 0 255 ECU_ADDRESS 0x0 /end MEASUREMENT
/begin MEASUREMENT Com_TxSigInfo[112].ByteLengthOfTxSigInfo "" UBYTE NO_COMPU_METHOD 0 0 0 255 ECU_ADDRESS 0x0 /end MEASUREMENT
/begin MEASUREMENT Com_TxSigInfo[112].DynSignalOfTxSigInfo "" UBYTE Com_DynSignalOfTxSigInfoType 0 0 0 1 ECU_ADDRESS 0x0 /end MEASUREMENT
/begin MEASUREMENT Com_TxSigInfo[112].FilterInitValueIdxOfTxSigInfo "" UBYTE Com_FilterInitValueIdxOfTxSigInfoType 0 0 0 255 ECU_ADDRESS 0x0 /end MEASUREMENT
/begin MEASUREMENT Com_TxSigInfo[112].FilterInitValueOfTxSigInfo "" UBYTE Com_FilterInitValueOfTxSigInfoType 0 0 0 255 ECU_ADDRESS 0x0 /end MEASUREMENT
/begin MEASUREMENT Com_TxSigInfo[112].InvValueIdxOfTxSigInfo "" UBYTE Com_InvValueIdxOfTxSigInfoType 0 0 0 255 ECU_ADDRESS 0x0 /end MEASUREMENT
/begin MEASUREMENT Com_TxSigInfo[112].InvValueOfTxSigInfo "" UBYTE Com_InvValueOfTxSigInfoType 0 0 0 255 ECU_ADDRESS 0x0 /end MEASUREMENT
/begin MEASUREMENT Com_TxSigInfo[112].OnChangeIdxOfTxSigInfo "" UBYTE Com_OnChangeIdxOfTxSigInfoType 0 0 0 255 ECU_ADDRESS 0x0 /end MEASUREMENT
/begin MEASUREMENT Com_TxSigInfo[112].OnChangeOfTxSigInfo "" UBYTE Com_OnChangeOfTxSigInfoType 0 0 0 255 ECU_ADDRESS 0x0 /end MEASUREMENT
/begin MEASUREMENT Com_TxSigInfo[112].StartByteInPduPositionOfTxSigInfo "" UBYTE NO_COMPU_METHOD 0 0 0 255 ECU_ADDRESS 0x0 /end MEASUREMENT
/begin MEASUREMENT Com_TxSigInfo[112].TxAccessInfoIdxOfTxSigInfo "" UWORD NO_COMPU_METHOD 0 0 0 65535 ECU_ADDRESS 0x0 /end MEASUREMENT
/begin MEASUREMENT Com_TxSigInfo[112].TxBufferEndIdxOfTxSigInfo "" UWORD Com_TxBufferEndIdxOfTxSigInfoType 0 0 0 65535 ECU_ADDRESS 0x0 /end MEASUREMENT
/begin MEASUREMENT Com_TxSigInfo[112].TxBufferStartIdxOfTxSigInfo "" UWORD Com_TxBufferStartIdxOfTxSigInfoType 0 0 0 65535 ECU_ADDRESS 0x0 /end MEASUREMENT
/begin MEASUREMENT Com_TxSigInfo[112].TxFilterInitValueArrayBasedFilterInitValueEndIdxOfTxSigInfo "" UBYTE Com_TxFilterInitValueArrayBasedFilterInitValueEndIdxOfTxSigInfoType 0 0 0 255 ECU_ADDRESS 0x0 /end MEASUREMENT
/begin MEASUREMENT Com_TxSigInfo[112].TxFilterInitValueArrayBasedFilterInitValueStartIdxOfTxSigInfo "" UBYTE Com_TxFilterInitValueArrayBasedFilterInitValueStartIdxOfTxSigInfoType 0 0 0 255 ECU_ADDRESS 0x0 /end MEASUREMENT
/begin MEASUREMENT Com_TxSigInfo[112].TxPduInfoIdxOfTxSigInfo "" UBYTE NO_COMPU_METHOD 0 0 0 255 ECU_ADDRESS 0x0 /end MEASUREMENT
/begin MEASUREMENT Com_TxSigInfo[113].ApplTypeOfTxSigInfo "" UBYTE Com_ApplTypeOfTxSigInfoType 0 0 0 255 ECU_ADDRESS 0x0 /end MEASUREMENT
/begin MEASUREMENT Com_TxSigInfo[113].BitLengthOfTxSigInfo "" UWORD NO_COMPU_METHOD 0 0 0 65535 ECU_ADDRESS 0x0 /end MEASUREMENT
/begin MEASUREMENT Com_TxSigInfo[113].BitPositionOfTxSigInfo "" UWORD NO_COMPU_METHOD 0 0 0 65535 ECU_ADDRESS 0x0 /end MEASUREMENT
/begin MEASUREMENT Com_TxSigInfo[113].BusAccOfTxSigInfo "" UBYTE Com_BusAccOfTxSigInfoType 0 0 0 255 ECU_ADDRESS 0x0 /end MEASUREMENT
/begin MEASUREMENT Com_TxSigInfo[113].ByteLengthOfTxSigInfo "" UBYTE NO_COMPU_METHOD 0 0 0 255 ECU_ADDRESS 0x0 /end MEASUREMENT
/begin MEASUREMENT Com_TxSigInfo[113].DynSignalOfTxSigInfo "" UBYTE Com_DynSignalOfTxSigInfoType 0 0 0 1 ECU_ADDRESS 0x0 /end MEASUREMENT
/begin MEASUREMENT Com_TxSigInfo[113].FilterInitValueIdxOfTxSigInfo "" UBYTE Com_FilterInitValueIdxOfTxSigInfoType 0 0 0 255 ECU_ADDRESS 0x0 /end MEASUREMENT
/begin MEASUREMENT Com_TxSigInfo[113].FilterInitValueOfTxSigInfo "" UBYTE Com_FilterInitValueOfTxSigInfoType 0 0 0 255 ECU_ADDRESS 0x0 /end MEASUREMENT
/begin MEASUREMENT Com_TxSigInfo[113].InvValueIdxOfTxSigInfo "" UBYTE Com_InvValueIdxOfTxSigInfoType 0 0 0 255 ECU_ADDRESS 0x0 /end MEASUREMENT
/begin MEASUREMENT Com_TxSigInfo[113].InvValueOfTxSigInfo "" UBYTE Com_InvValueOfTxSigInfoType 0 0 0 255 ECU_ADDRESS 0x0 /end MEASUREMENT
/begin MEASUREMENT Com_TxSigInfo[113].OnChangeIdxOfTxSigInfo "" UBYTE Com_OnChangeIdxOfTxSigInfoType 0 0 0 255 ECU_ADDRESS 0x0 /end MEASUREMENT
/begin MEASUREMENT Com_TxSigInfo[113].OnChangeOfTxSigInfo "" UBYTE Com_OnChangeOfTxSigInfoType 0 0 0 255 ECU_ADDRESS 0x0 /end MEASUREMENT
/begin MEASUREMENT Com_TxSigInfo[113].StartByteInPduPositionOfTxSigInfo "" UBYTE NO_COMPU_METHOD 0 0 0 255 ECU_ADDRESS 0x0 /end MEASUREMENT
/begin MEASUREMENT Com_TxSigInfo[113].TxAccessInfoIdxOfTxSigInfo "" UWORD NO_COMPU_METHOD 0 0 0 65535 ECU_ADDRESS 0x0 /end MEASUREMENT
/begin MEASUREMENT Com_TxSigInfo[113].TxBufferEndIdxOfTxSigInfo "" UWORD Com_TxBufferEndIdxOfTxSigInfoType 0 0 0 65535 ECU_ADDRESS 0x0 /end MEASUREMENT
/begin MEASUREMENT Com_TxSigInfo[113].TxBufferStartIdxOfTxSigInfo "" UWORD Com_TxBufferStartIdxOfTxSigInfoType 0 0 0 65535 ECU_ADDRESS 0x0 /end MEASUREMENT
/begin MEASUREMENT Com_TxSigInfo[113].TxFilterInitValueArrayBasedFilterInitValueEndIdxOfTxSigInfo "" UBYTE Com_TxFilterInitValueArrayBasedFilterInitValueEndIdxOfTxSigInfoType 0 0 0 255 ECU_ADDRESS 0x0 /end MEASUREMENT
/begin MEASUREMENT Com_TxSigInfo[113].TxFilterInitValueArrayBasedFilterInitValueStartIdxOfTxSigInfo "" UBYTE Com_TxFilterInitValueArrayBasedFilterInitValueStartIdxOfTxSigInfoType 0 0 0 255 ECU_ADDRESS 0x0 /end MEASUREMENT
/begin MEASUREMENT Com_TxSigInfo[113].TxPduInfoIdxOfTxSigInfo "" UBYTE NO_COMPU_METHOD 0 0 0 255 ECU_ADDRESS 0x0 /end MEASUREMENT
/begin MEASUREMENT Com_TxSigInfo[114].ApplTypeOfTxSigInfo "" UBYTE Com_ApplTypeOfTxSigInfoType 0 0 0 255 ECU_ADDRESS 0x0 /end MEASUREMENT
/begin MEASUREMENT Com_TxSigInfo[114].BitLengthOfTxSigInfo "" UWORD NO_COMPU_METHOD 0 0 0 65535 ECU_ADDRESS 0x0 /end MEASUREMENT
/begin MEASUREMENT Com_TxSigInfo[114].BitPositionOfTxSigInfo "" UWORD NO_COMPU_METHOD 0 0 0 65535 ECU_ADDRESS 0x0 /end MEASUREMENT
/begin MEASUREMENT Com_TxSigInfo[114].BusAccOfTxSigInfo "" UBYTE Com_BusAccOfTxSigInfoType 0 0 0 255 ECU_ADDRESS 0x0 /end MEASUREMENT
/begin MEASUREMENT Com_TxSigInfo[114].ByteLengthOfTxSigInfo "" UBYTE NO_COMPU_METHOD 0 0 0 255 ECU_ADDRESS 0x0 /end MEASUREMENT
/begin MEASUREMENT Com_TxSigInfo[114].DynSignalOfTxSigInfo "" UBYTE Com_DynSignalOfTxSigInfoType 0 0 0 1 ECU_ADDRESS 0x0 /end MEASUREMENT
/begin MEASUREMENT Com_TxSigInfo[114].FilterInitValueIdxOfTxSigInfo "" UBYTE Com_FilterInitValueIdxOfTxSigInfoType 0 0 0 255 ECU_ADDRESS 0x0 /end MEASUREMENT
/begin MEASUREMENT Com_TxSigInfo[114].FilterInitValueOfTxSigInfo "" UBYTE Com_FilterInitValueOfTxSigInfoType 0 0 0 255 ECU_ADDRESS 0x0 /end MEASUREMENT
/begin MEASUREMENT Com_TxSigInfo[114].InvValueIdxOfTxSigInfo "" UBYTE Com_InvValueIdxOfTxSigInfoType 0 0 0 255 ECU_ADDRESS 0x0 /end MEASUREMENT
/begin MEASUREMENT Com_TxSigInfo[114].InvValueOfTxSigInfo "" UBYTE Com_InvValueOfTxSigInfoType 0 0 0 255 ECU_ADDRESS 0x0 /end MEASUREMENT
/begin MEASUREMENT Com_TxSigInfo[114].OnChangeIdxOfTxSigInfo "" UBYTE Com_OnChangeIdxOfTxSigInfoType 0 0 0 255 ECU_ADDRESS 0x0 /end MEASUREMENT
/begin MEASUREMENT Com_TxSigInfo[114].OnChangeOfTxSigInfo "" UBYTE Com_OnChangeOfTxSigInfoType 0 0 0 255 ECU_ADDRESS 0x0 /end MEASUREMENT
/begin MEASUREMENT Com_TxSigInfo[114].StartByteInPduPositionOfTxSigInfo "" UBYTE NO_COMPU_METHOD 0 0 0 255 ECU_ADDRESS 0x0 /end MEASUREMENT
/begin MEASUREMENT Com_TxSigInfo[114].TxAccessInfoIdxOfTxSigInfo "" UWORD NO_COMPU_METHOD 0 0 0 65535 ECU_ADDRESS 0x0 /end MEASUREMENT
/begin MEASUREMENT Com_TxSigInfo[114].TxBufferEndIdxOfTxSigInfo "" UWORD Com_TxBufferEndIdxOfTxSigInfoType 0 0 0 65535 ECU_ADDRESS 0x0 /end MEASUREMENT
/begin MEASUREMENT Com_TxSigInfo[114].TxBufferStartIdxOfTxSigInfo "" UWORD Com_TxBufferStartIdxOfTxSigInfoType 0 0 0 65535 ECU_ADDRESS 0x0 /end MEASUREMENT
/begin MEASUREMENT Com_TxSigInfo[114].TxFilterInitValueArrayBasedFilterInitValueEndIdxOfTxSigInfo "" UBYTE Com_TxFilterInitValueArrayBasedFilterInitValueEndIdxOfTxSigInfoType 0 0 0 255 ECU_ADDRESS 0x0 /end MEASUREMENT
/begin MEASUREMENT Com_TxSigInfo[114].TxFilterInitValueArrayBasedFilterInitValueStartIdxOfTxSigInfo "" UBYTE Com_TxFilterInitValueArrayBasedFilterInitValueStartIdxOfTxSigInfoType 0 0 0 255 ECU_ADDRESS 0x0 /end MEASUREMENT
/begin MEASUREMENT Com_TxSigInfo[114].TxPduInfoIdxOfTxSigInfo "" UBYTE NO_COMPU_METHOD 0 0 0 255 ECU_ADDRESS 0x0 /end MEASUREMENT
/begin MEASUREMENT Com_TxSigInfo[115].ApplTypeOfTxSigInfo "" UBYTE Com_ApplTypeOfTxSigInfoType 0 0 0 255 ECU_ADDRESS 0x0 /end MEASUREMENT
/begin MEASUREMENT Com_TxSigInfo[115].BitLengthOfTxSigInfo "" UWORD NO_COMPU_METHOD 0 0 0 65535 ECU_ADDRESS 0x0 /end MEASUREMENT
/begin MEASUREMENT Com_TxSigInfo[115].BitPositionOfTxSigInfo "" UWORD NO_COMPU_METHOD 0 0 0 65535 ECU_ADDRESS 0x0 /end MEASUREMENT
/begin MEASUREMENT Com_TxSigInfo[115].BusAccOfTxSigInfo "" UBYTE Com_BusAccOfTxSigInfoType 0 0 0 255 ECU_ADDRESS 0x0 /end MEASUREMENT
/begin MEASUREMENT Com_TxSigInfo[115].ByteLengthOfTxSigInfo "" UBYTE NO_COMPU_METHOD 0 0 0 255 ECU_ADDRESS 0x0 /end MEASUREMENT
/begin MEASUREMENT Com_TxSigInfo[115].DynSignalOfTxSigInfo "" UBYTE Com_DynSignalOfTxSigInfoType 0 0 0 1 ECU_ADDRESS 0x0 /end MEASUREMENT
/begin MEASUREMENT Com_TxSigInfo[115].FilterInitValueIdxOfTxSigInfo "" UBYTE Com_FilterInitValueIdxOfTxSigInfoType 0 0 0 255 ECU_ADDRESS 0x0 /end MEASUREMENT
/begin MEASUREMENT Com_TxSigInfo[115].FilterInitValueOfTxSigInfo "" UBYTE Com_FilterInitValueOfTxSigInfoType 0 0 0 255 ECU_ADDRESS 0x0 /end MEASUREMENT
/begin MEASUREMENT Com_TxSigInfo[115].InvValueIdxOfTxSigInfo "" UBYTE Com_InvValueIdxOfTxSigInfoType 0 0 0 255 ECU_ADDRESS 0x0 /end MEASUREMENT
/begin MEASUREMENT Com_TxSigInfo[115].InvValueOfTxSigInfo "" UBYTE Com_InvValueOfTxSigInfoType 0 0 0 255 ECU_ADDRESS 0x0 /end MEASUREMENT
/begin MEASUREMENT Com_TxSigInfo[115].OnChangeIdxOfTxSigInfo "" UBYTE Com_OnChangeIdxOfTxSigInfoType 0 0 0 255 ECU_ADDRESS 0x0 /end MEASUREMENT
/begin MEASUREMENT Com_TxSigInfo[115].OnChangeOfTxSigInfo "" UBYTE Com_OnChangeOfTxSigInfoType 0 0 0 255 ECU_ADDRESS 0x0 /end MEASUREMENT
/begin MEASUREMENT Com_TxSigInfo[115].StartByteInPduPositionOfTxSigInfo "" UBYTE NO_COMPU_METHOD 0 0 0 255 ECU_ADDRESS 0x0 /end MEASUREMENT
/begin MEASUREMENT Com_TxSigInfo[115].TxAccessInfoIdxOfTxSigInfo "" UWORD NO_COMPU_METHOD 0 0 0 65535 ECU_ADDRESS 0x0 /end MEASUREMENT
/begin MEASUREMENT Com_TxSigInfo[115].TxBufferEndIdxOfTxSigInfo "" UWORD Com_TxBufferEndIdxOfTxSigInfoType 0 0 0 65535 ECU_ADDRESS 0x0 /end MEASUREMENT
/begin MEASUREMENT Com_TxSigInfo[115].TxBufferStartIdxOfTxSigInfo "" UWORD Com_TxBufferStartIdxOfTxSigInfoType 0 0 0 65535 ECU_ADDRESS 0x0 /end MEASUREMENT
/begin MEASUREMENT Com_TxSigInfo[115].TxFilterInitValueArrayBasedFilterInitValueEndIdxOfTxSigInfo "" UBYTE Com_TxFilterInitValueArrayBasedFilterInitValueEndIdxOfTxSigInfoType 0 0 0 255 ECU_ADDRESS 0x0 /end MEASUREMENT
/begin MEASUREMENT Com_TxSigInfo[115].TxFilterInitValueArrayBasedFilterInitValueStartIdxOfTxSigInfo "" UBYTE Com_TxFilterInitValueArrayBasedFilterInitValueStartIdxOfTxSigInfoType 0 0 0 255 ECU_ADDRESS 0x0 /end MEASUREMENT
/begin MEASUREMENT Com_TxSigInfo[115].TxPduInfoIdxOfTxSigInfo "" UBYTE NO_COMPU_METHOD 0 0 0 255 ECU_ADDRESS 0x0 /end MEASUREMENT
/begin MEASUREMENT Com_TxSigInfo[116].ApplTypeOfTxSigInfo "" UBYTE Com_ApplTypeOfTxSigInfoType 0 0 0 255 ECU_ADDRESS 0x0 /end MEASUREMENT
/begin MEASUREMENT Com_TxSigInfo[116].BitLengthOfTxSigInfo "" UWORD NO_COMPU_METHOD 0 0 0 65535 ECU_ADDRESS 0x0 /end MEASUREMENT
/begin MEASUREMENT Com_TxSigInfo[116].BitPositionOfTxSigInfo "" UWORD NO_COMPU_METHOD 0 0 0 65535 ECU_ADDRESS 0x0 /end MEASUREMENT
/begin MEASUREMENT Com_TxSigInfo[116].BusAccOfTxSigInfo "" UBYTE Com_BusAccOfTxSigInfoType 0 0 0 255 ECU_ADDRESS 0x0 /end MEASUREMENT
/begin MEASUREMENT Com_TxSigInfo[116].ByteLengthOfTxSigInfo "" UBYTE NO_COMPU_METHOD 0 0 0 255 ECU_ADDRESS 0x0 /end MEASUREMENT
/begin MEASUREMENT Com_TxSigInfo[116].DynSignalOfTxSigInfo "" UBYTE Com_DynSignalOfTxSigInfoType 0 0 0 1 ECU_ADDRESS 0x0 /end MEASUREMENT
/begin MEASUREMENT Com_TxSigInfo[116].FilterInitValueIdxOfTxSigInfo "" UBYTE Com_FilterInitValueIdxOfTxSigInfoType 0 0 0 255 ECU_ADDRESS 0x0 /end MEASUREMENT
/begin MEASUREMENT Com_TxSigInfo[116].FilterInitValueOfTxSigInfo "" UBYTE Com_FilterInitValueOfTxSigInfoType 0 0 0 255 ECU_ADDRESS 0x0 /end MEASUREMENT
/begin MEASUREMENT Com_TxSigInfo[116].InvValueIdxOfTxSigInfo "" UBYTE Com_InvValueIdxOfTxSigInfoType 0 0 0 255 ECU_ADDRESS 0x0 /end MEASUREMENT
/begin MEASUREMENT Com_TxSigInfo[116].InvValueOfTxSigInfo "" UBYTE Com_InvValueOfTxSigInfoType 0 0 0 255 ECU_ADDRESS 0x0 /end MEASUREMENT
/begin MEASUREMENT Com_TxSigInfo[116].OnChangeIdxOfTxSigInfo "" UBYTE Com_OnChangeIdxOfTxSigInfoType 0 0 0 255 ECU_ADDRESS 0x0 /end MEASUREMENT
/begin MEASUREMENT Com_TxSigInfo[116].OnChangeOfTxSigInfo "" UBYTE Com_OnChangeOfTxSigInfoType 0 0 0 255 ECU_ADDRESS 0x0 /end MEASUREMENT
/begin MEASUREMENT Com_TxSigInfo[116].StartByteInPduPositionOfTxSigInfo "" UBYTE NO_COMPU_METHOD 0 0 0 255 ECU_ADDRESS 0x0 /end MEASUREMENT
/begin MEASUREMENT Com_TxSigInfo[116].TxAccessInfoIdxOfTxSigInfo "" UWORD NO_COMPU_METHOD 0 0 0 65535 ECU_ADDRESS 0x0 /end MEASUREMENT
/begin MEASUREMENT Com_TxSigInfo[116].TxBufferEndIdxOfTxSigInfo "" UWORD Com_TxBufferEndIdxOfTxSigInfoType 0 0 0 65535 ECU_ADDRESS 0x0 /end MEASUREMENT
/begin MEASUREMENT Com_TxSigInfo[116].TxBufferStartIdxOfTxSigInfo "" UWORD Com_TxBufferStartIdxOfTxSigInfoType 0 0 0 65535 ECU_ADDRESS 0x0 /end MEASUREMENT
/begin MEASUREMENT Com_TxSigInfo[116].TxFilterInitValueArrayBasedFilterInitValueEndIdxOfTxSigInfo "" UBYTE Com_TxFilterInitValueArrayBasedFilterInitValueEndIdxOfTxSigInfoType 0 0 0 255 ECU_ADDRESS 0x0 /end MEASUREMENT
/begin MEASUREMENT Com_TxSigInfo[116].TxFilterInitValueArrayBasedFilterInitValueStartIdxOfTxSigInfo "" UBYTE Com_TxFilterInitValueArrayBasedFilterInitValueStartIdxOfTxSigInfoType 0 0 0 255 ECU_ADDRESS 0x0 /end MEASUREMENT
/begin MEASUREMENT Com_TxSigInfo[116].TxPduInfoIdxOfTxSigInfo "" UBYTE NO_COMPU_METHOD 0 0 0 255 ECU_ADDRESS 0x0 /end MEASUREMENT
/begin MEASUREMENT Com_TxSigInfo[117].ApplTypeOfTxSigInfo "" UBYTE Com_ApplTypeOfTxSigInfoType 0 0 0 255 ECU_ADDRESS 0x0 /end MEASUREMENT
/begin MEASUREMENT Com_TxSigInfo[117].BitLengthOfTxSigInfo "" UWORD NO_COMPU_METHOD 0 0 0 65535 ECU_ADDRESS 0x0 /end MEASUREMENT
/begin MEASUREMENT Com_TxSigInfo[117].BitPositionOfTxSigInfo "" UWORD NO_COMPU_METHOD 0 0 0 65535 ECU_ADDRESS 0x0 /end MEASUREMENT
/begin MEASUREMENT Com_TxSigInfo[117].BusAccOfTxSigInfo "" UBYTE Com_BusAccOfTxSigInfoType 0 0 0 255 ECU_ADDRESS 0x0 /end MEASUREMENT
/begin MEASUREMENT Com_TxSigInfo[117].ByteLengthOfTxSigInfo "" UBYTE NO_COMPU_METHOD 0 0 0 255 ECU_ADDRESS 0x0 /end MEASUREMENT
/begin MEASUREMENT Com_TxSigInfo[117].DynSignalOfTxSigInfo "" UBYTE Com_DynSignalOfTxSigInfoType 0 0 0 1 ECU_ADDRESS 0x0 /end MEASUREMENT
/begin MEASUREMENT Com_TxSigInfo[117].FilterInitValueIdxOfTxSigInfo "" UBYTE Com_FilterInitValueIdxOfTxSigInfoType 0 0 0 255 ECU_ADDRESS 0x0 /end MEASUREMENT
/begin MEASUREMENT Com_TxSigInfo[117].FilterInitValueOfTxSigInfo "" UBYTE Com_FilterInitValueOfTxSigInfoType 0 0 0 255 ECU_ADDRESS 0x0 /end MEASUREMENT
/begin MEASUREMENT Com_TxSigInfo[117].InvValueIdxOfTxSigInfo "" UBYTE Com_InvValueIdxOfTxSigInfoType 0 0 0 255 ECU_ADDRESS 0x0 /end MEASUREMENT
/begin MEASUREMENT Com_TxSigInfo[117].InvValueOfTxSigInfo "" UBYTE Com_InvValueOfTxSigInfoType 0 0 0 255 ECU_ADDRESS 0x0 /end MEASUREMENT
/begin MEASUREMENT Com_TxSigInfo[117].OnChangeIdxOfTxSigInfo "" UBYTE Com_OnChangeIdxOfTxSigInfoType 0 0 0 255 ECU_ADDRESS 0x0 /end MEASUREMENT
/begin MEASUREMENT Com_TxSigInfo[117].OnChangeOfTxSigInfo "" UBYTE Com_OnChangeOfTxSigInfoType 0 0 0 255 ECU_ADDRESS 0x0 /end MEASUREMENT
/begin MEASUREMENT Com_TxSigInfo[117].StartByteInPduPositionOfTxSigInfo "" UBYTE NO_COMPU_METHOD 0 0 0 255 ECU_ADDRESS 0x0 /end MEASUREMENT
/begin MEASUREMENT Com_TxSigInfo[117].TxAccessInfoIdxOfTxSigInfo "" UWORD NO_COMPU_METHOD 0 0 0 65535 ECU_ADDRESS 0x0 /end MEASUREMENT
/begin MEASUREMENT Com_TxSigInfo[117].TxBufferEndIdxOfTxSigInfo "" UWORD Com_TxBufferEndIdxOfTxSigInfoType 0 0 0 65535 ECU_ADDRESS 0x0 /end MEASUREMENT
/begin MEASUREMENT Com_TxSigInfo[117].TxBufferStartIdxOfTxSigInfo "" UWORD Com_TxBufferStartIdxOfTxSigInfoType 0 0 0 65535 ECU_ADDRESS 0x0 /end MEASUREMENT
/begin MEASUREMENT Com_TxSigInfo[117].TxFilterInitValueArrayBasedFilterInitValueEndIdxOfTxSigInfo "" UBYTE Com_TxFilterInitValueArrayBasedFilterInitValueEndIdxOfTxSigInfoType 0 0 0 255 ECU_ADDRESS 0x0 /end MEASUREMENT
/begin MEASUREMENT Com_TxSigInfo[117].TxFilterInitValueArrayBasedFilterInitValueStartIdxOfTxSigInfo "" UBYTE Com_TxFilterInitValueArrayBasedFilterInitValueStartIdxOfTxSigInfoType 0 0 0 255 ECU_ADDRESS 0x0 /end MEASUREMENT
/begin MEASUREMENT Com_TxSigInfo[117].TxPduInfoIdxOfTxSigInfo "" UBYTE NO_COMPU_METHOD 0 0 0 255 ECU_ADDRESS 0x0 /end MEASUREMENT
/begin MEASUREMENT Com_TxSigInfo[118].ApplTypeOfTxSigInfo "" UBYTE Com_ApplTypeOfTxSigInfoType 0 0 0 255 ECU_ADDRESS 0x0 /end MEASUREMENT
/begin MEASUREMENT Com_TxSigInfo[118].BitLengthOfTxSigInfo "" UWORD NO_COMPU_METHOD 0 0 0 65535 ECU_ADDRESS 0x0 /end MEASUREMENT
/begin MEASUREMENT Com_TxSigInfo[118].BitPositionOfTxSigInfo "" UWORD NO_COMPU_METHOD 0 0 0 65535 ECU_ADDRESS 0x0 /end MEASUREMENT
/begin MEASUREMENT Com_TxSigInfo[118].BusAccOfTxSigInfo "" UBYTE Com_BusAccOfTxSigInfoType 0 0 0 255 ECU_ADDRESS 0x0 /end MEASUREMENT
/begin MEASUREMENT Com_TxSigInfo[118].ByteLengthOfTxSigInfo "" UBYTE NO_COMPU_METHOD 0 0 0 255 ECU_ADDRESS 0x0 /end MEASUREMENT
/begin MEASUREMENT Com_TxSigInfo[118].DynSignalOfTxSigInfo "" UBYTE Com_DynSignalOfTxSigInfoType 0 0 0 1 ECU_ADDRESS 0x0 /end MEASUREMENT
/begin MEASUREMENT Com_TxSigInfo[118].FilterInitValueIdxOfTxSigInfo "" UBYTE Com_FilterInitValueIdxOfTxSigInfoType 0 0 0 255 ECU_ADDRESS 0x0 /end MEASUREMENT
/begin MEASUREMENT Com_TxSigInfo[118].FilterInitValueOfTxSigInfo "" UBYTE Com_FilterInitValueOfTxSigInfoType 0 0 0 255 ECU_ADDRESS 0x0 /end MEASUREMENT
/begin MEASUREMENT Com_TxSigInfo[118].InvValueIdxOfTxSigInfo "" UBYTE Com_InvValueIdxOfTxSigInfoType 0 0 0 255 ECU_ADDRESS 0x0 /end MEASUREMENT
/begin MEASUREMENT Com_TxSigInfo[118].InvValueOfTxSigInfo "" UBYTE Com_InvValueOfTxSigInfoType 0 0 0 255 ECU_ADDRESS 0x0 /end MEASUREMENT
/begin MEASUREMENT Com_TxSigInfo[118].OnChangeIdxOfTxSigInfo "" UBYTE Com_OnChangeIdxOfTxSigInfoType 0 0 0 255 ECU_ADDRESS 0x0 /end MEASUREMENT
/begin MEASUREMENT Com_TxSigInfo[118].OnChangeOfTxSigInfo "" UBYTE Com_OnChangeOfTxSigInfoType 0 0 0 255 ECU_ADDRESS 0x0 /end MEASUREMENT
/begin MEASUREMENT Com_TxSigInfo[118].StartByteInPduPositionOfTxSigInfo "" UBYTE NO_COMPU_METHOD 0 0 0 255 ECU_ADDRESS 0x0 /end MEASUREMENT
/begin MEASUREMENT Com_TxSigInfo[118].TxAccessInfoIdxOfTxSigInfo "" UWORD NO_COMPU_METHOD 0 0 0 65535 ECU_ADDRESS 0x0 /end MEASUREMENT
/begin MEASUREMENT Com_TxSigInfo[118].TxBufferEndIdxOfTxSigInfo "" UWORD Com_TxBufferEndIdxOfTxSigInfoType 0 0 0 65535 ECU_ADDRESS 0x0 /end MEASUREMENT
/begin MEASUREMENT Com_TxSigInfo[118].TxBufferStartIdxOfTxSigInfo "" UWORD Com_TxBufferStartIdxOfTxSigInfoType 0 0 0 65535 ECU_ADDRESS 0x0 /end MEASUREMENT
/begin MEASUREMENT Com_TxSigInfo[118].TxFilterInitValueArrayBasedFilterInitValueEndIdxOfTxSigInfo "" UBYTE Com_TxFilterInitValueArrayBasedFilterInitValueEndIdxOfTxSigInfoType 0 0 0 255 ECU_ADDRESS 0x0 /end MEASUREMENT
/begin MEASUREMENT Com_TxSigInfo[118].TxFilterInitValueArrayBasedFilterInitValueStartIdxOfTxSigInfo "" UBYTE Com_TxFilterInitValueArrayBasedFilterInitValueStartIdxOfTxSigInfoType 0 0 0 255 ECU_ADDRESS 0x0 /end MEASUREMENT
/begin MEASUREMENT Com_TxSigInfo[118].TxPduInfoIdxOfTxSigInfo "" UBYTE NO_COMPU_METHOD 0 0 0 255 ECU_ADDRESS 0x0 /end MEASUREMENT
/begin MEASUREMENT Com_TxSigInfo[119].ApplTypeOfTxSigInfo "" UBYTE Com_ApplTypeOfTxSigInfoType 0 0 0 255 ECU_ADDRESS 0x0 /end MEASUREMENT
/begin MEASUREMENT Com_TxSigInfo[119].BitLengthOfTxSigInfo "" UWORD NO_COMPU_METHOD 0 0 0 65535 ECU_ADDRESS 0x0 /end MEASUREMENT
/begin MEASUREMENT Com_TxSigInfo[119].BitPositionOfTxSigInfo "" UWORD NO_COMPU_METHOD 0 0 0 65535 ECU_ADDRESS 0x0 /end MEASUREMENT
/begin MEASUREMENT Com_TxSigInfo[119].BusAccOfTxSigInfo "" UBYTE Com_BusAccOfTxSigInfoType 0 0 0 255 ECU_ADDRESS 0x0 /end MEASUREMENT
/begin MEASUREMENT Com_TxSigInfo[119].ByteLengthOfTxSigInfo "" UBYTE NO_COMPU_METHOD 0 0 0 255 ECU_ADDRESS 0x0 /end MEASUREMENT
/begin MEASUREMENT Com_TxSigInfo[119].DynSignalOfTxSigInfo "" UBYTE Com_DynSignalOfTxSigInfoType 0 0 0 1 ECU_ADDRESS 0x0 /end MEASUREMENT
/begin MEASUREMENT Com_TxSigInfo[119].FilterInitValueIdxOfTxSigInfo "" UBYTE Com_FilterInitValueIdxOfTxSigInfoType 0 0 0 255 ECU_ADDRESS 0x0 /end MEASUREMENT
/begin MEASUREMENT Com_TxSigInfo[119].FilterInitValueOfTxSigInfo "" UBYTE Com_FilterInitValueOfTxSigInfoType 0 0 0 255 ECU_ADDRESS 0x0 /end MEASUREMENT
/begin MEASUREMENT Com_TxSigInfo[119].InvValueIdxOfTxSigInfo "" UBYTE Com_InvValueIdxOfTxSigInfoType 0 0 0 255 ECU_ADDRESS 0x0 /end MEASUREMENT
/begin MEASUREMENT Com_TxSigInfo[119].InvValueOfTxSigInfo "" UBYTE Com_InvValueOfTxSigInfoType 0 0 0 255 ECU_ADDRESS 0x0 /end MEASUREMENT
/begin MEASUREMENT Com_TxSigInfo[119].OnChangeIdxOfTxSigInfo "" UBYTE Com_OnChangeIdxOfTxSigInfoType 0 0 0 255 ECU_ADDRESS 0x0 /end MEASUREMENT
/begin MEASUREMENT Com_TxSigInfo[119].OnChangeOfTxSigInfo "" UBYTE Com_OnChangeOfTxSigInfoType 0 0 0 255 ECU_ADDRESS 0x0 /end MEASUREMENT
/begin MEASUREMENT Com_TxSigInfo[119].StartByteInPduPositionOfTxSigInfo "" UBYTE NO_COMPU_METHOD 0 0 0 255 ECU_ADDRESS 0x0 /end MEASUREMENT
/begin MEASUREMENT Com_TxSigInfo[119].TxAccessInfoIdxOfTxSigInfo "" UWORD NO_COMPU_METHOD 0 0 0 65535 ECU_ADDRESS 0x0 /end MEASUREMENT
/begin MEASUREMENT Com_TxSigInfo[119].TxBufferEndIdxOfTxSigInfo "" UWORD Com_TxBufferEndIdxOfTxSigInfoType 0 0 0 65535 ECU_ADDRESS 0x0 /end MEASUREMENT
/begin MEASUREMENT Com_TxSigInfo[119].TxBufferStartIdxOfTxSigInfo "" UWORD Com_TxBufferStartIdxOfTxSigInfoType 0 0 0 65535 ECU_ADDRESS 0x0 /end MEASUREMENT
/begin MEASUREMENT Com_TxSigInfo[119].TxFilterInitValueArrayBasedFilterInitValueEndIdxOfTxSigInfo "" UBYTE Com_TxFilterInitValueArrayBasedFilterInitValueEndIdxOfTxSigInfoType 0 0 0 255 ECU_ADDRESS 0x0 /end MEASUREMENT
/begin MEASUREMENT Com_TxSigInfo[119].TxFilterInitValueArrayBasedFilterInitValueStartIdxOfTxSigInfo "" UBYTE Com_TxFilterInitValueArrayBasedFilterInitValueStartIdxOfTxSigInfoType 0 0 0 255 ECU_ADDRESS 0x0 /end MEASUREMENT
/begin MEASUREMENT Com_TxSigInfo[119].TxPduInfoIdxOfTxSigInfo "" UBYTE NO_COMPU_METHOD 0 0 0 255 ECU_ADDRESS 0x0 /end MEASUREMENT
/begin MEASUREMENT Com_TxSigInfo[11].ApplTypeOfTxSigInfo "" UBYTE Com_ApplTypeOfTxSigInfoType 0 0 0 255 ECU_ADDRESS 0x0 /end MEASUREMENT
/begin MEASUREMENT Com_TxSigInfo[11].BitLengthOfTxSigInfo "" UWORD NO_COMPU_METHOD 0 0 0 65535 ECU_ADDRESS 0x0 /end MEASUREMENT
/begin MEASUREMENT Com_TxSigInfo[11].BitPositionOfTxSigInfo "" UWORD NO_COMPU_METHOD 0 0 0 65535 ECU_ADDRESS 0x0 /end MEASUREMENT
/begin MEASUREMENT Com_TxSigInfo[11].BusAccOfTxSigInfo "" UBYTE Com_BusAccOfTxSigInfoType 0 0 0 255 ECU_ADDRESS 0x0 /end MEASUREMENT
/begin MEASUREMENT Com_TxSigInfo[11].ByteLengthOfTxSigInfo "" UBYTE NO_COMPU_METHOD 0 0 0 255 ECU_ADDRESS 0x0 /end MEASUREMENT
/begin MEASUREMENT Com_TxSigInfo[11].DynSignalOfTxSigInfo "" UBYTE Com_DynSignalOfTxSigInfoType 0 0 0 1 ECU_ADDRESS 0x0 /end MEASUREMENT
/begin MEASUREMENT Com_TxSigInfo[11].FilterInitValueIdxOfTxSigInfo "" UBYTE Com_FilterInitValueIdxOfTxSigInfoType 0 0 0 255 ECU_ADDRESS 0x0 /end MEASUREMENT
/begin MEASUREMENT Com_TxSigInfo[11].FilterInitValueOfTxSigInfo "" UBYTE Com_FilterInitValueOfTxSigInfoType 0 0 0 255 ECU_ADDRESS 0x0 /end MEASUREMENT
/begin MEASUREMENT Com_TxSigInfo[11].InvValueIdxOfTxSigInfo "" UBYTE Com_InvValueIdxOfTxSigInfoType 0 0 0 255 ECU_ADDRESS 0x0 /end MEASUREMENT
/begin MEASUREMENT Com_TxSigInfo[11].InvValueOfTxSigInfo "" UBYTE Com_InvValueOfTxSigInfoType 0 0 0 255 ECU_ADDRESS 0x0 /end MEASUREMENT
/begin MEASUREMENT Com_TxSigInfo[11].OnChangeIdxOfTxSigInfo "" UBYTE Com_OnChangeIdxOfTxSigInfoType 0 0 0 255 ECU_ADDRESS 0x0 /end MEASUREMENT
/begin MEASUREMENT Com_TxSigInfo[11].OnChangeOfTxSigInfo "" UBYTE Com_OnChangeOfTxSigInfoType 0 0 0 255 ECU_ADDRESS 0x0 /end MEASUREMENT
/begin MEASUREMENT Com_TxSigInfo[11].StartByteInPduPositionOfTxSigInfo "" UBYTE NO_COMPU_METHOD 0 0 0 255 ECU_ADDRESS 0x0 /end MEASUREMENT
/begin MEASUREMENT Com_TxSigInfo[11].TxAccessInfoIdxOfTxSigInfo "" UWORD NO_COMPU_METHOD 0 0 0 65535 ECU_ADDRESS 0x0 /end MEASUREMENT
/begin MEASUREMENT Com_TxSigInfo[11].TxBufferEndIdxOfTxSigInfo "" UWORD Com_TxBufferEndIdxOfTxSigInfoType 0 0 0 65535 ECU_ADDRESS 0x0 /end MEASUREMENT
/begin MEASUREMENT Com_TxSigInfo[11].TxBufferStartIdxOfTxSigInfo "" UWORD Com_TxBufferStartIdxOfTxSigInfoType 0 0 0 65535 ECU_ADDRESS 0x0 /end MEASUREMENT
/begin MEASUREMENT Com_TxSigInfo[11].TxFilterInitValueArrayBasedFilterInitValueEndIdxOfTxSigInfo "" UBYTE Com_TxFilterInitValueArrayBasedFilterInitValueEndIdxOfTxSigInfoType 0 0 0 255 ECU_ADDRESS 0x0 /end MEASUREMENT
/begin MEASUREMENT Com_TxSigInfo[11].TxFilterInitValueArrayBasedFilterInitValueStartIdxOfTxSigInfo "" UBYTE Com_TxFilterInitValueArrayBasedFilterInitValueStartIdxOfTxSigInfoType 0 0 0 255 ECU_ADDRESS 0x0 /end MEASUREMENT
/begin MEASUREMENT Com_TxSigInfo[11].TxPduInfoIdxOfTxSigInfo "" UBYTE NO_COMPU_METHOD 0 0 0 255 ECU_ADDRESS 0x0 /end MEASUREMENT
/begin MEASUREMENT Com_TxSigInfo[120].ApplTypeOfTxSigInfo "" UBYTE Com_ApplTypeOfTxSigInfoType 0 0 0 255 ECU_ADDRESS 0x0 /end MEASUREMENT
/begin MEASUREMENT Com_TxSigInfo[120].BitLengthOfTxSigInfo "" UWORD NO_COMPU_METHOD 0 0 0 65535 ECU_ADDRESS 0x0 /end MEASUREMENT
/begin MEASUREMENT Com_TxSigInfo[120].BitPositionOfTxSigInfo "" UWORD NO_COMPU_METHOD 0 0 0 65535 ECU_ADDRESS 0x0 /end MEASUREMENT
/begin MEASUREMENT Com_TxSigInfo[120].BusAccOfTxSigInfo "" UBYTE Com_BusAccOfTxSigInfoType 0 0 0 255 ECU_ADDRESS 0x0 /end MEASUREMENT
/begin MEASUREMENT Com_TxSigInfo[120].ByteLengthOfTxSigInfo "" UBYTE NO_COMPU_METHOD 0 0 0 255 ECU_ADDRESS 0x0 /end MEASUREMENT
/begin MEASUREMENT Com_TxSigInfo[120].DynSignalOfTxSigInfo "" UBYTE Com_DynSignalOfTxSigInfoType 0 0 0 1 ECU_ADDRESS 0x0 /end MEASUREMENT
/begin MEASUREMENT Com_TxSigInfo[120].FilterInitValueIdxOfTxSigInfo "" UBYTE Com_FilterInitValueIdxOfTxSigInfoType 0 0 0 255 ECU_ADDRESS 0x0 /end MEASUREMENT
/begin MEASUREMENT Com_TxSigInfo[120].FilterInitValueOfTxSigInfo "" UBYTE Com_FilterInitValueOfTxSigInfoType 0 0 0 255 ECU_ADDRESS 0x0 /end MEASUREMENT
/begin MEASUREMENT Com_TxSigInfo[120].InvValueIdxOfTxSigInfo "" UBYTE Com_InvValueIdxOfTxSigInfoType 0 0 0 255 ECU_ADDRESS 0x0 /end MEASUREMENT
/begin MEASUREMENT Com_TxSigInfo[120].InvValueOfTxSigInfo "" UBYTE Com_InvValueOfTxSigInfoType 0 0 0 255 ECU_ADDRESS 0x0 /end MEASUREMENT
/begin MEASUREMENT Com_TxSigInfo[120].OnChangeIdxOfTxSigInfo "" UBYTE Com_OnChangeIdxOfTxSigInfoType 0 0 0 255 ECU_ADDRESS 0x0 /end MEASUREMENT
/begin MEASUREMENT Com_TxSigInfo[120].OnChangeOfTxSigInfo "" UBYTE Com_OnChangeOfTxSigInfoType 0 0 0 255 ECU_ADDRESS 0x0 /end MEASUREMENT
/begin MEASUREMENT Com_TxSigInfo[120].StartByteInPduPositionOfTxSigInfo "" UBYTE NO_COMPU_METHOD 0 0 0 255 ECU_ADDRESS 0x0 /end MEASUREMENT
/begin MEASUREMENT Com_TxSigInfo[120].TxAccessInfoIdxOfTxSigInfo "" UWORD NO_COMPU_METHOD 0 0 0 65535 ECU_ADDRESS 0x0 /end MEASUREMENT
/begin MEASUREMENT Com_TxSigInfo[120].TxBufferEndIdxOfTxSigInfo "" UWORD Com_TxBufferEndIdxOfTxSigInfoType 0 0 0 65535 ECU_ADDRESS 0x0 /end MEASUREMENT
/begin MEASUREMENT Com_TxSigInfo[120].TxBufferStartIdxOfTxSigInfo "" UWORD Com_TxBufferStartIdxOfTxSigInfoType 0 0 0 65535 ECU_ADDRESS 0x0 /end MEASUREMENT
/begin MEASUREMENT Com_TxSigInfo[120].TxFilterInitValueArrayBasedFilterInitValueEndIdxOfTxSigInfo "" UBYTE Com_TxFilterInitValueArrayBasedFilterInitValueEndIdxOfTxSigInfoType 0 0 0 255 ECU_ADDRESS 0x0 /end MEASUREMENT
/begin MEASUREMENT Com_TxSigInfo[120].TxFilterInitValueArrayBasedFilterInitValueStartIdxOfTxSigInfo "" UBYTE Com_TxFilterInitValueArrayBasedFilterInitValueStartIdxOfTxSigInfoType 0 0 0 255 ECU_ADDRESS 0x0 /end MEASUREMENT
/begin MEASUREMENT Com_TxSigInfo[120].TxPduInfoIdxOfTxSigInfo "" UBYTE NO_COMPU_METHOD 0 0 0 255 ECU_ADDRESS 0x0 /end MEASUREMENT
/begin MEASUREMENT Com_TxSigInfo[121].ApplTypeOfTxSigInfo "" UBYTE Com_ApplTypeOfTxSigInfoType 0 0 0 255 ECU_ADDRESS 0x0 /end MEASUREMENT
/begin MEASUREMENT Com_TxSigInfo[121].BitLengthOfTxSigInfo "" UWORD NO_COMPU_METHOD 0 0 0 65535 ECU_ADDRESS 0x0 /end MEASUREMENT
/begin MEASUREMENT Com_TxSigInfo[121].BitPositionOfTxSigInfo "" UWORD NO_COMPU_METHOD 0 0 0 65535 ECU_ADDRESS 0x0 /end MEASUREMENT
/begin MEASUREMENT Com_TxSigInfo[121].BusAccOfTxSigInfo "" UBYTE Com_BusAccOfTxSigInfoType 0 0 0 255 ECU_ADDRESS 0x0 /end MEASUREMENT
/begin MEASUREMENT Com_TxSigInfo[121].ByteLengthOfTxSigInfo "" UBYTE NO_COMPU_METHOD 0 0 0 255 ECU_ADDRESS 0x0 /end MEASUREMENT
/begin MEASUREMENT Com_TxSigInfo[121].DynSignalOfTxSigInfo "" UBYTE Com_DynSignalOfTxSigInfoType 0 0 0 1 ECU_ADDRESS 0x0 /end MEASUREMENT
/begin MEASUREMENT Com_TxSigInfo[121].FilterInitValueIdxOfTxSigInfo "" UBYTE Com_FilterInitValueIdxOfTxSigInfoType 0 0 0 255 ECU_ADDRESS 0x0 /end MEASUREMENT
/begin MEASUREMENT Com_TxSigInfo[121].FilterInitValueOfTxSigInfo "" UBYTE Com_FilterInitValueOfTxSigInfoType 0 0 0 255 ECU_ADDRESS 0x0 /end MEASUREMENT
/begin MEASUREMENT Com_TxSigInfo[121].InvValueIdxOfTxSigInfo "" UBYTE Com_InvValueIdxOfTxSigInfoType 0 0 0 255 ECU_ADDRESS 0x0 /end MEASUREMENT
/begin MEASUREMENT Com_TxSigInfo[121].InvValueOfTxSigInfo "" UBYTE Com_InvValueOfTxSigInfoType 0 0 0 255 ECU_ADDRESS 0x0 /end MEASUREMENT
/begin MEASUREMENT Com_TxSigInfo[121].OnChangeIdxOfTxSigInfo "" UBYTE Com_OnChangeIdxOfTxSigInfoType 0 0 0 255 ECU_ADDRESS 0x0 /end MEASUREMENT
/begin MEASUREMENT Com_TxSigInfo[121].OnChangeOfTxSigInfo "" UBYTE Com_OnChangeOfTxSigInfoType 0 0 0 255 ECU_ADDRESS 0x0 /end MEASUREMENT
/begin MEASUREMENT Com_TxSigInfo[121].StartByteInPduPositionOfTxSigInfo "" UBYTE NO_COMPU_METHOD 0 0 0 255 ECU_ADDRESS 0x0 /end MEASUREMENT
/begin MEASUREMENT Com_TxSigInfo[121].TxAccessInfoIdxOfTxSigInfo "" UWORD NO_COMPU_METHOD 0 0 0 65535 ECU_ADDRESS 0x0 /end MEASUREMENT
/begin MEASUREMENT Com_TxSigInfo[121].TxBufferEndIdxOfTxSigInfo "" UWORD Com_TxBufferEndIdxOfTxSigInfoType 0 0 0 65535 ECU_ADDRESS 0x0 /end MEASUREMENT
/begin MEASUREMENT Com_TxSigInfo[121].TxBufferStartIdxOfTxSigInfo "" UWORD Com_TxBufferStartIdxOfTxSigInfoType 0 0 0 65535 ECU_ADDRESS 0x0 /end MEASUREMENT
/begin MEASUREMENT Com_TxSigInfo[121].TxFilterInitValueArrayBasedFilterInitValueEndIdxOfTxSigInfo "" UBYTE Com_TxFilterInitValueArrayBasedFilterInitValueEndIdxOfTxSigInfoType 0 0 0 255 ECU_ADDRESS 0x0 /end MEASUREMENT
/begin MEASUREMENT Com_TxSigInfo[121].TxFilterInitValueArrayBasedFilterInitValueStartIdxOfTxSigInfo "" UBYTE Com_TxFilterInitValueArrayBasedFilterInitValueStartIdxOfTxSigInfoType 0 0 0 255 ECU_ADDRESS 0x0 /end MEASUREMENT
/begin MEASUREMENT Com_TxSigInfo[121].TxPduInfoIdxOfTxSigInfo "" UBYTE NO_COMPU_METHOD 0 0 0 255 ECU_ADDRESS 0x0 /end MEASUREMENT
/begin MEASUREMENT Com_TxSigInfo[122].ApplTypeOfTxSigInfo "" UBYTE Com_ApplTypeOfTxSigInfoType 0 0 0 255 ECU_ADDRESS 0x0 /end MEASUREMENT
/begin MEASUREMENT Com_TxSigInfo[122].BitLengthOfTxSigInfo "" UWORD NO_COMPU_METHOD 0 0 0 65535 ECU_ADDRESS 0x0 /end MEASUREMENT
/begin MEASUREMENT Com_TxSigInfo[122].BitPositionOfTxSigInfo "" UWORD NO_COMPU_METHOD 0 0 0 65535 ECU_ADDRESS 0x0 /end MEASUREMENT
/begin MEASUREMENT Com_TxSigInfo[122].BusAccOfTxSigInfo "" UBYTE Com_BusAccOfTxSigInfoType 0 0 0 255 ECU_ADDRESS 0x0 /end MEASUREMENT
/begin MEASUREMENT Com_TxSigInfo[122].ByteLengthOfTxSigInfo "" UBYTE NO_COMPU_METHOD 0 0 0 255 ECU_ADDRESS 0x0 /end MEASUREMENT
/begin MEASUREMENT Com_TxSigInfo[122].DynSignalOfTxSigInfo "" UBYTE Com_DynSignalOfTxSigInfoType 0 0 0 1 ECU_ADDRESS 0x0 /end MEASUREMENT
/begin MEASUREMENT Com_TxSigInfo[122].FilterInitValueIdxOfTxSigInfo "" UBYTE Com_FilterInitValueIdxOfTxSigInfoType 0 0 0 255 ECU_ADDRESS 0x0 /end MEASUREMENT
/begin MEASUREMENT Com_TxSigInfo[122].FilterInitValueOfTxSigInfo "" UBYTE Com_FilterInitValueOfTxSigInfoType 0 0 0 255 ECU_ADDRESS 0x0 /end MEASUREMENT
/begin MEASUREMENT Com_TxSigInfo[122].InvValueIdxOfTxSigInfo "" UBYTE Com_InvValueIdxOfTxSigInfoType 0 0 0 255 ECU_ADDRESS 0x0 /end MEASUREMENT
/begin MEASUREMENT Com_TxSigInfo[122].InvValueOfTxSigInfo "" UBYTE Com_InvValueOfTxSigInfoType 0 0 0 255 ECU_ADDRESS 0x0 /end MEASUREMENT
/begin MEASUREMENT Com_TxSigInfo[122].OnChangeIdxOfTxSigInfo "" UBYTE Com_OnChangeIdxOfTxSigInfoType 0 0 0 255 ECU_ADDRESS 0x0 /end MEASUREMENT
/begin MEASUREMENT Com_TxSigInfo[122].OnChangeOfTxSigInfo "" UBYTE Com_OnChangeOfTxSigInfoType 0 0 0 255 ECU_ADDRESS 0x0 /end MEASUREMENT
/begin MEASUREMENT Com_TxSigInfo[122].StartByteInPduPositionOfTxSigInfo "" UBYTE NO_COMPU_METHOD 0 0 0 255 ECU_ADDRESS 0x0 /end MEASUREMENT
/begin MEASUREMENT Com_TxSigInfo[122].TxAccessInfoIdxOfTxSigInfo "" UWORD NO_COMPU_METHOD 0 0 0 65535 ECU_ADDRESS 0x0 /end MEASUREMENT
/begin MEASUREMENT Com_TxSigInfo[122].TxBufferEndIdxOfTxSigInfo "" UWORD Com_TxBufferEndIdxOfTxSigInfoType 0 0 0 65535 ECU_ADDRESS 0x0 /end MEASUREMENT
/begin MEASUREMENT Com_TxSigInfo[122].TxBufferStartIdxOfTxSigInfo "" UWORD Com_TxBufferStartIdxOfTxSigInfoType 0 0 0 65535 ECU_ADDRESS 0x0 /end MEASUREMENT
/begin MEASUREMENT Com_TxSigInfo[122].TxFilterInitValueArrayBasedFilterInitValueEndIdxOfTxSigInfo "" UBYTE Com_TxFilterInitValueArrayBasedFilterInitValueEndIdxOfTxSigInfoType 0 0 0 255 ECU_ADDRESS 0x0 /end MEASUREMENT
/begin MEASUREMENT Com_TxSigInfo[122].TxFilterInitValueArrayBasedFilterInitValueStartIdxOfTxSigInfo "" UBYTE Com_TxFilterInitValueArrayBasedFilterInitValueStartIdxOfTxSigInfoType 0 0 0 255 ECU_ADDRESS 0x0 /end MEASUREMENT
/begin MEASUREMENT Com_TxSigInfo[122].TxPduInfoIdxOfTxSigInfo "" UBYTE NO_COMPU_METHOD 0 0 0 255 ECU_ADDRESS 0x0 /end MEASUREMENT
/begin MEASUREMENT Com_TxSigInfo[123].ApplTypeOfTxSigInfo "" UBYTE Com_ApplTypeOfTxSigInfoType 0 0 0 255 ECU_ADDRESS 0x0 /end MEASUREMENT
/begin MEASUREMENT Com_TxSigInfo[123].BitLengthOfTxSigInfo "" UWORD NO_COMPU_METHOD 0 0 0 65535 ECU_ADDRESS 0x0 /end MEASUREMENT
/begin MEASUREMENT Com_TxSigInfo[123].BitPositionOfTxSigInfo "" UWORD NO_COMPU_METHOD 0 0 0 65535 ECU_ADDRESS 0x0 /end MEASUREMENT
/begin MEASUREMENT Com_TxSigInfo[123].BusAccOfTxSigInfo "" UBYTE Com_BusAccOfTxSigInfoType 0 0 0 255 ECU_ADDRESS 0x0 /end MEASUREMENT
/begin MEASUREMENT Com_TxSigInfo[123].ByteLengthOfTxSigInfo "" UBYTE NO_COMPU_METHOD 0 0 0 255 ECU_ADDRESS 0x0 /end MEASUREMENT
/begin MEASUREMENT Com_TxSigInfo[123].DynSignalOfTxSigInfo "" UBYTE Com_DynSignalOfTxSigInfoType 0 0 0 1 ECU_ADDRESS 0x0 /end MEASUREMENT
/begin MEASUREMENT Com_TxSigInfo[123].FilterInitValueIdxOfTxSigInfo "" UBYTE Com_FilterInitValueIdxOfTxSigInfoType 0 0 0 255 ECU_ADDRESS 0x0 /end MEASUREMENT
/begin MEASUREMENT Com_TxSigInfo[123].FilterInitValueOfTxSigInfo "" UBYTE Com_FilterInitValueOfTxSigInfoType 0 0 0 255 ECU_ADDRESS 0x0 /end MEASUREMENT
/begin MEASUREMENT Com_TxSigInfo[123].InvValueIdxOfTxSigInfo "" UBYTE Com_InvValueIdxOfTxSigInfoType 0 0 0 255 ECU_ADDRESS 0x0 /end MEASUREMENT
/begin MEASUREMENT Com_TxSigInfo[123].InvValueOfTxSigInfo "" UBYTE Com_InvValueOfTxSigInfoType 0 0 0 255 ECU_ADDRESS 0x0 /end MEASUREMENT
/begin MEASUREMENT Com_TxSigInfo[123].OnChangeIdxOfTxSigInfo "" UBYTE Com_OnChangeIdxOfTxSigInfoType 0 0 0 255 ECU_ADDRESS 0x0 /end MEASUREMENT
/begin MEASUREMENT Com_TxSigInfo[123].OnChangeOfTxSigInfo "" UBYTE Com_OnChangeOfTxSigInfoType 0 0 0 255 ECU_ADDRESS 0x0 /end MEASUREMENT
/begin MEASUREMENT Com_TxSigInfo[123].StartByteInPduPositionOfTxSigInfo "" UBYTE NO_COMPU_METHOD 0 0 0 255 ECU_ADDRESS 0x0 /end MEASUREMENT
/begin MEASUREMENT Com_TxSigInfo[123].TxAccessInfoIdxOfTxSigInfo "" UWORD NO_COMPU_METHOD 0 0 0 65535 ECU_ADDRESS 0x0 /end MEASUREMENT
/begin MEASUREMENT Com_TxSigInfo[123].TxBufferEndIdxOfTxSigInfo "" UWORD Com_TxBufferEndIdxOfTxSigInfoType 0 0 0 65535 ECU_ADDRESS 0x0 /end MEASUREMENT
/begin MEASUREMENT Com_TxSigInfo[123].TxBufferStartIdxOfTxSigInfo "" UWORD Com_TxBufferStartIdxOfTxSigInfoType 0 0 0 65535 ECU_ADDRESS 0x0 /end MEASUREMENT
/begin MEASUREMENT Com_TxSigInfo[123].TxFilterInitValueArrayBasedFilterInitValueEndIdxOfTxSigInfo "" UBYTE Com_TxFilterInitValueArrayBasedFilterInitValueEndIdxOfTxSigInfoType 0 0 0 255 ECU_ADDRESS 0x0 /end MEASUREMENT
/begin MEASUREMENT Com_TxSigInfo[123].TxFilterInitValueArrayBasedFilterInitValueStartIdxOfTxSigInfo "" UBYTE Com_TxFilterInitValueArrayBasedFilterInitValueStartIdxOfTxSigInfoType 0 0 0 255 ECU_ADDRESS 0x0 /end MEASUREMENT
/begin MEASUREMENT Com_TxSigInfo[123].TxPduInfoIdxOfTxSigInfo "" UBYTE NO_COMPU_METHOD 0 0 0 255 ECU_ADDRESS 0x0 /end MEASUREMENT
/begin MEASUREMENT Com_TxSigInfo[124].ApplTypeOfTxSigInfo "" UBYTE Com_ApplTypeOfTxSigInfoType 0 0 0 255 ECU_ADDRESS 0x0 /end MEASUREMENT
/begin MEASUREMENT Com_TxSigInfo[124].BitLengthOfTxSigInfo "" UWORD NO_COMPU_METHOD 0 0 0 65535 ECU_ADDRESS 0x0 /end MEASUREMENT
/begin MEASUREMENT Com_TxSigInfo[124].BitPositionOfTxSigInfo "" UWORD NO_COMPU_METHOD 0 0 0 65535 ECU_ADDRESS 0x0 /end MEASUREMENT
/begin MEASUREMENT Com_TxSigInfo[124].BusAccOfTxSigInfo "" UBYTE Com_BusAccOfTxSigInfoType 0 0 0 255 ECU_ADDRESS 0x0 /end MEASUREMENT
/begin MEASUREMENT Com_TxSigInfo[124].ByteLengthOfTxSigInfo "" UBYTE NO_COMPU_METHOD 0 0 0 255 ECU_ADDRESS 0x0 /end MEASUREMENT
/begin MEASUREMENT Com_TxSigInfo[124].DynSignalOfTxSigInfo "" UBYTE Com_DynSignalOfTxSigInfoType 0 0 0 1 ECU_ADDRESS 0x0 /end MEASUREMENT
/begin MEASUREMENT Com_TxSigInfo[124].FilterInitValueIdxOfTxSigInfo "" UBYTE Com_FilterInitValueIdxOfTxSigInfoType 0 0 0 255 ECU_ADDRESS 0x0 /end MEASUREMENT
/begin MEASUREMENT Com_TxSigInfo[124].FilterInitValueOfTxSigInfo "" UBYTE Com_FilterInitValueOfTxSigInfoType 0 0 0 255 ECU_ADDRESS 0x0 /end MEASUREMENT
/begin MEASUREMENT Com_TxSigInfo[124].InvValueIdxOfTxSigInfo "" UBYTE Com_InvValueIdxOfTxSigInfoType 0 0 0 255 ECU_ADDRESS 0x0 /end MEASUREMENT
/begin MEASUREMENT Com_TxSigInfo[124].InvValueOfTxSigInfo "" UBYTE Com_InvValueOfTxSigInfoType 0 0 0 255 ECU_ADDRESS 0x0 /end MEASUREMENT
/begin MEASUREMENT Com_TxSigInfo[124].OnChangeIdxOfTxSigInfo "" UBYTE Com_OnChangeIdxOfTxSigInfoType 0 0 0 255 ECU_ADDRESS 0x0 /end MEASUREMENT
/begin MEASUREMENT Com_TxSigInfo[124].OnChangeOfTxSigInfo "" UBYTE Com_OnChangeOfTxSigInfoType 0 0 0 255 ECU_ADDRESS 0x0 /end MEASUREMENT
/begin MEASUREMENT Com_TxSigInfo[124].StartByteInPduPositionOfTxSigInfo "" UBYTE NO_COMPU_METHOD 0 0 0 255 ECU_ADDRESS 0x0 /end MEASUREMENT
/begin MEASUREMENT Com_TxSigInfo[124].TxAccessInfoIdxOfTxSigInfo "" UWORD NO_COMPU_METHOD 0 0 0 65535 ECU_ADDRESS 0x0 /end MEASUREMENT
/begin MEASUREMENT Com_TxSigInfo[124].TxBufferEndIdxOfTxSigInfo "" UWORD Com_TxBufferEndIdxOfTxSigInfoType 0 0 0 65535 ECU_ADDRESS 0x0 /end MEASUREMENT
/begin MEASUREMENT Com_TxSigInfo[124].TxBufferStartIdxOfTxSigInfo "" UWORD Com_TxBufferStartIdxOfTxSigInfoType 0 0 0 65535 ECU_ADDRESS 0x0 /end MEASUREMENT
/begin MEASUREMENT Com_TxSigInfo[124].TxFilterInitValueArrayBasedFilterInitValueEndIdxOfTxSigInfo "" UBYTE Com_TxFilterInitValueArrayBasedFilterInitValueEndIdxOfTxSigInfoType 0 0 0 255 ECU_ADDRESS 0x0 /end MEASUREMENT
/begin MEASUREMENT Com_TxSigInfo[124].TxFilterInitValueArrayBasedFilterInitValueStartIdxOfTxSigInfo "" UBYTE Com_TxFilterInitValueArrayBasedFilterInitValueStartIdxOfTxSigInfoType 0 0 0 255 ECU_ADDRESS 0x0 /end MEASUREMENT
/begin MEASUREMENT Com_TxSigInfo[124].TxPduInfoIdxOfTxSigInfo "" UBYTE NO_COMPU_METHOD 0 0 0 255 ECU_ADDRESS 0x0 /end MEASUREMENT
/begin MEASUREMENT Com_TxSigInfo[125].ApplTypeOfTxSigInfo "" UBYTE Com_ApplTypeOfTxSigInfoType 0 0 0 255 ECU_ADDRESS 0x0 /end MEASUREMENT
/begin MEASUREMENT Com_TxSigInfo[125].BitLengthOfTxSigInfo "" UWORD NO_COMPU_METHOD 0 0 0 65535 ECU_ADDRESS 0x0 /end MEASUREMENT
/begin MEASUREMENT Com_TxSigInfo[125].BitPositionOfTxSigInfo "" UWORD NO_COMPU_METHOD 0 0 0 65535 ECU_ADDRESS 0x0 /end MEASUREMENT
/begin MEASUREMENT Com_TxSigInfo[125].BusAccOfTxSigInfo "" UBYTE Com_BusAccOfTxSigInfoType 0 0 0 255 ECU_ADDRESS 0x0 /end MEASUREMENT
/begin MEASUREMENT Com_TxSigInfo[125].ByteLengthOfTxSigInfo "" UBYTE NO_COMPU_METHOD 0 0 0 255 ECU_ADDRESS 0x0 /end MEASUREMENT
/begin MEASUREMENT Com_TxSigInfo[125].DynSignalOfTxSigInfo "" UBYTE Com_DynSignalOfTxSigInfoType 0 0 0 1 ECU_ADDRESS 0x0 /end MEASUREMENT
/begin MEASUREMENT Com_TxSigInfo[125].FilterInitValueIdxOfTxSigInfo "" UBYTE Com_FilterInitValueIdxOfTxSigInfoType 0 0 0 255 ECU_ADDRESS 0x0 /end MEASUREMENT
/begin MEASUREMENT Com_TxSigInfo[125].FilterInitValueOfTxSigInfo "" UBYTE Com_FilterInitValueOfTxSigInfoType 0 0 0 255 ECU_ADDRESS 0x0 /end MEASUREMENT
/begin MEASUREMENT Com_TxSigInfo[125].InvValueIdxOfTxSigInfo "" UBYTE Com_InvValueIdxOfTxSigInfoType 0 0 0 255 ECU_ADDRESS 0x0 /end MEASUREMENT
/begin MEASUREMENT Com_TxSigInfo[125].InvValueOfTxSigInfo "" UBYTE Com_InvValueOfTxSigInfoType 0 0 0 255 ECU_ADDRESS 0x0 /end MEASUREMENT
/begin MEASUREMENT Com_TxSigInfo[125].OnChangeIdxOfTxSigInfo "" UBYTE Com_OnChangeIdxOfTxSigInfoType 0 0 0 255 ECU_ADDRESS 0x0 /end MEASUREMENT
/begin MEASUREMENT Com_TxSigInfo[125].OnChangeOfTxSigInfo "" UBYTE Com_OnChangeOfTxSigInfoType 0 0 0 255 ECU_ADDRESS 0x0 /end MEASUREMENT
/begin MEASUREMENT Com_TxSigInfo[125].StartByteInPduPositionOfTxSigInfo "" UBYTE NO_COMPU_METHOD 0 0 0 255 ECU_ADDRESS 0x0 /end MEASUREMENT
/begin MEASUREMENT Com_TxSigInfo[125].TxAccessInfoIdxOfTxSigInfo "" UWORD NO_COMPU_METHOD 0 0 0 65535 ECU_ADDRESS 0x0 /end MEASUREMENT
/begin MEASUREMENT Com_TxSigInfo[125].TxBufferEndIdxOfTxSigInfo "" UWORD Com_TxBufferEndIdxOfTxSigInfoType 0 0 0 65535 ECU_ADDRESS 0x0 /end MEASUREMENT
/begin MEASUREMENT Com_TxSigInfo[125].TxBufferStartIdxOfTxSigInfo "" UWORD Com_TxBufferStartIdxOfTxSigInfoType 0 0 0 65535 ECU_ADDRESS 0x0 /end MEASUREMENT
/begin MEASUREMENT Com_TxSigInfo[125].TxFilterInitValueArrayBasedFilterInitValueEndIdxOfTxSigInfo "" UBYTE Com_TxFilterInitValueArrayBasedFilterInitValueEndIdxOfTxSigInfoType 0 0 0 255 ECU_ADDRESS 0x0 /end MEASUREMENT
/begin MEASUREMENT Com_TxSigInfo[125].TxFilterInitValueArrayBasedFilterInitValueStartIdxOfTxSigInfo "" UBYTE Com_TxFilterInitValueArrayBasedFilterInitValueStartIdxOfTxSigInfoType 0 0 0 255 ECU_ADDRESS 0x0 /end MEASUREMENT
/begin MEASUREMENT Com_TxSigInfo[125].TxPduInfoIdxOfTxSigInfo "" UBYTE NO_COMPU_METHOD 0 0 0 255 ECU_ADDRESS 0x0 /end MEASUREMENT
/begin MEASUREMENT Com_TxSigInfo[126].ApplTypeOfTxSigInfo "" UBYTE Com_ApplTypeOfTxSigInfoType 0 0 0 255 ECU_ADDRESS 0x0 /end MEASUREMENT
/begin MEASUREMENT Com_TxSigInfo[126].BitLengthOfTxSigInfo "" UWORD NO_COMPU_METHOD 0 0 0 65535 ECU_ADDRESS 0x0 /end MEASUREMENT
/begin MEASUREMENT Com_TxSigInfo[126].BitPositionOfTxSigInfo "" UWORD NO_COMPU_METHOD 0 0 0 65535 ECU_ADDRESS 0x0 /end MEASUREMENT
/begin MEASUREMENT Com_TxSigInfo[126].BusAccOfTxSigInfo "" UBYTE Com_BusAccOfTxSigInfoType 0 0 0 255 ECU_ADDRESS 0x0 /end MEASUREMENT
/begin MEASUREMENT Com_TxSigInfo[126].ByteLengthOfTxSigInfo "" UBYTE NO_COMPU_METHOD 0 0 0 255 ECU_ADDRESS 0x0 /end MEASUREMENT
/begin MEASUREMENT Com_TxSigInfo[126].DynSignalOfTxSigInfo "" UBYTE Com_DynSignalOfTxSigInfoType 0 0 0 1 ECU_ADDRESS 0x0 /end MEASUREMENT
/begin MEASUREMENT Com_TxSigInfo[126].FilterInitValueIdxOfTxSigInfo "" UBYTE Com_FilterInitValueIdxOfTxSigInfoType 0 0 0 255 ECU_ADDRESS 0x0 /end MEASUREMENT
/begin MEASUREMENT Com_TxSigInfo[126].FilterInitValueOfTxSigInfo "" UBYTE Com_FilterInitValueOfTxSigInfoType 0 0 0 255 ECU_ADDRESS 0x0 /end MEASUREMENT
/begin MEASUREMENT Com_TxSigInfo[126].InvValueIdxOfTxSigInfo "" UBYTE Com_InvValueIdxOfTxSigInfoType 0 0 0 255 ECU_ADDRESS 0x0 /end MEASUREMENT
/begin MEASUREMENT Com_TxSigInfo[126].InvValueOfTxSigInfo "" UBYTE Com_InvValueOfTxSigInfoType 0 0 0 255 ECU_ADDRESS 0x0 /end MEASUREMENT
/begin MEASUREMENT Com_TxSigInfo[126].OnChangeIdxOfTxSigInfo "" UBYTE Com_OnChangeIdxOfTxSigInfoType 0 0 0 255 ECU_ADDRESS 0x0 /end MEASUREMENT
/begin MEASUREMENT Com_TxSigInfo[126].OnChangeOfTxSigInfo "" UBYTE Com_OnChangeOfTxSigInfoType 0 0 0 255 ECU_ADDRESS 0x0 /end MEASUREMENT
/begin MEASUREMENT Com_TxSigInfo[126].StartByteInPduPositionOfTxSigInfo "" UBYTE NO_COMPU_METHOD 0 0 0 255 ECU_ADDRESS 0x0 /end MEASUREMENT
/begin MEASUREMENT Com_TxSigInfo[126].TxAccessInfoIdxOfTxSigInfo "" UWORD NO_COMPU_METHOD 0 0 0 65535 ECU_ADDRESS 0x0 /end MEASUREMENT
/begin MEASUREMENT Com_TxSigInfo[126].TxBufferEndIdxOfTxSigInfo "" UWORD Com_TxBufferEndIdxOfTxSigInfoType 0 0 0 65535 ECU_ADDRESS 0x0 /end MEASUREMENT
/begin MEASUREMENT Com_TxSigInfo[126].TxBufferStartIdxOfTxSigInfo "" UWORD Com_TxBufferStartIdxOfTxSigInfoType 0 0 0 65535 ECU_ADDRESS 0x0 /end MEASUREMENT
/begin MEASUREMENT Com_TxSigInfo[126].TxFilterInitValueArrayBasedFilterInitValueEndIdxOfTxSigInfo "" UBYTE Com_TxFilterInitValueArrayBasedFilterInitValueEndIdxOfTxSigInfoType 0 0 0 255 ECU_ADDRESS 0x0 /end MEASUREMENT
/begin MEASUREMENT Com_TxSigInfo[126].TxFilterInitValueArrayBasedFilterInitValueStartIdxOfTxSigInfo "" UBYTE Com_TxFilterInitValueArrayBasedFilterInitValueStartIdxOfTxSigInfoType 0 0 0 255 ECU_ADDRESS 0x0 /end MEASUREMENT
/begin MEASUREMENT Com_TxSigInfo[126].TxPduInfoIdxOfTxSigInfo "" UBYTE NO_COMPU_METHOD 0 0 0 255 ECU_ADDRESS 0x0 /end MEASUREMENT
/begin MEASUREMENT Com_TxSigInfo[127].ApplTypeOfTxSigInfo "" UBYTE Com_ApplTypeOfTxSigInfoType 0 0 0 255 ECU_ADDRESS 0x0 /end MEASUREMENT
/begin MEASUREMENT Com_TxSigInfo[127].BitLengthOfTxSigInfo "" UWORD NO_COMPU_METHOD 0 0 0 65535 ECU_ADDRESS 0x0 /end MEASUREMENT
/begin MEASUREMENT Com_TxSigInfo[127].BitPositionOfTxSigInfo "" UWORD NO_COMPU_METHOD 0 0 0 65535 ECU_ADDRESS 0x0 /end MEASUREMENT
/begin MEASUREMENT Com_TxSigInfo[127].BusAccOfTxSigInfo "" UBYTE Com_BusAccOfTxSigInfoType 0 0 0 255 ECU_ADDRESS 0x0 /end MEASUREMENT
/begin MEASUREMENT Com_TxSigInfo[127].ByteLengthOfTxSigInfo "" UBYTE NO_COMPU_METHOD 0 0 0 255 ECU_ADDRESS 0x0 /end MEASUREMENT
/begin MEASUREMENT Com_TxSigInfo[127].DynSignalOfTxSigInfo "" UBYTE Com_DynSignalOfTxSigInfoType 0 0 0 1 ECU_ADDRESS 0x0 /end MEASUREMENT
/begin MEASUREMENT Com_TxSigInfo[127].FilterInitValueIdxOfTxSigInfo "" UBYTE Com_FilterInitValueIdxOfTxSigInfoType 0 0 0 255 ECU_ADDRESS 0x0 /end MEASUREMENT
/begin MEASUREMENT Com_TxSigInfo[127].FilterInitValueOfTxSigInfo "" UBYTE Com_FilterInitValueOfTxSigInfoType 0 0 0 255 ECU_ADDRESS 0x0 /end MEASUREMENT
/begin MEASUREMENT Com_TxSigInfo[127].InvValueIdxOfTxSigInfo "" UBYTE Com_InvValueIdxOfTxSigInfoType 0 0 0 255 ECU_ADDRESS 0x0 /end MEASUREMENT
/begin MEASUREMENT Com_TxSigInfo[127].InvValueOfTxSigInfo "" UBYTE Com_InvValueOfTxSigInfoType 0 0 0 255 ECU_ADDRESS 0x0 /end MEASUREMENT
/begin MEASUREMENT Com_TxSigInfo[127].OnChangeIdxOfTxSigInfo "" UBYTE Com_OnChangeIdxOfTxSigInfoType 0 0 0 255 ECU_ADDRESS 0x0 /end MEASUREMENT
/begin MEASUREMENT Com_TxSigInfo[127].OnChangeOfTxSigInfo "" UBYTE Com_OnChangeOfTxSigInfoType 0 0 0 255 ECU_ADDRESS 0x0 /end MEASUREMENT
/begin MEASUREMENT Com_TxSigInfo[127].StartByteInPduPositionOfTxSigInfo "" UBYTE NO_COMPU_METHOD 0 0 0 255 ECU_ADDRESS 0x0 /end MEASUREMENT
/begin MEASUREMENT Com_TxSigInfo[127].TxAccessInfoIdxOfTxSigInfo "" UWORD NO_COMPU_METHOD 0 0 0 65535 ECU_ADDRESS 0x0 /end MEASUREMENT
/begin MEASUREMENT Com_TxSigInfo[127].TxBufferEndIdxOfTxSigInfo "" UWORD Com_TxBufferEndIdxOfTxSigInfoType 0 0 0 65535 ECU_ADDRESS 0x0 /end MEASUREMENT
/begin MEASUREMENT Com_TxSigInfo[127].TxBufferStartIdxOfTxSigInfo "" UWORD Com_TxBufferStartIdxOfTxSigInfoType 0 0 0 65535 ECU_ADDRESS 0x0 /end MEASUREMENT
/begin MEASUREMENT Com_TxSigInfo[127].TxFilterInitValueArrayBasedFilterInitValueEndIdxOfTxSigInfo "" UBYTE Com_TxFilterInitValueArrayBasedFilterInitValueEndIdxOfTxSigInfoType 0 0 0 255 ECU_ADDRESS 0x0 /end MEASUREMENT
/begin MEASUREMENT Com_TxSigInfo[127].TxFilterInitValueArrayBasedFilterInitValueStartIdxOfTxSigInfo "" UBYTE Com_TxFilterInitValueArrayBasedFilterInitValueStartIdxOfTxSigInfoType 0 0 0 255 ECU_ADDRESS 0x0 /end MEASUREMENT
/begin MEASUREMENT Com_TxSigInfo[127].TxPduInfoIdxOfTxSigInfo "" UBYTE NO_COMPU_METHOD 0 0 0 255 ECU_ADDRESS 0x0 /end MEASUREMENT
/begin MEASUREMENT Com_TxSigInfo[128].ApplTypeOfTxSigInfo "" UBYTE Com_ApplTypeOfTxSigInfoType 0 0 0 255 ECU_ADDRESS 0x0 /end MEASUREMENT
/begin MEASUREMENT Com_TxSigInfo[128].BitLengthOfTxSigInfo "" UWORD NO_COMPU_METHOD 0 0 0 65535 ECU_ADDRESS 0x0 /end MEASUREMENT
/begin MEASUREMENT Com_TxSigInfo[128].BitPositionOfTxSigInfo "" UWORD NO_COMPU_METHOD 0 0 0 65535 ECU_ADDRESS 0x0 /end MEASUREMENT
/begin MEASUREMENT Com_TxSigInfo[128].BusAccOfTxSigInfo "" UBYTE Com_BusAccOfTxSigInfoType 0 0 0 255 ECU_ADDRESS 0x0 /end MEASUREMENT
/begin MEASUREMENT Com_TxSigInfo[128].ByteLengthOfTxSigInfo "" UBYTE NO_COMPU_METHOD 0 0 0 255 ECU_ADDRESS 0x0 /end MEASUREMENT
/begin MEASUREMENT Com_TxSigInfo[128].DynSignalOfTxSigInfo "" UBYTE Com_DynSignalOfTxSigInfoType 0 0 0 1 ECU_ADDRESS 0x0 /end MEASUREMENT
/begin MEASUREMENT Com_TxSigInfo[128].FilterInitValueIdxOfTxSigInfo "" UBYTE Com_FilterInitValueIdxOfTxSigInfoType 0 0 0 255 ECU_ADDRESS 0x0 /end MEASUREMENT
/begin MEASUREMENT Com_TxSigInfo[128].FilterInitValueOfTxSigInfo "" UBYTE Com_FilterInitValueOfTxSigInfoType 0 0 0 255 ECU_ADDRESS 0x0 /end MEASUREMENT
/begin MEASUREMENT Com_TxSigInfo[128].InvValueIdxOfTxSigInfo "" UBYTE Com_InvValueIdxOfTxSigInfoType 0 0 0 255 ECU_ADDRESS 0x0 /end MEASUREMENT
/begin MEASUREMENT Com_TxSigInfo[128].InvValueOfTxSigInfo "" UBYTE Com_InvValueOfTxSigInfoType 0 0 0 255 ECU_ADDRESS 0x0 /end MEASUREMENT
/begin MEASUREMENT Com_TxSigInfo[128].OnChangeIdxOfTxSigInfo "" UBYTE Com_OnChangeIdxOfTxSigInfoType 0 0 0 255 ECU_ADDRESS 0x0 /end MEASUREMENT
/begin MEASUREMENT Com_TxSigInfo[128].OnChangeOfTxSigInfo "" UBYTE Com_OnChangeOfTxSigInfoType 0 0 0 255 ECU_ADDRESS 0x0 /end MEASUREMENT
/begin MEASUREMENT Com_TxSigInfo[128].StartByteInPduPositionOfTxSigInfo "" UBYTE NO_COMPU_METHOD 0 0 0 255 ECU_ADDRESS 0x0 /end MEASUREMENT
/begin MEASUREMENT Com_TxSigInfo[128].TxAccessInfoIdxOfTxSigInfo "" UWORD NO_COMPU_METHOD 0 0 0 65535 ECU_ADDRESS 0x0 /end MEASUREMENT
/begin MEASUREMENT Com_TxSigInfo[128].TxBufferEndIdxOfTxSigInfo "" UWORD Com_TxBufferEndIdxOfTxSigInfoType 0 0 0 65535 ECU_ADDRESS 0x0 /end MEASUREMENT
/begin MEASUREMENT Com_TxSigInfo[128].TxBufferStartIdxOfTxSigInfo "" UWORD Com_TxBufferStartIdxOfTxSigInfoType 0 0 0 65535 ECU_ADDRESS 0x0 /end MEASUREMENT
/begin MEASUREMENT Com_TxSigInfo[128].TxFilterInitValueArrayBasedFilterInitValueEndIdxOfTxSigInfo "" UBYTE Com_TxFilterInitValueArrayBasedFilterInitValueEndIdxOfTxSigInfoType 0 0 0 255 ECU_ADDRESS 0x0 /end MEASUREMENT
/begin MEASUREMENT Com_TxSigInfo[128].TxFilterInitValueArrayBasedFilterInitValueStartIdxOfTxSigInfo "" UBYTE Com_TxFilterInitValueArrayBasedFilterInitValueStartIdxOfTxSigInfoType 0 0 0 255 ECU_ADDRESS 0x0 /end MEASUREMENT
/begin MEASUREMENT Com_TxSigInfo[128].TxPduInfoIdxOfTxSigInfo "" UBYTE NO_COMPU_METHOD 0 0 0 255 ECU_ADDRESS 0x0 /end MEASUREMENT
/begin MEASUREMENT Com_TxSigInfo[129].ApplTypeOfTxSigInfo "" UBYTE Com_ApplTypeOfTxSigInfoType 0 0 0 255 ECU_ADDRESS 0x0 /end MEASUREMENT
/begin MEASUREMENT Com_TxSigInfo[129].BitLengthOfTxSigInfo "" UWORD NO_COMPU_METHOD 0 0 0 65535 ECU_ADDRESS 0x0 /end MEASUREMENT
/begin MEASUREMENT Com_TxSigInfo[129].BitPositionOfTxSigInfo "" UWORD NO_COMPU_METHOD 0 0 0 65535 ECU_ADDRESS 0x0 /end MEASUREMENT
/begin MEASUREMENT Com_TxSigInfo[129].BusAccOfTxSigInfo "" UBYTE Com_BusAccOfTxSigInfoType 0 0 0 255 ECU_ADDRESS 0x0 /end MEASUREMENT
/begin MEASUREMENT Com_TxSigInfo[129].ByteLengthOfTxSigInfo "" UBYTE NO_COMPU_METHOD 0 0 0 255 ECU_ADDRESS 0x0 /end MEASUREMENT
/begin MEASUREMENT Com_TxSigInfo[129].DynSignalOfTxSigInfo "" UBYTE Com_DynSignalOfTxSigInfoType 0 0 0 1 ECU_ADDRESS 0x0 /end MEASUREMENT
/begin MEASUREMENT Com_TxSigInfo[129].FilterInitValueIdxOfTxSigInfo "" UBYTE Com_FilterInitValueIdxOfTxSigInfoType 0 0 0 255 ECU_ADDRESS 0x0 /end MEASUREMENT
/begin MEASUREMENT Com_TxSigInfo[129].FilterInitValueOfTxSigInfo "" UBYTE Com_FilterInitValueOfTxSigInfoType 0 0 0 255 ECU_ADDRESS 0x0 /end MEASUREMENT
/begin MEASUREMENT Com_TxSigInfo[129].InvValueIdxOfTxSigInfo "" UBYTE Com_InvValueIdxOfTxSigInfoType 0 0 0 255 ECU_ADDRESS 0x0 /end MEASUREMENT
/begin MEASUREMENT Com_TxSigInfo[129].InvValueOfTxSigInfo "" UBYTE Com_InvValueOfTxSigInfoType 0 0 0 255 ECU_ADDRESS 0x0 /end MEASUREMENT
/begin MEASUREMENT Com_TxSigInfo[129].OnChangeIdxOfTxSigInfo "" UBYTE Com_OnChangeIdxOfTxSigInfoType 0 0 0 255 ECU_ADDRESS 0x0 /end MEASUREMENT
/begin MEASUREMENT Com_TxSigInfo[129].OnChangeOfTxSigInfo "" UBYTE Com_OnChangeOfTxSigInfoType 0 0 0 255 ECU_ADDRESS 0x0 /end MEASUREMENT
/begin MEASUREMENT Com_TxSigInfo[129].StartByteInPduPositionOfTxSigInfo "" UBYTE NO_COMPU_METHOD 0 0 0 255 ECU_ADDRESS 0x0 /end MEASUREMENT
/begin MEASUREMENT Com_TxSigInfo[129].TxAccessInfoIdxOfTxSigInfo "" UWORD NO_COMPU_METHOD 0 0 0 65535 ECU_ADDRESS 0x0 /end MEASUREMENT
/begin MEASUREMENT Com_TxSigInfo[129].TxBufferEndIdxOfTxSigInfo "" UWORD Com_TxBufferEndIdxOfTxSigInfoType 0 0 0 65535 ECU_ADDRESS 0x0 /end MEASUREMENT
/begin MEASUREMENT Com_TxSigInfo[129].TxBufferStartIdxOfTxSigInfo "" UWORD Com_TxBufferStartIdxOfTxSigInfoType 0 0 0 65535 ECU_ADDRESS 0x0 /end MEASUREMENT
/begin MEASUREMENT Com_TxSigInfo[129].TxFilterInitValueArrayBasedFilterInitValueEndIdxOfTxSigInfo "" UBYTE Com_TxFilterInitValueArrayBasedFilterInitValueEndIdxOfTxSigInfoType 0 0 0 255 ECU_ADDRESS 0x0 /end MEASUREMENT
/begin MEASUREMENT Com_TxSigInfo[129].TxFilterInitValueArrayBasedFilterInitValueStartIdxOfTxSigInfo "" UBYTE Com_TxFilterInitValueArrayBasedFilterInitValueStartIdxOfTxSigInfoType 0 0 0 255 ECU_ADDRESS 0x0 /end MEASUREMENT
/begin MEASUREMENT Com_TxSigInfo[129].TxPduInfoIdxOfTxSigInfo "" UBYTE NO_COMPU_METHOD 0 0 0 255 ECU_ADDRESS 0x0 /end MEASUREMENT
/begin MEASUREMENT Com_TxSigInfo[12].ApplTypeOfTxSigInfo "" UBYTE Com_ApplTypeOfTxSigInfoType 0 0 0 255 ECU_ADDRESS 0x0 /end MEASUREMENT
/begin MEASUREMENT Com_TxSigInfo[12].BitLengthOfTxSigInfo "" UWORD NO_COMPU_METHOD 0 0 0 65535 ECU_ADDRESS 0x0 /end MEASUREMENT
/begin MEASUREMENT Com_TxSigInfo[12].BitPositionOfTxSigInfo "" UWORD NO_COMPU_METHOD 0 0 0 65535 ECU_ADDRESS 0x0 /end MEASUREMENT
/begin MEASUREMENT Com_TxSigInfo[12].BusAccOfTxSigInfo "" UBYTE Com_BusAccOfTxSigInfoType 0 0 0 255 ECU_ADDRESS 0x0 /end MEASUREMENT
/begin MEASUREMENT Com_TxSigInfo[12].ByteLengthOfTxSigInfo "" UBYTE NO_COMPU_METHOD 0 0 0 255 ECU_ADDRESS 0x0 /end MEASUREMENT
/begin MEASUREMENT Com_TxSigInfo[12].DynSignalOfTxSigInfo "" UBYTE Com_DynSignalOfTxSigInfoType 0 0 0 1 ECU_ADDRESS 0x0 /end MEASUREMENT
/begin MEASUREMENT Com_TxSigInfo[12].FilterInitValueIdxOfTxSigInfo "" UBYTE Com_FilterInitValueIdxOfTxSigInfoType 0 0 0 255 ECU_ADDRESS 0x0 /end MEASUREMENT
/begin MEASUREMENT Com_TxSigInfo[12].FilterInitValueOfTxSigInfo "" UBYTE Com_FilterInitValueOfTxSigInfoType 0 0 0 255 ECU_ADDRESS 0x0 /end MEASUREMENT
/begin MEASUREMENT Com_TxSigInfo[12].InvValueIdxOfTxSigInfo "" UBYTE Com_InvValueIdxOfTxSigInfoType 0 0 0 255 ECU_ADDRESS 0x0 /end MEASUREMENT
/begin MEASUREMENT Com_TxSigInfo[12].InvValueOfTxSigInfo "" UBYTE Com_InvValueOfTxSigInfoType 0 0 0 255 ECU_ADDRESS 0x0 /end MEASUREMENT
/begin MEASUREMENT Com_TxSigInfo[12].OnChangeIdxOfTxSigInfo "" UBYTE Com_OnChangeIdxOfTxSigInfoType 0 0 0 255 ECU_ADDRESS 0x0 /end MEASUREMENT
/begin MEASUREMENT Com_TxSigInfo[12].OnChangeOfTxSigInfo "" UBYTE Com_OnChangeOfTxSigInfoType 0 0 0 255 ECU_ADDRESS 0x0 /end MEASUREMENT
/begin MEASUREMENT Com_TxSigInfo[12].StartByteInPduPositionOfTxSigInfo "" UBYTE NO_COMPU_METHOD 0 0 0 255 ECU_ADDRESS 0x0 /end MEASUREMENT
/begin MEASUREMENT Com_TxSigInfo[12].TxAccessInfoIdxOfTxSigInfo "" UWORD NO_COMPU_METHOD 0 0 0 65535 ECU_ADDRESS 0x0 /end MEASUREMENT
/begin MEASUREMENT Com_TxSigInfo[12].TxBufferEndIdxOfTxSigInfo "" UWORD Com_TxBufferEndIdxOfTxSigInfoType 0 0 0 65535 ECU_ADDRESS 0x0 /end MEASUREMENT
/begin MEASUREMENT Com_TxSigInfo[12].TxBufferStartIdxOfTxSigInfo "" UWORD Com_TxBufferStartIdxOfTxSigInfoType 0 0 0 65535 ECU_ADDRESS 0x0 /end MEASUREMENT
/begin MEASUREMENT Com_TxSigInfo[12].TxFilterInitValueArrayBasedFilterInitValueEndIdxOfTxSigInfo "" UBYTE Com_TxFilterInitValueArrayBasedFilterInitValueEndIdxOfTxSigInfoType 0 0 0 255 ECU_ADDRESS 0x0 /end MEASUREMENT
/begin MEASUREMENT Com_TxSigInfo[12].TxFilterInitValueArrayBasedFilterInitValueStartIdxOfTxSigInfo "" UBYTE Com_TxFilterInitValueArrayBasedFilterInitValueStartIdxOfTxSigInfoType 0 0 0 255 ECU_ADDRESS 0x0 /end MEASUREMENT
/begin MEASUREMENT Com_TxSigInfo[12].TxPduInfoIdxOfTxSigInfo "" UBYTE NO_COMPU_METHOD 0 0 0 255 ECU_ADDRESS 0x0 /end MEASUREMENT
/begin MEASUREMENT Com_TxSigInfo[130].ApplTypeOfTxSigInfo "" UBYTE Com_ApplTypeOfTxSigInfoType 0 0 0 255 ECU_ADDRESS 0x0 /end MEASUREMENT
/begin MEASUREMENT Com_TxSigInfo[130].BitLengthOfTxSigInfo "" UWORD NO_COMPU_METHOD 0 0 0 65535 ECU_ADDRESS 0x0 /end MEASUREMENT
/begin MEASUREMENT Com_TxSigInfo[130].BitPositionOfTxSigInfo "" UWORD NO_COMPU_METHOD 0 0 0 65535 ECU_ADDRESS 0x0 /end MEASUREMENT
/begin MEASUREMENT Com_TxSigInfo[130].BusAccOfTxSigInfo "" UBYTE Com_BusAccOfTxSigInfoType 0 0 0 255 ECU_ADDRESS 0x0 /end MEASUREMENT
/begin MEASUREMENT Com_TxSigInfo[130].ByteLengthOfTxSigInfo "" UBYTE NO_COMPU_METHOD 0 0 0 255 ECU_ADDRESS 0x0 /end MEASUREMENT
/begin MEASUREMENT Com_TxSigInfo[130].DynSignalOfTxSigInfo "" UBYTE Com_DynSignalOfTxSigInfoType 0 0 0 1 ECU_ADDRESS 0x0 /end MEASUREMENT
/begin MEASUREMENT Com_TxSigInfo[130].FilterInitValueIdxOfTxSigInfo "" UBYTE Com_FilterInitValueIdxOfTxSigInfoType 0 0 0 255 ECU_ADDRESS 0x0 /end MEASUREMENT
/begin MEASUREMENT Com_TxSigInfo[130].FilterInitValueOfTxSigInfo "" UBYTE Com_FilterInitValueOfTxSigInfoType 0 0 0 255 ECU_ADDRESS 0x0 /end MEASUREMENT
/begin MEASUREMENT Com_TxSigInfo[130].InvValueIdxOfTxSigInfo "" UBYTE Com_InvValueIdxOfTxSigInfoType 0 0 0 255 ECU_ADDRESS 0x0 /end MEASUREMENT
/begin MEASUREMENT Com_TxSigInfo[130].InvValueOfTxSigInfo "" UBYTE Com_InvValueOfTxSigInfoType 0 0 0 255 ECU_ADDRESS 0x0 /end MEASUREMENT
/begin MEASUREMENT Com_TxSigInfo[130].OnChangeIdxOfTxSigInfo "" UBYTE Com_OnChangeIdxOfTxSigInfoType 0 0 0 255 ECU_ADDRESS 0x0 /end MEASUREMENT
/begin MEASUREMENT Com_TxSigInfo[130].OnChangeOfTxSigInfo "" UBYTE Com_OnChangeOfTxSigInfoType 0 0 0 255 ECU_ADDRESS 0x0 /end MEASUREMENT
/begin MEASUREMENT Com_TxSigInfo[130].StartByteInPduPositionOfTxSigInfo "" UBYTE NO_COMPU_METHOD 0 0 0 255 ECU_ADDRESS 0x0 /end MEASUREMENT
/begin MEASUREMENT Com_TxSigInfo[130].TxAccessInfoIdxOfTxSigInfo "" UWORD NO_COMPU_METHOD 0 0 0 65535 ECU_ADDRESS 0x0 /end MEASUREMENT
/begin MEASUREMENT Com_TxSigInfo[130].TxBufferEndIdxOfTxSigInfo "" UWORD Com_TxBufferEndIdxOfTxSigInfoType 0 0 0 65535 ECU_ADDRESS 0x0 /end MEASUREMENT
/begin MEASUREMENT Com_TxSigInfo[130].TxBufferStartIdxOfTxSigInfo "" UWORD Com_TxBufferStartIdxOfTxSigInfoType 0 0 0 65535 ECU_ADDRESS 0x0 /end MEASUREMENT
/begin MEASUREMENT Com_TxSigInfo[130].TxFilterInitValueArrayBasedFilterInitValueEndIdxOfTxSigInfo "" UBYTE Com_TxFilterInitValueArrayBasedFilterInitValueEndIdxOfTxSigInfoType 0 0 0 255 ECU_ADDRESS 0x0 /end MEASUREMENT
/begin MEASUREMENT Com_TxSigInfo[130].TxFilterInitValueArrayBasedFilterInitValueStartIdxOfTxSigInfo "" UBYTE Com_TxFilterInitValueArrayBasedFilterInitValueStartIdxOfTxSigInfoType 0 0 0 255 ECU_ADDRESS 0x0 /end MEASUREMENT
/begin MEASUREMENT Com_TxSigInfo[130].TxPduInfoIdxOfTxSigInfo "" UBYTE NO_COMPU_METHOD 0 0 0 255 ECU_ADDRESS 0x0 /end MEASUREMENT
/begin MEASUREMENT Com_TxSigInfo[131].ApplTypeOfTxSigInfo "" UBYTE Com_ApplTypeOfTxSigInfoType 0 0 0 255 ECU_ADDRESS 0x0 /end MEASUREMENT
/begin MEASUREMENT Com_TxSigInfo[131].BitLengthOfTxSigInfo "" UWORD NO_COMPU_METHOD 0 0 0 65535 ECU_ADDRESS 0x0 /end MEASUREMENT
/begin MEASUREMENT Com_TxSigInfo[131].BitPositionOfTxSigInfo "" UWORD NO_COMPU_METHOD 0 0 0 65535 ECU_ADDRESS 0x0 /end MEASUREMENT
/begin MEASUREMENT Com_TxSigInfo[131].BusAccOfTxSigInfo "" UBYTE Com_BusAccOfTxSigInfoType 0 0 0 255 ECU_ADDRESS 0x0 /end MEASUREMENT
/begin MEASUREMENT Com_TxSigInfo[131].ByteLengthOfTxSigInfo "" UBYTE NO_COMPU_METHOD 0 0 0 255 ECU_ADDRESS 0x0 /end MEASUREMENT
/begin MEASUREMENT Com_TxSigInfo[131].DynSignalOfTxSigInfo "" UBYTE Com_DynSignalOfTxSigInfoType 0 0 0 1 ECU_ADDRESS 0x0 /end MEASUREMENT
/begin MEASUREMENT Com_TxSigInfo[131].FilterInitValueIdxOfTxSigInfo "" UBYTE Com_FilterInitValueIdxOfTxSigInfoType 0 0 0 255 ECU_ADDRESS 0x0 /end MEASUREMENT
/begin MEASUREMENT Com_TxSigInfo[131].FilterInitValueOfTxSigInfo "" UBYTE Com_FilterInitValueOfTxSigInfoType 0 0 0 255 ECU_ADDRESS 0x0 /end MEASUREMENT
/begin MEASUREMENT Com_TxSigInfo[131].InvValueIdxOfTxSigInfo "" UBYTE Com_InvValueIdxOfTxSigInfoType 0 0 0 255 ECU_ADDRESS 0x0 /end MEASUREMENT
/begin MEASUREMENT Com_TxSigInfo[131].InvValueOfTxSigInfo "" UBYTE Com_InvValueOfTxSigInfoType 0 0 0 255 ECU_ADDRESS 0x0 /end MEASUREMENT
/begin MEASUREMENT Com_TxSigInfo[131].OnChangeIdxOfTxSigInfo "" UBYTE Com_OnChangeIdxOfTxSigInfoType 0 0 0 255 ECU_ADDRESS 0x0 /end MEASUREMENT
/begin MEASUREMENT Com_TxSigInfo[131].OnChangeOfTxSigInfo "" UBYTE Com_OnChangeOfTxSigInfoType 0 0 0 255 ECU_ADDRESS 0x0 /end MEASUREMENT
/begin MEASUREMENT Com_TxSigInfo[131].StartByteInPduPositionOfTxSigInfo "" UBYTE NO_COMPU_METHOD 0 0 0 255 ECU_ADDRESS 0x0 /end MEASUREMENT
/begin MEASUREMENT Com_TxSigInfo[131].TxAccessInfoIdxOfTxSigInfo "" UWORD NO_COMPU_METHOD 0 0 0 65535 ECU_ADDRESS 0x0 /end MEASUREMENT
/begin MEASUREMENT Com_TxSigInfo[131].TxBufferEndIdxOfTxSigInfo "" UWORD Com_TxBufferEndIdxOfTxSigInfoType 0 0 0 65535 ECU_ADDRESS 0x0 /end MEASUREMENT
/begin MEASUREMENT Com_TxSigInfo[131].TxBufferStartIdxOfTxSigInfo "" UWORD Com_TxBufferStartIdxOfTxSigInfoType 0 0 0 65535 ECU_ADDRESS 0x0 /end MEASUREMENT
/begin MEASUREMENT Com_TxSigInfo[131].TxFilterInitValueArrayBasedFilterInitValueEndIdxOfTxSigInfo "" UBYTE Com_TxFilterInitValueArrayBasedFilterInitValueEndIdxOfTxSigInfoType 0 0 0 255 ECU_ADDRESS 0x0 /end MEASUREMENT
/begin MEASUREMENT Com_TxSigInfo[131].TxFilterInitValueArrayBasedFilterInitValueStartIdxOfTxSigInfo "" UBYTE Com_TxFilterInitValueArrayBasedFilterInitValueStartIdxOfTxSigInfoType 0 0 0 255 ECU_ADDRESS 0x0 /end MEASUREMENT
/begin MEASUREMENT Com_TxSigInfo[131].TxPduInfoIdxOfTxSigInfo "" UBYTE NO_COMPU_METHOD 0 0 0 255 ECU_ADDRESS 0x0 /end MEASUREMENT
/begin MEASUREMENT Com_TxSigInfo[132].ApplTypeOfTxSigInfo "" UBYTE Com_ApplTypeOfTxSigInfoType 0 0 0 255 ECU_ADDRESS 0x0 /end MEASUREMENT
/begin MEASUREMENT Com_TxSigInfo[132].BitLengthOfTxSigInfo "" UWORD NO_COMPU_METHOD 0 0 0 65535 ECU_ADDRESS 0x0 /end MEASUREMENT
/begin MEASUREMENT Com_TxSigInfo[132].BitPositionOfTxSigInfo "" UWORD NO_COMPU_METHOD 0 0 0 65535 ECU_ADDRESS 0x0 /end MEASUREMENT
/begin MEASUREMENT Com_TxSigInfo[132].BusAccOfTxSigInfo "" UBYTE Com_BusAccOfTxSigInfoType 0 0 0 255 ECU_ADDRESS 0x0 /end MEASUREMENT
/begin MEASUREMENT Com_TxSigInfo[132].ByteLengthOfTxSigInfo "" UBYTE NO_COMPU_METHOD 0 0 0 255 ECU_ADDRESS 0x0 /end MEASUREMENT
/begin MEASUREMENT Com_TxSigInfo[132].DynSignalOfTxSigInfo "" UBYTE Com_DynSignalOfTxSigInfoType 0 0 0 1 ECU_ADDRESS 0x0 /end MEASUREMENT
/begin MEASUREMENT Com_TxSigInfo[132].FilterInitValueIdxOfTxSigInfo "" UBYTE Com_FilterInitValueIdxOfTxSigInfoType 0 0 0 255 ECU_ADDRESS 0x0 /end MEASUREMENT
/begin MEASUREMENT Com_TxSigInfo[132].FilterInitValueOfTxSigInfo "" UBYTE Com_FilterInitValueOfTxSigInfoType 0 0 0 255 ECU_ADDRESS 0x0 /end MEASUREMENT
/begin MEASUREMENT Com_TxSigInfo[132].InvValueIdxOfTxSigInfo "" UBYTE Com_InvValueIdxOfTxSigInfoType 0 0 0 255 ECU_ADDRESS 0x0 /end MEASUREMENT
/begin MEASUREMENT Com_TxSigInfo[132].InvValueOfTxSigInfo "" UBYTE Com_InvValueOfTxSigInfoType 0 0 0 255 ECU_ADDRESS 0x0 /end MEASUREMENT
/begin MEASUREMENT Com_TxSigInfo[132].OnChangeIdxOfTxSigInfo "" UBYTE Com_OnChangeIdxOfTxSigInfoType 0 0 0 255 ECU_ADDRESS 0x0 /end MEASUREMENT
/begin MEASUREMENT Com_TxSigInfo[132].OnChangeOfTxSigInfo "" UBYTE Com_OnChangeOfTxSigInfoType 0 0 0 255 ECU_ADDRESS 0x0 /end MEASUREMENT
/begin MEASUREMENT Com_TxSigInfo[132].StartByteInPduPositionOfTxSigInfo "" UBYTE NO_COMPU_METHOD 0 0 0 255 ECU_ADDRESS 0x0 /end MEASUREMENT
/begin MEASUREMENT Com_TxSigInfo[132].TxAccessInfoIdxOfTxSigInfo "" UWORD NO_COMPU_METHOD 0 0 0 65535 ECU_ADDRESS 0x0 /end MEASUREMENT
/begin MEASUREMENT Com_TxSigInfo[132].TxBufferEndIdxOfTxSigInfo "" UWORD Com_TxBufferEndIdxOfTxSigInfoType 0 0 0 65535 ECU_ADDRESS 0x0 /end MEASUREMENT
/begin MEASUREMENT Com_TxSigInfo[132].TxBufferStartIdxOfTxSigInfo "" UWORD Com_TxBufferStartIdxOfTxSigInfoType 0 0 0 65535 ECU_ADDRESS 0x0 /end MEASUREMENT
/begin MEASUREMENT Com_TxSigInfo[132].TxFilterInitValueArrayBasedFilterInitValueEndIdxOfTxSigInfo "" UBYTE Com_TxFilterInitValueArrayBasedFilterInitValueEndIdxOfTxSigInfoType 0 0 0 255 ECU_ADDRESS 0x0 /end MEASUREMENT
/begin MEASUREMENT Com_TxSigInfo[132].TxFilterInitValueArrayBasedFilterInitValueStartIdxOfTxSigInfo "" UBYTE Com_TxFilterInitValueArrayBasedFilterInitValueStartIdxOfTxSigInfoType 0 0 0 255 ECU_ADDRESS 0x0 /end MEASUREMENT
/begin MEASUREMENT Com_TxSigInfo[132].TxPduInfoIdxOfTxSigInfo "" UBYTE NO_COMPU_METHOD 0 0 0 255 ECU_ADDRESS 0x0 /end MEASUREMENT
/begin MEASUREMENT Com_TxSigInfo[133].ApplTypeOfTxSigInfo "" UBYTE Com_ApplTypeOfTxSigInfoType 0 0 0 255 ECU_ADDRESS 0x0 /end MEASUREMENT
/begin MEASUREMENT Com_TxSigInfo[133].BitLengthOfTxSigInfo "" UWORD NO_COMPU_METHOD 0 0 0 65535 ECU_ADDRESS 0x0 /end MEASUREMENT
/begin MEASUREMENT Com_TxSigInfo[133].BitPositionOfTxSigInfo "" UWORD NO_COMPU_METHOD 0 0 0 65535 ECU_ADDRESS 0x0 /end MEASUREMENT
/begin MEASUREMENT Com_TxSigInfo[133].BusAccOfTxSigInfo "" UBYTE Com_BusAccOfTxSigInfoType 0 0 0 255 ECU_ADDRESS 0x0 /end MEASUREMENT
/begin MEASUREMENT Com_TxSigInfo[133].ByteLengthOfTxSigInfo "" UBYTE NO_COMPU_METHOD 0 0 0 255 ECU_ADDRESS 0x0 /end MEASUREMENT
/begin MEASUREMENT Com_TxSigInfo[133].DynSignalOfTxSigInfo "" UBYTE Com_DynSignalOfTxSigInfoType 0 0 0 1 ECU_ADDRESS 0x0 /end MEASUREMENT
/begin MEASUREMENT Com_TxSigInfo[133].FilterInitValueIdxOfTxSigInfo "" UBYTE Com_FilterInitValueIdxOfTxSigInfoType 0 0 0 255 ECU_ADDRESS 0x0 /end MEASUREMENT
/begin MEASUREMENT Com_TxSigInfo[133].FilterInitValueOfTxSigInfo "" UBYTE Com_FilterInitValueOfTxSigInfoType 0 0 0 255 ECU_ADDRESS 0x0 /end MEASUREMENT
/begin MEASUREMENT Com_TxSigInfo[133].InvValueIdxOfTxSigInfo "" UBYTE Com_InvValueIdxOfTxSigInfoType 0 0 0 255 ECU_ADDRESS 0x0 /end MEASUREMENT
/begin MEASUREMENT Com_TxSigInfo[133].InvValueOfTxSigInfo "" UBYTE Com_InvValueOfTxSigInfoType 0 0 0 255 ECU_ADDRESS 0x0 /end MEASUREMENT
/begin MEASUREMENT Com_TxSigInfo[133].OnChangeIdxOfTxSigInfo "" UBYTE Com_OnChangeIdxOfTxSigInfoType 0 0 0 255 ECU_ADDRESS 0x0 /end MEASUREMENT
/begin MEASUREMENT Com_TxSigInfo[133].OnChangeOfTxSigInfo "" UBYTE Com_OnChangeOfTxSigInfoType 0 0 0 255 ECU_ADDRESS 0x0 /end MEASUREMENT
/begin MEASUREMENT Com_TxSigInfo[133].StartByteInPduPositionOfTxSigInfo "" UBYTE NO_COMPU_METHOD 0 0 0 255 ECU_ADDRESS 0x0 /end MEASUREMENT
/begin MEASUREMENT Com_TxSigInfo[133].TxAccessInfoIdxOfTxSigInfo "" UWORD NO_COMPU_METHOD 0 0 0 65535 ECU_ADDRESS 0x0 /end MEASUREMENT
/begin MEASUREMENT Com_TxSigInfo[133].TxBufferEndIdxOfTxSigInfo "" UWORD Com_TxBufferEndIdxOfTxSigInfoType 0 0 0 65535 ECU_ADDRESS 0x0 /end MEASUREMENT
/begin MEASUREMENT Com_TxSigInfo[133].TxBufferStartIdxOfTxSigInfo "" UWORD Com_TxBufferStartIdxOfTxSigInfoType 0 0 0 65535 ECU_ADDRESS 0x0 /end MEASUREMENT
/begin MEASUREMENT Com_TxSigInfo[133].TxFilterInitValueArrayBasedFilterInitValueEndIdxOfTxSigInfo "" UBYTE Com_TxFilterInitValueArrayBasedFilterInitValueEndIdxOfTxSigInfoType 0 0 0 255 ECU_ADDRESS 0x0 /end MEASUREMENT
/begin MEASUREMENT Com_TxSigInfo[133].TxFilterInitValueArrayBasedFilterInitValueStartIdxOfTxSigInfo "" UBYTE Com_TxFilterInitValueArrayBasedFilterInitValueStartIdxOfTxSigInfoType 0 0 0 255 ECU_ADDRESS 0x0 /end MEASUREMENT
/begin MEASUREMENT Com_TxSigInfo[133].TxPduInfoIdxOfTxSigInfo "" UBYTE NO_COMPU_METHOD 0 0 0 255 ECU_ADDRESS 0x0 /end MEASUREMENT
/begin MEASUREMENT Com_TxSigInfo[134].ApplTypeOfTxSigInfo "" UBYTE Com_ApplTypeOfTxSigInfoType 0 0 0 255 ECU_ADDRESS 0x0 /end MEASUREMENT
/begin MEASUREMENT Com_TxSigInfo[134].BitLengthOfTxSigInfo "" UWORD NO_COMPU_METHOD 0 0 0 65535 ECU_ADDRESS 0x0 /end MEASUREMENT
/begin MEASUREMENT Com_TxSigInfo[134].BitPositionOfTxSigInfo "" UWORD NO_COMPU_METHOD 0 0 0 65535 ECU_ADDRESS 0x0 /end MEASUREMENT
/begin MEASUREMENT Com_TxSigInfo[134].BusAccOfTxSigInfo "" UBYTE Com_BusAccOfTxSigInfoType 0 0 0 255 ECU_ADDRESS 0x0 /end MEASUREMENT
/begin MEASUREMENT Com_TxSigInfo[134].ByteLengthOfTxSigInfo "" UBYTE NO_COMPU_METHOD 0 0 0 255 ECU_ADDRESS 0x0 /end MEASUREMENT
/begin MEASUREMENT Com_TxSigInfo[134].DynSignalOfTxSigInfo "" UBYTE Com_DynSignalOfTxSigInfoType 0 0 0 1 ECU_ADDRESS 0x0 /end MEASUREMENT
/begin MEASUREMENT Com_TxSigInfo[134].FilterInitValueIdxOfTxSigInfo "" UBYTE Com_FilterInitValueIdxOfTxSigInfoType 0 0 0 255 ECU_ADDRESS 0x0 /end MEASUREMENT
/begin MEASUREMENT Com_TxSigInfo[134].FilterInitValueOfTxSigInfo "" UBYTE Com_FilterInitValueOfTxSigInfoType 0 0 0 255 ECU_ADDRESS 0x0 /end MEASUREMENT
/begin MEASUREMENT Com_TxSigInfo[134].InvValueIdxOfTxSigInfo "" UBYTE Com_InvValueIdxOfTxSigInfoType 0 0 0 255 ECU_ADDRESS 0x0 /end MEASUREMENT
/begin MEASUREMENT Com_TxSigInfo[134].InvValueOfTxSigInfo "" UBYTE Com_InvValueOfTxSigInfoType 0 0 0 255 ECU_ADDRESS 0x0 /end MEASUREMENT
/begin MEASUREMENT Com_TxSigInfo[134].OnChangeIdxOfTxSigInfo "" UBYTE Com_OnChangeIdxOfTxSigInfoType 0 0 0 255 ECU_ADDRESS 0x0 /end MEASUREMENT
/begin MEASUREMENT Com_TxSigInfo[134].OnChangeOfTxSigInfo "" UBYTE Com_OnChangeOfTxSigInfoType 0 0 0 255 ECU_ADDRESS 0x0 /end MEASUREMENT
/begin MEASUREMENT Com_TxSigInfo[134].StartByteInPduPositionOfTxSigInfo "" UBYTE NO_COMPU_METHOD 0 0 0 255 ECU_ADDRESS 0x0 /end MEASUREMENT
/begin MEASUREMENT Com_TxSigInfo[134].TxAccessInfoIdxOfTxSigInfo "" UWORD NO_COMPU_METHOD 0 0 0 65535 ECU_ADDRESS 0x0 /end MEASUREMENT
/begin MEASUREMENT Com_TxSigInfo[134].TxBufferEndIdxOfTxSigInfo "" UWORD Com_TxBufferEndIdxOfTxSigInfoType 0 0 0 65535 ECU_ADDRESS 0x0 /end MEASUREMENT
/begin MEASUREMENT Com_TxSigInfo[134].TxBufferStartIdxOfTxSigInfo "" UWORD Com_TxBufferStartIdxOfTxSigInfoType 0 0 0 65535 ECU_ADDRESS 0x0 /end MEASUREMENT
/begin MEASUREMENT Com_TxSigInfo[134].TxFilterInitValueArrayBasedFilterInitValueEndIdxOfTxSigInfo "" UBYTE Com_TxFilterInitValueArrayBasedFilterInitValueEndIdxOfTxSigInfoType 0 0 0 255 ECU_ADDRESS 0x0 /end MEASUREMENT
/begin MEASUREMENT Com_TxSigInfo[134].TxFilterInitValueArrayBasedFilterInitValueStartIdxOfTxSigInfo "" UBYTE Com_TxFilterInitValueArrayBasedFilterInitValueStartIdxOfTxSigInfoType 0 0 0 255 ECU_ADDRESS 0x0 /end MEASUREMENT
/begin MEASUREMENT Com_TxSigInfo[134].TxPduInfoIdxOfTxSigInfo "" UBYTE NO_COMPU_METHOD 0 0 0 255 ECU_ADDRESS 0x0 /end MEASUREMENT
/begin MEASUREMENT Com_TxSigInfo[135].ApplTypeOfTxSigInfo "" UBYTE Com_ApplTypeOfTxSigInfoType 0 0 0 255 ECU_ADDRESS 0x0 /end MEASUREMENT
/begin MEASUREMENT Com_TxSigInfo[135].BitLengthOfTxSigInfo "" UWORD NO_COMPU_METHOD 0 0 0 65535 ECU_ADDRESS 0x0 /end MEASUREMENT
/begin MEASUREMENT Com_TxSigInfo[135].BitPositionOfTxSigInfo "" UWORD NO_COMPU_METHOD 0 0 0 65535 ECU_ADDRESS 0x0 /end MEASUREMENT
/begin MEASUREMENT Com_TxSigInfo[135].BusAccOfTxSigInfo "" UBYTE Com_BusAccOfTxSigInfoType 0 0 0 255 ECU_ADDRESS 0x0 /end MEASUREMENT
/begin MEASUREMENT Com_TxSigInfo[135].ByteLengthOfTxSigInfo "" UBYTE NO_COMPU_METHOD 0 0 0 255 ECU_ADDRESS 0x0 /end MEASUREMENT
/begin MEASUREMENT Com_TxSigInfo[135].DynSignalOfTxSigInfo "" UBYTE Com_DynSignalOfTxSigInfoType 0 0 0 1 ECU_ADDRESS 0x0 /end MEASUREMENT
/begin MEASUREMENT Com_TxSigInfo[135].FilterInitValueIdxOfTxSigInfo "" UBYTE Com_FilterInitValueIdxOfTxSigInfoType 0 0 0 255 ECU_ADDRESS 0x0 /end MEASUREMENT
/begin MEASUREMENT Com_TxSigInfo[135].FilterInitValueOfTxSigInfo "" UBYTE Com_FilterInitValueOfTxSigInfoType 0 0 0 255 ECU_ADDRESS 0x0 /end MEASUREMENT
/begin MEASUREMENT Com_TxSigInfo[135].InvValueIdxOfTxSigInfo "" UBYTE Com_InvValueIdxOfTxSigInfoType 0 0 0 255 ECU_ADDRESS 0x0 /end MEASUREMENT
/begin MEASUREMENT Com_TxSigInfo[135].InvValueOfTxSigInfo "" UBYTE Com_InvValueOfTxSigInfoType 0 0 0 255 ECU_ADDRESS 0x0 /end MEASUREMENT
/begin MEASUREMENT Com_TxSigInfo[135].OnChangeIdxOfTxSigInfo "" UBYTE Com_OnChangeIdxOfTxSigInfoType 0 0 0 255 ECU_ADDRESS 0x0 /end MEASUREMENT
/begin MEASUREMENT Com_TxSigInfo[135].OnChangeOfTxSigInfo "" UBYTE Com_OnChangeOfTxSigInfoType 0 0 0 255 ECU_ADDRESS 0x0 /end MEASUREMENT
/begin MEASUREMENT Com_TxSigInfo[135].StartByteInPduPositionOfTxSigInfo "" UBYTE NO_COMPU_METHOD 0 0 0 255 ECU_ADDRESS 0x0 /end MEASUREMENT
/begin MEASUREMENT Com_TxSigInfo[135].TxAccessInfoIdxOfTxSigInfo "" UWORD NO_COMPU_METHOD 0 0 0 65535 ECU_ADDRESS 0x0 /end MEASUREMENT
/begin MEASUREMENT Com_TxSigInfo[135].TxBufferEndIdxOfTxSigInfo "" UWORD Com_TxBufferEndIdxOfTxSigInfoType 0 0 0 65535 ECU_ADDRESS 0x0 /end MEASUREMENT
/begin MEASUREMENT Com_TxSigInfo[135].TxBufferStartIdxOfTxSigInfo "" UWORD Com_TxBufferStartIdxOfTxSigInfoType 0 0 0 65535 ECU_ADDRESS 0x0 /end MEASUREMENT
/begin MEASUREMENT Com_TxSigInfo[135].TxFilterInitValueArrayBasedFilterInitValueEndIdxOfTxSigInfo "" UBYTE Com_TxFilterInitValueArrayBasedFilterInitValueEndIdxOfTxSigInfoType 0 0 0 255 ECU_ADDRESS 0x0 /end MEASUREMENT
/begin MEASUREMENT Com_TxSigInfo[135].TxFilterInitValueArrayBasedFilterInitValueStartIdxOfTxSigInfo "" UBYTE Com_TxFilterInitValueArrayBasedFilterInitValueStartIdxOfTxSigInfoType 0 0 0 255 ECU_ADDRESS 0x0 /end MEASUREMENT
/begin MEASUREMENT Com_TxSigInfo[135].TxPduInfoIdxOfTxSigInfo "" UBYTE NO_COMPU_METHOD 0 0 0 255 ECU_ADDRESS 0x0 /end MEASUREMENT
/begin MEASUREMENT Com_TxSigInfo[136].ApplTypeOfTxSigInfo "" UBYTE Com_ApplTypeOfTxSigInfoType 0 0 0 255 ECU_ADDRESS 0x0 /end MEASUREMENT
/begin MEASUREMENT Com_TxSigInfo[136].BitLengthOfTxSigInfo "" UWORD NO_COMPU_METHOD 0 0 0 65535 ECU_ADDRESS 0x0 /end MEASUREMENT
/begin MEASUREMENT Com_TxSigInfo[136].BitPositionOfTxSigInfo "" UWORD NO_COMPU_METHOD 0 0 0 65535 ECU_ADDRESS 0x0 /end MEASUREMENT
/begin MEASUREMENT Com_TxSigInfo[136].BusAccOfTxSigInfo "" UBYTE Com_BusAccOfTxSigInfoType 0 0 0 255 ECU_ADDRESS 0x0 /end MEASUREMENT
/begin MEASUREMENT Com_TxSigInfo[136].ByteLengthOfTxSigInfo "" UBYTE NO_COMPU_METHOD 0 0 0 255 ECU_ADDRESS 0x0 /end MEASUREMENT
/begin MEASUREMENT Com_TxSigInfo[136].DynSignalOfTxSigInfo "" UBYTE Com_DynSignalOfTxSigInfoType 0 0 0 1 ECU_ADDRESS 0x0 /end MEASUREMENT
/begin MEASUREMENT Com_TxSigInfo[136].FilterInitValueIdxOfTxSigInfo "" UBYTE Com_FilterInitValueIdxOfTxSigInfoType 0 0 0 255 ECU_ADDRESS 0x0 /end MEASUREMENT
/begin MEASUREMENT Com_TxSigInfo[136].FilterInitValueOfTxSigInfo "" UBYTE Com_FilterInitValueOfTxSigInfoType 0 0 0 255 ECU_ADDRESS 0x0 /end MEASUREMENT
/begin MEASUREMENT Com_TxSigInfo[136].InvValueIdxOfTxSigInfo "" UBYTE Com_InvValueIdxOfTxSigInfoType 0 0 0 255 ECU_ADDRESS 0x0 /end MEASUREMENT
/begin MEASUREMENT Com_TxSigInfo[136].InvValueOfTxSigInfo "" UBYTE Com_InvValueOfTxSigInfoType 0 0 0 255 ECU_ADDRESS 0x0 /end MEASUREMENT
/begin MEASUREMENT Com_TxSigInfo[136].OnChangeIdxOfTxSigInfo "" UBYTE Com_OnChangeIdxOfTxSigInfoType 0 0 0 255 ECU_ADDRESS 0x0 /end MEASUREMENT
/begin MEASUREMENT Com_TxSigInfo[136].OnChangeOfTxSigInfo "" UBYTE Com_OnChangeOfTxSigInfoType 0 0 0 255 ECU_ADDRESS 0x0 /end MEASUREMENT
/begin MEASUREMENT Com_TxSigInfo[136].StartByteInPduPositionOfTxSigInfo "" UBYTE NO_COMPU_METHOD 0 0 0 255 ECU_ADDRESS 0x0 /end MEASUREMENT
/begin MEASUREMENT Com_TxSigInfo[136].TxAccessInfoIdxOfTxSigInfo "" UWORD NO_COMPU_METHOD 0 0 0 65535 ECU_ADDRESS 0x0 /end MEASUREMENT
/begin MEASUREMENT Com_TxSigInfo[136].TxBufferEndIdxOfTxSigInfo "" UWORD Com_TxBufferEndIdxOfTxSigInfoType 0 0 0 65535 ECU_ADDRESS 0x0 /end MEASUREMENT
/begin MEASUREMENT Com_TxSigInfo[136].TxBufferStartIdxOfTxSigInfo "" UWORD Com_TxBufferStartIdxOfTxSigInfoType 0 0 0 65535 ECU_ADDRESS 0x0 /end MEASUREMENT
/begin MEASUREMENT Com_TxSigInfo[136].TxFilterInitValueArrayBasedFilterInitValueEndIdxOfTxSigInfo "" UBYTE Com_TxFilterInitValueArrayBasedFilterInitValueEndIdxOfTxSigInfoType 0 0 0 255 ECU_ADDRESS 0x0 /end MEASUREMENT
/begin MEASUREMENT Com_TxSigInfo[136].TxFilterInitValueArrayBasedFilterInitValueStartIdxOfTxSigInfo "" UBYTE Com_TxFilterInitValueArrayBasedFilterInitValueStartIdxOfTxSigInfoType 0 0 0 255 ECU_ADDRESS 0x0 /end MEASUREMENT
/begin MEASUREMENT Com_TxSigInfo[136].TxPduInfoIdxOfTxSigInfo "" UBYTE NO_COMPU_METHOD 0 0 0 255 ECU_ADDRESS 0x0 /end MEASUREMENT
/begin MEASUREMENT Com_TxSigInfo[137].ApplTypeOfTxSigInfo "" UBYTE Com_ApplTypeOfTxSigInfoType 0 0 0 255 ECU_ADDRESS 0x0 /end MEASUREMENT
/begin MEASUREMENT Com_TxSigInfo[137].BitLengthOfTxSigInfo "" UWORD NO_COMPU_METHOD 0 0 0 65535 ECU_ADDRESS 0x0 /end MEASUREMENT
/begin MEASUREMENT Com_TxSigInfo[137].BitPositionOfTxSigInfo "" UWORD NO_COMPU_METHOD 0 0 0 65535 ECU_ADDRESS 0x0 /end MEASUREMENT
/begin MEASUREMENT Com_TxSigInfo[137].BusAccOfTxSigInfo "" UBYTE Com_BusAccOfTxSigInfoType 0 0 0 255 ECU_ADDRESS 0x0 /end MEASUREMENT
/begin MEASUREMENT Com_TxSigInfo[137].ByteLengthOfTxSigInfo "" UBYTE NO_COMPU_METHOD 0 0 0 255 ECU_ADDRESS 0x0 /end MEASUREMENT
/begin MEASUREMENT Com_TxSigInfo[137].DynSignalOfTxSigInfo "" UBYTE Com_DynSignalOfTxSigInfoType 0 0 0 1 ECU_ADDRESS 0x0 /end MEASUREMENT
/begin MEASUREMENT Com_TxSigInfo[137].FilterInitValueIdxOfTxSigInfo "" UBYTE Com_FilterInitValueIdxOfTxSigInfoType 0 0 0 255 ECU_ADDRESS 0x0 /end MEASUREMENT
/begin MEASUREMENT Com_TxSigInfo[137].FilterInitValueOfTxSigInfo "" UBYTE Com_FilterInitValueOfTxSigInfoType 0 0 0 255 ECU_ADDRESS 0x0 /end MEASUREMENT
/begin MEASUREMENT Com_TxSigInfo[137].InvValueIdxOfTxSigInfo "" UBYTE Com_InvValueIdxOfTxSigInfoType 0 0 0 255 ECU_ADDRESS 0x0 /end MEASUREMENT
/begin MEASUREMENT Com_TxSigInfo[137].InvValueOfTxSigInfo "" UBYTE Com_InvValueOfTxSigInfoType 0 0 0 255 ECU_ADDRESS 0x0 /end MEASUREMENT
/begin MEASUREMENT Com_TxSigInfo[137].OnChangeIdxOfTxSigInfo "" UBYTE Com_OnChangeIdxOfTxSigInfoType 0 0 0 255 ECU_ADDRESS 0x0 /end MEASUREMENT
/begin MEASUREMENT Com_TxSigInfo[137].OnChangeOfTxSigInfo "" UBYTE Com_OnChangeOfTxSigInfoType 0 0 0 255 ECU_ADDRESS 0x0 /end MEASUREMENT
/begin MEASUREMENT Com_TxSigInfo[137].StartByteInPduPositionOfTxSigInfo "" UBYTE NO_COMPU_METHOD 0 0 0 255 ECU_ADDRESS 0x0 /end MEASUREMENT
/begin MEASUREMENT Com_TxSigInfo[137].TxAccessInfoIdxOfTxSigInfo "" UWORD NO_COMPU_METHOD 0 0 0 65535 ECU_ADDRESS 0x0 /end MEASUREMENT
/begin MEASUREMENT Com_TxSigInfo[137].TxBufferEndIdxOfTxSigInfo "" UWORD Com_TxBufferEndIdxOfTxSigInfoType 0 0 0 65535 ECU_ADDRESS 0x0 /end MEASUREMENT
/begin MEASUREMENT Com_TxSigInfo[137].TxBufferStartIdxOfTxSigInfo "" UWORD Com_TxBufferStartIdxOfTxSigInfoType 0 0 0 65535 ECU_ADDRESS 0x0 /end MEASUREMENT
/begin MEASUREMENT Com_TxSigInfo[137].TxFilterInitValueArrayBasedFilterInitValueEndIdxOfTxSigInfo "" UBYTE Com_TxFilterInitValueArrayBasedFilterInitValueEndIdxOfTxSigInfoType 0 0 0 255 ECU_ADDRESS 0x0 /end MEASUREMENT
/begin MEASUREMENT Com_TxSigInfo[137].TxFilterInitValueArrayBasedFilterInitValueStartIdxOfTxSigInfo "" UBYTE Com_TxFilterInitValueArrayBasedFilterInitValueStartIdxOfTxSigInfoType 0 0 0 255 ECU_ADDRESS 0x0 /end MEASUREMENT
/begin MEASUREMENT Com_TxSigInfo[137].TxPduInfoIdxOfTxSigInfo "" UBYTE NO_COMPU_METHOD 0 0 0 255 ECU_ADDRESS 0x0 /end MEASUREMENT
/begin MEASUREMENT Com_TxSigInfo[138].ApplTypeOfTxSigInfo "" UBYTE Com_ApplTypeOfTxSigInfoType 0 0 0 255 ECU_ADDRESS 0x0 /end MEASUREMENT
/begin MEASUREMENT Com_TxSigInfo[138].BitLengthOfTxSigInfo "" UWORD NO_COMPU_METHOD 0 0 0 65535 ECU_ADDRESS 0x0 /end MEASUREMENT
/begin MEASUREMENT Com_TxSigInfo[138].BitPositionOfTxSigInfo "" UWORD NO_COMPU_METHOD 0 0 0 65535 ECU_ADDRESS 0x0 /end MEASUREMENT
/begin MEASUREMENT Com_TxSigInfo[138].BusAccOfTxSigInfo "" UBYTE Com_BusAccOfTxSigInfoType 0 0 0 255 ECU_ADDRESS 0x0 /end MEASUREMENT
/begin MEASUREMENT Com_TxSigInfo[138].ByteLengthOfTxSigInfo "" UBYTE NO_COMPU_METHOD 0 0 0 255 ECU_ADDRESS 0x0 /end MEASUREMENT
/begin MEASUREMENT Com_TxSigInfo[138].DynSignalOfTxSigInfo "" UBYTE Com_DynSignalOfTxSigInfoType 0 0 0 1 ECU_ADDRESS 0x0 /end MEASUREMENT
/begin MEASUREMENT Com_TxSigInfo[138].FilterInitValueIdxOfTxSigInfo "" UBYTE Com_FilterInitValueIdxOfTxSigInfoType 0 0 0 255 ECU_ADDRESS 0x0 /end MEASUREMENT
/begin MEASUREMENT Com_TxSigInfo[138].FilterInitValueOfTxSigInfo "" UBYTE Com_FilterInitValueOfTxSigInfoType 0 0 0 255 ECU_ADDRESS 0x0 /end MEASUREMENT
/begin MEASUREMENT Com_TxSigInfo[138].InvValueIdxOfTxSigInfo "" UBYTE Com_InvValueIdxOfTxSigInfoType 0 0 0 255 ECU_ADDRESS 0x0 /end MEASUREMENT
/begin MEASUREMENT Com_TxSigInfo[138].InvValueOfTxSigInfo "" UBYTE Com_InvValueOfTxSigInfoType 0 0 0 255 ECU_ADDRESS 0x0 /end MEASUREMENT
/begin MEASUREMENT Com_TxSigInfo[138].OnChangeIdxOfTxSigInfo "" UBYTE Com_OnChangeIdxOfTxSigInfoType 0 0 0 255 ECU_ADDRESS 0x0 /end MEASUREMENT
/begin MEASUREMENT Com_TxSigInfo[138].OnChangeOfTxSigInfo "" UBYTE Com_OnChangeOfTxSigInfoType 0 0 0 255 ECU_ADDRESS 0x0 /end MEASUREMENT
/begin MEASUREMENT Com_TxSigInfo[138].StartByteInPduPositionOfTxSigInfo "" UBYTE NO_COMPU_METHOD 0 0 0 255 ECU_ADDRESS 0x0 /end MEASUREMENT
/begin MEASUREMENT Com_TxSigInfo[138].TxAccessInfoIdxOfTxSigInfo "" UWORD NO_COMPU_METHOD 0 0 0 65535 ECU_ADDRESS 0x0 /end MEASUREMENT
/begin MEASUREMENT Com_TxSigInfo[138].TxBufferEndIdxOfTxSigInfo "" UWORD Com_TxBufferEndIdxOfTxSigInfoType 0 0 0 65535 ECU_ADDRESS 0x0 /end MEASUREMENT
/begin MEASUREMENT Com_TxSigInfo[138].TxBufferStartIdxOfTxSigInfo "" UWORD Com_TxBufferStartIdxOfTxSigInfoType 0 0 0 65535 ECU_ADDRESS 0x0 /end MEASUREMENT
/begin MEASUREMENT Com_TxSigInfo[138].TxFilterInitValueArrayBasedFilterInitValueEndIdxOfTxSigInfo "" UBYTE Com_TxFilterInitValueArrayBasedFilterInitValueEndIdxOfTxSigInfoType 0 0 0 255 ECU_ADDRESS 0x0 /end MEASUREMENT
/begin MEASUREMENT Com_TxSigInfo[138].TxFilterInitValueArrayBasedFilterInitValueStartIdxOfTxSigInfo "" UBYTE Com_TxFilterInitValueArrayBasedFilterInitValueStartIdxOfTxSigInfoType 0 0 0 255 ECU_ADDRESS 0x0 /end MEASUREMENT
/begin MEASUREMENT Com_TxSigInfo[138].TxPduInfoIdxOfTxSigInfo "" UBYTE NO_COMPU_METHOD 0 0 0 255 ECU_ADDRESS 0x0 /end MEASUREMENT
/begin MEASUREMENT Com_TxSigInfo[139].ApplTypeOfTxSigInfo "" UBYTE Com_ApplTypeOfTxSigInfoType 0 0 0 255 ECU_ADDRESS 0x0 /end MEASUREMENT
/begin MEASUREMENT Com_TxSigInfo[139].BitLengthOfTxSigInfo "" UWORD NO_COMPU_METHOD 0 0 0 65535 ECU_ADDRESS 0x0 /end MEASUREMENT
/begin MEASUREMENT Com_TxSigInfo[139].BitPositionOfTxSigInfo "" UWORD NO_COMPU_METHOD 0 0 0 65535 ECU_ADDRESS 0x0 /end MEASUREMENT
/begin MEASUREMENT Com_TxSigInfo[139].BusAccOfTxSigInfo "" UBYTE Com_BusAccOfTxSigInfoType 0 0 0 255 ECU_ADDRESS 0x0 /end MEASUREMENT
/begin MEASUREMENT Com_TxSigInfo[139].ByteLengthOfTxSigInfo "" UBYTE NO_COMPU_METHOD 0 0 0 255 ECU_ADDRESS 0x0 /end MEASUREMENT
/begin MEASUREMENT Com_TxSigInfo[139].DynSignalOfTxSigInfo "" UBYTE Com_DynSignalOfTxSigInfoType 0 0 0 1 ECU_ADDRESS 0x0 /end MEASUREMENT
/begin MEASUREMENT Com_TxSigInfo[139].FilterInitValueIdxOfTxSigInfo "" UBYTE Com_FilterInitValueIdxOfTxSigInfoType 0 0 0 255 ECU_ADDRESS 0x0 /end MEASUREMENT
/begin MEASUREMENT Com_TxSigInfo[139].FilterInitValueOfTxSigInfo "" UBYTE Com_FilterInitValueOfTxSigInfoType 0 0 0 255 ECU_ADDRESS 0x0 /end MEASUREMENT
/begin MEASUREMENT Com_TxSigInfo[139].InvValueIdxOfTxSigInfo "" UBYTE Com_InvValueIdxOfTxSigInfoType 0 0 0 255 ECU_ADDRESS 0x0 /end MEASUREMENT
/begin MEASUREMENT Com_TxSigInfo[139].InvValueOfTxSigInfo "" UBYTE Com_InvValueOfTxSigInfoType 0 0 0 255 ECU_ADDRESS 0x0 /end MEASUREMENT
/begin MEASUREMENT Com_TxSigInfo[139].OnChangeIdxOfTxSigInfo "" UBYTE Com_OnChangeIdxOfTxSigInfoType 0 0 0 255 ECU_ADDRESS 0x0 /end MEASUREMENT
/begin MEASUREMENT Com_TxSigInfo[139].OnChangeOfTxSigInfo "" UBYTE Com_OnChangeOfTxSigInfoType 0 0 0 255 ECU_ADDRESS 0x0 /end MEASUREMENT
/begin MEASUREMENT Com_TxSigInfo[139].StartByteInPduPositionOfTxSigInfo "" UBYTE NO_COMPU_METHOD 0 0 0 255 ECU_ADDRESS 0x0 /end MEASUREMENT
/begin MEASUREMENT Com_TxSigInfo[139].TxAccessInfoIdxOfTxSigInfo "" UWORD NO_COMPU_METHOD 0 0 0 65535 ECU_ADDRESS 0x0 /end MEASUREMENT
/begin MEASUREMENT Com_TxSigInfo[139].TxBufferEndIdxOfTxSigInfo "" UWORD Com_TxBufferEndIdxOfTxSigInfoType 0 0 0 65535 ECU_ADDRESS 0x0 /end MEASUREMENT
/begin MEASUREMENT Com_TxSigInfo[139].TxBufferStartIdxOfTxSigInfo "" UWORD Com_TxBufferStartIdxOfTxSigInfoType 0 0 0 65535 ECU_ADDRESS 0x0 /end MEASUREMENT
/begin MEASUREMENT Com_TxSigInfo[139].TxFilterInitValueArrayBasedFilterInitValueEndIdxOfTxSigInfo "" UBYTE Com_TxFilterInitValueArrayBasedFilterInitValueEndIdxOfTxSigInfoType 0 0 0 255 ECU_ADDRESS 0x0 /end MEASUREMENT
/begin MEASUREMENT Com_TxSigInfo[139].TxFilterInitValueArrayBasedFilterInitValueStartIdxOfTxSigInfo "" UBYTE Com_TxFilterInitValueArrayBasedFilterInitValueStartIdxOfTxSigInfoType 0 0 0 255 ECU_ADDRESS 0x0 /end MEASUREMENT
/begin MEASUREMENT Com_TxSigInfo[139].TxPduInfoIdxOfTxSigInfo "" UBYTE NO_COMPU_METHOD 0 0 0 255 ECU_ADDRESS 0x0 /end MEASUREMENT
/begin MEASUREMENT Com_TxSigInfo[13].ApplTypeOfTxSigInfo "" UBYTE Com_ApplTypeOfTxSigInfoType 0 0 0 255 ECU_ADDRESS 0x0 /end MEASUREMENT
/begin MEASUREMENT Com_TxSigInfo[13].BitLengthOfTxSigInfo "" UWORD NO_COMPU_METHOD 0 0 0 65535 ECU_ADDRESS 0x0 /end MEASUREMENT
/begin MEASUREMENT Com_TxSigInfo[13].BitPositionOfTxSigInfo "" UWORD NO_COMPU_METHOD 0 0 0 65535 ECU_ADDRESS 0x0 /end MEASUREMENT
/begin MEASUREMENT Com_TxSigInfo[13].BusAccOfTxSigInfo "" UBYTE Com_BusAccOfTxSigInfoType 0 0 0 255 ECU_ADDRESS 0x0 /end MEASUREMENT
/begin MEASUREMENT Com_TxSigInfo[13].ByteLengthOfTxSigInfo "" UBYTE NO_COMPU_METHOD 0 0 0 255 ECU_ADDRESS 0x0 /end MEASUREMENT
/begin MEASUREMENT Com_TxSigInfo[13].DynSignalOfTxSigInfo "" UBYTE Com_DynSignalOfTxSigInfoType 0 0 0 1 ECU_ADDRESS 0x0 /end MEASUREMENT
/begin MEASUREMENT Com_TxSigInfo[13].FilterInitValueIdxOfTxSigInfo "" UBYTE Com_FilterInitValueIdxOfTxSigInfoType 0 0 0 255 ECU_ADDRESS 0x0 /end MEASUREMENT
/begin MEASUREMENT Com_TxSigInfo[13].FilterInitValueOfTxSigInfo "" UBYTE Com_FilterInitValueOfTxSigInfoType 0 0 0 255 ECU_ADDRESS 0x0 /end MEASUREMENT
/begin MEASUREMENT Com_TxSigInfo[13].InvValueIdxOfTxSigInfo "" UBYTE Com_InvValueIdxOfTxSigInfoType 0 0 0 255 ECU_ADDRESS 0x0 /end MEASUREMENT
/begin MEASUREMENT Com_TxSigInfo[13].InvValueOfTxSigInfo "" UBYTE Com_InvValueOfTxSigInfoType 0 0 0 255 ECU_ADDRESS 0x0 /end MEASUREMENT
/begin MEASUREMENT Com_TxSigInfo[13].OnChangeIdxOfTxSigInfo "" UBYTE Com_OnChangeIdxOfTxSigInfoType 0 0 0 255 ECU_ADDRESS 0x0 /end MEASUREMENT
/begin MEASUREMENT Com_TxSigInfo[13].OnChangeOfTxSigInfo "" UBYTE Com_OnChangeOfTxSigInfoType 0 0 0 255 ECU_ADDRESS 0x0 /end MEASUREMENT
/begin MEASUREMENT Com_TxSigInfo[13].StartByteInPduPositionOfTxSigInfo "" UBYTE NO_COMPU_METHOD 0 0 0 255 ECU_ADDRESS 0x0 /end MEASUREMENT
/begin MEASUREMENT Com_TxSigInfo[13].TxAccessInfoIdxOfTxSigInfo "" UWORD NO_COMPU_METHOD 0 0 0 65535 ECU_ADDRESS 0x0 /end MEASUREMENT
/begin MEASUREMENT Com_TxSigInfo[13].TxBufferEndIdxOfTxSigInfo "" UWORD Com_TxBufferEndIdxOfTxSigInfoType 0 0 0 65535 ECU_ADDRESS 0x0 /end MEASUREMENT
/begin MEASUREMENT Com_TxSigInfo[13].TxBufferStartIdxOfTxSigInfo "" UWORD Com_TxBufferStartIdxOfTxSigInfoType 0 0 0 65535 ECU_ADDRESS 0x0 /end MEASUREMENT
/begin MEASUREMENT Com_TxSigInfo[13].TxFilterInitValueArrayBasedFilterInitValueEndIdxOfTxSigInfo "" UBYTE Com_TxFilterInitValueArrayBasedFilterInitValueEndIdxOfTxSigInfoType 0 0 0 255 ECU_ADDRESS 0x0 /end MEASUREMENT
/begin MEASUREMENT Com_TxSigInfo[13].TxFilterInitValueArrayBasedFilterInitValueStartIdxOfTxSigInfo "" UBYTE Com_TxFilterInitValueArrayBasedFilterInitValueStartIdxOfTxSigInfoType 0 0 0 255 ECU_ADDRESS 0x0 /end MEASUREMENT
/begin MEASUREMENT Com_TxSigInfo[13].TxPduInfoIdxOfTxSigInfo "" UBYTE NO_COMPU_METHOD 0 0 0 255 ECU_ADDRESS 0x0 /end MEASUREMENT
/begin MEASUREMENT Com_TxSigInfo[140].ApplTypeOfTxSigInfo "" UBYTE Com_ApplTypeOfTxSigInfoType 0 0 0 255 ECU_ADDRESS 0x0 /end MEASUREMENT
/begin MEASUREMENT Com_TxSigInfo[140].BitLengthOfTxSigInfo "" UWORD NO_COMPU_METHOD 0 0 0 65535 ECU_ADDRESS 0x0 /end MEASUREMENT
/begin MEASUREMENT Com_TxSigInfo[140].BitPositionOfTxSigInfo "" UWORD NO_COMPU_METHOD 0 0 0 65535 ECU_ADDRESS 0x0 /end MEASUREMENT
/begin MEASUREMENT Com_TxSigInfo[140].BusAccOfTxSigInfo "" UBYTE Com_BusAccOfTxSigInfoType 0 0 0 255 ECU_ADDRESS 0x0 /end MEASUREMENT
/begin MEASUREMENT Com_TxSigInfo[140].ByteLengthOfTxSigInfo "" UBYTE NO_COMPU_METHOD 0 0 0 255 ECU_ADDRESS 0x0 /end MEASUREMENT
/begin MEASUREMENT Com_TxSigInfo[140].DynSignalOfTxSigInfo "" UBYTE Com_DynSignalOfTxSigInfoType 0 0 0 1 ECU_ADDRESS 0x0 /end MEASUREMENT
/begin MEASUREMENT Com_TxSigInfo[140].FilterInitValueIdxOfTxSigInfo "" UBYTE Com_FilterInitValueIdxOfTxSigInfoType 0 0 0 255 ECU_ADDRESS 0x0 /end MEASUREMENT
/begin MEASUREMENT Com_TxSigInfo[140].FilterInitValueOfTxSigInfo "" UBYTE Com_FilterInitValueOfTxSigInfoType 0 0 0 255 ECU_ADDRESS 0x0 /end MEASUREMENT
/begin MEASUREMENT Com_TxSigInfo[140].InvValueIdxOfTxSigInfo "" UBYTE Com_InvValueIdxOfTxSigInfoType 0 0 0 255 ECU_ADDRESS 0x0 /end MEASUREMENT
/begin MEASUREMENT Com_TxSigInfo[140].InvValueOfTxSigInfo "" UBYTE Com_InvValueOfTxSigInfoType 0 0 0 255 ECU_ADDRESS 0x0 /end MEASUREMENT
/begin MEASUREMENT Com_TxSigInfo[140].OnChangeIdxOfTxSigInfo "" UBYTE Com_OnChangeIdxOfTxSigInfoType 0 0 0 255 ECU_ADDRESS 0x0 /end MEASUREMENT
/begin MEASUREMENT Com_TxSigInfo[140].OnChangeOfTxSigInfo "" UBYTE Com_OnChangeOfTxSigInfoType 0 0 0 255 ECU_ADDRESS 0x0 /end MEASUREMENT
/begin MEASUREMENT Com_TxSigInfo[140].StartByteInPduPositionOfTxSigInfo "" UBYTE NO_COMPU_METHOD 0 0 0 255 ECU_ADDRESS 0x0 /end MEASUREMENT
/begin MEASUREMENT Com_TxSigInfo[140].TxAccessInfoIdxOfTxSigInfo "" UWORD NO_COMPU_METHOD 0 0 0 65535 ECU_ADDRESS 0x0 /end MEASUREMENT
/begin MEASUREMENT Com_TxSigInfo[140].TxBufferEndIdxOfTxSigInfo "" UWORD Com_TxBufferEndIdxOfTxSigInfoType 0 0 0 65535 ECU_ADDRESS 0x0 /end MEASUREMENT
/begin MEASUREMENT Com_TxSigInfo[140].TxBufferStartIdxOfTxSigInfo "" UWORD Com_TxBufferStartIdxOfTxSigInfoType 0 0 0 65535 ECU_ADDRESS 0x0 /end MEASUREMENT
/begin MEASUREMENT Com_TxSigInfo[140].TxFilterInitValueArrayBasedFilterInitValueEndIdxOfTxSigInfo "" UBYTE Com_TxFilterInitValueArrayBasedFilterInitValueEndIdxOfTxSigInfoType 0 0 0 255 ECU_ADDRESS 0x0 /end MEASUREMENT
/begin MEASUREMENT Com_TxSigInfo[140].TxFilterInitValueArrayBasedFilterInitValueStartIdxOfTxSigInfo "" UBYTE Com_TxFilterInitValueArrayBasedFilterInitValueStartIdxOfTxSigInfoType 0 0 0 255 ECU_ADDRESS 0x0 /end MEASUREMENT
/begin MEASUREMENT Com_TxSigInfo[140].TxPduInfoIdxOfTxSigInfo "" UBYTE NO_COMPU_METHOD 0 0 0 255 ECU_ADDRESS 0x0 /end MEASUREMENT
/begin MEASUREMENT Com_TxSigInfo[141].ApplTypeOfTxSigInfo "" UBYTE Com_ApplTypeOfTxSigInfoType 0 0 0 255 ECU_ADDRESS 0x0 /end MEASUREMENT
/begin MEASUREMENT Com_TxSigInfo[141].BitLengthOfTxSigInfo "" UWORD NO_COMPU_METHOD 0 0 0 65535 ECU_ADDRESS 0x0 /end MEASUREMENT
/begin MEASUREMENT Com_TxSigInfo[141].BitPositionOfTxSigInfo "" UWORD NO_COMPU_METHOD 0 0 0 65535 ECU_ADDRESS 0x0 /end MEASUREMENT
/begin MEASUREMENT Com_TxSigInfo[141].BusAccOfTxSigInfo "" UBYTE Com_BusAccOfTxSigInfoType 0 0 0 255 ECU_ADDRESS 0x0 /end MEASUREMENT
/begin MEASUREMENT Com_TxSigInfo[141].ByteLengthOfTxSigInfo "" UBYTE NO_COMPU_METHOD 0 0 0 255 ECU_ADDRESS 0x0 /end MEASUREMENT
/begin MEASUREMENT Com_TxSigInfo[141].DynSignalOfTxSigInfo "" UBYTE Com_DynSignalOfTxSigInfoType 0 0 0 1 ECU_ADDRESS 0x0 /end MEASUREMENT
/begin MEASUREMENT Com_TxSigInfo[141].FilterInitValueIdxOfTxSigInfo "" UBYTE Com_FilterInitValueIdxOfTxSigInfoType 0 0 0 255 ECU_ADDRESS 0x0 /end MEASUREMENT
/begin MEASUREMENT Com_TxSigInfo[141].FilterInitValueOfTxSigInfo "" UBYTE Com_FilterInitValueOfTxSigInfoType 0 0 0 255 ECU_ADDRESS 0x0 /end MEASUREMENT
/begin MEASUREMENT Com_TxSigInfo[141].InvValueIdxOfTxSigInfo "" UBYTE Com_InvValueIdxOfTxSigInfoType 0 0 0 255 ECU_ADDRESS 0x0 /end MEASUREMENT
/begin MEASUREMENT Com_TxSigInfo[141].InvValueOfTxSigInfo "" UBYTE Com_InvValueOfTxSigInfoType 0 0 0 255 ECU_ADDRESS 0x0 /end MEASUREMENT
/begin MEASUREMENT Com_TxSigInfo[141].OnChangeIdxOfTxSigInfo "" UBYTE Com_OnChangeIdxOfTxSigInfoType 0 0 0 255 ECU_ADDRESS 0x0 /end MEASUREMENT
/begin MEASUREMENT Com_TxSigInfo[141].OnChangeOfTxSigInfo "" UBYTE Com_OnChangeOfTxSigInfoType 0 0 0 255 ECU_ADDRESS 0x0 /end MEASUREMENT
/begin MEASUREMENT Com_TxSigInfo[141].StartByteInPduPositionOfTxSigInfo "" UBYTE NO_COMPU_METHOD 0 0 0 255 ECU_ADDRESS 0x0 /end MEASUREMENT
/begin MEASUREMENT Com_TxSigInfo[141].TxAccessInfoIdxOfTxSigInfo "" UWORD NO_COMPU_METHOD 0 0 0 65535 ECU_ADDRESS 0x0 /end MEASUREMENT
/begin MEASUREMENT Com_TxSigInfo[141].TxBufferEndIdxOfTxSigInfo "" UWORD Com_TxBufferEndIdxOfTxSigInfoType 0 0 0 65535 ECU_ADDRESS 0x0 /end MEASUREMENT
/begin MEASUREMENT Com_TxSigInfo[141].TxBufferStartIdxOfTxSigInfo "" UWORD Com_TxBufferStartIdxOfTxSigInfoType 0 0 0 65535 ECU_ADDRESS 0x0 /end MEASUREMENT
/begin MEASUREMENT Com_TxSigInfo[141].TxFilterInitValueArrayBasedFilterInitValueEndIdxOfTxSigInfo "" UBYTE Com_TxFilterInitValueArrayBasedFilterInitValueEndIdxOfTxSigInfoType 0 0 0 255 ECU_ADDRESS 0x0 /end MEASUREMENT
/begin MEASUREMENT Com_TxSigInfo[141].TxFilterInitValueArrayBasedFilterInitValueStartIdxOfTxSigInfo "" UBYTE Com_TxFilterInitValueArrayBasedFilterInitValueStartIdxOfTxSigInfoType 0 0 0 255 ECU_ADDRESS 0x0 /end MEASUREMENT
/begin MEASUREMENT Com_TxSigInfo[141].TxPduInfoIdxOfTxSigInfo "" UBYTE NO_COMPU_METHOD 0 0 0 255 ECU_ADDRESS 0x0 /end MEASUREMENT
/begin MEASUREMENT Com_TxSigInfo[142].ApplTypeOfTxSigInfo "" UBYTE Com_ApplTypeOfTxSigInfoType 0 0 0 255 ECU_ADDRESS 0x0 /end MEASUREMENT
/begin MEASUREMENT Com_TxSigInfo[142].BitLengthOfTxSigInfo "" UWORD NO_COMPU_METHOD 0 0 0 65535 ECU_ADDRESS 0x0 /end MEASUREMENT
/begin MEASUREMENT Com_TxSigInfo[142].BitPositionOfTxSigInfo "" UWORD NO_COMPU_METHOD 0 0 0 65535 ECU_ADDRESS 0x0 /end MEASUREMENT
/begin MEASUREMENT Com_TxSigInfo[142].BusAccOfTxSigInfo "" UBYTE Com_BusAccOfTxSigInfoType 0 0 0 255 ECU_ADDRESS 0x0 /end MEASUREMENT
/begin MEASUREMENT Com_TxSigInfo[142].ByteLengthOfTxSigInfo "" UBYTE NO_COMPU_METHOD 0 0 0 255 ECU_ADDRESS 0x0 /end MEASUREMENT
/begin MEASUREMENT Com_TxSigInfo[142].DynSignalOfTxSigInfo "" UBYTE Com_DynSignalOfTxSigInfoType 0 0 0 1 ECU_ADDRESS 0x0 /end MEASUREMENT
/begin MEASUREMENT Com_TxSigInfo[142].FilterInitValueIdxOfTxSigInfo "" UBYTE Com_FilterInitValueIdxOfTxSigInfoType 0 0 0 255 ECU_ADDRESS 0x0 /end MEASUREMENT
/begin MEASUREMENT Com_TxSigInfo[142].FilterInitValueOfTxSigInfo "" UBYTE Com_FilterInitValueOfTxSigInfoType 0 0 0 255 ECU_ADDRESS 0x0 /end MEASUREMENT
/begin MEASUREMENT Com_TxSigInfo[142].InvValueIdxOfTxSigInfo "" UBYTE Com_InvValueIdxOfTxSigInfoType 0 0 0 255 ECU_ADDRESS 0x0 /end MEASUREMENT
/begin MEASUREMENT Com_TxSigInfo[142].InvValueOfTxSigInfo "" UBYTE Com_InvValueOfTxSigInfoType 0 0 0 255 ECU_ADDRESS 0x0 /end MEASUREMENT
/begin MEASUREMENT Com_TxSigInfo[142].OnChangeIdxOfTxSigInfo "" UBYTE Com_OnChangeIdxOfTxSigInfoType 0 0 0 255 ECU_ADDRESS 0x0 /end MEASUREMENT
/begin MEASUREMENT Com_TxSigInfo[142].OnChangeOfTxSigInfo "" UBYTE Com_OnChangeOfTxSigInfoType 0 0 0 255 ECU_ADDRESS 0x0 /end MEASUREMENT
/begin MEASUREMENT Com_TxSigInfo[142].StartByteInPduPositionOfTxSigInfo "" UBYTE NO_COMPU_METHOD 0 0 0 255 ECU_ADDRESS 0x0 /end MEASUREMENT
/begin MEASUREMENT Com_TxSigInfo[142].TxAccessInfoIdxOfTxSigInfo "" UWORD NO_COMPU_METHOD 0 0 0 65535 ECU_ADDRESS 0x0 /end MEASUREMENT
/begin MEASUREMENT Com_TxSigInfo[142].TxBufferEndIdxOfTxSigInfo "" UWORD Com_TxBufferEndIdxOfTxSigInfoType 0 0 0 65535 ECU_ADDRESS 0x0 /end MEASUREMENT
/begin MEASUREMENT Com_TxSigInfo[142].TxBufferStartIdxOfTxSigInfo "" UWORD Com_TxBufferStartIdxOfTxSigInfoType 0 0 0 65535 ECU_ADDRESS 0x0 /end MEASUREMENT
/begin MEASUREMENT Com_TxSigInfo[142].TxFilterInitValueArrayBasedFilterInitValueEndIdxOfTxSigInfo "" UBYTE Com_TxFilterInitValueArrayBasedFilterInitValueEndIdxOfTxSigInfoType 0 0 0 255 ECU_ADDRESS 0x0 /end MEASUREMENT
/begin MEASUREMENT Com_TxSigInfo[142].TxFilterInitValueArrayBasedFilterInitValueStartIdxOfTxSigInfo "" UBYTE Com_TxFilterInitValueArrayBasedFilterInitValueStartIdxOfTxSigInfoType 0 0 0 255 ECU_ADDRESS 0x0 /end MEASUREMENT
/begin MEASUREMENT Com_TxSigInfo[142].TxPduInfoIdxOfTxSigInfo "" UBYTE NO_COMPU_METHOD 0 0 0 255 ECU_ADDRESS 0x0 /end MEASUREMENT
/begin MEASUREMENT Com_TxSigInfo[143].ApplTypeOfTxSigInfo "" UBYTE Com_ApplTypeOfTxSigInfoType 0 0 0 255 ECU_ADDRESS 0x0 /end MEASUREMENT
/begin MEASUREMENT Com_TxSigInfo[143].BitLengthOfTxSigInfo "" UWORD NO_COMPU_METHOD 0 0 0 65535 ECU_ADDRESS 0x0 /end MEASUREMENT
/begin MEASUREMENT Com_TxSigInfo[143].BitPositionOfTxSigInfo "" UWORD NO_COMPU_METHOD 0 0 0 65535 ECU_ADDRESS 0x0 /end MEASUREMENT
/begin MEASUREMENT Com_TxSigInfo[143].BusAccOfTxSigInfo "" UBYTE Com_BusAccOfTxSigInfoType 0 0 0 255 ECU_ADDRESS 0x0 /end MEASUREMENT
/begin MEASUREMENT Com_TxSigInfo[143].ByteLengthOfTxSigInfo "" UBYTE NO_COMPU_METHOD 0 0 0 255 ECU_ADDRESS 0x0 /end MEASUREMENT
/begin MEASUREMENT Com_TxSigInfo[143].DynSignalOfTxSigInfo "" UBYTE Com_DynSignalOfTxSigInfoType 0 0 0 1 ECU_ADDRESS 0x0 /end MEASUREMENT
/begin MEASUREMENT Com_TxSigInfo[143].FilterInitValueIdxOfTxSigInfo "" UBYTE Com_FilterInitValueIdxOfTxSigInfoType 0 0 0 255 ECU_ADDRESS 0x0 /end MEASUREMENT
/begin MEASUREMENT Com_TxSigInfo[143].FilterInitValueOfTxSigInfo "" UBYTE Com_FilterInitValueOfTxSigInfoType 0 0 0 255 ECU_ADDRESS 0x0 /end MEASUREMENT
/begin MEASUREMENT Com_TxSigInfo[143].InvValueIdxOfTxSigInfo "" UBYTE Com_InvValueIdxOfTxSigInfoType 0 0 0 255 ECU_ADDRESS 0x0 /end MEASUREMENT
/begin MEASUREMENT Com_TxSigInfo[143].InvValueOfTxSigInfo "" UBYTE Com_InvValueOfTxSigInfoType 0 0 0 255 ECU_ADDRESS 0x0 /end MEASUREMENT
/begin MEASUREMENT Com_TxSigInfo[143].OnChangeIdxOfTxSigInfo "" UBYTE Com_OnChangeIdxOfTxSigInfoType 0 0 0 255 ECU_ADDRESS 0x0 /end MEASUREMENT
/begin MEASUREMENT Com_TxSigInfo[143].OnChangeOfTxSigInfo "" UBYTE Com_OnChangeOfTxSigInfoType 0 0 0 255 ECU_ADDRESS 0x0 /end MEASUREMENT
/begin MEASUREMENT Com_TxSigInfo[143].StartByteInPduPositionOfTxSigInfo "" UBYTE NO_COMPU_METHOD 0 0 0 255 ECU_ADDRESS 0x0 /end MEASUREMENT
/begin MEASUREMENT Com_TxSigInfo[143].TxAccessInfoIdxOfTxSigInfo "" UWORD NO_COMPU_METHOD 0 0 0 65535 ECU_ADDRESS 0x0 /end MEASUREMENT
/begin MEASUREMENT Com_TxSigInfo[143].TxBufferEndIdxOfTxSigInfo "" UWORD Com_TxBufferEndIdxOfTxSigInfoType 0 0 0 65535 ECU_ADDRESS 0x0 /end MEASUREMENT
/begin MEASUREMENT Com_TxSigInfo[143].TxBufferStartIdxOfTxSigInfo "" UWORD Com_TxBufferStartIdxOfTxSigInfoType 0 0 0 65535 ECU_ADDRESS 0x0 /end MEASUREMENT
/begin MEASUREMENT Com_TxSigInfo[143].TxFilterInitValueArrayBasedFilterInitValueEndIdxOfTxSigInfo "" UBYTE Com_TxFilterInitValueArrayBasedFilterInitValueEndIdxOfTxSigInfoType 0 0 0 255 ECU_ADDRESS 0x0 /end MEASUREMENT
/begin MEASUREMENT Com_TxSigInfo[143].TxFilterInitValueArrayBasedFilterInitValueStartIdxOfTxSigInfo "" UBYTE Com_TxFilterInitValueArrayBasedFilterInitValueStartIdxOfTxSigInfoType 0 0 0 255 ECU_ADDRESS 0x0 /end MEASUREMENT
/begin MEASUREMENT Com_TxSigInfo[143].TxPduInfoIdxOfTxSigInfo "" UBYTE NO_COMPU_METHOD 0 0 0 255 ECU_ADDRESS 0x0 /end MEASUREMENT
/begin MEASUREMENT Com_TxSigInfo[144].ApplTypeOfTxSigInfo "" UBYTE Com_ApplTypeOfTxSigInfoType 0 0 0 255 ECU_ADDRESS 0x0 /end MEASUREMENT
/begin MEASUREMENT Com_TxSigInfo[144].BitLengthOfTxSigInfo "" UWORD NO_COMPU_METHOD 0 0 0 65535 ECU_ADDRESS 0x0 /end MEASUREMENT
/begin MEASUREMENT Com_TxSigInfo[144].BitPositionOfTxSigInfo "" UWORD NO_COMPU_METHOD 0 0 0 65535 ECU_ADDRESS 0x0 /end MEASUREMENT
/begin MEASUREMENT Com_TxSigInfo[144].BusAccOfTxSigInfo "" UBYTE Com_BusAccOfTxSigInfoType 0 0 0 255 ECU_ADDRESS 0x0 /end MEASUREMENT
/begin MEASUREMENT Com_TxSigInfo[144].ByteLengthOfTxSigInfo "" UBYTE NO_COMPU_METHOD 0 0 0 255 ECU_ADDRESS 0x0 /end MEASUREMENT
/begin MEASUREMENT Com_TxSigInfo[144].DynSignalOfTxSigInfo "" UBYTE Com_DynSignalOfTxSigInfoType 0 0 0 1 ECU_ADDRESS 0x0 /end MEASUREMENT
/begin MEASUREMENT Com_TxSigInfo[144].FilterInitValueIdxOfTxSigInfo "" UBYTE Com_FilterInitValueIdxOfTxSigInfoType 0 0 0 255 ECU_ADDRESS 0x0 /end MEASUREMENT
/begin MEASUREMENT Com_TxSigInfo[144].FilterInitValueOfTxSigInfo "" UBYTE Com_FilterInitValueOfTxSigInfoType 0 0 0 255 ECU_ADDRESS 0x0 /end MEASUREMENT
/begin MEASUREMENT Com_TxSigInfo[144].InvValueIdxOfTxSigInfo "" UBYTE Com_InvValueIdxOfTxSigInfoType 0 0 0 255 ECU_ADDRESS 0x0 /end MEASUREMENT
/begin MEASUREMENT Com_TxSigInfo[144].InvValueOfTxSigInfo "" UBYTE Com_InvValueOfTxSigInfoType 0 0 0 255 ECU_ADDRESS 0x0 /end MEASUREMENT
/begin MEASUREMENT Com_TxSigInfo[144].OnChangeIdxOfTxSigInfo "" UBYTE Com_OnChangeIdxOfTxSigInfoType 0 0 0 255 ECU_ADDRESS 0x0 /end MEASUREMENT
/begin MEASUREMENT Com_TxSigInfo[144].OnChangeOfTxSigInfo "" UBYTE Com_OnChangeOfTxSigInfoType 0 0 0 255 ECU_ADDRESS 0x0 /end MEASUREMENT
/begin MEASUREMENT Com_TxSigInfo[144].StartByteInPduPositionOfTxSigInfo "" UBYTE NO_COMPU_METHOD 0 0 0 255 ECU_ADDRESS 0x0 /end MEASUREMENT
/begin MEASUREMENT Com_TxSigInfo[144].TxAccessInfoIdxOfTxSigInfo "" UWORD NO_COMPU_METHOD 0 0 0 65535 ECU_ADDRESS 0x0 /end MEASUREMENT
/begin MEASUREMENT Com_TxSigInfo[144].TxBufferEndIdxOfTxSigInfo "" UWORD Com_TxBufferEndIdxOfTxSigInfoType 0 0 0 65535 ECU_ADDRESS 0x0 /end MEASUREMENT
/begin MEASUREMENT Com_TxSigInfo[144].TxBufferStartIdxOfTxSigInfo "" UWORD Com_TxBufferStartIdxOfTxSigInfoType 0 0 0 65535 ECU_ADDRESS 0x0 /end MEASUREMENT
/begin MEASUREMENT Com_TxSigInfo[144].TxFilterInitValueArrayBasedFilterInitValueEndIdxOfTxSigInfo "" UBYTE Com_TxFilterInitValueArrayBasedFilterInitValueEndIdxOfTxSigInfoType 0 0 0 255 ECU_ADDRESS 0x0 /end MEASUREMENT
/begin MEASUREMENT Com_TxSigInfo[144].TxFilterInitValueArrayBasedFilterInitValueStartIdxOfTxSigInfo "" UBYTE Com_TxFilterInitValueArrayBasedFilterInitValueStartIdxOfTxSigInfoType 0 0 0 255 ECU_ADDRESS 0x0 /end MEASUREMENT
/begin MEASUREMENT Com_TxSigInfo[144].TxPduInfoIdxOfTxSigInfo "" UBYTE NO_COMPU_METHOD 0 0 0 255 ECU_ADDRESS 0x0 /end MEASUREMENT
/begin MEASUREMENT Com_TxSigInfo[145].ApplTypeOfTxSigInfo "" UBYTE Com_ApplTypeOfTxSigInfoType 0 0 0 255 ECU_ADDRESS 0x0 /end MEASUREMENT
/begin MEASUREMENT Com_TxSigInfo[145].BitLengthOfTxSigInfo "" UWORD NO_COMPU_METHOD 0 0 0 65535 ECU_ADDRESS 0x0 /end MEASUREMENT
/begin MEASUREMENT Com_TxSigInfo[145].BitPositionOfTxSigInfo "" UWORD NO_COMPU_METHOD 0 0 0 65535 ECU_ADDRESS 0x0 /end MEASUREMENT
/begin MEASUREMENT Com_TxSigInfo[145].BusAccOfTxSigInfo "" UBYTE Com_BusAccOfTxSigInfoType 0 0 0 255 ECU_ADDRESS 0x0 /end MEASUREMENT
/begin MEASUREMENT Com_TxSigInfo[145].ByteLengthOfTxSigInfo "" UBYTE NO_COMPU_METHOD 0 0 0 255 ECU_ADDRESS 0x0 /end MEASUREMENT
/begin MEASUREMENT Com_TxSigInfo[145].DynSignalOfTxSigInfo "" UBYTE Com_DynSignalOfTxSigInfoType 0 0 0 1 ECU_ADDRESS 0x0 /end MEASUREMENT
/begin MEASUREMENT Com_TxSigInfo[145].FilterInitValueIdxOfTxSigInfo "" UBYTE Com_FilterInitValueIdxOfTxSigInfoType 0 0 0 255 ECU_ADDRESS 0x0 /end MEASUREMENT
/begin MEASUREMENT Com_TxSigInfo[145].FilterInitValueOfTxSigInfo "" UBYTE Com_FilterInitValueOfTxSigInfoType 0 0 0 255 ECU_ADDRESS 0x0 /end MEASUREMENT
/begin MEASUREMENT Com_TxSigInfo[145].InvValueIdxOfTxSigInfo "" UBYTE Com_InvValueIdxOfTxSigInfoType 0 0 0 255 ECU_ADDRESS 0x0 /end MEASUREMENT
/begin MEASUREMENT Com_TxSigInfo[145].InvValueOfTxSigInfo "" UBYTE Com_InvValueOfTxSigInfoType 0 0 0 255 ECU_ADDRESS 0x0 /end MEASUREMENT
/begin MEASUREMENT Com_TxSigInfo[145].OnChangeIdxOfTxSigInfo "" UBYTE Com_OnChangeIdxOfTxSigInfoType 0 0 0 255 ECU_ADDRESS 0x0 /end MEASUREMENT
/begin MEASUREMENT Com_TxSigInfo[145].OnChangeOfTxSigInfo "" UBYTE Com_OnChangeOfTxSigInfoType 0 0 0 255 ECU_ADDRESS 0x0 /end MEASUREMENT
/begin MEASUREMENT Com_TxSigInfo[145].StartByteInPduPositionOfTxSigInfo "" UBYTE NO_COMPU_METHOD 0 0 0 255 ECU_ADDRESS 0x0 /end MEASUREMENT
/begin MEASUREMENT Com_TxSigInfo[145].TxAccessInfoIdxOfTxSigInfo "" UWORD NO_COMPU_METHOD 0 0 0 65535 ECU_ADDRESS 0x0 /end MEASUREMENT
/begin MEASUREMENT Com_TxSigInfo[145].TxBufferEndIdxOfTxSigInfo "" UWORD Com_TxBufferEndIdxOfTxSigInfoType 0 0 0 65535 ECU_ADDRESS 0x0 /end MEASUREMENT
/begin MEASUREMENT Com_TxSigInfo[145].TxBufferStartIdxOfTxSigInfo "" UWORD Com_TxBufferStartIdxOfTxSigInfoType 0 0 0 65535 ECU_ADDRESS 0x0 /end MEASUREMENT
/begin MEASUREMENT Com_TxSigInfo[145].TxFilterInitValueArrayBasedFilterInitValueEndIdxOfTxSigInfo "" UBYTE Com_TxFilterInitValueArrayBasedFilterInitValueEndIdxOfTxSigInfoType 0 0 0 255 ECU_ADDRESS 0x0 /end MEASUREMENT
/begin MEASUREMENT Com_TxSigInfo[145].TxFilterInitValueArrayBasedFilterInitValueStartIdxOfTxSigInfo "" UBYTE Com_TxFilterInitValueArrayBasedFilterInitValueStartIdxOfTxSigInfoType 0 0 0 255 ECU_ADDRESS 0x0 /end MEASUREMENT
/begin MEASUREMENT Com_TxSigInfo[145].TxPduInfoIdxOfTxSigInfo "" UBYTE NO_COMPU_METHOD 0 0 0 255 ECU_ADDRESS 0x0 /end MEASUREMENT
/begin MEASUREMENT Com_TxSigInfo[146].ApplTypeOfTxSigInfo "" UBYTE Com_ApplTypeOfTxSigInfoType 0 0 0 255 ECU_ADDRESS 0x0 /end MEASUREMENT
/begin MEASUREMENT Com_TxSigInfo[146].BitLengthOfTxSigInfo "" UWORD NO_COMPU_METHOD 0 0 0 65535 ECU_ADDRESS 0x0 /end MEASUREMENT
/begin MEASUREMENT Com_TxSigInfo[146].BitPositionOfTxSigInfo "" UWORD NO_COMPU_METHOD 0 0 0 65535 ECU_ADDRESS 0x0 /end MEASUREMENT
/begin MEASUREMENT Com_TxSigInfo[146].BusAccOfTxSigInfo "" UBYTE Com_BusAccOfTxSigInfoType 0 0 0 255 ECU_ADDRESS 0x0 /end MEASUREMENT
/begin MEASUREMENT Com_TxSigInfo[146].ByteLengthOfTxSigInfo "" UBYTE NO_COMPU_METHOD 0 0 0 255 ECU_ADDRESS 0x0 /end MEASUREMENT
/begin MEASUREMENT Com_TxSigInfo[146].DynSignalOfTxSigInfo "" UBYTE Com_DynSignalOfTxSigInfoType 0 0 0 1 ECU_ADDRESS 0x0 /end MEASUREMENT
/begin MEASUREMENT Com_TxSigInfo[146].FilterInitValueIdxOfTxSigInfo "" UBYTE Com_FilterInitValueIdxOfTxSigInfoType 0 0 0 255 ECU_ADDRESS 0x0 /end MEASUREMENT
/begin MEASUREMENT Com_TxSigInfo[146].FilterInitValueOfTxSigInfo "" UBYTE Com_FilterInitValueOfTxSigInfoType 0 0 0 255 ECU_ADDRESS 0x0 /end MEASUREMENT
/begin MEASUREMENT Com_TxSigInfo[146].InvValueIdxOfTxSigInfo "" UBYTE Com_InvValueIdxOfTxSigInfoType 0 0 0 255 ECU_ADDRESS 0x0 /end MEASUREMENT
/begin MEASUREMENT Com_TxSigInfo[146].InvValueOfTxSigInfo "" UBYTE Com_InvValueOfTxSigInfoType 0 0 0 255 ECU_ADDRESS 0x0 /end MEASUREMENT
/begin MEASUREMENT Com_TxSigInfo[146].OnChangeIdxOfTxSigInfo "" UBYTE Com_OnChangeIdxOfTxSigInfoType 0 0 0 255 ECU_ADDRESS 0x0 /end MEASUREMENT
/begin MEASUREMENT Com_TxSigInfo[146].OnChangeOfTxSigInfo "" UBYTE Com_OnChangeOfTxSigInfoType 0 0 0 255 ECU_ADDRESS 0x0 /end MEASUREMENT
/begin MEASUREMENT Com_TxSigInfo[146].StartByteInPduPositionOfTxSigInfo "" UBYTE NO_COMPU_METHOD 0 0 0 255 ECU_ADDRESS 0x0 /end MEASUREMENT
/begin MEASUREMENT Com_TxSigInfo[146].TxAccessInfoIdxOfTxSigInfo "" UWORD NO_COMPU_METHOD 0 0 0 65535 ECU_ADDRESS 0x0 /end MEASUREMENT
/begin MEASUREMENT Com_TxSigInfo[146].TxBufferEndIdxOfTxSigInfo "" UWORD Com_TxBufferEndIdxOfTxSigInfoType 0 0 0 65535 ECU_ADDRESS 0x0 /end MEASUREMENT
/begin MEASUREMENT Com_TxSigInfo[146].TxBufferStartIdxOfTxSigInfo "" UWORD Com_TxBufferStartIdxOfTxSigInfoType 0 0 0 65535 ECU_ADDRESS 0x0 /end MEASUREMENT
/begin MEASUREMENT Com_TxSigInfo[146].TxFilterInitValueArrayBasedFilterInitValueEndIdxOfTxSigInfo "" UBYTE Com_TxFilterInitValueArrayBasedFilterInitValueEndIdxOfTxSigInfoType 0 0 0 255 ECU_ADDRESS 0x0 /end MEASUREMENT
/begin MEASUREMENT Com_TxSigInfo[146].TxFilterInitValueArrayBasedFilterInitValueStartIdxOfTxSigInfo "" UBYTE Com_TxFilterInitValueArrayBasedFilterInitValueStartIdxOfTxSigInfoType 0 0 0 255 ECU_ADDRESS 0x0 /end MEASUREMENT
/begin MEASUREMENT Com_TxSigInfo[146].TxPduInfoIdxOfTxSigInfo "" UBYTE NO_COMPU_METHOD 0 0 0 255 ECU_ADDRESS 0x0 /end MEASUREMENT
/begin MEASUREMENT Com_TxSigInfo[147].ApplTypeOfTxSigInfo "" UBYTE Com_ApplTypeOfTxSigInfoType 0 0 0 255 ECU_ADDRESS 0x0 /end MEASUREMENT
/begin MEASUREMENT Com_TxSigInfo[147].BitLengthOfTxSigInfo "" UWORD NO_COMPU_METHOD 0 0 0 65535 ECU_ADDRESS 0x0 /end MEASUREMENT
/begin MEASUREMENT Com_TxSigInfo[147].BitPositionOfTxSigInfo "" UWORD NO_COMPU_METHOD 0 0 0 65535 ECU_ADDRESS 0x0 /end MEASUREMENT
/begin MEASUREMENT Com_TxSigInfo[147].BusAccOfTxSigInfo "" UBYTE Com_BusAccOfTxSigInfoType 0 0 0 255 ECU_ADDRESS 0x0 /end MEASUREMENT
/begin MEASUREMENT Com_TxSigInfo[147].ByteLengthOfTxSigInfo "" UBYTE NO_COMPU_METHOD 0 0 0 255 ECU_ADDRESS 0x0 /end MEASUREMENT
/begin MEASUREMENT Com_TxSigInfo[147].DynSignalOfTxSigInfo "" UBYTE Com_DynSignalOfTxSigInfoType 0 0 0 1 ECU_ADDRESS 0x0 /end MEASUREMENT
/begin MEASUREMENT Com_TxSigInfo[147].FilterInitValueIdxOfTxSigInfo "" UBYTE Com_FilterInitValueIdxOfTxSigInfoType 0 0 0 255 ECU_ADDRESS 0x0 /end MEASUREMENT
/begin MEASUREMENT Com_TxSigInfo[147].FilterInitValueOfTxSigInfo "" UBYTE Com_FilterInitValueOfTxSigInfoType 0 0 0 255 ECU_ADDRESS 0x0 /end MEASUREMENT
/begin MEASUREMENT Com_TxSigInfo[147].InvValueIdxOfTxSigInfo "" UBYTE Com_InvValueIdxOfTxSigInfoType 0 0 0 255 ECU_ADDRESS 0x0 /end MEASUREMENT
/begin MEASUREMENT Com_TxSigInfo[147].InvValueOfTxSigInfo "" UBYTE Com_InvValueOfTxSigInfoType 0 0 0 255 ECU_ADDRESS 0x0 /end MEASUREMENT
/begin MEASUREMENT Com_TxSigInfo[147].OnChangeIdxOfTxSigInfo "" UBYTE Com_OnChangeIdxOfTxSigInfoType 0 0 0 255 ECU_ADDRESS 0x0 /end MEASUREMENT
/begin MEASUREMENT Com_TxSigInfo[147].OnChangeOfTxSigInfo "" UBYTE Com_OnChangeOfTxSigInfoType 0 0 0 255 ECU_ADDRESS 0x0 /end MEASUREMENT
/begin MEASUREMENT Com_TxSigInfo[147].StartByteInPduPositionOfTxSigInfo "" UBYTE NO_COMPU_METHOD 0 0 0 255 ECU_ADDRESS 0x0 /end MEASUREMENT
/begin MEASUREMENT Com_TxSigInfo[147].TxAccessInfoIdxOfTxSigInfo "" UWORD NO_COMPU_METHOD 0 0 0 65535 ECU_ADDRESS 0x0 /end MEASUREMENT
/begin MEASUREMENT Com_TxSigInfo[147].TxBufferEndIdxOfTxSigInfo "" UWORD Com_TxBufferEndIdxOfTxSigInfoType 0 0 0 65535 ECU_ADDRESS 0x0 /end MEASUREMENT
/begin MEASUREMENT Com_TxSigInfo[147].TxBufferStartIdxOfTxSigInfo "" UWORD Com_TxBufferStartIdxOfTxSigInfoType 0 0 0 65535 ECU_ADDRESS 0x0 /end MEASUREMENT
/begin MEASUREMENT Com_TxSigInfo[147].TxFilterInitValueArrayBasedFilterInitValueEndIdxOfTxSigInfo "" UBYTE Com_TxFilterInitValueArrayBasedFilterInitValueEndIdxOfTxSigInfoType 0 0 0 255 ECU_ADDRESS 0x0 /end MEASUREMENT
/begin MEASUREMENT Com_TxSigInfo[147].TxFilterInitValueArrayBasedFilterInitValueStartIdxOfTxSigInfo "" UBYTE Com_TxFilterInitValueArrayBasedFilterInitValueStartIdxOfTxSigInfoType 0 0 0 255 ECU_ADDRESS 0x0 /end MEASUREMENT
/begin MEASUREMENT Com_TxSigInfo[147].TxPduInfoIdxOfTxSigInfo "" UBYTE NO_COMPU_METHOD 0 0 0 255 ECU_ADDRESS 0x0 /end MEASUREMENT
/begin MEASUREMENT Com_TxSigInfo[148].ApplTypeOfTxSigInfo "" UBYTE Com_ApplTypeOfTxSigInfoType 0 0 0 255 ECU_ADDRESS 0x0 /end MEASUREMENT
/begin MEASUREMENT Com_TxSigInfo[148].BitLengthOfTxSigInfo "" UWORD NO_COMPU_METHOD 0 0 0 65535 ECU_ADDRESS 0x0 /end MEASUREMENT
/begin MEASUREMENT Com_TxSigInfo[148].BitPositionOfTxSigInfo "" UWORD NO_COMPU_METHOD 0 0 0 65535 ECU_ADDRESS 0x0 /end MEASUREMENT
/begin MEASUREMENT Com_TxSigInfo[148].BusAccOfTxSigInfo "" UBYTE Com_BusAccOfTxSigInfoType 0 0 0 255 ECU_ADDRESS 0x0 /end MEASUREMENT
/begin MEASUREMENT Com_TxSigInfo[148].ByteLengthOfTxSigInfo "" UBYTE NO_COMPU_METHOD 0 0 0 255 ECU_ADDRESS 0x0 /end MEASUREMENT
/begin MEASUREMENT Com_TxSigInfo[148].DynSignalOfTxSigInfo "" UBYTE Com_DynSignalOfTxSigInfoType 0 0 0 1 ECU_ADDRESS 0x0 /end MEASUREMENT
/begin MEASUREMENT Com_TxSigInfo[148].FilterInitValueIdxOfTxSigInfo "" UBYTE Com_FilterInitValueIdxOfTxSigInfoType 0 0 0 255 ECU_ADDRESS 0x0 /end MEASUREMENT
/begin MEASUREMENT Com_TxSigInfo[148].FilterInitValueOfTxSigInfo "" UBYTE Com_FilterInitValueOfTxSigInfoType 0 0 0 255 ECU_ADDRESS 0x0 /end MEASUREMENT
/begin MEASUREMENT Com_TxSigInfo[148].InvValueIdxOfTxSigInfo "" UBYTE Com_InvValueIdxOfTxSigInfoType 0 0 0 255 ECU_ADDRESS 0x0 /end MEASUREMENT
/begin MEASUREMENT Com_TxSigInfo[148].InvValueOfTxSigInfo "" UBYTE Com_InvValueOfTxSigInfoType 0 0 0 255 ECU_ADDRESS 0x0 /end MEASUREMENT
/begin MEASUREMENT Com_TxSigInfo[148].OnChangeIdxOfTxSigInfo "" UBYTE Com_OnChangeIdxOfTxSigInfoType 0 0 0 255 ECU_ADDRESS 0x0 /end MEASUREMENT
/begin MEASUREMENT Com_TxSigInfo[148].OnChangeOfTxSigInfo "" UBYTE Com_OnChangeOfTxSigInfoType 0 0 0 255 ECU_ADDRESS 0x0 /end MEASUREMENT
/begin MEASUREMENT Com_TxSigInfo[148].StartByteInPduPositionOfTxSigInfo "" UBYTE NO_COMPU_METHOD 0 0 0 255 ECU_ADDRESS 0x0 /end MEASUREMENT
/begin MEASUREMENT Com_TxSigInfo[148].TxAccessInfoIdxOfTxSigInfo "" UWORD NO_COMPU_METHOD 0 0 0 65535 ECU_ADDRESS 0x0 /end MEASUREMENT
/begin MEASUREMENT Com_TxSigInfo[148].TxBufferEndIdxOfTxSigInfo "" UWORD Com_TxBufferEndIdxOfTxSigInfoType 0 0 0 65535 ECU_ADDRESS 0x0 /end MEASUREMENT
/begin MEASUREMENT Com_TxSigInfo[148].TxBufferStartIdxOfTxSigInfo "" UWORD Com_TxBufferStartIdxOfTxSigInfoType 0 0 0 65535 ECU_ADDRESS 0x0 /end MEASUREMENT
/begin MEASUREMENT Com_TxSigInfo[148].TxFilterInitValueArrayBasedFilterInitValueEndIdxOfTxSigInfo "" UBYTE Com_TxFilterInitValueArrayBasedFilterInitValueEndIdxOfTxSigInfoType 0 0 0 255 ECU_ADDRESS 0x0 /end MEASUREMENT
/begin MEASUREMENT Com_TxSigInfo[148].TxFilterInitValueArrayBasedFilterInitValueStartIdxOfTxSigInfo "" UBYTE Com_TxFilterInitValueArrayBasedFilterInitValueStartIdxOfTxSigInfoType 0 0 0 255 ECU_ADDRESS 0x0 /end MEASUREMENT
/begin MEASUREMENT Com_TxSigInfo[148].TxPduInfoIdxOfTxSigInfo "" UBYTE NO_COMPU_METHOD 0 0 0 255 ECU_ADDRESS 0x0 /end MEASUREMENT
/begin MEASUREMENT Com_TxSigInfo[149].ApplTypeOfTxSigInfo "" UBYTE Com_ApplTypeOfTxSigInfoType 0 0 0 255 ECU_ADDRESS 0x0 /end MEASUREMENT
/begin MEASUREMENT Com_TxSigInfo[149].BitLengthOfTxSigInfo "" UWORD NO_COMPU_METHOD 0 0 0 65535 ECU_ADDRESS 0x0 /end MEASUREMENT
/begin MEASUREMENT Com_TxSigInfo[149].BitPositionOfTxSigInfo "" UWORD NO_COMPU_METHOD 0 0 0 65535 ECU_ADDRESS 0x0 /end MEASUREMENT
/begin MEASUREMENT Com_TxSigInfo[149].BusAccOfTxSigInfo "" UBYTE Com_BusAccOfTxSigInfoType 0 0 0 255 ECU_ADDRESS 0x0 /end MEASUREMENT
/begin MEASUREMENT Com_TxSigInfo[149].ByteLengthOfTxSigInfo "" UBYTE NO_COMPU_METHOD 0 0 0 255 ECU_ADDRESS 0x0 /end MEASUREMENT
/begin MEASUREMENT Com_TxSigInfo[149].DynSignalOfTxSigInfo "" UBYTE Com_DynSignalOfTxSigInfoType 0 0 0 1 ECU_ADDRESS 0x0 /end MEASUREMENT
/begin MEASUREMENT Com_TxSigInfo[149].FilterInitValueIdxOfTxSigInfo "" UBYTE Com_FilterInitValueIdxOfTxSigInfoType 0 0 0 255 ECU_ADDRESS 0x0 /end MEASUREMENT
/begin MEASUREMENT Com_TxSigInfo[149].FilterInitValueOfTxSigInfo "" UBYTE Com_FilterInitValueOfTxSigInfoType 0 0 0 255 ECU_ADDRESS 0x0 /end MEASUREMENT
/begin MEASUREMENT Com_TxSigInfo[149].InvValueIdxOfTxSigInfo "" UBYTE Com_InvValueIdxOfTxSigInfoType 0 0 0 255 ECU_ADDRESS 0x0 /end MEASUREMENT
/begin MEASUREMENT Com_TxSigInfo[149].InvValueOfTxSigInfo "" UBYTE Com_InvValueOfTxSigInfoType 0 0 0 255 ECU_ADDRESS 0x0 /end MEASUREMENT
/begin MEASUREMENT Com_TxSigInfo[149].OnChangeIdxOfTxSigInfo "" UBYTE Com_OnChangeIdxOfTxSigInfoType 0 0 0 255 ECU_ADDRESS 0x0 /end MEASUREMENT
/begin MEASUREMENT Com_TxSigInfo[149].OnChangeOfTxSigInfo "" UBYTE Com_OnChangeOfTxSigInfoType 0 0 0 255 ECU_ADDRESS 0x0 /end MEASUREMENT
/begin MEASUREMENT Com_TxSigInfo[149].StartByteInPduPositionOfTxSigInfo "" UBYTE NO_COMPU_METHOD 0 0 0 255 ECU_ADDRESS 0x0 /end MEASUREMENT
/begin MEASUREMENT Com_TxSigInfo[149].TxAccessInfoIdxOfTxSigInfo "" UWORD NO_COMPU_METHOD 0 0 0 65535 ECU_ADDRESS 0x0 /end MEASUREMENT
/begin MEASUREMENT Com_TxSigInfo[149].TxBufferEndIdxOfTxSigInfo "" UWORD Com_TxBufferEndIdxOfTxSigInfoType 0 0 0 65535 ECU_ADDRESS 0x0 /end MEASUREMENT
/begin MEASUREMENT Com_TxSigInfo[149].TxBufferStartIdxOfTxSigInfo "" UWORD Com_TxBufferStartIdxOfTxSigInfoType 0 0 0 65535 ECU_ADDRESS 0x0 /end MEASUREMENT
/begin MEASUREMENT Com_TxSigInfo[149].TxFilterInitValueArrayBasedFilterInitValueEndIdxOfTxSigInfo "" UBYTE Com_TxFilterInitValueArrayBasedFilterInitValueEndIdxOfTxSigInfoType 0 0 0 255 ECU_ADDRESS 0x0 /end MEASUREMENT
/begin MEASUREMENT Com_TxSigInfo[149].TxFilterInitValueArrayBasedFilterInitValueStartIdxOfTxSigInfo "" UBYTE Com_TxFilterInitValueArrayBasedFilterInitValueStartIdxOfTxSigInfoType 0 0 0 255 ECU_ADDRESS 0x0 /end MEASUREMENT
/begin MEASUREMENT Com_TxSigInfo[149].TxPduInfoIdxOfTxSigInfo "" UBYTE NO_COMPU_METHOD 0 0 0 255 ECU_ADDRESS 0x0 /end MEASUREMENT
/begin MEASUREMENT Com_TxSigInfo[14].ApplTypeOfTxSigInfo "" UBYTE Com_ApplTypeOfTxSigInfoType 0 0 0 255 ECU_ADDRESS 0x0 /end MEASUREMENT
/begin MEASUREMENT Com_TxSigInfo[14].BitLengthOfTxSigInfo "" UWORD NO_COMPU_METHOD 0 0 0 65535 ECU_ADDRESS 0x0 /end MEASUREMENT
/begin MEASUREMENT Com_TxSigInfo[14].BitPositionOfTxSigInfo "" UWORD NO_COMPU_METHOD 0 0 0 65535 ECU_ADDRESS 0x0 /end MEASUREMENT
/begin MEASUREMENT Com_TxSigInfo[14].BusAccOfTxSigInfo "" UBYTE Com_BusAccOfTxSigInfoType 0 0 0 255 ECU_ADDRESS 0x0 /end MEASUREMENT
/begin MEASUREMENT Com_TxSigInfo[14].ByteLengthOfTxSigInfo "" UBYTE NO_COMPU_METHOD 0 0 0 255 ECU_ADDRESS 0x0 /end MEASUREMENT
/begin MEASUREMENT Com_TxSigInfo[14].DynSignalOfTxSigInfo "" UBYTE Com_DynSignalOfTxSigInfoType 0 0 0 1 ECU_ADDRESS 0x0 /end MEASUREMENT
/begin MEASUREMENT Com_TxSigInfo[14].FilterInitValueIdxOfTxSigInfo "" UBYTE Com_FilterInitValueIdxOfTxSigInfoType 0 0 0 255 ECU_ADDRESS 0x0 /end MEASUREMENT
/begin MEASUREMENT Com_TxSigInfo[14].FilterInitValueOfTxSigInfo "" UBYTE Com_FilterInitValueOfTxSigInfoType 0 0 0 255 ECU_ADDRESS 0x0 /end MEASUREMENT
/begin MEASUREMENT Com_TxSigInfo[14].InvValueIdxOfTxSigInfo "" UBYTE Com_InvValueIdxOfTxSigInfoType 0 0 0 255 ECU_ADDRESS 0x0 /end MEASUREMENT
/begin MEASUREMENT Com_TxSigInfo[14].InvValueOfTxSigInfo "" UBYTE Com_InvValueOfTxSigInfoType 0 0 0 255 ECU_ADDRESS 0x0 /end MEASUREMENT
/begin MEASUREMENT Com_TxSigInfo[14].OnChangeIdxOfTxSigInfo "" UBYTE Com_OnChangeIdxOfTxSigInfoType 0 0 0 255 ECU_ADDRESS 0x0 /end MEASUREMENT
/begin MEASUREMENT Com_TxSigInfo[14].OnChangeOfTxSigInfo "" UBYTE Com_OnChangeOfTxSigInfoType 0 0 0 255 ECU_ADDRESS 0x0 /end MEASUREMENT
/begin MEASUREMENT Com_TxSigInfo[14].StartByteInPduPositionOfTxSigInfo "" UBYTE NO_COMPU_METHOD 0 0 0 255 ECU_ADDRESS 0x0 /end MEASUREMENT
/begin MEASUREMENT Com_TxSigInfo[14].TxAccessInfoIdxOfTxSigInfo "" UWORD NO_COMPU_METHOD 0 0 0 65535 ECU_ADDRESS 0x0 /end MEASUREMENT
/begin MEASUREMENT Com_TxSigInfo[14].TxBufferEndIdxOfTxSigInfo "" UWORD Com_TxBufferEndIdxOfTxSigInfoType 0 0 0 65535 ECU_ADDRESS 0x0 /end MEASUREMENT
/begin MEASUREMENT Com_TxSigInfo[14].TxBufferStartIdxOfTxSigInfo "" UWORD Com_TxBufferStartIdxOfTxSigInfoType 0 0 0 65535 ECU_ADDRESS 0x0 /end MEASUREMENT
/begin MEASUREMENT Com_TxSigInfo[14].TxFilterInitValueArrayBasedFilterInitValueEndIdxOfTxSigInfo "" UBYTE Com_TxFilterInitValueArrayBasedFilterInitValueEndIdxOfTxSigInfoType 0 0 0 255 ECU_ADDRESS 0x0 /end MEASUREMENT
/begin MEASUREMENT Com_TxSigInfo[14].TxFilterInitValueArrayBasedFilterInitValueStartIdxOfTxSigInfo "" UBYTE Com_TxFilterInitValueArrayBasedFilterInitValueStartIdxOfTxSigInfoType 0 0 0 255 ECU_ADDRESS 0x0 /end MEASUREMENT
/begin MEASUREMENT Com_TxSigInfo[14].TxPduInfoIdxOfTxSigInfo "" UBYTE NO_COMPU_METHOD 0 0 0 255 ECU_ADDRESS 0x0 /end MEASUREMENT
/begin MEASUREMENT Com_TxSigInfo[150].ApplTypeOfTxSigInfo "" UBYTE Com_ApplTypeOfTxSigInfoType 0 0 0 255 ECU_ADDRESS 0x0 /end MEASUREMENT
/begin MEASUREMENT Com_TxSigInfo[150].BitLengthOfTxSigInfo "" UWORD NO_COMPU_METHOD 0 0 0 65535 ECU_ADDRESS 0x0 /end MEASUREMENT
/begin MEASUREMENT Com_TxSigInfo[150].BitPositionOfTxSigInfo "" UWORD NO_COMPU_METHOD 0 0 0 65535 ECU_ADDRESS 0x0 /end MEASUREMENT
/begin MEASUREMENT Com_TxSigInfo[150].BusAccOfTxSigInfo "" UBYTE Com_BusAccOfTxSigInfoType 0 0 0 255 ECU_ADDRESS 0x0 /end MEASUREMENT
/begin MEASUREMENT Com_TxSigInfo[150].ByteLengthOfTxSigInfo "" UBYTE NO_COMPU_METHOD 0 0 0 255 ECU_ADDRESS 0x0 /end MEASUREMENT
/begin MEASUREMENT Com_TxSigInfo[150].DynSignalOfTxSigInfo "" UBYTE Com_DynSignalOfTxSigInfoType 0 0 0 1 ECU_ADDRESS 0x0 /end MEASUREMENT
/begin MEASUREMENT Com_TxSigInfo[150].FilterInitValueIdxOfTxSigInfo "" UBYTE Com_FilterInitValueIdxOfTxSigInfoType 0 0 0 255 ECU_ADDRESS 0x0 /end MEASUREMENT
/begin MEASUREMENT Com_TxSigInfo[150].FilterInitValueOfTxSigInfo "" UBYTE Com_FilterInitValueOfTxSigInfoType 0 0 0 255 ECU_ADDRESS 0x0 /end MEASUREMENT
/begin MEASUREMENT Com_TxSigInfo[150].InvValueIdxOfTxSigInfo "" UBYTE Com_InvValueIdxOfTxSigInfoType 0 0 0 255 ECU_ADDRESS 0x0 /end MEASUREMENT
/begin MEASUREMENT Com_TxSigInfo[150].InvValueOfTxSigInfo "" UBYTE Com_InvValueOfTxSigInfoType 0 0 0 255 ECU_ADDRESS 0x0 /end MEASUREMENT
/begin MEASUREMENT Com_TxSigInfo[150].OnChangeIdxOfTxSigInfo "" UBYTE Com_OnChangeIdxOfTxSigInfoType 0 0 0 255 ECU_ADDRESS 0x0 /end MEASUREMENT
/begin MEASUREMENT Com_TxSigInfo[150].OnChangeOfTxSigInfo "" UBYTE Com_OnChangeOfTxSigInfoType 0 0 0 255 ECU_ADDRESS 0x0 /end MEASUREMENT
/begin MEASUREMENT Com_TxSigInfo[150].StartByteInPduPositionOfTxSigInfo "" UBYTE NO_COMPU_METHOD 0 0 0 255 ECU_ADDRESS 0x0 /end MEASUREMENT
/begin MEASUREMENT Com_TxSigInfo[150].TxAccessInfoIdxOfTxSigInfo "" UWORD NO_COMPU_METHOD 0 0 0 65535 ECU_ADDRESS 0x0 /end MEASUREMENT
/begin MEASUREMENT Com_TxSigInfo[150].TxBufferEndIdxOfTxSigInfo "" UWORD Com_TxBufferEndIdxOfTxSigInfoType 0 0 0 65535 ECU_ADDRESS 0x0 /end MEASUREMENT
/begin MEASUREMENT Com_TxSigInfo[150].TxBufferStartIdxOfTxSigInfo "" UWORD Com_TxBufferStartIdxOfTxSigInfoType 0 0 0 65535 ECU_ADDRESS 0x0 /end MEASUREMENT
/begin MEASUREMENT Com_TxSigInfo[150].TxFilterInitValueArrayBasedFilterInitValueEndIdxOfTxSigInfo "" UBYTE Com_TxFilterInitValueArrayBasedFilterInitValueEndIdxOfTxSigInfoType 0 0 0 255 ECU_ADDRESS 0x0 /end MEASUREMENT
/begin MEASUREMENT Com_TxSigInfo[150].TxFilterInitValueArrayBasedFilterInitValueStartIdxOfTxSigInfo "" UBYTE Com_TxFilterInitValueArrayBasedFilterInitValueStartIdxOfTxSigInfoType 0 0 0 255 ECU_ADDRESS 0x0 /end MEASUREMENT
/begin MEASUREMENT Com_TxSigInfo[150].TxPduInfoIdxOfTxSigInfo "" UBYTE NO_COMPU_METHOD 0 0 0 255 ECU_ADDRESS 0x0 /end MEASUREMENT
/begin MEASUREMENT Com_TxSigInfo[151].ApplTypeOfTxSigInfo "" UBYTE Com_ApplTypeOfTxSigInfoType 0 0 0 255 ECU_ADDRESS 0x0 /end MEASUREMENT
/begin MEASUREMENT Com_TxSigInfo[151].BitLengthOfTxSigInfo "" UWORD NO_COMPU_METHOD 0 0 0 65535 ECU_ADDRESS 0x0 /end MEASUREMENT
/begin MEASUREMENT Com_TxSigInfo[151].BitPositionOfTxSigInfo "" UWORD NO_COMPU_METHOD 0 0 0 65535 ECU_ADDRESS 0x0 /end MEASUREMENT
/begin MEASUREMENT Com_TxSigInfo[151].BusAccOfTxSigInfo "" UBYTE Com_BusAccOfTxSigInfoType 0 0 0 255 ECU_ADDRESS 0x0 /end MEASUREMENT
/begin MEASUREMENT Com_TxSigInfo[151].ByteLengthOfTxSigInfo "" UBYTE NO_COMPU_METHOD 0 0 0 255 ECU_ADDRESS 0x0 /end MEASUREMENT
/begin MEASUREMENT Com_TxSigInfo[151].DynSignalOfTxSigInfo "" UBYTE Com_DynSignalOfTxSigInfoType 0 0 0 1 ECU_ADDRESS 0x0 /end MEASUREMENT
/begin MEASUREMENT Com_TxSigInfo[151].FilterInitValueIdxOfTxSigInfo "" UBYTE Com_FilterInitValueIdxOfTxSigInfoType 0 0 0 255 ECU_ADDRESS 0x0 /end MEASUREMENT
/begin MEASUREMENT Com_TxSigInfo[151].FilterInitValueOfTxSigInfo "" UBYTE Com_FilterInitValueOfTxSigInfoType 0 0 0 255 ECU_ADDRESS 0x0 /end MEASUREMENT
/begin MEASUREMENT Com_TxSigInfo[151].InvValueIdxOfTxSigInfo "" UBYTE Com_InvValueIdxOfTxSigInfoType 0 0 0 255 ECU_ADDRESS 0x0 /end MEASUREMENT
/begin MEASUREMENT Com_TxSigInfo[151].InvValueOfTxSigInfo "" UBYTE Com_InvValueOfTxSigInfoType 0 0 0 255 ECU_ADDRESS 0x0 /end MEASUREMENT
/begin MEASUREMENT Com_TxSigInfo[151].OnChangeIdxOfTxSigInfo "" UBYTE Com_OnChangeIdxOfTxSigInfoType 0 0 0 255 ECU_ADDRESS 0x0 /end MEASUREMENT
/begin MEASUREMENT Com_TxSigInfo[151].OnChangeOfTxSigInfo "" UBYTE Com_OnChangeOfTxSigInfoType 0 0 0 255 ECU_ADDRESS 0x0 /end MEASUREMENT
/begin MEASUREMENT Com_TxSigInfo[151].StartByteInPduPositionOfTxSigInfo "" UBYTE NO_COMPU_METHOD 0 0 0 255 ECU_ADDRESS 0x0 /end MEASUREMENT
/begin MEASUREMENT Com_TxSigInfo[151].TxAccessInfoIdxOfTxSigInfo "" UWORD NO_COMPU_METHOD 0 0 0 65535 ECU_ADDRESS 0x0 /end MEASUREMENT
/begin MEASUREMENT Com_TxSigInfo[151].TxBufferEndIdxOfTxSigInfo "" UWORD Com_TxBufferEndIdxOfTxSigInfoType 0 0 0 65535 ECU_ADDRESS 0x0 /end MEASUREMENT
/begin MEASUREMENT Com_TxSigInfo[151].TxBufferStartIdxOfTxSigInfo "" UWORD Com_TxBufferStartIdxOfTxSigInfoType 0 0 0 65535 ECU_ADDRESS 0x0 /end MEASUREMENT
/begin MEASUREMENT Com_TxSigInfo[151].TxFilterInitValueArrayBasedFilterInitValueEndIdxOfTxSigInfo "" UBYTE Com_TxFilterInitValueArrayBasedFilterInitValueEndIdxOfTxSigInfoType 0 0 0 255 ECU_ADDRESS 0x0 /end MEASUREMENT
/begin MEASUREMENT Com_TxSigInfo[151].TxFilterInitValueArrayBasedFilterInitValueStartIdxOfTxSigInfo "" UBYTE Com_TxFilterInitValueArrayBasedFilterInitValueStartIdxOfTxSigInfoType 0 0 0 255 ECU_ADDRESS 0x0 /end MEASUREMENT
/begin MEASUREMENT Com_TxSigInfo[151].TxPduInfoIdxOfTxSigInfo "" UBYTE NO_COMPU_METHOD 0 0 0 255 ECU_ADDRESS 0x0 /end MEASUREMENT
/begin MEASUREMENT Com_TxSigInfo[152].ApplTypeOfTxSigInfo "" UBYTE Com_ApplTypeOfTxSigInfoType 0 0 0 255 ECU_ADDRESS 0x0 /end MEASUREMENT
/begin MEASUREMENT Com_TxSigInfo[152].BitLengthOfTxSigInfo "" UWORD NO_COMPU_METHOD 0 0 0 65535 ECU_ADDRESS 0x0 /end MEASUREMENT
/begin MEASUREMENT Com_TxSigInfo[152].BitPositionOfTxSigInfo "" UWORD NO_COMPU_METHOD 0 0 0 65535 ECU_ADDRESS 0x0 /end MEASUREMENT
/begin MEASUREMENT Com_TxSigInfo[152].BusAccOfTxSigInfo "" UBYTE Com_BusAccOfTxSigInfoType 0 0 0 255 ECU_ADDRESS 0x0 /end MEASUREMENT
/begin MEASUREMENT Com_TxSigInfo[152].ByteLengthOfTxSigInfo "" UBYTE NO_COMPU_METHOD 0 0 0 255 ECU_ADDRESS 0x0 /end MEASUREMENT
/begin MEASUREMENT Com_TxSigInfo[152].DynSignalOfTxSigInfo "" UBYTE Com_DynSignalOfTxSigInfoType 0 0 0 1 ECU_ADDRESS 0x0 /end MEASUREMENT
/begin MEASUREMENT Com_TxSigInfo[152].FilterInitValueIdxOfTxSigInfo "" UBYTE Com_FilterInitValueIdxOfTxSigInfoType 0 0 0 255 ECU_ADDRESS 0x0 /end MEASUREMENT
/begin MEASUREMENT Com_TxSigInfo[152].FilterInitValueOfTxSigInfo "" UBYTE Com_FilterInitValueOfTxSigInfoType 0 0 0 255 ECU_ADDRESS 0x0 /end MEASUREMENT
/begin MEASUREMENT Com_TxSigInfo[152].InvValueIdxOfTxSigInfo "" UBYTE Com_InvValueIdxOfTxSigInfoType 0 0 0 255 ECU_ADDRESS 0x0 /end MEASUREMENT
/begin MEASUREMENT Com_TxSigInfo[152].InvValueOfTxSigInfo "" UBYTE Com_InvValueOfTxSigInfoType 0 0 0 255 ECU_ADDRESS 0x0 /end MEASUREMENT
/begin MEASUREMENT Com_TxSigInfo[152].OnChangeIdxOfTxSigInfo "" UBYTE Com_OnChangeIdxOfTxSigInfoType 0 0 0 255 ECU_ADDRESS 0x0 /end MEASUREMENT
/begin MEASUREMENT Com_TxSigInfo[152].OnChangeOfTxSigInfo "" UBYTE Com_OnChangeOfTxSigInfoType 0 0 0 255 ECU_ADDRESS 0x0 /end MEASUREMENT
/begin MEASUREMENT Com_TxSigInfo[152].StartByteInPduPositionOfTxSigInfo "" UBYTE NO_COMPU_METHOD 0 0 0 255 ECU_ADDRESS 0x0 /end MEASUREMENT
/begin MEASUREMENT Com_TxSigInfo[152].TxAccessInfoIdxOfTxSigInfo "" UWORD NO_COMPU_METHOD 0 0 0 65535 ECU_ADDRESS 0x0 /end MEASUREMENT
/begin MEASUREMENT Com_TxSigInfo[152].TxBufferEndIdxOfTxSigInfo "" UWORD Com_TxBufferEndIdxOfTxSigInfoType 0 0 0 65535 ECU_ADDRESS 0x0 /end MEASUREMENT
/begin MEASUREMENT Com_TxSigInfo[152].TxBufferStartIdxOfTxSigInfo "" UWORD Com_TxBufferStartIdxOfTxSigInfoType 0 0 0 65535 ECU_ADDRESS 0x0 /end MEASUREMENT
/begin MEASUREMENT Com_TxSigInfo[152].TxFilterInitValueArrayBasedFilterInitValueEndIdxOfTxSigInfo "" UBYTE Com_TxFilterInitValueArrayBasedFilterInitValueEndIdxOfTxSigInfoType 0 0 0 255 ECU_ADDRESS 0x0 /end MEASUREMENT
/begin MEASUREMENT Com_TxSigInfo[152].TxFilterInitValueArrayBasedFilterInitValueStartIdxOfTxSigInfo "" UBYTE Com_TxFilterInitValueArrayBasedFilterInitValueStartIdxOfTxSigInfoType 0 0 0 255 ECU_ADDRESS 0x0 /end MEASUREMENT
/begin MEASUREMENT Com_TxSigInfo[152].TxPduInfoIdxOfTxSigInfo "" UBYTE NO_COMPU_METHOD 0 0 0 255 ECU_ADDRESS 0x0 /end MEASUREMENT
/begin MEASUREMENT Com_TxSigInfo[153].ApplTypeOfTxSigInfo "" UBYTE Com_ApplTypeOfTxSigInfoType 0 0 0 255 ECU_ADDRESS 0x0 /end MEASUREMENT
/begin MEASUREMENT Com_TxSigInfo[153].BitLengthOfTxSigInfo "" UWORD NO_COMPU_METHOD 0 0 0 65535 ECU_ADDRESS 0x0 /end MEASUREMENT
/begin MEASUREMENT Com_TxSigInfo[153].BitPositionOfTxSigInfo "" UWORD NO_COMPU_METHOD 0 0 0 65535 ECU_ADDRESS 0x0 /end MEASUREMENT
/begin MEASUREMENT Com_TxSigInfo[153].BusAccOfTxSigInfo "" UBYTE Com_BusAccOfTxSigInfoType 0 0 0 255 ECU_ADDRESS 0x0 /end MEASUREMENT
/begin MEASUREMENT Com_TxSigInfo[153].ByteLengthOfTxSigInfo "" UBYTE NO_COMPU_METHOD 0 0 0 255 ECU_ADDRESS 0x0 /end MEASUREMENT
/begin MEASUREMENT Com_TxSigInfo[153].DynSignalOfTxSigInfo "" UBYTE Com_DynSignalOfTxSigInfoType 0 0 0 1 ECU_ADDRESS 0x0 /end MEASUREMENT
/begin MEASUREMENT Com_TxSigInfo[153].FilterInitValueIdxOfTxSigInfo "" UBYTE Com_FilterInitValueIdxOfTxSigInfoType 0 0 0 255 ECU_ADDRESS 0x0 /end MEASUREMENT
/begin MEASUREMENT Com_TxSigInfo[153].FilterInitValueOfTxSigInfo "" UBYTE Com_FilterInitValueOfTxSigInfoType 0 0 0 255 ECU_ADDRESS 0x0 /end MEASUREMENT
/begin MEASUREMENT Com_TxSigInfo[153].InvValueIdxOfTxSigInfo "" UBYTE Com_InvValueIdxOfTxSigInfoType 0 0 0 255 ECU_ADDRESS 0x0 /end MEASUREMENT
/begin MEASUREMENT Com_TxSigInfo[153].InvValueOfTxSigInfo "" UBYTE Com_InvValueOfTxSigInfoType 0 0 0 255 ECU_ADDRESS 0x0 /end MEASUREMENT
/begin MEASUREMENT Com_TxSigInfo[153].OnChangeIdxOfTxSigInfo "" UBYTE Com_OnChangeIdxOfTxSigInfoType 0 0 0 255 ECU_ADDRESS 0x0 /end MEASUREMENT
/begin MEASUREMENT Com_TxSigInfo[153].OnChangeOfTxSigInfo "" UBYTE Com_OnChangeOfTxSigInfoType 0 0 0 255 ECU_ADDRESS 0x0 /end MEASUREMENT
/begin MEASUREMENT Com_TxSigInfo[153].StartByteInPduPositionOfTxSigInfo "" UBYTE NO_COMPU_METHOD 0 0 0 255 ECU_ADDRESS 0x0 /end MEASUREMENT
/begin MEASUREMENT Com_TxSigInfo[153].TxAccessInfoIdxOfTxSigInfo "" UWORD NO_COMPU_METHOD 0 0 0 65535 ECU_ADDRESS 0x0 /end MEASUREMENT
/begin MEASUREMENT Com_TxSigInfo[153].TxBufferEndIdxOfTxSigInfo "" UWORD Com_TxBufferEndIdxOfTxSigInfoType 0 0 0 65535 ECU_ADDRESS 0x0 /end MEASUREMENT
/begin MEASUREMENT Com_TxSigInfo[153].TxBufferStartIdxOfTxSigInfo "" UWORD Com_TxBufferStartIdxOfTxSigInfoType 0 0 0 65535 ECU_ADDRESS 0x0 /end MEASUREMENT
/begin MEASUREMENT Com_TxSigInfo[153].TxFilterInitValueArrayBasedFilterInitValueEndIdxOfTxSigInfo "" UBYTE Com_TxFilterInitValueArrayBasedFilterInitValueEndIdxOfTxSigInfoType 0 0 0 255 ECU_ADDRESS 0x0 /end MEASUREMENT
/begin MEASUREMENT Com_TxSigInfo[153].TxFilterInitValueArrayBasedFilterInitValueStartIdxOfTxSigInfo "" UBYTE Com_TxFilterInitValueArrayBasedFilterInitValueStartIdxOfTxSigInfoType 0 0 0 255 ECU_ADDRESS 0x0 /end MEASUREMENT
/begin MEASUREMENT Com_TxSigInfo[153].TxPduInfoIdxOfTxSigInfo "" UBYTE NO_COMPU_METHOD 0 0 0 255 ECU_ADDRESS 0x0 /end MEASUREMENT
/begin MEASUREMENT Com_TxSigInfo[154].ApplTypeOfTxSigInfo "" UBYTE Com_ApplTypeOfTxSigInfoType 0 0 0 255 ECU_ADDRESS 0x0 /end MEASUREMENT
/begin MEASUREMENT Com_TxSigInfo[154].BitLengthOfTxSigInfo "" UWORD NO_COMPU_METHOD 0 0 0 65535 ECU_ADDRESS 0x0 /end MEASUREMENT
/begin MEASUREMENT Com_TxSigInfo[154].BitPositionOfTxSigInfo "" UWORD NO_COMPU_METHOD 0 0 0 65535 ECU_ADDRESS 0x0 /end MEASUREMENT
/begin MEASUREMENT Com_TxSigInfo[154].BusAccOfTxSigInfo "" UBYTE Com_BusAccOfTxSigInfoType 0 0 0 255 ECU_ADDRESS 0x0 /end MEASUREMENT
/begin MEASUREMENT Com_TxSigInfo[154].ByteLengthOfTxSigInfo "" UBYTE NO_COMPU_METHOD 0 0 0 255 ECU_ADDRESS 0x0 /end MEASUREMENT
/begin MEASUREMENT Com_TxSigInfo[154].DynSignalOfTxSigInfo "" UBYTE Com_DynSignalOfTxSigInfoType 0 0 0 1 ECU_ADDRESS 0x0 /end MEASUREMENT
/begin MEASUREMENT Com_TxSigInfo[154].FilterInitValueIdxOfTxSigInfo "" UBYTE Com_FilterInitValueIdxOfTxSigInfoType 0 0 0 255 ECU_ADDRESS 0x0 /end MEASUREMENT
/begin MEASUREMENT Com_TxSigInfo[154].FilterInitValueOfTxSigInfo "" UBYTE Com_FilterInitValueOfTxSigInfoType 0 0 0 255 ECU_ADDRESS 0x0 /end MEASUREMENT
/begin MEASUREMENT Com_TxSigInfo[154].InvValueIdxOfTxSigInfo "" UBYTE Com_InvValueIdxOfTxSigInfoType 0 0 0 255 ECU_ADDRESS 0x0 /end MEASUREMENT
/begin MEASUREMENT Com_TxSigInfo[154].InvValueOfTxSigInfo "" UBYTE Com_InvValueOfTxSigInfoType 0 0 0 255 ECU_ADDRESS 0x0 /end MEASUREMENT
/begin MEASUREMENT Com_TxSigInfo[154].OnChangeIdxOfTxSigInfo "" UBYTE Com_OnChangeIdxOfTxSigInfoType 0 0 0 255 ECU_ADDRESS 0x0 /end MEASUREMENT
/begin MEASUREMENT Com_TxSigInfo[154].OnChangeOfTxSigInfo "" UBYTE Com_OnChangeOfTxSigInfoType 0 0 0 255 ECU_ADDRESS 0x0 /end MEASUREMENT
/begin MEASUREMENT Com_TxSigInfo[154].StartByteInPduPositionOfTxSigInfo "" UBYTE NO_COMPU_METHOD 0 0 0 255 ECU_ADDRESS 0x0 /end MEASUREMENT
/begin MEASUREMENT Com_TxSigInfo[154].TxAccessInfoIdxOfTxSigInfo "" UWORD NO_COMPU_METHOD 0 0 0 65535 ECU_ADDRESS 0x0 /end MEASUREMENT
/begin MEASUREMENT Com_TxSigInfo[154].TxBufferEndIdxOfTxSigInfo "" UWORD Com_TxBufferEndIdxOfTxSigInfoType 0 0 0 65535 ECU_ADDRESS 0x0 /end MEASUREMENT
/begin MEASUREMENT Com_TxSigInfo[154].TxBufferStartIdxOfTxSigInfo "" UWORD Com_TxBufferStartIdxOfTxSigInfoType 0 0 0 65535 ECU_ADDRESS 0x0 /end MEASUREMENT
/begin MEASUREMENT Com_TxSigInfo[154].TxFilterInitValueArrayBasedFilterInitValueEndIdxOfTxSigInfo "" UBYTE Com_TxFilterInitValueArrayBasedFilterInitValueEndIdxOfTxSigInfoType 0 0 0 255 ECU_ADDRESS 0x0 /end MEASUREMENT
/begin MEASUREMENT Com_TxSigInfo[154].TxFilterInitValueArrayBasedFilterInitValueStartIdxOfTxSigInfo "" UBYTE Com_TxFilterInitValueArrayBasedFilterInitValueStartIdxOfTxSigInfoType 0 0 0 255 ECU_ADDRESS 0x0 /end MEASUREMENT
/begin MEASUREMENT Com_TxSigInfo[154].TxPduInfoIdxOfTxSigInfo "" UBYTE NO_COMPU_METHOD 0 0 0 255 ECU_ADDRESS 0x0 /end MEASUREMENT
/begin MEASUREMENT Com_TxSigInfo[155].ApplTypeOfTxSigInfo "" UBYTE Com_ApplTypeOfTxSigInfoType 0 0 0 255 ECU_ADDRESS 0x0 /end MEASUREMENT
/begin MEASUREMENT Com_TxSigInfo[155].BitLengthOfTxSigInfo "" UWORD NO_COMPU_METHOD 0 0 0 65535 ECU_ADDRESS 0x0 /end MEASUREMENT
/begin MEASUREMENT Com_TxSigInfo[155].BitPositionOfTxSigInfo "" UWORD NO_COMPU_METHOD 0 0 0 65535 ECU_ADDRESS 0x0 /end MEASUREMENT
/begin MEASUREMENT Com_TxSigInfo[155].BusAccOfTxSigInfo "" UBYTE Com_BusAccOfTxSigInfoType 0 0 0 255 ECU_ADDRESS 0x0 /end MEASUREMENT
/begin MEASUREMENT Com_TxSigInfo[155].ByteLengthOfTxSigInfo "" UBYTE NO_COMPU_METHOD 0 0 0 255 ECU_ADDRESS 0x0 /end MEASUREMENT
/begin MEASUREMENT Com_TxSigInfo[155].DynSignalOfTxSigInfo "" UBYTE Com_DynSignalOfTxSigInfoType 0 0 0 1 ECU_ADDRESS 0x0 /end MEASUREMENT
/begin MEASUREMENT Com_TxSigInfo[155].FilterInitValueIdxOfTxSigInfo "" UBYTE Com_FilterInitValueIdxOfTxSigInfoType 0 0 0 255 ECU_ADDRESS 0x0 /end MEASUREMENT
/begin MEASUREMENT Com_TxSigInfo[155].FilterInitValueOfTxSigInfo "" UBYTE Com_FilterInitValueOfTxSigInfoType 0 0 0 255 ECU_ADDRESS 0x0 /end MEASUREMENT
/begin MEASUREMENT Com_TxSigInfo[155].InvValueIdxOfTxSigInfo "" UBYTE Com_InvValueIdxOfTxSigInfoType 0 0 0 255 ECU_ADDRESS 0x0 /end MEASUREMENT
/begin MEASUREMENT Com_TxSigInfo[155].InvValueOfTxSigInfo "" UBYTE Com_InvValueOfTxSigInfoType 0 0 0 255 ECU_ADDRESS 0x0 /end MEASUREMENT
/begin MEASUREMENT Com_TxSigInfo[155].OnChangeIdxOfTxSigInfo "" UBYTE Com_OnChangeIdxOfTxSigInfoType 0 0 0 255 ECU_ADDRESS 0x0 /end MEASUREMENT
/begin MEASUREMENT Com_TxSigInfo[155].OnChangeOfTxSigInfo "" UBYTE Com_OnChangeOfTxSigInfoType 0 0 0 255 ECU_ADDRESS 0x0 /end MEASUREMENT
/begin MEASUREMENT Com_TxSigInfo[155].StartByteInPduPositionOfTxSigInfo "" UBYTE NO_COMPU_METHOD 0 0 0 255 ECU_ADDRESS 0x0 /end MEASUREMENT
/begin MEASUREMENT Com_TxSigInfo[155].TxAccessInfoIdxOfTxSigInfo "" UWORD NO_COMPU_METHOD 0 0 0 65535 ECU_ADDRESS 0x0 /end MEASUREMENT
/begin MEASUREMENT Com_TxSigInfo[155].TxBufferEndIdxOfTxSigInfo "" UWORD Com_TxBufferEndIdxOfTxSigInfoType 0 0 0 65535 ECU_ADDRESS 0x0 /end MEASUREMENT
/begin MEASUREMENT Com_TxSigInfo[155].TxBufferStartIdxOfTxSigInfo "" UWORD Com_TxBufferStartIdxOfTxSigInfoType 0 0 0 65535 ECU_ADDRESS 0x0 /end MEASUREMENT
/begin MEASUREMENT Com_TxSigInfo[155].TxFilterInitValueArrayBasedFilterInitValueEndIdxOfTxSigInfo "" UBYTE Com_TxFilterInitValueArrayBasedFilterInitValueEndIdxOfTxSigInfoType 0 0 0 255 ECU_ADDRESS 0x0 /end MEASUREMENT
/begin MEASUREMENT Com_TxSigInfo[155].TxFilterInitValueArrayBasedFilterInitValueStartIdxOfTxSigInfo "" UBYTE Com_TxFilterInitValueArrayBasedFilterInitValueStartIdxOfTxSigInfoType 0 0 0 255 ECU_ADDRESS 0x0 /end MEASUREMENT
/begin MEASUREMENT Com_TxSigInfo[155].TxPduInfoIdxOfTxSigInfo "" UBYTE NO_COMPU_METHOD 0 0 0 255 ECU_ADDRESS 0x0 /end MEASUREMENT
/begin MEASUREMENT Com_TxSigInfo[156].ApplTypeOfTxSigInfo "" UBYTE Com_ApplTypeOfTxSigInfoType 0 0 0 255 ECU_ADDRESS 0x0 /end MEASUREMENT
/begin MEASUREMENT Com_TxSigInfo[156].BitLengthOfTxSigInfo "" UWORD NO_COMPU_METHOD 0 0 0 65535 ECU_ADDRESS 0x0 /end MEASUREMENT
/begin MEASUREMENT Com_TxSigInfo[156].BitPositionOfTxSigInfo "" UWORD NO_COMPU_METHOD 0 0 0 65535 ECU_ADDRESS 0x0 /end MEASUREMENT
/begin MEASUREMENT Com_TxSigInfo[156].BusAccOfTxSigInfo "" UBYTE Com_BusAccOfTxSigInfoType 0 0 0 255 ECU_ADDRESS 0x0 /end MEASUREMENT
/begin MEASUREMENT Com_TxSigInfo[156].ByteLengthOfTxSigInfo "" UBYTE NO_COMPU_METHOD 0 0 0 255 ECU_ADDRESS 0x0 /end MEASUREMENT
/begin MEASUREMENT Com_TxSigInfo[156].DynSignalOfTxSigInfo "" UBYTE Com_DynSignalOfTxSigInfoType 0 0 0 1 ECU_ADDRESS 0x0 /end MEASUREMENT
/begin MEASUREMENT Com_TxSigInfo[156].FilterInitValueIdxOfTxSigInfo "" UBYTE Com_FilterInitValueIdxOfTxSigInfoType 0 0 0 255 ECU_ADDRESS 0x0 /end MEASUREMENT
/begin MEASUREMENT Com_TxSigInfo[156].FilterInitValueOfTxSigInfo "" UBYTE Com_FilterInitValueOfTxSigInfoType 0 0 0 255 ECU_ADDRESS 0x0 /end MEASUREMENT
/begin MEASUREMENT Com_TxSigInfo[156].InvValueIdxOfTxSigInfo "" UBYTE Com_InvValueIdxOfTxSigInfoType 0 0 0 255 ECU_ADDRESS 0x0 /end MEASUREMENT
/begin MEASUREMENT Com_TxSigInfo[156].InvValueOfTxSigInfo "" UBYTE Com_InvValueOfTxSigInfoType 0 0 0 255 ECU_ADDRESS 0x0 /end MEASUREMENT
/begin MEASUREMENT Com_TxSigInfo[156].OnChangeIdxOfTxSigInfo "" UBYTE Com_OnChangeIdxOfTxSigInfoType 0 0 0 255 ECU_ADDRESS 0x0 /end MEASUREMENT
/begin MEASUREMENT Com_TxSigInfo[156].OnChangeOfTxSigInfo "" UBYTE Com_OnChangeOfTxSigInfoType 0 0 0 255 ECU_ADDRESS 0x0 /end MEASUREMENT
/begin MEASUREMENT Com_TxSigInfo[156].StartByteInPduPositionOfTxSigInfo "" UBYTE NO_COMPU_METHOD 0 0 0 255 ECU_ADDRESS 0x0 /end MEASUREMENT
/begin MEASUREMENT Com_TxSigInfo[156].TxAccessInfoIdxOfTxSigInfo "" UWORD NO_COMPU_METHOD 0 0 0 65535 ECU_ADDRESS 0x0 /end MEASUREMENT
/begin MEASUREMENT Com_TxSigInfo[156].TxBufferEndIdxOfTxSigInfo "" UWORD Com_TxBufferEndIdxOfTxSigInfoType 0 0 0 65535 ECU_ADDRESS 0x0 /end MEASUREMENT
/begin MEASUREMENT Com_TxSigInfo[156].TxBufferStartIdxOfTxSigInfo "" UWORD Com_TxBufferStartIdxOfTxSigInfoType 0 0 0 65535 ECU_ADDRESS 0x0 /end MEASUREMENT
/begin MEASUREMENT Com_TxSigInfo[156].TxFilterInitValueArrayBasedFilterInitValueEndIdxOfTxSigInfo "" UBYTE Com_TxFilterInitValueArrayBasedFilterInitValueEndIdxOfTxSigInfoType 0 0 0 255 ECU_ADDRESS 0x0 /end MEASUREMENT
/begin MEASUREMENT Com_TxSigInfo[156].TxFilterInitValueArrayBasedFilterInitValueStartIdxOfTxSigInfo "" UBYTE Com_TxFilterInitValueArrayBasedFilterInitValueStartIdxOfTxSigInfoType 0 0 0 255 ECU_ADDRESS 0x0 /end MEASUREMENT
/begin MEASUREMENT Com_TxSigInfo[156].TxPduInfoIdxOfTxSigInfo "" UBYTE NO_COMPU_METHOD 0 0 0 255 ECU_ADDRESS 0x0 /end MEASUREMENT
/begin MEASUREMENT Com_TxSigInfo[157].ApplTypeOfTxSigInfo "" UBYTE Com_ApplTypeOfTxSigInfoType 0 0 0 255 ECU_ADDRESS 0x0 /end MEASUREMENT
/begin MEASUREMENT Com_TxSigInfo[157].BitLengthOfTxSigInfo "" UWORD NO_COMPU_METHOD 0 0 0 65535 ECU_ADDRESS 0x0 /end MEASUREMENT
/begin MEASUREMENT Com_TxSigInfo[157].BitPositionOfTxSigInfo "" UWORD NO_COMPU_METHOD 0 0 0 65535 ECU_ADDRESS 0x0 /end MEASUREMENT
/begin MEASUREMENT Com_TxSigInfo[157].BusAccOfTxSigInfo "" UBYTE Com_BusAccOfTxSigInfoType 0 0 0 255 ECU_ADDRESS 0x0 /end MEASUREMENT
/begin MEASUREMENT Com_TxSigInfo[157].ByteLengthOfTxSigInfo "" UBYTE NO_COMPU_METHOD 0 0 0 255 ECU_ADDRESS 0x0 /end MEASUREMENT
/begin MEASUREMENT Com_TxSigInfo[157].DynSignalOfTxSigInfo "" UBYTE Com_DynSignalOfTxSigInfoType 0 0 0 1 ECU_ADDRESS 0x0 /end MEASUREMENT
/begin MEASUREMENT Com_TxSigInfo[157].FilterInitValueIdxOfTxSigInfo "" UBYTE Com_FilterInitValueIdxOfTxSigInfoType 0 0 0 255 ECU_ADDRESS 0x0 /end MEASUREMENT
/begin MEASUREMENT Com_TxSigInfo[157].FilterInitValueOfTxSigInfo "" UBYTE Com_FilterInitValueOfTxSigInfoType 0 0 0 255 ECU_ADDRESS 0x0 /end MEASUREMENT
/begin MEASUREMENT Com_TxSigInfo[157].InvValueIdxOfTxSigInfo "" UBYTE Com_InvValueIdxOfTxSigInfoType 0 0 0 255 ECU_ADDRESS 0x0 /end MEASUREMENT
/begin MEASUREMENT Com_TxSigInfo[157].InvValueOfTxSigInfo "" UBYTE Com_InvValueOfTxSigInfoType 0 0 0 255 ECU_ADDRESS 0x0 /end MEASUREMENT
/begin MEASUREMENT Com_TxSigInfo[157].OnChangeIdxOfTxSigInfo "" UBYTE Com_OnChangeIdxOfTxSigInfoType 0 0 0 255 ECU_ADDRESS 0x0 /end MEASUREMENT
/begin MEASUREMENT Com_TxSigInfo[157].OnChangeOfTxSigInfo "" UBYTE Com_OnChangeOfTxSigInfoType 0 0 0 255 ECU_ADDRESS 0x0 /end MEASUREMENT
/begin MEASUREMENT Com_TxSigInfo[157].StartByteInPduPositionOfTxSigInfo "" UBYTE NO_COMPU_METHOD 0 0 0 255 ECU_ADDRESS 0x0 /end MEASUREMENT
/begin MEASUREMENT Com_TxSigInfo[157].TxAccessInfoIdxOfTxSigInfo "" UWORD NO_COMPU_METHOD 0 0 0 65535 ECU_ADDRESS 0x0 /end MEASUREMENT
/begin MEASUREMENT Com_TxSigInfo[157].TxBufferEndIdxOfTxSigInfo "" UWORD Com_TxBufferEndIdxOfTxSigInfoType 0 0 0 65535 ECU_ADDRESS 0x0 /end MEASUREMENT
/begin MEASUREMENT Com_TxSigInfo[157].TxBufferStartIdxOfTxSigInfo "" UWORD Com_TxBufferStartIdxOfTxSigInfoType 0 0 0 65535 ECU_ADDRESS 0x0 /end MEASUREMENT
/begin MEASUREMENT Com_TxSigInfo[157].TxFilterInitValueArrayBasedFilterInitValueEndIdxOfTxSigInfo "" UBYTE Com_TxFilterInitValueArrayBasedFilterInitValueEndIdxOfTxSigInfoType 0 0 0 255 ECU_ADDRESS 0x0 /end MEASUREMENT
/begin MEASUREMENT Com_TxSigInfo[157].TxFilterInitValueArrayBasedFilterInitValueStartIdxOfTxSigInfo "" UBYTE Com_TxFilterInitValueArrayBasedFilterInitValueStartIdxOfTxSigInfoType 0 0 0 255 ECU_ADDRESS 0x0 /end MEASUREMENT
/begin MEASUREMENT Com_TxSigInfo[157].TxPduInfoIdxOfTxSigInfo "" UBYTE NO_COMPU_METHOD 0 0 0 255 ECU_ADDRESS 0x0 /end MEASUREMENT
/begin MEASUREMENT Com_TxSigInfo[158].ApplTypeOfTxSigInfo "" UBYTE Com_ApplTypeOfTxSigInfoType 0 0 0 255 ECU_ADDRESS 0x0 /end MEASUREMENT
/begin MEASUREMENT Com_TxSigInfo[158].BitLengthOfTxSigInfo "" UWORD NO_COMPU_METHOD 0 0 0 65535 ECU_ADDRESS 0x0 /end MEASUREMENT
/begin MEASUREMENT Com_TxSigInfo[158].BitPositionOfTxSigInfo "" UWORD NO_COMPU_METHOD 0 0 0 65535 ECU_ADDRESS 0x0 /end MEASUREMENT
/begin MEASUREMENT Com_TxSigInfo[158].BusAccOfTxSigInfo "" UBYTE Com_BusAccOfTxSigInfoType 0 0 0 255 ECU_ADDRESS 0x0 /end MEASUREMENT
/begin MEASUREMENT Com_TxSigInfo[158].ByteLengthOfTxSigInfo "" UBYTE NO_COMPU_METHOD 0 0 0 255 ECU_ADDRESS 0x0 /end MEASUREMENT
/begin MEASUREMENT Com_TxSigInfo[158].DynSignalOfTxSigInfo "" UBYTE Com_DynSignalOfTxSigInfoType 0 0 0 1 ECU_ADDRESS 0x0 /end MEASUREMENT
/begin MEASUREMENT Com_TxSigInfo[158].FilterInitValueIdxOfTxSigInfo "" UBYTE Com_FilterInitValueIdxOfTxSigInfoType 0 0 0 255 ECU_ADDRESS 0x0 /end MEASUREMENT
/begin MEASUREMENT Com_TxSigInfo[158].FilterInitValueOfTxSigInfo "" UBYTE Com_FilterInitValueOfTxSigInfoType 0 0 0 255 ECU_ADDRESS 0x0 /end MEASUREMENT
/begin MEASUREMENT Com_TxSigInfo[158].InvValueIdxOfTxSigInfo "" UBYTE Com_InvValueIdxOfTxSigInfoType 0 0 0 255 ECU_ADDRESS 0x0 /end MEASUREMENT
/begin MEASUREMENT Com_TxSigInfo[158].InvValueOfTxSigInfo "" UBYTE Com_InvValueOfTxSigInfoType 0 0 0 255 ECU_ADDRESS 0x0 /end MEASUREMENT
/begin MEASUREMENT Com_TxSigInfo[158].OnChangeIdxOfTxSigInfo "" UBYTE Com_OnChangeIdxOfTxSigInfoType 0 0 0 255 ECU_ADDRESS 0x0 /end MEASUREMENT
/begin MEASUREMENT Com_TxSigInfo[158].OnChangeOfTxSigInfo "" UBYTE Com_OnChangeOfTxSigInfoType 0 0 0 255 ECU_ADDRESS 0x0 /end MEASUREMENT
/begin MEASUREMENT Com_TxSigInfo[158].StartByteInPduPositionOfTxSigInfo "" UBYTE NO_COMPU_METHOD 0 0 0 255 ECU_ADDRESS 0x0 /end MEASUREMENT
/begin MEASUREMENT Com_TxSigInfo[158].TxAccessInfoIdxOfTxSigInfo "" UWORD NO_COMPU_METHOD 0 0 0 65535 ECU_ADDRESS 0x0 /end MEASUREMENT
/begin MEASUREMENT Com_TxSigInfo[158].TxBufferEndIdxOfTxSigInfo "" UWORD Com_TxBufferEndIdxOfTxSigInfoType 0 0 0 65535 ECU_ADDRESS 0x0 /end MEASUREMENT
/begin MEASUREMENT Com_TxSigInfo[158].TxBufferStartIdxOfTxSigInfo "" UWORD Com_TxBufferStartIdxOfTxSigInfoType 0 0 0 65535 ECU_ADDRESS 0x0 /end MEASUREMENT
/begin MEASUREMENT Com_TxSigInfo[158].TxFilterInitValueArrayBasedFilterInitValueEndIdxOfTxSigInfo "" UBYTE Com_TxFilterInitValueArrayBasedFilterInitValueEndIdxOfTxSigInfoType 0 0 0 255 ECU_ADDRESS 0x0 /end MEASUREMENT
/begin MEASUREMENT Com_TxSigInfo[158].TxFilterInitValueArrayBasedFilterInitValueStartIdxOfTxSigInfo "" UBYTE Com_TxFilterInitValueArrayBasedFilterInitValueStartIdxOfTxSigInfoType 0 0 0 255 ECU_ADDRESS 0x0 /end MEASUREMENT
/begin MEASUREMENT Com_TxSigInfo[158].TxPduInfoIdxOfTxSigInfo "" UBYTE NO_COMPU_METHOD 0 0 0 255 ECU_ADDRESS 0x0 /end MEASUREMENT
/begin MEASUREMENT Com_TxSigInfo[159].ApplTypeOfTxSigInfo "" UBYTE Com_ApplTypeOfTxSigInfoType 0 0 0 255 ECU_ADDRESS 0x0 /end MEASUREMENT
/begin MEASUREMENT Com_TxSigInfo[159].BitLengthOfTxSigInfo "" UWORD NO_COMPU_METHOD 0 0 0 65535 ECU_ADDRESS 0x0 /end MEASUREMENT
/begin MEASUREMENT Com_TxSigInfo[159].BitPositionOfTxSigInfo "" UWORD NO_COMPU_METHOD 0 0 0 65535 ECU_ADDRESS 0x0 /end MEASUREMENT
/begin COMPU_METHOD Com_ApplTypeOfTxSigInfoType "" TAB_VERB "%10.1" "" COMPU_TAB_REF Com_ApplTypeOfTxSigInfoType /end COMPU_METHOD
/begin COMPU_METHOD Com_BusAccOfTxSigInfoType "" TAB_VERB "%10.1" "" COMPU_TAB_REF Com_BusAccOfTxSigInfoType /end COMPU_METHOD
/begin COMPU_METHOD Com_DynSignalOfTxSigInfoType "" TAB_VERB "%10.1" "" COMPU_TAB_REF Com_DynSignalOfTxSigInfoType /end COMPU_METHOD
/begin COMPU_METHOD Com_FilterInitValueIdxOfTxSigInfoType "" TAB_VERB "%10.1" "" COMPU_TAB_REF Com_FilterInitValueIdxOfTxSigInfoType /end COMPU_METHOD
/begin COMPU_METHOD Com_FilterInitValueOfTxSigInfoType "" TAB_VERB "%10.1" "" COMPU_TAB_REF Com_FilterInitValueOfTxSigInfoType /end COMPU_METHOD
/begin COMPU_METHOD Com_InvValueIdxOfTxSigInfoType "" TAB_VERB "%10.1" "" COMPU_TAB_REF Com_InvValueIdxOfTxSigInfoType /end COMPU_METHOD
/begin COMPU_METHOD Com_InvValueOfTxSigInfoType "" TAB_VERB "%10.1" "" COMPU_TAB_REF Com_InvValueOfTxSigInfoType /end COMPU_METHOD
/begin COMPU_METHOD Com_OnChangeIdxOfTxSigInfoType "" TAB_VERB "%10.1" "" COMPU_TAB_REF Com_OnChangeIdxOfTxSigInfoType /end COMPU_METHOD
/begin COMPU_METHOD Com_OnChangeOfTxSigInfoType "" TAB_VERB "%10.1" "" COMPU_TAB_REF Com_OnChangeOfTxSigInfoType /end COMPU_METHOD
/begin COMPU_METHOD Com_TxBufferEndIdxOfTxSigInfoType "" TAB_VERB "%10.1" "" COMPU_TAB_REF Com_TxBufferEndIdxOfTxSigInfoType /end COMPU_METHOD
/begin COMPU_METHOD Com_TxBufferStartIdxOfTxSigInfoType "" TAB_VERB "%10.1" "" COMPU_TAB_REF Com_TxBufferStartIdxOfTxSigInfoType /end COMPU_METHOD
/begin COMPU_METHOD Com_TxFilterInitValueArrayBasedFilterInitValueEndIdxOfTxSigInfoType "" TAB_VERB "%10.1" "" COMPU_TAB_REF Com_TxFilterInitValueArrayBasedFilterInitValueEndIdxOfTxSigInfoType /end COMPU_METHOD
/begin COMPU_METHOD Com_TxFilterInitValueArrayBasedFilterInitValueStartIdxOfTxSigInfoType "" TAB_VERB "%10.1" "" COMPU_TAB_REF Com_TxFilterInitValueArrayBasedFilterInitValueStartIdxOfTxSigInfoType /end COMPU_METHOD
/begin COMPU_VTAB Com_ApplTypeOfTxSigInfoType "" TAB_VERB 4 0 "COM_UINT8_APPLTYPEOFTXSIGINFO" 2 "COM_UINT16_APPLTYPEOFTXSIGINFO" 4 "COM_UINT32_APPLTYPEOFTXSIGINFO" 8 "COM_UINT8_N_APPLTYPEOFTXSIGINFO" /end COMPU_VTAB
/begin COMPU_VTAB Com_BusAccOfTxSigInfoType "" TAB_VERB 5 0 "COM_NBIT_BUSACCOFTXSIGINFO" 1 "COM_BYTE_BUSACCOFTXSIGINFO" 2 "COM_NBYTE_BUSACCOFTXSIGINFO" 4 "COM_NBITNBYTE_BUSACCOFTXSIGINFO" 6 "COM_ARRAY_BASED_BUSACCOFTXSIGINFO" /end COMPU_VTAB
/begin COMPU_VTAB_RANGE Com_DynSignalOfTxSigInfoType "" 2 0 0 "FALSE" 1 255 "TRUE" /end COMPU_VTAB_RANGE
/begin COMPU_VTAB Com_FilterInitValueIdxOfTxSigInfoType "" TAB_VERB 1 255 "COM_NO_FILTERINITVALUEIDXOFTXSIGINFO" /end COMPU_VTAB
/begin COMPU_VTAB Com_FilterInitValueOfTxSigInfoType "" TAB_VERB 3 0 "COM_TXFILTERINITVALUEUINT8_FILTERINITVALUEOFTXSIGINFO" 1 "COM_TXFILTERINITVALUEUINT16_FILTERINITVALUEOFTXSIGINFO" 255 "COM_NO_FILTERINITVALUEOFTXSIGINFO" /end COMPU_VTAB
/begin COMPU_VTAB Com_InvValueIdxOfTxSigInfoType "" TAB_VERB 1 255 "COM_NO_INVVALUEIDXOFTXSIGINFO" /end COMPU_VTAB
/begin COMPU_VTAB Com_InvValueOfTxSigInfoType "" TAB_VERB 4 0 "COM_CONSTVALUEUINT8_INVVALUEOFTXSIGINFO" 1 "COM_CONSTVALUEUINT16_INVVALUEOFTXSIGINFO" 2 "COM_CONSTVALUEUINT32_INVVALUEOFTXSIGINFO" 255 "COM_NO_INVVALUEOFTXSIGINFO" /end COMPU_VTAB
/begin COMPU_VTAB Com_OnChangeIdxOfTxSigInfoType "" TAB_VERB 1 255 "COM_NO_ONCHANGEIDXOFTXSIGINFO" /end COMPU_VTAB
/begin COMPU_VTAB Com_OnChangeOfTxSigInfoType "" TAB_VERB 4 0 "COM_FILTERINFO_UINT8_ONCHANGEOFTXSIGINFO" 2 "COM_FILTERINFO_UINT16_ONCHANGEOFTXSIGINFO" 10 "COM_FILTERINFO_UINT8_N_ONCHANGEOFTXSIGINFO" 255 "COM_NO_ONCHANGEOFTXSIGINFO" /end COMPU_VTAB
/begin COMPU_VTAB Com_TxBufferEndIdxOfTxSigInfoType "" TAB_VERB 1 65535 "COM_NO_TXBUFFERENDIDXOFTXSIGINFO" /end COMPU_VTAB
/begin COMPU_VTAB Com_TxBufferStartIdxOfTxSigInfoType "" TAB_VERB 1 65535 "COM_NO_TXBUFFERSTARTIDXOFTXSIGINFO" /end COMPU_VTAB
/begin COMPU_VTAB Com_TxFilterInitValueArrayBasedFilterInitValueEndIdxOfTxSigInfoType "" TAB_VERB 1 255 "COM_NO_TXFILTERINITVALUEARRAYBASEDFILTERINITVALUEENDIDXOFTXSIGINFO" /end COMPU_VTAB
/begin COMPU_VTAB Com_TxFilterInitValueArrayBasedFilterInitValueStartIdxOfTxSigInfoType "" TAB_VERB 1 255 "COM_NO_TXFILTERINITVALUEARRAYBASEDFILTERINITVALUESTARTIDXOFTXSIGINFO" /end COMPU_VTAB
/begin GROUP Com ""
 /begin REF_MEASUREMENT Com_TxSigInfo[111].TxFilterInitValueArrayBasedFilterInitValueEndIdxOfTxSigInfo Com_TxSigInfo[111].TxFilterInitValueArrayBasedFilterInitValueStartIdxOfTxSigInfo Com_TxSigInfo[111].TxPduInfoIdxOfTxSigInfo Com_TxSigInfo[112].ApplTypeOfTxSigInfo Com_TxSigInfo[112].BitLengthOfTxSigInfo Com_TxSigInfo[112].BitPositionOfTxSigInfo Com_TxSigInfo[112].BusAccOfTxSigInfo Com_TxSigInfo[112].ByteLengthOfTxSigInfo Com_TxSigInfo[112].DynSignalOfTxSigInfo Com_TxSigInfo[112].FilterInitValueIdxOfTxSigInfo Com_TxSigInfo[112].FilterInitValueOfTxSigInfo Com_TxSigInfo[112].InvValueIdxOfTxSigInfo Com_TxSigInfo[112].InvValueOfTxSigInfo Com_TxSigInfo[112].OnChangeIdxOfTxSigInfo Com_TxSigInfo[112].OnChangeOfTxSigInfo Com_TxSigInfo[112].StartByteInPduPositionOfTxSigInfo Com_TxSigInfo[112].TxAccessInfoIdxOfTxSigInfo Com_TxSigInfo[112].TxBufferEndIdxOfTxSigInfo Com_TxSigInfo[112].TxBufferStartIdxOfTxSigInfo Com_TxSigInfo[112].TxFilterInitValueArrayBasedFilterInitValueEndIdxOfTxSigInfo Com_TxSigInfo[112].TxFilterInitValueArrayBasedFilterInitValueStartIdxOfTxSigInfo Com_TxSigInfo[112].TxPduInfoIdxOfTxSigInfo Com_TxSigInfo[113].ApplTypeOfTxSigInfo Com_TxSigInfo[113].BitLengthOfTxSigInfo Com_TxSigInfo[113].BitPositionOfTxSigInfo Com_TxSigInfo[113].BusAccOfTxSigInfo Com_TxSigInfo[113].ByteLengthOfTxSigInfo Com_TxSigInfo[113].DynSignalOfTxSigInfo Com_TxSigInfo[113].FilterInitValueIdxOfTxSigInfo Com_TxSigInfo[113].FilterInitValueOfTxSigInfo Com_TxSigInfo[113].InvValueIdxOfTxSigInfo Com_TxSigInfo[113].InvValueOfTxSigInfo Com_TxSigInfo[113].OnChangeIdxOfTxSigInfo Com_TxSigInfo[113].OnChangeOfTxSigInfo Com_TxSigInfo[113].StartByteInPduPositionOfTxSigInfo Com_TxSigInfo[113].TxAccessInfoIdxOfTxSigInfo Com_TxSigInfo[113].TxBufferEndIdxOfTxSigInfo Com_TxSigInfo[113].TxBufferStartIdxOfTxSigInfo Com_TxSigInfo[113].TxFilterInitValueArrayBasedFilterInitValueEndIdxOfTxSigInfo Com_TxSigInfo[113].TxFilterInitValueArrayBasedFilterInitValueStartIdxOfTxSigInfo Com_TxSigInfo[113].TxPduInfoIdxOfTxSigInfo Com_TxSigInfo[114].ApplTypeOfTxSigInfo Com_TxSigInfo[114].BitLengthOfTxSigInfo Com_TxSigInfo[114].BitPositionOfTxSigInfo Com_TxSigInfo[114].BusAccOfTxSigInfo Com_TxSigInfo[114].ByteLengthOfTxSigInfo Com_TxSigInfo[114].DynSignalOfTxSigInfo Com_TxSigInfo[114].FilterInitValueIdxOfTxSigInfo Com_TxSigInfo[114].FilterInitValueOfTxSigInfo Com_TxSigInfo[114].InvValueIdxOfTxSigInfo Com_TxSigInfo[114].InvValueOfTxSigInfo Com_TxSigInfo[114].OnChangeIdxOfTxSigInfo Com_TxSigInfo[114].OnChangeOfTxSigInfo Com_TxSigInfo[114].StartByteInPduPositionOfTxSigInfo Com_TxSigInfo[114].TxAccessInfoIdxOfTxSigInfo Com_TxSigInfo[114].TxBufferEndIdxOfTxSigInfo Com_TxSigInfo[114].TxBufferStartIdxOfTxSigInfo Com_TxSigInfo[114].TxFilterInitValueArrayBasedFilterInitValueEndIdxOfTxSigInfo Com_TxSigInfo[114].TxFilterInitValueArrayBasedFilterInitValueStartIdxOfTxSigInfo Com_TxSigInfo[114].TxPduInfoIdxOfTxSigInfo Com_TxSigInfo[115].ApplTypeOfTxSigInfo Com_TxSigInfo[115].BitLengthOfTxSigInfo Com_TxSigInfo[115].BitPositionOfTxSigInfo Com_TxSigInfo[115].BusAccOfTxSigInfo Com_TxSigInfo[115].ByteLengthOfTxSigInfo Com_TxSigInfo[115].DynSignalOfTxSigInfo Com_TxSigInfo[115].FilterInitValueIdxOfTxSigInfo Com_TxSigInfo[115].FilterInitValueOfTxSigInfo Com_TxSigInfo[115].InvValueIdxOfTxSigInfo Com_TxSigInfo[115].InvValueOfTxSigInfo Com_TxSigInfo[115].OnChangeIdxOfTxSigInfo Com_TxSigInfo[115].OnChangeOfTxSigInfo Com_TxSigInfo[115].StartByteInPduPositionOfTxSigInfo Com_TxSigInfo[115].TxAccessInfoIdxOfTxSigInfo Com_TxSigInfo[115].TxBufferEndIdxOfTxSigInfo Com_TxSigInfo[115].TxBufferStartIdxOfTxSigInfo Com_TxSigInfo[115].TxFilterInitValueArrayBasedFilterInitValueEndIdxOfTxSigInfo Com_TxSigInfo[115].TxFilterInitValueArrayBasedFilterInitValueStartIdxOfTxSigInfo Com_TxSigInfo[115].TxPduInfoIdxOfTxSigInfo Com_TxSigInfo[116].ApplTypeOfTxSigInfo Com_TxSigInfo[116].BitLengthOfTxSigInfo Com_TxSigInfo[116].BitPositionOfTxSigInfo Com_TxSigInfo[116].BusAccOfTxSigInfo Com_TxSigInfo[116].ByteLengthOfTxSigInfo Com_TxSigInfo[116].DynSignalOfTxSigInfo Com_TxSigInfo[116].FilterInitValueIdxOfTxSigInfo Com_TxSigInfo[116].FilterInitValueOfTxSigInfo Com_TxSigInfo[116].InvValueIdxOfTxSigInfo Com_TxSigInfo[116].InvValueOfTxSigInfo Com_TxSigInfo[116].OnChangeIdxOfTxSigInfo Com_TxSigInfo[116].OnChangeOfTxSigInfo Com_TxSigInfo[116].StartByteInPduPositionOfTxSigInfo Com_TxSigInfo[116].TxAccessInfoIdxOfTxSigInfo Com_TxSigInfo[116].TxBufferEndIdxOfTxSigInfo Com_TxSigInfo[116].TxBufferStartIdxOfTxSigInfo Com_TxSigInfo[116].TxFilterInitValueArrayBasedFilterInitValueEndIdxOfTxSigInfo Com_TxSigInfo[116].TxFilterInitValueArrayBasedFilterInitValueStartIdxOfTxSigInfo Com_TxSigInfo[116].TxPduInfoIdxOfTxSigInfo Com_TxSigInfo[117].ApplTypeOfTxSigInfo Com_TxSigInfo[117].BitLengthOfTxSigInfo Com_TxSigInfo[117].BitPositionOfTxSigInfo Com_TxSigInfo[117].BusAccOfTxSigInfo Com_TxSigInfo[117].ByteLengthOfTxSigInfo Com_TxSigInfo[117].DynSignalOfTxSigInfo Com_TxSigInfo[117].FilterInitValueIdxOfTxSigInfo Com_TxSigInfo[117].FilterInitValueOfTxSigInfo Com_TxSigInfo[117].InvValueIdxOfTxSigInfo Com_TxSigInfo[117].InvValueOfTxSigInfo Com_TxSigInfo[117].OnChangeIdxOfTxSigInfo Com_TxSigInfo[117].OnChangeOfTxSigInfo Com_TxSigInfo[117].StartByteInPduPositionOfTxSigInfo Com_TxSigInfo[117].TxAccessInfoIdxOfTxSigInfo Com_TxSigInfo[117].TxBufferEndIdxOfTxSigInfo Com_TxSigInfo[117].TxBufferStartIdxOfTxSigInfo Com_TxSigInfo[117].TxFilterInitValueArrayBasedFilterInitValueEndIdxOfTxSigInfo Com_TxSigInfo[117].TxFilterInitValueArrayBasedFilterInitValueStartIdxOfTxSigInfo Com_TxSigInfo[117].TxPduInfoIdxOfTxSigInfo Com_TxSigInfo[118].ApplTypeOfTxSigInfo Com_TxSigInfo[118].BitLengthOfTxSigInfo Com_TxSigInfo[118].BitPositionOfTxSigInfo Com_TxSigInfo[118].BusAccOfTxSigInfo Com_TxSigInfo[118].ByteLengthOfTxSigInfo Com_TxSigInfo[118].DynSignalOfTxSigInfo Com_TxSigInfo[118].FilterInitValueIdxOfTxSigInfo Com_TxSigInfo[118].FilterInitValueOfTxSigInfo Com_TxSigInfo[118].InvValueIdxOfTxSigInfo Com_TxSigInfo[118].InvValueOfTxSigInfo Com_TxSigInfo[118].OnChangeIdxOfTxSigInfo Com_TxSigInfo[118].OnChangeOfTxSigInfo Com_TxSigInfo[118].StartByteInPduPositionOfTxSigInfo Com_TxSigInfo[118].TxAccessInfoIdxOfTxSigInfo Com_TxSigInfo[118].TxBufferEndIdxOfTxSigInfo Com_TxSigInfo[118].TxBufferStartIdxOfTxSigInfo Com_TxSigInfo[118].TxFilterInitValueArrayBasedFilterInitValueEndIdxOfTxSigInfo Com_TxSigInfo[118].TxFilterInitValueArrayBasedFilterInitValueStartIdxOfTxSigInfo Com_TxSigInfo[118].TxPduInfoIdxOfTxSigInfo Com_TxSigInfo[119].ApplTypeOfTxSigInfo Com_TxSigInfo[119].BitLengthOfTxSigInfo Com_TxSigInfo[119].BitPositionOfTxSigInfo Com_TxSigInfo[119].BusAccOfTxSigInfo Com_TxSigInfo[119].ByteLengthOfTxSigInfo Com_TxSigInfo[119].DynSignalOfTxSigInfo Com_TxSigInfo[119].FilterInitValueIdxOfTxSigInfo Com_TxSigInfo[119].FilterInitValueOfTxSigInfo Com_TxSigInfo[119].InvValueIdxOfTxSigInfo Com_TxSigInfo[119].InvValueOfTxSigInfo Com_TxSigInfo[119].OnChangeIdxOfTxSigInfo Com_TxSigInfo[119].OnChangeOfTxSigInfo Com_TxSigInfo[119].StartByteInPduPositionOfTxSigInfo Com_TxSigInfo[119].TxAccessInfoIdxOfTxSigInfo Com_TxSigInfo[119].TxBufferEndIdxOfTxSigInfo Com_TxSigInfo[119].TxBufferStartIdxOfTxSigInfo Com_TxSigInfo[119].TxFilterInitValueArrayBasedFilterInitValueEndIdxOfTxSigInfo Com_TxSigInfo[119].TxFilterInitValueArrayBasedFilterInitValueStartIdxOfTxSigInfo Com_TxSigInfo[119].TxPduInfoIdxOfTxSigInfo Com_TxSigInfo[11].ApplTypeOfTxSigInfo Com_TxSigInfo[11].BitLengthOfTxSigInfo Com_TxSigInfo[11].BitPositionOfTxSigInfo Com_TxSigInfo[11].BusAccOfTxSigInfo Com_TxSigInfo[11].ByteLengthOfTxSigInfo Com_TxSigInfo[11].DynSignalOfTxSigInfo Com_TxSigInfo[11].FilterInitValueIdxOfTxSigInfo Com_TxSigInfo[11].FilterInitValueOfTxSigInfo Com_TxSigInfo[11].InvValueIdxOfTxSigInfo Com_TxSigInfo[11].InvValueOfTxSigInfo Com_TxSigInfo[11].OnChangeIdxOfTxSigInfo Com_TxSigInfo[11].OnChangeOfTxSigInfo Com_TxSigInfo[11].StartByteInPduPositionOfTxSigInfo Com_TxSigInfo[11].TxAccessInfoIdxOfTxSigInfo Com_TxSigInfo[11].TxBufferEndIdxOfTxSigInfo Com_TxSigInfo[11].TxBufferStartIdxOfTxSigInfo Com_TxSigInfo[11].TxFilterInitValueArrayBasedFilterInitValueEndIdxOfTxSigInfo Com_TxSigInfo[11].TxFilterInitValueArrayBasedFilterInitValueStartIdxOfTxSigInfo Com_TxSigInfo[11].TxPduInfoIdxOfTxSigInfo Com_TxSigInfo[120].ApplTypeOfTxSigInfo Com_TxSigInfo[120].BitLengthOfTxSigInfo Com_TxSigInfo[120].BitPositionOfTxSigInfo Com_TxSigInfo[120].BusAccOfTxSigInfo Com_TxSigInfo[120].ByteLengthOfTxSigInfo Com_TxSigInfo[120].DynSignalOfTxSigInfo Com_TxSigInfo[120].FilterInitValueIdxOfTxSigInfo Com_TxSigInfo[120].FilterInitValueOfTxSigInfo Com_TxSigInfo[120].InvValueIdxOfTxSigInfo Com_TxSigInfo[120].InvValueOfTxSigInfo Com_TxSigInfo[120].OnChangeIdxOfTxSigInfo Com_TxSigInfo[120].OnChangeOfTxSigInfo Com_TxSigInfo[120].StartByteInPduPositionOfTxSigInfo Com_TxSigInfo[120].TxAccessInfoIdxOfTxSigInfo Com_TxSigInfo[120].TxBufferEndIdxOfTxSigInfo Com_TxSigInfo[120].TxBufferStartIdxOfTxSigInfo Com_TxSigInfo[120].TxFilterInitValueArrayBasedFilterInitValueEndIdxOfTxSigInfo Com_TxSigInfo[120].TxFilterInitValueArrayBasedFilterInitValueStartIdxOfTxSigInfo Com_TxSigInfo[120].TxPduInfoIdxOfTxSigInfo Com_TxSigInfo[121].ApplTypeOfTxSigInfo Com_TxSigInfo[121].BitLengthOfTxSigInfo Com_TxSigInfo[121].BitPositionOfTxSigInfo Com_TxSigInfo[121].BusAccOfTxSigInfo Com_TxSigInfo[121].ByteLengthOfTxSigInfo Com_TxSigInfo[121].DynSignalOfTxSigInfo Com_TxSigInfo[121].FilterInitValueIdxOfTxSigInfo Com_TxSigInfo[121].FilterInitValueOfTxSigInfo Com_TxSigInfo[121].InvValueIdxOfTxSigInfo Com_TxSigInfo[121].InvValueOfTxSigInfo Com_TxSigInfo[121].OnChangeIdxOfTxSigInfo Com_TxSigInfo[121].OnChangeOfTxSigInfo Com_TxSigInfo[121].StartByteInPduPositionOfTxSigInfo Com_TxSigInfo[121].TxAccessInfoIdxOfTxSigInfo Com_TxSigInfo[121].TxBufferEndIdxOfTxSigInfo Com_TxSigInfo[121].TxBufferStartIdxOfTxSigInfo Com_TxSigInfo[121].TxFilterInitValueArrayBasedFilterInitValueEndIdxOfTxSigInfo Com_TxSigInfo[121].TxFilterInitValueArrayBasedFilterInitValueStartIdxOfTxSigInfo Com_TxSigInfo[121].TxPduInfoIdxOfTxSigInfo Com_TxSigInfo[122].ApplTypeOfTxSigInfo Com_TxSigInfo[122].BitLengthOfTxSigInfo Com_TxSigInfo[122].BitPositionOfTxSigInfo Com_TxSigInfo[122].BusAccOfTxSigInfo Com_TxSigInfo[122].ByteLengthOfTxSigInfo Com_TxSigInfo[122].DynSignalOfTxSigInfo Com_TxSigInfo[122].FilterInitValueIdxOfTxSigInfo Com_TxSigInfo[122].FilterInitValueOfTxSigInfo Com_TxSigInfo[122].InvValueIdxOfTxSigInfo Com_TxSigInfo[122].InvValueOfTxSigInfo Com_TxSigInfo[122].OnChangeIdxOfTxSigInfo Com_TxSigInfo[122].OnChangeOfTxSigInfo Com_TxSigInfo[122].StartByteInPduPositionOfTxSigInfo Com_TxSigInfo[122].TxAccessInfoIdxOfTxSigInfo Com_TxSigInfo[122].TxBufferEndIdxOfTxSigInfo Com_TxSigInfo[122].TxBufferStartIdxOfTxSigInfo Com_TxSigInfo[122].TxFilterInitValueArrayBasedFilterInitValueEndIdxOfTxSigInfo Com_TxSigInfo[122].TxFilterInitValueArrayBasedFilterInitValueStartIdxOfTxSigInfo Com_TxSigInfo[122].TxPduInfoIdxOfTxSigInfo Com_TxSigInfo[123].ApplTypeOfTxSigInfo Com_TxSigInfo[123].BitLengthOfTxSigInfo Com_TxSigInfo[123].BitPositionOfTxSigInfo Com_TxSigInfo[123].BusAccOfTxSigInfo Com_TxSigInfo[123].ByteLengthOfTxSigInfo Com_TxSigInfo[123].DynSignalOfTxSigInfo Com_TxSigInfo[123].FilterInitValueIdxOfTxSigInfo Com_TxSigInfo[123].FilterInitValueOfTxSigInfo Com_TxSigInfo[123].InvValueIdxOfTxSigInfo Com_TxSigInfo[123].InvValueOfTxSigInfo Com_TxSigInfo[123].OnChangeIdxOfTxSigInfo Com_TxSigInfo[123].OnChangeOfTxSigInfo Com_TxSigInfo[123].StartByteInPduPositionOfTxSigInfo Com_TxSigInfo[123].TxAccessInfoIdxOfTxSigInfo Com_TxSigInfo[123].TxBufferEndIdxOfTxSigInfo Com_TxSigInfo[123].TxBufferStartIdxOfTxSigInfo Com_TxSigInfo[123].TxFilterInitValueArrayBasedFilterInitValueEndIdxOfTxSigInfo Com_TxSigInfo[123].TxFilterInitValueArrayBasedFilterInitValueStartIdxOfTxSigInfo Com_TxSigInfo[123].TxPduInfoIdxOfTxSigInfo Com_TxSigInfo[124].ApplTypeOfTxSigInfo Com_TxSigInfo[124].BitLengthOfTxSigInfo Com_TxSigInfo[124].BitPositionOfTxSigInfo Com_TxSigInfo[124].BusAccOfTxSigInfo Com_TxSigInfo[124].ByteLengthOfTxSigInfo Com_TxSigInfo[124].DynSignalOfTxSigInfo Com_TxSigInfo[124].FilterInitValueIdxOfTxSigInfo Com_TxSigInfo[124].FilterInitValueOfTxSigInfo Com_TxSigInfo[124].InvValueIdxOfTxSigInfo Com_TxSigInfo[124].InvValueOfTxSigInfo Com_TxSigInfo[124].OnChangeIdxOfTxSigInfo Com_TxSigInfo[124].OnChangeOfTxSigInfo Com_TxSigInfo[124].StartByteInPduPositionOfTxSigInfo Com_TxSigInfo[124].TxAccessInfoIdxOfTxSigInfo Com_TxSigInfo[124].TxBufferEndIdxOfTxSigInfo Com_TxSigInfo[124].TxBufferStartIdxOfTxSigInfo Com_TxSigInfo[124].TxFilterInitValueArrayBasedFilterInitValueEndIdxOfTxSigInfo Com_TxSigInfo[124].TxFilterInitValueArrayBasedFilterInitValueStartIdxOfTxSigInfo Com_TxSigInfo[124].TxPduInfoIdxOfTxSigInfo Com_TxSigInfo[125].ApplTypeOfTxSigInfo Com_TxSigInfo[125].BitLengthOfTxSigInfo Com_TxSigInfo[125].BitPositionOfTxSigInfo Com_TxSigInfo[125].BusAccOfTxSigInfo Com_TxSigInfo[125].ByteLengthOfTxSigInfo Com_TxSigInfo[125].DynSignalOfTxSigInfo Com_TxSigInfo[125].FilterInitValueIdxOfTxSigInfo Com_TxSigInfo[125].FilterInitValueOfTxSigInfo Com_TxSigInfo[125].InvValueIdxOfTxSigInfo Com_TxSigInfo[125].InvValueOfTxSigInfo Com_TxSigInfo[125].OnChangeIdxOfTxSigInfo Com_TxSigInfo[125].OnChangeOfTxSigInfo Com_TxSigInfo[125].StartByteInPduPositionOfTxSigInfo Com_TxSigInfo[125].TxAccessInfoIdxOfTxSigInfo Com_TxSigInfo[125].TxBufferEndIdxOfTxSigInfo Com_TxSigInfo[125].TxBufferStartIdxOfTxSigInfo Com_TxSigInfo[125].TxFilterInitValueArrayBasedFilterInitValueEndIdxOfTxSigInfo Com_TxSigInfo[125].TxFilterInitValueArrayBasedFilterInitValueStartIdxOfTxSigInfo Com_TxSigInfo[125].TxPduInfoIdxOfTxSigInfo Com_TxSigInfo[126].ApplTypeOfTxSigInfo Com_TxSigInfo[126].BitLengthOfTxSigInfo Com_TxSigInfo[126].BitPositionOfTxSigInfo Com_TxSigInfo[126].BusAccOfTxSigInfo Com_TxSigInfo[126].ByteLengthOfTxSigInfo Com_TxSigInfo[126].DynSignalOfTxSigInfo Com_TxSigInfo[126].FilterInitValueIdxOfTxSigInfo Com_TxSigInfo[126].FilterInitValueOfTxSigInfo Com_TxSigInfo[126].InvValueIdxOfTxSigInfo Com_TxSigInfo[126].InvValueOfTxSigInfo Com_TxSigInfo[126].OnChangeIdxOfTxSigInfo Com_TxSigInfo[126].OnChangeOfTxSigInfo Com_TxSigInfo[126].StartByteInPduPositionOfTxSigInfo Com_TxSigInfo[126].TxAccessInfoIdxOfTxSigInfo Com_TxSigInfo[126].TxBufferEndIdxOfTxSigInfo Com_TxSigInfo[126].TxBufferStartIdxOfTxSigInfo Com_TxSigInfo[126].TxFilterInitValueArrayBasedFilterInitValueEndIdxOfTxSigInfo Com_TxSigInfo[126].TxFilterInitValueArrayBasedFilterInitValueStartIdxOfTxSigInfo Com_TxSigInfo[126].TxPduInfoIdxOfTxSigInfo Com_TxSigInfo[127].ApplTypeOfTxSigInfo Com_TxSigInfo[127].BitLengthOfTxSigInfo Com_TxSigInfo[127].BitPositionOfTxSigInfo Com_TxSigInfo[127].BusAccOfTxSigInfo Com_TxSigInfo[127].ByteLengthOfTxSigInfo Com_TxSigInfo[127].DynSignalOfTxSigInfo Com_TxSigInfo[127].FilterInitValueIdxOfTxSigInfo Com_TxSigInfo[127].FilterInitValueOfTxSigInfo Com_TxSigInfo[127].InvValueIdxOfTxSigInfo Com_TxSigInfo[127].InvValueOfTxSigInfo Com_TxSigInfo[127].OnChangeIdxOfTxSigInfo Com_TxSigInfo[127].OnChangeOfTxSigInfo Com_TxSigInfo[127].StartByteInPduPositionOfTxSigInfo Com_TxSigInfo[127].TxAccessInfoIdxOfTxSigInfo Com_TxSigInfo[127].TxBufferEndIdxOfTxSigInfo Com_TxSigInfo[127].TxBufferStartIdxOfTxSigInfo Com_TxSigInfo[127].TxFilterInitValueArrayBasedFilterInitValueEndIdxOfTxSigInfo Com_TxSigInfo[127].TxFilterInitValueArrayBasedFilterInitValueStartIdxOfTxSigInfo Com_TxSigInfo[127].TxPduInfoIdxOfTxSigInfo Com_TxSigInfo[128].ApplTypeOfTxSigInfo Com_TxSigInfo[128].BitLengthOfTxSigInfo Com_TxSigInfo[128].BitPositionOfTxSigInfo Com_TxSigInfo[128].BusAccOfTxSigInfo Com_TxSigInfo[128].ByteLengthOfTxSigInfo Com_TxSigInfo[128].DynSignalOfTxSigInfo Com_TxSigInfo[128].FilterInitValueIdxOfTxSigInfo Com_TxSigInfo[128].FilterInitValueOfTxSigInfo Com_TxSigInfo[128].InvValueIdxOfTxSigInfo Com_TxSigInfo[128].InvValueOfTxSigInfo Com_TxSigInfo[128].OnChangeIdxOfTxSigInfo Com_TxSigInfo[128].OnChangeOfTxSigInfo Com_TxSigInfo[128].StartByteInPduPositionOfTxSigInfo Com_TxSigInfo[128].TxAccessInfoIdxOfTxSigInfo Com_TxSigInfo[128].TxBufferEndIdxOfTxSigInfo Com_TxSigInfo[128].TxBufferStartIdxOfTxSigInfo Com_TxSigInfo[128].TxFilterInitValueArrayBasedFilterInitValueEndIdxOfTxSigInfo Com_TxSigInfo[128].TxFilterInitValueArrayBasedFilterInitValueStartIdxOfTxSigInfo Com_TxSigInfo[128].TxPduInfoIdxOfTxSigInfo Com_TxSigInfo[129].ApplTypeOfTxSigInfo Com_TxSigInfo[129].BitLengthOfTxSigInfo Com_TxSigInfo[129].BitPositionOfTxSigInfo Com_TxSigInfo[129].BusAccOfTxSigInfo Com_TxSigInfo[129].ByteLengthOfTxSigInfo Com_TxSigInfo[129].DynSignalOfTxSigInfo Com_TxSigInfo[129].FilterInitValueIdxOfTxSigInfo Com_TxSigInfo[129].FilterInitValueOfTxSigInfo Com_TxSigInfo[129].InvValueIdxOfTxSigInfo Com_TxSigInfo[129].InvValueOfTxSigInfo Com_TxSigInfo[129].OnChangeIdxOfTxSigInfo Com_TxSigInfo[129].OnChangeOfTxSigInfo Com_TxSigInfo[129].StartByteInPduPositionOfTxSigInfo Com_TxSigInfo[129].TxAccessInfoIdxOfTxSigInfo Com_TxSigInfo[129].TxBufferEndIdxOfTxSigInfo Com_TxSigInfo[129].TxBufferStartIdxOfTxSigInfo Com_TxSigInfo[129].TxFilterInitValueArrayBasedFilterInitValueEndIdxOfTxSigInfo Com_TxSigInfo[129].TxFilterInitValueArrayBasedFilterInitValueStartIdxOfTxSigInfo Com_TxSigInfo[129].TxPduInfoIdxOfTxSigInfo Com_TxSigInfo[12].ApplTypeOfTxSigInfo Com_TxSigInfo[12].BitLengthOfTxSigInfo Com_TxSigInfo[12].BitPositionOfTxSigInfo Com_TxSigInfo[12].BusAccOfTxSigInfo Com_TxSigInfo[12].ByteLengthOfTxSigInfo Com_TxSigInfo[12].DynSignalOfTxSigInfo Com_TxSigInfo[12].FilterInitValueIdxOfTxSigInfo Com_TxSigInfo[12].FilterInitValueOfTxSigInfo Com_TxSigInfo[12].InvValueIdxOfTxSigInfo Com_TxSigInfo[12].InvValueOfTxSigInfo Com_TxSigInfo[12].OnChangeIdxOfTxSigInfo Com_TxSigInfo[12].OnChangeOfTxSigInfo Com_TxSigInfo[12].StartByteInPduPositionOfTxSigInfo Com_TxSigInfo[12].TxAccessInfoIdxOfTxSigInfo Com_TxSigInfo[12].TxBufferEndIdxOfTxSigInfo Com_TxSigInfo[12].TxBufferStartIdxOfTxSigInfo Com_TxSigInfo[12].TxFilterInitValueArrayBasedFilterInitValueEndIdxOfTxSigInfo Com_TxSigInfo[12].TxFilterInitValueArrayBasedFilterInitValueStartIdxOfTxSigInfo Com_TxSigInfo[12].TxPduInfoIdxOfTxSigInfo Com_TxSigInfo[130].ApplTypeOfTxSigInfo Com_TxSigInfo[130].BitLengthOfTxSigInfo Com_TxSigInfo[130].BitPositionOfTxSigInfo Com_TxSigInfo[130].BusAccOfTxSigInfo Com_TxSigInfo[130].ByteLengthOfTxSigInfo Com_TxSigInfo[130].DynSignalOfTxSigInfo Com_TxSigInfo[130].FilterInitValueIdxOfTxSigInfo Com_TxSigInfo[130].FilterInitValueOfTxSigInfo Com_TxSigInfo[130].InvValueIdxOfTxSigInfo Com_TxSigInfo[130].InvValueOfTxSigInfo Com_TxSigInfo[130].OnChangeIdxOfTxSigInfo Com_TxSigInfo[130].OnChangeOfTxSigInfo Com_TxSigInfo[130].StartByteInPduPositionOfTxSigInfo Com_TxSigInfo[130].TxAccessInfoIdxOfTxSigInfo Com_TxSigInfo[130].TxBufferEndIdxOfTxSigInfo Com_TxSigInfo[130].TxBufferStartIdxOfTxSigInfo Com_TxSigInfo[130].TxFilterInitValueArrayBasedFilterInitValueEndIdxOfTxSigInfo Com_TxSigInfo[130].TxFilterInitValueArrayBasedFilterInitValueStartIdxOfTxSigInfo Com_TxSigInfo[130].TxPduInfoIdxOfTxSigInfo Com_TxSigInfo[131].ApplTypeOfTxSigInfo Com_TxSigInfo[131].BitLengthOfTxSigInfo Com_TxSigInfo[131].BitPositionOfTxSigInfo Com_TxSigInfo[131].BusAccOfTxSigInfo Com_TxSigInfo[131].ByteLengthOfTxSigInfo Com_TxSigInfo[131].DynSignalOfTxSigInfo Com_TxSigInfo[131].FilterInitValueIdxOfTxSigInfo Com_TxSigInfo[131].FilterInitValueOfTxSigInfo Com_TxSigInfo[131].InvValueIdxOfTxSigInfo Com_TxSigInfo[131].InvValueOfTxSigInfo Com_TxSigInfo[131].OnChangeIdxOfTxSigInfo Com_TxSigInfo[131].OnChangeOfTxSigInfo Com_TxSigInfo[131].StartByteInPduPositionOfTxSigInfo Com_TxSigInfo[131].TxAccessInfoIdxOfTxSigInfo Com_TxSigInfo[131].TxBufferEndIdxOfTxSigInfo Com_TxSigInfo[131].TxBufferStartIdxOfTxSigInfo Com_TxSigInfo[131].TxFilterInitValueArrayBasedFilterInitValueEndIdxOfTxSigInfo Com_TxSigInfo[131].TxFilterInitValueArrayBasedFilterInitValueStartIdxOfTxSigInfo Com_TxSigInfo[131].TxPduInfoIdxOfTxSigInfo Com_TxSigInfo[132].ApplTypeOfTxSigInfo Com_TxSigInfo[132].BitLengthOfTxSigInfo Com_TxSigInfo[132].BitPositionOfTxSigInfo Com_TxSigInfo[132].BusAccOfTxSigInfo Com_TxSigInfo[132].ByteLengthOfTxSigInfo Com_TxSigInfo[132].DynSignalOfTxSigInfo Com_TxSigInfo[132].FilterInitValueIdxOfTxSigInfo Com_TxSigInfo[132].FilterInitValueOfTxSigInfo Com_TxSigInfo[132].InvValueIdxOfTxSigInfo Com_TxSigInfo[132].InvValueOfTxSigInfo Com_TxSigInfo[132].OnChangeIdxOfTxSigInfo Com_TxSigInfo[132].OnChangeOfTxSigInfo Com_TxSigInfo[132].StartByteInPduPositionOfTxSigInfo Com_TxSigInfo[132].TxAccessInfoIdxOfTxSigInfo Com_TxSigInfo[132].TxBufferEndIdxOfTxSigInfo Com_TxSigInfo[132].TxBufferStartIdxOfTxSigInfo Com_TxSigInfo[132].TxFilterInitValueArrayBasedFilterInitValueEndIdxOfTxSigInfo Com_TxSigInfo[132].TxFilterInitValueArrayBasedFilterInitValueStartIdxOfTxSigInfo Com_TxSigInfo[132].TxPduInfoIdxOfTxSigInfo Com_TxSigInfo[133].ApplTypeOfTxSigInfo Com_TxSigInfo[133].BitLengthOfTxSigInfo Com_TxSigInfo[133].BitPositionOfTxSigInfo Com_TxSigInfo[133].BusAccOfTxSigInfo Com_TxSigInfo[133].ByteLengthOfTxSigInfo Com_TxSigInfo[133].DynSignalOfTxSigInfo Com_TxSigInfo[133].FilterInitValueIdxOfTxSigInfo Com_TxSigInfo[133].FilterInitValueOfTxSigInfo Com_TxSigInfo[133].InvValueIdxOfTxSigInfo Com_TxSigInfo[133].InvValueOfTxSigInfo Com_TxSigInfo[133].OnChangeIdxOfTxSigInfo Com_TxSigInfo[133].OnChangeOfTxSigInfo Com_TxSigInfo[133].StartByteInPduPositionOfTxSigInfo Com_TxSigInfo[133].TxAccessInfoIdxOfTxSigInfo Com_TxSigInfo[133].TxBufferEndIdxOfTxSigInfo Com_TxSigInfo[133].TxBufferStartIdxOfTxSigInfo Com_TxSigInfo[133].TxFilterInitValueArrayBasedFilterInitValueEndIdxOfTxSigInfo Com_TxSigInfo[133].TxFilterInitValueArrayBasedFilterInitValueStartIdxOfTxSigInfo Com_TxSigInfo[133].TxPduInfoIdxOfTxSigInfo Com_TxSigInfo[134].ApplTypeOfTxSigInfo Com_TxSigInfo[134].BitLengthOfTxSigInfo Com_TxSigInfo[134].BitPositionOfTxSigInfo Com_TxSigInfo[134].BusAccOfTxSigInfo Com_TxSigInfo[134].ByteLengthOfTxSigInfo Com_TxSigInfo[134].DynSignalOfTxSigInfo Com_TxSigInfo[134].FilterInitValueIdxOfTxSigInfo Com_TxSigInfo[134].FilterInitValueOfTxSigInfo Com_TxSigInfo[134].InvValueIdxOfTxSigInfo Com_TxSigInfo[134].InvValueOfTxSigInfo Com_TxSigInfo[134].OnChangeIdxOfTxSigInfo Com_TxSigInfo[134].OnChangeOfTxSigInfo Com_TxSigInfo[134].StartByteInPduPositionOfTxSigInfo Com_TxSigInfo[134].TxAccessInfoIdxOfTxSigInfo Com_TxSigInfo[134].TxBufferEndIdxOfTxSigInfo Com_TxSigInfo[134].TxBufferStartIdxOfTxSigInfo Com_TxSigInfo[134].TxFilterInitValueArrayBasedFilterInitValueEndIdxOfTxSigInfo Com_TxSigInfo[134].TxFilterInitValueArrayBasedFilterInitValueStartIdxOfTxSigInfo Com_TxSigInfo[134].TxPduInfoIdxOfTxSigInfo Com_TxSigInfo[135].ApplTypeOfTxSigInfo Com_TxSigInfo[135].BitLengthOfTxSigInfo Com_TxSigInfo[135].BitPositionOfTxSigInfo Com_TxSigInfo[135].BusAccOfTxSigInfo Com_TxSigInfo[135].ByteLengthOfTxSigInfo Com_TxSigInfo[135].DynSignalOfTxSigInfo Com_TxSigInfo[135].FilterInitValueIdxOfTxSigInfo Com_TxSigInfo[135].FilterInitValueOfTxSigInfo Com_TxSigInfo[135].InvValueIdxOfTxSigInfo Com_TxSigInfo[135].InvValueOfTxSigInfo Com_TxSigInfo[135].OnChangeIdxOfTxSigInfo Com_TxSigInfo[135].OnChangeOfTxSigInfo Com_TxSigInfo[135].StartByteInPduPositionOfTxSigInfo Com_TxSigInfo[135].TxAccessInfoIdxOfTxSigInfo Com_TxSigInfo[135].TxBufferEndIdxOfTxSigInfo Com_TxSigInfo[135].TxBufferStartIdxOfTxSigInfo Com_TxSigInfo[135].TxFilterInitValueArrayBasedFilterInitValueEndIdxOfTxSigInfo Com_TxSigInfo[135].TxFilterInitValueArrayBasedFilterInitValueStartIdxOfTxSigInfo Com_TxSigInfo[135].TxPduInfoIdxOfTxSigInfo Com_TxSigInfo[136].ApplTypeOfTxSigInfo Com_TxSigInfo[136].BitLengthOfTxSigInfo Com_TxSigInfo[136].BitPositionOfTxSigInfo Com_TxSigInfo[136].BusAccOfTxSigInfo Com_TxSigInfo[136].ByteLengthOfTxSigInfo Com_TxSigInfo[136].DynSignalOfTxSigInfo Com_TxSigInfo[136].FilterInitValueIdxOfTxSigInfo Com_TxSigInfo[136].FilterInitValueOfTxSigInfo Com_TxSigInfo[136].InvValueIdxOfTxSigInfo Com_TxSigInfo[136].InvValueOfTxSigInfo Com_TxSigInfo[136].OnChangeIdxOfTxSigInfo Com_TxSigInfo[136].OnChangeOfTxSigInfo Com_TxSigInfo[136].StartByteInPduPositionOfTxSigInfo Com_TxSigInfo[136].TxAccessInfoIdxOfTxSigInfo Com_TxSigInfo[136].TxBufferEndIdxOfTxSigInfo Com_TxSigInfo[136].TxBufferStartIdxOfTxSigInfo Com_TxSigInfo[136].TxFilterInitValueArrayBasedFilterInitValueEndIdxOfTxSigInfo Com_TxSigInfo[136].TxFilterInitValueArrayBasedFilterInitValueStartIdxOfTxSigInfo Com_TxSigInfo[136].TxPduInfoIdxOfTxSigInfo Com_TxSigInfo[137].ApplTypeOfTxSigInfo Com_TxSigInfo[137].BitLengthOfTxSigInfo Com_TxSigInfo[137].BitPositionOfTxSigInfo Com_TxSigInfo[137].BusAccOfTxSigInfo Com_TxSigInfo[137].ByteLengthOfTxSigInfo Com_TxSigInfo[137].DynSignalOfTxSigInfo Com_TxSigInfo[137].FilterInitValueIdxOfTxSigInfo Com_TxSigInfo[137].FilterInitValueOfTxSigInfo Com_TxSigInfo[137].InvValueIdxOfTxSigInfo Com_TxSigInfo[137].InvValueOfTxSigInfo Com_TxSigInfo[137].OnChangeIdxOfTxSigInfo Com_TxSigInfo[137].OnChangeOfTxSigInfo Com_TxSigInfo[137].StartByteInPduPositionOfTxSigInfo Com_TxSigInfo[137].TxAccessInfoIdxOfTxSigInfo Com_TxSigInfo[137].TxBufferEndIdxOfTxSigInfo Com_TxSigInfo[137].TxBufferStartIdxOfTxSigInfo Com_TxSigInfo[137].TxFilterInitValueArrayBasedFilterInitValueEndIdxOfTxSigInfo Com_TxSigInfo[137].TxFilterInitValueArrayBasedFilterInitValueStartIdxOfTxSigInfo Com_TxSigInfo[137].TxPduInfoIdxOfTxSigInfo Com_TxSigInfo[138].ApplTypeOfTxSigInfo Com_TxSigInfo[138].BitLengthOfTxSigInfo Com_TxSigInfo[138].BitPositionOfTxSigInfo Com_TxSigInfo[138].BusAccOfTxSigInfo Com_TxSigInfo[138].ByteLengthOfTxSigInfo Com_TxSigInfo[138].DynSignalOfTxSigInfo Com_TxSigInfo[138].FilterInitValueIdxOfTxSigInfo Com_TxSigInfo[138].FilterInitValueOfTxSigInfo Com_TxSigInfo[138].InvValueIdxOfTxSigInfo Com_TxSigInfo[138].InvValueOfTxSigInfo Com_TxSigInfo[138].OnChangeIdxOfTxSigInfo Com_TxSigInfo[138].OnChangeOfTxSigInfo Com_TxSigInfo[138].StartByteInPduPositionOfTxSigInfo Com_TxSigInfo[138].TxAccessInfoIdxOfTxSigInfo Com_TxSigInfo[138].TxBufferEndIdxOfTxSigInfo Com_TxSigInfo[138].TxBufferStartIdxOfTxSigInfo Com_TxSigInfo[138].TxFilterInitValueArrayBasedFilterInitValueEndIdxOfTxSigInfo Com_TxSigInfo[138].TxFilterInitValueArrayBasedFilterInitValueStartIdxOfTxSigInfo Com_TxSigInfo[138].TxPduInfoIdxOfTxSigInfo Com_TxSigInfo[139].ApplTypeOfTxSigInfo Com_TxSigInfo[139].BitLengthOfTxSigInfo Com_TxSigInfo[139].BitPositionOfTxSigInfo Com_TxSigInfo[139].BusAccOfTxSigInfo Com_TxSigInfo[139].ByteLengthOfTxSigInfo Com_TxSigInfo[139].DynSignalOfTxSigInfo Com_TxSigInfo[139].FilterInitValueIdxOfTxSigInfo Com_TxSigInfo[139].FilterInitValueOfTxSigInfo Com_TxSigInfo[139].InvValueIdxOfTxSigInfo Com_TxSigInfo[139].InvValueOfTxSigInfo Com_TxSigInfo[139].OnChangeIdxOfTxSigInfo Com_TxSigInfo[139].OnChangeOfTxSigInfo Com_TxSigInfo[139].StartByteInPduPositionOfTxSigInfo Com_TxSigInfo[139].TxAccessInfoIdxOfTxSigInfo Com_TxSigInfo[139].TxBufferEndIdxOfTxSigInfo Com_TxSigInfo[139].TxBufferStartIdxOfTxSigInfo Com_TxSigInfo[139].TxFilterInitValueArrayBasedFilterInitValueEndIdxOfTxSigInfo Com_TxSigInfo[139].TxFilterInitValueArrayBasedFilterInitValueStartIdxOfTxSigInfo Com_TxSigInfo[139].TxPduInfoIdxOfTxSigInfo Com_TxSigInfo[13].ApplTypeOfTxSigInfo Com_TxSigInfo[13].BitLengthOfTxSigInfo Com_TxSigInfo[13].BitPositionOfTxSigInfo Com_TxSigInfo[13].BusAccOfTxSigInfo Com_TxSigInfo[13].ByteLengthOfTxSigInfo Com_TxSigInfo[13].DynSignalOfTxSigInfo Com_TxSigInfo[13].FilterInitValueIdxOfTxSigInfo Com_TxSigInfo[13].FilterInitValueOfTxSigInfo Com_TxSigInfo[13].InvValueIdxOfTxSigInfo Com_TxSigInfo[13].InvValueOfTxSigInfo Com_TxSigInfo[13].OnChangeIdxOfTxSigInfo Com_TxSigInfo[13].OnChangeOfTxSigInfo Com_TxSigInfo[13].StartByteInPduPositionOfTxSigInfo Com_TxSigInfo[13].TxAccessInfoIdxOfTxSigInfo Com_TxSigInfo[13].TxBufferEndIdxOfTxSigInfo Com_TxSigInfo[13].TxBufferStartIdxOfTxSigInfo Com_TxSigInfo[13].TxFilterInitValueArrayBasedFilterInitValueEndIdxOfTxSigInfo Com_TxSigInfo[13].TxFilterInitValueArrayBasedFilterInitValueStartIdxOfTxSigInfo Com_TxSigInfo[13].TxPduInfoIdxOfTxSigInfo Com_TxSigInfo[140].ApplTypeOfTxSigInfo Com_TxSigInfo[140].BitLengthOfTxSigInfo Com_TxSigInfo[140].BitPositionOfTxSigInfo Com_TxSigInfo[140].BusAccOfTxSigInfo Com_TxSigInfo[140].ByteLengthOfTxSigInfo Com_TxSigInfo[140].DynSignalOfTxSigInfo Com_TxSigInfo[140].FilterInitValueIdxOfTxSigInfo Com_TxSigInfo[140].FilterInitValueOfTxSigInfo Com_TxSigInfo[140].InvValueIdxOfTxSigInfo Com_TxSigInfo[140].InvValueOfTxSigInfo Com_TxSigInfo[140].OnChangeIdxOfTxSigInfo Com_TxSigInfo[140].OnChangeOfTxSigInfo Com_TxSigInfo[140].StartByteInPduPositionOfTxSigInfo Com_TxSigInfo[140].TxAccessInfoIdxOfTxSigInfo Com_TxSigInfo[140].TxBufferEndIdxOfTxSigInfo Com_TxSigInfo[140].TxBufferStartIdxOfTxSigInfo Com_TxSigInfo[140].TxFilterInitValueArrayBasedFilterInitValueEndIdxOfTxSigInfo Com_TxSigInfo[140].TxFilterInitValueArrayBasedFilterInitValueStartIdxOfTxSigInfo Com_TxSigInfo[140].TxPduInfoIdxOfTxSigInfo Com_TxSigInfo[141].ApplTypeOfTxSigInfo Com_TxSigInfo[141].BitLengthOfTxSigInfo Com_TxSigInfo[141].BitPositionOfTxSigInfo Com_TxSigInfo[141].BusAccOfTxSigInfo Com_TxSigInfo[141].ByteLengthOfTxSigInfo Com_TxSigInfo[141].DynSignalOfTxSigInfo Com_TxSigInfo[141].FilterInitValueIdxOfTxSigInfo Com_TxSigInfo[141].FilterInitValueOfTxSigInfo Com_TxSigInfo[141].InvValueIdxOfTxSigInfo Com_TxSigInfo[141].InvValueOfTxSigInfo Com_TxSigInfo[141].OnChangeIdxOfTxSigInfo Com_TxSigInfo[141].OnChangeOfTxSigInfo Com_TxSigInfo[141].StartByteInPduPositionOfTxSigInfo Com_TxSigInfo[141].TxAccessInfoIdxOfTxSigInfo Com_TxSigInfo[141].TxBufferEndIdxOfTxSigInfo Com_TxSigInfo[141].TxBufferStartIdxOfTxSigInfo Com_TxSigInfo[141].TxFilterInitValueArrayBasedFilterInitValueEndIdxOfTxSigInfo Com_TxSigInfo[141].TxFilterInitValueArrayBasedFilterInitValueStartIdxOfTxSigInfo Com_TxSigInfo[141].TxPduInfoIdxOfTxSigInfo Com_TxSigInfo[142].ApplTypeOfTxSigInfo Com_TxSigInfo[142].BitLengthOfTxSigInfo Com_TxSigInfo[142].BitPositionOfTxSigInfo Com_TxSigInfo[142].BusAccOfTxSigInfo Com_TxSigInfo[142].ByteLengthOfTxSigInfo Com_TxSigInfo[142].DynSignalOfTxSigInfo Com_TxSigInfo[142].FilterInitValueIdxOfTxSigInfo Com_TxSigInfo[142].FilterInitValueOfTxSigInfo Com_TxSigInfo[142].InvValueIdxOfTxSigInfo Com_TxSigInfo[142].InvValueOfTxSigInfo Com_TxSigInfo[142].OnChangeIdxOfTxSigInfo Com_TxSigInfo[142].OnChangeOfTxSigInfo Com_TxSigInfo[142].StartByteInPduPositionOfTxSigInfo Com_TxSigInfo[142].TxAccessInfoIdxOfTxSigInfo Com_TxSigInfo[142].TxBufferEndIdxOfTxSigInfo Com_TxSigInfo[142].TxBufferStartIdxOfTxSigInfo Com_TxSigInfo[142].TxFilterInitValueArrayBasedFilterInitValueEndIdxOfTxSigInfo Com_TxSigInfo[142].TxFilterInitValueArrayBasedFilterInitValueStartIdxOfTxSigInfo Com_TxSigInfo[142].TxPduInfoIdxOfTxSigInfo Com_TxSigInfo[143].ApplTypeOfTxSigInfo Com_TxSigInfo[143].BitLengthOfTxSigInfo Com_TxSigInfo[143].BitPositionOfTxSigInfo Com_TxSigInfo[143].BusAccOfTxSigInfo Com_TxSigInfo[143].ByteLengthOfTxSigInfo Com_TxSigInfo[143].DynSignalOfTxSigInfo Com_TxSigInfo[143].FilterInitValueIdxOfTxSigInfo Com_TxSigInfo[143].FilterInitValueOfTxSigInfo Com_TxSigInfo[143].InvValueIdxOfTxSigInfo Com_TxSigInfo[143].InvValueOfTxSigInfo Com_TxSigInfo[143].OnChangeIdxOfTxSigInfo Com_TxSigInfo[143].OnChangeOfTxSigInfo Com_TxSigInfo[143].StartByteInPduPositionOfTxSigInfo Com_TxSigInfo[143].TxAccessInfoIdxOfTxSigInfo Com_TxSigInfo[143].TxBufferEndIdxOfTxSigInfo Com_TxSigInfo[143].TxBufferStartIdxOfTxSigInfo Com_TxSigInfo[143].TxFilterInitValueArrayBasedFilterInitValueEndIdxOfTxSigInfo Com_TxSigInfo[143].TxFilterInitValueArrayBasedFilterInitValueStartIdxOfTxSigInfo Com_TxSigInfo[143].TxPduInfoIdxOfTxSigInfo Com_TxSigInfo[144].ApplTypeOfTxSigInfo Com_TxSigInfo[144].BitLengthOfTxSigInfo Com_TxSigInfo[144].BitPositionOfTxSigInfo Com_TxSigInfo[144].BusAccOfTxSigInfo Com_TxSigInfo[144].ByteLengthOfTxSigInfo Com_TxSigInfo[144].DynSignalOfTxSigInfo Com_TxSigInfo[144].FilterInitValueIdxOfTxSigInfo Com_TxSigInfo[144].FilterInitValueOfTxSigInfo Com_TxSigInfo[144].InvValueIdxOfTxSigInfo Com_TxSigInfo[144].InvValueOfTxSigInfo Com_TxSigInfo[144].OnChangeIdxOfTxSigInfo Com_TxSigInfo[144].OnChangeOfTxSigInfo Com_TxSigInfo[144].StartByteInPduPositionOfTxSigInfo Com_TxSigInfo[144].TxAccessInfoIdxOfTxSigInfo Com_TxSigInfo[144].TxBufferEndIdxOfTxSigInfo Com_TxSigInfo[144].TxBufferStartIdxOfTxSigInfo Com_TxSigInfo[144].TxFilterInitValueArrayBasedFilterInitValueEndIdxOfTxSigInfo Com_TxSigInfo[144].TxFilterInitValueArrayBasedFilterInitValueStartIdxOfTxSigInfo Com_TxSigInfo[144].TxPduInfoIdxOfTxSigInfo Com_TxSigInfo[145].ApplTypeOfTxSigInfo Com_TxSigInfo[145].BitLengthOfTxSigInfo Com_TxSigInfo[145].BitPositionOfTxSigInfo Com_TxSigInfo[145].BusAccOfTxSigInfo Com_TxSigInfo[145].ByteLengthOfTxSigInfo Com_TxSigInfo[145].DynSignalOfTxSigInfo Com_TxSigInfo[145].FilterInitValueIdxOfTxSigInfo Com_TxSigInfo[145].FilterInitValueOfTxSigInfo Com_TxSigInfo[145].InvValueIdxOfTxSigInfo Com_TxSigInfo[145].InvValueOfTxSigInfo Com_TxSigInfo[145].OnChangeIdxOfTxSigInfo Com_TxSigInfo[145].OnChangeOfTxSigInfo Com_TxSigInfo[145].StartByteInPduPositionOfTxSigInfo Com_TxSigInfo[145].TxAccessInfoIdxOfTxSigInfo Com_TxSigInfo[145].TxBufferEndIdxOfTxSigInfo Com_TxSigInfo[145].TxBufferStartIdxOfTxSigInfo Com_TxSigInfo[145].TxFilterInitValueArrayBasedFilterInitValueEndIdxOfTxSigInfo Com_TxSigInfo[145].TxFilterInitValueArrayBasedFilterInitValueStartIdxOfTxSigInfo Com_TxSigInfo[145].TxPduInfoIdxOfTxSigInfo Com_TxSigInfo[146].ApplTypeOfTxSigInfo Com_TxSigInfo[146].BitLengthOfTxSigInfo Com_TxSigInfo[146].BitPositionOfTxSigInfo Com_TxSigInfo[146].BusAccOfTxSigInfo Com_TxSigInfo[146].ByteLengthOfTxSigInfo Com_TxSigInfo[146].DynSignalOfTxSigInfo Com_TxSigInfo[146].FilterInitValueIdxOfTxSigInfo Com_TxSigInfo[146].FilterInitValueOfTxSigInfo Com_TxSigInfo[146].InvValueIdxOfTxSigInfo Com_TxSigInfo[146].InvValueOfTxSigInfo Com_TxSigInfo[146].OnChangeIdxOfTxSigInfo Com_TxSigInfo[146].OnChangeOfTxSigInfo Com_TxSigInfo[146].StartByteInPduPositionOfTxSigInfo Com_TxSigInfo[146].TxAccessInfoIdxOfTxSigInfo Com_TxSigInfo[146].TxBufferEndIdxOfTxSigInfo Com_TxSigInfo[146].TxBufferStartIdxOfTxSigInfo Com_TxSigInfo[146].TxFilterInitValueArrayBasedFilterInitValueEndIdxOfTxSigInfo Com_TxSigInfo[146].TxFilterInitValueArrayBasedFilterInitValueStartIdxOfTxSigInfo Com_TxSigInfo[146].TxPduInfoIdxOfTxSigInfo Com_TxSigInfo[147].ApplTypeOfTxSigInfo Com_TxSigInfo[147].BitLengthOfTxSigInfo Com_TxSigInfo[147].BitPositionOfTxSigInfo Com_TxSigInfo[147].BusAccOfTxSigInfo Com_TxSigInfo[147].ByteLengthOfTxSigInfo Com_TxSigInfo[147].DynSignalOfTxSigInfo Com_TxSigInfo[147].FilterInitValueIdxOfTxSigInfo Com_TxSigInfo[147].FilterInitValueOfTxSigInfo Com_TxSigInfo[147].InvValueIdxOfTxSigInfo Com_TxSigInfo[147].InvValueOfTxSigInfo Com_TxSigInfo[147].OnChangeIdxOfTxSigInfo Com_TxSigInfo[147].OnChangeOfTxSigInfo Com_TxSigInfo[147].StartByteInPduPositionOfTxSigInfo Com_TxSigInfo[147].TxAccessInfoIdxOfTxSigInfo Com_TxSigInfo[147].TxBufferEndIdxOfTxSigInfo Com_TxSigInfo[147].TxBufferStartIdxOfTxSigInfo Com_TxSigInfo[147].TxFilterInitValueArrayBasedFilterInitValueEndIdxOfTxSigInfo Com_TxSigInfo[147].TxFilterInitValueArrayBasedFilterInitValueStartIdxOfTxSigInfo Com_TxSigInfo[147].TxPduInfoIdxOfTxSigInfo Com_TxSigInfo[148].ApplTypeOfTxSigInfo Com_TxSigInfo[148].BitLengthOfTxSigInfo Com_TxSigInfo[148].BitPositionOfTxSigInfo Com_TxSigInfo[148].BusAccOfTxSigInfo Com_TxSigInfo[148].ByteLengthOfTxSigInfo Com_TxSigInfo[148].DynSignalOfTxSigInfo Com_TxSigInfo[148].FilterInitValueIdxOfTxSigInfo Com_TxSigInfo[148].FilterInitValueOfTxSigInfo Com_TxSigInfo[148].InvValueIdxOfTxSigInfo Com_TxSigInfo[148].InvValueOfTxSigInfo Com_TxSigInfo[148].OnChangeIdxOfTxSigInfo Com_TxSigInfo[148].OnChangeOfTxSigInfo Com_TxSigInfo[148].StartByteInPduPositionOfTxSigInfo Com_TxSigInfo[148].TxAccessInfoIdxOfTxSigInfo Com_TxSigInfo[148].TxBufferEndIdxOfTxSigInfo Com_TxSigInfo[148].TxBufferStartIdxOfTxSigInfo Com_TxSigInfo[148].TxFilterInitValueArrayBasedFilterInitValueEndIdxOfTxSigInfo Com_TxSigInfo[148].TxFilterInitValueArrayBasedFilterInitValueStartIdxOfTxSigInfo Com_TxSigInfo[148].TxPduInfoIdxOfTxSigInfo Com_TxSigInfo[149].ApplTypeOfTxSigInfo Com_TxSigInfo[149].BitLengthOfTxSigInfo Com_TxSigInfo[149].BitPositionOfTxSigInfo Com_TxSigInfo[149].BusAccOfTxSigInfo Com_TxSigInfo[149].ByteLengthOfTxSigInfo Com_TxSigInfo[149].DynSignalOfTxSigInfo Com_TxSigInfo[149].FilterInitValueIdxOfTxSigInfo Com_TxSigInfo[149].FilterInitValueOfTxSigInfo Com_TxSigInfo[149].InvValueIdxOfTxSigInfo Com_TxSigInfo[149].InvValueOfTxSigInfo Com_TxSigInfo[149].OnChangeIdxOfTxSigInfo Com_TxSigInfo[149].OnChangeOfTxSigInfo Com_TxSigInfo[149].StartByteInPduPositionOfTxSigInfo Com_TxSigInfo[149].TxAccessInfoIdxOfTxSigInfo Com_TxSigInfo[149].TxBufferEndIdxOfTxSigInfo Com_TxSigInfo[149].TxBufferStartIdxOfTxSigInfo Com_TxSigInfo[149].TxFilterInitValueArrayBasedFilterInitValueEndIdxOfTxSigInfo Com_TxSigInfo[149].TxFilterInitValueArrayBasedFilterInitValueStartIdxOfTxSigInfo Com_TxSigInfo[149].TxPduInfoIdxOfTxSigInfo Com_TxSigInfo[14].ApplTypeOfTxSigInfo Com_TxSigInfo[14].BitLengthOfTxSigInfo Com_TxSigInfo[14].BitPositionOfTxSigInfo Com_TxSigInfo[14].BusAccOfTxSigInfo Com_TxSigInfo[14].ByteLengthOfTxSigInfo Com_TxSigInfo[14].DynSignalOfTxSigInfo Com_TxSigInfo[14].FilterInitValueIdxOfTxSigInfo Com_TxSigInfo[14].FilterInitValueOfTxSigInfo Com_TxSigInfo[14].InvValueIdxOfTxSigInfo Com_TxSigInfo[14].InvValueOfTxSigInfo Com_TxSigInfo[14].OnChangeIdxOfTxSigInfo Com_TxSigInfo[14].OnChangeOfTxSigInfo Com_TxSigInfo[14].StartByteInPduPositionOfTxSigInfo Com_TxSigInfo[14].TxAccessInfoIdxOfTxSigInfo Com_TxSigInfo[14].TxBufferEndIdxOfTxSigInfo Com_TxSigInfo[14].TxBufferStartIdxOfTxSigInfo Com_TxSigInfo[14].TxFilterInitValueArrayBasedFilterInitValueEndIdxOfTxSigInfo Com_TxSigInfo[14].TxFilterInitValueArrayBasedFilterInitValueStartIdxOfTxSigInfo Com_TxSigInfo[14].TxPduInfoIdxOfTxSigInfo Com_TxSigInfo[150].ApplTypeOfTxSigInfo Com_TxSigInfo[150].BitLengthOfTxSigInfo Com_TxSigInfo[150].BitPositionOfTxSigInfo Com_TxSigInfo[150].BusAccOfTxSigInfo Com_TxSigInfo[150].ByteLengthOfTxSigInfo Com_TxSigInfo[150].DynSignalOfTxSigInfo Com_TxSigInfo[150].FilterInitValueIdxOfTxSigInfo Com_TxSigInfo[150].FilterInitValueOfTxSigInfo Com_TxSigInfo[150].InvValueIdxOfTxSigInfo Com_TxSigInfo[150].InvValueOfTxSigInfo Com_TxSigInfo[150].OnChangeIdxOfTxSigInfo Com_TxSigInfo[150].OnChangeOfTxSigInfo Com_TxSigInfo[150].StartByteInPduPositionOfTxSigInfo Com_TxSigInfo[150].TxAccessInfoIdxOfTxSigInfo Com_TxSigInfo[150].TxBufferEndIdxOfTxSigInfo Com_TxSigInfo[150].TxBufferStartIdxOfTxSigInfo Com_TxSigInfo[150].TxFilterInitValueArrayBasedFilterInitValueEndIdxOfTxSigInfo Com_TxSigInfo[150].TxFilterInitValueArrayBasedFilterInitValueStartIdxOfTxSigInfo Com_TxSigInfo[150].TxPduInfoIdxOfTxSigInfo Com_TxSigInfo[151].ApplTypeOfTxSigInfo Com_TxSigInfo[151].BitLengthOfTxSigInfo Com_TxSigInfo[151].BitPositionOfTxSigInfo Com_TxSigInfo[151].BusAccOfTxSigInfo Com_TxSigInfo[151].ByteLengthOfTxSigInfo Com_TxSigInfo[151].DynSignalOfTxSigInfo Com_TxSigInfo[151].FilterInitValueIdxOfTxSigInfo Com_TxSigInfo[151].FilterInitValueOfTxSigInfo Com_TxSigInfo[151].InvValueIdxOfTxSigInfo Com_TxSigInfo[151].InvValueOfTxSigInfo Com_TxSigInfo[151].OnChangeIdxOfTxSigInfo Com_TxSigInfo[151].OnChangeOfTxSigInfo Com_TxSigInfo[151].StartByteInPduPositionOfTxSigInfo Com_TxSigInfo[151].TxAccessInfoIdxOfTxSigInfo Com_TxSigInfo[151].TxBufferEndIdxOfTxSigInfo Com_TxSigInfo[151].TxBufferStartIdxOfTxSigInfo Com_TxSigInfo[151].TxFilterInitValueArrayBasedFilterInitValueEndIdxOfTxSigInfo Com_TxSigInfo[151].TxFilterInitValueArrayBasedFilterInitValueStartIdxOfTxSigInfo Com_TxSigInfo[151].TxPduInfoIdxOfTxSigInfo Com_TxSigInfo[152].ApplTypeOfTxSigInfo Com_TxSigInfo[152].BitLengthOfTxSigInfo Com_TxSigInfo[152].BitPositionOfTxSigInfo Com_TxSigInfo[152].BusAccOfTxSigInfo Com_TxSigInfo[152].ByteLengthOfTxSigInfo Com_TxSigInfo[152].DynSignalOfTxSigInfo Com_TxSigInfo[152].FilterInitValueIdxOfTxSigInfo Com_TxSigInfo[152].FilterInitValueOfTxSigInfo Com_TxSigInfo[152].InvValueIdxOfTxSigInfo Com_TxSigInfo[152].InvValueOfTxSigInfo Com_TxSigInfo[152].OnChangeIdxOfTxSigInfo Com_TxSigInfo[152].OnChangeOfTxSigInfo Com_TxSigInfo[152].StartByteInPduPositionOfTxSigInfo Com_TxSigInfo[152].TxAccessInfoIdxOfTxSigInfo Com_TxSigInfo[152].TxBufferEndIdxOfTxSigInfo Com_TxSigInfo[152].TxBufferStartIdxOfTxSigInfo Com_TxSigInfo[152].TxFilterInitValueArrayBasedFilterInitValueEndIdxOfTxSigInfo Com_TxSigInfo[152].TxFilterInitValueArrayBasedFilterInitValueStartIdxOfTxSigInfo Com_TxSigInfo[152].TxPduInfoIdxOfTxSigInfo Com_TxSigInfo[153].ApplTypeOfTxSigInfo Com_TxSigInfo[153].BitLengthOfTxSigInfo Com_TxSigInfo[153].BitPositionOfTxSigInfo Com_TxSigInfo[153].BusAccOfTxSigInfo Com_TxSigInfo[153].ByteLengthOfTxSigInfo Com_TxSigInfo[153].DynSignalOfTxSigInfo Com_TxSigInfo[153].FilterInitValueIdxOfTxSigInfo Com_TxSigInfo[153].FilterInitValueOfTxSigInfo Com_TxSigInfo[153].InvValueIdxOfTxSigInfo Com_TxSigInfo[153].InvValueOfTxSigInfo Com_TxSigInfo[153].OnChangeIdxOfTxSigInfo Com_TxSigInfo[153].OnChangeOfTxSigInfo Com_TxSigInfo[153].StartByteInPduPositionOfTxSigInfo Com_TxSigInfo[153].TxAccessInfoIdxOfTxSigInfo Com_TxSigInfo[153].TxBufferEndIdxOfTxSigInfo Com_TxSigInfo[153].TxBufferStartIdxOfTxSigInfo Com_TxSigInfo[153].TxFilterInitValueArrayBasedFilterInitValueEndIdxOfTxSigInfo Com_TxSigInfo[153].TxFilterInitValueArrayBasedFilterInitValueStartIdxOfTxSigInfo Com_TxSigInfo[153].TxPduInfoIdxOfTxSigInfo Com_TxSigInfo[154].ApplTypeOfTxSigInfo Com_TxSigInfo[154].BitLengthOfTxSigInfo Com_TxSigInfo[154].BitPositionOfTxSigInfo Com_TxSigInfo[154].BusAccOfTxSigInfo Com_TxSigInfo[154].ByteLengthOfTxSigInfo Com_TxSigInfo[154].DynSignalOfTxSigInfo Com_TxSigInfo[154].FilterInitValueIdxOfTxSigInfo Com_TxSigInfo[154].FilterInitValueOfTxSigInfo Com_TxSigInfo[154].InvValueIdxOfTxSigInfo Com_TxSigInfo[154].InvValueOfTxSigInfo Com_TxSigInfo[154].OnChangeIdxOfTxSigInfo Com_TxSigInfo[154].OnChangeOfTxSigInfo Com_TxSigInfo[154].StartByteInPduPositionOfTxSigInfo Com_TxSigInfo[154].TxAccessInfoIdxOfTxSigInfo Com_TxSigInfo[154].TxBufferEndIdxOfTxSigInfo Com_TxSigInfo[154].TxBufferStartIdxOfTxSigInfo Com_TxSigInfo[154].TxFilterInitValueArrayBasedFilterInitValueEndIdxOfTxSigInfo Com_TxSigInfo[154].TxFilterInitValueArrayBasedFilterInitValueStartIdxOfTxSigInfo Com_TxSigInfo[154].TxPduInfoIdxOfTxSigInfo Com_TxSigInfo[155].ApplTypeOfTxSigInfo Com_TxSigInfo[155].BitLengthOfTxSigInfo Com_TxSigInfo[155].BitPositionOfTxSigInfo Com_TxSigInfo[155].BusAccOfTxSigInfo Com_TxSigInfo[155].ByteLengthOfTxSigInfo Com_TxSigInfo[155].DynSignalOfTxSigInfo Com_TxSigInfo[155].FilterInitValueIdxOfTxSigInfo Com_TxSigInfo[155].FilterInitValueOfTxSigInfo Com_TxSigInfo[155].InvValueIdxOfTxSigInfo Com_TxSigInfo[155].InvValueOfTxSigInfo Com_TxSigInfo[155].OnChangeIdxOfTxSigInfo Com_TxSigInfo[155].OnChangeOfTxSigInfo Com_TxSigInfo[155].StartByteInPduPositionOfTxSigInfo Com_TxSigInfo[155].TxAccessInfoIdxOfTxSigInfo Com_TxSigInfo[155].TxBufferEndIdxOfTxSigInfo Com_TxSigInfo[155].TxBufferStartIdxOfTxSigInfo Com_TxSigInfo[155].TxFilterInitValueArrayBasedFilterInitValueEndIdxOfTxSigInfo Com_TxSigInfo[155].TxFilterInitValueArrayBasedFilterInitValueStartIdxOfTxSigInfo Com_TxSigInfo[155].TxPduInfoIdxOfTxSigInfo Com_TxSigInfo[156].ApplTypeOfTxSigInfo Com_TxSigInfo[156].BitLengthOfTxSigInfo Com_TxSigInfo[156].BitPositionOfTxSigInfo Com_TxSigInfo[156].BusAccOfTxSigInfo Com_TxSigInfo[156].ByteLengthOfTxSigInfo Com_TxSigInfo[156].DynSignalOfTxSigInfo Com_TxSigInfo[156].FilterInitValueIdxOfTxSigInfo Com_TxSigInfo[156].FilterInitValueOfTxSigInfo Com_TxSigInfo[156].InvValueIdxOfTxSigInfo Com_TxSigInfo[156].InvValueOfTxSigInfo Com_TxSigInfo[156].OnChangeIdxOfTxSigInfo Com_TxSigInfo[156].OnChangeOfTxSigInfo Com_TxSigInfo[156].StartByteInPduPositionOfTxSigInfo Com_TxSigInfo[156].TxAccessInfoIdxOfTxSigInfo Com_TxSigInfo[156].TxBufferEndIdxOfTxSigInfo Com_TxSigInfo[156].TxBufferStartIdxOfTxSigInfo Com_TxSigInfo[156].TxFilterInitValueArrayBasedFilterInitValueEndIdxOfTxSigInfo Com_TxSigInfo[156].TxFilterInitValueArrayBasedFilterInitValueStartIdxOfTxSigInfo Com_TxSigInfo[156].TxPduInfoIdxOfTxSigInfo Com_TxSigInfo[157].ApplTypeOfTxSigInfo Com_TxSigInfo[157].BitLengthOfTxSigInfo Com_TxSigInfo[157].BitPositionOfTxSigInfo Com_TxSigInfo[157].BusAccOfTxSigInfo Com_TxSigInfo[157].ByteLengthOfTxSigInfo Com_TxSigInfo[157].DynSignalOfTxSigInfo Com_TxSigInfo[157].FilterInitValueIdxOfTxSigInfo Com_TxSigInfo[157].FilterInitValueOfTxSigInfo Com_TxSigInfo[157].InvValueIdxOfTxSigInfo Com_TxSigInfo[157].InvValueOfTxSigInfo Com_TxSigInfo[157].OnChangeIdxOfTxSigInfo Com_TxSigInfo[157].OnChangeOfTxSigInfo Com_TxSigInfo[157].StartByteInPduPositionOfTxSigInfo Com_TxSigInfo[157].TxAccessInfoIdxOfTxSigInfo Com_TxSigInfo[157].TxBufferEndIdxOfTxSigInfo Com_TxSigInfo[157].TxBufferStartIdxOfTxSigInfo Com_TxSigInfo[157].TxFilterInitValueArrayBasedFilterInitValueEndIdxOfTxSigInfo Com_TxSigInfo[157].TxFilterInitValueArrayBasedFilterInitValueStartIdxOfTxSigInfo Com_TxSigInfo[157].TxPduInfoIdxOfTxSigInfo Com_TxSigInfo[158].ApplTypeOfTxSigInfo Com_TxSigInfo[158].BitLengthOfTxSigInfo Com_TxSigInfo[158].BitPositionOfTxSigInfo Com_TxSigInfo[158].BusAccOfTxSigInfo Com_TxSigInfo[158].ByteLengthOfTxSigInfo Com_TxSigInfo[158].DynSignalOfTxSigInfo Com_TxSigInfo[158].FilterInitValueIdxOfTxSigInfo Com_TxSigInfo[158].FilterInitValueOfTxSigInfo Com_TxSigInfo[158].InvValueIdxOfTxSigInfo Com_TxSigInfo[158].InvValueOfTxSigInfo Com_TxSigInfo[158].OnChangeIdxOfTxSigInfo Com_TxSigInfo[158].OnChangeOfTxSigInfo Com_TxSigInfo[158].StartByteInPduPositionOfTxSigInfo Com_TxSigInfo[158].TxAccessInfoIdxOfTxSigInfo Com_TxSigInfo[158].TxBufferEndIdxOfTxSigInfo Com_TxSigInfo[158].TxBufferStartIdxOfTxSigInfo Com_TxSigInfo[158].TxFilterInitValueArrayBasedFilterInitValueEndIdxOfTxSigInfo Com_TxSigInfo[158].TxFilterInitValueArrayBasedFilterInitValueStartIdxOfTxSigInfo Com_TxSigInfo[158].TxPduInfoIdxOfTxSigInfo Com_TxSigInfo[159].ApplTypeOfTxSigInfo Com_TxSigInfo[159].BitLengthOfTxSigInfo Com_TxSigInfo[159].BitPositionOfTxSigInfo /end REF_MEASUREMENT
/end GROUP
/end MODULE
/end PROJECT
