ASAP2_VERSION 1 71
/begin PROJECT MICROSAR ""
/begin MODULE CPP ""
/begin MOD_COMMON "" BYTE_ORDER MSB_LAST ALIGNMENT_BYTE 1 ALIGNMENT_WORD 2 ALIGNMENT_LONG 4 ALIGNMENT_FLOAT16_IEEE 2 ALIGNMENT_FLOAT32_IEEE 4 ALIGNMENT_FLOAT64_IEEE 8 ALIGNMENT_INT64 8 /end MOD_COMMON
/begin MEASUREMENT ComM_ActiveComMode "Current ComM communication state" UBYTE CompuMethod_ComM_ComModeType_Values 0 0 0 255 ECU_ADDRESS 0x0 MATRIX_DIM 2 SYMBOL_LINK "ComM_ActiveComMode.raw" 0 /end MEASUREMENT
/begin MEASUREMENT ComM_BusComModeReq "requested ComM communication channel mode" UBYTE CompuMethod_ComM_ComModeType_Values 0 0 0 255 ECU_ADDRESS 0x0 MATRIX_DIM 2 SYMBOL_LINK "ComM_BusComModeReq.raw" 0 /end MEASUREMENT
/begin MEASUREMENT ComM_BusSmState "Current BusSM communication state" UBYTE CompuMethod_ComM_BusSMModeType_Values 0 0 0 255 ECU_ADDRESS 0x0 MATRIX_DIM 2 SYMBOL_LINK "ComM_BusSmState.raw" 0 /end MEASUREMENT
/begin MEASUREMENT ComM_ChannelPb[0].PncPbIndEndIdxOfChannelPb "" UBYTE ComM_PncPbIndEndIdxOfChannelPbType 0 0 0 255 ECU_ADDRESS 0x0 /end MEASUREMENT
/begin MEASUREMENT ComM_ChannelPb[0].PncPbIndStartIdxOfChannelPb "" UBYTE ComM_PncPbIndStartIdxOfChannelPbType 0 0 0 255 ECU_ADDRESS 0x0 /end MEASUREMENT
/begin MEASUREMENT ComM_ChannelPb[0].UserReqFullComEndIdxOfChannelPb "" UBYTE ComM_UserReqFullComEndIdxOfChannelPbType 0 0 0 255 ECU_ADDRESS 0x0 /end MEASUREMENT
/begin MEASUREMENT ComM_ChannelPb[0].UserReqFullComStartIdxOfChannelPb "" UBYTE ComM_UserReqFullComStartIdxOfChannelPbType 0 0 0 255 ECU_ADDRESS 0x0 /end MEASUREMENT
/begin MEASUREMENT ComM_ChannelPb[1].PncPbIndEndIdxOfChannelPb "" UBYTE ComM_PncPbIndEndIdxOfChannelPbType 0 0 0 255 ECU_ADDRESS 0x0 /end MEASUREMENT
/begin MEASUREMENT ComM_ChannelPb[1].PncPbIndStartIdxOfChannelPb "" UBYTE ComM_PncPbIndStartIdxOfChannelPbType 0 0 0 255 ECU_ADDRESS 0x0 /end MEASUREMENT
/begin MEASUREMENT ComM_ChannelPb[1].UserReqFullComEndIdxOfChannelPb "" UBYTE ComM_UserReqFullComEndIdxOfChannelPbType 0 0 0 255 ECU_ADDRESS 0x0 /end MEASUREMENT
/begin MEASUREMENT ComM_ChannelPb[1].UserReqFullComStartIdxOfChannelPb "" UBYTE ComM_UserReqFullComStartIdxOfChannelPbType 0 0 0 255 ECU_ADDRESS 0x0 /end MEASUREMENT
/begin MEASUREMENT ComM_ComAllowed "Communication allowed status of a channel" UBYTE ComM_ComAllowedType 0 0 0 1 ECU_ADDRESS 0x0 MATRIX_DIM 2 SYMBOL_LINK "ComM_ComAllowed.raw" 0 /end MEASUREMENT
/begin MEASUREMENT ComM_ComAllowed_ComMChannel_0 "The element: ComMChannel_0 of ComM_ComAllowed" UBYTE ComM_ComAllowedType 0 0 0 1 ECU_ADDRESS 0x0 SYMBOL_LINK "ComM_ComAllowed.raw[0]" 0 /end MEASUREMENT
/begin MEASUREMENT ComM_ComAllowed_ComMChannel_1 "The element: ComMChannel_1 of ComM_ComAllowed" UBYTE ComM_ComAllowedType 0 0 0 1 ECU_ADDRESS 0x0 SYMBOL_LINK "ComM_ComAllowed.raw[1]" 0 /end MEASUREMENT
/begin MEASUREMENT ComM_DcmRequestActive "Status of Dcm active diagnostic request, TRUE if requested, FALSE otherwise" UBYTE ComM_DcmRequestActiveType 0 0 0 1 ECU_ADDRESS 0x0 MATRIX_DIM 2 SYMBOL_LINK "ComM_DcmRequestActive.raw" 0 /end MEASUREMENT
/begin MEASUREMENT ComM_DcmRequestActive_ComMChannel_0 "The element: ComMChannel_0 of ComM_DcmRequestActive" UBYTE ComM_DcmRequestActiveType 0 0 0 1 ECU_ADDRESS 0x0 SYMBOL_LINK "ComM_DcmRequestActive.raw[0]" 0 /end MEASUREMENT
/begin MEASUREMENT ComM_DcmRequestActive_ComMChannel_1 "The element: ComMChannel_1 of ComM_DcmRequestActive" UBYTE ComM_DcmRequestActiveType 0 0 0 1 ECU_ADDRESS 0x0 SYMBOL_LINK "ComM_DcmRequestActive.raw[1]" 0 /end MEASUREMENT
/begin MEASUREMENT ComM_FullComRequesters "Temporarily stores the IDs of users currently requesting FullComm for a channel. It is used as a pseudo-parameter between ComM_CurrentChannelRequestUpdate and the generated ComM_CurrentChannelRequestNotification." UWORD NO_COMPU_METHOD 0 0 0 65535 ECU_ADDRESS 0x0 MATRIX_DIM 50 /end MEASUREMENT
/begin MEASUREMENT ComM_PartitionIdentifiers[0].PCPartitionConfigIdxOfPartitionIdentifiers "" UBYTE NO_COMPU_METHOD 0 0 0 255 ECU_ADDRESS 0x0 /end MEASUREMENT
/begin MEASUREMENT ComM_PartitionIdentifiers[0].PartitionSNVOfPartitionIdentifiers "" ULONG NO_COMPU_METHOD 0 0 0 4294967295 ECU_ADDRESS 0x0 /end MEASUREMENT
/begin MEASUREMENT ComM_PncPSleepTimer "partial network prepare sleep timer" UWORD NO_COMPU_METHOD 0 0 0 65535 ECU_ADDRESS 0x0 MATRIX_DIM 48 SYMBOL_LINK "ComM_PncPSleepTimer.raw" 0 /end MEASUREMENT
/begin MEASUREMENT ComM_PncPSleepTimer_PNC_01_CarWakeUp_d7102746 "The element: PNC_01_CarWakeUp_d7102746 of ComM_PncPSleepTimer" UWORD NO_COMPU_METHOD 0 0 0 65535 ECU_ADDRESS 0x0 SYMBOL_LINK "ComM_PncPSleepTimer.raw[0]" 0 /end MEASUREMENT
/begin MEASUREMENT ComM_PncPSleepTimer_PNC_02_Basefunction_Powertrain_6b6ac64e "The element: PNC_02_Basefunction_Powertrain_6b6ac64e of ComM_PncPSleepTimer" UWORD NO_COMPU_METHOD 0 0 0 65535 ECU_ADDRESS 0x0 SYMBOL_LINK "ComM_PncPSleepTimer.raw[1]" 0 /end MEASUREMENT
/begin MEASUREMENT ComM_PncPSleepTimer_PNC_03_Basefunction_Chassis_a155dfc3 "The element: PNC_03_Basefunction_Chassis_a155dfc3 of ComM_PncPSleepTimer" UWORD NO_COMPU_METHOD 0 0 0 65535 ECU_ADDRESS 0x0 SYMBOL_LINK "ComM_PncPSleepTimer.raw[2]" 0 /end MEASUREMENT
/begin MEASUREMENT ComM_PncPSleepTimer_PNC_04_Basefunction_DrivingAssistance_f26b19b4 "The element: PNC_04_Basefunction_DrivingAssistance_f26b19b4 of ComM_PncPSleepTimer" UWORD NO_COMPU_METHOD 0 0 0 65535 ECU_ADDRESS 0x0 SYMBOL_LINK "ComM_PncPSleepTimer.raw[3]" 0 /end MEASUREMENT
/begin MEASUREMENT ComM_PncPSleepTimer_PNC_05_Basefunction_Infotainment_f043623b "The element: PNC_05_Basefunction_Infotainment_f043623b of ComM_PncPSleepTimer" UWORD NO_COMPU_METHOD 0 0 0 65535 ECU_ADDRESS 0x0 SYMBOL_LINK "ComM_PncPSleepTimer.raw[4]" 0 /end MEASUREMENT
/begin MEASUREMENT ComM_PncPSleepTimer_PNC_06_Basefunction_ComfortLight_d2d0a736 "The element: PNC_06_Basefunction_ComfortLight_d2d0a736 of ComM_PncPSleepTimer" UWORD NO_COMPU_METHOD 0 0 0 65535 ECU_ADDRESS 0x0 SYMBOL_LINK "ComM_PncPSleepTimer.raw[5]" 0 /end MEASUREMENT
/begin MEASUREMENT ComM_PncPSleepTimer_PNC_07_Basefunction_CrossSection_7b625db2 "The element: PNC_07_Basefunction_CrossSection_7b625db2 of ComM_PncPSleepTimer" UWORD NO_COMPU_METHOD 0 0 0 65535 ECU_ADDRESS 0x0 SYMBOL_LINK "ComM_PncPSleepTimer.raw[6]" 0 /end MEASUREMENT
/begin MEASUREMENT ComM_PncPSleepTimer_PNC_08_Basefunction_Connectivity_56f2bd6b "The element: PNC_08_Basefunction_Connectivity_56f2bd6b of ComM_PncPSleepTimer" UWORD NO_COMPU_METHOD 0 0 0 65535 ECU_ADDRESS 0x0 SYMBOL_LINK "ComM_PncPSleepTimer.raw[7]" 0 /end MEASUREMENT
/begin MEASUREMENT ComM_PncPSleepTimer_PNC_10_Powertrain_b3959ad4 "The element: PNC_10_Powertrain_b3959ad4 of ComM_PncPSleepTimer" UWORD NO_COMPU_METHOD 0 0 0 65535 ECU_ADDRESS 0x0 SYMBOL_LINK "ComM_PncPSleepTimer.raw[8]" 0 /end MEASUREMENT
/begin MEASUREMENT ComM_PncPSleepTimer_PNC_11_Chassis_dce36bbc "The element: PNC_11_Chassis_dce36bbc of ComM_PncPSleepTimer" UWORD NO_COMPU_METHOD 0 0 0 65535 ECU_ADDRESS 0x0 SYMBOL_LINK "ComM_PncPSleepTimer.raw[9]" 0 /end MEASUREMENT
/begin MEASUREMENT ComM_PncPSleepTimer_PNC_12_GearSelector_9f4a754a "The element: PNC_12_GearSelector_9f4a754a of ComM_PncPSleepTimer" UWORD NO_COMPU_METHOD 0 0 0 65535 ECU_ADDRESS 0x0 SYMBOL_LINK "ComM_PncPSleepTimer.raw[10]" 0 /end MEASUREMENT
/begin MEASUREMENT ComM_PncPSleepTimer_PNC_13_Airbag_727cecad "The element: PNC_13_Airbag_727cecad of ComM_PncPSleepTimer" UWORD NO_COMPU_METHOD 0 0 0 65535 ECU_ADDRESS 0x0 SYMBOL_LINK "ComM_PncPSleepTimer.raw[11]" 0 /end MEASUREMENT
/begin MEASUREMENT ComM_PncPSleepTimer_PNC_14_InfotainmentExtensions_ca9cb1f5 "The element: PNC_14_InfotainmentExtensions_ca9cb1f5 of ComM_PncPSleepTimer" UWORD NO_COMPU_METHOD 0 0 0 65535 ECU_ADDRESS 0x0 SYMBOL_LINK "ComM_PncPSleepTimer.raw[12]" 0 /end MEASUREMENT
/begin MEASUREMENT ComM_PncPSleepTimer_PNC_15_InstrumentclusterDisplay_afd3c636 "The element: PNC_15_InstrumentclusterDisplay_afd3c636 of ComM_PncPSleepTimer" UWORD NO_COMPU_METHOD 0 0 0 65535 ECU_ADDRESS 0x0 SYMBOL_LINK "ComM_PncPSleepTimer.raw[13]" 0 /end MEASUREMENT
/begin MEASUREMENT ComM_PncPSleepTimer_PNC_16_InfotainmentDisplay_e8d84b12 "The element: PNC_16_InfotainmentDisplay_e8d84b12 of ComM_PncPSleepTimer" UWORD NO_COMPU_METHOD 0 0 0 65535 ECU_ADDRESS 0x0 SYMBOL_LINK "ComM_PncPSleepTimer.raw[14]" 0 /end MEASUREMENT
/begin MEASUREMENT ComM_PncPSleepTimer_PNC_17_Audio_8cbcad43 "The element: PNC_17_Audio_8cbcad43 of ComM_PncPSleepTimer" UWORD NO_COMPU_METHOD 0 0 0 65535 ECU_ADDRESS 0x0 SYMBOL_LINK "ComM_PncPSleepTimer.raw[15]" 0 /end MEASUREMENT
/begin MEASUREMENT ComM_PncPSleepTimer_PNC_18_VirtualSideMirrors_5814f436 "The element: PNC_18_VirtualSideMirrors_5814f436 of ComM_PncPSleepTimer" UWORD NO_COMPU_METHOD 0 0 0 65535 ECU_ADDRESS 0x0 SYMBOL_LINK "ComM_PncPSleepTimer.raw[16]" 0 /end MEASUREMENT
/begin MEASUREMENT ComM_PncPSleepTimer_PNC_19_Doors_Hatches_6a90831c "The element: PNC_19_Doors_Hatches_6a90831c of ComM_PncPSleepTimer" UWORD NO_COMPU_METHOD 0 0 0 65535 ECU_ADDRESS 0x0 SYMBOL_LINK "ComM_PncPSleepTimer.raw[17]" 0 /end MEASUREMENT
/begin MEASUREMENT ComM_PncPSleepTimer_PNC_20_OptionalComfort_769509a7 "The element: PNC_20_OptionalComfort_769509a7 of ComM_PncPSleepTimer" UWORD NO_COMPU_METHOD 0 0 0 65535 ECU_ADDRESS 0x0 SYMBOL_LINK "ComM_PncPSleepTimer.raw[18]" 0 /end MEASUREMENT
/begin MEASUREMENT ComM_PncPSleepTimer_PNC_21_AirSuspension_32658f46 "The element: PNC_21_AirSuspension_32658f46 of ComM_PncPSleepTimer" UWORD NO_COMPU_METHOD 0 0 0 65535 ECU_ADDRESS 0x0 SYMBOL_LINK "ComM_PncPSleepTimer.raw[19]" 0 /end MEASUREMENT
/begin MEASUREMENT ComM_PncPSleepTimer_PNC_22_ExteriorLights_ee477910 "The element: PNC_22_ExteriorLights_ee477910 of ComM_PncPSleepTimer" UWORD NO_COMPU_METHOD 0 0 0 65535 ECU_ADDRESS 0x0 SYMBOL_LINK "ComM_PncPSleepTimer.raw[20]" 0 /end MEASUREMENT
/begin MEASUREMENT ComM_PncPSleepTimer_PNC_23_Climate_ab0b2697 "The element: PNC_23_Climate_ab0b2697 of ComM_PncPSleepTimer" UWORD NO_COMPU_METHOD 0 0 0 65535 ECU_ADDRESS 0x0 SYMBOL_LINK "ComM_PncPSleepTimer.raw[21]" 0 /end MEASUREMENT
/begin MEASUREMENT ComM_PncPSleepTimer_PNC_24_ThermoManagement_4f639819 "The element: PNC_24_ThermoManagement_4f639819 of ComM_PncPSleepTimer" UWORD NO_COMPU_METHOD 0 0 0 65535 ECU_ADDRESS 0x0 SYMBOL_LINK "ComM_PncPSleepTimer.raw[22]" 0 /end MEASUREMENT
/begin MEASUREMENT ComM_PncPSleepTimer_PNC_25_AccessSystemSensors_0f593a4b "The element: PNC_25_AccessSystemSensors_0f593a4b of ComM_PncPSleepTimer" UWORD NO_COMPU_METHOD 0 0 0 65535 ECU_ADDRESS 0x0 SYMBOL_LINK "ComM_PncPSleepTimer.raw[23]" 0 /end MEASUREMENT
/begin MEASUREMENT ComM_PncPSleepTimer_PNC_26_HighVoltage_Charging_24d89ab8 "The element: PNC_26_HighVoltage_Charging_24d89ab8 of ComM_PncPSleepTimer" UWORD NO_COMPU_METHOD 0 0 0 65535 ECU_ADDRESS 0x0 SYMBOL_LINK "ComM_PncPSleepTimer.raw[24]" 0 /end MEASUREMENT
/begin MEASUREMENT ComM_PncPSleepTimer_PNC_27_Timemaster_Timer_8da5bb27 "The element: PNC_27_Timemaster_Timer_8da5bb27 of ComM_PncPSleepTimer" UWORD NO_COMPU_METHOD 0 0 0 65535 ECU_ADDRESS 0x0 SYMBOL_LINK "ComM_PncPSleepTimer.raw[25]" 0 /end MEASUREMENT
/begin MEASUREMENT ComM_PncPSleepTimer_PNC_28_OnboardTester_DataCollector_1afa9561 "The element: PNC_28_OnboardTester_DataCollector_1afa9561 of ComM_PncPSleepTimer" UWORD NO_COMPU_METHOD 0 0 0 65535 ECU_ADDRESS 0x0 SYMBOL_LINK "ComM_PncPSleepTimer.raw[26]" 0 /end MEASUREMENT
/begin MEASUREMENT ComM_PncPSleepTimer_PNC_29_SteeringColumnLock_af7c21af "The element: PNC_29_SteeringColumnLock_af7c21af of ComM_PncPSleepTimer" UWORD NO_COMPU_METHOD 0 0 0 65535 ECU_ADDRESS 0x0 SYMBOL_LINK "ComM_PncPSleepTimer.raw[27]" 0 /end MEASUREMENT
/begin MEASUREMENT ComM_PncPSleepTimer_PNC_30_EnergyManagement_9072504c "The element: PNC_30_EnergyManagement_9072504c of ComM_PncPSleepTimer" UWORD NO_COMPU_METHOD 0 0 0 65535 ECU_ADDRESS 0x0 SYMBOL_LINK "ComM_PncPSleepTimer.raw[28]" 0 /end MEASUREMENT
/begin MEASUREMENT ComM_PncPSleepTimer_PNC_31_MultifunctionalSteeringWheel_4e0a8e7c "The element: PNC_31_MultifunctionalSteeringWheel_4e0a8e7c of ComM_PncPSleepTimer" UWORD NO_COMPU_METHOD 0 0 0 65535 ECU_ADDRESS 0x0 SYMBOL_LINK "ComM_PncPSleepTimer.raw[29]" 0 /end MEASUREMENT
/begin MEASUREMENT ComM_PncPSleepTimer_PNC_32_OnlineAccess_91b6041d "The element: PNC_32_OnlineAccess_91b6041d of ComM_PncPSleepTimer" UWORD NO_COMPU_METHOD 0 0 0 65535 ECU_ADDRESS 0x0 SYMBOL_LINK "ComM_PncPSleepTimer.raw[30]" 0 /end MEASUREMENT
/begin MEASUREMENT ComM_PncPSleepTimer_PNC_33_ExternalWirelessCommunication_85f99735 "The element: PNC_33_ExternalWirelessCommunication_85f99735 of ComM_PncPSleepTimer" UWORD NO_COMPU_METHOD 0 0 0 65535 ECU_ADDRESS 0x0 SYMBOL_LINK "ComM_PncPSleepTimer.raw[31]" 0 /end MEASUREMENT
/begin MEASUREMENT ComM_PncPSleepTimer_PNC_34_GPS_Lokalization_74821ca8 "The element: PNC_34_GPS_Lokalization_74821ca8 of ComM_PncPSleepTimer" UWORD NO_COMPU_METHOD 0 0 0 65535 ECU_ADDRESS 0x0 SYMBOL_LINK "ComM_PncPSleepTimer.raw[32]" 0 /end MEASUREMENT
/begin MEASUREMENT ComM_PncPSleepTimer_PNC_35_ExteriorSound_90ecdcdb "The element: PNC_35_ExteriorSound_90ecdcdb of ComM_PncPSleepTimer" UWORD NO_COMPU_METHOD 0 0 0 65535 ECU_ADDRESS 0x0 SYMBOL_LINK "ComM_PncPSleepTimer.raw[33]" 0 /end MEASUREMENT
/begin MEASUREMENT ComM_PncPSleepTimer_PNC_36_Preheater_b14f0d7f "The element: PNC_36_Preheater_b14f0d7f of ComM_PncPSleepTimer" UWORD NO_COMPU_METHOD 0 0 0 65535 ECU_ADDRESS 0x0 SYMBOL_LINK "ComM_PncPSleepTimer.raw[34]" 0 /end MEASUREMENT
/begin MEASUREMENT ComM_PncPSleepTimer_PNC_37_HighVoltage_WirelessChargingStation_717f15f0 "The element: PNC_37_HighVoltage_WirelessChargingStation_717f15f0 of ComM_PncPSleepTimer" UWORD NO_COMPU_METHOD 0 0 0 65535 ECU_ADDRESS 0x0 SYMBOL_LINK "ComM_PncPSleepTimer.raw[35]" 0 /end MEASUREMENT
/begin MEASUREMENT ComM_PncPSleepTimer_PNC_40_Diagnosis_Energy_40b20ab8 "The element: PNC_40_Diagnosis_Energy_40b20ab8 of ComM_PncPSleepTimer" UWORD NO_COMPU_METHOD 0 0 0 65535 ECU_ADDRESS 0x0 SYMBOL_LINK "ComM_PncPSleepTimer.raw[36]" 0 /end MEASUREMENT
/begin MEASUREMENT ComM_PncPSleepTimer_PNC_41_Diagnosis_Powertrain_d7bd9faf "The element: PNC_41_Diagnosis_Powertrain_d7bd9faf of ComM_PncPSleepTimer" UWORD NO_COMPU_METHOD 0 0 0 65535 ECU_ADDRESS 0x0 SYMBOL_LINK "ComM_PncPSleepTimer.raw[37]" 0 /end MEASUREMENT
/begin MEASUREMENT ComM_PncPSleepTimer_PNC_42_Diagnosis_FlexRay_e9cd26c7 "The element: PNC_42_Diagnosis_FlexRay_e9cd26c7 of ComM_PncPSleepTimer" UWORD NO_COMPU_METHOD 0 0 0 65535 ECU_ADDRESS 0x0 SYMBOL_LINK "ComM_PncPSleepTimer.raw[38]" 0 /end MEASUREMENT
/begin MEASUREMENT ComM_PncPSleepTimer_PNC_43_Diagnosis_DrivingAssistance_906b6e52 "The element: PNC_43_Diagnosis_DrivingAssistance_906b6e52 of ComM_PncPSleepTimer" UWORD NO_COMPU_METHOD 0 0 0 65535 ECU_ADDRESS 0x0 SYMBOL_LINK "ComM_PncPSleepTimer.raw[39]" 0 /end MEASUREMENT
/begin MEASUREMENT ComM_PncPSleepTimer_PNC_44_Diagnosis_Infotainment_d2af29c0 "The element: PNC_44_Diagnosis_Infotainment_d2af29c0 of ComM_PncPSleepTimer" UWORD NO_COMPU_METHOD 0 0 0 65535 ECU_ADDRESS 0x0 SYMBOL_LINK "ComM_PncPSleepTimer.raw[40]" 0 /end MEASUREMENT
/begin MEASUREMENT ComM_PncPSleepTimer_PNC_45_Diagnosis_Comfort_54b3da15 "The element: PNC_45_Diagnosis_Comfort_54b3da15 of ComM_PncPSleepTimer" UWORD NO_COMPU_METHOD 0 0 0 65535 ECU_ADDRESS 0x0 SYMBOL_LINK "ComM_PncPSleepTimer.raw[41]" 0 /end MEASUREMENT
/begin MEASUREMENT ComM_PncPSleepTimer_PNC_46_Diagnosis_Light_2422ec0e "The element: PNC_46_Diagnosis_Light_2422ec0e of ComM_PncPSleepTimer" UWORD NO_COMPU_METHOD 0 0 0 65535 ECU_ADDRESS 0x0 SYMBOL_LINK "ComM_PncPSleepTimer.raw[42]" 0 /end MEASUREMENT
/begin MEASUREMENT ComM_PncPSleepTimer_PNC_47_Diagnosis_ComfortLINs_fb22fd75 "The element: PNC_47_Diagnosis_ComfortLINs_fb22fd75 of ComM_PncPSleepTimer" UWORD NO_COMPU_METHOD 0 0 0 65535 ECU_ADDRESS 0x0 SYMBOL_LINK "ComM_PncPSleepTimer.raw[43]" 0 /end MEASUREMENT
/begin MEASUREMENT ComM_PncPSleepTimer_PNC_48_Diagnosis_ClimateTmeLINs_cce3bfb2 "The element: PNC_48_Diagnosis_ClimateTmeLINs_cce3bfb2 of ComM_PncPSleepTimer" UWORD NO_COMPU_METHOD 0 0 0 65535 ECU_ADDRESS 0x0 SYMBOL_LINK "ComM_PncPSleepTimer.raw[44]" 0 /end MEASUREMENT
/begin MEASUREMENT ComM_PncPSleepTimer_PNC_53_Lock_Unlock_51015b9a "The element: PNC_53_Lock_Unlock_51015b9a of ComM_PncPSleepTimer" UWORD NO_COMPU_METHOD 0 0 0 65535 ECU_ADDRESS 0x0 SYMBOL_LINK "ComM_PncPSleepTimer.raw[45]" 0 /end MEASUREMENT
/begin MEASUREMENT ComM_PncPSleepTimer_PNC_55_Dimming_ea37854f "The element: PNC_55_Dimming_ea37854f of ComM_PncPSleepTimer" UWORD NO_COMPU_METHOD 0 0 0 65535 ECU_ADDRESS 0x0 SYMBOL_LINK "ComM_PncPSleepTimer.raw[46]" 0 /end MEASUREMENT
/begin MEASUREMENT ComM_PncPSleepTimer_PNC_56_Charging_Status_19bd3663 "The element: PNC_56_Charging_Status_19bd3663 of ComM_PncPSleepTimer" UWORD NO_COMPU_METHOD 0 0 0 65535 ECU_ADDRESS 0x0 SYMBOL_LINK "ComM_PncPSleepTimer.raw[47]" 0 /end MEASUREMENT
/begin MEASUREMENT ComM_PncPbInd "the indexes of the 1:1 sorted relation pointing to ComM_PncPb" UBYTE NO_COMPU_METHOD 0 0 0 255 ECU_ADDRESS 0x0 MATRIX_DIM 48 /end MEASUREMENT
/begin MEASUREMENT ComM_PncPb[0].PncChannelMappingEndIdxOfPncPb "" UBYTE ComM_PncChannelMappingEndIdxOfPncPbType 0 0 0 255 ECU_ADDRESS 0x0 /end MEASUREMENT
/begin MEASUREMENT ComM_PncPb[0].PncChannelMappingStartIdxOfPncPb "" UBYTE ComM_PncChannelMappingStartIdxOfPncPbType 0 0 0 255 ECU_ADDRESS 0x0 /end MEASUREMENT
/begin MEASUREMENT ComM_PncPb[0].PncSignalIndEndIdxOfPncPb "" UBYTE ComM_PncSignalIndEndIdxOfPncPbType 0 0 0 255 ECU_ADDRESS 0x0 /end MEASUREMENT
/begin MEASUREMENT ComM_PncPb[0].PncSignalIndStartIdxOfPncPb "" UBYTE ComM_PncSignalIndStartIdxOfPncPbType 0 0 0 255 ECU_ADDRESS 0x0 /end MEASUREMENT
/begin MEASUREMENT ComM_PncPb[0].SignalByteIndexOfPncPb "" UBYTE NO_COMPU_METHOD 0 0 0 255 ECU_ADDRESS 0x0 /end MEASUREMENT
/begin MEASUREMENT ComM_PncPb[0].UserReqPncFullComEndIdxOfPncPb "" UBYTE NO_COMPU_METHOD 0 0 0 255 ECU_ADDRESS 0x0 /end MEASUREMENT
/begin MEASUREMENT ComM_PncPb[0].UserReqPncFullComStartIdxOfPncPb "" UBYTE NO_COMPU_METHOD 0 0 0 255 ECU_ADDRESS 0x0 /end MEASUREMENT
/begin MEASUREMENT ComM_PncPb[10].PncChannelMappingEndIdxOfPncPb "" UBYTE ComM_PncChannelMappingEndIdxOfPncPbType 0 0 0 255 ECU_ADDRESS 0x0 /end MEASUREMENT
/begin MEASUREMENT ComM_PncPb[10].PncChannelMappingStartIdxOfPncPb "" UBYTE ComM_PncChannelMappingStartIdxOfPncPbType 0 0 0 255 ECU_ADDRESS 0x0 /end MEASUREMENT
/begin MEASUREMENT ComM_PncPb[10].PncSignalIndEndIdxOfPncPb "" UBYTE ComM_PncSignalIndEndIdxOfPncPbType 0 0 0 255 ECU_ADDRESS 0x0 /end MEASUREMENT
/begin MEASUREMENT ComM_PncPb[10].PncSignalIndStartIdxOfPncPb "" UBYTE ComM_PncSignalIndStartIdxOfPncPbType 0 0 0 255 ECU_ADDRESS 0x0 /end MEASUREMENT
/begin MEASUREMENT ComM_PncPb[10].SignalByteIndexOfPncPb "" UBYTE NO_COMPU_METHOD 0 0 0 255 ECU_ADDRESS 0x0 /end MEASUREMENT
/begin MEASUREMENT ComM_PncPb[10].UserReqPncFullComEndIdxOfPncPb "" UBYTE NO_COMPU_METHOD 0 0 0 255 ECU_ADDRESS 0x0 /end MEASUREMENT
/begin MEASUREMENT ComM_PncPb[10].UserReqPncFullComStartIdxOfPncPb "" UBYTE NO_COMPU_METHOD 0 0 0 255 ECU_ADDRESS 0x0 /end MEASUREMENT
/begin MEASUREMENT ComM_PncPb[11].PncChannelMappingEndIdxOfPncPb "" UBYTE ComM_PncChannelMappingEndIdxOfPncPbType 0 0 0 255 ECU_ADDRESS 0x0 /end MEASUREMENT
/begin MEASUREMENT ComM_PncPb[11].PncChannelMappingStartIdxOfPncPb "" UBYTE ComM_PncChannelMappingStartIdxOfPncPbType 0 0 0 255 ECU_ADDRESS 0x0 /end MEASUREMENT
/begin MEASUREMENT ComM_PncPb[11].PncSignalIndEndIdxOfPncPb "" UBYTE ComM_PncSignalIndEndIdxOfPncPbType 0 0 0 255 ECU_ADDRESS 0x0 /end MEASUREMENT
/begin MEASUREMENT ComM_PncPb[11].PncSignalIndStartIdxOfPncPb "" UBYTE ComM_PncSignalIndStartIdxOfPncPbType 0 0 0 255 ECU_ADDRESS 0x0 /end MEASUREMENT
/begin MEASUREMENT ComM_PncPb[11].SignalByteIndexOfPncPb "" UBYTE NO_COMPU_METHOD 0 0 0 255 ECU_ADDRESS 0x0 /end MEASUREMENT
/begin MEASUREMENT ComM_PncPb[11].UserReqPncFullComEndIdxOfPncPb "" UBYTE NO_COMPU_METHOD 0 0 0 255 ECU_ADDRESS 0x0 /end MEASUREMENT
/begin MEASUREMENT ComM_PncPb[11].UserReqPncFullComStartIdxOfPncPb "" UBYTE NO_COMPU_METHOD 0 0 0 255 ECU_ADDRESS 0x0 /end MEASUREMENT
/begin MEASUREMENT ComM_PncPb[12].PncChannelMappingEndIdxOfPncPb "" UBYTE ComM_PncChannelMappingEndIdxOfPncPbType 0 0 0 255 ECU_ADDRESS 0x0 /end MEASUREMENT
/begin MEASUREMENT ComM_PncPb[12].PncChannelMappingStartIdxOfPncPb "" UBYTE ComM_PncChannelMappingStartIdxOfPncPbType 0 0 0 255 ECU_ADDRESS 0x0 /end MEASUREMENT
/begin MEASUREMENT ComM_PncPb[12].PncSignalIndEndIdxOfPncPb "" UBYTE ComM_PncSignalIndEndIdxOfPncPbType 0 0 0 255 ECU_ADDRESS 0x0 /end MEASUREMENT
/begin MEASUREMENT ComM_PncPb[12].PncSignalIndStartIdxOfPncPb "" UBYTE ComM_PncSignalIndStartIdxOfPncPbType 0 0 0 255 ECU_ADDRESS 0x0 /end MEASUREMENT
/begin MEASUREMENT ComM_PncPb[12].SignalByteIndexOfPncPb "" UBYTE NO_COMPU_METHOD 0 0 0 255 ECU_ADDRESS 0x0 /end MEASUREMENT
/begin MEASUREMENT ComM_PncPb[12].UserReqPncFullComEndIdxOfPncPb "" UBYTE NO_COMPU_METHOD 0 0 0 255 ECU_ADDRESS 0x0 /end MEASUREMENT
/begin MEASUREMENT ComM_PncPb[12].UserReqPncFullComStartIdxOfPncPb "" UBYTE NO_COMPU_METHOD 0 0 0 255 ECU_ADDRESS 0x0 /end MEASUREMENT
/begin MEASUREMENT ComM_PncPb[13].PncChannelMappingEndIdxOfPncPb "" UBYTE ComM_PncChannelMappingEndIdxOfPncPbType 0 0 0 255 ECU_ADDRESS 0x0 /end MEASUREMENT
/begin MEASUREMENT ComM_PncPb[13].PncChannelMappingStartIdxOfPncPb "" UBYTE ComM_PncChannelMappingStartIdxOfPncPbType 0 0 0 255 ECU_ADDRESS 0x0 /end MEASUREMENT
/begin MEASUREMENT ComM_PncPb[13].PncSignalIndEndIdxOfPncPb "" UBYTE ComM_PncSignalIndEndIdxOfPncPbType 0 0 0 255 ECU_ADDRESS 0x0 /end MEASUREMENT
/begin MEASUREMENT ComM_PncPb[13].PncSignalIndStartIdxOfPncPb "" UBYTE ComM_PncSignalIndStartIdxOfPncPbType 0 0 0 255 ECU_ADDRESS 0x0 /end MEASUREMENT
/begin MEASUREMENT ComM_PncPb[13].SignalByteIndexOfPncPb "" UBYTE NO_COMPU_METHOD 0 0 0 255 ECU_ADDRESS 0x0 /end MEASUREMENT
/begin MEASUREMENT ComM_PncPb[13].UserReqPncFullComEndIdxOfPncPb "" UBYTE NO_COMPU_METHOD 0 0 0 255 ECU_ADDRESS 0x0 /end MEASUREMENT
/begin MEASUREMENT ComM_PncPb[13].UserReqPncFullComStartIdxOfPncPb "" UBYTE NO_COMPU_METHOD 0 0 0 255 ECU_ADDRESS 0x0 /end MEASUREMENT
/begin MEASUREMENT ComM_PncPb[14].PncChannelMappingEndIdxOfPncPb "" UBYTE ComM_PncChannelMappingEndIdxOfPncPbType 0 0 0 255 ECU_ADDRESS 0x0 /end MEASUREMENT
/begin MEASUREMENT ComM_PncPb[14].PncChannelMappingStartIdxOfPncPb "" UBYTE ComM_PncChannelMappingStartIdxOfPncPbType 0 0 0 255 ECU_ADDRESS 0x0 /end MEASUREMENT
/begin MEASUREMENT ComM_PncPb[14].PncSignalIndEndIdxOfPncPb "" UBYTE ComM_PncSignalIndEndIdxOfPncPbType 0 0 0 255 ECU_ADDRESS 0x0 /end MEASUREMENT
/begin MEASUREMENT ComM_PncPb[14].PncSignalIndStartIdxOfPncPb "" UBYTE ComM_PncSignalIndStartIdxOfPncPbType 0 0 0 255 ECU_ADDRESS 0x0 /end MEASUREMENT
/begin MEASUREMENT ComM_PncPb[14].SignalByteIndexOfPncPb "" UBYTE NO_COMPU_METHOD 0 0 0 255 ECU_ADDRESS 0x0 /end MEASUREMENT
/begin MEASUREMENT ComM_PncPb[14].UserReqPncFullComEndIdxOfPncPb "" UBYTE NO_COMPU_METHOD 0 0 0 255 ECU_ADDRESS 0x0 /end MEASUREMENT
/begin MEASUREMENT ComM_PncPb[14].UserReqPncFullComStartIdxOfPncPb "" UBYTE NO_COMPU_METHOD 0 0 0 255 ECU_ADDRESS 0x0 /end MEASUREMENT
/begin MEASUREMENT ComM_PncPb[15].PncChannelMappingEndIdxOfPncPb "" UBYTE ComM_PncChannelMappingEndIdxOfPncPbType 0 0 0 255 ECU_ADDRESS 0x0 /end MEASUREMENT
/begin MEASUREMENT ComM_PncPb[15].PncChannelMappingStartIdxOfPncPb "" UBYTE ComM_PncChannelMappingStartIdxOfPncPbType 0 0 0 255 ECU_ADDRESS 0x0 /end MEASUREMENT
/begin MEASUREMENT ComM_PncPb[15].PncSignalIndEndIdxOfPncPb "" UBYTE ComM_PncSignalIndEndIdxOfPncPbType 0 0 0 255 ECU_ADDRESS 0x0 /end MEASUREMENT
/begin MEASUREMENT ComM_PncPb[15].PncSignalIndStartIdxOfPncPb "" UBYTE ComM_PncSignalIndStartIdxOfPncPbType 0 0 0 255 ECU_ADDRESS 0x0 /end MEASUREMENT
/begin MEASUREMENT ComM_PncPb[15].SignalByteIndexOfPncPb "" UBYTE NO_COMPU_METHOD 0 0 0 255 ECU_ADDRESS 0x0 /end MEASUREMENT
/begin MEASUREMENT ComM_PncPb[15].UserReqPncFullComEndIdxOfPncPb "" UBYTE NO_COMPU_METHOD 0 0 0 255 ECU_ADDRESS 0x0 /end MEASUREMENT
/begin MEASUREMENT ComM_PncPb[15].UserReqPncFullComStartIdxOfPncPb "" UBYTE NO_COMPU_METHOD 0 0 0 255 ECU_ADDRESS 0x0 /end MEASUREMENT
/begin MEASUREMENT ComM_PncPb[16].PncChannelMappingEndIdxOfPncPb "" UBYTE ComM_PncChannelMappingEndIdxOfPncPbType 0 0 0 255 ECU_ADDRESS 0x0 /end MEASUREMENT
/begin MEASUREMENT ComM_PncPb[16].PncChannelMappingStartIdxOfPncPb "" UBYTE ComM_PncChannelMappingStartIdxOfPncPbType 0 0 0 255 ECU_ADDRESS 0x0 /end MEASUREMENT
/begin MEASUREMENT ComM_PncPb[16].PncSignalIndEndIdxOfPncPb "" UBYTE ComM_PncSignalIndEndIdxOfPncPbType 0 0 0 255 ECU_ADDRESS 0x0 /end MEASUREMENT
/begin MEASUREMENT ComM_PncPb[16].PncSignalIndStartIdxOfPncPb "" UBYTE ComM_PncSignalIndStartIdxOfPncPbType 0 0 0 255 ECU_ADDRESS 0x0 /end MEASUREMENT
/begin MEASUREMENT ComM_PncPb[16].SignalByteIndexOfPncPb "" UBYTE NO_COMPU_METHOD 0 0 0 255 ECU_ADDRESS 0x0 /end MEASUREMENT
/begin MEASUREMENT ComM_PncPb[16].UserReqPncFullComEndIdxOfPncPb "" UBYTE NO_COMPU_METHOD 0 0 0 255 ECU_ADDRESS 0x0 /end MEASUREMENT
/begin MEASUREMENT ComM_PncPb[16].UserReqPncFullComStartIdxOfPncPb "" UBYTE NO_COMPU_METHOD 0 0 0 255 ECU_ADDRESS 0x0 /end MEASUREMENT
/begin MEASUREMENT ComM_PncPb[17].PncChannelMappingEndIdxOfPncPb "" UBYTE ComM_PncChannelMappingEndIdxOfPncPbType 0 0 0 255 ECU_ADDRESS 0x0 /end MEASUREMENT
/begin MEASUREMENT ComM_PncPb[17].PncChannelMappingStartIdxOfPncPb "" UBYTE ComM_PncChannelMappingStartIdxOfPncPbType 0 0 0 255 ECU_ADDRESS 0x0 /end MEASUREMENT
/begin MEASUREMENT ComM_PncPb[17].PncSignalIndEndIdxOfPncPb "" UBYTE ComM_PncSignalIndEndIdxOfPncPbType 0 0 0 255 ECU_ADDRESS 0x0 /end MEASUREMENT
/begin MEASUREMENT ComM_PncPb[17].PncSignalIndStartIdxOfPncPb "" UBYTE ComM_PncSignalIndStartIdxOfPncPbType 0 0 0 255 ECU_ADDRESS 0x0 /end MEASUREMENT
/begin MEASUREMENT ComM_PncPb[17].SignalByteIndexOfPncPb "" UBYTE NO_COMPU_METHOD 0 0 0 255 ECU_ADDRESS 0x0 /end MEASUREMENT
/begin MEASUREMENT ComM_PncPb[17].UserReqPncFullComEndIdxOfPncPb "" UBYTE NO_COMPU_METHOD 0 0 0 255 ECU_ADDRESS 0x0 /end MEASUREMENT
/begin MEASUREMENT ComM_PncPb[17].UserReqPncFullComStartIdxOfPncPb "" UBYTE NO_COMPU_METHOD 0 0 0 255 ECU_ADDRESS 0x0 /end MEASUREMENT
/begin MEASUREMENT ComM_PncPb[18].PncChannelMappingEndIdxOfPncPb "" UBYTE ComM_PncChannelMappingEndIdxOfPncPbType 0 0 0 255 ECU_ADDRESS 0x0 /end MEASUREMENT
/begin MEASUREMENT ComM_PncPb[18].PncChannelMappingStartIdxOfPncPb "" UBYTE ComM_PncChannelMappingStartIdxOfPncPbType 0 0 0 255 ECU_ADDRESS 0x0 /end MEASUREMENT
/begin MEASUREMENT ComM_PncPb[18].PncSignalIndEndIdxOfPncPb "" UBYTE ComM_PncSignalIndEndIdxOfPncPbType 0 0 0 255 ECU_ADDRESS 0x0 /end MEASUREMENT
/begin MEASUREMENT ComM_PncPb[18].PncSignalIndStartIdxOfPncPb "" UBYTE ComM_PncSignalIndStartIdxOfPncPbType 0 0 0 255 ECU_ADDRESS 0x0 /end MEASUREMENT
/begin MEASUREMENT ComM_PncPb[18].SignalByteIndexOfPncPb "" UBYTE NO_COMPU_METHOD 0 0 0 255 ECU_ADDRESS 0x0 /end MEASUREMENT
/begin MEASUREMENT ComM_PncPb[18].UserReqPncFullComEndIdxOfPncPb "" UBYTE NO_COMPU_METHOD 0 0 0 255 ECU_ADDRESS 0x0 /end MEASUREMENT
/begin MEASUREMENT ComM_PncPb[18].UserReqPncFullComStartIdxOfPncPb "" UBYTE NO_COMPU_METHOD 0 0 0 255 ECU_ADDRESS 0x0 /end MEASUREMENT
/begin MEASUREMENT ComM_PncPb[19].PncChannelMappingEndIdxOfPncPb "" UBYTE ComM_PncChannelMappingEndIdxOfPncPbType 0 0 0 255 ECU_ADDRESS 0x0 /end MEASUREMENT
/begin MEASUREMENT ComM_PncPb[19].PncChannelMappingStartIdxOfPncPb "" UBYTE ComM_PncChannelMappingStartIdxOfPncPbType 0 0 0 255 ECU_ADDRESS 0x0 /end MEASUREMENT
/begin MEASUREMENT ComM_PncPb[19].PncSignalIndEndIdxOfPncPb "" UBYTE ComM_PncSignalIndEndIdxOfPncPbType 0 0 0 255 ECU_ADDRESS 0x0 /end MEASUREMENT
/begin MEASUREMENT ComM_PncPb[19].PncSignalIndStartIdxOfPncPb "" UBYTE ComM_PncSignalIndStartIdxOfPncPbType 0 0 0 255 ECU_ADDRESS 0x0 /end MEASUREMENT
/begin MEASUREMENT ComM_PncPb[19].SignalByteIndexOfPncPb "" UBYTE NO_COMPU_METHOD 0 0 0 255 ECU_ADDRESS 0x0 /end MEASUREMENT
/begin MEASUREMENT ComM_PncPb[19].UserReqPncFullComEndIdxOfPncPb "" UBYTE NO_COMPU_METHOD 0 0 0 255 ECU_ADDRESS 0x0 /end MEASUREMENT
/begin MEASUREMENT ComM_PncPb[19].UserReqPncFullComStartIdxOfPncPb "" UBYTE NO_COMPU_METHOD 0 0 0 255 ECU_ADDRESS 0x0 /end MEASUREMENT
/begin MEASUREMENT ComM_PncPb[1].PncChannelMappingEndIdxOfPncPb "" UBYTE ComM_PncChannelMappingEndIdxOfPncPbType 0 0 0 255 ECU_ADDRESS 0x0 /end MEASUREMENT
/begin MEASUREMENT ComM_PncPb[1].PncChannelMappingStartIdxOfPncPb "" UBYTE ComM_PncChannelMappingStartIdxOfPncPbType 0 0 0 255 ECU_ADDRESS 0x0 /end MEASUREMENT
/begin MEASUREMENT ComM_PncPb[1].PncSignalIndEndIdxOfPncPb "" UBYTE ComM_PncSignalIndEndIdxOfPncPbType 0 0 0 255 ECU_ADDRESS 0x0 /end MEASUREMENT
/begin MEASUREMENT ComM_PncPb[1].PncSignalIndStartIdxOfPncPb "" UBYTE ComM_PncSignalIndStartIdxOfPncPbType 0 0 0 255 ECU_ADDRESS 0x0 /end MEASUREMENT
/begin MEASUREMENT ComM_PncPb[1].SignalByteIndexOfPncPb "" UBYTE NO_COMPU_METHOD 0 0 0 255 ECU_ADDRESS 0x0 /end MEASUREMENT
/begin MEASUREMENT ComM_PncPb[1].UserReqPncFullComEndIdxOfPncPb "" UBYTE NO_COMPU_METHOD 0 0 0 255 ECU_ADDRESS 0x0 /end MEASUREMENT
/begin MEASUREMENT ComM_PncPb[1].UserReqPncFullComStartIdxOfPncPb "" UBYTE NO_COMPU_METHOD 0 0 0 255 ECU_ADDRESS 0x0 /end MEASUREMENT
/begin MEASUREMENT ComM_PncPb[20].PncChannelMappingEndIdxOfPncPb "" UBYTE ComM_PncChannelMappingEndIdxOfPncPbType 0 0 0 255 ECU_ADDRESS 0x0 /end MEASUREMENT
/begin MEASUREMENT ComM_PncPb[20].PncChannelMappingStartIdxOfPncPb "" UBYTE ComM_PncChannelMappingStartIdxOfPncPbType 0 0 0 255 ECU_ADDRESS 0x0 /end MEASUREMENT
/begin MEASUREMENT ComM_PncPb[20].PncSignalIndEndIdxOfPncPb "" UBYTE ComM_PncSignalIndEndIdxOfPncPbType 0 0 0 255 ECU_ADDRESS 0x0 /end MEASUREMENT
/begin MEASUREMENT ComM_PncPb[20].PncSignalIndStartIdxOfPncPb "" UBYTE ComM_PncSignalIndStartIdxOfPncPbType 0 0 0 255 ECU_ADDRESS 0x0 /end MEASUREMENT
/begin MEASUREMENT ComM_PncPb[20].SignalByteIndexOfPncPb "" UBYTE NO_COMPU_METHOD 0 0 0 255 ECU_ADDRESS 0x0 /end MEASUREMENT
/begin MEASUREMENT ComM_PncPb[20].UserReqPncFullComEndIdxOfPncPb "" UBYTE NO_COMPU_METHOD 0 0 0 255 ECU_ADDRESS 0x0 /end MEASUREMENT
/begin MEASUREMENT ComM_PncPb[20].UserReqPncFullComStartIdxOfPncPb "" UBYTE NO_COMPU_METHOD 0 0 0 255 ECU_ADDRESS 0x0 /end MEASUREMENT
/begin MEASUREMENT ComM_PncPb[21].PncChannelMappingEndIdxOfPncPb "" UBYTE ComM_PncChannelMappingEndIdxOfPncPbType 0 0 0 255 ECU_ADDRESS 0x0 /end MEASUREMENT
/begin MEASUREMENT ComM_PncPb[21].PncChannelMappingStartIdxOfPncPb "" UBYTE ComM_PncChannelMappingStartIdxOfPncPbType 0 0 0 255 ECU_ADDRESS 0x0 /end MEASUREMENT
/begin MEASUREMENT ComM_PncPb[21].PncSignalIndEndIdxOfPncPb "" UBYTE ComM_PncSignalIndEndIdxOfPncPbType 0 0 0 255 ECU_ADDRESS 0x0 /end MEASUREMENT
/begin MEASUREMENT ComM_PncPb[21].PncSignalIndStartIdxOfPncPb "" UBYTE ComM_PncSignalIndStartIdxOfPncPbType 0 0 0 255 ECU_ADDRESS 0x0 /end MEASUREMENT
/begin MEASUREMENT ComM_PncPb[21].SignalByteIndexOfPncPb "" UBYTE NO_COMPU_METHOD 0 0 0 255 ECU_ADDRESS 0x0 /end MEASUREMENT
/begin MEASUREMENT ComM_PncPb[21].UserReqPncFullComEndIdxOfPncPb "" UBYTE NO_COMPU_METHOD 0 0 0 255 ECU_ADDRESS 0x0 /end MEASUREMENT
/begin MEASUREMENT ComM_PncPb[21].UserReqPncFullComStartIdxOfPncPb "" UBYTE NO_COMPU_METHOD 0 0 0 255 ECU_ADDRESS 0x0 /end MEASUREMENT
/begin MEASUREMENT ComM_PncPb[22].PncChannelMappingEndIdxOfPncPb "" UBYTE ComM_PncChannelMappingEndIdxOfPncPbType 0 0 0 255 ECU_ADDRESS 0x0 /end MEASUREMENT
/begin MEASUREMENT ComM_PncPb[22].PncChannelMappingStartIdxOfPncPb "" UBYTE ComM_PncChannelMappingStartIdxOfPncPbType 0 0 0 255 ECU_ADDRESS 0x0 /end MEASUREMENT
/begin MEASUREMENT ComM_PncPb[22].PncSignalIndEndIdxOfPncPb "" UBYTE ComM_PncSignalIndEndIdxOfPncPbType 0 0 0 255 ECU_ADDRESS 0x0 /end MEASUREMENT
/begin MEASUREMENT ComM_PncPb[22].PncSignalIndStartIdxOfPncPb "" UBYTE ComM_PncSignalIndStartIdxOfPncPbType 0 0 0 255 ECU_ADDRESS 0x0 /end MEASUREMENT
/begin MEASUREMENT ComM_PncPb[22].SignalByteIndexOfPncPb "" UBYTE NO_COMPU_METHOD 0 0 0 255 ECU_ADDRESS 0x0 /end MEASUREMENT
/begin MEASUREMENT ComM_PncPb[22].UserReqPncFullComEndIdxOfPncPb "" UBYTE NO_COMPU_METHOD 0 0 0 255 ECU_ADDRESS 0x0 /end MEASUREMENT
/begin MEASUREMENT ComM_PncPb[22].UserReqPncFullComStartIdxOfPncPb "" UBYTE NO_COMPU_METHOD 0 0 0 255 ECU_ADDRESS 0x0 /end MEASUREMENT
/begin MEASUREMENT ComM_PncPb[23].PncChannelMappingEndIdxOfPncPb "" UBYTE ComM_PncChannelMappingEndIdxOfPncPbType 0 0 0 255 ECU_ADDRESS 0x0 /end MEASUREMENT
/begin MEASUREMENT ComM_PncPb[23].PncChannelMappingStartIdxOfPncPb "" UBYTE ComM_PncChannelMappingStartIdxOfPncPbType 0 0 0 255 ECU_ADDRESS 0x0 /end MEASUREMENT
/begin MEASUREMENT ComM_PncPb[23].PncSignalIndEndIdxOfPncPb "" UBYTE ComM_PncSignalIndEndIdxOfPncPbType 0 0 0 255 ECU_ADDRESS 0x0 /end MEASUREMENT
/begin MEASUREMENT ComM_PncPb[23].PncSignalIndStartIdxOfPncPb "" UBYTE ComM_PncSignalIndStartIdxOfPncPbType 0 0 0 255 ECU_ADDRESS 0x0 /end MEASUREMENT
/begin MEASUREMENT ComM_PncPb[23].SignalByteIndexOfPncPb "" UBYTE NO_COMPU_METHOD 0 0 0 255 ECU_ADDRESS 0x0 /end MEASUREMENT
/begin MEASUREMENT ComM_PncPb[23].UserReqPncFullComEndIdxOfPncPb "" UBYTE NO_COMPU_METHOD 0 0 0 255 ECU_ADDRESS 0x0 /end MEASUREMENT
/begin MEASUREMENT ComM_PncPb[23].UserReqPncFullComStartIdxOfPncPb "" UBYTE NO_COMPU_METHOD 0 0 0 255 ECU_ADDRESS 0x0 /end MEASUREMENT
/begin MEASUREMENT ComM_PncPb[24].PncChannelMappingEndIdxOfPncPb "" UBYTE ComM_PncChannelMappingEndIdxOfPncPbType 0 0 0 255 ECU_ADDRESS 0x0 /end MEASUREMENT
/begin MEASUREMENT ComM_PncPb[24].PncChannelMappingStartIdxOfPncPb "" UBYTE ComM_PncChannelMappingStartIdxOfPncPbType 0 0 0 255 ECU_ADDRESS 0x0 /end MEASUREMENT
/begin MEASUREMENT ComM_PncPb[24].PncSignalIndEndIdxOfPncPb "" UBYTE ComM_PncSignalIndEndIdxOfPncPbType 0 0 0 255 ECU_ADDRESS 0x0 /end MEASUREMENT
/begin MEASUREMENT ComM_PncPb[24].PncSignalIndStartIdxOfPncPb "" UBYTE ComM_PncSignalIndStartIdxOfPncPbType 0 0 0 255 ECU_ADDRESS 0x0 /end MEASUREMENT
/begin MEASUREMENT ComM_PncPb[24].SignalByteIndexOfPncPb "" UBYTE NO_COMPU_METHOD 0 0 0 255 ECU_ADDRESS 0x0 /end MEASUREMENT
/begin MEASUREMENT ComM_PncPb[24].UserReqPncFullComEndIdxOfPncPb "" UBYTE NO_COMPU_METHOD 0 0 0 255 ECU_ADDRESS 0x0 /end MEASUREMENT
/begin MEASUREMENT ComM_PncPb[24].UserReqPncFullComStartIdxOfPncPb "" UBYTE NO_COMPU_METHOD 0 0 0 255 ECU_ADDRESS 0x0 /end MEASUREMENT
/begin MEASUREMENT ComM_PncPb[25].PncChannelMappingEndIdxOfPncPb "" UBYTE ComM_PncChannelMappingEndIdxOfPncPbType 0 0 0 255 ECU_ADDRESS 0x0 /end MEASUREMENT
/begin MEASUREMENT ComM_PncPb[25].PncChannelMappingStartIdxOfPncPb "" UBYTE ComM_PncChannelMappingStartIdxOfPncPbType 0 0 0 255 ECU_ADDRESS 0x0 /end MEASUREMENT
/begin MEASUREMENT ComM_PncPb[25].PncSignalIndEndIdxOfPncPb "" UBYTE ComM_PncSignalIndEndIdxOfPncPbType 0 0 0 255 ECU_ADDRESS 0x0 /end MEASUREMENT
/begin MEASUREMENT ComM_PncPb[25].PncSignalIndStartIdxOfPncPb "" UBYTE ComM_PncSignalIndStartIdxOfPncPbType 0 0 0 255 ECU_ADDRESS 0x0 /end MEASUREMENT
/begin MEASUREMENT ComM_PncPb[25].SignalByteIndexOfPncPb "" UBYTE NO_COMPU_METHOD 0 0 0 255 ECU_ADDRESS 0x0 /end MEASUREMENT
/begin MEASUREMENT ComM_PncPb[25].UserReqPncFullComEndIdxOfPncPb "" UBYTE NO_COMPU_METHOD 0 0 0 255 ECU_ADDRESS 0x0 /end MEASUREMENT
/begin MEASUREMENT ComM_PncPb[25].UserReqPncFullComStartIdxOfPncPb "" UBYTE NO_COMPU_METHOD 0 0 0 255 ECU_ADDRESS 0x0 /end MEASUREMENT
/begin MEASUREMENT ComM_PncPb[26].PncChannelMappingEndIdxOfPncPb "" UBYTE ComM_PncChannelMappingEndIdxOfPncPbType 0 0 0 255 ECU_ADDRESS 0x0 /end MEASUREMENT
/begin MEASUREMENT ComM_PncPb[26].PncChannelMappingStartIdxOfPncPb "" UBYTE ComM_PncChannelMappingStartIdxOfPncPbType 0 0 0 255 ECU_ADDRESS 0x0 /end MEASUREMENT
/begin MEASUREMENT ComM_PncPb[26].PncSignalIndEndIdxOfPncPb "" UBYTE ComM_PncSignalIndEndIdxOfPncPbType 0 0 0 255 ECU_ADDRESS 0x0 /end MEASUREMENT
/begin MEASUREMENT ComM_PncPb[26].PncSignalIndStartIdxOfPncPb "" UBYTE ComM_PncSignalIndStartIdxOfPncPbType 0 0 0 255 ECU_ADDRESS 0x0 /end MEASUREMENT
/begin MEASUREMENT ComM_PncPb[26].SignalByteIndexOfPncPb "" UBYTE NO_COMPU_METHOD 0 0 0 255 ECU_ADDRESS 0x0 /end MEASUREMENT
/begin MEASUREMENT ComM_PncPb[26].UserReqPncFullComEndIdxOfPncPb "" UBYTE NO_COMPU_METHOD 0 0 0 255 ECU_ADDRESS 0x0 /end MEASUREMENT
/begin MEASUREMENT ComM_PncPb[26].UserReqPncFullComStartIdxOfPncPb "" UBYTE NO_COMPU_METHOD 0 0 0 255 ECU_ADDRESS 0x0 /end MEASUREMENT
/begin MEASUREMENT ComM_PncPb[27].PncChannelMappingEndIdxOfPncPb "" UBYTE ComM_PncChannelMappingEndIdxOfPncPbType 0 0 0 255 ECU_ADDRESS 0x0 /end MEASUREMENT
/begin MEASUREMENT ComM_PncPb[27].PncChannelMappingStartIdxOfPncPb "" UBYTE ComM_PncChannelMappingStartIdxOfPncPbType 0 0 0 255 ECU_ADDRESS 0x0 /end MEASUREMENT
/begin MEASUREMENT ComM_PncPb[27].PncSignalIndEndIdxOfPncPb "" UBYTE ComM_PncSignalIndEndIdxOfPncPbType 0 0 0 255 ECU_ADDRESS 0x0 /end MEASUREMENT
/begin MEASUREMENT ComM_PncPb[27].PncSignalIndStartIdxOfPncPb "" UBYTE ComM_PncSignalIndStartIdxOfPncPbType 0 0 0 255 ECU_ADDRESS 0x0 /end MEASUREMENT
/begin MEASUREMENT ComM_PncPb[27].SignalByteIndexOfPncPb "" UBYTE NO_COMPU_METHOD 0 0 0 255 ECU_ADDRESS 0x0 /end MEASUREMENT
/begin MEASUREMENT ComM_PncPb[27].UserReqPncFullComEndIdxOfPncPb "" UBYTE NO_COMPU_METHOD 0 0 0 255 ECU_ADDRESS 0x0 /end MEASUREMENT
/begin MEASUREMENT ComM_PncPb[27].UserReqPncFullComStartIdxOfPncPb "" UBYTE NO_COMPU_METHOD 0 0 0 255 ECU_ADDRESS 0x0 /end MEASUREMENT
/begin MEASUREMENT ComM_PncPb[28].PncChannelMappingEndIdxOfPncPb "" UBYTE ComM_PncChannelMappingEndIdxOfPncPbType 0 0 0 255 ECU_ADDRESS 0x0 /end MEASUREMENT
/begin MEASUREMENT ComM_PncPb[28].PncChannelMappingStartIdxOfPncPb "" UBYTE ComM_PncChannelMappingStartIdxOfPncPbType 0 0 0 255 ECU_ADDRESS 0x0 /end MEASUREMENT
/begin MEASUREMENT ComM_PncPb[28].PncSignalIndEndIdxOfPncPb "" UBYTE ComM_PncSignalIndEndIdxOfPncPbType 0 0 0 255 ECU_ADDRESS 0x0 /end MEASUREMENT
/begin MEASUREMENT ComM_PncPb[28].PncSignalIndStartIdxOfPncPb "" UBYTE ComM_PncSignalIndStartIdxOfPncPbType 0 0 0 255 ECU_ADDRESS 0x0 /end MEASUREMENT
/begin MEASUREMENT ComM_PncPb[28].SignalByteIndexOfPncPb "" UBYTE NO_COMPU_METHOD 0 0 0 255 ECU_ADDRESS 0x0 /end MEASUREMENT
/begin MEASUREMENT ComM_PncPb[28].UserReqPncFullComEndIdxOfPncPb "" UBYTE NO_COMPU_METHOD 0 0 0 255 ECU_ADDRESS 0x0 /end MEASUREMENT
/begin MEASUREMENT ComM_PncPb[28].UserReqPncFullComStartIdxOfPncPb "" UBYTE NO_COMPU_METHOD 0 0 0 255 ECU_ADDRESS 0x0 /end MEASUREMENT
/begin MEASUREMENT ComM_PncPb[29].PncChannelMappingEndIdxOfPncPb "" UBYTE ComM_PncChannelMappingEndIdxOfPncPbType 0 0 0 255 ECU_ADDRESS 0x0 /end MEASUREMENT
/begin MEASUREMENT ComM_PncPb[29].PncChannelMappingStartIdxOfPncPb "" UBYTE ComM_PncChannelMappingStartIdxOfPncPbType 0 0 0 255 ECU_ADDRESS 0x0 /end MEASUREMENT
/begin MEASUREMENT ComM_PncPb[29].PncSignalIndEndIdxOfPncPb "" UBYTE ComM_PncSignalIndEndIdxOfPncPbType 0 0 0 255 ECU_ADDRESS 0x0 /end MEASUREMENT
/begin MEASUREMENT ComM_PncPb[29].PncSignalIndStartIdxOfPncPb "" UBYTE ComM_PncSignalIndStartIdxOfPncPbType 0 0 0 255 ECU_ADDRESS 0x0 /end MEASUREMENT
/begin MEASUREMENT ComM_PncPb[29].SignalByteIndexOfPncPb "" UBYTE NO_COMPU_METHOD 0 0 0 255 ECU_ADDRESS 0x0 /end MEASUREMENT
/begin MEASUREMENT ComM_PncPb[29].UserReqPncFullComEndIdxOfPncPb "" UBYTE NO_COMPU_METHOD 0 0 0 255 ECU_ADDRESS 0x0 /end MEASUREMENT
/begin MEASUREMENT ComM_PncPb[29].UserReqPncFullComStartIdxOfPncPb "" UBYTE NO_COMPU_METHOD 0 0 0 255 ECU_ADDRESS 0x0 /end MEASUREMENT
/begin MEASUREMENT ComM_PncPb[2].PncChannelMappingEndIdxOfPncPb "" UBYTE ComM_PncChannelMappingEndIdxOfPncPbType 0 0 0 255 ECU_ADDRESS 0x0 /end MEASUREMENT
/begin MEASUREMENT ComM_PncPb[2].PncChannelMappingStartIdxOfPncPb "" UBYTE ComM_PncChannelMappingStartIdxOfPncPbType 0 0 0 255 ECU_ADDRESS 0x0 /end MEASUREMENT
/begin MEASUREMENT ComM_PncPb[2].PncSignalIndEndIdxOfPncPb "" UBYTE ComM_PncSignalIndEndIdxOfPncPbType 0 0 0 255 ECU_ADDRESS 0x0 /end MEASUREMENT
/begin MEASUREMENT ComM_PncPb[2].PncSignalIndStartIdxOfPncPb "" UBYTE ComM_PncSignalIndStartIdxOfPncPbType 0 0 0 255 ECU_ADDRESS 0x0 /end MEASUREMENT
/begin MEASUREMENT ComM_PncPb[2].SignalByteIndexOfPncPb "" UBYTE NO_COMPU_METHOD 0 0 0 255 ECU_ADDRESS 0x0 /end MEASUREMENT
/begin MEASUREMENT ComM_PncPb[2].UserReqPncFullComEndIdxOfPncPb "" UBYTE NO_COMPU_METHOD 0 0 0 255 ECU_ADDRESS 0x0 /end MEASUREMENT
/begin MEASUREMENT ComM_PncPb[2].UserReqPncFullComStartIdxOfPncPb "" UBYTE NO_COMPU_METHOD 0 0 0 255 ECU_ADDRESS 0x0 /end MEASUREMENT
/begin MEASUREMENT ComM_PncPb[30].PncChannelMappingEndIdxOfPncPb "" UBYTE ComM_PncChannelMappingEndIdxOfPncPbType 0 0 0 255 ECU_ADDRESS 0x0 /end MEASUREMENT
/begin MEASUREMENT ComM_PncPb[30].PncChannelMappingStartIdxOfPncPb "" UBYTE ComM_PncChannelMappingStartIdxOfPncPbType 0 0 0 255 ECU_ADDRESS 0x0 /end MEASUREMENT
/begin MEASUREMENT ComM_PncPb[30].PncSignalIndEndIdxOfPncPb "" UBYTE ComM_PncSignalIndEndIdxOfPncPbType 0 0 0 255 ECU_ADDRESS 0x0 /end MEASUREMENT
/begin MEASUREMENT ComM_PncPb[30].PncSignalIndStartIdxOfPncPb "" UBYTE ComM_PncSignalIndStartIdxOfPncPbType 0 0 0 255 ECU_ADDRESS 0x0 /end MEASUREMENT
/begin MEASUREMENT ComM_PncPb[30].SignalByteIndexOfPncPb "" UBYTE NO_COMPU_METHOD 0 0 0 255 ECU_ADDRESS 0x0 /end MEASUREMENT
/begin MEASUREMENT ComM_PncPb[30].UserReqPncFullComEndIdxOfPncPb "" UBYTE NO_COMPU_METHOD 0 0 0 255 ECU_ADDRESS 0x0 /end MEASUREMENT
/begin MEASUREMENT ComM_PncPb[30].UserReqPncFullComStartIdxOfPncPb "" UBYTE NO_COMPU_METHOD 0 0 0 255 ECU_ADDRESS 0x0 /end MEASUREMENT
/begin MEASUREMENT ComM_PncPb[31].PncChannelMappingEndIdxOfPncPb "" UBYTE ComM_PncChannelMappingEndIdxOfPncPbType 0 0 0 255 ECU_ADDRESS 0x0 /end MEASUREMENT
/begin MEASUREMENT ComM_PncPb[31].PncChannelMappingStartIdxOfPncPb "" UBYTE ComM_PncChannelMappingStartIdxOfPncPbType 0 0 0 255 ECU_ADDRESS 0x0 /end MEASUREMENT
/begin MEASUREMENT ComM_PncPb[31].PncSignalIndEndIdxOfPncPb "" UBYTE ComM_PncSignalIndEndIdxOfPncPbType 0 0 0 255 ECU_ADDRESS 0x0 /end MEASUREMENT
/begin MEASUREMENT ComM_PncPb[31].PncSignalIndStartIdxOfPncPb "" UBYTE ComM_PncSignalIndStartIdxOfPncPbType 0 0 0 255 ECU_ADDRESS 0x0 /end MEASUREMENT
/begin MEASUREMENT ComM_PncPb[31].SignalByteIndexOfPncPb "" UBYTE NO_COMPU_METHOD 0 0 0 255 ECU_ADDRESS 0x0 /end MEASUREMENT
/begin MEASUREMENT ComM_PncPb[31].UserReqPncFullComEndIdxOfPncPb "" UBYTE NO_COMPU_METHOD 0 0 0 255 ECU_ADDRESS 0x0 /end MEASUREMENT
/begin MEASUREMENT ComM_PncPb[31].UserReqPncFullComStartIdxOfPncPb "" UBYTE NO_COMPU_METHOD 0 0 0 255 ECU_ADDRESS 0x0 /end MEASUREMENT
/begin MEASUREMENT ComM_PncPb[32].PncChannelMappingEndIdxOfPncPb "" UBYTE ComM_PncChannelMappingEndIdxOfPncPbType 0 0 0 255 ECU_ADDRESS 0x0 /end MEASUREMENT
/begin MEASUREMENT ComM_PncPb[32].PncChannelMappingStartIdxOfPncPb "" UBYTE ComM_PncChannelMappingStartIdxOfPncPbType 0 0 0 255 ECU_ADDRESS 0x0 /end MEASUREMENT
/begin MEASUREMENT ComM_PncPb[32].PncSignalIndEndIdxOfPncPb "" UBYTE ComM_PncSignalIndEndIdxOfPncPbType 0 0 0 255 ECU_ADDRESS 0x0 /end MEASUREMENT
/begin MEASUREMENT ComM_PncPb[32].PncSignalIndStartIdxOfPncPb "" UBYTE ComM_PncSignalIndStartIdxOfPncPbType 0 0 0 255 ECU_ADDRESS 0x0 /end MEASUREMENT
/begin MEASUREMENT ComM_PncPb[32].SignalByteIndexOfPncPb "" UBYTE NO_COMPU_METHOD 0 0 0 255 ECU_ADDRESS 0x0 /end MEASUREMENT
/begin MEASUREMENT ComM_PncPb[32].UserReqPncFullComEndIdxOfPncPb "" UBYTE NO_COMPU_METHOD 0 0 0 255 ECU_ADDRESS 0x0 /end MEASUREMENT
/begin MEASUREMENT ComM_PncPb[32].UserReqPncFullComStartIdxOfPncPb "" UBYTE NO_COMPU_METHOD 0 0 0 255 ECU_ADDRESS 0x0 /end MEASUREMENT
/begin MEASUREMENT ComM_PncPb[33].PncChannelMappingEndIdxOfPncPb "" UBYTE ComM_PncChannelMappingEndIdxOfPncPbType 0 0 0 255 ECU_ADDRESS 0x0 /end MEASUREMENT
/begin MEASUREMENT ComM_PncPb[33].PncChannelMappingStartIdxOfPncPb "" UBYTE ComM_PncChannelMappingStartIdxOfPncPbType 0 0 0 255 ECU_ADDRESS 0x0 /end MEASUREMENT
/begin MEASUREMENT ComM_PncPb[33].PncSignalIndEndIdxOfPncPb "" UBYTE ComM_PncSignalIndEndIdxOfPncPbType 0 0 0 255 ECU_ADDRESS 0x0 /end MEASUREMENT
/begin MEASUREMENT ComM_PncPb[33].PncSignalIndStartIdxOfPncPb "" UBYTE ComM_PncSignalIndStartIdxOfPncPbType 0 0 0 255 ECU_ADDRESS 0x0 /end MEASUREMENT
/begin MEASUREMENT ComM_PncPb[33].SignalByteIndexOfPncPb "" UBYTE NO_COMPU_METHOD 0 0 0 255 ECU_ADDRESS 0x0 /end MEASUREMENT
/begin MEASUREMENT ComM_PncPb[33].UserReqPncFullComEndIdxOfPncPb "" UBYTE NO_COMPU_METHOD 0 0 0 255 ECU_ADDRESS 0x0 /end MEASUREMENT
/begin MEASUREMENT ComM_PncPb[33].UserReqPncFullComStartIdxOfPncPb "" UBYTE NO_COMPU_METHOD 0 0 0 255 ECU_ADDRESS 0x0 /end MEASUREMENT
/begin MEASUREMENT ComM_PncPb[34].PncChannelMappingEndIdxOfPncPb "" UBYTE ComM_PncChannelMappingEndIdxOfPncPbType 0 0 0 255 ECU_ADDRESS 0x0 /end MEASUREMENT
/begin MEASUREMENT ComM_PncPb[34].PncChannelMappingStartIdxOfPncPb "" UBYTE ComM_PncChannelMappingStartIdxOfPncPbType 0 0 0 255 ECU_ADDRESS 0x0 /end MEASUREMENT
/begin MEASUREMENT ComM_PncPb[34].PncSignalIndEndIdxOfPncPb "" UBYTE ComM_PncSignalIndEndIdxOfPncPbType 0 0 0 255 ECU_ADDRESS 0x0 /end MEASUREMENT
/begin MEASUREMENT ComM_PncPb[34].PncSignalIndStartIdxOfPncPb "" UBYTE ComM_PncSignalIndStartIdxOfPncPbType 0 0 0 255 ECU_ADDRESS 0x0 /end MEASUREMENT
/begin MEASUREMENT ComM_PncPb[34].SignalByteIndexOfPncPb "" UBYTE NO_COMPU_METHOD 0 0 0 255 ECU_ADDRESS 0x0 /end MEASUREMENT
/begin MEASUREMENT ComM_PncPb[34].UserReqPncFullComEndIdxOfPncPb "" UBYTE NO_COMPU_METHOD 0 0 0 255 ECU_ADDRESS 0x0 /end MEASUREMENT
/begin MEASUREMENT ComM_PncPb[34].UserReqPncFullComStartIdxOfPncPb "" UBYTE NO_COMPU_METHOD 0 0 0 255 ECU_ADDRESS 0x0 /end MEASUREMENT
/begin MEASUREMENT ComM_PncPb[35].PncChannelMappingEndIdxOfPncPb "" UBYTE ComM_PncChannelMappingEndIdxOfPncPbType 0 0 0 255 ECU_ADDRESS 0x0 /end MEASUREMENT
/begin MEASUREMENT ComM_PncPb[35].PncChannelMappingStartIdxOfPncPb "" UBYTE ComM_PncChannelMappingStartIdxOfPncPbType 0 0 0 255 ECU_ADDRESS 0x0 /end MEASUREMENT
/begin MEASUREMENT ComM_PncPb[35].PncSignalIndEndIdxOfPncPb "" UBYTE ComM_PncSignalIndEndIdxOfPncPbType 0 0 0 255 ECU_ADDRESS 0x0 /end MEASUREMENT
/begin MEASUREMENT ComM_PncPb[35].PncSignalIndStartIdxOfPncPb "" UBYTE ComM_PncSignalIndStartIdxOfPncPbType 0 0 0 255 ECU_ADDRESS 0x0 /end MEASUREMENT
/begin MEASUREMENT ComM_PncPb[35].SignalByteIndexOfPncPb "" UBYTE NO_COMPU_METHOD 0 0 0 255 ECU_ADDRESS 0x0 /end MEASUREMENT
/begin MEASUREMENT ComM_PncPb[35].UserReqPncFullComEndIdxOfPncPb "" UBYTE NO_COMPU_METHOD 0 0 0 255 ECU_ADDRESS 0x0 /end MEASUREMENT
/begin MEASUREMENT ComM_PncPb[35].UserReqPncFullComStartIdxOfPncPb "" UBYTE NO_COMPU_METHOD 0 0 0 255 ECU_ADDRESS 0x0 /end MEASUREMENT
/begin MEASUREMENT ComM_PncPb[36].PncChannelMappingEndIdxOfPncPb "" UBYTE ComM_PncChannelMappingEndIdxOfPncPbType 0 0 0 255 ECU_ADDRESS 0x0 /end MEASUREMENT
/begin MEASUREMENT ComM_PncPb[36].PncChannelMappingStartIdxOfPncPb "" UBYTE ComM_PncChannelMappingStartIdxOfPncPbType 0 0 0 255 ECU_ADDRESS 0x0 /end MEASUREMENT
/begin MEASUREMENT ComM_PncPb[36].PncSignalIndEndIdxOfPncPb "" UBYTE ComM_PncSignalIndEndIdxOfPncPbType 0 0 0 255 ECU_ADDRESS 0x0 /end MEASUREMENT
/begin MEASUREMENT ComM_PncPb[36].PncSignalIndStartIdxOfPncPb "" UBYTE ComM_PncSignalIndStartIdxOfPncPbType 0 0 0 255 ECU_ADDRESS 0x0 /end MEASUREMENT
/begin MEASUREMENT ComM_PncPb[36].SignalByteIndexOfPncPb "" UBYTE NO_COMPU_METHOD 0 0 0 255 ECU_ADDRESS 0x0 /end MEASUREMENT
/begin MEASUREMENT ComM_PncPb[36].UserReqPncFullComEndIdxOfPncPb "" UBYTE NO_COMPU_METHOD 0 0 0 255 ECU_ADDRESS 0x0 /end MEASUREMENT
/begin MEASUREMENT ComM_PncPb[36].UserReqPncFullComStartIdxOfPncPb "" UBYTE NO_COMPU_METHOD 0 0 0 255 ECU_ADDRESS 0x0 /end MEASUREMENT
/begin MEASUREMENT ComM_PncPb[37].PncChannelMappingEndIdxOfPncPb "" UBYTE ComM_PncChannelMappingEndIdxOfPncPbType 0 0 0 255 ECU_ADDRESS 0x0 /end MEASUREMENT
/begin MEASUREMENT ComM_PncPb[37].PncChannelMappingStartIdxOfPncPb "" UBYTE ComM_PncChannelMappingStartIdxOfPncPbType 0 0 0 255 ECU_ADDRESS 0x0 /end MEASUREMENT
/begin MEASUREMENT ComM_PncPb[37].PncSignalIndEndIdxOfPncPb "" UBYTE ComM_PncSignalIndEndIdxOfPncPbType 0 0 0 255 ECU_ADDRESS 0x0 /end MEASUREMENT
/begin MEASUREMENT ComM_PncPb[37].PncSignalIndStartIdxOfPncPb "" UBYTE ComM_PncSignalIndStartIdxOfPncPbType 0 0 0 255 ECU_ADDRESS 0x0 /end MEASUREMENT
/begin MEASUREMENT ComM_PncPb[37].SignalByteIndexOfPncPb "" UBYTE NO_COMPU_METHOD 0 0 0 255 ECU_ADDRESS 0x0 /end MEASUREMENT
/begin MEASUREMENT ComM_PncPb[37].UserReqPncFullComEndIdxOfPncPb "" UBYTE NO_COMPU_METHOD 0 0 0 255 ECU_ADDRESS 0x0 /end MEASUREMENT
/begin MEASUREMENT ComM_PncPb[37].UserReqPncFullComStartIdxOfPncPb "" UBYTE NO_COMPU_METHOD 0 0 0 255 ECU_ADDRESS 0x0 /end MEASUREMENT
/begin MEASUREMENT ComM_PncPb[38].PncChannelMappingEndIdxOfPncPb "" UBYTE ComM_PncChannelMappingEndIdxOfPncPbType 0 0 0 255 ECU_ADDRESS 0x0 /end MEASUREMENT
/begin MEASUREMENT ComM_PncPb[38].PncChannelMappingStartIdxOfPncPb "" UBYTE ComM_PncChannelMappingStartIdxOfPncPbType 0 0 0 255 ECU_ADDRESS 0x0 /end MEASUREMENT
/begin MEASUREMENT ComM_PncPb[38].PncSignalIndEndIdxOfPncPb "" UBYTE ComM_PncSignalIndEndIdxOfPncPbType 0 0 0 255 ECU_ADDRESS 0x0 /end MEASUREMENT
/begin MEASUREMENT ComM_PncPb[38].PncSignalIndStartIdxOfPncPb "" UBYTE ComM_PncSignalIndStartIdxOfPncPbType 0 0 0 255 ECU_ADDRESS 0x0 /end MEASUREMENT
/begin MEASUREMENT ComM_PncPb[38].SignalByteIndexOfPncPb "" UBYTE NO_COMPU_METHOD 0 0 0 255 ECU_ADDRESS 0x0 /end MEASUREMENT
/begin MEASUREMENT ComM_PncPb[38].UserReqPncFullComEndIdxOfPncPb "" UBYTE NO_COMPU_METHOD 0 0 0 255 ECU_ADDRESS 0x0 /end MEASUREMENT
/begin MEASUREMENT ComM_PncPb[38].UserReqPncFullComStartIdxOfPncPb "" UBYTE NO_COMPU_METHOD 0 0 0 255 ECU_ADDRESS 0x0 /end MEASUREMENT
/begin MEASUREMENT ComM_PncPb[39].PncChannelMappingEndIdxOfPncPb "" UBYTE ComM_PncChannelMappingEndIdxOfPncPbType 0 0 0 255 ECU_ADDRESS 0x0 /end MEASUREMENT
/begin MEASUREMENT ComM_PncPb[39].PncChannelMappingStartIdxOfPncPb "" UBYTE ComM_PncChannelMappingStartIdxOfPncPbType 0 0 0 255 ECU_ADDRESS 0x0 /end MEASUREMENT
/begin MEASUREMENT ComM_PncPb[39].PncSignalIndEndIdxOfPncPb "" UBYTE ComM_PncSignalIndEndIdxOfPncPbType 0 0 0 255 ECU_ADDRESS 0x0 /end MEASUREMENT
/begin MEASUREMENT ComM_PncPb[39].PncSignalIndStartIdxOfPncPb "" UBYTE ComM_PncSignalIndStartIdxOfPncPbType 0 0 0 255 ECU_ADDRESS 0x0 /end MEASUREMENT
/begin MEASUREMENT ComM_PncPb[39].SignalByteIndexOfPncPb "" UBYTE NO_COMPU_METHOD 0 0 0 255 ECU_ADDRESS 0x0 /end MEASUREMENT
/begin MEASUREMENT ComM_PncPb[39].UserReqPncFullComEndIdxOfPncPb "" UBYTE NO_COMPU_METHOD 0 0 0 255 ECU_ADDRESS 0x0 /end MEASUREMENT
/begin MEASUREMENT ComM_PncPb[39].UserReqPncFullComStartIdxOfPncPb "" UBYTE NO_COMPU_METHOD 0 0 0 255 ECU_ADDRESS 0x0 /end MEASUREMENT
/begin MEASUREMENT ComM_PncPb[3].PncChannelMappingEndIdxOfPncPb "" UBYTE ComM_PncChannelMappingEndIdxOfPncPbType 0 0 0 255 ECU_ADDRESS 0x0 /end MEASUREMENT
/begin MEASUREMENT ComM_PncPb[3].PncChannelMappingStartIdxOfPncPb "" UBYTE ComM_PncChannelMappingStartIdxOfPncPbType 0 0 0 255 ECU_ADDRESS 0x0 /end MEASUREMENT
/begin MEASUREMENT ComM_PncPb[3].PncSignalIndEndIdxOfPncPb "" UBYTE ComM_PncSignalIndEndIdxOfPncPbType 0 0 0 255 ECU_ADDRESS 0x0 /end MEASUREMENT
/begin MEASUREMENT ComM_PncPb[3].PncSignalIndStartIdxOfPncPb "" UBYTE ComM_PncSignalIndStartIdxOfPncPbType 0 0 0 255 ECU_ADDRESS 0x0 /end MEASUREMENT
/begin MEASUREMENT ComM_PncPb[3].SignalByteIndexOfPncPb "" UBYTE NO_COMPU_METHOD 0 0 0 255 ECU_ADDRESS 0x0 /end MEASUREMENT
/begin MEASUREMENT ComM_PncPb[3].UserReqPncFullComEndIdxOfPncPb "" UBYTE NO_COMPU_METHOD 0 0 0 255 ECU_ADDRESS 0x0 /end MEASUREMENT
/begin MEASUREMENT ComM_PncPb[3].UserReqPncFullComStartIdxOfPncPb "" UBYTE NO_COMPU_METHOD 0 0 0 255 ECU_ADDRESS 0x0 /end MEASUREMENT
/begin MEASUREMENT ComM_PncPb[40].PncChannelMappingEndIdxOfPncPb "" UBYTE ComM_PncChannelMappingEndIdxOfPncPbType 0 0 0 255 ECU_ADDRESS 0x0 /end MEASUREMENT
/begin MEASUREMENT ComM_PncPb[40].PncChannelMappingStartIdxOfPncPb "" UBYTE ComM_PncChannelMappingStartIdxOfPncPbType 0 0 0 255 ECU_ADDRESS 0x0 /end MEASUREMENT
/begin MEASUREMENT ComM_PncPb[40].PncSignalIndEndIdxOfPncPb "" UBYTE ComM_PncSignalIndEndIdxOfPncPbType 0 0 0 255 ECU_ADDRESS 0x0 /end MEASUREMENT
/begin MEASUREMENT ComM_PncPb[40].PncSignalIndStartIdxOfPncPb "" UBYTE ComM_PncSignalIndStartIdxOfPncPbType 0 0 0 255 ECU_ADDRESS 0x0 /end MEASUREMENT
/begin MEASUREMENT ComM_PncPb[40].SignalByteIndexOfPncPb "" UBYTE NO_COMPU_METHOD 0 0 0 255 ECU_ADDRESS 0x0 /end MEASUREMENT
/begin MEASUREMENT ComM_PncPb[40].UserReqPncFullComEndIdxOfPncPb "" UBYTE NO_COMPU_METHOD 0 0 0 255 ECU_ADDRESS 0x0 /end MEASUREMENT
/begin MEASUREMENT ComM_PncPb[40].UserReqPncFullComStartIdxOfPncPb "" UBYTE NO_COMPU_METHOD 0 0 0 255 ECU_ADDRESS 0x0 /end MEASUREMENT
/begin MEASUREMENT ComM_PncPb[41].PncChannelMappingEndIdxOfPncPb "" UBYTE ComM_PncChannelMappingEndIdxOfPncPbType 0 0 0 255 ECU_ADDRESS 0x0 /end MEASUREMENT
/begin MEASUREMENT ComM_PncPb[41].PncChannelMappingStartIdxOfPncPb "" UBYTE ComM_PncChannelMappingStartIdxOfPncPbType 0 0 0 255 ECU_ADDRESS 0x0 /end MEASUREMENT
/begin MEASUREMENT ComM_PncPb[41].PncSignalIndEndIdxOfPncPb "" UBYTE ComM_PncSignalIndEndIdxOfPncPbType 0 0 0 255 ECU_ADDRESS 0x0 /end MEASUREMENT
/begin MEASUREMENT ComM_PncPb[41].PncSignalIndStartIdxOfPncPb "" UBYTE ComM_PncSignalIndStartIdxOfPncPbType 0 0 0 255 ECU_ADDRESS 0x0 /end MEASUREMENT
/begin MEASUREMENT ComM_PncPb[41].SignalByteIndexOfPncPb "" UBYTE NO_COMPU_METHOD 0 0 0 255 ECU_ADDRESS 0x0 /end MEASUREMENT
/begin MEASUREMENT ComM_PncPb[41].UserReqPncFullComEndIdxOfPncPb "" UBYTE NO_COMPU_METHOD 0 0 0 255 ECU_ADDRESS 0x0 /end MEASUREMENT
/begin MEASUREMENT ComM_PncPb[41].UserReqPncFullComStartIdxOfPncPb "" UBYTE NO_COMPU_METHOD 0 0 0 255 ECU_ADDRESS 0x0 /end MEASUREMENT
/begin MEASUREMENT ComM_PncPb[42].PncChannelMappingEndIdxOfPncPb "" UBYTE ComM_PncChannelMappingEndIdxOfPncPbType 0 0 0 255 ECU_ADDRESS 0x0 /end MEASUREMENT
/begin MEASUREMENT ComM_PncPb[42].PncChannelMappingStartIdxOfPncPb "" UBYTE ComM_PncChannelMappingStartIdxOfPncPbType 0 0 0 255 ECU_ADDRESS 0x0 /end MEASUREMENT
/begin MEASUREMENT ComM_PncPb[42].PncSignalIndEndIdxOfPncPb "" UBYTE ComM_PncSignalIndEndIdxOfPncPbType 0 0 0 255 ECU_ADDRESS 0x0 /end MEASUREMENT
/begin MEASUREMENT ComM_PncPb[42].PncSignalIndStartIdxOfPncPb "" UBYTE ComM_PncSignalIndStartIdxOfPncPbType 0 0 0 255 ECU_ADDRESS 0x0 /end MEASUREMENT
/begin MEASUREMENT ComM_PncPb[42].SignalByteIndexOfPncPb "" UBYTE NO_COMPU_METHOD 0 0 0 255 ECU_ADDRESS 0x0 /end MEASUREMENT
/begin MEASUREMENT ComM_PncPb[42].UserReqPncFullComEndIdxOfPncPb "" UBYTE NO_COMPU_METHOD 0 0 0 255 ECU_ADDRESS 0x0 /end MEASUREMENT
/begin MEASUREMENT ComM_PncPb[42].UserReqPncFullComStartIdxOfPncPb "" UBYTE NO_COMPU_METHOD 0 0 0 255 ECU_ADDRESS 0x0 /end MEASUREMENT
/begin MEASUREMENT ComM_PncPb[43].PncChannelMappingEndIdxOfPncPb "" UBYTE ComM_PncChannelMappingEndIdxOfPncPbType 0 0 0 255 ECU_ADDRESS 0x0 /end MEASUREMENT
/begin MEASUREMENT ComM_PncPb[43].PncChannelMappingStartIdxOfPncPb "" UBYTE ComM_PncChannelMappingStartIdxOfPncPbType 0 0 0 255 ECU_ADDRESS 0x0 /end MEASUREMENT
/begin MEASUREMENT ComM_PncPb[43].PncSignalIndEndIdxOfPncPb "" UBYTE ComM_PncSignalIndEndIdxOfPncPbType 0 0 0 255 ECU_ADDRESS 0x0 /end MEASUREMENT
/begin MEASUREMENT ComM_PncPb[43].PncSignalIndStartIdxOfPncPb "" UBYTE ComM_PncSignalIndStartIdxOfPncPbType 0 0 0 255 ECU_ADDRESS 0x0 /end MEASUREMENT
/begin MEASUREMENT ComM_PncPb[43].SignalByteIndexOfPncPb "" UBYTE NO_COMPU_METHOD 0 0 0 255 ECU_ADDRESS 0x0 /end MEASUREMENT
/begin MEASUREMENT ComM_PncPb[43].UserReqPncFullComEndIdxOfPncPb "" UBYTE NO_COMPU_METHOD 0 0 0 255 ECU_ADDRESS 0x0 /end MEASUREMENT
/begin MEASUREMENT ComM_PncPb[43].UserReqPncFullComStartIdxOfPncPb "" UBYTE NO_COMPU_METHOD 0 0 0 255 ECU_ADDRESS 0x0 /end MEASUREMENT
/begin MEASUREMENT ComM_PncPb[44].PncChannelMappingEndIdxOfPncPb "" UBYTE ComM_PncChannelMappingEndIdxOfPncPbType 0 0 0 255 ECU_ADDRESS 0x0 /end MEASUREMENT
/begin MEASUREMENT ComM_PncPb[44].PncChannelMappingStartIdxOfPncPb "" UBYTE ComM_PncChannelMappingStartIdxOfPncPbType 0 0 0 255 ECU_ADDRESS 0x0 /end MEASUREMENT
/begin MEASUREMENT ComM_PncPb[44].PncSignalIndEndIdxOfPncPb "" UBYTE ComM_PncSignalIndEndIdxOfPncPbType 0 0 0 255 ECU_ADDRESS 0x0 /end MEASUREMENT
/begin MEASUREMENT ComM_PncPb[44].PncSignalIndStartIdxOfPncPb "" UBYTE ComM_PncSignalIndStartIdxOfPncPbType 0 0 0 255 ECU_ADDRESS 0x0 /end MEASUREMENT
/begin MEASUREMENT ComM_PncPb[44].SignalByteIndexOfPncPb "" UBYTE NO_COMPU_METHOD 0 0 0 255 ECU_ADDRESS 0x0 /end MEASUREMENT
/begin MEASUREMENT ComM_PncPb[44].UserReqPncFullComEndIdxOfPncPb "" UBYTE NO_COMPU_METHOD 0 0 0 255 ECU_ADDRESS 0x0 /end MEASUREMENT
/begin MEASUREMENT ComM_PncPb[44].UserReqPncFullComStartIdxOfPncPb "" UBYTE NO_COMPU_METHOD 0 0 0 255 ECU_ADDRESS 0x0 /end MEASUREMENT
/begin MEASUREMENT ComM_PncPb[45].PncChannelMappingEndIdxOfPncPb "" UBYTE ComM_PncChannelMappingEndIdxOfPncPbType 0 0 0 255 ECU_ADDRESS 0x0 /end MEASUREMENT
/begin MEASUREMENT ComM_PncPb[45].PncChannelMappingStartIdxOfPncPb "" UBYTE ComM_PncChannelMappingStartIdxOfPncPbType 0 0 0 255 ECU_ADDRESS 0x0 /end MEASUREMENT
/begin MEASUREMENT ComM_PncPb[45].PncSignalIndEndIdxOfPncPb "" UBYTE ComM_PncSignalIndEndIdxOfPncPbType 0 0 0 255 ECU_ADDRESS 0x0 /end MEASUREMENT
/begin MEASUREMENT ComM_PncPb[45].PncSignalIndStartIdxOfPncPb "" UBYTE ComM_PncSignalIndStartIdxOfPncPbType 0 0 0 255 ECU_ADDRESS 0x0 /end MEASUREMENT
/begin MEASUREMENT ComM_PncPb[45].SignalByteIndexOfPncPb "" UBYTE NO_COMPU_METHOD 0 0 0 255 ECU_ADDRESS 0x0 /end MEASUREMENT
/begin MEASUREMENT ComM_PncPb[45].UserReqPncFullComEndIdxOfPncPb "" UBYTE NO_COMPU_METHOD 0 0 0 255 ECU_ADDRESS 0x0 /end MEASUREMENT
/begin MEASUREMENT ComM_PncPb[45].UserReqPncFullComStartIdxOfPncPb "" UBYTE NO_COMPU_METHOD 0 0 0 255 ECU_ADDRESS 0x0 /end MEASUREMENT
/begin MEASUREMENT ComM_PncPb[46].PncChannelMappingEndIdxOfPncPb "" UBYTE ComM_PncChannelMappingEndIdxOfPncPbType 0 0 0 255 ECU_ADDRESS 0x0 /end MEASUREMENT
/begin MEASUREMENT ComM_PncPb[46].PncChannelMappingStartIdxOfPncPb "" UBYTE ComM_PncChannelMappingStartIdxOfPncPbType 0 0 0 255 ECU_ADDRESS 0x0 /end MEASUREMENT
/begin MEASUREMENT ComM_PncPb[46].PncSignalIndEndIdxOfPncPb "" UBYTE ComM_PncSignalIndEndIdxOfPncPbType 0 0 0 255 ECU_ADDRESS 0x0 /end MEASUREMENT
/begin MEASUREMENT ComM_PncPb[46].PncSignalIndStartIdxOfPncPb "" UBYTE ComM_PncSignalIndStartIdxOfPncPbType 0 0 0 255 ECU_ADDRESS 0x0 /end MEASUREMENT
/begin MEASUREMENT ComM_PncPb[46].SignalByteIndexOfPncPb "" UBYTE NO_COMPU_METHOD 0 0 0 255 ECU_ADDRESS 0x0 /end MEASUREMENT
/begin MEASUREMENT ComM_PncPb[46].UserReqPncFullComEndIdxOfPncPb "" UBYTE NO_COMPU_METHOD 0 0 0 255 ECU_ADDRESS 0x0 /end MEASUREMENT
/begin MEASUREMENT ComM_PncPb[46].UserReqPncFullComStartIdxOfPncPb "" UBYTE NO_COMPU_METHOD 0 0 0 255 ECU_ADDRESS 0x0 /end MEASUREMENT
/begin MEASUREMENT ComM_PncPb[47].PncChannelMappingEndIdxOfPncPb "" UBYTE ComM_PncChannelMappingEndIdxOfPncPbType 0 0 0 255 ECU_ADDRESS 0x0 /end MEASUREMENT
/begin MEASUREMENT ComM_PncPb[47].PncChannelMappingStartIdxOfPncPb "" UBYTE ComM_PncChannelMappingStartIdxOfPncPbType 0 0 0 255 ECU_ADDRESS 0x0 /end MEASUREMENT
/begin MEASUREMENT ComM_PncPb[47].PncSignalIndEndIdxOfPncPb "" UBYTE ComM_PncSignalIndEndIdxOfPncPbType 0 0 0 255 ECU_ADDRESS 0x0 /end MEASUREMENT
/begin MEASUREMENT ComM_PncPb[47].PncSignalIndStartIdxOfPncPb "" UBYTE ComM_PncSignalIndStartIdxOfPncPbType 0 0 0 255 ECU_ADDRESS 0x0 /end MEASUREMENT
/begin MEASUREMENT ComM_PncPb[47].SignalByteIndexOfPncPb "" UBYTE NO_COMPU_METHOD 0 0 0 255 ECU_ADDRESS 0x0 /end MEASUREMENT
/begin MEASUREMENT ComM_PncPb[47].UserReqPncFullComEndIdxOfPncPb "" UBYTE NO_COMPU_METHOD 0 0 0 255 ECU_ADDRESS 0x0 /end MEASUREMENT
/begin MEASUREMENT ComM_PncPb[47].UserReqPncFullComStartIdxOfPncPb "" UBYTE NO_COMPU_METHOD 0 0 0 255 ECU_ADDRESS 0x0 /end MEASUREMENT
/begin MEASUREMENT ComM_PncPb[4].PncChannelMappingEndIdxOfPncPb "" UBYTE ComM_PncChannelMappingEndIdxOfPncPbType 0 0 0 255 ECU_ADDRESS 0x0 /end MEASUREMENT
/begin MEASUREMENT ComM_PncPb[4].PncChannelMappingStartIdxOfPncPb "" UBYTE ComM_PncChannelMappingStartIdxOfPncPbType 0 0 0 255 ECU_ADDRESS 0x0 /end MEASUREMENT
/begin MEASUREMENT ComM_PncPb[4].PncSignalIndEndIdxOfPncPb "" UBYTE ComM_PncSignalIndEndIdxOfPncPbType 0 0 0 255 ECU_ADDRESS 0x0 /end MEASUREMENT
/begin MEASUREMENT ComM_PncPb[4].PncSignalIndStartIdxOfPncPb "" UBYTE ComM_PncSignalIndStartIdxOfPncPbType 0 0 0 255 ECU_ADDRESS 0x0 /end MEASUREMENT
/begin MEASUREMENT ComM_PncPb[4].SignalByteIndexOfPncPb "" UBYTE NO_COMPU_METHOD 0 0 0 255 ECU_ADDRESS 0x0 /end MEASUREMENT
/begin MEASUREMENT ComM_PncPb[4].UserReqPncFullComEndIdxOfPncPb "" UBYTE NO_COMPU_METHOD 0 0 0 255 ECU_ADDRESS 0x0 /end MEASUREMENT
/begin MEASUREMENT ComM_PncPb[4].UserReqPncFullComStartIdxOfPncPb "" UBYTE NO_COMPU_METHOD 0 0 0 255 ECU_ADDRESS 0x0 /end MEASUREMENT
/begin MEASUREMENT ComM_PncPb[5].PncChannelMappingEndIdxOfPncPb "" UBYTE ComM_PncChannelMappingEndIdxOfPncPbType 0 0 0 255 ECU_ADDRESS 0x0 /end MEASUREMENT
/begin MEASUREMENT ComM_PncPb[5].PncChannelMappingStartIdxOfPncPb "" UBYTE ComM_PncChannelMappingStartIdxOfPncPbType 0 0 0 255 ECU_ADDRESS 0x0 /end MEASUREMENT
/begin MEASUREMENT ComM_PncPb[5].PncSignalIndEndIdxOfPncPb "" UBYTE ComM_PncSignalIndEndIdxOfPncPbType 0 0 0 255 ECU_ADDRESS 0x0 /end MEASUREMENT
/begin MEASUREMENT ComM_PncPb[5].PncSignalIndStartIdxOfPncPb "" UBYTE ComM_PncSignalIndStartIdxOfPncPbType 0 0 0 255 ECU_ADDRESS 0x0 /end MEASUREMENT
/begin MEASUREMENT ComM_PncPb[5].SignalByteIndexOfPncPb "" UBYTE NO_COMPU_METHOD 0 0 0 255 ECU_ADDRESS 0x0 /end MEASUREMENT
/begin MEASUREMENT ComM_PncPb[5].UserReqPncFullComEndIdxOfPncPb "" UBYTE NO_COMPU_METHOD 0 0 0 255 ECU_ADDRESS 0x0 /end MEASUREMENT
/begin MEASUREMENT ComM_PncPb[5].UserReqPncFullComStartIdxOfPncPb "" UBYTE NO_COMPU_METHOD 0 0 0 255 ECU_ADDRESS 0x0 /end MEASUREMENT
/begin MEASUREMENT ComM_PncPb[6].PncChannelMappingEndIdxOfPncPb "" UBYTE ComM_PncChannelMappingEndIdxOfPncPbType 0 0 0 255 ECU_ADDRESS 0x0 /end MEASUREMENT
/begin MEASUREMENT ComM_PncPb[6].PncChannelMappingStartIdxOfPncPb "" UBYTE ComM_PncChannelMappingStartIdxOfPncPbType 0 0 0 255 ECU_ADDRESS 0x0 /end MEASUREMENT
/begin MEASUREMENT ComM_PncPb[6].PncSignalIndEndIdxOfPncPb "" UBYTE ComM_PncSignalIndEndIdxOfPncPbType 0 0 0 255 ECU_ADDRESS 0x0 /end MEASUREMENT
/begin MEASUREMENT ComM_PncPb[6].PncSignalIndStartIdxOfPncPb "" UBYTE ComM_PncSignalIndStartIdxOfPncPbType 0 0 0 255 ECU_ADDRESS 0x0 /end MEASUREMENT
/begin MEASUREMENT ComM_PncPb[6].SignalByteIndexOfPncPb "" UBYTE NO_COMPU_METHOD 0 0 0 255 ECU_ADDRESS 0x0 /end MEASUREMENT
/begin MEASUREMENT ComM_PncPb[6].UserReqPncFullComEndIdxOfPncPb "" UBYTE NO_COMPU_METHOD 0 0 0 255 ECU_ADDRESS 0x0 /end MEASUREMENT
/begin MEASUREMENT ComM_PncPb[6].UserReqPncFullComStartIdxOfPncPb "" UBYTE NO_COMPU_METHOD 0 0 0 255 ECU_ADDRESS 0x0 /end MEASUREMENT
/begin MEASUREMENT ComM_PncPb[7].PncChannelMappingEndIdxOfPncPb "" UBYTE ComM_PncChannelMappingEndIdxOfPncPbType 0 0 0 255 ECU_ADDRESS 0x0 /end MEASUREMENT
/begin MEASUREMENT ComM_PncPb[7].PncChannelMappingStartIdxOfPncPb "" UBYTE ComM_PncChannelMappingStartIdxOfPncPbType 0 0 0 255 ECU_ADDRESS 0x0 /end MEASUREMENT
/begin MEASUREMENT ComM_PncPb[7].PncSignalIndEndIdxOfPncPb "" UBYTE ComM_PncSignalIndEndIdxOfPncPbType 0 0 0 255 ECU_ADDRESS 0x0 /end MEASUREMENT
/begin MEASUREMENT ComM_PncPb[7].PncSignalIndStartIdxOfPncPb "" UBYTE ComM_PncSignalIndStartIdxOfPncPbType 0 0 0 255 ECU_ADDRESS 0x0 /end MEASUREMENT
/begin MEASUREMENT ComM_PncPb[7].SignalByteIndexOfPncPb "" UBYTE NO_COMPU_METHOD 0 0 0 255 ECU_ADDRESS 0x0 /end MEASUREMENT
/begin MEASUREMENT ComM_PncPb[7].UserReqPncFullComEndIdxOfPncPb "" UBYTE NO_COMPU_METHOD 0 0 0 255 ECU_ADDRESS 0x0 /end MEASUREMENT
/begin MEASUREMENT ComM_PncPb[7].UserReqPncFullComStartIdxOfPncPb "" UBYTE NO_COMPU_METHOD 0 0 0 255 ECU_ADDRESS 0x0 /end MEASUREMENT
/begin MEASUREMENT ComM_PncPb[8].PncChannelMappingEndIdxOfPncPb "" UBYTE ComM_PncChannelMappingEndIdxOfPncPbType 0 0 0 255 ECU_ADDRESS 0x0 /end MEASUREMENT
/begin MEASUREMENT ComM_PncPb[8].PncChannelMappingStartIdxOfPncPb "" UBYTE ComM_PncChannelMappingStartIdxOfPncPbType 0 0 0 255 ECU_ADDRESS 0x0 /end MEASUREMENT
/begin MEASUREMENT ComM_PncPb[8].PncSignalIndEndIdxOfPncPb "" UBYTE ComM_PncSignalIndEndIdxOfPncPbType 0 0 0 255 ECU_ADDRESS 0x0 /end MEASUREMENT
/begin MEASUREMENT ComM_PncPb[8].PncSignalIndStartIdxOfPncPb "" UBYTE ComM_PncSignalIndStartIdxOfPncPbType 0 0 0 255 ECU_ADDRESS 0x0 /end MEASUREMENT
/begin MEASUREMENT ComM_PncPb[8].SignalByteIndexOfPncPb "" UBYTE NO_COMPU_METHOD 0 0 0 255 ECU_ADDRESS 0x0 /end MEASUREMENT
/begin MEASUREMENT ComM_PncPb[8].UserReqPncFullComEndIdxOfPncPb "" UBYTE NO_COMPU_METHOD 0 0 0 255 ECU_ADDRESS 0x0 /end MEASUREMENT
/begin MEASUREMENT ComM_PncPb[8].UserReqPncFullComStartIdxOfPncPb "" UBYTE NO_COMPU_METHOD 0 0 0 255 ECU_ADDRESS 0x0 /end MEASUREMENT
/begin MEASUREMENT ComM_PncPb[9].PncChannelMappingEndIdxOfPncPb "" UBYTE ComM_PncChannelMappingEndIdxOfPncPbType 0 0 0 255 ECU_ADDRESS 0x0 /end MEASUREMENT
/begin MEASUREMENT ComM_PncPb[9].PncChannelMappingStartIdxOfPncPb "" UBYTE ComM_PncChannelMappingStartIdxOfPncPbType 0 0 0 255 ECU_ADDRESS 0x0 /end MEASUREMENT
/begin MEASUREMENT ComM_PncPb[9].PncSignalIndEndIdxOfPncPb "" UBYTE ComM_PncSignalIndEndIdxOfPncPbType 0 0 0 255 ECU_ADDRESS 0x0 /end MEASUREMENT
/begin MEASUREMENT ComM_PncPb[9].PncSignalIndStartIdxOfPncPb "" UBYTE ComM_PncSignalIndStartIdxOfPncPbType 0 0 0 255 ECU_ADDRESS 0x0 /end MEASUREMENT
/begin MEASUREMENT ComM_PncPb[9].SignalByteIndexOfPncPb "" UBYTE NO_COMPU_METHOD 0 0 0 255 ECU_ADDRESS 0x0 /end MEASUREMENT
/begin MEASUREMENT ComM_PncPb[9].UserReqPncFullComEndIdxOfPncPb "" UBYTE NO_COMPU_METHOD 0 0 0 255 ECU_ADDRESS 0x0 /end MEASUREMENT
/begin MEASUREMENT ComM_PncPb[9].UserReqPncFullComStartIdxOfPncPb "" UBYTE NO_COMPU_METHOD 0 0 0 255 ECU_ADDRESS 0x0 /end MEASUREMENT
/begin MEASUREMENT ComM_PncSignalValues "" UBYTE NO_COMPU_METHOD 0 0 0 255 ECU_ADDRESS 0x0 MATRIX_DIM 14 SYMBOL_LINK "ComM_PncSignalValues.raw" 0 /end MEASUREMENT
/begin MEASUREMENT ComM_PncSignalValues_ComM_ComConf_ComSignal_ComSignalPnc_EIRA_CAN_Rx "The element: ComM_ComConf_ComSignal_ComSignalPnc_EIRA_CAN_Rx of ComM_PncSignalValues" UBYTE NO_COMPU_METHOD 0 0 0 255 ECU_ADDRESS 0x0 MATRIX_DIM 7 SYMBOL_LINK "ComM_PncSignalValues.raw[0]" 0 /end MEASUREMENT
/begin MEASUREMENT ComM_PncSignalValues_ComM_ComConf_ComSignal_NM_Hybrid_01_FCAB_XIX_NM_Hybrid_01_XIX_HCP5_CANFD01_38c188fa_Tx "The element: ComM_ComConf_ComSignal_NM_Hybrid_01_FCAB_XIX_NM_Hybrid_01_XIX_HCP5_CANFD01_38c188fa_Tx of ComM_PncSignalValues" UBYTE NO_COMPU_METHOD 0 0 0 255 ECU_ADDRESS 0x0 MATRIX_DIM 7 SYMBOL_LINK "ComM_PncSignalValues.raw[7]" 0 /end MEASUREMENT
/begin MEASUREMENT ComM_PncSignal[0].ChannelIdxOfPncSignal "" UBYTE ComM_ChannelIdxOfPncSignalType 0 0 0 255 ECU_ADDRESS 0x0 /end MEASUREMENT
/begin MEASUREMENT ComM_PncSignal[0].PncSignalValuesEndIdxOfPncSignal "" UBYTE ComM_PncSignalValuesEndIdxOfPncSignalType 0 0 0 255 ECU_ADDRESS 0x0 /end MEASUREMENT
/begin MEASUREMENT ComM_PncSignal[0].PncSignalValuesStartIdxOfPncSignal "" UBYTE ComM_PncSignalValuesStartIdxOfPncSignalType 0 0 0 255 ECU_ADDRESS 0x0 /end MEASUREMENT
/begin MEASUREMENT ComM_PncSignal[0].TypeOfPncSignal "" UBYTE ComM_TypeOfPncSignalType 0 0 0 255 ECU_ADDRESS 0x0 /end MEASUREMENT
/begin MEASUREMENT ComM_PncSignal[1].ChannelIdxOfPncSignal "" UBYTE ComM_ChannelIdxOfPncSignalType 0 0 0 255 ECU_ADDRESS 0x0 /end MEASUREMENT
/begin MEASUREMENT ComM_PncSignal[1].PncSignalValuesEndIdxOfPncSignal "" UBYTE ComM_PncSignalValuesEndIdxOfPncSignalType 0 0 0 255 ECU_ADDRESS 0x0 /end MEASUREMENT
/begin MEASUREMENT ComM_PncSignal[1].PncSignalValuesStartIdxOfPncSignal "" UBYTE ComM_PncSignalValuesStartIdxOfPncSignalType 0 0 0 255 ECU_ADDRESS 0x0 /end MEASUREMENT
/begin MEASUREMENT ComM_PncSignal[1].TypeOfPncSignal "" UBYTE ComM_TypeOfPncSignalType 0 0 0 255 ECU_ADDRESS 0x0 /end MEASUREMENT
/begin MEASUREMENT ComM_PncToChannelRoutingState "Bit flags describing the current PNC Routing state per channel" UBYTE NO_COMPU_METHOD 0 0 0 255 ECU_ADDRESS 0x0 MATRIX_DIM 2 SYMBOL_LINK "ComM_PncToChannelRoutingState.raw" 0 /end MEASUREMENT
/begin MEASUREMENT ComM_PncToChannelRoutingState_ComMChannel_0 "The element: ComMChannel_0 of ComM_PncToChannelRoutingState" UBYTE NO_COMPU_METHOD 0 0 0 255 ECU_ADDRESS 0x0 SYMBOL_LINK "ComM_PncToChannelRoutingState.raw[0]" 0 /end MEASUREMENT
/begin MEASUREMENT ComM_PncToChannelRoutingState_ComMChannel_1 "The element: ComMChannel_1 of ComM_PncToChannelRoutingState" UBYTE NO_COMPU_METHOD 0 0 0 255 ECU_ADDRESS 0x0 SYMBOL_LINK "ComM_PncToChannelRoutingState.raw[1]" 0 /end MEASUREMENT
/begin MEASUREMENT ComM_Pnc[0].ClearMaskOfPnc "" UBYTE NO_COMPU_METHOD 0 0 0 255 ECU_ADDRESS 0x0 /end MEASUREMENT
/begin MEASUREMENT ComM_Pnc[0].PncIdOfPnc "" UBYTE NO_COMPU_METHOD 0 0 0 255 ECU_ADDRESS 0x0 /end MEASUREMENT
/begin MEASUREMENT ComM_Pnc[0].SetMaskOfPnc "" UBYTE NO_COMPU_METHOD 0 0 0 255 ECU_ADDRESS 0x0 /end MEASUREMENT
/begin MEASUREMENT ComM_Pnc[10].ClearMaskOfPnc "" UBYTE NO_COMPU_METHOD 0 0 0 255 ECU_ADDRESS 0x0 /end MEASUREMENT
/begin MEASUREMENT ComM_Pnc[10].PncIdOfPnc "" UBYTE NO_COMPU_METHOD 0 0 0 255 ECU_ADDRESS 0x0 /end MEASUREMENT
/begin MEASUREMENT ComM_Pnc[10].SetMaskOfPnc "" UBYTE NO_COMPU_METHOD 0 0 0 255 ECU_ADDRESS 0x0 /end MEASUREMENT
/begin MEASUREMENT ComM_Pnc[11].ClearMaskOfPnc "" UBYTE NO_COMPU_METHOD 0 0 0 255 ECU_ADDRESS 0x0 /end MEASUREMENT
/begin MEASUREMENT ComM_Pnc[11].PncIdOfPnc "" UBYTE NO_COMPU_METHOD 0 0 0 255 ECU_ADDRESS 0x0 /end MEASUREMENT
/begin MEASUREMENT ComM_Pnc[11].SetMaskOfPnc "" UBYTE NO_COMPU_METHOD 0 0 0 255 ECU_ADDRESS 0x0 /end MEASUREMENT
/begin MEASUREMENT ComM_Pnc[12].ClearMaskOfPnc "" UBYTE NO_COMPU_METHOD 0 0 0 255 ECU_ADDRESS 0x0 /end MEASUREMENT
/begin MEASUREMENT ComM_Pnc[12].PncIdOfPnc "" UBYTE NO_COMPU_METHOD 0 0 0 255 ECU_ADDRESS 0x0 /end MEASUREMENT
/begin MEASUREMENT ComM_Pnc[12].SetMaskOfPnc "" UBYTE NO_COMPU_METHOD 0 0 0 255 ECU_ADDRESS 0x0 /end MEASUREMENT
/begin MEASUREMENT ComM_Pnc[13].ClearMaskOfPnc "" UBYTE NO_COMPU_METHOD 0 0 0 255 ECU_ADDRESS 0x0 /end MEASUREMENT
/begin MEASUREMENT ComM_Pnc[13].PncIdOfPnc "" UBYTE NO_COMPU_METHOD 0 0 0 255 ECU_ADDRESS 0x0 /end MEASUREMENT
/begin MEASUREMENT ComM_Pnc[13].SetMaskOfPnc "" UBYTE NO_COMPU_METHOD 0 0 0 255 ECU_ADDRESS 0x0 /end MEASUREMENT
/begin MEASUREMENT ComM_Pnc[14].ClearMaskOfPnc "" UBYTE NO_COMPU_METHOD 0 0 0 255 ECU_ADDRESS 0x0 /end MEASUREMENT
/begin MEASUREMENT ComM_Pnc[14].PncIdOfPnc "" UBYTE NO_COMPU_METHOD 0 0 0 255 ECU_ADDRESS 0x0 /end MEASUREMENT
/begin MEASUREMENT ComM_Pnc[14].SetMaskOfPnc "" UBYTE NO_COMPU_METHOD 0 0 0 255 ECU_ADDRESS 0x0 /end MEASUREMENT
/begin MEASUREMENT ComM_Pnc[15].ClearMaskOfPnc "" UBYTE NO_COMPU_METHOD 0 0 0 255 ECU_ADDRESS 0x0 /end MEASUREMENT
/begin MEASUREMENT ComM_Pnc[15].PncIdOfPnc "" UBYTE NO_COMPU_METHOD 0 0 0 255 ECU_ADDRESS 0x0 /end MEASUREMENT
/begin MEASUREMENT ComM_Pnc[15].SetMaskOfPnc "" UBYTE NO_COMPU_METHOD 0 0 0 255 ECU_ADDRESS 0x0 /end MEASUREMENT
/begin MEASUREMENT ComM_Pnc[16].ClearMaskOfPnc "" UBYTE NO_COMPU_METHOD 0 0 0 255 ECU_ADDRESS 0x0 /end MEASUREMENT
/begin MEASUREMENT ComM_Pnc[16].PncIdOfPnc "" UBYTE NO_COMPU_METHOD 0 0 0 255 ECU_ADDRESS 0x0 /end MEASUREMENT
/begin MEASUREMENT ComM_Pnc[16].SetMaskOfPnc "" UBYTE NO_COMPU_METHOD 0 0 0 255 ECU_ADDRESS 0x0 /end MEASUREMENT
/begin MEASUREMENT ComM_Pnc[17].ClearMaskOfPnc "" UBYTE NO_COMPU_METHOD 0 0 0 255 ECU_ADDRESS 0x0 /end MEASUREMENT
/begin MEASUREMENT ComM_Pnc[17].PncIdOfPnc "" UBYTE NO_COMPU_METHOD 0 0 0 255 ECU_ADDRESS 0x0 /end MEASUREMENT
/begin MEASUREMENT ComM_Pnc[17].SetMaskOfPnc "" UBYTE NO_COMPU_METHOD 0 0 0 255 ECU_ADDRESS 0x0 /end MEASUREMENT
/begin MEASUREMENT ComM_Pnc[18].ClearMaskOfPnc "" UBYTE NO_COMPU_METHOD 0 0 0 255 ECU_ADDRESS 0x0 /end MEASUREMENT
/begin MEASUREMENT ComM_Pnc[18].PncIdOfPnc "" UBYTE NO_COMPU_METHOD 0 0 0 255 ECU_ADDRESS 0x0 /end MEASUREMENT
/begin MEASUREMENT ComM_Pnc[18].SetMaskOfPnc "" UBYTE NO_COMPU_METHOD 0 0 0 255 ECU_ADDRESS 0x0 /end MEASUREMENT
/begin MEASUREMENT ComM_Pnc[19].ClearMaskOfPnc "" UBYTE NO_COMPU_METHOD 0 0 0 255 ECU_ADDRESS 0x0 /end MEASUREMENT
/begin MEASUREMENT ComM_Pnc[19].PncIdOfPnc "" UBYTE NO_COMPU_METHOD 0 0 0 255 ECU_ADDRESS 0x0 /end MEASUREMENT
/begin MEASUREMENT ComM_Pnc[19].SetMaskOfPnc "" UBYTE NO_COMPU_METHOD 0 0 0 255 ECU_ADDRESS 0x0 /end MEASUREMENT
/begin MEASUREMENT ComM_Pnc[1].ClearMaskOfPnc "" UBYTE NO_COMPU_METHOD 0 0 0 255 ECU_ADDRESS 0x0 /end MEASUREMENT
/begin MEASUREMENT ComM_Pnc[1].PncIdOfPnc "" UBYTE NO_COMPU_METHOD 0 0 0 255 ECU_ADDRESS 0x0 /end MEASUREMENT
/begin MEASUREMENT ComM_Pnc[1].SetMaskOfPnc "" UBYTE NO_COMPU_METHOD 0 0 0 255 ECU_ADDRESS 0x0 /end MEASUREMENT
/begin MEASUREMENT ComM_Pnc[20].ClearMaskOfPnc "" UBYTE NO_COMPU_METHOD 0 0 0 255 ECU_ADDRESS 0x0 /end MEASUREMENT
/begin MEASUREMENT ComM_Pnc[20].PncIdOfPnc "" UBYTE NO_COMPU_METHOD 0 0 0 255 ECU_ADDRESS 0x0 /end MEASUREMENT
/begin MEASUREMENT ComM_Pnc[20].SetMaskOfPnc "" UBYTE NO_COMPU_METHOD 0 0 0 255 ECU_ADDRESS 0x0 /end MEASUREMENT
/begin MEASUREMENT ComM_Pnc[21].ClearMaskOfPnc "" UBYTE NO_COMPU_METHOD 0 0 0 255 ECU_ADDRESS 0x0 /end MEASUREMENT
/begin MEASUREMENT ComM_Pnc[21].PncIdOfPnc "" UBYTE NO_COMPU_METHOD 0 0 0 255 ECU_ADDRESS 0x0 /end MEASUREMENT
/begin MEASUREMENT ComM_Pnc[21].SetMaskOfPnc "" UBYTE NO_COMPU_METHOD 0 0 0 255 ECU_ADDRESS 0x0 /end MEASUREMENT
/begin MEASUREMENT ComM_Pnc[22].ClearMaskOfPnc "" UBYTE NO_COMPU_METHOD 0 0 0 255 ECU_ADDRESS 0x0 /end MEASUREMENT
/begin MEASUREMENT ComM_Pnc[22].PncIdOfPnc "" UBYTE NO_COMPU_METHOD 0 0 0 255 ECU_ADDRESS 0x0 /end MEASUREMENT
/begin MEASUREMENT ComM_Pnc[22].SetMaskOfPnc "" UBYTE NO_COMPU_METHOD 0 0 0 255 ECU_ADDRESS 0x0 /end MEASUREMENT
/begin MEASUREMENT ComM_Pnc[23].ClearMaskOfPnc "" UBYTE NO_COMPU_METHOD 0 0 0 255 ECU_ADDRESS 0x0 /end MEASUREMENT
/begin MEASUREMENT ComM_Pnc[23].PncIdOfPnc "" UBYTE NO_COMPU_METHOD 0 0 0 255 ECU_ADDRESS 0x0 /end MEASUREMENT
/begin MEASUREMENT ComM_Pnc[23].SetMaskOfPnc "" UBYTE NO_COMPU_METHOD 0 0 0 255 ECU_ADDRESS 0x0 /end MEASUREMENT
/begin MEASUREMENT ComM_Pnc[24].ClearMaskOfPnc "" UBYTE NO_COMPU_METHOD 0 0 0 255 ECU_ADDRESS 0x0 /end MEASUREMENT
/begin MEASUREMENT ComM_Pnc[24].PncIdOfPnc "" UBYTE NO_COMPU_METHOD 0 0 0 255 ECU_ADDRESS 0x0 /end MEASUREMENT
/begin MEASUREMENT ComM_Pnc[24].SetMaskOfPnc "" UBYTE NO_COMPU_METHOD 0 0 0 255 ECU_ADDRESS 0x0 /end MEASUREMENT
/begin MEASUREMENT ComM_Pnc[25].ClearMaskOfPnc "" UBYTE NO_COMPU_METHOD 0 0 0 255 ECU_ADDRESS 0x0 /end MEASUREMENT
/begin MEASUREMENT ComM_Pnc[25].PncIdOfPnc "" UBYTE NO_COMPU_METHOD 0 0 0 255 ECU_ADDRESS 0x0 /end MEASUREMENT
/begin MEASUREMENT ComM_Pnc[25].SetMaskOfPnc "" UBYTE NO_COMPU_METHOD 0 0 0 255 ECU_ADDRESS 0x0 /end MEASUREMENT
/begin MEASUREMENT ComM_Pnc[26].ClearMaskOfPnc "" UBYTE NO_COMPU_METHOD 0 0 0 255 ECU_ADDRESS 0x0 /end MEASUREMENT
/begin MEASUREMENT ComM_Pnc[26].PncIdOfPnc "" UBYTE NO_COMPU_METHOD 0 0 0 255 ECU_ADDRESS 0x0 /end MEASUREMENT
/begin MEASUREMENT ComM_Pnc[26].SetMaskOfPnc "" UBYTE NO_COMPU_METHOD 0 0 0 255 ECU_ADDRESS 0x0 /end MEASUREMENT
/begin MEASUREMENT ComM_Pnc[27].ClearMaskOfPnc "" UBYTE NO_COMPU_METHOD 0 0 0 255 ECU_ADDRESS 0x0 /end MEASUREMENT
/begin MEASUREMENT ComM_Pnc[27].PncIdOfPnc "" UBYTE NO_COMPU_METHOD 0 0 0 255 ECU_ADDRESS 0x0 /end MEASUREMENT
/begin MEASUREMENT ComM_Pnc[27].SetMaskOfPnc "" UBYTE NO_COMPU_METHOD 0 0 0 255 ECU_ADDRESS 0x0 /end MEASUREMENT
/begin MEASUREMENT ComM_Pnc[28].ClearMaskOfPnc "" UBYTE NO_COMPU_METHOD 0 0 0 255 ECU_ADDRESS 0x0 /end MEASUREMENT
/begin MEASUREMENT ComM_Pnc[28].PncIdOfPnc "" UBYTE NO_COMPU_METHOD 0 0 0 255 ECU_ADDRESS 0x0 /end MEASUREMENT
/begin MEASUREMENT ComM_Pnc[28].SetMaskOfPnc "" UBYTE NO_COMPU_METHOD 0 0 0 255 ECU_ADDRESS 0x0 /end MEASUREMENT
/begin MEASUREMENT ComM_Pnc[29].ClearMaskOfPnc "" UBYTE NO_COMPU_METHOD 0 0 0 255 ECU_ADDRESS 0x0 /end MEASUREMENT
/begin MEASUREMENT ComM_Pnc[29].PncIdOfPnc "" UBYTE NO_COMPU_METHOD 0 0 0 255 ECU_ADDRESS 0x0 /end MEASUREMENT
/begin MEASUREMENT ComM_Pnc[29].SetMaskOfPnc "" UBYTE NO_COMPU_METHOD 0 0 0 255 ECU_ADDRESS 0x0 /end MEASUREMENT
/begin MEASUREMENT ComM_Pnc[2].ClearMaskOfPnc "" UBYTE NO_COMPU_METHOD 0 0 0 255 ECU_ADDRESS 0x0 /end MEASUREMENT
/begin MEASUREMENT ComM_Pnc[2].PncIdOfPnc "" UBYTE NO_COMPU_METHOD 0 0 0 255 ECU_ADDRESS 0x0 /end MEASUREMENT
/begin MEASUREMENT ComM_Pnc[2].SetMaskOfPnc "" UBYTE NO_COMPU_METHOD 0 0 0 255 ECU_ADDRESS 0x0 /end MEASUREMENT
/begin MEASUREMENT ComM_Pnc[30].ClearMaskOfPnc "" UBYTE NO_COMPU_METHOD 0 0 0 255 ECU_ADDRESS 0x0 /end MEASUREMENT
/begin MEASUREMENT ComM_Pnc[30].PncIdOfPnc "" UBYTE NO_COMPU_METHOD 0 0 0 255 ECU_ADDRESS 0x0 /end MEASUREMENT
/begin MEASUREMENT ComM_Pnc[30].SetMaskOfPnc "" UBYTE NO_COMPU_METHOD 0 0 0 255 ECU_ADDRESS 0x0 /end MEASUREMENT
/begin MEASUREMENT ComM_Pnc[31].ClearMaskOfPnc "" UBYTE NO_COMPU_METHOD 0 0 0 255 ECU_ADDRESS 0x0 /end MEASUREMENT
/begin MEASUREMENT ComM_Pnc[31].PncIdOfPnc "" UBYTE NO_COMPU_METHOD 0 0 0 255 ECU_ADDRESS 0x0 /end MEASUREMENT
/begin MEASUREMENT ComM_Pnc[31].SetMaskOfPnc "" UBYTE NO_COMPU_METHOD 0 0 0 255 ECU_ADDRESS 0x0 /end MEASUREMENT
/begin MEASUREMENT ComM_Pnc[32].ClearMaskOfPnc "" UBYTE NO_COMPU_METHOD 0 0 0 255 ECU_ADDRESS 0x0 /end MEASUREMENT
/begin MEASUREMENT ComM_Pnc[32].PncIdOfPnc "" UBYTE NO_COMPU_METHOD 0 0 0 255 ECU_ADDRESS 0x0 /end MEASUREMENT
/begin MEASUREMENT ComM_Pnc[32].SetMaskOfPnc "" UBYTE NO_COMPU_METHOD 0 0 0 255 ECU_ADDRESS 0x0 /end MEASUREMENT
/begin MEASUREMENT ComM_Pnc[33].ClearMaskOfPnc "" UBYTE NO_COMPU_METHOD 0 0 0 255 ECU_ADDRESS 0x0 /end MEASUREMENT
/begin MEASUREMENT ComM_Pnc[33].PncIdOfPnc "" UBYTE NO_COMPU_METHOD 0 0 0 255 ECU_ADDRESS 0x0 /end MEASUREMENT
/begin MEASUREMENT ComM_Pnc[33].SetMaskOfPnc "" UBYTE NO_COMPU_METHOD 0 0 0 255 ECU_ADDRESS 0x0 /end MEASUREMENT
/begin MEASUREMENT ComM_Pnc[34].ClearMaskOfPnc "" UBYTE NO_COMPU_METHOD 0 0 0 255 ECU_ADDRESS 0x0 /end MEASUREMENT
/begin MEASUREMENT ComM_Pnc[34].PncIdOfPnc "" UBYTE NO_COMPU_METHOD 0 0 0 255 ECU_ADDRESS 0x0 /end MEASUREMENT
/begin MEASUREMENT ComM_Pnc[34].SetMaskOfPnc "" UBYTE NO_COMPU_METHOD 0 0 0 255 ECU_ADDRESS 0x0 /end MEASUREMENT
/begin MEASUREMENT ComM_Pnc[35].ClearMaskOfPnc "" UBYTE NO_COMPU_METHOD 0 0 0 255 ECU_ADDRESS 0x0 /end MEASUREMENT
/begin MEASUREMENT ComM_Pnc[35].PncIdOfPnc "" UBYTE NO_COMPU_METHOD 0 0 0 255 ECU_ADDRESS 0x0 /end MEASUREMENT
/begin MEASUREMENT ComM_Pnc[35].SetMaskOfPnc "" UBYTE NO_COMPU_METHOD 0 0 0 255 ECU_ADDRESS 0x0 /end MEASUREMENT
/begin MEASUREMENT ComM_Pnc[36].ClearMaskOfPnc "" UBYTE NO_COMPU_METHOD 0 0 0 255 ECU_ADDRESS 0x0 /end MEASUREMENT
/begin MEASUREMENT ComM_Pnc[36].PncIdOfPnc "" UBYTE NO_COMPU_METHOD 0 0 0 255 ECU_ADDRESS 0x0 /end MEASUREMENT
/begin MEASUREMENT ComM_Pnc[36].SetMaskOfPnc "" UBYTE NO_COMPU_METHOD 0 0 0 255 ECU_ADDRESS 0x0 /end MEASUREMENT
/begin MEASUREMENT ComM_Pnc[37].ClearMaskOfPnc "" UBYTE NO_COMPU_METHOD 0 0 0 255 ECU_ADDRESS 0x0 /end MEASUREMENT
/begin MEASUREMENT ComM_Pnc[37].PncIdOfPnc "" UBYTE NO_COMPU_METHOD 0 0 0 255 ECU_ADDRESS 0x0 /end MEASUREMENT
/begin MEASUREMENT ComM_Pnc[37].SetMaskOfPnc "" UBYTE NO_COMPU_METHOD 0 0 0 255 ECU_ADDRESS 0x0 /end MEASUREMENT
/begin MEASUREMENT ComM_Pnc[38].ClearMaskOfPnc "" UBYTE NO_COMPU_METHOD 0 0 0 255 ECU_ADDRESS 0x0 /end MEASUREMENT
/begin MEASUREMENT ComM_Pnc[38].PncIdOfPnc "" UBYTE NO_COMPU_METHOD 0 0 0 255 ECU_ADDRESS 0x0 /end MEASUREMENT
/begin MEASUREMENT ComM_Pnc[38].SetMaskOfPnc "" UBYTE NO_COMPU_METHOD 0 0 0 255 ECU_ADDRESS 0x0 /end MEASUREMENT
/begin MEASUREMENT ComM_Pnc[39].ClearMaskOfPnc "" UBYTE NO_COMPU_METHOD 0 0 0 255 ECU_ADDRESS 0x0 /end MEASUREMENT
/begin MEASUREMENT ComM_Pnc[39].PncIdOfPnc "" UBYTE NO_COMPU_METHOD 0 0 0 255 ECU_ADDRESS 0x0 /end MEASUREMENT
/begin MEASUREMENT ComM_Pnc[39].SetMaskOfPnc "" UBYTE NO_COMPU_METHOD 0 0 0 255 ECU_ADDRESS 0x0 /end MEASUREMENT
/begin MEASUREMENT ComM_Pnc[3].ClearMaskOfPnc "" UBYTE NO_COMPU_METHOD 0 0 0 255 ECU_ADDRESS 0x0 /end MEASUREMENT
/begin MEASUREMENT ComM_Pnc[3].PncIdOfPnc "" UBYTE NO_COMPU_METHOD 0 0 0 255 ECU_ADDRESS 0x0 /end MEASUREMENT
/begin MEASUREMENT ComM_Pnc[3].SetMaskOfPnc "" UBYTE NO_COMPU_METHOD 0 0 0 255 ECU_ADDRESS 0x0 /end MEASUREMENT
/begin MEASUREMENT ComM_Pnc[40].ClearMaskOfPnc "" UBYTE NO_COMPU_METHOD 0 0 0 255 ECU_ADDRESS 0x0 /end MEASUREMENT
/begin MEASUREMENT ComM_Pnc[40].PncIdOfPnc "" UBYTE NO_COMPU_METHOD 0 0 0 255 ECU_ADDRESS 0x0 /end MEASUREMENT
/begin MEASUREMENT ComM_Pnc[40].SetMaskOfPnc "" UBYTE NO_COMPU_METHOD 0 0 0 255 ECU_ADDRESS 0x0 /end MEASUREMENT
/begin MEASUREMENT ComM_Pnc[41].ClearMaskOfPnc "" UBYTE NO_COMPU_METHOD 0 0 0 255 ECU_ADDRESS 0x0 /end MEASUREMENT
/begin MEASUREMENT ComM_Pnc[41].PncIdOfPnc "" UBYTE NO_COMPU_METHOD 0 0 0 255 ECU_ADDRESS 0x0 /end MEASUREMENT
/begin MEASUREMENT ComM_Pnc[41].SetMaskOfPnc "" UBYTE NO_COMPU_METHOD 0 0 0 255 ECU_ADDRESS 0x0 /end MEASUREMENT
/begin MEASUREMENT ComM_Pnc[42].ClearMaskOfPnc "" UBYTE NO_COMPU_METHOD 0 0 0 255 ECU_ADDRESS 0x0 /end MEASUREMENT
/begin MEASUREMENT ComM_Pnc[42].PncIdOfPnc "" UBYTE NO_COMPU_METHOD 0 0 0 255 ECU_ADDRESS 0x0 /end MEASUREMENT
/begin MEASUREMENT ComM_Pnc[42].SetMaskOfPnc "" UBYTE NO_COMPU_METHOD 0 0 0 255 ECU_ADDRESS 0x0 /end MEASUREMENT
/begin MEASUREMENT ComM_Pnc[43].ClearMaskOfPnc "" UBYTE NO_COMPU_METHOD 0 0 0 255 ECU_ADDRESS 0x0 /end MEASUREMENT
/begin MEASUREMENT ComM_Pnc[43].PncIdOfPnc "" UBYTE NO_COMPU_METHOD 0 0 0 255 ECU_ADDRESS 0x0 /end MEASUREMENT
/begin MEASUREMENT ComM_Pnc[43].SetMaskOfPnc "" UBYTE NO_COMPU_METHOD 0 0 0 255 ECU_ADDRESS 0x0 /end MEASUREMENT
/begin MEASUREMENT ComM_Pnc[44].ClearMaskOfPnc "" UBYTE NO_COMPU_METHOD 0 0 0 255 ECU_ADDRESS 0x0 /end MEASUREMENT
/begin MEASUREMENT ComM_Pnc[44].PncIdOfPnc "" UBYTE NO_COMPU_METHOD 0 0 0 255 ECU_ADDRESS 0x0 /end MEASUREMENT
/begin MEASUREMENT ComM_Pnc[44].SetMaskOfPnc "" UBYTE NO_COMPU_METHOD 0 0 0 255 ECU_ADDRESS 0x0 /end MEASUREMENT
/begin MEASUREMENT ComM_Pnc[45].ClearMaskOfPnc "" UBYTE NO_COMPU_METHOD 0 0 0 255 ECU_ADDRESS 0x0 /end MEASUREMENT
/begin MEASUREMENT ComM_Pnc[45].PncIdOfPnc "" UBYTE NO_COMPU_METHOD 0 0 0 255 ECU_ADDRESS 0x0 /end MEASUREMENT
/begin MEASUREMENT ComM_Pnc[45].SetMaskOfPnc "" UBYTE NO_COMPU_METHOD 0 0 0 255 ECU_ADDRESS 0x0 /end MEASUREMENT
/begin MEASUREMENT ComM_Pnc[46].ClearMaskOfPnc "" UBYTE NO_COMPU_METHOD 0 0 0 255 ECU_ADDRESS 0x0 /end MEASUREMENT
/begin MEASUREMENT ComM_Pnc[46].PncIdOfPnc "" UBYTE NO_COMPU_METHOD 0 0 0 255 ECU_ADDRESS 0x0 /end MEASUREMENT
/begin MEASUREMENT ComM_Pnc[46].SetMaskOfPnc "" UBYTE NO_COMPU_METHOD 0 0 0 255 ECU_ADDRESS 0x0 /end MEASUREMENT
/begin MEASUREMENT ComM_Pnc[47].ClearMaskOfPnc "" UBYTE NO_COMPU_METHOD 0 0 0 255 ECU_ADDRESS 0x0 /end MEASUREMENT
/begin MEASUREMENT ComM_Pnc[47].PncIdOfPnc "" UBYTE NO_COMPU_METHOD 0 0 0 255 ECU_ADDRESS 0x0 /end MEASUREMENT
/begin MEASUREMENT ComM_Pnc[47].SetMaskOfPnc "" UBYTE NO_COMPU_METHOD 0 0 0 255 ECU_ADDRESS 0x0 /end MEASUREMENT
/begin MEASUREMENT ComM_Pnc[4].ClearMaskOfPnc "" UBYTE NO_COMPU_METHOD 0 0 0 255 ECU_ADDRESS 0x0 /end MEASUREMENT
/begin MEASUREMENT ComM_Pnc[4].PncIdOfPnc "" UBYTE NO_COMPU_METHOD 0 0 0 255 ECU_ADDRESS 0x0 /end MEASUREMENT
/begin MEASUREMENT ComM_Pnc[4].SetMaskOfPnc "" UBYTE NO_COMPU_METHOD 0 0 0 255 ECU_ADDRESS 0x0 /end MEASUREMENT
/begin MEASUREMENT ComM_Pnc[5].ClearMaskOfPnc "" UBYTE NO_COMPU_METHOD 0 0 0 255 ECU_ADDRESS 0x0 /end MEASUREMENT
/begin MEASUREMENT ComM_Pnc[5].PncIdOfPnc "" UBYTE NO_COMPU_METHOD 0 0 0 255 ECU_ADDRESS 0x0 /end MEASUREMENT
/begin MEASUREMENT ComM_Pnc[5].SetMaskOfPnc "" UBYTE NO_COMPU_METHOD 0 0 0 255 ECU_ADDRESS 0x0 /end MEASUREMENT
/begin MEASUREMENT ComM_Pnc[6].ClearMaskOfPnc "" UBYTE NO_COMPU_METHOD 0 0 0 255 ECU_ADDRESS 0x0 /end MEASUREMENT
/begin MEASUREMENT ComM_Pnc[6].PncIdOfPnc "" UBYTE NO_COMPU_METHOD 0 0 0 255 ECU_ADDRESS 0x0 /end MEASUREMENT
/begin MEASUREMENT ComM_Pnc[6].SetMaskOfPnc "" UBYTE NO_COMPU_METHOD 0 0 0 255 ECU_ADDRESS 0x0 /end MEASUREMENT
/begin MEASUREMENT ComM_Pnc[7].ClearMaskOfPnc "" UBYTE NO_COMPU_METHOD 0 0 0 255 ECU_ADDRESS 0x0 /end MEASUREMENT
/begin MEASUREMENT ComM_Pnc[7].PncIdOfPnc "" UBYTE NO_COMPU_METHOD 0 0 0 255 ECU_ADDRESS 0x0 /end MEASUREMENT
/begin MEASUREMENT ComM_Pnc[7].SetMaskOfPnc "" UBYTE NO_COMPU_METHOD 0 0 0 255 ECU_ADDRESS 0x0 /end MEASUREMENT
/begin MEASUREMENT ComM_Pnc[8].ClearMaskOfPnc "" UBYTE NO_COMPU_METHOD 0 0 0 255 ECU_ADDRESS 0x0 /end MEASUREMENT
/begin MEASUREMENT ComM_Pnc[8].PncIdOfPnc "" UBYTE NO_COMPU_METHOD 0 0 0 255 ECU_ADDRESS 0x0 /end MEASUREMENT
/begin MEASUREMENT ComM_Pnc[8].SetMaskOfPnc "" UBYTE NO_COMPU_METHOD 0 0 0 255 ECU_ADDRESS 0x0 /end MEASUREMENT
/begin MEASUREMENT ComM_Pnc[9].ClearMaskOfPnc "" UBYTE NO_COMPU_METHOD 0 0 0 255 ECU_ADDRESS 0x0 /end MEASUREMENT
/begin MEASUREMENT ComM_Pnc[9].PncIdOfPnc "" UBYTE NO_COMPU_METHOD 0 0 0 255 ECU_ADDRESS 0x0 /end MEASUREMENT
/begin MEASUREMENT ComM_Pnc[9].SetMaskOfPnc "" UBYTE NO_COMPU_METHOD 0 0 0 255 ECU_ADDRESS 0x0 /end MEASUREMENT
/begin MEASUREMENT ComM_PostInitialized "Post-Initialized state" UBYTE ComM_PostInitializedType 0 0 0 1 ECU_ADDRESS 0x0 /end MEASUREMENT
/begin MEASUREMENT ComM_UserByteMask[0].ChannelOfUserByteMask "" UBYTE NO_COMPU_METHOD 0 0 0 255 ECU_ADDRESS 0x0 /end MEASUREMENT
/begin MEASUREMENT ComM_UserByteMask[0].ClearMaskOfUserByteMask "" UBYTE NO_COMPU_METHOD 0 0 0 255 ECU_ADDRESS 0x0 /end MEASUREMENT
/begin MEASUREMENT ComM_UserByteMask[0].SetMaskOfUserByteMask "" UBYTE NO_COMPU_METHOD 0 0 0 255 ECU_ADDRESS 0x0 /end MEASUREMENT
/begin MEASUREMENT ComM_UserByteMask[0].UserReqFullComIdxOfUserByteMask "" UBYTE NO_COMPU_METHOD 0 0 0 255 ECU_ADDRESS 0x0 /end MEASUREMENT
/begin MEASUREMENT ComM_UserByteMask[10].ChannelOfUserByteMask "" UBYTE NO_COMPU_METHOD 0 0 0 255 ECU_ADDRESS 0x0 /end MEASUREMENT
/begin MEASUREMENT ComM_UserByteMask[10].ClearMaskOfUserByteMask "" UBYTE NO_COMPU_METHOD 0 0 0 255 ECU_ADDRESS 0x0 /end MEASUREMENT
/begin MEASUREMENT ComM_UserByteMask[10].SetMaskOfUserByteMask "" UBYTE NO_COMPU_METHOD 0 0 0 255 ECU_ADDRESS 0x0 /end MEASUREMENT
/begin MEASUREMENT ComM_UserByteMask[10].UserReqFullComIdxOfUserByteMask "" UBYTE NO_COMPU_METHOD 0 0 0 255 ECU_ADDRESS 0x0 /end MEASUREMENT
/begin MEASUREMENT ComM_UserByteMask[11].ChannelOfUserByteMask "" UBYTE NO_COMPU_METHOD 0 0 0 255 ECU_ADDRESS 0x0 /end MEASUREMENT
/begin MEASUREMENT ComM_UserByteMask[11].ClearMaskOfUserByteMask "" UBYTE NO_COMPU_METHOD 0 0 0 255 ECU_ADDRESS 0x0 /end MEASUREMENT
/begin MEASUREMENT ComM_UserByteMask[11].SetMaskOfUserByteMask "" UBYTE NO_COMPU_METHOD 0 0 0 255 ECU_ADDRESS 0x0 /end MEASUREMENT
/begin MEASUREMENT ComM_UserByteMask[11].UserReqFullComIdxOfUserByteMask "" UBYTE NO_COMPU_METHOD 0 0 0 255 ECU_ADDRESS 0x0 /end MEASUREMENT
/begin MEASUREMENT ComM_UserByteMask[12].ChannelOfUserByteMask "" UBYTE NO_COMPU_METHOD 0 0 0 255 ECU_ADDRESS 0x0 /end MEASUREMENT
/begin MEASUREMENT ComM_UserByteMask[12].ClearMaskOfUserByteMask "" UBYTE NO_COMPU_METHOD 0 0 0 255 ECU_ADDRESS 0x0 /end MEASUREMENT
/begin MEASUREMENT ComM_UserByteMask[12].SetMaskOfUserByteMask "" UBYTE NO_COMPU_METHOD 0 0 0 255 ECU_ADDRESS 0x0 /end MEASUREMENT
/begin MEASUREMENT ComM_UserByteMask[12].UserReqFullComIdxOfUserByteMask "" UBYTE NO_COMPU_METHOD 0 0 0 255 ECU_ADDRESS 0x0 /end MEASUREMENT
/begin MEASUREMENT ComM_UserByteMask[13].ChannelOfUserByteMask "" UBYTE NO_COMPU_METHOD 0 0 0 255 ECU_ADDRESS 0x0 /end MEASUREMENT
/begin MEASUREMENT ComM_UserByteMask[13].ClearMaskOfUserByteMask "" UBYTE NO_COMPU_METHOD 0 0 0 255 ECU_ADDRESS 0x0 /end MEASUREMENT
/begin MEASUREMENT ComM_UserByteMask[13].SetMaskOfUserByteMask "" UBYTE NO_COMPU_METHOD 0 0 0 255 ECU_ADDRESS 0x0 /end MEASUREMENT
/begin MEASUREMENT ComM_UserByteMask[13].UserReqFullComIdxOfUserByteMask "" UBYTE NO_COMPU_METHOD 0 0 0 255 ECU_ADDRESS 0x0 /end MEASUREMENT
/begin MEASUREMENT ComM_UserByteMask[14].ChannelOfUserByteMask "" UBYTE NO_COMPU_METHOD 0 0 0 255 ECU_ADDRESS 0x0 /end MEASUREMENT
/begin MEASUREMENT ComM_UserByteMask[14].ClearMaskOfUserByteMask "" UBYTE NO_COMPU_METHOD 0 0 0 255 ECU_ADDRESS 0x0 /end MEASUREMENT
/begin MEASUREMENT ComM_UserByteMask[14].SetMaskOfUserByteMask "" UBYTE NO_COMPU_METHOD 0 0 0 255 ECU_ADDRESS 0x0 /end MEASUREMENT
/begin MEASUREMENT ComM_UserByteMask[14].UserReqFullComIdxOfUserByteMask "" UBYTE NO_COMPU_METHOD 0 0 0 255 ECU_ADDRESS 0x0 /end MEASUREMENT
/begin MEASUREMENT ComM_UserByteMask[15].ChannelOfUserByteMask "" UBYTE NO_COMPU_METHOD 0 0 0 255 ECU_ADDRESS 0x0 /end MEASUREMENT
/begin MEASUREMENT ComM_UserByteMask[15].ClearMaskOfUserByteMask "" UBYTE NO_COMPU_METHOD 0 0 0 255 ECU_ADDRESS 0x0 /end MEASUREMENT
/begin MEASUREMENT ComM_UserByteMask[15].SetMaskOfUserByteMask "" UBYTE NO_COMPU_METHOD 0 0 0 255 ECU_ADDRESS 0x0 /end MEASUREMENT
/begin MEASUREMENT ComM_UserByteMask[15].UserReqFullComIdxOfUserByteMask "" UBYTE NO_COMPU_METHOD 0 0 0 255 ECU_ADDRESS 0x0 /end MEASUREMENT
/begin MEASUREMENT ComM_UserByteMask[16].ChannelOfUserByteMask "" UBYTE NO_COMPU_METHOD 0 0 0 255 ECU_ADDRESS 0x0 /end MEASUREMENT
/begin MEASUREMENT ComM_UserByteMask[16].ClearMaskOfUserByteMask "" UBYTE NO_COMPU_METHOD 0 0 0 255 ECU_ADDRESS 0x0 /end MEASUREMENT
/begin MEASUREMENT ComM_UserByteMask[16].SetMaskOfUserByteMask "" UBYTE NO_COMPU_METHOD 0 0 0 255 ECU_ADDRESS 0x0 /end MEASUREMENT
/begin MEASUREMENT ComM_UserByteMask[16].UserReqFullComIdxOfUserByteMask "" UBYTE NO_COMPU_METHOD 0 0 0 255 ECU_ADDRESS 0x0 /end MEASUREMENT
/begin MEASUREMENT ComM_UserByteMask[17].ChannelOfUserByteMask "" UBYTE NO_COMPU_METHOD 0 0 0 255 ECU_ADDRESS 0x0 /end MEASUREMENT
/begin MEASUREMENT ComM_UserByteMask[17].ClearMaskOfUserByteMask "" UBYTE NO_COMPU_METHOD 0 0 0 255 ECU_ADDRESS 0x0 /end MEASUREMENT
/begin MEASUREMENT ComM_UserByteMask[17].SetMaskOfUserByteMask "" UBYTE NO_COMPU_METHOD 0 0 0 255 ECU_ADDRESS 0x0 /end MEASUREMENT
/begin MEASUREMENT ComM_UserByteMask[17].UserReqFullComIdxOfUserByteMask "" UBYTE NO_COMPU_METHOD 0 0 0 255 ECU_ADDRESS 0x0 /end MEASUREMENT
/begin MEASUREMENT ComM_UserByteMask[18].ChannelOfUserByteMask "" UBYTE NO_COMPU_METHOD 0 0 0 255 ECU_ADDRESS 0x0 /end MEASUREMENT
/begin MEASUREMENT ComM_UserByteMask[18].ClearMaskOfUserByteMask "" UBYTE NO_COMPU_METHOD 0 0 0 255 ECU_ADDRESS 0x0 /end MEASUREMENT
/begin MEASUREMENT ComM_UserByteMask[18].SetMaskOfUserByteMask "" UBYTE NO_COMPU_METHOD 0 0 0 255 ECU_ADDRESS 0x0 /end MEASUREMENT
/begin MEASUREMENT ComM_UserByteMask[18].UserReqFullComIdxOfUserByteMask "" UBYTE NO_COMPU_METHOD 0 0 0 255 ECU_ADDRESS 0x0 /end MEASUREMENT
/begin MEASUREMENT ComM_UserByteMask[19].ChannelOfUserByteMask "" UBYTE NO_COMPU_METHOD 0 0 0 255 ECU_ADDRESS 0x0 /end MEASUREMENT
/begin MEASUREMENT ComM_UserByteMask[19].ClearMaskOfUserByteMask "" UBYTE NO_COMPU_METHOD 0 0 0 255 ECU_ADDRESS 0x0 /end MEASUREMENT
/begin MEASUREMENT ComM_UserByteMask[19].SetMaskOfUserByteMask "" UBYTE NO_COMPU_METHOD 0 0 0 255 ECU_ADDRESS 0x0 /end MEASUREMENT
/begin MEASUREMENT ComM_UserByteMask[19].UserReqFullComIdxOfUserByteMask "" UBYTE NO_COMPU_METHOD 0 0 0 255 ECU_ADDRESS 0x0 /end MEASUREMENT
/begin MEASUREMENT ComM_UserByteMask[1].ChannelOfUserByteMask "" UBYTE NO_COMPU_METHOD 0 0 0 255 ECU_ADDRESS 0x0 /end MEASUREMENT
/begin MEASUREMENT ComM_UserByteMask[1].ClearMaskOfUserByteMask "" UBYTE NO_COMPU_METHOD 0 0 0 255 ECU_ADDRESS 0x0 /end MEASUREMENT
/begin MEASUREMENT ComM_UserByteMask[1].SetMaskOfUserByteMask "" UBYTE NO_COMPU_METHOD 0 0 0 255 ECU_ADDRESS 0x0 /end MEASUREMENT
/begin MEASUREMENT ComM_UserByteMask[1].UserReqFullComIdxOfUserByteMask "" UBYTE NO_COMPU_METHOD 0 0 0 255 ECU_ADDRESS 0x0 /end MEASUREMENT
/begin MEASUREMENT ComM_UserByteMask[20].ChannelOfUserByteMask "" UBYTE NO_COMPU_METHOD 0 0 0 255 ECU_ADDRESS 0x0 /end MEASUREMENT
/begin MEASUREMENT ComM_UserByteMask[20].ClearMaskOfUserByteMask "" UBYTE NO_COMPU_METHOD 0 0 0 255 ECU_ADDRESS 0x0 /end MEASUREMENT
/begin MEASUREMENT ComM_UserByteMask[20].SetMaskOfUserByteMask "" UBYTE NO_COMPU_METHOD 0 0 0 255 ECU_ADDRESS 0x0 /end MEASUREMENT
/begin MEASUREMENT ComM_UserByteMask[20].UserReqFullComIdxOfUserByteMask "" UBYTE NO_COMPU_METHOD 0 0 0 255 ECU_ADDRESS 0x0 /end MEASUREMENT
/begin MEASUREMENT ComM_UserByteMask[21].ChannelOfUserByteMask "" UBYTE NO_COMPU_METHOD 0 0 0 255 ECU_ADDRESS 0x0 /end MEASUREMENT
/begin MEASUREMENT ComM_UserByteMask[21].ClearMaskOfUserByteMask "" UBYTE NO_COMPU_METHOD 0 0 0 255 ECU_ADDRESS 0x0 /end MEASUREMENT
/begin MEASUREMENT ComM_UserByteMask[21].SetMaskOfUserByteMask "" UBYTE NO_COMPU_METHOD 0 0 0 255 ECU_ADDRESS 0x0 /end MEASUREMENT
/begin MEASUREMENT ComM_UserByteMask[21].UserReqFullComIdxOfUserByteMask "" UBYTE NO_COMPU_METHOD 0 0 0 255 ECU_ADDRESS 0x0 /end MEASUREMENT
/begin MEASUREMENT ComM_UserByteMask[22].ChannelOfUserByteMask "" UBYTE NO_COMPU_METHOD 0 0 0 255 ECU_ADDRESS 0x0 /end MEASUREMENT
/begin MEASUREMENT ComM_UserByteMask[22].ClearMaskOfUserByteMask "" UBYTE NO_COMPU_METHOD 0 0 0 255 ECU_ADDRESS 0x0 /end MEASUREMENT
/begin MEASUREMENT ComM_UserByteMask[22].SetMaskOfUserByteMask "" UBYTE NO_COMPU_METHOD 0 0 0 255 ECU_ADDRESS 0x0 /end MEASUREMENT
/begin MEASUREMENT ComM_UserByteMask[22].UserReqFullComIdxOfUserByteMask "" UBYTE NO_COMPU_METHOD 0 0 0 255 ECU_ADDRESS 0x0 /end MEASUREMENT
/begin MEASUREMENT ComM_UserByteMask[23].ChannelOfUserByteMask "" UBYTE NO_COMPU_METHOD 0 0 0 255 ECU_ADDRESS 0x0 /end MEASUREMENT
/begin MEASUREMENT ComM_UserByteMask[23].ClearMaskOfUserByteMask "" UBYTE NO_COMPU_METHOD 0 0 0 255 ECU_ADDRESS 0x0 /end MEASUREMENT
/begin MEASUREMENT ComM_UserByteMask[23].SetMaskOfUserByteMask "" UBYTE NO_COMPU_METHOD 0 0 0 255 ECU_ADDRESS 0x0 /end MEASUREMENT
/begin MEASUREMENT ComM_UserByteMask[23].UserReqFullComIdxOfUserByteMask "" UBYTE NO_COMPU_METHOD 0 0 0 255 ECU_ADDRESS 0x0 /end MEASUREMENT
/begin MEASUREMENT ComM_UserByteMask[24].ChannelOfUserByteMask "" UBYTE NO_COMPU_METHOD 0 0 0 255 ECU_ADDRESS 0x0 /end MEASUREMENT
/begin MEASUREMENT ComM_UserByteMask[24].ClearMaskOfUserByteMask "" UBYTE NO_COMPU_METHOD 0 0 0 255 ECU_ADDRESS 0x0 /end MEASUREMENT
/begin MEASUREMENT ComM_UserByteMask[24].SetMaskOfUserByteMask "" UBYTE NO_COMPU_METHOD 0 0 0 255 ECU_ADDRESS 0x0 /end MEASUREMENT
/begin MEASUREMENT ComM_UserByteMask[24].UserReqFullComIdxOfUserByteMask "" UBYTE NO_COMPU_METHOD 0 0 0 255 ECU_ADDRESS 0x0 /end MEASUREMENT
/begin MEASUREMENT ComM_UserByteMask[25].ChannelOfUserByteMask "" UBYTE NO_COMPU_METHOD 0 0 0 255 ECU_ADDRESS 0x0 /end MEASUREMENT
/begin MEASUREMENT ComM_UserByteMask[25].ClearMaskOfUserByteMask "" UBYTE NO_COMPU_METHOD 0 0 0 255 ECU_ADDRESS 0x0 /end MEASUREMENT
/begin MEASUREMENT ComM_UserByteMask[25].SetMaskOfUserByteMask "" UBYTE NO_COMPU_METHOD 0 0 0 255 ECU_ADDRESS 0x0 /end MEASUREMENT
/begin MEASUREMENT ComM_UserByteMask[25].UserReqFullComIdxOfUserByteMask "" UBYTE NO_COMPU_METHOD 0 0 0 255 ECU_ADDRESS 0x0 /end MEASUREMENT
/begin MEASUREMENT ComM_UserByteMask[26].ChannelOfUserByteMask "" UBYTE NO_COMPU_METHOD 0 0 0 255 ECU_ADDRESS 0x0 /end MEASUREMENT
/begin MEASUREMENT ComM_UserByteMask[26].ClearMaskOfUserByteMask "" UBYTE NO_COMPU_METHOD 0 0 0 255 ECU_ADDRESS 0x0 /end MEASUREMENT
/begin MEASUREMENT ComM_UserByteMask[26].SetMaskOfUserByteMask "" UBYTE NO_COMPU_METHOD 0 0 0 255 ECU_ADDRESS 0x0 /end MEASUREMENT
/begin MEASUREMENT ComM_UserByteMask[26].UserReqFullComIdxOfUserByteMask "" UBYTE NO_COMPU_METHOD 0 0 0 255 ECU_ADDRESS 0x0 /end MEASUREMENT
/begin MEASUREMENT ComM_UserByteMask[27].ChannelOfUserByteMask "" UBYTE NO_COMPU_METHOD 0 0 0 255 ECU_ADDRESS 0x0 /end MEASUREMENT
/begin MEASUREMENT Com_TxSigInfo[92].BitLengthOfTxSigInfo "" UWORD NO_COMPU_METHOD 0 0 0 65535 ECU_ADDRESS 0x0 /end MEASUREMENT
/begin MEASUREMENT Com_TxSigInfo[92].BitPositionOfTxSigInfo "" UWORD NO_COMPU_METHOD 0 0 0 65535 ECU_ADDRESS 0x0 /end MEASUREMENT
/begin MEASUREMENT Com_TxSigInfo[92].BusAccOfTxSigInfo "" UBYTE Com_BusAccOfTxSigInfoType 0 0 0 255 ECU_ADDRESS 0x0 /end MEASUREMENT
/begin MEASUREMENT Com_TxSigInfo[92].ByteLengthOfTxSigInfo "" UBYTE NO_COMPU_METHOD 0 0 0 255 ECU_ADDRESS 0x0 /end MEASUREMENT
/begin MEASUREMENT Com_TxSigInfo[92].DynSignalOfTxSigInfo "" UBYTE Com_DynSignalOfTxSigInfoType 0 0 0 1 ECU_ADDRESS 0x0 /end MEASUREMENT
/begin MEASUREMENT Com_TxSigInfo[92].FilterInitValueIdxOfTxSigInfo "" UBYTE Com_FilterInitValueIdxOfTxSigInfoType 0 0 0 255 ECU_ADDRESS 0x0 /end MEASUREMENT
/begin MEASUREMENT Com_TxSigInfo[92].FilterInitValueOfTxSigInfo "" UBYTE Com_FilterInitValueOfTxSigInfoType 0 0 0 255 ECU_ADDRESS 0x0 /end MEASUREMENT
/begin MEASUREMENT Com_TxSigInfo[92].InvValueIdxOfTxSigInfo "" UBYTE Com_InvValueIdxOfTxSigInfoType 0 0 0 255 ECU_ADDRESS 0x0 /end MEASUREMENT
/begin MEASUREMENT Com_TxSigInfo[92].InvValueOfTxSigInfo "" UBYTE Com_InvValueOfTxSigInfoType 0 0 0 255 ECU_ADDRESS 0x0 /end MEASUREMENT
/begin MEASUREMENT Com_TxSigInfo[92].OnChangeIdxOfTxSigInfo "" UBYTE Com_OnChangeIdxOfTxSigInfoType 0 0 0 255 ECU_ADDRESS 0x0 /end MEASUREMENT
/begin MEASUREMENT Com_TxSigInfo[92].OnChangeOfTxSigInfo "" UBYTE Com_OnChangeOfTxSigInfoType 0 0 0 255 ECU_ADDRESS 0x0 /end MEASUREMENT
/begin MEASUREMENT Com_TxSigInfo[92].StartByteInPduPositionOfTxSigInfo "" UBYTE NO_COMPU_METHOD 0 0 0 255 ECU_ADDRESS 0x0 /end MEASUREMENT
/begin MEASUREMENT Com_TxSigInfo[92].TxAccessInfoIdxOfTxSigInfo "" UWORD NO_COMPU_METHOD 0 0 0 65535 ECU_ADDRESS 0x0 /end MEASUREMENT
/begin MEASUREMENT Com_TxSigInfo[92].TxBufferEndIdxOfTxSigInfo "" UWORD Com_TxBufferEndIdxOfTxSigInfoType 0 0 0 65535 ECU_ADDRESS 0x0 /end MEASUREMENT
/begin MEASUREMENT Com_TxSigInfo[92].TxBufferStartIdxOfTxSigInfo "" UWORD Com_TxBufferStartIdxOfTxSigInfoType 0 0 0 65535 ECU_ADDRESS 0x0 /end MEASUREMENT
/begin MEASUREMENT Com_TxSigInfo[92].TxFilterInitValueArrayBasedFilterInitValueEndIdxOfTxSigInfo "" UBYTE Com_TxFilterInitValueArrayBasedFilterInitValueEndIdxOfTxSigInfoType 0 0 0 255 ECU_ADDRESS 0x0 /end MEASUREMENT
/begin MEASUREMENT Com_TxSigInfo[92].TxFilterInitValueArrayBasedFilterInitValueStartIdxOfTxSigInfo "" UBYTE Com_TxFilterInitValueArrayBasedFilterInitValueStartIdxOfTxSigInfoType 0 0 0 255 ECU_ADDRESS 0x0 /end MEASUREMENT
/begin MEASUREMENT Com_TxSigInfo[92].TxPduInfoIdxOfTxSigInfo "" UBYTE NO_COMPU_METHOD 0 0 0 255 ECU_ADDRESS 0x0 /end MEASUREMENT
/begin MEASUREMENT Com_TxSigInfo[93].ApplTypeOfTxSigInfo "" UBYTE Com_ApplTypeOfTxSigInfoType 0 0 0 255 ECU_ADDRESS 0x0 /end MEASUREMENT
/begin MEASUREMENT Com_TxSigInfo[93].BitLengthOfTxSigInfo "" UWORD NO_COMPU_METHOD 0 0 0 65535 ECU_ADDRESS 0x0 /end MEASUREMENT
/begin MEASUREMENT Com_TxSigInfo[93].BitPositionOfTxSigInfo "" UWORD NO_COMPU_METHOD 0 0 0 65535 ECU_ADDRESS 0x0 /end MEASUREMENT
/begin MEASUREMENT Com_TxSigInfo[93].BusAccOfTxSigInfo "" UBYTE Com_BusAccOfTxSigInfoType 0 0 0 255 ECU_ADDRESS 0x0 /end MEASUREMENT
/begin MEASUREMENT Com_TxSigInfo[93].ByteLengthOfTxSigInfo "" UBYTE NO_COMPU_METHOD 0 0 0 255 ECU_ADDRESS 0x0 /end MEASUREMENT
/begin MEASUREMENT Com_TxSigInfo[93].DynSignalOfTxSigInfo "" UBYTE Com_DynSignalOfTxSigInfoType 0 0 0 1 ECU_ADDRESS 0x0 /end MEASUREMENT
/begin MEASUREMENT Com_TxSigInfo[93].FilterInitValueIdxOfTxSigInfo "" UBYTE Com_FilterInitValueIdxOfTxSigInfoType 0 0 0 255 ECU_ADDRESS 0x0 /end MEASUREMENT
/begin MEASUREMENT Com_TxSigInfo[93].FilterInitValueOfTxSigInfo "" UBYTE Com_FilterInitValueOfTxSigInfoType 0 0 0 255 ECU_ADDRESS 0x0 /end MEASUREMENT
/begin MEASUREMENT Com_TxSigInfo[93].InvValueIdxOfTxSigInfo "" UBYTE Com_InvValueIdxOfTxSigInfoType 0 0 0 255 ECU_ADDRESS 0x0 /end MEASUREMENT
/begin MEASUREMENT Com_TxSigInfo[93].InvValueOfTxSigInfo "" UBYTE Com_InvValueOfTxSigInfoType 0 0 0 255 ECU_ADDRESS 0x0 /end MEASUREMENT
/begin MEASUREMENT Com_TxSigInfo[93].OnChangeIdxOfTxSigInfo "" UBYTE Com_OnChangeIdxOfTxSigInfoType 0 0 0 255 ECU_ADDRESS 0x0 /end MEASUREMENT
/begin MEASUREMENT Com_TxSigInfo[93].OnChangeOfTxSigInfo "" UBYTE Com_OnChangeOfTxSigInfoType 0 0 0 255 ECU_ADDRESS 0x0 /end MEASUREMENT
/begin MEASUREMENT Com_TxSigInfo[93].StartByteInPduPositionOfTxSigInfo "" UBYTE NO_COMPU_METHOD 0 0 0 255 ECU_ADDRESS 0x0 /end MEASUREMENT
/begin MEASUREMENT Com_TxSigInfo[93].TxAccessInfoIdxOfTxSigInfo "" UWORD NO_COMPU_METHOD 0 0 0 65535 ECU_ADDRESS 0x0 /end MEASUREMENT
/begin MEASUREMENT Com_TxSigInfo[93].TxBufferEndIdxOfTxSigInfo "" UWORD Com_TxBufferEndIdxOfTxSigInfoType 0 0 0 65535 ECU_ADDRESS 0x0 /end MEASUREMENT
/begin MEASUREMENT Com_TxSigInfo[93].TxBufferStartIdxOfTxSigInfo "" UWORD Com_TxBufferStartIdxOfTxSigInfoType 0 0 0 65535 ECU_ADDRESS 0x0 /end MEASUREMENT
/begin MEASUREMENT Com_TxSigInfo[93].TxFilterInitValueArrayBasedFilterInitValueEndIdxOfTxSigInfo "" UBYTE Com_TxFilterInitValueArrayBasedFilterInitValueEndIdxOfTxSigInfoType 0 0 0 255 ECU_ADDRESS 0x0 /end MEASUREMENT
/begin MEASUREMENT Com_TxSigInfo[93].TxFilterInitValueArrayBasedFilterInitValueStartIdxOfTxSigInfo "" UBYTE Com_TxFilterInitValueArrayBasedFilterInitValueStartIdxOfTxSigInfoType 0 0 0 255 ECU_ADDRESS 0x0 /end MEASUREMENT
/begin MEASUREMENT Com_TxSigInfo[93].TxPduInfoIdxOfTxSigInfo "" UBYTE NO_COMPU_METHOD 0 0 0 255 ECU_ADDRESS 0x0 /end MEASUREMENT
/begin MEASUREMENT Com_TxSigInfo[94].ApplTypeOfTxSigInfo "" UBYTE Com_ApplTypeOfTxSigInfoType 0 0 0 255 ECU_ADDRESS 0x0 /end MEASUREMENT
/begin MEASUREMENT Com_TxSigInfo[94].BitLengthOfTxSigInfo "" UWORD NO_COMPU_METHOD 0 0 0 65535 ECU_ADDRESS 0x0 /end MEASUREMENT
/begin MEASUREMENT Com_TxSigInfo[94].BitPositionOfTxSigInfo "" UWORD NO_COMPU_METHOD 0 0 0 65535 ECU_ADDRESS 0x0 /end MEASUREMENT
/begin MEASUREMENT Com_TxSigInfo[94].BusAccOfTxSigInfo "" UBYTE Com_BusAccOfTxSigInfoType 0 0 0 255 ECU_ADDRESS 0x0 /end MEASUREMENT
/begin MEASUREMENT Com_TxSigInfo[94].ByteLengthOfTxSigInfo "" UBYTE NO_COMPU_METHOD 0 0 0 255 ECU_ADDRESS 0x0 /end MEASUREMENT
/begin MEASUREMENT Com_TxSigInfo[94].DynSignalOfTxSigInfo "" UBYTE Com_DynSignalOfTxSigInfoType 0 0 0 1 ECU_ADDRESS 0x0 /end MEASUREMENT
/begin MEASUREMENT Com_TxSigInfo[94].FilterInitValueIdxOfTxSigInfo "" UBYTE Com_FilterInitValueIdxOfTxSigInfoType 0 0 0 255 ECU_ADDRESS 0x0 /end MEASUREMENT
/begin MEASUREMENT Com_TxSigInfo[94].FilterInitValueOfTxSigInfo "" UBYTE Com_FilterInitValueOfTxSigInfoType 0 0 0 255 ECU_ADDRESS 0x0 /end MEASUREMENT
/begin MEASUREMENT Com_TxSigInfo[94].InvValueIdxOfTxSigInfo "" UBYTE Com_InvValueIdxOfTxSigInfoType 0 0 0 255 ECU_ADDRESS 0x0 /end MEASUREMENT
/begin MEASUREMENT Com_TxSigInfo[94].InvValueOfTxSigInfo "" UBYTE Com_InvValueOfTxSigInfoType 0 0 0 255 ECU_ADDRESS 0x0 /end MEASUREMENT
/begin MEASUREMENT Com_TxSigInfo[94].OnChangeIdxOfTxSigInfo "" UBYTE Com_OnChangeIdxOfTxSigInfoType 0 0 0 255 ECU_ADDRESS 0x0 /end MEASUREMENT
/begin MEASUREMENT Com_TxSigInfo[94].OnChangeOfTxSigInfo "" UBYTE Com_OnChangeOfTxSigInfoType 0 0 0 255 ECU_ADDRESS 0x0 /end MEASUREMENT
/begin MEASUREMENT Com_TxSigInfo[94].StartByteInPduPositionOfTxSigInfo "" UBYTE NO_COMPU_METHOD 0 0 0 255 ECU_ADDRESS 0x0 /end MEASUREMENT
/begin MEASUREMENT Com_TxSigInfo[94].TxAccessInfoIdxOfTxSigInfo "" UWORD NO_COMPU_METHOD 0 0 0 65535 ECU_ADDRESS 0x0 /end MEASUREMENT
/begin MEASUREMENT Com_TxSigInfo[94].TxBufferEndIdxOfTxSigInfo "" UWORD Com_TxBufferEndIdxOfTxSigInfoType 0 0 0 65535 ECU_ADDRESS 0x0 /end MEASUREMENT
/begin MEASUREMENT Com_TxSigInfo[94].TxBufferStartIdxOfTxSigInfo "" UWORD Com_TxBufferStartIdxOfTxSigInfoType 0 0 0 65535 ECU_ADDRESS 0x0 /end MEASUREMENT
/begin MEASUREMENT Com_TxSigInfo[94].TxFilterInitValueArrayBasedFilterInitValueEndIdxOfTxSigInfo "" UBYTE Com_TxFilterInitValueArrayBasedFilterInitValueEndIdxOfTxSigInfoType 0 0 0 255 ECU_ADDRESS 0x0 /end MEASUREMENT
/begin MEASUREMENT Com_TxSigInfo[94].TxFilterInitValueArrayBasedFilterInitValueStartIdxOfTxSigInfo "" UBYTE Com_TxFilterInitValueArrayBasedFilterInitValueStartIdxOfTxSigInfoType 0 0 0 255 ECU_ADDRESS 0x0 /end MEASUREMENT
/begin MEASUREMENT Com_TxSigInfo[94].TxPduInfoIdxOfTxSigInfo "" UBYTE NO_COMPU_METHOD 0 0 0 255 ECU_ADDRESS 0x0 /end MEASUREMENT
/begin MEASUREMENT Com_TxSigInfo[95].ApplTypeOfTxSigInfo "" UBYTE Com_ApplTypeOfTxSigInfoType 0 0 0 255 ECU_ADDRESS 0x0 /end MEASUREMENT
/begin MEASUREMENT Com_TxSigInfo[95].BitLengthOfTxSigInfo "" UWORD NO_COMPU_METHOD 0 0 0 65535 ECU_ADDRESS 0x0 /end MEASUREMENT
/begin MEASUREMENT Com_TxSigInfo[95].BitPositionOfTxSigInfo "" UWORD NO_COMPU_METHOD 0 0 0 65535 ECU_ADDRESS 0x0 /end MEASUREMENT
/begin MEASUREMENT Com_TxSigInfo[95].BusAccOfTxSigInfo "" UBYTE Com_BusAccOfTxSigInfoType 0 0 0 255 ECU_ADDRESS 0x0 /end MEASUREMENT
/begin MEASUREMENT Com_TxSigInfo[95].ByteLengthOfTxSigInfo "" UBYTE NO_COMPU_METHOD 0 0 0 255 ECU_ADDRESS 0x0 /end MEASUREMENT
/begin MEASUREMENT Com_TxSigInfo[95].DynSignalOfTxSigInfo "" UBYTE Com_DynSignalOfTxSigInfoType 0 0 0 1 ECU_ADDRESS 0x0 /end MEASUREMENT
/begin MEASUREMENT Com_TxSigInfo[95].FilterInitValueIdxOfTxSigInfo "" UBYTE Com_FilterInitValueIdxOfTxSigInfoType 0 0 0 255 ECU_ADDRESS 0x0 /end MEASUREMENT
/begin MEASUREMENT Com_TxSigInfo[95].FilterInitValueOfTxSigInfo "" UBYTE Com_FilterInitValueOfTxSigInfoType 0 0 0 255 ECU_ADDRESS 0x0 /end MEASUREMENT
/begin MEASUREMENT Com_TxSigInfo[95].InvValueIdxOfTxSigInfo "" UBYTE Com_InvValueIdxOfTxSigInfoType 0 0 0 255 ECU_ADDRESS 0x0 /end MEASUREMENT
/begin MEASUREMENT Com_TxSigInfo[95].InvValueOfTxSigInfo "" UBYTE Com_InvValueOfTxSigInfoType 0 0 0 255 ECU_ADDRESS 0x0 /end MEASUREMENT
/begin MEASUREMENT Com_TxSigInfo[95].OnChangeIdxOfTxSigInfo "" UBYTE Com_OnChangeIdxOfTxSigInfoType 0 0 0 255 ECU_ADDRESS 0x0 /end MEASUREMENT
/begin MEASUREMENT Com_TxSigInfo[95].OnChangeOfTxSigInfo "" UBYTE Com_OnChangeOfTxSigInfoType 0 0 0 255 ECU_ADDRESS 0x0 /end MEASUREMENT
/begin MEASUREMENT Com_TxSigInfo[95].StartByteInPduPositionOfTxSigInfo "" UBYTE NO_COMPU_METHOD 0 0 0 255 ECU_ADDRESS 0x0 /end MEASUREMENT
/begin MEASUREMENT Com_TxSigInfo[95].TxAccessInfoIdxOfTxSigInfo "" UWORD NO_COMPU_METHOD 0 0 0 65535 ECU_ADDRESS 0x0 /end MEASUREMENT
/begin MEASUREMENT Com_TxSigInfo[95].TxBufferEndIdxOfTxSigInfo "" UWORD Com_TxBufferEndIdxOfTxSigInfoType 0 0 0 65535 ECU_ADDRESS 0x0 /end MEASUREMENT
/begin MEASUREMENT Com_TxSigInfo[95].TxBufferStartIdxOfTxSigInfo "" UWORD Com_TxBufferStartIdxOfTxSigInfoType 0 0 0 65535 ECU_ADDRESS 0x0 /end MEASUREMENT
/begin MEASUREMENT Com_TxSigInfo[95].TxFilterInitValueArrayBasedFilterInitValueEndIdxOfTxSigInfo "" UBYTE Com_TxFilterInitValueArrayBasedFilterInitValueEndIdxOfTxSigInfoType 0 0 0 255 ECU_ADDRESS 0x0 /end MEASUREMENT
/begin MEASUREMENT Com_TxSigInfo[95].TxFilterInitValueArrayBasedFilterInitValueStartIdxOfTxSigInfo "" UBYTE Com_TxFilterInitValueArrayBasedFilterInitValueStartIdxOfTxSigInfoType 0 0 0 255 ECU_ADDRESS 0x0 /end MEASUREMENT
/begin MEASUREMENT Com_TxSigInfo[95].TxPduInfoIdxOfTxSigInfo "" UBYTE NO_COMPU_METHOD 0 0 0 255 ECU_ADDRESS 0x0 /end MEASUREMENT
/begin MEASUREMENT Com_TxSigInfo[96].ApplTypeOfTxSigInfo "" UBYTE Com_ApplTypeOfTxSigInfoType 0 0 0 255 ECU_ADDRESS 0x0 /end MEASUREMENT
/begin MEASUREMENT Com_TxSigInfo[96].BitLengthOfTxSigInfo "" UWORD NO_COMPU_METHOD 0 0 0 65535 ECU_ADDRESS 0x0 /end MEASUREMENT
/begin MEASUREMENT Com_TxSigInfo[96].BitPositionOfTxSigInfo "" UWORD NO_COMPU_METHOD 0 0 0 65535 ECU_ADDRESS 0x0 /end MEASUREMENT
/begin MEASUREMENT Com_TxSigInfo[96].BusAccOfTxSigInfo "" UBYTE Com_BusAccOfTxSigInfoType 0 0 0 255 ECU_ADDRESS 0x0 /end MEASUREMENT
/begin MEASUREMENT Com_TxSigInfo[96].ByteLengthOfTxSigInfo "" UBYTE NO_COMPU_METHOD 0 0 0 255 ECU_ADDRESS 0x0 /end MEASUREMENT
/begin MEASUREMENT Com_TxSigInfo[96].DynSignalOfTxSigInfo "" UBYTE Com_DynSignalOfTxSigInfoType 0 0 0 1 ECU_ADDRESS 0x0 /end MEASUREMENT
/begin MEASUREMENT Com_TxSigInfo[96].FilterInitValueIdxOfTxSigInfo "" UBYTE Com_FilterInitValueIdxOfTxSigInfoType 0 0 0 255 ECU_ADDRESS 0x0 /end MEASUREMENT
/begin MEASUREMENT Com_TxSigInfo[96].FilterInitValueOfTxSigInfo "" UBYTE Com_FilterInitValueOfTxSigInfoType 0 0 0 255 ECU_ADDRESS 0x0 /end MEASUREMENT
/begin MEASUREMENT Com_TxSigInfo[96].InvValueIdxOfTxSigInfo "" UBYTE Com_InvValueIdxOfTxSigInfoType 0 0 0 255 ECU_ADDRESS 0x0 /end MEASUREMENT
/begin MEASUREMENT Com_TxSigInfo[96].InvValueOfTxSigInfo "" UBYTE Com_InvValueOfTxSigInfoType 0 0 0 255 ECU_ADDRESS 0x0 /end MEASUREMENT
/begin MEASUREMENT Com_TxSigInfo[96].OnChangeIdxOfTxSigInfo "" UBYTE Com_OnChangeIdxOfTxSigInfoType 0 0 0 255 ECU_ADDRESS 0x0 /end MEASUREMENT
/begin MEASUREMENT Com_TxSigInfo[96].OnChangeOfTxSigInfo "" UBYTE Com_OnChangeOfTxSigInfoType 0 0 0 255 ECU_ADDRESS 0x0 /end MEASUREMENT
/begin MEASUREMENT Com_TxSigInfo[96].StartByteInPduPositionOfTxSigInfo "" UBYTE NO_COMPU_METHOD 0 0 0 255 ECU_ADDRESS 0x0 /end MEASUREMENT
/begin MEASUREMENT Com_TxSigInfo[96].TxAccessInfoIdxOfTxSigInfo "" UWORD NO_COMPU_METHOD 0 0 0 65535 ECU_ADDRESS 0x0 /end MEASUREMENT
/begin MEASUREMENT Com_TxSigInfo[96].TxBufferEndIdxOfTxSigInfo "" UWORD Com_TxBufferEndIdxOfTxSigInfoType 0 0 0 65535 ECU_ADDRESS 0x0 /end MEASUREMENT
/begin MEASUREMENT Com_TxSigInfo[96].TxBufferStartIdxOfTxSigInfo "" UWORD Com_TxBufferStartIdxOfTxSigInfoType 0 0 0 65535 ECU_ADDRESS 0x0 /end MEASUREMENT
/begin MEASUREMENT Com_TxSigInfo[96].TxFilterInitValueArrayBasedFilterInitValueEndIdxOfTxSigInfo "" UBYTE Com_TxFilterInitValueArrayBasedFilterInitValueEndIdxOfTxSigInfoType 0 0 0 255 ECU_ADDRESS 0x0 /end MEASUREMENT
/begin MEASUREMENT Com_TxSigInfo[96].TxFilterInitValueArrayBasedFilterInitValueStartIdxOfTxSigInfo "" UBYTE Com_TxFilterInitValueArrayBasedFilterInitValueStartIdxOfTxSigInfoType 0 0 0 255 ECU_ADDRESS 0x0 /end MEASUREMENT
/begin MEASUREMENT Com_TxSigInfo[96].TxPduInfoIdxOfTxSigInfo "" UBYTE NO_COMPU_METHOD 0 0 0 255 ECU_ADDRESS 0x0 /end MEASUREMENT
/begin MEASUREMENT Com_TxSigInfo[97].ApplTypeOfTxSigInfo "" UBYTE Com_ApplTypeOfTxSigInfoType 0 0 0 255 ECU_ADDRESS 0x0 /end MEASUREMENT
/begin MEASUREMENT Com_TxSigInfo[97].BitLengthOfTxSigInfo "" UWORD NO_COMPU_METHOD 0 0 0 65535 ECU_ADDRESS 0x0 /end MEASUREMENT
/begin MEASUREMENT Com_TxSigInfo[97].BitPositionOfTxSigInfo "" UWORD NO_COMPU_METHOD 0 0 0 65535 ECU_ADDRESS 0x0 /end MEASUREMENT
/begin MEASUREMENT Com_TxSigInfo[97].BusAccOfTxSigInfo "" UBYTE Com_BusAccOfTxSigInfoType 0 0 0 255 ECU_ADDRESS 0x0 /end MEASUREMENT
/begin MEASUREMENT Com_TxSigInfo[97].ByteLengthOfTxSigInfo "" UBYTE NO_COMPU_METHOD 0 0 0 255 ECU_ADDRESS 0x0 /end MEASUREMENT
/begin MEASUREMENT Com_TxSigInfo[97].DynSignalOfTxSigInfo "" UBYTE Com_DynSignalOfTxSigInfoType 0 0 0 1 ECU_ADDRESS 0x0 /end MEASUREMENT
/begin MEASUREMENT Com_TxSigInfo[97].FilterInitValueIdxOfTxSigInfo "" UBYTE Com_FilterInitValueIdxOfTxSigInfoType 0 0 0 255 ECU_ADDRESS 0x0 /end MEASUREMENT
/begin MEASUREMENT Com_TxSigInfo[97].FilterInitValueOfTxSigInfo "" UBYTE Com_FilterInitValueOfTxSigInfoType 0 0 0 255 ECU_ADDRESS 0x0 /end MEASUREMENT
/begin MEASUREMENT Com_TxSigInfo[97].InvValueIdxOfTxSigInfo "" UBYTE Com_InvValueIdxOfTxSigInfoType 0 0 0 255 ECU_ADDRESS 0x0 /end MEASUREMENT
/begin MEASUREMENT Com_TxSigInfo[97].InvValueOfTxSigInfo "" UBYTE Com_InvValueOfTxSigInfoType 0 0 0 255 ECU_ADDRESS 0x0 /end MEASUREMENT
/begin MEASUREMENT Com_TxSigInfo[97].OnChangeIdxOfTxSigInfo "" UBYTE Com_OnChangeIdxOfTxSigInfoType 0 0 0 255 ECU_ADDRESS 0x0 /end MEASUREMENT
/begin MEASUREMENT Com_TxSigInfo[97].OnChangeOfTxSigInfo "" UBYTE Com_OnChangeOfTxSigInfoType 0 0 0 255 ECU_ADDRESS 0x0 /end MEASUREMENT
/begin MEASUREMENT Com_TxSigInfo[97].StartByteInPduPositionOfTxSigInfo "" UBYTE NO_COMPU_METHOD 0 0 0 255 ECU_ADDRESS 0x0 /end MEASUREMENT
/begin MEASUREMENT Com_TxSigInfo[97].TxAccessInfoIdxOfTxSigInfo "" UWORD NO_COMPU_METHOD 0 0 0 65535 ECU_ADDRESS 0x0 /end MEASUREMENT
/begin MEASUREMENT Com_TxSigInfo[97].TxBufferEndIdxOfTxSigInfo "" UWORD Com_TxBufferEndIdxOfTxSigInfoType 0 0 0 65535 ECU_ADDRESS 0x0 /end MEASUREMENT
/begin MEASUREMENT Com_TxSigInfo[97].TxBufferStartIdxOfTxSigInfo "" UWORD Com_TxBufferStartIdxOfTxSigInfoType 0 0 0 65535 ECU_ADDRESS 0x0 /end MEASUREMENT
/begin MEASUREMENT Com_TxSigInfo[97].TxFilterInitValueArrayBasedFilterInitValueEndIdxOfTxSigInfo "" UBYTE Com_TxFilterInitValueArrayBasedFilterInitValueEndIdxOfTxSigInfoType 0 0 0 255 ECU_ADDRESS 0x0 /end MEASUREMENT
/begin MEASUREMENT Com_TxSigInfo[97].TxFilterInitValueArrayBasedFilterInitValueStartIdxOfTxSigInfo "" UBYTE Com_TxFilterInitValueArrayBasedFilterInitValueStartIdxOfTxSigInfoType 0 0 0 255 ECU_ADDRESS 0x0 /end MEASUREMENT
/begin MEASUREMENT Com_TxSigInfo[97].TxPduInfoIdxOfTxSigInfo "" UBYTE NO_COMPU_METHOD 0 0 0 255 ECU_ADDRESS 0x0 /end MEASUREMENT
/begin MEASUREMENT Com_TxSigInfo[98].ApplTypeOfTxSigInfo "" UBYTE Com_ApplTypeOfTxSigInfoType 0 0 0 255 ECU_ADDRESS 0x0 /end MEASUREMENT
/begin MEASUREMENT Com_TxSigInfo[98].BitLengthOfTxSigInfo "" UWORD NO_COMPU_METHOD 0 0 0 65535 ECU_ADDRESS 0x0 /end MEASUREMENT
/begin MEASUREMENT Com_TxSigInfo[98].BitPositionOfTxSigInfo "" UWORD NO_COMPU_METHOD 0 0 0 65535 ECU_ADDRESS 0x0 /end MEASUREMENT
/begin MEASUREMENT Com_TxSigInfo[98].BusAccOfTxSigInfo "" UBYTE Com_BusAccOfTxSigInfoType 0 0 0 255 ECU_ADDRESS 0x0 /end MEASUREMENT
/begin MEASUREMENT Com_TxSigInfo[98].ByteLengthOfTxSigInfo "" UBYTE NO_COMPU_METHOD 0 0 0 255 ECU_ADDRESS 0x0 /end MEASUREMENT
/begin MEASUREMENT Com_TxSigInfo[98].DynSignalOfTxSigInfo "" UBYTE Com_DynSignalOfTxSigInfoType 0 0 0 1 ECU_ADDRESS 0x0 /end MEASUREMENT
/begin MEASUREMENT Com_TxSigInfo[98].FilterInitValueIdxOfTxSigInfo "" UBYTE Com_FilterInitValueIdxOfTxSigInfoType 0 0 0 255 ECU_ADDRESS 0x0 /end MEASUREMENT
/begin MEASUREMENT Com_TxSigInfo[98].FilterInitValueOfTxSigInfo "" UBYTE Com_FilterInitValueOfTxSigInfoType 0 0 0 255 ECU_ADDRESS 0x0 /end MEASUREMENT
/begin MEASUREMENT Com_TxSigInfo[98].InvValueIdxOfTxSigInfo "" UBYTE Com_InvValueIdxOfTxSigInfoType 0 0 0 255 ECU_ADDRESS 0x0 /end MEASUREMENT
/begin MEASUREMENT Com_TxSigInfo[98].InvValueOfTxSigInfo "" UBYTE Com_InvValueOfTxSigInfoType 0 0 0 255 ECU_ADDRESS 0x0 /end MEASUREMENT
/begin MEASUREMENT Com_TxSigInfo[98].OnChangeIdxOfTxSigInfo "" UBYTE Com_OnChangeIdxOfTxSigInfoType 0 0 0 255 ECU_ADDRESS 0x0 /end MEASUREMENT
/begin MEASUREMENT Com_TxSigInfo[98].OnChangeOfTxSigInfo "" UBYTE Com_OnChangeOfTxSigInfoType 0 0 0 255 ECU_ADDRESS 0x0 /end MEASUREMENT
/begin MEASUREMENT Com_TxSigInfo[98].StartByteInPduPositionOfTxSigInfo "" UBYTE NO_COMPU_METHOD 0 0 0 255 ECU_ADDRESS 0x0 /end MEASUREMENT
/begin MEASUREMENT Com_TxSigInfo[98].TxAccessInfoIdxOfTxSigInfo "" UWORD NO_COMPU_METHOD 0 0 0 65535 ECU_ADDRESS 0x0 /end MEASUREMENT
/begin MEASUREMENT Com_TxSigInfo[98].TxBufferEndIdxOfTxSigInfo "" UWORD Com_TxBufferEndIdxOfTxSigInfoType 0 0 0 65535 ECU_ADDRESS 0x0 /end MEASUREMENT
/begin MEASUREMENT Com_TxSigInfo[98].TxBufferStartIdxOfTxSigInfo "" UWORD Com_TxBufferStartIdxOfTxSigInfoType 0 0 0 65535 ECU_ADDRESS 0x0 /end MEASUREMENT
/begin MEASUREMENT Com_TxSigInfo[98].TxFilterInitValueArrayBasedFilterInitValueEndIdxOfTxSigInfo "" UBYTE Com_TxFilterInitValueArrayBasedFilterInitValueEndIdxOfTxSigInfoType 0 0 0 255 ECU_ADDRESS 0x0 /end MEASUREMENT
/begin MEASUREMENT Com_TxSigInfo[98].TxFilterInitValueArrayBasedFilterInitValueStartIdxOfTxSigInfo "" UBYTE Com_TxFilterInitValueArrayBasedFilterInitValueStartIdxOfTxSigInfoType 0 0 0 255 ECU_ADDRESS 0x0 /end MEASUREMENT
/begin MEASUREMENT Com_TxSigInfo[98].TxPduInfoIdxOfTxSigInfo "" UBYTE NO_COMPU_METHOD 0 0 0 255 ECU_ADDRESS 0x0 /end MEASUREMENT
/begin MEASUREMENT Com_TxSigInfo[99].ApplTypeOfTxSigInfo "" UBYTE Com_ApplTypeOfTxSigInfoType 0 0 0 255 ECU_ADDRESS 0x0 /end MEASUREMENT
/begin MEASUREMENT Com_TxSigInfo[99].BitLengthOfTxSigInfo "" UWORD NO_COMPU_METHOD 0 0 0 65535 ECU_ADDRESS 0x0 /end MEASUREMENT
/begin MEASUREMENT Com_TxSigInfo[99].BitPositionOfTxSigInfo "" UWORD NO_COMPU_METHOD 0 0 0 65535 ECU_ADDRESS 0x0 /end MEASUREMENT
/begin MEASUREMENT Com_TxSigInfo[99].BusAccOfTxSigInfo "" UBYTE Com_BusAccOfTxSigInfoType 0 0 0 255 ECU_ADDRESS 0x0 /end MEASUREMENT
/begin MEASUREMENT Com_TxSigInfo[99].ByteLengthOfTxSigInfo "" UBYTE NO_COMPU_METHOD 0 0 0 255 ECU_ADDRESS 0x0 /end MEASUREMENT
/begin MEASUREMENT Com_TxSigInfo[99].DynSignalOfTxSigInfo "" UBYTE Com_DynSignalOfTxSigInfoType 0 0 0 1 ECU_ADDRESS 0x0 /end MEASUREMENT
/begin MEASUREMENT Com_TxSigInfo[99].FilterInitValueIdxOfTxSigInfo "" UBYTE Com_FilterInitValueIdxOfTxSigInfoType 0 0 0 255 ECU_ADDRESS 0x0 /end MEASUREMENT
/begin MEASUREMENT Com_TxSigInfo[99].FilterInitValueOfTxSigInfo "" UBYTE Com_FilterInitValueOfTxSigInfoType 0 0 0 255 ECU_ADDRESS 0x0 /end MEASUREMENT
/begin MEASUREMENT Com_TxSigInfo[99].InvValueIdxOfTxSigInfo "" UBYTE Com_InvValueIdxOfTxSigInfoType 0 0 0 255 ECU_ADDRESS 0x0 /end MEASUREMENT
/begin MEASUREMENT Com_TxSigInfo[99].InvValueOfTxSigInfo "" UBYTE Com_InvValueOfTxSigInfoType 0 0 0 255 ECU_ADDRESS 0x0 /end MEASUREMENT
/begin MEASUREMENT Com_TxSigInfo[99].OnChangeIdxOfTxSigInfo "" UBYTE Com_OnChangeIdxOfTxSigInfoType 0 0 0 255 ECU_ADDRESS 0x0 /end MEASUREMENT
/begin MEASUREMENT Com_TxSigInfo[99].OnChangeOfTxSigInfo "" UBYTE Com_OnChangeOfTxSigInfoType 0 0 0 255 ECU_ADDRESS 0x0 /end MEASUREMENT
/begin MEASUREMENT Com_TxSigInfo[99].StartByteInPduPositionOfTxSigInfo "" UBYTE NO_COMPU_METHOD 0 0 0 255 ECU_ADDRESS 0x0 /end MEASUREMENT
/begin MEASUREMENT Com_TxSigInfo[99].TxAccessInfoIdxOfTxSigInfo "" UWORD NO_COMPU_METHOD 0 0 0 65535 ECU_ADDRESS 0x0 /end MEASUREMENT
/begin MEASUREMENT Com_TxSigInfo[99].TxBufferEndIdxOfTxSigInfo "" UWORD Com_TxBufferEndIdxOfTxSigInfoType 0 0 0 65535 ECU_ADDRESS 0x0 /end MEASUREMENT
/begin MEASUREMENT Com_TxSigInfo[99].TxBufferStartIdxOfTxSigInfo "" UWORD Com_TxBufferStartIdxOfTxSigInfoType 0 0 0 65535 ECU_ADDRESS 0x0 /end MEASUREMENT
/begin MEASUREMENT Com_TxSigInfo[99].TxFilterInitValueArrayBasedFilterInitValueEndIdxOfTxSigInfo "" UBYTE Com_TxFilterInitValueArrayBasedFilterInitValueEndIdxOfTxSigInfoType 0 0 0 255 ECU_ADDRESS 0x0 /end MEASUREMENT
/begin MEASUREMENT Com_TxSigInfo[99].TxFilterInitValueArrayBasedFilterInitValueStartIdxOfTxSigInfo "" UBYTE Com_TxFilterInitValueArrayBasedFilterInitValueStartIdxOfTxSigInfoType 0 0 0 255 ECU_ADDRESS 0x0 /end MEASUREMENT
/begin MEASUREMENT Com_TxSigInfo[99].TxPduInfoIdxOfTxSigInfo "" UBYTE NO_COMPU_METHOD 0 0 0 255 ECU_ADDRESS 0x0 /end MEASUREMENT
/begin MEASUREMENT Com_TxSigInfo[9].ApplTypeOfTxSigInfo "" UBYTE Com_ApplTypeOfTxSigInfoType 0 0 0 255 ECU_ADDRESS 0x0 /end MEASUREMENT
/begin MEASUREMENT Com_TxSigInfo[9].BitLengthOfTxSigInfo "" UWORD NO_COMPU_METHOD 0 0 0 65535 ECU_ADDRESS 0x0 /end MEASUREMENT
/begin MEASUREMENT Com_TxSigInfo[9].BitPositionOfTxSigInfo "" UWORD NO_COMPU_METHOD 0 0 0 65535 ECU_ADDRESS 0x0 /end MEASUREMENT
/begin MEASUREMENT Com_TxSigInfo[9].BusAccOfTxSigInfo "" UBYTE Com_BusAccOfTxSigInfoType 0 0 0 255 ECU_ADDRESS 0x0 /end MEASUREMENT
/begin MEASUREMENT Com_TxSigInfo[9].ByteLengthOfTxSigInfo "" UBYTE NO_COMPU_METHOD 0 0 0 255 ECU_ADDRESS 0x0 /end MEASUREMENT
/begin MEASUREMENT Com_TxSigInfo[9].DynSignalOfTxSigInfo "" UBYTE Com_DynSignalOfTxSigInfoType 0 0 0 1 ECU_ADDRESS 0x0 /end MEASUREMENT
/begin MEASUREMENT Com_TxSigInfo[9].FilterInitValueIdxOfTxSigInfo "" UBYTE Com_FilterInitValueIdxOfTxSigInfoType 0 0 0 255 ECU_ADDRESS 0x0 /end MEASUREMENT
/begin MEASUREMENT Com_TxSigInfo[9].FilterInitValueOfTxSigInfo "" UBYTE Com_FilterInitValueOfTxSigInfoType 0 0 0 255 ECU_ADDRESS 0x0 /end MEASUREMENT
/begin MEASUREMENT Com_TxSigInfo[9].InvValueIdxOfTxSigInfo "" UBYTE Com_InvValueIdxOfTxSigInfoType 0 0 0 255 ECU_ADDRESS 0x0 /end MEASUREMENT
/begin MEASUREMENT Com_TxSigInfo[9].InvValueOfTxSigInfo "" UBYTE Com_InvValueOfTxSigInfoType 0 0 0 255 ECU_ADDRESS 0x0 /end MEASUREMENT
/begin MEASUREMENT Com_TxSigInfo[9].OnChangeIdxOfTxSigInfo "" UBYTE Com_OnChangeIdxOfTxSigInfoType 0 0 0 255 ECU_ADDRESS 0x0 /end MEASUREMENT
/begin MEASUREMENT Com_TxSigInfo[9].OnChangeOfTxSigInfo "" UBYTE Com_OnChangeOfTxSigInfoType 0 0 0 255 ECU_ADDRESS 0x0 /end MEASUREMENT
/begin MEASUREMENT Com_TxSigInfo[9].StartByteInPduPositionOfTxSigInfo "" UBYTE NO_COMPU_METHOD 0 0 0 255 ECU_ADDRESS 0x0 /end MEASUREMENT
/begin MEASUREMENT Com_TxSigInfo[9].TxAccessInfoIdxOfTxSigInfo "" UWORD NO_COMPU_METHOD 0 0 0 65535 ECU_ADDRESS 0x0 /end MEASUREMENT
/begin MEASUREMENT Com_TxSigInfo[9].TxBufferEndIdxOfTxSigInfo "" UWORD Com_TxBufferEndIdxOfTxSigInfoType 0 0 0 65535 ECU_ADDRESS 0x0 /end MEASUREMENT
/begin MEASUREMENT Com_TxSigInfo[9].TxBufferStartIdxOfTxSigInfo "" UWORD Com_TxBufferStartIdxOfTxSigInfoType 0 0 0 65535 ECU_ADDRESS 0x0 /end MEASUREMENT
/begin MEASUREMENT Com_TxSigInfo[9].TxFilterInitValueArrayBasedFilterInitValueEndIdxOfTxSigInfo "" UBYTE Com_TxFilterInitValueArrayBasedFilterInitValueEndIdxOfTxSigInfoType 0 0 0 255 ECU_ADDRESS 0x0 /end MEASUREMENT
/begin MEASUREMENT Com_TxSigInfo[9].TxFilterInitValueArrayBasedFilterInitValueStartIdxOfTxSigInfo "" UBYTE Com_TxFilterInitValueArrayBasedFilterInitValueStartIdxOfTxSigInfoType 0 0 0 255 ECU_ADDRESS 0x0 /end MEASUREMENT
/begin MEASUREMENT Com_TxSigInfo[9].TxPduInfoIdxOfTxSigInfo "" UBYTE NO_COMPU_METHOD 0 0 0 255 ECU_ADDRESS 0x0 /end MEASUREMENT
/begin MEASUREMENT Com_TxTOutCnt "This array holds timeout counters for all Tx I-PDUs with a configured I-PDU based deadline monitoring." UWORD NO_COMPU_METHOD 0 0 0 65535 ECU_ADDRESS 0x0 /end MEASUREMENT
/begin MEASUREMENT Com_TxTOutInfo[0].CbkTxTOutFuncPtrIndStartIdxOfTxTOutInfo "" UBYTE Com_CbkTxTOutFuncPtrIndStartIdxOfTxTOutInfoType 0 0 0 255 ECU_ADDRESS 0x0 /end MEASUREMENT
/begin COMPU_METHOD CM_BMC_CMC_Zellspannung_176 "" TAB_INTP "%10.1" "Unit_MilliVolt" COMPU_TAB_REF CM_BMC_CMC_Zellspannung_176 STATUS_STRING_REF CM_BMC_CMC_Zellspannung_176.StatusText /end COMPU_METHOD
/begin COMPU_METHOD CM_BMC_CMC_Zellspannung_177 "" TAB_INTP "%10.1" "Unit_MilliVolt" COMPU_TAB_REF CM_BMC_CMC_Zellspannung_177 STATUS_STRING_REF CM_BMC_CMC_Zellspannung_177.StatusText /end COMPU_METHOD
/begin COMPU_METHOD CM_BMC_CMC_Zellspannung_178 "" TAB_INTP "%10.1" "Unit_MilliVolt" COMPU_TAB_REF CM_BMC_CMC_Zellspannung_178 STATUS_STRING_REF CM_BMC_CMC_Zellspannung_178.StatusText /end COMPU_METHOD
/begin COMPU_METHOD CM_BMC_CMC_Zellspannung_179 "" TAB_INTP "%10.1" "Unit_MilliVolt" COMPU_TAB_REF CM_BMC_CMC_Zellspannung_179 STATUS_STRING_REF CM_BMC_CMC_Zellspannung_179.StatusText /end COMPU_METHOD
/begin COMPU_METHOD CM_BMC_CMC_Zellspannung_180 "" TAB_INTP "%10.1" "Unit_MilliVolt" COMPU_TAB_REF CM_BMC_CMC_Zellspannung_180 STATUS_STRING_REF CM_BMC_CMC_Zellspannung_180.StatusText /end COMPU_METHOD
/begin COMPU_METHOD CM_BMC_CMC_Zellspannung_181 "" TAB_INTP "%10.1" "Unit_MilliVolt" COMPU_TAB_REF CM_BMC_CMC_Zellspannung_181 STATUS_STRING_REF CM_BMC_CMC_Zellspannung_181.StatusText /end COMPU_METHOD
/begin COMPU_METHOD CM_BMC_CMC_Zellspannung_182 "" TAB_INTP "%10.1" "Unit_MilliVolt" COMPU_TAB_REF CM_BMC_CMC_Zellspannung_182 STATUS_STRING_REF CM_BMC_CMC_Zellspannung_182.StatusText /end COMPU_METHOD
/begin COMPU_METHOD CM_BMC_CMC_Zellspannung_183 "" TAB_INTP "%10.1" "Unit_MilliVolt" COMPU_TAB_REF CM_BMC_CMC_Zellspannung_183 STATUS_STRING_REF CM_BMC_CMC_Zellspannung_183.StatusText /end COMPU_METHOD
/begin COMPU_METHOD CM_BMC_CMC_Zellspannung_184 "" TAB_INTP "%10.1" "Unit_MilliVolt" COMPU_TAB_REF CM_BMC_CMC_Zellspannung_184 STATUS_STRING_REF CM_BMC_CMC_Zellspannung_184.StatusText /end COMPU_METHOD
/begin COMPU_METHOD CM_BMC_CMC_Zellspannung_185 "" TAB_INTP "%10.1" "Unit_MilliVolt" COMPU_TAB_REF CM_BMC_CMC_Zellspannung_185 STATUS_STRING_REF CM_BMC_CMC_Zellspannung_185.StatusText /end COMPU_METHOD
/begin COMPU_METHOD CM_BMC_CMC_Zellspannung_186 "" TAB_INTP "%10.1" "Unit_MilliVolt" COMPU_TAB_REF CM_BMC_CMC_Zellspannung_186 STATUS_STRING_REF CM_BMC_CMC_Zellspannung_186.StatusText /end COMPU_METHOD
/begin COMPU_METHOD CM_BMC_CMC_Zellspannung_187 "" TAB_INTP "%10.1" "Unit_MilliVolt" COMPU_TAB_REF CM_BMC_CMC_Zellspannung_187 STATUS_STRING_REF CM_BMC_CMC_Zellspannung_187.StatusText /end COMPU_METHOD
/begin COMPU_METHOD CM_BMC_CMC_Zellspannung_188 "" TAB_INTP "%10.1" "Unit_MilliVolt" COMPU_TAB_REF CM_BMC_CMC_Zellspannung_188 STATUS_STRING_REF CM_BMC_CMC_Zellspannung_188.StatusText /end COMPU_METHOD
/begin COMPU_METHOD CM_BMC_CMC_Zellspannung_189 "" TAB_INTP "%10.1" "Unit_MilliVolt" COMPU_TAB_REF CM_BMC_CMC_Zellspannung_189 STATUS_STRING_REF CM_BMC_CMC_Zellspannung_189.StatusText /end COMPU_METHOD
/begin COMPU_METHOD CM_BMC_CMC_Zellspannung_190 "" TAB_INTP "%10.1" "Unit_MilliVolt" COMPU_TAB_REF CM_BMC_CMC_Zellspannung_190 STATUS_STRING_REF CM_BMC_CMC_Zellspannung_190.StatusText /end COMPU_METHOD
/begin COMPU_METHOD CM_BMC_CMC_Zellspannung_191 "" TAB_INTP "%10.1" "Unit_MilliVolt" COMPU_TAB_REF CM_BMC_CMC_Zellspannung_191 STATUS_STRING_REF CM_BMC_CMC_Zellspannung_191.StatusText /end COMPU_METHOD
/begin COMPU_METHOD CM_BMC_CMC_Zellspannung_192 "" TAB_INTP "%10.1" "Unit_MilliVolt" COMPU_TAB_REF CM_BMC_CMC_Zellspannung_192 STATUS_STRING_REF CM_BMC_CMC_Zellspannung_192.StatusText /end COMPU_METHOD
/begin COMPU_METHOD CM_BMC_DC_Laden "" TAB_VERB "%10.1" "" COMPU_TAB_REF CM_BMC_DC_Laden /end COMPU_METHOD
/begin COMPU_METHOD CM_BMC_Datenuebernahme_Anf "" TAB_VERB "%10.1" "" COMPU_TAB_REF CM_BMC_Datenuebernahme_Anf /end COMPU_METHOD
/begin COMPU_METHOD CM_BMC_Dauer_Entladeleistung "" TAB_INTP "%10.1" "Unit_Watt" COMPU_TAB_REF CM_BMC_Dauer_Entladeleistung STATUS_STRING_REF CM_BMC_Dauer_Entladeleistung.StatusText /end COMPU_METHOD
/begin COMPU_METHOD CM_BMC_Dauer_Entladeleistung_02 "" TAB_INTP "%10.1" "Unit_Watt" COMPU_TAB_REF CM_BMC_Dauer_Entladeleistung_02 STATUS_STRING_REF CM_BMC_Dauer_Entladeleistung_02.StatusText /end COMPU_METHOD
/begin COMPU_METHOD CM_BMC_Dauer_Ladeleistung "" TAB_INTP "%10.1" "Unit_Watt" COMPU_TAB_REF CM_BMC_Dauer_Ladeleistung STATUS_STRING_REF CM_BMC_Dauer_Ladeleistung.StatusText /end COMPU_METHOD
/begin COMPU_METHOD CM_BMC_Dauer_Ladeleistung_02 "" TAB_INTP "%10.1" "Unit_Watt" COMPU_TAB_REF CM_BMC_Dauer_Ladeleistung_02 STATUS_STRING_REF CM_BMC_Dauer_Ladeleistung_02.StatusText /end COMPU_METHOD
/begin COMPU_METHOD CM_BMC_Dev_Freigabe "" TAB_VERB "%10.1" "" COMPU_TAB_REF CM_BMC_Dev_Freigabe /end COMPU_METHOD
/begin COMPU_METHOD CM_BMC_EnergieVorhalt "" TAB_INTP "%10.1" "Unit_KiloWattHour" COMPU_TAB_REF CM_BMC_EnergieVorhalt STATUS_STRING_REF CM_BMC_EnergieVorhalt.StatusText /end COMPU_METHOD
/begin COMPU_METHOD CM_BMC_Energie_Entladen "" TAB_INTP "%10.1" "Unit_KiloWattHour" COMPU_TAB_REF CM_BMC_Energie_Entladen STATUS_STRING_REF CM_BMC_Energie_Entladen.StatusText /end COMPU_METHOD
/begin COMPU_METHOD CM_BMC_Energie_Laden "" TAB_INTP "%10.1" "Unit_KiloWattHour" COMPU_TAB_REF CM_BMC_Energie_Laden STATUS_STRING_REF CM_BMC_Energie_Laden.StatusText /end COMPU_METHOD
/begin COMPU_METHOD CM_BMC_Energie_Sockel_SoC "" TAB_INTP "%10.1" "Unit_PerCent" COMPU_TAB_REF CM_BMC_Energie_Sockel_SoC STATUS_STRING_REF CM_BMC_Energie_Sockel_SoC.StatusText /end COMPU_METHOD
/begin COMPU_METHOD CM_BMC_Energieinhalt "" TAB_INTP "%10.1" "Unit_WattHour" COMPU_TAB_REF CM_BMC_Energieinhalt STATUS_STRING_REF CM_BMC_Energieinhalt.StatusText /end COMPU_METHOD
/begin COMPU_METHOD CM_BMC_ExtLadeleistung "" TAB_INTP "%10.1" "Unit_KiloWatt" COMPU_TAB_REF CM_BMC_ExtLadeleistung STATUS_STRING_REF CM_BMC_ExtLadeleistung.StatusText /end COMPU_METHOD
/begin COMPU_METHOD CM_BMC_Fehler_Leistungsred "" TAB_VERB "%10.1" "" COMPU_TAB_REF CM_BMC_Fehler_Leistungsred /end COMPU_METHOD
/begin COMPU_METHOD CM_BMC_Fehler_Warnung "" TAB_VERB "%10.1" "" COMPU_TAB_REF CM_BMC_Fehler_Warnung /end COMPU_METHOD
/begin COMPU_METHOD CM_BMC_Flash_Freigabe "" TAB_VERB "%10.1" "" COMPU_TAB_REF CM_BMC_Flash_Freigabe /end COMPU_METHOD
/begin COMPU_METHOD CM_BMC_HVK_EoHVL_Status "" TAB_VERB "%10.1" "" COMPU_TAB_REF CM_BMC_HVK_EoHVL_Status /end COMPU_METHOD
/begin COMPU_METHOD CM_BMC_HVK_Fehler_HVIL "" TAB_VERB "%10.1" "" COMPU_TAB_REF CM_BMC_HVK_Fehler_HVIL /end COMPU_METHOD
/begin COMPU_METHOD CM_BMC_HVK_Fehler_Intern "" TAB_VERB "%10.1" "" COMPU_TAB_REF CM_BMC_HVK_Fehler_Intern /end COMPU_METHOD
/begin COMPU_METHOD CM_BMC_HVK_Fehler_SD "" TAB_VERB "%10.1" "" COMPU_TAB_REF CM_BMC_HVK_Fehler_SD /end COMPU_METHOD
/begin COMPU_METHOD CM_BMC_HV_01_BZ "" TAB_INTP "%10.1" "" COMPU_TAB_REF CM_BMC_HV_01_BZ /end COMPU_METHOD
/begin COMPU_METHOD CM_BMC_HV_01_CRC "" TAB_INTP "%10.1" "" COMPU_TAB_REF CM_BMC_HV_01_CRC /end COMPU_METHOD
/begin COMPU_METHOD CM_BMC_HV_02_BZ "" TAB_INTP "%10.1" "" COMPU_TAB_REF CM_BMC_HV_02_BZ /end COMPU_METHOD
/begin COMPU_METHOD CM_BMC_HV_02_CRC "" TAB_INTP "%10.1" "" COMPU_TAB_REF CM_BMC_HV_02_CRC /end COMPU_METHOD
/begin COMPU_METHOD CM_BMC_HV_04_BZ "" TAB_INTP "%10.1" "" COMPU_TAB_REF CM_BMC_HV_04_BZ /end COMPU_METHOD
/begin COMPU_METHOD CM_BMC_HV_04_CRC "" TAB_INTP "%10.1" "" COMPU_TAB_REF CM_BMC_HV_04_CRC /end COMPU_METHOD
/begin COMPU_METHOD CM_BMC_IWU_Status "" TAB_VERB "%10.1" "" COMPU_TAB_REF CM_BMC_IWU_Status /end COMPU_METHOD
/begin COMPU_METHOD CM_BMC_IWU_Wert_neg "" TAB_INTP "%10.1" "Unit_Ohm" COMPU_TAB_REF CM_BMC_IWU_Wert_neg STATUS_STRING_REF CM_BMC_IWU_Wert_neg.StatusText /end COMPU_METHOD
/begin COMPU_METHOD CM_BMC_IWU_Wert_pos "" TAB_INTP "%10.1" "Unit_Ohm" COMPU_TAB_REF CM_BMC_IWU_Wert_pos STATUS_STRING_REF CM_BMC_IWU_Wert_pos.StatusText /end COMPU_METHOD
/begin COMPU_METHOD CM_BMC_Iso_Mode_Anf "" TAB_VERB "%10.1" "" COMPU_TAB_REF CM_BMC_Iso_Mode_Anf /end COMPU_METHOD
/begin COMPU_METHOD CM_BMC_IstTemperaturMax_Modul_ID "" TAB_INTP "%10.1" "Unit_None" COMPU_TAB_REF CM_BMC_IstTemperaturMax_Modul_ID STATUS_STRING_REF CM_BMC_IstTemperaturMax_Modul_ID.StatusText /end COMPU_METHOD
/begin COMPU_METHOD CM_BMC_IstTemperaturMax_Sensor_ID "" TAB_INTP "%10.1" "Unit_None" COMPU_TAB_REF CM_BMC_IstTemperaturMax_Sensor_ID STATUS_STRING_REF CM_BMC_IstTemperaturMax_Sensor_ID.StatusText /end COMPU_METHOD
/begin COMPU_METHOD CM_BMC_IstTemperaturMin_Modul_ID "" TAB_INTP "%10.1" "Unit_None" COMPU_TAB_REF CM_BMC_IstTemperaturMin_Modul_ID STATUS_STRING_REF CM_BMC_IstTemperaturMin_Modul_ID.StatusText /end COMPU_METHOD
/begin COMPU_METHOD CM_BMC_IstTemperaturMin_Sensor_ID "" TAB_INTP "%10.1" "Unit_None" COMPU_TAB_REF CM_BMC_IstTemperaturMin_Sensor_ID STATUS_STRING_REF CM_BMC_IstTemperaturMin_Sensor_ID.StatusText /end COMPU_METHOD
/begin COMPU_METHOD CM_BMC_IstZellSpannungMax_Modul_ID "" TAB_INTP "%10.1" "Unit_None" COMPU_TAB_REF CM_BMC_IstZellSpannungMax_Modul_ID STATUS_STRING_REF CM_BMC_IstZellSpannungMax_Modul_ID.StatusText /end COMPU_METHOD
/begin COMPU_METHOD CM_BMC_IstZellSpannungMax_Zell_ID "" TAB_INTP "%10.1" "Unit_None" COMPU_TAB_REF CM_BMC_IstZellSpannungMax_Zell_ID STATUS_STRING_REF CM_BMC_IstZellSpannungMax_Zell_ID.StatusText /end COMPU_METHOD
/begin COMPU_METHOD CM_BMC_IstZellSpannungMin_Modul_ID "" TAB_INTP "%10.1" "Unit_None" COMPU_TAB_REF CM_BMC_IstZellSpannungMin_Modul_ID STATUS_STRING_REF CM_BMC_IstZellSpannungMin_Modul_ID.StatusText /end COMPU_METHOD
/begin COMPU_METHOD CM_BMC_IstZellSpannungMin_Zell_ID "" TAB_INTP "%10.1" "Unit_None" COMPU_TAB_REF CM_BMC_IstZellSpannungMin_Zell_ID STATUS_STRING_REF CM_BMC_IstZellSpannungMin_Zell_ID.StatusText /end COMPU_METHOD
/begin COMPU_METHOD CM_BMC_IstZellspannungMax "" TAB_INTP "%10.1" "Unit_MilliVolt" COMPU_TAB_REF CM_BMC_IstZellspannungMax STATUS_STRING_REF CM_BMC_IstZellspannungMax.StatusText /end COMPU_METHOD
/begin COMPU_METHOD CM_BMC_IstZellspannungMin "" TAB_INTP "%10.1" "Unit_MilliVolt" COMPU_TAB_REF CM_BMC_IstZellspannungMin STATUS_STRING_REF CM_BMC_IstZellspannungMin.StatusText /end COMPU_METHOD
/begin COMPU_METHOD CM_BMC_Lebensdauer_Trennelemente "" TAB_INTP "%10.1" "Unit_None" COMPU_TAB_REF CM_BMC_Lebensdauer_Trennelemente STATUS_STRING_REF CM_BMC_Lebensdauer_Trennelemente.StatusText /end COMPU_METHOD
/begin COMPU_METHOD CM_BMC_Leerlaufspannung "" TAB_INTP "%10.1" "Unit_Volt" COMPU_TAB_REF CM_BMC_Leerlaufspannung STATUS_STRING_REF CM_BMC_Leerlaufspannung.StatusText /end COMPU_METHOD
/begin COMPU_METHOD CM_BMC_MMTR_Status "" TAB_VERB "%10.1" "" COMPU_TAB_REF CM_BMC_MMTR_Status /end COMPU_METHOD
/begin COMPU_METHOD CM_BMC_MaxEnergieinhalt "" TAB_INTP "%10.1" "Unit_WattHour" COMPU_TAB_REF CM_BMC_MaxEnergieinhalt STATUS_STRING_REF CM_BMC_MaxEnergieinhalt.StatusText /end COMPU_METHOD
/begin COMPU_METHOD CM_BMC_Max_Entladeleistung "" TAB_INTP "%10.1" "Unit_Watt" COMPU_TAB_REF CM_BMC_Max_Entladeleistung STATUS_STRING_REF CM_BMC_Max_Entladeleistung.StatusText /end COMPU_METHOD
/begin COMPU_METHOD CM_BMC_Max_Entladeleistung_02 "" TAB_INTP "%10.1" "Unit_Watt" COMPU_TAB_REF CM_BMC_Max_Entladeleistung_02 STATUS_STRING_REF CM_BMC_Max_Entladeleistung_02.StatusText /end COMPU_METHOD
/begin COMPU_METHOD CM_BMC_Max_Entladestrom "" TAB_INTP "%10.1" "Unit_Amper" COMPU_TAB_REF CM_BMC_Max_Entladestrom STATUS_STRING_REF CM_BMC_Max_Entladestrom.StatusText /end COMPU_METHOD
/begin COMPU_METHOD CM_BMC_Max_Entladestrom_02 "" TAB_INTP "%10.1" "Unit_Amper" COMPU_TAB_REF CM_BMC_Max_Entladestrom_02 STATUS_STRING_REF CM_BMC_Max_Entladestrom_02.StatusText /end COMPU_METHOD
/begin COMPU_METHOD CM_BMC_Max_Ladeleistung "" TAB_INTP "%10.1" "Unit_Watt" COMPU_TAB_REF CM_BMC_Max_Ladeleistung STATUS_STRING_REF CM_BMC_Max_Ladeleistung.StatusText /end COMPU_METHOD
/begin COMPU_METHOD CM_BMC_Max_Ladeleistung_02 "" TAB_INTP "%10.1" "Unit_Watt" COMPU_TAB_REF CM_BMC_Max_Ladeleistung_02 STATUS_STRING_REF CM_BMC_Max_Ladeleistung_02.StatusText /end COMPU_METHOD
/begin COMPU_METHOD ComM_ChannelIdxOfPncSignalType "" TAB_VERB "%10.1" "" COMPU_TAB_REF ComM_ChannelIdxOfPncSignalType /end COMPU_METHOD
/begin COMPU_METHOD ComM_ComAllowedType "" TAB_VERB "%10.1" "" COMPU_TAB_REF ComM_ComAllowedType /end COMPU_METHOD
/begin COMPU_METHOD ComM_DcmRequestActiveType "" TAB_VERB "%10.1" "" COMPU_TAB_REF ComM_DcmRequestActiveType /end COMPU_METHOD
/begin COMPU_METHOD ComM_PncChannelMappingEndIdxOfPncPbType "" TAB_VERB "%10.1" "" COMPU_TAB_REF ComM_PncChannelMappingEndIdxOfPncPbType /end COMPU_METHOD
/begin COMPU_METHOD ComM_PncChannelMappingStartIdxOfPncPbType "" TAB_VERB "%10.1" "" COMPU_TAB_REF ComM_PncChannelMappingStartIdxOfPncPbType /end COMPU_METHOD
/begin COMPU_METHOD ComM_PncPbIndEndIdxOfChannelPbType "" TAB_VERB "%10.1" "" COMPU_TAB_REF ComM_PncPbIndEndIdxOfChannelPbType /end COMPU_METHOD
/begin COMPU_METHOD ComM_PncPbIndStartIdxOfChannelPbType "" TAB_VERB "%10.1" "" COMPU_TAB_REF ComM_PncPbIndStartIdxOfChannelPbType /end COMPU_METHOD
/begin COMPU_METHOD ComM_PncSignalIndEndIdxOfPncPbType "" TAB_VERB "%10.1" "" COMPU_TAB_REF ComM_PncSignalIndEndIdxOfPncPbType /end COMPU_METHOD
/begin COMPU_METHOD ComM_PncSignalIndStartIdxOfPncPbType "" TAB_VERB "%10.1" "" COMPU_TAB_REF ComM_PncSignalIndStartIdxOfPncPbType /end COMPU_METHOD
/begin COMPU_METHOD ComM_PncSignalValuesEndIdxOfPncSignalType "" TAB_VERB "%10.1" "" COMPU_TAB_REF ComM_PncSignalValuesEndIdxOfPncSignalType /end COMPU_METHOD
/begin COMPU_METHOD ComM_PncSignalValuesStartIdxOfPncSignalType "" TAB_VERB "%10.1" "" COMPU_TAB_REF ComM_PncSignalValuesStartIdxOfPncSignalType /end COMPU_METHOD
/begin COMPU_METHOD ComM_PostInitializedType "" TAB_VERB "%10.1" "" COMPU_TAB_REF ComM_PostInitializedType /end COMPU_METHOD
/begin COMPU_METHOD ComM_TypeOfPncSignalType "" TAB_VERB "%10.1" "" COMPU_TAB_REF ComM_TypeOfPncSignalType /end COMPU_METHOD
/begin COMPU_METHOD ComM_UserReqFullComEndIdxOfChannelPbType "" TAB_VERB "%10.1" "" COMPU_TAB_REF ComM_UserReqFullComEndIdxOfChannelPbType /end COMPU_METHOD
/begin COMPU_METHOD ComM_UserReqFullComStartIdxOfChannelPbType "" TAB_VERB "%10.1" "" COMPU_TAB_REF ComM_UserReqFullComStartIdxOfChannelPbType /end COMPU_METHOD
/begin COMPU_METHOD Com_ApplTypeOfTxSigInfoType "" TAB_VERB "%10.1" "" COMPU_TAB_REF Com_ApplTypeOfTxSigInfoType /end COMPU_METHOD
/begin COMPU_METHOD Com_BusAccOfTxSigInfoType "" TAB_VERB "%10.1" "" COMPU_TAB_REF Com_BusAccOfTxSigInfoType /end COMPU_METHOD
/begin COMPU_METHOD Com_CbkTxTOutFuncPtrIndStartIdxOfTxTOutInfoType "" TAB_VERB "%10.1" "" COMPU_TAB_REF Com_CbkTxTOutFuncPtrIndStartIdxOfTxTOutInfoType /end COMPU_METHOD
/begin COMPU_METHOD Com_DynSignalOfTxSigInfoType "" TAB_VERB "%10.1" "" COMPU_TAB_REF Com_DynSignalOfTxSigInfoType /end COMPU_METHOD
/begin COMPU_METHOD Com_FilterInitValueIdxOfTxSigInfoType "" TAB_VERB "%10.1" "" COMPU_TAB_REF Com_FilterInitValueIdxOfTxSigInfoType /end COMPU_METHOD
/begin COMPU_METHOD Com_FilterInitValueOfTxSigInfoType "" TAB_VERB "%10.1" "" COMPU_TAB_REF Com_FilterInitValueOfTxSigInfoType /end COMPU_METHOD
/begin COMPU_METHOD Com_InvValueIdxOfTxSigInfoType "" TAB_VERB "%10.1" "" COMPU_TAB_REF Com_InvValueIdxOfTxSigInfoType /end COMPU_METHOD
/begin COMPU_METHOD Com_InvValueOfTxSigInfoType "" TAB_VERB "%10.1" "" COMPU_TAB_REF Com_InvValueOfTxSigInfoType /end COMPU_METHOD
/begin COMPU_METHOD Com_OnChangeIdxOfTxSigInfoType "" TAB_VERB "%10.1" "" COMPU_TAB_REF Com_OnChangeIdxOfTxSigInfoType /end COMPU_METHOD
/begin COMPU_METHOD Com_OnChangeOfTxSigInfoType "" TAB_VERB "%10.1" "" COMPU_TAB_REF Com_OnChangeOfTxSigInfoType /end COMPU_METHOD
/begin COMPU_METHOD Com_TxBufferEndIdxOfTxSigInfoType "" TAB_VERB "%10.1" "" COMPU_TAB_REF Com_TxBufferEndIdxOfTxSigInfoType /end COMPU_METHOD
/begin COMPU_METHOD Com_TxBufferStartIdxOfTxSigInfoType "" TAB_VERB "%10.1" "" COMPU_TAB_REF Com_TxBufferStartIdxOfTxSigInfoType /end COMPU_METHOD
/begin COMPU_METHOD Com_TxFilterInitValueArrayBasedFilterInitValueEndIdxOfTxSigInfoType "" TAB_VERB "%10.1" "" COMPU_TAB_REF Com_TxFilterInitValueArrayBasedFilterInitValueEndIdxOfTxSigInfoType /end COMPU_METHOD
/begin COMPU_METHOD Com_TxFilterInitValueArrayBasedFilterInitValueStartIdxOfTxSigInfoType "" TAB_VERB "%10.1" "" COMPU_TAB_REF Com_TxFilterInitValueArrayBasedFilterInitValueStartIdxOfTxSigInfoType /end COMPU_METHOD
/begin COMPU_METHOD CompuMethod_ComM_BusSMModeType_Values "" TAB_VERB "%10.1" "" COMPU_TAB_REF CompuMethod_ComM_BusSMModeType_Values /end COMPU_METHOD
/begin COMPU_METHOD CompuMethod_ComM_ComModeType_Values "" TAB_VERB "%10.1" "" COMPU_TAB_REF CompuMethod_ComM_ComModeType_Values /end COMPU_METHOD
/begin COMPU_TAB CM_BMC_CMC_Zellspannung_176 "" TAB_INTP 2 0 1000 4091 5091 /end COMPU_TAB
/begin COMPU_VTAB CM_BMC_CMC_Zellspannung_176.StatusText "" TAB_VERB 4 4092 "CM_BMC_CMC_Zellspannung_176_Cxffc_kleiner_1V" 4093 "CM_BMC_CMC_Zellspannung_176_Cxffd_nicht_vorhanden" 4094 "CM_BMC_CMC_Zellspannung_176_Cxffe_Init" 4095 "CM_BMC_CMC_Zellspannung_176_Cxfff_Fehler" /end COMPU_VTAB
/begin COMPU_TAB CM_BMC_CMC_Zellspannung_177 "" TAB_INTP 2 0 1000 4091 5091 /end COMPU_TAB
/begin COMPU_VTAB CM_BMC_CMC_Zellspannung_177.StatusText "" TAB_VERB 4 4092 "CM_BMC_CMC_Zellspannung_177_Cxffc_kleiner_1V" 4093 "CM_BMC_CMC_Zellspannung_177_Cxffd_nicht_vorhanden" 4094 "CM_BMC_CMC_Zellspannung_177_Cxffe_Init" 4095 "CM_BMC_CMC_Zellspannung_177_Cxfff_Fehler" /end COMPU_VTAB
/begin COMPU_TAB CM_BMC_CMC_Zellspannung_178 "" TAB_INTP 2 0 1000 4091 5091 /end COMPU_TAB
/begin COMPU_VTAB CM_BMC_CMC_Zellspannung_178.StatusText "" TAB_VERB 4 4092 "CM_BMC_CMC_Zellspannung_178_Cxffc_kleiner_1V" 4093 "CM_BMC_CMC_Zellspannung_178_Cxffd_nicht_vorhanden" 4094 "CM_BMC_CMC_Zellspannung_178_Cxffe_Init" 4095 "CM_BMC_CMC_Zellspannung_178_Cxfff_Fehler" /end COMPU_VTAB
/begin COMPU_TAB CM_BMC_CMC_Zellspannung_179 "" TAB_INTP 2 0 1000 4091 5091 /end COMPU_TAB
/begin COMPU_VTAB CM_BMC_CMC_Zellspannung_179.StatusText "" TAB_VERB 4 4092 "CM_BMC_CMC_Zellspannung_179_Cxffc_kleiner_1V" 4093 "CM_BMC_CMC_Zellspannung_179_Cxffd_nicht_vorhanden" 4094 "CM_BMC_CMC_Zellspannung_179_Cxffe_Init" 4095 "CM_BMC_CMC_Zellspannung_179_Cxfff_Fehler" /end COMPU_VTAB
/begin COMPU_TAB CM_BMC_CMC_Zellspannung_180 "" TAB_INTP 2 0 1000 4091 5091 /end COMPU_TAB
/begin COMPU_VTAB CM_BMC_CMC_Zellspannung_180.StatusText "" TAB_VERB 4 4092 "CM_BMC_CMC_Zellspannung_180_Cxffc_kleiner_1V" 4093 "CM_BMC_CMC_Zellspannung_180_Cxffd_nicht_vorhanden" 4094 "CM_BMC_CMC_Zellspannung_180_Cxffe_Init" 4095 "CM_BMC_CMC_Zellspannung_180_Cxfff_Fehler" /end COMPU_VTAB
/begin COMPU_TAB CM_BMC_CMC_Zellspannung_181 "" TAB_INTP 2 0 1000 4091 5091 /end COMPU_TAB
/begin COMPU_VTAB CM_BMC_CMC_Zellspannung_181.StatusText "" TAB_VERB 4 4092 "CM_BMC_CMC_Zellspannung_181_Cxffc_kleiner_1V" 4093 "CM_BMC_CMC_Zellspannung_181_Cxffd_nicht_vorhanden" 4094 "CM_BMC_CMC_Zellspannung_181_Cxffe_Init" 4095 "CM_BMC_CMC_Zellspannung_181_Cxfff_Fehler" /end COMPU_VTAB
/begin COMPU_TAB CM_BMC_CMC_Zellspannung_182 "" TAB_INTP 2 0 1000 4091 5091 /end COMPU_TAB
/begin COMPU_VTAB CM_BMC_CMC_Zellspannung_182.StatusText "" TAB_VERB 4 4092 "CM_BMC_CMC_Zellspannung_182_Cxffc_kleiner_1V" 4093 "CM_BMC_CMC_Zellspannung_182_Cxffd_nicht_vorhanden" 4094 "CM_BMC_CMC_Zellspannung_182_Cxffe_Init" 4095 "CM_BMC_CMC_Zellspannung_182_Cxfff_Fehler" /end COMPU_VTAB
/begin COMPU_TAB CM_BMC_CMC_Zellspannung_183 "" TAB_INTP 2 0 1000 4091 5091 /end COMPU_TAB
/begin COMPU_VTAB CM_BMC_CMC_Zellspannung_183.StatusText "" TAB_VERB 4 4092 "CM_BMC_CMC_Zellspannung_183_Cxffc_kleiner_1V" 4093 "CM_BMC_CMC_Zellspannung_183_Cxffd_nicht_vorhanden" 4094 "CM_BMC_CMC_Zellspannung_183_Cxffe_Init" 4095 "CM_BMC_CMC_Zellspannung_183_Cxfff_Fehler" /end COMPU_VTAB
/begin COMPU_TAB CM_BMC_CMC_Zellspannung_184 "" TAB_INTP 2 0 1000 4091 5091 /end COMPU_TAB
/begin COMPU_VTAB CM_BMC_CMC_Zellspannung_184.StatusText "" TAB_VERB 4 4092 "CM_BMC_CMC_Zellspannung_184_Cxffc_kleiner_1V" 4093 "CM_BMC_CMC_Zellspannung_184_Cxffd_nicht_vorhanden" 4094 "CM_BMC_CMC_Zellspannung_184_Cxffe_Init" 4095 "CM_BMC_CMC_Zellspannung_184_Cxfff_Fehler" /end COMPU_VTAB
/begin COMPU_TAB CM_BMC_CMC_Zellspannung_185 "" TAB_INTP 2 0 1000 4091 5091 /end COMPU_TAB
/begin COMPU_VTAB CM_BMC_CMC_Zellspannung_185.StatusText "" TAB_VERB 4 4092 "CM_BMC_CMC_Zellspannung_185_Cxffc_kleiner_1V" 4093 "CM_BMC_CMC_Zellspannung_185_Cxffd_nicht_vorhanden" 4094 "CM_BMC_CMC_Zellspannung_185_Cxffe_Init" 4095 "CM_BMC_CMC_Zellspannung_185_Cxfff_Fehler" /end COMPU_VTAB
/begin COMPU_TAB CM_BMC_CMC_Zellspannung_186 "" TAB_INTP 2 0 1000 4091 5091 /end COMPU_TAB
/begin COMPU_VTAB CM_BMC_CMC_Zellspannung_186.StatusText "" TAB_VERB 4 4092 "CM_BMC_CMC_Zellspannung_186_Cxffc_kleiner_1V" 4093 "CM_BMC_CMC_Zellspannung_186_Cxffd_nicht_vorhanden" 4094 "CM_BMC_CMC_Zellspannung_186_Cxffe_Init" 4095 "CM_BMC_CMC_Zellspannung_186_Cxfff_Fehler" /end COMPU_VTAB
/begin COMPU_TAB CM_BMC_CMC_Zellspannung_187 "" TAB_INTP 2 0 1000 4091 5091 /end COMPU_TAB
/begin COMPU_VTAB CM_BMC_CMC_Zellspannung_187.StatusText "" TAB_VERB 4 4092 "CM_BMC_CMC_Zellspannung_187_Cxffc_kleiner_1V" 4093 "CM_BMC_CMC_Zellspannung_187_Cxffd_nicht_vorhanden" 4094 "CM_BMC_CMC_Zellspannung_187_Cxffe_Init" 4095 "CM_BMC_CMC_Zellspannung_187_Cxfff_Fehler" /end COMPU_VTAB
/begin COMPU_TAB CM_BMC_CMC_Zellspannung_188 "" TAB_INTP 2 0 1000 4091 5091 /end COMPU_TAB
/begin COMPU_VTAB CM_BMC_CMC_Zellspannung_188.StatusText "" TAB_VERB 4 4092 "CM_BMC_CMC_Zellspannung_188_Cxffc_kleiner_1V" 4093 "CM_BMC_CMC_Zellspannung_188_Cxffd_nicht_vorhanden" 4094 "CM_BMC_CMC_Zellspannung_188_Cxffe_Init" 4095 "CM_BMC_CMC_Zellspannung_188_Cxfff_Fehler" /end COMPU_VTAB
/begin COMPU_TAB CM_BMC_CMC_Zellspannung_189 "" TAB_INTP 2 0 1000 4091 5091 /end COMPU_TAB
/begin COMPU_VTAB CM_BMC_CMC_Zellspannung_189.StatusText "" TAB_VERB 4 4092 "CM_BMC_CMC_Zellspannung_189_Cxffc_kleiner_1V" 4093 "CM_BMC_CMC_Zellspannung_189_Cxffd_nicht_vorhanden" 4094 "CM_BMC_CMC_Zellspannung_189_Cxffe_Init" 4095 "CM_BMC_CMC_Zellspannung_189_Cxfff_Fehler" /end COMPU_VTAB
/begin COMPU_TAB CM_BMC_CMC_Zellspannung_190 "" TAB_INTP 2 0 1000 4091 5091 /end COMPU_TAB
/begin COMPU_VTAB CM_BMC_CMC_Zellspannung_190.StatusText "" TAB_VERB 4 4092 "CM_BMC_CMC_Zellspannung_190_Cxffc_kleiner_1V" 4093 "CM_BMC_CMC_Zellspannung_190_Cxffd_nicht_vorhanden" 4094 "CM_BMC_CMC_Zellspannung_190_Cxffe_Init" 4095 "CM_BMC_CMC_Zellspannung_190_Cxfff_Fehler" /end COMPU_VTAB
/begin COMPU_TAB CM_BMC_CMC_Zellspannung_191 "" TAB_INTP 2 0 1000 4091 5091 /end COMPU_TAB
/begin COMPU_VTAB CM_BMC_CMC_Zellspannung_191.StatusText "" TAB_VERB 4 4092 "CM_BMC_CMC_Zellspannung_191_Cxffc_kleiner_1V" 4093 "CM_BMC_CMC_Zellspannung_191_Cxffd_nicht_vorhanden" 4094 "CM_BMC_CMC_Zellspannung_191_Cxffe_Init" 4095 "CM_BMC_CMC_Zellspannung_191_Cxfff_Fehler" /end COMPU_VTAB
/begin COMPU_TAB CM_BMC_CMC_Zellspannung_192 "" TAB_INTP 2 0 1000 4091 5091 /end COMPU_TAB
/begin COMPU_VTAB CM_BMC_CMC_Zellspannung_192.StatusText "" TAB_VERB 4 4092 "CM_BMC_CMC_Zellspannung_192_Cxffc_kleiner_1V" 4093 "CM_BMC_CMC_Zellspannung_192_Cxffd_nicht_vorhanden" 4094 "CM_BMC_CMC_Zellspannung_192_Cxffe_Init" 4095 "CM_BMC_CMC_Zellspannung_192_Cxfff_Fehler" /end COMPU_VTAB
/begin COMPU_VTAB CM_BMC_DC_Laden "" TAB_VERB 4 0 "CM_BMC_DC_Laden_Cx0_Init" 1 "CM_BMC_DC_Laden_Cx1_nicht_vorhanden" 2 "CM_BMC_DC_Laden_Cx2_vorhanden" 3 "CM_BMC_DC_Laden_Cx3_Fehler" /end COMPU_VTAB
/begin COMPU_VTAB CM_BMC_Datenuebernahme_Anf "" TAB_VERB 2 0 "CM_BMC_Datenuebernahme_Anf_Cx0_Daten_nicht_uebernehmen" 1 "CM_BMC_Datenuebernahme_Anf_Cx1_Daten_uebernehmen" /end COMPU_VTAB
/begin COMPU_TAB CM_BMC_Dauer_Entladeleistung "" TAB_INTP 2 0 0 4093 818600 /end COMPU_TAB
/begin COMPU_VTAB CM_BMC_Dauer_Entladeleistung.StatusText "" TAB_VERB 2 4094 "CM_BMC_Dauer_Entladeleistung_Cxffe_Init" 4095 "CM_BMC_Dauer_Entladeleistung_Cxfff_Fehler" /end COMPU_VTAB
/begin COMPU_TAB CM_BMC_Dauer_Entladeleistung_02 "" TAB_INTP 2 0 0 16250 3250000 /end COMPU_TAB
/begin COMPU_VTAB CM_BMC_Dauer_Entladeleistung_02.StatusText "" TAB_VERB 2 16382 "CM_BMC_Dauer_Entladeleistung_02_Cx3ffe_Init" 16383 "CM_BMC_Dauer_Entladeleistung_02_Cx3fff_Fehler" /end COMPU_VTAB
/begin COMPU_TAB CM_BMC_Dauer_Ladeleistung "" TAB_INTP 2 0 0 4093 818600 /end COMPU_TAB
/begin COMPU_VTAB CM_BMC_Dauer_Ladeleistung.StatusText "" TAB_VERB 2 4094 "CM_BMC_Dauer_Ladeleistung_Cxffe_Init" 4095 "CM_BMC_Dauer_Ladeleistung_Cxfff_Fehler" /end COMPU_VTAB
/begin COMPU_TAB CM_BMC_Dauer_Ladeleistung_02 "" TAB_INTP 2 0 0 16250 3250000 /end COMPU_TAB
/begin COMPU_VTAB CM_BMC_Dauer_Ladeleistung_02.StatusText "" TAB_VERB 2 16382 "CM_BMC_Dauer_Ladeleistung_02_Cx3ffe_Init" 16383 "CM_BMC_Dauer_Ladeleistung_02_Cx3fff_Fehler" /end COMPU_VTAB
/begin COMPU_VTAB CM_BMC_Dev_Freigabe "" TAB_VERB 2 0 "CM_BMC_Dev_Freigabe_Cx0_keine_Freigabe" 1 "CM_BMC_Dev_Freigabe_Cx1_Freigabe" /end COMPU_VTAB
/begin COMPU_TAB CM_BMC_EnergieVorhalt "" TAB_INTP 2 0 0 65532 6553.2000000000007 /end COMPU_TAB
/begin COMPU_VTAB CM_BMC_EnergieVorhalt.StatusText "" TAB_VERB 3 65533 "CM_BMC_EnergieVorhalt_Cxfffd_Funktion_nicht_umgesetzt" 65534 "CM_BMC_EnergieVorhalt_Cxfffe_Init" 65535 "CM_BMC_EnergieVorhalt_Cxffff_Fehler" /end COMPU_VTAB
/begin COMPU_TAB CM_BMC_Energie_Entladen "" TAB_INTP 2 0 0 65533 655.33000000000004 /end COMPU_TAB
/begin COMPU_VTAB CM_BMC_Energie_Entladen.StatusText "" TAB_VERB 2 65534 "CM_BMC_Energie_Entladen_Cxfffe_Init" 65535 "CM_BMC_Energie_Entladen_Cxffff_Fehler" /end COMPU_VTAB
/begin COMPU_TAB CM_BMC_Energie_Laden "" TAB_INTP 2 0 0 65533 655.33000000000004 /end COMPU_TAB
/begin COMPU_VTAB CM_BMC_Energie_Laden.StatusText "" TAB_VERB 2 65534 "CM_BMC_Energie_Laden_Cxfffe_Init" 65535 "CM_BMC_Energie_Laden_Cxffff_Fehler" /end COMPU_VTAB
/begin COMPU_TAB CM_BMC_Energie_Sockel_SoC "" TAB_INTP 2 0 0 1000 100 /end COMPU_TAB
/begin COMPU_VTAB CM_BMC_Energie_Sockel_SoC.StatusText "" TAB_VERB 23 1001 "CM_BMC_Energie_Sockel_SoC_Cx3e9_reserviert" 1002 "CM_BMC_Energie_Sockel_SoC_Cx3ea_reserviert" 1003 "CM_BMC_Energie_Sockel_SoC_Cx3eb_reserviert" 1004 "CM_BMC_Energie_Sockel_SoC_Cx3ec_reserviert" 1005 "CM_BMC_Energie_Sockel_SoC_Cx3ed_reserviert" 1006 "CM_BMC_Energie_Sockel_SoC_Cx3ee_reserviert" 1007 "CM_BMC_Energie_Sockel_SoC_Cx3ef_reserviert" 1008 "CM_BMC_Energie_Sockel_SoC_Cx3f0_reserviert" 1009 "CM_BMC_Energie_Sockel_SoC_Cx3f1_reserviert" 1010 "CM_BMC_Energie_Sockel_SoC_Cx3f2_reserviert" 1011 "CM_BMC_Energie_Sockel_SoC_Cx3f3_reserviert" 1012 "CM_BMC_Energie_Sockel_SoC_Cx3f4_reserviert" 1013 "CM_BMC_Energie_Sockel_SoC_Cx3f5_reserviert" 1014 "CM_BMC_Energie_Sockel_SoC_Cx3f6_reserviert" 1015 "CM_BMC_Energie_Sockel_SoC_Cx3f7_reserviert" 1016 "CM_BMC_Energie_Sockel_SoC_Cx3f8_reserviert" 1017 "CM_BMC_Energie_Sockel_SoC_Cx3f9_reserviert" 1018 "CM_BMC_Energie_Sockel_SoC_Cx3fa_reserviert" 1019 "CM_BMC_Energie_Sockel_SoC_Cx3fb_reserviert" 1020 "CM_BMC_Energie_Sockel_SoC_Cx3fc_reserviert" 1021 "CM_BMC_Energie_Sockel_SoC_Cx3fd_reserviert" 1022 "CM_BMC_Energie_Sockel_SoC_Cx3fe_Init" 1023 "CM_BMC_Energie_Sockel_SoC_Cx3ff_Fehler" /end COMPU_VTAB
/begin COMPU_TAB CM_BMC_Energieinhalt "" TAB_INTP 2 0 0 65533 262132 /end COMPU_TAB
/begin COMPU_VTAB CM_BMC_Energieinhalt.StatusText "" TAB_VERB 2 65534 "CM_BMC_Energieinhalt_Cxfffe_Init" 65535 "CM_BMC_Energieinhalt_Cxffff_Fehler" /end COMPU_VTAB
/begin COMPU_TAB CM_BMC_ExtLadeleistung "" TAB_INTP 2 0 0 65533 3276.6500000000001 /end COMPU_TAB
/begin COMPU_VTAB CM_BMC_ExtLadeleistung.StatusText "" TAB_VERB 2 65534 "CM_BMC_ExtLadeleistung_Cxfffe_Init" 65535 "CM_BMC_ExtLadeleistung_Cxffff_Fehler" /end COMPU_VTAB
/begin COMPU_VTAB CM_BMC_Fehler_Leistungsred "" TAB_VERB 2 0 "CM_BMC_Fehler_Leistungsred_Cx0_kein_Fehler" 1 "CM_BMC_Fehler_Leistungsred_Cx1_Fehler_Leistungsred" /end COMPU_VTAB
/begin COMPU_VTAB CM_BMC_Fehler_Warnung "" TAB_VERB 3 0 "CM_BMC_Fehler_Warnung_Cx0_Keine_Warnung" 1 "CM_BMC_Fehler_Warnung_Cx1_Warnung_ohne_Leistungseinschraenkung" 2 "CM_BMC_Fehler_Warnung_Cx2_Warnung_mit_Leistungseinschraenkung" /end COMPU_VTAB
/begin COMPU_VTAB CM_BMC_Flash_Freigabe "" TAB_VERB 2 0 "CM_BMC_Flash_Freigabe_Cx0_keine_Freigabe" 1 "CM_BMC_Flash_Freigabe_Cx1_Freigabe" /end COMPU_VTAB
/begin COMPU_VTAB CM_BMC_HVK_EoHVL_Status "" TAB_VERB 4 0 "CM_BMC_HVK_EoHVL_Status_Cx0_Init" 1 "CM_BMC_HVK_EoHVL_Status_Cx1_Uzwkr_kleiner_UEoHVL_Schwell" 2 "CM_BMC_HVK_EoHVL_Status_Cx2_Uzwkr_groesgleich_UEoHVL_Schwell" 3 "CM_BMC_HVK_EoHVL_Status_Cx3_Fehler" /end COMPU_VTAB
/begin COMPU_VTAB CM_BMC_HVK_Fehler_HVIL "" TAB_VERB 4 0 "CM_BMC_HVK_Fehler_HVIL_Cx0_HVIL_geschlossen" 1 "CM_BMC_HVK_Fehler_HVIL_Cx1_HVIL_offen" 2 "CM_BMC_HVK_Fehler_HVIL_Cx2_Fehler" 3 "CM_BMC_HVK_Fehler_HVIL_Cx3_Init" /end COMPU_VTAB
/begin COMPU_VTAB CM_BMC_HVK_Fehler_Intern "" TAB_VERB 4 0 "CM_BMC_HVK_Fehler_Intern_Cx0_nicht_aktiv" 1 "CM_BMC_HVK_Fehler_Intern_Cx1_aktiv" 2 "CM_BMC_HVK_Fehler_Intern_Cx2_Fehler" 3 "CM_BMC_HVK_Fehler_Intern_Cx3_Init" /end COMPU_VTAB
/begin COMPU_VTAB CM_BMC_HVK_Fehler_SD "" TAB_VERB 4 0 "CM_BMC_HVK_Fehler_SD_Cx0_SD_gesteckt" 1 "CM_BMC_HVK_Fehler_SD_Cx1_SD_gezogen" 2 "CM_BMC_HVK_Fehler_SD_Cx2_Fehler" 3 "CM_BMC_HVK_Fehler_SD_Cx3_Init" /end COMPU_VTAB
/begin COMPU_TAB CM_BMC_HV_01_BZ "" TAB_INTP 2 0 0 15 15 /end COMPU_TAB
/begin COMPU_TAB CM_BMC_HV_01_CRC "" TAB_INTP 2 0 0 255 255 /end COMPU_TAB
/begin COMPU_TAB CM_BMC_HV_02_BZ "" TAB_INTP 2 0 0 15 15 /end COMPU_TAB
/begin COMPU_TAB CM_BMC_HV_02_CRC "" TAB_INTP 2 0 0 255 255 /end COMPU_TAB
/begin COMPU_TAB CM_BMC_HV_04_BZ "" TAB_INTP 2 0 0 15 15 /end COMPU_TAB
/begin COMPU_TAB CM_BMC_HV_04_CRC "" TAB_INTP 2 0 0 255 255 /end COMPU_TAB
/begin COMPU_VTAB CM_BMC_IWU_Status "" TAB_VERB 7 0 "CM_BMC_IWU_Status_Cx0_Init" 1 "CM_BMC_IWU_Status_Cx1_IWU_defekt" 2 "CM_BMC_IWU_Status_Cx2_kein_Messwert" 3 "CM_BMC_IWU_Status_Cx3_ISO_Messung_aktiv" 4 "CM_BMC_IWU_Status_Cx4_Deaktiviert" 5 "CM_BMC_IWU_Status_Cx5_ISO_Messung_abgeschlossen" 6 "CM_BMC_IWU_Status_Cx6_ISO_Messung_extern" /end COMPU_VTAB
/begin COMPU_TAB CM_BMC_IWU_Wert_neg "" TAB_INTP 2 0 0 65532 6553200 /end COMPU_TAB
/begin COMPU_VTAB CM_BMC_IWU_Wert_neg.StatusText "" TAB_VERB 3 65533 "CM_BMC_IWU_Wert_neg_Cxfffd_kein_Messwert" 65534 "CM_BMC_IWU_Wert_neg_Cxfffe_Init" 65535 "CM_BMC_IWU_Wert_neg_Cxffff_Fehler" /end COMPU_VTAB
/begin COMPU_TAB CM_BMC_IWU_Wert_pos "" TAB_INTP 2 0 0 65532 6553200 /end COMPU_TAB
/begin COMPU_VTAB CM_BMC_IWU_Wert_pos.StatusText "" TAB_VERB 3 65533 "CM_BMC_IWU_Wert_pos_Cxfffd_kein_Messwert" 65534 "CM_BMC_IWU_Wert_pos_Cxfffe_Init" 65535 "CM_BMC_IWU_Wert_pos_Cxffff_Fehler" /end COMPU_VTAB
/begin COMPU_VTAB CM_BMC_Iso_Mode_Anf "" TAB_VERB 8 0 "CM_BMC_Iso_Mode_Anf_Cx0_Init" 1 "CM_BMC_Iso_Mode_Anf_Cx1_zyklisch_Zeit1" 2 "CM_BMC_Iso_Mode_Anf_Cx2_zyklisch_Zeit2" 3 "CM_BMC_Iso_Mode_Anf_Cx3_zyklisch_Zeit3" 4 "CM_BMC_Iso_Mode_Anf_Cx4_Pause" 5 "CM_BMC_Iso_Mode_Anf_Cx5_Einzelmessung" 6 "CM_BMC_Iso_Mode_Anf_Cx6_Schnellmessung" 7 "CM_BMC_Iso_Mode_Anf_Cx7_Aus" /end COMPU_VTAB
/begin COMPU_TAB CM_BMC_IstTemperaturMax_Modul_ID "" TAB_INTP 2 1 1 254 254 /end COMPU_TAB
/begin COMPU_VTAB CM_BMC_IstTemperaturMax_Modul_ID.StatusText "" TAB_VERB 1 255 "CM_BMC_IstTemperaturMax_Modul_ID_Cxff_Init" /end COMPU_VTAB
/begin COMPU_TAB CM_BMC_IstTemperaturMax_Sensor_ID "" TAB_INTP 2 1 1 30 30 /end COMPU_TAB
/begin COMPU_VTAB CM_BMC_IstTemperaturMax_Sensor_ID.StatusText "" TAB_VERB 1 31 "CM_BMC_IstTemperaturMax_Sensor_ID_Cx1f_Init" /end COMPU_VTAB
/begin COMPU_TAB CM_BMC_IstTemperaturMin_Modul_ID "" TAB_INTP 2 1 1 254 254 /end COMPU_TAB
/begin COMPU_VTAB CM_BMC_IstTemperaturMin_Modul_ID.StatusText "" TAB_VERB 1 255 "CM_BMC_IstTemperaturMin_Modul_ID_Cxff_Init" /end COMPU_VTAB
/begin COMPU_TAB CM_BMC_IstTemperaturMin_Sensor_ID "" TAB_INTP 2 1 1 30 30 /end COMPU_TAB
/begin COMPU_VTAB CM_BMC_IstTemperaturMin_Sensor_ID.StatusText "" TAB_VERB 1 31 "CM_BMC_IstTemperaturMin_Sensor_ID_Cx1f_Init" /end COMPU_VTAB
/begin COMPU_TAB CM_BMC_IstZellSpannungMax_Modul_ID "" TAB_INTP 2 1 1 254 254 /end COMPU_TAB
/begin COMPU_VTAB CM_BMC_IstZellSpannungMax_Modul_ID.StatusText "" TAB_VERB 1 255 "CM_BMC_IstZellSpannungMax_Modul_ID_Cxff_Init" /end COMPU_VTAB
/begin COMPU_TAB CM_BMC_IstZellSpannungMax_Zell_ID "" TAB_INTP 2 1 1 254 254 /end COMPU_TAB
/begin COMPU_VTAB CM_BMC_IstZellSpannungMax_Zell_ID.StatusText "" TAB_VERB 1 255 "CM_BMC_IstZellSpannungMax_Zell_ID_Cxff_Init" /end COMPU_VTAB
/begin COMPU_TAB CM_BMC_IstZellSpannungMin_Modul_ID "" TAB_INTP 2 1 1 254 254 /end COMPU_TAB
/begin COMPU_VTAB CM_BMC_IstZellSpannungMin_Modul_ID.StatusText "" TAB_VERB 1 255 "CM_BMC_IstZellSpannungMin_Modul_ID_Cxff_Init" /end COMPU_VTAB
/begin COMPU_TAB CM_BMC_IstZellSpannungMin_Zell_ID "" TAB_INTP 2 1 1 254 254 /end COMPU_TAB
/begin COMPU_VTAB CM_BMC_IstZellSpannungMin_Zell_ID.StatusText "" TAB_VERB 1 255 "CM_BMC_IstZellSpannungMin_Zell_ID_Cxff_Init" /end COMPU_VTAB
/begin COMPU_TAB CM_BMC_IstZellspannungMax "" TAB_INTP 2 0 1000 4091 5091 /end COMPU_TAB
/begin COMPU_VTAB CM_BMC_IstZellspannungMax.StatusText "" TAB_VERB 4 4092 "CM_BMC_IstZellspannungMax_Cxffc_kleiner_1V" 4093 "CM_BMC_IstZellspannungMax_Cxffd_reserviert" 4094 "CM_BMC_IstZellspannungMax_Cxffe_Init" 4095 "CM_BMC_IstZellspannungMax_Cxfff_Fehler" /end COMPU_VTAB
/begin COMPU_TAB CM_BMC_IstZellspannungMin "" TAB_INTP 2 0 1000 4091 5091 /end COMPU_TAB
/begin COMPU_VTAB CM_BMC_IstZellspannungMin.StatusText "" TAB_VERB 4 4092 "CM_BMC_IstZellspannungMin_Cxffc_kleiner_1V" 4093 "CM_BMC_IstZellspannungMin_Cxffd_reserviert" 4094 "CM_BMC_IstZellspannungMin_Cxffe_Init" 4095 "CM_BMC_IstZellspannungMin_Cxfff_Fehler" /end COMPU_VTAB
/begin COMPU_TAB CM_BMC_Lebensdauer_Trennelemente "" TAB_INTP 2 0 0 100000 100000 /end COMPU_TAB
/begin COMPU_VTAB CM_BMC_Lebensdauer_Trennelemente.StatusText "" TAB_VERB 2 131070 "CM_BMC_Lebensdauer_Trennelemente_Cx1fffe_InitWert" 131071 "CM_BMC_Lebensdauer_Trennelemente_Cx1ffff_Fehler" /end COMPU_VTAB
/begin COMPU_TAB CM_BMC_Leerlaufspannung "" TAB_INTP 2 0 0 1021 1021 /end COMPU_TAB
/begin COMPU_VTAB CM_BMC_Leerlaufspannung.StatusText "" TAB_VERB 2 1022 "CM_BMC_Leerlaufspannung_Cx3fe_Init" 1023 "CM_BMC_Leerlaufspannung_Cx3ff_Fehler" /end COMPU_VTAB
/begin COMPU_VTAB CM_BMC_MMTR_Status "" TAB_VERB 9 0 "CM_BMC_MMTR_Status_Cx0_Nicht_verfuegbar" 1 "CM_BMC_MMTR_Status_Cx1_Inaktiv" 2 "CM_BMC_MMTR_Status_Cx2_Aktiv_Vorkonditionierung" 3 "CM_BMC_MMTR_Status_Cx3_Aktiv_TrackSession" 4 "CM_BMC_MMTR_Status_Cx4_Nicht_verfuegbar_Lebensdauertimer" 5 "CM_BMC_MMTR_Status_Cx5_Abgeschlossen_Vorkonditionierung" 6 "CM_BMC_MMTR_Status_Cx6_Aktiv_Rueckkehrstrategie" 14 "CM_BMC_MMTR_Status_Cxe_Init" 15 "CM_BMC_MMTR_Status_Cxf_Fehler" /end COMPU_VTAB
/begin COMPU_TAB CM_BMC_MaxEnergieinhalt "" TAB_INTP 2 0 0 65533 262132 /end COMPU_TAB
/begin COMPU_VTAB CM_BMC_MaxEnergieinhalt.StatusText "" TAB_VERB 2 65534 "CM_BMC_MaxEnergieinhalt_Cxfffe_Init" 65535 "CM_BMC_MaxEnergieinhalt_Cxffff_Fehler" /end COMPU_VTAB
/begin COMPU_TAB CM_BMC_Max_Entladeleistung "" TAB_INTP 2 0 0 8189 818900 /end COMPU_TAB
/begin COMPU_VTAB CM_BMC_Max_Entladeleistung.StatusText "" TAB_VERB 2 8190 "CM_BMC_Max_Entladeleistung_Cx1ffe_Init" 8191 "CM_BMC_Max_Entladeleistung_Cx1fff_Fehler" /end COMPU_VTAB
/begin COMPU_TAB CM_BMC_Max_Entladeleistung_02 "" TAB_INTP 2 0 0 32500 3250000 /end COMPU_TAB
/begin COMPU_VTAB CM_BMC_Max_Entladeleistung_02.StatusText "" TAB_VERB 2 32766 "CM_BMC_Max_Entladeleistung_02_Cx7ffe_Init" 32767 "CM_BMC_Max_Entladeleistung_02_Cx7fff_Fehler" /end COMPU_VTAB
/begin COMPU_TAB CM_BMC_Max_Entladestrom "" TAB_INTP 2 0 0 8189 1637.8000000000002 /end COMPU_TAB
/begin COMPU_VTAB CM_BMC_Max_Entladestrom.StatusText "" TAB_VERB 2 8190 "CM_BMC_Max_Entladestrom_Cx1ffe_Init" 8191 "CM_BMC_Max_Entladestrom_Cx1fff_Fehler" /end COMPU_VTAB
/begin COMPU_TAB CM_BMC_Max_Entladestrom_02 "" TAB_INTP 2 0 0 16250 3250 /end COMPU_TAB
/begin COMPU_VTAB CM_BMC_Max_Entladestrom_02.StatusText "" TAB_VERB 2 16382 "CM_BMC_Max_Entladestrom_02_Cx3ffe_Init" 16383 "CM_BMC_Max_Entladestrom_02_Cx3fff_Fehler" /end COMPU_VTAB
/begin COMPU_TAB CM_BMC_Max_Ladeleistung "" TAB_INTP 2 0 0 8189 818900 /end COMPU_TAB
/begin COMPU_VTAB CM_BMC_Max_Ladeleistung.StatusText "" TAB_VERB 2 8190 "CM_BMC_Max_Ladeleistung_Cx1ffe_Init" 8191 "CM_BMC_Max_Ladeleistung_Cx1fff_Fehler" /end COMPU_VTAB
/begin COMPU_TAB CM_BMC_Max_Ladeleistung_02 "" TAB_INTP 2 0 0 32500 3250000 /end COMPU_TAB
/begin COMPU_VTAB CM_BMC_Max_Ladeleistung_02.StatusText "" TAB_VERB 2 32766 "CM_BMC_Max_Ladeleistung_02_Cx7ffe_Init" 32767 "CM_BMC_Max_Ladeleistung_02_Cx7fff_Fehler" /end COMPU_VTAB
/begin COMPU_VTAB ComM_ChannelIdxOfPncSignalType "" TAB_VERB 1 255 "COMM_NO_CHANNELIDXOFPNCSIGNAL" /end COMPU_VTAB
/begin COMPU_VTAB_RANGE ComM_ComAllowedType "" 2 0 0 "FALSE" 1 255 "TRUE" /end COMPU_VTAB_RANGE
/begin COMPU_VTAB_RANGE ComM_DcmRequestActiveType "" 2 0 0 "FALSE" 1 255 "TRUE" /end COMPU_VTAB_RANGE
/begin COMPU_VTAB ComM_PncChannelMappingEndIdxOfPncPbType "" TAB_VERB 1 255 "COMM_NO_PNCCHANNELMAPPINGENDIDXOFPNCPB" /end COMPU_VTAB
/begin COMPU_VTAB ComM_PncChannelMappingStartIdxOfPncPbType "" TAB_VERB 1 255 "COMM_NO_PNCCHANNELMAPPINGSTARTIDXOFPNCPB" /end COMPU_VTAB
/begin COMPU_VTAB ComM_PncPbIndEndIdxOfChannelPbType "" TAB_VERB 1 255 "COMM_NO_PNCPBINDENDIDXOFCHANNELPB" /end COMPU_VTAB
/begin COMPU_VTAB ComM_PncPbIndStartIdxOfChannelPbType "" TAB_VERB 1 255 "COMM_NO_PNCPBINDSTARTIDXOFCHANNELPB" /end COMPU_VTAB
/begin COMPU_VTAB ComM_PncSignalIndEndIdxOfPncPbType "" TAB_VERB 1 255 "COMM_NO_PNCSIGNALINDENDIDXOFPNCPB" /end COMPU_VTAB
/begin COMPU_VTAB ComM_PncSignalIndStartIdxOfPncPbType "" TAB_VERB 1 255 "COMM_NO_PNCSIGNALINDSTARTIDXOFPNCPB" /end COMPU_VTAB
/begin COMPU_VTAB ComM_PncSignalValuesEndIdxOfPncSignalType "" TAB_VERB 1 255 "COMM_NO_PNCSIGNALVALUESENDIDXOFPNCSIGNAL" /end COMPU_VTAB
/begin COMPU_VTAB ComM_PncSignalValuesStartIdxOfPncSignalType "" TAB_VERB 1 255 "COMM_NO_PNCSIGNALVALUESSTARTIDXOFPNCSIGNAL" /end COMPU_VTAB
/begin COMPU_VTAB_RANGE ComM_PostInitializedType "" 2 0 0 "FALSE" 1 255 "TRUE" /end COMPU_VTAB_RANGE
/begin COMPU_VTAB ComM_TypeOfPncSignalType "" TAB_VERB 2 0 "COMM_EIRA_RX_TYPEOFPNCSIGNAL" 1 "COMM_EIRA_TX_TYPEOFPNCSIGNAL" /end COMPU_VTAB
/begin COMPU_VTAB ComM_UserReqFullComEndIdxOfChannelPbType "" TAB_VERB 1 255 "COMM_NO_USERREQFULLCOMENDIDXOFCHANNELPB" /end COMPU_VTAB
/begin COMPU_VTAB ComM_UserReqFullComStartIdxOfChannelPbType "" TAB_VERB 1 255 "COMM_NO_USERREQFULLCOMSTARTIDXOFCHANNELPB" /end COMPU_VTAB
/begin COMPU_VTAB Com_ApplTypeOfTxSigInfoType "" TAB_VERB 4 0 "COM_UINT8_APPLTYPEOFTXSIGINFO" 2 "COM_UINT16_APPLTYPEOFTXSIGINFO" 4 "COM_UINT32_APPLTYPEOFTXSIGINFO" 8 "COM_UINT8_N_APPLTYPEOFTXSIGINFO" /end COMPU_VTAB
/begin COMPU_VTAB Com_BusAccOfTxSigInfoType "" TAB_VERB 5 0 "COM_NBIT_BUSACCOFTXSIGINFO" 1 "COM_BYTE_BUSACCOFTXSIGINFO" 2 "COM_NBYTE_BUSACCOFTXSIGINFO" 4 "COM_NBITNBYTE_BUSACCOFTXSIGINFO" 6 "COM_ARRAY_BASED_BUSACCOFTXSIGINFO" /end COMPU_VTAB
/begin COMPU_VTAB Com_CbkTxTOutFuncPtrIndStartIdxOfTxTOutInfoType "" TAB_VERB 1 255 "COM_NO_CBKTXTOUTFUNCPTRINDSTARTIDXOFTXTOUTINFO" /end COMPU_VTAB
/begin COMPU_VTAB_RANGE Com_DynSignalOfTxSigInfoType "" 2 0 0 "FALSE" 1 255 "TRUE" /end COMPU_VTAB_RANGE
/begin COMPU_VTAB Com_FilterInitValueIdxOfTxSigInfoType "" TAB_VERB 1 255 "COM_NO_FILTERINITVALUEIDXOFTXSIGINFO" /end COMPU_VTAB
/begin COMPU_VTAB Com_FilterInitValueOfTxSigInfoType "" TAB_VERB 3 0 "COM_TXFILTERINITVALUEUINT8_FILTERINITVALUEOFTXSIGINFO" 1 "COM_TXFILTERINITVALUEUINT16_FILTERINITVALUEOFTXSIGINFO" 255 "COM_NO_FILTERINITVALUEOFTXSIGINFO" /end COMPU_VTAB
/begin COMPU_VTAB Com_InvValueIdxOfTxSigInfoType "" TAB_VERB 1 255 "COM_NO_INVVALUEIDXOFTXSIGINFO" /end COMPU_VTAB
/begin COMPU_VTAB Com_InvValueOfTxSigInfoType "" TAB_VERB 4 0 "COM_CONSTVALUEUINT8_INVVALUEOFTXSIGINFO" 1 "COM_CONSTVALUEUINT16_INVVALUEOFTXSIGINFO" 2 "COM_CONSTVALUEUINT32_INVVALUEOFTXSIGINFO" 255 "COM_NO_INVVALUEOFTXSIGINFO" /end COMPU_VTAB
/begin COMPU_VTAB Com_OnChangeIdxOfTxSigInfoType "" TAB_VERB 1 255 "COM_NO_ONCHANGEIDXOFTXSIGINFO" /end COMPU_VTAB
/begin COMPU_VTAB Com_OnChangeOfTxSigInfoType "" TAB_VERB 4 0 "COM_FILTERINFO_UINT8_ONCHANGEOFTXSIGINFO" 2 "COM_FILTERINFO_UINT16_ONCHANGEOFTXSIGINFO" 10 "COM_FILTERINFO_UINT8_N_ONCHANGEOFTXSIGINFO" 255 "COM_NO_ONCHANGEOFTXSIGINFO" /end COMPU_VTAB
/begin COMPU_VTAB Com_TxBufferEndIdxOfTxSigInfoType "" TAB_VERB 1 65535 "COM_NO_TXBUFFERENDIDXOFTXSIGINFO" /end COMPU_VTAB
/begin COMPU_VTAB Com_TxBufferStartIdxOfTxSigInfoType "" TAB_VERB 1 65535 "COM_NO_TXBUFFERSTARTIDXOFTXSIGINFO" /end COMPU_VTAB
/begin COMPU_VTAB Com_TxFilterInitValueArrayBasedFilterInitValueEndIdxOfTxSigInfoType "" TAB_VERB 1 255 "COM_NO_TXFILTERINITVALUEARRAYBASEDFILTERINITVALUEENDIDXOFTXSIGINFO" /end COMPU_VTAB
/begin COMPU_VTAB Com_TxFilterInitValueArrayBasedFilterInitValueStartIdxOfTxSigInfoType "" TAB_VERB 1 255 "COM_NO_TXFILTERINITVALUEARRAYBASEDFILTERINITVALUESTARTIDXOFTXSIGINFO" /end COMPU_VTAB
/begin COMPU_VTAB CompuMethod_ComM_BusSMModeType_Values "" TAB_VERB 3 0 "COMM_NO_COMMUNICATION" 1 "COMM_SILENT_COMMUNICATION" 2 "COMM_FULL_COMMUNICATION" /end COMPU_VTAB
/begin COMPU_VTAB CompuMethod_ComM_ComModeType_Values "" TAB_VERB 5 0 "COMM_NO_COM_NO_PENDING_REQUEST" 1 "COMM_NO_COM_REQUEST_PENDING" 2 "COMM_FULL_COM_NETWORK_REQUESTED" 3 "COMM_FULL_COM_READY_SLEEP" 4 "COMM_SILENT_COM" /end COMPU_VTAB
/begin GROUP Com ""
 /begin REF_MEASUREMENT Com_TxSigInfo[92].BitLengthOfTxSigInfo Com_TxSigInfo[92].BitPositionOfTxSigInfo Com_TxSigInfo[92].BusAccOfTxSigInfo Com_TxSigInfo[92].ByteLengthOfTxSigInfo Com_TxSigInfo[92].DynSignalOfTxSigInfo Com_TxSigInfo[92].FilterInitValueIdxOfTxSigInfo Com_TxSigInfo[92].FilterInitValueOfTxSigInfo Com_TxSigInfo[92].InvValueIdxOfTxSigInfo Com_TxSigInfo[92].InvValueOfTxSigInfo Com_TxSigInfo[92].OnChangeIdxOfTxSigInfo Com_TxSigInfo[92].OnChangeOfTxSigInfo Com_TxSigInfo[92].StartByteInPduPositionOfTxSigInfo Com_TxSigInfo[92].TxAccessInfoIdxOfTxSigInfo Com_TxSigInfo[92].TxBufferEndIdxOfTxSigInfo Com_TxSigInfo[92].TxBufferStartIdxOfTxSigInfo Com_TxSigInfo[92].TxFilterInitValueArrayBasedFilterInitValueEndIdxOfTxSigInfo Com_TxSigInfo[92].TxFilterInitValueArrayBasedFilterInitValueStartIdxOfTxSigInfo Com_TxSigInfo[92].TxPduInfoIdxOfTxSigInfo Com_TxSigInfo[93].ApplTypeOfTxSigInfo Com_TxSigInfo[93].BitLengthOfTxSigInfo Com_TxSigInfo[93].BitPositionOfTxSigInfo Com_TxSigInfo[93].BusAccOfTxSigInfo Com_TxSigInfo[93].ByteLengthOfTxSigInfo Com_TxSigInfo[93].DynSignalOfTxSigInfo Com_TxSigInfo[93].FilterInitValueIdxOfTxSigInfo Com_TxSigInfo[93].FilterInitValueOfTxSigInfo Com_TxSigInfo[93].InvValueIdxOfTxSigInfo Com_TxSigInfo[93].InvValueOfTxSigInfo Com_TxSigInfo[93].OnChangeIdxOfTxSigInfo Com_TxSigInfo[93].OnChangeOfTxSigInfo Com_TxSigInfo[93].StartByteInPduPositionOfTxSigInfo Com_TxSigInfo[93].TxAccessInfoIdxOfTxSigInfo Com_TxSigInfo[93].TxBufferEndIdxOfTxSigInfo Com_TxSigInfo[93].TxBufferStartIdxOfTxSigInfo Com_TxSigInfo[93].TxFilterInitValueArrayBasedFilterInitValueEndIdxOfTxSigInfo Com_TxSigInfo[93].TxFilterInitValueArrayBasedFilterInitValueStartIdxOfTxSigInfo Com_TxSigInfo[93].TxPduInfoIdxOfTxSigInfo Com_TxSigInfo[94].ApplTypeOfTxSigInfo Com_TxSigInfo[94].BitLengthOfTxSigInfo Com_TxSigInfo[94].BitPositionOfTxSigInfo Com_TxSigInfo[94].BusAccOfTxSigInfo Com_TxSigInfo[94].ByteLengthOfTxSigInfo Com_TxSigInfo[94].DynSignalOfTxSigInfo Com_TxSigInfo[94].FilterInitValueIdxOfTxSigInfo Com_TxSigInfo[94].FilterInitValueOfTxSigInfo Com_TxSigInfo[94].InvValueIdxOfTxSigInfo Com_TxSigInfo[94].InvValueOfTxSigInfo Com_TxSigInfo[94].OnChangeIdxOfTxSigInfo Com_TxSigInfo[94].OnChangeOfTxSigInfo Com_TxSigInfo[94].StartByteInPduPositionOfTxSigInfo Com_TxSigInfo[94].TxAccessInfoIdxOfTxSigInfo Com_TxSigInfo[94].TxBufferEndIdxOfTxSigInfo Com_TxSigInfo[94].TxBufferStartIdxOfTxSigInfo Com_TxSigInfo[94].TxFilterInitValueArrayBasedFilterInitValueEndIdxOfTxSigInfo Com_TxSigInfo[94].TxFilterInitValueArrayBasedFilterInitValueStartIdxOfTxSigInfo Com_TxSigInfo[94].TxPduInfoIdxOfTxSigInfo Com_TxSigInfo[95].ApplTypeOfTxSigInfo Com_TxSigInfo[95].BitLengthOfTxSigInfo Com_TxSigInfo[95].BitPositionOfTxSigInfo Com_TxSigInfo[95].BusAccOfTxSigInfo Com_TxSigInfo[95].ByteLengthOfTxSigInfo Com_TxSigInfo[95].DynSignalOfTxSigInfo Com_TxSigInfo[95].FilterInitValueIdxOfTxSigInfo Com_TxSigInfo[95].FilterInitValueOfTxSigInfo Com_TxSigInfo[95].InvValueIdxOfTxSigInfo Com_TxSigInfo[95].InvValueOfTxSigInfo Com_TxSigInfo[95].OnChangeIdxOfTxSigInfo Com_TxSigInfo[95].OnChangeOfTxSigInfo Com_TxSigInfo[95].StartByteInPduPositionOfTxSigInfo Com_TxSigInfo[95].TxAccessInfoIdxOfTxSigInfo Com_TxSigInfo[95].TxBufferEndIdxOfTxSigInfo Com_TxSigInfo[95].TxBufferStartIdxOfTxSigInfo Com_TxSigInfo[95].TxFilterInitValueArrayBasedFilterInitValueEndIdxOfTxSigInfo Com_TxSigInfo[95].TxFilterInitValueArrayBasedFilterInitValueStartIdxOfTxSigInfo Com_TxSigInfo[95].TxPduInfoIdxOfTxSigInfo Com_TxSigInfo[96].ApplTypeOfTxSigInfo Com_TxSigInfo[96].BitLengthOfTxSigInfo Com_TxSigInfo[96].BitPositionOfTxSigInfo Com_TxSigInfo[96].BusAccOfTxSigInfo Com_TxSigInfo[96].ByteLengthOfTxSigInfo Com_TxSigInfo[96].DynSignalOfTxSigInfo Com_TxSigInfo[96].FilterInitValueIdxOfTxSigInfo Com_TxSigInfo[96].FilterInitValueOfTxSigInfo Com_TxSigInfo[96].InvValueIdxOfTxSigInfo Com_TxSigInfo[96].InvValueOfTxSigInfo Com_TxSigInfo[96].OnChangeIdxOfTxSigInfo Com_TxSigInfo[96].OnChangeOfTxSigInfo Com_TxSigInfo[96].StartByteInPduPositionOfTxSigInfo Com_TxSigInfo[96].TxAccessInfoIdxOfTxSigInfo Com_TxSigInfo[96].TxBufferEndIdxOfTxSigInfo Com_TxSigInfo[96].TxBufferStartIdxOfTxSigInfo Com_TxSigInfo[96].TxFilterInitValueArrayBasedFilterInitValueEndIdxOfTxSigInfo Com_TxSigInfo[96].TxFilterInitValueArrayBasedFilterInitValueStartIdxOfTxSigInfo Com_TxSigInfo[96].TxPduInfoIdxOfTxSigInfo Com_TxSigInfo[97].ApplTypeOfTxSigInfo Com_TxSigInfo[97].BitLengthOfTxSigInfo Com_TxSigInfo[97].BitPositionOfTxSigInfo Com_TxSigInfo[97].BusAccOfTxSigInfo Com_TxSigInfo[97].ByteLengthOfTxSigInfo Com_TxSigInfo[97].DynSignalOfTxSigInfo Com_TxSigInfo[97].FilterInitValueIdxOfTxSigInfo Com_TxSigInfo[97].FilterInitValueOfTxSigInfo Com_TxSigInfo[97].InvValueIdxOfTxSigInfo Com_TxSigInfo[97].InvValueOfTxSigInfo Com_TxSigInfo[97].OnChangeIdxOfTxSigInfo Com_TxSigInfo[97].OnChangeOfTxSigInfo Com_TxSigInfo[97].StartByteInPduPositionOfTxSigInfo Com_TxSigInfo[97].TxAccessInfoIdxOfTxSigInfo Com_TxSigInfo[97].TxBufferEndIdxOfTxSigInfo Com_TxSigInfo[97].TxBufferStartIdxOfTxSigInfo Com_TxSigInfo[97].TxFilterInitValueArrayBasedFilterInitValueEndIdxOfTxSigInfo Com_TxSigInfo[97].TxFilterInitValueArrayBasedFilterInitValueStartIdxOfTxSigInfo Com_TxSigInfo[97].TxPduInfoIdxOfTxSigInfo Com_TxSigInfo[98].ApplTypeOfTxSigInfo Com_TxSigInfo[98].BitLengthOfTxSigInfo Com_TxSigInfo[98].BitPositionOfTxSigInfo Com_TxSigInfo[98].BusAccOfTxSigInfo Com_TxSigInfo[98].ByteLengthOfTxSigInfo Com_TxSigInfo[98].DynSignalOfTxSigInfo Com_TxSigInfo[98].FilterInitValueIdxOfTxSigInfo Com_TxSigInfo[98].FilterInitValueOfTxSigInfo Com_TxSigInfo[98].InvValueIdxOfTxSigInfo Com_TxSigInfo[98].InvValueOfTxSigInfo Com_TxSigInfo[98].OnChangeIdxOfTxSigInfo Com_TxSigInfo[98].OnChangeOfTxSigInfo Com_TxSigInfo[98].StartByteInPduPositionOfTxSigInfo Com_TxSigInfo[98].TxAccessInfoIdxOfTxSigInfo Com_TxSigInfo[98].TxBufferEndIdxOfTxSigInfo Com_TxSigInfo[98].TxBufferStartIdxOfTxSigInfo Com_TxSigInfo[98].TxFilterInitValueArrayBasedFilterInitValueEndIdxOfTxSigInfo Com_TxSigInfo[98].TxFilterInitValueArrayBasedFilterInitValueStartIdxOfTxSigInfo Com_TxSigInfo[98].TxPduInfoIdxOfTxSigInfo Com_TxSigInfo[99].ApplTypeOfTxSigInfo Com_TxSigInfo[99].BitLengthOfTxSigInfo Com_TxSigInfo[99].BitPositionOfTxSigInfo Com_TxSigInfo[99].BusAccOfTxSigInfo Com_TxSigInfo[99].ByteLengthOfTxSigInfo Com_TxSigInfo[99].DynSignalOfTxSigInfo Com_TxSigInfo[99].FilterInitValueIdxOfTxSigInfo Com_TxSigInfo[99].FilterInitValueOfTxSigInfo Com_TxSigInfo[99].InvValueIdxOfTxSigInfo Com_TxSigInfo[99].InvValueOfTxSigInfo Com_TxSigInfo[99].OnChangeIdxOfTxSigInfo Com_TxSigInfo[99].OnChangeOfTxSigInfo Com_TxSigInfo[99].StartByteInPduPositionOfTxSigInfo Com_TxSigInfo[99].TxAccessInfoIdxOfTxSigInfo Com_TxSigInfo[99].TxBufferEndIdxOfTxSigInfo Com_TxSigInfo[99].TxBufferStartIdxOfTxSigInfo Com_TxSigInfo[99].TxFilterInitValueArrayBasedFilterInitValueEndIdxOfTxSigInfo Com_TxSigInfo[99].TxFilterInitValueArrayBasedFilterInitValueStartIdxOfTxSigInfo Com_TxSigInfo[99].TxPduInfoIdxOfTxSigInfo Com_TxSigInfo[9].ApplTypeOfTxSigInfo Com_TxSigInfo[9].BitLengthOfTxSigInfo Com_TxSigInfo[9].BitPositionOfTxSigInfo Com_TxSigInfo[9].BusAccOfTxSigInfo Com_TxSigInfo[9].ByteLengthOfTxSigInfo Com_TxSigInfo[9].DynSignalOfTxSigInfo Com_TxSigInfo[9].FilterInitValueIdxOfTxSigInfo Com_TxSigInfo[9].FilterInitValueOfTxSigInfo Com_TxSigInfo[9].InvValueIdxOfTxSigInfo Com_TxSigInfo[9].InvValueOfTxSigInfo Com_TxSigInfo[9].OnChangeIdxOfTxSigInfo Com_TxSigInfo[9].OnChangeOfTxSigInfo Com_TxSigInfo[9].StartByteInPduPositionOfTxSigInfo Com_TxSigInfo[9].TxAccessInfoIdxOfTxSigInfo Com_TxSigInfo[9].TxBufferEndIdxOfTxSigInfo Com_TxSigInfo[9].TxBufferStartIdxOfTxSigInfo Com_TxSigInfo[9].TxFilterInitValueArrayBasedFilterInitValueEndIdxOfTxSigInfo Com_TxSigInfo[9].TxFilterInitValueArrayBasedFilterInitValueStartIdxOfTxSigInfo Com_TxSigInfo[9].TxPduInfoIdxOfTxSigInfo Com_TxTOutCnt Com_TxTOutInfo[0].CbkTxTOutFuncPtrIndStartIdxOfTxTOutInfo /end REF_MEASUREMENT
/end GROUP
/begin GROUP ComM ""
 /begin REF_MEASUREMENT ComM_ActiveComMode ComM_BusComModeReq ComM_BusSmState ComM_ChannelPb[0].PncPbIndEndIdxOfChannelPb ComM_ChannelPb[0].PncPbIndStartIdxOfChannelPb ComM_ChannelPb[0].UserReqFullComEndIdxOfChannelPb ComM_ChannelPb[0].UserReqFullComStartIdxOfChannelPb ComM_ChannelPb[1].PncPbIndEndIdxOfChannelPb ComM_ChannelPb[1].PncPbIndStartIdxOfChannelPb ComM_ChannelPb[1].UserReqFullComEndIdxOfChannelPb ComM_ChannelPb[1].UserReqFullComStartIdxOfChannelPb ComM_ComAllowed ComM_ComAllowed_ComMChannel_0 ComM_ComAllowed_ComMChannel_1 ComM_DcmRequestActive ComM_DcmRequestActive_ComMChannel_0 ComM_DcmRequestActive_ComMChannel_1 ComM_FullComRequesters ComM_PartitionIdentifiers[0].PCPartitionConfigIdxOfPartitionIdentifiers ComM_PartitionIdentifiers[0].PartitionSNVOfPartitionIdentifiers ComM_PncPSleepTimer ComM_PncPSleepTimer_PNC_01_CarWakeUp_d7102746 ComM_PncPSleepTimer_PNC_02_Basefunction_Powertrain_6b6ac64e ComM_PncPSleepTimer_PNC_03_Basefunction_Chassis_a155dfc3 ComM_PncPSleepTimer_PNC_04_Basefunction_DrivingAssistance_f26b19b4 ComM_PncPSleepTimer_PNC_05_Basefunction_Infotainment_f043623b ComM_PncPSleepTimer_PNC_06_Basefunction_ComfortLight_d2d0a736 ComM_PncPSleepTimer_PNC_07_Basefunction_CrossSection_7b625db2 ComM_PncPSleepTimer_PNC_08_Basefunction_Connectivity_56f2bd6b ComM_PncPSleepTimer_PNC_10_Powertrain_b3959ad4 ComM_PncPSleepTimer_PNC_11_Chassis_dce36bbc ComM_PncPSleepTimer_PNC_12_GearSelector_9f4a754a ComM_PncPSleepTimer_PNC_13_Airbag_727cecad ComM_PncPSleepTimer_PNC_14_InfotainmentExtensions_ca9cb1f5 ComM_PncPSleepTimer_PNC_15_InstrumentclusterDisplay_afd3c636 ComM_PncPSleepTimer_PNC_16_InfotainmentDisplay_e8d84b12 ComM_PncPSleepTimer_PNC_17_Audio_8cbcad43 ComM_PncPSleepTimer_PNC_18_VirtualSideMirrors_5814f436 ComM_PncPSleepTimer_PNC_19_Doors_Hatches_6a90831c ComM_PncPSleepTimer_PNC_20_OptionalComfort_769509a7 ComM_PncPSleepTimer_PNC_21_AirSuspension_32658f46 ComM_PncPSleepTimer_PNC_22_ExteriorLights_ee477910 ComM_PncPSleepTimer_PNC_23_Climate_ab0b2697 ComM_PncPSleepTimer_PNC_24_ThermoManagement_4f639819 ComM_PncPSleepTimer_PNC_25_AccessSystemSensors_0f593a4b ComM_PncPSleepTimer_PNC_26_HighVoltage_Charging_24d89ab8 ComM_PncPSleepTimer_PNC_27_Timemaster_Timer_8da5bb27 ComM_PncPSleepTimer_PNC_28_OnboardTester_DataCollector_1afa9561 ComM_PncPSleepTimer_PNC_29_SteeringColumnLock_af7c21af ComM_PncPSleepTimer_PNC_30_EnergyManagement_9072504c ComM_PncPSleepTimer_PNC_31_MultifunctionalSteeringWheel_4e0a8e7c ComM_PncPSleepTimer_PNC_32_OnlineAccess_91b6041d ComM_PncPSleepTimer_PNC_33_ExternalWirelessCommunication_85f99735 ComM_PncPSleepTimer_PNC_34_GPS_Lokalization_74821ca8 ComM_PncPSleepTimer_PNC_35_ExteriorSound_90ecdcdb ComM_PncPSleepTimer_PNC_36_Preheater_b14f0d7f ComM_PncPSleepTimer_PNC_37_HighVoltage_WirelessChargingStation_717f15f0 ComM_PncPSleepTimer_PNC_40_Diagnosis_Energy_40b20ab8 ComM_PncPSleepTimer_PNC_41_Diagnosis_Powertrain_d7bd9faf ComM_PncPSleepTimer_PNC_42_Diagnosis_FlexRay_e9cd26c7 ComM_PncPSleepTimer_PNC_43_Diagnosis_DrivingAssistance_906b6e52 ComM_PncPSleepTimer_PNC_44_Diagnosis_Infotainment_d2af29c0 ComM_PncPSleepTimer_PNC_45_Diagnosis_Comfort_54b3da15 ComM_PncPSleepTimer_PNC_46_Diagnosis_Light_2422ec0e ComM_PncPSleepTimer_PNC_47_Diagnosis_ComfortLINs_fb22fd75 ComM_PncPSleepTimer_PNC_48_Diagnosis_ClimateTmeLINs_cce3bfb2 ComM_PncPSleepTimer_PNC_53_Lock_Unlock_51015b9a ComM_PncPSleepTimer_PNC_55_Dimming_ea37854f ComM_PncPSleepTimer_PNC_56_Charging_Status_19bd3663 ComM_PncPbInd ComM_PncPb[0].PncChannelMappingEndIdxOfPncPb ComM_PncPb[0].PncChannelMappingStartIdxOfPncPb ComM_PncPb[0].PncSignalIndEndIdxOfPncPb ComM_PncPb[0].PncSignalIndStartIdxOfPncPb ComM_PncPb[0].SignalByteIndexOfPncPb ComM_PncPb[0].UserReqPncFullComEndIdxOfPncPb ComM_PncPb[0].UserReqPncFullComStartIdxOfPncPb ComM_PncPb[10].PncChannelMappingEndIdxOfPncPb ComM_PncPb[10].PncChannelMappingStartIdxOfPncPb ComM_PncPb[10].PncSignalIndEndIdxOfPncPb ComM_PncPb[10].PncSignalIndStartIdxOfPncPb ComM_PncPb[10].SignalByteIndexOfPncPb ComM_PncPb[10].UserReqPncFullComEndIdxOfPncPb ComM_PncPb[10].UserReqPncFullComStartIdxOfPncPb ComM_PncPb[11].PncChannelMappingEndIdxOfPncPb ComM_PncPb[11].PncChannelMappingStartIdxOfPncPb ComM_PncPb[11].PncSignalIndEndIdxOfPncPb ComM_PncPb[11].PncSignalIndStartIdxOfPncPb ComM_PncPb[11].SignalByteIndexOfPncPb ComM_PncPb[11].UserReqPncFullComEndIdxOfPncPb ComM_PncPb[11].UserReqPncFullComStartIdxOfPncPb ComM_PncPb[12].PncChannelMappingEndIdxOfPncPb ComM_PncPb[12].PncChannelMappingStartIdxOfPncPb ComM_PncPb[12].PncSignalIndEndIdxOfPncPb ComM_PncPb[12].PncSignalIndStartIdxOfPncPb ComM_PncPb[12].SignalByteIndexOfPncPb ComM_PncPb[12].UserReqPncFullComEndIdxOfPncPb ComM_PncPb[12].UserReqPncFullComStartIdxOfPncPb ComM_PncPb[13].PncChannelMappingEndIdxOfPncPb ComM_PncPb[13].PncChannelMappingStartIdxOfPncPb ComM_PncPb[13].PncSignalIndEndIdxOfPncPb ComM_PncPb[13].PncSignalIndStartIdxOfPncPb ComM_PncPb[13].SignalByteIndexOfPncPb ComM_PncPb[13].UserReqPncFullComEndIdxOfPncPb ComM_PncPb[13].UserReqPncFullComStartIdxOfPncPb ComM_PncPb[14].PncChannelMappingEndIdxOfPncPb ComM_PncPb[14].PncChannelMappingStartIdxOfPncPb ComM_PncPb[14].PncSignalIndEndIdxOfPncPb ComM_PncPb[14].PncSignalIndStartIdxOfPncPb ComM_PncPb[14].SignalByteIndexOfPncPb ComM_PncPb[14].UserReqPncFullComEndIdxOfPncPb ComM_PncPb[14].UserReqPncFullComStartIdxOfPncPb ComM_PncPb[15].PncChannelMappingEndIdxOfPncPb ComM_PncPb[15].PncChannelMappingStartIdxOfPncPb ComM_PncPb[15].PncSignalIndEndIdxOfPncPb ComM_PncPb[15].PncSignalIndStartIdxOfPncPb ComM_PncPb[15].SignalByteIndexOfPncPb ComM_PncPb[15].UserReqPncFullComEndIdxOfPncPb ComM_PncPb[15].UserReqPncFullComStartIdxOfPncPb ComM_PncPb[16].PncChannelMappingEndIdxOfPncPb ComM_PncPb[16].PncChannelMappingStartIdxOfPncPb ComM_PncPb[16].PncSignalIndEndIdxOfPncPb ComM_PncPb[16].PncSignalIndStartIdxOfPncPb ComM_PncPb[16].SignalByteIndexOfPncPb ComM_PncPb[16].UserReqPncFullComEndIdxOfPncPb ComM_PncPb[16].UserReqPncFullComStartIdxOfPncPb ComM_PncPb[17].PncChannelMappingEndIdxOfPncPb ComM_PncPb[17].PncChannelMappingStartIdxOfPncPb ComM_PncPb[17].PncSignalIndEndIdxOfPncPb ComM_PncPb[17].PncSignalIndStartIdxOfPncPb ComM_PncPb[17].SignalByteIndexOfPncPb ComM_PncPb[17].UserReqPncFullComEndIdxOfPncPb ComM_PncPb[17].UserReqPncFullComStartIdxOfPncPb ComM_PncPb[18].PncChannelMappingEndIdxOfPncPb ComM_PncPb[18].PncChannelMappingStartIdxOfPncPb ComM_PncPb[18].PncSignalIndEndIdxOfPncPb ComM_PncPb[18].PncSignalIndStartIdxOfPncPb ComM_PncPb[18].SignalByteIndexOfPncPb ComM_PncPb[18].UserReqPncFullComEndIdxOfPncPb ComM_PncPb[18].UserReqPncFullComStartIdxOfPncPb ComM_PncPb[19].PncChannelMappingEndIdxOfPncPb ComM_PncPb[19].PncChannelMappingStartIdxOfPncPb ComM_PncPb[19].PncSignalIndEndIdxOfPncPb ComM_PncPb[19].PncSignalIndStartIdxOfPncPb ComM_PncPb[19].SignalByteIndexOfPncPb ComM_PncPb[19].UserReqPncFullComEndIdxOfPncPb ComM_PncPb[19].UserReqPncFullComStartIdxOfPncPb ComM_PncPb[1].PncChannelMappingEndIdxOfPncPb ComM_PncPb[1].PncChannelMappingStartIdxOfPncPb ComM_PncPb[1].PncSignalIndEndIdxOfPncPb ComM_PncPb[1].PncSignalIndStartIdxOfPncPb ComM_PncPb[1].SignalByteIndexOfPncPb ComM_PncPb[1].UserReqPncFullComEndIdxOfPncPb ComM_PncPb[1].UserReqPncFullComStartIdxOfPncPb ComM_PncPb[20].PncChannelMappingEndIdxOfPncPb ComM_PncPb[20].PncChannelMappingStartIdxOfPncPb ComM_PncPb[20].PncSignalIndEndIdxOfPncPb ComM_PncPb[20].PncSignalIndStartIdxOfPncPb ComM_PncPb[20].SignalByteIndexOfPncPb ComM_PncPb[20].UserReqPncFullComEndIdxOfPncPb ComM_PncPb[20].UserReqPncFullComStartIdxOfPncPb ComM_PncPb[21].PncChannelMappingEndIdxOfPncPb ComM_PncPb[21].PncChannelMappingStartIdxOfPncPb ComM_PncPb[21].PncSignalIndEndIdxOfPncPb ComM_PncPb[21].PncSignalIndStartIdxOfPncPb ComM_PncPb[21].SignalByteIndexOfPncPb ComM_PncPb[21].UserReqPncFullComEndIdxOfPncPb ComM_PncPb[21].UserReqPncFullComStartIdxOfPncPb ComM_PncPb[22].PncChannelMappingEndIdxOfPncPb ComM_PncPb[22].PncChannelMappingStartIdxOfPncPb ComM_PncPb[22].PncSignalIndEndIdxOfPncPb ComM_PncPb[22].PncSignalIndStartIdxOfPncPb ComM_PncPb[22].SignalByteIndexOfPncPb ComM_PncPb[22].UserReqPncFullComEndIdxOfPncPb ComM_PncPb[22].UserReqPncFullComStartIdxOfPncPb ComM_PncPb[23].PncChannelMappingEndIdxOfPncPb ComM_PncPb[23].PncChannelMappingStartIdxOfPncPb ComM_PncPb[23].PncSignalIndEndIdxOfPncPb ComM_PncPb[23].PncSignalIndStartIdxOfPncPb ComM_PncPb[23].SignalByteIndexOfPncPb ComM_PncPb[23].UserReqPncFullComEndIdxOfPncPb ComM_PncPb[23].UserReqPncFullComStartIdxOfPncPb ComM_PncPb[24].PncChannelMappingEndIdxOfPncPb ComM_PncPb[24].PncChannelMappingStartIdxOfPncPb ComM_PncPb[24].PncSignalIndEndIdxOfPncPb ComM_PncPb[24].PncSignalIndStartIdxOfPncPb ComM_PncPb[24].SignalByteIndexOfPncPb ComM_PncPb[24].UserReqPncFullComEndIdxOfPncPb ComM_PncPb[24].UserReqPncFullComStartIdxOfPncPb ComM_PncPb[25].PncChannelMappingEndIdxOfPncPb ComM_PncPb[25].PncChannelMappingStartIdxOfPncPb ComM_PncPb[25].PncSignalIndEndIdxOfPncPb ComM_PncPb[25].PncSignalIndStartIdxOfPncPb ComM_PncPb[25].SignalByteIndexOfPncPb ComM_PncPb[25].UserReqPncFullComEndIdxOfPncPb ComM_PncPb[25].UserReqPncFullComStartIdxOfPncPb ComM_PncPb[26].PncChannelMappingEndIdxOfPncPb ComM_PncPb[26].PncChannelMappingStartIdxOfPncPb ComM_PncPb[26].PncSignalIndEndIdxOfPncPb ComM_PncPb[26].PncSignalIndStartIdxOfPncPb ComM_PncPb[26].SignalByteIndexOfPncPb ComM_PncPb[26].UserReqPncFullComEndIdxOfPncPb ComM_PncPb[26].UserReqPncFullComStartIdxOfPncPb ComM_PncPb[27].PncChannelMappingEndIdxOfPncPb ComM_PncPb[27].PncChannelMappingStartIdxOfPncPb ComM_PncPb[27].PncSignalIndEndIdxOfPncPb ComM_PncPb[27].PncSignalIndStartIdxOfPncPb ComM_PncPb[27].SignalByteIndexOfPncPb ComM_PncPb[27].UserReqPncFullComEndIdxOfPncPb ComM_PncPb[27].UserReqPncFullComStartIdxOfPncPb ComM_PncPb[28].PncChannelMappingEndIdxOfPncPb ComM_PncPb[28].PncChannelMappingStartIdxOfPncPb ComM_PncPb[28].PncSignalIndEndIdxOfPncPb ComM_PncPb[28].PncSignalIndStartIdxOfPncPb ComM_PncPb[28].SignalByteIndexOfPncPb ComM_PncPb[28].UserReqPncFullComEndIdxOfPncPb ComM_PncPb[28].UserReqPncFullComStartIdxOfPncPb ComM_PncPb[29].PncChannelMappingEndIdxOfPncPb ComM_PncPb[29].PncChannelMappingStartIdxOfPncPb ComM_PncPb[29].PncSignalIndEndIdxOfPncPb ComM_PncPb[29].PncSignalIndStartIdxOfPncPb ComM_PncPb[29].SignalByteIndexOfPncPb ComM_PncPb[29].UserReqPncFullComEndIdxOfPncPb ComM_PncPb[29].UserReqPncFullComStartIdxOfPncPb ComM_PncPb[2].PncChannelMappingEndIdxOfPncPb ComM_PncPb[2].PncChannelMappingStartIdxOfPncPb ComM_PncPb[2].PncSignalIndEndIdxOfPncPb ComM_PncPb[2].PncSignalIndStartIdxOfPncPb ComM_PncPb[2].SignalByteIndexOfPncPb ComM_PncPb[2].UserReqPncFullComEndIdxOfPncPb ComM_PncPb[2].UserReqPncFullComStartIdxOfPncPb ComM_PncPb[30].PncChannelMappingEndIdxOfPncPb ComM_PncPb[30].PncChannelMappingStartIdxOfPncPb ComM_PncPb[30].PncSignalIndEndIdxOfPncPb ComM_PncPb[30].PncSignalIndStartIdxOfPncPb ComM_PncPb[30].SignalByteIndexOfPncPb ComM_PncPb[30].UserReqPncFullComEndIdxOfPncPb ComM_PncPb[30].UserReqPncFullComStartIdxOfPncPb ComM_PncPb[31].PncChannelMappingEndIdxOfPncPb ComM_PncPb[31].PncChannelMappingStartIdxOfPncPb ComM_PncPb[31].PncSignalIndEndIdxOfPncPb ComM_PncPb[31].PncSignalIndStartIdxOfPncPb ComM_PncPb[31].SignalByteIndexOfPncPb ComM_PncPb[31].UserReqPncFullComEndIdxOfPncPb ComM_PncPb[31].UserReqPncFullComStartIdxOfPncPb ComM_PncPb[32].PncChannelMappingEndIdxOfPncPb ComM_PncPb[32].PncChannelMappingStartIdxOfPncPb ComM_PncPb[32].PncSignalIndEndIdxOfPncPb ComM_PncPb[32].PncSignalIndStartIdxOfPncPb ComM_PncPb[32].SignalByteIndexOfPncPb ComM_PncPb[32].UserReqPncFullComEndIdxOfPncPb ComM_PncPb[32].UserReqPncFullComStartIdxOfPncPb ComM_PncPb[33].PncChannelMappingEndIdxOfPncPb ComM_PncPb[33].PncChannelMappingStartIdxOfPncPb ComM_PncPb[33].PncSignalIndEndIdxOfPncPb ComM_PncPb[33].PncSignalIndStartIdxOfPncPb ComM_PncPb[33].SignalByteIndexOfPncPb ComM_PncPb[33].UserReqPncFullComEndIdxOfPncPb ComM_PncPb[33].UserReqPncFullComStartIdxOfPncPb ComM_PncPb[34].PncChannelMappingEndIdxOfPncPb ComM_PncPb[34].PncChannelMappingStartIdxOfPncPb ComM_PncPb[34].PncSignalIndEndIdxOfPncPb ComM_PncPb[34].PncSignalIndStartIdxOfPncPb ComM_PncPb[34].SignalByteIndexOfPncPb ComM_PncPb[34].UserReqPncFullComEndIdxOfPncPb ComM_PncPb[34].UserReqPncFullComStartIdxOfPncPb ComM_PncPb[35].PncChannelMappingEndIdxOfPncPb ComM_PncPb[35].PncChannelMappingStartIdxOfPncPb ComM_PncPb[35].PncSignalIndEndIdxOfPncPb ComM_PncPb[35].PncSignalIndStartIdxOfPncPb ComM_PncPb[35].SignalByteIndexOfPncPb ComM_PncPb[35].UserReqPncFullComEndIdxOfPncPb ComM_PncPb[35].UserReqPncFullComStartIdxOfPncPb ComM_PncPb[36].PncChannelMappingEndIdxOfPncPb ComM_PncPb[36].PncChannelMappingStartIdxOfPncPb ComM_PncPb[36].PncSignalIndEndIdxOfPncPb ComM_PncPb[36].PncSignalIndStartIdxOfPncPb ComM_PncPb[36].SignalByteIndexOfPncPb ComM_PncPb[36].UserReqPncFullComEndIdxOfPncPb ComM_PncPb[36].UserReqPncFullComStartIdxOfPncPb ComM_PncPb[37].PncChannelMappingEndIdxOfPncPb ComM_PncPb[37].PncChannelMappingStartIdxOfPncPb ComM_PncPb[37].PncSignalIndEndIdxOfPncPb ComM_PncPb[37].PncSignalIndStartIdxOfPncPb ComM_PncPb[37].SignalByteIndexOfPncPb ComM_PncPb[37].UserReqPncFullComEndIdxOfPncPb ComM_PncPb[37].UserReqPncFullComStartIdxOfPncPb ComM_PncPb[38].PncChannelMappingEndIdxOfPncPb ComM_PncPb[38].PncChannelMappingStartIdxOfPncPb ComM_PncPb[38].PncSignalIndEndIdxOfPncPb ComM_PncPb[38].PncSignalIndStartIdxOfPncPb ComM_PncPb[38].SignalByteIndexOfPncPb ComM_PncPb[38].UserReqPncFullComEndIdxOfPncPb ComM_PncPb[38].UserReqPncFullComStartIdxOfPncPb ComM_PncPb[39].PncChannelMappingEndIdxOfPncPb ComM_PncPb[39].PncChannelMappingStartIdxOfPncPb ComM_PncPb[39].PncSignalIndEndIdxOfPncPb ComM_PncPb[39].PncSignalIndStartIdxOfPncPb ComM_PncPb[39].SignalByteIndexOfPncPb ComM_PncPb[39].UserReqPncFullComEndIdxOfPncPb ComM_PncPb[39].UserReqPncFullComStartIdxOfPncPb ComM_PncPb[3].PncChannelMappingEndIdxOfPncPb ComM_PncPb[3].PncChannelMappingStartIdxOfPncPb ComM_PncPb[3].PncSignalIndEndIdxOfPncPb ComM_PncPb[3].PncSignalIndStartIdxOfPncPb ComM_PncPb[3].SignalByteIndexOfPncPb ComM_PncPb[3].UserReqPncFullComEndIdxOfPncPb ComM_PncPb[3].UserReqPncFullComStartIdxOfPncPb ComM_PncPb[40].PncChannelMappingEndIdxOfPncPb ComM_PncPb[40].PncChannelMappingStartIdxOfPncPb ComM_PncPb[40].PncSignalIndEndIdxOfPncPb ComM_PncPb[40].PncSignalIndStartIdxOfPncPb ComM_PncPb[40].SignalByteIndexOfPncPb ComM_PncPb[40].UserReqPncFullComEndIdxOfPncPb ComM_PncPb[40].UserReqPncFullComStartIdxOfPncPb ComM_PncPb[41].PncChannelMappingEndIdxOfPncPb ComM_PncPb[41].PncChannelMappingStartIdxOfPncPb ComM_PncPb[41].PncSignalIndEndIdxOfPncPb ComM_PncPb[41].PncSignalIndStartIdxOfPncPb ComM_PncPb[41].SignalByteIndexOfPncPb ComM_PncPb[41].UserReqPncFullComEndIdxOfPncPb ComM_PncPb[41].UserReqPncFullComStartIdxOfPncPb ComM_PncPb[42].PncChannelMappingEndIdxOfPncPb ComM_PncPb[42].PncChannelMappingStartIdxOfPncPb ComM_PncPb[42].PncSignalIndEndIdxOfPncPb ComM_PncPb[42].PncSignalIndStartIdxOfPncPb ComM_PncPb[42].SignalByteIndexOfPncPb ComM_PncPb[42].UserReqPncFullComEndIdxOfPncPb ComM_PncPb[42].UserReqPncFullComStartIdxOfPncPb ComM_PncPb[43].PncChannelMappingEndIdxOfPncPb ComM_PncPb[43].PncChannelMappingStartIdxOfPncPb ComM_PncPb[43].PncSignalIndEndIdxOfPncPb ComM_PncPb[43].PncSignalIndStartIdxOfPncPb ComM_PncPb[43].SignalByteIndexOfPncPb ComM_PncPb[43].UserReqPncFullComEndIdxOfPncPb ComM_PncPb[43].UserReqPncFullComStartIdxOfPncPb ComM_PncPb[44].PncChannelMappingEndIdxOfPncPb ComM_PncPb[44].PncChannelMappingStartIdxOfPncPb ComM_PncPb[44].PncSignalIndEndIdxOfPncPb ComM_PncPb[44].PncSignalIndStartIdxOfPncPb ComM_PncPb[44].SignalByteIndexOfPncPb ComM_PncPb[44].UserReqPncFullComEndIdxOfPncPb ComM_PncPb[44].UserReqPncFullComStartIdxOfPncPb ComM_PncPb[45].PncChannelMappingEndIdxOfPncPb ComM_PncPb[45].PncChannelMappingStartIdxOfPncPb ComM_PncPb[45].PncSignalIndEndIdxOfPncPb ComM_PncPb[45].PncSignalIndStartIdxOfPncPb ComM_PncPb[45].SignalByteIndexOfPncPb ComM_PncPb[45].UserReqPncFullComEndIdxOfPncPb ComM_PncPb[45].UserReqPncFullComStartIdxOfPncPb ComM_PncPb[46].PncChannelMappingEndIdxOfPncPb ComM_PncPb[46].PncChannelMappingStartIdxOfPncPb ComM_PncPb[46].PncSignalIndEndIdxOfPncPb ComM_PncPb[46].PncSignalIndStartIdxOfPncPb ComM_PncPb[46].SignalByteIndexOfPncPb ComM_PncPb[46].UserReqPncFullComEndIdxOfPncPb ComM_PncPb[46].UserReqPncFullComStartIdxOfPncPb ComM_PncPb[47].PncChannelMappingEndIdxOfPncPb ComM_PncPb[47].PncChannelMappingStartIdxOfPncPb ComM_PncPb[47].PncSignalIndEndIdxOfPncPb ComM_PncPb[47].PncSignalIndStartIdxOfPncPb ComM_PncPb[47].SignalByteIndexOfPncPb ComM_PncPb[47].UserReqPncFullComEndIdxOfPncPb ComM_PncPb[47].UserReqPncFullComStartIdxOfPncPb ComM_PncPb[4].PncChannelMappingEndIdxOfPncPb ComM_PncPb[4].PncChannelMappingStartIdxOfPncPb ComM_PncPb[4].PncSignalIndEndIdxOfPncPb ComM_PncPb[4].PncSignalIndStartIdxOfPncPb ComM_PncPb[4].SignalByteIndexOfPncPb ComM_PncPb[4].UserReqPncFullComEndIdxOfPncPb ComM_PncPb[4].UserReqPncFullComStartIdxOfPncPb ComM_PncPb[5].PncChannelMappingEndIdxOfPncPb ComM_PncPb[5].PncChannelMappingStartIdxOfPncPb ComM_PncPb[5].PncSignalIndEndIdxOfPncPb ComM_PncPb[5].PncSignalIndStartIdxOfPncPb ComM_PncPb[5].SignalByteIndexOfPncPb ComM_PncPb[5].UserReqPncFullComEndIdxOfPncPb ComM_PncPb[5].UserReqPncFullComStartIdxOfPncPb ComM_PncPb[6].PncChannelMappingEndIdxOfPncPb ComM_PncPb[6].PncChannelMappingStartIdxOfPncPb ComM_PncPb[6].PncSignalIndEndIdxOfPncPb ComM_PncPb[6].PncSignalIndStartIdxOfPncPb ComM_PncPb[6].SignalByteIndexOfPncPb ComM_PncPb[6].UserReqPncFullComEndIdxOfPncPb ComM_PncPb[6].UserReqPncFullComStartIdxOfPncPb ComM_PncPb[7].PncChannelMappingEndIdxOfPncPb ComM_PncPb[7].PncChannelMappingStartIdxOfPncPb ComM_PncPb[7].PncSignalIndEndIdxOfPncPb ComM_PncPb[7].PncSignalIndStartIdxOfPncPb ComM_PncPb[7].SignalByteIndexOfPncPb ComM_PncPb[7].UserReqPncFullComEndIdxOfPncPb ComM_PncPb[7].UserReqPncFullComStartIdxOfPncPb ComM_PncPb[8].PncChannelMappingEndIdxOfPncPb ComM_PncPb[8].PncChannelMappingStartIdxOfPncPb ComM_PncPb[8].PncSignalIndEndIdxOfPncPb ComM_PncPb[8].PncSignalIndStartIdxOfPncPb ComM_PncPb[8].SignalByteIndexOfPncPb ComM_PncPb[8].UserReqPncFullComEndIdxOfPncPb ComM_PncPb[8].UserReqPncFullComStartIdxOfPncPb ComM_PncPb[9].PncChannelMappingEndIdxOfPncPb ComM_PncPb[9].PncChannelMappingStartIdxOfPncPb ComM_PncPb[9].PncSignalIndEndIdxOfPncPb ComM_PncPb[9].PncSignalIndStartIdxOfPncPb ComM_PncPb[9].SignalByteIndexOfPncPb ComM_PncPb[9].UserReqPncFullComEndIdxOfPncPb ComM_PncPb[9].UserReqPncFullComStartIdxOfPncPb ComM_PncSignalValues ComM_PncSignalValues_ComM_ComConf_ComSignal_ComSignalPnc_EIRA_CAN_Rx ComM_PncSignalValues_ComM_ComConf_ComSignal_NM_Hybrid_01_FCAB_XIX_NM_Hybrid_01_XIX_HCP5_CANFD01_38c188fa_Tx ComM_PncSignal[0].ChannelIdxOfPncSignal ComM_PncSignal[0].PncSignalValuesEndIdxOfPncSignal ComM_PncSignal[0].PncSignalValuesStartIdxOfPncSignal ComM_PncSignal[0].TypeOfPncSignal ComM_PncSignal[1].ChannelIdxOfPncSignal ComM_PncSignal[1].PncSignalValuesEndIdxOfPncSignal ComM_PncSignal[1].PncSignalValuesStartIdxOfPncSignal ComM_PncSignal[1].TypeOfPncSignal ComM_PncToChannelRoutingState ComM_PncToChannelRoutingState_ComMChannel_0 ComM_PncToChannelRoutingState_ComMChannel_1 ComM_Pnc[0].ClearMaskOfPnc ComM_Pnc[0].PncIdOfPnc ComM_Pnc[0].SetMaskOfPnc ComM_Pnc[10].ClearMaskOfPnc ComM_Pnc[10].PncIdOfPnc ComM_Pnc[10].SetMaskOfPnc ComM_Pnc[11].ClearMaskOfPnc ComM_Pnc[11].PncIdOfPnc ComM_Pnc[11].SetMaskOfPnc ComM_Pnc[12].ClearMaskOfPnc ComM_Pnc[12].PncIdOfPnc ComM_Pnc[12].SetMaskOfPnc ComM_Pnc[13].ClearMaskOfPnc ComM_Pnc[13].PncIdOfPnc ComM_Pnc[13].SetMaskOfPnc ComM_Pnc[14].ClearMaskOfPnc ComM_Pnc[14].PncIdOfPnc ComM_Pnc[14].SetMaskOfPnc ComM_Pnc[15].ClearMaskOfPnc ComM_Pnc[15].PncIdOfPnc ComM_Pnc[15].SetMaskOfPnc ComM_Pnc[16].ClearMaskOfPnc ComM_Pnc[16].PncIdOfPnc ComM_Pnc[16].SetMaskOfPnc ComM_Pnc[17].ClearMaskOfPnc ComM_Pnc[17].PncIdOfPnc ComM_Pnc[17].SetMaskOfPnc ComM_Pnc[18].ClearMaskOfPnc ComM_Pnc[18].PncIdOfPnc ComM_Pnc[18].SetMaskOfPnc ComM_Pnc[19].ClearMaskOfPnc ComM_Pnc[19].PncIdOfPnc ComM_Pnc[19].SetMaskOfPnc ComM_Pnc[1].ClearMaskOfPnc ComM_Pnc[1].PncIdOfPnc ComM_Pnc[1].SetMaskOfPnc ComM_Pnc[20].ClearMaskOfPnc ComM_Pnc[20].PncIdOfPnc ComM_Pnc[20].SetMaskOfPnc ComM_Pnc[21].ClearMaskOfPnc ComM_Pnc[21].PncIdOfPnc ComM_Pnc[21].SetMaskOfPnc ComM_Pnc[22].ClearMaskOfPnc ComM_Pnc[22].PncIdOfPnc ComM_Pnc[22].SetMaskOfPnc ComM_Pnc[23].ClearMaskOfPnc ComM_Pnc[23].PncIdOfPnc ComM_Pnc[23].SetMaskOfPnc ComM_Pnc[24].ClearMaskOfPnc ComM_Pnc[24].PncIdOfPnc ComM_Pnc[24].SetMaskOfPnc ComM_Pnc[25].ClearMaskOfPnc ComM_Pnc[25].PncIdOfPnc ComM_Pnc[25].SetMaskOfPnc ComM_Pnc[26].ClearMaskOfPnc ComM_Pnc[26].PncIdOfPnc ComM_Pnc[26].SetMaskOfPnc ComM_Pnc[27].ClearMaskOfPnc ComM_Pnc[27].PncIdOfPnc ComM_Pnc[27].SetMaskOfPnc ComM_Pnc[28].ClearMaskOfPnc ComM_Pnc[28].PncIdOfPnc ComM_Pnc[28].SetMaskOfPnc ComM_Pnc[29].ClearMaskOfPnc ComM_Pnc[29].PncIdOfPnc ComM_Pnc[29].SetMaskOfPnc ComM_Pnc[2].ClearMaskOfPnc ComM_Pnc[2].PncIdOfPnc ComM_Pnc[2].SetMaskOfPnc ComM_Pnc[30].ClearMaskOfPnc ComM_Pnc[30].PncIdOfPnc ComM_Pnc[30].SetMaskOfPnc ComM_Pnc[31].ClearMaskOfPnc ComM_Pnc[31].PncIdOfPnc ComM_Pnc[31].SetMaskOfPnc ComM_Pnc[32].ClearMaskOfPnc ComM_Pnc[32].PncIdOfPnc ComM_Pnc[32].SetMaskOfPnc ComM_Pnc[33].ClearMaskOfPnc ComM_Pnc[33].PncIdOfPnc ComM_Pnc[33].SetMaskOfPnc ComM_Pnc[34].ClearMaskOfPnc ComM_Pnc[34].PncIdOfPnc ComM_Pnc[34].SetMaskOfPnc ComM_Pnc[35].ClearMaskOfPnc ComM_Pnc[35].PncIdOfPnc ComM_Pnc[35].SetMaskOfPnc ComM_Pnc[36].ClearMaskOfPnc ComM_Pnc[36].PncIdOfPnc ComM_Pnc[36].SetMaskOfPnc ComM_Pnc[37].ClearMaskOfPnc ComM_Pnc[37].PncIdOfPnc ComM_Pnc[37].SetMaskOfPnc ComM_Pnc[38].ClearMaskOfPnc ComM_Pnc[38].PncIdOfPnc ComM_Pnc[38].SetMaskOfPnc ComM_Pnc[39].ClearMaskOfPnc ComM_Pnc[39].PncIdOfPnc ComM_Pnc[39].SetMaskOfPnc ComM_Pnc[3].ClearMaskOfPnc ComM_Pnc[3].PncIdOfPnc ComM_Pnc[3].SetMaskOfPnc ComM_Pnc[40].ClearMaskOfPnc ComM_Pnc[40].PncIdOfPnc ComM_Pnc[40].SetMaskOfPnc ComM_Pnc[41].ClearMaskOfPnc ComM_Pnc[41].PncIdOfPnc ComM_Pnc[41].SetMaskOfPnc ComM_Pnc[42].ClearMaskOfPnc ComM_Pnc[42].PncIdOfPnc ComM_Pnc[42].SetMaskOfPnc ComM_Pnc[43].ClearMaskOfPnc ComM_Pnc[43].PncIdOfPnc ComM_Pnc[43].SetMaskOfPnc ComM_Pnc[44].ClearMaskOfPnc ComM_Pnc[44].PncIdOfPnc ComM_Pnc[44].SetMaskOfPnc ComM_Pnc[45].ClearMaskOfPnc ComM_Pnc[45].PncIdOfPnc ComM_Pnc[45].SetMaskOfPnc ComM_Pnc[46].ClearMaskOfPnc ComM_Pnc[46].PncIdOfPnc ComM_Pnc[46].SetMaskOfPnc ComM_Pnc[47].ClearMaskOfPnc ComM_Pnc[47].PncIdOfPnc ComM_Pnc[47].SetMaskOfPnc ComM_Pnc[4].ClearMaskOfPnc ComM_Pnc[4].PncIdOfPnc ComM_Pnc[4].SetMaskOfPnc ComM_Pnc[5].ClearMaskOfPnc ComM_Pnc[5].PncIdOfPnc ComM_Pnc[5].SetMaskOfPnc ComM_Pnc[6].ClearMaskOfPnc ComM_Pnc[6].PncIdOfPnc ComM_Pnc[6].SetMaskOfPnc ComM_Pnc[7].ClearMaskOfPnc ComM_Pnc[7].PncIdOfPnc ComM_Pnc[7].SetMaskOfPnc ComM_Pnc[8].ClearMaskOfPnc ComM_Pnc[8].PncIdOfPnc ComM_Pnc[8].SetMaskOfPnc ComM_Pnc[9].ClearMaskOfPnc ComM_Pnc[9].PncIdOfPnc ComM_Pnc[9].SetMaskOfPnc ComM_PostInitialized ComM_UserByteMask[0].ChannelOfUserByteMask ComM_UserByteMask[0].ClearMaskOfUserByteMask ComM_UserByteMask[0].SetMaskOfUserByteMask ComM_UserByteMask[0].UserReqFullComIdxOfUserByteMask ComM_UserByteMask[10].ChannelOfUserByteMask ComM_UserByteMask[10].ClearMaskOfUserByteMask ComM_UserByteMask[10].SetMaskOfUserByteMask ComM_UserByteMask[10].UserReqFullComIdxOfUserByteMask ComM_UserByteMask[11].ChannelOfUserByteMask ComM_UserByteMask[11].ClearMaskOfUserByteMask ComM_UserByteMask[11].SetMaskOfUserByteMask ComM_UserByteMask[11].UserReqFullComIdxOfUserByteMask ComM_UserByteMask[12].ChannelOfUserByteMask ComM_UserByteMask[12].ClearMaskOfUserByteMask ComM_UserByteMask[12].SetMaskOfUserByteMask ComM_UserByteMask[12].UserReqFullComIdxOfUserByteMask ComM_UserByteMask[13].ChannelOfUserByteMask ComM_UserByteMask[13].ClearMaskOfUserByteMask ComM_UserByteMask[13].SetMaskOfUserByteMask ComM_UserByteMask[13].UserReqFullComIdxOfUserByteMask ComM_UserByteMask[14].ChannelOfUserByteMask ComM_UserByteMask[14].ClearMaskOfUserByteMask ComM_UserByteMask[14].SetMaskOfUserByteMask ComM_UserByteMask[14].UserReqFullComIdxOfUserByteMask ComM_UserByteMask[15].ChannelOfUserByteMask ComM_UserByteMask[15].ClearMaskOfUserByteMask ComM_UserByteMask[15].SetMaskOfUserByteMask ComM_UserByteMask[15].UserReqFullComIdxOfUserByteMask ComM_UserByteMask[16].ChannelOfUserByteMask ComM_UserByteMask[16].ClearMaskOfUserByteMask ComM_UserByteMask[16].SetMaskOfUserByteMask ComM_UserByteMask[16].UserReqFullComIdxOfUserByteMask ComM_UserByteMask[17].ChannelOfUserByteMask ComM_UserByteMask[17].ClearMaskOfUserByteMask ComM_UserByteMask[17].SetMaskOfUserByteMask ComM_UserByteMask[17].UserReqFullComIdxOfUserByteMask ComM_UserByteMask[18].ChannelOfUserByteMask ComM_UserByteMask[18].ClearMaskOfUserByteMask ComM_UserByteMask[18].SetMaskOfUserByteMask ComM_UserByteMask[18].UserReqFullComIdxOfUserByteMask ComM_UserByteMask[19].ChannelOfUserByteMask ComM_UserByteMask[19].ClearMaskOfUserByteMask ComM_UserByteMask[19].SetMaskOfUserByteMask ComM_UserByteMask[19].UserReqFullComIdxOfUserByteMask ComM_UserByteMask[1].ChannelOfUserByteMask ComM_UserByteMask[1].ClearMaskOfUserByteMask ComM_UserByteMask[1].SetMaskOfUserByteMask ComM_UserByteMask[1].UserReqFullComIdxOfUserByteMask ComM_UserByteMask[20].ChannelOfUserByteMask ComM_UserByteMask[20].ClearMaskOfUserByteMask ComM_UserByteMask[20].SetMaskOfUserByteMask ComM_UserByteMask[20].UserReqFullComIdxOfUserByteMask ComM_UserByteMask[21].ChannelOfUserByteMask ComM_UserByteMask[21].ClearMaskOfUserByteMask ComM_UserByteMask[21].SetMaskOfUserByteMask ComM_UserByteMask[21].UserReqFullComIdxOfUserByteMask ComM_UserByteMask[22].ChannelOfUserByteMask ComM_UserByteMask[22].ClearMaskOfUserByteMask ComM_UserByteMask[22].SetMaskOfUserByteMask ComM_UserByteMask[22].UserReqFullComIdxOfUserByteMask ComM_UserByteMask[23].ChannelOfUserByteMask ComM_UserByteMask[23].ClearMaskOfUserByteMask ComM_UserByteMask[23].SetMaskOfUserByteMask ComM_UserByteMask[23].UserReqFullComIdxOfUserByteMask ComM_UserByteMask[24].ChannelOfUserByteMask ComM_UserByteMask[24].ClearMaskOfUserByteMask ComM_UserByteMask[24].SetMaskOfUserByteMask ComM_UserByteMask[24].UserReqFullComIdxOfUserByteMask ComM_UserByteMask[25].ChannelOfUserByteMask ComM_UserByteMask[25].ClearMaskOfUserByteMask ComM_UserByteMask[25].SetMaskOfUserByteMask ComM_UserByteMask[25].UserReqFullComIdxOfUserByteMask ComM_UserByteMask[26].ChannelOfUserByteMask ComM_UserByteMask[26].ClearMaskOfUserByteMask ComM_UserByteMask[26].SetMaskOfUserByteMask ComM_UserByteMask[26].UserReqFullComIdxOfUserByteMask ComM_UserByteMask[27].ChannelOfUserByteMask /end REF_MEASUREMENT
/end GROUP
/end MODULE
/end PROJECT
