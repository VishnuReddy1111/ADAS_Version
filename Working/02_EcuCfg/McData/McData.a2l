ASAP2_VERSION 1 71
/begin PROJECT MICROSAR ""
/begin MODULE CPP ""
/begin MOD_COMMON "" BYTE_ORDER MSB_LAST ALIGNMENT_BYTE 1 ALIGNMENT_WORD 2 ALIGNMENT_LONG 4 ALIGNMENT_FLOAT16_IEEE 2 ALIGNMENT_FLOAT32_IEEE 4 ALIGNMENT_FLOAT64_IEEE 8 ALIGNMENT_INT64 8 /end MOD_COMMON
/begin MEASUREMENT Com_TxAccessInfo[552].TxSigInfoIdxOfTxAccessInfo "" UWORD Com_TxSigInfoIdxOfTxAccessInfoType 0 0 0 65535 ECU_ADDRESS 0x0 /end MEASUREMENT
/begin MEASUREMENT Com_TxAccessInfo[553].TxGrpSigInfoIdxOfTxAccessInfo "" UBYTE Com_TxGrpSigInfoIdxOfTxAccessInfoType 0 0 0 255 ECU_ADDRESS 0x0 /end MEASUREMENT
/begin MEASUREMENT Com_TxAccessInfo[553].TxSigInfoIdxOfTxAccessInfo "" UWORD Com_TxSigInfoIdxOfTxAccessInfoType 0 0 0 65535 ECU_ADDRESS 0x0 /end MEASUREMENT
/begin MEASUREMENT Com_TxAccessInfo[554].TxGrpSigInfoIdxOfTxAccessInfo "" UBYTE Com_TxGrpSigInfoIdxOfTxAccessInfoType 0 0 0 255 ECU_ADDRESS 0x0 /end MEASUREMENT
/begin MEASUREMENT Com_TxAccessInfo[554].TxSigInfoIdxOfTxAccessInfo "" UWORD Com_TxSigInfoIdxOfTxAccessInfoType 0 0 0 65535 ECU_ADDRESS 0x0 /end MEASUREMENT
/begin MEASUREMENT Com_TxAccessInfo[555].TxGrpSigInfoIdxOfTxAccessInfo "" UBYTE Com_TxGrpSigInfoIdxOfTxAccessInfoType 0 0 0 255 ECU_ADDRESS 0x0 /end MEASUREMENT
/begin MEASUREMENT Com_TxAccessInfo[555].TxSigInfoIdxOfTxAccessInfo "" UWORD Com_TxSigInfoIdxOfTxAccessInfoType 0 0 0 65535 ECU_ADDRESS 0x0 /end MEASUREMENT
/begin MEASUREMENT Com_TxAccessInfo[556].TxGrpSigInfoIdxOfTxAccessInfo "" UBYTE Com_TxGrpSigInfoIdxOfTxAccessInfoType 0 0 0 255 ECU_ADDRESS 0x0 /end MEASUREMENT
/begin MEASUREMENT Com_TxAccessInfo[556].TxSigInfoIdxOfTxAccessInfo "" UWORD Com_TxSigInfoIdxOfTxAccessInfoType 0 0 0 65535 ECU_ADDRESS 0x0 /end MEASUREMENT
/begin MEASUREMENT Com_TxAccessInfo[557].TxGrpSigInfoIdxOfTxAccessInfo "" UBYTE Com_TxGrpSigInfoIdxOfTxAccessInfoType 0 0 0 255 ECU_ADDRESS 0x0 /end MEASUREMENT
/begin MEASUREMENT Com_TxAccessInfo[557].TxSigInfoIdxOfTxAccessInfo "" UWORD Com_TxSigInfoIdxOfTxAccessInfoType 0 0 0 65535 ECU_ADDRESS 0x0 /end MEASUREMENT
/begin MEASUREMENT Com_TxAccessInfo[55].TxGrpSigInfoIdxOfTxAccessInfo "" UBYTE Com_TxGrpSigInfoIdxOfTxAccessInfoType 0 0 0 255 ECU_ADDRESS 0x0 /end MEASUREMENT
/begin MEASUREMENT Com_TxAccessInfo[55].TxSigInfoIdxOfTxAccessInfo "" UWORD Com_TxSigInfoIdxOfTxAccessInfoType 0 0 0 65535 ECU_ADDRESS 0x0 /end MEASUREMENT
/begin MEASUREMENT Com_TxAccessInfo[56].TxGrpSigInfoIdxOfTxAccessInfo "" UBYTE Com_TxGrpSigInfoIdxOfTxAccessInfoType 0 0 0 255 ECU_ADDRESS 0x0 /end MEASUREMENT
/begin MEASUREMENT Com_TxAccessInfo[56].TxSigInfoIdxOfTxAccessInfo "" UWORD Com_TxSigInfoIdxOfTxAccessInfoType 0 0 0 65535 ECU_ADDRESS 0x0 /end MEASUREMENT
/begin MEASUREMENT Com_TxAccessInfo[57].TxGrpSigInfoIdxOfTxAccessInfo "" UBYTE Com_TxGrpSigInfoIdxOfTxAccessInfoType 0 0 0 255 ECU_ADDRESS 0x0 /end MEASUREMENT
/begin MEASUREMENT Com_TxAccessInfo[57].TxSigInfoIdxOfTxAccessInfo "" UWORD Com_TxSigInfoIdxOfTxAccessInfoType 0 0 0 65535 ECU_ADDRESS 0x0 /end MEASUREMENT
/begin MEASUREMENT Com_TxAccessInfo[58].TxGrpSigInfoIdxOfTxAccessInfo "" UBYTE Com_TxGrpSigInfoIdxOfTxAccessInfoType 0 0 0 255 ECU_ADDRESS 0x0 /end MEASUREMENT
/begin MEASUREMENT Com_TxAccessInfo[58].TxSigInfoIdxOfTxAccessInfo "" UWORD Com_TxSigInfoIdxOfTxAccessInfoType 0 0 0 65535 ECU_ADDRESS 0x0 /end MEASUREMENT
/begin MEASUREMENT Com_TxAccessInfo[59].TxGrpSigInfoIdxOfTxAccessInfo "" UBYTE Com_TxGrpSigInfoIdxOfTxAccessInfoType 0 0 0 255 ECU_ADDRESS 0x0 /end MEASUREMENT
/begin MEASUREMENT Com_TxAccessInfo[59].TxSigInfoIdxOfTxAccessInfo "" UWORD Com_TxSigInfoIdxOfTxAccessInfoType 0 0 0 65535 ECU_ADDRESS 0x0 /end MEASUREMENT
/begin MEASUREMENT Com_TxAccessInfo[5].TxGrpSigInfoIdxOfTxAccessInfo "" UBYTE Com_TxGrpSigInfoIdxOfTxAccessInfoType 0 0 0 255 ECU_ADDRESS 0x0 /end MEASUREMENT
/begin MEASUREMENT Com_TxAccessInfo[5].TxSigInfoIdxOfTxAccessInfo "" UWORD Com_TxSigInfoIdxOfTxAccessInfoType 0 0 0 65535 ECU_ADDRESS 0x0 /end MEASUREMENT
/begin MEASUREMENT Com_TxAccessInfo[60].TxGrpSigInfoIdxOfTxAccessInfo "" UBYTE Com_TxGrpSigInfoIdxOfTxAccessInfoType 0 0 0 255 ECU_ADDRESS 0x0 /end MEASUREMENT
/begin MEASUREMENT Com_TxAccessInfo[60].TxSigInfoIdxOfTxAccessInfo "" UWORD Com_TxSigInfoIdxOfTxAccessInfoType 0 0 0 65535 ECU_ADDRESS 0x0 /end MEASUREMENT
/begin MEASUREMENT Com_TxAccessInfo[61].TxGrpSigInfoIdxOfTxAccessInfo "" UBYTE Com_TxGrpSigInfoIdxOfTxAccessInfoType 0 0 0 255 ECU_ADDRESS 0x0 /end MEASUREMENT
/begin MEASUREMENT Com_TxAccessInfo[61].TxSigInfoIdxOfTxAccessInfo "" UWORD Com_TxSigInfoIdxOfTxAccessInfoType 0 0 0 65535 ECU_ADDRESS 0x0 /end MEASUREMENT
/begin MEASUREMENT Com_TxAccessInfo[62].TxGrpSigInfoIdxOfTxAccessInfo "" UBYTE Com_TxGrpSigInfoIdxOfTxAccessInfoType 0 0 0 255 ECU_ADDRESS 0x0 /end MEASUREMENT
/begin MEASUREMENT Com_TxAccessInfo[62].TxSigInfoIdxOfTxAccessInfo "" UWORD Com_TxSigInfoIdxOfTxAccessInfoType 0 0 0 65535 ECU_ADDRESS 0x0 /end MEASUREMENT
/begin MEASUREMENT Com_TxAccessInfo[63].TxGrpSigInfoIdxOfTxAccessInfo "" UBYTE Com_TxGrpSigInfoIdxOfTxAccessInfoType 0 0 0 255 ECU_ADDRESS 0x0 /end MEASUREMENT
/begin MEASUREMENT Com_TxAccessInfo[63].TxSigInfoIdxOfTxAccessInfo "" UWORD Com_TxSigInfoIdxOfTxAccessInfoType 0 0 0 65535 ECU_ADDRESS 0x0 /end MEASUREMENT
/begin MEASUREMENT Com_TxAccessInfo[64].TxGrpSigInfoIdxOfTxAccessInfo "" UBYTE Com_TxGrpSigInfoIdxOfTxAccessInfoType 0 0 0 255 ECU_ADDRESS 0x0 /end MEASUREMENT
/begin MEASUREMENT Com_TxAccessInfo[64].TxSigInfoIdxOfTxAccessInfo "" UWORD Com_TxSigInfoIdxOfTxAccessInfoType 0 0 0 65535 ECU_ADDRESS 0x0 /end MEASUREMENT
/begin MEASUREMENT Com_TxAccessInfo[65].TxGrpSigInfoIdxOfTxAccessInfo "" UBYTE Com_TxGrpSigInfoIdxOfTxAccessInfoType 0 0 0 255 ECU_ADDRESS 0x0 /end MEASUREMENT
/begin MEASUREMENT Com_TxAccessInfo[65].TxSigInfoIdxOfTxAccessInfo "" UWORD Com_TxSigInfoIdxOfTxAccessInfoType 0 0 0 65535 ECU_ADDRESS 0x0 /end MEASUREMENT
/begin MEASUREMENT Com_TxAccessInfo[66].TxGrpSigInfoIdxOfTxAccessInfo "" UBYTE Com_TxGrpSigInfoIdxOfTxAccessInfoType 0 0 0 255 ECU_ADDRESS 0x0 /end MEASUREMENT
/begin MEASUREMENT Com_TxAccessInfo[66].TxSigInfoIdxOfTxAccessInfo "" UWORD Com_TxSigInfoIdxOfTxAccessInfoType 0 0 0 65535 ECU_ADDRESS 0x0 /end MEASUREMENT
/begin MEASUREMENT Com_TxAccessInfo[67].TxGrpSigInfoIdxOfTxAccessInfo "" UBYTE Com_TxGrpSigInfoIdxOfTxAccessInfoType 0 0 0 255 ECU_ADDRESS 0x0 /end MEASUREMENT
/begin MEASUREMENT Com_TxAccessInfo[67].TxSigInfoIdxOfTxAccessInfo "" UWORD Com_TxSigInfoIdxOfTxAccessInfoType 0 0 0 65535 ECU_ADDRESS 0x0 /end MEASUREMENT
/begin MEASUREMENT Com_TxAccessInfo[68].TxGrpSigInfoIdxOfTxAccessInfo "" UBYTE Com_TxGrpSigInfoIdxOfTxAccessInfoType 0 0 0 255 ECU_ADDRESS 0x0 /end MEASUREMENT
/begin MEASUREMENT Com_TxAccessInfo[68].TxSigInfoIdxOfTxAccessInfo "" UWORD Com_TxSigInfoIdxOfTxAccessInfoType 0 0 0 65535 ECU_ADDRESS 0x0 /end MEASUREMENT
/begin MEASUREMENT Com_TxAccessInfo[69].TxGrpSigInfoIdxOfTxAccessInfo "" UBYTE Com_TxGrpSigInfoIdxOfTxAccessInfoType 0 0 0 255 ECU_ADDRESS 0x0 /end MEASUREMENT
/begin MEASUREMENT Com_TxAccessInfo[69].TxSigInfoIdxOfTxAccessInfo "" UWORD Com_TxSigInfoIdxOfTxAccessInfoType 0 0 0 65535 ECU_ADDRESS 0x0 /end MEASUREMENT
/begin MEASUREMENT Com_TxAccessInfo[6].TxGrpSigInfoIdxOfTxAccessInfo "" UBYTE Com_TxGrpSigInfoIdxOfTxAccessInfoType 0 0 0 255 ECU_ADDRESS 0x0 /end MEASUREMENT
/begin MEASUREMENT Com_TxAccessInfo[6].TxSigInfoIdxOfTxAccessInfo "" UWORD Com_TxSigInfoIdxOfTxAccessInfoType 0 0 0 65535 ECU_ADDRESS 0x0 /end MEASUREMENT
/begin MEASUREMENT Com_TxAccessInfo[70].TxGrpSigInfoIdxOfTxAccessInfo "" UBYTE Com_TxGrpSigInfoIdxOfTxAccessInfoType 0 0 0 255 ECU_ADDRESS 0x0 /end MEASUREMENT
/begin MEASUREMENT Com_TxAccessInfo[70].TxSigInfoIdxOfTxAccessInfo "" UWORD Com_TxSigInfoIdxOfTxAccessInfoType 0 0 0 65535 ECU_ADDRESS 0x0 /end MEASUREMENT
/begin MEASUREMENT Com_TxAccessInfo[71].TxGrpSigInfoIdxOfTxAccessInfo "" UBYTE Com_TxGrpSigInfoIdxOfTxAccessInfoType 0 0 0 255 ECU_ADDRESS 0x0 /end MEASUREMENT
/begin MEASUREMENT Com_TxAccessInfo[71].TxSigInfoIdxOfTxAccessInfo "" UWORD Com_TxSigInfoIdxOfTxAccessInfoType 0 0 0 65535 ECU_ADDRESS 0x0 /end MEASUREMENT
/begin MEASUREMENT Com_TxAccessInfo[72].TxGrpSigInfoIdxOfTxAccessInfo "" UBYTE Com_TxGrpSigInfoIdxOfTxAccessInfoType 0 0 0 255 ECU_ADDRESS 0x0 /end MEASUREMENT
/begin MEASUREMENT Com_TxAccessInfo[72].TxSigInfoIdxOfTxAccessInfo "" UWORD Com_TxSigInfoIdxOfTxAccessInfoType 0 0 0 65535 ECU_ADDRESS 0x0 /end MEASUREMENT
/begin MEASUREMENT Com_TxAccessInfo[73].TxGrpSigInfoIdxOfTxAccessInfo "" UBYTE Com_TxGrpSigInfoIdxOfTxAccessInfoType 0 0 0 255 ECU_ADDRESS 0x0 /end MEASUREMENT
/begin MEASUREMENT Com_TxAccessInfo[73].TxSigInfoIdxOfTxAccessInfo "" UWORD Com_TxSigInfoIdxOfTxAccessInfoType 0 0 0 65535 ECU_ADDRESS 0x0 /end MEASUREMENT
/begin MEASUREMENT Com_TxAccessInfo[74].TxGrpSigInfoIdxOfTxAccessInfo "" UBYTE Com_TxGrpSigInfoIdxOfTxAccessInfoType 0 0 0 255 ECU_ADDRESS 0x0 /end MEASUREMENT
/begin MEASUREMENT Com_TxAccessInfo[74].TxSigInfoIdxOfTxAccessInfo "" UWORD Com_TxSigInfoIdxOfTxAccessInfoType 0 0 0 65535 ECU_ADDRESS 0x0 /end MEASUREMENT
/begin MEASUREMENT Com_TxAccessInfo[75].TxGrpSigInfoIdxOfTxAccessInfo "" UBYTE Com_TxGrpSigInfoIdxOfTxAccessInfoType 0 0 0 255 ECU_ADDRESS 0x0 /end MEASUREMENT
/begin MEASUREMENT Com_TxAccessInfo[75].TxSigInfoIdxOfTxAccessInfo "" UWORD Com_TxSigInfoIdxOfTxAccessInfoType 0 0 0 65535 ECU_ADDRESS 0x0 /end MEASUREMENT
/begin MEASUREMENT Com_TxAccessInfo[76].TxGrpSigInfoIdxOfTxAccessInfo "" UBYTE Com_TxGrpSigInfoIdxOfTxAccessInfoType 0 0 0 255 ECU_ADDRESS 0x0 /end MEASUREMENT
/begin MEASUREMENT Com_TxAccessInfo[76].TxSigInfoIdxOfTxAccessInfo "" UWORD Com_TxSigInfoIdxOfTxAccessInfoType 0 0 0 65535 ECU_ADDRESS 0x0 /end MEASUREMENT
/begin MEASUREMENT Com_TxAccessInfo[77].TxGrpSigInfoIdxOfTxAccessInfo "" UBYTE Com_TxGrpSigInfoIdxOfTxAccessInfoType 0 0 0 255 ECU_ADDRESS 0x0 /end MEASUREMENT
/begin MEASUREMENT Com_TxAccessInfo[77].TxSigInfoIdxOfTxAccessInfo "" UWORD Com_TxSigInfoIdxOfTxAccessInfoType 0 0 0 65535 ECU_ADDRESS 0x0 /end MEASUREMENT
/begin MEASUREMENT Com_TxAccessInfo[78].TxGrpSigInfoIdxOfTxAccessInfo "" UBYTE Com_TxGrpSigInfoIdxOfTxAccessInfoType 0 0 0 255 ECU_ADDRESS 0x0 /end MEASUREMENT
/begin MEASUREMENT Com_TxAccessInfo[78].TxSigInfoIdxOfTxAccessInfo "" UWORD Com_TxSigInfoIdxOfTxAccessInfoType 0 0 0 65535 ECU_ADDRESS 0x0 /end MEASUREMENT
/begin MEASUREMENT Com_TxAccessInfo[79].TxGrpSigInfoIdxOfTxAccessInfo "" UBYTE Com_TxGrpSigInfoIdxOfTxAccessInfoType 0 0 0 255 ECU_ADDRESS 0x0 /end MEASUREMENT
/begin MEASUREMENT Com_TxAccessInfo[79].TxSigInfoIdxOfTxAccessInfo "" UWORD Com_TxSigInfoIdxOfTxAccessInfoType 0 0 0 65535 ECU_ADDRESS 0x0 /end MEASUREMENT
/begin MEASUREMENT Com_TxAccessInfo[7].TxGrpSigInfoIdxOfTxAccessInfo "" UBYTE Com_TxGrpSigInfoIdxOfTxAccessInfoType 0 0 0 255 ECU_ADDRESS 0x0 /end MEASUREMENT
/begin MEASUREMENT Com_TxAccessInfo[7].TxSigInfoIdxOfTxAccessInfo "" UWORD Com_TxSigInfoIdxOfTxAccessInfoType 0 0 0 65535 ECU_ADDRESS 0x0 /end MEASUREMENT
/begin MEASUREMENT Com_TxAccessInfo[80].TxGrpSigInfoIdxOfTxAccessInfo "" UBYTE Com_TxGrpSigInfoIdxOfTxAccessInfoType 0 0 0 255 ECU_ADDRESS 0x0 /end MEASUREMENT
/begin MEASUREMENT Com_TxAccessInfo[80].TxSigInfoIdxOfTxAccessInfo "" UWORD Com_TxSigInfoIdxOfTxAccessInfoType 0 0 0 65535 ECU_ADDRESS 0x0 /end MEASUREMENT
/begin MEASUREMENT Com_TxAccessInfo[81].TxGrpSigInfoIdxOfTxAccessInfo "" UBYTE Com_TxGrpSigInfoIdxOfTxAccessInfoType 0 0 0 255 ECU_ADDRESS 0x0 /end MEASUREMENT
/begin MEASUREMENT Com_TxAccessInfo[81].TxSigInfoIdxOfTxAccessInfo "" UWORD Com_TxSigInfoIdxOfTxAccessInfoType 0 0 0 65535 ECU_ADDRESS 0x0 /end MEASUREMENT
/begin MEASUREMENT Com_TxAccessInfo[82].TxGrpSigInfoIdxOfTxAccessInfo "" UBYTE Com_TxGrpSigInfoIdxOfTxAccessInfoType 0 0 0 255 ECU_ADDRESS 0x0 /end MEASUREMENT
/begin MEASUREMENT Com_TxAccessInfo[82].TxSigInfoIdxOfTxAccessInfo "" UWORD Com_TxSigInfoIdxOfTxAccessInfoType 0 0 0 65535 ECU_ADDRESS 0x0 /end MEASUREMENT
/begin MEASUREMENT Com_TxAccessInfo[83].TxGrpSigInfoIdxOfTxAccessInfo "" UBYTE Com_TxGrpSigInfoIdxOfTxAccessInfoType 0 0 0 255 ECU_ADDRESS 0x0 /end MEASUREMENT
/begin MEASUREMENT Com_TxAccessInfo[83].TxSigInfoIdxOfTxAccessInfo "" UWORD Com_TxSigInfoIdxOfTxAccessInfoType 0 0 0 65535 ECU_ADDRESS 0x0 /end MEASUREMENT
/begin MEASUREMENT Com_TxAccessInfo[84].TxGrpSigInfoIdxOfTxAccessInfo "" UBYTE Com_TxGrpSigInfoIdxOfTxAccessInfoType 0 0 0 255 ECU_ADDRESS 0x0 /end MEASUREMENT
/begin MEASUREMENT Com_TxAccessInfo[84].TxSigInfoIdxOfTxAccessInfo "" UWORD Com_TxSigInfoIdxOfTxAccessInfoType 0 0 0 65535 ECU_ADDRESS 0x0 /end MEASUREMENT
/begin MEASUREMENT Com_TxAccessInfo[85].TxGrpSigInfoIdxOfTxAccessInfo "" UBYTE Com_TxGrpSigInfoIdxOfTxAccessInfoType 0 0 0 255 ECU_ADDRESS 0x0 /end MEASUREMENT
/begin MEASUREMENT Com_TxAccessInfo[85].TxSigInfoIdxOfTxAccessInfo "" UWORD Com_TxSigInfoIdxOfTxAccessInfoType 0 0 0 65535 ECU_ADDRESS 0x0 /end MEASUREMENT
/begin MEASUREMENT Com_TxAccessInfo[86].TxGrpSigInfoIdxOfTxAccessInfo "" UBYTE Com_TxGrpSigInfoIdxOfTxAccessInfoType 0 0 0 255 ECU_ADDRESS 0x0 /end MEASUREMENT
/begin MEASUREMENT Com_TxAccessInfo[86].TxSigInfoIdxOfTxAccessInfo "" UWORD Com_TxSigInfoIdxOfTxAccessInfoType 0 0 0 65535 ECU_ADDRESS 0x0 /end MEASUREMENT
/begin MEASUREMENT Com_TxAccessInfo[87].TxGrpSigInfoIdxOfTxAccessInfo "" UBYTE Com_TxGrpSigInfoIdxOfTxAccessInfoType 0 0 0 255 ECU_ADDRESS 0x0 /end MEASUREMENT
/begin MEASUREMENT Com_TxAccessInfo[87].TxSigInfoIdxOfTxAccessInfo "" UWORD Com_TxSigInfoIdxOfTxAccessInfoType 0 0 0 65535 ECU_ADDRESS 0x0 /end MEASUREMENT
/begin MEASUREMENT Com_TxAccessInfo[88].TxGrpSigInfoIdxOfTxAccessInfo "" UBYTE Com_TxGrpSigInfoIdxOfTxAccessInfoType 0 0 0 255 ECU_ADDRESS 0x0 /end MEASUREMENT
/begin MEASUREMENT Com_TxAccessInfo[88].TxSigInfoIdxOfTxAccessInfo "" UWORD Com_TxSigInfoIdxOfTxAccessInfoType 0 0 0 65535 ECU_ADDRESS 0x0 /end MEASUREMENT
/begin MEASUREMENT Com_TxAccessInfo[89].TxGrpSigInfoIdxOfTxAccessInfo "" UBYTE Com_TxGrpSigInfoIdxOfTxAccessInfoType 0 0 0 255 ECU_ADDRESS 0x0 /end MEASUREMENT
/begin MEASUREMENT Com_TxAccessInfo[89].TxSigInfoIdxOfTxAccessInfo "" UWORD Com_TxSigInfoIdxOfTxAccessInfoType 0 0 0 65535 ECU_ADDRESS 0x0 /end MEASUREMENT
/begin MEASUREMENT Com_TxAccessInfo[8].TxGrpSigInfoIdxOfTxAccessInfo "" UBYTE Com_TxGrpSigInfoIdxOfTxAccessInfoType 0 0 0 255 ECU_ADDRESS 0x0 /end MEASUREMENT
/begin MEASUREMENT Com_TxAccessInfo[8].TxSigInfoIdxOfTxAccessInfo "" UWORD Com_TxSigInfoIdxOfTxAccessInfoType 0 0 0 65535 ECU_ADDRESS 0x0 /end MEASUREMENT
/begin MEASUREMENT Com_TxAccessInfo[90].TxGrpSigInfoIdxOfTxAccessInfo "" UBYTE Com_TxGrpSigInfoIdxOfTxAccessInfoType 0 0 0 255 ECU_ADDRESS 0x0 /end MEASUREMENT
/begin MEASUREMENT Com_TxAccessInfo[90].TxSigInfoIdxOfTxAccessInfo "" UWORD Com_TxSigInfoIdxOfTxAccessInfoType 0 0 0 65535 ECU_ADDRESS 0x0 /end MEASUREMENT
/begin MEASUREMENT Com_TxAccessInfo[91].TxGrpSigInfoIdxOfTxAccessInfo "" UBYTE Com_TxGrpSigInfoIdxOfTxAccessInfoType 0 0 0 255 ECU_ADDRESS 0x0 /end MEASUREMENT
/begin MEASUREMENT Com_TxAccessInfo[91].TxSigInfoIdxOfTxAccessInfo "" UWORD Com_TxSigInfoIdxOfTxAccessInfoType 0 0 0 65535 ECU_ADDRESS 0x0 /end MEASUREMENT
/begin MEASUREMENT Com_TxAccessInfo[92].TxGrpSigInfoIdxOfTxAccessInfo "" UBYTE Com_TxGrpSigInfoIdxOfTxAccessInfoType 0 0 0 255 ECU_ADDRESS 0x0 /end MEASUREMENT
/begin MEASUREMENT Com_TxAccessInfo[92].TxSigInfoIdxOfTxAccessInfo "" UWORD Com_TxSigInfoIdxOfTxAccessInfoType 0 0 0 65535 ECU_ADDRESS 0x0 /end MEASUREMENT
/begin MEASUREMENT Com_TxAccessInfo[93].TxGrpSigInfoIdxOfTxAccessInfo "" UBYTE Com_TxGrpSigInfoIdxOfTxAccessInfoType 0 0 0 255 ECU_ADDRESS 0x0 /end MEASUREMENT
/begin MEASUREMENT Com_TxAccessInfo[93].TxSigInfoIdxOfTxAccessInfo "" UWORD Com_TxSigInfoIdxOfTxAccessInfoType 0 0 0 65535 ECU_ADDRESS 0x0 /end MEASUREMENT
/begin MEASUREMENT Com_TxAccessInfo[94].TxGrpSigInfoIdxOfTxAccessInfo "" UBYTE Com_TxGrpSigInfoIdxOfTxAccessInfoType 0 0 0 255 ECU_ADDRESS 0x0 /end MEASUREMENT
/begin MEASUREMENT Com_TxAccessInfo[94].TxSigInfoIdxOfTxAccessInfo "" UWORD Com_TxSigInfoIdxOfTxAccessInfoType 0 0 0 65535 ECU_ADDRESS 0x0 /end MEASUREMENT
/begin MEASUREMENT Com_TxAccessInfo[95].TxGrpSigInfoIdxOfTxAccessInfo "" UBYTE Com_TxGrpSigInfoIdxOfTxAccessInfoType 0 0 0 255 ECU_ADDRESS 0x0 /end MEASUREMENT
/begin MEASUREMENT Com_TxAccessInfo[95].TxSigInfoIdxOfTxAccessInfo "" UWORD Com_TxSigInfoIdxOfTxAccessInfoType 0 0 0 65535 ECU_ADDRESS 0x0 /end MEASUREMENT
/begin MEASUREMENT Com_TxAccessInfo[96].TxGrpSigInfoIdxOfTxAccessInfo "" UBYTE Com_TxGrpSigInfoIdxOfTxAccessInfoType 0 0 0 255 ECU_ADDRESS 0x0 /end MEASUREMENT
/begin MEASUREMENT Com_TxAccessInfo[96].TxSigInfoIdxOfTxAccessInfo "" UWORD Com_TxSigInfoIdxOfTxAccessInfoType 0 0 0 65535 ECU_ADDRESS 0x0 /end MEASUREMENT
/begin MEASUREMENT Com_TxAccessInfo[97].TxGrpSigInfoIdxOfTxAccessInfo "" UBYTE Com_TxGrpSigInfoIdxOfTxAccessInfoType 0 0 0 255 ECU_ADDRESS 0x0 /end MEASUREMENT
/begin MEASUREMENT Com_TxAccessInfo[97].TxSigInfoIdxOfTxAccessInfo "" UWORD Com_TxSigInfoIdxOfTxAccessInfoType 0 0 0 65535 ECU_ADDRESS 0x0 /end MEASUREMENT
/begin MEASUREMENT Com_TxAccessInfo[98].TxGrpSigInfoIdxOfTxAccessInfo "" UBYTE Com_TxGrpSigInfoIdxOfTxAccessInfoType 0 0 0 255 ECU_ADDRESS 0x0 /end MEASUREMENT
/begin MEASUREMENT Com_TxAccessInfo[98].TxSigInfoIdxOfTxAccessInfo "" UWORD Com_TxSigInfoIdxOfTxAccessInfoType 0 0 0 65535 ECU_ADDRESS 0x0 /end MEASUREMENT
/begin MEASUREMENT Com_TxAccessInfo[99].TxGrpSigInfoIdxOfTxAccessInfo "" UBYTE Com_TxGrpSigInfoIdxOfTxAccessInfoType 0 0 0 255 ECU_ADDRESS 0x0 /end MEASUREMENT
/begin MEASUREMENT Com_TxAccessInfo[99].TxSigInfoIdxOfTxAccessInfo "" UWORD Com_TxSigInfoIdxOfTxAccessInfoType 0 0 0 65535 ECU_ADDRESS 0x0 /end MEASUREMENT
/begin MEASUREMENT Com_TxAccessInfo[9].TxGrpSigInfoIdxOfTxAccessInfo "" UBYTE Com_TxGrpSigInfoIdxOfTxAccessInfoType 0 0 0 255 ECU_ADDRESS 0x0 /end MEASUREMENT
/begin MEASUREMENT Com_TxAccessInfo[9].TxSigInfoIdxOfTxAccessInfo "" UWORD Com_TxSigInfoIdxOfTxAccessInfoType 0 0 0 65535 ECU_ADDRESS 0x0 /end MEASUREMENT
/begin MEASUREMENT Com_TxBuffer "Shared uint8 buffer for Tx I-PDUs and ComSignalGroup shadow buffer." UBYTE NO_COMPU_METHOD 0 0 0 255 ECU_ADDRESS 0x0 MATRIX_DIM 972 /end MEASUREMENT
/begin MEASUREMENT Com_TxCyclicPdu[0].TxPduInfoIdxOfTxCyclicPdu "" UBYTE NO_COMPU_METHOD 0 0 0 255 ECU_ADDRESS 0x0 /end MEASUREMENT
/begin MEASUREMENT Com_TxCyclicPdu[10].TxPduInfoIdxOfTxCyclicPdu "" UBYTE NO_COMPU_METHOD 0 0 0 255 ECU_ADDRESS 0x0 /end MEASUREMENT
/begin MEASUREMENT Com_TxCyclicPdu[11].TxPduInfoIdxOfTxCyclicPdu "" UBYTE NO_COMPU_METHOD 0 0 0 255 ECU_ADDRESS 0x0 /end MEASUREMENT
/begin MEASUREMENT Com_TxCyclicPdu[12].TxPduInfoIdxOfTxCyclicPdu "" UBYTE NO_COMPU_METHOD 0 0 0 255 ECU_ADDRESS 0x0 /end MEASUREMENT
/begin MEASUREMENT Com_TxCyclicPdu[13].TxPduInfoIdxOfTxCyclicPdu "" UBYTE NO_COMPU_METHOD 0 0 0 255 ECU_ADDRESS 0x0 /end MEASUREMENT
/begin MEASUREMENT Com_TxCyclicPdu[14].TxPduInfoIdxOfTxCyclicPdu "" UBYTE NO_COMPU_METHOD 0 0 0 255 ECU_ADDRESS 0x0 /end MEASUREMENT
/begin MEASUREMENT Com_TxCyclicPdu[15].TxPduInfoIdxOfTxCyclicPdu "" UBYTE NO_COMPU_METHOD 0 0 0 255 ECU_ADDRESS 0x0 /end MEASUREMENT
/begin MEASUREMENT Com_TxCyclicPdu[16].TxPduInfoIdxOfTxCyclicPdu "" UBYTE NO_COMPU_METHOD 0 0 0 255 ECU_ADDRESS 0x0 /end MEASUREMENT
/begin MEASUREMENT Com_TxCyclicPdu[17].TxPduInfoIdxOfTxCyclicPdu "" UBYTE NO_COMPU_METHOD 0 0 0 255 ECU_ADDRESS 0x0 /end MEASUREMENT
/begin MEASUREMENT Com_TxCyclicPdu[18].TxPduInfoIdxOfTxCyclicPdu "" UBYTE NO_COMPU_METHOD 0 0 0 255 ECU_ADDRESS 0x0 /end MEASUREMENT
/begin MEASUREMENT Com_TxCyclicPdu[19].TxPduInfoIdxOfTxCyclicPdu "" UBYTE NO_COMPU_METHOD 0 0 0 255 ECU_ADDRESS 0x0 /end MEASUREMENT
/begin MEASUREMENT Com_TxCyclicPdu[1].TxPduInfoIdxOfTxCyclicPdu "" UBYTE NO_COMPU_METHOD 0 0 0 255 ECU_ADDRESS 0x0 /end MEASUREMENT
/begin MEASUREMENT Com_TxCyclicPdu[2].TxPduInfoIdxOfTxCyclicPdu "" UBYTE NO_COMPU_METHOD 0 0 0 255 ECU_ADDRESS 0x0 /end MEASUREMENT
/begin MEASUREMENT Com_TxCyclicPdu[3].TxPduInfoIdxOfTxCyclicPdu "" UBYTE NO_COMPU_METHOD 0 0 0 255 ECU_ADDRESS 0x0 /end MEASUREMENT
/begin MEASUREMENT Com_TxCyclicPdu[4].TxPduInfoIdxOfTxCyclicPdu "" UBYTE NO_COMPU_METHOD 0 0 0 255 ECU_ADDRESS 0x0 /end MEASUREMENT
/begin MEASUREMENT Com_TxCyclicPdu[5].TxPduInfoIdxOfTxCyclicPdu "" UBYTE NO_COMPU_METHOD 0 0 0 255 ECU_ADDRESS 0x0 /end MEASUREMENT
/begin MEASUREMENT Com_TxCyclicPdu[6].TxPduInfoIdxOfTxCyclicPdu "" UBYTE NO_COMPU_METHOD 0 0 0 255 ECU_ADDRESS 0x0 /end MEASUREMENT
/begin MEASUREMENT Com_TxCyclicPdu[7].TxPduInfoIdxOfTxCyclicPdu "" UBYTE NO_COMPU_METHOD 0 0 0 255 ECU_ADDRESS 0x0 /end MEASUREMENT
/begin MEASUREMENT Com_TxCyclicPdu[8].TxPduInfoIdxOfTxCyclicPdu "" UBYTE NO_COMPU_METHOD 0 0 0 255 ECU_ADDRESS 0x0 /end MEASUREMENT
/begin MEASUREMENT Com_TxCyclicPdu[9].TxPduInfoIdxOfTxCyclicPdu "" UBYTE NO_COMPU_METHOD 0 0 0 255 ECU_ADDRESS 0x0 /end MEASUREMENT
/begin MEASUREMENT Com_TxFilterInitValueArrayBased "Contains the initial values used for initialization of the old value to evaluate the filter algorithm. (UINT8_N, UINT8_DYN)" UBYTE NO_COMPU_METHOD 0 0 0 255 ECU_ADDRESS 0x0 MATRIX_DIM 72 /end MEASUREMENT
/begin MEASUREMENT Com_TxFilterInitValueUInt16 "Contains the initial values used for initialization of the old value to evaluate the filter algorithm. (UINT16)" UWORD NO_COMPU_METHOD 0 0 0 65535 ECU_ADDRESS 0x0 MATRIX_DIM 2 /end MEASUREMENT
/begin MEASUREMENT Com_TxFilterInitValueUInt8 "Contains the initial values used for initialization of the old value to evaluate the filter algorithm. (BOOLEAN, UINT8)" UBYTE NO_COMPU_METHOD 0 0 0 255 ECU_ADDRESS 0x0 MATRIX_DIM 8 /end MEASUREMENT
/begin MEASUREMENT Com_TxFilterOldValueArrayBased "This buffer holds the old signal values for filter MASKED_NEW_DIFFERS_MASKED_OLD and for transfer property TRIGGERED_ON_CHANGE_* evaluation. (UINT8_N)" UBYTE NO_COMPU_METHOD 0 0 0 255 ECU_ADDRESS 0x0 MATRIX_DIM 72 /end MEASUREMENT
/begin MEASUREMENT Com_TxFilterOldValueUInt16 "This buffer holds the old signal values for filter MASKED_NEW_DIFFERS_MASKED_OLD and for transfer property TRIGGERED_ON_CHANGE_* evaluation. (UINT16)" UWORD NO_COMPU_METHOD 0 0 0 65535 ECU_ADDRESS 0x0 MATRIX_DIM 2 /end MEASUREMENT
/begin MEASUREMENT Com_TxFilterOldValueUInt8 "This buffer holds the old signal values for filter MASKED_NEW_DIFFERS_MASKED_OLD and for transfer property TRIGGERED_ON_CHANGE_* evaluation. (BOOLEAN, UINT8)" UBYTE NO_COMPU_METHOD 0 0 0 255 ECU_ADDRESS 0x0 MATRIX_DIM 8 /end MEASUREMENT
/begin MEASUREMENT Com_TxGrpSigInfoInvValueInd "the indexes of the 1:1 sorted relation pointing to Com_TxGrpSigInfo" UBYTE NO_COMPU_METHOD 0 0 0 255 ECU_ADDRESS 0x0 MATRIX_DIM 57 /end MEASUREMENT
/begin MEASUREMENT Com_TxGrpSigInfo[0].ApplTypeOfTxGrpSigInfo "" UBYTE Com_ApplTypeOfTxGrpSigInfoType 0 0 0 255 ECU_ADDRESS 0x0 /end MEASUREMENT
/begin MEASUREMENT Com_TxGrpSigInfo[0].BitLengthOfTxGrpSigInfo "" UBYTE NO_COMPU_METHOD 0 0 0 255 ECU_ADDRESS 0x0 /end MEASUREMENT
/begin MEASUREMENT Com_TxGrpSigInfo[0].BitPositionOfTxGrpSigInfo "" UWORD NO_COMPU_METHOD 0 0 0 65535 ECU_ADDRESS 0x0 /end MEASUREMENT
/begin MEASUREMENT Com_TxGrpSigInfo[0].BusAccOfTxGrpSigInfo "" UBYTE Com_BusAccOfTxGrpSigInfoType 0 0 0 255 ECU_ADDRESS 0x0 /end MEASUREMENT
/begin MEASUREMENT Com_TxGrpSigInfo[0].ByteLengthOfTxGrpSigInfo "" UBYTE NO_COMPU_METHOD 0 0 0 255 ECU_ADDRESS 0x0 /end MEASUREMENT
/begin MEASUREMENT Com_TxGrpSigInfo[0].DynSignalOfTxGrpSigInfo "" UBYTE Com_DynSignalOfTxGrpSigInfoType 0 0 0 1 ECU_ADDRESS 0x0 /end MEASUREMENT
/begin MEASUREMENT Com_TxGrpSigInfo[0].InvValueIdxOfTxGrpSigInfo "" UBYTE Com_InvValueIdxOfTxGrpSigInfoType 0 0 0 255 ECU_ADDRESS 0x0 /end MEASUREMENT
/begin MEASUREMENT Com_TxGrpSigInfo[0].InvValueOfTxGrpSigInfo "" UBYTE Com_InvValueOfTxGrpSigInfoType 0 0 0 255 ECU_ADDRESS 0x0 /end MEASUREMENT
/begin MEASUREMENT Com_TxGrpSigInfo[0].StartByteInPduPositionOfTxGrpSigInfo "" UBYTE NO_COMPU_METHOD 0 0 0 255 ECU_ADDRESS 0x0 /end MEASUREMENT
/begin MEASUREMENT Com_TxGrpSigInfo[0].TxBufferEndIdxOfTxGrpSigInfo "" UWORD Com_TxBufferEndIdxOfTxGrpSigInfoType 0 0 0 65535 ECU_ADDRESS 0x0 /end MEASUREMENT
/begin MEASUREMENT Com_TxGrpSigInfo[0].TxBufferStartIdxOfTxGrpSigInfo "" UWORD Com_TxBufferStartIdxOfTxGrpSigInfoType 0 0 0 65535 ECU_ADDRESS 0x0 /end MEASUREMENT
/begin MEASUREMENT Com_TxGrpSigInfo[0].TxPduInfoIdxOfTxGrpSigInfo "" UBYTE NO_COMPU_METHOD 0 0 0 255 ECU_ADDRESS 0x0 /end MEASUREMENT
/begin MEASUREMENT Com_TxGrpSigInfo[0].TxSigGrpInfoIdxOfTxGrpSigInfo "" UBYTE NO_COMPU_METHOD 0 0 0 255 ECU_ADDRESS 0x0 /end MEASUREMENT
/begin MEASUREMENT Com_TxGrpSigInfo[0].WithoutRepOfTxGrpSigInfo "" UBYTE Com_WithoutRepOfTxGrpSigInfoType 0 0 0 1 ECU_ADDRESS 0x0 /end MEASUREMENT
/begin MEASUREMENT Com_TxGrpSigInfo[100].ApplTypeOfTxGrpSigInfo "" UBYTE Com_ApplTypeOfTxGrpSigInfoType 0 0 0 255 ECU_ADDRESS 0x0 /end MEASUREMENT
/begin MEASUREMENT Com_TxGrpSigInfo[100].BitLengthOfTxGrpSigInfo "" UBYTE NO_COMPU_METHOD 0 0 0 255 ECU_ADDRESS 0x0 /end MEASUREMENT
/begin MEASUREMENT Com_TxGrpSigInfo[100].BitPositionOfTxGrpSigInfo "" UWORD NO_COMPU_METHOD 0 0 0 65535 ECU_ADDRESS 0x0 /end MEASUREMENT
/begin MEASUREMENT Com_TxGrpSigInfo[100].BusAccOfTxGrpSigInfo "" UBYTE Com_BusAccOfTxGrpSigInfoType 0 0 0 255 ECU_ADDRESS 0x0 /end MEASUREMENT
/begin MEASUREMENT Com_TxGrpSigInfo[100].ByteLengthOfTxGrpSigInfo "" UBYTE NO_COMPU_METHOD 0 0 0 255 ECU_ADDRESS 0x0 /end MEASUREMENT
/begin MEASUREMENT Com_TxGrpSigInfo[100].DynSignalOfTxGrpSigInfo "" UBYTE Com_DynSignalOfTxGrpSigInfoType 0 0 0 1 ECU_ADDRESS 0x0 /end MEASUREMENT
/begin MEASUREMENT Com_TxGrpSigInfo[100].InvValueIdxOfTxGrpSigInfo "" UBYTE Com_InvValueIdxOfTxGrpSigInfoType 0 0 0 255 ECU_ADDRESS 0x0 /end MEASUREMENT
/begin MEASUREMENT Com_TxGrpSigInfo[100].InvValueOfTxGrpSigInfo "" UBYTE Com_InvValueOfTxGrpSigInfoType 0 0 0 255 ECU_ADDRESS 0x0 /end MEASUREMENT
/begin MEASUREMENT Com_TxGrpSigInfo[100].StartByteInPduPositionOfTxGrpSigInfo "" UBYTE NO_COMPU_METHOD 0 0 0 255 ECU_ADDRESS 0x0 /end MEASUREMENT
/begin MEASUREMENT Com_TxGrpSigInfo[100].TxBufferEndIdxOfTxGrpSigInfo "" UWORD Com_TxBufferEndIdxOfTxGrpSigInfoType 0 0 0 65535 ECU_ADDRESS 0x0 /end MEASUREMENT
/begin MEASUREMENT Com_TxGrpSigInfo[100].TxBufferStartIdxOfTxGrpSigInfo "" UWORD Com_TxBufferStartIdxOfTxGrpSigInfoType 0 0 0 65535 ECU_ADDRESS 0x0 /end MEASUREMENT
/begin MEASUREMENT Com_TxGrpSigInfo[100].TxPduInfoIdxOfTxGrpSigInfo "" UBYTE NO_COMPU_METHOD 0 0 0 255 ECU_ADDRESS 0x0 /end MEASUREMENT
/begin MEASUREMENT Com_TxGrpSigInfo[100].TxSigGrpInfoIdxOfTxGrpSigInfo "" UBYTE NO_COMPU_METHOD 0 0 0 255 ECU_ADDRESS 0x0 /end MEASUREMENT
/begin MEASUREMENT Com_TxGrpSigInfo[100].WithoutRepOfTxGrpSigInfo "" UBYTE Com_WithoutRepOfTxGrpSigInfoType 0 0 0 1 ECU_ADDRESS 0x0 /end MEASUREMENT
/begin MEASUREMENT Com_TxGrpSigInfo[101].ApplTypeOfTxGrpSigInfo "" UBYTE Com_ApplTypeOfTxGrpSigInfoType 0 0 0 255 ECU_ADDRESS 0x0 /end MEASUREMENT
/begin MEASUREMENT Com_TxGrpSigInfo[101].BitLengthOfTxGrpSigInfo "" UBYTE NO_COMPU_METHOD 0 0 0 255 ECU_ADDRESS 0x0 /end MEASUREMENT
/begin MEASUREMENT Com_TxGrpSigInfo[101].BitPositionOfTxGrpSigInfo "" UWORD NO_COMPU_METHOD 0 0 0 65535 ECU_ADDRESS 0x0 /end MEASUREMENT
/begin MEASUREMENT Com_TxGrpSigInfo[101].BusAccOfTxGrpSigInfo "" UBYTE Com_BusAccOfTxGrpSigInfoType 0 0 0 255 ECU_ADDRESS 0x0 /end MEASUREMENT
/begin MEASUREMENT Com_TxGrpSigInfo[101].ByteLengthOfTxGrpSigInfo "" UBYTE NO_COMPU_METHOD 0 0 0 255 ECU_ADDRESS 0x0 /end MEASUREMENT
/begin MEASUREMENT Com_TxGrpSigInfo[101].DynSignalOfTxGrpSigInfo "" UBYTE Com_DynSignalOfTxGrpSigInfoType 0 0 0 1 ECU_ADDRESS 0x0 /end MEASUREMENT
/begin MEASUREMENT Com_TxGrpSigInfo[101].InvValueIdxOfTxGrpSigInfo "" UBYTE Com_InvValueIdxOfTxGrpSigInfoType 0 0 0 255 ECU_ADDRESS 0x0 /end MEASUREMENT
/begin MEASUREMENT Com_TxGrpSigInfo[101].InvValueOfTxGrpSigInfo "" UBYTE Com_InvValueOfTxGrpSigInfoType 0 0 0 255 ECU_ADDRESS 0x0 /end MEASUREMENT
/begin MEASUREMENT Com_TxGrpSigInfo[101].StartByteInPduPositionOfTxGrpSigInfo "" UBYTE NO_COMPU_METHOD 0 0 0 255 ECU_ADDRESS 0x0 /end MEASUREMENT
/begin MEASUREMENT Com_TxGrpSigInfo[101].TxBufferEndIdxOfTxGrpSigInfo "" UWORD Com_TxBufferEndIdxOfTxGrpSigInfoType 0 0 0 65535 ECU_ADDRESS 0x0 /end MEASUREMENT
/begin MEASUREMENT Com_TxGrpSigInfo[101].TxBufferStartIdxOfTxGrpSigInfo "" UWORD Com_TxBufferStartIdxOfTxGrpSigInfoType 0 0 0 65535 ECU_ADDRESS 0x0 /end MEASUREMENT
/begin MEASUREMENT Com_TxGrpSigInfo[101].TxPduInfoIdxOfTxGrpSigInfo "" UBYTE NO_COMPU_METHOD 0 0 0 255 ECU_ADDRESS 0x0 /end MEASUREMENT
/begin MEASUREMENT Com_TxGrpSigInfo[101].TxSigGrpInfoIdxOfTxGrpSigInfo "" UBYTE NO_COMPU_METHOD 0 0 0 255 ECU_ADDRESS 0x0 /end MEASUREMENT
/begin MEASUREMENT Com_TxGrpSigInfo[101].WithoutRepOfTxGrpSigInfo "" UBYTE Com_WithoutRepOfTxGrpSigInfoType 0 0 0 1 ECU_ADDRESS 0x0 /end MEASUREMENT
/begin MEASUREMENT Com_TxGrpSigInfo[102].ApplTypeOfTxGrpSigInfo "" UBYTE Com_ApplTypeOfTxGrpSigInfoType 0 0 0 255 ECU_ADDRESS 0x0 /end MEASUREMENT
/begin MEASUREMENT Com_TxGrpSigInfo[102].BitLengthOfTxGrpSigInfo "" UBYTE NO_COMPU_METHOD 0 0 0 255 ECU_ADDRESS 0x0 /end MEASUREMENT
/begin MEASUREMENT Com_TxGrpSigInfo[102].BitPositionOfTxGrpSigInfo "" UWORD NO_COMPU_METHOD 0 0 0 65535 ECU_ADDRESS 0x0 /end MEASUREMENT
/begin MEASUREMENT Com_TxGrpSigInfo[102].BusAccOfTxGrpSigInfo "" UBYTE Com_BusAccOfTxGrpSigInfoType 0 0 0 255 ECU_ADDRESS 0x0 /end MEASUREMENT
/begin MEASUREMENT Com_TxGrpSigInfo[102].ByteLengthOfTxGrpSigInfo "" UBYTE NO_COMPU_METHOD 0 0 0 255 ECU_ADDRESS 0x0 /end MEASUREMENT
/begin MEASUREMENT Com_TxGrpSigInfo[102].DynSignalOfTxGrpSigInfo "" UBYTE Com_DynSignalOfTxGrpSigInfoType 0 0 0 1 ECU_ADDRESS 0x0 /end MEASUREMENT
/begin MEASUREMENT Com_TxGrpSigInfo[102].InvValueIdxOfTxGrpSigInfo "" UBYTE Com_InvValueIdxOfTxGrpSigInfoType 0 0 0 255 ECU_ADDRESS 0x0 /end MEASUREMENT
/begin MEASUREMENT Com_TxGrpSigInfo[102].InvValueOfTxGrpSigInfo "" UBYTE Com_InvValueOfTxGrpSigInfoType 0 0 0 255 ECU_ADDRESS 0x0 /end MEASUREMENT
/begin MEASUREMENT Com_TxGrpSigInfo[102].StartByteInPduPositionOfTxGrpSigInfo "" UBYTE NO_COMPU_METHOD 0 0 0 255 ECU_ADDRESS 0x0 /end MEASUREMENT
/begin MEASUREMENT Com_TxGrpSigInfo[102].TxBufferEndIdxOfTxGrpSigInfo "" UWORD Com_TxBufferEndIdxOfTxGrpSigInfoType 0 0 0 65535 ECU_ADDRESS 0x0 /end MEASUREMENT
/begin MEASUREMENT Com_TxGrpSigInfo[102].TxBufferStartIdxOfTxGrpSigInfo "" UWORD Com_TxBufferStartIdxOfTxGrpSigInfoType 0 0 0 65535 ECU_ADDRESS 0x0 /end MEASUREMENT
/begin MEASUREMENT Com_TxGrpSigInfo[102].TxPduInfoIdxOfTxGrpSigInfo "" UBYTE NO_COMPU_METHOD 0 0 0 255 ECU_ADDRESS 0x0 /end MEASUREMENT
/begin MEASUREMENT Com_TxGrpSigInfo[102].TxSigGrpInfoIdxOfTxGrpSigInfo "" UBYTE NO_COMPU_METHOD 0 0 0 255 ECU_ADDRESS 0x0 /end MEASUREMENT
/begin MEASUREMENT Com_TxGrpSigInfo[102].WithoutRepOfTxGrpSigInfo "" UBYTE Com_WithoutRepOfTxGrpSigInfoType 0 0 0 1 ECU_ADDRESS 0x0 /end MEASUREMENT
/begin MEASUREMENT Com_TxGrpSigInfo[103].ApplTypeOfTxGrpSigInfo "" UBYTE Com_ApplTypeOfTxGrpSigInfoType 0 0 0 255 ECU_ADDRESS 0x0 /end MEASUREMENT
/begin MEASUREMENT Com_TxGrpSigInfo[103].BitLengthOfTxGrpSigInfo "" UBYTE NO_COMPU_METHOD 0 0 0 255 ECU_ADDRESS 0x0 /end MEASUREMENT
/begin MEASUREMENT Com_TxGrpSigInfo[103].BitPositionOfTxGrpSigInfo "" UWORD NO_COMPU_METHOD 0 0 0 65535 ECU_ADDRESS 0x0 /end MEASUREMENT
/begin MEASUREMENT Com_TxGrpSigInfo[103].BusAccOfTxGrpSigInfo "" UBYTE Com_BusAccOfTxGrpSigInfoType 0 0 0 255 ECU_ADDRESS 0x0 /end MEASUREMENT
/begin MEASUREMENT Com_TxGrpSigInfo[103].ByteLengthOfTxGrpSigInfo "" UBYTE NO_COMPU_METHOD 0 0 0 255 ECU_ADDRESS 0x0 /end MEASUREMENT
/begin MEASUREMENT Com_TxGrpSigInfo[103].DynSignalOfTxGrpSigInfo "" UBYTE Com_DynSignalOfTxGrpSigInfoType 0 0 0 1 ECU_ADDRESS 0x0 /end MEASUREMENT
/begin MEASUREMENT Com_TxGrpSigInfo[103].InvValueIdxOfTxGrpSigInfo "" UBYTE Com_InvValueIdxOfTxGrpSigInfoType 0 0 0 255 ECU_ADDRESS 0x0 /end MEASUREMENT
/begin MEASUREMENT Com_TxGrpSigInfo[103].InvValueOfTxGrpSigInfo "" UBYTE Com_InvValueOfTxGrpSigInfoType 0 0 0 255 ECU_ADDRESS 0x0 /end MEASUREMENT
/begin MEASUREMENT Com_TxGrpSigInfo[103].StartByteInPduPositionOfTxGrpSigInfo "" UBYTE NO_COMPU_METHOD 0 0 0 255 ECU_ADDRESS 0x0 /end MEASUREMENT
/begin MEASUREMENT Com_TxGrpSigInfo[103].TxBufferEndIdxOfTxGrpSigInfo "" UWORD Com_TxBufferEndIdxOfTxGrpSigInfoType 0 0 0 65535 ECU_ADDRESS 0x0 /end MEASUREMENT
/begin MEASUREMENT Com_TxGrpSigInfo[103].TxBufferStartIdxOfTxGrpSigInfo "" UWORD Com_TxBufferStartIdxOfTxGrpSigInfoType 0 0 0 65535 ECU_ADDRESS 0x0 /end MEASUREMENT
/begin MEASUREMENT Com_TxGrpSigInfo[103].TxPduInfoIdxOfTxGrpSigInfo "" UBYTE NO_COMPU_METHOD 0 0 0 255 ECU_ADDRESS 0x0 /end MEASUREMENT
/begin MEASUREMENT Com_TxGrpSigInfo[103].TxSigGrpInfoIdxOfTxGrpSigInfo "" UBYTE NO_COMPU_METHOD 0 0 0 255 ECU_ADDRESS 0x0 /end MEASUREMENT
/begin MEASUREMENT Com_TxGrpSigInfo[103].WithoutRepOfTxGrpSigInfo "" UBYTE Com_WithoutRepOfTxGrpSigInfoType 0 0 0 1 ECU_ADDRESS 0x0 /end MEASUREMENT
/begin MEASUREMENT Com_TxGrpSigInfo[104].ApplTypeOfTxGrpSigInfo "" UBYTE Com_ApplTypeOfTxGrpSigInfoType 0 0 0 255 ECU_ADDRESS 0x0 /end MEASUREMENT
/begin MEASUREMENT Com_TxGrpSigInfo[104].BitLengthOfTxGrpSigInfo "" UBYTE NO_COMPU_METHOD 0 0 0 255 ECU_ADDRESS 0x0 /end MEASUREMENT
/begin MEASUREMENT Com_TxGrpSigInfo[104].BitPositionOfTxGrpSigInfo "" UWORD NO_COMPU_METHOD 0 0 0 65535 ECU_ADDRESS 0x0 /end MEASUREMENT
/begin MEASUREMENT Com_TxGrpSigInfo[104].BusAccOfTxGrpSigInfo "" UBYTE Com_BusAccOfTxGrpSigInfoType 0 0 0 255 ECU_ADDRESS 0x0 /end MEASUREMENT
/begin MEASUREMENT Com_TxGrpSigInfo[104].ByteLengthOfTxGrpSigInfo "" UBYTE NO_COMPU_METHOD 0 0 0 255 ECU_ADDRESS 0x0 /end MEASUREMENT
/begin MEASUREMENT Com_TxGrpSigInfo[104].DynSignalOfTxGrpSigInfo "" UBYTE Com_DynSignalOfTxGrpSigInfoType 0 0 0 1 ECU_ADDRESS 0x0 /end MEASUREMENT
/begin MEASUREMENT Com_TxGrpSigInfo[104].InvValueIdxOfTxGrpSigInfo "" UBYTE Com_InvValueIdxOfTxGrpSigInfoType 0 0 0 255 ECU_ADDRESS 0x0 /end MEASUREMENT
/begin MEASUREMENT Com_TxGrpSigInfo[104].InvValueOfTxGrpSigInfo "" UBYTE Com_InvValueOfTxGrpSigInfoType 0 0 0 255 ECU_ADDRESS 0x0 /end MEASUREMENT
/begin MEASUREMENT Com_TxGrpSigInfo[104].StartByteInPduPositionOfTxGrpSigInfo "" UBYTE NO_COMPU_METHOD 0 0 0 255 ECU_ADDRESS 0x0 /end MEASUREMENT
/begin MEASUREMENT Com_TxGrpSigInfo[104].TxBufferEndIdxOfTxGrpSigInfo "" UWORD Com_TxBufferEndIdxOfTxGrpSigInfoType 0 0 0 65535 ECU_ADDRESS 0x0 /end MEASUREMENT
/begin MEASUREMENT Com_TxGrpSigInfo[104].TxBufferStartIdxOfTxGrpSigInfo "" UWORD Com_TxBufferStartIdxOfTxGrpSigInfoType 0 0 0 65535 ECU_ADDRESS 0x0 /end MEASUREMENT
/begin MEASUREMENT Com_TxGrpSigInfo[104].TxPduInfoIdxOfTxGrpSigInfo "" UBYTE NO_COMPU_METHOD 0 0 0 255 ECU_ADDRESS 0x0 /end MEASUREMENT
/begin MEASUREMENT Com_TxGrpSigInfo[104].TxSigGrpInfoIdxOfTxGrpSigInfo "" UBYTE NO_COMPU_METHOD 0 0 0 255 ECU_ADDRESS 0x0 /end MEASUREMENT
/begin MEASUREMENT Com_TxGrpSigInfo[104].WithoutRepOfTxGrpSigInfo "" UBYTE Com_WithoutRepOfTxGrpSigInfoType 0 0 0 1 ECU_ADDRESS 0x0 /end MEASUREMENT
/begin MEASUREMENT Com_TxGrpSigInfo[105].ApplTypeOfTxGrpSigInfo "" UBYTE Com_ApplTypeOfTxGrpSigInfoType 0 0 0 255 ECU_ADDRESS 0x0 /end MEASUREMENT
/begin MEASUREMENT Com_TxGrpSigInfo[105].BitLengthOfTxGrpSigInfo "" UBYTE NO_COMPU_METHOD 0 0 0 255 ECU_ADDRESS 0x0 /end MEASUREMENT
/begin MEASUREMENT Com_TxGrpSigInfo[105].BitPositionOfTxGrpSigInfo "" UWORD NO_COMPU_METHOD 0 0 0 65535 ECU_ADDRESS 0x0 /end MEASUREMENT
/begin MEASUREMENT Com_TxGrpSigInfo[105].BusAccOfTxGrpSigInfo "" UBYTE Com_BusAccOfTxGrpSigInfoType 0 0 0 255 ECU_ADDRESS 0x0 /end MEASUREMENT
/begin MEASUREMENT Com_TxGrpSigInfo[105].ByteLengthOfTxGrpSigInfo "" UBYTE NO_COMPU_METHOD 0 0 0 255 ECU_ADDRESS 0x0 /end MEASUREMENT
/begin MEASUREMENT Com_TxGrpSigInfo[105].DynSignalOfTxGrpSigInfo "" UBYTE Com_DynSignalOfTxGrpSigInfoType 0 0 0 1 ECU_ADDRESS 0x0 /end MEASUREMENT
/begin MEASUREMENT Com_TxGrpSigInfo[105].InvValueIdxOfTxGrpSigInfo "" UBYTE Com_InvValueIdxOfTxGrpSigInfoType 0 0 0 255 ECU_ADDRESS 0x0 /end MEASUREMENT
/begin MEASUREMENT Com_TxGrpSigInfo[105].InvValueOfTxGrpSigInfo "" UBYTE Com_InvValueOfTxGrpSigInfoType 0 0 0 255 ECU_ADDRESS 0x0 /end MEASUREMENT
/begin MEASUREMENT Com_TxGrpSigInfo[105].StartByteInPduPositionOfTxGrpSigInfo "" UBYTE NO_COMPU_METHOD 0 0 0 255 ECU_ADDRESS 0x0 /end MEASUREMENT
/begin MEASUREMENT Com_TxGrpSigInfo[105].TxBufferEndIdxOfTxGrpSigInfo "" UWORD Com_TxBufferEndIdxOfTxGrpSigInfoType 0 0 0 65535 ECU_ADDRESS 0x0 /end MEASUREMENT
/begin MEASUREMENT Com_TxGrpSigInfo[105].TxBufferStartIdxOfTxGrpSigInfo "" UWORD Com_TxBufferStartIdxOfTxGrpSigInfoType 0 0 0 65535 ECU_ADDRESS 0x0 /end MEASUREMENT
/begin MEASUREMENT Com_TxGrpSigInfo[105].TxPduInfoIdxOfTxGrpSigInfo "" UBYTE NO_COMPU_METHOD 0 0 0 255 ECU_ADDRESS 0x0 /end MEASUREMENT
/begin MEASUREMENT Com_TxGrpSigInfo[105].TxSigGrpInfoIdxOfTxGrpSigInfo "" UBYTE NO_COMPU_METHOD 0 0 0 255 ECU_ADDRESS 0x0 /end MEASUREMENT
/begin MEASUREMENT Com_TxGrpSigInfo[105].WithoutRepOfTxGrpSigInfo "" UBYTE Com_WithoutRepOfTxGrpSigInfoType 0 0 0 1 ECU_ADDRESS 0x0 /end MEASUREMENT
/begin MEASUREMENT Com_TxGrpSigInfo[106].ApplTypeOfTxGrpSigInfo "" UBYTE Com_ApplTypeOfTxGrpSigInfoType 0 0 0 255 ECU_ADDRESS 0x0 /end MEASUREMENT
/begin MEASUREMENT Com_TxGrpSigInfo[106].BitLengthOfTxGrpSigInfo "" UBYTE NO_COMPU_METHOD 0 0 0 255 ECU_ADDRESS 0x0 /end MEASUREMENT
/begin MEASUREMENT Com_TxGrpSigInfo[106].BitPositionOfTxGrpSigInfo "" UWORD NO_COMPU_METHOD 0 0 0 65535 ECU_ADDRESS 0x0 /end MEASUREMENT
/begin MEASUREMENT Com_TxGrpSigInfo[106].BusAccOfTxGrpSigInfo "" UBYTE Com_BusAccOfTxGrpSigInfoType 0 0 0 255 ECU_ADDRESS 0x0 /end MEASUREMENT
/begin MEASUREMENT Com_TxGrpSigInfo[106].ByteLengthOfTxGrpSigInfo "" UBYTE NO_COMPU_METHOD 0 0 0 255 ECU_ADDRESS 0x0 /end MEASUREMENT
/begin MEASUREMENT Com_TxGrpSigInfo[106].DynSignalOfTxGrpSigInfo "" UBYTE Com_DynSignalOfTxGrpSigInfoType 0 0 0 1 ECU_ADDRESS 0x0 /end MEASUREMENT
/begin MEASUREMENT Com_TxGrpSigInfo[106].InvValueIdxOfTxGrpSigInfo "" UBYTE Com_InvValueIdxOfTxGrpSigInfoType 0 0 0 255 ECU_ADDRESS 0x0 /end MEASUREMENT
/begin MEASUREMENT Com_TxGrpSigInfo[106].InvValueOfTxGrpSigInfo "" UBYTE Com_InvValueOfTxGrpSigInfoType 0 0 0 255 ECU_ADDRESS 0x0 /end MEASUREMENT
/begin MEASUREMENT Com_TxGrpSigInfo[106].StartByteInPduPositionOfTxGrpSigInfo "" UBYTE NO_COMPU_METHOD 0 0 0 255 ECU_ADDRESS 0x0 /end MEASUREMENT
/begin MEASUREMENT Com_TxGrpSigInfo[106].TxBufferEndIdxOfTxGrpSigInfo "" UWORD Com_TxBufferEndIdxOfTxGrpSigInfoType 0 0 0 65535 ECU_ADDRESS 0x0 /end MEASUREMENT
/begin MEASUREMENT Com_TxGrpSigInfo[106].TxBufferStartIdxOfTxGrpSigInfo "" UWORD Com_TxBufferStartIdxOfTxGrpSigInfoType 0 0 0 65535 ECU_ADDRESS 0x0 /end MEASUREMENT
/begin MEASUREMENT Com_TxGrpSigInfo[106].TxPduInfoIdxOfTxGrpSigInfo "" UBYTE NO_COMPU_METHOD 0 0 0 255 ECU_ADDRESS 0x0 /end MEASUREMENT
/begin MEASUREMENT Com_TxGrpSigInfo[106].TxSigGrpInfoIdxOfTxGrpSigInfo "" UBYTE NO_COMPU_METHOD 0 0 0 255 ECU_ADDRESS 0x0 /end MEASUREMENT
/begin MEASUREMENT Com_TxGrpSigInfo[106].WithoutRepOfTxGrpSigInfo "" UBYTE Com_WithoutRepOfTxGrpSigInfoType 0 0 0 1 ECU_ADDRESS 0x0 /end MEASUREMENT
/begin MEASUREMENT Com_TxGrpSigInfo[107].ApplTypeOfTxGrpSigInfo "" UBYTE Com_ApplTypeOfTxGrpSigInfoType 0 0 0 255 ECU_ADDRESS 0x0 /end MEASUREMENT
/begin MEASUREMENT Com_TxGrpSigInfo[107].BitLengthOfTxGrpSigInfo "" UBYTE NO_COMPU_METHOD 0 0 0 255 ECU_ADDRESS 0x0 /end MEASUREMENT
/begin MEASUREMENT Com_TxGrpSigInfo[107].BitPositionOfTxGrpSigInfo "" UWORD NO_COMPU_METHOD 0 0 0 65535 ECU_ADDRESS 0x0 /end MEASUREMENT
/begin MEASUREMENT Com_TxGrpSigInfo[107].BusAccOfTxGrpSigInfo "" UBYTE Com_BusAccOfTxGrpSigInfoType 0 0 0 255 ECU_ADDRESS 0x0 /end MEASUREMENT
/begin MEASUREMENT Com_TxGrpSigInfo[107].ByteLengthOfTxGrpSigInfo "" UBYTE NO_COMPU_METHOD 0 0 0 255 ECU_ADDRESS 0x0 /end MEASUREMENT
/begin MEASUREMENT Com_TxGrpSigInfo[107].DynSignalOfTxGrpSigInfo "" UBYTE Com_DynSignalOfTxGrpSigInfoType 0 0 0 1 ECU_ADDRESS 0x0 /end MEASUREMENT
/begin MEASUREMENT Com_TxGrpSigInfo[107].InvValueIdxOfTxGrpSigInfo "" UBYTE Com_InvValueIdxOfTxGrpSigInfoType 0 0 0 255 ECU_ADDRESS 0x0 /end MEASUREMENT
/begin MEASUREMENT Com_TxGrpSigInfo[107].InvValueOfTxGrpSigInfo "" UBYTE Com_InvValueOfTxGrpSigInfoType 0 0 0 255 ECU_ADDRESS 0x0 /end MEASUREMENT
/begin MEASUREMENT Com_TxGrpSigInfo[107].StartByteInPduPositionOfTxGrpSigInfo "" UBYTE NO_COMPU_METHOD 0 0 0 255 ECU_ADDRESS 0x0 /end MEASUREMENT
/begin MEASUREMENT Com_TxGrpSigInfo[107].TxBufferEndIdxOfTxGrpSigInfo "" UWORD Com_TxBufferEndIdxOfTxGrpSigInfoType 0 0 0 65535 ECU_ADDRESS 0x0 /end MEASUREMENT
/begin MEASUREMENT Com_TxGrpSigInfo[107].TxBufferStartIdxOfTxGrpSigInfo "" UWORD Com_TxBufferStartIdxOfTxGrpSigInfoType 0 0 0 65535 ECU_ADDRESS 0x0 /end MEASUREMENT
/begin MEASUREMENT Com_TxGrpSigInfo[107].TxPduInfoIdxOfTxGrpSigInfo "" UBYTE NO_COMPU_METHOD 0 0 0 255 ECU_ADDRESS 0x0 /end MEASUREMENT
/begin MEASUREMENT Com_TxGrpSigInfo[107].TxSigGrpInfoIdxOfTxGrpSigInfo "" UBYTE NO_COMPU_METHOD 0 0 0 255 ECU_ADDRESS 0x0 /end MEASUREMENT
/begin MEASUREMENT Com_TxGrpSigInfo[107].WithoutRepOfTxGrpSigInfo "" UBYTE Com_WithoutRepOfTxGrpSigInfoType 0 0 0 1 ECU_ADDRESS 0x0 /end MEASUREMENT
/begin MEASUREMENT Com_TxGrpSigInfo[108].ApplTypeOfTxGrpSigInfo "" UBYTE Com_ApplTypeOfTxGrpSigInfoType 0 0 0 255 ECU_ADDRESS 0x0 /end MEASUREMENT
/begin MEASUREMENT Com_TxGrpSigInfo[108].BitLengthOfTxGrpSigInfo "" UBYTE NO_COMPU_METHOD 0 0 0 255 ECU_ADDRESS 0x0 /end MEASUREMENT
/begin MEASUREMENT Com_TxGrpSigInfo[108].BitPositionOfTxGrpSigInfo "" UWORD NO_COMPU_METHOD 0 0 0 65535 ECU_ADDRESS 0x0 /end MEASUREMENT
/begin MEASUREMENT Com_TxGrpSigInfo[108].BusAccOfTxGrpSigInfo "" UBYTE Com_BusAccOfTxGrpSigInfoType 0 0 0 255 ECU_ADDRESS 0x0 /end MEASUREMENT
/begin MEASUREMENT Com_TxGrpSigInfo[108].ByteLengthOfTxGrpSigInfo "" UBYTE NO_COMPU_METHOD 0 0 0 255 ECU_ADDRESS 0x0 /end MEASUREMENT
/begin MEASUREMENT Com_TxGrpSigInfo[108].DynSignalOfTxGrpSigInfo "" UBYTE Com_DynSignalOfTxGrpSigInfoType 0 0 0 1 ECU_ADDRESS 0x0 /end MEASUREMENT
/begin MEASUREMENT Com_TxGrpSigInfo[108].InvValueIdxOfTxGrpSigInfo "" UBYTE Com_InvValueIdxOfTxGrpSigInfoType 0 0 0 255 ECU_ADDRESS 0x0 /end MEASUREMENT
/begin MEASUREMENT Com_TxGrpSigInfo[108].InvValueOfTxGrpSigInfo "" UBYTE Com_InvValueOfTxGrpSigInfoType 0 0 0 255 ECU_ADDRESS 0x0 /end MEASUREMENT
/begin MEASUREMENT Com_TxGrpSigInfo[108].StartByteInPduPositionOfTxGrpSigInfo "" UBYTE NO_COMPU_METHOD 0 0 0 255 ECU_ADDRESS 0x0 /end MEASUREMENT
/begin MEASUREMENT Com_TxGrpSigInfo[108].TxBufferEndIdxOfTxGrpSigInfo "" UWORD Com_TxBufferEndIdxOfTxGrpSigInfoType 0 0 0 65535 ECU_ADDRESS 0x0 /end MEASUREMENT
/begin MEASUREMENT Com_TxGrpSigInfo[108].TxBufferStartIdxOfTxGrpSigInfo "" UWORD Com_TxBufferStartIdxOfTxGrpSigInfoType 0 0 0 65535 ECU_ADDRESS 0x0 /end MEASUREMENT
/begin MEASUREMENT Com_TxGrpSigInfo[108].TxPduInfoIdxOfTxGrpSigInfo "" UBYTE NO_COMPU_METHOD 0 0 0 255 ECU_ADDRESS 0x0 /end MEASUREMENT
/begin MEASUREMENT Com_TxGrpSigInfo[108].TxSigGrpInfoIdxOfTxGrpSigInfo "" UBYTE NO_COMPU_METHOD 0 0 0 255 ECU_ADDRESS 0x0 /end MEASUREMENT
/begin MEASUREMENT Com_TxGrpSigInfo[108].WithoutRepOfTxGrpSigInfo "" UBYTE Com_WithoutRepOfTxGrpSigInfoType 0 0 0 1 ECU_ADDRESS 0x0 /end MEASUREMENT
/begin MEASUREMENT Com_TxGrpSigInfo[109].ApplTypeOfTxGrpSigInfo "" UBYTE Com_ApplTypeOfTxGrpSigInfoType 0 0 0 255 ECU_ADDRESS 0x0 /end MEASUREMENT
/begin MEASUREMENT Com_TxGrpSigInfo[109].BitLengthOfTxGrpSigInfo "" UBYTE NO_COMPU_METHOD 0 0 0 255 ECU_ADDRESS 0x0 /end MEASUREMENT
/begin MEASUREMENT Com_TxGrpSigInfo[109].BitPositionOfTxGrpSigInfo "" UWORD NO_COMPU_METHOD 0 0 0 65535 ECU_ADDRESS 0x0 /end MEASUREMENT
/begin MEASUREMENT Com_TxGrpSigInfo[109].BusAccOfTxGrpSigInfo "" UBYTE Com_BusAccOfTxGrpSigInfoType 0 0 0 255 ECU_ADDRESS 0x0 /end MEASUREMENT
/begin MEASUREMENT Com_TxGrpSigInfo[109].ByteLengthOfTxGrpSigInfo "" UBYTE NO_COMPU_METHOD 0 0 0 255 ECU_ADDRESS 0x0 /end MEASUREMENT
/begin MEASUREMENT Com_TxGrpSigInfo[109].DynSignalOfTxGrpSigInfo "" UBYTE Com_DynSignalOfTxGrpSigInfoType 0 0 0 1 ECU_ADDRESS 0x0 /end MEASUREMENT
/begin MEASUREMENT Com_TxGrpSigInfo[109].InvValueIdxOfTxGrpSigInfo "" UBYTE Com_InvValueIdxOfTxGrpSigInfoType 0 0 0 255 ECU_ADDRESS 0x0 /end MEASUREMENT
/begin MEASUREMENT Com_TxGrpSigInfo[109].InvValueOfTxGrpSigInfo "" UBYTE Com_InvValueOfTxGrpSigInfoType 0 0 0 255 ECU_ADDRESS 0x0 /end MEASUREMENT
/begin MEASUREMENT Com_TxGrpSigInfo[109].StartByteInPduPositionOfTxGrpSigInfo "" UBYTE NO_COMPU_METHOD 0 0 0 255 ECU_ADDRESS 0x0 /end MEASUREMENT
/begin MEASUREMENT Com_TxGrpSigInfo[109].TxBufferEndIdxOfTxGrpSigInfo "" UWORD Com_TxBufferEndIdxOfTxGrpSigInfoType 0 0 0 65535 ECU_ADDRESS 0x0 /end MEASUREMENT
/begin MEASUREMENT Com_TxGrpSigInfo[109].TxBufferStartIdxOfTxGrpSigInfo "" UWORD Com_TxBufferStartIdxOfTxGrpSigInfoType 0 0 0 65535 ECU_ADDRESS 0x0 /end MEASUREMENT
/begin MEASUREMENT Com_TxGrpSigInfo[109].TxPduInfoIdxOfTxGrpSigInfo "" UBYTE NO_COMPU_METHOD 0 0 0 255 ECU_ADDRESS 0x0 /end MEASUREMENT
/begin MEASUREMENT Com_TxGrpSigInfo[109].TxSigGrpInfoIdxOfTxGrpSigInfo "" UBYTE NO_COMPU_METHOD 0 0 0 255 ECU_ADDRESS 0x0 /end MEASUREMENT
/begin MEASUREMENT Com_TxGrpSigInfo[109].WithoutRepOfTxGrpSigInfo "" UBYTE Com_WithoutRepOfTxGrpSigInfoType 0 0 0 1 ECU_ADDRESS 0x0 /end MEASUREMENT
/begin MEASUREMENT Com_TxGrpSigInfo[10].ApplTypeOfTxGrpSigInfo "" UBYTE Com_ApplTypeOfTxGrpSigInfoType 0 0 0 255 ECU_ADDRESS 0x0 /end MEASUREMENT
/begin MEASUREMENT Com_TxGrpSigInfo[10].BitLengthOfTxGrpSigInfo "" UBYTE NO_COMPU_METHOD 0 0 0 255 ECU_ADDRESS 0x0 /end MEASUREMENT
/begin MEASUREMENT Com_TxGrpSigInfo[10].BitPositionOfTxGrpSigInfo "" UWORD NO_COMPU_METHOD 0 0 0 65535 ECU_ADDRESS 0x0 /end MEASUREMENT
/begin MEASUREMENT Com_TxGrpSigInfo[10].BusAccOfTxGrpSigInfo "" UBYTE Com_BusAccOfTxGrpSigInfoType 0 0 0 255 ECU_ADDRESS 0x0 /end MEASUREMENT
/begin MEASUREMENT Com_TxGrpSigInfo[10].ByteLengthOfTxGrpSigInfo "" UBYTE NO_COMPU_METHOD 0 0 0 255 ECU_ADDRESS 0x0 /end MEASUREMENT
/begin MEASUREMENT Com_TxGrpSigInfo[10].DynSignalOfTxGrpSigInfo "" UBYTE Com_DynSignalOfTxGrpSigInfoType 0 0 0 1 ECU_ADDRESS 0x0 /end MEASUREMENT
/begin MEASUREMENT Com_TxGrpSigInfo[10].InvValueIdxOfTxGrpSigInfo "" UBYTE Com_InvValueIdxOfTxGrpSigInfoType 0 0 0 255 ECU_ADDRESS 0x0 /end MEASUREMENT
/begin MEASUREMENT Com_TxGrpSigInfo[10].InvValueOfTxGrpSigInfo "" UBYTE Com_InvValueOfTxGrpSigInfoType 0 0 0 255 ECU_ADDRESS 0x0 /end MEASUREMENT
/begin MEASUREMENT Com_TxGrpSigInfo[10].StartByteInPduPositionOfTxGrpSigInfo "" UBYTE NO_COMPU_METHOD 0 0 0 255 ECU_ADDRESS 0x0 /end MEASUREMENT
/begin MEASUREMENT Com_TxGrpSigInfo[10].TxBufferEndIdxOfTxGrpSigInfo "" UWORD Com_TxBufferEndIdxOfTxGrpSigInfoType 0 0 0 65535 ECU_ADDRESS 0x0 /end MEASUREMENT
/begin MEASUREMENT Com_TxGrpSigInfo[10].TxBufferStartIdxOfTxGrpSigInfo "" UWORD Com_TxBufferStartIdxOfTxGrpSigInfoType 0 0 0 65535 ECU_ADDRESS 0x0 /end MEASUREMENT
/begin MEASUREMENT Com_TxGrpSigInfo[10].TxPduInfoIdxOfTxGrpSigInfo "" UBYTE NO_COMPU_METHOD 0 0 0 255 ECU_ADDRESS 0x0 /end MEASUREMENT
/begin MEASUREMENT Com_TxGrpSigInfo[10].TxSigGrpInfoIdxOfTxGrpSigInfo "" UBYTE NO_COMPU_METHOD 0 0 0 255 ECU_ADDRESS 0x0 /end MEASUREMENT
/begin MEASUREMENT Com_TxGrpSigInfo[10].WithoutRepOfTxGrpSigInfo "" UBYTE Com_WithoutRepOfTxGrpSigInfoType 0 0 0 1 ECU_ADDRESS 0x0 /end MEASUREMENT
/begin MEASUREMENT Com_TxGrpSigInfo[110].ApplTypeOfTxGrpSigInfo "" UBYTE Com_ApplTypeOfTxGrpSigInfoType 0 0 0 255 ECU_ADDRESS 0x0 /end MEASUREMENT
/begin MEASUREMENT Com_TxGrpSigInfo[110].BitLengthOfTxGrpSigInfo "" UBYTE NO_COMPU_METHOD 0 0 0 255 ECU_ADDRESS 0x0 /end MEASUREMENT
/begin MEASUREMENT Com_TxGrpSigInfo[110].BitPositionOfTxGrpSigInfo "" UWORD NO_COMPU_METHOD 0 0 0 65535 ECU_ADDRESS 0x0 /end MEASUREMENT
/begin MEASUREMENT Com_TxGrpSigInfo[110].BusAccOfTxGrpSigInfo "" UBYTE Com_BusAccOfTxGrpSigInfoType 0 0 0 255 ECU_ADDRESS 0x0 /end MEASUREMENT
/begin MEASUREMENT Com_TxGrpSigInfo[110].ByteLengthOfTxGrpSigInfo "" UBYTE NO_COMPU_METHOD 0 0 0 255 ECU_ADDRESS 0x0 /end MEASUREMENT
/begin MEASUREMENT Com_TxGrpSigInfo[110].DynSignalOfTxGrpSigInfo "" UBYTE Com_DynSignalOfTxGrpSigInfoType 0 0 0 1 ECU_ADDRESS 0x0 /end MEASUREMENT
/begin MEASUREMENT Com_TxGrpSigInfo[110].InvValueIdxOfTxGrpSigInfo "" UBYTE Com_InvValueIdxOfTxGrpSigInfoType 0 0 0 255 ECU_ADDRESS 0x0 /end MEASUREMENT
/begin MEASUREMENT Com_TxGrpSigInfo[110].InvValueOfTxGrpSigInfo "" UBYTE Com_InvValueOfTxGrpSigInfoType 0 0 0 255 ECU_ADDRESS 0x0 /end MEASUREMENT
/begin MEASUREMENT Com_TxGrpSigInfo[110].StartByteInPduPositionOfTxGrpSigInfo "" UBYTE NO_COMPU_METHOD 0 0 0 255 ECU_ADDRESS 0x0 /end MEASUREMENT
/begin MEASUREMENT Com_TxGrpSigInfo[110].TxBufferEndIdxOfTxGrpSigInfo "" UWORD Com_TxBufferEndIdxOfTxGrpSigInfoType 0 0 0 65535 ECU_ADDRESS 0x0 /end MEASUREMENT
/begin MEASUREMENT Com_TxGrpSigInfo[110].TxBufferStartIdxOfTxGrpSigInfo "" UWORD Com_TxBufferStartIdxOfTxGrpSigInfoType 0 0 0 65535 ECU_ADDRESS 0x0 /end MEASUREMENT
/begin MEASUREMENT Com_TxGrpSigInfo[110].TxPduInfoIdxOfTxGrpSigInfo "" UBYTE NO_COMPU_METHOD 0 0 0 255 ECU_ADDRESS 0x0 /end MEASUREMENT
/begin MEASUREMENT Com_TxGrpSigInfo[110].TxSigGrpInfoIdxOfTxGrpSigInfo "" UBYTE NO_COMPU_METHOD 0 0 0 255 ECU_ADDRESS 0x0 /end MEASUREMENT
/begin MEASUREMENT Com_TxGrpSigInfo[110].WithoutRepOfTxGrpSigInfo "" UBYTE Com_WithoutRepOfTxGrpSigInfoType 0 0 0 1 ECU_ADDRESS 0x0 /end MEASUREMENT
/begin MEASUREMENT Com_TxGrpSigInfo[111].ApplTypeOfTxGrpSigInfo "" UBYTE Com_ApplTypeOfTxGrpSigInfoType 0 0 0 255 ECU_ADDRESS 0x0 /end MEASUREMENT
/begin MEASUREMENT Com_TxGrpSigInfo[111].BitLengthOfTxGrpSigInfo "" UBYTE NO_COMPU_METHOD 0 0 0 255 ECU_ADDRESS 0x0 /end MEASUREMENT
/begin MEASUREMENT Com_TxGrpSigInfo[111].BitPositionOfTxGrpSigInfo "" UWORD NO_COMPU_METHOD 0 0 0 65535 ECU_ADDRESS 0x0 /end MEASUREMENT
/begin MEASUREMENT Com_TxGrpSigInfo[111].BusAccOfTxGrpSigInfo "" UBYTE Com_BusAccOfTxGrpSigInfoType 0 0 0 255 ECU_ADDRESS 0x0 /end MEASUREMENT
/begin MEASUREMENT Com_TxGrpSigInfo[111].ByteLengthOfTxGrpSigInfo "" UBYTE NO_COMPU_METHOD 0 0 0 255 ECU_ADDRESS 0x0 /end MEASUREMENT
/begin MEASUREMENT Com_TxGrpSigInfo[111].DynSignalOfTxGrpSigInfo "" UBYTE Com_DynSignalOfTxGrpSigInfoType 0 0 0 1 ECU_ADDRESS 0x0 /end MEASUREMENT
/begin MEASUREMENT Com_TxGrpSigInfo[111].InvValueIdxOfTxGrpSigInfo "" UBYTE Com_InvValueIdxOfTxGrpSigInfoType 0 0 0 255 ECU_ADDRESS 0x0 /end MEASUREMENT
/begin MEASUREMENT Com_TxGrpSigInfo[111].InvValueOfTxGrpSigInfo "" UBYTE Com_InvValueOfTxGrpSigInfoType 0 0 0 255 ECU_ADDRESS 0x0 /end MEASUREMENT
/begin MEASUREMENT Com_TxGrpSigInfo[111].StartByteInPduPositionOfTxGrpSigInfo "" UBYTE NO_COMPU_METHOD 0 0 0 255 ECU_ADDRESS 0x0 /end MEASUREMENT
/begin MEASUREMENT Com_TxGrpSigInfo[111].TxBufferEndIdxOfTxGrpSigInfo "" UWORD Com_TxBufferEndIdxOfTxGrpSigInfoType 0 0 0 65535 ECU_ADDRESS 0x0 /end MEASUREMENT
/begin MEASUREMENT Com_TxGrpSigInfo[111].TxBufferStartIdxOfTxGrpSigInfo "" UWORD Com_TxBufferStartIdxOfTxGrpSigInfoType 0 0 0 65535 ECU_ADDRESS 0x0 /end MEASUREMENT
/begin MEASUREMENT Com_TxGrpSigInfo[111].TxPduInfoIdxOfTxGrpSigInfo "" UBYTE NO_COMPU_METHOD 0 0 0 255 ECU_ADDRESS 0x0 /end MEASUREMENT
/begin MEASUREMENT Com_TxGrpSigInfo[111].TxSigGrpInfoIdxOfTxGrpSigInfo "" UBYTE NO_COMPU_METHOD 0 0 0 255 ECU_ADDRESS 0x0 /end MEASUREMENT
/begin MEASUREMENT Com_TxGrpSigInfo[111].WithoutRepOfTxGrpSigInfo "" UBYTE Com_WithoutRepOfTxGrpSigInfoType 0 0 0 1 ECU_ADDRESS 0x0 /end MEASUREMENT
/begin MEASUREMENT Com_TxGrpSigInfo[112].ApplTypeOfTxGrpSigInfo "" UBYTE Com_ApplTypeOfTxGrpSigInfoType 0 0 0 255 ECU_ADDRESS 0x0 /end MEASUREMENT
/begin MEASUREMENT Com_TxGrpSigInfo[112].BitLengthOfTxGrpSigInfo "" UBYTE NO_COMPU_METHOD 0 0 0 255 ECU_ADDRESS 0x0 /end MEASUREMENT
/begin MEASUREMENT Com_TxGrpSigInfo[112].BitPositionOfTxGrpSigInfo "" UWORD NO_COMPU_METHOD 0 0 0 65535 ECU_ADDRESS 0x0 /end MEASUREMENT
/begin MEASUREMENT Com_TxGrpSigInfo[112].BusAccOfTxGrpSigInfo "" UBYTE Com_BusAccOfTxGrpSigInfoType 0 0 0 255 ECU_ADDRESS 0x0 /end MEASUREMENT
/begin MEASUREMENT Com_TxGrpSigInfo[112].ByteLengthOfTxGrpSigInfo "" UBYTE NO_COMPU_METHOD 0 0 0 255 ECU_ADDRESS 0x0 /end MEASUREMENT
/begin MEASUREMENT Com_TxGrpSigInfo[112].DynSignalOfTxGrpSigInfo "" UBYTE Com_DynSignalOfTxGrpSigInfoType 0 0 0 1 ECU_ADDRESS 0x0 /end MEASUREMENT
/begin MEASUREMENT Com_TxGrpSigInfo[112].InvValueIdxOfTxGrpSigInfo "" UBYTE Com_InvValueIdxOfTxGrpSigInfoType 0 0 0 255 ECU_ADDRESS 0x0 /end MEASUREMENT
/begin MEASUREMENT Com_TxGrpSigInfo[112].InvValueOfTxGrpSigInfo "" UBYTE Com_InvValueOfTxGrpSigInfoType 0 0 0 255 ECU_ADDRESS 0x0 /end MEASUREMENT
/begin MEASUREMENT Com_TxGrpSigInfo[112].StartByteInPduPositionOfTxGrpSigInfo "" UBYTE NO_COMPU_METHOD 0 0 0 255 ECU_ADDRESS 0x0 /end MEASUREMENT
/begin MEASUREMENT Com_TxGrpSigInfo[112].TxBufferEndIdxOfTxGrpSigInfo "" UWORD Com_TxBufferEndIdxOfTxGrpSigInfoType 0 0 0 65535 ECU_ADDRESS 0x0 /end MEASUREMENT
/begin MEASUREMENT Com_TxGrpSigInfo[112].TxBufferStartIdxOfTxGrpSigInfo "" UWORD Com_TxBufferStartIdxOfTxGrpSigInfoType 0 0 0 65535 ECU_ADDRESS 0x0 /end MEASUREMENT
/begin MEASUREMENT Com_TxGrpSigInfo[112].TxPduInfoIdxOfTxGrpSigInfo "" UBYTE NO_COMPU_METHOD 0 0 0 255 ECU_ADDRESS 0x0 /end MEASUREMENT
/begin MEASUREMENT Com_TxGrpSigInfo[112].TxSigGrpInfoIdxOfTxGrpSigInfo "" UBYTE NO_COMPU_METHOD 0 0 0 255 ECU_ADDRESS 0x0 /end MEASUREMENT
/begin MEASUREMENT Com_TxGrpSigInfo[112].WithoutRepOfTxGrpSigInfo "" UBYTE Com_WithoutRepOfTxGrpSigInfoType 0 0 0 1 ECU_ADDRESS 0x0 /end MEASUREMENT
/begin MEASUREMENT Com_TxGrpSigInfo[113].ApplTypeOfTxGrpSigInfo "" UBYTE Com_ApplTypeOfTxGrpSigInfoType 0 0 0 255 ECU_ADDRESS 0x0 /end MEASUREMENT
/begin MEASUREMENT Com_TxGrpSigInfo[113].BitLengthOfTxGrpSigInfo "" UBYTE NO_COMPU_METHOD 0 0 0 255 ECU_ADDRESS 0x0 /end MEASUREMENT
/begin MEASUREMENT Com_TxGrpSigInfo[113].BitPositionOfTxGrpSigInfo "" UWORD NO_COMPU_METHOD 0 0 0 65535 ECU_ADDRESS 0x0 /end MEASUREMENT
/begin MEASUREMENT Com_TxGrpSigInfo[113].BusAccOfTxGrpSigInfo "" UBYTE Com_BusAccOfTxGrpSigInfoType 0 0 0 255 ECU_ADDRESS 0x0 /end MEASUREMENT
/begin MEASUREMENT Com_TxGrpSigInfo[113].ByteLengthOfTxGrpSigInfo "" UBYTE NO_COMPU_METHOD 0 0 0 255 ECU_ADDRESS 0x0 /end MEASUREMENT
/begin MEASUREMENT Com_TxGrpSigInfo[113].DynSignalOfTxGrpSigInfo "" UBYTE Com_DynSignalOfTxGrpSigInfoType 0 0 0 1 ECU_ADDRESS 0x0 /end MEASUREMENT
/begin MEASUREMENT Com_TxGrpSigInfo[113].InvValueIdxOfTxGrpSigInfo "" UBYTE Com_InvValueIdxOfTxGrpSigInfoType 0 0 0 255 ECU_ADDRESS 0x0 /end MEASUREMENT
/begin MEASUREMENT Com_TxGrpSigInfo[113].InvValueOfTxGrpSigInfo "" UBYTE Com_InvValueOfTxGrpSigInfoType 0 0 0 255 ECU_ADDRESS 0x0 /end MEASUREMENT
/begin MEASUREMENT Com_TxGrpSigInfo[113].StartByteInPduPositionOfTxGrpSigInfo "" UBYTE NO_COMPU_METHOD 0 0 0 255 ECU_ADDRESS 0x0 /end MEASUREMENT
/begin MEASUREMENT Com_TxGrpSigInfo[113].TxBufferEndIdxOfTxGrpSigInfo "" UWORD Com_TxBufferEndIdxOfTxGrpSigInfoType 0 0 0 65535 ECU_ADDRESS 0x0 /end MEASUREMENT
/begin MEASUREMENT Com_TxGrpSigInfo[113].TxBufferStartIdxOfTxGrpSigInfo "" UWORD Com_TxBufferStartIdxOfTxGrpSigInfoType 0 0 0 65535 ECU_ADDRESS 0x0 /end MEASUREMENT
/begin MEASUREMENT Com_TxGrpSigInfo[113].TxPduInfoIdxOfTxGrpSigInfo "" UBYTE NO_COMPU_METHOD 0 0 0 255 ECU_ADDRESS 0x0 /end MEASUREMENT
/begin MEASUREMENT Com_TxGrpSigInfo[113].TxSigGrpInfoIdxOfTxGrpSigInfo "" UBYTE NO_COMPU_METHOD 0 0 0 255 ECU_ADDRESS 0x0 /end MEASUREMENT
/begin MEASUREMENT Com_TxGrpSigInfo[113].WithoutRepOfTxGrpSigInfo "" UBYTE Com_WithoutRepOfTxGrpSigInfoType 0 0 0 1 ECU_ADDRESS 0x0 /end MEASUREMENT
/begin MEASUREMENT Com_TxGrpSigInfo[114].ApplTypeOfTxGrpSigInfo "" UBYTE Com_ApplTypeOfTxGrpSigInfoType 0 0 0 255 ECU_ADDRESS 0x0 /end MEASUREMENT
/begin MEASUREMENT Com_TxGrpSigInfo[114].BitLengthOfTxGrpSigInfo "" UBYTE NO_COMPU_METHOD 0 0 0 255 ECU_ADDRESS 0x0 /end MEASUREMENT
/begin MEASUREMENT Com_TxGrpSigInfo[114].BitPositionOfTxGrpSigInfo "" UWORD NO_COMPU_METHOD 0 0 0 65535 ECU_ADDRESS 0x0 /end MEASUREMENT
/begin MEASUREMENT Com_TxGrpSigInfo[114].BusAccOfTxGrpSigInfo "" UBYTE Com_BusAccOfTxGrpSigInfoType 0 0 0 255 ECU_ADDRESS 0x0 /end MEASUREMENT
/begin MEASUREMENT Com_TxGrpSigInfo[114].ByteLengthOfTxGrpSigInfo "" UBYTE NO_COMPU_METHOD 0 0 0 255 ECU_ADDRESS 0x0 /end MEASUREMENT
/begin MEASUREMENT Com_TxGrpSigInfo[114].DynSignalOfTxGrpSigInfo "" UBYTE Com_DynSignalOfTxGrpSigInfoType 0 0 0 1 ECU_ADDRESS 0x0 /end MEASUREMENT
/begin MEASUREMENT Com_TxGrpSigInfo[114].InvValueIdxOfTxGrpSigInfo "" UBYTE Com_InvValueIdxOfTxGrpSigInfoType 0 0 0 255 ECU_ADDRESS 0x0 /end MEASUREMENT
/begin MEASUREMENT Com_TxGrpSigInfo[114].InvValueOfTxGrpSigInfo "" UBYTE Com_InvValueOfTxGrpSigInfoType 0 0 0 255 ECU_ADDRESS 0x0 /end MEASUREMENT
/begin MEASUREMENT Com_TxGrpSigInfo[114].StartByteInPduPositionOfTxGrpSigInfo "" UBYTE NO_COMPU_METHOD 0 0 0 255 ECU_ADDRESS 0x0 /end MEASUREMENT
/begin MEASUREMENT Com_TxGrpSigInfo[114].TxBufferEndIdxOfTxGrpSigInfo "" UWORD Com_TxBufferEndIdxOfTxGrpSigInfoType 0 0 0 65535 ECU_ADDRESS 0x0 /end MEASUREMENT
/begin MEASUREMENT Com_TxGrpSigInfo[114].TxBufferStartIdxOfTxGrpSigInfo "" UWORD Com_TxBufferStartIdxOfTxGrpSigInfoType 0 0 0 65535 ECU_ADDRESS 0x0 /end MEASUREMENT
/begin MEASUREMENT Com_TxGrpSigInfo[114].TxPduInfoIdxOfTxGrpSigInfo "" UBYTE NO_COMPU_METHOD 0 0 0 255 ECU_ADDRESS 0x0 /end MEASUREMENT
/begin MEASUREMENT Com_TxGrpSigInfo[114].TxSigGrpInfoIdxOfTxGrpSigInfo "" UBYTE NO_COMPU_METHOD 0 0 0 255 ECU_ADDRESS 0x0 /end MEASUREMENT
/begin MEASUREMENT Com_TxGrpSigInfo[114].WithoutRepOfTxGrpSigInfo "" UBYTE Com_WithoutRepOfTxGrpSigInfoType 0 0 0 1 ECU_ADDRESS 0x0 /end MEASUREMENT
/begin MEASUREMENT Com_TxGrpSigInfo[115].ApplTypeOfTxGrpSigInfo "" UBYTE Com_ApplTypeOfTxGrpSigInfoType 0 0 0 255 ECU_ADDRESS 0x0 /end MEASUREMENT
/begin MEASUREMENT Com_TxGrpSigInfo[115].BitLengthOfTxGrpSigInfo "" UBYTE NO_COMPU_METHOD 0 0 0 255 ECU_ADDRESS 0x0 /end MEASUREMENT
/begin MEASUREMENT Com_TxGrpSigInfo[115].BitPositionOfTxGrpSigInfo "" UWORD NO_COMPU_METHOD 0 0 0 65535 ECU_ADDRESS 0x0 /end MEASUREMENT
/begin MEASUREMENT Com_TxGrpSigInfo[115].BusAccOfTxGrpSigInfo "" UBYTE Com_BusAccOfTxGrpSigInfoType 0 0 0 255 ECU_ADDRESS 0x0 /end MEASUREMENT
/begin MEASUREMENT Com_TxGrpSigInfo[115].ByteLengthOfTxGrpSigInfo "" UBYTE NO_COMPU_METHOD 0 0 0 255 ECU_ADDRESS 0x0 /end MEASUREMENT
/begin MEASUREMENT Com_TxGrpSigInfo[115].DynSignalOfTxGrpSigInfo "" UBYTE Com_DynSignalOfTxGrpSigInfoType 0 0 0 1 ECU_ADDRESS 0x0 /end MEASUREMENT
/begin MEASUREMENT Com_TxGrpSigInfo[115].InvValueIdxOfTxGrpSigInfo "" UBYTE Com_InvValueIdxOfTxGrpSigInfoType 0 0 0 255 ECU_ADDRESS 0x0 /end MEASUREMENT
/begin MEASUREMENT Com_TxGrpSigInfo[115].InvValueOfTxGrpSigInfo "" UBYTE Com_InvValueOfTxGrpSigInfoType 0 0 0 255 ECU_ADDRESS 0x0 /end MEASUREMENT
/begin MEASUREMENT Com_TxGrpSigInfo[115].StartByteInPduPositionOfTxGrpSigInfo "" UBYTE NO_COMPU_METHOD 0 0 0 255 ECU_ADDRESS 0x0 /end MEASUREMENT
/begin MEASUREMENT Com_TxGrpSigInfo[115].TxBufferEndIdxOfTxGrpSigInfo "" UWORD Com_TxBufferEndIdxOfTxGrpSigInfoType 0 0 0 65535 ECU_ADDRESS 0x0 /end MEASUREMENT
/begin MEASUREMENT Com_TxGrpSigInfo[115].TxBufferStartIdxOfTxGrpSigInfo "" UWORD Com_TxBufferStartIdxOfTxGrpSigInfoType 0 0 0 65535 ECU_ADDRESS 0x0 /end MEASUREMENT
/begin MEASUREMENT Com_TxGrpSigInfo[115].TxPduInfoIdxOfTxGrpSigInfo "" UBYTE NO_COMPU_METHOD 0 0 0 255 ECU_ADDRESS 0x0 /end MEASUREMENT
/begin MEASUREMENT Com_TxGrpSigInfo[115].TxSigGrpInfoIdxOfTxGrpSigInfo "" UBYTE NO_COMPU_METHOD 0 0 0 255 ECU_ADDRESS 0x0 /end MEASUREMENT
/begin MEASUREMENT Com_TxGrpSigInfo[115].WithoutRepOfTxGrpSigInfo "" UBYTE Com_WithoutRepOfTxGrpSigInfoType 0 0 0 1 ECU_ADDRESS 0x0 /end MEASUREMENT
/begin MEASUREMENT Com_TxGrpSigInfo[116].ApplTypeOfTxGrpSigInfo "" UBYTE Com_ApplTypeOfTxGrpSigInfoType 0 0 0 255 ECU_ADDRESS 0x0 /end MEASUREMENT
/begin MEASUREMENT Com_TxGrpSigInfo[116].BitLengthOfTxGrpSigInfo "" UBYTE NO_COMPU_METHOD 0 0 0 255 ECU_ADDRESS 0x0 /end MEASUREMENT
/begin MEASUREMENT Com_TxGrpSigInfo[116].BitPositionOfTxGrpSigInfo "" UWORD NO_COMPU_METHOD 0 0 0 65535 ECU_ADDRESS 0x0 /end MEASUREMENT
/begin MEASUREMENT Com_TxGrpSigInfo[116].BusAccOfTxGrpSigInfo "" UBYTE Com_BusAccOfTxGrpSigInfoType 0 0 0 255 ECU_ADDRESS 0x0 /end MEASUREMENT
/begin MEASUREMENT Com_TxGrpSigInfo[116].ByteLengthOfTxGrpSigInfo "" UBYTE NO_COMPU_METHOD 0 0 0 255 ECU_ADDRESS 0x0 /end MEASUREMENT
/begin MEASUREMENT Com_TxGrpSigInfo[116].DynSignalOfTxGrpSigInfo "" UBYTE Com_DynSignalOfTxGrpSigInfoType 0 0 0 1 ECU_ADDRESS 0x0 /end MEASUREMENT
/begin MEASUREMENT Com_TxGrpSigInfo[116].InvValueIdxOfTxGrpSigInfo "" UBYTE Com_InvValueIdxOfTxGrpSigInfoType 0 0 0 255 ECU_ADDRESS 0x0 /end MEASUREMENT
/begin MEASUREMENT Com_TxGrpSigInfo[116].InvValueOfTxGrpSigInfo "" UBYTE Com_InvValueOfTxGrpSigInfoType 0 0 0 255 ECU_ADDRESS 0x0 /end MEASUREMENT
/begin MEASUREMENT Com_TxGrpSigInfo[116].StartByteInPduPositionOfTxGrpSigInfo "" UBYTE NO_COMPU_METHOD 0 0 0 255 ECU_ADDRESS 0x0 /end MEASUREMENT
/begin MEASUREMENT Com_TxGrpSigInfo[116].TxBufferEndIdxOfTxGrpSigInfo "" UWORD Com_TxBufferEndIdxOfTxGrpSigInfoType 0 0 0 65535 ECU_ADDRESS 0x0 /end MEASUREMENT
/begin MEASUREMENT Com_TxGrpSigInfo[116].TxBufferStartIdxOfTxGrpSigInfo "" UWORD Com_TxBufferStartIdxOfTxGrpSigInfoType 0 0 0 65535 ECU_ADDRESS 0x0 /end MEASUREMENT
/begin MEASUREMENT Com_TxGrpSigInfo[116].TxPduInfoIdxOfTxGrpSigInfo "" UBYTE NO_COMPU_METHOD 0 0 0 255 ECU_ADDRESS 0x0 /end MEASUREMENT
/begin MEASUREMENT Com_TxGrpSigInfo[116].TxSigGrpInfoIdxOfTxGrpSigInfo "" UBYTE NO_COMPU_METHOD 0 0 0 255 ECU_ADDRESS 0x0 /end MEASUREMENT
/begin MEASUREMENT Com_TxGrpSigInfo[116].WithoutRepOfTxGrpSigInfo "" UBYTE Com_WithoutRepOfTxGrpSigInfoType 0 0 0 1 ECU_ADDRESS 0x0 /end MEASUREMENT
/begin MEASUREMENT Com_TxGrpSigInfo[117].ApplTypeOfTxGrpSigInfo "" UBYTE Com_ApplTypeOfTxGrpSigInfoType 0 0 0 255 ECU_ADDRESS 0x0 /end MEASUREMENT
/begin MEASUREMENT Com_TxGrpSigInfo[117].BitLengthOfTxGrpSigInfo "" UBYTE NO_COMPU_METHOD 0 0 0 255 ECU_ADDRESS 0x0 /end MEASUREMENT
/begin MEASUREMENT Com_TxGrpSigInfo[117].BitPositionOfTxGrpSigInfo "" UWORD NO_COMPU_METHOD 0 0 0 65535 ECU_ADDRESS 0x0 /end MEASUREMENT
/begin MEASUREMENT Com_TxGrpSigInfo[117].BusAccOfTxGrpSigInfo "" UBYTE Com_BusAccOfTxGrpSigInfoType 0 0 0 255 ECU_ADDRESS 0x0 /end MEASUREMENT
/begin MEASUREMENT Com_TxGrpSigInfo[117].ByteLengthOfTxGrpSigInfo "" UBYTE NO_COMPU_METHOD 0 0 0 255 ECU_ADDRESS 0x0 /end MEASUREMENT
/begin MEASUREMENT Com_TxGrpSigInfo[117].DynSignalOfTxGrpSigInfo "" UBYTE Com_DynSignalOfTxGrpSigInfoType 0 0 0 1 ECU_ADDRESS 0x0 /end MEASUREMENT
/begin MEASUREMENT Com_TxGrpSigInfo[117].InvValueIdxOfTxGrpSigInfo "" UBYTE Com_InvValueIdxOfTxGrpSigInfoType 0 0 0 255 ECU_ADDRESS 0x0 /end MEASUREMENT
/begin MEASUREMENT Com_TxGrpSigInfo[117].InvValueOfTxGrpSigInfo "" UBYTE Com_InvValueOfTxGrpSigInfoType 0 0 0 255 ECU_ADDRESS 0x0 /end MEASUREMENT
/begin MEASUREMENT Com_TxGrpSigInfo[117].StartByteInPduPositionOfTxGrpSigInfo "" UBYTE NO_COMPU_METHOD 0 0 0 255 ECU_ADDRESS 0x0 /end MEASUREMENT
/begin MEASUREMENT Com_TxGrpSigInfo[117].TxBufferEndIdxOfTxGrpSigInfo "" UWORD Com_TxBufferEndIdxOfTxGrpSigInfoType 0 0 0 65535 ECU_ADDRESS 0x0 /end MEASUREMENT
/begin MEASUREMENT Com_TxGrpSigInfo[117].TxBufferStartIdxOfTxGrpSigInfo "" UWORD Com_TxBufferStartIdxOfTxGrpSigInfoType 0 0 0 65535 ECU_ADDRESS 0x0 /end MEASUREMENT
/begin MEASUREMENT Com_TxGrpSigInfo[117].TxPduInfoIdxOfTxGrpSigInfo "" UBYTE NO_COMPU_METHOD 0 0 0 255 ECU_ADDRESS 0x0 /end MEASUREMENT
/begin MEASUREMENT Com_TxGrpSigInfo[117].TxSigGrpInfoIdxOfTxGrpSigInfo "" UBYTE NO_COMPU_METHOD 0 0 0 255 ECU_ADDRESS 0x0 /end MEASUREMENT
/begin MEASUREMENT Com_TxGrpSigInfo[117].WithoutRepOfTxGrpSigInfo "" UBYTE Com_WithoutRepOfTxGrpSigInfoType 0 0 0 1 ECU_ADDRESS 0x0 /end MEASUREMENT
/begin MEASUREMENT Com_TxGrpSigInfo[118].ApplTypeOfTxGrpSigInfo "" UBYTE Com_ApplTypeOfTxGrpSigInfoType 0 0 0 255 ECU_ADDRESS 0x0 /end MEASUREMENT
/begin MEASUREMENT Com_TxGrpSigInfo[118].BitLengthOfTxGrpSigInfo "" UBYTE NO_COMPU_METHOD 0 0 0 255 ECU_ADDRESS 0x0 /end MEASUREMENT
/begin MEASUREMENT Com_TxGrpSigInfo[118].BitPositionOfTxGrpSigInfo "" UWORD NO_COMPU_METHOD 0 0 0 65535 ECU_ADDRESS 0x0 /end MEASUREMENT
/begin MEASUREMENT Com_TxGrpSigInfo[118].BusAccOfTxGrpSigInfo "" UBYTE Com_BusAccOfTxGrpSigInfoType 0 0 0 255 ECU_ADDRESS 0x0 /end MEASUREMENT
/begin MEASUREMENT Com_TxGrpSigInfo[118].ByteLengthOfTxGrpSigInfo "" UBYTE NO_COMPU_METHOD 0 0 0 255 ECU_ADDRESS 0x0 /end MEASUREMENT
/begin MEASUREMENT Com_TxGrpSigInfo[118].DynSignalOfTxGrpSigInfo "" UBYTE Com_DynSignalOfTxGrpSigInfoType 0 0 0 1 ECU_ADDRESS 0x0 /end MEASUREMENT
/begin MEASUREMENT Com_TxGrpSigInfo[118].InvValueIdxOfTxGrpSigInfo "" UBYTE Com_InvValueIdxOfTxGrpSigInfoType 0 0 0 255 ECU_ADDRESS 0x0 /end MEASUREMENT
/begin MEASUREMENT Com_TxGrpSigInfo[118].InvValueOfTxGrpSigInfo "" UBYTE Com_InvValueOfTxGrpSigInfoType 0 0 0 255 ECU_ADDRESS 0x0 /end MEASUREMENT
/begin MEASUREMENT Com_TxGrpSigInfo[118].StartByteInPduPositionOfTxGrpSigInfo "" UBYTE NO_COMPU_METHOD 0 0 0 255 ECU_ADDRESS 0x0 /end MEASUREMENT
/begin MEASUREMENT Com_TxGrpSigInfo[118].TxBufferEndIdxOfTxGrpSigInfo "" UWORD Com_TxBufferEndIdxOfTxGrpSigInfoType 0 0 0 65535 ECU_ADDRESS 0x0 /end MEASUREMENT
/begin MEASUREMENT Com_TxGrpSigInfo[118].TxBufferStartIdxOfTxGrpSigInfo "" UWORD Com_TxBufferStartIdxOfTxGrpSigInfoType 0 0 0 65535 ECU_ADDRESS 0x0 /end MEASUREMENT
/begin MEASUREMENT Com_TxGrpSigInfo[118].TxPduInfoIdxOfTxGrpSigInfo "" UBYTE NO_COMPU_METHOD 0 0 0 255 ECU_ADDRESS 0x0 /end MEASUREMENT
/begin MEASUREMENT Com_TxGrpSigInfo[118].TxSigGrpInfoIdxOfTxGrpSigInfo "" UBYTE NO_COMPU_METHOD 0 0 0 255 ECU_ADDRESS 0x0 /end MEASUREMENT
/begin MEASUREMENT Com_TxGrpSigInfo[118].WithoutRepOfTxGrpSigInfo "" UBYTE Com_WithoutRepOfTxGrpSigInfoType 0 0 0 1 ECU_ADDRESS 0x0 /end MEASUREMENT
/begin MEASUREMENT Com_TxGrpSigInfo[119].ApplTypeOfTxGrpSigInfo "" UBYTE Com_ApplTypeOfTxGrpSigInfoType 0 0 0 255 ECU_ADDRESS 0x0 /end MEASUREMENT
/begin MEASUREMENT Com_TxGrpSigInfo[119].BitLengthOfTxGrpSigInfo "" UBYTE NO_COMPU_METHOD 0 0 0 255 ECU_ADDRESS 0x0 /end MEASUREMENT
/begin MEASUREMENT Com_TxGrpSigInfo[119].BitPositionOfTxGrpSigInfo "" UWORD NO_COMPU_METHOD 0 0 0 65535 ECU_ADDRESS 0x0 /end MEASUREMENT
/begin MEASUREMENT Com_TxGrpSigInfo[119].BusAccOfTxGrpSigInfo "" UBYTE Com_BusAccOfTxGrpSigInfoType 0 0 0 255 ECU_ADDRESS 0x0 /end MEASUREMENT
/begin MEASUREMENT Com_TxGrpSigInfo[119].ByteLengthOfTxGrpSigInfo "" UBYTE NO_COMPU_METHOD 0 0 0 255 ECU_ADDRESS 0x0 /end MEASUREMENT
/begin MEASUREMENT Com_TxGrpSigInfo[119].DynSignalOfTxGrpSigInfo "" UBYTE Com_DynSignalOfTxGrpSigInfoType 0 0 0 1 ECU_ADDRESS 0x0 /end MEASUREMENT
/begin MEASUREMENT Com_TxGrpSigInfo[119].InvValueIdxOfTxGrpSigInfo "" UBYTE Com_InvValueIdxOfTxGrpSigInfoType 0 0 0 255 ECU_ADDRESS 0x0 /end MEASUREMENT
/begin MEASUREMENT Com_TxGrpSigInfo[119].InvValueOfTxGrpSigInfo "" UBYTE Com_InvValueOfTxGrpSigInfoType 0 0 0 255 ECU_ADDRESS 0x0 /end MEASUREMENT
/begin MEASUREMENT Com_TxGrpSigInfo[119].StartByteInPduPositionOfTxGrpSigInfo "" UBYTE NO_COMPU_METHOD 0 0 0 255 ECU_ADDRESS 0x0 /end MEASUREMENT
/begin MEASUREMENT Com_TxGrpSigInfo[119].TxBufferEndIdxOfTxGrpSigInfo "" UWORD Com_TxBufferEndIdxOfTxGrpSigInfoType 0 0 0 65535 ECU_ADDRESS 0x0 /end MEASUREMENT
/begin MEASUREMENT Com_TxGrpSigInfo[119].TxBufferStartIdxOfTxGrpSigInfo "" UWORD Com_TxBufferStartIdxOfTxGrpSigInfoType 0 0 0 65535 ECU_ADDRESS 0x0 /end MEASUREMENT
/begin MEASUREMENT Com_TxGrpSigInfo[119].TxPduInfoIdxOfTxGrpSigInfo "" UBYTE NO_COMPU_METHOD 0 0 0 255 ECU_ADDRESS 0x0 /end MEASUREMENT
/begin MEASUREMENT Com_TxGrpSigInfo[119].TxSigGrpInfoIdxOfTxGrpSigInfo "" UBYTE NO_COMPU_METHOD 0 0 0 255 ECU_ADDRESS 0x0 /end MEASUREMENT
/begin MEASUREMENT Com_TxGrpSigInfo[119].WithoutRepOfTxGrpSigInfo "" UBYTE Com_WithoutRepOfTxGrpSigInfoType 0 0 0 1 ECU_ADDRESS 0x0 /end MEASUREMENT
/begin MEASUREMENT Com_TxGrpSigInfo[11].ApplTypeOfTxGrpSigInfo "" UBYTE Com_ApplTypeOfTxGrpSigInfoType 0 0 0 255 ECU_ADDRESS 0x0 /end MEASUREMENT
/begin MEASUREMENT Com_TxGrpSigInfo[11].BitLengthOfTxGrpSigInfo "" UBYTE NO_COMPU_METHOD 0 0 0 255 ECU_ADDRESS 0x0 /end MEASUREMENT
/begin MEASUREMENT Com_TxGrpSigInfo[11].BitPositionOfTxGrpSigInfo "" UWORD NO_COMPU_METHOD 0 0 0 65535 ECU_ADDRESS 0x0 /end MEASUREMENT
/begin MEASUREMENT Com_TxGrpSigInfo[11].BusAccOfTxGrpSigInfo "" UBYTE Com_BusAccOfTxGrpSigInfoType 0 0 0 255 ECU_ADDRESS 0x0 /end MEASUREMENT
/begin MEASUREMENT Com_TxGrpSigInfo[11].ByteLengthOfTxGrpSigInfo "" UBYTE NO_COMPU_METHOD 0 0 0 255 ECU_ADDRESS 0x0 /end MEASUREMENT
/begin MEASUREMENT Com_TxGrpSigInfo[11].DynSignalOfTxGrpSigInfo "" UBYTE Com_DynSignalOfTxGrpSigInfoType 0 0 0 1 ECU_ADDRESS 0x0 /end MEASUREMENT
/begin MEASUREMENT Com_TxGrpSigInfo[11].InvValueIdxOfTxGrpSigInfo "" UBYTE Com_InvValueIdxOfTxGrpSigInfoType 0 0 0 255 ECU_ADDRESS 0x0 /end MEASUREMENT
/begin MEASUREMENT Com_TxGrpSigInfo[11].InvValueOfTxGrpSigInfo "" UBYTE Com_InvValueOfTxGrpSigInfoType 0 0 0 255 ECU_ADDRESS 0x0 /end MEASUREMENT
/begin MEASUREMENT Com_TxGrpSigInfo[11].StartByteInPduPositionOfTxGrpSigInfo "" UBYTE NO_COMPU_METHOD 0 0 0 255 ECU_ADDRESS 0x0 /end MEASUREMENT
/begin MEASUREMENT Com_TxGrpSigInfo[11].TxBufferEndIdxOfTxGrpSigInfo "" UWORD Com_TxBufferEndIdxOfTxGrpSigInfoType 0 0 0 65535 ECU_ADDRESS 0x0 /end MEASUREMENT
/begin MEASUREMENT Com_TxGrpSigInfo[11].TxBufferStartIdxOfTxGrpSigInfo "" UWORD Com_TxBufferStartIdxOfTxGrpSigInfoType 0 0 0 65535 ECU_ADDRESS 0x0 /end MEASUREMENT
/begin MEASUREMENT Com_TxGrpSigInfo[11].TxPduInfoIdxOfTxGrpSigInfo "" UBYTE NO_COMPU_METHOD 0 0 0 255 ECU_ADDRESS 0x0 /end MEASUREMENT
/begin MEASUREMENT Com_TxGrpSigInfo[11].TxSigGrpInfoIdxOfTxGrpSigInfo "" UBYTE NO_COMPU_METHOD 0 0 0 255 ECU_ADDRESS 0x0 /end MEASUREMENT
/begin MEASUREMENT Com_TxGrpSigInfo[11].WithoutRepOfTxGrpSigInfo "" UBYTE Com_WithoutRepOfTxGrpSigInfoType 0 0 0 1 ECU_ADDRESS 0x0 /end MEASUREMENT
/begin MEASUREMENT Com_TxGrpSigInfo[120].ApplTypeOfTxGrpSigInfo "" UBYTE Com_ApplTypeOfTxGrpSigInfoType 0 0 0 255 ECU_ADDRESS 0x0 /end MEASUREMENT
/begin MEASUREMENT Com_TxGrpSigInfo[120].BitLengthOfTxGrpSigInfo "" UBYTE NO_COMPU_METHOD 0 0 0 255 ECU_ADDRESS 0x0 /end MEASUREMENT
/begin MEASUREMENT Com_TxGrpSigInfo[120].BitPositionOfTxGrpSigInfo "" UWORD NO_COMPU_METHOD 0 0 0 65535 ECU_ADDRESS 0x0 /end MEASUREMENT
/begin MEASUREMENT Com_TxGrpSigInfo[120].BusAccOfTxGrpSigInfo "" UBYTE Com_BusAccOfTxGrpSigInfoType 0 0 0 255 ECU_ADDRESS 0x0 /end MEASUREMENT
/begin MEASUREMENT Com_TxGrpSigInfo[120].ByteLengthOfTxGrpSigInfo "" UBYTE NO_COMPU_METHOD 0 0 0 255 ECU_ADDRESS 0x0 /end MEASUREMENT
/begin MEASUREMENT Com_TxGrpSigInfo[120].DynSignalOfTxGrpSigInfo "" UBYTE Com_DynSignalOfTxGrpSigInfoType 0 0 0 1 ECU_ADDRESS 0x0 /end MEASUREMENT
/begin MEASUREMENT Com_TxGrpSigInfo[120].InvValueIdxOfTxGrpSigInfo "" UBYTE Com_InvValueIdxOfTxGrpSigInfoType 0 0 0 255 ECU_ADDRESS 0x0 /end MEASUREMENT
/begin MEASUREMENT Com_TxGrpSigInfo[120].InvValueOfTxGrpSigInfo "" UBYTE Com_InvValueOfTxGrpSigInfoType 0 0 0 255 ECU_ADDRESS 0x0 /end MEASUREMENT
/begin MEASUREMENT Com_TxGrpSigInfo[120].StartByteInPduPositionOfTxGrpSigInfo "" UBYTE NO_COMPU_METHOD 0 0 0 255 ECU_ADDRESS 0x0 /end MEASUREMENT
/begin MEASUREMENT Com_TxGrpSigInfo[120].TxBufferEndIdxOfTxGrpSigInfo "" UWORD Com_TxBufferEndIdxOfTxGrpSigInfoType 0 0 0 65535 ECU_ADDRESS 0x0 /end MEASUREMENT
/begin MEASUREMENT Com_TxGrpSigInfo[120].TxBufferStartIdxOfTxGrpSigInfo "" UWORD Com_TxBufferStartIdxOfTxGrpSigInfoType 0 0 0 65535 ECU_ADDRESS 0x0 /end MEASUREMENT
/begin MEASUREMENT Com_TxGrpSigInfo[120].TxPduInfoIdxOfTxGrpSigInfo "" UBYTE NO_COMPU_METHOD 0 0 0 255 ECU_ADDRESS 0x0 /end MEASUREMENT
/begin MEASUREMENT Com_TxGrpSigInfo[120].TxSigGrpInfoIdxOfTxGrpSigInfo "" UBYTE NO_COMPU_METHOD 0 0 0 255 ECU_ADDRESS 0x0 /end MEASUREMENT
/begin MEASUREMENT Com_TxGrpSigInfo[120].WithoutRepOfTxGrpSigInfo "" UBYTE Com_WithoutRepOfTxGrpSigInfoType 0 0 0 1 ECU_ADDRESS 0x0 /end MEASUREMENT
/begin MEASUREMENT Com_TxGrpSigInfo[121].ApplTypeOfTxGrpSigInfo "" UBYTE Com_ApplTypeOfTxGrpSigInfoType 0 0 0 255 ECU_ADDRESS 0x0 /end MEASUREMENT
/begin MEASUREMENT Com_TxGrpSigInfo[121].BitLengthOfTxGrpSigInfo "" UBYTE NO_COMPU_METHOD 0 0 0 255 ECU_ADDRESS 0x0 /end MEASUREMENT
/begin MEASUREMENT Com_TxGrpSigInfo[121].BitPositionOfTxGrpSigInfo "" UWORD NO_COMPU_METHOD 0 0 0 65535 ECU_ADDRESS 0x0 /end MEASUREMENT
/begin MEASUREMENT Com_TxGrpSigInfo[121].BusAccOfTxGrpSigInfo "" UBYTE Com_BusAccOfTxGrpSigInfoType 0 0 0 255 ECU_ADDRESS 0x0 /end MEASUREMENT
/begin MEASUREMENT Com_TxGrpSigInfo[121].ByteLengthOfTxGrpSigInfo "" UBYTE NO_COMPU_METHOD 0 0 0 255 ECU_ADDRESS 0x0 /end MEASUREMENT
/begin MEASUREMENT Com_TxGrpSigInfo[121].DynSignalOfTxGrpSigInfo "" UBYTE Com_DynSignalOfTxGrpSigInfoType 0 0 0 1 ECU_ADDRESS 0x0 /end MEASUREMENT
/begin MEASUREMENT Com_TxGrpSigInfo[121].InvValueIdxOfTxGrpSigInfo "" UBYTE Com_InvValueIdxOfTxGrpSigInfoType 0 0 0 255 ECU_ADDRESS 0x0 /end MEASUREMENT
/begin MEASUREMENT Com_TxGrpSigInfo[121].InvValueOfTxGrpSigInfo "" UBYTE Com_InvValueOfTxGrpSigInfoType 0 0 0 255 ECU_ADDRESS 0x0 /end MEASUREMENT
/begin MEASUREMENT Com_TxGrpSigInfo[121].StartByteInPduPositionOfTxGrpSigInfo "" UBYTE NO_COMPU_METHOD 0 0 0 255 ECU_ADDRESS 0x0 /end MEASUREMENT
/begin MEASUREMENT Com_TxGrpSigInfo[121].TxBufferEndIdxOfTxGrpSigInfo "" UWORD Com_TxBufferEndIdxOfTxGrpSigInfoType 0 0 0 65535 ECU_ADDRESS 0x0 /end MEASUREMENT
/begin MEASUREMENT Com_TxGrpSigInfo[121].TxBufferStartIdxOfTxGrpSigInfo "" UWORD Com_TxBufferStartIdxOfTxGrpSigInfoType 0 0 0 65535 ECU_ADDRESS 0x0 /end MEASUREMENT
/begin MEASUREMENT Com_TxGrpSigInfo[121].TxPduInfoIdxOfTxGrpSigInfo "" UBYTE NO_COMPU_METHOD 0 0 0 255 ECU_ADDRESS 0x0 /end MEASUREMENT
/begin MEASUREMENT Com_TxGrpSigInfo[121].TxSigGrpInfoIdxOfTxGrpSigInfo "" UBYTE NO_COMPU_METHOD 0 0 0 255 ECU_ADDRESS 0x0 /end MEASUREMENT
/begin MEASUREMENT Com_TxGrpSigInfo[121].WithoutRepOfTxGrpSigInfo "" UBYTE Com_WithoutRepOfTxGrpSigInfoType 0 0 0 1 ECU_ADDRESS 0x0 /end MEASUREMENT
/begin MEASUREMENT Com_TxGrpSigInfo[122].ApplTypeOfTxGrpSigInfo "" UBYTE Com_ApplTypeOfTxGrpSigInfoType 0 0 0 255 ECU_ADDRESS 0x0 /end MEASUREMENT
/begin MEASUREMENT Com_TxGrpSigInfo[122].BitLengthOfTxGrpSigInfo "" UBYTE NO_COMPU_METHOD 0 0 0 255 ECU_ADDRESS 0x0 /end MEASUREMENT
/begin MEASUREMENT Com_TxGrpSigInfo[122].BitPositionOfTxGrpSigInfo "" UWORD NO_COMPU_METHOD 0 0 0 65535 ECU_ADDRESS 0x0 /end MEASUREMENT
/begin MEASUREMENT Com_TxGrpSigInfo[122].BusAccOfTxGrpSigInfo "" UBYTE Com_BusAccOfTxGrpSigInfoType 0 0 0 255 ECU_ADDRESS 0x0 /end MEASUREMENT
/begin MEASUREMENT Com_TxGrpSigInfo[122].ByteLengthOfTxGrpSigInfo "" UBYTE NO_COMPU_METHOD 0 0 0 255 ECU_ADDRESS 0x0 /end MEASUREMENT
/begin MEASUREMENT Com_TxGrpSigInfo[122].DynSignalOfTxGrpSigInfo "" UBYTE Com_DynSignalOfTxGrpSigInfoType 0 0 0 1 ECU_ADDRESS 0x0 /end MEASUREMENT
/begin MEASUREMENT Com_TxGrpSigInfo[122].InvValueIdxOfTxGrpSigInfo "" UBYTE Com_InvValueIdxOfTxGrpSigInfoType 0 0 0 255 ECU_ADDRESS 0x0 /end MEASUREMENT
/begin MEASUREMENT Com_TxGrpSigInfo[122].InvValueOfTxGrpSigInfo "" UBYTE Com_InvValueOfTxGrpSigInfoType 0 0 0 255 ECU_ADDRESS 0x0 /end MEASUREMENT
/begin MEASUREMENT Com_TxGrpSigInfo[122].StartByteInPduPositionOfTxGrpSigInfo "" UBYTE NO_COMPU_METHOD 0 0 0 255 ECU_ADDRESS 0x0 /end MEASUREMENT
/begin MEASUREMENT Com_TxGrpSigInfo[122].TxBufferEndIdxOfTxGrpSigInfo "" UWORD Com_TxBufferEndIdxOfTxGrpSigInfoType 0 0 0 65535 ECU_ADDRESS 0x0 /end MEASUREMENT
/begin MEASUREMENT Com_TxGrpSigInfo[122].TxBufferStartIdxOfTxGrpSigInfo "" UWORD Com_TxBufferStartIdxOfTxGrpSigInfoType 0 0 0 65535 ECU_ADDRESS 0x0 /end MEASUREMENT
/begin MEASUREMENT Com_TxGrpSigInfo[122].TxPduInfoIdxOfTxGrpSigInfo "" UBYTE NO_COMPU_METHOD 0 0 0 255 ECU_ADDRESS 0x0 /end MEASUREMENT
/begin MEASUREMENT Com_TxGrpSigInfo[122].TxSigGrpInfoIdxOfTxGrpSigInfo "" UBYTE NO_COMPU_METHOD 0 0 0 255 ECU_ADDRESS 0x0 /end MEASUREMENT
/begin MEASUREMENT Com_TxGrpSigInfo[122].WithoutRepOfTxGrpSigInfo "" UBYTE Com_WithoutRepOfTxGrpSigInfoType 0 0 0 1 ECU_ADDRESS 0x0 /end MEASUREMENT
/begin MEASUREMENT Com_TxGrpSigInfo[123].ApplTypeOfTxGrpSigInfo "" UBYTE Com_ApplTypeOfTxGrpSigInfoType 0 0 0 255 ECU_ADDRESS 0x0 /end MEASUREMENT
/begin MEASUREMENT Com_TxGrpSigInfo[123].BitLengthOfTxGrpSigInfo "" UBYTE NO_COMPU_METHOD 0 0 0 255 ECU_ADDRESS 0x0 /end MEASUREMENT
/begin MEASUREMENT Com_TxGrpSigInfo[123].BitPositionOfTxGrpSigInfo "" UWORD NO_COMPU_METHOD 0 0 0 65535 ECU_ADDRESS 0x0 /end MEASUREMENT
/begin MEASUREMENT Com_TxGrpSigInfo[123].BusAccOfTxGrpSigInfo "" UBYTE Com_BusAccOfTxGrpSigInfoType 0 0 0 255 ECU_ADDRESS 0x0 /end MEASUREMENT
/begin MEASUREMENT Com_TxGrpSigInfo[123].ByteLengthOfTxGrpSigInfo "" UBYTE NO_COMPU_METHOD 0 0 0 255 ECU_ADDRESS 0x0 /end MEASUREMENT
/begin MEASUREMENT Com_TxGrpSigInfo[123].DynSignalOfTxGrpSigInfo "" UBYTE Com_DynSignalOfTxGrpSigInfoType 0 0 0 1 ECU_ADDRESS 0x0 /end MEASUREMENT
/begin MEASUREMENT Com_TxGrpSigInfo[123].InvValueIdxOfTxGrpSigInfo "" UBYTE Com_InvValueIdxOfTxGrpSigInfoType 0 0 0 255 ECU_ADDRESS 0x0 /end MEASUREMENT
/begin MEASUREMENT Com_TxGrpSigInfo[123].InvValueOfTxGrpSigInfo "" UBYTE Com_InvValueOfTxGrpSigInfoType 0 0 0 255 ECU_ADDRESS 0x0 /end MEASUREMENT
/begin MEASUREMENT Com_TxGrpSigInfo[123].StartByteInPduPositionOfTxGrpSigInfo "" UBYTE NO_COMPU_METHOD 0 0 0 255 ECU_ADDRESS 0x0 /end MEASUREMENT
/begin MEASUREMENT Com_TxGrpSigInfo[123].TxBufferEndIdxOfTxGrpSigInfo "" UWORD Com_TxBufferEndIdxOfTxGrpSigInfoType 0 0 0 65535 ECU_ADDRESS 0x0 /end MEASUREMENT
/begin MEASUREMENT Com_TxGrpSigInfo[123].TxBufferStartIdxOfTxGrpSigInfo "" UWORD Com_TxBufferStartIdxOfTxGrpSigInfoType 0 0 0 65535 ECU_ADDRESS 0x0 /end MEASUREMENT
/begin MEASUREMENT Com_TxGrpSigInfo[123].TxPduInfoIdxOfTxGrpSigInfo "" UBYTE NO_COMPU_METHOD 0 0 0 255 ECU_ADDRESS 0x0 /end MEASUREMENT
/begin MEASUREMENT Com_TxGrpSigInfo[123].TxSigGrpInfoIdxOfTxGrpSigInfo "" UBYTE NO_COMPU_METHOD 0 0 0 255 ECU_ADDRESS 0x0 /end MEASUREMENT
/begin MEASUREMENT Com_TxGrpSigInfo[123].WithoutRepOfTxGrpSigInfo "" UBYTE Com_WithoutRepOfTxGrpSigInfoType 0 0 0 1 ECU_ADDRESS 0x0 /end MEASUREMENT
/begin MEASUREMENT Com_TxGrpSigInfo[12].ApplTypeOfTxGrpSigInfo "" UBYTE Com_ApplTypeOfTxGrpSigInfoType 0 0 0 255 ECU_ADDRESS 0x0 /end MEASUREMENT
/begin MEASUREMENT Com_TxGrpSigInfo[12].BitLengthOfTxGrpSigInfo "" UBYTE NO_COMPU_METHOD 0 0 0 255 ECU_ADDRESS 0x0 /end MEASUREMENT
/begin MEASUREMENT Com_TxGrpSigInfo[12].BitPositionOfTxGrpSigInfo "" UWORD NO_COMPU_METHOD 0 0 0 65535 ECU_ADDRESS 0x0 /end MEASUREMENT
/begin MEASUREMENT Com_TxGrpSigInfo[12].BusAccOfTxGrpSigInfo "" UBYTE Com_BusAccOfTxGrpSigInfoType 0 0 0 255 ECU_ADDRESS 0x0 /end MEASUREMENT
/begin MEASUREMENT Com_TxGrpSigInfo[12].ByteLengthOfTxGrpSigInfo "" UBYTE NO_COMPU_METHOD 0 0 0 255 ECU_ADDRESS 0x0 /end MEASUREMENT
/begin MEASUREMENT Com_TxGrpSigInfo[12].DynSignalOfTxGrpSigInfo "" UBYTE Com_DynSignalOfTxGrpSigInfoType 0 0 0 1 ECU_ADDRESS 0x0 /end MEASUREMENT
/begin MEASUREMENT Com_TxGrpSigInfo[12].InvValueIdxOfTxGrpSigInfo "" UBYTE Com_InvValueIdxOfTxGrpSigInfoType 0 0 0 255 ECU_ADDRESS 0x0 /end MEASUREMENT
/begin MEASUREMENT Com_TxGrpSigInfo[12].InvValueOfTxGrpSigInfo "" UBYTE Com_InvValueOfTxGrpSigInfoType 0 0 0 255 ECU_ADDRESS 0x0 /end MEASUREMENT
/begin MEASUREMENT Com_TxGrpSigInfo[12].StartByteInPduPositionOfTxGrpSigInfo "" UBYTE NO_COMPU_METHOD 0 0 0 255 ECU_ADDRESS 0x0 /end MEASUREMENT
/begin MEASUREMENT Com_TxGrpSigInfo[12].TxBufferEndIdxOfTxGrpSigInfo "" UWORD Com_TxBufferEndIdxOfTxGrpSigInfoType 0 0 0 65535 ECU_ADDRESS 0x0 /end MEASUREMENT
/begin MEASUREMENT Com_TxGrpSigInfo[12].TxBufferStartIdxOfTxGrpSigInfo "" UWORD Com_TxBufferStartIdxOfTxGrpSigInfoType 0 0 0 65535 ECU_ADDRESS 0x0 /end MEASUREMENT
/begin MEASUREMENT Com_TxGrpSigInfo[12].TxPduInfoIdxOfTxGrpSigInfo "" UBYTE NO_COMPU_METHOD 0 0 0 255 ECU_ADDRESS 0x0 /end MEASUREMENT
/begin MEASUREMENT Com_TxGrpSigInfo[12].TxSigGrpInfoIdxOfTxGrpSigInfo "" UBYTE NO_COMPU_METHOD 0 0 0 255 ECU_ADDRESS 0x0 /end MEASUREMENT
/begin MEASUREMENT Com_TxGrpSigInfo[12].WithoutRepOfTxGrpSigInfo "" UBYTE Com_WithoutRepOfTxGrpSigInfoType 0 0 0 1 ECU_ADDRESS 0x0 /end MEASUREMENT
/begin MEASUREMENT Com_TxGrpSigInfo[13].ApplTypeOfTxGrpSigInfo "" UBYTE Com_ApplTypeOfTxGrpSigInfoType 0 0 0 255 ECU_ADDRESS 0x0 /end MEASUREMENT
/begin MEASUREMENT Com_TxGrpSigInfo[13].BitLengthOfTxGrpSigInfo "" UBYTE NO_COMPU_METHOD 0 0 0 255 ECU_ADDRESS 0x0 /end MEASUREMENT
/begin MEASUREMENT Com_TxGrpSigInfo[13].BitPositionOfTxGrpSigInfo "" UWORD NO_COMPU_METHOD 0 0 0 65535 ECU_ADDRESS 0x0 /end MEASUREMENT
/begin MEASUREMENT Com_TxGrpSigInfo[13].BusAccOfTxGrpSigInfo "" UBYTE Com_BusAccOfTxGrpSigInfoType 0 0 0 255 ECU_ADDRESS 0x0 /end MEASUREMENT
/begin MEASUREMENT Com_TxGrpSigInfo[13].ByteLengthOfTxGrpSigInfo "" UBYTE NO_COMPU_METHOD 0 0 0 255 ECU_ADDRESS 0x0 /end MEASUREMENT
/begin MEASUREMENT Com_TxGrpSigInfo[13].DynSignalOfTxGrpSigInfo "" UBYTE Com_DynSignalOfTxGrpSigInfoType 0 0 0 1 ECU_ADDRESS 0x0 /end MEASUREMENT
/begin MEASUREMENT Com_TxGrpSigInfo[13].InvValueIdxOfTxGrpSigInfo "" UBYTE Com_InvValueIdxOfTxGrpSigInfoType 0 0 0 255 ECU_ADDRESS 0x0 /end MEASUREMENT
/begin MEASUREMENT Com_TxGrpSigInfo[13].InvValueOfTxGrpSigInfo "" UBYTE Com_InvValueOfTxGrpSigInfoType 0 0 0 255 ECU_ADDRESS 0x0 /end MEASUREMENT
/begin MEASUREMENT Com_TxGrpSigInfo[13].StartByteInPduPositionOfTxGrpSigInfo "" UBYTE NO_COMPU_METHOD 0 0 0 255 ECU_ADDRESS 0x0 /end MEASUREMENT
/begin MEASUREMENT Com_TxGrpSigInfo[13].TxBufferEndIdxOfTxGrpSigInfo "" UWORD Com_TxBufferEndIdxOfTxGrpSigInfoType 0 0 0 65535 ECU_ADDRESS 0x0 /end MEASUREMENT
/begin MEASUREMENT Com_TxGrpSigInfo[13].TxBufferStartIdxOfTxGrpSigInfo "" UWORD Com_TxBufferStartIdxOfTxGrpSigInfoType 0 0 0 65535 ECU_ADDRESS 0x0 /end MEASUREMENT
/begin MEASUREMENT Com_TxGrpSigInfo[13].TxPduInfoIdxOfTxGrpSigInfo "" UBYTE NO_COMPU_METHOD 0 0 0 255 ECU_ADDRESS 0x0 /end MEASUREMENT
/begin MEASUREMENT Com_TxGrpSigInfo[13].TxSigGrpInfoIdxOfTxGrpSigInfo "" UBYTE NO_COMPU_METHOD 0 0 0 255 ECU_ADDRESS 0x0 /end MEASUREMENT
/begin MEASUREMENT Com_TxGrpSigInfo[13].WithoutRepOfTxGrpSigInfo "" UBYTE Com_WithoutRepOfTxGrpSigInfoType 0 0 0 1 ECU_ADDRESS 0x0 /end MEASUREMENT
/begin MEASUREMENT Com_TxGrpSigInfo[14].ApplTypeOfTxGrpSigInfo "" UBYTE Com_ApplTypeOfTxGrpSigInfoType 0 0 0 255 ECU_ADDRESS 0x0 /end MEASUREMENT
/begin MEASUREMENT Com_TxGrpSigInfo[14].BitLengthOfTxGrpSigInfo "" UBYTE NO_COMPU_METHOD 0 0 0 255 ECU_ADDRESS 0x0 /end MEASUREMENT
/begin MEASUREMENT Com_TxGrpSigInfo[14].BitPositionOfTxGrpSigInfo "" UWORD NO_COMPU_METHOD 0 0 0 65535 ECU_ADDRESS 0x0 /end MEASUREMENT
/begin MEASUREMENT Com_TxGrpSigInfo[14].BusAccOfTxGrpSigInfo "" UBYTE Com_BusAccOfTxGrpSigInfoType 0 0 0 255 ECU_ADDRESS 0x0 /end MEASUREMENT
/begin MEASUREMENT Com_TxGrpSigInfo[14].ByteLengthOfTxGrpSigInfo "" UBYTE NO_COMPU_METHOD 0 0 0 255 ECU_ADDRESS 0x0 /end MEASUREMENT
/begin MEASUREMENT Com_TxGrpSigInfo[14].DynSignalOfTxGrpSigInfo "" UBYTE Com_DynSignalOfTxGrpSigInfoType 0 0 0 1 ECU_ADDRESS 0x0 /end MEASUREMENT
/begin MEASUREMENT Com_TxGrpSigInfo[14].InvValueIdxOfTxGrpSigInfo "" UBYTE Com_InvValueIdxOfTxGrpSigInfoType 0 0 0 255 ECU_ADDRESS 0x0 /end MEASUREMENT
/begin MEASUREMENT Com_TxGrpSigInfo[14].InvValueOfTxGrpSigInfo "" UBYTE Com_InvValueOfTxGrpSigInfoType 0 0 0 255 ECU_ADDRESS 0x0 /end MEASUREMENT
/begin MEASUREMENT Com_TxGrpSigInfo[14].StartByteInPduPositionOfTxGrpSigInfo "" UBYTE NO_COMPU_METHOD 0 0 0 255 ECU_ADDRESS 0x0 /end MEASUREMENT
/begin MEASUREMENT Com_TxGrpSigInfo[14].TxBufferEndIdxOfTxGrpSigInfo "" UWORD Com_TxBufferEndIdxOfTxGrpSigInfoType 0 0 0 65535 ECU_ADDRESS 0x0 /end MEASUREMENT
/begin MEASUREMENT Com_TxGrpSigInfo[14].TxBufferStartIdxOfTxGrpSigInfo "" UWORD Com_TxBufferStartIdxOfTxGrpSigInfoType 0 0 0 65535 ECU_ADDRESS 0x0 /end MEASUREMENT
/begin MEASUREMENT Com_TxGrpSigInfo[14].TxPduInfoIdxOfTxGrpSigInfo "" UBYTE NO_COMPU_METHOD 0 0 0 255 ECU_ADDRESS 0x0 /end MEASUREMENT
/begin MEASUREMENT Com_TxGrpSigInfo[14].TxSigGrpInfoIdxOfTxGrpSigInfo "" UBYTE NO_COMPU_METHOD 0 0 0 255 ECU_ADDRESS 0x0 /end MEASUREMENT
/begin MEASUREMENT Com_TxGrpSigInfo[14].WithoutRepOfTxGrpSigInfo "" UBYTE Com_WithoutRepOfTxGrpSigInfoType 0 0 0 1 ECU_ADDRESS 0x0 /end MEASUREMENT
/begin MEASUREMENT Com_TxGrpSigInfo[15].ApplTypeOfTxGrpSigInfo "" UBYTE Com_ApplTypeOfTxGrpSigInfoType 0 0 0 255 ECU_ADDRESS 0x0 /end MEASUREMENT
/begin MEASUREMENT Com_TxGrpSigInfo[15].BitLengthOfTxGrpSigInfo "" UBYTE NO_COMPU_METHOD 0 0 0 255 ECU_ADDRESS 0x0 /end MEASUREMENT
/begin MEASUREMENT Com_TxGrpSigInfo[15].BitPositionOfTxGrpSigInfo "" UWORD NO_COMPU_METHOD 0 0 0 65535 ECU_ADDRESS 0x0 /end MEASUREMENT
/begin MEASUREMENT Com_TxGrpSigInfo[15].BusAccOfTxGrpSigInfo "" UBYTE Com_BusAccOfTxGrpSigInfoType 0 0 0 255 ECU_ADDRESS 0x0 /end MEASUREMENT
/begin MEASUREMENT Com_TxGrpSigInfo[15].ByteLengthOfTxGrpSigInfo "" UBYTE NO_COMPU_METHOD 0 0 0 255 ECU_ADDRESS 0x0 /end MEASUREMENT
/begin MEASUREMENT Com_TxGrpSigInfo[15].DynSignalOfTxGrpSigInfo "" UBYTE Com_DynSignalOfTxGrpSigInfoType 0 0 0 1 ECU_ADDRESS 0x0 /end MEASUREMENT
/begin MEASUREMENT Com_TxGrpSigInfo[15].InvValueIdxOfTxGrpSigInfo "" UBYTE Com_InvValueIdxOfTxGrpSigInfoType 0 0 0 255 ECU_ADDRESS 0x0 /end MEASUREMENT
/begin MEASUREMENT Com_TxGrpSigInfo[15].InvValueOfTxGrpSigInfo "" UBYTE Com_InvValueOfTxGrpSigInfoType 0 0 0 255 ECU_ADDRESS 0x0 /end MEASUREMENT
/begin MEASUREMENT Com_TxGrpSigInfo[15].StartByteInPduPositionOfTxGrpSigInfo "" UBYTE NO_COMPU_METHOD 0 0 0 255 ECU_ADDRESS 0x0 /end MEASUREMENT
/begin MEASUREMENT Com_TxGrpSigInfo[15].TxBufferEndIdxOfTxGrpSigInfo "" UWORD Com_TxBufferEndIdxOfTxGrpSigInfoType 0 0 0 65535 ECU_ADDRESS 0x0 /end MEASUREMENT
/begin MEASUREMENT Com_TxGrpSigInfo[15].TxBufferStartIdxOfTxGrpSigInfo "" UWORD Com_TxBufferStartIdxOfTxGrpSigInfoType 0 0 0 65535 ECU_ADDRESS 0x0 /end MEASUREMENT
/begin MEASUREMENT Com_TxGrpSigInfo[15].TxPduInfoIdxOfTxGrpSigInfo "" UBYTE NO_COMPU_METHOD 0 0 0 255 ECU_ADDRESS 0x0 /end MEASUREMENT
/begin MEASUREMENT Com_TxGrpSigInfo[15].TxSigGrpInfoIdxOfTxGrpSigInfo "" UBYTE NO_COMPU_METHOD 0 0 0 255 ECU_ADDRESS 0x0 /end MEASUREMENT
/begin MEASUREMENT Com_TxGrpSigInfo[15].WithoutRepOfTxGrpSigInfo "" UBYTE Com_WithoutRepOfTxGrpSigInfoType 0 0 0 1 ECU_ADDRESS 0x0 /end MEASUREMENT
/begin MEASUREMENT Com_TxGrpSigInfo[16].ApplTypeOfTxGrpSigInfo "" UBYTE Com_ApplTypeOfTxGrpSigInfoType 0 0 0 255 ECU_ADDRESS 0x0 /end MEASUREMENT
/begin MEASUREMENT Com_TxGrpSigInfo[16].BitLengthOfTxGrpSigInfo "" UBYTE NO_COMPU_METHOD 0 0 0 255 ECU_ADDRESS 0x0 /end MEASUREMENT
/begin MEASUREMENT Com_TxGrpSigInfo[16].BitPositionOfTxGrpSigInfo "" UWORD NO_COMPU_METHOD 0 0 0 65535 ECU_ADDRESS 0x0 /end MEASUREMENT
/begin MEASUREMENT Com_TxGrpSigInfo[16].BusAccOfTxGrpSigInfo "" UBYTE Com_BusAccOfTxGrpSigInfoType 0 0 0 255 ECU_ADDRESS 0x0 /end MEASUREMENT
/begin MEASUREMENT Com_TxGrpSigInfo[16].ByteLengthOfTxGrpSigInfo "" UBYTE NO_COMPU_METHOD 0 0 0 255 ECU_ADDRESS 0x0 /end MEASUREMENT
/begin MEASUREMENT Com_TxGrpSigInfo[16].DynSignalOfTxGrpSigInfo "" UBYTE Com_DynSignalOfTxGrpSigInfoType 0 0 0 1 ECU_ADDRESS 0x0 /end MEASUREMENT
/begin MEASUREMENT Com_TxGrpSigInfo[16].InvValueIdxOfTxGrpSigInfo "" UBYTE Com_InvValueIdxOfTxGrpSigInfoType 0 0 0 255 ECU_ADDRESS 0x0 /end MEASUREMENT
/begin MEASUREMENT Com_TxGrpSigInfo[16].InvValueOfTxGrpSigInfo "" UBYTE Com_InvValueOfTxGrpSigInfoType 0 0 0 255 ECU_ADDRESS 0x0 /end MEASUREMENT
/begin MEASUREMENT Com_TxGrpSigInfo[16].StartByteInPduPositionOfTxGrpSigInfo "" UBYTE NO_COMPU_METHOD 0 0 0 255 ECU_ADDRESS 0x0 /end MEASUREMENT
/begin MEASUREMENT Com_TxGrpSigInfo[16].TxBufferEndIdxOfTxGrpSigInfo "" UWORD Com_TxBufferEndIdxOfTxGrpSigInfoType 0 0 0 65535 ECU_ADDRESS 0x0 /end MEASUREMENT
/begin MEASUREMENT Com_TxGrpSigInfo[16].TxBufferStartIdxOfTxGrpSigInfo "" UWORD Com_TxBufferStartIdxOfTxGrpSigInfoType 0 0 0 65535 ECU_ADDRESS 0x0 /end MEASUREMENT
/begin MEASUREMENT Com_TxGrpSigInfo[16].TxPduInfoIdxOfTxGrpSigInfo "" UBYTE NO_COMPU_METHOD 0 0 0 255 ECU_ADDRESS 0x0 /end MEASUREMENT
/begin MEASUREMENT Com_TxGrpSigInfo[16].TxSigGrpInfoIdxOfTxGrpSigInfo "" UBYTE NO_COMPU_METHOD 0 0 0 255 ECU_ADDRESS 0x0 /end MEASUREMENT
/begin MEASUREMENT Com_TxGrpSigInfo[16].WithoutRepOfTxGrpSigInfo "" UBYTE Com_WithoutRepOfTxGrpSigInfoType 0 0 0 1 ECU_ADDRESS 0x0 /end MEASUREMENT
/begin MEASUREMENT Com_TxGrpSigInfo[17].ApplTypeOfTxGrpSigInfo "" UBYTE Com_ApplTypeOfTxGrpSigInfoType 0 0 0 255 ECU_ADDRESS 0x0 /end MEASUREMENT
/begin MEASUREMENT Com_TxGrpSigInfo[17].BitLengthOfTxGrpSigInfo "" UBYTE NO_COMPU_METHOD 0 0 0 255 ECU_ADDRESS 0x0 /end MEASUREMENT
/begin MEASUREMENT Com_TxGrpSigInfo[17].BitPositionOfTxGrpSigInfo "" UWORD NO_COMPU_METHOD 0 0 0 65535 ECU_ADDRESS 0x0 /end MEASUREMENT
/begin MEASUREMENT Com_TxGrpSigInfo[17].BusAccOfTxGrpSigInfo "" UBYTE Com_BusAccOfTxGrpSigInfoType 0 0 0 255 ECU_ADDRESS 0x0 /end MEASUREMENT
/begin MEASUREMENT Com_TxGrpSigInfo[17].ByteLengthOfTxGrpSigInfo "" UBYTE NO_COMPU_METHOD 0 0 0 255 ECU_ADDRESS 0x0 /end MEASUREMENT
/begin MEASUREMENT Com_TxGrpSigInfo[17].DynSignalOfTxGrpSigInfo "" UBYTE Com_DynSignalOfTxGrpSigInfoType 0 0 0 1 ECU_ADDRESS 0x0 /end MEASUREMENT
/begin MEASUREMENT Com_TxGrpSigInfo[17].InvValueIdxOfTxGrpSigInfo "" UBYTE Com_InvValueIdxOfTxGrpSigInfoType 0 0 0 255 ECU_ADDRESS 0x0 /end MEASUREMENT
/begin MEASUREMENT Com_TxGrpSigInfo[17].InvValueOfTxGrpSigInfo "" UBYTE Com_InvValueOfTxGrpSigInfoType 0 0 0 255 ECU_ADDRESS 0x0 /end MEASUREMENT
/begin MEASUREMENT Com_TxGrpSigInfo[17].StartByteInPduPositionOfTxGrpSigInfo "" UBYTE NO_COMPU_METHOD 0 0 0 255 ECU_ADDRESS 0x0 /end MEASUREMENT
/begin MEASUREMENT Com_TxGrpSigInfo[17].TxBufferEndIdxOfTxGrpSigInfo "" UWORD Com_TxBufferEndIdxOfTxGrpSigInfoType 0 0 0 65535 ECU_ADDRESS 0x0 /end MEASUREMENT
/begin MEASUREMENT Com_TxGrpSigInfo[17].TxBufferStartIdxOfTxGrpSigInfo "" UWORD Com_TxBufferStartIdxOfTxGrpSigInfoType 0 0 0 65535 ECU_ADDRESS 0x0 /end MEASUREMENT
/begin MEASUREMENT Com_TxGrpSigInfo[17].TxPduInfoIdxOfTxGrpSigInfo "" UBYTE NO_COMPU_METHOD 0 0 0 255 ECU_ADDRESS 0x0 /end MEASUREMENT
/begin MEASUREMENT Com_TxGrpSigInfo[17].TxSigGrpInfoIdxOfTxGrpSigInfo "" UBYTE NO_COMPU_METHOD 0 0 0 255 ECU_ADDRESS 0x0 /end MEASUREMENT
/begin MEASUREMENT Com_TxGrpSigInfo[17].WithoutRepOfTxGrpSigInfo "" UBYTE Com_WithoutRepOfTxGrpSigInfoType 0 0 0 1 ECU_ADDRESS 0x0 /end MEASUREMENT
/begin MEASUREMENT Com_TxGrpSigInfo[18].ApplTypeOfTxGrpSigInfo "" UBYTE Com_ApplTypeOfTxGrpSigInfoType 0 0 0 255 ECU_ADDRESS 0x0 /end MEASUREMENT
/begin MEASUREMENT Com_TxGrpSigInfo[18].BitLengthOfTxGrpSigInfo "" UBYTE NO_COMPU_METHOD 0 0 0 255 ECU_ADDRESS 0x0 /end MEASUREMENT
/begin MEASUREMENT Com_TxGrpSigInfo[18].BitPositionOfTxGrpSigInfo "" UWORD NO_COMPU_METHOD 0 0 0 65535 ECU_ADDRESS 0x0 /end MEASUREMENT
/begin MEASUREMENT Com_TxGrpSigInfo[18].BusAccOfTxGrpSigInfo "" UBYTE Com_BusAccOfTxGrpSigInfoType 0 0 0 255 ECU_ADDRESS 0x0 /end MEASUREMENT
/begin MEASUREMENT Com_TxGrpSigInfo[18].ByteLengthOfTxGrpSigInfo "" UBYTE NO_COMPU_METHOD 0 0 0 255 ECU_ADDRESS 0x0 /end MEASUREMENT
/begin MEASUREMENT Com_TxGrpSigInfo[18].DynSignalOfTxGrpSigInfo "" UBYTE Com_DynSignalOfTxGrpSigInfoType 0 0 0 1 ECU_ADDRESS 0x0 /end MEASUREMENT
/begin MEASUREMENT Com_TxGrpSigInfo[18].InvValueIdxOfTxGrpSigInfo "" UBYTE Com_InvValueIdxOfTxGrpSigInfoType 0 0 0 255 ECU_ADDRESS 0x0 /end MEASUREMENT
/begin MEASUREMENT Com_TxGrpSigInfo[18].InvValueOfTxGrpSigInfo "" UBYTE Com_InvValueOfTxGrpSigInfoType 0 0 0 255 ECU_ADDRESS 0x0 /end MEASUREMENT
/begin MEASUREMENT Com_TxGrpSigInfo[18].StartByteInPduPositionOfTxGrpSigInfo "" UBYTE NO_COMPU_METHOD 0 0 0 255 ECU_ADDRESS 0x0 /end MEASUREMENT
/begin MEASUREMENT Com_TxGrpSigInfo[18].TxBufferEndIdxOfTxGrpSigInfo "" UWORD Com_TxBufferEndIdxOfTxGrpSigInfoType 0 0 0 65535 ECU_ADDRESS 0x0 /end MEASUREMENT
/begin MEASUREMENT Com_TxGrpSigInfo[18].TxBufferStartIdxOfTxGrpSigInfo "" UWORD Com_TxBufferStartIdxOfTxGrpSigInfoType 0 0 0 65535 ECU_ADDRESS 0x0 /end MEASUREMENT
/begin MEASUREMENT Com_TxGrpSigInfo[18].TxPduInfoIdxOfTxGrpSigInfo "" UBYTE NO_COMPU_METHOD 0 0 0 255 ECU_ADDRESS 0x0 /end MEASUREMENT
/begin MEASUREMENT Com_TxGrpSigInfo[18].TxSigGrpInfoIdxOfTxGrpSigInfo "" UBYTE NO_COMPU_METHOD 0 0 0 255 ECU_ADDRESS 0x0 /end MEASUREMENT
/begin MEASUREMENT Com_TxGrpSigInfo[18].WithoutRepOfTxGrpSigInfo "" UBYTE Com_WithoutRepOfTxGrpSigInfoType 0 0 0 1 ECU_ADDRESS 0x0 /end MEASUREMENT
/begin MEASUREMENT Com_TxGrpSigInfo[19].ApplTypeOfTxGrpSigInfo "" UBYTE Com_ApplTypeOfTxGrpSigInfoType 0 0 0 255 ECU_ADDRESS 0x0 /end MEASUREMENT
/begin MEASUREMENT Com_TxGrpSigInfo[19].BitLengthOfTxGrpSigInfo "" UBYTE NO_COMPU_METHOD 0 0 0 255 ECU_ADDRESS 0x0 /end MEASUREMENT
/begin MEASUREMENT Com_TxGrpSigInfo[19].BitPositionOfTxGrpSigInfo "" UWORD NO_COMPU_METHOD 0 0 0 65535 ECU_ADDRESS 0x0 /end MEASUREMENT
/begin MEASUREMENT Com_TxGrpSigInfo[19].BusAccOfTxGrpSigInfo "" UBYTE Com_BusAccOfTxGrpSigInfoType 0 0 0 255 ECU_ADDRESS 0x0 /end MEASUREMENT
/begin MEASUREMENT Com_TxGrpSigInfo[19].ByteLengthOfTxGrpSigInfo "" UBYTE NO_COMPU_METHOD 0 0 0 255 ECU_ADDRESS 0x0 /end MEASUREMENT
/begin MEASUREMENT Com_TxGrpSigInfo[19].DynSignalOfTxGrpSigInfo "" UBYTE Com_DynSignalOfTxGrpSigInfoType 0 0 0 1 ECU_ADDRESS 0x0 /end MEASUREMENT
/begin MEASUREMENT Com_TxGrpSigInfo[19].InvValueIdxOfTxGrpSigInfo "" UBYTE Com_InvValueIdxOfTxGrpSigInfoType 0 0 0 255 ECU_ADDRESS 0x0 /end MEASUREMENT
/begin MEASUREMENT Com_TxGrpSigInfo[19].InvValueOfTxGrpSigInfo "" UBYTE Com_InvValueOfTxGrpSigInfoType 0 0 0 255 ECU_ADDRESS 0x0 /end MEASUREMENT
/begin MEASUREMENT Com_TxGrpSigInfo[19].StartByteInPduPositionOfTxGrpSigInfo "" UBYTE NO_COMPU_METHOD 0 0 0 255 ECU_ADDRESS 0x0 /end MEASUREMENT
/begin MEASUREMENT Com_TxGrpSigInfo[19].TxBufferEndIdxOfTxGrpSigInfo "" UWORD Com_TxBufferEndIdxOfTxGrpSigInfoType 0 0 0 65535 ECU_ADDRESS 0x0 /end MEASUREMENT
/begin MEASUREMENT Com_TxGrpSigInfo[19].TxBufferStartIdxOfTxGrpSigInfo "" UWORD Com_TxBufferStartIdxOfTxGrpSigInfoType 0 0 0 65535 ECU_ADDRESS 0x0 /end MEASUREMENT
/begin MEASUREMENT Com_TxGrpSigInfo[19].TxPduInfoIdxOfTxGrpSigInfo "" UBYTE NO_COMPU_METHOD 0 0 0 255 ECU_ADDRESS 0x0 /end MEASUREMENT
/begin MEASUREMENT Com_TxGrpSigInfo[19].TxSigGrpInfoIdxOfTxGrpSigInfo "" UBYTE NO_COMPU_METHOD 0 0 0 255 ECU_ADDRESS 0x0 /end MEASUREMENT
/begin MEASUREMENT Com_TxGrpSigInfo[19].WithoutRepOfTxGrpSigInfo "" UBYTE Com_WithoutRepOfTxGrpSigInfoType 0 0 0 1 ECU_ADDRESS 0x0 /end MEASUREMENT
/begin MEASUREMENT Com_TxGrpSigInfo[1].ApplTypeOfTxGrpSigInfo "" UBYTE Com_ApplTypeOfTxGrpSigInfoType 0 0 0 255 ECU_ADDRESS 0x0 /end MEASUREMENT
/begin MEASUREMENT Com_TxGrpSigInfo[1].BitLengthOfTxGrpSigInfo "" UBYTE NO_COMPU_METHOD 0 0 0 255 ECU_ADDRESS 0x0 /end MEASUREMENT
/begin MEASUREMENT Com_TxGrpSigInfo[1].BitPositionOfTxGrpSigInfo "" UWORD NO_COMPU_METHOD 0 0 0 65535 ECU_ADDRESS 0x0 /end MEASUREMENT
/begin MEASUREMENT Com_TxGrpSigInfo[1].BusAccOfTxGrpSigInfo "" UBYTE Com_BusAccOfTxGrpSigInfoType 0 0 0 255 ECU_ADDRESS 0x0 /end MEASUREMENT
/begin MEASUREMENT Com_TxGrpSigInfo[1].ByteLengthOfTxGrpSigInfo "" UBYTE NO_COMPU_METHOD 0 0 0 255 ECU_ADDRESS 0x0 /end MEASUREMENT
/begin MEASUREMENT Com_TxGrpSigInfo[1].DynSignalOfTxGrpSigInfo "" UBYTE Com_DynSignalOfTxGrpSigInfoType 0 0 0 1 ECU_ADDRESS 0x0 /end MEASUREMENT
/begin MEASUREMENT Com_TxGrpSigInfo[1].InvValueIdxOfTxGrpSigInfo "" UBYTE Com_InvValueIdxOfTxGrpSigInfoType 0 0 0 255 ECU_ADDRESS 0x0 /end MEASUREMENT
/begin MEASUREMENT Com_TxGrpSigInfo[1].InvValueOfTxGrpSigInfo "" UBYTE Com_InvValueOfTxGrpSigInfoType 0 0 0 255 ECU_ADDRESS 0x0 /end MEASUREMENT
/begin MEASUREMENT Com_TxGrpSigInfo[1].StartByteInPduPositionOfTxGrpSigInfo "" UBYTE NO_COMPU_METHOD 0 0 0 255 ECU_ADDRESS 0x0 /end MEASUREMENT
/begin MEASUREMENT Com_TxGrpSigInfo[1].TxBufferEndIdxOfTxGrpSigInfo "" UWORD Com_TxBufferEndIdxOfTxGrpSigInfoType 0 0 0 65535 ECU_ADDRESS 0x0 /end MEASUREMENT
/begin MEASUREMENT Com_TxGrpSigInfo[1].TxBufferStartIdxOfTxGrpSigInfo "" UWORD Com_TxBufferStartIdxOfTxGrpSigInfoType 0 0 0 65535 ECU_ADDRESS 0x0 /end MEASUREMENT
/begin MEASUREMENT Com_TxGrpSigInfo[1].TxPduInfoIdxOfTxGrpSigInfo "" UBYTE NO_COMPU_METHOD 0 0 0 255 ECU_ADDRESS 0x0 /end MEASUREMENT
/begin MEASUREMENT Com_TxGrpSigInfo[1].TxSigGrpInfoIdxOfTxGrpSigInfo "" UBYTE NO_COMPU_METHOD 0 0 0 255 ECU_ADDRESS 0x0 /end MEASUREMENT
/begin MEASUREMENT Com_TxGrpSigInfo[1].WithoutRepOfTxGrpSigInfo "" UBYTE Com_WithoutRepOfTxGrpSigInfoType 0 0 0 1 ECU_ADDRESS 0x0 /end MEASUREMENT
/begin MEASUREMENT Com_TxGrpSigInfo[20].ApplTypeOfTxGrpSigInfo "" UBYTE Com_ApplTypeOfTxGrpSigInfoType 0 0 0 255 ECU_ADDRESS 0x0 /end MEASUREMENT
/begin MEASUREMENT Com_TxGrpSigInfo[20].BitLengthOfTxGrpSigInfo "" UBYTE NO_COMPU_METHOD 0 0 0 255 ECU_ADDRESS 0x0 /end MEASUREMENT
/begin MEASUREMENT Com_TxGrpSigInfo[20].BitPositionOfTxGrpSigInfo "" UWORD NO_COMPU_METHOD 0 0 0 65535 ECU_ADDRESS 0x0 /end MEASUREMENT
/begin MEASUREMENT Com_TxGrpSigInfo[20].BusAccOfTxGrpSigInfo "" UBYTE Com_BusAccOfTxGrpSigInfoType 0 0 0 255 ECU_ADDRESS 0x0 /end MEASUREMENT
/begin MEASUREMENT Com_TxGrpSigInfo[20].ByteLengthOfTxGrpSigInfo "" UBYTE NO_COMPU_METHOD 0 0 0 255 ECU_ADDRESS 0x0 /end MEASUREMENT
/begin MEASUREMENT Com_TxGrpSigInfo[20].DynSignalOfTxGrpSigInfo "" UBYTE Com_DynSignalOfTxGrpSigInfoType 0 0 0 1 ECU_ADDRESS 0x0 /end MEASUREMENT
/begin MEASUREMENT Com_TxGrpSigInfo[20].InvValueIdxOfTxGrpSigInfo "" UBYTE Com_InvValueIdxOfTxGrpSigInfoType 0 0 0 255 ECU_ADDRESS 0x0 /end MEASUREMENT
/begin MEASUREMENT Com_TxGrpSigInfo[20].InvValueOfTxGrpSigInfo "" UBYTE Com_InvValueOfTxGrpSigInfoType 0 0 0 255 ECU_ADDRESS 0x0 /end MEASUREMENT
/begin MEASUREMENT Com_TxGrpSigInfo[20].StartByteInPduPositionOfTxGrpSigInfo "" UBYTE NO_COMPU_METHOD 0 0 0 255 ECU_ADDRESS 0x0 /end MEASUREMENT
/begin MEASUREMENT Com_TxGrpSigInfo[20].TxBufferEndIdxOfTxGrpSigInfo "" UWORD Com_TxBufferEndIdxOfTxGrpSigInfoType 0 0 0 65535 ECU_ADDRESS 0x0 /end MEASUREMENT
/begin MEASUREMENT Com_TxGrpSigInfo[20].TxBufferStartIdxOfTxGrpSigInfo "" UWORD Com_TxBufferStartIdxOfTxGrpSigInfoType 0 0 0 65535 ECU_ADDRESS 0x0 /end MEASUREMENT
/begin MEASUREMENT Com_TxGrpSigInfo[20].TxPduInfoIdxOfTxGrpSigInfo "" UBYTE NO_COMPU_METHOD 0 0 0 255 ECU_ADDRESS 0x0 /end MEASUREMENT
/begin MEASUREMENT Com_TxGrpSigInfo[20].TxSigGrpInfoIdxOfTxGrpSigInfo "" UBYTE NO_COMPU_METHOD 0 0 0 255 ECU_ADDRESS 0x0 /end MEASUREMENT
/begin MEASUREMENT Com_TxGrpSigInfo[20].WithoutRepOfTxGrpSigInfo "" UBYTE Com_WithoutRepOfTxGrpSigInfoType 0 0 0 1 ECU_ADDRESS 0x0 /end MEASUREMENT
/begin MEASUREMENT Com_TxGrpSigInfo[21].ApplTypeOfTxGrpSigInfo "" UBYTE Com_ApplTypeOfTxGrpSigInfoType 0 0 0 255 ECU_ADDRESS 0x0 /end MEASUREMENT
/begin MEASUREMENT Com_TxGrpSigInfo[21].BitLengthOfTxGrpSigInfo "" UBYTE NO_COMPU_METHOD 0 0 0 255 ECU_ADDRESS 0x0 /end MEASUREMENT
/begin MEASUREMENT Com_TxGrpSigInfo[21].BitPositionOfTxGrpSigInfo "" UWORD NO_COMPU_METHOD 0 0 0 65535 ECU_ADDRESS 0x0 /end MEASUREMENT
/begin MEASUREMENT Com_TxGrpSigInfo[21].BusAccOfTxGrpSigInfo "" UBYTE Com_BusAccOfTxGrpSigInfoType 0 0 0 255 ECU_ADDRESS 0x0 /end MEASUREMENT
/begin MEASUREMENT Com_TxGrpSigInfo[21].ByteLengthOfTxGrpSigInfo "" UBYTE NO_COMPU_METHOD 0 0 0 255 ECU_ADDRESS 0x0 /end MEASUREMENT
/begin MEASUREMENT Com_TxGrpSigInfo[21].DynSignalOfTxGrpSigInfo "" UBYTE Com_DynSignalOfTxGrpSigInfoType 0 0 0 1 ECU_ADDRESS 0x0 /end MEASUREMENT
/begin MEASUREMENT Com_TxGrpSigInfo[21].InvValueIdxOfTxGrpSigInfo "" UBYTE Com_InvValueIdxOfTxGrpSigInfoType 0 0 0 255 ECU_ADDRESS 0x0 /end MEASUREMENT
/begin MEASUREMENT Com_TxGrpSigInfo[21].InvValueOfTxGrpSigInfo "" UBYTE Com_InvValueOfTxGrpSigInfoType 0 0 0 255 ECU_ADDRESS 0x0 /end MEASUREMENT
/begin MEASUREMENT Com_TxGrpSigInfo[21].StartByteInPduPositionOfTxGrpSigInfo "" UBYTE NO_COMPU_METHOD 0 0 0 255 ECU_ADDRESS 0x0 /end MEASUREMENT
/begin MEASUREMENT Com_TxGrpSigInfo[21].TxBufferEndIdxOfTxGrpSigInfo "" UWORD Com_TxBufferEndIdxOfTxGrpSigInfoType 0 0 0 65535 ECU_ADDRESS 0x0 /end MEASUREMENT
/begin MEASUREMENT Com_TxGrpSigInfo[21].TxBufferStartIdxOfTxGrpSigInfo "" UWORD Com_TxBufferStartIdxOfTxGrpSigInfoType 0 0 0 65535 ECU_ADDRESS 0x0 /end MEASUREMENT
/begin MEASUREMENT Com_TxGrpSigInfo[21].TxPduInfoIdxOfTxGrpSigInfo "" UBYTE NO_COMPU_METHOD 0 0 0 255 ECU_ADDRESS 0x0 /end MEASUREMENT
/begin MEASUREMENT Com_TxGrpSigInfo[21].TxSigGrpInfoIdxOfTxGrpSigInfo "" UBYTE NO_COMPU_METHOD 0 0 0 255 ECU_ADDRESS 0x0 /end MEASUREMENT
/begin MEASUREMENT Com_TxGrpSigInfo[21].WithoutRepOfTxGrpSigInfo "" UBYTE Com_WithoutRepOfTxGrpSigInfoType 0 0 0 1 ECU_ADDRESS 0x0 /end MEASUREMENT
/begin MEASUREMENT Com_TxGrpSigInfo[22].ApplTypeOfTxGrpSigInfo "" UBYTE Com_ApplTypeOfTxGrpSigInfoType 0 0 0 255 ECU_ADDRESS 0x0 /end MEASUREMENT
/begin MEASUREMENT Com_TxGrpSigInfo[22].BitLengthOfTxGrpSigInfo "" UBYTE NO_COMPU_METHOD 0 0 0 255 ECU_ADDRESS 0x0 /end MEASUREMENT
/begin MEASUREMENT Com_TxGrpSigInfo[22].BitPositionOfTxGrpSigInfo "" UWORD NO_COMPU_METHOD 0 0 0 65535 ECU_ADDRESS 0x0 /end MEASUREMENT
/begin MEASUREMENT Com_TxGrpSigInfo[22].BusAccOfTxGrpSigInfo "" UBYTE Com_BusAccOfTxGrpSigInfoType 0 0 0 255 ECU_ADDRESS 0x0 /end MEASUREMENT
/begin MEASUREMENT Com_TxGrpSigInfo[22].ByteLengthOfTxGrpSigInfo "" UBYTE NO_COMPU_METHOD 0 0 0 255 ECU_ADDRESS 0x0 /end MEASUREMENT
/begin MEASUREMENT Com_TxGrpSigInfo[22].DynSignalOfTxGrpSigInfo "" UBYTE Com_DynSignalOfTxGrpSigInfoType 0 0 0 1 ECU_ADDRESS 0x0 /end MEASUREMENT
/begin MEASUREMENT Com_TxGrpSigInfo[22].InvValueIdxOfTxGrpSigInfo "" UBYTE Com_InvValueIdxOfTxGrpSigInfoType 0 0 0 255 ECU_ADDRESS 0x0 /end MEASUREMENT
/begin MEASUREMENT Com_TxGrpSigInfo[22].InvValueOfTxGrpSigInfo "" UBYTE Com_InvValueOfTxGrpSigInfoType 0 0 0 255 ECU_ADDRESS 0x0 /end MEASUREMENT
/begin MEASUREMENT Com_TxGrpSigInfo[22].StartByteInPduPositionOfTxGrpSigInfo "" UBYTE NO_COMPU_METHOD 0 0 0 255 ECU_ADDRESS 0x0 /end MEASUREMENT
/begin MEASUREMENT Com_TxGrpSigInfo[22].TxBufferEndIdxOfTxGrpSigInfo "" UWORD Com_TxBufferEndIdxOfTxGrpSigInfoType 0 0 0 65535 ECU_ADDRESS 0x0 /end MEASUREMENT
/begin MEASUREMENT Com_TxGrpSigInfo[22].TxBufferStartIdxOfTxGrpSigInfo "" UWORD Com_TxBufferStartIdxOfTxGrpSigInfoType 0 0 0 65535 ECU_ADDRESS 0x0 /end MEASUREMENT
/begin MEASUREMENT Com_TxGrpSigInfo[22].TxPduInfoIdxOfTxGrpSigInfo "" UBYTE NO_COMPU_METHOD 0 0 0 255 ECU_ADDRESS 0x0 /end MEASUREMENT
/begin MEASUREMENT Com_TxGrpSigInfo[22].TxSigGrpInfoIdxOfTxGrpSigInfo "" UBYTE NO_COMPU_METHOD 0 0 0 255 ECU_ADDRESS 0x0 /end MEASUREMENT
/begin MEASUREMENT Com_TxGrpSigInfo[22].WithoutRepOfTxGrpSigInfo "" UBYTE Com_WithoutRepOfTxGrpSigInfoType 0 0 0 1 ECU_ADDRESS 0x0 /end MEASUREMENT
/begin MEASUREMENT Com_TxGrpSigInfo[23].ApplTypeOfTxGrpSigInfo "" UBYTE Com_ApplTypeOfTxGrpSigInfoType 0 0 0 255 ECU_ADDRESS 0x0 /end MEASUREMENT
/begin MEASUREMENT Com_TxGrpSigInfo[23].BitLengthOfTxGrpSigInfo "" UBYTE NO_COMPU_METHOD 0 0 0 255 ECU_ADDRESS 0x0 /end MEASUREMENT
/begin MEASUREMENT Com_TxGrpSigInfo[23].BitPositionOfTxGrpSigInfo "" UWORD NO_COMPU_METHOD 0 0 0 65535 ECU_ADDRESS 0x0 /end MEASUREMENT
/begin MEASUREMENT Com_TxGrpSigInfo[23].BusAccOfTxGrpSigInfo "" UBYTE Com_BusAccOfTxGrpSigInfoType 0 0 0 255 ECU_ADDRESS 0x0 /end MEASUREMENT
/begin MEASUREMENT Com_TxGrpSigInfo[23].ByteLengthOfTxGrpSigInfo "" UBYTE NO_COMPU_METHOD 0 0 0 255 ECU_ADDRESS 0x0 /end MEASUREMENT
/begin MEASUREMENT Com_TxGrpSigInfo[23].DynSignalOfTxGrpSigInfo "" UBYTE Com_DynSignalOfTxGrpSigInfoType 0 0 0 1 ECU_ADDRESS 0x0 /end MEASUREMENT
/begin MEASUREMENT Com_TxGrpSigInfo[23].InvValueIdxOfTxGrpSigInfo "" UBYTE Com_InvValueIdxOfTxGrpSigInfoType 0 0 0 255 ECU_ADDRESS 0x0 /end MEASUREMENT
/begin MEASUREMENT Com_TxGrpSigInfo[23].InvValueOfTxGrpSigInfo "" UBYTE Com_InvValueOfTxGrpSigInfoType 0 0 0 255 ECU_ADDRESS 0x0 /end MEASUREMENT
/begin MEASUREMENT Com_TxGrpSigInfo[23].StartByteInPduPositionOfTxGrpSigInfo "" UBYTE NO_COMPU_METHOD 0 0 0 255 ECU_ADDRESS 0x0 /end MEASUREMENT
/begin MEASUREMENT Com_TxGrpSigInfo[23].TxBufferEndIdxOfTxGrpSigInfo "" UWORD Com_TxBufferEndIdxOfTxGrpSigInfoType 0 0 0 65535 ECU_ADDRESS 0x0 /end MEASUREMENT
/begin MEASUREMENT Com_TxGrpSigInfo[23].TxBufferStartIdxOfTxGrpSigInfo "" UWORD Com_TxBufferStartIdxOfTxGrpSigInfoType 0 0 0 65535 ECU_ADDRESS 0x0 /end MEASUREMENT
/begin MEASUREMENT Com_TxGrpSigInfo[23].TxPduInfoIdxOfTxGrpSigInfo "" UBYTE NO_COMPU_METHOD 0 0 0 255 ECU_ADDRESS 0x0 /end MEASUREMENT
/begin MEASUREMENT Com_TxGrpSigInfo[23].TxSigGrpInfoIdxOfTxGrpSigInfo "" UBYTE NO_COMPU_METHOD 0 0 0 255 ECU_ADDRESS 0x0 /end MEASUREMENT
/begin MEASUREMENT Com_TxGrpSigInfo[23].WithoutRepOfTxGrpSigInfo "" UBYTE Com_WithoutRepOfTxGrpSigInfoType 0 0 0 1 ECU_ADDRESS 0x0 /end MEASUREMENT
/begin MEASUREMENT Com_TxGrpSigInfo[24].ApplTypeOfTxGrpSigInfo "" UBYTE Com_ApplTypeOfTxGrpSigInfoType 0 0 0 255 ECU_ADDRESS 0x0 /end MEASUREMENT
/begin MEASUREMENT Com_TxGrpSigInfo[24].BitLengthOfTxGrpSigInfo "" UBYTE NO_COMPU_METHOD 0 0 0 255 ECU_ADDRESS 0x0 /end MEASUREMENT
/begin MEASUREMENT Com_TxGrpSigInfo[24].BitPositionOfTxGrpSigInfo "" UWORD NO_COMPU_METHOD 0 0 0 65535 ECU_ADDRESS 0x0 /end MEASUREMENT
/begin MEASUREMENT Com_TxGrpSigInfo[24].BusAccOfTxGrpSigInfo "" UBYTE Com_BusAccOfTxGrpSigInfoType 0 0 0 255 ECU_ADDRESS 0x0 /end MEASUREMENT
/begin MEASUREMENT Com_TxGrpSigInfo[24].ByteLengthOfTxGrpSigInfo "" UBYTE NO_COMPU_METHOD 0 0 0 255 ECU_ADDRESS 0x0 /end MEASUREMENT
/begin MEASUREMENT Com_TxGrpSigInfo[24].DynSignalOfTxGrpSigInfo "" UBYTE Com_DynSignalOfTxGrpSigInfoType 0 0 0 1 ECU_ADDRESS 0x0 /end MEASUREMENT
/begin MEASUREMENT Com_TxGrpSigInfo[24].InvValueIdxOfTxGrpSigInfo "" UBYTE Com_InvValueIdxOfTxGrpSigInfoType 0 0 0 255 ECU_ADDRESS 0x0 /end MEASUREMENT
/begin MEASUREMENT Com_TxGrpSigInfo[24].InvValueOfTxGrpSigInfo "" UBYTE Com_InvValueOfTxGrpSigInfoType 0 0 0 255 ECU_ADDRESS 0x0 /end MEASUREMENT
/begin MEASUREMENT Com_TxGrpSigInfo[24].StartByteInPduPositionOfTxGrpSigInfo "" UBYTE NO_COMPU_METHOD 0 0 0 255 ECU_ADDRESS 0x0 /end MEASUREMENT
/begin MEASUREMENT Com_TxGrpSigInfo[24].TxBufferEndIdxOfTxGrpSigInfo "" UWORD Com_TxBufferEndIdxOfTxGrpSigInfoType 0 0 0 65535 ECU_ADDRESS 0x0 /end MEASUREMENT
/begin MEASUREMENT Com_TxGrpSigInfo[24].TxBufferStartIdxOfTxGrpSigInfo "" UWORD Com_TxBufferStartIdxOfTxGrpSigInfoType 0 0 0 65535 ECU_ADDRESS 0x0 /end MEASUREMENT
/begin MEASUREMENT Com_TxGrpSigInfo[24].TxPduInfoIdxOfTxGrpSigInfo "" UBYTE NO_COMPU_METHOD 0 0 0 255 ECU_ADDRESS 0x0 /end MEASUREMENT
/begin MEASUREMENT Com_TxGrpSigInfo[24].TxSigGrpInfoIdxOfTxGrpSigInfo "" UBYTE NO_COMPU_METHOD 0 0 0 255 ECU_ADDRESS 0x0 /end MEASUREMENT
/begin MEASUREMENT Com_TxGrpSigInfo[24].WithoutRepOfTxGrpSigInfo "" UBYTE Com_WithoutRepOfTxGrpSigInfoType 0 0 0 1 ECU_ADDRESS 0x0 /end MEASUREMENT
/begin MEASUREMENT Com_TxGrpSigInfo[25].ApplTypeOfTxGrpSigInfo "" UBYTE Com_ApplTypeOfTxGrpSigInfoType 0 0 0 255 ECU_ADDRESS 0x0 /end MEASUREMENT
/begin MEASUREMENT Com_TxGrpSigInfo[25].BitLengthOfTxGrpSigInfo "" UBYTE NO_COMPU_METHOD 0 0 0 255 ECU_ADDRESS 0x0 /end MEASUREMENT
/begin MEASUREMENT Com_TxGrpSigInfo[25].BitPositionOfTxGrpSigInfo "" UWORD NO_COMPU_METHOD 0 0 0 65535 ECU_ADDRESS 0x0 /end MEASUREMENT
/begin MEASUREMENT Com_TxGrpSigInfo[25].BusAccOfTxGrpSigInfo "" UBYTE Com_BusAccOfTxGrpSigInfoType 0 0 0 255 ECU_ADDRESS 0x0 /end MEASUREMENT
/begin MEASUREMENT Com_TxGrpSigInfo[25].ByteLengthOfTxGrpSigInfo "" UBYTE NO_COMPU_METHOD 0 0 0 255 ECU_ADDRESS 0x0 /end MEASUREMENT
/begin MEASUREMENT Com_TxGrpSigInfo[25].DynSignalOfTxGrpSigInfo "" UBYTE Com_DynSignalOfTxGrpSigInfoType 0 0 0 1 ECU_ADDRESS 0x0 /end MEASUREMENT
/begin MEASUREMENT Com_TxGrpSigInfo[25].InvValueIdxOfTxGrpSigInfo "" UBYTE Com_InvValueIdxOfTxGrpSigInfoType 0 0 0 255 ECU_ADDRESS 0x0 /end MEASUREMENT
/begin MEASUREMENT Com_TxGrpSigInfo[25].InvValueOfTxGrpSigInfo "" UBYTE Com_InvValueOfTxGrpSigInfoType 0 0 0 255 ECU_ADDRESS 0x0 /end MEASUREMENT
/begin MEASUREMENT Com_TxGrpSigInfo[25].StartByteInPduPositionOfTxGrpSigInfo "" UBYTE NO_COMPU_METHOD 0 0 0 255 ECU_ADDRESS 0x0 /end MEASUREMENT
/begin MEASUREMENT Com_TxGrpSigInfo[25].TxBufferEndIdxOfTxGrpSigInfo "" UWORD Com_TxBufferEndIdxOfTxGrpSigInfoType 0 0 0 65535 ECU_ADDRESS 0x0 /end MEASUREMENT
/begin MEASUREMENT Com_TxGrpSigInfo[25].TxBufferStartIdxOfTxGrpSigInfo "" UWORD Com_TxBufferStartIdxOfTxGrpSigInfoType 0 0 0 65535 ECU_ADDRESS 0x0 /end MEASUREMENT
/begin MEASUREMENT Com_TxGrpSigInfo[25].TxPduInfoIdxOfTxGrpSigInfo "" UBYTE NO_COMPU_METHOD 0 0 0 255 ECU_ADDRESS 0x0 /end MEASUREMENT
/begin MEASUREMENT Com_TxGrpSigInfo[25].TxSigGrpInfoIdxOfTxGrpSigInfo "" UBYTE NO_COMPU_METHOD 0 0 0 255 ECU_ADDRESS 0x0 /end MEASUREMENT
/begin MEASUREMENT Com_TxGrpSigInfo[25].WithoutRepOfTxGrpSigInfo "" UBYTE Com_WithoutRepOfTxGrpSigInfoType 0 0 0 1 ECU_ADDRESS 0x0 /end MEASUREMENT
/begin MEASUREMENT Com_TxGrpSigInfo[26].ApplTypeOfTxGrpSigInfo "" UBYTE Com_ApplTypeOfTxGrpSigInfoType 0 0 0 255 ECU_ADDRESS 0x0 /end MEASUREMENT
/begin MEASUREMENT Com_TxGrpSigInfo[26].BitLengthOfTxGrpSigInfo "" UBYTE NO_COMPU_METHOD 0 0 0 255 ECU_ADDRESS 0x0 /end MEASUREMENT
/begin MEASUREMENT Com_TxGrpSigInfo[26].BitPositionOfTxGrpSigInfo "" UWORD NO_COMPU_METHOD 0 0 0 65535 ECU_ADDRESS 0x0 /end MEASUREMENT
/begin MEASUREMENT Com_TxGrpSigInfo[26].BusAccOfTxGrpSigInfo "" UBYTE Com_BusAccOfTxGrpSigInfoType 0 0 0 255 ECU_ADDRESS 0x0 /end MEASUREMENT
/begin MEASUREMENT Com_TxGrpSigInfo[26].ByteLengthOfTxGrpSigInfo "" UBYTE NO_COMPU_METHOD 0 0 0 255 ECU_ADDRESS 0x0 /end MEASUREMENT
/begin MEASUREMENT Com_TxGrpSigInfo[26].DynSignalOfTxGrpSigInfo "" UBYTE Com_DynSignalOfTxGrpSigInfoType 0 0 0 1 ECU_ADDRESS 0x0 /end MEASUREMENT
/begin MEASUREMENT Com_TxGrpSigInfo[26].InvValueIdxOfTxGrpSigInfo "" UBYTE Com_InvValueIdxOfTxGrpSigInfoType 0 0 0 255 ECU_ADDRESS 0x0 /end MEASUREMENT
/begin MEASUREMENT Com_TxGrpSigInfo[26].InvValueOfTxGrpSigInfo "" UBYTE Com_InvValueOfTxGrpSigInfoType 0 0 0 255 ECU_ADDRESS 0x0 /end MEASUREMENT
/begin MEASUREMENT Com_TxGrpSigInfo[26].StartByteInPduPositionOfTxGrpSigInfo "" UBYTE NO_COMPU_METHOD 0 0 0 255 ECU_ADDRESS 0x0 /end MEASUREMENT
/begin MEASUREMENT Com_TxGrpSigInfo[26].TxBufferEndIdxOfTxGrpSigInfo "" UWORD Com_TxBufferEndIdxOfTxGrpSigInfoType 0 0 0 65535 ECU_ADDRESS 0x0 /end MEASUREMENT
/begin MEASUREMENT Com_TxGrpSigInfo[26].TxBufferStartIdxOfTxGrpSigInfo "" UWORD Com_TxBufferStartIdxOfTxGrpSigInfoType 0 0 0 65535 ECU_ADDRESS 0x0 /end MEASUREMENT
/begin MEASUREMENT Com_TxGrpSigInfo[26].TxPduInfoIdxOfTxGrpSigInfo "" UBYTE NO_COMPU_METHOD 0 0 0 255 ECU_ADDRESS 0x0 /end MEASUREMENT
/begin MEASUREMENT Com_TxGrpSigInfo[26].TxSigGrpInfoIdxOfTxGrpSigInfo "" UBYTE NO_COMPU_METHOD 0 0 0 255 ECU_ADDRESS 0x0 /end MEASUREMENT
/begin MEASUREMENT Com_TxGrpSigInfo[26].WithoutRepOfTxGrpSigInfo "" UBYTE Com_WithoutRepOfTxGrpSigInfoType 0 0 0 1 ECU_ADDRESS 0x0 /end MEASUREMENT
/begin MEASUREMENT Com_TxGrpSigInfo[27].ApplTypeOfTxGrpSigInfo "" UBYTE Com_ApplTypeOfTxGrpSigInfoType 0 0 0 255 ECU_ADDRESS 0x0 /end MEASUREMENT
/begin MEASUREMENT Com_TxGrpSigInfo[27].BitLengthOfTxGrpSigInfo "" UBYTE NO_COMPU_METHOD 0 0 0 255 ECU_ADDRESS 0x0 /end MEASUREMENT
/begin MEASUREMENT Com_TxGrpSigInfo[27].BitPositionOfTxGrpSigInfo "" UWORD NO_COMPU_METHOD 0 0 0 65535 ECU_ADDRESS 0x0 /end MEASUREMENT
/begin MEASUREMENT Com_TxGrpSigInfo[27].BusAccOfTxGrpSigInfo "" UBYTE Com_BusAccOfTxGrpSigInfoType 0 0 0 255 ECU_ADDRESS 0x0 /end MEASUREMENT
/begin MEASUREMENT Com_TxGrpSigInfo[27].ByteLengthOfTxGrpSigInfo "" UBYTE NO_COMPU_METHOD 0 0 0 255 ECU_ADDRESS 0x0 /end MEASUREMENT
/begin MEASUREMENT Com_TxGrpSigInfo[27].DynSignalOfTxGrpSigInfo "" UBYTE Com_DynSignalOfTxGrpSigInfoType 0 0 0 1 ECU_ADDRESS 0x0 /end MEASUREMENT
/begin MEASUREMENT Com_TxGrpSigInfo[27].InvValueIdxOfTxGrpSigInfo "" UBYTE Com_InvValueIdxOfTxGrpSigInfoType 0 0 0 255 ECU_ADDRESS 0x0 /end MEASUREMENT
/begin MEASUREMENT Com_TxGrpSigInfo[27].InvValueOfTxGrpSigInfo "" UBYTE Com_InvValueOfTxGrpSigInfoType 0 0 0 255 ECU_ADDRESS 0x0 /end MEASUREMENT
/begin MEASUREMENT Com_TxGrpSigInfo[27].StartByteInPduPositionOfTxGrpSigInfo "" UBYTE NO_COMPU_METHOD 0 0 0 255 ECU_ADDRESS 0x0 /end MEASUREMENT
/begin MEASUREMENT Com_TxGrpSigInfo[27].TxBufferEndIdxOfTxGrpSigInfo "" UWORD Com_TxBufferEndIdxOfTxGrpSigInfoType 0 0 0 65535 ECU_ADDRESS 0x0 /end MEASUREMENT
/begin MEASUREMENT Com_TxGrpSigInfo[27].TxBufferStartIdxOfTxGrpSigInfo "" UWORD Com_TxBufferStartIdxOfTxGrpSigInfoType 0 0 0 65535 ECU_ADDRESS 0x0 /end MEASUREMENT
/begin MEASUREMENT Com_TxGrpSigInfo[27].TxPduInfoIdxOfTxGrpSigInfo "" UBYTE NO_COMPU_METHOD 0 0 0 255 ECU_ADDRESS 0x0 /end MEASUREMENT
/begin MEASUREMENT Com_TxGrpSigInfo[27].TxSigGrpInfoIdxOfTxGrpSigInfo "" UBYTE NO_COMPU_METHOD 0 0 0 255 ECU_ADDRESS 0x0 /end MEASUREMENT
/begin MEASUREMENT Com_TxGrpSigInfo[27].WithoutRepOfTxGrpSigInfo "" UBYTE Com_WithoutRepOfTxGrpSigInfoType 0 0 0 1 ECU_ADDRESS 0x0 /end MEASUREMENT
/begin MEASUREMENT Com_TxGrpSigInfo[28].ApplTypeOfTxGrpSigInfo "" UBYTE Com_ApplTypeOfTxGrpSigInfoType 0 0 0 255 ECU_ADDRESS 0x0 /end MEASUREMENT
/begin MEASUREMENT Com_TxGrpSigInfo[28].BitLengthOfTxGrpSigInfo "" UBYTE NO_COMPU_METHOD 0 0 0 255 ECU_ADDRESS 0x0 /end MEASUREMENT
/begin MEASUREMENT Com_TxGrpSigInfo[28].BitPositionOfTxGrpSigInfo "" UWORD NO_COMPU_METHOD 0 0 0 65535 ECU_ADDRESS 0x0 /end MEASUREMENT
/begin MEASUREMENT Com_TxGrpSigInfo[28].BusAccOfTxGrpSigInfo "" UBYTE Com_BusAccOfTxGrpSigInfoType 0 0 0 255 ECU_ADDRESS 0x0 /end MEASUREMENT
/begin MEASUREMENT Com_TxGrpSigInfo[28].ByteLengthOfTxGrpSigInfo "" UBYTE NO_COMPU_METHOD 0 0 0 255 ECU_ADDRESS 0x0 /end MEASUREMENT
/begin MEASUREMENT Com_TxGrpSigInfo[28].DynSignalOfTxGrpSigInfo "" UBYTE Com_DynSignalOfTxGrpSigInfoType 0 0 0 1 ECU_ADDRESS 0x0 /end MEASUREMENT
/begin MEASUREMENT Com_TxGrpSigInfo[28].InvValueIdxOfTxGrpSigInfo "" UBYTE Com_InvValueIdxOfTxGrpSigInfoType 0 0 0 255 ECU_ADDRESS 0x0 /end MEASUREMENT
/begin MEASUREMENT Com_TxGrpSigInfo[28].InvValueOfTxGrpSigInfo "" UBYTE Com_InvValueOfTxGrpSigInfoType 0 0 0 255 ECU_ADDRESS 0x0 /end MEASUREMENT
/begin MEASUREMENT Com_TxGrpSigInfo[28].StartByteInPduPositionOfTxGrpSigInfo "" UBYTE NO_COMPU_METHOD 0 0 0 255 ECU_ADDRESS 0x0 /end MEASUREMENT
/begin MEASUREMENT Com_TxGrpSigInfo[28].TxBufferEndIdxOfTxGrpSigInfo "" UWORD Com_TxBufferEndIdxOfTxGrpSigInfoType 0 0 0 65535 ECU_ADDRESS 0x0 /end MEASUREMENT
/begin MEASUREMENT Com_TxGrpSigInfo[28].TxBufferStartIdxOfTxGrpSigInfo "" UWORD Com_TxBufferStartIdxOfTxGrpSigInfoType 0 0 0 65535 ECU_ADDRESS 0x0 /end MEASUREMENT
/begin MEASUREMENT Com_TxGrpSigInfo[28].TxPduInfoIdxOfTxGrpSigInfo "" UBYTE NO_COMPU_METHOD 0 0 0 255 ECU_ADDRESS 0x0 /end MEASUREMENT
/begin MEASUREMENT Com_TxGrpSigInfo[28].TxSigGrpInfoIdxOfTxGrpSigInfo "" UBYTE NO_COMPU_METHOD 0 0 0 255 ECU_ADDRESS 0x0 /end MEASUREMENT
/begin MEASUREMENT Com_TxGrpSigInfo[28].WithoutRepOfTxGrpSigInfo "" UBYTE Com_WithoutRepOfTxGrpSigInfoType 0 0 0 1 ECU_ADDRESS 0x0 /end MEASUREMENT
/begin MEASUREMENT Com_TxGrpSigInfo[29].ApplTypeOfTxGrpSigInfo "" UBYTE Com_ApplTypeOfTxGrpSigInfoType 0 0 0 255 ECU_ADDRESS 0x0 /end MEASUREMENT
/begin MEASUREMENT Com_TxGrpSigInfo[29].BitLengthOfTxGrpSigInfo "" UBYTE NO_COMPU_METHOD 0 0 0 255 ECU_ADDRESS 0x0 /end MEASUREMENT
/begin MEASUREMENT Com_TxGrpSigInfo[29].BitPositionOfTxGrpSigInfo "" UWORD NO_COMPU_METHOD 0 0 0 65535 ECU_ADDRESS 0x0 /end MEASUREMENT
/begin MEASUREMENT Com_TxGrpSigInfo[29].BusAccOfTxGrpSigInfo "" UBYTE Com_BusAccOfTxGrpSigInfoType 0 0 0 255 ECU_ADDRESS 0x0 /end MEASUREMENT
/begin MEASUREMENT Com_TxGrpSigInfo[29].ByteLengthOfTxGrpSigInfo "" UBYTE NO_COMPU_METHOD 0 0 0 255 ECU_ADDRESS 0x0 /end MEASUREMENT
/begin MEASUREMENT Com_TxGrpSigInfo[29].DynSignalOfTxGrpSigInfo "" UBYTE Com_DynSignalOfTxGrpSigInfoType 0 0 0 1 ECU_ADDRESS 0x0 /end MEASUREMENT
/begin MEASUREMENT Com_TxGrpSigInfo[29].InvValueIdxOfTxGrpSigInfo "" UBYTE Com_InvValueIdxOfTxGrpSigInfoType 0 0 0 255 ECU_ADDRESS 0x0 /end MEASUREMENT
/begin MEASUREMENT Com_TxGrpSigInfo[29].InvValueOfTxGrpSigInfo "" UBYTE Com_InvValueOfTxGrpSigInfoType 0 0 0 255 ECU_ADDRESS 0x0 /end MEASUREMENT
/begin MEASUREMENT Com_TxGrpSigInfo[29].StartByteInPduPositionOfTxGrpSigInfo "" UBYTE NO_COMPU_METHOD 0 0 0 255 ECU_ADDRESS 0x0 /end MEASUREMENT
/begin MEASUREMENT Com_TxGrpSigInfo[29].TxBufferEndIdxOfTxGrpSigInfo "" UWORD Com_TxBufferEndIdxOfTxGrpSigInfoType 0 0 0 65535 ECU_ADDRESS 0x0 /end MEASUREMENT
/begin MEASUREMENT Com_TxGrpSigInfo[29].TxBufferStartIdxOfTxGrpSigInfo "" UWORD Com_TxBufferStartIdxOfTxGrpSigInfoType 0 0 0 65535 ECU_ADDRESS 0x0 /end MEASUREMENT
/begin MEASUREMENT Com_TxGrpSigInfo[29].TxPduInfoIdxOfTxGrpSigInfo "" UBYTE NO_COMPU_METHOD 0 0 0 255 ECU_ADDRESS 0x0 /end MEASUREMENT
/begin MEASUREMENT Com_TxGrpSigInfo[29].TxSigGrpInfoIdxOfTxGrpSigInfo "" UBYTE NO_COMPU_METHOD 0 0 0 255 ECU_ADDRESS 0x0 /end MEASUREMENT
/begin MEASUREMENT Com_TxGrpSigInfo[29].WithoutRepOfTxGrpSigInfo "" UBYTE Com_WithoutRepOfTxGrpSigInfoType 0 0 0 1 ECU_ADDRESS 0x0 /end MEASUREMENT
/begin MEASUREMENT Com_TxGrpSigInfo[2].ApplTypeOfTxGrpSigInfo "" UBYTE Com_ApplTypeOfTxGrpSigInfoType 0 0 0 255 ECU_ADDRESS 0x0 /end MEASUREMENT
/begin MEASUREMENT Com_TxGrpSigInfo[2].BitLengthOfTxGrpSigInfo "" UBYTE NO_COMPU_METHOD 0 0 0 255 ECU_ADDRESS 0x0 /end MEASUREMENT
/begin MEASUREMENT Com_TxGrpSigInfo[2].BitPositionOfTxGrpSigInfo "" UWORD NO_COMPU_METHOD 0 0 0 65535 ECU_ADDRESS 0x0 /end MEASUREMENT
/begin MEASUREMENT Com_TxGrpSigInfo[2].BusAccOfTxGrpSigInfo "" UBYTE Com_BusAccOfTxGrpSigInfoType 0 0 0 255 ECU_ADDRESS 0x0 /end MEASUREMENT
/begin MEASUREMENT Com_TxGrpSigInfo[2].ByteLengthOfTxGrpSigInfo "" UBYTE NO_COMPU_METHOD 0 0 0 255 ECU_ADDRESS 0x0 /end MEASUREMENT
/begin MEASUREMENT Com_TxGrpSigInfo[2].DynSignalOfTxGrpSigInfo "" UBYTE Com_DynSignalOfTxGrpSigInfoType 0 0 0 1 ECU_ADDRESS 0x0 /end MEASUREMENT
/begin MEASUREMENT Com_TxGrpSigInfo[2].InvValueIdxOfTxGrpSigInfo "" UBYTE Com_InvValueIdxOfTxGrpSigInfoType 0 0 0 255 ECU_ADDRESS 0x0 /end MEASUREMENT
/begin MEASUREMENT Com_TxGrpSigInfo[2].InvValueOfTxGrpSigInfo "" UBYTE Com_InvValueOfTxGrpSigInfoType 0 0 0 255 ECU_ADDRESS 0x0 /end MEASUREMENT
/begin MEASUREMENT Com_TxGrpSigInfo[2].StartByteInPduPositionOfTxGrpSigInfo "" UBYTE NO_COMPU_METHOD 0 0 0 255 ECU_ADDRESS 0x0 /end MEASUREMENT
/begin MEASUREMENT Com_TxGrpSigInfo[2].TxBufferEndIdxOfTxGrpSigInfo "" UWORD Com_TxBufferEndIdxOfTxGrpSigInfoType 0 0 0 65535 ECU_ADDRESS 0x0 /end MEASUREMENT
/begin MEASUREMENT Com_TxGrpSigInfo[2].TxBufferStartIdxOfTxGrpSigInfo "" UWORD Com_TxBufferStartIdxOfTxGrpSigInfoType 0 0 0 65535 ECU_ADDRESS 0x0 /end MEASUREMENT
/begin MEASUREMENT Com_TxGrpSigInfo[2].TxPduInfoIdxOfTxGrpSigInfo "" UBYTE NO_COMPU_METHOD 0 0 0 255 ECU_ADDRESS 0x0 /end MEASUREMENT
/begin MEASUREMENT Com_TxGrpSigInfo[2].TxSigGrpInfoIdxOfTxGrpSigInfo "" UBYTE NO_COMPU_METHOD 0 0 0 255 ECU_ADDRESS 0x0 /end MEASUREMENT
/begin MEASUREMENT Com_TxGrpSigInfo[2].WithoutRepOfTxGrpSigInfo "" UBYTE Com_WithoutRepOfTxGrpSigInfoType 0 0 0 1 ECU_ADDRESS 0x0 /end MEASUREMENT
/begin MEASUREMENT Com_TxGrpSigInfo[30].ApplTypeOfTxGrpSigInfo "" UBYTE Com_ApplTypeOfTxGrpSigInfoType 0 0 0 255 ECU_ADDRESS 0x0 /end MEASUREMENT
/begin MEASUREMENT Com_TxGrpSigInfo[30].BitLengthOfTxGrpSigInfo "" UBYTE NO_COMPU_METHOD 0 0 0 255 ECU_ADDRESS 0x0 /end MEASUREMENT
/begin MEASUREMENT Com_TxGrpSigInfo[30].BitPositionOfTxGrpSigInfo "" UWORD NO_COMPU_METHOD 0 0 0 65535 ECU_ADDRESS 0x0 /end MEASUREMENT
/begin MEASUREMENT Com_TxGrpSigInfo[30].BusAccOfTxGrpSigInfo "" UBYTE Com_BusAccOfTxGrpSigInfoType 0 0 0 255 ECU_ADDRESS 0x0 /end MEASUREMENT
/begin MEASUREMENT Com_TxGrpSigInfo[30].ByteLengthOfTxGrpSigInfo "" UBYTE NO_COMPU_METHOD 0 0 0 255 ECU_ADDRESS 0x0 /end MEASUREMENT
/begin MEASUREMENT Com_TxGrpSigInfo[30].DynSignalOfTxGrpSigInfo "" UBYTE Com_DynSignalOfTxGrpSigInfoType 0 0 0 1 ECU_ADDRESS 0x0 /end MEASUREMENT
/begin MEASUREMENT Com_TxGrpSigInfo[30].InvValueIdxOfTxGrpSigInfo "" UBYTE Com_InvValueIdxOfTxGrpSigInfoType 0 0 0 255 ECU_ADDRESS 0x0 /end MEASUREMENT
/begin MEASUREMENT Com_TxGrpSigInfo[30].InvValueOfTxGrpSigInfo "" UBYTE Com_InvValueOfTxGrpSigInfoType 0 0 0 255 ECU_ADDRESS 0x0 /end MEASUREMENT
/begin MEASUREMENT Com_TxGrpSigInfo[30].StartByteInPduPositionOfTxGrpSigInfo "" UBYTE NO_COMPU_METHOD 0 0 0 255 ECU_ADDRESS 0x0 /end MEASUREMENT
/begin MEASUREMENT Com_TxGrpSigInfo[30].TxBufferEndIdxOfTxGrpSigInfo "" UWORD Com_TxBufferEndIdxOfTxGrpSigInfoType 0 0 0 65535 ECU_ADDRESS 0x0 /end MEASUREMENT
/begin MEASUREMENT Com_TxGrpSigInfo[30].TxBufferStartIdxOfTxGrpSigInfo "" UWORD Com_TxBufferStartIdxOfTxGrpSigInfoType 0 0 0 65535 ECU_ADDRESS 0x0 /end MEASUREMENT
/begin MEASUREMENT Com_TxGrpSigInfo[30].TxPduInfoIdxOfTxGrpSigInfo "" UBYTE NO_COMPU_METHOD 0 0 0 255 ECU_ADDRESS 0x0 /end MEASUREMENT
/begin MEASUREMENT Com_TxGrpSigInfo[30].TxSigGrpInfoIdxOfTxGrpSigInfo "" UBYTE NO_COMPU_METHOD 0 0 0 255 ECU_ADDRESS 0x0 /end MEASUREMENT
/begin MEASUREMENT Com_TxGrpSigInfo[30].WithoutRepOfTxGrpSigInfo "" UBYTE Com_WithoutRepOfTxGrpSigInfoType 0 0 0 1 ECU_ADDRESS 0x0 /end MEASUREMENT
/begin MEASUREMENT Com_TxGrpSigInfo[31].ApplTypeOfTxGrpSigInfo "" UBYTE Com_ApplTypeOfTxGrpSigInfoType 0 0 0 255 ECU_ADDRESS 0x0 /end MEASUREMENT
/begin MEASUREMENT Com_TxGrpSigInfo[31].BitLengthOfTxGrpSigInfo "" UBYTE NO_COMPU_METHOD 0 0 0 255 ECU_ADDRESS 0x0 /end MEASUREMENT
/begin MEASUREMENT Com_TxGrpSigInfo[31].BitPositionOfTxGrpSigInfo "" UWORD NO_COMPU_METHOD 0 0 0 65535 ECU_ADDRESS 0x0 /end MEASUREMENT
/begin MEASUREMENT Com_TxGrpSigInfo[31].BusAccOfTxGrpSigInfo "" UBYTE Com_BusAccOfTxGrpSigInfoType 0 0 0 255 ECU_ADDRESS 0x0 /end MEASUREMENT
/begin MEASUREMENT Com_TxGrpSigInfo[31].ByteLengthOfTxGrpSigInfo "" UBYTE NO_COMPU_METHOD 0 0 0 255 ECU_ADDRESS 0x0 /end MEASUREMENT
/begin MEASUREMENT Com_TxGrpSigInfo[31].DynSignalOfTxGrpSigInfo "" UBYTE Com_DynSignalOfTxGrpSigInfoType 0 0 0 1 ECU_ADDRESS 0x0 /end MEASUREMENT
/begin MEASUREMENT Com_TxGrpSigInfo[31].InvValueIdxOfTxGrpSigInfo "" UBYTE Com_InvValueIdxOfTxGrpSigInfoType 0 0 0 255 ECU_ADDRESS 0x0 /end MEASUREMENT
/begin MEASUREMENT Com_TxGrpSigInfo[31].InvValueOfTxGrpSigInfo "" UBYTE Com_InvValueOfTxGrpSigInfoType 0 0 0 255 ECU_ADDRESS 0x0 /end MEASUREMENT
/begin MEASUREMENT Com_TxGrpSigInfo[31].StartByteInPduPositionOfTxGrpSigInfo "" UBYTE NO_COMPU_METHOD 0 0 0 255 ECU_ADDRESS 0x0 /end MEASUREMENT
/begin MEASUREMENT Com_TxGrpSigInfo[31].TxBufferEndIdxOfTxGrpSigInfo "" UWORD Com_TxBufferEndIdxOfTxGrpSigInfoType 0 0 0 65535 ECU_ADDRESS 0x0 /end MEASUREMENT
/begin MEASUREMENT Com_TxGrpSigInfo[31].TxBufferStartIdxOfTxGrpSigInfo "" UWORD Com_TxBufferStartIdxOfTxGrpSigInfoType 0 0 0 65535 ECU_ADDRESS 0x0 /end MEASUREMENT
/begin MEASUREMENT Com_TxGrpSigInfo[31].TxPduInfoIdxOfTxGrpSigInfo "" UBYTE NO_COMPU_METHOD 0 0 0 255 ECU_ADDRESS 0x0 /end MEASUREMENT
/begin MEASUREMENT Com_TxGrpSigInfo[31].TxSigGrpInfoIdxOfTxGrpSigInfo "" UBYTE NO_COMPU_METHOD 0 0 0 255 ECU_ADDRESS 0x0 /end MEASUREMENT
/begin MEASUREMENT Com_TxGrpSigInfo[31].WithoutRepOfTxGrpSigInfo "" UBYTE Com_WithoutRepOfTxGrpSigInfoType 0 0 0 1 ECU_ADDRESS 0x0 /end MEASUREMENT
/begin MEASUREMENT Com_TxGrpSigInfo[32].ApplTypeOfTxGrpSigInfo "" UBYTE Com_ApplTypeOfTxGrpSigInfoType 0 0 0 255 ECU_ADDRESS 0x0 /end MEASUREMENT
/begin MEASUREMENT Com_TxGrpSigInfo[32].BitLengthOfTxGrpSigInfo "" UBYTE NO_COMPU_METHOD 0 0 0 255 ECU_ADDRESS 0x0 /end MEASUREMENT
/begin MEASUREMENT Com_TxGrpSigInfo[32].BitPositionOfTxGrpSigInfo "" UWORD NO_COMPU_METHOD 0 0 0 65535 ECU_ADDRESS 0x0 /end MEASUREMENT
/begin MEASUREMENT Com_TxGrpSigInfo[32].BusAccOfTxGrpSigInfo "" UBYTE Com_BusAccOfTxGrpSigInfoType 0 0 0 255 ECU_ADDRESS 0x0 /end MEASUREMENT
/begin MEASUREMENT Com_TxGrpSigInfo[32].ByteLengthOfTxGrpSigInfo "" UBYTE NO_COMPU_METHOD 0 0 0 255 ECU_ADDRESS 0x0 /end MEASUREMENT
/begin MEASUREMENT Com_TxGrpSigInfo[32].DynSignalOfTxGrpSigInfo "" UBYTE Com_DynSignalOfTxGrpSigInfoType 0 0 0 1 ECU_ADDRESS 0x0 /end MEASUREMENT
/begin MEASUREMENT Com_TxGrpSigInfo[32].InvValueIdxOfTxGrpSigInfo "" UBYTE Com_InvValueIdxOfTxGrpSigInfoType 0 0 0 255 ECU_ADDRESS 0x0 /end MEASUREMENT
/begin MEASUREMENT Com_TxGrpSigInfo[32].InvValueOfTxGrpSigInfo "" UBYTE Com_InvValueOfTxGrpSigInfoType 0 0 0 255 ECU_ADDRESS 0x0 /end MEASUREMENT
/begin MEASUREMENT Com_TxGrpSigInfo[32].StartByteInPduPositionOfTxGrpSigInfo "" UBYTE NO_COMPU_METHOD 0 0 0 255 ECU_ADDRESS 0x0 /end MEASUREMENT
/begin MEASUREMENT Com_TxGrpSigInfo[32].TxBufferEndIdxOfTxGrpSigInfo "" UWORD Com_TxBufferEndIdxOfTxGrpSigInfoType 0 0 0 65535 ECU_ADDRESS 0x0 /end MEASUREMENT
/begin MEASUREMENT Com_TxGrpSigInfo[32].TxBufferStartIdxOfTxGrpSigInfo "" UWORD Com_TxBufferStartIdxOfTxGrpSigInfoType 0 0 0 65535 ECU_ADDRESS 0x0 /end MEASUREMENT
/begin MEASUREMENT Com_TxGrpSigInfo[32].TxPduInfoIdxOfTxGrpSigInfo "" UBYTE NO_COMPU_METHOD 0 0 0 255 ECU_ADDRESS 0x0 /end MEASUREMENT
/begin MEASUREMENT Com_TxGrpSigInfo[32].TxSigGrpInfoIdxOfTxGrpSigInfo "" UBYTE NO_COMPU_METHOD 0 0 0 255 ECU_ADDRESS 0x0 /end MEASUREMENT
/begin MEASUREMENT Com_TxGrpSigInfo[32].WithoutRepOfTxGrpSigInfo "" UBYTE Com_WithoutRepOfTxGrpSigInfoType 0 0 0 1 ECU_ADDRESS 0x0 /end MEASUREMENT
/begin MEASUREMENT Com_TxGrpSigInfo[33].ApplTypeOfTxGrpSigInfo "" UBYTE Com_ApplTypeOfTxGrpSigInfoType 0 0 0 255 ECU_ADDRESS 0x0 /end MEASUREMENT
/begin MEASUREMENT Com_TxGrpSigInfo[33].BitLengthOfTxGrpSigInfo "" UBYTE NO_COMPU_METHOD 0 0 0 255 ECU_ADDRESS 0x0 /end MEASUREMENT
/begin MEASUREMENT Com_TxGrpSigInfo[33].BitPositionOfTxGrpSigInfo "" UWORD NO_COMPU_METHOD 0 0 0 65535 ECU_ADDRESS 0x0 /end MEASUREMENT
/begin MEASUREMENT Com_TxGrpSigInfo[33].BusAccOfTxGrpSigInfo "" UBYTE Com_BusAccOfTxGrpSigInfoType 0 0 0 255 ECU_ADDRESS 0x0 /end MEASUREMENT
/begin MEASUREMENT Com_TxGrpSigInfo[33].ByteLengthOfTxGrpSigInfo "" UBYTE NO_COMPU_METHOD 0 0 0 255 ECU_ADDRESS 0x0 /end MEASUREMENT
/begin MEASUREMENT Com_TxGrpSigInfo[33].DynSignalOfTxGrpSigInfo "" UBYTE Com_DynSignalOfTxGrpSigInfoType 0 0 0 1 ECU_ADDRESS 0x0 /end MEASUREMENT
/begin MEASUREMENT Com_TxGrpSigInfo[33].InvValueIdxOfTxGrpSigInfo "" UBYTE Com_InvValueIdxOfTxGrpSigInfoType 0 0 0 255 ECU_ADDRESS 0x0 /end MEASUREMENT
/begin MEASUREMENT Com_TxGrpSigInfo[33].InvValueOfTxGrpSigInfo "" UBYTE Com_InvValueOfTxGrpSigInfoType 0 0 0 255 ECU_ADDRESS 0x0 /end MEASUREMENT
/begin MEASUREMENT Com_TxGrpSigInfo[33].StartByteInPduPositionOfTxGrpSigInfo "" UBYTE NO_COMPU_METHOD 0 0 0 255 ECU_ADDRESS 0x0 /end MEASUREMENT
/begin MEASUREMENT Com_TxGrpSigInfo[33].TxBufferEndIdxOfTxGrpSigInfo "" UWORD Com_TxBufferEndIdxOfTxGrpSigInfoType 0 0 0 65535 ECU_ADDRESS 0x0 /end MEASUREMENT
/begin MEASUREMENT Com_TxGrpSigInfo[33].TxBufferStartIdxOfTxGrpSigInfo "" UWORD Com_TxBufferStartIdxOfTxGrpSigInfoType 0 0 0 65535 ECU_ADDRESS 0x0 /end MEASUREMENT
/begin MEASUREMENT Com_TxGrpSigInfo[33].TxPduInfoIdxOfTxGrpSigInfo "" UBYTE NO_COMPU_METHOD 0 0 0 255 ECU_ADDRESS 0x0 /end MEASUREMENT
/begin MEASUREMENT Com_TxGrpSigInfo[33].TxSigGrpInfoIdxOfTxGrpSigInfo "" UBYTE NO_COMPU_METHOD 0 0 0 255 ECU_ADDRESS 0x0 /end MEASUREMENT
/begin MEASUREMENT Com_TxGrpSigInfo[33].WithoutRepOfTxGrpSigInfo "" UBYTE Com_WithoutRepOfTxGrpSigInfoType 0 0 0 1 ECU_ADDRESS 0x0 /end MEASUREMENT
/begin MEASUREMENT Com_TxGrpSigInfo[34].ApplTypeOfTxGrpSigInfo "" UBYTE Com_ApplTypeOfTxGrpSigInfoType 0 0 0 255 ECU_ADDRESS 0x0 /end MEASUREMENT
/begin MEASUREMENT Com_TxGrpSigInfo[34].BitLengthOfTxGrpSigInfo "" UBYTE NO_COMPU_METHOD 0 0 0 255 ECU_ADDRESS 0x0 /end MEASUREMENT
/begin MEASUREMENT Com_TxGrpSigInfo[34].BitPositionOfTxGrpSigInfo "" UWORD NO_COMPU_METHOD 0 0 0 65535 ECU_ADDRESS 0x0 /end MEASUREMENT
/begin MEASUREMENT Com_TxGrpSigInfo[34].BusAccOfTxGrpSigInfo "" UBYTE Com_BusAccOfTxGrpSigInfoType 0 0 0 255 ECU_ADDRESS 0x0 /end MEASUREMENT
/begin MEASUREMENT Com_TxGrpSigInfo[34].ByteLengthOfTxGrpSigInfo "" UBYTE NO_COMPU_METHOD 0 0 0 255 ECU_ADDRESS 0x0 /end MEASUREMENT
/begin MEASUREMENT Com_TxGrpSigInfo[34].DynSignalOfTxGrpSigInfo "" UBYTE Com_DynSignalOfTxGrpSigInfoType 0 0 0 1 ECU_ADDRESS 0x0 /end MEASUREMENT
/begin MEASUREMENT Com_TxGrpSigInfo[34].InvValueIdxOfTxGrpSigInfo "" UBYTE Com_InvValueIdxOfTxGrpSigInfoType 0 0 0 255 ECU_ADDRESS 0x0 /end MEASUREMENT
/begin MEASUREMENT Com_TxGrpSigInfo[34].InvValueOfTxGrpSigInfo "" UBYTE Com_InvValueOfTxGrpSigInfoType 0 0 0 255 ECU_ADDRESS 0x0 /end MEASUREMENT
/begin MEASUREMENT Com_TxGrpSigInfo[34].StartByteInPduPositionOfTxGrpSigInfo "" UBYTE NO_COMPU_METHOD 0 0 0 255 ECU_ADDRESS 0x0 /end MEASUREMENT
/begin MEASUREMENT Com_TxGrpSigInfo[34].TxBufferEndIdxOfTxGrpSigInfo "" UWORD Com_TxBufferEndIdxOfTxGrpSigInfoType 0 0 0 65535 ECU_ADDRESS 0x0 /end MEASUREMENT
/begin MEASUREMENT Com_TxGrpSigInfo[34].TxBufferStartIdxOfTxGrpSigInfo "" UWORD Com_TxBufferStartIdxOfTxGrpSigInfoType 0 0 0 65535 ECU_ADDRESS 0x0 /end MEASUREMENT
/begin MEASUREMENT Com_TxGrpSigInfo[34].TxPduInfoIdxOfTxGrpSigInfo "" UBYTE NO_COMPU_METHOD 0 0 0 255 ECU_ADDRESS 0x0 /end MEASUREMENT
/begin MEASUREMENT Com_TxGrpSigInfo[34].TxSigGrpInfoIdxOfTxGrpSigInfo "" UBYTE NO_COMPU_METHOD 0 0 0 255 ECU_ADDRESS 0x0 /end MEASUREMENT
/begin MEASUREMENT Com_TxGrpSigInfo[34].WithoutRepOfTxGrpSigInfo "" UBYTE Com_WithoutRepOfTxGrpSigInfoType 0 0 0 1 ECU_ADDRESS 0x0 /end MEASUREMENT
/begin MEASUREMENT Com_TxGrpSigInfo[35].ApplTypeOfTxGrpSigInfo "" UBYTE Com_ApplTypeOfTxGrpSigInfoType 0 0 0 255 ECU_ADDRESS 0x0 /end MEASUREMENT
/begin MEASUREMENT Com_TxGrpSigInfo[35].BitLengthOfTxGrpSigInfo "" UBYTE NO_COMPU_METHOD 0 0 0 255 ECU_ADDRESS 0x0 /end MEASUREMENT
/begin MEASUREMENT Com_TxGrpSigInfo[35].BitPositionOfTxGrpSigInfo "" UWORD NO_COMPU_METHOD 0 0 0 65535 ECU_ADDRESS 0x0 /end MEASUREMENT
/begin MEASUREMENT Com_TxGrpSigInfo[35].BusAccOfTxGrpSigInfo "" UBYTE Com_BusAccOfTxGrpSigInfoType 0 0 0 255 ECU_ADDRESS 0x0 /end MEASUREMENT
/begin MEASUREMENT Com_TxGrpSigInfo[35].ByteLengthOfTxGrpSigInfo "" UBYTE NO_COMPU_METHOD 0 0 0 255 ECU_ADDRESS 0x0 /end MEASUREMENT
/begin MEASUREMENT Com_TxGrpSigInfo[35].DynSignalOfTxGrpSigInfo "" UBYTE Com_DynSignalOfTxGrpSigInfoType 0 0 0 1 ECU_ADDRESS 0x0 /end MEASUREMENT
/begin MEASUREMENT Com_TxGrpSigInfo[35].InvValueIdxOfTxGrpSigInfo "" UBYTE Com_InvValueIdxOfTxGrpSigInfoType 0 0 0 255 ECU_ADDRESS 0x0 /end MEASUREMENT
/begin MEASUREMENT Com_TxGrpSigInfo[35].InvValueOfTxGrpSigInfo "" UBYTE Com_InvValueOfTxGrpSigInfoType 0 0 0 255 ECU_ADDRESS 0x0 /end MEASUREMENT
/begin MEASUREMENT Com_TxGrpSigInfo[35].StartByteInPduPositionOfTxGrpSigInfo "" UBYTE NO_COMPU_METHOD 0 0 0 255 ECU_ADDRESS 0x0 /end MEASUREMENT
/begin MEASUREMENT Com_TxGrpSigInfo[35].TxBufferEndIdxOfTxGrpSigInfo "" UWORD Com_TxBufferEndIdxOfTxGrpSigInfoType 0 0 0 65535 ECU_ADDRESS 0x0 /end MEASUREMENT
/begin MEASUREMENT Com_TxGrpSigInfo[35].TxBufferStartIdxOfTxGrpSigInfo "" UWORD Com_TxBufferStartIdxOfTxGrpSigInfoType 0 0 0 65535 ECU_ADDRESS 0x0 /end MEASUREMENT
/begin MEASUREMENT Com_TxGrpSigInfo[35].TxPduInfoIdxOfTxGrpSigInfo "" UBYTE NO_COMPU_METHOD 0 0 0 255 ECU_ADDRESS 0x0 /end MEASUREMENT
/begin MEASUREMENT Com_TxGrpSigInfo[35].TxSigGrpInfoIdxOfTxGrpSigInfo "" UBYTE NO_COMPU_METHOD 0 0 0 255 ECU_ADDRESS 0x0 /end MEASUREMENT
/begin MEASUREMENT Com_TxGrpSigInfo[35].WithoutRepOfTxGrpSigInfo "" UBYTE Com_WithoutRepOfTxGrpSigInfoType 0 0 0 1 ECU_ADDRESS 0x0 /end MEASUREMENT
/begin MEASUREMENT Com_TxGrpSigInfo[36].ApplTypeOfTxGrpSigInfo "" UBYTE Com_ApplTypeOfTxGrpSigInfoType 0 0 0 255 ECU_ADDRESS 0x0 /end MEASUREMENT
/begin MEASUREMENT Com_TxGrpSigInfo[36].BitLengthOfTxGrpSigInfo "" UBYTE NO_COMPU_METHOD 0 0 0 255 ECU_ADDRESS 0x0 /end MEASUREMENT
/begin MEASUREMENT Com_TxGrpSigInfo[36].BitPositionOfTxGrpSigInfo "" UWORD NO_COMPU_METHOD 0 0 0 65535 ECU_ADDRESS 0x0 /end MEASUREMENT
/begin MEASUREMENT Com_TxGrpSigInfo[36].BusAccOfTxGrpSigInfo "" UBYTE Com_BusAccOfTxGrpSigInfoType 0 0 0 255 ECU_ADDRESS 0x0 /end MEASUREMENT
/begin MEASUREMENT Com_TxGrpSigInfo[36].ByteLengthOfTxGrpSigInfo "" UBYTE NO_COMPU_METHOD 0 0 0 255 ECU_ADDRESS 0x0 /end MEASUREMENT
/begin MEASUREMENT Com_TxGrpSigInfo[36].DynSignalOfTxGrpSigInfo "" UBYTE Com_DynSignalOfTxGrpSigInfoType 0 0 0 1 ECU_ADDRESS 0x0 /end MEASUREMENT
/begin MEASUREMENT Com_TxGrpSigInfo[36].InvValueIdxOfTxGrpSigInfo "" UBYTE Com_InvValueIdxOfTxGrpSigInfoType 0 0 0 255 ECU_ADDRESS 0x0 /end MEASUREMENT
/begin MEASUREMENT Com_TxGrpSigInfo[36].InvValueOfTxGrpSigInfo "" UBYTE Com_InvValueOfTxGrpSigInfoType 0 0 0 255 ECU_ADDRESS 0x0 /end MEASUREMENT
/begin MEASUREMENT Com_TxGrpSigInfo[36].StartByteInPduPositionOfTxGrpSigInfo "" UBYTE NO_COMPU_METHOD 0 0 0 255 ECU_ADDRESS 0x0 /end MEASUREMENT
/begin MEASUREMENT Com_TxGrpSigInfo[36].TxBufferEndIdxOfTxGrpSigInfo "" UWORD Com_TxBufferEndIdxOfTxGrpSigInfoType 0 0 0 65535 ECU_ADDRESS 0x0 /end MEASUREMENT
/begin MEASUREMENT Com_TxGrpSigInfo[36].TxBufferStartIdxOfTxGrpSigInfo "" UWORD Com_TxBufferStartIdxOfTxGrpSigInfoType 0 0 0 65535 ECU_ADDRESS 0x0 /end MEASUREMENT
/begin MEASUREMENT Com_TxGrpSigInfo[36].TxPduInfoIdxOfTxGrpSigInfo "" UBYTE NO_COMPU_METHOD 0 0 0 255 ECU_ADDRESS 0x0 /end MEASUREMENT
/begin MEASUREMENT Com_TxGrpSigInfo[36].TxSigGrpInfoIdxOfTxGrpSigInfo "" UBYTE NO_COMPU_METHOD 0 0 0 255 ECU_ADDRESS 0x0 /end MEASUREMENT
/begin MEASUREMENT Com_TxGrpSigInfo[36].WithoutRepOfTxGrpSigInfo "" UBYTE Com_WithoutRepOfTxGrpSigInfoType 0 0 0 1 ECU_ADDRESS 0x0 /end MEASUREMENT
/begin MEASUREMENT Com_TxGrpSigInfo[37].ApplTypeOfTxGrpSigInfo "" UBYTE Com_ApplTypeOfTxGrpSigInfoType 0 0 0 255 ECU_ADDRESS 0x0 /end MEASUREMENT
/begin MEASUREMENT Com_TxGrpSigInfo[37].BitLengthOfTxGrpSigInfo "" UBYTE NO_COMPU_METHOD 0 0 0 255 ECU_ADDRESS 0x0 /end MEASUREMENT
/begin MEASUREMENT Com_TxGrpSigInfo[37].BitPositionOfTxGrpSigInfo "" UWORD NO_COMPU_METHOD 0 0 0 65535 ECU_ADDRESS 0x0 /end MEASUREMENT
/begin MEASUREMENT Com_TxGrpSigInfo[37].BusAccOfTxGrpSigInfo "" UBYTE Com_BusAccOfTxGrpSigInfoType 0 0 0 255 ECU_ADDRESS 0x0 /end MEASUREMENT
/begin MEASUREMENT Com_TxGrpSigInfo[37].ByteLengthOfTxGrpSigInfo "" UBYTE NO_COMPU_METHOD 0 0 0 255 ECU_ADDRESS 0x0 /end MEASUREMENT
/begin MEASUREMENT Com_TxGrpSigInfo[37].DynSignalOfTxGrpSigInfo "" UBYTE Com_DynSignalOfTxGrpSigInfoType 0 0 0 1 ECU_ADDRESS 0x0 /end MEASUREMENT
/begin MEASUREMENT Com_TxGrpSigInfo[37].InvValueIdxOfTxGrpSigInfo "" UBYTE Com_InvValueIdxOfTxGrpSigInfoType 0 0 0 255 ECU_ADDRESS 0x0 /end MEASUREMENT
/begin MEASUREMENT Com_TxGrpSigInfo[37].InvValueOfTxGrpSigInfo "" UBYTE Com_InvValueOfTxGrpSigInfoType 0 0 0 255 ECU_ADDRESS 0x0 /end MEASUREMENT
/begin MEASUREMENT Com_TxGrpSigInfo[37].StartByteInPduPositionOfTxGrpSigInfo "" UBYTE NO_COMPU_METHOD 0 0 0 255 ECU_ADDRESS 0x0 /end MEASUREMENT
/begin MEASUREMENT Com_TxGrpSigInfo[37].TxBufferEndIdxOfTxGrpSigInfo "" UWORD Com_TxBufferEndIdxOfTxGrpSigInfoType 0 0 0 65535 ECU_ADDRESS 0x0 /end MEASUREMENT
/begin MEASUREMENT Com_TxGrpSigInfo[37].TxBufferStartIdxOfTxGrpSigInfo "" UWORD Com_TxBufferStartIdxOfTxGrpSigInfoType 0 0 0 65535 ECU_ADDRESS 0x0 /end MEASUREMENT
/begin MEASUREMENT Com_TxGrpSigInfo[37].TxPduInfoIdxOfTxGrpSigInfo "" UBYTE NO_COMPU_METHOD 0 0 0 255 ECU_ADDRESS 0x0 /end MEASUREMENT
/begin MEASUREMENT Com_TxGrpSigInfo[37].TxSigGrpInfoIdxOfTxGrpSigInfo "" UBYTE NO_COMPU_METHOD 0 0 0 255 ECU_ADDRESS 0x0 /end MEASUREMENT
/begin MEASUREMENT Com_TxGrpSigInfo[37].WithoutRepOfTxGrpSigInfo "" UBYTE Com_WithoutRepOfTxGrpSigInfoType 0 0 0 1 ECU_ADDRESS 0x0 /end MEASUREMENT
/begin MEASUREMENT Com_TxGrpSigInfo[38].ApplTypeOfTxGrpSigInfo "" UBYTE Com_ApplTypeOfTxGrpSigInfoType 0 0 0 255 ECU_ADDRESS 0x0 /end MEASUREMENT
/begin MEASUREMENT Com_TxGrpSigInfo[38].BitLengthOfTxGrpSigInfo "" UBYTE NO_COMPU_METHOD 0 0 0 255 ECU_ADDRESS 0x0 /end MEASUREMENT
/begin MEASUREMENT Com_TxGrpSigInfo[38].BitPositionOfTxGrpSigInfo "" UWORD NO_COMPU_METHOD 0 0 0 65535 ECU_ADDRESS 0x0 /end MEASUREMENT
/begin MEASUREMENT Com_TxGrpSigInfo[38].BusAccOfTxGrpSigInfo "" UBYTE Com_BusAccOfTxGrpSigInfoType 0 0 0 255 ECU_ADDRESS 0x0 /end MEASUREMENT
/begin MEASUREMENT Com_TxGrpSigInfo[38].ByteLengthOfTxGrpSigInfo "" UBYTE NO_COMPU_METHOD 0 0 0 255 ECU_ADDRESS 0x0 /end MEASUREMENT
/begin MEASUREMENT Com_TxGrpSigInfo[38].DynSignalOfTxGrpSigInfo "" UBYTE Com_DynSignalOfTxGrpSigInfoType 0 0 0 1 ECU_ADDRESS 0x0 /end MEASUREMENT
/begin MEASUREMENT Com_TxGrpSigInfo[38].InvValueIdxOfTxGrpSigInfo "" UBYTE Com_InvValueIdxOfTxGrpSigInfoType 0 0 0 255 ECU_ADDRESS 0x0 /end MEASUREMENT
/begin MEASUREMENT Com_TxGrpSigInfo[38].InvValueOfTxGrpSigInfo "" UBYTE Com_InvValueOfTxGrpSigInfoType 0 0 0 255 ECU_ADDRESS 0x0 /end MEASUREMENT
/begin MEASUREMENT Com_TxGrpSigInfo[38].StartByteInPduPositionOfTxGrpSigInfo "" UBYTE NO_COMPU_METHOD 0 0 0 255 ECU_ADDRESS 0x0 /end MEASUREMENT
/begin MEASUREMENT Com_TxGrpSigInfo[38].TxBufferEndIdxOfTxGrpSigInfo "" UWORD Com_TxBufferEndIdxOfTxGrpSigInfoType 0 0 0 65535 ECU_ADDRESS 0x0 /end MEASUREMENT
/begin MEASUREMENT Com_TxGrpSigInfo[38].TxBufferStartIdxOfTxGrpSigInfo "" UWORD Com_TxBufferStartIdxOfTxGrpSigInfoType 0 0 0 65535 ECU_ADDRESS 0x0 /end MEASUREMENT
/begin MEASUREMENT Com_TxGrpSigInfo[38].TxPduInfoIdxOfTxGrpSigInfo "" UBYTE NO_COMPU_METHOD 0 0 0 255 ECU_ADDRESS 0x0 /end MEASUREMENT
/begin MEASUREMENT Com_TxGrpSigInfo[38].TxSigGrpInfoIdxOfTxGrpSigInfo "" UBYTE NO_COMPU_METHOD 0 0 0 255 ECU_ADDRESS 0x0 /end MEASUREMENT
/begin MEASUREMENT Com_TxGrpSigInfo[38].WithoutRepOfTxGrpSigInfo "" UBYTE Com_WithoutRepOfTxGrpSigInfoType 0 0 0 1 ECU_ADDRESS 0x0 /end MEASUREMENT
/begin MEASUREMENT Com_TxGrpSigInfo[39].ApplTypeOfTxGrpSigInfo "" UBYTE Com_ApplTypeOfTxGrpSigInfoType 0 0 0 255 ECU_ADDRESS 0x0 /end MEASUREMENT
/begin MEASUREMENT Com_TxGrpSigInfo[39].BitLengthOfTxGrpSigInfo "" UBYTE NO_COMPU_METHOD 0 0 0 255 ECU_ADDRESS 0x0 /end MEASUREMENT
/begin MEASUREMENT Com_TxGrpSigInfo[39].BitPositionOfTxGrpSigInfo "" UWORD NO_COMPU_METHOD 0 0 0 65535 ECU_ADDRESS 0x0 /end MEASUREMENT
/begin MEASUREMENT Com_TxGrpSigInfo[39].BusAccOfTxGrpSigInfo "" UBYTE Com_BusAccOfTxGrpSigInfoType 0 0 0 255 ECU_ADDRESS 0x0 /end MEASUREMENT
/begin MEASUREMENT Com_TxGrpSigInfo[39].ByteLengthOfTxGrpSigInfo "" UBYTE NO_COMPU_METHOD 0 0 0 255 ECU_ADDRESS 0x0 /end MEASUREMENT
/begin MEASUREMENT Com_TxGrpSigInfo[39].DynSignalOfTxGrpSigInfo "" UBYTE Com_DynSignalOfTxGrpSigInfoType 0 0 0 1 ECU_ADDRESS 0x0 /end MEASUREMENT
/begin MEASUREMENT Com_TxGrpSigInfo[39].InvValueIdxOfTxGrpSigInfo "" UBYTE Com_InvValueIdxOfTxGrpSigInfoType 0 0 0 255 ECU_ADDRESS 0x0 /end MEASUREMENT
/begin MEASUREMENT Com_TxGrpSigInfo[39].InvValueOfTxGrpSigInfo "" UBYTE Com_InvValueOfTxGrpSigInfoType 0 0 0 255 ECU_ADDRESS 0x0 /end MEASUREMENT
/begin MEASUREMENT Com_TxGrpSigInfo[39].StartByteInPduPositionOfTxGrpSigInfo "" UBYTE NO_COMPU_METHOD 0 0 0 255 ECU_ADDRESS 0x0 /end MEASUREMENT
/begin MEASUREMENT Com_TxGrpSigInfo[39].TxBufferEndIdxOfTxGrpSigInfo "" UWORD Com_TxBufferEndIdxOfTxGrpSigInfoType 0 0 0 65535 ECU_ADDRESS 0x0 /end MEASUREMENT
/begin MEASUREMENT Com_TxGrpSigInfo[39].TxBufferStartIdxOfTxGrpSigInfo "" UWORD Com_TxBufferStartIdxOfTxGrpSigInfoType 0 0 0 65535 ECU_ADDRESS 0x0 /end MEASUREMENT
/begin MEASUREMENT Com_TxGrpSigInfo[39].TxPduInfoIdxOfTxGrpSigInfo "" UBYTE NO_COMPU_METHOD 0 0 0 255 ECU_ADDRESS 0x0 /end MEASUREMENT
/begin MEASUREMENT Com_TxGrpSigInfo[39].TxSigGrpInfoIdxOfTxGrpSigInfo "" UBYTE NO_COMPU_METHOD 0 0 0 255 ECU_ADDRESS 0x0 /end MEASUREMENT
/begin MEASUREMENT Com_TxGrpSigInfo[39].WithoutRepOfTxGrpSigInfo "" UBYTE Com_WithoutRepOfTxGrpSigInfoType 0 0 0 1 ECU_ADDRESS 0x0 /end MEASUREMENT
/begin MEASUREMENT Com_TxGrpSigInfo[3].ApplTypeOfTxGrpSigInfo "" UBYTE Com_ApplTypeOfTxGrpSigInfoType 0 0 0 255 ECU_ADDRESS 0x0 /end MEASUREMENT
/begin MEASUREMENT Com_TxGrpSigInfo[3].BitLengthOfTxGrpSigInfo "" UBYTE NO_COMPU_METHOD 0 0 0 255 ECU_ADDRESS 0x0 /end MEASUREMENT
/begin MEASUREMENT Com_TxGrpSigInfo[3].BitPositionOfTxGrpSigInfo "" UWORD NO_COMPU_METHOD 0 0 0 65535 ECU_ADDRESS 0x0 /end MEASUREMENT
/begin MEASUREMENT Com_TxGrpSigInfo[3].BusAccOfTxGrpSigInfo "" UBYTE Com_BusAccOfTxGrpSigInfoType 0 0 0 255 ECU_ADDRESS 0x0 /end MEASUREMENT
/begin MEASUREMENT Com_TxGrpSigInfo[3].ByteLengthOfTxGrpSigInfo "" UBYTE NO_COMPU_METHOD 0 0 0 255 ECU_ADDRESS 0x0 /end MEASUREMENT
/begin MEASUREMENT Com_TxGrpSigInfo[3].DynSignalOfTxGrpSigInfo "" UBYTE Com_DynSignalOfTxGrpSigInfoType 0 0 0 1 ECU_ADDRESS 0x0 /end MEASUREMENT
/begin MEASUREMENT Com_TxGrpSigInfo[3].InvValueIdxOfTxGrpSigInfo "" UBYTE Com_InvValueIdxOfTxGrpSigInfoType 0 0 0 255 ECU_ADDRESS 0x0 /end MEASUREMENT
/begin MEASUREMENT Com_TxGrpSigInfo[3].InvValueOfTxGrpSigInfo "" UBYTE Com_InvValueOfTxGrpSigInfoType 0 0 0 255 ECU_ADDRESS 0x0 /end MEASUREMENT
/begin MEASUREMENT Com_TxGrpSigInfo[3].StartByteInPduPositionOfTxGrpSigInfo "" UBYTE NO_COMPU_METHOD 0 0 0 255 ECU_ADDRESS 0x0 /end MEASUREMENT
/begin MEASUREMENT Com_TxGrpSigInfo[3].TxBufferEndIdxOfTxGrpSigInfo "" UWORD Com_TxBufferEndIdxOfTxGrpSigInfoType 0 0 0 65535 ECU_ADDRESS 0x0 /end MEASUREMENT
/begin MEASUREMENT Com_TxGrpSigInfo[3].TxBufferStartIdxOfTxGrpSigInfo "" UWORD Com_TxBufferStartIdxOfTxGrpSigInfoType 0 0 0 65535 ECU_ADDRESS 0x0 /end MEASUREMENT
/begin MEASUREMENT Com_TxGrpSigInfo[3].TxPduInfoIdxOfTxGrpSigInfo "" UBYTE NO_COMPU_METHOD 0 0 0 255 ECU_ADDRESS 0x0 /end MEASUREMENT
/begin MEASUREMENT Com_TxGrpSigInfo[3].TxSigGrpInfoIdxOfTxGrpSigInfo "" UBYTE NO_COMPU_METHOD 0 0 0 255 ECU_ADDRESS 0x0 /end MEASUREMENT
/begin MEASUREMENT Com_TxGrpSigInfo[3].WithoutRepOfTxGrpSigInfo "" UBYTE Com_WithoutRepOfTxGrpSigInfoType 0 0 0 1 ECU_ADDRESS 0x0 /end MEASUREMENT
/begin MEASUREMENT Com_TxGrpSigInfo[40].ApplTypeOfTxGrpSigInfo "" UBYTE Com_ApplTypeOfTxGrpSigInfoType 0 0 0 255 ECU_ADDRESS 0x0 /end MEASUREMENT
/begin MEASUREMENT Com_TxGrpSigInfo[40].BitLengthOfTxGrpSigInfo "" UBYTE NO_COMPU_METHOD 0 0 0 255 ECU_ADDRESS 0x0 /end MEASUREMENT
/begin MEASUREMENT Com_TxGrpSigInfo[40].BitPositionOfTxGrpSigInfo "" UWORD NO_COMPU_METHOD 0 0 0 65535 ECU_ADDRESS 0x0 /end MEASUREMENT
/begin MEASUREMENT Com_TxGrpSigInfo[40].BusAccOfTxGrpSigInfo "" UBYTE Com_BusAccOfTxGrpSigInfoType 0 0 0 255 ECU_ADDRESS 0x0 /end MEASUREMENT
/begin MEASUREMENT Com_TxGrpSigInfo[40].ByteLengthOfTxGrpSigInfo "" UBYTE NO_COMPU_METHOD 0 0 0 255 ECU_ADDRESS 0x0 /end MEASUREMENT
/begin MEASUREMENT Com_TxGrpSigInfo[40].DynSignalOfTxGrpSigInfo "" UBYTE Com_DynSignalOfTxGrpSigInfoType 0 0 0 1 ECU_ADDRESS 0x0 /end MEASUREMENT
/begin MEASUREMENT Com_TxGrpSigInfo[40].InvValueIdxOfTxGrpSigInfo "" UBYTE Com_InvValueIdxOfTxGrpSigInfoType 0 0 0 255 ECU_ADDRESS 0x0 /end MEASUREMENT
/begin MEASUREMENT Com_TxGrpSigInfo[40].InvValueOfTxGrpSigInfo "" UBYTE Com_InvValueOfTxGrpSigInfoType 0 0 0 255 ECU_ADDRESS 0x0 /end MEASUREMENT
/begin MEASUREMENT Com_TxGrpSigInfo[40].StartByteInPduPositionOfTxGrpSigInfo "" UBYTE NO_COMPU_METHOD 0 0 0 255 ECU_ADDRESS 0x0 /end MEASUREMENT
/begin MEASUREMENT Com_TxGrpSigInfo[40].TxBufferEndIdxOfTxGrpSigInfo "" UWORD Com_TxBufferEndIdxOfTxGrpSigInfoType 0 0 0 65535 ECU_ADDRESS 0x0 /end MEASUREMENT
/begin MEASUREMENT Com_TxGrpSigInfo[40].TxBufferStartIdxOfTxGrpSigInfo "" UWORD Com_TxBufferStartIdxOfTxGrpSigInfoType 0 0 0 65535 ECU_ADDRESS 0x0 /end MEASUREMENT
/begin MEASUREMENT Com_TxGrpSigInfo[40].TxPduInfoIdxOfTxGrpSigInfo "" UBYTE NO_COMPU_METHOD 0 0 0 255 ECU_ADDRESS 0x0 /end MEASUREMENT
/begin MEASUREMENT Com_TxGrpSigInfo[40].TxSigGrpInfoIdxOfTxGrpSigInfo "" UBYTE NO_COMPU_METHOD 0 0 0 255 ECU_ADDRESS 0x0 /end MEASUREMENT
/begin MEASUREMENT Com_TxGrpSigInfo[40].WithoutRepOfTxGrpSigInfo "" UBYTE Com_WithoutRepOfTxGrpSigInfoType 0 0 0 1 ECU_ADDRESS 0x0 /end MEASUREMENT
/begin MEASUREMENT Com_TxGrpSigInfo[41].ApplTypeOfTxGrpSigInfo "" UBYTE Com_ApplTypeOfTxGrpSigInfoType 0 0 0 255 ECU_ADDRESS 0x0 /end MEASUREMENT
/begin MEASUREMENT Com_TxGrpSigInfo[41].BitLengthOfTxGrpSigInfo "" UBYTE NO_COMPU_METHOD 0 0 0 255 ECU_ADDRESS 0x0 /end MEASUREMENT
/begin MEASUREMENT Com_TxGrpSigInfo[41].BitPositionOfTxGrpSigInfo "" UWORD NO_COMPU_METHOD 0 0 0 65535 ECU_ADDRESS 0x0 /end MEASUREMENT
/begin MEASUREMENT Com_TxGrpSigInfo[41].BusAccOfTxGrpSigInfo "" UBYTE Com_BusAccOfTxGrpSigInfoType 0 0 0 255 ECU_ADDRESS 0x0 /end MEASUREMENT
/begin MEASUREMENT Com_TxGrpSigInfo[41].ByteLengthOfTxGrpSigInfo "" UBYTE NO_COMPU_METHOD 0 0 0 255 ECU_ADDRESS 0x0 /end MEASUREMENT
/begin MEASUREMENT Com_TxGrpSigInfo[41].DynSignalOfTxGrpSigInfo "" UBYTE Com_DynSignalOfTxGrpSigInfoType 0 0 0 1 ECU_ADDRESS 0x0 /end MEASUREMENT
/begin MEASUREMENT Com_TxGrpSigInfo[41].InvValueIdxOfTxGrpSigInfo "" UBYTE Com_InvValueIdxOfTxGrpSigInfoType 0 0 0 255 ECU_ADDRESS 0x0 /end MEASUREMENT
/begin MEASUREMENT Com_TxGrpSigInfo[41].InvValueOfTxGrpSigInfo "" UBYTE Com_InvValueOfTxGrpSigInfoType 0 0 0 255 ECU_ADDRESS 0x0 /end MEASUREMENT
/begin MEASUREMENT Com_TxGrpSigInfo[41].StartByteInPduPositionOfTxGrpSigInfo "" UBYTE NO_COMPU_METHOD 0 0 0 255 ECU_ADDRESS 0x0 /end MEASUREMENT
/begin MEASUREMENT Com_TxGrpSigInfo[41].TxBufferEndIdxOfTxGrpSigInfo "" UWORD Com_TxBufferEndIdxOfTxGrpSigInfoType 0 0 0 65535 ECU_ADDRESS 0x0 /end MEASUREMENT
/begin MEASUREMENT Com_TxGrpSigInfo[41].TxBufferStartIdxOfTxGrpSigInfo "" UWORD Com_TxBufferStartIdxOfTxGrpSigInfoType 0 0 0 65535 ECU_ADDRESS 0x0 /end MEASUREMENT
/begin MEASUREMENT Com_TxGrpSigInfo[41].TxPduInfoIdxOfTxGrpSigInfo "" UBYTE NO_COMPU_METHOD 0 0 0 255 ECU_ADDRESS 0x0 /end MEASUREMENT
/begin MEASUREMENT Com_TxGrpSigInfo[41].TxSigGrpInfoIdxOfTxGrpSigInfo "" UBYTE NO_COMPU_METHOD 0 0 0 255 ECU_ADDRESS 0x0 /end MEASUREMENT
/begin MEASUREMENT Com_TxGrpSigInfo[41].WithoutRepOfTxGrpSigInfo "" UBYTE Com_WithoutRepOfTxGrpSigInfoType 0 0 0 1 ECU_ADDRESS 0x0 /end MEASUREMENT
/begin MEASUREMENT Com_TxGrpSigInfo[42].ApplTypeOfTxGrpSigInfo "" UBYTE Com_ApplTypeOfTxGrpSigInfoType 0 0 0 255 ECU_ADDRESS 0x0 /end MEASUREMENT
/begin MEASUREMENT Com_TxGrpSigInfo[42].BitLengthOfTxGrpSigInfo "" UBYTE NO_COMPU_METHOD 0 0 0 255 ECU_ADDRESS 0x0 /end MEASUREMENT
/begin MEASUREMENT Com_TxGrpSigInfo[42].BitPositionOfTxGrpSigInfo "" UWORD NO_COMPU_METHOD 0 0 0 65535 ECU_ADDRESS 0x0 /end MEASUREMENT
/begin MEASUREMENT Com_TxGrpSigInfo[42].BusAccOfTxGrpSigInfo "" UBYTE Com_BusAccOfTxGrpSigInfoType 0 0 0 255 ECU_ADDRESS 0x0 /end MEASUREMENT
/begin MEASUREMENT Com_TxGrpSigInfo[42].ByteLengthOfTxGrpSigInfo "" UBYTE NO_COMPU_METHOD 0 0 0 255 ECU_ADDRESS 0x0 /end MEASUREMENT
/begin MEASUREMENT Com_TxGrpSigInfo[42].DynSignalOfTxGrpSigInfo "" UBYTE Com_DynSignalOfTxGrpSigInfoType 0 0 0 1 ECU_ADDRESS 0x0 /end MEASUREMENT
/begin COMPU_METHOD Com_ApplTypeOfTxGrpSigInfoType "" TAB_VERB "%10.1" "" COMPU_TAB_REF Com_ApplTypeOfTxGrpSigInfoType /end COMPU_METHOD
/begin COMPU_METHOD Com_BusAccOfTxGrpSigInfoType "" TAB_VERB "%10.1" "" COMPU_TAB_REF Com_BusAccOfTxGrpSigInfoType /end COMPU_METHOD
/begin COMPU_METHOD Com_DynSignalOfTxGrpSigInfoType "" TAB_VERB "%10.1" "" COMPU_TAB_REF Com_DynSignalOfTxGrpSigInfoType /end COMPU_METHOD
/begin COMPU_METHOD Com_InvValueIdxOfTxGrpSigInfoType "" TAB_VERB "%10.1" "" COMPU_TAB_REF Com_InvValueIdxOfTxGrpSigInfoType /end COMPU_METHOD
/begin COMPU_METHOD Com_InvValueOfTxGrpSigInfoType "" TAB_VERB "%10.1" "" COMPU_TAB_REF Com_InvValueOfTxGrpSigInfoType /end COMPU_METHOD
/begin COMPU_METHOD Com_TxBufferEndIdxOfTxGrpSigInfoType "" TAB_VERB "%10.1" "" COMPU_TAB_REF Com_TxBufferEndIdxOfTxGrpSigInfoType /end COMPU_METHOD
/begin COMPU_METHOD Com_TxBufferStartIdxOfTxGrpSigInfoType "" TAB_VERB "%10.1" "" COMPU_TAB_REF Com_TxBufferStartIdxOfTxGrpSigInfoType /end COMPU_METHOD
/begin COMPU_METHOD Com_TxGrpSigInfoIdxOfTxAccessInfoType "" TAB_VERB "%10.1" "" COMPU_TAB_REF Com_TxGrpSigInfoIdxOfTxAccessInfoType /end COMPU_METHOD
/begin COMPU_METHOD Com_TxSigInfoIdxOfTxAccessInfoType "" TAB_VERB "%10.1" "" COMPU_TAB_REF Com_TxSigInfoIdxOfTxAccessInfoType /end COMPU_METHOD
/begin COMPU_METHOD Com_WithoutRepOfTxGrpSigInfoType "" TAB_VERB "%10.1" "" COMPU_TAB_REF Com_WithoutRepOfTxGrpSigInfoType /end COMPU_METHOD
/begin COMPU_VTAB Com_ApplTypeOfTxGrpSigInfoType "" TAB_VERB 4 0 "COM_UINT8_APPLTYPEOFTXGRPSIGINFO" 2 "COM_UINT16_APPLTYPEOFTXGRPSIGINFO" 4 "COM_UINT32_APPLTYPEOFTXGRPSIGINFO" 8 "COM_UINT8_N_APPLTYPEOFTXGRPSIGINFO" /end COMPU_VTAB
/begin COMPU_VTAB Com_BusAccOfTxGrpSigInfoType "" TAB_VERB 5 0 "COM_NBIT_BUSACCOFTXGRPSIGINFO" 1 "COM_BYTE_BUSACCOFTXGRPSIGINFO" 2 "COM_NBYTE_BUSACCOFTXGRPSIGINFO" 4 "COM_NBITNBYTE_BUSACCOFTXGRPSIGINFO" 6 "COM_ARRAY_BASED_BUSACCOFTXGRPSIGINFO" /end COMPU_VTAB
/begin COMPU_VTAB_RANGE Com_DynSignalOfTxGrpSigInfoType "" 2 0 0 "FALSE" 1 255 "TRUE" /end COMPU_VTAB_RANGE
/begin COMPU_VTAB Com_InvValueIdxOfTxGrpSigInfoType "" TAB_VERB 1 255 "COM_NO_INVVALUEIDXOFTXGRPSIGINFO" /end COMPU_VTAB
/begin COMPU_VTAB Com_InvValueOfTxGrpSigInfoType "" TAB_VERB 4 0 "COM_CONSTVALUEUINT8_INVVALUEOFTXGRPSIGINFO" 1 "COM_CONSTVALUEUINT16_INVVALUEOFTXGRPSIGINFO" 2 "COM_CONSTVALUEUINT32_INVVALUEOFTXGRPSIGINFO" 255 "COM_NO_INVVALUEOFTXGRPSIGINFO" /end COMPU_VTAB
/begin COMPU_VTAB Com_TxBufferEndIdxOfTxGrpSigInfoType "" TAB_VERB 1 65535 "COM_NO_TXBUFFERENDIDXOFTXGRPSIGINFO" /end COMPU_VTAB
/begin COMPU_VTAB Com_TxBufferStartIdxOfTxGrpSigInfoType "" TAB_VERB 1 65535 "COM_NO_TXBUFFERSTARTIDXOFTXGRPSIGINFO" /end COMPU_VTAB
/begin COMPU_VTAB Com_TxGrpSigInfoIdxOfTxAccessInfoType "" TAB_VERB 1 255 "COM_NO_TXGRPSIGINFOIDXOFTXACCESSINFO" /end COMPU_VTAB
/begin COMPU_VTAB Com_TxSigInfoIdxOfTxAccessInfoType "" TAB_VERB 1 65535 "COM_NO_TXSIGINFOIDXOFTXACCESSINFO" /end COMPU_VTAB
/begin COMPU_VTAB_RANGE Com_WithoutRepOfTxGrpSigInfoType "" 2 0 0 "FALSE" 1 255 "TRUE" /end COMPU_VTAB_RANGE
/begin GROUP Com ""
 /begin REF_MEASUREMENT Com_TxAccessInfo[552].TxSigInfoIdxOfTxAccessInfo Com_TxAccessInfo[553].TxGrpSigInfoIdxOfTxAccessInfo Com_TxAccessInfo[553].TxSigInfoIdxOfTxAccessInfo Com_TxAccessInfo[554].TxGrpSigInfoIdxOfTxAccessInfo Com_TxAccessInfo[554].TxSigInfoIdxOfTxAccessInfo Com_TxAccessInfo[555].TxGrpSigInfoIdxOfTxAccessInfo Com_TxAccessInfo[555].TxSigInfoIdxOfTxAccessInfo Com_TxAccessInfo[556].TxGrpSigInfoIdxOfTxAccessInfo Com_TxAccessInfo[556].TxSigInfoIdxOfTxAccessInfo Com_TxAccessInfo[557].TxGrpSigInfoIdxOfTxAccessInfo Com_TxAccessInfo[557].TxSigInfoIdxOfTxAccessInfo Com_TxAccessInfo[55].TxGrpSigInfoIdxOfTxAccessInfo Com_TxAccessInfo[55].TxSigInfoIdxOfTxAccessInfo Com_TxAccessInfo[56].TxGrpSigInfoIdxOfTxAccessInfo Com_TxAccessInfo[56].TxSigInfoIdxOfTxAccessInfo Com_TxAccessInfo[57].TxGrpSigInfoIdxOfTxAccessInfo Com_TxAccessInfo[57].TxSigInfoIdxOfTxAccessInfo Com_TxAccessInfo[58].TxGrpSigInfoIdxOfTxAccessInfo Com_TxAccessInfo[58].TxSigInfoIdxOfTxAccessInfo Com_TxAccessInfo[59].TxGrpSigInfoIdxOfTxAccessInfo Com_TxAccessInfo[59].TxSigInfoIdxOfTxAccessInfo Com_TxAccessInfo[5].TxGrpSigInfoIdxOfTxAccessInfo Com_TxAccessInfo[5].TxSigInfoIdxOfTxAccessInfo Com_TxAccessInfo[60].TxGrpSigInfoIdxOfTxAccessInfo Com_TxAccessInfo[60].TxSigInfoIdxOfTxAccessInfo Com_TxAccessInfo[61].TxGrpSigInfoIdxOfTxAccessInfo Com_TxAccessInfo[61].TxSigInfoIdxOfTxAccessInfo Com_TxAccessInfo[62].TxGrpSigInfoIdxOfTxAccessInfo Com_TxAccessInfo[62].TxSigInfoIdxOfTxAccessInfo Com_TxAccessInfo[63].TxGrpSigInfoIdxOfTxAccessInfo Com_TxAccessInfo[63].TxSigInfoIdxOfTxAccessInfo Com_TxAccessInfo[64].TxGrpSigInfoIdxOfTxAccessInfo Com_TxAccessInfo[64].TxSigInfoIdxOfTxAccessInfo Com_TxAccessInfo[65].TxGrpSigInfoIdxOfTxAccessInfo Com_TxAccessInfo[65].TxSigInfoIdxOfTxAccessInfo Com_TxAccessInfo[66].TxGrpSigInfoIdxOfTxAccessInfo Com_TxAccessInfo[66].TxSigInfoIdxOfTxAccessInfo Com_TxAccessInfo[67].TxGrpSigInfoIdxOfTxAccessInfo Com_TxAccessInfo[67].TxSigInfoIdxOfTxAccessInfo Com_TxAccessInfo[68].TxGrpSigInfoIdxOfTxAccessInfo Com_TxAccessInfo[68].TxSigInfoIdxOfTxAccessInfo Com_TxAccessInfo[69].TxGrpSigInfoIdxOfTxAccessInfo Com_TxAccessInfo[69].TxSigInfoIdxOfTxAccessInfo Com_TxAccessInfo[6].TxGrpSigInfoIdxOfTxAccessInfo Com_TxAccessInfo[6].TxSigInfoIdxOfTxAccessInfo Com_TxAccessInfo[70].TxGrpSigInfoIdxOfTxAccessInfo Com_TxAccessInfo[70].TxSigInfoIdxOfTxAccessInfo Com_TxAccessInfo[71].TxGrpSigInfoIdxOfTxAccessInfo Com_TxAccessInfo[71].TxSigInfoIdxOfTxAccessInfo Com_TxAccessInfo[72].TxGrpSigInfoIdxOfTxAccessInfo Com_TxAccessInfo[72].TxSigInfoIdxOfTxAccessInfo Com_TxAccessInfo[73].TxGrpSigInfoIdxOfTxAccessInfo Com_TxAccessInfo[73].TxSigInfoIdxOfTxAccessInfo Com_TxAccessInfo[74].TxGrpSigInfoIdxOfTxAccessInfo Com_TxAccessInfo[74].TxSigInfoIdxOfTxAccessInfo Com_TxAccessInfo[75].TxGrpSigInfoIdxOfTxAccessInfo Com_TxAccessInfo[75].TxSigInfoIdxOfTxAccessInfo Com_TxAccessInfo[76].TxGrpSigInfoIdxOfTxAccessInfo Com_TxAccessInfo[76].TxSigInfoIdxOfTxAccessInfo Com_TxAccessInfo[77].TxGrpSigInfoIdxOfTxAccessInfo Com_TxAccessInfo[77].TxSigInfoIdxOfTxAccessInfo Com_TxAccessInfo[78].TxGrpSigInfoIdxOfTxAccessInfo Com_TxAccessInfo[78].TxSigInfoIdxOfTxAccessInfo Com_TxAccessInfo[79].TxGrpSigInfoIdxOfTxAccessInfo Com_TxAccessInfo[79].TxSigInfoIdxOfTxAccessInfo Com_TxAccessInfo[7].TxGrpSigInfoIdxOfTxAccessInfo Com_TxAccessInfo[7].TxSigInfoIdxOfTxAccessInfo Com_TxAccessInfo[80].TxGrpSigInfoIdxOfTxAccessInfo Com_TxAccessInfo[80].TxSigInfoIdxOfTxAccessInfo Com_TxAccessInfo[81].TxGrpSigInfoIdxOfTxAccessInfo Com_TxAccessInfo[81].TxSigInfoIdxOfTxAccessInfo Com_TxAccessInfo[82].TxGrpSigInfoIdxOfTxAccessInfo Com_TxAccessInfo[82].TxSigInfoIdxOfTxAccessInfo Com_TxAccessInfo[83].TxGrpSigInfoIdxOfTxAccessInfo Com_TxAccessInfo[83].TxSigInfoIdxOfTxAccessInfo Com_TxAccessInfo[84].TxGrpSigInfoIdxOfTxAccessInfo Com_TxAccessInfo[84].TxSigInfoIdxOfTxAccessInfo Com_TxAccessInfo[85].TxGrpSigInfoIdxOfTxAccessInfo Com_TxAccessInfo[85].TxSigInfoIdxOfTxAccessInfo Com_TxAccessInfo[86].TxGrpSigInfoIdxOfTxAccessInfo Com_TxAccessInfo[86].TxSigInfoIdxOfTxAccessInfo Com_TxAccessInfo[87].TxGrpSigInfoIdxOfTxAccessInfo Com_TxAccessInfo[87].TxSigInfoIdxOfTxAccessInfo Com_TxAccessInfo[88].TxGrpSigInfoIdxOfTxAccessInfo Com_TxAccessInfo[88].TxSigInfoIdxOfTxAccessInfo Com_TxAccessInfo[89].TxGrpSigInfoIdxOfTxAccessInfo Com_TxAccessInfo[89].TxSigInfoIdxOfTxAccessInfo Com_TxAccessInfo[8].TxGrpSigInfoIdxOfTxAccessInfo Com_TxAccessInfo[8].TxSigInfoIdxOfTxAccessInfo Com_TxAccessInfo[90].TxGrpSigInfoIdxOfTxAccessInfo Com_TxAccessInfo[90].TxSigInfoIdxOfTxAccessInfo Com_TxAccessInfo[91].TxGrpSigInfoIdxOfTxAccessInfo Com_TxAccessInfo[91].TxSigInfoIdxOfTxAccessInfo Com_TxAccessInfo[92].TxGrpSigInfoIdxOfTxAccessInfo Com_TxAccessInfo[92].TxSigInfoIdxOfTxAccessInfo Com_TxAccessInfo[93].TxGrpSigInfoIdxOfTxAccessInfo Com_TxAccessInfo[93].TxSigInfoIdxOfTxAccessInfo Com_TxAccessInfo[94].TxGrpSigInfoIdxOfTxAccessInfo Com_TxAccessInfo[94].TxSigInfoIdxOfTxAccessInfo Com_TxAccessInfo[95].TxGrpSigInfoIdxOfTxAccessInfo Com_TxAccessInfo[95].TxSigInfoIdxOfTxAccessInfo Com_TxAccessInfo[96].TxGrpSigInfoIdxOfTxAccessInfo Com_TxAccessInfo[96].TxSigInfoIdxOfTxAccessInfo Com_TxAccessInfo[97].TxGrpSigInfoIdxOfTxAccessInfo Com_TxAccessInfo[97].TxSigInfoIdxOfTxAccessInfo Com_TxAccessInfo[98].TxGrpSigInfoIdxOfTxAccessInfo Com_TxAccessInfo[98].TxSigInfoIdxOfTxAccessInfo Com_TxAccessInfo[99].TxGrpSigInfoIdxOfTxAccessInfo Com_TxAccessInfo[99].TxSigInfoIdxOfTxAccessInfo Com_TxAccessInfo[9].TxGrpSigInfoIdxOfTxAccessInfo Com_TxAccessInfo[9].TxSigInfoIdxOfTxAccessInfo Com_TxBuffer Com_TxCyclicPdu[0].TxPduInfoIdxOfTxCyclicPdu Com_TxCyclicPdu[10].TxPduInfoIdxOfTxCyclicPdu Com_TxCyclicPdu[11].TxPduInfoIdxOfTxCyclicPdu Com_TxCyclicPdu[12].TxPduInfoIdxOfTxCyclicPdu Com_TxCyclicPdu[13].TxPduInfoIdxOfTxCyclicPdu Com_TxCyclicPdu[14].TxPduInfoIdxOfTxCyclicPdu Com_TxCyclicPdu[15].TxPduInfoIdxOfTxCyclicPdu Com_TxCyclicPdu[16].TxPduInfoIdxOfTxCyclicPdu Com_TxCyclicPdu[17].TxPduInfoIdxOfTxCyclicPdu Com_TxCyclicPdu[18].TxPduInfoIdxOfTxCyclicPdu Com_TxCyclicPdu[19].TxPduInfoIdxOfTxCyclicPdu Com_TxCyclicPdu[1].TxPduInfoIdxOfTxCyclicPdu Com_TxCyclicPdu[2].TxPduInfoIdxOfTxCyclicPdu Com_TxCyclicPdu[3].TxPduInfoIdxOfTxCyclicPdu Com_TxCyclicPdu[4].TxPduInfoIdxOfTxCyclicPdu Com_TxCyclicPdu[5].TxPduInfoIdxOfTxCyclicPdu Com_TxCyclicPdu[6].TxPduInfoIdxOfTxCyclicPdu Com_TxCyclicPdu[7].TxPduInfoIdxOfTxCyclicPdu Com_TxCyclicPdu[8].TxPduInfoIdxOfTxCyclicPdu Com_TxCyclicPdu[9].TxPduInfoIdxOfTxCyclicPdu Com_TxFilterInitValueArrayBased Com_TxFilterInitValueUInt16 Com_TxFilterInitValueUInt8 Com_TxFilterOldValueArrayBased Com_TxFilterOldValueUInt16 Com_TxFilterOldValueUInt8 Com_TxGrpSigInfoInvValueInd Com_TxGrpSigInfo[0].ApplTypeOfTxGrpSigInfo Com_TxGrpSigInfo[0].BitLengthOfTxGrpSigInfo Com_TxGrpSigInfo[0].BitPositionOfTxGrpSigInfo Com_TxGrpSigInfo[0].BusAccOfTxGrpSigInfo Com_TxGrpSigInfo[0].ByteLengthOfTxGrpSigInfo Com_TxGrpSigInfo[0].DynSignalOfTxGrpSigInfo Com_TxGrpSigInfo[0].InvValueIdxOfTxGrpSigInfo Com_TxGrpSigInfo[0].InvValueOfTxGrpSigInfo Com_TxGrpSigInfo[0].StartByteInPduPositionOfTxGrpSigInfo Com_TxGrpSigInfo[0].TxBufferEndIdxOfTxGrpSigInfo Com_TxGrpSigInfo[0].TxBufferStartIdxOfTxGrpSigInfo Com_TxGrpSigInfo[0].TxPduInfoIdxOfTxGrpSigInfo Com_TxGrpSigInfo[0].TxSigGrpInfoIdxOfTxGrpSigInfo Com_TxGrpSigInfo[0].WithoutRepOfTxGrpSigInfo Com_TxGrpSigInfo[100].ApplTypeOfTxGrpSigInfo Com_TxGrpSigInfo[100].BitLengthOfTxGrpSigInfo Com_TxGrpSigInfo[100].BitPositionOfTxGrpSigInfo Com_TxGrpSigInfo[100].BusAccOfTxGrpSigInfo Com_TxGrpSigInfo[100].ByteLengthOfTxGrpSigInfo Com_TxGrpSigInfo[100].DynSignalOfTxGrpSigInfo Com_TxGrpSigInfo[100].InvValueIdxOfTxGrpSigInfo Com_TxGrpSigInfo[100].InvValueOfTxGrpSigInfo Com_TxGrpSigInfo[100].StartByteInPduPositionOfTxGrpSigInfo Com_TxGrpSigInfo[100].TxBufferEndIdxOfTxGrpSigInfo Com_TxGrpSigInfo[100].TxBufferStartIdxOfTxGrpSigInfo Com_TxGrpSigInfo[100].TxPduInfoIdxOfTxGrpSigInfo Com_TxGrpSigInfo[100].TxSigGrpInfoIdxOfTxGrpSigInfo Com_TxGrpSigInfo[100].WithoutRepOfTxGrpSigInfo Com_TxGrpSigInfo[101].ApplTypeOfTxGrpSigInfo Com_TxGrpSigInfo[101].BitLengthOfTxGrpSigInfo Com_TxGrpSigInfo[101].BitPositionOfTxGrpSigInfo Com_TxGrpSigInfo[101].BusAccOfTxGrpSigInfo Com_TxGrpSigInfo[101].ByteLengthOfTxGrpSigInfo Com_TxGrpSigInfo[101].DynSignalOfTxGrpSigInfo Com_TxGrpSigInfo[101].InvValueIdxOfTxGrpSigInfo Com_TxGrpSigInfo[101].InvValueOfTxGrpSigInfo Com_TxGrpSigInfo[101].StartByteInPduPositionOfTxGrpSigInfo Com_TxGrpSigInfo[101].TxBufferEndIdxOfTxGrpSigInfo Com_TxGrpSigInfo[101].TxBufferStartIdxOfTxGrpSigInfo Com_TxGrpSigInfo[101].TxPduInfoIdxOfTxGrpSigInfo Com_TxGrpSigInfo[101].TxSigGrpInfoIdxOfTxGrpSigInfo Com_TxGrpSigInfo[101].WithoutRepOfTxGrpSigInfo Com_TxGrpSigInfo[102].ApplTypeOfTxGrpSigInfo Com_TxGrpSigInfo[102].BitLengthOfTxGrpSigInfo Com_TxGrpSigInfo[102].BitPositionOfTxGrpSigInfo Com_TxGrpSigInfo[102].BusAccOfTxGrpSigInfo Com_TxGrpSigInfo[102].ByteLengthOfTxGrpSigInfo Com_TxGrpSigInfo[102].DynSignalOfTxGrpSigInfo Com_TxGrpSigInfo[102].InvValueIdxOfTxGrpSigInfo Com_TxGrpSigInfo[102].InvValueOfTxGrpSigInfo Com_TxGrpSigInfo[102].StartByteInPduPositionOfTxGrpSigInfo Com_TxGrpSigInfo[102].TxBufferEndIdxOfTxGrpSigInfo Com_TxGrpSigInfo[102].TxBufferStartIdxOfTxGrpSigInfo Com_TxGrpSigInfo[102].TxPduInfoIdxOfTxGrpSigInfo Com_TxGrpSigInfo[102].TxSigGrpInfoIdxOfTxGrpSigInfo Com_TxGrpSigInfo[102].WithoutRepOfTxGrpSigInfo Com_TxGrpSigInfo[103].ApplTypeOfTxGrpSigInfo Com_TxGrpSigInfo[103].BitLengthOfTxGrpSigInfo Com_TxGrpSigInfo[103].BitPositionOfTxGrpSigInfo Com_TxGrpSigInfo[103].BusAccOfTxGrpSigInfo Com_TxGrpSigInfo[103].ByteLengthOfTxGrpSigInfo Com_TxGrpSigInfo[103].DynSignalOfTxGrpSigInfo Com_TxGrpSigInfo[103].InvValueIdxOfTxGrpSigInfo Com_TxGrpSigInfo[103].InvValueOfTxGrpSigInfo Com_TxGrpSigInfo[103].StartByteInPduPositionOfTxGrpSigInfo Com_TxGrpSigInfo[103].TxBufferEndIdxOfTxGrpSigInfo Com_TxGrpSigInfo[103].TxBufferStartIdxOfTxGrpSigInfo Com_TxGrpSigInfo[103].TxPduInfoIdxOfTxGrpSigInfo Com_TxGrpSigInfo[103].TxSigGrpInfoIdxOfTxGrpSigInfo Com_TxGrpSigInfo[103].WithoutRepOfTxGrpSigInfo Com_TxGrpSigInfo[104].ApplTypeOfTxGrpSigInfo Com_TxGrpSigInfo[104].BitLengthOfTxGrpSigInfo Com_TxGrpSigInfo[104].BitPositionOfTxGrpSigInfo Com_TxGrpSigInfo[104].BusAccOfTxGrpSigInfo Com_TxGrpSigInfo[104].ByteLengthOfTxGrpSigInfo Com_TxGrpSigInfo[104].DynSignalOfTxGrpSigInfo Com_TxGrpSigInfo[104].InvValueIdxOfTxGrpSigInfo Com_TxGrpSigInfo[104].InvValueOfTxGrpSigInfo Com_TxGrpSigInfo[104].StartByteInPduPositionOfTxGrpSigInfo Com_TxGrpSigInfo[104].TxBufferEndIdxOfTxGrpSigInfo Com_TxGrpSigInfo[104].TxBufferStartIdxOfTxGrpSigInfo Com_TxGrpSigInfo[104].TxPduInfoIdxOfTxGrpSigInfo Com_TxGrpSigInfo[104].TxSigGrpInfoIdxOfTxGrpSigInfo Com_TxGrpSigInfo[104].WithoutRepOfTxGrpSigInfo Com_TxGrpSigInfo[105].ApplTypeOfTxGrpSigInfo Com_TxGrpSigInfo[105].BitLengthOfTxGrpSigInfo Com_TxGrpSigInfo[105].BitPositionOfTxGrpSigInfo Com_TxGrpSigInfo[105].BusAccOfTxGrpSigInfo Com_TxGrpSigInfo[105].ByteLengthOfTxGrpSigInfo Com_TxGrpSigInfo[105].DynSignalOfTxGrpSigInfo Com_TxGrpSigInfo[105].InvValueIdxOfTxGrpSigInfo Com_TxGrpSigInfo[105].InvValueOfTxGrpSigInfo Com_TxGrpSigInfo[105].StartByteInPduPositionOfTxGrpSigInfo Com_TxGrpSigInfo[105].TxBufferEndIdxOfTxGrpSigInfo Com_TxGrpSigInfo[105].TxBufferStartIdxOfTxGrpSigInfo Com_TxGrpSigInfo[105].TxPduInfoIdxOfTxGrpSigInfo Com_TxGrpSigInfo[105].TxSigGrpInfoIdxOfTxGrpSigInfo Com_TxGrpSigInfo[105].WithoutRepOfTxGrpSigInfo Com_TxGrpSigInfo[106].ApplTypeOfTxGrpSigInfo Com_TxGrpSigInfo[106].BitLengthOfTxGrpSigInfo Com_TxGrpSigInfo[106].BitPositionOfTxGrpSigInfo Com_TxGrpSigInfo[106].BusAccOfTxGrpSigInfo Com_TxGrpSigInfo[106].ByteLengthOfTxGrpSigInfo Com_TxGrpSigInfo[106].DynSignalOfTxGrpSigInfo Com_TxGrpSigInfo[106].InvValueIdxOfTxGrpSigInfo Com_TxGrpSigInfo[106].InvValueOfTxGrpSigInfo Com_TxGrpSigInfo[106].StartByteInPduPositionOfTxGrpSigInfo Com_TxGrpSigInfo[106].TxBufferEndIdxOfTxGrpSigInfo Com_TxGrpSigInfo[106].TxBufferStartIdxOfTxGrpSigInfo Com_TxGrpSigInfo[106].TxPduInfoIdxOfTxGrpSigInfo Com_TxGrpSigInfo[106].TxSigGrpInfoIdxOfTxGrpSigInfo Com_TxGrpSigInfo[106].WithoutRepOfTxGrpSigInfo Com_TxGrpSigInfo[107].ApplTypeOfTxGrpSigInfo Com_TxGrpSigInfo[107].BitLengthOfTxGrpSigInfo Com_TxGrpSigInfo[107].BitPositionOfTxGrpSigInfo Com_TxGrpSigInfo[107].BusAccOfTxGrpSigInfo Com_TxGrpSigInfo[107].ByteLengthOfTxGrpSigInfo Com_TxGrpSigInfo[107].DynSignalOfTxGrpSigInfo Com_TxGrpSigInfo[107].InvValueIdxOfTxGrpSigInfo Com_TxGrpSigInfo[107].InvValueOfTxGrpSigInfo Com_TxGrpSigInfo[107].StartByteInPduPositionOfTxGrpSigInfo Com_TxGrpSigInfo[107].TxBufferEndIdxOfTxGrpSigInfo Com_TxGrpSigInfo[107].TxBufferStartIdxOfTxGrpSigInfo Com_TxGrpSigInfo[107].TxPduInfoIdxOfTxGrpSigInfo Com_TxGrpSigInfo[107].TxSigGrpInfoIdxOfTxGrpSigInfo Com_TxGrpSigInfo[107].WithoutRepOfTxGrpSigInfo Com_TxGrpSigInfo[108].ApplTypeOfTxGrpSigInfo Com_TxGrpSigInfo[108].BitLengthOfTxGrpSigInfo Com_TxGrpSigInfo[108].BitPositionOfTxGrpSigInfo Com_TxGrpSigInfo[108].BusAccOfTxGrpSigInfo Com_TxGrpSigInfo[108].ByteLengthOfTxGrpSigInfo Com_TxGrpSigInfo[108].DynSignalOfTxGrpSigInfo Com_TxGrpSigInfo[108].InvValueIdxOfTxGrpSigInfo Com_TxGrpSigInfo[108].InvValueOfTxGrpSigInfo Com_TxGrpSigInfo[108].StartByteInPduPositionOfTxGrpSigInfo Com_TxGrpSigInfo[108].TxBufferEndIdxOfTxGrpSigInfo Com_TxGrpSigInfo[108].TxBufferStartIdxOfTxGrpSigInfo Com_TxGrpSigInfo[108].TxPduInfoIdxOfTxGrpSigInfo Com_TxGrpSigInfo[108].TxSigGrpInfoIdxOfTxGrpSigInfo Com_TxGrpSigInfo[108].WithoutRepOfTxGrpSigInfo Com_TxGrpSigInfo[109].ApplTypeOfTxGrpSigInfo Com_TxGrpSigInfo[109].BitLengthOfTxGrpSigInfo Com_TxGrpSigInfo[109].BitPositionOfTxGrpSigInfo Com_TxGrpSigInfo[109].BusAccOfTxGrpSigInfo Com_TxGrpSigInfo[109].ByteLengthOfTxGrpSigInfo Com_TxGrpSigInfo[109].DynSignalOfTxGrpSigInfo Com_TxGrpSigInfo[109].InvValueIdxOfTxGrpSigInfo Com_TxGrpSigInfo[109].InvValueOfTxGrpSigInfo Com_TxGrpSigInfo[109].StartByteInPduPositionOfTxGrpSigInfo Com_TxGrpSigInfo[109].TxBufferEndIdxOfTxGrpSigInfo Com_TxGrpSigInfo[109].TxBufferStartIdxOfTxGrpSigInfo Com_TxGrpSigInfo[109].TxPduInfoIdxOfTxGrpSigInfo Com_TxGrpSigInfo[109].TxSigGrpInfoIdxOfTxGrpSigInfo Com_TxGrpSigInfo[109].WithoutRepOfTxGrpSigInfo Com_TxGrpSigInfo[10].ApplTypeOfTxGrpSigInfo Com_TxGrpSigInfo[10].BitLengthOfTxGrpSigInfo Com_TxGrpSigInfo[10].BitPositionOfTxGrpSigInfo Com_TxGrpSigInfo[10].BusAccOfTxGrpSigInfo Com_TxGrpSigInfo[10].ByteLengthOfTxGrpSigInfo Com_TxGrpSigInfo[10].DynSignalOfTxGrpSigInfo Com_TxGrpSigInfo[10].InvValueIdxOfTxGrpSigInfo Com_TxGrpSigInfo[10].InvValueOfTxGrpSigInfo Com_TxGrpSigInfo[10].StartByteInPduPositionOfTxGrpSigInfo Com_TxGrpSigInfo[10].TxBufferEndIdxOfTxGrpSigInfo Com_TxGrpSigInfo[10].TxBufferStartIdxOfTxGrpSigInfo Com_TxGrpSigInfo[10].TxPduInfoIdxOfTxGrpSigInfo Com_TxGrpSigInfo[10].TxSigGrpInfoIdxOfTxGrpSigInfo Com_TxGrpSigInfo[10].WithoutRepOfTxGrpSigInfo Com_TxGrpSigInfo[110].ApplTypeOfTxGrpSigInfo Com_TxGrpSigInfo[110].BitLengthOfTxGrpSigInfo Com_TxGrpSigInfo[110].BitPositionOfTxGrpSigInfo Com_TxGrpSigInfo[110].BusAccOfTxGrpSigInfo Com_TxGrpSigInfo[110].ByteLengthOfTxGrpSigInfo Com_TxGrpSigInfo[110].DynSignalOfTxGrpSigInfo Com_TxGrpSigInfo[110].InvValueIdxOfTxGrpSigInfo Com_TxGrpSigInfo[110].InvValueOfTxGrpSigInfo Com_TxGrpSigInfo[110].StartByteInPduPositionOfTxGrpSigInfo Com_TxGrpSigInfo[110].TxBufferEndIdxOfTxGrpSigInfo Com_TxGrpSigInfo[110].TxBufferStartIdxOfTxGrpSigInfo Com_TxGrpSigInfo[110].TxPduInfoIdxOfTxGrpSigInfo Com_TxGrpSigInfo[110].TxSigGrpInfoIdxOfTxGrpSigInfo Com_TxGrpSigInfo[110].WithoutRepOfTxGrpSigInfo Com_TxGrpSigInfo[111].ApplTypeOfTxGrpSigInfo Com_TxGrpSigInfo[111].BitLengthOfTxGrpSigInfo Com_TxGrpSigInfo[111].BitPositionOfTxGrpSigInfo Com_TxGrpSigInfo[111].BusAccOfTxGrpSigInfo Com_TxGrpSigInfo[111].ByteLengthOfTxGrpSigInfo Com_TxGrpSigInfo[111].DynSignalOfTxGrpSigInfo Com_TxGrpSigInfo[111].InvValueIdxOfTxGrpSigInfo Com_TxGrpSigInfo[111].InvValueOfTxGrpSigInfo Com_TxGrpSigInfo[111].StartByteInPduPositionOfTxGrpSigInfo Com_TxGrpSigInfo[111].TxBufferEndIdxOfTxGrpSigInfo Com_TxGrpSigInfo[111].TxBufferStartIdxOfTxGrpSigInfo Com_TxGrpSigInfo[111].TxPduInfoIdxOfTxGrpSigInfo Com_TxGrpSigInfo[111].TxSigGrpInfoIdxOfTxGrpSigInfo Com_TxGrpSigInfo[111].WithoutRepOfTxGrpSigInfo Com_TxGrpSigInfo[112].ApplTypeOfTxGrpSigInfo Com_TxGrpSigInfo[112].BitLengthOfTxGrpSigInfo Com_TxGrpSigInfo[112].BitPositionOfTxGrpSigInfo Com_TxGrpSigInfo[112].BusAccOfTxGrpSigInfo Com_TxGrpSigInfo[112].ByteLengthOfTxGrpSigInfo Com_TxGrpSigInfo[112].DynSignalOfTxGrpSigInfo Com_TxGrpSigInfo[112].InvValueIdxOfTxGrpSigInfo Com_TxGrpSigInfo[112].InvValueOfTxGrpSigInfo Com_TxGrpSigInfo[112].StartByteInPduPositionOfTxGrpSigInfo Com_TxGrpSigInfo[112].TxBufferEndIdxOfTxGrpSigInfo Com_TxGrpSigInfo[112].TxBufferStartIdxOfTxGrpSigInfo Com_TxGrpSigInfo[112].TxPduInfoIdxOfTxGrpSigInfo Com_TxGrpSigInfo[112].TxSigGrpInfoIdxOfTxGrpSigInfo Com_TxGrpSigInfo[112].WithoutRepOfTxGrpSigInfo Com_TxGrpSigInfo[113].ApplTypeOfTxGrpSigInfo Com_TxGrpSigInfo[113].BitLengthOfTxGrpSigInfo Com_TxGrpSigInfo[113].BitPositionOfTxGrpSigInfo Com_TxGrpSigInfo[113].BusAccOfTxGrpSigInfo Com_TxGrpSigInfo[113].ByteLengthOfTxGrpSigInfo Com_TxGrpSigInfo[113].DynSignalOfTxGrpSigInfo Com_TxGrpSigInfo[113].InvValueIdxOfTxGrpSigInfo Com_TxGrpSigInfo[113].InvValueOfTxGrpSigInfo Com_TxGrpSigInfo[113].StartByteInPduPositionOfTxGrpSigInfo Com_TxGrpSigInfo[113].TxBufferEndIdxOfTxGrpSigInfo Com_TxGrpSigInfo[113].TxBufferStartIdxOfTxGrpSigInfo Com_TxGrpSigInfo[113].TxPduInfoIdxOfTxGrpSigInfo Com_TxGrpSigInfo[113].TxSigGrpInfoIdxOfTxGrpSigInfo Com_TxGrpSigInfo[113].WithoutRepOfTxGrpSigInfo Com_TxGrpSigInfo[114].ApplTypeOfTxGrpSigInfo Com_TxGrpSigInfo[114].BitLengthOfTxGrpSigInfo Com_TxGrpSigInfo[114].BitPositionOfTxGrpSigInfo Com_TxGrpSigInfo[114].BusAccOfTxGrpSigInfo Com_TxGrpSigInfo[114].ByteLengthOfTxGrpSigInfo Com_TxGrpSigInfo[114].DynSignalOfTxGrpSigInfo Com_TxGrpSigInfo[114].InvValueIdxOfTxGrpSigInfo Com_TxGrpSigInfo[114].InvValueOfTxGrpSigInfo Com_TxGrpSigInfo[114].StartByteInPduPositionOfTxGrpSigInfo Com_TxGrpSigInfo[114].TxBufferEndIdxOfTxGrpSigInfo Com_TxGrpSigInfo[114].TxBufferStartIdxOfTxGrpSigInfo Com_TxGrpSigInfo[114].TxPduInfoIdxOfTxGrpSigInfo Com_TxGrpSigInfo[114].TxSigGrpInfoIdxOfTxGrpSigInfo Com_TxGrpSigInfo[114].WithoutRepOfTxGrpSigInfo Com_TxGrpSigInfo[115].ApplTypeOfTxGrpSigInfo Com_TxGrpSigInfo[115].BitLengthOfTxGrpSigInfo Com_TxGrpSigInfo[115].BitPositionOfTxGrpSigInfo Com_TxGrpSigInfo[115].BusAccOfTxGrpSigInfo Com_TxGrpSigInfo[115].ByteLengthOfTxGrpSigInfo Com_TxGrpSigInfo[115].DynSignalOfTxGrpSigInfo Com_TxGrpSigInfo[115].InvValueIdxOfTxGrpSigInfo Com_TxGrpSigInfo[115].InvValueOfTxGrpSigInfo Com_TxGrpSigInfo[115].StartByteInPduPositionOfTxGrpSigInfo Com_TxGrpSigInfo[115].TxBufferEndIdxOfTxGrpSigInfo Com_TxGrpSigInfo[115].TxBufferStartIdxOfTxGrpSigInfo Com_TxGrpSigInfo[115].TxPduInfoIdxOfTxGrpSigInfo Com_TxGrpSigInfo[115].TxSigGrpInfoIdxOfTxGrpSigInfo Com_TxGrpSigInfo[115].WithoutRepOfTxGrpSigInfo Com_TxGrpSigInfo[116].ApplTypeOfTxGrpSigInfo Com_TxGrpSigInfo[116].BitLengthOfTxGrpSigInfo Com_TxGrpSigInfo[116].BitPositionOfTxGrpSigInfo Com_TxGrpSigInfo[116].BusAccOfTxGrpSigInfo Com_TxGrpSigInfo[116].ByteLengthOfTxGrpSigInfo Com_TxGrpSigInfo[116].DynSignalOfTxGrpSigInfo Com_TxGrpSigInfo[116].InvValueIdxOfTxGrpSigInfo Com_TxGrpSigInfo[116].InvValueOfTxGrpSigInfo Com_TxGrpSigInfo[116].StartByteInPduPositionOfTxGrpSigInfo Com_TxGrpSigInfo[116].TxBufferEndIdxOfTxGrpSigInfo Com_TxGrpSigInfo[116].TxBufferStartIdxOfTxGrpSigInfo Com_TxGrpSigInfo[116].TxPduInfoIdxOfTxGrpSigInfo Com_TxGrpSigInfo[116].TxSigGrpInfoIdxOfTxGrpSigInfo Com_TxGrpSigInfo[116].WithoutRepOfTxGrpSigInfo Com_TxGrpSigInfo[117].ApplTypeOfTxGrpSigInfo Com_TxGrpSigInfo[117].BitLengthOfTxGrpSigInfo Com_TxGrpSigInfo[117].BitPositionOfTxGrpSigInfo Com_TxGrpSigInfo[117].BusAccOfTxGrpSigInfo Com_TxGrpSigInfo[117].ByteLengthOfTxGrpSigInfo Com_TxGrpSigInfo[117].DynSignalOfTxGrpSigInfo Com_TxGrpSigInfo[117].InvValueIdxOfTxGrpSigInfo Com_TxGrpSigInfo[117].InvValueOfTxGrpSigInfo Com_TxGrpSigInfo[117].StartByteInPduPositionOfTxGrpSigInfo Com_TxGrpSigInfo[117].TxBufferEndIdxOfTxGrpSigInfo Com_TxGrpSigInfo[117].TxBufferStartIdxOfTxGrpSigInfo Com_TxGrpSigInfo[117].TxPduInfoIdxOfTxGrpSigInfo Com_TxGrpSigInfo[117].TxSigGrpInfoIdxOfTxGrpSigInfo Com_TxGrpSigInfo[117].WithoutRepOfTxGrpSigInfo Com_TxGrpSigInfo[118].ApplTypeOfTxGrpSigInfo Com_TxGrpSigInfo[118].BitLengthOfTxGrpSigInfo Com_TxGrpSigInfo[118].BitPositionOfTxGrpSigInfo Com_TxGrpSigInfo[118].BusAccOfTxGrpSigInfo Com_TxGrpSigInfo[118].ByteLengthOfTxGrpSigInfo Com_TxGrpSigInfo[118].DynSignalOfTxGrpSigInfo Com_TxGrpSigInfo[118].InvValueIdxOfTxGrpSigInfo Com_TxGrpSigInfo[118].InvValueOfTxGrpSigInfo Com_TxGrpSigInfo[118].StartByteInPduPositionOfTxGrpSigInfo Com_TxGrpSigInfo[118].TxBufferEndIdxOfTxGrpSigInfo Com_TxGrpSigInfo[118].TxBufferStartIdxOfTxGrpSigInfo Com_TxGrpSigInfo[118].TxPduInfoIdxOfTxGrpSigInfo Com_TxGrpSigInfo[118].TxSigGrpInfoIdxOfTxGrpSigInfo Com_TxGrpSigInfo[118].WithoutRepOfTxGrpSigInfo Com_TxGrpSigInfo[119].ApplTypeOfTxGrpSigInfo Com_TxGrpSigInfo[119].BitLengthOfTxGrpSigInfo Com_TxGrpSigInfo[119].BitPositionOfTxGrpSigInfo Com_TxGrpSigInfo[119].BusAccOfTxGrpSigInfo Com_TxGrpSigInfo[119].ByteLengthOfTxGrpSigInfo Com_TxGrpSigInfo[119].DynSignalOfTxGrpSigInfo Com_TxGrpSigInfo[119].InvValueIdxOfTxGrpSigInfo Com_TxGrpSigInfo[119].InvValueOfTxGrpSigInfo Com_TxGrpSigInfo[119].StartByteInPduPositionOfTxGrpSigInfo Com_TxGrpSigInfo[119].TxBufferEndIdxOfTxGrpSigInfo Com_TxGrpSigInfo[119].TxBufferStartIdxOfTxGrpSigInfo Com_TxGrpSigInfo[119].TxPduInfoIdxOfTxGrpSigInfo Com_TxGrpSigInfo[119].TxSigGrpInfoIdxOfTxGrpSigInfo Com_TxGrpSigInfo[119].WithoutRepOfTxGrpSigInfo Com_TxGrpSigInfo[11].ApplTypeOfTxGrpSigInfo Com_TxGrpSigInfo[11].BitLengthOfTxGrpSigInfo Com_TxGrpSigInfo[11].BitPositionOfTxGrpSigInfo Com_TxGrpSigInfo[11].BusAccOfTxGrpSigInfo Com_TxGrpSigInfo[11].ByteLengthOfTxGrpSigInfo Com_TxGrpSigInfo[11].DynSignalOfTxGrpSigInfo Com_TxGrpSigInfo[11].InvValueIdxOfTxGrpSigInfo Com_TxGrpSigInfo[11].InvValueOfTxGrpSigInfo Com_TxGrpSigInfo[11].StartByteInPduPositionOfTxGrpSigInfo Com_TxGrpSigInfo[11].TxBufferEndIdxOfTxGrpSigInfo Com_TxGrpSigInfo[11].TxBufferStartIdxOfTxGrpSigInfo Com_TxGrpSigInfo[11].TxPduInfoIdxOfTxGrpSigInfo Com_TxGrpSigInfo[11].TxSigGrpInfoIdxOfTxGrpSigInfo Com_TxGrpSigInfo[11].WithoutRepOfTxGrpSigInfo Com_TxGrpSigInfo[120].ApplTypeOfTxGrpSigInfo Com_TxGrpSigInfo[120].BitLengthOfTxGrpSigInfo Com_TxGrpSigInfo[120].BitPositionOfTxGrpSigInfo Com_TxGrpSigInfo[120].BusAccOfTxGrpSigInfo Com_TxGrpSigInfo[120].ByteLengthOfTxGrpSigInfo Com_TxGrpSigInfo[120].DynSignalOfTxGrpSigInfo Com_TxGrpSigInfo[120].InvValueIdxOfTxGrpSigInfo Com_TxGrpSigInfo[120].InvValueOfTxGrpSigInfo Com_TxGrpSigInfo[120].StartByteInPduPositionOfTxGrpSigInfo Com_TxGrpSigInfo[120].TxBufferEndIdxOfTxGrpSigInfo Com_TxGrpSigInfo[120].TxBufferStartIdxOfTxGrpSigInfo Com_TxGrpSigInfo[120].TxPduInfoIdxOfTxGrpSigInfo Com_TxGrpSigInfo[120].TxSigGrpInfoIdxOfTxGrpSigInfo Com_TxGrpSigInfo[120].WithoutRepOfTxGrpSigInfo Com_TxGrpSigInfo[121].ApplTypeOfTxGrpSigInfo Com_TxGrpSigInfo[121].BitLengthOfTxGrpSigInfo Com_TxGrpSigInfo[121].BitPositionOfTxGrpSigInfo Com_TxGrpSigInfo[121].BusAccOfTxGrpSigInfo Com_TxGrpSigInfo[121].ByteLengthOfTxGrpSigInfo Com_TxGrpSigInfo[121].DynSignalOfTxGrpSigInfo Com_TxGrpSigInfo[121].InvValueIdxOfTxGrpSigInfo Com_TxGrpSigInfo[121].InvValueOfTxGrpSigInfo Com_TxGrpSigInfo[121].StartByteInPduPositionOfTxGrpSigInfo Com_TxGrpSigInfo[121].TxBufferEndIdxOfTxGrpSigInfo Com_TxGrpSigInfo[121].TxBufferStartIdxOfTxGrpSigInfo Com_TxGrpSigInfo[121].TxPduInfoIdxOfTxGrpSigInfo Com_TxGrpSigInfo[121].TxSigGrpInfoIdxOfTxGrpSigInfo Com_TxGrpSigInfo[121].WithoutRepOfTxGrpSigInfo Com_TxGrpSigInfo[122].ApplTypeOfTxGrpSigInfo Com_TxGrpSigInfo[122].BitLengthOfTxGrpSigInfo Com_TxGrpSigInfo[122].BitPositionOfTxGrpSigInfo Com_TxGrpSigInfo[122].BusAccOfTxGrpSigInfo Com_TxGrpSigInfo[122].ByteLengthOfTxGrpSigInfo Com_TxGrpSigInfo[122].DynSignalOfTxGrpSigInfo Com_TxGrpSigInfo[122].InvValueIdxOfTxGrpSigInfo Com_TxGrpSigInfo[122].InvValueOfTxGrpSigInfo Com_TxGrpSigInfo[122].StartByteInPduPositionOfTxGrpSigInfo Com_TxGrpSigInfo[122].TxBufferEndIdxOfTxGrpSigInfo Com_TxGrpSigInfo[122].TxBufferStartIdxOfTxGrpSigInfo Com_TxGrpSigInfo[122].TxPduInfoIdxOfTxGrpSigInfo Com_TxGrpSigInfo[122].TxSigGrpInfoIdxOfTxGrpSigInfo Com_TxGrpSigInfo[122].WithoutRepOfTxGrpSigInfo Com_TxGrpSigInfo[123].ApplTypeOfTxGrpSigInfo Com_TxGrpSigInfo[123].BitLengthOfTxGrpSigInfo Com_TxGrpSigInfo[123].BitPositionOfTxGrpSigInfo Com_TxGrpSigInfo[123].BusAccOfTxGrpSigInfo Com_TxGrpSigInfo[123].ByteLengthOfTxGrpSigInfo Com_TxGrpSigInfo[123].DynSignalOfTxGrpSigInfo Com_TxGrpSigInfo[123].InvValueIdxOfTxGrpSigInfo Com_TxGrpSigInfo[123].InvValueOfTxGrpSigInfo Com_TxGrpSigInfo[123].StartByteInPduPositionOfTxGrpSigInfo Com_TxGrpSigInfo[123].TxBufferEndIdxOfTxGrpSigInfo Com_TxGrpSigInfo[123].TxBufferStartIdxOfTxGrpSigInfo Com_TxGrpSigInfo[123].TxPduInfoIdxOfTxGrpSigInfo Com_TxGrpSigInfo[123].TxSigGrpInfoIdxOfTxGrpSigInfo Com_TxGrpSigInfo[123].WithoutRepOfTxGrpSigInfo Com_TxGrpSigInfo[12].ApplTypeOfTxGrpSigInfo Com_TxGrpSigInfo[12].BitLengthOfTxGrpSigInfo Com_TxGrpSigInfo[12].BitPositionOfTxGrpSigInfo Com_TxGrpSigInfo[12].BusAccOfTxGrpSigInfo Com_TxGrpSigInfo[12].ByteLengthOfTxGrpSigInfo Com_TxGrpSigInfo[12].DynSignalOfTxGrpSigInfo Com_TxGrpSigInfo[12].InvValueIdxOfTxGrpSigInfo Com_TxGrpSigInfo[12].InvValueOfTxGrpSigInfo Com_TxGrpSigInfo[12].StartByteInPduPositionOfTxGrpSigInfo Com_TxGrpSigInfo[12].TxBufferEndIdxOfTxGrpSigInfo Com_TxGrpSigInfo[12].TxBufferStartIdxOfTxGrpSigInfo Com_TxGrpSigInfo[12].TxPduInfoIdxOfTxGrpSigInfo Com_TxGrpSigInfo[12].TxSigGrpInfoIdxOfTxGrpSigInfo Com_TxGrpSigInfo[12].WithoutRepOfTxGrpSigInfo Com_TxGrpSigInfo[13].ApplTypeOfTxGrpSigInfo Com_TxGrpSigInfo[13].BitLengthOfTxGrpSigInfo Com_TxGrpSigInfo[13].BitPositionOfTxGrpSigInfo Com_TxGrpSigInfo[13].BusAccOfTxGrpSigInfo Com_TxGrpSigInfo[13].ByteLengthOfTxGrpSigInfo Com_TxGrpSigInfo[13].DynSignalOfTxGrpSigInfo Com_TxGrpSigInfo[13].InvValueIdxOfTxGrpSigInfo Com_TxGrpSigInfo[13].InvValueOfTxGrpSigInfo Com_TxGrpSigInfo[13].StartByteInPduPositionOfTxGrpSigInfo Com_TxGrpSigInfo[13].TxBufferEndIdxOfTxGrpSigInfo Com_TxGrpSigInfo[13].TxBufferStartIdxOfTxGrpSigInfo Com_TxGrpSigInfo[13].TxPduInfoIdxOfTxGrpSigInfo Com_TxGrpSigInfo[13].TxSigGrpInfoIdxOfTxGrpSigInfo Com_TxGrpSigInfo[13].WithoutRepOfTxGrpSigInfo Com_TxGrpSigInfo[14].ApplTypeOfTxGrpSigInfo Com_TxGrpSigInfo[14].BitLengthOfTxGrpSigInfo Com_TxGrpSigInfo[14].BitPositionOfTxGrpSigInfo Com_TxGrpSigInfo[14].BusAccOfTxGrpSigInfo Com_TxGrpSigInfo[14].ByteLengthOfTxGrpSigInfo Com_TxGrpSigInfo[14].DynSignalOfTxGrpSigInfo Com_TxGrpSigInfo[14].InvValueIdxOfTxGrpSigInfo Com_TxGrpSigInfo[14].InvValueOfTxGrpSigInfo Com_TxGrpSigInfo[14].StartByteInPduPositionOfTxGrpSigInfo Com_TxGrpSigInfo[14].TxBufferEndIdxOfTxGrpSigInfo Com_TxGrpSigInfo[14].TxBufferStartIdxOfTxGrpSigInfo Com_TxGrpSigInfo[14].TxPduInfoIdxOfTxGrpSigInfo Com_TxGrpSigInfo[14].TxSigGrpInfoIdxOfTxGrpSigInfo Com_TxGrpSigInfo[14].WithoutRepOfTxGrpSigInfo Com_TxGrpSigInfo[15].ApplTypeOfTxGrpSigInfo Com_TxGrpSigInfo[15].BitLengthOfTxGrpSigInfo Com_TxGrpSigInfo[15].BitPositionOfTxGrpSigInfo Com_TxGrpSigInfo[15].BusAccOfTxGrpSigInfo Com_TxGrpSigInfo[15].ByteLengthOfTxGrpSigInfo Com_TxGrpSigInfo[15].DynSignalOfTxGrpSigInfo Com_TxGrpSigInfo[15].InvValueIdxOfTxGrpSigInfo Com_TxGrpSigInfo[15].InvValueOfTxGrpSigInfo Com_TxGrpSigInfo[15].StartByteInPduPositionOfTxGrpSigInfo Com_TxGrpSigInfo[15].TxBufferEndIdxOfTxGrpSigInfo Com_TxGrpSigInfo[15].TxBufferStartIdxOfTxGrpSigInfo Com_TxGrpSigInfo[15].TxPduInfoIdxOfTxGrpSigInfo Com_TxGrpSigInfo[15].TxSigGrpInfoIdxOfTxGrpSigInfo Com_TxGrpSigInfo[15].WithoutRepOfTxGrpSigInfo Com_TxGrpSigInfo[16].ApplTypeOfTxGrpSigInfo Com_TxGrpSigInfo[16].BitLengthOfTxGrpSigInfo Com_TxGrpSigInfo[16].BitPositionOfTxGrpSigInfo Com_TxGrpSigInfo[16].BusAccOfTxGrpSigInfo Com_TxGrpSigInfo[16].ByteLengthOfTxGrpSigInfo Com_TxGrpSigInfo[16].DynSignalOfTxGrpSigInfo Com_TxGrpSigInfo[16].InvValueIdxOfTxGrpSigInfo Com_TxGrpSigInfo[16].InvValueOfTxGrpSigInfo Com_TxGrpSigInfo[16].StartByteInPduPositionOfTxGrpSigInfo Com_TxGrpSigInfo[16].TxBufferEndIdxOfTxGrpSigInfo Com_TxGrpSigInfo[16].TxBufferStartIdxOfTxGrpSigInfo Com_TxGrpSigInfo[16].TxPduInfoIdxOfTxGrpSigInfo Com_TxGrpSigInfo[16].TxSigGrpInfoIdxOfTxGrpSigInfo Com_TxGrpSigInfo[16].WithoutRepOfTxGrpSigInfo Com_TxGrpSigInfo[17].ApplTypeOfTxGrpSigInfo Com_TxGrpSigInfo[17].BitLengthOfTxGrpSigInfo Com_TxGrpSigInfo[17].BitPositionOfTxGrpSigInfo Com_TxGrpSigInfo[17].BusAccOfTxGrpSigInfo Com_TxGrpSigInfo[17].ByteLengthOfTxGrpSigInfo Com_TxGrpSigInfo[17].DynSignalOfTxGrpSigInfo Com_TxGrpSigInfo[17].InvValueIdxOfTxGrpSigInfo Com_TxGrpSigInfo[17].InvValueOfTxGrpSigInfo Com_TxGrpSigInfo[17].StartByteInPduPositionOfTxGrpSigInfo Com_TxGrpSigInfo[17].TxBufferEndIdxOfTxGrpSigInfo Com_TxGrpSigInfo[17].TxBufferStartIdxOfTxGrpSigInfo Com_TxGrpSigInfo[17].TxPduInfoIdxOfTxGrpSigInfo Com_TxGrpSigInfo[17].TxSigGrpInfoIdxOfTxGrpSigInfo Com_TxGrpSigInfo[17].WithoutRepOfTxGrpSigInfo Com_TxGrpSigInfo[18].ApplTypeOfTxGrpSigInfo Com_TxGrpSigInfo[18].BitLengthOfTxGrpSigInfo Com_TxGrpSigInfo[18].BitPositionOfTxGrpSigInfo Com_TxGrpSigInfo[18].BusAccOfTxGrpSigInfo Com_TxGrpSigInfo[18].ByteLengthOfTxGrpSigInfo Com_TxGrpSigInfo[18].DynSignalOfTxGrpSigInfo Com_TxGrpSigInfo[18].InvValueIdxOfTxGrpSigInfo Com_TxGrpSigInfo[18].InvValueOfTxGrpSigInfo Com_TxGrpSigInfo[18].StartByteInPduPositionOfTxGrpSigInfo Com_TxGrpSigInfo[18].TxBufferEndIdxOfTxGrpSigInfo Com_TxGrpSigInfo[18].TxBufferStartIdxOfTxGrpSigInfo Com_TxGrpSigInfo[18].TxPduInfoIdxOfTxGrpSigInfo Com_TxGrpSigInfo[18].TxSigGrpInfoIdxOfTxGrpSigInfo Com_TxGrpSigInfo[18].WithoutRepOfTxGrpSigInfo Com_TxGrpSigInfo[19].ApplTypeOfTxGrpSigInfo Com_TxGrpSigInfo[19].BitLengthOfTxGrpSigInfo Com_TxGrpSigInfo[19].BitPositionOfTxGrpSigInfo Com_TxGrpSigInfo[19].BusAccOfTxGrpSigInfo Com_TxGrpSigInfo[19].ByteLengthOfTxGrpSigInfo Com_TxGrpSigInfo[19].DynSignalOfTxGrpSigInfo Com_TxGrpSigInfo[19].InvValueIdxOfTxGrpSigInfo Com_TxGrpSigInfo[19].InvValueOfTxGrpSigInfo Com_TxGrpSigInfo[19].StartByteInPduPositionOfTxGrpSigInfo Com_TxGrpSigInfo[19].TxBufferEndIdxOfTxGrpSigInfo Com_TxGrpSigInfo[19].TxBufferStartIdxOfTxGrpSigInfo Com_TxGrpSigInfo[19].TxPduInfoIdxOfTxGrpSigInfo Com_TxGrpSigInfo[19].TxSigGrpInfoIdxOfTxGrpSigInfo Com_TxGrpSigInfo[19].WithoutRepOfTxGrpSigInfo Com_TxGrpSigInfo[1].ApplTypeOfTxGrpSigInfo Com_TxGrpSigInfo[1].BitLengthOfTxGrpSigInfo Com_TxGrpSigInfo[1].BitPositionOfTxGrpSigInfo Com_TxGrpSigInfo[1].BusAccOfTxGrpSigInfo Com_TxGrpSigInfo[1].ByteLengthOfTxGrpSigInfo Com_TxGrpSigInfo[1].DynSignalOfTxGrpSigInfo Com_TxGrpSigInfo[1].InvValueIdxOfTxGrpSigInfo Com_TxGrpSigInfo[1].InvValueOfTxGrpSigInfo Com_TxGrpSigInfo[1].StartByteInPduPositionOfTxGrpSigInfo Com_TxGrpSigInfo[1].TxBufferEndIdxOfTxGrpSigInfo Com_TxGrpSigInfo[1].TxBufferStartIdxOfTxGrpSigInfo Com_TxGrpSigInfo[1].TxPduInfoIdxOfTxGrpSigInfo Com_TxGrpSigInfo[1].TxSigGrpInfoIdxOfTxGrpSigInfo Com_TxGrpSigInfo[1].WithoutRepOfTxGrpSigInfo Com_TxGrpSigInfo[20].ApplTypeOfTxGrpSigInfo Com_TxGrpSigInfo[20].BitLengthOfTxGrpSigInfo Com_TxGrpSigInfo[20].BitPositionOfTxGrpSigInfo Com_TxGrpSigInfo[20].BusAccOfTxGrpSigInfo Com_TxGrpSigInfo[20].ByteLengthOfTxGrpSigInfo Com_TxGrpSigInfo[20].DynSignalOfTxGrpSigInfo Com_TxGrpSigInfo[20].InvValueIdxOfTxGrpSigInfo Com_TxGrpSigInfo[20].InvValueOfTxGrpSigInfo Com_TxGrpSigInfo[20].StartByteInPduPositionOfTxGrpSigInfo Com_TxGrpSigInfo[20].TxBufferEndIdxOfTxGrpSigInfo Com_TxGrpSigInfo[20].TxBufferStartIdxOfTxGrpSigInfo Com_TxGrpSigInfo[20].TxPduInfoIdxOfTxGrpSigInfo Com_TxGrpSigInfo[20].TxSigGrpInfoIdxOfTxGrpSigInfo Com_TxGrpSigInfo[20].WithoutRepOfTxGrpSigInfo Com_TxGrpSigInfo[21].ApplTypeOfTxGrpSigInfo Com_TxGrpSigInfo[21].BitLengthOfTxGrpSigInfo Com_TxGrpSigInfo[21].BitPositionOfTxGrpSigInfo Com_TxGrpSigInfo[21].BusAccOfTxGrpSigInfo Com_TxGrpSigInfo[21].ByteLengthOfTxGrpSigInfo Com_TxGrpSigInfo[21].DynSignalOfTxGrpSigInfo Com_TxGrpSigInfo[21].InvValueIdxOfTxGrpSigInfo Com_TxGrpSigInfo[21].InvValueOfTxGrpSigInfo Com_TxGrpSigInfo[21].StartByteInPduPositionOfTxGrpSigInfo Com_TxGrpSigInfo[21].TxBufferEndIdxOfTxGrpSigInfo Com_TxGrpSigInfo[21].TxBufferStartIdxOfTxGrpSigInfo Com_TxGrpSigInfo[21].TxPduInfoIdxOfTxGrpSigInfo Com_TxGrpSigInfo[21].TxSigGrpInfoIdxOfTxGrpSigInfo Com_TxGrpSigInfo[21].WithoutRepOfTxGrpSigInfo Com_TxGrpSigInfo[22].ApplTypeOfTxGrpSigInfo Com_TxGrpSigInfo[22].BitLengthOfTxGrpSigInfo Com_TxGrpSigInfo[22].BitPositionOfTxGrpSigInfo Com_TxGrpSigInfo[22].BusAccOfTxGrpSigInfo Com_TxGrpSigInfo[22].ByteLengthOfTxGrpSigInfo Com_TxGrpSigInfo[22].DynSignalOfTxGrpSigInfo Com_TxGrpSigInfo[22].InvValueIdxOfTxGrpSigInfo Com_TxGrpSigInfo[22].InvValueOfTxGrpSigInfo Com_TxGrpSigInfo[22].StartByteInPduPositionOfTxGrpSigInfo Com_TxGrpSigInfo[22].TxBufferEndIdxOfTxGrpSigInfo Com_TxGrpSigInfo[22].TxBufferStartIdxOfTxGrpSigInfo Com_TxGrpSigInfo[22].TxPduInfoIdxOfTxGrpSigInfo Com_TxGrpSigInfo[22].TxSigGrpInfoIdxOfTxGrpSigInfo Com_TxGrpSigInfo[22].WithoutRepOfTxGrpSigInfo Com_TxGrpSigInfo[23].ApplTypeOfTxGrpSigInfo Com_TxGrpSigInfo[23].BitLengthOfTxGrpSigInfo Com_TxGrpSigInfo[23].BitPositionOfTxGrpSigInfo Com_TxGrpSigInfo[23].BusAccOfTxGrpSigInfo Com_TxGrpSigInfo[23].ByteLengthOfTxGrpSigInfo Com_TxGrpSigInfo[23].DynSignalOfTxGrpSigInfo Com_TxGrpSigInfo[23].InvValueIdxOfTxGrpSigInfo Com_TxGrpSigInfo[23].InvValueOfTxGrpSigInfo Com_TxGrpSigInfo[23].StartByteInPduPositionOfTxGrpSigInfo Com_TxGrpSigInfo[23].TxBufferEndIdxOfTxGrpSigInfo Com_TxGrpSigInfo[23].TxBufferStartIdxOfTxGrpSigInfo Com_TxGrpSigInfo[23].TxPduInfoIdxOfTxGrpSigInfo Com_TxGrpSigInfo[23].TxSigGrpInfoIdxOfTxGrpSigInfo Com_TxGrpSigInfo[23].WithoutRepOfTxGrpSigInfo Com_TxGrpSigInfo[24].ApplTypeOfTxGrpSigInfo Com_TxGrpSigInfo[24].BitLengthOfTxGrpSigInfo Com_TxGrpSigInfo[24].BitPositionOfTxGrpSigInfo Com_TxGrpSigInfo[24].BusAccOfTxGrpSigInfo Com_TxGrpSigInfo[24].ByteLengthOfTxGrpSigInfo Com_TxGrpSigInfo[24].DynSignalOfTxGrpSigInfo Com_TxGrpSigInfo[24].InvValueIdxOfTxGrpSigInfo Com_TxGrpSigInfo[24].InvValueOfTxGrpSigInfo Com_TxGrpSigInfo[24].StartByteInPduPositionOfTxGrpSigInfo Com_TxGrpSigInfo[24].TxBufferEndIdxOfTxGrpSigInfo Com_TxGrpSigInfo[24].TxBufferStartIdxOfTxGrpSigInfo Com_TxGrpSigInfo[24].TxPduInfoIdxOfTxGrpSigInfo Com_TxGrpSigInfo[24].TxSigGrpInfoIdxOfTxGrpSigInfo Com_TxGrpSigInfo[24].WithoutRepOfTxGrpSigInfo Com_TxGrpSigInfo[25].ApplTypeOfTxGrpSigInfo Com_TxGrpSigInfo[25].BitLengthOfTxGrpSigInfo Com_TxGrpSigInfo[25].BitPositionOfTxGrpSigInfo Com_TxGrpSigInfo[25].BusAccOfTxGrpSigInfo Com_TxGrpSigInfo[25].ByteLengthOfTxGrpSigInfo Com_TxGrpSigInfo[25].DynSignalOfTxGrpSigInfo Com_TxGrpSigInfo[25].InvValueIdxOfTxGrpSigInfo Com_TxGrpSigInfo[25].InvValueOfTxGrpSigInfo Com_TxGrpSigInfo[25].StartByteInPduPositionOfTxGrpSigInfo Com_TxGrpSigInfo[25].TxBufferEndIdxOfTxGrpSigInfo Com_TxGrpSigInfo[25].TxBufferStartIdxOfTxGrpSigInfo Com_TxGrpSigInfo[25].TxPduInfoIdxOfTxGrpSigInfo Com_TxGrpSigInfo[25].TxSigGrpInfoIdxOfTxGrpSigInfo Com_TxGrpSigInfo[25].WithoutRepOfTxGrpSigInfo Com_TxGrpSigInfo[26].ApplTypeOfTxGrpSigInfo Com_TxGrpSigInfo[26].BitLengthOfTxGrpSigInfo Com_TxGrpSigInfo[26].BitPositionOfTxGrpSigInfo Com_TxGrpSigInfo[26].BusAccOfTxGrpSigInfo Com_TxGrpSigInfo[26].ByteLengthOfTxGrpSigInfo Com_TxGrpSigInfo[26].DynSignalOfTxGrpSigInfo Com_TxGrpSigInfo[26].InvValueIdxOfTxGrpSigInfo Com_TxGrpSigInfo[26].InvValueOfTxGrpSigInfo Com_TxGrpSigInfo[26].StartByteInPduPositionOfTxGrpSigInfo Com_TxGrpSigInfo[26].TxBufferEndIdxOfTxGrpSigInfo Com_TxGrpSigInfo[26].TxBufferStartIdxOfTxGrpSigInfo Com_TxGrpSigInfo[26].TxPduInfoIdxOfTxGrpSigInfo Com_TxGrpSigInfo[26].TxSigGrpInfoIdxOfTxGrpSigInfo Com_TxGrpSigInfo[26].WithoutRepOfTxGrpSigInfo Com_TxGrpSigInfo[27].ApplTypeOfTxGrpSigInfo Com_TxGrpSigInfo[27].BitLengthOfTxGrpSigInfo Com_TxGrpSigInfo[27].BitPositionOfTxGrpSigInfo Com_TxGrpSigInfo[27].BusAccOfTxGrpSigInfo Com_TxGrpSigInfo[27].ByteLengthOfTxGrpSigInfo Com_TxGrpSigInfo[27].DynSignalOfTxGrpSigInfo Com_TxGrpSigInfo[27].InvValueIdxOfTxGrpSigInfo Com_TxGrpSigInfo[27].InvValueOfTxGrpSigInfo Com_TxGrpSigInfo[27].StartByteInPduPositionOfTxGrpSigInfo Com_TxGrpSigInfo[27].TxBufferEndIdxOfTxGrpSigInfo Com_TxGrpSigInfo[27].TxBufferStartIdxOfTxGrpSigInfo Com_TxGrpSigInfo[27].TxPduInfoIdxOfTxGrpSigInfo Com_TxGrpSigInfo[27].TxSigGrpInfoIdxOfTxGrpSigInfo Com_TxGrpSigInfo[27].WithoutRepOfTxGrpSigInfo Com_TxGrpSigInfo[28].ApplTypeOfTxGrpSigInfo Com_TxGrpSigInfo[28].BitLengthOfTxGrpSigInfo Com_TxGrpSigInfo[28].BitPositionOfTxGrpSigInfo Com_TxGrpSigInfo[28].BusAccOfTxGrpSigInfo Com_TxGrpSigInfo[28].ByteLengthOfTxGrpSigInfo Com_TxGrpSigInfo[28].DynSignalOfTxGrpSigInfo Com_TxGrpSigInfo[28].InvValueIdxOfTxGrpSigInfo Com_TxGrpSigInfo[28].InvValueOfTxGrpSigInfo Com_TxGrpSigInfo[28].StartByteInPduPositionOfTxGrpSigInfo Com_TxGrpSigInfo[28].TxBufferEndIdxOfTxGrpSigInfo Com_TxGrpSigInfo[28].TxBufferStartIdxOfTxGrpSigInfo Com_TxGrpSigInfo[28].TxPduInfoIdxOfTxGrpSigInfo Com_TxGrpSigInfo[28].TxSigGrpInfoIdxOfTxGrpSigInfo Com_TxGrpSigInfo[28].WithoutRepOfTxGrpSigInfo Com_TxGrpSigInfo[29].ApplTypeOfTxGrpSigInfo Com_TxGrpSigInfo[29].BitLengthOfTxGrpSigInfo Com_TxGrpSigInfo[29].BitPositionOfTxGrpSigInfo Com_TxGrpSigInfo[29].BusAccOfTxGrpSigInfo Com_TxGrpSigInfo[29].ByteLengthOfTxGrpSigInfo Com_TxGrpSigInfo[29].DynSignalOfTxGrpSigInfo Com_TxGrpSigInfo[29].InvValueIdxOfTxGrpSigInfo Com_TxGrpSigInfo[29].InvValueOfTxGrpSigInfo Com_TxGrpSigInfo[29].StartByteInPduPositionOfTxGrpSigInfo Com_TxGrpSigInfo[29].TxBufferEndIdxOfTxGrpSigInfo Com_TxGrpSigInfo[29].TxBufferStartIdxOfTxGrpSigInfo Com_TxGrpSigInfo[29].TxPduInfoIdxOfTxGrpSigInfo Com_TxGrpSigInfo[29].TxSigGrpInfoIdxOfTxGrpSigInfo Com_TxGrpSigInfo[29].WithoutRepOfTxGrpSigInfo Com_TxGrpSigInfo[2].ApplTypeOfTxGrpSigInfo Com_TxGrpSigInfo[2].BitLengthOfTxGrpSigInfo Com_TxGrpSigInfo[2].BitPositionOfTxGrpSigInfo Com_TxGrpSigInfo[2].BusAccOfTxGrpSigInfo Com_TxGrpSigInfo[2].ByteLengthOfTxGrpSigInfo Com_TxGrpSigInfo[2].DynSignalOfTxGrpSigInfo Com_TxGrpSigInfo[2].InvValueIdxOfTxGrpSigInfo Com_TxGrpSigInfo[2].InvValueOfTxGrpSigInfo Com_TxGrpSigInfo[2].StartByteInPduPositionOfTxGrpSigInfo Com_TxGrpSigInfo[2].TxBufferEndIdxOfTxGrpSigInfo Com_TxGrpSigInfo[2].TxBufferStartIdxOfTxGrpSigInfo Com_TxGrpSigInfo[2].TxPduInfoIdxOfTxGrpSigInfo Com_TxGrpSigInfo[2].TxSigGrpInfoIdxOfTxGrpSigInfo Com_TxGrpSigInfo[2].WithoutRepOfTxGrpSigInfo Com_TxGrpSigInfo[30].ApplTypeOfTxGrpSigInfo Com_TxGrpSigInfo[30].BitLengthOfTxGrpSigInfo Com_TxGrpSigInfo[30].BitPositionOfTxGrpSigInfo Com_TxGrpSigInfo[30].BusAccOfTxGrpSigInfo Com_TxGrpSigInfo[30].ByteLengthOfTxGrpSigInfo Com_TxGrpSigInfo[30].DynSignalOfTxGrpSigInfo Com_TxGrpSigInfo[30].InvValueIdxOfTxGrpSigInfo Com_TxGrpSigInfo[30].InvValueOfTxGrpSigInfo Com_TxGrpSigInfo[30].StartByteInPduPositionOfTxGrpSigInfo Com_TxGrpSigInfo[30].TxBufferEndIdxOfTxGrpSigInfo Com_TxGrpSigInfo[30].TxBufferStartIdxOfTxGrpSigInfo Com_TxGrpSigInfo[30].TxPduInfoIdxOfTxGrpSigInfo Com_TxGrpSigInfo[30].TxSigGrpInfoIdxOfTxGrpSigInfo Com_TxGrpSigInfo[30].WithoutRepOfTxGrpSigInfo Com_TxGrpSigInfo[31].ApplTypeOfTxGrpSigInfo Com_TxGrpSigInfo[31].BitLengthOfTxGrpSigInfo Com_TxGrpSigInfo[31].BitPositionOfTxGrpSigInfo Com_TxGrpSigInfo[31].BusAccOfTxGrpSigInfo Com_TxGrpSigInfo[31].ByteLengthOfTxGrpSigInfo Com_TxGrpSigInfo[31].DynSignalOfTxGrpSigInfo Com_TxGrpSigInfo[31].InvValueIdxOfTxGrpSigInfo Com_TxGrpSigInfo[31].InvValueOfTxGrpSigInfo Com_TxGrpSigInfo[31].StartByteInPduPositionOfTxGrpSigInfo Com_TxGrpSigInfo[31].TxBufferEndIdxOfTxGrpSigInfo Com_TxGrpSigInfo[31].TxBufferStartIdxOfTxGrpSigInfo Com_TxGrpSigInfo[31].TxPduInfoIdxOfTxGrpSigInfo Com_TxGrpSigInfo[31].TxSigGrpInfoIdxOfTxGrpSigInfo Com_TxGrpSigInfo[31].WithoutRepOfTxGrpSigInfo Com_TxGrpSigInfo[32].ApplTypeOfTxGrpSigInfo Com_TxGrpSigInfo[32].BitLengthOfTxGrpSigInfo Com_TxGrpSigInfo[32].BitPositionOfTxGrpSigInfo Com_TxGrpSigInfo[32].BusAccOfTxGrpSigInfo Com_TxGrpSigInfo[32].ByteLengthOfTxGrpSigInfo Com_TxGrpSigInfo[32].DynSignalOfTxGrpSigInfo Com_TxGrpSigInfo[32].InvValueIdxOfTxGrpSigInfo Com_TxGrpSigInfo[32].InvValueOfTxGrpSigInfo Com_TxGrpSigInfo[32].StartByteInPduPositionOfTxGrpSigInfo Com_TxGrpSigInfo[32].TxBufferEndIdxOfTxGrpSigInfo Com_TxGrpSigInfo[32].TxBufferStartIdxOfTxGrpSigInfo Com_TxGrpSigInfo[32].TxPduInfoIdxOfTxGrpSigInfo Com_TxGrpSigInfo[32].TxSigGrpInfoIdxOfTxGrpSigInfo Com_TxGrpSigInfo[32].WithoutRepOfTxGrpSigInfo Com_TxGrpSigInfo[33].ApplTypeOfTxGrpSigInfo Com_TxGrpSigInfo[33].BitLengthOfTxGrpSigInfo Com_TxGrpSigInfo[33].BitPositionOfTxGrpSigInfo Com_TxGrpSigInfo[33].BusAccOfTxGrpSigInfo Com_TxGrpSigInfo[33].ByteLengthOfTxGrpSigInfo Com_TxGrpSigInfo[33].DynSignalOfTxGrpSigInfo Com_TxGrpSigInfo[33].InvValueIdxOfTxGrpSigInfo Com_TxGrpSigInfo[33].InvValueOfTxGrpSigInfo Com_TxGrpSigInfo[33].StartByteInPduPositionOfTxGrpSigInfo Com_TxGrpSigInfo[33].TxBufferEndIdxOfTxGrpSigInfo Com_TxGrpSigInfo[33].TxBufferStartIdxOfTxGrpSigInfo Com_TxGrpSigInfo[33].TxPduInfoIdxOfTxGrpSigInfo Com_TxGrpSigInfo[33].TxSigGrpInfoIdxOfTxGrpSigInfo Com_TxGrpSigInfo[33].WithoutRepOfTxGrpSigInfo Com_TxGrpSigInfo[34].ApplTypeOfTxGrpSigInfo Com_TxGrpSigInfo[34].BitLengthOfTxGrpSigInfo Com_TxGrpSigInfo[34].BitPositionOfTxGrpSigInfo Com_TxGrpSigInfo[34].BusAccOfTxGrpSigInfo Com_TxGrpSigInfo[34].ByteLengthOfTxGrpSigInfo Com_TxGrpSigInfo[34].DynSignalOfTxGrpSigInfo Com_TxGrpSigInfo[34].InvValueIdxOfTxGrpSigInfo Com_TxGrpSigInfo[34].InvValueOfTxGrpSigInfo Com_TxGrpSigInfo[34].StartByteInPduPositionOfTxGrpSigInfo Com_TxGrpSigInfo[34].TxBufferEndIdxOfTxGrpSigInfo Com_TxGrpSigInfo[34].TxBufferStartIdxOfTxGrpSigInfo Com_TxGrpSigInfo[34].TxPduInfoIdxOfTxGrpSigInfo Com_TxGrpSigInfo[34].TxSigGrpInfoIdxOfTxGrpSigInfo Com_TxGrpSigInfo[34].WithoutRepOfTxGrpSigInfo Com_TxGrpSigInfo[35].ApplTypeOfTxGrpSigInfo Com_TxGrpSigInfo[35].BitLengthOfTxGrpSigInfo Com_TxGrpSigInfo[35].BitPositionOfTxGrpSigInfo Com_TxGrpSigInfo[35].BusAccOfTxGrpSigInfo Com_TxGrpSigInfo[35].ByteLengthOfTxGrpSigInfo Com_TxGrpSigInfo[35].DynSignalOfTxGrpSigInfo Com_TxGrpSigInfo[35].InvValueIdxOfTxGrpSigInfo Com_TxGrpSigInfo[35].InvValueOfTxGrpSigInfo Com_TxGrpSigInfo[35].StartByteInPduPositionOfTxGrpSigInfo Com_TxGrpSigInfo[35].TxBufferEndIdxOfTxGrpSigInfo Com_TxGrpSigInfo[35].TxBufferStartIdxOfTxGrpSigInfo Com_TxGrpSigInfo[35].TxPduInfoIdxOfTxGrpSigInfo Com_TxGrpSigInfo[35].TxSigGrpInfoIdxOfTxGrpSigInfo Com_TxGrpSigInfo[35].WithoutRepOfTxGrpSigInfo Com_TxGrpSigInfo[36].ApplTypeOfTxGrpSigInfo Com_TxGrpSigInfo[36].BitLengthOfTxGrpSigInfo Com_TxGrpSigInfo[36].BitPositionOfTxGrpSigInfo Com_TxGrpSigInfo[36].BusAccOfTxGrpSigInfo Com_TxGrpSigInfo[36].ByteLengthOfTxGrpSigInfo Com_TxGrpSigInfo[36].DynSignalOfTxGrpSigInfo Com_TxGrpSigInfo[36].InvValueIdxOfTxGrpSigInfo Com_TxGrpSigInfo[36].InvValueOfTxGrpSigInfo Com_TxGrpSigInfo[36].StartByteInPduPositionOfTxGrpSigInfo Com_TxGrpSigInfo[36].TxBufferEndIdxOfTxGrpSigInfo Com_TxGrpSigInfo[36].TxBufferStartIdxOfTxGrpSigInfo Com_TxGrpSigInfo[36].TxPduInfoIdxOfTxGrpSigInfo Com_TxGrpSigInfo[36].TxSigGrpInfoIdxOfTxGrpSigInfo Com_TxGrpSigInfo[36].WithoutRepOfTxGrpSigInfo Com_TxGrpSigInfo[37].ApplTypeOfTxGrpSigInfo Com_TxGrpSigInfo[37].BitLengthOfTxGrpSigInfo Com_TxGrpSigInfo[37].BitPositionOfTxGrpSigInfo Com_TxGrpSigInfo[37].BusAccOfTxGrpSigInfo Com_TxGrpSigInfo[37].ByteLengthOfTxGrpSigInfo Com_TxGrpSigInfo[37].DynSignalOfTxGrpSigInfo Com_TxGrpSigInfo[37].InvValueIdxOfTxGrpSigInfo Com_TxGrpSigInfo[37].InvValueOfTxGrpSigInfo Com_TxGrpSigInfo[37].StartByteInPduPositionOfTxGrpSigInfo Com_TxGrpSigInfo[37].TxBufferEndIdxOfTxGrpSigInfo Com_TxGrpSigInfo[37].TxBufferStartIdxOfTxGrpSigInfo Com_TxGrpSigInfo[37].TxPduInfoIdxOfTxGrpSigInfo Com_TxGrpSigInfo[37].TxSigGrpInfoIdxOfTxGrpSigInfo Com_TxGrpSigInfo[37].WithoutRepOfTxGrpSigInfo Com_TxGrpSigInfo[38].ApplTypeOfTxGrpSigInfo Com_TxGrpSigInfo[38].BitLengthOfTxGrpSigInfo Com_TxGrpSigInfo[38].BitPositionOfTxGrpSigInfo Com_TxGrpSigInfo[38].BusAccOfTxGrpSigInfo Com_TxGrpSigInfo[38].ByteLengthOfTxGrpSigInfo Com_TxGrpSigInfo[38].DynSignalOfTxGrpSigInfo Com_TxGrpSigInfo[38].InvValueIdxOfTxGrpSigInfo Com_TxGrpSigInfo[38].InvValueOfTxGrpSigInfo Com_TxGrpSigInfo[38].StartByteInPduPositionOfTxGrpSigInfo Com_TxGrpSigInfo[38].TxBufferEndIdxOfTxGrpSigInfo Com_TxGrpSigInfo[38].TxBufferStartIdxOfTxGrpSigInfo Com_TxGrpSigInfo[38].TxPduInfoIdxOfTxGrpSigInfo Com_TxGrpSigInfo[38].TxSigGrpInfoIdxOfTxGrpSigInfo Com_TxGrpSigInfo[38].WithoutRepOfTxGrpSigInfo Com_TxGrpSigInfo[39].ApplTypeOfTxGrpSigInfo Com_TxGrpSigInfo[39].BitLengthOfTxGrpSigInfo Com_TxGrpSigInfo[39].BitPositionOfTxGrpSigInfo Com_TxGrpSigInfo[39].BusAccOfTxGrpSigInfo Com_TxGrpSigInfo[39].ByteLengthOfTxGrpSigInfo Com_TxGrpSigInfo[39].DynSignalOfTxGrpSigInfo Com_TxGrpSigInfo[39].InvValueIdxOfTxGrpSigInfo Com_TxGrpSigInfo[39].InvValueOfTxGrpSigInfo Com_TxGrpSigInfo[39].StartByteInPduPositionOfTxGrpSigInfo Com_TxGrpSigInfo[39].TxBufferEndIdxOfTxGrpSigInfo Com_TxGrpSigInfo[39].TxBufferStartIdxOfTxGrpSigInfo Com_TxGrpSigInfo[39].TxPduInfoIdxOfTxGrpSigInfo Com_TxGrpSigInfo[39].TxSigGrpInfoIdxOfTxGrpSigInfo Com_TxGrpSigInfo[39].WithoutRepOfTxGrpSigInfo Com_TxGrpSigInfo[3].ApplTypeOfTxGrpSigInfo Com_TxGrpSigInfo[3].BitLengthOfTxGrpSigInfo Com_TxGrpSigInfo[3].BitPositionOfTxGrpSigInfo Com_TxGrpSigInfo[3].BusAccOfTxGrpSigInfo Com_TxGrpSigInfo[3].ByteLengthOfTxGrpSigInfo Com_TxGrpSigInfo[3].DynSignalOfTxGrpSigInfo Com_TxGrpSigInfo[3].InvValueIdxOfTxGrpSigInfo Com_TxGrpSigInfo[3].InvValueOfTxGrpSigInfo Com_TxGrpSigInfo[3].StartByteInPduPositionOfTxGrpSigInfo Com_TxGrpSigInfo[3].TxBufferEndIdxOfTxGrpSigInfo Com_TxGrpSigInfo[3].TxBufferStartIdxOfTxGrpSigInfo Com_TxGrpSigInfo[3].TxPduInfoIdxOfTxGrpSigInfo Com_TxGrpSigInfo[3].TxSigGrpInfoIdxOfTxGrpSigInfo Com_TxGrpSigInfo[3].WithoutRepOfTxGrpSigInfo Com_TxGrpSigInfo[40].ApplTypeOfTxGrpSigInfo Com_TxGrpSigInfo[40].BitLengthOfTxGrpSigInfo Com_TxGrpSigInfo[40].BitPositionOfTxGrpSigInfo Com_TxGrpSigInfo[40].BusAccOfTxGrpSigInfo Com_TxGrpSigInfo[40].ByteLengthOfTxGrpSigInfo Com_TxGrpSigInfo[40].DynSignalOfTxGrpSigInfo Com_TxGrpSigInfo[40].InvValueIdxOfTxGrpSigInfo Com_TxGrpSigInfo[40].InvValueOfTxGrpSigInfo Com_TxGrpSigInfo[40].StartByteInPduPositionOfTxGrpSigInfo Com_TxGrpSigInfo[40].TxBufferEndIdxOfTxGrpSigInfo Com_TxGrpSigInfo[40].TxBufferStartIdxOfTxGrpSigInfo Com_TxGrpSigInfo[40].TxPduInfoIdxOfTxGrpSigInfo Com_TxGrpSigInfo[40].TxSigGrpInfoIdxOfTxGrpSigInfo Com_TxGrpSigInfo[40].WithoutRepOfTxGrpSigInfo Com_TxGrpSigInfo[41].ApplTypeOfTxGrpSigInfo Com_TxGrpSigInfo[41].BitLengthOfTxGrpSigInfo Com_TxGrpSigInfo[41].BitPositionOfTxGrpSigInfo Com_TxGrpSigInfo[41].BusAccOfTxGrpSigInfo Com_TxGrpSigInfo[41].ByteLengthOfTxGrpSigInfo Com_TxGrpSigInfo[41].DynSignalOfTxGrpSigInfo Com_TxGrpSigInfo[41].InvValueIdxOfTxGrpSigInfo Com_TxGrpSigInfo[41].InvValueOfTxGrpSigInfo Com_TxGrpSigInfo[41].StartByteInPduPositionOfTxGrpSigInfo Com_TxGrpSigInfo[41].TxBufferEndIdxOfTxGrpSigInfo Com_TxGrpSigInfo[41].TxBufferStartIdxOfTxGrpSigInfo Com_TxGrpSigInfo[41].TxPduInfoIdxOfTxGrpSigInfo Com_TxGrpSigInfo[41].TxSigGrpInfoIdxOfTxGrpSigInfo Com_TxGrpSigInfo[41].WithoutRepOfTxGrpSigInfo Com_TxGrpSigInfo[42].ApplTypeOfTxGrpSigInfo Com_TxGrpSigInfo[42].BitLengthOfTxGrpSigInfo Com_TxGrpSigInfo[42].BitPositionOfTxGrpSigInfo Com_TxGrpSigInfo[42].BusAccOfTxGrpSigInfo Com_TxGrpSigInfo[42].ByteLengthOfTxGrpSigInfo Com_TxGrpSigInfo[42].DynSignalOfTxGrpSigInfo /end REF_MEASUREMENT
/end GROUP
/end MODULE
/end PROJECT
