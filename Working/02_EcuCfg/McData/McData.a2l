ASAP2_VERSION 1 71
/begin PROJECT MICROSAR ""
/begin MODULE CPP ""
/begin MOD_COMMON "" BYTE_ORDER MSB_LAST ALIGNMENT_BYTE 1 ALIGNMENT_WORD 2 ALIGNMENT_LONG 4 ALIGNMENT_FLOAT16_IEEE 2 ALIGNMENT_FLOAT32_IEEE 4 ALIGNMENT_FLOAT64_IEEE 8 ALIGNMENT_INT64 8 /end MOD_COMMON
/begin MEASUREMENT Com_RxAccessInfo[147].BusAccOfRxAccessInfo "" UBYTE Com_BusAccOfRxAccessInfoType 0 0 0 255 ECU_ADDRESS 0x0 /end MEASUREMENT
/begin MEASUREMENT Com_RxAccessInfo[147].ByteLengthOfRxAccessInfo "" UBYTE NO_COMPU_METHOD 0 0 0 255 ECU_ADDRESS 0x0 /end MEASUREMENT
/begin MEASUREMENT Com_RxAccessInfo[147].ConstValueArrayBasedInitValueEndIdxOfRxAccessInfo "" UBYTE Com_ConstValueArrayBasedInitValueEndIdxOfRxAccessInfoType 0 0 0 255 ECU_ADDRESS 0x0 /end MEASUREMENT
/begin MEASUREMENT Com_RxAccessInfo[147].ConstValueArrayBasedInitValueStartIdxOfRxAccessInfo "" UBYTE Com_ConstValueArrayBasedInitValueStartIdxOfRxAccessInfoType 0 0 0 255 ECU_ADDRESS 0x0 /end MEASUREMENT
/begin MEASUREMENT Com_RxAccessInfo[147].DynSignalOfRxAccessInfo "" UBYTE Com_DynSignalOfRxAccessInfoType 0 0 0 1 ECU_ADDRESS 0x0 /end MEASUREMENT
/begin MEASUREMENT Com_RxAccessInfo[147].InitValueIdxOfRxAccessInfo "" UBYTE Com_InitValueIdxOfRxAccessInfoType 0 0 0 255 ECU_ADDRESS 0x0 /end MEASUREMENT
/begin MEASUREMENT Com_RxAccessInfo[147].InitValueOfRxAccessInfo "" UBYTE Com_InitValueOfRxAccessInfoType 0 0 0 255 ECU_ADDRESS 0x0 /end MEASUREMENT
/begin MEASUREMENT Com_RxAccessInfo[147].InvValueIdxOfRxAccessInfo "" UBYTE Com_InvValueIdxOfRxAccessInfoType 0 0 0 255 ECU_ADDRESS 0x0 /end MEASUREMENT
/begin MEASUREMENT Com_RxAccessInfo[147].InvValueOfRxAccessInfo "" UBYTE Com_InvValueOfRxAccessInfoType 0 0 0 255 ECU_ADDRESS 0x0 /end MEASUREMENT
/begin MEASUREMENT Com_RxAccessInfo[147].IsGroupSignalOfRxAccessInfo "" UBYTE Com_IsGroupSignalOfRxAccessInfoType 0 0 0 1 ECU_ADDRESS 0x0 /end MEASUREMENT
/begin MEASUREMENT Com_RxAccessInfo[147].RxDataTimeoutSubstitutionValueIdxOfRxAccessInfo "" UBYTE Com_RxDataTimeoutSubstitutionValueIdxOfRxAccessInfoType 0 0 0 255 ECU_ADDRESS 0x0 /end MEASUREMENT
/begin MEASUREMENT Com_RxAccessInfo[147].RxDataTimeoutSubstitutionValueOfRxAccessInfo "" UBYTE Com_RxDataTimeoutSubstitutionValueOfRxAccessInfoType 0 0 0 255 ECU_ADDRESS 0x0 /end MEASUREMENT
/begin MEASUREMENT Com_RxAccessInfo[147].RxPduInfoIdxOfRxAccessInfo "" UBYTE NO_COMPU_METHOD 0 0 0 255 ECU_ADDRESS 0x0 /end MEASUREMENT
/begin MEASUREMENT Com_RxAccessInfo[147].RxSigBufferArrayBasedBufferEndIdxOfRxAccessInfo "" UBYTE Com_RxSigBufferArrayBasedBufferEndIdxOfRxAccessInfoType 0 0 0 255 ECU_ADDRESS 0x0 /end MEASUREMENT
/begin MEASUREMENT Com_RxAccessInfo[147].RxSigBufferArrayBasedBufferStartIdxOfRxAccessInfo "" UBYTE Com_RxSigBufferArrayBasedBufferStartIdxOfRxAccessInfoType 0 0 0 255 ECU_ADDRESS 0x0 /end MEASUREMENT
/begin MEASUREMENT Com_RxAccessInfo[147].RxSigBufferArrayBasedShdBufferEndIdxOfRxAccessInfo "" UBYTE Com_RxSigBufferArrayBasedShdBufferEndIdxOfRxAccessInfoType 0 0 0 255 ECU_ADDRESS 0x0 /end MEASUREMENT
/begin MEASUREMENT Com_RxAccessInfo[147].RxSigBufferArrayBasedShdBufferStartIdxOfRxAccessInfo "" UBYTE Com_RxSigBufferArrayBasedShdBufferStartIdxOfRxAccessInfoType 0 0 0 255 ECU_ADDRESS 0x0 /end MEASUREMENT
/begin MEASUREMENT Com_RxAccessInfo[147].RxTOutInfoIdxOfRxAccessInfo "" UBYTE Com_RxTOutInfoIdxOfRxAccessInfoType 0 0 0 255 ECU_ADDRESS 0x0 /end MEASUREMENT
/begin MEASUREMENT Com_RxAccessInfo[147].ShdBufferIdxOfRxAccessInfo "" UWORD Com_ShdBufferIdxOfRxAccessInfoType 0 0 0 65535 ECU_ADDRESS 0x0 /end MEASUREMENT
/begin MEASUREMENT Com_RxAccessInfo[147].SignalLengthInByteOfRxAccessInfo "" UBYTE NO_COMPU_METHOD 0 0 0 255 ECU_ADDRESS 0x0 /end MEASUREMENT
/begin MEASUREMENT Com_RxAccessInfo[147].StartByteInPduPositionOfRxAccessInfo "" UBYTE NO_COMPU_METHOD 0 0 0 255 ECU_ADDRESS 0x0 /end MEASUREMENT
/begin MEASUREMENT Com_RxAccessInfo[147].TmpBufferIdxOfRxAccessInfo "" UBYTE Com_TmpBufferIdxOfRxAccessInfoType 0 0 0 255 ECU_ADDRESS 0x0 /end MEASUREMENT
/begin MEASUREMENT Com_RxAccessInfo[147].TmpBufferOfRxAccessInfo "" UBYTE Com_TmpBufferOfRxAccessInfoType 0 0 0 255 ECU_ADDRESS 0x0 /end MEASUREMENT
/begin MEASUREMENT Com_RxAccessInfo[147].TmpRxShdBufferArrayBasedTmpBufferEndIdxOfRxAccessInfo "" UBYTE Com_TmpRxShdBufferArrayBasedTmpBufferEndIdxOfRxAccessInfoType 0 0 0 255 ECU_ADDRESS 0x0 /end MEASUREMENT
/begin MEASUREMENT Com_RxAccessInfo[147].TmpRxShdBufferArrayBasedTmpBufferStartIdxOfRxAccessInfo "" UBYTE Com_TmpRxShdBufferArrayBasedTmpBufferStartIdxOfRxAccessInfoType 0 0 0 255 ECU_ADDRESS 0x0 /end MEASUREMENT
/begin MEASUREMENT Com_RxAccessInfo[148].ApplTypeOfRxAccessInfo "" UBYTE Com_ApplTypeOfRxAccessInfoType 0 0 0 255 ECU_ADDRESS 0x0 /end MEASUREMENT
/begin MEASUREMENT Com_RxAccessInfo[148].BitLengthOfRxAccessInfo "" UWORD NO_COMPU_METHOD 0 0 0 65535 ECU_ADDRESS 0x0 /end MEASUREMENT
/begin MEASUREMENT Com_RxAccessInfo[148].BitPositionOfRxAccessInfo "" UWORD NO_COMPU_METHOD 0 0 0 65535 ECU_ADDRESS 0x0 /end MEASUREMENT
/begin MEASUREMENT Com_RxAccessInfo[148].BufferIdxOfRxAccessInfo "" UWORD Com_BufferIdxOfRxAccessInfoType 0 0 0 65535 ECU_ADDRESS 0x0 /end MEASUREMENT
/begin MEASUREMENT Com_RxAccessInfo[148].BusAccOfRxAccessInfo "" UBYTE Com_BusAccOfRxAccessInfoType 0 0 0 255 ECU_ADDRESS 0x0 /end MEASUREMENT
/begin MEASUREMENT Com_RxAccessInfo[148].ByteLengthOfRxAccessInfo "" UBYTE NO_COMPU_METHOD 0 0 0 255 ECU_ADDRESS 0x0 /end MEASUREMENT
/begin MEASUREMENT Com_RxAccessInfo[148].ConstValueArrayBasedInitValueEndIdxOfRxAccessInfo "" UBYTE Com_ConstValueArrayBasedInitValueEndIdxOfRxAccessInfoType 0 0 0 255 ECU_ADDRESS 0x0 /end MEASUREMENT
/begin MEASUREMENT Com_RxAccessInfo[148].ConstValueArrayBasedInitValueStartIdxOfRxAccessInfo "" UBYTE Com_ConstValueArrayBasedInitValueStartIdxOfRxAccessInfoType 0 0 0 255 ECU_ADDRESS 0x0 /end MEASUREMENT
/begin MEASUREMENT Com_RxAccessInfo[148].DynSignalOfRxAccessInfo "" UBYTE Com_DynSignalOfRxAccessInfoType 0 0 0 1 ECU_ADDRESS 0x0 /end MEASUREMENT
/begin MEASUREMENT Com_RxAccessInfo[148].InitValueIdxOfRxAccessInfo "" UBYTE Com_InitValueIdxOfRxAccessInfoType 0 0 0 255 ECU_ADDRESS 0x0 /end MEASUREMENT
/begin MEASUREMENT Com_RxAccessInfo[148].InitValueOfRxAccessInfo "" UBYTE Com_InitValueOfRxAccessInfoType 0 0 0 255 ECU_ADDRESS 0x0 /end MEASUREMENT
/begin MEASUREMENT Com_RxAccessInfo[148].InvValueIdxOfRxAccessInfo "" UBYTE Com_InvValueIdxOfRxAccessInfoType 0 0 0 255 ECU_ADDRESS 0x0 /end MEASUREMENT
/begin MEASUREMENT Com_RxAccessInfo[148].InvValueOfRxAccessInfo "" UBYTE Com_InvValueOfRxAccessInfoType 0 0 0 255 ECU_ADDRESS 0x0 /end MEASUREMENT
/begin MEASUREMENT Com_RxAccessInfo[148].IsGroupSignalOfRxAccessInfo "" UBYTE Com_IsGroupSignalOfRxAccessInfoType 0 0 0 1 ECU_ADDRESS 0x0 /end MEASUREMENT
/begin MEASUREMENT Com_RxAccessInfo[148].RxDataTimeoutSubstitutionValueIdxOfRxAccessInfo "" UBYTE Com_RxDataTimeoutSubstitutionValueIdxOfRxAccessInfoType 0 0 0 255 ECU_ADDRESS 0x0 /end MEASUREMENT
/begin MEASUREMENT Com_RxAccessInfo[148].RxDataTimeoutSubstitutionValueOfRxAccessInfo "" UBYTE Com_RxDataTimeoutSubstitutionValueOfRxAccessInfoType 0 0 0 255 ECU_ADDRESS 0x0 /end MEASUREMENT
/begin MEASUREMENT Com_RxAccessInfo[148].RxPduInfoIdxOfRxAccessInfo "" UBYTE NO_COMPU_METHOD 0 0 0 255 ECU_ADDRESS 0x0 /end MEASUREMENT
/begin MEASUREMENT Com_RxAccessInfo[148].RxSigBufferArrayBasedBufferEndIdxOfRxAccessInfo "" UBYTE Com_RxSigBufferArrayBasedBufferEndIdxOfRxAccessInfoType 0 0 0 255 ECU_ADDRESS 0x0 /end MEASUREMENT
/begin MEASUREMENT Com_RxAccessInfo[148].RxSigBufferArrayBasedBufferStartIdxOfRxAccessInfo "" UBYTE Com_RxSigBufferArrayBasedBufferStartIdxOfRxAccessInfoType 0 0 0 255 ECU_ADDRESS 0x0 /end MEASUREMENT
/begin MEASUREMENT Com_RxAccessInfo[148].RxSigBufferArrayBasedShdBufferEndIdxOfRxAccessInfo "" UBYTE Com_RxSigBufferArrayBasedShdBufferEndIdxOfRxAccessInfoType 0 0 0 255 ECU_ADDRESS 0x0 /end MEASUREMENT
/begin MEASUREMENT Com_RxAccessInfo[148].RxSigBufferArrayBasedShdBufferStartIdxOfRxAccessInfo "" UBYTE Com_RxSigBufferArrayBasedShdBufferStartIdxOfRxAccessInfoType 0 0 0 255 ECU_ADDRESS 0x0 /end MEASUREMENT
/begin MEASUREMENT Com_RxAccessInfo[148].RxTOutInfoIdxOfRxAccessInfo "" UBYTE Com_RxTOutInfoIdxOfRxAccessInfoType 0 0 0 255 ECU_ADDRESS 0x0 /end MEASUREMENT
/begin MEASUREMENT Com_RxAccessInfo[148].ShdBufferIdxOfRxAccessInfo "" UWORD Com_ShdBufferIdxOfRxAccessInfoType 0 0 0 65535 ECU_ADDRESS 0x0 /end MEASUREMENT
/begin MEASUREMENT Com_RxAccessInfo[148].SignalLengthInByteOfRxAccessInfo "" UBYTE NO_COMPU_METHOD 0 0 0 255 ECU_ADDRESS 0x0 /end MEASUREMENT
/begin MEASUREMENT Com_RxAccessInfo[148].StartByteInPduPositionOfRxAccessInfo "" UBYTE NO_COMPU_METHOD 0 0 0 255 ECU_ADDRESS 0x0 /end MEASUREMENT
/begin MEASUREMENT Com_RxAccessInfo[148].TmpBufferIdxOfRxAccessInfo "" UBYTE Com_TmpBufferIdxOfRxAccessInfoType 0 0 0 255 ECU_ADDRESS 0x0 /end MEASUREMENT
/begin MEASUREMENT Com_RxAccessInfo[148].TmpBufferOfRxAccessInfo "" UBYTE Com_TmpBufferOfRxAccessInfoType 0 0 0 255 ECU_ADDRESS 0x0 /end MEASUREMENT
/begin MEASUREMENT Com_RxAccessInfo[148].TmpRxShdBufferArrayBasedTmpBufferEndIdxOfRxAccessInfo "" UBYTE Com_TmpRxShdBufferArrayBasedTmpBufferEndIdxOfRxAccessInfoType 0 0 0 255 ECU_ADDRESS 0x0 /end MEASUREMENT
/begin MEASUREMENT Com_RxAccessInfo[148].TmpRxShdBufferArrayBasedTmpBufferStartIdxOfRxAccessInfo "" UBYTE Com_TmpRxShdBufferArrayBasedTmpBufferStartIdxOfRxAccessInfoType 0 0 0 255 ECU_ADDRESS 0x0 /end MEASUREMENT
/begin MEASUREMENT Com_RxAccessInfo[149].ApplTypeOfRxAccessInfo "" UBYTE Com_ApplTypeOfRxAccessInfoType 0 0 0 255 ECU_ADDRESS 0x0 /end MEASUREMENT
/begin MEASUREMENT Com_RxAccessInfo[149].BitLengthOfRxAccessInfo "" UWORD NO_COMPU_METHOD 0 0 0 65535 ECU_ADDRESS 0x0 /end MEASUREMENT
/begin MEASUREMENT Com_RxAccessInfo[149].BitPositionOfRxAccessInfo "" UWORD NO_COMPU_METHOD 0 0 0 65535 ECU_ADDRESS 0x0 /end MEASUREMENT
/begin MEASUREMENT Com_RxAccessInfo[149].BufferIdxOfRxAccessInfo "" UWORD Com_BufferIdxOfRxAccessInfoType 0 0 0 65535 ECU_ADDRESS 0x0 /end MEASUREMENT
/begin MEASUREMENT Com_RxAccessInfo[149].BusAccOfRxAccessInfo "" UBYTE Com_BusAccOfRxAccessInfoType 0 0 0 255 ECU_ADDRESS 0x0 /end MEASUREMENT
/begin MEASUREMENT Com_RxAccessInfo[149].ByteLengthOfRxAccessInfo "" UBYTE NO_COMPU_METHOD 0 0 0 255 ECU_ADDRESS 0x0 /end MEASUREMENT
/begin MEASUREMENT Com_RxAccessInfo[149].ConstValueArrayBasedInitValueEndIdxOfRxAccessInfo "" UBYTE Com_ConstValueArrayBasedInitValueEndIdxOfRxAccessInfoType 0 0 0 255 ECU_ADDRESS 0x0 /end MEASUREMENT
/begin MEASUREMENT Com_RxAccessInfo[149].ConstValueArrayBasedInitValueStartIdxOfRxAccessInfo "" UBYTE Com_ConstValueArrayBasedInitValueStartIdxOfRxAccessInfoType 0 0 0 255 ECU_ADDRESS 0x0 /end MEASUREMENT
/begin MEASUREMENT Com_RxAccessInfo[149].DynSignalOfRxAccessInfo "" UBYTE Com_DynSignalOfRxAccessInfoType 0 0 0 1 ECU_ADDRESS 0x0 /end MEASUREMENT
/begin MEASUREMENT Com_RxAccessInfo[149].InitValueIdxOfRxAccessInfo "" UBYTE Com_InitValueIdxOfRxAccessInfoType 0 0 0 255 ECU_ADDRESS 0x0 /end MEASUREMENT
/begin MEASUREMENT Com_RxAccessInfo[149].InitValueOfRxAccessInfo "" UBYTE Com_InitValueOfRxAccessInfoType 0 0 0 255 ECU_ADDRESS 0x0 /end MEASUREMENT
/begin MEASUREMENT Com_RxAccessInfo[149].InvValueIdxOfRxAccessInfo "" UBYTE Com_InvValueIdxOfRxAccessInfoType 0 0 0 255 ECU_ADDRESS 0x0 /end MEASUREMENT
/begin MEASUREMENT Com_RxAccessInfo[149].InvValueOfRxAccessInfo "" UBYTE Com_InvValueOfRxAccessInfoType 0 0 0 255 ECU_ADDRESS 0x0 /end MEASUREMENT
/begin MEASUREMENT Com_RxAccessInfo[149].IsGroupSignalOfRxAccessInfo "" UBYTE Com_IsGroupSignalOfRxAccessInfoType 0 0 0 1 ECU_ADDRESS 0x0 /end MEASUREMENT
/begin MEASUREMENT Com_RxAccessInfo[149].RxDataTimeoutSubstitutionValueIdxOfRxAccessInfo "" UBYTE Com_RxDataTimeoutSubstitutionValueIdxOfRxAccessInfoType 0 0 0 255 ECU_ADDRESS 0x0 /end MEASUREMENT
/begin MEASUREMENT Com_RxAccessInfo[149].RxDataTimeoutSubstitutionValueOfRxAccessInfo "" UBYTE Com_RxDataTimeoutSubstitutionValueOfRxAccessInfoType 0 0 0 255 ECU_ADDRESS 0x0 /end MEASUREMENT
/begin MEASUREMENT Com_RxAccessInfo[149].RxPduInfoIdxOfRxAccessInfo "" UBYTE NO_COMPU_METHOD 0 0 0 255 ECU_ADDRESS 0x0 /end MEASUREMENT
/begin MEASUREMENT Com_RxAccessInfo[149].RxSigBufferArrayBasedBufferEndIdxOfRxAccessInfo "" UBYTE Com_RxSigBufferArrayBasedBufferEndIdxOfRxAccessInfoType 0 0 0 255 ECU_ADDRESS 0x0 /end MEASUREMENT
/begin MEASUREMENT Com_RxAccessInfo[149].RxSigBufferArrayBasedBufferStartIdxOfRxAccessInfo "" UBYTE Com_RxSigBufferArrayBasedBufferStartIdxOfRxAccessInfoType 0 0 0 255 ECU_ADDRESS 0x0 /end MEASUREMENT
/begin MEASUREMENT Com_RxAccessInfo[149].RxSigBufferArrayBasedShdBufferEndIdxOfRxAccessInfo "" UBYTE Com_RxSigBufferArrayBasedShdBufferEndIdxOfRxAccessInfoType 0 0 0 255 ECU_ADDRESS 0x0 /end MEASUREMENT
/begin MEASUREMENT Com_RxAccessInfo[149].RxSigBufferArrayBasedShdBufferStartIdxOfRxAccessInfo "" UBYTE Com_RxSigBufferArrayBasedShdBufferStartIdxOfRxAccessInfoType 0 0 0 255 ECU_ADDRESS 0x0 /end MEASUREMENT
/begin MEASUREMENT Com_RxAccessInfo[149].RxTOutInfoIdxOfRxAccessInfo "" UBYTE Com_RxTOutInfoIdxOfRxAccessInfoType 0 0 0 255 ECU_ADDRESS 0x0 /end MEASUREMENT
/begin MEASUREMENT Com_RxAccessInfo[149].ShdBufferIdxOfRxAccessInfo "" UWORD Com_ShdBufferIdxOfRxAccessInfoType 0 0 0 65535 ECU_ADDRESS 0x0 /end MEASUREMENT
/begin MEASUREMENT Com_RxAccessInfo[149].SignalLengthInByteOfRxAccessInfo "" UBYTE NO_COMPU_METHOD 0 0 0 255 ECU_ADDRESS 0x0 /end MEASUREMENT
/begin MEASUREMENT Com_RxAccessInfo[149].StartByteInPduPositionOfRxAccessInfo "" UBYTE NO_COMPU_METHOD 0 0 0 255 ECU_ADDRESS 0x0 /end MEASUREMENT
/begin MEASUREMENT Com_RxAccessInfo[149].TmpBufferIdxOfRxAccessInfo "" UBYTE Com_TmpBufferIdxOfRxAccessInfoType 0 0 0 255 ECU_ADDRESS 0x0 /end MEASUREMENT
/begin MEASUREMENT Com_RxAccessInfo[149].TmpBufferOfRxAccessInfo "" UBYTE Com_TmpBufferOfRxAccessInfoType 0 0 0 255 ECU_ADDRESS 0x0 /end MEASUREMENT
/begin MEASUREMENT Com_RxAccessInfo[149].TmpRxShdBufferArrayBasedTmpBufferEndIdxOfRxAccessInfo "" UBYTE Com_TmpRxShdBufferArrayBasedTmpBufferEndIdxOfRxAccessInfoType 0 0 0 255 ECU_ADDRESS 0x0 /end MEASUREMENT
/begin MEASUREMENT Com_RxAccessInfo[149].TmpRxShdBufferArrayBasedTmpBufferStartIdxOfRxAccessInfo "" UBYTE Com_TmpRxShdBufferArrayBasedTmpBufferStartIdxOfRxAccessInfoType 0 0 0 255 ECU_ADDRESS 0x0 /end MEASUREMENT
/begin MEASUREMENT Com_RxAccessInfo[14].ApplTypeOfRxAccessInfo "" UBYTE Com_ApplTypeOfRxAccessInfoType 0 0 0 255 ECU_ADDRESS 0x0 /end MEASUREMENT
/begin MEASUREMENT Com_RxAccessInfo[14].BitLengthOfRxAccessInfo "" UWORD NO_COMPU_METHOD 0 0 0 65535 ECU_ADDRESS 0x0 /end MEASUREMENT
/begin MEASUREMENT Com_RxAccessInfo[14].BitPositionOfRxAccessInfo "" UWORD NO_COMPU_METHOD 0 0 0 65535 ECU_ADDRESS 0x0 /end MEASUREMENT
/begin MEASUREMENT Com_RxAccessInfo[14].BufferIdxOfRxAccessInfo "" UWORD Com_BufferIdxOfRxAccessInfoType 0 0 0 65535 ECU_ADDRESS 0x0 /end MEASUREMENT
/begin MEASUREMENT Com_RxAccessInfo[14].BusAccOfRxAccessInfo "" UBYTE Com_BusAccOfRxAccessInfoType 0 0 0 255 ECU_ADDRESS 0x0 /end MEASUREMENT
/begin MEASUREMENT Com_RxAccessInfo[14].ByteLengthOfRxAccessInfo "" UBYTE NO_COMPU_METHOD 0 0 0 255 ECU_ADDRESS 0x0 /end MEASUREMENT
/begin MEASUREMENT Com_RxAccessInfo[14].ConstValueArrayBasedInitValueEndIdxOfRxAccessInfo "" UBYTE Com_ConstValueArrayBasedInitValueEndIdxOfRxAccessInfoType 0 0 0 255 ECU_ADDRESS 0x0 /end MEASUREMENT
/begin MEASUREMENT Com_RxAccessInfo[14].ConstValueArrayBasedInitValueStartIdxOfRxAccessInfo "" UBYTE Com_ConstValueArrayBasedInitValueStartIdxOfRxAccessInfoType 0 0 0 255 ECU_ADDRESS 0x0 /end MEASUREMENT
/begin MEASUREMENT Com_RxAccessInfo[14].DynSignalOfRxAccessInfo "" UBYTE Com_DynSignalOfRxAccessInfoType 0 0 0 1 ECU_ADDRESS 0x0 /end MEASUREMENT
/begin MEASUREMENT Com_RxAccessInfo[14].InitValueIdxOfRxAccessInfo "" UBYTE Com_InitValueIdxOfRxAccessInfoType 0 0 0 255 ECU_ADDRESS 0x0 /end MEASUREMENT
/begin MEASUREMENT Com_RxAccessInfo[14].InitValueOfRxAccessInfo "" UBYTE Com_InitValueOfRxAccessInfoType 0 0 0 255 ECU_ADDRESS 0x0 /end MEASUREMENT
/begin MEASUREMENT Com_RxAccessInfo[14].InvValueIdxOfRxAccessInfo "" UBYTE Com_InvValueIdxOfRxAccessInfoType 0 0 0 255 ECU_ADDRESS 0x0 /end MEASUREMENT
/begin MEASUREMENT Com_RxAccessInfo[14].InvValueOfRxAccessInfo "" UBYTE Com_InvValueOfRxAccessInfoType 0 0 0 255 ECU_ADDRESS 0x0 /end MEASUREMENT
/begin MEASUREMENT Com_RxAccessInfo[14].IsGroupSignalOfRxAccessInfo "" UBYTE Com_IsGroupSignalOfRxAccessInfoType 0 0 0 1 ECU_ADDRESS 0x0 /end MEASUREMENT
/begin MEASUREMENT Com_RxAccessInfo[14].RxDataTimeoutSubstitutionValueIdxOfRxAccessInfo "" UBYTE Com_RxDataTimeoutSubstitutionValueIdxOfRxAccessInfoType 0 0 0 255 ECU_ADDRESS 0x0 /end MEASUREMENT
/begin MEASUREMENT Com_RxAccessInfo[14].RxDataTimeoutSubstitutionValueOfRxAccessInfo "" UBYTE Com_RxDataTimeoutSubstitutionValueOfRxAccessInfoType 0 0 0 255 ECU_ADDRESS 0x0 /end MEASUREMENT
/begin MEASUREMENT Com_RxAccessInfo[14].RxPduInfoIdxOfRxAccessInfo "" UBYTE NO_COMPU_METHOD 0 0 0 255 ECU_ADDRESS 0x0 /end MEASUREMENT
/begin MEASUREMENT Com_RxAccessInfo[14].RxSigBufferArrayBasedBufferEndIdxOfRxAccessInfo "" UBYTE Com_RxSigBufferArrayBasedBufferEndIdxOfRxAccessInfoType 0 0 0 255 ECU_ADDRESS 0x0 /end MEASUREMENT
/begin MEASUREMENT Com_RxAccessInfo[14].RxSigBufferArrayBasedBufferStartIdxOfRxAccessInfo "" UBYTE Com_RxSigBufferArrayBasedBufferStartIdxOfRxAccessInfoType 0 0 0 255 ECU_ADDRESS 0x0 /end MEASUREMENT
/begin MEASUREMENT Com_RxAccessInfo[14].RxSigBufferArrayBasedShdBufferEndIdxOfRxAccessInfo "" UBYTE Com_RxSigBufferArrayBasedShdBufferEndIdxOfRxAccessInfoType 0 0 0 255 ECU_ADDRESS 0x0 /end MEASUREMENT
/begin MEASUREMENT Com_RxAccessInfo[14].RxSigBufferArrayBasedShdBufferStartIdxOfRxAccessInfo "" UBYTE Com_RxSigBufferArrayBasedShdBufferStartIdxOfRxAccessInfoType 0 0 0 255 ECU_ADDRESS 0x0 /end MEASUREMENT
/begin MEASUREMENT Com_RxAccessInfo[14].RxTOutInfoIdxOfRxAccessInfo "" UBYTE Com_RxTOutInfoIdxOfRxAccessInfoType 0 0 0 255 ECU_ADDRESS 0x0 /end MEASUREMENT
/begin MEASUREMENT Com_RxAccessInfo[14].ShdBufferIdxOfRxAccessInfo "" UWORD Com_ShdBufferIdxOfRxAccessInfoType 0 0 0 65535 ECU_ADDRESS 0x0 /end MEASUREMENT
/begin MEASUREMENT Com_RxAccessInfo[14].SignalLengthInByteOfRxAccessInfo "" UBYTE NO_COMPU_METHOD 0 0 0 255 ECU_ADDRESS 0x0 /end MEASUREMENT
/begin MEASUREMENT Com_RxAccessInfo[14].StartByteInPduPositionOfRxAccessInfo "" UBYTE NO_COMPU_METHOD 0 0 0 255 ECU_ADDRESS 0x0 /end MEASUREMENT
/begin MEASUREMENT Com_RxAccessInfo[14].TmpBufferIdxOfRxAccessInfo "" UBYTE Com_TmpBufferIdxOfRxAccessInfoType 0 0 0 255 ECU_ADDRESS 0x0 /end MEASUREMENT
/begin MEASUREMENT Com_RxAccessInfo[14].TmpBufferOfRxAccessInfo "" UBYTE Com_TmpBufferOfRxAccessInfoType 0 0 0 255 ECU_ADDRESS 0x0 /end MEASUREMENT
/begin MEASUREMENT Com_RxAccessInfo[14].TmpRxShdBufferArrayBasedTmpBufferEndIdxOfRxAccessInfo "" UBYTE Com_TmpRxShdBufferArrayBasedTmpBufferEndIdxOfRxAccessInfoType 0 0 0 255 ECU_ADDRESS 0x0 /end MEASUREMENT
/begin MEASUREMENT Com_RxAccessInfo[14].TmpRxShdBufferArrayBasedTmpBufferStartIdxOfRxAccessInfo "" UBYTE Com_TmpRxShdBufferArrayBasedTmpBufferStartIdxOfRxAccessInfoType 0 0 0 255 ECU_ADDRESS 0x0 /end MEASUREMENT
/begin MEASUREMENT Com_RxAccessInfo[150].ApplTypeOfRxAccessInfo "" UBYTE Com_ApplTypeOfRxAccessInfoType 0 0 0 255 ECU_ADDRESS 0x0 /end MEASUREMENT
/begin MEASUREMENT Com_RxAccessInfo[150].BitLengthOfRxAccessInfo "" UWORD NO_COMPU_METHOD 0 0 0 65535 ECU_ADDRESS 0x0 /end MEASUREMENT
/begin MEASUREMENT Com_RxAccessInfo[150].BitPositionOfRxAccessInfo "" UWORD NO_COMPU_METHOD 0 0 0 65535 ECU_ADDRESS 0x0 /end MEASUREMENT
/begin MEASUREMENT Com_RxAccessInfo[150].BufferIdxOfRxAccessInfo "" UWORD Com_BufferIdxOfRxAccessInfoType 0 0 0 65535 ECU_ADDRESS 0x0 /end MEASUREMENT
/begin MEASUREMENT Com_RxAccessInfo[150].BusAccOfRxAccessInfo "" UBYTE Com_BusAccOfRxAccessInfoType 0 0 0 255 ECU_ADDRESS 0x0 /end MEASUREMENT
/begin MEASUREMENT Com_RxAccessInfo[150].ByteLengthOfRxAccessInfo "" UBYTE NO_COMPU_METHOD 0 0 0 255 ECU_ADDRESS 0x0 /end MEASUREMENT
/begin MEASUREMENT Com_RxAccessInfo[150].ConstValueArrayBasedInitValueEndIdxOfRxAccessInfo "" UBYTE Com_ConstValueArrayBasedInitValueEndIdxOfRxAccessInfoType 0 0 0 255 ECU_ADDRESS 0x0 /end MEASUREMENT
/begin MEASUREMENT Com_RxAccessInfo[150].ConstValueArrayBasedInitValueStartIdxOfRxAccessInfo "" UBYTE Com_ConstValueArrayBasedInitValueStartIdxOfRxAccessInfoType 0 0 0 255 ECU_ADDRESS 0x0 /end MEASUREMENT
/begin MEASUREMENT Com_RxAccessInfo[150].DynSignalOfRxAccessInfo "" UBYTE Com_DynSignalOfRxAccessInfoType 0 0 0 1 ECU_ADDRESS 0x0 /end MEASUREMENT
/begin MEASUREMENT Com_RxAccessInfo[150].InitValueIdxOfRxAccessInfo "" UBYTE Com_InitValueIdxOfRxAccessInfoType 0 0 0 255 ECU_ADDRESS 0x0 /end MEASUREMENT
/begin MEASUREMENT Com_RxAccessInfo[150].InitValueOfRxAccessInfo "" UBYTE Com_InitValueOfRxAccessInfoType 0 0 0 255 ECU_ADDRESS 0x0 /end MEASUREMENT
/begin MEASUREMENT Com_RxAccessInfo[150].InvValueIdxOfRxAccessInfo "" UBYTE Com_InvValueIdxOfRxAccessInfoType 0 0 0 255 ECU_ADDRESS 0x0 /end MEASUREMENT
/begin MEASUREMENT Com_RxAccessInfo[150].InvValueOfRxAccessInfo "" UBYTE Com_InvValueOfRxAccessInfoType 0 0 0 255 ECU_ADDRESS 0x0 /end MEASUREMENT
/begin MEASUREMENT Com_RxAccessInfo[150].IsGroupSignalOfRxAccessInfo "" UBYTE Com_IsGroupSignalOfRxAccessInfoType 0 0 0 1 ECU_ADDRESS 0x0 /end MEASUREMENT
/begin MEASUREMENT Com_RxAccessInfo[150].RxDataTimeoutSubstitutionValueIdxOfRxAccessInfo "" UBYTE Com_RxDataTimeoutSubstitutionValueIdxOfRxAccessInfoType 0 0 0 255 ECU_ADDRESS 0x0 /end MEASUREMENT
/begin MEASUREMENT Com_RxAccessInfo[150].RxDataTimeoutSubstitutionValueOfRxAccessInfo "" UBYTE Com_RxDataTimeoutSubstitutionValueOfRxAccessInfoType 0 0 0 255 ECU_ADDRESS 0x0 /end MEASUREMENT
/begin MEASUREMENT Com_RxAccessInfo[150].RxPduInfoIdxOfRxAccessInfo "" UBYTE NO_COMPU_METHOD 0 0 0 255 ECU_ADDRESS 0x0 /end MEASUREMENT
/begin MEASUREMENT Com_RxAccessInfo[150].RxSigBufferArrayBasedBufferEndIdxOfRxAccessInfo "" UBYTE Com_RxSigBufferArrayBasedBufferEndIdxOfRxAccessInfoType 0 0 0 255 ECU_ADDRESS 0x0 /end MEASUREMENT
/begin MEASUREMENT Com_RxAccessInfo[150].RxSigBufferArrayBasedBufferStartIdxOfRxAccessInfo "" UBYTE Com_RxSigBufferArrayBasedBufferStartIdxOfRxAccessInfoType 0 0 0 255 ECU_ADDRESS 0x0 /end MEASUREMENT
/begin MEASUREMENT Com_RxAccessInfo[150].RxSigBufferArrayBasedShdBufferEndIdxOfRxAccessInfo "" UBYTE Com_RxSigBufferArrayBasedShdBufferEndIdxOfRxAccessInfoType 0 0 0 255 ECU_ADDRESS 0x0 /end MEASUREMENT
/begin MEASUREMENT Com_RxAccessInfo[150].RxSigBufferArrayBasedShdBufferStartIdxOfRxAccessInfo "" UBYTE Com_RxSigBufferArrayBasedShdBufferStartIdxOfRxAccessInfoType 0 0 0 255 ECU_ADDRESS 0x0 /end MEASUREMENT
/begin MEASUREMENT Com_RxAccessInfo[150].RxTOutInfoIdxOfRxAccessInfo "" UBYTE Com_RxTOutInfoIdxOfRxAccessInfoType 0 0 0 255 ECU_ADDRESS 0x0 /end MEASUREMENT
/begin MEASUREMENT Com_RxAccessInfo[150].ShdBufferIdxOfRxAccessInfo "" UWORD Com_ShdBufferIdxOfRxAccessInfoType 0 0 0 65535 ECU_ADDRESS 0x0 /end MEASUREMENT
/begin MEASUREMENT Com_RxAccessInfo[150].SignalLengthInByteOfRxAccessInfo "" UBYTE NO_COMPU_METHOD 0 0 0 255 ECU_ADDRESS 0x0 /end MEASUREMENT
/begin MEASUREMENT Com_RxAccessInfo[150].StartByteInPduPositionOfRxAccessInfo "" UBYTE NO_COMPU_METHOD 0 0 0 255 ECU_ADDRESS 0x0 /end MEASUREMENT
/begin MEASUREMENT Com_RxAccessInfo[150].TmpBufferIdxOfRxAccessInfo "" UBYTE Com_TmpBufferIdxOfRxAccessInfoType 0 0 0 255 ECU_ADDRESS 0x0 /end MEASUREMENT
/begin MEASUREMENT Com_RxAccessInfo[150].TmpBufferOfRxAccessInfo "" UBYTE Com_TmpBufferOfRxAccessInfoType 0 0 0 255 ECU_ADDRESS 0x0 /end MEASUREMENT
/begin MEASUREMENT Com_RxAccessInfo[150].TmpRxShdBufferArrayBasedTmpBufferEndIdxOfRxAccessInfo "" UBYTE Com_TmpRxShdBufferArrayBasedTmpBufferEndIdxOfRxAccessInfoType 0 0 0 255 ECU_ADDRESS 0x0 /end MEASUREMENT
/begin MEASUREMENT Com_RxAccessInfo[150].TmpRxShdBufferArrayBasedTmpBufferStartIdxOfRxAccessInfo "" UBYTE Com_TmpRxShdBufferArrayBasedTmpBufferStartIdxOfRxAccessInfoType 0 0 0 255 ECU_ADDRESS 0x0 /end MEASUREMENT
/begin MEASUREMENT Com_RxAccessInfo[151].ApplTypeOfRxAccessInfo "" UBYTE Com_ApplTypeOfRxAccessInfoType 0 0 0 255 ECU_ADDRESS 0x0 /end MEASUREMENT
/begin MEASUREMENT Com_RxAccessInfo[151].BitLengthOfRxAccessInfo "" UWORD NO_COMPU_METHOD 0 0 0 65535 ECU_ADDRESS 0x0 /end MEASUREMENT
/begin MEASUREMENT Com_RxAccessInfo[151].BitPositionOfRxAccessInfo "" UWORD NO_COMPU_METHOD 0 0 0 65535 ECU_ADDRESS 0x0 /end MEASUREMENT
/begin MEASUREMENT Com_RxAccessInfo[151].BufferIdxOfRxAccessInfo "" UWORD Com_BufferIdxOfRxAccessInfoType 0 0 0 65535 ECU_ADDRESS 0x0 /end MEASUREMENT
/begin MEASUREMENT Com_RxAccessInfo[151].BusAccOfRxAccessInfo "" UBYTE Com_BusAccOfRxAccessInfoType 0 0 0 255 ECU_ADDRESS 0x0 /end MEASUREMENT
/begin MEASUREMENT Com_RxAccessInfo[151].ByteLengthOfRxAccessInfo "" UBYTE NO_COMPU_METHOD 0 0 0 255 ECU_ADDRESS 0x0 /end MEASUREMENT
/begin MEASUREMENT Com_RxAccessInfo[151].ConstValueArrayBasedInitValueEndIdxOfRxAccessInfo "" UBYTE Com_ConstValueArrayBasedInitValueEndIdxOfRxAccessInfoType 0 0 0 255 ECU_ADDRESS 0x0 /end MEASUREMENT
/begin MEASUREMENT Com_RxAccessInfo[151].ConstValueArrayBasedInitValueStartIdxOfRxAccessInfo "" UBYTE Com_ConstValueArrayBasedInitValueStartIdxOfRxAccessInfoType 0 0 0 255 ECU_ADDRESS 0x0 /end MEASUREMENT
/begin MEASUREMENT Com_RxAccessInfo[151].DynSignalOfRxAccessInfo "" UBYTE Com_DynSignalOfRxAccessInfoType 0 0 0 1 ECU_ADDRESS 0x0 /end MEASUREMENT
/begin MEASUREMENT Com_RxAccessInfo[151].InitValueIdxOfRxAccessInfo "" UBYTE Com_InitValueIdxOfRxAccessInfoType 0 0 0 255 ECU_ADDRESS 0x0 /end MEASUREMENT
/begin MEASUREMENT Com_RxAccessInfo[151].InitValueOfRxAccessInfo "" UBYTE Com_InitValueOfRxAccessInfoType 0 0 0 255 ECU_ADDRESS 0x0 /end MEASUREMENT
/begin MEASUREMENT Com_RxAccessInfo[151].InvValueIdxOfRxAccessInfo "" UBYTE Com_InvValueIdxOfRxAccessInfoType 0 0 0 255 ECU_ADDRESS 0x0 /end MEASUREMENT
/begin MEASUREMENT Com_RxAccessInfo[151].InvValueOfRxAccessInfo "" UBYTE Com_InvValueOfRxAccessInfoType 0 0 0 255 ECU_ADDRESS 0x0 /end MEASUREMENT
/begin MEASUREMENT Com_RxAccessInfo[151].IsGroupSignalOfRxAccessInfo "" UBYTE Com_IsGroupSignalOfRxAccessInfoType 0 0 0 1 ECU_ADDRESS 0x0 /end MEASUREMENT
/begin MEASUREMENT Com_RxAccessInfo[151].RxDataTimeoutSubstitutionValueIdxOfRxAccessInfo "" UBYTE Com_RxDataTimeoutSubstitutionValueIdxOfRxAccessInfoType 0 0 0 255 ECU_ADDRESS 0x0 /end MEASUREMENT
/begin MEASUREMENT Com_RxAccessInfo[151].RxDataTimeoutSubstitutionValueOfRxAccessInfo "" UBYTE Com_RxDataTimeoutSubstitutionValueOfRxAccessInfoType 0 0 0 255 ECU_ADDRESS 0x0 /end MEASUREMENT
/begin MEASUREMENT Com_RxAccessInfo[151].RxPduInfoIdxOfRxAccessInfo "" UBYTE NO_COMPU_METHOD 0 0 0 255 ECU_ADDRESS 0x0 /end MEASUREMENT
/begin MEASUREMENT Com_RxAccessInfo[151].RxSigBufferArrayBasedBufferEndIdxOfRxAccessInfo "" UBYTE Com_RxSigBufferArrayBasedBufferEndIdxOfRxAccessInfoType 0 0 0 255 ECU_ADDRESS 0x0 /end MEASUREMENT
/begin MEASUREMENT Com_RxAccessInfo[151].RxSigBufferArrayBasedBufferStartIdxOfRxAccessInfo "" UBYTE Com_RxSigBufferArrayBasedBufferStartIdxOfRxAccessInfoType 0 0 0 255 ECU_ADDRESS 0x0 /end MEASUREMENT
/begin MEASUREMENT Com_RxAccessInfo[151].RxSigBufferArrayBasedShdBufferEndIdxOfRxAccessInfo "" UBYTE Com_RxSigBufferArrayBasedShdBufferEndIdxOfRxAccessInfoType 0 0 0 255 ECU_ADDRESS 0x0 /end MEASUREMENT
/begin MEASUREMENT Com_RxAccessInfo[151].RxSigBufferArrayBasedShdBufferStartIdxOfRxAccessInfo "" UBYTE Com_RxSigBufferArrayBasedShdBufferStartIdxOfRxAccessInfoType 0 0 0 255 ECU_ADDRESS 0x0 /end MEASUREMENT
/begin MEASUREMENT Com_RxAccessInfo[151].RxTOutInfoIdxOfRxAccessInfo "" UBYTE Com_RxTOutInfoIdxOfRxAccessInfoType 0 0 0 255 ECU_ADDRESS 0x0 /end MEASUREMENT
/begin MEASUREMENT Com_RxAccessInfo[151].ShdBufferIdxOfRxAccessInfo "" UWORD Com_ShdBufferIdxOfRxAccessInfoType 0 0 0 65535 ECU_ADDRESS 0x0 /end MEASUREMENT
/begin MEASUREMENT Com_RxAccessInfo[151].SignalLengthInByteOfRxAccessInfo "" UBYTE NO_COMPU_METHOD 0 0 0 255 ECU_ADDRESS 0x0 /end MEASUREMENT
/begin MEASUREMENT Com_RxAccessInfo[151].StartByteInPduPositionOfRxAccessInfo "" UBYTE NO_COMPU_METHOD 0 0 0 255 ECU_ADDRESS 0x0 /end MEASUREMENT
/begin MEASUREMENT Com_RxAccessInfo[151].TmpBufferIdxOfRxAccessInfo "" UBYTE Com_TmpBufferIdxOfRxAccessInfoType 0 0 0 255 ECU_ADDRESS 0x0 /end MEASUREMENT
/begin MEASUREMENT Com_RxAccessInfo[151].TmpBufferOfRxAccessInfo "" UBYTE Com_TmpBufferOfRxAccessInfoType 0 0 0 255 ECU_ADDRESS 0x0 /end MEASUREMENT
/begin MEASUREMENT Com_RxAccessInfo[151].TmpRxShdBufferArrayBasedTmpBufferEndIdxOfRxAccessInfo "" UBYTE Com_TmpRxShdBufferArrayBasedTmpBufferEndIdxOfRxAccessInfoType 0 0 0 255 ECU_ADDRESS 0x0 /end MEASUREMENT
/begin MEASUREMENT Com_RxAccessInfo[151].TmpRxShdBufferArrayBasedTmpBufferStartIdxOfRxAccessInfo "" UBYTE Com_TmpRxShdBufferArrayBasedTmpBufferStartIdxOfRxAccessInfoType 0 0 0 255 ECU_ADDRESS 0x0 /end MEASUREMENT
/begin MEASUREMENT Com_RxAccessInfo[152].ApplTypeOfRxAccessInfo "" UBYTE Com_ApplTypeOfRxAccessInfoType 0 0 0 255 ECU_ADDRESS 0x0 /end MEASUREMENT
/begin MEASUREMENT Com_RxAccessInfo[152].BitLengthOfRxAccessInfo "" UWORD NO_COMPU_METHOD 0 0 0 65535 ECU_ADDRESS 0x0 /end MEASUREMENT
/begin MEASUREMENT Com_RxAccessInfo[152].BitPositionOfRxAccessInfo "" UWORD NO_COMPU_METHOD 0 0 0 65535 ECU_ADDRESS 0x0 /end MEASUREMENT
/begin MEASUREMENT Com_RxAccessInfo[152].BufferIdxOfRxAccessInfo "" UWORD Com_BufferIdxOfRxAccessInfoType 0 0 0 65535 ECU_ADDRESS 0x0 /end MEASUREMENT
/begin MEASUREMENT Com_RxAccessInfo[152].BusAccOfRxAccessInfo "" UBYTE Com_BusAccOfRxAccessInfoType 0 0 0 255 ECU_ADDRESS 0x0 /end MEASUREMENT
/begin MEASUREMENT Com_RxAccessInfo[152].ByteLengthOfRxAccessInfo "" UBYTE NO_COMPU_METHOD 0 0 0 255 ECU_ADDRESS 0x0 /end MEASUREMENT
/begin MEASUREMENT Com_RxAccessInfo[152].ConstValueArrayBasedInitValueEndIdxOfRxAccessInfo "" UBYTE Com_ConstValueArrayBasedInitValueEndIdxOfRxAccessInfoType 0 0 0 255 ECU_ADDRESS 0x0 /end MEASUREMENT
/begin MEASUREMENT Com_RxAccessInfo[152].ConstValueArrayBasedInitValueStartIdxOfRxAccessInfo "" UBYTE Com_ConstValueArrayBasedInitValueStartIdxOfRxAccessInfoType 0 0 0 255 ECU_ADDRESS 0x0 /end MEASUREMENT
/begin MEASUREMENT Com_RxAccessInfo[152].DynSignalOfRxAccessInfo "" UBYTE Com_DynSignalOfRxAccessInfoType 0 0 0 1 ECU_ADDRESS 0x0 /end MEASUREMENT
/begin MEASUREMENT Com_RxAccessInfo[152].InitValueIdxOfRxAccessInfo "" UBYTE Com_InitValueIdxOfRxAccessInfoType 0 0 0 255 ECU_ADDRESS 0x0 /end MEASUREMENT
/begin MEASUREMENT Com_RxAccessInfo[152].InitValueOfRxAccessInfo "" UBYTE Com_InitValueOfRxAccessInfoType 0 0 0 255 ECU_ADDRESS 0x0 /end MEASUREMENT
/begin MEASUREMENT Com_RxAccessInfo[152].InvValueIdxOfRxAccessInfo "" UBYTE Com_InvValueIdxOfRxAccessInfoType 0 0 0 255 ECU_ADDRESS 0x0 /end MEASUREMENT
/begin MEASUREMENT Com_RxAccessInfo[152].InvValueOfRxAccessInfo "" UBYTE Com_InvValueOfRxAccessInfoType 0 0 0 255 ECU_ADDRESS 0x0 /end MEASUREMENT
/begin MEASUREMENT Com_RxAccessInfo[152].IsGroupSignalOfRxAccessInfo "" UBYTE Com_IsGroupSignalOfRxAccessInfoType 0 0 0 1 ECU_ADDRESS 0x0 /end MEASUREMENT
/begin MEASUREMENT Com_RxAccessInfo[152].RxDataTimeoutSubstitutionValueIdxOfRxAccessInfo "" UBYTE Com_RxDataTimeoutSubstitutionValueIdxOfRxAccessInfoType 0 0 0 255 ECU_ADDRESS 0x0 /end MEASUREMENT
/begin MEASUREMENT Com_RxAccessInfo[152].RxDataTimeoutSubstitutionValueOfRxAccessInfo "" UBYTE Com_RxDataTimeoutSubstitutionValueOfRxAccessInfoType 0 0 0 255 ECU_ADDRESS 0x0 /end MEASUREMENT
/begin MEASUREMENT Com_RxAccessInfo[152].RxPduInfoIdxOfRxAccessInfo "" UBYTE NO_COMPU_METHOD 0 0 0 255 ECU_ADDRESS 0x0 /end MEASUREMENT
/begin MEASUREMENT Com_RxAccessInfo[152].RxSigBufferArrayBasedBufferEndIdxOfRxAccessInfo "" UBYTE Com_RxSigBufferArrayBasedBufferEndIdxOfRxAccessInfoType 0 0 0 255 ECU_ADDRESS 0x0 /end MEASUREMENT
/begin MEASUREMENT Com_RxAccessInfo[152].RxSigBufferArrayBasedBufferStartIdxOfRxAccessInfo "" UBYTE Com_RxSigBufferArrayBasedBufferStartIdxOfRxAccessInfoType 0 0 0 255 ECU_ADDRESS 0x0 /end MEASUREMENT
/begin MEASUREMENT Com_RxAccessInfo[152].RxSigBufferArrayBasedShdBufferEndIdxOfRxAccessInfo "" UBYTE Com_RxSigBufferArrayBasedShdBufferEndIdxOfRxAccessInfoType 0 0 0 255 ECU_ADDRESS 0x0 /end MEASUREMENT
/begin MEASUREMENT Com_RxAccessInfo[152].RxSigBufferArrayBasedShdBufferStartIdxOfRxAccessInfo "" UBYTE Com_RxSigBufferArrayBasedShdBufferStartIdxOfRxAccessInfoType 0 0 0 255 ECU_ADDRESS 0x0 /end MEASUREMENT
/begin MEASUREMENT Com_RxAccessInfo[152].RxTOutInfoIdxOfRxAccessInfo "" UBYTE Com_RxTOutInfoIdxOfRxAccessInfoType 0 0 0 255 ECU_ADDRESS 0x0 /end MEASUREMENT
/begin MEASUREMENT Com_RxAccessInfo[152].ShdBufferIdxOfRxAccessInfo "" UWORD Com_ShdBufferIdxOfRxAccessInfoType 0 0 0 65535 ECU_ADDRESS 0x0 /end MEASUREMENT
/begin MEASUREMENT Com_RxAccessInfo[152].SignalLengthInByteOfRxAccessInfo "" UBYTE NO_COMPU_METHOD 0 0 0 255 ECU_ADDRESS 0x0 /end MEASUREMENT
/begin MEASUREMENT Com_RxAccessInfo[152].StartByteInPduPositionOfRxAccessInfo "" UBYTE NO_COMPU_METHOD 0 0 0 255 ECU_ADDRESS 0x0 /end MEASUREMENT
/begin MEASUREMENT Com_RxAccessInfo[152].TmpBufferIdxOfRxAccessInfo "" UBYTE Com_TmpBufferIdxOfRxAccessInfoType 0 0 0 255 ECU_ADDRESS 0x0 /end MEASUREMENT
/begin MEASUREMENT Com_RxAccessInfo[152].TmpBufferOfRxAccessInfo "" UBYTE Com_TmpBufferOfRxAccessInfoType 0 0 0 255 ECU_ADDRESS 0x0 /end MEASUREMENT
/begin MEASUREMENT Com_RxAccessInfo[152].TmpRxShdBufferArrayBasedTmpBufferEndIdxOfRxAccessInfo "" UBYTE Com_TmpRxShdBufferArrayBasedTmpBufferEndIdxOfRxAccessInfoType 0 0 0 255 ECU_ADDRESS 0x0 /end MEASUREMENT
/begin MEASUREMENT Com_RxAccessInfo[152].TmpRxShdBufferArrayBasedTmpBufferStartIdxOfRxAccessInfo "" UBYTE Com_TmpRxShdBufferArrayBasedTmpBufferStartIdxOfRxAccessInfoType 0 0 0 255 ECU_ADDRESS 0x0 /end MEASUREMENT
/begin MEASUREMENT Com_RxAccessInfo[153].ApplTypeOfRxAccessInfo "" UBYTE Com_ApplTypeOfRxAccessInfoType 0 0 0 255 ECU_ADDRESS 0x0 /end MEASUREMENT
/begin MEASUREMENT Com_RxAccessInfo[153].BitLengthOfRxAccessInfo "" UWORD NO_COMPU_METHOD 0 0 0 65535 ECU_ADDRESS 0x0 /end MEASUREMENT
/begin MEASUREMENT Com_RxAccessInfo[153].BitPositionOfRxAccessInfo "" UWORD NO_COMPU_METHOD 0 0 0 65535 ECU_ADDRESS 0x0 /end MEASUREMENT
/begin MEASUREMENT Com_RxAccessInfo[153].BufferIdxOfRxAccessInfo "" UWORD Com_BufferIdxOfRxAccessInfoType 0 0 0 65535 ECU_ADDRESS 0x0 /end MEASUREMENT
/begin MEASUREMENT Com_RxAccessInfo[153].BusAccOfRxAccessInfo "" UBYTE Com_BusAccOfRxAccessInfoType 0 0 0 255 ECU_ADDRESS 0x0 /end MEASUREMENT
/begin MEASUREMENT Com_RxAccessInfo[153].ByteLengthOfRxAccessInfo "" UBYTE NO_COMPU_METHOD 0 0 0 255 ECU_ADDRESS 0x0 /end MEASUREMENT
/begin MEASUREMENT Com_RxAccessInfo[153].ConstValueArrayBasedInitValueEndIdxOfRxAccessInfo "" UBYTE Com_ConstValueArrayBasedInitValueEndIdxOfRxAccessInfoType 0 0 0 255 ECU_ADDRESS 0x0 /end MEASUREMENT
/begin MEASUREMENT Com_RxAccessInfo[153].ConstValueArrayBasedInitValueStartIdxOfRxAccessInfo "" UBYTE Com_ConstValueArrayBasedInitValueStartIdxOfRxAccessInfoType 0 0 0 255 ECU_ADDRESS 0x0 /end MEASUREMENT
/begin MEASUREMENT Com_RxAccessInfo[153].DynSignalOfRxAccessInfo "" UBYTE Com_DynSignalOfRxAccessInfoType 0 0 0 1 ECU_ADDRESS 0x0 /end MEASUREMENT
/begin MEASUREMENT Com_RxAccessInfo[153].InitValueIdxOfRxAccessInfo "" UBYTE Com_InitValueIdxOfRxAccessInfoType 0 0 0 255 ECU_ADDRESS 0x0 /end MEASUREMENT
/begin MEASUREMENT Com_RxAccessInfo[153].InitValueOfRxAccessInfo "" UBYTE Com_InitValueOfRxAccessInfoType 0 0 0 255 ECU_ADDRESS 0x0 /end MEASUREMENT
/begin MEASUREMENT Com_RxAccessInfo[153].InvValueIdxOfRxAccessInfo "" UBYTE Com_InvValueIdxOfRxAccessInfoType 0 0 0 255 ECU_ADDRESS 0x0 /end MEASUREMENT
/begin MEASUREMENT Com_RxAccessInfo[153].InvValueOfRxAccessInfo "" UBYTE Com_InvValueOfRxAccessInfoType 0 0 0 255 ECU_ADDRESS 0x0 /end MEASUREMENT
/begin MEASUREMENT Com_RxAccessInfo[153].IsGroupSignalOfRxAccessInfo "" UBYTE Com_IsGroupSignalOfRxAccessInfoType 0 0 0 1 ECU_ADDRESS 0x0 /end MEASUREMENT
/begin MEASUREMENT Com_RxAccessInfo[153].RxDataTimeoutSubstitutionValueIdxOfRxAccessInfo "" UBYTE Com_RxDataTimeoutSubstitutionValueIdxOfRxAccessInfoType 0 0 0 255 ECU_ADDRESS 0x0 /end MEASUREMENT
/begin MEASUREMENT Com_RxAccessInfo[153].RxDataTimeoutSubstitutionValueOfRxAccessInfo "" UBYTE Com_RxDataTimeoutSubstitutionValueOfRxAccessInfoType 0 0 0 255 ECU_ADDRESS 0x0 /end MEASUREMENT
/begin MEASUREMENT Com_RxAccessInfo[153].RxPduInfoIdxOfRxAccessInfo "" UBYTE NO_COMPU_METHOD 0 0 0 255 ECU_ADDRESS 0x0 /end MEASUREMENT
/begin MEASUREMENT Com_RxAccessInfo[153].RxSigBufferArrayBasedBufferEndIdxOfRxAccessInfo "" UBYTE Com_RxSigBufferArrayBasedBufferEndIdxOfRxAccessInfoType 0 0 0 255 ECU_ADDRESS 0x0 /end MEASUREMENT
/begin MEASUREMENT Com_RxAccessInfo[153].RxSigBufferArrayBasedBufferStartIdxOfRxAccessInfo "" UBYTE Com_RxSigBufferArrayBasedBufferStartIdxOfRxAccessInfoType 0 0 0 255 ECU_ADDRESS 0x0 /end MEASUREMENT
/begin MEASUREMENT Com_RxAccessInfo[153].RxSigBufferArrayBasedShdBufferEndIdxOfRxAccessInfo "" UBYTE Com_RxSigBufferArrayBasedShdBufferEndIdxOfRxAccessInfoType 0 0 0 255 ECU_ADDRESS 0x0 /end MEASUREMENT
/begin MEASUREMENT Com_RxAccessInfo[153].RxSigBufferArrayBasedShdBufferStartIdxOfRxAccessInfo "" UBYTE Com_RxSigBufferArrayBasedShdBufferStartIdxOfRxAccessInfoType 0 0 0 255 ECU_ADDRESS 0x0 /end MEASUREMENT
/begin MEASUREMENT Com_RxAccessInfo[153].RxTOutInfoIdxOfRxAccessInfo "" UBYTE Com_RxTOutInfoIdxOfRxAccessInfoType 0 0 0 255 ECU_ADDRESS 0x0 /end MEASUREMENT
/begin MEASUREMENT Com_RxAccessInfo[153].ShdBufferIdxOfRxAccessInfo "" UWORD Com_ShdBufferIdxOfRxAccessInfoType 0 0 0 65535 ECU_ADDRESS 0x0 /end MEASUREMENT
/begin MEASUREMENT Com_RxAccessInfo[153].SignalLengthInByteOfRxAccessInfo "" UBYTE NO_COMPU_METHOD 0 0 0 255 ECU_ADDRESS 0x0 /end MEASUREMENT
/begin MEASUREMENT Com_RxAccessInfo[153].StartByteInPduPositionOfRxAccessInfo "" UBYTE NO_COMPU_METHOD 0 0 0 255 ECU_ADDRESS 0x0 /end MEASUREMENT
/begin MEASUREMENT Com_RxAccessInfo[153].TmpBufferIdxOfRxAccessInfo "" UBYTE Com_TmpBufferIdxOfRxAccessInfoType 0 0 0 255 ECU_ADDRESS 0x0 /end MEASUREMENT
/begin MEASUREMENT Com_RxAccessInfo[153].TmpBufferOfRxAccessInfo "" UBYTE Com_TmpBufferOfRxAccessInfoType 0 0 0 255 ECU_ADDRESS 0x0 /end MEASUREMENT
/begin MEASUREMENT Com_RxAccessInfo[153].TmpRxShdBufferArrayBasedTmpBufferEndIdxOfRxAccessInfo "" UBYTE Com_TmpRxShdBufferArrayBasedTmpBufferEndIdxOfRxAccessInfoType 0 0 0 255 ECU_ADDRESS 0x0 /end MEASUREMENT
/begin MEASUREMENT Com_RxAccessInfo[153].TmpRxShdBufferArrayBasedTmpBufferStartIdxOfRxAccessInfo "" UBYTE Com_TmpRxShdBufferArrayBasedTmpBufferStartIdxOfRxAccessInfoType 0 0 0 255 ECU_ADDRESS 0x0 /end MEASUREMENT
/begin MEASUREMENT Com_RxAccessInfo[154].ApplTypeOfRxAccessInfo "" UBYTE Com_ApplTypeOfRxAccessInfoType 0 0 0 255 ECU_ADDRESS 0x0 /end MEASUREMENT
/begin MEASUREMENT Com_RxAccessInfo[154].BitLengthOfRxAccessInfo "" UWORD NO_COMPU_METHOD 0 0 0 65535 ECU_ADDRESS 0x0 /end MEASUREMENT
/begin MEASUREMENT Com_RxAccessInfo[154].BitPositionOfRxAccessInfo "" UWORD NO_COMPU_METHOD 0 0 0 65535 ECU_ADDRESS 0x0 /end MEASUREMENT
/begin MEASUREMENT Com_RxAccessInfo[154].BufferIdxOfRxAccessInfo "" UWORD Com_BufferIdxOfRxAccessInfoType 0 0 0 65535 ECU_ADDRESS 0x0 /end MEASUREMENT
/begin MEASUREMENT Com_RxAccessInfo[154].BusAccOfRxAccessInfo "" UBYTE Com_BusAccOfRxAccessInfoType 0 0 0 255 ECU_ADDRESS 0x0 /end MEASUREMENT
/begin MEASUREMENT Com_RxAccessInfo[154].ByteLengthOfRxAccessInfo "" UBYTE NO_COMPU_METHOD 0 0 0 255 ECU_ADDRESS 0x0 /end MEASUREMENT
/begin MEASUREMENT Com_RxAccessInfo[154].ConstValueArrayBasedInitValueEndIdxOfRxAccessInfo "" UBYTE Com_ConstValueArrayBasedInitValueEndIdxOfRxAccessInfoType 0 0 0 255 ECU_ADDRESS 0x0 /end MEASUREMENT
/begin MEASUREMENT Com_RxAccessInfo[154].ConstValueArrayBasedInitValueStartIdxOfRxAccessInfo "" UBYTE Com_ConstValueArrayBasedInitValueStartIdxOfRxAccessInfoType 0 0 0 255 ECU_ADDRESS 0x0 /end MEASUREMENT
/begin MEASUREMENT Com_RxAccessInfo[154].DynSignalOfRxAccessInfo "" UBYTE Com_DynSignalOfRxAccessInfoType 0 0 0 1 ECU_ADDRESS 0x0 /end MEASUREMENT
/begin MEASUREMENT Com_RxAccessInfo[154].InitValueIdxOfRxAccessInfo "" UBYTE Com_InitValueIdxOfRxAccessInfoType 0 0 0 255 ECU_ADDRESS 0x0 /end MEASUREMENT
/begin MEASUREMENT Com_RxAccessInfo[154].InitValueOfRxAccessInfo "" UBYTE Com_InitValueOfRxAccessInfoType 0 0 0 255 ECU_ADDRESS 0x0 /end MEASUREMENT
/begin MEASUREMENT Com_RxAccessInfo[154].InvValueIdxOfRxAccessInfo "" UBYTE Com_InvValueIdxOfRxAccessInfoType 0 0 0 255 ECU_ADDRESS 0x0 /end MEASUREMENT
/begin MEASUREMENT Com_RxAccessInfo[154].InvValueOfRxAccessInfo "" UBYTE Com_InvValueOfRxAccessInfoType 0 0 0 255 ECU_ADDRESS 0x0 /end MEASUREMENT
/begin MEASUREMENT Com_RxAccessInfo[154].IsGroupSignalOfRxAccessInfo "" UBYTE Com_IsGroupSignalOfRxAccessInfoType 0 0 0 1 ECU_ADDRESS 0x0 /end MEASUREMENT
/begin MEASUREMENT Com_RxAccessInfo[154].RxDataTimeoutSubstitutionValueIdxOfRxAccessInfo "" UBYTE Com_RxDataTimeoutSubstitutionValueIdxOfRxAccessInfoType 0 0 0 255 ECU_ADDRESS 0x0 /end MEASUREMENT
/begin MEASUREMENT Com_RxAccessInfo[154].RxDataTimeoutSubstitutionValueOfRxAccessInfo "" UBYTE Com_RxDataTimeoutSubstitutionValueOfRxAccessInfoType 0 0 0 255 ECU_ADDRESS 0x0 /end MEASUREMENT
/begin MEASUREMENT Com_RxAccessInfo[154].RxPduInfoIdxOfRxAccessInfo "" UBYTE NO_COMPU_METHOD 0 0 0 255 ECU_ADDRESS 0x0 /end MEASUREMENT
/begin MEASUREMENT Com_RxAccessInfo[154].RxSigBufferArrayBasedBufferEndIdxOfRxAccessInfo "" UBYTE Com_RxSigBufferArrayBasedBufferEndIdxOfRxAccessInfoType 0 0 0 255 ECU_ADDRESS 0x0 /end MEASUREMENT
/begin MEASUREMENT Com_RxAccessInfo[154].RxSigBufferArrayBasedBufferStartIdxOfRxAccessInfo "" UBYTE Com_RxSigBufferArrayBasedBufferStartIdxOfRxAccessInfoType 0 0 0 255 ECU_ADDRESS 0x0 /end MEASUREMENT
/begin MEASUREMENT Com_RxAccessInfo[154].RxSigBufferArrayBasedShdBufferEndIdxOfRxAccessInfo "" UBYTE Com_RxSigBufferArrayBasedShdBufferEndIdxOfRxAccessInfoType 0 0 0 255 ECU_ADDRESS 0x0 /end MEASUREMENT
/begin MEASUREMENT Com_RxAccessInfo[154].RxSigBufferArrayBasedShdBufferStartIdxOfRxAccessInfo "" UBYTE Com_RxSigBufferArrayBasedShdBufferStartIdxOfRxAccessInfoType 0 0 0 255 ECU_ADDRESS 0x0 /end MEASUREMENT
/begin MEASUREMENT Com_RxAccessInfo[154].RxTOutInfoIdxOfRxAccessInfo "" UBYTE Com_RxTOutInfoIdxOfRxAccessInfoType 0 0 0 255 ECU_ADDRESS 0x0 /end MEASUREMENT
/begin MEASUREMENT Com_RxAccessInfo[154].ShdBufferIdxOfRxAccessInfo "" UWORD Com_ShdBufferIdxOfRxAccessInfoType 0 0 0 65535 ECU_ADDRESS 0x0 /end MEASUREMENT
/begin MEASUREMENT Com_RxAccessInfo[154].SignalLengthInByteOfRxAccessInfo "" UBYTE NO_COMPU_METHOD 0 0 0 255 ECU_ADDRESS 0x0 /end MEASUREMENT
/begin MEASUREMENT Com_RxAccessInfo[154].StartByteInPduPositionOfRxAccessInfo "" UBYTE NO_COMPU_METHOD 0 0 0 255 ECU_ADDRESS 0x0 /end MEASUREMENT
/begin MEASUREMENT Com_RxAccessInfo[154].TmpBufferIdxOfRxAccessInfo "" UBYTE Com_TmpBufferIdxOfRxAccessInfoType 0 0 0 255 ECU_ADDRESS 0x0 /end MEASUREMENT
/begin MEASUREMENT Com_RxAccessInfo[154].TmpBufferOfRxAccessInfo "" UBYTE Com_TmpBufferOfRxAccessInfoType 0 0 0 255 ECU_ADDRESS 0x0 /end MEASUREMENT
/begin MEASUREMENT Com_RxAccessInfo[154].TmpRxShdBufferArrayBasedTmpBufferEndIdxOfRxAccessInfo "" UBYTE Com_TmpRxShdBufferArrayBasedTmpBufferEndIdxOfRxAccessInfoType 0 0 0 255 ECU_ADDRESS 0x0 /end MEASUREMENT
/begin MEASUREMENT Com_RxAccessInfo[154].TmpRxShdBufferArrayBasedTmpBufferStartIdxOfRxAccessInfo "" UBYTE Com_TmpRxShdBufferArrayBasedTmpBufferStartIdxOfRxAccessInfoType 0 0 0 255 ECU_ADDRESS 0x0 /end MEASUREMENT
/begin MEASUREMENT Com_RxAccessInfo[155].ApplTypeOfRxAccessInfo "" UBYTE Com_ApplTypeOfRxAccessInfoType 0 0 0 255 ECU_ADDRESS 0x0 /end MEASUREMENT
/begin MEASUREMENT Com_RxAccessInfo[155].BitLengthOfRxAccessInfo "" UWORD NO_COMPU_METHOD 0 0 0 65535 ECU_ADDRESS 0x0 /end MEASUREMENT
/begin MEASUREMENT Com_RxAccessInfo[155].BitPositionOfRxAccessInfo "" UWORD NO_COMPU_METHOD 0 0 0 65535 ECU_ADDRESS 0x0 /end MEASUREMENT
/begin MEASUREMENT Com_RxAccessInfo[155].BufferIdxOfRxAccessInfo "" UWORD Com_BufferIdxOfRxAccessInfoType 0 0 0 65535 ECU_ADDRESS 0x0 /end MEASUREMENT
/begin MEASUREMENT Com_RxAccessInfo[155].BusAccOfRxAccessInfo "" UBYTE Com_BusAccOfRxAccessInfoType 0 0 0 255 ECU_ADDRESS 0x0 /end MEASUREMENT
/begin MEASUREMENT Com_RxAccessInfo[155].ByteLengthOfRxAccessInfo "" UBYTE NO_COMPU_METHOD 0 0 0 255 ECU_ADDRESS 0x0 /end MEASUREMENT
/begin MEASUREMENT Com_RxAccessInfo[155].ConstValueArrayBasedInitValueEndIdxOfRxAccessInfo "" UBYTE Com_ConstValueArrayBasedInitValueEndIdxOfRxAccessInfoType 0 0 0 255 ECU_ADDRESS 0x0 /end MEASUREMENT
/begin MEASUREMENT Com_RxAccessInfo[155].ConstValueArrayBasedInitValueStartIdxOfRxAccessInfo "" UBYTE Com_ConstValueArrayBasedInitValueStartIdxOfRxAccessInfoType 0 0 0 255 ECU_ADDRESS 0x0 /end MEASUREMENT
/begin MEASUREMENT Com_RxAccessInfo[155].DynSignalOfRxAccessInfo "" UBYTE Com_DynSignalOfRxAccessInfoType 0 0 0 1 ECU_ADDRESS 0x0 /end MEASUREMENT
/begin MEASUREMENT Com_RxAccessInfo[155].InitValueIdxOfRxAccessInfo "" UBYTE Com_InitValueIdxOfRxAccessInfoType 0 0 0 255 ECU_ADDRESS 0x0 /end MEASUREMENT
/begin MEASUREMENT Com_RxAccessInfo[155].InitValueOfRxAccessInfo "" UBYTE Com_InitValueOfRxAccessInfoType 0 0 0 255 ECU_ADDRESS 0x0 /end MEASUREMENT
/begin MEASUREMENT Com_RxAccessInfo[155].InvValueIdxOfRxAccessInfo "" UBYTE Com_InvValueIdxOfRxAccessInfoType 0 0 0 255 ECU_ADDRESS 0x0 /end MEASUREMENT
/begin MEASUREMENT Com_RxAccessInfo[155].InvValueOfRxAccessInfo "" UBYTE Com_InvValueOfRxAccessInfoType 0 0 0 255 ECU_ADDRESS 0x0 /end MEASUREMENT
/begin MEASUREMENT Com_RxAccessInfo[155].IsGroupSignalOfRxAccessInfo "" UBYTE Com_IsGroupSignalOfRxAccessInfoType 0 0 0 1 ECU_ADDRESS 0x0 /end MEASUREMENT
/begin MEASUREMENT Com_RxAccessInfo[155].RxDataTimeoutSubstitutionValueIdxOfRxAccessInfo "" UBYTE Com_RxDataTimeoutSubstitutionValueIdxOfRxAccessInfoType 0 0 0 255 ECU_ADDRESS 0x0 /end MEASUREMENT
/begin MEASUREMENT Com_RxAccessInfo[155].RxDataTimeoutSubstitutionValueOfRxAccessInfo "" UBYTE Com_RxDataTimeoutSubstitutionValueOfRxAccessInfoType 0 0 0 255 ECU_ADDRESS 0x0 /end MEASUREMENT
/begin MEASUREMENT Com_RxAccessInfo[155].RxPduInfoIdxOfRxAccessInfo "" UBYTE NO_COMPU_METHOD 0 0 0 255 ECU_ADDRESS 0x0 /end MEASUREMENT
/begin MEASUREMENT Com_RxAccessInfo[155].RxSigBufferArrayBasedBufferEndIdxOfRxAccessInfo "" UBYTE Com_RxSigBufferArrayBasedBufferEndIdxOfRxAccessInfoType 0 0 0 255 ECU_ADDRESS 0x0 /end MEASUREMENT
/begin MEASUREMENT Com_RxAccessInfo[155].RxSigBufferArrayBasedBufferStartIdxOfRxAccessInfo "" UBYTE Com_RxSigBufferArrayBasedBufferStartIdxOfRxAccessInfoType 0 0 0 255 ECU_ADDRESS 0x0 /end MEASUREMENT
/begin MEASUREMENT Com_RxAccessInfo[155].RxSigBufferArrayBasedShdBufferEndIdxOfRxAccessInfo "" UBYTE Com_RxSigBufferArrayBasedShdBufferEndIdxOfRxAccessInfoType 0 0 0 255 ECU_ADDRESS 0x0 /end MEASUREMENT
/begin MEASUREMENT Com_RxAccessInfo[155].RxSigBufferArrayBasedShdBufferStartIdxOfRxAccessInfo "" UBYTE Com_RxSigBufferArrayBasedShdBufferStartIdxOfRxAccessInfoType 0 0 0 255 ECU_ADDRESS 0x0 /end MEASUREMENT
/begin MEASUREMENT Com_RxAccessInfo[155].RxTOutInfoIdxOfRxAccessInfo "" UBYTE Com_RxTOutInfoIdxOfRxAccessInfoType 0 0 0 255 ECU_ADDRESS 0x0 /end MEASUREMENT
/begin MEASUREMENT Com_RxAccessInfo[155].ShdBufferIdxOfRxAccessInfo "" UWORD Com_ShdBufferIdxOfRxAccessInfoType 0 0 0 65535 ECU_ADDRESS 0x0 /end MEASUREMENT
/begin MEASUREMENT Com_RxAccessInfo[155].SignalLengthInByteOfRxAccessInfo "" UBYTE NO_COMPU_METHOD 0 0 0 255 ECU_ADDRESS 0x0 /end MEASUREMENT
/begin MEASUREMENT Com_RxAccessInfo[155].StartByteInPduPositionOfRxAccessInfo "" UBYTE NO_COMPU_METHOD 0 0 0 255 ECU_ADDRESS 0x0 /end MEASUREMENT
/begin MEASUREMENT Com_RxAccessInfo[155].TmpBufferIdxOfRxAccessInfo "" UBYTE Com_TmpBufferIdxOfRxAccessInfoType 0 0 0 255 ECU_ADDRESS 0x0 /end MEASUREMENT
/begin MEASUREMENT Com_RxAccessInfo[155].TmpBufferOfRxAccessInfo "" UBYTE Com_TmpBufferOfRxAccessInfoType 0 0 0 255 ECU_ADDRESS 0x0 /end MEASUREMENT
/begin MEASUREMENT Com_RxAccessInfo[155].TmpRxShdBufferArrayBasedTmpBufferEndIdxOfRxAccessInfo "" UBYTE Com_TmpRxShdBufferArrayBasedTmpBufferEndIdxOfRxAccessInfoType 0 0 0 255 ECU_ADDRESS 0x0 /end MEASUREMENT
/begin MEASUREMENT Com_RxAccessInfo[155].TmpRxShdBufferArrayBasedTmpBufferStartIdxOfRxAccessInfo "" UBYTE Com_TmpRxShdBufferArrayBasedTmpBufferStartIdxOfRxAccessInfoType 0 0 0 255 ECU_ADDRESS 0x0 /end MEASUREMENT
/begin MEASUREMENT Com_RxAccessInfo[156].ApplTypeOfRxAccessInfo "" UBYTE Com_ApplTypeOfRxAccessInfoType 0 0 0 255 ECU_ADDRESS 0x0 /end MEASUREMENT
/begin MEASUREMENT Com_RxAccessInfo[156].BitLengthOfRxAccessInfo "" UWORD NO_COMPU_METHOD 0 0 0 65535 ECU_ADDRESS 0x0 /end MEASUREMENT
/begin MEASUREMENT Com_RxAccessInfo[156].BitPositionOfRxAccessInfo "" UWORD NO_COMPU_METHOD 0 0 0 65535 ECU_ADDRESS 0x0 /end MEASUREMENT
/begin MEASUREMENT Com_RxAccessInfo[156].BufferIdxOfRxAccessInfo "" UWORD Com_BufferIdxOfRxAccessInfoType 0 0 0 65535 ECU_ADDRESS 0x0 /end MEASUREMENT
/begin MEASUREMENT Com_RxAccessInfo[156].BusAccOfRxAccessInfo "" UBYTE Com_BusAccOfRxAccessInfoType 0 0 0 255 ECU_ADDRESS 0x0 /end MEASUREMENT
/begin MEASUREMENT Com_RxAccessInfo[156].ByteLengthOfRxAccessInfo "" UBYTE NO_COMPU_METHOD 0 0 0 255 ECU_ADDRESS 0x0 /end MEASUREMENT
/begin MEASUREMENT Com_RxAccessInfo[156].ConstValueArrayBasedInitValueEndIdxOfRxAccessInfo "" UBYTE Com_ConstValueArrayBasedInitValueEndIdxOfRxAccessInfoType 0 0 0 255 ECU_ADDRESS 0x0 /end MEASUREMENT
/begin MEASUREMENT Com_RxAccessInfo[156].ConstValueArrayBasedInitValueStartIdxOfRxAccessInfo "" UBYTE Com_ConstValueArrayBasedInitValueStartIdxOfRxAccessInfoType 0 0 0 255 ECU_ADDRESS 0x0 /end MEASUREMENT
/begin MEASUREMENT Com_RxAccessInfo[156].DynSignalOfRxAccessInfo "" UBYTE Com_DynSignalOfRxAccessInfoType 0 0 0 1 ECU_ADDRESS 0x0 /end MEASUREMENT
/begin MEASUREMENT Com_RxAccessInfo[156].InitValueIdxOfRxAccessInfo "" UBYTE Com_InitValueIdxOfRxAccessInfoType 0 0 0 255 ECU_ADDRESS 0x0 /end MEASUREMENT
/begin MEASUREMENT Com_RxAccessInfo[156].InitValueOfRxAccessInfo "" UBYTE Com_InitValueOfRxAccessInfoType 0 0 0 255 ECU_ADDRESS 0x0 /end MEASUREMENT
/begin MEASUREMENT Com_RxAccessInfo[156].InvValueIdxOfRxAccessInfo "" UBYTE Com_InvValueIdxOfRxAccessInfoType 0 0 0 255 ECU_ADDRESS 0x0 /end MEASUREMENT
/begin MEASUREMENT Com_RxAccessInfo[156].InvValueOfRxAccessInfo "" UBYTE Com_InvValueOfRxAccessInfoType 0 0 0 255 ECU_ADDRESS 0x0 /end MEASUREMENT
/begin MEASUREMENT Com_RxAccessInfo[156].IsGroupSignalOfRxAccessInfo "" UBYTE Com_IsGroupSignalOfRxAccessInfoType 0 0 0 1 ECU_ADDRESS 0x0 /end MEASUREMENT
/begin MEASUREMENT Com_RxAccessInfo[156].RxDataTimeoutSubstitutionValueIdxOfRxAccessInfo "" UBYTE Com_RxDataTimeoutSubstitutionValueIdxOfRxAccessInfoType 0 0 0 255 ECU_ADDRESS 0x0 /end MEASUREMENT
/begin MEASUREMENT Com_RxAccessInfo[156].RxDataTimeoutSubstitutionValueOfRxAccessInfo "" UBYTE Com_RxDataTimeoutSubstitutionValueOfRxAccessInfoType 0 0 0 255 ECU_ADDRESS 0x0 /end MEASUREMENT
/begin MEASUREMENT Com_RxAccessInfo[156].RxPduInfoIdxOfRxAccessInfo "" UBYTE NO_COMPU_METHOD 0 0 0 255 ECU_ADDRESS 0x0 /end MEASUREMENT
/begin MEASUREMENT Com_RxAccessInfo[156].RxSigBufferArrayBasedBufferEndIdxOfRxAccessInfo "" UBYTE Com_RxSigBufferArrayBasedBufferEndIdxOfRxAccessInfoType 0 0 0 255 ECU_ADDRESS 0x0 /end MEASUREMENT
/begin MEASUREMENT Com_RxAccessInfo[156].RxSigBufferArrayBasedBufferStartIdxOfRxAccessInfo "" UBYTE Com_RxSigBufferArrayBasedBufferStartIdxOfRxAccessInfoType 0 0 0 255 ECU_ADDRESS 0x0 /end MEASUREMENT
/begin MEASUREMENT Com_RxAccessInfo[156].RxSigBufferArrayBasedShdBufferEndIdxOfRxAccessInfo "" UBYTE Com_RxSigBufferArrayBasedShdBufferEndIdxOfRxAccessInfoType 0 0 0 255 ECU_ADDRESS 0x0 /end MEASUREMENT
/begin MEASUREMENT Com_RxAccessInfo[156].RxSigBufferArrayBasedShdBufferStartIdxOfRxAccessInfo "" UBYTE Com_RxSigBufferArrayBasedShdBufferStartIdxOfRxAccessInfoType 0 0 0 255 ECU_ADDRESS 0x0 /end MEASUREMENT
/begin MEASUREMENT Com_RxAccessInfo[156].RxTOutInfoIdxOfRxAccessInfo "" UBYTE Com_RxTOutInfoIdxOfRxAccessInfoType 0 0 0 255 ECU_ADDRESS 0x0 /end MEASUREMENT
/begin MEASUREMENT Com_RxAccessInfo[156].ShdBufferIdxOfRxAccessInfo "" UWORD Com_ShdBufferIdxOfRxAccessInfoType 0 0 0 65535 ECU_ADDRESS 0x0 /end MEASUREMENT
/begin MEASUREMENT Com_RxAccessInfo[156].SignalLengthInByteOfRxAccessInfo "" UBYTE NO_COMPU_METHOD 0 0 0 255 ECU_ADDRESS 0x0 /end MEASUREMENT
/begin MEASUREMENT Com_RxAccessInfo[156].StartByteInPduPositionOfRxAccessInfo "" UBYTE NO_COMPU_METHOD 0 0 0 255 ECU_ADDRESS 0x0 /end MEASUREMENT
/begin MEASUREMENT Com_RxAccessInfo[156].TmpBufferIdxOfRxAccessInfo "" UBYTE Com_TmpBufferIdxOfRxAccessInfoType 0 0 0 255 ECU_ADDRESS 0x0 /end MEASUREMENT
/begin MEASUREMENT Com_RxAccessInfo[156].TmpBufferOfRxAccessInfo "" UBYTE Com_TmpBufferOfRxAccessInfoType 0 0 0 255 ECU_ADDRESS 0x0 /end MEASUREMENT
/begin MEASUREMENT Com_RxAccessInfo[156].TmpRxShdBufferArrayBasedTmpBufferEndIdxOfRxAccessInfo "" UBYTE Com_TmpRxShdBufferArrayBasedTmpBufferEndIdxOfRxAccessInfoType 0 0 0 255 ECU_ADDRESS 0x0 /end MEASUREMENT
/begin MEASUREMENT Com_RxAccessInfo[156].TmpRxShdBufferArrayBasedTmpBufferStartIdxOfRxAccessInfo "" UBYTE Com_TmpRxShdBufferArrayBasedTmpBufferStartIdxOfRxAccessInfoType 0 0 0 255 ECU_ADDRESS 0x0 /end MEASUREMENT
/begin MEASUREMENT Com_RxAccessInfo[157].ApplTypeOfRxAccessInfo "" UBYTE Com_ApplTypeOfRxAccessInfoType 0 0 0 255 ECU_ADDRESS 0x0 /end MEASUREMENT
/begin MEASUREMENT Com_RxAccessInfo[157].BitLengthOfRxAccessInfo "" UWORD NO_COMPU_METHOD 0 0 0 65535 ECU_ADDRESS 0x0 /end MEASUREMENT
/begin MEASUREMENT Com_RxAccessInfo[157].BitPositionOfRxAccessInfo "" UWORD NO_COMPU_METHOD 0 0 0 65535 ECU_ADDRESS 0x0 /end MEASUREMENT
/begin MEASUREMENT Com_RxAccessInfo[157].BufferIdxOfRxAccessInfo "" UWORD Com_BufferIdxOfRxAccessInfoType 0 0 0 65535 ECU_ADDRESS 0x0 /end MEASUREMENT
/begin MEASUREMENT Com_RxAccessInfo[157].BusAccOfRxAccessInfo "" UBYTE Com_BusAccOfRxAccessInfoType 0 0 0 255 ECU_ADDRESS 0x0 /end MEASUREMENT
/begin MEASUREMENT Com_RxAccessInfo[157].ByteLengthOfRxAccessInfo "" UBYTE NO_COMPU_METHOD 0 0 0 255 ECU_ADDRESS 0x0 /end MEASUREMENT
/begin MEASUREMENT Com_RxAccessInfo[157].ConstValueArrayBasedInitValueEndIdxOfRxAccessInfo "" UBYTE Com_ConstValueArrayBasedInitValueEndIdxOfRxAccessInfoType 0 0 0 255 ECU_ADDRESS 0x0 /end MEASUREMENT
/begin MEASUREMENT Com_RxAccessInfo[157].ConstValueArrayBasedInitValueStartIdxOfRxAccessInfo "" UBYTE Com_ConstValueArrayBasedInitValueStartIdxOfRxAccessInfoType 0 0 0 255 ECU_ADDRESS 0x0 /end MEASUREMENT
/begin MEASUREMENT Com_RxAccessInfo[157].DynSignalOfRxAccessInfo "" UBYTE Com_DynSignalOfRxAccessInfoType 0 0 0 1 ECU_ADDRESS 0x0 /end MEASUREMENT
/begin MEASUREMENT Com_RxAccessInfo[157].InitValueIdxOfRxAccessInfo "" UBYTE Com_InitValueIdxOfRxAccessInfoType 0 0 0 255 ECU_ADDRESS 0x0 /end MEASUREMENT
/begin MEASUREMENT Com_RxAccessInfo[157].InitValueOfRxAccessInfo "" UBYTE Com_InitValueOfRxAccessInfoType 0 0 0 255 ECU_ADDRESS 0x0 /end MEASUREMENT
/begin MEASUREMENT Com_RxAccessInfo[157].InvValueIdxOfRxAccessInfo "" UBYTE Com_InvValueIdxOfRxAccessInfoType 0 0 0 255 ECU_ADDRESS 0x0 /end MEASUREMENT
/begin MEASUREMENT Com_RxAccessInfo[157].InvValueOfRxAccessInfo "" UBYTE Com_InvValueOfRxAccessInfoType 0 0 0 255 ECU_ADDRESS 0x0 /end MEASUREMENT
/begin MEASUREMENT Com_RxAccessInfo[157].IsGroupSignalOfRxAccessInfo "" UBYTE Com_IsGroupSignalOfRxAccessInfoType 0 0 0 1 ECU_ADDRESS 0x0 /end MEASUREMENT
/begin MEASUREMENT Com_RxAccessInfo[157].RxDataTimeoutSubstitutionValueIdxOfRxAccessInfo "" UBYTE Com_RxDataTimeoutSubstitutionValueIdxOfRxAccessInfoType 0 0 0 255 ECU_ADDRESS 0x0 /end MEASUREMENT
/begin MEASUREMENT Com_RxAccessInfo[157].RxDataTimeoutSubstitutionValueOfRxAccessInfo "" UBYTE Com_RxDataTimeoutSubstitutionValueOfRxAccessInfoType 0 0 0 255 ECU_ADDRESS 0x0 /end MEASUREMENT
/begin MEASUREMENT Com_RxAccessInfo[157].RxPduInfoIdxOfRxAccessInfo "" UBYTE NO_COMPU_METHOD 0 0 0 255 ECU_ADDRESS 0x0 /end MEASUREMENT
/begin MEASUREMENT Com_RxAccessInfo[157].RxSigBufferArrayBasedBufferEndIdxOfRxAccessInfo "" UBYTE Com_RxSigBufferArrayBasedBufferEndIdxOfRxAccessInfoType 0 0 0 255 ECU_ADDRESS 0x0 /end MEASUREMENT
/begin MEASUREMENT Com_RxAccessInfo[157].RxSigBufferArrayBasedBufferStartIdxOfRxAccessInfo "" UBYTE Com_RxSigBufferArrayBasedBufferStartIdxOfRxAccessInfoType 0 0 0 255 ECU_ADDRESS 0x0 /end MEASUREMENT
/begin MEASUREMENT Com_RxAccessInfo[157].RxSigBufferArrayBasedShdBufferEndIdxOfRxAccessInfo "" UBYTE Com_RxSigBufferArrayBasedShdBufferEndIdxOfRxAccessInfoType 0 0 0 255 ECU_ADDRESS 0x0 /end MEASUREMENT
/begin MEASUREMENT Com_RxAccessInfo[157].RxSigBufferArrayBasedShdBufferStartIdxOfRxAccessInfo "" UBYTE Com_RxSigBufferArrayBasedShdBufferStartIdxOfRxAccessInfoType 0 0 0 255 ECU_ADDRESS 0x0 /end MEASUREMENT
/begin MEASUREMENT Com_RxAccessInfo[157].RxTOutInfoIdxOfRxAccessInfo "" UBYTE Com_RxTOutInfoIdxOfRxAccessInfoType 0 0 0 255 ECU_ADDRESS 0x0 /end MEASUREMENT
/begin MEASUREMENT Com_RxAccessInfo[157].ShdBufferIdxOfRxAccessInfo "" UWORD Com_ShdBufferIdxOfRxAccessInfoType 0 0 0 65535 ECU_ADDRESS 0x0 /end MEASUREMENT
/begin MEASUREMENT Com_RxAccessInfo[157].SignalLengthInByteOfRxAccessInfo "" UBYTE NO_COMPU_METHOD 0 0 0 255 ECU_ADDRESS 0x0 /end MEASUREMENT
/begin MEASUREMENT Com_RxAccessInfo[157].StartByteInPduPositionOfRxAccessInfo "" UBYTE NO_COMPU_METHOD 0 0 0 255 ECU_ADDRESS 0x0 /end MEASUREMENT
/begin MEASUREMENT Com_RxAccessInfo[157].TmpBufferIdxOfRxAccessInfo "" UBYTE Com_TmpBufferIdxOfRxAccessInfoType 0 0 0 255 ECU_ADDRESS 0x0 /end MEASUREMENT
/begin MEASUREMENT Com_RxAccessInfo[157].TmpBufferOfRxAccessInfo "" UBYTE Com_TmpBufferOfRxAccessInfoType 0 0 0 255 ECU_ADDRESS 0x0 /end MEASUREMENT
/begin MEASUREMENT Com_RxAccessInfo[157].TmpRxShdBufferArrayBasedTmpBufferEndIdxOfRxAccessInfo "" UBYTE Com_TmpRxShdBufferArrayBasedTmpBufferEndIdxOfRxAccessInfoType 0 0 0 255 ECU_ADDRESS 0x0 /end MEASUREMENT
/begin MEASUREMENT Com_RxAccessInfo[157].TmpRxShdBufferArrayBasedTmpBufferStartIdxOfRxAccessInfo "" UBYTE Com_TmpRxShdBufferArrayBasedTmpBufferStartIdxOfRxAccessInfoType 0 0 0 255 ECU_ADDRESS 0x0 /end MEASUREMENT
/begin MEASUREMENT Com_RxAccessInfo[158].ApplTypeOfRxAccessInfo "" UBYTE Com_ApplTypeOfRxAccessInfoType 0 0 0 255 ECU_ADDRESS 0x0 /end MEASUREMENT
/begin MEASUREMENT Com_RxAccessInfo[158].BitLengthOfRxAccessInfo "" UWORD NO_COMPU_METHOD 0 0 0 65535 ECU_ADDRESS 0x0 /end MEASUREMENT
/begin MEASUREMENT Com_RxAccessInfo[158].BitPositionOfRxAccessInfo "" UWORD NO_COMPU_METHOD 0 0 0 65535 ECU_ADDRESS 0x0 /end MEASUREMENT
/begin MEASUREMENT Com_RxAccessInfo[158].BufferIdxOfRxAccessInfo "" UWORD Com_BufferIdxOfRxAccessInfoType 0 0 0 65535 ECU_ADDRESS 0x0 /end MEASUREMENT
/begin MEASUREMENT Com_RxAccessInfo[158].BusAccOfRxAccessInfo "" UBYTE Com_BusAccOfRxAccessInfoType 0 0 0 255 ECU_ADDRESS 0x0 /end MEASUREMENT
/begin MEASUREMENT Com_RxAccessInfo[158].ByteLengthOfRxAccessInfo "" UBYTE NO_COMPU_METHOD 0 0 0 255 ECU_ADDRESS 0x0 /end MEASUREMENT
/begin MEASUREMENT Com_RxAccessInfo[158].ConstValueArrayBasedInitValueEndIdxOfRxAccessInfo "" UBYTE Com_ConstValueArrayBasedInitValueEndIdxOfRxAccessInfoType 0 0 0 255 ECU_ADDRESS 0x0 /end MEASUREMENT
/begin MEASUREMENT Com_RxAccessInfo[158].ConstValueArrayBasedInitValueStartIdxOfRxAccessInfo "" UBYTE Com_ConstValueArrayBasedInitValueStartIdxOfRxAccessInfoType 0 0 0 255 ECU_ADDRESS 0x0 /end MEASUREMENT
/begin MEASUREMENT Com_RxAccessInfo[158].DynSignalOfRxAccessInfo "" UBYTE Com_DynSignalOfRxAccessInfoType 0 0 0 1 ECU_ADDRESS 0x0 /end MEASUREMENT
/begin MEASUREMENT Com_RxAccessInfo[158].InitValueIdxOfRxAccessInfo "" UBYTE Com_InitValueIdxOfRxAccessInfoType 0 0 0 255 ECU_ADDRESS 0x0 /end MEASUREMENT
/begin MEASUREMENT Com_RxAccessInfo[158].InitValueOfRxAccessInfo "" UBYTE Com_InitValueOfRxAccessInfoType 0 0 0 255 ECU_ADDRESS 0x0 /end MEASUREMENT
/begin MEASUREMENT Com_RxAccessInfo[158].InvValueIdxOfRxAccessInfo "" UBYTE Com_InvValueIdxOfRxAccessInfoType 0 0 0 255 ECU_ADDRESS 0x0 /end MEASUREMENT
/begin MEASUREMENT Com_RxAccessInfo[158].InvValueOfRxAccessInfo "" UBYTE Com_InvValueOfRxAccessInfoType 0 0 0 255 ECU_ADDRESS 0x0 /end MEASUREMENT
/begin MEASUREMENT Com_RxAccessInfo[158].IsGroupSignalOfRxAccessInfo "" UBYTE Com_IsGroupSignalOfRxAccessInfoType 0 0 0 1 ECU_ADDRESS 0x0 /end MEASUREMENT
/begin MEASUREMENT Com_RxAccessInfo[158].RxDataTimeoutSubstitutionValueIdxOfRxAccessInfo "" UBYTE Com_RxDataTimeoutSubstitutionValueIdxOfRxAccessInfoType 0 0 0 255 ECU_ADDRESS 0x0 /end MEASUREMENT
/begin MEASUREMENT Com_RxAccessInfo[158].RxDataTimeoutSubstitutionValueOfRxAccessInfo "" UBYTE Com_RxDataTimeoutSubstitutionValueOfRxAccessInfoType 0 0 0 255 ECU_ADDRESS 0x0 /end MEASUREMENT
/begin MEASUREMENT Com_RxAccessInfo[158].RxPduInfoIdxOfRxAccessInfo "" UBYTE NO_COMPU_METHOD 0 0 0 255 ECU_ADDRESS 0x0 /end MEASUREMENT
/begin MEASUREMENT Com_RxAccessInfo[158].RxSigBufferArrayBasedBufferEndIdxOfRxAccessInfo "" UBYTE Com_RxSigBufferArrayBasedBufferEndIdxOfRxAccessInfoType 0 0 0 255 ECU_ADDRESS 0x0 /end MEASUREMENT
/begin MEASUREMENT Com_RxAccessInfo[158].RxSigBufferArrayBasedBufferStartIdxOfRxAccessInfo "" UBYTE Com_RxSigBufferArrayBasedBufferStartIdxOfRxAccessInfoType 0 0 0 255 ECU_ADDRESS 0x0 /end MEASUREMENT
/begin MEASUREMENT Com_RxAccessInfo[158].RxSigBufferArrayBasedShdBufferEndIdxOfRxAccessInfo "" UBYTE Com_RxSigBufferArrayBasedShdBufferEndIdxOfRxAccessInfoType 0 0 0 255 ECU_ADDRESS 0x0 /end MEASUREMENT
/begin MEASUREMENT Com_RxAccessInfo[158].RxSigBufferArrayBasedShdBufferStartIdxOfRxAccessInfo "" UBYTE Com_RxSigBufferArrayBasedShdBufferStartIdxOfRxAccessInfoType 0 0 0 255 ECU_ADDRESS 0x0 /end MEASUREMENT
/begin MEASUREMENT Com_RxAccessInfo[158].RxTOutInfoIdxOfRxAccessInfo "" UBYTE Com_RxTOutInfoIdxOfRxAccessInfoType 0 0 0 255 ECU_ADDRESS 0x0 /end MEASUREMENT
/begin MEASUREMENT Com_RxAccessInfo[158].ShdBufferIdxOfRxAccessInfo "" UWORD Com_ShdBufferIdxOfRxAccessInfoType 0 0 0 65535 ECU_ADDRESS 0x0 /end MEASUREMENT
/begin MEASUREMENT Com_RxAccessInfo[158].SignalLengthInByteOfRxAccessInfo "" UBYTE NO_COMPU_METHOD 0 0 0 255 ECU_ADDRESS 0x0 /end MEASUREMENT
/begin MEASUREMENT Com_RxAccessInfo[158].StartByteInPduPositionOfRxAccessInfo "" UBYTE NO_COMPU_METHOD 0 0 0 255 ECU_ADDRESS 0x0 /end MEASUREMENT
/begin MEASUREMENT Com_RxAccessInfo[158].TmpBufferIdxOfRxAccessInfo "" UBYTE Com_TmpBufferIdxOfRxAccessInfoType 0 0 0 255 ECU_ADDRESS 0x0 /end MEASUREMENT
/begin MEASUREMENT Com_RxAccessInfo[158].TmpBufferOfRxAccessInfo "" UBYTE Com_TmpBufferOfRxAccessInfoType 0 0 0 255 ECU_ADDRESS 0x0 /end MEASUREMENT
/begin MEASUREMENT Com_RxAccessInfo[158].TmpRxShdBufferArrayBasedTmpBufferEndIdxOfRxAccessInfo "" UBYTE Com_TmpRxShdBufferArrayBasedTmpBufferEndIdxOfRxAccessInfoType 0 0 0 255 ECU_ADDRESS 0x0 /end MEASUREMENT
/begin MEASUREMENT Com_RxAccessInfo[158].TmpRxShdBufferArrayBasedTmpBufferStartIdxOfRxAccessInfo "" UBYTE Com_TmpRxShdBufferArrayBasedTmpBufferStartIdxOfRxAccessInfoType 0 0 0 255 ECU_ADDRESS 0x0 /end MEASUREMENT
/begin MEASUREMENT Com_RxAccessInfo[159].ApplTypeOfRxAccessInfo "" UBYTE Com_ApplTypeOfRxAccessInfoType 0 0 0 255 ECU_ADDRESS 0x0 /end MEASUREMENT
/begin MEASUREMENT Com_RxAccessInfo[159].BitLengthOfRxAccessInfo "" UWORD NO_COMPU_METHOD 0 0 0 65535 ECU_ADDRESS 0x0 /end MEASUREMENT
/begin MEASUREMENT Com_RxAccessInfo[159].BitPositionOfRxAccessInfo "" UWORD NO_COMPU_METHOD 0 0 0 65535 ECU_ADDRESS 0x0 /end MEASUREMENT
/begin MEASUREMENT Com_RxAccessInfo[159].BufferIdxOfRxAccessInfo "" UWORD Com_BufferIdxOfRxAccessInfoType 0 0 0 65535 ECU_ADDRESS 0x0 /end MEASUREMENT
/begin MEASUREMENT Com_RxAccessInfo[159].BusAccOfRxAccessInfo "" UBYTE Com_BusAccOfRxAccessInfoType 0 0 0 255 ECU_ADDRESS 0x0 /end MEASUREMENT
/begin MEASUREMENT Com_RxAccessInfo[159].ByteLengthOfRxAccessInfo "" UBYTE NO_COMPU_METHOD 0 0 0 255 ECU_ADDRESS 0x0 /end MEASUREMENT
/begin MEASUREMENT Com_RxAccessInfo[159].ConstValueArrayBasedInitValueEndIdxOfRxAccessInfo "" UBYTE Com_ConstValueArrayBasedInitValueEndIdxOfRxAccessInfoType 0 0 0 255 ECU_ADDRESS 0x0 /end MEASUREMENT
/begin MEASUREMENT Com_RxAccessInfo[159].ConstValueArrayBasedInitValueStartIdxOfRxAccessInfo "" UBYTE Com_ConstValueArrayBasedInitValueStartIdxOfRxAccessInfoType 0 0 0 255 ECU_ADDRESS 0x0 /end MEASUREMENT
/begin MEASUREMENT Com_RxAccessInfo[159].DynSignalOfRxAccessInfo "" UBYTE Com_DynSignalOfRxAccessInfoType 0 0 0 1 ECU_ADDRESS 0x0 /end MEASUREMENT
/begin MEASUREMENT Com_RxAccessInfo[159].InitValueIdxOfRxAccessInfo "" UBYTE Com_InitValueIdxOfRxAccessInfoType 0 0 0 255 ECU_ADDRESS 0x0 /end MEASUREMENT
/begin MEASUREMENT Com_RxAccessInfo[159].InitValueOfRxAccessInfo "" UBYTE Com_InitValueOfRxAccessInfoType 0 0 0 255 ECU_ADDRESS 0x0 /end MEASUREMENT
/begin MEASUREMENT Com_RxAccessInfo[159].InvValueIdxOfRxAccessInfo "" UBYTE Com_InvValueIdxOfRxAccessInfoType 0 0 0 255 ECU_ADDRESS 0x0 /end MEASUREMENT
/begin MEASUREMENT Com_RxAccessInfo[159].InvValueOfRxAccessInfo "" UBYTE Com_InvValueOfRxAccessInfoType 0 0 0 255 ECU_ADDRESS 0x0 /end MEASUREMENT
/begin MEASUREMENT Com_RxAccessInfo[159].IsGroupSignalOfRxAccessInfo "" UBYTE Com_IsGroupSignalOfRxAccessInfoType 0 0 0 1 ECU_ADDRESS 0x0 /end MEASUREMENT
/begin MEASUREMENT Com_RxAccessInfo[159].RxDataTimeoutSubstitutionValueIdxOfRxAccessInfo "" UBYTE Com_RxDataTimeoutSubstitutionValueIdxOfRxAccessInfoType 0 0 0 255 ECU_ADDRESS 0x0 /end MEASUREMENT
/begin MEASUREMENT Com_RxAccessInfo[159].RxDataTimeoutSubstitutionValueOfRxAccessInfo "" UBYTE Com_RxDataTimeoutSubstitutionValueOfRxAccessInfoType 0 0 0 255 ECU_ADDRESS 0x0 /end MEASUREMENT
/begin MEASUREMENT Com_RxAccessInfo[159].RxPduInfoIdxOfRxAccessInfo "" UBYTE NO_COMPU_METHOD 0 0 0 255 ECU_ADDRESS 0x0 /end MEASUREMENT
/begin MEASUREMENT Com_RxAccessInfo[159].RxSigBufferArrayBasedBufferEndIdxOfRxAccessInfo "" UBYTE Com_RxSigBufferArrayBasedBufferEndIdxOfRxAccessInfoType 0 0 0 255 ECU_ADDRESS 0x0 /end MEASUREMENT
/begin MEASUREMENT Com_RxAccessInfo[159].RxSigBufferArrayBasedBufferStartIdxOfRxAccessInfo "" UBYTE Com_RxSigBufferArrayBasedBufferStartIdxOfRxAccessInfoType 0 0 0 255 ECU_ADDRESS 0x0 /end MEASUREMENT
/begin MEASUREMENT Com_RxAccessInfo[159].RxSigBufferArrayBasedShdBufferEndIdxOfRxAccessInfo "" UBYTE Com_RxSigBufferArrayBasedShdBufferEndIdxOfRxAccessInfoType 0 0 0 255 ECU_ADDRESS 0x0 /end MEASUREMENT
/begin MEASUREMENT Com_RxAccessInfo[159].RxSigBufferArrayBasedShdBufferStartIdxOfRxAccessInfo "" UBYTE Com_RxSigBufferArrayBasedShdBufferStartIdxOfRxAccessInfoType 0 0 0 255 ECU_ADDRESS 0x0 /end MEASUREMENT
/begin MEASUREMENT Com_RxAccessInfo[159].RxTOutInfoIdxOfRxAccessInfo "" UBYTE Com_RxTOutInfoIdxOfRxAccessInfoType 0 0 0 255 ECU_ADDRESS 0x0 /end MEASUREMENT
/begin MEASUREMENT Com_RxAccessInfo[159].ShdBufferIdxOfRxAccessInfo "" UWORD Com_ShdBufferIdxOfRxAccessInfoType 0 0 0 65535 ECU_ADDRESS 0x0 /end MEASUREMENT
/begin MEASUREMENT Com_RxAccessInfo[159].SignalLengthInByteOfRxAccessInfo "" UBYTE NO_COMPU_METHOD 0 0 0 255 ECU_ADDRESS 0x0 /end MEASUREMENT
/begin MEASUREMENT Com_RxAccessInfo[159].StartByteInPduPositionOfRxAccessInfo "" UBYTE NO_COMPU_METHOD 0 0 0 255 ECU_ADDRESS 0x0 /end MEASUREMENT
/begin MEASUREMENT Com_RxAccessInfo[159].TmpBufferIdxOfRxAccessInfo "" UBYTE Com_TmpBufferIdxOfRxAccessInfoType 0 0 0 255 ECU_ADDRESS 0x0 /end MEASUREMENT
/begin MEASUREMENT Com_RxAccessInfo[159].TmpBufferOfRxAccessInfo "" UBYTE Com_TmpBufferOfRxAccessInfoType 0 0 0 255 ECU_ADDRESS 0x0 /end MEASUREMENT
/begin MEASUREMENT Com_RxAccessInfo[159].TmpRxShdBufferArrayBasedTmpBufferEndIdxOfRxAccessInfo "" UBYTE Com_TmpRxShdBufferArrayBasedTmpBufferEndIdxOfRxAccessInfoType 0 0 0 255 ECU_ADDRESS 0x0 /end MEASUREMENT
/begin MEASUREMENT Com_RxAccessInfo[159].TmpRxShdBufferArrayBasedTmpBufferStartIdxOfRxAccessInfo "" UBYTE Com_TmpRxShdBufferArrayBasedTmpBufferStartIdxOfRxAccessInfoType 0 0 0 255 ECU_ADDRESS 0x0 /end MEASUREMENT
/begin MEASUREMENT Com_RxAccessInfo[15].ApplTypeOfRxAccessInfo "" UBYTE Com_ApplTypeOfRxAccessInfoType 0 0 0 255 ECU_ADDRESS 0x0 /end MEASUREMENT
/begin MEASUREMENT Com_RxAccessInfo[15].BitLengthOfRxAccessInfo "" UWORD NO_COMPU_METHOD 0 0 0 65535 ECU_ADDRESS 0x0 /end MEASUREMENT
/begin MEASUREMENT Com_RxAccessInfo[15].BitPositionOfRxAccessInfo "" UWORD NO_COMPU_METHOD 0 0 0 65535 ECU_ADDRESS 0x0 /end MEASUREMENT
/begin MEASUREMENT Com_RxAccessInfo[15].BufferIdxOfRxAccessInfo "" UWORD Com_BufferIdxOfRxAccessInfoType 0 0 0 65535 ECU_ADDRESS 0x0 /end MEASUREMENT
/begin MEASUREMENT Com_RxAccessInfo[15].BusAccOfRxAccessInfo "" UBYTE Com_BusAccOfRxAccessInfoType 0 0 0 255 ECU_ADDRESS 0x0 /end MEASUREMENT
/begin MEASUREMENT Com_RxAccessInfo[15].ByteLengthOfRxAccessInfo "" UBYTE NO_COMPU_METHOD 0 0 0 255 ECU_ADDRESS 0x0 /end MEASUREMENT
/begin MEASUREMENT Com_RxAccessInfo[15].ConstValueArrayBasedInitValueEndIdxOfRxAccessInfo "" UBYTE Com_ConstValueArrayBasedInitValueEndIdxOfRxAccessInfoType 0 0 0 255 ECU_ADDRESS 0x0 /end MEASUREMENT
/begin MEASUREMENT Com_RxAccessInfo[15].ConstValueArrayBasedInitValueStartIdxOfRxAccessInfo "" UBYTE Com_ConstValueArrayBasedInitValueStartIdxOfRxAccessInfoType 0 0 0 255 ECU_ADDRESS 0x0 /end MEASUREMENT
/begin MEASUREMENT Com_RxAccessInfo[15].DynSignalOfRxAccessInfo "" UBYTE Com_DynSignalOfRxAccessInfoType 0 0 0 1 ECU_ADDRESS 0x0 /end MEASUREMENT
/begin MEASUREMENT Com_RxAccessInfo[15].InitValueIdxOfRxAccessInfo "" UBYTE Com_InitValueIdxOfRxAccessInfoType 0 0 0 255 ECU_ADDRESS 0x0 /end MEASUREMENT
/begin MEASUREMENT Com_RxAccessInfo[15].InitValueOfRxAccessInfo "" UBYTE Com_InitValueOfRxAccessInfoType 0 0 0 255 ECU_ADDRESS 0x0 /end MEASUREMENT
/begin MEASUREMENT Com_RxAccessInfo[15].InvValueIdxOfRxAccessInfo "" UBYTE Com_InvValueIdxOfRxAccessInfoType 0 0 0 255 ECU_ADDRESS 0x0 /end MEASUREMENT
/begin MEASUREMENT Com_RxAccessInfo[15].InvValueOfRxAccessInfo "" UBYTE Com_InvValueOfRxAccessInfoType 0 0 0 255 ECU_ADDRESS 0x0 /end MEASUREMENT
/begin MEASUREMENT Com_RxAccessInfo[15].IsGroupSignalOfRxAccessInfo "" UBYTE Com_IsGroupSignalOfRxAccessInfoType 0 0 0 1 ECU_ADDRESS 0x0 /end MEASUREMENT
/begin MEASUREMENT Com_RxAccessInfo[15].RxDataTimeoutSubstitutionValueIdxOfRxAccessInfo "" UBYTE Com_RxDataTimeoutSubstitutionValueIdxOfRxAccessInfoType 0 0 0 255 ECU_ADDRESS 0x0 /end MEASUREMENT
/begin MEASUREMENT Com_RxAccessInfo[15].RxDataTimeoutSubstitutionValueOfRxAccessInfo "" UBYTE Com_RxDataTimeoutSubstitutionValueOfRxAccessInfoType 0 0 0 255 ECU_ADDRESS 0x0 /end MEASUREMENT
/begin MEASUREMENT Com_RxAccessInfo[15].RxPduInfoIdxOfRxAccessInfo "" UBYTE NO_COMPU_METHOD 0 0 0 255 ECU_ADDRESS 0x0 /end MEASUREMENT
/begin MEASUREMENT Com_RxAccessInfo[15].RxSigBufferArrayBasedBufferEndIdxOfRxAccessInfo "" UBYTE Com_RxSigBufferArrayBasedBufferEndIdxOfRxAccessInfoType 0 0 0 255 ECU_ADDRESS 0x0 /end MEASUREMENT
/begin MEASUREMENT Com_RxAccessInfo[15].RxSigBufferArrayBasedBufferStartIdxOfRxAccessInfo "" UBYTE Com_RxSigBufferArrayBasedBufferStartIdxOfRxAccessInfoType 0 0 0 255 ECU_ADDRESS 0x0 /end MEASUREMENT
/begin MEASUREMENT Com_RxAccessInfo[15].RxSigBufferArrayBasedShdBufferEndIdxOfRxAccessInfo "" UBYTE Com_RxSigBufferArrayBasedShdBufferEndIdxOfRxAccessInfoType 0 0 0 255 ECU_ADDRESS 0x0 /end MEASUREMENT
/begin MEASUREMENT Com_RxAccessInfo[15].RxSigBufferArrayBasedShdBufferStartIdxOfRxAccessInfo "" UBYTE Com_RxSigBufferArrayBasedShdBufferStartIdxOfRxAccessInfoType 0 0 0 255 ECU_ADDRESS 0x0 /end MEASUREMENT
/begin MEASUREMENT Com_RxAccessInfo[15].RxTOutInfoIdxOfRxAccessInfo "" UBYTE Com_RxTOutInfoIdxOfRxAccessInfoType 0 0 0 255 ECU_ADDRESS 0x0 /end MEASUREMENT
/begin MEASUREMENT Com_RxAccessInfo[15].ShdBufferIdxOfRxAccessInfo "" UWORD Com_ShdBufferIdxOfRxAccessInfoType 0 0 0 65535 ECU_ADDRESS 0x0 /end MEASUREMENT
/begin MEASUREMENT Com_RxAccessInfo[15].SignalLengthInByteOfRxAccessInfo "" UBYTE NO_COMPU_METHOD 0 0 0 255 ECU_ADDRESS 0x0 /end MEASUREMENT
/begin MEASUREMENT Com_RxAccessInfo[15].StartByteInPduPositionOfRxAccessInfo "" UBYTE NO_COMPU_METHOD 0 0 0 255 ECU_ADDRESS 0x0 /end MEASUREMENT
/begin MEASUREMENT Com_RxAccessInfo[15].TmpBufferIdxOfRxAccessInfo "" UBYTE Com_TmpBufferIdxOfRxAccessInfoType 0 0 0 255 ECU_ADDRESS 0x0 /end MEASUREMENT
/begin MEASUREMENT Com_RxAccessInfo[15].TmpBufferOfRxAccessInfo "" UBYTE Com_TmpBufferOfRxAccessInfoType 0 0 0 255 ECU_ADDRESS 0x0 /end MEASUREMENT
/begin MEASUREMENT Com_RxAccessInfo[15].TmpRxShdBufferArrayBasedTmpBufferEndIdxOfRxAccessInfo "" UBYTE Com_TmpRxShdBufferArrayBasedTmpBufferEndIdxOfRxAccessInfoType 0 0 0 255 ECU_ADDRESS 0x0 /end MEASUREMENT
/begin MEASUREMENT Com_RxAccessInfo[15].TmpRxShdBufferArrayBasedTmpBufferStartIdxOfRxAccessInfo "" UBYTE Com_TmpRxShdBufferArrayBasedTmpBufferStartIdxOfRxAccessInfoType 0 0 0 255 ECU_ADDRESS 0x0 /end MEASUREMENT
/begin MEASUREMENT Com_RxAccessInfo[160].ApplTypeOfRxAccessInfo "" UBYTE Com_ApplTypeOfRxAccessInfoType 0 0 0 255 ECU_ADDRESS 0x0 /end MEASUREMENT
/begin MEASUREMENT Com_RxAccessInfo[160].BitLengthOfRxAccessInfo "" UWORD NO_COMPU_METHOD 0 0 0 65535 ECU_ADDRESS 0x0 /end MEASUREMENT
/begin MEASUREMENT Com_RxAccessInfo[160].BitPositionOfRxAccessInfo "" UWORD NO_COMPU_METHOD 0 0 0 65535 ECU_ADDRESS 0x0 /end MEASUREMENT
/begin MEASUREMENT Com_RxAccessInfo[160].BufferIdxOfRxAccessInfo "" UWORD Com_BufferIdxOfRxAccessInfoType 0 0 0 65535 ECU_ADDRESS 0x0 /end MEASUREMENT
/begin MEASUREMENT Com_RxAccessInfo[160].BusAccOfRxAccessInfo "" UBYTE Com_BusAccOfRxAccessInfoType 0 0 0 255 ECU_ADDRESS 0x0 /end MEASUREMENT
/begin MEASUREMENT Com_RxAccessInfo[160].ByteLengthOfRxAccessInfo "" UBYTE NO_COMPU_METHOD 0 0 0 255 ECU_ADDRESS 0x0 /end MEASUREMENT
/begin MEASUREMENT Com_RxAccessInfo[160].ConstValueArrayBasedInitValueEndIdxOfRxAccessInfo "" UBYTE Com_ConstValueArrayBasedInitValueEndIdxOfRxAccessInfoType 0 0 0 255 ECU_ADDRESS 0x0 /end MEASUREMENT
/begin MEASUREMENT Com_RxAccessInfo[160].ConstValueArrayBasedInitValueStartIdxOfRxAccessInfo "" UBYTE Com_ConstValueArrayBasedInitValueStartIdxOfRxAccessInfoType 0 0 0 255 ECU_ADDRESS 0x0 /end MEASUREMENT
/begin MEASUREMENT Com_RxAccessInfo[160].DynSignalOfRxAccessInfo "" UBYTE Com_DynSignalOfRxAccessInfoType 0 0 0 1 ECU_ADDRESS 0x0 /end MEASUREMENT
/begin MEASUREMENT Com_RxAccessInfo[160].InitValueIdxOfRxAccessInfo "" UBYTE Com_InitValueIdxOfRxAccessInfoType 0 0 0 255 ECU_ADDRESS 0x0 /end MEASUREMENT
/begin MEASUREMENT Com_RxAccessInfo[160].InitValueOfRxAccessInfo "" UBYTE Com_InitValueOfRxAccessInfoType 0 0 0 255 ECU_ADDRESS 0x0 /end MEASUREMENT
/begin MEASUREMENT Com_RxAccessInfo[160].InvValueIdxOfRxAccessInfo "" UBYTE Com_InvValueIdxOfRxAccessInfoType 0 0 0 255 ECU_ADDRESS 0x0 /end MEASUREMENT
/begin MEASUREMENT Com_RxAccessInfo[160].InvValueOfRxAccessInfo "" UBYTE Com_InvValueOfRxAccessInfoType 0 0 0 255 ECU_ADDRESS 0x0 /end MEASUREMENT
/begin MEASUREMENT Com_RxAccessInfo[160].IsGroupSignalOfRxAccessInfo "" UBYTE Com_IsGroupSignalOfRxAccessInfoType 0 0 0 1 ECU_ADDRESS 0x0 /end MEASUREMENT
/begin MEASUREMENT Com_RxAccessInfo[160].RxDataTimeoutSubstitutionValueIdxOfRxAccessInfo "" UBYTE Com_RxDataTimeoutSubstitutionValueIdxOfRxAccessInfoType 0 0 0 255 ECU_ADDRESS 0x0 /end MEASUREMENT
/begin MEASUREMENT Com_RxAccessInfo[160].RxDataTimeoutSubstitutionValueOfRxAccessInfo "" UBYTE Com_RxDataTimeoutSubstitutionValueOfRxAccessInfoType 0 0 0 255 ECU_ADDRESS 0x0 /end MEASUREMENT
/begin MEASUREMENT Com_RxAccessInfo[160].RxPduInfoIdxOfRxAccessInfo "" UBYTE NO_COMPU_METHOD 0 0 0 255 ECU_ADDRESS 0x0 /end MEASUREMENT
/begin MEASUREMENT Com_RxAccessInfo[160].RxSigBufferArrayBasedBufferEndIdxOfRxAccessInfo "" UBYTE Com_RxSigBufferArrayBasedBufferEndIdxOfRxAccessInfoType 0 0 0 255 ECU_ADDRESS 0x0 /end MEASUREMENT
/begin MEASUREMENT Com_RxAccessInfo[160].RxSigBufferArrayBasedBufferStartIdxOfRxAccessInfo "" UBYTE Com_RxSigBufferArrayBasedBufferStartIdxOfRxAccessInfoType 0 0 0 255 ECU_ADDRESS 0x0 /end MEASUREMENT
/begin MEASUREMENT Com_RxAccessInfo[160].RxSigBufferArrayBasedShdBufferEndIdxOfRxAccessInfo "" UBYTE Com_RxSigBufferArrayBasedShdBufferEndIdxOfRxAccessInfoType 0 0 0 255 ECU_ADDRESS 0x0 /end MEASUREMENT
/begin MEASUREMENT Com_RxAccessInfo[160].RxSigBufferArrayBasedShdBufferStartIdxOfRxAccessInfo "" UBYTE Com_RxSigBufferArrayBasedShdBufferStartIdxOfRxAccessInfoType 0 0 0 255 ECU_ADDRESS 0x0 /end MEASUREMENT
/begin MEASUREMENT Com_RxAccessInfo[160].RxTOutInfoIdxOfRxAccessInfo "" UBYTE Com_RxTOutInfoIdxOfRxAccessInfoType 0 0 0 255 ECU_ADDRESS 0x0 /end MEASUREMENT
/begin MEASUREMENT Com_RxAccessInfo[160].ShdBufferIdxOfRxAccessInfo "" UWORD Com_ShdBufferIdxOfRxAccessInfoType 0 0 0 65535 ECU_ADDRESS 0x0 /end MEASUREMENT
/begin MEASUREMENT Com_RxAccessInfo[160].SignalLengthInByteOfRxAccessInfo "" UBYTE NO_COMPU_METHOD 0 0 0 255 ECU_ADDRESS 0x0 /end MEASUREMENT
/begin MEASUREMENT Com_RxAccessInfo[160].StartByteInPduPositionOfRxAccessInfo "" UBYTE NO_COMPU_METHOD 0 0 0 255 ECU_ADDRESS 0x0 /end MEASUREMENT
/begin MEASUREMENT Com_RxAccessInfo[160].TmpBufferIdxOfRxAccessInfo "" UBYTE Com_TmpBufferIdxOfRxAccessInfoType 0 0 0 255 ECU_ADDRESS 0x0 /end MEASUREMENT
/begin MEASUREMENT Com_RxAccessInfo[160].TmpBufferOfRxAccessInfo "" UBYTE Com_TmpBufferOfRxAccessInfoType 0 0 0 255 ECU_ADDRESS 0x0 /end MEASUREMENT
/begin MEASUREMENT Com_RxAccessInfo[160].TmpRxShdBufferArrayBasedTmpBufferEndIdxOfRxAccessInfo "" UBYTE Com_TmpRxShdBufferArrayBasedTmpBufferEndIdxOfRxAccessInfoType 0 0 0 255 ECU_ADDRESS 0x0 /end MEASUREMENT
/begin MEASUREMENT Com_RxAccessInfo[160].TmpRxShdBufferArrayBasedTmpBufferStartIdxOfRxAccessInfo "" UBYTE Com_TmpRxShdBufferArrayBasedTmpBufferStartIdxOfRxAccessInfoType 0 0 0 255 ECU_ADDRESS 0x0 /end MEASUREMENT
/begin MEASUREMENT Com_RxAccessInfo[161].ApplTypeOfRxAccessInfo "" UBYTE Com_ApplTypeOfRxAccessInfoType 0 0 0 255 ECU_ADDRESS 0x0 /end MEASUREMENT
/begin MEASUREMENT Com_RxAccessInfo[161].BitLengthOfRxAccessInfo "" UWORD NO_COMPU_METHOD 0 0 0 65535 ECU_ADDRESS 0x0 /end MEASUREMENT
/begin MEASUREMENT Com_RxAccessInfo[161].BitPositionOfRxAccessInfo "" UWORD NO_COMPU_METHOD 0 0 0 65535 ECU_ADDRESS 0x0 /end MEASUREMENT
/begin MEASUREMENT Com_RxAccessInfo[161].BufferIdxOfRxAccessInfo "" UWORD Com_BufferIdxOfRxAccessInfoType 0 0 0 65535 ECU_ADDRESS 0x0 /end MEASUREMENT
/begin MEASUREMENT Com_RxAccessInfo[161].BusAccOfRxAccessInfo "" UBYTE Com_BusAccOfRxAccessInfoType 0 0 0 255 ECU_ADDRESS 0x0 /end MEASUREMENT
/begin MEASUREMENT Com_RxAccessInfo[161].ByteLengthOfRxAccessInfo "" UBYTE NO_COMPU_METHOD 0 0 0 255 ECU_ADDRESS 0x0 /end MEASUREMENT
/begin MEASUREMENT Com_RxAccessInfo[161].ConstValueArrayBasedInitValueEndIdxOfRxAccessInfo "" UBYTE Com_ConstValueArrayBasedInitValueEndIdxOfRxAccessInfoType 0 0 0 255 ECU_ADDRESS 0x0 /end MEASUREMENT
/begin MEASUREMENT Com_RxAccessInfo[161].ConstValueArrayBasedInitValueStartIdxOfRxAccessInfo "" UBYTE Com_ConstValueArrayBasedInitValueStartIdxOfRxAccessInfoType 0 0 0 255 ECU_ADDRESS 0x0 /end MEASUREMENT
/begin MEASUREMENT Com_RxAccessInfo[161].DynSignalOfRxAccessInfo "" UBYTE Com_DynSignalOfRxAccessInfoType 0 0 0 1 ECU_ADDRESS 0x0 /end MEASUREMENT
/begin MEASUREMENT Com_RxAccessInfo[161].InitValueIdxOfRxAccessInfo "" UBYTE Com_InitValueIdxOfRxAccessInfoType 0 0 0 255 ECU_ADDRESS 0x0 /end MEASUREMENT
/begin MEASUREMENT Com_RxAccessInfo[161].InitValueOfRxAccessInfo "" UBYTE Com_InitValueOfRxAccessInfoType 0 0 0 255 ECU_ADDRESS 0x0 /end MEASUREMENT
/begin MEASUREMENT Com_RxAccessInfo[161].InvValueIdxOfRxAccessInfo "" UBYTE Com_InvValueIdxOfRxAccessInfoType 0 0 0 255 ECU_ADDRESS 0x0 /end MEASUREMENT
/begin MEASUREMENT Com_RxAccessInfo[161].InvValueOfRxAccessInfo "" UBYTE Com_InvValueOfRxAccessInfoType 0 0 0 255 ECU_ADDRESS 0x0 /end MEASUREMENT
/begin MEASUREMENT Com_RxAccessInfo[161].IsGroupSignalOfRxAccessInfo "" UBYTE Com_IsGroupSignalOfRxAccessInfoType 0 0 0 1 ECU_ADDRESS 0x0 /end MEASUREMENT
/begin MEASUREMENT Com_RxAccessInfo[161].RxDataTimeoutSubstitutionValueIdxOfRxAccessInfo "" UBYTE Com_RxDataTimeoutSubstitutionValueIdxOfRxAccessInfoType 0 0 0 255 ECU_ADDRESS 0x0 /end MEASUREMENT
/begin MEASUREMENT Com_RxAccessInfo[161].RxDataTimeoutSubstitutionValueOfRxAccessInfo "" UBYTE Com_RxDataTimeoutSubstitutionValueOfRxAccessInfoType 0 0 0 255 ECU_ADDRESS 0x0 /end MEASUREMENT
/begin MEASUREMENT Com_RxAccessInfo[161].RxPduInfoIdxOfRxAccessInfo "" UBYTE NO_COMPU_METHOD 0 0 0 255 ECU_ADDRESS 0x0 /end MEASUREMENT
/begin MEASUREMENT Com_RxAccessInfo[161].RxSigBufferArrayBasedBufferEndIdxOfRxAccessInfo "" UBYTE Com_RxSigBufferArrayBasedBufferEndIdxOfRxAccessInfoType 0 0 0 255 ECU_ADDRESS 0x0 /end MEASUREMENT
/begin MEASUREMENT Com_RxAccessInfo[161].RxSigBufferArrayBasedBufferStartIdxOfRxAccessInfo "" UBYTE Com_RxSigBufferArrayBasedBufferStartIdxOfRxAccessInfoType 0 0 0 255 ECU_ADDRESS 0x0 /end MEASUREMENT
/begin MEASUREMENT Com_RxAccessInfo[161].RxSigBufferArrayBasedShdBufferEndIdxOfRxAccessInfo "" UBYTE Com_RxSigBufferArrayBasedShdBufferEndIdxOfRxAccessInfoType 0 0 0 255 ECU_ADDRESS 0x0 /end MEASUREMENT
/begin MEASUREMENT Com_RxAccessInfo[161].RxSigBufferArrayBasedShdBufferStartIdxOfRxAccessInfo "" UBYTE Com_RxSigBufferArrayBasedShdBufferStartIdxOfRxAccessInfoType 0 0 0 255 ECU_ADDRESS 0x0 /end MEASUREMENT
/begin MEASUREMENT Com_RxAccessInfo[161].RxTOutInfoIdxOfRxAccessInfo "" UBYTE Com_RxTOutInfoIdxOfRxAccessInfoType 0 0 0 255 ECU_ADDRESS 0x0 /end MEASUREMENT
/begin MEASUREMENT Com_RxAccessInfo[161].ShdBufferIdxOfRxAccessInfo "" UWORD Com_ShdBufferIdxOfRxAccessInfoType 0 0 0 65535 ECU_ADDRESS 0x0 /end MEASUREMENT
/begin MEASUREMENT Com_RxAccessInfo[161].SignalLengthInByteOfRxAccessInfo "" UBYTE NO_COMPU_METHOD 0 0 0 255 ECU_ADDRESS 0x0 /end MEASUREMENT
/begin MEASUREMENT Com_RxAccessInfo[161].StartByteInPduPositionOfRxAccessInfo "" UBYTE NO_COMPU_METHOD 0 0 0 255 ECU_ADDRESS 0x0 /end MEASUREMENT
/begin MEASUREMENT Com_RxAccessInfo[161].TmpBufferIdxOfRxAccessInfo "" UBYTE Com_TmpBufferIdxOfRxAccessInfoType 0 0 0 255 ECU_ADDRESS 0x0 /end MEASUREMENT
/begin MEASUREMENT Com_RxAccessInfo[161].TmpBufferOfRxAccessInfo "" UBYTE Com_TmpBufferOfRxAccessInfoType 0 0 0 255 ECU_ADDRESS 0x0 /end MEASUREMENT
/begin MEASUREMENT Com_RxAccessInfo[161].TmpRxShdBufferArrayBasedTmpBufferEndIdxOfRxAccessInfo "" UBYTE Com_TmpRxShdBufferArrayBasedTmpBufferEndIdxOfRxAccessInfoType 0 0 0 255 ECU_ADDRESS 0x0 /end MEASUREMENT
/begin MEASUREMENT Com_RxAccessInfo[161].TmpRxShdBufferArrayBasedTmpBufferStartIdxOfRxAccessInfo "" UBYTE Com_TmpRxShdBufferArrayBasedTmpBufferStartIdxOfRxAccessInfoType 0 0 0 255 ECU_ADDRESS 0x0 /end MEASUREMENT
/begin MEASUREMENT Com_RxAccessInfo[162].ApplTypeOfRxAccessInfo "" UBYTE Com_ApplTypeOfRxAccessInfoType 0 0 0 255 ECU_ADDRESS 0x0 /end MEASUREMENT
/begin MEASUREMENT Com_RxAccessInfo[162].BitLengthOfRxAccessInfo "" UWORD NO_COMPU_METHOD 0 0 0 65535 ECU_ADDRESS 0x0 /end MEASUREMENT
/begin MEASUREMENT Com_RxAccessInfo[162].BitPositionOfRxAccessInfo "" UWORD NO_COMPU_METHOD 0 0 0 65535 ECU_ADDRESS 0x0 /end MEASUREMENT
/begin MEASUREMENT Com_RxAccessInfo[162].BufferIdxOfRxAccessInfo "" UWORD Com_BufferIdxOfRxAccessInfoType 0 0 0 65535 ECU_ADDRESS 0x0 /end MEASUREMENT
/begin MEASUREMENT Com_RxAccessInfo[162].BusAccOfRxAccessInfo "" UBYTE Com_BusAccOfRxAccessInfoType 0 0 0 255 ECU_ADDRESS 0x0 /end MEASUREMENT
/begin MEASUREMENT Com_RxAccessInfo[162].ByteLengthOfRxAccessInfo "" UBYTE NO_COMPU_METHOD 0 0 0 255 ECU_ADDRESS 0x0 /end MEASUREMENT
/begin MEASUREMENT Com_RxAccessInfo[162].ConstValueArrayBasedInitValueEndIdxOfRxAccessInfo "" UBYTE Com_ConstValueArrayBasedInitValueEndIdxOfRxAccessInfoType 0 0 0 255 ECU_ADDRESS 0x0 /end MEASUREMENT
/begin MEASUREMENT Com_RxAccessInfo[162].ConstValueArrayBasedInitValueStartIdxOfRxAccessInfo "" UBYTE Com_ConstValueArrayBasedInitValueStartIdxOfRxAccessInfoType 0 0 0 255 ECU_ADDRESS 0x0 /end MEASUREMENT
/begin MEASUREMENT Com_RxAccessInfo[162].DynSignalOfRxAccessInfo "" UBYTE Com_DynSignalOfRxAccessInfoType 0 0 0 1 ECU_ADDRESS 0x0 /end MEASUREMENT
/begin MEASUREMENT Com_RxAccessInfo[162].InitValueIdxOfRxAccessInfo "" UBYTE Com_InitValueIdxOfRxAccessInfoType 0 0 0 255 ECU_ADDRESS 0x0 /end MEASUREMENT
/begin MEASUREMENT Com_RxAccessInfo[162].InitValueOfRxAccessInfo "" UBYTE Com_InitValueOfRxAccessInfoType 0 0 0 255 ECU_ADDRESS 0x0 /end MEASUREMENT
/begin MEASUREMENT Com_RxAccessInfo[162].InvValueIdxOfRxAccessInfo "" UBYTE Com_InvValueIdxOfRxAccessInfoType 0 0 0 255 ECU_ADDRESS 0x0 /end MEASUREMENT
/begin MEASUREMENT Com_RxAccessInfo[162].InvValueOfRxAccessInfo "" UBYTE Com_InvValueOfRxAccessInfoType 0 0 0 255 ECU_ADDRESS 0x0 /end MEASUREMENT
/begin MEASUREMENT Com_RxAccessInfo[162].IsGroupSignalOfRxAccessInfo "" UBYTE Com_IsGroupSignalOfRxAccessInfoType 0 0 0 1 ECU_ADDRESS 0x0 /end MEASUREMENT
/begin MEASUREMENT Com_RxAccessInfo[162].RxDataTimeoutSubstitutionValueIdxOfRxAccessInfo "" UBYTE Com_RxDataTimeoutSubstitutionValueIdxOfRxAccessInfoType 0 0 0 255 ECU_ADDRESS 0x0 /end MEASUREMENT
/begin MEASUREMENT Com_RxAccessInfo[162].RxDataTimeoutSubstitutionValueOfRxAccessInfo "" UBYTE Com_RxDataTimeoutSubstitutionValueOfRxAccessInfoType 0 0 0 255 ECU_ADDRESS 0x0 /end MEASUREMENT
/begin MEASUREMENT Com_RxAccessInfo[162].RxPduInfoIdxOfRxAccessInfo "" UBYTE NO_COMPU_METHOD 0 0 0 255 ECU_ADDRESS 0x0 /end MEASUREMENT
/begin MEASUREMENT Com_RxAccessInfo[162].RxSigBufferArrayBasedBufferEndIdxOfRxAccessInfo "" UBYTE Com_RxSigBufferArrayBasedBufferEndIdxOfRxAccessInfoType 0 0 0 255 ECU_ADDRESS 0x0 /end MEASUREMENT
/begin MEASUREMENT Com_RxAccessInfo[162].RxSigBufferArrayBasedBufferStartIdxOfRxAccessInfo "" UBYTE Com_RxSigBufferArrayBasedBufferStartIdxOfRxAccessInfoType 0 0 0 255 ECU_ADDRESS 0x0 /end MEASUREMENT
/begin MEASUREMENT Com_RxAccessInfo[162].RxSigBufferArrayBasedShdBufferEndIdxOfRxAccessInfo "" UBYTE Com_RxSigBufferArrayBasedShdBufferEndIdxOfRxAccessInfoType 0 0 0 255 ECU_ADDRESS 0x0 /end MEASUREMENT
/begin MEASUREMENT Com_RxAccessInfo[162].RxSigBufferArrayBasedShdBufferStartIdxOfRxAccessInfo "" UBYTE Com_RxSigBufferArrayBasedShdBufferStartIdxOfRxAccessInfoType 0 0 0 255 ECU_ADDRESS 0x0 /end MEASUREMENT
/begin MEASUREMENT Com_RxAccessInfo[162].RxTOutInfoIdxOfRxAccessInfo "" UBYTE Com_RxTOutInfoIdxOfRxAccessInfoType 0 0 0 255 ECU_ADDRESS 0x0 /end MEASUREMENT
/begin MEASUREMENT Com_RxAccessInfo[162].ShdBufferIdxOfRxAccessInfo "" UWORD Com_ShdBufferIdxOfRxAccessInfoType 0 0 0 65535 ECU_ADDRESS 0x0 /end MEASUREMENT
/begin MEASUREMENT Com_RxAccessInfo[162].SignalLengthInByteOfRxAccessInfo "" UBYTE NO_COMPU_METHOD 0 0 0 255 ECU_ADDRESS 0x0 /end MEASUREMENT
/begin MEASUREMENT Com_RxAccessInfo[162].StartByteInPduPositionOfRxAccessInfo "" UBYTE NO_COMPU_METHOD 0 0 0 255 ECU_ADDRESS 0x0 /end MEASUREMENT
/begin MEASUREMENT Com_RxAccessInfo[162].TmpBufferIdxOfRxAccessInfo "" UBYTE Com_TmpBufferIdxOfRxAccessInfoType 0 0 0 255 ECU_ADDRESS 0x0 /end MEASUREMENT
/begin MEASUREMENT Com_RxAccessInfo[162].TmpBufferOfRxAccessInfo "" UBYTE Com_TmpBufferOfRxAccessInfoType 0 0 0 255 ECU_ADDRESS 0x0 /end MEASUREMENT
/begin MEASUREMENT Com_RxAccessInfo[162].TmpRxShdBufferArrayBasedTmpBufferEndIdxOfRxAccessInfo "" UBYTE Com_TmpRxShdBufferArrayBasedTmpBufferEndIdxOfRxAccessInfoType 0 0 0 255 ECU_ADDRESS 0x0 /end MEASUREMENT
/begin MEASUREMENT Com_RxAccessInfo[162].TmpRxShdBufferArrayBasedTmpBufferStartIdxOfRxAccessInfo "" UBYTE Com_TmpRxShdBufferArrayBasedTmpBufferStartIdxOfRxAccessInfoType 0 0 0 255 ECU_ADDRESS 0x0 /end MEASUREMENT
/begin MEASUREMENT Com_RxAccessInfo[163].ApplTypeOfRxAccessInfo "" UBYTE Com_ApplTypeOfRxAccessInfoType 0 0 0 255 ECU_ADDRESS 0x0 /end MEASUREMENT
/begin MEASUREMENT Com_RxAccessInfo[163].BitLengthOfRxAccessInfo "" UWORD NO_COMPU_METHOD 0 0 0 65535 ECU_ADDRESS 0x0 /end MEASUREMENT
/begin MEASUREMENT Com_RxAccessInfo[163].BitPositionOfRxAccessInfo "" UWORD NO_COMPU_METHOD 0 0 0 65535 ECU_ADDRESS 0x0 /end MEASUREMENT
/begin MEASUREMENT Com_RxAccessInfo[163].BufferIdxOfRxAccessInfo "" UWORD Com_BufferIdxOfRxAccessInfoType 0 0 0 65535 ECU_ADDRESS 0x0 /end MEASUREMENT
/begin MEASUREMENT Com_RxAccessInfo[163].BusAccOfRxAccessInfo "" UBYTE Com_BusAccOfRxAccessInfoType 0 0 0 255 ECU_ADDRESS 0x0 /end MEASUREMENT
/begin MEASUREMENT Com_RxAccessInfo[163].ByteLengthOfRxAccessInfo "" UBYTE NO_COMPU_METHOD 0 0 0 255 ECU_ADDRESS 0x0 /end MEASUREMENT
/begin MEASUREMENT Com_RxAccessInfo[163].ConstValueArrayBasedInitValueEndIdxOfRxAccessInfo "" UBYTE Com_ConstValueArrayBasedInitValueEndIdxOfRxAccessInfoType 0 0 0 255 ECU_ADDRESS 0x0 /end MEASUREMENT
/begin MEASUREMENT Com_RxAccessInfo[163].ConstValueArrayBasedInitValueStartIdxOfRxAccessInfo "" UBYTE Com_ConstValueArrayBasedInitValueStartIdxOfRxAccessInfoType 0 0 0 255 ECU_ADDRESS 0x0 /end MEASUREMENT
/begin MEASUREMENT Com_RxAccessInfo[163].DynSignalOfRxAccessInfo "" UBYTE Com_DynSignalOfRxAccessInfoType 0 0 0 1 ECU_ADDRESS 0x0 /end MEASUREMENT
/begin MEASUREMENT Com_RxAccessInfo[163].InitValueIdxOfRxAccessInfo "" UBYTE Com_InitValueIdxOfRxAccessInfoType 0 0 0 255 ECU_ADDRESS 0x0 /end MEASUREMENT
/begin MEASUREMENT Com_RxAccessInfo[163].InitValueOfRxAccessInfo "" UBYTE Com_InitValueOfRxAccessInfoType 0 0 0 255 ECU_ADDRESS 0x0 /end MEASUREMENT
/begin MEASUREMENT Com_RxAccessInfo[163].InvValueIdxOfRxAccessInfo "" UBYTE Com_InvValueIdxOfRxAccessInfoType 0 0 0 255 ECU_ADDRESS 0x0 /end MEASUREMENT
/begin MEASUREMENT Com_RxAccessInfo[163].InvValueOfRxAccessInfo "" UBYTE Com_InvValueOfRxAccessInfoType 0 0 0 255 ECU_ADDRESS 0x0 /end MEASUREMENT
/begin MEASUREMENT Com_RxAccessInfo[163].IsGroupSignalOfRxAccessInfo "" UBYTE Com_IsGroupSignalOfRxAccessInfoType 0 0 0 1 ECU_ADDRESS 0x0 /end MEASUREMENT
/begin MEASUREMENT Com_RxAccessInfo[163].RxDataTimeoutSubstitutionValueIdxOfRxAccessInfo "" UBYTE Com_RxDataTimeoutSubstitutionValueIdxOfRxAccessInfoType 0 0 0 255 ECU_ADDRESS 0x0 /end MEASUREMENT
/begin MEASUREMENT Com_RxAccessInfo[163].RxDataTimeoutSubstitutionValueOfRxAccessInfo "" UBYTE Com_RxDataTimeoutSubstitutionValueOfRxAccessInfoType 0 0 0 255 ECU_ADDRESS 0x0 /end MEASUREMENT
/begin MEASUREMENT Com_RxAccessInfo[163].RxPduInfoIdxOfRxAccessInfo "" UBYTE NO_COMPU_METHOD 0 0 0 255 ECU_ADDRESS 0x0 /end MEASUREMENT
/begin MEASUREMENT Com_RxAccessInfo[163].RxSigBufferArrayBasedBufferEndIdxOfRxAccessInfo "" UBYTE Com_RxSigBufferArrayBasedBufferEndIdxOfRxAccessInfoType 0 0 0 255 ECU_ADDRESS 0x0 /end MEASUREMENT
/begin MEASUREMENT Com_RxAccessInfo[163].RxSigBufferArrayBasedBufferStartIdxOfRxAccessInfo "" UBYTE Com_RxSigBufferArrayBasedBufferStartIdxOfRxAccessInfoType 0 0 0 255 ECU_ADDRESS 0x0 /end MEASUREMENT
/begin MEASUREMENT Com_RxAccessInfo[163].RxSigBufferArrayBasedShdBufferEndIdxOfRxAccessInfo "" UBYTE Com_RxSigBufferArrayBasedShdBufferEndIdxOfRxAccessInfoType 0 0 0 255 ECU_ADDRESS 0x0 /end MEASUREMENT
/begin MEASUREMENT Com_RxAccessInfo[163].RxSigBufferArrayBasedShdBufferStartIdxOfRxAccessInfo "" UBYTE Com_RxSigBufferArrayBasedShdBufferStartIdxOfRxAccessInfoType 0 0 0 255 ECU_ADDRESS 0x0 /end MEASUREMENT
/begin MEASUREMENT Com_RxAccessInfo[163].RxTOutInfoIdxOfRxAccessInfo "" UBYTE Com_RxTOutInfoIdxOfRxAccessInfoType 0 0 0 255 ECU_ADDRESS 0x0 /end MEASUREMENT
/begin MEASUREMENT Com_RxAccessInfo[163].ShdBufferIdxOfRxAccessInfo "" UWORD Com_ShdBufferIdxOfRxAccessInfoType 0 0 0 65535 ECU_ADDRESS 0x0 /end MEASUREMENT
/begin MEASUREMENT Com_RxAccessInfo[163].SignalLengthInByteOfRxAccessInfo "" UBYTE NO_COMPU_METHOD 0 0 0 255 ECU_ADDRESS 0x0 /end MEASUREMENT
/begin MEASUREMENT Com_RxAccessInfo[163].StartByteInPduPositionOfRxAccessInfo "" UBYTE NO_COMPU_METHOD 0 0 0 255 ECU_ADDRESS 0x0 /end MEASUREMENT
/begin MEASUREMENT Com_RxAccessInfo[163].TmpBufferIdxOfRxAccessInfo "" UBYTE Com_TmpBufferIdxOfRxAccessInfoType 0 0 0 255 ECU_ADDRESS 0x0 /end MEASUREMENT
/begin MEASUREMENT Com_RxAccessInfo[163].TmpBufferOfRxAccessInfo "" UBYTE Com_TmpBufferOfRxAccessInfoType 0 0 0 255 ECU_ADDRESS 0x0 /end MEASUREMENT
/begin MEASUREMENT Com_RxAccessInfo[163].TmpRxShdBufferArrayBasedTmpBufferEndIdxOfRxAccessInfo "" UBYTE Com_TmpRxShdBufferArrayBasedTmpBufferEndIdxOfRxAccessInfoType 0 0 0 255 ECU_ADDRESS 0x0 /end MEASUREMENT
/begin MEASUREMENT Com_RxAccessInfo[163].TmpRxShdBufferArrayBasedTmpBufferStartIdxOfRxAccessInfo "" UBYTE Com_TmpRxShdBufferArrayBasedTmpBufferStartIdxOfRxAccessInfoType 0 0 0 255 ECU_ADDRESS 0x0 /end MEASUREMENT
/begin MEASUREMENT Com_RxAccessInfo[164].ApplTypeOfRxAccessInfo "" UBYTE Com_ApplTypeOfRxAccessInfoType 0 0 0 255 ECU_ADDRESS 0x0 /end MEASUREMENT
/begin MEASUREMENT Com_RxAccessInfo[164].BitLengthOfRxAccessInfo "" UWORD NO_COMPU_METHOD 0 0 0 65535 ECU_ADDRESS 0x0 /end MEASUREMENT
/begin MEASUREMENT Com_RxAccessInfo[164].BitPositionOfRxAccessInfo "" UWORD NO_COMPU_METHOD 0 0 0 65535 ECU_ADDRESS 0x0 /end MEASUREMENT
/begin MEASUREMENT Com_RxAccessInfo[164].BufferIdxOfRxAccessInfo "" UWORD Com_BufferIdxOfRxAccessInfoType 0 0 0 65535 ECU_ADDRESS 0x0 /end MEASUREMENT
/begin MEASUREMENT Com_RxAccessInfo[164].BusAccOfRxAccessInfo "" UBYTE Com_BusAccOfRxAccessInfoType 0 0 0 255 ECU_ADDRESS 0x0 /end MEASUREMENT
/begin MEASUREMENT Com_RxAccessInfo[164].ByteLengthOfRxAccessInfo "" UBYTE NO_COMPU_METHOD 0 0 0 255 ECU_ADDRESS 0x0 /end MEASUREMENT
/begin MEASUREMENT Com_RxAccessInfo[164].ConstValueArrayBasedInitValueEndIdxOfRxAccessInfo "" UBYTE Com_ConstValueArrayBasedInitValueEndIdxOfRxAccessInfoType 0 0 0 255 ECU_ADDRESS 0x0 /end MEASUREMENT
/begin MEASUREMENT Com_RxAccessInfo[164].ConstValueArrayBasedInitValueStartIdxOfRxAccessInfo "" UBYTE Com_ConstValueArrayBasedInitValueStartIdxOfRxAccessInfoType 0 0 0 255 ECU_ADDRESS 0x0 /end MEASUREMENT
/begin MEASUREMENT Com_RxAccessInfo[164].DynSignalOfRxAccessInfo "" UBYTE Com_DynSignalOfRxAccessInfoType 0 0 0 1 ECU_ADDRESS 0x0 /end MEASUREMENT
/begin MEASUREMENT Com_RxAccessInfo[164].InitValueIdxOfRxAccessInfo "" UBYTE Com_InitValueIdxOfRxAccessInfoType 0 0 0 255 ECU_ADDRESS 0x0 /end MEASUREMENT
/begin MEASUREMENT Com_RxAccessInfo[164].InitValueOfRxAccessInfo "" UBYTE Com_InitValueOfRxAccessInfoType 0 0 0 255 ECU_ADDRESS 0x0 /end MEASUREMENT
/begin MEASUREMENT Com_RxAccessInfo[164].InvValueIdxOfRxAccessInfo "" UBYTE Com_InvValueIdxOfRxAccessInfoType 0 0 0 255 ECU_ADDRESS 0x0 /end MEASUREMENT
/begin MEASUREMENT Com_RxAccessInfo[164].InvValueOfRxAccessInfo "" UBYTE Com_InvValueOfRxAccessInfoType 0 0 0 255 ECU_ADDRESS 0x0 /end MEASUREMENT
/begin MEASUREMENT Com_RxAccessInfo[164].IsGroupSignalOfRxAccessInfo "" UBYTE Com_IsGroupSignalOfRxAccessInfoType 0 0 0 1 ECU_ADDRESS 0x0 /end MEASUREMENT
/begin MEASUREMENT Com_RxAccessInfo[164].RxDataTimeoutSubstitutionValueIdxOfRxAccessInfo "" UBYTE Com_RxDataTimeoutSubstitutionValueIdxOfRxAccessInfoType 0 0 0 255 ECU_ADDRESS 0x0 /end MEASUREMENT
/begin MEASUREMENT Com_RxAccessInfo[164].RxDataTimeoutSubstitutionValueOfRxAccessInfo "" UBYTE Com_RxDataTimeoutSubstitutionValueOfRxAccessInfoType 0 0 0 255 ECU_ADDRESS 0x0 /end MEASUREMENT
/begin MEASUREMENT Com_RxAccessInfo[164].RxPduInfoIdxOfRxAccessInfo "" UBYTE NO_COMPU_METHOD 0 0 0 255 ECU_ADDRESS 0x0 /end MEASUREMENT
/begin MEASUREMENT Com_RxAccessInfo[164].RxSigBufferArrayBasedBufferEndIdxOfRxAccessInfo "" UBYTE Com_RxSigBufferArrayBasedBufferEndIdxOfRxAccessInfoType 0 0 0 255 ECU_ADDRESS 0x0 /end MEASUREMENT
/begin MEASUREMENT Com_RxAccessInfo[164].RxSigBufferArrayBasedBufferStartIdxOfRxAccessInfo "" UBYTE Com_RxSigBufferArrayBasedBufferStartIdxOfRxAccessInfoType 0 0 0 255 ECU_ADDRESS 0x0 /end MEASUREMENT
/begin MEASUREMENT Com_RxAccessInfo[164].RxSigBufferArrayBasedShdBufferEndIdxOfRxAccessInfo "" UBYTE Com_RxSigBufferArrayBasedShdBufferEndIdxOfRxAccessInfoType 0 0 0 255 ECU_ADDRESS 0x0 /end MEASUREMENT
/begin MEASUREMENT Com_RxAccessInfo[164].RxSigBufferArrayBasedShdBufferStartIdxOfRxAccessInfo "" UBYTE Com_RxSigBufferArrayBasedShdBufferStartIdxOfRxAccessInfoType 0 0 0 255 ECU_ADDRESS 0x0 /end MEASUREMENT
/begin MEASUREMENT Com_RxAccessInfo[164].RxTOutInfoIdxOfRxAccessInfo "" UBYTE Com_RxTOutInfoIdxOfRxAccessInfoType 0 0 0 255 ECU_ADDRESS 0x0 /end MEASUREMENT
/begin MEASUREMENT Com_RxAccessInfo[164].ShdBufferIdxOfRxAccessInfo "" UWORD Com_ShdBufferIdxOfRxAccessInfoType 0 0 0 65535 ECU_ADDRESS 0x0 /end MEASUREMENT
/begin MEASUREMENT Com_RxAccessInfo[164].SignalLengthInByteOfRxAccessInfo "" UBYTE NO_COMPU_METHOD 0 0 0 255 ECU_ADDRESS 0x0 /end MEASUREMENT
/begin MEASUREMENT Com_RxAccessInfo[164].StartByteInPduPositionOfRxAccessInfo "" UBYTE NO_COMPU_METHOD 0 0 0 255 ECU_ADDRESS 0x0 /end MEASUREMENT
/begin MEASUREMENT Com_RxAccessInfo[164].TmpBufferIdxOfRxAccessInfo "" UBYTE Com_TmpBufferIdxOfRxAccessInfoType 0 0 0 255 ECU_ADDRESS 0x0 /end MEASUREMENT
/begin MEASUREMENT Com_RxAccessInfo[164].TmpBufferOfRxAccessInfo "" UBYTE Com_TmpBufferOfRxAccessInfoType 0 0 0 255 ECU_ADDRESS 0x0 /end MEASUREMENT
/begin MEASUREMENT Com_RxAccessInfo[164].TmpRxShdBufferArrayBasedTmpBufferEndIdxOfRxAccessInfo "" UBYTE Com_TmpRxShdBufferArrayBasedTmpBufferEndIdxOfRxAccessInfoType 0 0 0 255 ECU_ADDRESS 0x0 /end MEASUREMENT
/begin MEASUREMENT Com_RxAccessInfo[164].TmpRxShdBufferArrayBasedTmpBufferStartIdxOfRxAccessInfo "" UBYTE Com_TmpRxShdBufferArrayBasedTmpBufferStartIdxOfRxAccessInfoType 0 0 0 255 ECU_ADDRESS 0x0 /end MEASUREMENT
/begin MEASUREMENT Com_RxAccessInfo[165].ApplTypeOfRxAccessInfo "" UBYTE Com_ApplTypeOfRxAccessInfoType 0 0 0 255 ECU_ADDRESS 0x0 /end MEASUREMENT
/begin MEASUREMENT Com_RxAccessInfo[165].BitLengthOfRxAccessInfo "" UWORD NO_COMPU_METHOD 0 0 0 65535 ECU_ADDRESS 0x0 /end MEASUREMENT
/begin MEASUREMENT Com_RxAccessInfo[165].BitPositionOfRxAccessInfo "" UWORD NO_COMPU_METHOD 0 0 0 65535 ECU_ADDRESS 0x0 /end MEASUREMENT
/begin MEASUREMENT Com_RxAccessInfo[165].BufferIdxOfRxAccessInfo "" UWORD Com_BufferIdxOfRxAccessInfoType 0 0 0 65535 ECU_ADDRESS 0x0 /end MEASUREMENT
/begin MEASUREMENT Com_RxAccessInfo[165].BusAccOfRxAccessInfo "" UBYTE Com_BusAccOfRxAccessInfoType 0 0 0 255 ECU_ADDRESS 0x0 /end MEASUREMENT
/begin MEASUREMENT Com_RxAccessInfo[165].ByteLengthOfRxAccessInfo "" UBYTE NO_COMPU_METHOD 0 0 0 255 ECU_ADDRESS 0x0 /end MEASUREMENT
/begin MEASUREMENT Com_RxAccessInfo[165].ConstValueArrayBasedInitValueEndIdxOfRxAccessInfo "" UBYTE Com_ConstValueArrayBasedInitValueEndIdxOfRxAccessInfoType 0 0 0 255 ECU_ADDRESS 0x0 /end MEASUREMENT
/begin MEASUREMENT Com_RxAccessInfo[165].ConstValueArrayBasedInitValueStartIdxOfRxAccessInfo "" UBYTE Com_ConstValueArrayBasedInitValueStartIdxOfRxAccessInfoType 0 0 0 255 ECU_ADDRESS 0x0 /end MEASUREMENT
/begin MEASUREMENT Com_RxAccessInfo[165].DynSignalOfRxAccessInfo "" UBYTE Com_DynSignalOfRxAccessInfoType 0 0 0 1 ECU_ADDRESS 0x0 /end MEASUREMENT
/begin MEASUREMENT Com_RxAccessInfo[165].InitValueIdxOfRxAccessInfo "" UBYTE Com_InitValueIdxOfRxAccessInfoType 0 0 0 255 ECU_ADDRESS 0x0 /end MEASUREMENT
/begin MEASUREMENT Com_RxAccessInfo[165].InitValueOfRxAccessInfo "" UBYTE Com_InitValueOfRxAccessInfoType 0 0 0 255 ECU_ADDRESS 0x0 /end MEASUREMENT
/begin MEASUREMENT Com_RxAccessInfo[165].InvValueIdxOfRxAccessInfo "" UBYTE Com_InvValueIdxOfRxAccessInfoType 0 0 0 255 ECU_ADDRESS 0x0 /end MEASUREMENT
/begin MEASUREMENT Com_RxAccessInfo[165].InvValueOfRxAccessInfo "" UBYTE Com_InvValueOfRxAccessInfoType 0 0 0 255 ECU_ADDRESS 0x0 /end MEASUREMENT
/begin MEASUREMENT Com_RxAccessInfo[165].IsGroupSignalOfRxAccessInfo "" UBYTE Com_IsGroupSignalOfRxAccessInfoType 0 0 0 1 ECU_ADDRESS 0x0 /end MEASUREMENT
/begin MEASUREMENT Com_RxAccessInfo[165].RxDataTimeoutSubstitutionValueIdxOfRxAccessInfo "" UBYTE Com_RxDataTimeoutSubstitutionValueIdxOfRxAccessInfoType 0 0 0 255 ECU_ADDRESS 0x0 /end MEASUREMENT
/begin MEASUREMENT Com_RxAccessInfo[165].RxDataTimeoutSubstitutionValueOfRxAccessInfo "" UBYTE Com_RxDataTimeoutSubstitutionValueOfRxAccessInfoType 0 0 0 255 ECU_ADDRESS 0x0 /end MEASUREMENT
/begin MEASUREMENT Com_RxAccessInfo[165].RxPduInfoIdxOfRxAccessInfo "" UBYTE NO_COMPU_METHOD 0 0 0 255 ECU_ADDRESS 0x0 /end MEASUREMENT
/begin MEASUREMENT Com_RxAccessInfo[165].RxSigBufferArrayBasedBufferEndIdxOfRxAccessInfo "" UBYTE Com_RxSigBufferArrayBasedBufferEndIdxOfRxAccessInfoType 0 0 0 255 ECU_ADDRESS 0x0 /end MEASUREMENT
/begin MEASUREMENT Com_RxAccessInfo[165].RxSigBufferArrayBasedBufferStartIdxOfRxAccessInfo "" UBYTE Com_RxSigBufferArrayBasedBufferStartIdxOfRxAccessInfoType 0 0 0 255 ECU_ADDRESS 0x0 /end MEASUREMENT
/begin MEASUREMENT Com_RxAccessInfo[165].RxSigBufferArrayBasedShdBufferEndIdxOfRxAccessInfo "" UBYTE Com_RxSigBufferArrayBasedShdBufferEndIdxOfRxAccessInfoType 0 0 0 255 ECU_ADDRESS 0x0 /end MEASUREMENT
/begin MEASUREMENT Com_RxAccessInfo[165].RxSigBufferArrayBasedShdBufferStartIdxOfRxAccessInfo "" UBYTE Com_RxSigBufferArrayBasedShdBufferStartIdxOfRxAccessInfoType 0 0 0 255 ECU_ADDRESS 0x0 /end MEASUREMENT
/begin MEASUREMENT Com_RxAccessInfo[165].RxTOutInfoIdxOfRxAccessInfo "" UBYTE Com_RxTOutInfoIdxOfRxAccessInfoType 0 0 0 255 ECU_ADDRESS 0x0 /end MEASUREMENT
/begin MEASUREMENT Com_RxAccessInfo[165].ShdBufferIdxOfRxAccessInfo "" UWORD Com_ShdBufferIdxOfRxAccessInfoType 0 0 0 65535 ECU_ADDRESS 0x0 /end MEASUREMENT
/begin MEASUREMENT Com_RxAccessInfo[165].SignalLengthInByteOfRxAccessInfo "" UBYTE NO_COMPU_METHOD 0 0 0 255 ECU_ADDRESS 0x0 /end MEASUREMENT
/begin MEASUREMENT Com_RxAccessInfo[165].StartByteInPduPositionOfRxAccessInfo "" UBYTE NO_COMPU_METHOD 0 0 0 255 ECU_ADDRESS 0x0 /end MEASUREMENT
/begin MEASUREMENT Com_RxAccessInfo[165].TmpBufferIdxOfRxAccessInfo "" UBYTE Com_TmpBufferIdxOfRxAccessInfoType 0 0 0 255 ECU_ADDRESS 0x0 /end MEASUREMENT
/begin MEASUREMENT Com_RxAccessInfo[165].TmpBufferOfRxAccessInfo "" UBYTE Com_TmpBufferOfRxAccessInfoType 0 0 0 255 ECU_ADDRESS 0x0 /end MEASUREMENT
/begin MEASUREMENT Com_RxAccessInfo[165].TmpRxShdBufferArrayBasedTmpBufferEndIdxOfRxAccessInfo "" UBYTE Com_TmpRxShdBufferArrayBasedTmpBufferEndIdxOfRxAccessInfoType 0 0 0 255 ECU_ADDRESS 0x0 /end MEASUREMENT
/begin MEASUREMENT Com_RxAccessInfo[165].TmpRxShdBufferArrayBasedTmpBufferStartIdxOfRxAccessInfo "" UBYTE Com_TmpRxShdBufferArrayBasedTmpBufferStartIdxOfRxAccessInfoType 0 0 0 255 ECU_ADDRESS 0x0 /end MEASUREMENT
/begin MEASUREMENT Com_RxAccessInfo[166].ApplTypeOfRxAccessInfo "" UBYTE Com_ApplTypeOfRxAccessInfoType 0 0 0 255 ECU_ADDRESS 0x0 /end MEASUREMENT
/begin MEASUREMENT Com_RxAccessInfo[166].BitLengthOfRxAccessInfo "" UWORD NO_COMPU_METHOD 0 0 0 65535 ECU_ADDRESS 0x0 /end MEASUREMENT
/begin MEASUREMENT Com_RxAccessInfo[166].BitPositionOfRxAccessInfo "" UWORD NO_COMPU_METHOD 0 0 0 65535 ECU_ADDRESS 0x0 /end MEASUREMENT
/begin MEASUREMENT Com_RxAccessInfo[166].BufferIdxOfRxAccessInfo "" UWORD Com_BufferIdxOfRxAccessInfoType 0 0 0 65535 ECU_ADDRESS 0x0 /end MEASUREMENT
/begin MEASUREMENT Com_RxAccessInfo[166].BusAccOfRxAccessInfo "" UBYTE Com_BusAccOfRxAccessInfoType 0 0 0 255 ECU_ADDRESS 0x0 /end MEASUREMENT
/begin MEASUREMENT Com_RxAccessInfo[166].ByteLengthOfRxAccessInfo "" UBYTE NO_COMPU_METHOD 0 0 0 255 ECU_ADDRESS 0x0 /end MEASUREMENT
/begin MEASUREMENT Com_RxAccessInfo[166].ConstValueArrayBasedInitValueEndIdxOfRxAccessInfo "" UBYTE Com_ConstValueArrayBasedInitValueEndIdxOfRxAccessInfoType 0 0 0 255 ECU_ADDRESS 0x0 /end MEASUREMENT
/begin MEASUREMENT Com_RxAccessInfo[166].ConstValueArrayBasedInitValueStartIdxOfRxAccessInfo "" UBYTE Com_ConstValueArrayBasedInitValueStartIdxOfRxAccessInfoType 0 0 0 255 ECU_ADDRESS 0x0 /end MEASUREMENT
/begin MEASUREMENT Com_RxAccessInfo[166].DynSignalOfRxAccessInfo "" UBYTE Com_DynSignalOfRxAccessInfoType 0 0 0 1 ECU_ADDRESS 0x0 /end MEASUREMENT
/begin MEASUREMENT Com_RxAccessInfo[166].InitValueIdxOfRxAccessInfo "" UBYTE Com_InitValueIdxOfRxAccessInfoType 0 0 0 255 ECU_ADDRESS 0x0 /end MEASUREMENT
/begin MEASUREMENT Com_RxAccessInfo[166].InitValueOfRxAccessInfo "" UBYTE Com_InitValueOfRxAccessInfoType 0 0 0 255 ECU_ADDRESS 0x0 /end MEASUREMENT
/begin MEASUREMENT Com_RxAccessInfo[166].InvValueIdxOfRxAccessInfo "" UBYTE Com_InvValueIdxOfRxAccessInfoType 0 0 0 255 ECU_ADDRESS 0x0 /end MEASUREMENT
/begin MEASUREMENT Com_RxAccessInfo[166].InvValueOfRxAccessInfo "" UBYTE Com_InvValueOfRxAccessInfoType 0 0 0 255 ECU_ADDRESS 0x0 /end MEASUREMENT
/begin MEASUREMENT Com_RxAccessInfo[166].IsGroupSignalOfRxAccessInfo "" UBYTE Com_IsGroupSignalOfRxAccessInfoType 0 0 0 1 ECU_ADDRESS 0x0 /end MEASUREMENT
/begin MEASUREMENT Com_RxAccessInfo[166].RxDataTimeoutSubstitutionValueIdxOfRxAccessInfo "" UBYTE Com_RxDataTimeoutSubstitutionValueIdxOfRxAccessInfoType 0 0 0 255 ECU_ADDRESS 0x0 /end MEASUREMENT
/begin MEASUREMENT Com_RxAccessInfo[166].RxDataTimeoutSubstitutionValueOfRxAccessInfo "" UBYTE Com_RxDataTimeoutSubstitutionValueOfRxAccessInfoType 0 0 0 255 ECU_ADDRESS 0x0 /end MEASUREMENT
/begin MEASUREMENT Com_RxAccessInfo[166].RxPduInfoIdxOfRxAccessInfo "" UBYTE NO_COMPU_METHOD 0 0 0 255 ECU_ADDRESS 0x0 /end MEASUREMENT
/begin MEASUREMENT Com_RxAccessInfo[166].RxSigBufferArrayBasedBufferEndIdxOfRxAccessInfo "" UBYTE Com_RxSigBufferArrayBasedBufferEndIdxOfRxAccessInfoType 0 0 0 255 ECU_ADDRESS 0x0 /end MEASUREMENT
/begin MEASUREMENT Com_RxAccessInfo[166].RxSigBufferArrayBasedBufferStartIdxOfRxAccessInfo "" UBYTE Com_RxSigBufferArrayBasedBufferStartIdxOfRxAccessInfoType 0 0 0 255 ECU_ADDRESS 0x0 /end MEASUREMENT
/begin MEASUREMENT Com_RxAccessInfo[166].RxSigBufferArrayBasedShdBufferEndIdxOfRxAccessInfo "" UBYTE Com_RxSigBufferArrayBasedShdBufferEndIdxOfRxAccessInfoType 0 0 0 255 ECU_ADDRESS 0x0 /end MEASUREMENT
/begin MEASUREMENT Com_RxAccessInfo[166].RxSigBufferArrayBasedShdBufferStartIdxOfRxAccessInfo "" UBYTE Com_RxSigBufferArrayBasedShdBufferStartIdxOfRxAccessInfoType 0 0 0 255 ECU_ADDRESS 0x0 /end MEASUREMENT
/begin MEASUREMENT Com_RxAccessInfo[166].RxTOutInfoIdxOfRxAccessInfo "" UBYTE Com_RxTOutInfoIdxOfRxAccessInfoType 0 0 0 255 ECU_ADDRESS 0x0 /end MEASUREMENT
/begin MEASUREMENT Com_RxAccessInfo[166].ShdBufferIdxOfRxAccessInfo "" UWORD Com_ShdBufferIdxOfRxAccessInfoType 0 0 0 65535 ECU_ADDRESS 0x0 /end MEASUREMENT
/begin MEASUREMENT Com_RxAccessInfo[166].SignalLengthInByteOfRxAccessInfo "" UBYTE NO_COMPU_METHOD 0 0 0 255 ECU_ADDRESS 0x0 /end MEASUREMENT
/begin MEASUREMENT Com_RxAccessInfo[166].StartByteInPduPositionOfRxAccessInfo "" UBYTE NO_COMPU_METHOD 0 0 0 255 ECU_ADDRESS 0x0 /end MEASUREMENT
/begin MEASUREMENT Com_RxAccessInfo[166].TmpBufferIdxOfRxAccessInfo "" UBYTE Com_TmpBufferIdxOfRxAccessInfoType 0 0 0 255 ECU_ADDRESS 0x0 /end MEASUREMENT
/begin MEASUREMENT Com_RxAccessInfo[166].TmpBufferOfRxAccessInfo "" UBYTE Com_TmpBufferOfRxAccessInfoType 0 0 0 255 ECU_ADDRESS 0x0 /end MEASUREMENT
/begin MEASUREMENT Com_RxAccessInfo[166].TmpRxShdBufferArrayBasedTmpBufferEndIdxOfRxAccessInfo "" UBYTE Com_TmpRxShdBufferArrayBasedTmpBufferEndIdxOfRxAccessInfoType 0 0 0 255 ECU_ADDRESS 0x0 /end MEASUREMENT
/begin MEASUREMENT Com_RxAccessInfo[166].TmpRxShdBufferArrayBasedTmpBufferStartIdxOfRxAccessInfo "" UBYTE Com_TmpRxShdBufferArrayBasedTmpBufferStartIdxOfRxAccessInfoType 0 0 0 255 ECU_ADDRESS 0x0 /end MEASUREMENT
/begin MEASUREMENT Com_RxAccessInfo[167].ApplTypeOfRxAccessInfo "" UBYTE Com_ApplTypeOfRxAccessInfoType 0 0 0 255 ECU_ADDRESS 0x0 /end MEASUREMENT
/begin MEASUREMENT Com_RxAccessInfo[167].BitLengthOfRxAccessInfo "" UWORD NO_COMPU_METHOD 0 0 0 65535 ECU_ADDRESS 0x0 /end MEASUREMENT
/begin MEASUREMENT Com_RxAccessInfo[167].BitPositionOfRxAccessInfo "" UWORD NO_COMPU_METHOD 0 0 0 65535 ECU_ADDRESS 0x0 /end MEASUREMENT
/begin MEASUREMENT Com_RxAccessInfo[167].BufferIdxOfRxAccessInfo "" UWORD Com_BufferIdxOfRxAccessInfoType 0 0 0 65535 ECU_ADDRESS 0x0 /end MEASUREMENT
/begin MEASUREMENT Com_RxAccessInfo[167].BusAccOfRxAccessInfo "" UBYTE Com_BusAccOfRxAccessInfoType 0 0 0 255 ECU_ADDRESS 0x0 /end MEASUREMENT
/begin MEASUREMENT Com_RxAccessInfo[167].ByteLengthOfRxAccessInfo "" UBYTE NO_COMPU_METHOD 0 0 0 255 ECU_ADDRESS 0x0 /end MEASUREMENT
/begin MEASUREMENT Com_RxAccessInfo[167].ConstValueArrayBasedInitValueEndIdxOfRxAccessInfo "" UBYTE Com_ConstValueArrayBasedInitValueEndIdxOfRxAccessInfoType 0 0 0 255 ECU_ADDRESS 0x0 /end MEASUREMENT
/begin MEASUREMENT Com_RxAccessInfo[167].ConstValueArrayBasedInitValueStartIdxOfRxAccessInfo "" UBYTE Com_ConstValueArrayBasedInitValueStartIdxOfRxAccessInfoType 0 0 0 255 ECU_ADDRESS 0x0 /end MEASUREMENT
/begin MEASUREMENT Com_RxAccessInfo[167].DynSignalOfRxAccessInfo "" UBYTE Com_DynSignalOfRxAccessInfoType 0 0 0 1 ECU_ADDRESS 0x0 /end MEASUREMENT
/begin MEASUREMENT Com_RxAccessInfo[167].InitValueIdxOfRxAccessInfo "" UBYTE Com_InitValueIdxOfRxAccessInfoType 0 0 0 255 ECU_ADDRESS 0x0 /end MEASUREMENT
/begin MEASUREMENT Com_RxAccessInfo[167].InitValueOfRxAccessInfo "" UBYTE Com_InitValueOfRxAccessInfoType 0 0 0 255 ECU_ADDRESS 0x0 /end MEASUREMENT
/begin MEASUREMENT Com_RxAccessInfo[167].InvValueIdxOfRxAccessInfo "" UBYTE Com_InvValueIdxOfRxAccessInfoType 0 0 0 255 ECU_ADDRESS 0x0 /end MEASUREMENT
/begin MEASUREMENT Com_RxAccessInfo[167].InvValueOfRxAccessInfo "" UBYTE Com_InvValueOfRxAccessInfoType 0 0 0 255 ECU_ADDRESS 0x0 /end MEASUREMENT
/begin MEASUREMENT Com_RxAccessInfo[167].IsGroupSignalOfRxAccessInfo "" UBYTE Com_IsGroupSignalOfRxAccessInfoType 0 0 0 1 ECU_ADDRESS 0x0 /end MEASUREMENT
/begin MEASUREMENT Com_RxAccessInfo[167].RxDataTimeoutSubstitutionValueIdxOfRxAccessInfo "" UBYTE Com_RxDataTimeoutSubstitutionValueIdxOfRxAccessInfoType 0 0 0 255 ECU_ADDRESS 0x0 /end MEASUREMENT
/begin MEASUREMENT Com_RxAccessInfo[167].RxDataTimeoutSubstitutionValueOfRxAccessInfo "" UBYTE Com_RxDataTimeoutSubstitutionValueOfRxAccessInfoType 0 0 0 255 ECU_ADDRESS 0x0 /end MEASUREMENT
/begin MEASUREMENT Com_RxAccessInfo[167].RxPduInfoIdxOfRxAccessInfo "" UBYTE NO_COMPU_METHOD 0 0 0 255 ECU_ADDRESS 0x0 /end MEASUREMENT
/begin MEASUREMENT Com_RxAccessInfo[167].RxSigBufferArrayBasedBufferEndIdxOfRxAccessInfo "" UBYTE Com_RxSigBufferArrayBasedBufferEndIdxOfRxAccessInfoType 0 0 0 255 ECU_ADDRESS 0x0 /end MEASUREMENT
/begin MEASUREMENT Com_RxAccessInfo[167].RxSigBufferArrayBasedBufferStartIdxOfRxAccessInfo "" UBYTE Com_RxSigBufferArrayBasedBufferStartIdxOfRxAccessInfoType 0 0 0 255 ECU_ADDRESS 0x0 /end MEASUREMENT
/begin MEASUREMENT Com_RxAccessInfo[167].RxSigBufferArrayBasedShdBufferEndIdxOfRxAccessInfo "" UBYTE Com_RxSigBufferArrayBasedShdBufferEndIdxOfRxAccessInfoType 0 0 0 255 ECU_ADDRESS 0x0 /end MEASUREMENT
/begin MEASUREMENT Com_RxAccessInfo[167].RxSigBufferArrayBasedShdBufferStartIdxOfRxAccessInfo "" UBYTE Com_RxSigBufferArrayBasedShdBufferStartIdxOfRxAccessInfoType 0 0 0 255 ECU_ADDRESS 0x0 /end MEASUREMENT
/begin MEASUREMENT Com_RxAccessInfo[167].RxTOutInfoIdxOfRxAccessInfo "" UBYTE Com_RxTOutInfoIdxOfRxAccessInfoType 0 0 0 255 ECU_ADDRESS 0x0 /end MEASUREMENT
/begin MEASUREMENT Com_RxAccessInfo[167].ShdBufferIdxOfRxAccessInfo "" UWORD Com_ShdBufferIdxOfRxAccessInfoType 0 0 0 65535 ECU_ADDRESS 0x0 /end MEASUREMENT
/begin MEASUREMENT Com_RxAccessInfo[167].SignalLengthInByteOfRxAccessInfo "" UBYTE NO_COMPU_METHOD 0 0 0 255 ECU_ADDRESS 0x0 /end MEASUREMENT
/begin MEASUREMENT Com_RxAccessInfo[167].StartByteInPduPositionOfRxAccessInfo "" UBYTE NO_COMPU_METHOD 0 0 0 255 ECU_ADDRESS 0x0 /end MEASUREMENT
/begin MEASUREMENT Com_RxAccessInfo[167].TmpBufferIdxOfRxAccessInfo "" UBYTE Com_TmpBufferIdxOfRxAccessInfoType 0 0 0 255 ECU_ADDRESS 0x0 /end MEASUREMENT
/begin MEASUREMENT Com_RxAccessInfo[167].TmpBufferOfRxAccessInfo "" UBYTE Com_TmpBufferOfRxAccessInfoType 0 0 0 255 ECU_ADDRESS 0x0 /end MEASUREMENT
/begin MEASUREMENT Com_RxAccessInfo[167].TmpRxShdBufferArrayBasedTmpBufferEndIdxOfRxAccessInfo "" UBYTE Com_TmpRxShdBufferArrayBasedTmpBufferEndIdxOfRxAccessInfoType 0 0 0 255 ECU_ADDRESS 0x0 /end MEASUREMENT
/begin MEASUREMENT Com_RxAccessInfo[167].TmpRxShdBufferArrayBasedTmpBufferStartIdxOfRxAccessInfo "" UBYTE Com_TmpRxShdBufferArrayBasedTmpBufferStartIdxOfRxAccessInfoType 0 0 0 255 ECU_ADDRESS 0x0 /end MEASUREMENT
/begin MEASUREMENT Com_RxAccessInfo[168].ApplTypeOfRxAccessInfo "" UBYTE Com_ApplTypeOfRxAccessInfoType 0 0 0 255 ECU_ADDRESS 0x0 /end MEASUREMENT
/begin MEASUREMENT Com_RxAccessInfo[168].BitLengthOfRxAccessInfo "" UWORD NO_COMPU_METHOD 0 0 0 65535 ECU_ADDRESS 0x0 /end MEASUREMENT
/begin MEASUREMENT Com_RxAccessInfo[168].BitPositionOfRxAccessInfo "" UWORD NO_COMPU_METHOD 0 0 0 65535 ECU_ADDRESS 0x0 /end MEASUREMENT
/begin MEASUREMENT Com_RxAccessInfo[168].BufferIdxOfRxAccessInfo "" UWORD Com_BufferIdxOfRxAccessInfoType 0 0 0 65535 ECU_ADDRESS 0x0 /end MEASUREMENT
/begin MEASUREMENT Com_RxAccessInfo[168].BusAccOfRxAccessInfo "" UBYTE Com_BusAccOfRxAccessInfoType 0 0 0 255 ECU_ADDRESS 0x0 /end MEASUREMENT
/begin MEASUREMENT Com_RxAccessInfo[168].ByteLengthOfRxAccessInfo "" UBYTE NO_COMPU_METHOD 0 0 0 255 ECU_ADDRESS 0x0 /end MEASUREMENT
/begin MEASUREMENT Com_RxAccessInfo[168].ConstValueArrayBasedInitValueEndIdxOfRxAccessInfo "" UBYTE Com_ConstValueArrayBasedInitValueEndIdxOfRxAccessInfoType 0 0 0 255 ECU_ADDRESS 0x0 /end MEASUREMENT
/begin MEASUREMENT Com_RxAccessInfo[168].ConstValueArrayBasedInitValueStartIdxOfRxAccessInfo "" UBYTE Com_ConstValueArrayBasedInitValueStartIdxOfRxAccessInfoType 0 0 0 255 ECU_ADDRESS 0x0 /end MEASUREMENT
/begin MEASUREMENT Com_RxAccessInfo[168].DynSignalOfRxAccessInfo "" UBYTE Com_DynSignalOfRxAccessInfoType 0 0 0 1 ECU_ADDRESS 0x0 /end MEASUREMENT
/begin MEASUREMENT Com_RxAccessInfo[168].InitValueIdxOfRxAccessInfo "" UBYTE Com_InitValueIdxOfRxAccessInfoType 0 0 0 255 ECU_ADDRESS 0x0 /end MEASUREMENT
/begin MEASUREMENT Com_RxAccessInfo[168].InitValueOfRxAccessInfo "" UBYTE Com_InitValueOfRxAccessInfoType 0 0 0 255 ECU_ADDRESS 0x0 /end MEASUREMENT
/begin MEASUREMENT Com_RxAccessInfo[168].InvValueIdxOfRxAccessInfo "" UBYTE Com_InvValueIdxOfRxAccessInfoType 0 0 0 255 ECU_ADDRESS 0x0 /end MEASUREMENT
/begin MEASUREMENT Com_RxAccessInfo[168].InvValueOfRxAccessInfo "" UBYTE Com_InvValueOfRxAccessInfoType 0 0 0 255 ECU_ADDRESS 0x0 /end MEASUREMENT
/begin MEASUREMENT Com_RxAccessInfo[168].IsGroupSignalOfRxAccessInfo "" UBYTE Com_IsGroupSignalOfRxAccessInfoType 0 0 0 1 ECU_ADDRESS 0x0 /end MEASUREMENT
/begin MEASUREMENT Com_RxAccessInfo[168].RxDataTimeoutSubstitutionValueIdxOfRxAccessInfo "" UBYTE Com_RxDataTimeoutSubstitutionValueIdxOfRxAccessInfoType 0 0 0 255 ECU_ADDRESS 0x0 /end MEASUREMENT
/begin MEASUREMENT Com_RxAccessInfo[168].RxDataTimeoutSubstitutionValueOfRxAccessInfo "" UBYTE Com_RxDataTimeoutSubstitutionValueOfRxAccessInfoType 0 0 0 255 ECU_ADDRESS 0x0 /end MEASUREMENT
/begin MEASUREMENT Com_RxAccessInfo[168].RxPduInfoIdxOfRxAccessInfo "" UBYTE NO_COMPU_METHOD 0 0 0 255 ECU_ADDRESS 0x0 /end MEASUREMENT
/begin MEASUREMENT Com_RxAccessInfo[168].RxSigBufferArrayBasedBufferEndIdxOfRxAccessInfo "" UBYTE Com_RxSigBufferArrayBasedBufferEndIdxOfRxAccessInfoType 0 0 0 255 ECU_ADDRESS 0x0 /end MEASUREMENT
/begin MEASUREMENT Com_RxAccessInfo[168].RxSigBufferArrayBasedBufferStartIdxOfRxAccessInfo "" UBYTE Com_RxSigBufferArrayBasedBufferStartIdxOfRxAccessInfoType 0 0 0 255 ECU_ADDRESS 0x0 /end MEASUREMENT
/begin MEASUREMENT Com_RxAccessInfo[168].RxSigBufferArrayBasedShdBufferEndIdxOfRxAccessInfo "" UBYTE Com_RxSigBufferArrayBasedShdBufferEndIdxOfRxAccessInfoType 0 0 0 255 ECU_ADDRESS 0x0 /end MEASUREMENT
/begin MEASUREMENT Com_RxAccessInfo[168].RxSigBufferArrayBasedShdBufferStartIdxOfRxAccessInfo "" UBYTE Com_RxSigBufferArrayBasedShdBufferStartIdxOfRxAccessInfoType 0 0 0 255 ECU_ADDRESS 0x0 /end MEASUREMENT
/begin MEASUREMENT Com_RxAccessInfo[168].RxTOutInfoIdxOfRxAccessInfo "" UBYTE Com_RxTOutInfoIdxOfRxAccessInfoType 0 0 0 255 ECU_ADDRESS 0x0 /end MEASUREMENT
/begin MEASUREMENT Com_RxAccessInfo[168].ShdBufferIdxOfRxAccessInfo "" UWORD Com_ShdBufferIdxOfRxAccessInfoType 0 0 0 65535 ECU_ADDRESS 0x0 /end MEASUREMENT
/begin MEASUREMENT Com_RxAccessInfo[168].SignalLengthInByteOfRxAccessInfo "" UBYTE NO_COMPU_METHOD 0 0 0 255 ECU_ADDRESS 0x0 /end MEASUREMENT
/begin MEASUREMENT Com_RxAccessInfo[168].StartByteInPduPositionOfRxAccessInfo "" UBYTE NO_COMPU_METHOD 0 0 0 255 ECU_ADDRESS 0x0 /end MEASUREMENT
/begin MEASUREMENT Com_RxAccessInfo[168].TmpBufferIdxOfRxAccessInfo "" UBYTE Com_TmpBufferIdxOfRxAccessInfoType 0 0 0 255 ECU_ADDRESS 0x0 /end MEASUREMENT
/begin MEASUREMENT Com_RxAccessInfo[168].TmpBufferOfRxAccessInfo "" UBYTE Com_TmpBufferOfRxAccessInfoType 0 0 0 255 ECU_ADDRESS 0x0 /end MEASUREMENT
/begin MEASUREMENT Com_RxAccessInfo[168].TmpRxShdBufferArrayBasedTmpBufferEndIdxOfRxAccessInfo "" UBYTE Com_TmpRxShdBufferArrayBasedTmpBufferEndIdxOfRxAccessInfoType 0 0 0 255 ECU_ADDRESS 0x0 /end MEASUREMENT
/begin MEASUREMENT Com_RxAccessInfo[168].TmpRxShdBufferArrayBasedTmpBufferStartIdxOfRxAccessInfo "" UBYTE Com_TmpRxShdBufferArrayBasedTmpBufferStartIdxOfRxAccessInfoType 0 0 0 255 ECU_ADDRESS 0x0 /end MEASUREMENT
/begin MEASUREMENT Com_RxAccessInfo[169].ApplTypeOfRxAccessInfo "" UBYTE Com_ApplTypeOfRxAccessInfoType 0 0 0 255 ECU_ADDRESS 0x0 /end MEASUREMENT
/begin MEASUREMENT Com_RxAccessInfo[169].BitLengthOfRxAccessInfo "" UWORD NO_COMPU_METHOD 0 0 0 65535 ECU_ADDRESS 0x0 /end MEASUREMENT
/begin MEASUREMENT Com_RxAccessInfo[169].BitPositionOfRxAccessInfo "" UWORD NO_COMPU_METHOD 0 0 0 65535 ECU_ADDRESS 0x0 /end MEASUREMENT
/begin MEASUREMENT Com_RxAccessInfo[169].BufferIdxOfRxAccessInfo "" UWORD Com_BufferIdxOfRxAccessInfoType 0 0 0 65535 ECU_ADDRESS 0x0 /end MEASUREMENT
/begin MEASUREMENT Com_RxAccessInfo[169].BusAccOfRxAccessInfo "" UBYTE Com_BusAccOfRxAccessInfoType 0 0 0 255 ECU_ADDRESS 0x0 /end MEASUREMENT
/begin MEASUREMENT Com_RxAccessInfo[169].ByteLengthOfRxAccessInfo "" UBYTE NO_COMPU_METHOD 0 0 0 255 ECU_ADDRESS 0x0 /end MEASUREMENT
/begin MEASUREMENT Com_RxAccessInfo[169].ConstValueArrayBasedInitValueEndIdxOfRxAccessInfo "" UBYTE Com_ConstValueArrayBasedInitValueEndIdxOfRxAccessInfoType 0 0 0 255 ECU_ADDRESS 0x0 /end MEASUREMENT
/begin MEASUREMENT Com_RxAccessInfo[169].ConstValueArrayBasedInitValueStartIdxOfRxAccessInfo "" UBYTE Com_ConstValueArrayBasedInitValueStartIdxOfRxAccessInfoType 0 0 0 255 ECU_ADDRESS 0x0 /end MEASUREMENT
/begin MEASUREMENT Com_RxAccessInfo[169].DynSignalOfRxAccessInfo "" UBYTE Com_DynSignalOfRxAccessInfoType 0 0 0 1 ECU_ADDRESS 0x0 /end MEASUREMENT
/begin MEASUREMENT Com_RxAccessInfo[169].InitValueIdxOfRxAccessInfo "" UBYTE Com_InitValueIdxOfRxAccessInfoType 0 0 0 255 ECU_ADDRESS 0x0 /end MEASUREMENT
/begin MEASUREMENT Com_RxAccessInfo[169].InitValueOfRxAccessInfo "" UBYTE Com_InitValueOfRxAccessInfoType 0 0 0 255 ECU_ADDRESS 0x0 /end MEASUREMENT
/begin MEASUREMENT Com_RxAccessInfo[169].InvValueIdxOfRxAccessInfo "" UBYTE Com_InvValueIdxOfRxAccessInfoType 0 0 0 255 ECU_ADDRESS 0x0 /end MEASUREMENT
/begin MEASUREMENT Com_RxAccessInfo[169].InvValueOfRxAccessInfo "" UBYTE Com_InvValueOfRxAccessInfoType 0 0 0 255 ECU_ADDRESS 0x0 /end MEASUREMENT
/begin MEASUREMENT Com_RxAccessInfo[169].IsGroupSignalOfRxAccessInfo "" UBYTE Com_IsGroupSignalOfRxAccessInfoType 0 0 0 1 ECU_ADDRESS 0x0 /end MEASUREMENT
/begin MEASUREMENT Com_RxAccessInfo[169].RxDataTimeoutSubstitutionValueIdxOfRxAccessInfo "" UBYTE Com_RxDataTimeoutSubstitutionValueIdxOfRxAccessInfoType 0 0 0 255 ECU_ADDRESS 0x0 /end MEASUREMENT
/begin MEASUREMENT Com_RxAccessInfo[169].RxDataTimeoutSubstitutionValueOfRxAccessInfo "" UBYTE Com_RxDataTimeoutSubstitutionValueOfRxAccessInfoType 0 0 0 255 ECU_ADDRESS 0x0 /end MEASUREMENT
/begin MEASUREMENT Com_RxAccessInfo[169].RxPduInfoIdxOfRxAccessInfo "" UBYTE NO_COMPU_METHOD 0 0 0 255 ECU_ADDRESS 0x0 /end MEASUREMENT
/begin MEASUREMENT Com_RxAccessInfo[169].RxSigBufferArrayBasedBufferEndIdxOfRxAccessInfo "" UBYTE Com_RxSigBufferArrayBasedBufferEndIdxOfRxAccessInfoType 0 0 0 255 ECU_ADDRESS 0x0 /end MEASUREMENT
/begin MEASUREMENT Com_RxAccessInfo[169].RxSigBufferArrayBasedBufferStartIdxOfRxAccessInfo "" UBYTE Com_RxSigBufferArrayBasedBufferStartIdxOfRxAccessInfoType 0 0 0 255 ECU_ADDRESS 0x0 /end MEASUREMENT
/begin MEASUREMENT Com_RxAccessInfo[169].RxSigBufferArrayBasedShdBufferEndIdxOfRxAccessInfo "" UBYTE Com_RxSigBufferArrayBasedShdBufferEndIdxOfRxAccessInfoType 0 0 0 255 ECU_ADDRESS 0x0 /end MEASUREMENT
/begin MEASUREMENT Com_RxAccessInfo[169].RxSigBufferArrayBasedShdBufferStartIdxOfRxAccessInfo "" UBYTE Com_RxSigBufferArrayBasedShdBufferStartIdxOfRxAccessInfoType 0 0 0 255 ECU_ADDRESS 0x0 /end MEASUREMENT
/begin MEASUREMENT Com_RxAccessInfo[169].RxTOutInfoIdxOfRxAccessInfo "" UBYTE Com_RxTOutInfoIdxOfRxAccessInfoType 0 0 0 255 ECU_ADDRESS 0x0 /end MEASUREMENT
/begin MEASUREMENT Com_RxAccessInfo[169].ShdBufferIdxOfRxAccessInfo "" UWORD Com_ShdBufferIdxOfRxAccessInfoType 0 0 0 65535 ECU_ADDRESS 0x0 /end MEASUREMENT
/begin MEASUREMENT Com_RxAccessInfo[169].SignalLengthInByteOfRxAccessInfo "" UBYTE NO_COMPU_METHOD 0 0 0 255 ECU_ADDRESS 0x0 /end MEASUREMENT
/begin MEASUREMENT Com_RxAccessInfo[169].StartByteInPduPositionOfRxAccessInfo "" UBYTE NO_COMPU_METHOD 0 0 0 255 ECU_ADDRESS 0x0 /end MEASUREMENT
/begin MEASUREMENT Com_RxAccessInfo[169].TmpBufferIdxOfRxAccessInfo "" UBYTE Com_TmpBufferIdxOfRxAccessInfoType 0 0 0 255 ECU_ADDRESS 0x0 /end MEASUREMENT
/begin MEASUREMENT Com_RxAccessInfo[169].TmpBufferOfRxAccessInfo "" UBYTE Com_TmpBufferOfRxAccessInfoType 0 0 0 255 ECU_ADDRESS 0x0 /end MEASUREMENT
/begin MEASUREMENT Com_RxAccessInfo[169].TmpRxShdBufferArrayBasedTmpBufferEndIdxOfRxAccessInfo "" UBYTE Com_TmpRxShdBufferArrayBasedTmpBufferEndIdxOfRxAccessInfoType 0 0 0 255 ECU_ADDRESS 0x0 /end MEASUREMENT
/begin MEASUREMENT Com_RxAccessInfo[169].TmpRxShdBufferArrayBasedTmpBufferStartIdxOfRxAccessInfo "" UBYTE Com_TmpRxShdBufferArrayBasedTmpBufferStartIdxOfRxAccessInfoType 0 0 0 255 ECU_ADDRESS 0x0 /end MEASUREMENT
/begin MEASUREMENT Com_RxAccessInfo[16].ApplTypeOfRxAccessInfo "" UBYTE Com_ApplTypeOfRxAccessInfoType 0 0 0 255 ECU_ADDRESS 0x0 /end MEASUREMENT
/begin MEASUREMENT Com_RxAccessInfo[16].BitLengthOfRxAccessInfo "" UWORD NO_COMPU_METHOD 0 0 0 65535 ECU_ADDRESS 0x0 /end MEASUREMENT
/begin MEASUREMENT Com_RxAccessInfo[16].BitPositionOfRxAccessInfo "" UWORD NO_COMPU_METHOD 0 0 0 65535 ECU_ADDRESS 0x0 /end MEASUREMENT
/begin MEASUREMENT Com_RxAccessInfo[16].BufferIdxOfRxAccessInfo "" UWORD Com_BufferIdxOfRxAccessInfoType 0 0 0 65535 ECU_ADDRESS 0x0 /end MEASUREMENT
/begin MEASUREMENT Com_RxAccessInfo[16].BusAccOfRxAccessInfo "" UBYTE Com_BusAccOfRxAccessInfoType 0 0 0 255 ECU_ADDRESS 0x0 /end MEASUREMENT
/begin MEASUREMENT Com_RxAccessInfo[16].ByteLengthOfRxAccessInfo "" UBYTE NO_COMPU_METHOD 0 0 0 255 ECU_ADDRESS 0x0 /end MEASUREMENT
/begin MEASUREMENT Com_RxAccessInfo[16].ConstValueArrayBasedInitValueEndIdxOfRxAccessInfo "" UBYTE Com_ConstValueArrayBasedInitValueEndIdxOfRxAccessInfoType 0 0 0 255 ECU_ADDRESS 0x0 /end MEASUREMENT
/begin MEASUREMENT Com_RxAccessInfo[16].ConstValueArrayBasedInitValueStartIdxOfRxAccessInfo "" UBYTE Com_ConstValueArrayBasedInitValueStartIdxOfRxAccessInfoType 0 0 0 255 ECU_ADDRESS 0x0 /end MEASUREMENT
/begin MEASUREMENT Com_RxAccessInfo[16].DynSignalOfRxAccessInfo "" UBYTE Com_DynSignalOfRxAccessInfoType 0 0 0 1 ECU_ADDRESS 0x0 /end MEASUREMENT
/begin MEASUREMENT Com_RxAccessInfo[16].InitValueIdxOfRxAccessInfo "" UBYTE Com_InitValueIdxOfRxAccessInfoType 0 0 0 255 ECU_ADDRESS 0x0 /end MEASUREMENT
/begin MEASUREMENT Com_RxAccessInfo[16].InitValueOfRxAccessInfo "" UBYTE Com_InitValueOfRxAccessInfoType 0 0 0 255 ECU_ADDRESS 0x0 /end MEASUREMENT
/begin MEASUREMENT Com_RxAccessInfo[16].InvValueIdxOfRxAccessInfo "" UBYTE Com_InvValueIdxOfRxAccessInfoType 0 0 0 255 ECU_ADDRESS 0x0 /end MEASUREMENT
/begin MEASUREMENT Com_RxAccessInfo[16].InvValueOfRxAccessInfo "" UBYTE Com_InvValueOfRxAccessInfoType 0 0 0 255 ECU_ADDRESS 0x0 /end MEASUREMENT
/begin MEASUREMENT Com_RxAccessInfo[16].IsGroupSignalOfRxAccessInfo "" UBYTE Com_IsGroupSignalOfRxAccessInfoType 0 0 0 1 ECU_ADDRESS 0x0 /end MEASUREMENT
/begin MEASUREMENT Com_RxAccessInfo[16].RxDataTimeoutSubstitutionValueIdxOfRxAccessInfo "" UBYTE Com_RxDataTimeoutSubstitutionValueIdxOfRxAccessInfoType 0 0 0 255 ECU_ADDRESS 0x0 /end MEASUREMENT
/begin MEASUREMENT Com_RxAccessInfo[16].RxDataTimeoutSubstitutionValueOfRxAccessInfo "" UBYTE Com_RxDataTimeoutSubstitutionValueOfRxAccessInfoType 0 0 0 255 ECU_ADDRESS 0x0 /end MEASUREMENT
/begin MEASUREMENT Com_RxAccessInfo[16].RxPduInfoIdxOfRxAccessInfo "" UBYTE NO_COMPU_METHOD 0 0 0 255 ECU_ADDRESS 0x0 /end MEASUREMENT
/begin MEASUREMENT Com_RxAccessInfo[16].RxSigBufferArrayBasedBufferEndIdxOfRxAccessInfo "" UBYTE Com_RxSigBufferArrayBasedBufferEndIdxOfRxAccessInfoType 0 0 0 255 ECU_ADDRESS 0x0 /end MEASUREMENT
/begin MEASUREMENT Com_RxAccessInfo[16].RxSigBufferArrayBasedBufferStartIdxOfRxAccessInfo "" UBYTE Com_RxSigBufferArrayBasedBufferStartIdxOfRxAccessInfoType 0 0 0 255 ECU_ADDRESS 0x0 /end MEASUREMENT
/begin MEASUREMENT Com_RxAccessInfo[16].RxSigBufferArrayBasedShdBufferEndIdxOfRxAccessInfo "" UBYTE Com_RxSigBufferArrayBasedShdBufferEndIdxOfRxAccessInfoType 0 0 0 255 ECU_ADDRESS 0x0 /end MEASUREMENT
/begin MEASUREMENT Com_RxAccessInfo[16].RxSigBufferArrayBasedShdBufferStartIdxOfRxAccessInfo "" UBYTE Com_RxSigBufferArrayBasedShdBufferStartIdxOfRxAccessInfoType 0 0 0 255 ECU_ADDRESS 0x0 /end MEASUREMENT
/begin MEASUREMENT Com_RxAccessInfo[16].RxTOutInfoIdxOfRxAccessInfo "" UBYTE Com_RxTOutInfoIdxOfRxAccessInfoType 0 0 0 255 ECU_ADDRESS 0x0 /end MEASUREMENT
/begin MEASUREMENT Com_RxAccessInfo[16].ShdBufferIdxOfRxAccessInfo "" UWORD Com_ShdBufferIdxOfRxAccessInfoType 0 0 0 65535 ECU_ADDRESS 0x0 /end MEASUREMENT
/begin MEASUREMENT Com_RxAccessInfo[16].SignalLengthInByteOfRxAccessInfo "" UBYTE NO_COMPU_METHOD 0 0 0 255 ECU_ADDRESS 0x0 /end MEASUREMENT
/begin MEASUREMENT Com_RxAccessInfo[16].StartByteInPduPositionOfRxAccessInfo "" UBYTE NO_COMPU_METHOD 0 0 0 255 ECU_ADDRESS 0x0 /end MEASUREMENT
/begin MEASUREMENT Com_RxAccessInfo[16].TmpBufferIdxOfRxAccessInfo "" UBYTE Com_TmpBufferIdxOfRxAccessInfoType 0 0 0 255 ECU_ADDRESS 0x0 /end MEASUREMENT
/begin MEASUREMENT Com_RxAccessInfo[16].TmpBufferOfRxAccessInfo "" UBYTE Com_TmpBufferOfRxAccessInfoType 0 0 0 255 ECU_ADDRESS 0x0 /end MEASUREMENT
/begin MEASUREMENT Com_RxAccessInfo[16].TmpRxShdBufferArrayBasedTmpBufferEndIdxOfRxAccessInfo "" UBYTE Com_TmpRxShdBufferArrayBasedTmpBufferEndIdxOfRxAccessInfoType 0 0 0 255 ECU_ADDRESS 0x0 /end MEASUREMENT
/begin MEASUREMENT Com_RxAccessInfo[16].TmpRxShdBufferArrayBasedTmpBufferStartIdxOfRxAccessInfo "" UBYTE Com_TmpRxShdBufferArrayBasedTmpBufferStartIdxOfRxAccessInfoType 0 0 0 255 ECU_ADDRESS 0x0 /end MEASUREMENT
/begin MEASUREMENT Com_RxAccessInfo[170].ApplTypeOfRxAccessInfo "" UBYTE Com_ApplTypeOfRxAccessInfoType 0 0 0 255 ECU_ADDRESS 0x0 /end MEASUREMENT
/begin MEASUREMENT Com_RxAccessInfo[170].BitLengthOfRxAccessInfo "" UWORD NO_COMPU_METHOD 0 0 0 65535 ECU_ADDRESS 0x0 /end MEASUREMENT
/begin MEASUREMENT Com_RxAccessInfo[170].BitPositionOfRxAccessInfo "" UWORD NO_COMPU_METHOD 0 0 0 65535 ECU_ADDRESS 0x0 /end MEASUREMENT
/begin MEASUREMENT Com_RxAccessInfo[170].BufferIdxOfRxAccessInfo "" UWORD Com_BufferIdxOfRxAccessInfoType 0 0 0 65535 ECU_ADDRESS 0x0 /end MEASUREMENT
/begin MEASUREMENT Com_RxAccessInfo[170].BusAccOfRxAccessInfo "" UBYTE Com_BusAccOfRxAccessInfoType 0 0 0 255 ECU_ADDRESS 0x0 /end MEASUREMENT
/begin MEASUREMENT Com_RxAccessInfo[170].ByteLengthOfRxAccessInfo "" UBYTE NO_COMPU_METHOD 0 0 0 255 ECU_ADDRESS 0x0 /end MEASUREMENT
/begin MEASUREMENT Com_RxAccessInfo[170].ConstValueArrayBasedInitValueEndIdxOfRxAccessInfo "" UBYTE Com_ConstValueArrayBasedInitValueEndIdxOfRxAccessInfoType 0 0 0 255 ECU_ADDRESS 0x0 /end MEASUREMENT
/begin MEASUREMENT Com_RxAccessInfo[170].ConstValueArrayBasedInitValueStartIdxOfRxAccessInfo "" UBYTE Com_ConstValueArrayBasedInitValueStartIdxOfRxAccessInfoType 0 0 0 255 ECU_ADDRESS 0x0 /end MEASUREMENT
/begin MEASUREMENT Com_RxAccessInfo[170].DynSignalOfRxAccessInfo "" UBYTE Com_DynSignalOfRxAccessInfoType 0 0 0 1 ECU_ADDRESS 0x0 /end MEASUREMENT
/begin MEASUREMENT Com_RxAccessInfo[170].InitValueIdxOfRxAccessInfo "" UBYTE Com_InitValueIdxOfRxAccessInfoType 0 0 0 255 ECU_ADDRESS 0x0 /end MEASUREMENT
/begin MEASUREMENT Com_RxAccessInfo[170].InitValueOfRxAccessInfo "" UBYTE Com_InitValueOfRxAccessInfoType 0 0 0 255 ECU_ADDRESS 0x0 /end MEASUREMENT
/begin MEASUREMENT Com_RxAccessInfo[170].InvValueIdxOfRxAccessInfo "" UBYTE Com_InvValueIdxOfRxAccessInfoType 0 0 0 255 ECU_ADDRESS 0x0 /end MEASUREMENT
/begin MEASUREMENT Com_RxAccessInfo[170].InvValueOfRxAccessInfo "" UBYTE Com_InvValueOfRxAccessInfoType 0 0 0 255 ECU_ADDRESS 0x0 /end MEASUREMENT
/begin MEASUREMENT Com_RxAccessInfo[170].IsGroupSignalOfRxAccessInfo "" UBYTE Com_IsGroupSignalOfRxAccessInfoType 0 0 0 1 ECU_ADDRESS 0x0 /end MEASUREMENT
/begin MEASUREMENT Com_RxAccessInfo[170].RxDataTimeoutSubstitutionValueIdxOfRxAccessInfo "" UBYTE Com_RxDataTimeoutSubstitutionValueIdxOfRxAccessInfoType 0 0 0 255 ECU_ADDRESS 0x0 /end MEASUREMENT
/begin MEASUREMENT Com_RxAccessInfo[170].RxDataTimeoutSubstitutionValueOfRxAccessInfo "" UBYTE Com_RxDataTimeoutSubstitutionValueOfRxAccessInfoType 0 0 0 255 ECU_ADDRESS 0x0 /end MEASUREMENT
/begin MEASUREMENT Com_RxAccessInfo[170].RxPduInfoIdxOfRxAccessInfo "" UBYTE NO_COMPU_METHOD 0 0 0 255 ECU_ADDRESS 0x0 /end MEASUREMENT
/begin MEASUREMENT Com_RxAccessInfo[170].RxSigBufferArrayBasedBufferEndIdxOfRxAccessInfo "" UBYTE Com_RxSigBufferArrayBasedBufferEndIdxOfRxAccessInfoType 0 0 0 255 ECU_ADDRESS 0x0 /end MEASUREMENT
/begin MEASUREMENT Com_RxAccessInfo[170].RxSigBufferArrayBasedBufferStartIdxOfRxAccessInfo "" UBYTE Com_RxSigBufferArrayBasedBufferStartIdxOfRxAccessInfoType 0 0 0 255 ECU_ADDRESS 0x0 /end MEASUREMENT
/begin MEASUREMENT Com_RxAccessInfo[170].RxSigBufferArrayBasedShdBufferEndIdxOfRxAccessInfo "" UBYTE Com_RxSigBufferArrayBasedShdBufferEndIdxOfRxAccessInfoType 0 0 0 255 ECU_ADDRESS 0x0 /end MEASUREMENT
/begin MEASUREMENT Com_RxAccessInfo[170].RxSigBufferArrayBasedShdBufferStartIdxOfRxAccessInfo "" UBYTE Com_RxSigBufferArrayBasedShdBufferStartIdxOfRxAccessInfoType 0 0 0 255 ECU_ADDRESS 0x0 /end MEASUREMENT
/begin MEASUREMENT Com_RxAccessInfo[170].RxTOutInfoIdxOfRxAccessInfo "" UBYTE Com_RxTOutInfoIdxOfRxAccessInfoType 0 0 0 255 ECU_ADDRESS 0x0 /end MEASUREMENT
/begin MEASUREMENT Com_RxAccessInfo[170].ShdBufferIdxOfRxAccessInfo "" UWORD Com_ShdBufferIdxOfRxAccessInfoType 0 0 0 65535 ECU_ADDRESS 0x0 /end MEASUREMENT
/begin MEASUREMENT Com_RxAccessInfo[170].SignalLengthInByteOfRxAccessInfo "" UBYTE NO_COMPU_METHOD 0 0 0 255 ECU_ADDRESS 0x0 /end MEASUREMENT
/begin MEASUREMENT Com_RxAccessInfo[170].StartByteInPduPositionOfRxAccessInfo "" UBYTE NO_COMPU_METHOD 0 0 0 255 ECU_ADDRESS 0x0 /end MEASUREMENT
/begin MEASUREMENT Com_RxAccessInfo[170].TmpBufferIdxOfRxAccessInfo "" UBYTE Com_TmpBufferIdxOfRxAccessInfoType 0 0 0 255 ECU_ADDRESS 0x0 /end MEASUREMENT
/begin MEASUREMENT Com_RxAccessInfo[170].TmpBufferOfRxAccessInfo "" UBYTE Com_TmpBufferOfRxAccessInfoType 0 0 0 255 ECU_ADDRESS 0x0 /end MEASUREMENT
/begin MEASUREMENT Com_RxAccessInfo[170].TmpRxShdBufferArrayBasedTmpBufferEndIdxOfRxAccessInfo "" UBYTE Com_TmpRxShdBufferArrayBasedTmpBufferEndIdxOfRxAccessInfoType 0 0 0 255 ECU_ADDRESS 0x0 /end MEASUREMENT
/begin MEASUREMENT Com_RxAccessInfo[170].TmpRxShdBufferArrayBasedTmpBufferStartIdxOfRxAccessInfo "" UBYTE Com_TmpRxShdBufferArrayBasedTmpBufferStartIdxOfRxAccessInfoType 0 0 0 255 ECU_ADDRESS 0x0 /end MEASUREMENT
/begin MEASUREMENT Com_RxAccessInfo[171].ApplTypeOfRxAccessInfo "" UBYTE Com_ApplTypeOfRxAccessInfoType 0 0 0 255 ECU_ADDRESS 0x0 /end MEASUREMENT
/begin MEASUREMENT Com_RxAccessInfo[171].BitLengthOfRxAccessInfo "" UWORD NO_COMPU_METHOD 0 0 0 65535 ECU_ADDRESS 0x0 /end MEASUREMENT
/begin MEASUREMENT Com_RxAccessInfo[171].BitPositionOfRxAccessInfo "" UWORD NO_COMPU_METHOD 0 0 0 65535 ECU_ADDRESS 0x0 /end MEASUREMENT
/begin MEASUREMENT Com_RxAccessInfo[171].BufferIdxOfRxAccessInfo "" UWORD Com_BufferIdxOfRxAccessInfoType 0 0 0 65535 ECU_ADDRESS 0x0 /end MEASUREMENT
/begin MEASUREMENT Com_RxAccessInfo[171].BusAccOfRxAccessInfo "" UBYTE Com_BusAccOfRxAccessInfoType 0 0 0 255 ECU_ADDRESS 0x0 /end MEASUREMENT
/begin MEASUREMENT Com_RxAccessInfo[171].ByteLengthOfRxAccessInfo "" UBYTE NO_COMPU_METHOD 0 0 0 255 ECU_ADDRESS 0x0 /end MEASUREMENT
/begin MEASUREMENT Com_RxAccessInfo[171].ConstValueArrayBasedInitValueEndIdxOfRxAccessInfo "" UBYTE Com_ConstValueArrayBasedInitValueEndIdxOfRxAccessInfoType 0 0 0 255 ECU_ADDRESS 0x0 /end MEASUREMENT
/begin MEASUREMENT Com_RxAccessInfo[171].ConstValueArrayBasedInitValueStartIdxOfRxAccessInfo "" UBYTE Com_ConstValueArrayBasedInitValueStartIdxOfRxAccessInfoType 0 0 0 255 ECU_ADDRESS 0x0 /end MEASUREMENT
/begin MEASUREMENT Com_RxAccessInfo[171].DynSignalOfRxAccessInfo "" UBYTE Com_DynSignalOfRxAccessInfoType 0 0 0 1 ECU_ADDRESS 0x0 /end MEASUREMENT
/begin MEASUREMENT Com_RxAccessInfo[171].InitValueIdxOfRxAccessInfo "" UBYTE Com_InitValueIdxOfRxAccessInfoType 0 0 0 255 ECU_ADDRESS 0x0 /end MEASUREMENT
/begin MEASUREMENT Com_RxAccessInfo[171].InitValueOfRxAccessInfo "" UBYTE Com_InitValueOfRxAccessInfoType 0 0 0 255 ECU_ADDRESS 0x0 /end MEASUREMENT
/begin MEASUREMENT Com_RxAccessInfo[171].InvValueIdxOfRxAccessInfo "" UBYTE Com_InvValueIdxOfRxAccessInfoType 0 0 0 255 ECU_ADDRESS 0x0 /end MEASUREMENT
/begin MEASUREMENT Com_RxAccessInfo[171].InvValueOfRxAccessInfo "" UBYTE Com_InvValueOfRxAccessInfoType 0 0 0 255 ECU_ADDRESS 0x0 /end MEASUREMENT
/begin MEASUREMENT Com_RxAccessInfo[171].IsGroupSignalOfRxAccessInfo "" UBYTE Com_IsGroupSignalOfRxAccessInfoType 0 0 0 1 ECU_ADDRESS 0x0 /end MEASUREMENT
/begin MEASUREMENT Com_RxAccessInfo[171].RxDataTimeoutSubstitutionValueIdxOfRxAccessInfo "" UBYTE Com_RxDataTimeoutSubstitutionValueIdxOfRxAccessInfoType 0 0 0 255 ECU_ADDRESS 0x0 /end MEASUREMENT
/begin MEASUREMENT Com_RxAccessInfo[171].RxDataTimeoutSubstitutionValueOfRxAccessInfo "" UBYTE Com_RxDataTimeoutSubstitutionValueOfRxAccessInfoType 0 0 0 255 ECU_ADDRESS 0x0 /end MEASUREMENT
/begin MEASUREMENT Com_RxAccessInfo[171].RxPduInfoIdxOfRxAccessInfo "" UBYTE NO_COMPU_METHOD 0 0 0 255 ECU_ADDRESS 0x0 /end MEASUREMENT
/begin MEASUREMENT Com_RxAccessInfo[171].RxSigBufferArrayBasedBufferEndIdxOfRxAccessInfo "" UBYTE Com_RxSigBufferArrayBasedBufferEndIdxOfRxAccessInfoType 0 0 0 255 ECU_ADDRESS 0x0 /end MEASUREMENT
/begin MEASUREMENT Com_RxAccessInfo[171].RxSigBufferArrayBasedBufferStartIdxOfRxAccessInfo "" UBYTE Com_RxSigBufferArrayBasedBufferStartIdxOfRxAccessInfoType 0 0 0 255 ECU_ADDRESS 0x0 /end MEASUREMENT
/begin MEASUREMENT Com_RxAccessInfo[171].RxSigBufferArrayBasedShdBufferEndIdxOfRxAccessInfo "" UBYTE Com_RxSigBufferArrayBasedShdBufferEndIdxOfRxAccessInfoType 0 0 0 255 ECU_ADDRESS 0x0 /end MEASUREMENT
/begin MEASUREMENT Com_RxAccessInfo[171].RxSigBufferArrayBasedShdBufferStartIdxOfRxAccessInfo "" UBYTE Com_RxSigBufferArrayBasedShdBufferStartIdxOfRxAccessInfoType 0 0 0 255 ECU_ADDRESS 0x0 /end MEASUREMENT
/begin MEASUREMENT Com_RxAccessInfo[171].RxTOutInfoIdxOfRxAccessInfo "" UBYTE Com_RxTOutInfoIdxOfRxAccessInfoType 0 0 0 255 ECU_ADDRESS 0x0 /end MEASUREMENT
/begin MEASUREMENT Com_RxAccessInfo[171].ShdBufferIdxOfRxAccessInfo "" UWORD Com_ShdBufferIdxOfRxAccessInfoType 0 0 0 65535 ECU_ADDRESS 0x0 /end MEASUREMENT
/begin MEASUREMENT Com_RxAccessInfo[171].SignalLengthInByteOfRxAccessInfo "" UBYTE NO_COMPU_METHOD 0 0 0 255 ECU_ADDRESS 0x0 /end MEASUREMENT
/begin MEASUREMENT Com_RxAccessInfo[171].StartByteInPduPositionOfRxAccessInfo "" UBYTE NO_COMPU_METHOD 0 0 0 255 ECU_ADDRESS 0x0 /end MEASUREMENT
/begin MEASUREMENT Com_RxAccessInfo[171].TmpBufferIdxOfRxAccessInfo "" UBYTE Com_TmpBufferIdxOfRxAccessInfoType 0 0 0 255 ECU_ADDRESS 0x0 /end MEASUREMENT
/begin MEASUREMENT Com_RxAccessInfo[171].TmpBufferOfRxAccessInfo "" UBYTE Com_TmpBufferOfRxAccessInfoType 0 0 0 255 ECU_ADDRESS 0x0 /end MEASUREMENT
/begin MEASUREMENT Com_RxAccessInfo[171].TmpRxShdBufferArrayBasedTmpBufferEndIdxOfRxAccessInfo "" UBYTE Com_TmpRxShdBufferArrayBasedTmpBufferEndIdxOfRxAccessInfoType 0 0 0 255 ECU_ADDRESS 0x0 /end MEASUREMENT
/begin MEASUREMENT Com_RxAccessInfo[171].TmpRxShdBufferArrayBasedTmpBufferStartIdxOfRxAccessInfo "" UBYTE Com_TmpRxShdBufferArrayBasedTmpBufferStartIdxOfRxAccessInfoType 0 0 0 255 ECU_ADDRESS 0x0 /end MEASUREMENT
/begin MEASUREMENT Com_RxAccessInfo[172].ApplTypeOfRxAccessInfo "" UBYTE Com_ApplTypeOfRxAccessInfoType 0 0 0 255 ECU_ADDRESS 0x0 /end MEASUREMENT
/begin MEASUREMENT Com_RxAccessInfo[172].BitLengthOfRxAccessInfo "" UWORD NO_COMPU_METHOD 0 0 0 65535 ECU_ADDRESS 0x0 /end MEASUREMENT
/begin MEASUREMENT Com_RxAccessInfo[172].BitPositionOfRxAccessInfo "" UWORD NO_COMPU_METHOD 0 0 0 65535 ECU_ADDRESS 0x0 /end MEASUREMENT
/begin MEASUREMENT Com_RxAccessInfo[172].BufferIdxOfRxAccessInfo "" UWORD Com_BufferIdxOfRxAccessInfoType 0 0 0 65535 ECU_ADDRESS 0x0 /end MEASUREMENT
/begin MEASUREMENT Com_RxAccessInfo[172].BusAccOfRxAccessInfo "" UBYTE Com_BusAccOfRxAccessInfoType 0 0 0 255 ECU_ADDRESS 0x0 /end MEASUREMENT
/begin MEASUREMENT Com_RxAccessInfo[172].ByteLengthOfRxAccessInfo "" UBYTE NO_COMPU_METHOD 0 0 0 255 ECU_ADDRESS 0x0 /end MEASUREMENT
/begin MEASUREMENT Com_RxAccessInfo[172].ConstValueArrayBasedInitValueEndIdxOfRxAccessInfo "" UBYTE Com_ConstValueArrayBasedInitValueEndIdxOfRxAccessInfoType 0 0 0 255 ECU_ADDRESS 0x0 /end MEASUREMENT
/begin MEASUREMENT Com_RxAccessInfo[172].ConstValueArrayBasedInitValueStartIdxOfRxAccessInfo "" UBYTE Com_ConstValueArrayBasedInitValueStartIdxOfRxAccessInfoType 0 0 0 255 ECU_ADDRESS 0x0 /end MEASUREMENT
/begin MEASUREMENT Com_RxAccessInfo[172].DynSignalOfRxAccessInfo "" UBYTE Com_DynSignalOfRxAccessInfoType 0 0 0 1 ECU_ADDRESS 0x0 /end MEASUREMENT
/begin MEASUREMENT Com_RxAccessInfo[172].InitValueIdxOfRxAccessInfo "" UBYTE Com_InitValueIdxOfRxAccessInfoType 0 0 0 255 ECU_ADDRESS 0x0 /end MEASUREMENT
/begin MEASUREMENT Com_RxAccessInfo[172].InitValueOfRxAccessInfo "" UBYTE Com_InitValueOfRxAccessInfoType 0 0 0 255 ECU_ADDRESS 0x0 /end MEASUREMENT
/begin MEASUREMENT Com_RxAccessInfo[172].InvValueIdxOfRxAccessInfo "" UBYTE Com_InvValueIdxOfRxAccessInfoType 0 0 0 255 ECU_ADDRESS 0x0 /end MEASUREMENT
/begin MEASUREMENT Com_RxAccessInfo[172].InvValueOfRxAccessInfo "" UBYTE Com_InvValueOfRxAccessInfoType 0 0 0 255 ECU_ADDRESS 0x0 /end MEASUREMENT
/begin MEASUREMENT Com_RxAccessInfo[172].IsGroupSignalOfRxAccessInfo "" UBYTE Com_IsGroupSignalOfRxAccessInfoType 0 0 0 1 ECU_ADDRESS 0x0 /end MEASUREMENT
/begin MEASUREMENT Com_RxAccessInfo[172].RxDataTimeoutSubstitutionValueIdxOfRxAccessInfo "" UBYTE Com_RxDataTimeoutSubstitutionValueIdxOfRxAccessInfoType 0 0 0 255 ECU_ADDRESS 0x0 /end MEASUREMENT
/begin MEASUREMENT Com_RxAccessInfo[172].RxDataTimeoutSubstitutionValueOfRxAccessInfo "" UBYTE Com_RxDataTimeoutSubstitutionValueOfRxAccessInfoType 0 0 0 255 ECU_ADDRESS 0x0 /end MEASUREMENT
/begin MEASUREMENT Com_RxAccessInfo[172].RxPduInfoIdxOfRxAccessInfo "" UBYTE NO_COMPU_METHOD 0 0 0 255 ECU_ADDRESS 0x0 /end MEASUREMENT
/begin MEASUREMENT Com_RxAccessInfo[172].RxSigBufferArrayBasedBufferEndIdxOfRxAccessInfo "" UBYTE Com_RxSigBufferArrayBasedBufferEndIdxOfRxAccessInfoType 0 0 0 255 ECU_ADDRESS 0x0 /end MEASUREMENT
/begin MEASUREMENT Com_RxAccessInfo[172].RxSigBufferArrayBasedBufferStartIdxOfRxAccessInfo "" UBYTE Com_RxSigBufferArrayBasedBufferStartIdxOfRxAccessInfoType 0 0 0 255 ECU_ADDRESS 0x0 /end MEASUREMENT
/begin MEASUREMENT Com_RxAccessInfo[172].RxSigBufferArrayBasedShdBufferEndIdxOfRxAccessInfo "" UBYTE Com_RxSigBufferArrayBasedShdBufferEndIdxOfRxAccessInfoType 0 0 0 255 ECU_ADDRESS 0x0 /end MEASUREMENT
/begin MEASUREMENT Com_RxAccessInfo[172].RxSigBufferArrayBasedShdBufferStartIdxOfRxAccessInfo "" UBYTE Com_RxSigBufferArrayBasedShdBufferStartIdxOfRxAccessInfoType 0 0 0 255 ECU_ADDRESS 0x0 /end MEASUREMENT
/begin MEASUREMENT Com_RxAccessInfo[172].RxTOutInfoIdxOfRxAccessInfo "" UBYTE Com_RxTOutInfoIdxOfRxAccessInfoType 0 0 0 255 ECU_ADDRESS 0x0 /end MEASUREMENT
/begin MEASUREMENT Com_RxAccessInfo[172].ShdBufferIdxOfRxAccessInfo "" UWORD Com_ShdBufferIdxOfRxAccessInfoType 0 0 0 65535 ECU_ADDRESS 0x0 /end MEASUREMENT
/begin MEASUREMENT Com_RxAccessInfo[172].SignalLengthInByteOfRxAccessInfo "" UBYTE NO_COMPU_METHOD 0 0 0 255 ECU_ADDRESS 0x0 /end MEASUREMENT
/begin MEASUREMENT Com_RxAccessInfo[172].StartByteInPduPositionOfRxAccessInfo "" UBYTE NO_COMPU_METHOD 0 0 0 255 ECU_ADDRESS 0x0 /end MEASUREMENT
/begin MEASUREMENT Com_RxAccessInfo[172].TmpBufferIdxOfRxAccessInfo "" UBYTE Com_TmpBufferIdxOfRxAccessInfoType 0 0 0 255 ECU_ADDRESS 0x0 /end MEASUREMENT
/begin MEASUREMENT Com_RxAccessInfo[172].TmpBufferOfRxAccessInfo "" UBYTE Com_TmpBufferOfRxAccessInfoType 0 0 0 255 ECU_ADDRESS 0x0 /end MEASUREMENT
/begin MEASUREMENT Com_RxAccessInfo[172].TmpRxShdBufferArrayBasedTmpBufferEndIdxOfRxAccessInfo "" UBYTE Com_TmpRxShdBufferArrayBasedTmpBufferEndIdxOfRxAccessInfoType 0 0 0 255 ECU_ADDRESS 0x0 /end MEASUREMENT
/begin MEASUREMENT Com_RxAccessInfo[172].TmpRxShdBufferArrayBasedTmpBufferStartIdxOfRxAccessInfo "" UBYTE Com_TmpRxShdBufferArrayBasedTmpBufferStartIdxOfRxAccessInfoType 0 0 0 255 ECU_ADDRESS 0x0 /end MEASUREMENT
/begin MEASUREMENT Com_RxAccessInfo[173].ApplTypeOfRxAccessInfo "" UBYTE Com_ApplTypeOfRxAccessInfoType 0 0 0 255 ECU_ADDRESS 0x0 /end MEASUREMENT
/begin MEASUREMENT Com_RxAccessInfo[173].BitLengthOfRxAccessInfo "" UWORD NO_COMPU_METHOD 0 0 0 65535 ECU_ADDRESS 0x0 /end MEASUREMENT
/begin COMPU_METHOD Com_ApplTypeOfRxAccessInfoType "" TAB_VERB "%10.1" "" COMPU_TAB_REF Com_ApplTypeOfRxAccessInfoType /end COMPU_METHOD
/begin COMPU_METHOD Com_BufferIdxOfRxAccessInfoType "" TAB_VERB "%10.1" "" COMPU_TAB_REF Com_BufferIdxOfRxAccessInfoType /end COMPU_METHOD
/begin COMPU_METHOD Com_BusAccOfRxAccessInfoType "" TAB_VERB "%10.1" "" COMPU_TAB_REF Com_BusAccOfRxAccessInfoType /end COMPU_METHOD
/begin COMPU_METHOD Com_ConstValueArrayBasedInitValueEndIdxOfRxAccessInfoType "" TAB_VERB "%10.1" "" COMPU_TAB_REF Com_ConstValueArrayBasedInitValueEndIdxOfRxAccessInfoType /end COMPU_METHOD
/begin COMPU_METHOD Com_ConstValueArrayBasedInitValueStartIdxOfRxAccessInfoType "" TAB_VERB "%10.1" "" COMPU_TAB_REF Com_ConstValueArrayBasedInitValueStartIdxOfRxAccessInfoType /end COMPU_METHOD
/begin COMPU_METHOD Com_DynSignalOfRxAccessInfoType "" TAB_VERB "%10.1" "" COMPU_TAB_REF Com_DynSignalOfRxAccessInfoType /end COMPU_METHOD
/begin COMPU_METHOD Com_InitValueIdxOfRxAccessInfoType "" TAB_VERB "%10.1" "" COMPU_TAB_REF Com_InitValueIdxOfRxAccessInfoType /end COMPU_METHOD
/begin COMPU_METHOD Com_InitValueOfRxAccessInfoType "" TAB_VERB "%10.1" "" COMPU_TAB_REF Com_InitValueOfRxAccessInfoType /end COMPU_METHOD
/begin COMPU_METHOD Com_InvValueIdxOfRxAccessInfoType "" TAB_VERB "%10.1" "" COMPU_TAB_REF Com_InvValueIdxOfRxAccessInfoType /end COMPU_METHOD
/begin COMPU_METHOD Com_InvValueOfRxAccessInfoType "" TAB_VERB "%10.1" "" COMPU_TAB_REF Com_InvValueOfRxAccessInfoType /end COMPU_METHOD
/begin COMPU_METHOD Com_IsGroupSignalOfRxAccessInfoType "" TAB_VERB "%10.1" "" COMPU_TAB_REF Com_IsGroupSignalOfRxAccessInfoType /end COMPU_METHOD
/begin COMPU_METHOD Com_RxDataTimeoutSubstitutionValueIdxOfRxAccessInfoType "" TAB_VERB "%10.1" "" COMPU_TAB_REF Com_RxDataTimeoutSubstitutionValueIdxOfRxAccessInfoType /end COMPU_METHOD
/begin COMPU_METHOD Com_RxDataTimeoutSubstitutionValueOfRxAccessInfoType "" TAB_VERB "%10.1" "" COMPU_TAB_REF Com_RxDataTimeoutSubstitutionValueOfRxAccessInfoType /end COMPU_METHOD
/begin COMPU_METHOD Com_RxSigBufferArrayBasedBufferEndIdxOfRxAccessInfoType "" TAB_VERB "%10.1" "" COMPU_TAB_REF Com_RxSigBufferArrayBasedBufferEndIdxOfRxAccessInfoType /end COMPU_METHOD
/begin COMPU_METHOD Com_RxSigBufferArrayBasedBufferStartIdxOfRxAccessInfoType "" TAB_VERB "%10.1" "" COMPU_TAB_REF Com_RxSigBufferArrayBasedBufferStartIdxOfRxAccessInfoType /end COMPU_METHOD
/begin COMPU_METHOD Com_RxSigBufferArrayBasedShdBufferEndIdxOfRxAccessInfoType "" TAB_VERB "%10.1" "" COMPU_TAB_REF Com_RxSigBufferArrayBasedShdBufferEndIdxOfRxAccessInfoType /end COMPU_METHOD
/begin COMPU_METHOD Com_RxSigBufferArrayBasedShdBufferStartIdxOfRxAccessInfoType "" TAB_VERB "%10.1" "" COMPU_TAB_REF Com_RxSigBufferArrayBasedShdBufferStartIdxOfRxAccessInfoType /end COMPU_METHOD
/begin COMPU_METHOD Com_RxTOutInfoIdxOfRxAccessInfoType "" TAB_VERB "%10.1" "" COMPU_TAB_REF Com_RxTOutInfoIdxOfRxAccessInfoType /end COMPU_METHOD
/begin COMPU_METHOD Com_ShdBufferIdxOfRxAccessInfoType "" TAB_VERB "%10.1" "" COMPU_TAB_REF Com_ShdBufferIdxOfRxAccessInfoType /end COMPU_METHOD
/begin COMPU_METHOD Com_TmpBufferIdxOfRxAccessInfoType "" TAB_VERB "%10.1" "" COMPU_TAB_REF Com_TmpBufferIdxOfRxAccessInfoType /end COMPU_METHOD
/begin COMPU_METHOD Com_TmpBufferOfRxAccessInfoType "" TAB_VERB "%10.1" "" COMPU_TAB_REF Com_TmpBufferOfRxAccessInfoType /end COMPU_METHOD
/begin COMPU_METHOD Com_TmpRxShdBufferArrayBasedTmpBufferEndIdxOfRxAccessInfoType "" TAB_VERB "%10.1" "" COMPU_TAB_REF Com_TmpRxShdBufferArrayBasedTmpBufferEndIdxOfRxAccessInfoType /end COMPU_METHOD
/begin COMPU_METHOD Com_TmpRxShdBufferArrayBasedTmpBufferStartIdxOfRxAccessInfoType "" TAB_VERB "%10.1" "" COMPU_TAB_REF Com_TmpRxShdBufferArrayBasedTmpBufferStartIdxOfRxAccessInfoType /end COMPU_METHOD
/begin COMPU_VTAB Com_ApplTypeOfRxAccessInfoType "" TAB_VERB 4 0 "COM_UINT8_APPLTYPEOFRXACCESSINFO" 2 "COM_UINT16_APPLTYPEOFRXACCESSINFO" 4 "COM_UINT32_APPLTYPEOFRXACCESSINFO" 8 "COM_UINT8_N_APPLTYPEOFRXACCESSINFO" /end COMPU_VTAB
/begin COMPU_VTAB Com_BufferIdxOfRxAccessInfoType "" TAB_VERB 1 65535 "COM_NO_BUFFERIDXOFRXACCESSINFO" /end COMPU_VTAB
/begin COMPU_VTAB Com_BusAccOfRxAccessInfoType "" TAB_VERB 5 0 "COM_NBIT_BUSACCOFRXACCESSINFO" 1 "COM_BYTE_BUSACCOFRXACCESSINFO" 2 "COM_NBYTE_BUSACCOFRXACCESSINFO" 4 "COM_NBITNBYTE_BUSACCOFRXACCESSINFO" 6 "COM_ARRAY_BASED_BUSACCOFRXACCESSINFO" /end COMPU_VTAB
/begin COMPU_VTAB Com_ConstValueArrayBasedInitValueEndIdxOfRxAccessInfoType "" TAB_VERB 1 255 "COM_NO_CONSTVALUEARRAYBASEDINITVALUEENDIDXOFRXACCESSINFO" /end COMPU_VTAB
/begin COMPU_VTAB Com_ConstValueArrayBasedInitValueStartIdxOfRxAccessInfoType "" TAB_VERB 1 255 "COM_NO_CONSTVALUEARRAYBASEDINITVALUESTARTIDXOFRXACCESSINFO" /end COMPU_VTAB
/begin COMPU_VTAB_RANGE Com_DynSignalOfRxAccessInfoType "" 2 0 0 "FALSE" 1 255 "TRUE" /end COMPU_VTAB_RANGE
/begin COMPU_VTAB Com_InitValueIdxOfRxAccessInfoType "" TAB_VERB 1 255 "COM_NO_INITVALUEIDXOFRXACCESSINFO" /end COMPU_VTAB
/begin COMPU_VTAB Com_InitValueOfRxAccessInfoType "" TAB_VERB 4 0 "COM_CONSTVALUEUINT8_INITVALUEOFRXACCESSINFO" 1 "COM_CONSTVALUEUINT16_INITVALUEOFRXACCESSINFO" 2 "COM_CONSTVALUEUINT32_INITVALUEOFRXACCESSINFO" 255 "COM_NO_INITVALUEOFRXACCESSINFO" /end COMPU_VTAB
/begin COMPU_VTAB Com_InvValueIdxOfRxAccessInfoType "" TAB_VERB 1 255 "COM_NO_INVVALUEIDXOFRXACCESSINFO" /end COMPU_VTAB
/begin COMPU_VTAB Com_InvValueOfRxAccessInfoType "" TAB_VERB 4 0 "COM_CONSTVALUEUINT8_INVVALUEOFRXACCESSINFO" 1 "COM_CONSTVALUEUINT16_INVVALUEOFRXACCESSINFO" 2 "COM_CONSTVALUEUINT32_INVVALUEOFRXACCESSINFO" 255 "COM_NO_INVVALUEOFRXACCESSINFO" /end COMPU_VTAB
/begin COMPU_VTAB_RANGE Com_IsGroupSignalOfRxAccessInfoType "" 2 0 0 "FALSE" 1 255 "TRUE" /end COMPU_VTAB_RANGE
/begin COMPU_VTAB Com_RxDataTimeoutSubstitutionValueIdxOfRxAccessInfoType "" TAB_VERB 1 255 "COM_NO_RXDATATIMEOUTSUBSTITUTIONVALUEIDXOFRXACCESSINFO" /end COMPU_VTAB
/begin COMPU_VTAB Com_RxDataTimeoutSubstitutionValueOfRxAccessInfoType "" TAB_VERB 3 0 "COM_CONSTVALUEUINT8_RXDATATIMEOUTSUBSTITUTIONVALUEOFRXACCESSINFO" 2 "COM_CONSTVALUEUINT32_RXDATATIMEOUTSUBSTITUTIONVALUEOFRXACCESSINFO" 255 "COM_NO_RXDATATIMEOUTSUBSTITUTIONVALUEOFRXACCESSINFO" /end COMPU_VTAB
/begin COMPU_VTAB Com_RxSigBufferArrayBasedBufferEndIdxOfRxAccessInfoType "" TAB_VERB 1 255 "COM_NO_RXSIGBUFFERARRAYBASEDBUFFERENDIDXOFRXACCESSINFO" /end COMPU_VTAB
/begin COMPU_VTAB Com_RxSigBufferArrayBasedBufferStartIdxOfRxAccessInfoType "" TAB_VERB 1 255 "COM_NO_RXSIGBUFFERARRAYBASEDBUFFERSTARTIDXOFRXACCESSINFO" /end COMPU_VTAB
/begin COMPU_VTAB Com_RxSigBufferArrayBasedShdBufferEndIdxOfRxAccessInfoType "" TAB_VERB 1 255 "COM_NO_RXSIGBUFFERARRAYBASEDSHDBUFFERENDIDXOFRXACCESSINFO" /end COMPU_VTAB
/begin COMPU_VTAB Com_RxSigBufferArrayBasedShdBufferStartIdxOfRxAccessInfoType "" TAB_VERB 1 255 "COM_NO_RXSIGBUFFERARRAYBASEDSHDBUFFERSTARTIDXOFRXACCESSINFO" /end COMPU_VTAB
/begin COMPU_VTAB Com_RxTOutInfoIdxOfRxAccessInfoType "" TAB_VERB 1 255 "COM_NO_RXTOUTINFOIDXOFRXACCESSINFO" /end COMPU_VTAB
/begin COMPU_VTAB Com_ShdBufferIdxOfRxAccessInfoType "" TAB_VERB 1 65535 "COM_NO_SHDBUFFERIDXOFRXACCESSINFO" /end COMPU_VTAB
/begin COMPU_VTAB Com_TmpBufferIdxOfRxAccessInfoType "" TAB_VERB 1 255 "COM_NO_TMPBUFFERIDXOFRXACCESSINFO" /end COMPU_VTAB
/begin COMPU_VTAB Com_TmpBufferOfRxAccessInfoType "" TAB_VERB 4 0 "COM_TMPRXSHDBUFFERUINT8_TMPBUFFEROFRXACCESSINFO" 1 "COM_TMPRXSHDBUFFERUINT16_TMPBUFFEROFRXACCESSINFO" 2 "COM_TMPRXSHDBUFFERUINT32_TMPBUFFEROFRXACCESSINFO" 255 "COM_NO_TMPBUFFEROFRXACCESSINFO" /end COMPU_VTAB
/begin COMPU_VTAB Com_TmpRxShdBufferArrayBasedTmpBufferEndIdxOfRxAccessInfoType "" TAB_VERB 1 255 "COM_NO_TMPRXSHDBUFFERARRAYBASEDTMPBUFFERENDIDXOFRXACCESSINFO" /end COMPU_VTAB
/begin COMPU_VTAB Com_TmpRxShdBufferArrayBasedTmpBufferStartIdxOfRxAccessInfoType "" TAB_VERB 1 255 "COM_NO_TMPRXSHDBUFFERARRAYBASEDTMPBUFFERSTARTIDXOFRXACCESSINFO" /end COMPU_VTAB
/begin GROUP Com ""
 /begin REF_MEASUREMENT Com_RxAccessInfo[147].BusAccOfRxAccessInfo Com_RxAccessInfo[147].ByteLengthOfRxAccessInfo Com_RxAccessInfo[147].ConstValueArrayBasedInitValueEndIdxOfRxAccessInfo Com_RxAccessInfo[147].ConstValueArrayBasedInitValueStartIdxOfRxAccessInfo Com_RxAccessInfo[147].DynSignalOfRxAccessInfo Com_RxAccessInfo[147].InitValueIdxOfRxAccessInfo Com_RxAccessInfo[147].InitValueOfRxAccessInfo Com_RxAccessInfo[147].InvValueIdxOfRxAccessInfo Com_RxAccessInfo[147].InvValueOfRxAccessInfo Com_RxAccessInfo[147].IsGroupSignalOfRxAccessInfo Com_RxAccessInfo[147].RxDataTimeoutSubstitutionValueIdxOfRxAccessInfo Com_RxAccessInfo[147].RxDataTimeoutSubstitutionValueOfRxAccessInfo Com_RxAccessInfo[147].RxPduInfoIdxOfRxAccessInfo Com_RxAccessInfo[147].RxSigBufferArrayBasedBufferEndIdxOfRxAccessInfo Com_RxAccessInfo[147].RxSigBufferArrayBasedBufferStartIdxOfRxAccessInfo Com_RxAccessInfo[147].RxSigBufferArrayBasedShdBufferEndIdxOfRxAccessInfo Com_RxAccessInfo[147].RxSigBufferArrayBasedShdBufferStartIdxOfRxAccessInfo Com_RxAccessInfo[147].RxTOutInfoIdxOfRxAccessInfo Com_RxAccessInfo[147].ShdBufferIdxOfRxAccessInfo Com_RxAccessInfo[147].SignalLengthInByteOfRxAccessInfo Com_RxAccessInfo[147].StartByteInPduPositionOfRxAccessInfo Com_RxAccessInfo[147].TmpBufferIdxOfRxAccessInfo Com_RxAccessInfo[147].TmpBufferOfRxAccessInfo Com_RxAccessInfo[147].TmpRxShdBufferArrayBasedTmpBufferEndIdxOfRxAccessInfo Com_RxAccessInfo[147].TmpRxShdBufferArrayBasedTmpBufferStartIdxOfRxAccessInfo Com_RxAccessInfo[148].ApplTypeOfRxAccessInfo Com_RxAccessInfo[148].BitLengthOfRxAccessInfo Com_RxAccessInfo[148].BitPositionOfRxAccessInfo Com_RxAccessInfo[148].BufferIdxOfRxAccessInfo Com_RxAccessInfo[148].BusAccOfRxAccessInfo Com_RxAccessInfo[148].ByteLengthOfRxAccessInfo Com_RxAccessInfo[148].ConstValueArrayBasedInitValueEndIdxOfRxAccessInfo Com_RxAccessInfo[148].ConstValueArrayBasedInitValueStartIdxOfRxAccessInfo Com_RxAccessInfo[148].DynSignalOfRxAccessInfo Com_RxAccessInfo[148].InitValueIdxOfRxAccessInfo Com_RxAccessInfo[148].InitValueOfRxAccessInfo Com_RxAccessInfo[148].InvValueIdxOfRxAccessInfo Com_RxAccessInfo[148].InvValueOfRxAccessInfo Com_RxAccessInfo[148].IsGroupSignalOfRxAccessInfo Com_RxAccessInfo[148].RxDataTimeoutSubstitutionValueIdxOfRxAccessInfo Com_RxAccessInfo[148].RxDataTimeoutSubstitutionValueOfRxAccessInfo Com_RxAccessInfo[148].RxPduInfoIdxOfRxAccessInfo Com_RxAccessInfo[148].RxSigBufferArrayBasedBufferEndIdxOfRxAccessInfo Com_RxAccessInfo[148].RxSigBufferArrayBasedBufferStartIdxOfRxAccessInfo Com_RxAccessInfo[148].RxSigBufferArrayBasedShdBufferEndIdxOfRxAccessInfo Com_RxAccessInfo[148].RxSigBufferArrayBasedShdBufferStartIdxOfRxAccessInfo Com_RxAccessInfo[148].RxTOutInfoIdxOfRxAccessInfo Com_RxAccessInfo[148].ShdBufferIdxOfRxAccessInfo Com_RxAccessInfo[148].SignalLengthInByteOfRxAccessInfo Com_RxAccessInfo[148].StartByteInPduPositionOfRxAccessInfo Com_RxAccessInfo[148].TmpBufferIdxOfRxAccessInfo Com_RxAccessInfo[148].TmpBufferOfRxAccessInfo Com_RxAccessInfo[148].TmpRxShdBufferArrayBasedTmpBufferEndIdxOfRxAccessInfo Com_RxAccessInfo[148].TmpRxShdBufferArrayBasedTmpBufferStartIdxOfRxAccessInfo Com_RxAccessInfo[149].ApplTypeOfRxAccessInfo Com_RxAccessInfo[149].BitLengthOfRxAccessInfo Com_RxAccessInfo[149].BitPositionOfRxAccessInfo Com_RxAccessInfo[149].BufferIdxOfRxAccessInfo Com_RxAccessInfo[149].BusAccOfRxAccessInfo Com_RxAccessInfo[149].ByteLengthOfRxAccessInfo Com_RxAccessInfo[149].ConstValueArrayBasedInitValueEndIdxOfRxAccessInfo Com_RxAccessInfo[149].ConstValueArrayBasedInitValueStartIdxOfRxAccessInfo Com_RxAccessInfo[149].DynSignalOfRxAccessInfo Com_RxAccessInfo[149].InitValueIdxOfRxAccessInfo Com_RxAccessInfo[149].InitValueOfRxAccessInfo Com_RxAccessInfo[149].InvValueIdxOfRxAccessInfo Com_RxAccessInfo[149].InvValueOfRxAccessInfo Com_RxAccessInfo[149].IsGroupSignalOfRxAccessInfo Com_RxAccessInfo[149].RxDataTimeoutSubstitutionValueIdxOfRxAccessInfo Com_RxAccessInfo[149].RxDataTimeoutSubstitutionValueOfRxAccessInfo Com_RxAccessInfo[149].RxPduInfoIdxOfRxAccessInfo Com_RxAccessInfo[149].RxSigBufferArrayBasedBufferEndIdxOfRxAccessInfo Com_RxAccessInfo[149].RxSigBufferArrayBasedBufferStartIdxOfRxAccessInfo Com_RxAccessInfo[149].RxSigBufferArrayBasedShdBufferEndIdxOfRxAccessInfo Com_RxAccessInfo[149].RxSigBufferArrayBasedShdBufferStartIdxOfRxAccessInfo Com_RxAccessInfo[149].RxTOutInfoIdxOfRxAccessInfo Com_RxAccessInfo[149].ShdBufferIdxOfRxAccessInfo Com_RxAccessInfo[149].SignalLengthInByteOfRxAccessInfo Com_RxAccessInfo[149].StartByteInPduPositionOfRxAccessInfo Com_RxAccessInfo[149].TmpBufferIdxOfRxAccessInfo Com_RxAccessInfo[149].TmpBufferOfRxAccessInfo Com_RxAccessInfo[149].TmpRxShdBufferArrayBasedTmpBufferEndIdxOfRxAccessInfo Com_RxAccessInfo[149].TmpRxShdBufferArrayBasedTmpBufferStartIdxOfRxAccessInfo Com_RxAccessInfo[14].ApplTypeOfRxAccessInfo Com_RxAccessInfo[14].BitLengthOfRxAccessInfo Com_RxAccessInfo[14].BitPositionOfRxAccessInfo Com_RxAccessInfo[14].BufferIdxOfRxAccessInfo Com_RxAccessInfo[14].BusAccOfRxAccessInfo Com_RxAccessInfo[14].ByteLengthOfRxAccessInfo Com_RxAccessInfo[14].ConstValueArrayBasedInitValueEndIdxOfRxAccessInfo Com_RxAccessInfo[14].ConstValueArrayBasedInitValueStartIdxOfRxAccessInfo Com_RxAccessInfo[14].DynSignalOfRxAccessInfo Com_RxAccessInfo[14].InitValueIdxOfRxAccessInfo Com_RxAccessInfo[14].InitValueOfRxAccessInfo Com_RxAccessInfo[14].InvValueIdxOfRxAccessInfo Com_RxAccessInfo[14].InvValueOfRxAccessInfo Com_RxAccessInfo[14].IsGroupSignalOfRxAccessInfo Com_RxAccessInfo[14].RxDataTimeoutSubstitutionValueIdxOfRxAccessInfo Com_RxAccessInfo[14].RxDataTimeoutSubstitutionValueOfRxAccessInfo Com_RxAccessInfo[14].RxPduInfoIdxOfRxAccessInfo Com_RxAccessInfo[14].RxSigBufferArrayBasedBufferEndIdxOfRxAccessInfo Com_RxAccessInfo[14].RxSigBufferArrayBasedBufferStartIdxOfRxAccessInfo Com_RxAccessInfo[14].RxSigBufferArrayBasedShdBufferEndIdxOfRxAccessInfo Com_RxAccessInfo[14].RxSigBufferArrayBasedShdBufferStartIdxOfRxAccessInfo Com_RxAccessInfo[14].RxTOutInfoIdxOfRxAccessInfo Com_RxAccessInfo[14].ShdBufferIdxOfRxAccessInfo Com_RxAccessInfo[14].SignalLengthInByteOfRxAccessInfo Com_RxAccessInfo[14].StartByteInPduPositionOfRxAccessInfo Com_RxAccessInfo[14].TmpBufferIdxOfRxAccessInfo Com_RxAccessInfo[14].TmpBufferOfRxAccessInfo Com_RxAccessInfo[14].TmpRxShdBufferArrayBasedTmpBufferEndIdxOfRxAccessInfo Com_RxAccessInfo[14].TmpRxShdBufferArrayBasedTmpBufferStartIdxOfRxAccessInfo Com_RxAccessInfo[150].ApplTypeOfRxAccessInfo Com_RxAccessInfo[150].BitLengthOfRxAccessInfo Com_RxAccessInfo[150].BitPositionOfRxAccessInfo Com_RxAccessInfo[150].BufferIdxOfRxAccessInfo Com_RxAccessInfo[150].BusAccOfRxAccessInfo Com_RxAccessInfo[150].ByteLengthOfRxAccessInfo Com_RxAccessInfo[150].ConstValueArrayBasedInitValueEndIdxOfRxAccessInfo Com_RxAccessInfo[150].ConstValueArrayBasedInitValueStartIdxOfRxAccessInfo Com_RxAccessInfo[150].DynSignalOfRxAccessInfo Com_RxAccessInfo[150].InitValueIdxOfRxAccessInfo Com_RxAccessInfo[150].InitValueOfRxAccessInfo Com_RxAccessInfo[150].InvValueIdxOfRxAccessInfo Com_RxAccessInfo[150].InvValueOfRxAccessInfo Com_RxAccessInfo[150].IsGroupSignalOfRxAccessInfo Com_RxAccessInfo[150].RxDataTimeoutSubstitutionValueIdxOfRxAccessInfo Com_RxAccessInfo[150].RxDataTimeoutSubstitutionValueOfRxAccessInfo Com_RxAccessInfo[150].RxPduInfoIdxOfRxAccessInfo Com_RxAccessInfo[150].RxSigBufferArrayBasedBufferEndIdxOfRxAccessInfo Com_RxAccessInfo[150].RxSigBufferArrayBasedBufferStartIdxOfRxAccessInfo Com_RxAccessInfo[150].RxSigBufferArrayBasedShdBufferEndIdxOfRxAccessInfo Com_RxAccessInfo[150].RxSigBufferArrayBasedShdBufferStartIdxOfRxAccessInfo Com_RxAccessInfo[150].RxTOutInfoIdxOfRxAccessInfo Com_RxAccessInfo[150].ShdBufferIdxOfRxAccessInfo Com_RxAccessInfo[150].SignalLengthInByteOfRxAccessInfo Com_RxAccessInfo[150].StartByteInPduPositionOfRxAccessInfo Com_RxAccessInfo[150].TmpBufferIdxOfRxAccessInfo Com_RxAccessInfo[150].TmpBufferOfRxAccessInfo Com_RxAccessInfo[150].TmpRxShdBufferArrayBasedTmpBufferEndIdxOfRxAccessInfo Com_RxAccessInfo[150].TmpRxShdBufferArrayBasedTmpBufferStartIdxOfRxAccessInfo Com_RxAccessInfo[151].ApplTypeOfRxAccessInfo Com_RxAccessInfo[151].BitLengthOfRxAccessInfo Com_RxAccessInfo[151].BitPositionOfRxAccessInfo Com_RxAccessInfo[151].BufferIdxOfRxAccessInfo Com_RxAccessInfo[151].BusAccOfRxAccessInfo Com_RxAccessInfo[151].ByteLengthOfRxAccessInfo Com_RxAccessInfo[151].ConstValueArrayBasedInitValueEndIdxOfRxAccessInfo Com_RxAccessInfo[151].ConstValueArrayBasedInitValueStartIdxOfRxAccessInfo Com_RxAccessInfo[151].DynSignalOfRxAccessInfo Com_RxAccessInfo[151].InitValueIdxOfRxAccessInfo Com_RxAccessInfo[151].InitValueOfRxAccessInfo Com_RxAccessInfo[151].InvValueIdxOfRxAccessInfo Com_RxAccessInfo[151].InvValueOfRxAccessInfo Com_RxAccessInfo[151].IsGroupSignalOfRxAccessInfo Com_RxAccessInfo[151].RxDataTimeoutSubstitutionValueIdxOfRxAccessInfo Com_RxAccessInfo[151].RxDataTimeoutSubstitutionValueOfRxAccessInfo Com_RxAccessInfo[151].RxPduInfoIdxOfRxAccessInfo Com_RxAccessInfo[151].RxSigBufferArrayBasedBufferEndIdxOfRxAccessInfo Com_RxAccessInfo[151].RxSigBufferArrayBasedBufferStartIdxOfRxAccessInfo Com_RxAccessInfo[151].RxSigBufferArrayBasedShdBufferEndIdxOfRxAccessInfo Com_RxAccessInfo[151].RxSigBufferArrayBasedShdBufferStartIdxOfRxAccessInfo Com_RxAccessInfo[151].RxTOutInfoIdxOfRxAccessInfo Com_RxAccessInfo[151].ShdBufferIdxOfRxAccessInfo Com_RxAccessInfo[151].SignalLengthInByteOfRxAccessInfo Com_RxAccessInfo[151].StartByteInPduPositionOfRxAccessInfo Com_RxAccessInfo[151].TmpBufferIdxOfRxAccessInfo Com_RxAccessInfo[151].TmpBufferOfRxAccessInfo Com_RxAccessInfo[151].TmpRxShdBufferArrayBasedTmpBufferEndIdxOfRxAccessInfo Com_RxAccessInfo[151].TmpRxShdBufferArrayBasedTmpBufferStartIdxOfRxAccessInfo Com_RxAccessInfo[152].ApplTypeOfRxAccessInfo Com_RxAccessInfo[152].BitLengthOfRxAccessInfo Com_RxAccessInfo[152].BitPositionOfRxAccessInfo Com_RxAccessInfo[152].BufferIdxOfRxAccessInfo Com_RxAccessInfo[152].BusAccOfRxAccessInfo Com_RxAccessInfo[152].ByteLengthOfRxAccessInfo Com_RxAccessInfo[152].ConstValueArrayBasedInitValueEndIdxOfRxAccessInfo Com_RxAccessInfo[152].ConstValueArrayBasedInitValueStartIdxOfRxAccessInfo Com_RxAccessInfo[152].DynSignalOfRxAccessInfo Com_RxAccessInfo[152].InitValueIdxOfRxAccessInfo Com_RxAccessInfo[152].InitValueOfRxAccessInfo Com_RxAccessInfo[152].InvValueIdxOfRxAccessInfo Com_RxAccessInfo[152].InvValueOfRxAccessInfo Com_RxAccessInfo[152].IsGroupSignalOfRxAccessInfo Com_RxAccessInfo[152].RxDataTimeoutSubstitutionValueIdxOfRxAccessInfo Com_RxAccessInfo[152].RxDataTimeoutSubstitutionValueOfRxAccessInfo Com_RxAccessInfo[152].RxPduInfoIdxOfRxAccessInfo Com_RxAccessInfo[152].RxSigBufferArrayBasedBufferEndIdxOfRxAccessInfo Com_RxAccessInfo[152].RxSigBufferArrayBasedBufferStartIdxOfRxAccessInfo Com_RxAccessInfo[152].RxSigBufferArrayBasedShdBufferEndIdxOfRxAccessInfo Com_RxAccessInfo[152].RxSigBufferArrayBasedShdBufferStartIdxOfRxAccessInfo Com_RxAccessInfo[152].RxTOutInfoIdxOfRxAccessInfo Com_RxAccessInfo[152].ShdBufferIdxOfRxAccessInfo Com_RxAccessInfo[152].SignalLengthInByteOfRxAccessInfo Com_RxAccessInfo[152].StartByteInPduPositionOfRxAccessInfo Com_RxAccessInfo[152].TmpBufferIdxOfRxAccessInfo Com_RxAccessInfo[152].TmpBufferOfRxAccessInfo Com_RxAccessInfo[152].TmpRxShdBufferArrayBasedTmpBufferEndIdxOfRxAccessInfo Com_RxAccessInfo[152].TmpRxShdBufferArrayBasedTmpBufferStartIdxOfRxAccessInfo Com_RxAccessInfo[153].ApplTypeOfRxAccessInfo Com_RxAccessInfo[153].BitLengthOfRxAccessInfo Com_RxAccessInfo[153].BitPositionOfRxAccessInfo Com_RxAccessInfo[153].BufferIdxOfRxAccessInfo Com_RxAccessInfo[153].BusAccOfRxAccessInfo Com_RxAccessInfo[153].ByteLengthOfRxAccessInfo Com_RxAccessInfo[153].ConstValueArrayBasedInitValueEndIdxOfRxAccessInfo Com_RxAccessInfo[153].ConstValueArrayBasedInitValueStartIdxOfRxAccessInfo Com_RxAccessInfo[153].DynSignalOfRxAccessInfo Com_RxAccessInfo[153].InitValueIdxOfRxAccessInfo Com_RxAccessInfo[153].InitValueOfRxAccessInfo Com_RxAccessInfo[153].InvValueIdxOfRxAccessInfo Com_RxAccessInfo[153].InvValueOfRxAccessInfo Com_RxAccessInfo[153].IsGroupSignalOfRxAccessInfo Com_RxAccessInfo[153].RxDataTimeoutSubstitutionValueIdxOfRxAccessInfo Com_RxAccessInfo[153].RxDataTimeoutSubstitutionValueOfRxAccessInfo Com_RxAccessInfo[153].RxPduInfoIdxOfRxAccessInfo Com_RxAccessInfo[153].RxSigBufferArrayBasedBufferEndIdxOfRxAccessInfo Com_RxAccessInfo[153].RxSigBufferArrayBasedBufferStartIdxOfRxAccessInfo Com_RxAccessInfo[153].RxSigBufferArrayBasedShdBufferEndIdxOfRxAccessInfo Com_RxAccessInfo[153].RxSigBufferArrayBasedShdBufferStartIdxOfRxAccessInfo Com_RxAccessInfo[153].RxTOutInfoIdxOfRxAccessInfo Com_RxAccessInfo[153].ShdBufferIdxOfRxAccessInfo Com_RxAccessInfo[153].SignalLengthInByteOfRxAccessInfo Com_RxAccessInfo[153].StartByteInPduPositionOfRxAccessInfo Com_RxAccessInfo[153].TmpBufferIdxOfRxAccessInfo Com_RxAccessInfo[153].TmpBufferOfRxAccessInfo Com_RxAccessInfo[153].TmpRxShdBufferArrayBasedTmpBufferEndIdxOfRxAccessInfo Com_RxAccessInfo[153].TmpRxShdBufferArrayBasedTmpBufferStartIdxOfRxAccessInfo Com_RxAccessInfo[154].ApplTypeOfRxAccessInfo Com_RxAccessInfo[154].BitLengthOfRxAccessInfo Com_RxAccessInfo[154].BitPositionOfRxAccessInfo Com_RxAccessInfo[154].BufferIdxOfRxAccessInfo Com_RxAccessInfo[154].BusAccOfRxAccessInfo Com_RxAccessInfo[154].ByteLengthOfRxAccessInfo Com_RxAccessInfo[154].ConstValueArrayBasedInitValueEndIdxOfRxAccessInfo Com_RxAccessInfo[154].ConstValueArrayBasedInitValueStartIdxOfRxAccessInfo Com_RxAccessInfo[154].DynSignalOfRxAccessInfo Com_RxAccessInfo[154].InitValueIdxOfRxAccessInfo Com_RxAccessInfo[154].InitValueOfRxAccessInfo Com_RxAccessInfo[154].InvValueIdxOfRxAccessInfo Com_RxAccessInfo[154].InvValueOfRxAccessInfo Com_RxAccessInfo[154].IsGroupSignalOfRxAccessInfo Com_RxAccessInfo[154].RxDataTimeoutSubstitutionValueIdxOfRxAccessInfo Com_RxAccessInfo[154].RxDataTimeoutSubstitutionValueOfRxAccessInfo Com_RxAccessInfo[154].RxPduInfoIdxOfRxAccessInfo Com_RxAccessInfo[154].RxSigBufferArrayBasedBufferEndIdxOfRxAccessInfo Com_RxAccessInfo[154].RxSigBufferArrayBasedBufferStartIdxOfRxAccessInfo Com_RxAccessInfo[154].RxSigBufferArrayBasedShdBufferEndIdxOfRxAccessInfo Com_RxAccessInfo[154].RxSigBufferArrayBasedShdBufferStartIdxOfRxAccessInfo Com_RxAccessInfo[154].RxTOutInfoIdxOfRxAccessInfo Com_RxAccessInfo[154].ShdBufferIdxOfRxAccessInfo Com_RxAccessInfo[154].SignalLengthInByteOfRxAccessInfo Com_RxAccessInfo[154].StartByteInPduPositionOfRxAccessInfo Com_RxAccessInfo[154].TmpBufferIdxOfRxAccessInfo Com_RxAccessInfo[154].TmpBufferOfRxAccessInfo Com_RxAccessInfo[154].TmpRxShdBufferArrayBasedTmpBufferEndIdxOfRxAccessInfo Com_RxAccessInfo[154].TmpRxShdBufferArrayBasedTmpBufferStartIdxOfRxAccessInfo Com_RxAccessInfo[155].ApplTypeOfRxAccessInfo Com_RxAccessInfo[155].BitLengthOfRxAccessInfo Com_RxAccessInfo[155].BitPositionOfRxAccessInfo Com_RxAccessInfo[155].BufferIdxOfRxAccessInfo Com_RxAccessInfo[155].BusAccOfRxAccessInfo Com_RxAccessInfo[155].ByteLengthOfRxAccessInfo Com_RxAccessInfo[155].ConstValueArrayBasedInitValueEndIdxOfRxAccessInfo Com_RxAccessInfo[155].ConstValueArrayBasedInitValueStartIdxOfRxAccessInfo Com_RxAccessInfo[155].DynSignalOfRxAccessInfo Com_RxAccessInfo[155].InitValueIdxOfRxAccessInfo Com_RxAccessInfo[155].InitValueOfRxAccessInfo Com_RxAccessInfo[155].InvValueIdxOfRxAccessInfo Com_RxAccessInfo[155].InvValueOfRxAccessInfo Com_RxAccessInfo[155].IsGroupSignalOfRxAccessInfo Com_RxAccessInfo[155].RxDataTimeoutSubstitutionValueIdxOfRxAccessInfo Com_RxAccessInfo[155].RxDataTimeoutSubstitutionValueOfRxAccessInfo Com_RxAccessInfo[155].RxPduInfoIdxOfRxAccessInfo Com_RxAccessInfo[155].RxSigBufferArrayBasedBufferEndIdxOfRxAccessInfo Com_RxAccessInfo[155].RxSigBufferArrayBasedBufferStartIdxOfRxAccessInfo Com_RxAccessInfo[155].RxSigBufferArrayBasedShdBufferEndIdxOfRxAccessInfo Com_RxAccessInfo[155].RxSigBufferArrayBasedShdBufferStartIdxOfRxAccessInfo Com_RxAccessInfo[155].RxTOutInfoIdxOfRxAccessInfo Com_RxAccessInfo[155].ShdBufferIdxOfRxAccessInfo Com_RxAccessInfo[155].SignalLengthInByteOfRxAccessInfo Com_RxAccessInfo[155].StartByteInPduPositionOfRxAccessInfo Com_RxAccessInfo[155].TmpBufferIdxOfRxAccessInfo Com_RxAccessInfo[155].TmpBufferOfRxAccessInfo Com_RxAccessInfo[155].TmpRxShdBufferArrayBasedTmpBufferEndIdxOfRxAccessInfo Com_RxAccessInfo[155].TmpRxShdBufferArrayBasedTmpBufferStartIdxOfRxAccessInfo Com_RxAccessInfo[156].ApplTypeOfRxAccessInfo Com_RxAccessInfo[156].BitLengthOfRxAccessInfo Com_RxAccessInfo[156].BitPositionOfRxAccessInfo Com_RxAccessInfo[156].BufferIdxOfRxAccessInfo Com_RxAccessInfo[156].BusAccOfRxAccessInfo Com_RxAccessInfo[156].ByteLengthOfRxAccessInfo Com_RxAccessInfo[156].ConstValueArrayBasedInitValueEndIdxOfRxAccessInfo Com_RxAccessInfo[156].ConstValueArrayBasedInitValueStartIdxOfRxAccessInfo Com_RxAccessInfo[156].DynSignalOfRxAccessInfo Com_RxAccessInfo[156].InitValueIdxOfRxAccessInfo Com_RxAccessInfo[156].InitValueOfRxAccessInfo Com_RxAccessInfo[156].InvValueIdxOfRxAccessInfo Com_RxAccessInfo[156].InvValueOfRxAccessInfo Com_RxAccessInfo[156].IsGroupSignalOfRxAccessInfo Com_RxAccessInfo[156].RxDataTimeoutSubstitutionValueIdxOfRxAccessInfo Com_RxAccessInfo[156].RxDataTimeoutSubstitutionValueOfRxAccessInfo Com_RxAccessInfo[156].RxPduInfoIdxOfRxAccessInfo Com_RxAccessInfo[156].RxSigBufferArrayBasedBufferEndIdxOfRxAccessInfo Com_RxAccessInfo[156].RxSigBufferArrayBasedBufferStartIdxOfRxAccessInfo Com_RxAccessInfo[156].RxSigBufferArrayBasedShdBufferEndIdxOfRxAccessInfo Com_RxAccessInfo[156].RxSigBufferArrayBasedShdBufferStartIdxOfRxAccessInfo Com_RxAccessInfo[156].RxTOutInfoIdxOfRxAccessInfo Com_RxAccessInfo[156].ShdBufferIdxOfRxAccessInfo Com_RxAccessInfo[156].SignalLengthInByteOfRxAccessInfo Com_RxAccessInfo[156].StartByteInPduPositionOfRxAccessInfo Com_RxAccessInfo[156].TmpBufferIdxOfRxAccessInfo Com_RxAccessInfo[156].TmpBufferOfRxAccessInfo Com_RxAccessInfo[156].TmpRxShdBufferArrayBasedTmpBufferEndIdxOfRxAccessInfo Com_RxAccessInfo[156].TmpRxShdBufferArrayBasedTmpBufferStartIdxOfRxAccessInfo Com_RxAccessInfo[157].ApplTypeOfRxAccessInfo Com_RxAccessInfo[157].BitLengthOfRxAccessInfo Com_RxAccessInfo[157].BitPositionOfRxAccessInfo Com_RxAccessInfo[157].BufferIdxOfRxAccessInfo Com_RxAccessInfo[157].BusAccOfRxAccessInfo Com_RxAccessInfo[157].ByteLengthOfRxAccessInfo Com_RxAccessInfo[157].ConstValueArrayBasedInitValueEndIdxOfRxAccessInfo Com_RxAccessInfo[157].ConstValueArrayBasedInitValueStartIdxOfRxAccessInfo Com_RxAccessInfo[157].DynSignalOfRxAccessInfo Com_RxAccessInfo[157].InitValueIdxOfRxAccessInfo Com_RxAccessInfo[157].InitValueOfRxAccessInfo Com_RxAccessInfo[157].InvValueIdxOfRxAccessInfo Com_RxAccessInfo[157].InvValueOfRxAccessInfo Com_RxAccessInfo[157].IsGroupSignalOfRxAccessInfo Com_RxAccessInfo[157].RxDataTimeoutSubstitutionValueIdxOfRxAccessInfo Com_RxAccessInfo[157].RxDataTimeoutSubstitutionValueOfRxAccessInfo Com_RxAccessInfo[157].RxPduInfoIdxOfRxAccessInfo Com_RxAccessInfo[157].RxSigBufferArrayBasedBufferEndIdxOfRxAccessInfo Com_RxAccessInfo[157].RxSigBufferArrayBasedBufferStartIdxOfRxAccessInfo Com_RxAccessInfo[157].RxSigBufferArrayBasedShdBufferEndIdxOfRxAccessInfo Com_RxAccessInfo[157].RxSigBufferArrayBasedShdBufferStartIdxOfRxAccessInfo Com_RxAccessInfo[157].RxTOutInfoIdxOfRxAccessInfo Com_RxAccessInfo[157].ShdBufferIdxOfRxAccessInfo Com_RxAccessInfo[157].SignalLengthInByteOfRxAccessInfo Com_RxAccessInfo[157].StartByteInPduPositionOfRxAccessInfo Com_RxAccessInfo[157].TmpBufferIdxOfRxAccessInfo Com_RxAccessInfo[157].TmpBufferOfRxAccessInfo Com_RxAccessInfo[157].TmpRxShdBufferArrayBasedTmpBufferEndIdxOfRxAccessInfo Com_RxAccessInfo[157].TmpRxShdBufferArrayBasedTmpBufferStartIdxOfRxAccessInfo Com_RxAccessInfo[158].ApplTypeOfRxAccessInfo Com_RxAccessInfo[158].BitLengthOfRxAccessInfo Com_RxAccessInfo[158].BitPositionOfRxAccessInfo Com_RxAccessInfo[158].BufferIdxOfRxAccessInfo Com_RxAccessInfo[158].BusAccOfRxAccessInfo Com_RxAccessInfo[158].ByteLengthOfRxAccessInfo Com_RxAccessInfo[158].ConstValueArrayBasedInitValueEndIdxOfRxAccessInfo Com_RxAccessInfo[158].ConstValueArrayBasedInitValueStartIdxOfRxAccessInfo Com_RxAccessInfo[158].DynSignalOfRxAccessInfo Com_RxAccessInfo[158].InitValueIdxOfRxAccessInfo Com_RxAccessInfo[158].InitValueOfRxAccessInfo Com_RxAccessInfo[158].InvValueIdxOfRxAccessInfo Com_RxAccessInfo[158].InvValueOfRxAccessInfo Com_RxAccessInfo[158].IsGroupSignalOfRxAccessInfo Com_RxAccessInfo[158].RxDataTimeoutSubstitutionValueIdxOfRxAccessInfo Com_RxAccessInfo[158].RxDataTimeoutSubstitutionValueOfRxAccessInfo Com_RxAccessInfo[158].RxPduInfoIdxOfRxAccessInfo Com_RxAccessInfo[158].RxSigBufferArrayBasedBufferEndIdxOfRxAccessInfo Com_RxAccessInfo[158].RxSigBufferArrayBasedBufferStartIdxOfRxAccessInfo Com_RxAccessInfo[158].RxSigBufferArrayBasedShdBufferEndIdxOfRxAccessInfo Com_RxAccessInfo[158].RxSigBufferArrayBasedShdBufferStartIdxOfRxAccessInfo Com_RxAccessInfo[158].RxTOutInfoIdxOfRxAccessInfo Com_RxAccessInfo[158].ShdBufferIdxOfRxAccessInfo Com_RxAccessInfo[158].SignalLengthInByteOfRxAccessInfo Com_RxAccessInfo[158].StartByteInPduPositionOfRxAccessInfo Com_RxAccessInfo[158].TmpBufferIdxOfRxAccessInfo Com_RxAccessInfo[158].TmpBufferOfRxAccessInfo Com_RxAccessInfo[158].TmpRxShdBufferArrayBasedTmpBufferEndIdxOfRxAccessInfo Com_RxAccessInfo[158].TmpRxShdBufferArrayBasedTmpBufferStartIdxOfRxAccessInfo Com_RxAccessInfo[159].ApplTypeOfRxAccessInfo Com_RxAccessInfo[159].BitLengthOfRxAccessInfo Com_RxAccessInfo[159].BitPositionOfRxAccessInfo Com_RxAccessInfo[159].BufferIdxOfRxAccessInfo Com_RxAccessInfo[159].BusAccOfRxAccessInfo Com_RxAccessInfo[159].ByteLengthOfRxAccessInfo Com_RxAccessInfo[159].ConstValueArrayBasedInitValueEndIdxOfRxAccessInfo Com_RxAccessInfo[159].ConstValueArrayBasedInitValueStartIdxOfRxAccessInfo Com_RxAccessInfo[159].DynSignalOfRxAccessInfo Com_RxAccessInfo[159].InitValueIdxOfRxAccessInfo Com_RxAccessInfo[159].InitValueOfRxAccessInfo Com_RxAccessInfo[159].InvValueIdxOfRxAccessInfo Com_RxAccessInfo[159].InvValueOfRxAccessInfo Com_RxAccessInfo[159].IsGroupSignalOfRxAccessInfo Com_RxAccessInfo[159].RxDataTimeoutSubstitutionValueIdxOfRxAccessInfo Com_RxAccessInfo[159].RxDataTimeoutSubstitutionValueOfRxAccessInfo Com_RxAccessInfo[159].RxPduInfoIdxOfRxAccessInfo Com_RxAccessInfo[159].RxSigBufferArrayBasedBufferEndIdxOfRxAccessInfo Com_RxAccessInfo[159].RxSigBufferArrayBasedBufferStartIdxOfRxAccessInfo Com_RxAccessInfo[159].RxSigBufferArrayBasedShdBufferEndIdxOfRxAccessInfo Com_RxAccessInfo[159].RxSigBufferArrayBasedShdBufferStartIdxOfRxAccessInfo Com_RxAccessInfo[159].RxTOutInfoIdxOfRxAccessInfo Com_RxAccessInfo[159].ShdBufferIdxOfRxAccessInfo Com_RxAccessInfo[159].SignalLengthInByteOfRxAccessInfo Com_RxAccessInfo[159].StartByteInPduPositionOfRxAccessInfo Com_RxAccessInfo[159].TmpBufferIdxOfRxAccessInfo Com_RxAccessInfo[159].TmpBufferOfRxAccessInfo Com_RxAccessInfo[159].TmpRxShdBufferArrayBasedTmpBufferEndIdxOfRxAccessInfo Com_RxAccessInfo[159].TmpRxShdBufferArrayBasedTmpBufferStartIdxOfRxAccessInfo Com_RxAccessInfo[15].ApplTypeOfRxAccessInfo Com_RxAccessInfo[15].BitLengthOfRxAccessInfo Com_RxAccessInfo[15].BitPositionOfRxAccessInfo Com_RxAccessInfo[15].BufferIdxOfRxAccessInfo Com_RxAccessInfo[15].BusAccOfRxAccessInfo Com_RxAccessInfo[15].ByteLengthOfRxAccessInfo Com_RxAccessInfo[15].ConstValueArrayBasedInitValueEndIdxOfRxAccessInfo Com_RxAccessInfo[15].ConstValueArrayBasedInitValueStartIdxOfRxAccessInfo Com_RxAccessInfo[15].DynSignalOfRxAccessInfo Com_RxAccessInfo[15].InitValueIdxOfRxAccessInfo Com_RxAccessInfo[15].InitValueOfRxAccessInfo Com_RxAccessInfo[15].InvValueIdxOfRxAccessInfo Com_RxAccessInfo[15].InvValueOfRxAccessInfo Com_RxAccessInfo[15].IsGroupSignalOfRxAccessInfo Com_RxAccessInfo[15].RxDataTimeoutSubstitutionValueIdxOfRxAccessInfo Com_RxAccessInfo[15].RxDataTimeoutSubstitutionValueOfRxAccessInfo Com_RxAccessInfo[15].RxPduInfoIdxOfRxAccessInfo Com_RxAccessInfo[15].RxSigBufferArrayBasedBufferEndIdxOfRxAccessInfo Com_RxAccessInfo[15].RxSigBufferArrayBasedBufferStartIdxOfRxAccessInfo Com_RxAccessInfo[15].RxSigBufferArrayBasedShdBufferEndIdxOfRxAccessInfo Com_RxAccessInfo[15].RxSigBufferArrayBasedShdBufferStartIdxOfRxAccessInfo Com_RxAccessInfo[15].RxTOutInfoIdxOfRxAccessInfo Com_RxAccessInfo[15].ShdBufferIdxOfRxAccessInfo Com_RxAccessInfo[15].SignalLengthInByteOfRxAccessInfo Com_RxAccessInfo[15].StartByteInPduPositionOfRxAccessInfo Com_RxAccessInfo[15].TmpBufferIdxOfRxAccessInfo Com_RxAccessInfo[15].TmpBufferOfRxAccessInfo Com_RxAccessInfo[15].TmpRxShdBufferArrayBasedTmpBufferEndIdxOfRxAccessInfo Com_RxAccessInfo[15].TmpRxShdBufferArrayBasedTmpBufferStartIdxOfRxAccessInfo Com_RxAccessInfo[160].ApplTypeOfRxAccessInfo Com_RxAccessInfo[160].BitLengthOfRxAccessInfo Com_RxAccessInfo[160].BitPositionOfRxAccessInfo Com_RxAccessInfo[160].BufferIdxOfRxAccessInfo Com_RxAccessInfo[160].BusAccOfRxAccessInfo Com_RxAccessInfo[160].ByteLengthOfRxAccessInfo Com_RxAccessInfo[160].ConstValueArrayBasedInitValueEndIdxOfRxAccessInfo Com_RxAccessInfo[160].ConstValueArrayBasedInitValueStartIdxOfRxAccessInfo Com_RxAccessInfo[160].DynSignalOfRxAccessInfo Com_RxAccessInfo[160].InitValueIdxOfRxAccessInfo Com_RxAccessInfo[160].InitValueOfRxAccessInfo Com_RxAccessInfo[160].InvValueIdxOfRxAccessInfo Com_RxAccessInfo[160].InvValueOfRxAccessInfo Com_RxAccessInfo[160].IsGroupSignalOfRxAccessInfo Com_RxAccessInfo[160].RxDataTimeoutSubstitutionValueIdxOfRxAccessInfo Com_RxAccessInfo[160].RxDataTimeoutSubstitutionValueOfRxAccessInfo Com_RxAccessInfo[160].RxPduInfoIdxOfRxAccessInfo Com_RxAccessInfo[160].RxSigBufferArrayBasedBufferEndIdxOfRxAccessInfo Com_RxAccessInfo[160].RxSigBufferArrayBasedBufferStartIdxOfRxAccessInfo Com_RxAccessInfo[160].RxSigBufferArrayBasedShdBufferEndIdxOfRxAccessInfo Com_RxAccessInfo[160].RxSigBufferArrayBasedShdBufferStartIdxOfRxAccessInfo Com_RxAccessInfo[160].RxTOutInfoIdxOfRxAccessInfo Com_RxAccessInfo[160].ShdBufferIdxOfRxAccessInfo Com_RxAccessInfo[160].SignalLengthInByteOfRxAccessInfo Com_RxAccessInfo[160].StartByteInPduPositionOfRxAccessInfo Com_RxAccessInfo[160].TmpBufferIdxOfRxAccessInfo Com_RxAccessInfo[160].TmpBufferOfRxAccessInfo Com_RxAccessInfo[160].TmpRxShdBufferArrayBasedTmpBufferEndIdxOfRxAccessInfo Com_RxAccessInfo[160].TmpRxShdBufferArrayBasedTmpBufferStartIdxOfRxAccessInfo Com_RxAccessInfo[161].ApplTypeOfRxAccessInfo Com_RxAccessInfo[161].BitLengthOfRxAccessInfo Com_RxAccessInfo[161].BitPositionOfRxAccessInfo Com_RxAccessInfo[161].BufferIdxOfRxAccessInfo Com_RxAccessInfo[161].BusAccOfRxAccessInfo Com_RxAccessInfo[161].ByteLengthOfRxAccessInfo Com_RxAccessInfo[161].ConstValueArrayBasedInitValueEndIdxOfRxAccessInfo Com_RxAccessInfo[161].ConstValueArrayBasedInitValueStartIdxOfRxAccessInfo Com_RxAccessInfo[161].DynSignalOfRxAccessInfo Com_RxAccessInfo[161].InitValueIdxOfRxAccessInfo Com_RxAccessInfo[161].InitValueOfRxAccessInfo Com_RxAccessInfo[161].InvValueIdxOfRxAccessInfo Com_RxAccessInfo[161].InvValueOfRxAccessInfo Com_RxAccessInfo[161].IsGroupSignalOfRxAccessInfo Com_RxAccessInfo[161].RxDataTimeoutSubstitutionValueIdxOfRxAccessInfo Com_RxAccessInfo[161].RxDataTimeoutSubstitutionValueOfRxAccessInfo Com_RxAccessInfo[161].RxPduInfoIdxOfRxAccessInfo Com_RxAccessInfo[161].RxSigBufferArrayBasedBufferEndIdxOfRxAccessInfo Com_RxAccessInfo[161].RxSigBufferArrayBasedBufferStartIdxOfRxAccessInfo Com_RxAccessInfo[161].RxSigBufferArrayBasedShdBufferEndIdxOfRxAccessInfo Com_RxAccessInfo[161].RxSigBufferArrayBasedShdBufferStartIdxOfRxAccessInfo Com_RxAccessInfo[161].RxTOutInfoIdxOfRxAccessInfo Com_RxAccessInfo[161].ShdBufferIdxOfRxAccessInfo Com_RxAccessInfo[161].SignalLengthInByteOfRxAccessInfo Com_RxAccessInfo[161].StartByteInPduPositionOfRxAccessInfo Com_RxAccessInfo[161].TmpBufferIdxOfRxAccessInfo Com_RxAccessInfo[161].TmpBufferOfRxAccessInfo Com_RxAccessInfo[161].TmpRxShdBufferArrayBasedTmpBufferEndIdxOfRxAccessInfo Com_RxAccessInfo[161].TmpRxShdBufferArrayBasedTmpBufferStartIdxOfRxAccessInfo Com_RxAccessInfo[162].ApplTypeOfRxAccessInfo Com_RxAccessInfo[162].BitLengthOfRxAccessInfo Com_RxAccessInfo[162].BitPositionOfRxAccessInfo Com_RxAccessInfo[162].BufferIdxOfRxAccessInfo Com_RxAccessInfo[162].BusAccOfRxAccessInfo Com_RxAccessInfo[162].ByteLengthOfRxAccessInfo Com_RxAccessInfo[162].ConstValueArrayBasedInitValueEndIdxOfRxAccessInfo Com_RxAccessInfo[162].ConstValueArrayBasedInitValueStartIdxOfRxAccessInfo Com_RxAccessInfo[162].DynSignalOfRxAccessInfo Com_RxAccessInfo[162].InitValueIdxOfRxAccessInfo Com_RxAccessInfo[162].InitValueOfRxAccessInfo Com_RxAccessInfo[162].InvValueIdxOfRxAccessInfo Com_RxAccessInfo[162].InvValueOfRxAccessInfo Com_RxAccessInfo[162].IsGroupSignalOfRxAccessInfo Com_RxAccessInfo[162].RxDataTimeoutSubstitutionValueIdxOfRxAccessInfo Com_RxAccessInfo[162].RxDataTimeoutSubstitutionValueOfRxAccessInfo Com_RxAccessInfo[162].RxPduInfoIdxOfRxAccessInfo Com_RxAccessInfo[162].RxSigBufferArrayBasedBufferEndIdxOfRxAccessInfo Com_RxAccessInfo[162].RxSigBufferArrayBasedBufferStartIdxOfRxAccessInfo Com_RxAccessInfo[162].RxSigBufferArrayBasedShdBufferEndIdxOfRxAccessInfo Com_RxAccessInfo[162].RxSigBufferArrayBasedShdBufferStartIdxOfRxAccessInfo Com_RxAccessInfo[162].RxTOutInfoIdxOfRxAccessInfo Com_RxAccessInfo[162].ShdBufferIdxOfRxAccessInfo Com_RxAccessInfo[162].SignalLengthInByteOfRxAccessInfo Com_RxAccessInfo[162].StartByteInPduPositionOfRxAccessInfo Com_RxAccessInfo[162].TmpBufferIdxOfRxAccessInfo Com_RxAccessInfo[162].TmpBufferOfRxAccessInfo Com_RxAccessInfo[162].TmpRxShdBufferArrayBasedTmpBufferEndIdxOfRxAccessInfo Com_RxAccessInfo[162].TmpRxShdBufferArrayBasedTmpBufferStartIdxOfRxAccessInfo Com_RxAccessInfo[163].ApplTypeOfRxAccessInfo Com_RxAccessInfo[163].BitLengthOfRxAccessInfo Com_RxAccessInfo[163].BitPositionOfRxAccessInfo Com_RxAccessInfo[163].BufferIdxOfRxAccessInfo Com_RxAccessInfo[163].BusAccOfRxAccessInfo Com_RxAccessInfo[163].ByteLengthOfRxAccessInfo Com_RxAccessInfo[163].ConstValueArrayBasedInitValueEndIdxOfRxAccessInfo Com_RxAccessInfo[163].ConstValueArrayBasedInitValueStartIdxOfRxAccessInfo Com_RxAccessInfo[163].DynSignalOfRxAccessInfo Com_RxAccessInfo[163].InitValueIdxOfRxAccessInfo Com_RxAccessInfo[163].InitValueOfRxAccessInfo Com_RxAccessInfo[163].InvValueIdxOfRxAccessInfo Com_RxAccessInfo[163].InvValueOfRxAccessInfo Com_RxAccessInfo[163].IsGroupSignalOfRxAccessInfo Com_RxAccessInfo[163].RxDataTimeoutSubstitutionValueIdxOfRxAccessInfo Com_RxAccessInfo[163].RxDataTimeoutSubstitutionValueOfRxAccessInfo Com_RxAccessInfo[163].RxPduInfoIdxOfRxAccessInfo Com_RxAccessInfo[163].RxSigBufferArrayBasedBufferEndIdxOfRxAccessInfo Com_RxAccessInfo[163].RxSigBufferArrayBasedBufferStartIdxOfRxAccessInfo Com_RxAccessInfo[163].RxSigBufferArrayBasedShdBufferEndIdxOfRxAccessInfo Com_RxAccessInfo[163].RxSigBufferArrayBasedShdBufferStartIdxOfRxAccessInfo Com_RxAccessInfo[163].RxTOutInfoIdxOfRxAccessInfo Com_RxAccessInfo[163].ShdBufferIdxOfRxAccessInfo Com_RxAccessInfo[163].SignalLengthInByteOfRxAccessInfo Com_RxAccessInfo[163].StartByteInPduPositionOfRxAccessInfo Com_RxAccessInfo[163].TmpBufferIdxOfRxAccessInfo Com_RxAccessInfo[163].TmpBufferOfRxAccessInfo Com_RxAccessInfo[163].TmpRxShdBufferArrayBasedTmpBufferEndIdxOfRxAccessInfo Com_RxAccessInfo[163].TmpRxShdBufferArrayBasedTmpBufferStartIdxOfRxAccessInfo Com_RxAccessInfo[164].ApplTypeOfRxAccessInfo Com_RxAccessInfo[164].BitLengthOfRxAccessInfo Com_RxAccessInfo[164].BitPositionOfRxAccessInfo Com_RxAccessInfo[164].BufferIdxOfRxAccessInfo Com_RxAccessInfo[164].BusAccOfRxAccessInfo Com_RxAccessInfo[164].ByteLengthOfRxAccessInfo Com_RxAccessInfo[164].ConstValueArrayBasedInitValueEndIdxOfRxAccessInfo Com_RxAccessInfo[164].ConstValueArrayBasedInitValueStartIdxOfRxAccessInfo Com_RxAccessInfo[164].DynSignalOfRxAccessInfo Com_RxAccessInfo[164].InitValueIdxOfRxAccessInfo Com_RxAccessInfo[164].InitValueOfRxAccessInfo Com_RxAccessInfo[164].InvValueIdxOfRxAccessInfo Com_RxAccessInfo[164].InvValueOfRxAccessInfo Com_RxAccessInfo[164].IsGroupSignalOfRxAccessInfo Com_RxAccessInfo[164].RxDataTimeoutSubstitutionValueIdxOfRxAccessInfo Com_RxAccessInfo[164].RxDataTimeoutSubstitutionValueOfRxAccessInfo Com_RxAccessInfo[164].RxPduInfoIdxOfRxAccessInfo Com_RxAccessInfo[164].RxSigBufferArrayBasedBufferEndIdxOfRxAccessInfo Com_RxAccessInfo[164].RxSigBufferArrayBasedBufferStartIdxOfRxAccessInfo Com_RxAccessInfo[164].RxSigBufferArrayBasedShdBufferEndIdxOfRxAccessInfo Com_RxAccessInfo[164].RxSigBufferArrayBasedShdBufferStartIdxOfRxAccessInfo Com_RxAccessInfo[164].RxTOutInfoIdxOfRxAccessInfo Com_RxAccessInfo[164].ShdBufferIdxOfRxAccessInfo Com_RxAccessInfo[164].SignalLengthInByteOfRxAccessInfo Com_RxAccessInfo[164].StartByteInPduPositionOfRxAccessInfo Com_RxAccessInfo[164].TmpBufferIdxOfRxAccessInfo Com_RxAccessInfo[164].TmpBufferOfRxAccessInfo Com_RxAccessInfo[164].TmpRxShdBufferArrayBasedTmpBufferEndIdxOfRxAccessInfo Com_RxAccessInfo[164].TmpRxShdBufferArrayBasedTmpBufferStartIdxOfRxAccessInfo Com_RxAccessInfo[165].ApplTypeOfRxAccessInfo Com_RxAccessInfo[165].BitLengthOfRxAccessInfo Com_RxAccessInfo[165].BitPositionOfRxAccessInfo Com_RxAccessInfo[165].BufferIdxOfRxAccessInfo Com_RxAccessInfo[165].BusAccOfRxAccessInfo Com_RxAccessInfo[165].ByteLengthOfRxAccessInfo Com_RxAccessInfo[165].ConstValueArrayBasedInitValueEndIdxOfRxAccessInfo Com_RxAccessInfo[165].ConstValueArrayBasedInitValueStartIdxOfRxAccessInfo Com_RxAccessInfo[165].DynSignalOfRxAccessInfo Com_RxAccessInfo[165].InitValueIdxOfRxAccessInfo Com_RxAccessInfo[165].InitValueOfRxAccessInfo Com_RxAccessInfo[165].InvValueIdxOfRxAccessInfo Com_RxAccessInfo[165].InvValueOfRxAccessInfo Com_RxAccessInfo[165].IsGroupSignalOfRxAccessInfo Com_RxAccessInfo[165].RxDataTimeoutSubstitutionValueIdxOfRxAccessInfo Com_RxAccessInfo[165].RxDataTimeoutSubstitutionValueOfRxAccessInfo Com_RxAccessInfo[165].RxPduInfoIdxOfRxAccessInfo Com_RxAccessInfo[165].RxSigBufferArrayBasedBufferEndIdxOfRxAccessInfo Com_RxAccessInfo[165].RxSigBufferArrayBasedBufferStartIdxOfRxAccessInfo Com_RxAccessInfo[165].RxSigBufferArrayBasedShdBufferEndIdxOfRxAccessInfo Com_RxAccessInfo[165].RxSigBufferArrayBasedShdBufferStartIdxOfRxAccessInfo Com_RxAccessInfo[165].RxTOutInfoIdxOfRxAccessInfo Com_RxAccessInfo[165].ShdBufferIdxOfRxAccessInfo Com_RxAccessInfo[165].SignalLengthInByteOfRxAccessInfo Com_RxAccessInfo[165].StartByteInPduPositionOfRxAccessInfo Com_RxAccessInfo[165].TmpBufferIdxOfRxAccessInfo Com_RxAccessInfo[165].TmpBufferOfRxAccessInfo Com_RxAccessInfo[165].TmpRxShdBufferArrayBasedTmpBufferEndIdxOfRxAccessInfo Com_RxAccessInfo[165].TmpRxShdBufferArrayBasedTmpBufferStartIdxOfRxAccessInfo Com_RxAccessInfo[166].ApplTypeOfRxAccessInfo Com_RxAccessInfo[166].BitLengthOfRxAccessInfo Com_RxAccessInfo[166].BitPositionOfRxAccessInfo Com_RxAccessInfo[166].BufferIdxOfRxAccessInfo Com_RxAccessInfo[166].BusAccOfRxAccessInfo Com_RxAccessInfo[166].ByteLengthOfRxAccessInfo Com_RxAccessInfo[166].ConstValueArrayBasedInitValueEndIdxOfRxAccessInfo Com_RxAccessInfo[166].ConstValueArrayBasedInitValueStartIdxOfRxAccessInfo Com_RxAccessInfo[166].DynSignalOfRxAccessInfo Com_RxAccessInfo[166].InitValueIdxOfRxAccessInfo Com_RxAccessInfo[166].InitValueOfRxAccessInfo Com_RxAccessInfo[166].InvValueIdxOfRxAccessInfo Com_RxAccessInfo[166].InvValueOfRxAccessInfo Com_RxAccessInfo[166].IsGroupSignalOfRxAccessInfo Com_RxAccessInfo[166].RxDataTimeoutSubstitutionValueIdxOfRxAccessInfo Com_RxAccessInfo[166].RxDataTimeoutSubstitutionValueOfRxAccessInfo Com_RxAccessInfo[166].RxPduInfoIdxOfRxAccessInfo Com_RxAccessInfo[166].RxSigBufferArrayBasedBufferEndIdxOfRxAccessInfo Com_RxAccessInfo[166].RxSigBufferArrayBasedBufferStartIdxOfRxAccessInfo Com_RxAccessInfo[166].RxSigBufferArrayBasedShdBufferEndIdxOfRxAccessInfo Com_RxAccessInfo[166].RxSigBufferArrayBasedShdBufferStartIdxOfRxAccessInfo Com_RxAccessInfo[166].RxTOutInfoIdxOfRxAccessInfo Com_RxAccessInfo[166].ShdBufferIdxOfRxAccessInfo Com_RxAccessInfo[166].SignalLengthInByteOfRxAccessInfo Com_RxAccessInfo[166].StartByteInPduPositionOfRxAccessInfo Com_RxAccessInfo[166].TmpBufferIdxOfRxAccessInfo Com_RxAccessInfo[166].TmpBufferOfRxAccessInfo Com_RxAccessInfo[166].TmpRxShdBufferArrayBasedTmpBufferEndIdxOfRxAccessInfo Com_RxAccessInfo[166].TmpRxShdBufferArrayBasedTmpBufferStartIdxOfRxAccessInfo Com_RxAccessInfo[167].ApplTypeOfRxAccessInfo Com_RxAccessInfo[167].BitLengthOfRxAccessInfo Com_RxAccessInfo[167].BitPositionOfRxAccessInfo Com_RxAccessInfo[167].BufferIdxOfRxAccessInfo Com_RxAccessInfo[167].BusAccOfRxAccessInfo Com_RxAccessInfo[167].ByteLengthOfRxAccessInfo Com_RxAccessInfo[167].ConstValueArrayBasedInitValueEndIdxOfRxAccessInfo Com_RxAccessInfo[167].ConstValueArrayBasedInitValueStartIdxOfRxAccessInfo Com_RxAccessInfo[167].DynSignalOfRxAccessInfo Com_RxAccessInfo[167].InitValueIdxOfRxAccessInfo Com_RxAccessInfo[167].InitValueOfRxAccessInfo Com_RxAccessInfo[167].InvValueIdxOfRxAccessInfo Com_RxAccessInfo[167].InvValueOfRxAccessInfo Com_RxAccessInfo[167].IsGroupSignalOfRxAccessInfo Com_RxAccessInfo[167].RxDataTimeoutSubstitutionValueIdxOfRxAccessInfo Com_RxAccessInfo[167].RxDataTimeoutSubstitutionValueOfRxAccessInfo Com_RxAccessInfo[167].RxPduInfoIdxOfRxAccessInfo Com_RxAccessInfo[167].RxSigBufferArrayBasedBufferEndIdxOfRxAccessInfo Com_RxAccessInfo[167].RxSigBufferArrayBasedBufferStartIdxOfRxAccessInfo Com_RxAccessInfo[167].RxSigBufferArrayBasedShdBufferEndIdxOfRxAccessInfo Com_RxAccessInfo[167].RxSigBufferArrayBasedShdBufferStartIdxOfRxAccessInfo Com_RxAccessInfo[167].RxTOutInfoIdxOfRxAccessInfo Com_RxAccessInfo[167].ShdBufferIdxOfRxAccessInfo Com_RxAccessInfo[167].SignalLengthInByteOfRxAccessInfo Com_RxAccessInfo[167].StartByteInPduPositionOfRxAccessInfo Com_RxAccessInfo[167].TmpBufferIdxOfRxAccessInfo Com_RxAccessInfo[167].TmpBufferOfRxAccessInfo Com_RxAccessInfo[167].TmpRxShdBufferArrayBasedTmpBufferEndIdxOfRxAccessInfo Com_RxAccessInfo[167].TmpRxShdBufferArrayBasedTmpBufferStartIdxOfRxAccessInfo Com_RxAccessInfo[168].ApplTypeOfRxAccessInfo Com_RxAccessInfo[168].BitLengthOfRxAccessInfo Com_RxAccessInfo[168].BitPositionOfRxAccessInfo Com_RxAccessInfo[168].BufferIdxOfRxAccessInfo Com_RxAccessInfo[168].BusAccOfRxAccessInfo Com_RxAccessInfo[168].ByteLengthOfRxAccessInfo Com_RxAccessInfo[168].ConstValueArrayBasedInitValueEndIdxOfRxAccessInfo Com_RxAccessInfo[168].ConstValueArrayBasedInitValueStartIdxOfRxAccessInfo Com_RxAccessInfo[168].DynSignalOfRxAccessInfo Com_RxAccessInfo[168].InitValueIdxOfRxAccessInfo Com_RxAccessInfo[168].InitValueOfRxAccessInfo Com_RxAccessInfo[168].InvValueIdxOfRxAccessInfo Com_RxAccessInfo[168].InvValueOfRxAccessInfo Com_RxAccessInfo[168].IsGroupSignalOfRxAccessInfo Com_RxAccessInfo[168].RxDataTimeoutSubstitutionValueIdxOfRxAccessInfo Com_RxAccessInfo[168].RxDataTimeoutSubstitutionValueOfRxAccessInfo Com_RxAccessInfo[168].RxPduInfoIdxOfRxAccessInfo Com_RxAccessInfo[168].RxSigBufferArrayBasedBufferEndIdxOfRxAccessInfo Com_RxAccessInfo[168].RxSigBufferArrayBasedBufferStartIdxOfRxAccessInfo Com_RxAccessInfo[168].RxSigBufferArrayBasedShdBufferEndIdxOfRxAccessInfo Com_RxAccessInfo[168].RxSigBufferArrayBasedShdBufferStartIdxOfRxAccessInfo Com_RxAccessInfo[168].RxTOutInfoIdxOfRxAccessInfo Com_RxAccessInfo[168].ShdBufferIdxOfRxAccessInfo Com_RxAccessInfo[168].SignalLengthInByteOfRxAccessInfo Com_RxAccessInfo[168].StartByteInPduPositionOfRxAccessInfo Com_RxAccessInfo[168].TmpBufferIdxOfRxAccessInfo Com_RxAccessInfo[168].TmpBufferOfRxAccessInfo Com_RxAccessInfo[168].TmpRxShdBufferArrayBasedTmpBufferEndIdxOfRxAccessInfo Com_RxAccessInfo[168].TmpRxShdBufferArrayBasedTmpBufferStartIdxOfRxAccessInfo Com_RxAccessInfo[169].ApplTypeOfRxAccessInfo Com_RxAccessInfo[169].BitLengthOfRxAccessInfo Com_RxAccessInfo[169].BitPositionOfRxAccessInfo Com_RxAccessInfo[169].BufferIdxOfRxAccessInfo Com_RxAccessInfo[169].BusAccOfRxAccessInfo Com_RxAccessInfo[169].ByteLengthOfRxAccessInfo Com_RxAccessInfo[169].ConstValueArrayBasedInitValueEndIdxOfRxAccessInfo Com_RxAccessInfo[169].ConstValueArrayBasedInitValueStartIdxOfRxAccessInfo Com_RxAccessInfo[169].DynSignalOfRxAccessInfo Com_RxAccessInfo[169].InitValueIdxOfRxAccessInfo Com_RxAccessInfo[169].InitValueOfRxAccessInfo Com_RxAccessInfo[169].InvValueIdxOfRxAccessInfo Com_RxAccessInfo[169].InvValueOfRxAccessInfo Com_RxAccessInfo[169].IsGroupSignalOfRxAccessInfo Com_RxAccessInfo[169].RxDataTimeoutSubstitutionValueIdxOfRxAccessInfo Com_RxAccessInfo[169].RxDataTimeoutSubstitutionValueOfRxAccessInfo Com_RxAccessInfo[169].RxPduInfoIdxOfRxAccessInfo Com_RxAccessInfo[169].RxSigBufferArrayBasedBufferEndIdxOfRxAccessInfo Com_RxAccessInfo[169].RxSigBufferArrayBasedBufferStartIdxOfRxAccessInfo Com_RxAccessInfo[169].RxSigBufferArrayBasedShdBufferEndIdxOfRxAccessInfo Com_RxAccessInfo[169].RxSigBufferArrayBasedShdBufferStartIdxOfRxAccessInfo Com_RxAccessInfo[169].RxTOutInfoIdxOfRxAccessInfo Com_RxAccessInfo[169].ShdBufferIdxOfRxAccessInfo Com_RxAccessInfo[169].SignalLengthInByteOfRxAccessInfo Com_RxAccessInfo[169].StartByteInPduPositionOfRxAccessInfo Com_RxAccessInfo[169].TmpBufferIdxOfRxAccessInfo Com_RxAccessInfo[169].TmpBufferOfRxAccessInfo Com_RxAccessInfo[169].TmpRxShdBufferArrayBasedTmpBufferEndIdxOfRxAccessInfo Com_RxAccessInfo[169].TmpRxShdBufferArrayBasedTmpBufferStartIdxOfRxAccessInfo Com_RxAccessInfo[16].ApplTypeOfRxAccessInfo Com_RxAccessInfo[16].BitLengthOfRxAccessInfo Com_RxAccessInfo[16].BitPositionOfRxAccessInfo Com_RxAccessInfo[16].BufferIdxOfRxAccessInfo Com_RxAccessInfo[16].BusAccOfRxAccessInfo Com_RxAccessInfo[16].ByteLengthOfRxAccessInfo Com_RxAccessInfo[16].ConstValueArrayBasedInitValueEndIdxOfRxAccessInfo Com_RxAccessInfo[16].ConstValueArrayBasedInitValueStartIdxOfRxAccessInfo Com_RxAccessInfo[16].DynSignalOfRxAccessInfo Com_RxAccessInfo[16].InitValueIdxOfRxAccessInfo Com_RxAccessInfo[16].InitValueOfRxAccessInfo Com_RxAccessInfo[16].InvValueIdxOfRxAccessInfo Com_RxAccessInfo[16].InvValueOfRxAccessInfo Com_RxAccessInfo[16].IsGroupSignalOfRxAccessInfo Com_RxAccessInfo[16].RxDataTimeoutSubstitutionValueIdxOfRxAccessInfo Com_RxAccessInfo[16].RxDataTimeoutSubstitutionValueOfRxAccessInfo Com_RxAccessInfo[16].RxPduInfoIdxOfRxAccessInfo Com_RxAccessInfo[16].RxSigBufferArrayBasedBufferEndIdxOfRxAccessInfo Com_RxAccessInfo[16].RxSigBufferArrayBasedBufferStartIdxOfRxAccessInfo Com_RxAccessInfo[16].RxSigBufferArrayBasedShdBufferEndIdxOfRxAccessInfo Com_RxAccessInfo[16].RxSigBufferArrayBasedShdBufferStartIdxOfRxAccessInfo Com_RxAccessInfo[16].RxTOutInfoIdxOfRxAccessInfo Com_RxAccessInfo[16].ShdBufferIdxOfRxAccessInfo Com_RxAccessInfo[16].SignalLengthInByteOfRxAccessInfo Com_RxAccessInfo[16].StartByteInPduPositionOfRxAccessInfo Com_RxAccessInfo[16].TmpBufferIdxOfRxAccessInfo Com_RxAccessInfo[16].TmpBufferOfRxAccessInfo Com_RxAccessInfo[16].TmpRxShdBufferArrayBasedTmpBufferEndIdxOfRxAccessInfo Com_RxAccessInfo[16].TmpRxShdBufferArrayBasedTmpBufferStartIdxOfRxAccessInfo Com_RxAccessInfo[170].ApplTypeOfRxAccessInfo Com_RxAccessInfo[170].BitLengthOfRxAccessInfo Com_RxAccessInfo[170].BitPositionOfRxAccessInfo Com_RxAccessInfo[170].BufferIdxOfRxAccessInfo Com_RxAccessInfo[170].BusAccOfRxAccessInfo Com_RxAccessInfo[170].ByteLengthOfRxAccessInfo Com_RxAccessInfo[170].ConstValueArrayBasedInitValueEndIdxOfRxAccessInfo Com_RxAccessInfo[170].ConstValueArrayBasedInitValueStartIdxOfRxAccessInfo Com_RxAccessInfo[170].DynSignalOfRxAccessInfo Com_RxAccessInfo[170].InitValueIdxOfRxAccessInfo Com_RxAccessInfo[170].InitValueOfRxAccessInfo Com_RxAccessInfo[170].InvValueIdxOfRxAccessInfo Com_RxAccessInfo[170].InvValueOfRxAccessInfo Com_RxAccessInfo[170].IsGroupSignalOfRxAccessInfo Com_RxAccessInfo[170].RxDataTimeoutSubstitutionValueIdxOfRxAccessInfo Com_RxAccessInfo[170].RxDataTimeoutSubstitutionValueOfRxAccessInfo Com_RxAccessInfo[170].RxPduInfoIdxOfRxAccessInfo Com_RxAccessInfo[170].RxSigBufferArrayBasedBufferEndIdxOfRxAccessInfo Com_RxAccessInfo[170].RxSigBufferArrayBasedBufferStartIdxOfRxAccessInfo Com_RxAccessInfo[170].RxSigBufferArrayBasedShdBufferEndIdxOfRxAccessInfo Com_RxAccessInfo[170].RxSigBufferArrayBasedShdBufferStartIdxOfRxAccessInfo Com_RxAccessInfo[170].RxTOutInfoIdxOfRxAccessInfo Com_RxAccessInfo[170].ShdBufferIdxOfRxAccessInfo Com_RxAccessInfo[170].SignalLengthInByteOfRxAccessInfo Com_RxAccessInfo[170].StartByteInPduPositionOfRxAccessInfo Com_RxAccessInfo[170].TmpBufferIdxOfRxAccessInfo Com_RxAccessInfo[170].TmpBufferOfRxAccessInfo Com_RxAccessInfo[170].TmpRxShdBufferArrayBasedTmpBufferEndIdxOfRxAccessInfo Com_RxAccessInfo[170].TmpRxShdBufferArrayBasedTmpBufferStartIdxOfRxAccessInfo Com_RxAccessInfo[171].ApplTypeOfRxAccessInfo Com_RxAccessInfo[171].BitLengthOfRxAccessInfo Com_RxAccessInfo[171].BitPositionOfRxAccessInfo Com_RxAccessInfo[171].BufferIdxOfRxAccessInfo Com_RxAccessInfo[171].BusAccOfRxAccessInfo Com_RxAccessInfo[171].ByteLengthOfRxAccessInfo Com_RxAccessInfo[171].ConstValueArrayBasedInitValueEndIdxOfRxAccessInfo Com_RxAccessInfo[171].ConstValueArrayBasedInitValueStartIdxOfRxAccessInfo Com_RxAccessInfo[171].DynSignalOfRxAccessInfo Com_RxAccessInfo[171].InitValueIdxOfRxAccessInfo Com_RxAccessInfo[171].InitValueOfRxAccessInfo Com_RxAccessInfo[171].InvValueIdxOfRxAccessInfo Com_RxAccessInfo[171].InvValueOfRxAccessInfo Com_RxAccessInfo[171].IsGroupSignalOfRxAccessInfo Com_RxAccessInfo[171].RxDataTimeoutSubstitutionValueIdxOfRxAccessInfo Com_RxAccessInfo[171].RxDataTimeoutSubstitutionValueOfRxAccessInfo Com_RxAccessInfo[171].RxPduInfoIdxOfRxAccessInfo Com_RxAccessInfo[171].RxSigBufferArrayBasedBufferEndIdxOfRxAccessInfo Com_RxAccessInfo[171].RxSigBufferArrayBasedBufferStartIdxOfRxAccessInfo Com_RxAccessInfo[171].RxSigBufferArrayBasedShdBufferEndIdxOfRxAccessInfo Com_RxAccessInfo[171].RxSigBufferArrayBasedShdBufferStartIdxOfRxAccessInfo Com_RxAccessInfo[171].RxTOutInfoIdxOfRxAccessInfo Com_RxAccessInfo[171].ShdBufferIdxOfRxAccessInfo Com_RxAccessInfo[171].SignalLengthInByteOfRxAccessInfo Com_RxAccessInfo[171].StartByteInPduPositionOfRxAccessInfo Com_RxAccessInfo[171].TmpBufferIdxOfRxAccessInfo Com_RxAccessInfo[171].TmpBufferOfRxAccessInfo Com_RxAccessInfo[171].TmpRxShdBufferArrayBasedTmpBufferEndIdxOfRxAccessInfo Com_RxAccessInfo[171].TmpRxShdBufferArrayBasedTmpBufferStartIdxOfRxAccessInfo Com_RxAccessInfo[172].ApplTypeOfRxAccessInfo Com_RxAccessInfo[172].BitLengthOfRxAccessInfo Com_RxAccessInfo[172].BitPositionOfRxAccessInfo Com_RxAccessInfo[172].BufferIdxOfRxAccessInfo Com_RxAccessInfo[172].BusAccOfRxAccessInfo Com_RxAccessInfo[172].ByteLengthOfRxAccessInfo Com_RxAccessInfo[172].ConstValueArrayBasedInitValueEndIdxOfRxAccessInfo Com_RxAccessInfo[172].ConstValueArrayBasedInitValueStartIdxOfRxAccessInfo Com_RxAccessInfo[172].DynSignalOfRxAccessInfo Com_RxAccessInfo[172].InitValueIdxOfRxAccessInfo Com_RxAccessInfo[172].InitValueOfRxAccessInfo Com_RxAccessInfo[172].InvValueIdxOfRxAccessInfo Com_RxAccessInfo[172].InvValueOfRxAccessInfo Com_RxAccessInfo[172].IsGroupSignalOfRxAccessInfo Com_RxAccessInfo[172].RxDataTimeoutSubstitutionValueIdxOfRxAccessInfo Com_RxAccessInfo[172].RxDataTimeoutSubstitutionValueOfRxAccessInfo Com_RxAccessInfo[172].RxPduInfoIdxOfRxAccessInfo Com_RxAccessInfo[172].RxSigBufferArrayBasedBufferEndIdxOfRxAccessInfo Com_RxAccessInfo[172].RxSigBufferArrayBasedBufferStartIdxOfRxAccessInfo Com_RxAccessInfo[172].RxSigBufferArrayBasedShdBufferEndIdxOfRxAccessInfo Com_RxAccessInfo[172].RxSigBufferArrayBasedShdBufferStartIdxOfRxAccessInfo Com_RxAccessInfo[172].RxTOutInfoIdxOfRxAccessInfo Com_RxAccessInfo[172].ShdBufferIdxOfRxAccessInfo Com_RxAccessInfo[172].SignalLengthInByteOfRxAccessInfo Com_RxAccessInfo[172].StartByteInPduPositionOfRxAccessInfo Com_RxAccessInfo[172].TmpBufferIdxOfRxAccessInfo Com_RxAccessInfo[172].TmpBufferOfRxAccessInfo Com_RxAccessInfo[172].TmpRxShdBufferArrayBasedTmpBufferEndIdxOfRxAccessInfo Com_RxAccessInfo[172].TmpRxShdBufferArrayBasedTmpBufferStartIdxOfRxAccessInfo Com_RxAccessInfo[173].ApplTypeOfRxAccessInfo Com_RxAccessInfo[173].BitLengthOfRxAccessInfo /end REF_MEASUREMENT
/end GROUP
/end MODULE
/end PROJECT
