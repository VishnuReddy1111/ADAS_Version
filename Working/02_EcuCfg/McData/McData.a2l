/*********************************************************************************************************************
* COPYRIGHT *
* Copyright (c) 2013 - 2024 by Vector Informatik GmbH. All rights reserved. *
* This software is copyright protected and proprietary to Vector Informatik GmbH. *
* Vector Informatik GmbH grants to you only those rights as set out in the license conditions. *
* All other rights remain with Vector Informatik GmbH. *
* FILE DESCRIPTION *
* File: McData.a2l *
* Description: MICROSAR A2L file *
* Generated at: 2024-12-19 16:56:39 *
* Generator: MICROSAR McDataConverter, Version 1.2.9.0 *
* CUSTOMER INFORMATION *
* Customer: AUTOSAR 4 Evaluation Bundle *
* Serial Number: CBD2201090 *
* Delivery Number: 0 *
* Expiry Date: *
*********************************************************************************************************************/
ASAP2_VERSION 1 71
/begin PROJECT MICROSAR ""
/begin MODULE CPP ""
/begin MOD_PAR "" /end MOD_PAR
/begin MOD_COMMON "" BYTE_ORDER MSB_LAST ALIGNMENT_BYTE 1 ALIGNMENT_WORD 2 ALIGNMENT_LONG 4 ALIGNMENT_FLOAT16_IEEE 2 ALIGNMENT_FLOAT32_IEEE 4 ALIGNMENT_FLOAT64_IEEE 8 ALIGNMENT_INT64 8 /end MOD_COMMON
/begin IF_DATA XCPplus 0x0104
 /begin PROTOCOL_LAYER 0x0104 0x07D0 0x2710 0x07D0 0x07D0 0x07D0 0x07D0 0x00 0x08 0x08 BYTE_ORDER_MSB_LAST ADDRESS_GRANULARITY_BYTE OPTIONAL_CMD GET_COMM_MODE_INFO OPTIONAL_CMD SET_MTA OPTIONAL_CMD UPLOAD OPTIONAL_CMD SHORT_UPLOAD OPTIONAL_CMD TRANSPORT_LAYER_CMD OPTIONAL_CMD DOWNLOAD OPTIONAL_CMD DOWNLOAD_NEXT OPTIONAL_CMD SHORT_DOWNLOAD OPTIONAL_CMD SET_DAQ_PTR OPTIONAL_CMD WRITE_DAQ OPTIONAL_CMD SET_DAQ_LIST_MODE OPTIONAL_CMD GET_DAQ_LIST_MODE OPTIONAL_CMD START_STOP_DAQ_LIST OPTIONAL_CMD START_STOP_SYNCH OPTIONAL_CMD GET_DAQ_PROCESSOR_INFO OPTIONAL_CMD GET_DAQ_RESOLUTION_INFO OPTIONAL_CMD GET_DAQ_EVENT_INFO OPTIONAL_CMD FREE_DAQ OPTIONAL_CMD ALLOC_DAQ OPTIONAL_CMD ALLOC_ODT OPTIONAL_CMD ALLOC_ODT_ENTRY COMMUNICATION_MODE_SUPPORTED BLOCK /end PROTOCOL_LAYER
 /begin DAQ DYNAMIC 0x10 0x10 0x00 OPTIMISATION_TYPE_DEFAULT ADDRESS_EXTENSION_FREE IDENTIFICATION_FIELD_TYPE_ABSOLUTE GRANULARITY_ODT_ENTRY_SIZE_DAQ_BYTE 0x07 OVERLOAD_INDICATION_PID PRESCALER_SUPPORTED /begin STIM GRANULARITY_ODT_ENTRY_SIZE_STIM_BYTE 0x07 /end STIM
  /begin EVENT "XcpEventChannel_StartApplication" "XcpEvent" 0x0F DAQ_STIM 0x01 0xFA 0x06 0x00 /end EVENT
  /begin EVENT "Rtm_Evt" "Rtm_Evt" 0x0D DAQ 0x01 0x00 0x06 0x00 /end EVENT
  /begin EVENT "Dbg_EvtIdleTask_OsCore0" "Dbg_EvtI" 0x08 DAQ 0x01 0x00 0x06 0x00 /end EVENT
  /begin EVENT "Dbg_EvtDefault_Appl_Init_Task" "Dbg_EvtD" 0x02 DAQ 0x01 0x00 0x06 0x00 /end EVENT
  /begin EVENT "Dbg_EvtDefault_BSW_Sync_Task" "Dbg_EvtD" 0x05 DAQ 0x01 0x00 0x06 0x00 /end EVENT
  /begin EVENT "Dbg_EvtDefault_Init_Task" "Dbg_EvtD" 0x06 DAQ 0x01 0x00 0x06 0x00 /end EVENT
  /begin EVENT "Dbg_EvtDefault_Appl_Task" "Dbg_EvtD" 0x03 DAQ 0x01 0x00 0x06 0x00 /end EVENT
  /begin EVENT "Dbg_EvtDefault_BSW_Async_Task" "Dbg_EvtD" 0x04 DAQ 0x01 0x00 0x06 0x00 /end EVENT
  /begin EVENT "Dbg_EvtDefault_RTE_Mode_switch_Task" "Dbg_EvtD" 0x07 DAQ 0x01 0x00 0x06 0x00 /end EVENT
  /begin EVENT "Dbg_EvtCounterIsr_SystemTimer" "Dbg_EvtC" 0x01 DAQ 0x01 0x00 0x06 0x00 /end EVENT
  /begin EVENT "XcpEventChannel_Firewall" "XcpEvent" 0x0E DAQ 0x01 0x00 0x06 0x00 /end EVENT
  /begin EVENT "Dbg_EvtStartApplication_Appl_Task" "Dbg_EvtS" 0x0A DAQ 0x01 0x00 0x06 0x00 /end EVENT
  /begin EVENT "Dbg_EvtStartApplication_Appl_Init_Task" "Dbg_EvtS" 0x09 DAQ 0x01 0x00 0x06 0x00 /end EVENT
  /begin EVENT "Dbg_EvtStartApplication_NoSwc_Appl_Task" "Dbg_EvtS" 0x0B DAQ 0x01 0x00 0x06 0x00 /end EVENT
  /begin EVENT "Dbg_EvtStartApplication_NoSwc_Init_Task" "Dbg_EvtS" 0x0C DAQ 0x01 0x00 0x06 0x00 /end EVENT
  /begin EVENT "Dbg_EvtBswBackgroundTask" "Dbg_EvtB" 0x00 DAQ 0x01 0x00 0x06 0x00 /end EVENT
 /end DAQ
 /begin XCP_ON_CAN 0x0102 CAN_ID_MASTER 0x0703 CAN_ID_SLAVE 0x0704 BAUDRATE 0x03D090 SAMPLE_POINT 0x50 SAMPLE_RATE SINGLE BTL_CYCLES 0x0A SJW 0x02 MAX_DLC_REQUIRED
  /begin CAN_FD MAX_DLC 0x08 CAN_FD_DATA_TRANSFER_BAUDRATE 0x0F4240 SAMPLE_POINT 0x50 BTL_CYCLES 0x0A SJW 0x02 MAX_DLC_REQUIRED SECONDARY_SAMPLE_POINT 0x00 TRANSCEIVER_DELAY_COMPENSATION OFF /end CAN_FD
  /begin PROTOCOL_LAYER 0x0104 0x07D0 0x2710 0x07D0 0x07D0 0x07D0 0x07D0 0x00 0x08 0x08 BYTE_ORDER_MSB_LAST ADDRESS_GRANULARITY_BYTE OPTIONAL_CMD GET_COMM_MODE_INFO OPTIONAL_CMD SET_MTA OPTIONAL_CMD UPLOAD OPTIONAL_CMD SHORT_UPLOAD OPTIONAL_CMD DOWNLOAD OPTIONAL_CMD DOWNLOAD_NEXT OPTIONAL_CMD SHORT_DOWNLOAD OPTIONAL_CMD SET_DAQ_PTR OPTIONAL_CMD WRITE_DAQ OPTIONAL_CMD SET_DAQ_LIST_MODE OPTIONAL_CMD GET_DAQ_LIST_MODE OPTIONAL_CMD START_STOP_DAQ_LIST OPTIONAL_CMD START_STOP_SYNCH OPTIONAL_CMD GET_DAQ_PROCESSOR_INFO OPTIONAL_CMD GET_DAQ_RESOLUTION_INFO OPTIONAL_CMD GET_DAQ_EVENT_INFO OPTIONAL_CMD FREE_DAQ OPTIONAL_CMD ALLOC_DAQ OPTIONAL_CMD ALLOC_ODT OPTIONAL_CMD ALLOC_ODT_ENTRY COMMUNICATION_MODE_SUPPORTED BLOCK /end PROTOCOL_LAYER
 /end XCP_ON_CAN
 /begin XCP_ON_FLX 0x0101 0x03E8 "FlexRay" "0" 0x00 HEADER_NAX_CTR PACKET_ALIGNMENT_16
  /begin INITIAL_CMD_BUFFER 0x02 MAX_FLX_LEN_BUF FIXED 0x64
   /begin LPDU_ID FLX_SLOT_ID FIXED 0x64 OFFSET FIXED 0x00 CYCLE_REPETITION FIXED 0x02 CHANNEL FIXED A /end LPDU_ID
   /begin XCP_PACKET CMD FIXED RES_ERR NOT_ALLOWED EV_SERV NOT_ALLOWED DAQ NOT_ALLOWED STIM NOT_ALLOWED /end XCP_PACKET
  /end INITIAL_CMD_BUFFER
  /begin INITIAL_RES_ERR_BUFFER 0x01 MAX_FLX_LEN_BUF FIXED 0x64
   /begin LPDU_ID FLX_SLOT_ID FIXED 0x69 OFFSET FIXED 0x00 CYCLE_REPETITION FIXED 0x02 CHANNEL FIXED A /end LPDU_ID
   /begin XCP_PACKET CMD NOT_ALLOWED RES_ERR FIXED EV_SERV NOT_ALLOWED DAQ NOT_ALLOWED STIM NOT_ALLOWED /end XCP_PACKET
  /end INITIAL_RES_ERR_BUFFER
  /begin POOL_BUFFER 0x00 MAX_FLX_LEN_BUF FIXED 0x64
   /begin LPDU_ID FLX_SLOT_ID FIXED 0x6A OFFSET FIXED 0x00 CYCLE_REPETITION FIXED 0x02 CHANNEL FIXED A /end LPDU_ID
   /begin XCP_PACKET CMD NOT_ALLOWED RES_ERR NOT_ALLOWED EV_SERV NOT_ALLOWED DAQ FIXED STIM NOT_ALLOWED /end XCP_PACKET
  /end POOL_BUFFER
  /begin POOL_BUFFER 0x03 MAX_FLX_LEN_BUF FIXED 0x64
   /begin LPDU_ID FLX_SLOT_ID FIXED 0x65 OFFSET FIXED 0x00 CYCLE_REPETITION FIXED 0x02 CHANNEL FIXED A /end LPDU_ID
   /begin XCP_PACKET CMD NOT_ALLOWED RES_ERR NOT_ALLOWED EV_SERV NOT_ALLOWED DAQ NOT_ALLOWED STIM FIXED /end XCP_PACKET
  /end POOL_BUFFER
 /end XCP_ON_FLX
 /begin XCP_ON_UDP_IP 0x0102 0x15B3 ADDRESS "192.168.1.11" /end XCP_ON_UDP_IP
/end IF_DATA
/begin MEASUREMENT BswM_ActionListQueueOsApplication_SystemApplication_Core0 "Variable to store action lists which shall be executed." UBYTE NO_COMPU_METHOD 0 0 0 255 ECU_ADDRESS 0x0 MATRIX_DIM 77 SYMBOL_LINK "BswM_ActionListQueueOsApplication_SystemApplication_Core0.raw" 0 /end MEASUREMENT
/begin MEASUREMENT BswM_ActionListQueueOsApplication_SystemApplication_Core0_AL_AL_Dcm_Reset "The element: AL_AL_Dcm_Reset of BswM_ActionListQueueOsApplication_SystemApplication_Core0" UBYTE NO_COMPU_METHOD 0 0 0 255 ECU_ADDRESS 0x0 SYMBOL_LINK "BswM_ActionListQueueOsApplication_SystemApplication_Core0.raw[76]" 0 /end MEASUREMENT
/begin MEASUREMENT BswM_ActionListQueueOsApplication_SystemApplication_Core0_AL_CC_AL_CN_BMC_CAN01_78a85e89_Disable_DM "The element: AL_CC_AL_CN_BMC_CAN01_78a85e89_Disable_DM of BswM_ActionListQueueOsApplication_SystemApplication_Core0" UBYTE NO_COMPU_METHOD 0 0 0 255 ECU_ADDRESS 0x0 SYMBOL_LINK "BswM_ActionListQueueOsApplication_SystemApplication_Core0.raw[12]" 0 /end MEASUREMENT
/begin MEASUREMENT BswM_ActionListQueueOsApplication_SystemApplication_Core0_AL_CC_AL_CN_BMC_CAN01_78a85e89_Enable_DM "The element: AL_CC_AL_CN_BMC_CAN01_78a85e89_Enable_DM of BswM_ActionListQueueOsApplication_SystemApplication_Core0" UBYTE NO_COMPU_METHOD 0 0 0 255 ECU_ADDRESS 0x0 SYMBOL_LINK "BswM_ActionListQueueOsApplication_SystemApplication_Core0.raw[13]" 0 /end MEASUREMENT
/begin MEASUREMENT BswM_ActionListQueueOsApplication_SystemApplication_Core0_AL_CC_AL_CN_BMC_CAN01_78a85e89_RX_Disable "The element: AL_CC_AL_CN_BMC_CAN01_78a85e89_RX_Disable of BswM_ActionListQueueOsApplication_SystemApplication_Core0" UBYTE NO_COMPU_METHOD 0 0 0 255 ECU_ADDRESS 0x0 SYMBOL_LINK "BswM_ActionListQueueOsApplication_SystemApplication_Core0.raw[16]" 0 /end MEASUREMENT
/begin MEASUREMENT BswM_ActionListQueueOsApplication_SystemApplication_Core0_AL_CC_AL_CN_BMC_CAN01_78a85e89_RX_EnableNoinit "The element: AL_CC_AL_CN_BMC_CAN01_78a85e89_RX_EnableNoinit of BswM_ActionListQueueOsApplication_SystemApplication_Core0" UBYTE NO_COMPU_METHOD 0 0 0 255 ECU_ADDRESS 0x0 SYMBOL_LINK "BswM_ActionListQueueOsApplication_SystemApplication_Core0.raw[17]" 0 /end MEASUREMENT
/begin MEASUREMENT BswM_ActionListQueueOsApplication_SystemApplication_Core0_AL_CC_AL_CN_BMC_CAN01_78a85e89_TX_Disable "The element: AL_CC_AL_CN_BMC_CAN01_78a85e89_TX_Disable of BswM_ActionListQueueOsApplication_SystemApplication_Core0" UBYTE NO_COMPU_METHOD 0 0 0 255 ECU_ADDRESS 0x0 SYMBOL_LINK "BswM_ActionListQueueOsApplication_SystemApplication_Core0.raw[14]" 0 /end MEASUREMENT
/begin MEASUREMENT BswM_ActionListQueueOsApplication_SystemApplication_Core0_AL_CC_AL_CN_BMC_CAN01_78a85e89_TX_EnableNoinit "The element: AL_CC_AL_CN_BMC_CAN01_78a85e89_TX_EnableNoinit of BswM_ActionListQueueOsApplication_SystemApplication_Core0" UBYTE NO_COMPU_METHOD 0 0 0 255 ECU_ADDRESS 0x0 SYMBOL_LINK "BswM_ActionListQueueOsApplication_SystemApplication_Core0.raw[15]" 0 /end MEASUREMENT
/begin MEASUREMENT BswM_ActionListQueueOsApplication_SystemApplication_Core0_AL_CC_AL_CN_HCP5_CANFD01_54d90215_Disable_DM "The element: AL_CC_AL_CN_HCP5_CANFD01_54d90215_Disable_DM of BswM_ActionListQueueOsApplication_SystemApplication_Core0" UBYTE NO_COMPU_METHOD 0 0 0 255 ECU_ADDRESS 0x0 SYMBOL_LINK "BswM_ActionListQueueOsApplication_SystemApplication_Core0.raw[44]" 0 /end MEASUREMENT
/begin MEASUREMENT BswM_ActionListQueueOsApplication_SystemApplication_Core0_AL_CC_AL_CN_HCP5_CANFD01_54d90215_Enable_DM "The element: AL_CC_AL_CN_HCP5_CANFD01_54d90215_Enable_DM of BswM_ActionListQueueOsApplication_SystemApplication_Core0" UBYTE NO_COMPU_METHOD 0 0 0 255 ECU_ADDRESS 0x0 SYMBOL_LINK "BswM_ActionListQueueOsApplication_SystemApplication_Core0.raw[45]" 0 /end MEASUREMENT
/begin MEASUREMENT BswM_ActionListQueueOsApplication_SystemApplication_Core0_AL_CC_AL_CN_HCP5_CANFD01_54d90215_PNC_11_Chassis_dce36bbc_Enable_DM "The element: AL_CC_AL_CN_HCP5_CANFD01_54d90215_PNC_11_Chassis_dce36bbc_Enable_DM of BswM_ActionListQueueOsApplication_SystemApplication_Core0" UBYTE NO_COMPU_METHOD 0 0 0 255 ECU_ADDRESS 0x0 SYMBOL_LINK "BswM_ActionListQueueOsApplication_SystemApplication_Core0.raw[49]" 0 /end MEASUREMENT
/begin MEASUREMENT BswM_ActionListQueueOsApplication_SystemApplication_Core0_AL_CC_AL_CN_HCP5_CANFD01_54d90215_PNC_13_Airbag_727cecad_Disable_DM "The element: AL_CC_AL_CN_HCP5_CANFD01_54d90215_PNC_13_Airbag_727cecad_Disable_DM of BswM_ActionListQueueOsApplication_SystemApplication_Core0" UBYTE NO_COMPU_METHOD 0 0 0 255 ECU_ADDRESS 0x0 SYMBOL_LINK "BswM_ActionListQueueOsApplication_SystemApplication_Core0.raw[60]" 0 /end MEASUREMENT
/begin MEASUREMENT BswM_ActionListQueueOsApplication_SystemApplication_Core0_AL_CC_AL_CN_HCP5_CANFD01_54d90215_PNC_13_Airbag_727cecad_Enable_DM "The element: AL_CC_AL_CN_HCP5_CANFD01_54d90215_PNC_13_Airbag_727cecad_Enable_DM of BswM_ActionListQueueOsApplication_SystemApplication_Core0" UBYTE NO_COMPU_METHOD 0 0 0 255 ECU_ADDRESS 0x0 SYMBOL_LINK "BswM_ActionListQueueOsApplication_SystemApplication_Core0.raw[61]" 0 /end MEASUREMENT
/begin MEASUREMENT BswM_ActionListQueueOsApplication_SystemApplication_Core0_AL_CC_AL_CN_HCP5_CANFD01_54d90215_PNC_13_Airbag_727cecad_RX_Disable "The element: AL_CC_AL_CN_HCP5_CANFD01_54d90215_PNC_13_Airbag_727cecad_RX_Disable of BswM_ActionListQueueOsApplication_SystemApplication_Core0" UBYTE NO_COMPU_METHOD 0 0 0 255 ECU_ADDRESS 0x0 SYMBOL_LINK "BswM_ActionListQueueOsApplication_SystemApplication_Core0.raw[26]" 0 /end MEASUREMENT
/begin MEASUREMENT BswM_ActionListQueueOsApplication_SystemApplication_Core0_AL_CC_AL_CN_HCP5_CANFD01_54d90215_RX_Disable "The element: AL_CC_AL_CN_HCP5_CANFD01_54d90215_RX_Disable of BswM_ActionListQueueOsApplication_SystemApplication_Core0" UBYTE NO_COMPU_METHOD 0 0 0 255 ECU_ADDRESS 0x0 SYMBOL_LINK "BswM_ActionListQueueOsApplication_SystemApplication_Core0.raw[58]" 0 /end MEASUREMENT
/begin MEASUREMENT BswM_ActionListQueueOsApplication_SystemApplication_Core0_AL_CC_AL_CN_HCP5_CANFD01_54d90215_RX_EnableNoinit "The element: AL_CC_AL_CN_HCP5_CANFD01_54d90215_RX_EnableNoinit of BswM_ActionListQueueOsApplication_SystemApplication_Core0" UBYTE NO_COMPU_METHOD 0 0 0 255 ECU_ADDRESS 0x0 SYMBOL_LINK "BswM_ActionListQueueOsApplication_SystemApplication_Core0.raw[59]" 0 /end MEASUREMENT
/begin MEASUREMENT BswM_ActionListQueueOsApplication_SystemApplication_Core0_AL_CC_AL_CN_HCP5_CANFD01_54d90215_TX_Disable "The element: AL_CC_AL_CN_HCP5_CANFD01_54d90215_TX_Disable of BswM_ActionListQueueOsApplication_SystemApplication_Core0" UBYTE NO_COMPU_METHOD 0 0 0 255 ECU_ADDRESS 0x0 SYMBOL_LINK "BswM_ActionListQueueOsApplication_SystemApplication_Core0.raw[32]" 0 /end MEASUREMENT
/begin MEASUREMENT BswM_ActionListQueueOsApplication_SystemApplication_Core0_AL_CC_AL_CN_HCP5_CANFD01_54d90215_TX_EnableNoinit "The element: AL_CC_AL_CN_HCP5_CANFD01_54d90215_TX_EnableNoinit of BswM_ActionListQueueOsApplication_SystemApplication_Core0" UBYTE NO_COMPU_METHOD 0 0 0 255 ECU_ADDRESS 0x0 SYMBOL_LINK "BswM_ActionListQueueOsApplication_SystemApplication_Core0.raw[33]" 0 /end MEASUREMENT
/begin MEASUREMENT BswM_ActionListQueueOsApplication_SystemApplication_Core0_AL_ESH_AL_ExitPostRun "The element: AL_ESH_AL_ExitPostRun of BswM_ActionListQueueOsApplication_SystemApplication_Core0" UBYTE NO_COMPU_METHOD 0 0 0 255 ECU_ADDRESS 0x0 SYMBOL_LINK "BswM_ActionListQueueOsApplication_SystemApplication_Core0.raw[10]" 0 /end MEASUREMENT
/begin MEASUREMENT BswM_ActionListQueueOsApplication_SystemApplication_Core0_AL_ESH_AL_ExitRun "The element: AL_ESH_AL_ExitRun of BswM_ActionListQueueOsApplication_SystemApplication_Core0" UBYTE NO_COMPU_METHOD 0 0 0 255 ECU_ADDRESS 0x0 SYMBOL_LINK "BswM_ActionListQueueOsApplication_SystemApplication_Core0.raw[1]" 0 /end MEASUREMENT
/begin MEASUREMENT BswM_ActionListQueueOsApplication_SystemApplication_Core0_AL_ESH_AL_InitToWakeup "The element: AL_ESH_AL_InitToWakeup of BswM_ActionListQueueOsApplication_SystemApplication_Core0" UBYTE NO_COMPU_METHOD 0 0 0 255 ECU_ADDRESS 0x0 SYMBOL_LINK "BswM_ActionListQueueOsApplication_SystemApplication_Core0.raw[7]" 0 /end MEASUREMENT
/begin MEASUREMENT BswM_ActionListQueueOsApplication_SystemApplication_Core0_AL_ESH_AL_PostRunToPrepShutdown "The element: AL_ESH_AL_PostRunToPrepShutdown of BswM_ActionListQueueOsApplication_SystemApplication_Core0" UBYTE NO_COMPU_METHOD 0 0 0 255 ECU_ADDRESS 0x0 SYMBOL_LINK "BswM_ActionListQueueOsApplication_SystemApplication_Core0.raw[8]" 0 /end MEASUREMENT
/begin MEASUREMENT BswM_ActionListQueueOsApplication_SystemApplication_Core0_AL_ESH_AL_PostRunToRun "The element: AL_ESH_AL_PostRunToRun of BswM_ActionListQueueOsApplication_SystemApplication_Core0" UBYTE NO_COMPU_METHOD 0 0 0 255 ECU_ADDRESS 0x0 SYMBOL_LINK "BswM_ActionListQueueOsApplication_SystemApplication_Core0.raw[9]" 0 /end MEASUREMENT
/begin MEASUREMENT BswM_ActionListQueueOsApplication_SystemApplication_Core0_AL_ESH_AL_PrepShutdownToWaitForNvM "The element: AL_ESH_AL_PrepShutdownToWaitForNvM of BswM_ActionListQueueOsApplication_SystemApplication_Core0" UBYTE NO_COMPU_METHOD 0 0 0 255 ECU_ADDRESS 0x0 SYMBOL_LINK "BswM_ActionListQueueOsApplication_SystemApplication_Core0.raw[11]" 0 /end MEASUREMENT
/begin MEASUREMENT BswM_ActionListQueueOsApplication_SystemApplication_Core0_AL_ESH_AL_RunToPostRun "The element: AL_ESH_AL_RunToPostRun of BswM_ActionListQueueOsApplication_SystemApplication_Core0" UBYTE NO_COMPU_METHOD 0 0 0 255 ECU_ADDRESS 0x0 SYMBOL_LINK "BswM_ActionListQueueOsApplication_SystemApplication_Core0.raw[2]" 0 /end MEASUREMENT
/begin MEASUREMENT BswM_ActionListQueueOsApplication_SystemApplication_Core0_AL_ESH_AL_WaitForNvMToShutdown "The element: AL_ESH_AL_WaitForNvMToShutdown of BswM_ActionListQueueOsApplication_SystemApplication_Core0" UBYTE NO_COMPU_METHOD 0 0 0 255 ECU_ADDRESS 0x0 SYMBOL_LINK "BswM_ActionListQueueOsApplication_SystemApplication_Core0.raw[3]" 0 /end MEASUREMENT
/begin MEASUREMENT BswM_ActionListQueueOsApplication_SystemApplication_Core0_AL_ESH_AL_WaitForNvMWakeup "The element: AL_ESH_AL_WaitForNvMWakeup of BswM_ActionListQueueOsApplication_SystemApplication_Core0" UBYTE NO_COMPU_METHOD 0 0 0 255 ECU_ADDRESS 0x0 SYMBOL_LINK "BswM_ActionListQueueOsApplication_SystemApplication_Core0.raw[5]" 0 /end MEASUREMENT
/begin MEASUREMENT BswM_ActionListQueueOsApplication_SystemApplication_Core0_AL_ESH_AL_WakeupToPrep "The element: AL_ESH_AL_WakeupToPrep of BswM_ActionListQueueOsApplication_SystemApplication_Core0" UBYTE NO_COMPU_METHOD 0 0 0 255 ECU_ADDRESS 0x0 SYMBOL_LINK "BswM_ActionListQueueOsApplication_SystemApplication_Core0.raw[4]" 0 /end MEASUREMENT
/begin MEASUREMENT BswM_ActionListQueueOsApplication_SystemApplication_Core0_AL_ESH_AL_WakeupToRun "The element: AL_ESH_AL_WakeupToRun of BswM_ActionListQueueOsApplication_SystemApplication_Core0" UBYTE NO_COMPU_METHOD 0 0 0 255 ECU_ADDRESS 0x0 SYMBOL_LINK "BswM_ActionListQueueOsApplication_SystemApplication_Core0.raw[6]" 0 /end MEASUREMENT
/begin MEASUREMENT BswM_ActionListQueueOsApplication_SystemApplication_Core1 "Variable to store action lists which shall be executed." UBYTE NO_COMPU_METHOD 0 0 0 255 ECU_ADDRESS 0x0 SYMBOL_LINK "BswM_ActionListQueueOsApplication_SystemApplication_Core1.raw" 0 /end MEASUREMENT
/begin MEASUREMENT BswM_CoreSyncValueOsApplication_SystemApplication_Core0 "" UBYTE NO_COMPU_METHOD 0 0 0 255 ECU_ADDRESS 0x0 /end MEASUREMENT
/begin MEASUREMENT BswM_CoreSyncValueOsApplication_SystemApplication_Core1 "" UBYTE NO_COMPU_METHOD 0 0 0 255 ECU_ADDRESS 0x0 /end MEASUREMENT
/begin MEASUREMENT BswM_DeferredRulesOsApplication_SystemApplication_Core0[0].RulesIdxOfDeferredRules "" UBYTE NO_COMPU_METHOD 0 0 0 255 ECU_ADDRESS 0x0 SYMBOL_LINK "BswM_DeferredRules[0].RulesIdxOfDeferredRules" 0 /end MEASUREMENT
/begin MEASUREMENT BswM_DeferredRulesOsApplication_SystemApplication_Core0[1].RulesIdxOfDeferredRules "" UBYTE NO_COMPU_METHOD 0 0 0 255 ECU_ADDRESS 0x0 SYMBOL_LINK "BswM_DeferredRules[1].RulesIdxOfDeferredRules" 0 /end MEASUREMENT
/begin MEASUREMENT BswM_DeferredRulesOsApplication_SystemApplication_Core0[2].RulesIdxOfDeferredRules "" UBYTE NO_COMPU_METHOD 0 0 0 255 ECU_ADDRESS 0x0 SYMBOL_LINK "BswM_DeferredRules[2].RulesIdxOfDeferredRules" 0 /end MEASUREMENT
/begin MEASUREMENT BswM_DeferredRulesOsApplication_SystemApplication_Core0[3].RulesIdxOfDeferredRules "" UBYTE NO_COMPU_METHOD 0 0 0 255 ECU_ADDRESS 0x0 SYMBOL_LINK "BswM_DeferredRules[3].RulesIdxOfDeferredRules" 0 /end MEASUREMENT
/begin MEASUREMENT BswM_DeferredRulesOsApplication_SystemApplication_Core0[4].RulesIdxOfDeferredRules "" UBYTE NO_COMPU_METHOD 0 0 0 255 ECU_ADDRESS 0x0 SYMBOL_LINK "BswM_DeferredRules[4].RulesIdxOfDeferredRules" 0 /end MEASUREMENT
/begin MEASUREMENT BswM_DeferredRulesOsApplication_SystemApplication_Core0[5].RulesIdxOfDeferredRules "" UBYTE NO_COMPU_METHOD 0 0 0 255 ECU_ADDRESS 0x0 SYMBOL_LINK "BswM_DeferredRules[5].RulesIdxOfDeferredRules" 0 /end MEASUREMENT
/begin MEASUREMENT BswM_DeferredRulesOsApplication_SystemApplication_Core0[6].RulesIdxOfDeferredRules "" UBYTE NO_COMPU_METHOD 0 0 0 255 ECU_ADDRESS 0x0 SYMBOL_LINK "BswM_DeferredRules[6].RulesIdxOfDeferredRules" 0 /end MEASUREMENT
/begin MEASUREMENT BswM_DeferredRulesOsApplication_SystemApplication_Core0[7].RulesIdxOfDeferredRules "" UBYTE NO_COMPU_METHOD 0 0 0 255 ECU_ADDRESS 0x0 SYMBOL_LINK "BswM_DeferredRules[7].RulesIdxOfDeferredRules" 0 /end MEASUREMENT
/begin MEASUREMENT BswM_ForcedActionListPriorityOsApplication_SystemApplication_Core0 "" UBYTE NO_COMPU_METHOD 0 0 0 255 ECU_ADDRESS 0x0 /end MEASUREMENT
/begin MEASUREMENT BswM_ForcedActionListPriorityOsApplication_SystemApplication_Core1 "" UBYTE NO_COMPU_METHOD 0 0 0 255 ECU_ADDRESS 0x0 /end MEASUREMENT
/begin MEASUREMENT BswM_ImmediateUserOsApplication_SystemApplication_Core0[0].OnInitOfImmediateUser "" UBYTE BswM_OnInitOfImmediateUserType 0 0 0 1 ECU_ADDRESS 0x0 SYMBOL_LINK "BswM_ImmediateUser[0].OnInitOfImmediateUser" 0 /end MEASUREMENT
/begin MEASUREMENT BswM_ImmediateUserOsApplication_SystemApplication_Core0[0].RulesIndEndIdxOfImmediateUser "" UBYTE BswM_RulesIndEndIdxOfImmediateUserType 0 0 0 255 ECU_ADDRESS 0x0 SYMBOL_LINK "BswM_ImmediateUser[0].RulesIndEndIdxOfImmediateUser" 0 /end MEASUREMENT
/begin MEASUREMENT BswM_ImmediateUserOsApplication_SystemApplication_Core0[0].RulesIndStartIdxOfImmediateUser "" UBYTE BswM_RulesIndStartIdxOfImmediateUserType 0 0 0 255 ECU_ADDRESS 0x0 SYMBOL_LINK "BswM_ImmediateUser[0].RulesIndStartIdxOfImmediateUser" 0 /end MEASUREMENT
/begin MEASUREMENT BswM_ImmediateUserOsApplication_SystemApplication_Core0[10].OnInitOfImmediateUser "" UBYTE BswM_OnInitOfImmediateUserType 0 0 0 1 ECU_ADDRESS 0x0 SYMBOL_LINK "BswM_ImmediateUser[10].OnInitOfImmediateUser" 0 /end MEASUREMENT
/begin MEASUREMENT BswM_ImmediateUserOsApplication_SystemApplication_Core0[10].RulesIndEndIdxOfImmediateUser "" UBYTE BswM_RulesIndEndIdxOfImmediateUserType 0 0 0 255 ECU_ADDRESS 0x0 SYMBOL_LINK "BswM_ImmediateUser[10].RulesIndEndIdxOfImmediateUser" 0 /end MEASUREMENT
/begin MEASUREMENT BswM_ImmediateUserOsApplication_SystemApplication_Core0[10].RulesIndStartIdxOfImmediateUser "" UBYTE BswM_RulesIndStartIdxOfImmediateUserType 0 0 0 255 ECU_ADDRESS 0x0 SYMBOL_LINK "BswM_ImmediateUser[10].RulesIndStartIdxOfImmediateUser" 0 /end MEASUREMENT
/begin MEASUREMENT BswM_ImmediateUserOsApplication_SystemApplication_Core0[11].OnInitOfImmediateUser "" UBYTE BswM_OnInitOfImmediateUserType 0 0 0 1 ECU_ADDRESS 0x0 SYMBOL_LINK "BswM_ImmediateUser[11].OnInitOfImmediateUser" 0 /end MEASUREMENT
/begin MEASUREMENT BswM_ImmediateUserOsApplication_SystemApplication_Core0[11].RulesIndEndIdxOfImmediateUser "" UBYTE BswM_RulesIndEndIdxOfImmediateUserType 0 0 0 255 ECU_ADDRESS 0x0 SYMBOL_LINK "BswM_ImmediateUser[11].RulesIndEndIdxOfImmediateUser" 0 /end MEASUREMENT
/begin MEASUREMENT BswM_ImmediateUserOsApplication_SystemApplication_Core0[11].RulesIndStartIdxOfImmediateUser "" UBYTE BswM_RulesIndStartIdxOfImmediateUserType 0 0 0 255 ECU_ADDRESS 0x0 SYMBOL_LINK "BswM_ImmediateUser[11].RulesIndStartIdxOfImmediateUser" 0 /end MEASUREMENT
/begin MEASUREMENT BswM_ImmediateUserOsApplication_SystemApplication_Core0[12].OnInitOfImmediateUser "" UBYTE BswM_OnInitOfImmediateUserType 0 0 0 1 ECU_ADDRESS 0x0 SYMBOL_LINK "BswM_ImmediateUser[12].OnInitOfImmediateUser" 0 /end MEASUREMENT
/begin MEASUREMENT BswM_ImmediateUserOsApplication_SystemApplication_Core0[12].RulesIndEndIdxOfImmediateUser "" UBYTE BswM_RulesIndEndIdxOfImmediateUserType 0 0 0 255 ECU_ADDRESS 0x0 SYMBOL_LINK "BswM_ImmediateUser[12].RulesIndEndIdxOfImmediateUser" 0 /end MEASUREMENT
/begin MEASUREMENT BswM_ImmediateUserOsApplication_SystemApplication_Core0[12].RulesIndStartIdxOfImmediateUser "" UBYTE BswM_RulesIndStartIdxOfImmediateUserType 0 0 0 255 ECU_ADDRESS 0x0 SYMBOL_LINK "BswM_ImmediateUser[12].RulesIndStartIdxOfImmediateUser" 0 /end MEASUREMENT
/begin MEASUREMENT BswM_ImmediateUserOsApplication_SystemApplication_Core0[13].OnInitOfImmediateUser "" UBYTE BswM_OnInitOfImmediateUserType 0 0 0 1 ECU_ADDRESS 0x0 SYMBOL_LINK "BswM_ImmediateUser[13].OnInitOfImmediateUser" 0 /end MEASUREMENT
/begin MEASUREMENT BswM_ImmediateUserOsApplication_SystemApplication_Core0[13].RulesIndEndIdxOfImmediateUser "" UBYTE BswM_RulesIndEndIdxOfImmediateUserType 0 0 0 255 ECU_ADDRESS 0x0 SYMBOL_LINK "BswM_ImmediateUser[13].RulesIndEndIdxOfImmediateUser" 0 /end MEASUREMENT
/begin MEASUREMENT BswM_ImmediateUserOsApplication_SystemApplication_Core0[13].RulesIndStartIdxOfImmediateUser "" UBYTE BswM_RulesIndStartIdxOfImmediateUserType 0 0 0 255 ECU_ADDRESS 0x0 SYMBOL_LINK "BswM_ImmediateUser[13].RulesIndStartIdxOfImmediateUser" 0 /end MEASUREMENT
/begin MEASUREMENT BswM_ImmediateUserOsApplication_SystemApplication_Core0[14].OnInitOfImmediateUser "" UBYTE BswM_OnInitOfImmediateUserType 0 0 0 1 ECU_ADDRESS 0x0 SYMBOL_LINK "BswM_ImmediateUser[14].OnInitOfImmediateUser" 0 /end MEASUREMENT
/begin MEASUREMENT BswM_ImmediateUserOsApplication_SystemApplication_Core0[14].RulesIndEndIdxOfImmediateUser "" UBYTE BswM_RulesIndEndIdxOfImmediateUserType 0 0 0 255 ECU_ADDRESS 0x0 SYMBOL_LINK "BswM_ImmediateUser[14].RulesIndEndIdxOfImmediateUser" 0 /end MEASUREMENT
/begin MEASUREMENT BswM_ImmediateUserOsApplication_SystemApplication_Core0[14].RulesIndStartIdxOfImmediateUser "" UBYTE BswM_RulesIndStartIdxOfImmediateUserType 0 0 0 255 ECU_ADDRESS 0x0 SYMBOL_LINK "BswM_ImmediateUser[14].RulesIndStartIdxOfImmediateUser" 0 /end MEASUREMENT
/begin MEASUREMENT BswM_ImmediateUserOsApplication_SystemApplication_Core0[1].OnInitOfImmediateUser "" UBYTE BswM_OnInitOfImmediateUserType 0 0 0 1 ECU_ADDRESS 0x0 SYMBOL_LINK "BswM_ImmediateUser[1].OnInitOfImmediateUser" 0 /end MEASUREMENT
/begin MEASUREMENT BswM_ImmediateUserOsApplication_SystemApplication_Core0[1].RulesIndEndIdxOfImmediateUser "" UBYTE BswM_RulesIndEndIdxOfImmediateUserType 0 0 0 255 ECU_ADDRESS 0x0 SYMBOL_LINK "BswM_ImmediateUser[1].RulesIndEndIdxOfImmediateUser" 0 /end MEASUREMENT
/begin MEASUREMENT BswM_ImmediateUserOsApplication_SystemApplication_Core0[1].RulesIndStartIdxOfImmediateUser "" UBYTE BswM_RulesIndStartIdxOfImmediateUserType 0 0 0 255 ECU_ADDRESS 0x0 SYMBOL_LINK "BswM_ImmediateUser[1].RulesIndStartIdxOfImmediateUser" 0 /end MEASUREMENT
/begin MEASUREMENT BswM_ImmediateUserOsApplication_SystemApplication_Core0[2].OnInitOfImmediateUser "" UBYTE BswM_OnInitOfImmediateUserType 0 0 0 1 ECU_ADDRESS 0x0 SYMBOL_LINK "BswM_ImmediateUser[2].OnInitOfImmediateUser" 0 /end MEASUREMENT
/begin MEASUREMENT BswM_ImmediateUserOsApplication_SystemApplication_Core0[2].RulesIndEndIdxOfImmediateUser "" UBYTE BswM_RulesIndEndIdxOfImmediateUserType 0 0 0 255 ECU_ADDRESS 0x0 SYMBOL_LINK "BswM_ImmediateUser[2].RulesIndEndIdxOfImmediateUser" 0 /end MEASUREMENT
/begin MEASUREMENT BswM_ImmediateUserOsApplication_SystemApplication_Core0[2].RulesIndStartIdxOfImmediateUser "" UBYTE BswM_RulesIndStartIdxOfImmediateUserType 0 0 0 255 ECU_ADDRESS 0x0 SYMBOL_LINK "BswM_ImmediateUser[2].RulesIndStartIdxOfImmediateUser" 0 /end MEASUREMENT
/begin MEASUREMENT BswM_ImmediateUserOsApplication_SystemApplication_Core0[3].OnInitOfImmediateUser "" UBYTE BswM_OnInitOfImmediateUserType 0 0 0 1 ECU_ADDRESS 0x0 SYMBOL_LINK "BswM_ImmediateUser[3].OnInitOfImmediateUser" 0 /end MEASUREMENT
/begin MEASUREMENT BswM_ImmediateUserOsApplication_SystemApplication_Core0[3].RulesIndEndIdxOfImmediateUser "" UBYTE BswM_RulesIndEndIdxOfImmediateUserType 0 0 0 255 ECU_ADDRESS 0x0 SYMBOL_LINK "BswM_ImmediateUser[3].RulesIndEndIdxOfImmediateUser" 0 /end MEASUREMENT
/begin MEASUREMENT BswM_ImmediateUserOsApplication_SystemApplication_Core0[3].RulesIndStartIdxOfImmediateUser "" UBYTE BswM_RulesIndStartIdxOfImmediateUserType 0 0 0 255 ECU_ADDRESS 0x0 SYMBOL_LINK "BswM_ImmediateUser[3].RulesIndStartIdxOfImmediateUser" 0 /end MEASUREMENT
/begin MEASUREMENT BswM_ImmediateUserOsApplication_SystemApplication_Core0[4].OnInitOfImmediateUser "" UBYTE BswM_OnInitOfImmediateUserType 0 0 0 1 ECU_ADDRESS 0x0 SYMBOL_LINK "BswM_ImmediateUser[4].OnInitOfImmediateUser" 0 /end MEASUREMENT
/begin MEASUREMENT BswM_ImmediateUserOsApplication_SystemApplication_Core0[4].RulesIndEndIdxOfImmediateUser "" UBYTE BswM_RulesIndEndIdxOfImmediateUserType 0 0 0 255 ECU_ADDRESS 0x0 SYMBOL_LINK "BswM_ImmediateUser[4].RulesIndEndIdxOfImmediateUser" 0 /end MEASUREMENT
/begin MEASUREMENT BswM_ImmediateUserOsApplication_SystemApplication_Core0[4].RulesIndStartIdxOfImmediateUser "" UBYTE BswM_RulesIndStartIdxOfImmediateUserType 0 0 0 255 ECU_ADDRESS 0x0 SYMBOL_LINK "BswM_ImmediateUser[4].RulesIndStartIdxOfImmediateUser" 0 /end MEASUREMENT
/begin MEASUREMENT BswM_ImmediateUserOsApplication_SystemApplication_Core0[5].OnInitOfImmediateUser "" UBYTE BswM_OnInitOfImmediateUserType 0 0 0 1 ECU_ADDRESS 0x0 SYMBOL_LINK "BswM_ImmediateUser[5].OnInitOfImmediateUser" 0 /end MEASUREMENT
/begin MEASUREMENT BswM_ImmediateUserOsApplication_SystemApplication_Core0[5].RulesIndEndIdxOfImmediateUser "" UBYTE BswM_RulesIndEndIdxOfImmediateUserType 0 0 0 255 ECU_ADDRESS 0x0 SYMBOL_LINK "BswM_ImmediateUser[5].RulesIndEndIdxOfImmediateUser" 0 /end MEASUREMENT
/begin MEASUREMENT BswM_ImmediateUserOsApplication_SystemApplication_Core0[5].RulesIndStartIdxOfImmediateUser "" UBYTE BswM_RulesIndStartIdxOfImmediateUserType 0 0 0 255 ECU_ADDRESS 0x0 SYMBOL_LINK "BswM_ImmediateUser[5].RulesIndStartIdxOfImmediateUser" 0 /end MEASUREMENT
/begin MEASUREMENT BswM_ImmediateUserOsApplication_SystemApplication_Core0[6].OnInitOfImmediateUser "" UBYTE BswM_OnInitOfImmediateUserType 0 0 0 1 ECU_ADDRESS 0x0 SYMBOL_LINK "BswM_ImmediateUser[6].OnInitOfImmediateUser" 0 /end MEASUREMENT
/begin MEASUREMENT BswM_ImmediateUserOsApplication_SystemApplication_Core0[6].RulesIndEndIdxOfImmediateUser "" UBYTE BswM_RulesIndEndIdxOfImmediateUserType 0 0 0 255 ECU_ADDRESS 0x0 SYMBOL_LINK "BswM_ImmediateUser[6].RulesIndEndIdxOfImmediateUser" 0 /end MEASUREMENT
/begin MEASUREMENT BswM_ImmediateUserOsApplication_SystemApplication_Core0[6].RulesIndStartIdxOfImmediateUser "" UBYTE BswM_RulesIndStartIdxOfImmediateUserType 0 0 0 255 ECU_ADDRESS 0x0 SYMBOL_LINK "BswM_ImmediateUser[6].RulesIndStartIdxOfImmediateUser" 0 /end MEASUREMENT
/begin MEASUREMENT BswM_ImmediateUserOsApplication_SystemApplication_Core0[7].OnInitOfImmediateUser "" UBYTE BswM_OnInitOfImmediateUserType 0 0 0 1 ECU_ADDRESS 0x0 SYMBOL_LINK "BswM_ImmediateUser[7].OnInitOfImmediateUser" 0 /end MEASUREMENT
/begin MEASUREMENT BswM_ImmediateUserOsApplication_SystemApplication_Core0[7].RulesIndEndIdxOfImmediateUser "" UBYTE BswM_RulesIndEndIdxOfImmediateUserType 0 0 0 255 ECU_ADDRESS 0x0 SYMBOL_LINK "BswM_ImmediateUser[7].RulesIndEndIdxOfImmediateUser" 0 /end MEASUREMENT
/begin MEASUREMENT BswM_ImmediateUserOsApplication_SystemApplication_Core0[7].RulesIndStartIdxOfImmediateUser "" UBYTE BswM_RulesIndStartIdxOfImmediateUserType 0 0 0 255 ECU_ADDRESS 0x0 SYMBOL_LINK "BswM_ImmediateUser[7].RulesIndStartIdxOfImmediateUser" 0 /end MEASUREMENT
/begin MEASUREMENT BswM_ImmediateUserOsApplication_SystemApplication_Core0[8].OnInitOfImmediateUser "" UBYTE BswM_OnInitOfImmediateUserType 0 0 0 1 ECU_ADDRESS 0x0 SYMBOL_LINK "BswM_ImmediateUser[8].OnInitOfImmediateUser" 0 /end MEASUREMENT
/begin MEASUREMENT BswM_ImmediateUserOsApplication_SystemApplication_Core0[8].RulesIndEndIdxOfImmediateUser "" UBYTE BswM_RulesIndEndIdxOfImmediateUserType 0 0 0 255 ECU_ADDRESS 0x0 SYMBOL_LINK "BswM_ImmediateUser[8].RulesIndEndIdxOfImmediateUser" 0 /end MEASUREMENT
/begin MEASUREMENT BswM_ImmediateUserOsApplication_SystemApplication_Core0[8].RulesIndStartIdxOfImmediateUser "" UBYTE BswM_RulesIndStartIdxOfImmediateUserType 0 0 0 255 ECU_ADDRESS 0x0 SYMBOL_LINK "BswM_ImmediateUser[8].RulesIndStartIdxOfImmediateUser" 0 /end MEASUREMENT
/begin MEASUREMENT BswM_ImmediateUserOsApplication_SystemApplication_Core0[9].OnInitOfImmediateUser "" UBYTE BswM_OnInitOfImmediateUserType 0 0 0 1 ECU_ADDRESS 0x0 SYMBOL_LINK "BswM_ImmediateUser[9].OnInitOfImmediateUser" 0 /end MEASUREMENT
/begin MEASUREMENT BswM_ImmediateUserOsApplication_SystemApplication_Core0[9].RulesIndEndIdxOfImmediateUser "" UBYTE BswM_RulesIndEndIdxOfImmediateUserType 0 0 0 255 ECU_ADDRESS 0x0 SYMBOL_LINK "BswM_ImmediateUser[9].RulesIndEndIdxOfImmediateUser" 0 /end MEASUREMENT
/begin MEASUREMENT BswM_ImmediateUserOsApplication_SystemApplication_Core0[9].RulesIndStartIdxOfImmediateUser "" UBYTE BswM_RulesIndStartIdxOfImmediateUserType 0 0 0 255 ECU_ADDRESS 0x0 SYMBOL_LINK "BswM_ImmediateUser[9].RulesIndStartIdxOfImmediateUser" 0 /end MEASUREMENT
/begin MEASUREMENT BswM_InitializedOsApplication_SystemApplication_Core0 "" UBYTE BswM_InitializedType 0 0 0 1 ECU_ADDRESS 0x0 /end MEASUREMENT
/begin MEASUREMENT BswM_InitializedOsApplication_SystemApplication_Core1 "" UBYTE BswM_InitializedType 0 0 0 1 ECU_ADDRESS 0x0 /end MEASUREMENT
/begin MEASUREMENT BswM_ModeRequestQueueOsApplication_SystemApplication_Core0 "Variable to store an immediate mode request which must be queued because of a current active arbitration." UBYTE NO_COMPU_METHOD 0 0 0 255 ECU_ADDRESS 0x0 MATRIX_DIM 15 SYMBOL_LINK "BswM_ModeRequestQueue" 0 /end MEASUREMENT
/begin MEASUREMENT BswM_PCPartitionConfig.ActionListQueueOfPCPartitionConfig "" ULONG BswM_ActionListQueueOfPCPartitionConfigType 0 0 0 4294967295 ECU_ADDRESS 0x0 /end MEASUREMENT
/begin MEASUREMENT BswM_PCPartitionConfig.ActionListsOfPCPartitionConfig "" ULONG BswM_ActionListsOfPCPartitionConfigType 0 0 0 4294967295 ECU_ADDRESS 0x0 /end MEASUREMENT
/begin MEASUREMENT BswM_PCPartitionConfig.CanSMChannelMappingOfPCPartitionConfig "" ULONG BswM_CanSMChannelMappingOfPCPartitionConfigType 0 0 0 4294967295 ECU_ADDRESS 0x0 /end MEASUREMENT
/begin MEASUREMENT BswM_PCPartitionConfig.CanSMChannelStateOfPCPartitionConfig "" ULONG BswM_CanSMChannelStateOfPCPartitionConfigType 0 0 0 4294967295 ECU_ADDRESS 0x0 /end MEASUREMENT
/begin MEASUREMENT BswM_PCPartitionConfig.ComMChannelMappingOfPCPartitionConfig "" ULONG BswM_ComMChannelMappingOfPCPartitionConfigType 0 0 0 4294967295 ECU_ADDRESS 0x0 /end MEASUREMENT
/begin MEASUREMENT BswM_PCPartitionConfig.ComMChannelStateOfPCPartitionConfig "" ULONG BswM_ComMChannelStateOfPCPartitionConfigType 0 0 0 4294967295 ECU_ADDRESS 0x0 /end MEASUREMENT
/begin MEASUREMENT BswM_PCPartitionConfig.ComMPncMappingOfPCPartitionConfig "" ULONG BswM_ComMPncMappingOfPCPartitionConfigType 0 0 0 4294967295 ECU_ADDRESS 0x0 /end MEASUREMENT
/begin MEASUREMENT BswM_PCPartitionConfig.ComMPncStateOfPCPartitionConfig "" ULONG BswM_ComMPncStateOfPCPartitionConfigType 0 0 0 4294967295 ECU_ADDRESS 0x0 /end MEASUREMENT
/begin MEASUREMENT BswM_PCPartitionConfig.CoreSyncValueOfPCPartitionConfig "" ULONG BswM_CoreSyncValueOfPCPartitionConfigType 0 0 0 4294967295 ECU_ADDRESS 0x0 /end MEASUREMENT
/begin MEASUREMENT BswM_PCPartitionConfig.DeferredRulesOfPCPartitionConfig "" ULONG BswM_DeferredRulesOfPCPartitionConfigType 0 0 0 4294967295 ECU_ADDRESS 0x0 /end MEASUREMENT
/begin MEASUREMENT BswM_PCPartitionConfig.ForcedActionListPriorityOfPCPartitionConfig "" ULONG BswM_ForcedActionListPriorityOfPCPartitionConfigType 0 0 0 4294967295 ECU_ADDRESS 0x0 /end MEASUREMENT
/begin MEASUREMENT BswM_PCPartitionConfig.GenericMappingOfPCPartitionConfig "" ULONG BswM_GenericMappingOfPCPartitionConfigType 0 0 0 4294967295 ECU_ADDRESS 0x0 /end MEASUREMENT
/begin MEASUREMENT BswM_PCPartitionConfig.GenericStateOfPCPartitionConfig "" ULONG BswM_GenericStateOfPCPartitionConfigType 0 0 0 4294967295 ECU_ADDRESS 0x0 /end MEASUREMENT
/begin MEASUREMENT BswM_PCPartitionConfig.ImmediateUserOfPCPartitionConfig "" ULONG BswM_ImmediateUserOfPCPartitionConfigType 0 0 0 4294967295 ECU_ADDRESS 0x0 /end MEASUREMENT
/begin MEASUREMENT BswM_PCPartitionConfig.InitGenVarAndInitALOfPCPartitionConfig "" ULONG BswM_InitGenVarAndInitALOfPCPartitionConfigType 0 0 0 4294967295 ECU_ADDRESS 0x0 /end MEASUREMENT
/begin MEASUREMENT BswM_PCPartitionConfig.InitSyncCalloutOfPCPartitionConfig "" ULONG BswM_InitSyncCalloutOfPCPartitionConfigType 0 0 0 4294967295 ECU_ADDRESS 0x0 /end MEASUREMENT
/begin MEASUREMENT BswM_PCPartitionConfig.InitializedOfPCPartitionConfig "" ULONG BswM_InitializedOfPCPartitionConfigType 0 0 0 4294967295 ECU_ADDRESS 0x0 /end MEASUREMENT
/begin MEASUREMENT BswM_PCPartitionConfig.ModeNotificationFctOfPCPartitionConfig "" ULONG BswM_ModeNotificationFctOfPCPartitionConfigType 0 0 0 4294967295 ECU_ADDRESS 0x0 /end MEASUREMENT
/begin MEASUREMENT BswM_PCPartitionConfig.ModeRequestQueueOfPCPartitionConfig "" ULONG BswM_ModeRequestQueueOfPCPartitionConfigType 0 0 0 4294967295 ECU_ADDRESS 0x0 /end MEASUREMENT
/begin MEASUREMENT BswM_PCPartitionConfig.NvMJobMappingOfPCPartitionConfig "" ULONG BswM_NvMJobMappingOfPCPartitionConfigType 0 0 0 4294967295 ECU_ADDRESS 0x0 /end MEASUREMENT
/begin MEASUREMENT BswM_PCPartitionConfig.NvMJobStateOfPCPartitionConfig "" ULONG BswM_NvMJobStateOfPCPartitionConfigType 0 0 0 4294967295 ECU_ADDRESS 0x0 /end MEASUREMENT
/begin MEASUREMENT BswM_PCPartitionConfig.QueueSemaphoreOfPCPartitionConfig "" ULONG BswM_QueueSemaphoreOfPCPartitionConfigType 0 0 0 4294967295 ECU_ADDRESS 0x0 /end MEASUREMENT
/begin MEASUREMENT BswM_PCPartitionConfig.QueueWrittenOfPCPartitionConfig "" ULONG BswM_QueueWrittenOfPCPartitionConfigType 0 0 0 4294967295 ECU_ADDRESS 0x0 /end MEASUREMENT
/begin MEASUREMENT BswM_PCPartitionConfig.RuleStatesOfPCPartitionConfig "" ULONG BswM_RuleStatesOfPCPartitionConfigType 0 0 0 4294967295 ECU_ADDRESS 0x0 /end MEASUREMENT
/begin MEASUREMENT BswM_PCPartitionConfig.RulesIndOfPCPartitionConfig "" ULONG BswM_RulesIndOfPCPartitionConfigType 0 0 0 4294967295 ECU_ADDRESS 0x0 /end MEASUREMENT
/begin MEASUREMENT BswM_PCPartitionConfig.RulesOfPCPartitionConfig "" ULONG BswM_RulesOfPCPartitionConfigType 0 0 0 4294967295 ECU_ADDRESS 0x0 /end MEASUREMENT
/begin MEASUREMENT BswM_PCPartitionConfig.SizeOfActionListsOfPCPartitionConfig "" UBYTE NO_COMPU_METHOD 0 0 0 255 ECU_ADDRESS 0x0 /end MEASUREMENT
/begin MEASUREMENT BswM_PCPartitionConfig.SizeOfCanSMChannelMappingOfPCPartitionConfig "" UBYTE NO_COMPU_METHOD 0 0 0 255 ECU_ADDRESS 0x0 /end MEASUREMENT
/begin MEASUREMENT BswM_PCPartitionConfig.SizeOfCanSMChannelStateOfPCPartitionConfig "" UBYTE NO_COMPU_METHOD 0 0 0 255 ECU_ADDRESS 0x0 /end MEASUREMENT
/begin MEASUREMENT BswM_PCPartitionConfig.SizeOfComMChannelMappingOfPCPartitionConfig "" UBYTE NO_COMPU_METHOD 0 0 0 255 ECU_ADDRESS 0x0 /end MEASUREMENT
/begin MEASUREMENT BswM_PCPartitionConfig.SizeOfComMChannelStateOfPCPartitionConfig "" UBYTE NO_COMPU_METHOD 0 0 0 255 ECU_ADDRESS 0x0 /end MEASUREMENT
/begin MEASUREMENT BswM_PCPartitionConfig.SizeOfComMPncMappingOfPCPartitionConfig "" UBYTE NO_COMPU_METHOD 0 0 0 255 ECU_ADDRESS 0x0 /end MEASUREMENT
/begin MEASUREMENT BswM_PCPartitionConfig.SizeOfComMPncStateOfPCPartitionConfig "" UBYTE NO_COMPU_METHOD 0 0 0 255 ECU_ADDRESS 0x0 /end MEASUREMENT
/begin MEASUREMENT BswM_PCPartitionConfig.SizeOfDeferredRulesOfPCPartitionConfig "" UBYTE NO_COMPU_METHOD 0 0 0 255 ECU_ADDRESS 0x0 /end MEASUREMENT
/begin MEASUREMENT BswM_PCPartitionConfig.SizeOfGenericMappingOfPCPartitionConfig "" UBYTE NO_COMPU_METHOD 0 0 0 255 ECU_ADDRESS 0x0 /end MEASUREMENT
/begin MEASUREMENT BswM_PCPartitionConfig.SizeOfGenericStateOfPCPartitionConfig "" UBYTE NO_COMPU_METHOD 0 0 0 255 ECU_ADDRESS 0x0 /end MEASUREMENT
/begin MEASUREMENT BswM_PCPartitionConfig.SizeOfImmediateUserOfPCPartitionConfig "" UBYTE NO_COMPU_METHOD 0 0 0 255 ECU_ADDRESS 0x0 /end MEASUREMENT
/begin MEASUREMENT BswM_PCPartitionConfig.SizeOfModeNotificationFctOfPCPartitionConfig "" UBYTE NO_COMPU_METHOD 0 0 0 255 ECU_ADDRESS 0x0 /end MEASUREMENT
/begin MEASUREMENT BswM_PCPartitionConfig.SizeOfNvMJobMappingOfPCPartitionConfig "" UBYTE NO_COMPU_METHOD 0 0 0 255 ECU_ADDRESS 0x0 /end MEASUREMENT
/begin MEASUREMENT BswM_PCPartitionConfig.SizeOfNvMJobStateOfPCPartitionConfig "" UBYTE NO_COMPU_METHOD 0 0 0 255 ECU_ADDRESS 0x0 /end MEASUREMENT
/begin MEASUREMENT BswM_PCPartitionConfig.SizeOfRuleStatesOfPCPartitionConfig "" UBYTE NO_COMPU_METHOD 0 0 0 255 ECU_ADDRESS 0x0 /end MEASUREMENT
/begin MEASUREMENT BswM_PCPartitionConfig.SizeOfRulesIndOfPCPartitionConfig "" UBYTE NO_COMPU_METHOD 0 0 0 255 ECU_ADDRESS 0x0 /end MEASUREMENT
/begin MEASUREMENT BswM_PCPartitionConfig.SizeOfRulesOfPCPartitionConfig "" UBYTE NO_COMPU_METHOD 0 0 0 255 ECU_ADDRESS 0x0 /end MEASUREMENT
/begin MEASUREMENT BswM_PCPartitionConfig.SizeOfSwcModeRequestUpdateFctOfPCPartitionConfig "" UBYTE NO_COMPU_METHOD 0 0 0 255 ECU_ADDRESS 0x0 /end MEASUREMENT
/begin MEASUREMENT BswM_PCPartitionConfig.SizeOfTimerStateOfPCPartitionConfig "" UBYTE NO_COMPU_METHOD 0 0 0 255 ECU_ADDRESS 0x0 /end MEASUREMENT
/begin MEASUREMENT BswM_PCPartitionConfig.SizeOfTimerValueOfPCPartitionConfig "" UBYTE NO_COMPU_METHOD 0 0 0 255 ECU_ADDRESS 0x0 /end MEASUREMENT
/begin MEASUREMENT BswM_PCPartitionConfig.SwcModeRequestUpdateFctOfPCPartitionConfig "" ULONG BswM_SwcModeRequestUpdateFctOfPCPartitionConfigType 0 0 0 4294967295 ECU_ADDRESS 0x0 /end MEASUREMENT
/begin MEASUREMENT BswM_PCPartitionConfig.TimerStateOfPCPartitionConfig "" ULONG BswM_TimerStateOfPCPartitionConfigType 0 0 0 4294967295 ECU_ADDRESS 0x0 /end MEASUREMENT
/begin MEASUREMENT BswM_PCPartitionConfig.TimerValueOfPCPartitionConfig "" ULONG BswM_TimerValueOfPCPartitionConfigType 0 0 0 4294967295 ECU_ADDRESS 0x0 /end MEASUREMENT
/begin MEASUREMENT BswM_QueueSemaphoreOsApplication_SystemApplication_Core0 "" UBYTE NO_COMPU_METHOD 0 0 0 255 ECU_ADDRESS 0x0 /end MEASUREMENT
/begin MEASUREMENT BswM_QueueSemaphoreOsApplication_SystemApplication_Core1 "" UBYTE NO_COMPU_METHOD 0 0 0 255 ECU_ADDRESS 0x0 /end MEASUREMENT
/begin MEASUREMENT BswM_QueueWrittenOsApplication_SystemApplication_Core0 "" UBYTE BswM_QueueWrittenType 0 0 0 1 ECU_ADDRESS 0x0 /end MEASUREMENT
/begin MEASUREMENT BswM_QueueWrittenOsApplication_SystemApplication_Core1 "" UBYTE BswM_QueueWrittenType 0 0 0 1 ECU_ADDRESS 0x0 /end MEASUREMENT
/begin MEASUREMENT BswM_RuleStatesOsApplication_SystemApplication_Core0 "Stores the last execution state of the rule." UBYTE NO_COMPU_METHOD 0 0 0 255 ECU_ADDRESS 0x0 MATRIX_DIM 43 SYMBOL_LINK "BswM_RuleStates.raw" 0 /end MEASUREMENT
/begin MEASUREMENT BswM_RuleStatesOsApplication_SystemApplication_Core0_R_BswMRule_DCMRESET "The element: R_BswMRule_DCMRESET of BswM_RuleStates" UBYTE NO_COMPU_METHOD 0 0 0 255 ECU_ADDRESS 0x0 SYMBOL_LINK "BswM_RuleStates.raw[42]" 0 /end MEASUREMENT
/begin MEASUREMENT BswM_RuleStatesOsApplication_SystemApplication_Core0_R_CC_CN_BMC_CAN01_78a85e89_RX "The element: R_CC_CN_BMC_CAN01_78a85e89_RX of BswM_RuleStates" UBYTE NO_COMPU_METHOD 0 0 0 255 ECU_ADDRESS 0x0 SYMBOL_LINK "BswM_RuleStates.raw[12]" 0 /end MEASUREMENT
/begin MEASUREMENT BswM_RuleStatesOsApplication_SystemApplication_Core0_R_CC_CN_BMC_CAN01_78a85e89_RX_DM "The element: R_CC_CN_BMC_CAN01_78a85e89_RX_DM of BswM_RuleStates" UBYTE NO_COMPU_METHOD 0 0 0 255 ECU_ADDRESS 0x0 SYMBOL_LINK "BswM_RuleStates.raw[10]" 0 /end MEASUREMENT
/begin MEASUREMENT BswM_RuleStatesOsApplication_SystemApplication_Core0_R_CC_CN_BMC_CAN01_78a85e89_TX "The element: R_CC_CN_BMC_CAN01_78a85e89_TX of BswM_RuleStates" UBYTE NO_COMPU_METHOD 0 0 0 255 ECU_ADDRESS 0x0 SYMBOL_LINK "BswM_RuleStates.raw[11]" 0 /end MEASUREMENT
/begin MEASUREMENT BswM_RuleStatesOsApplication_SystemApplication_Core0_R_CC_CN_HCP5_CANFD01_54d90215_PNC_26_HighVoltage_Charging_24d89ab8_TX "The element: R_CC_CN_HCP5_CANFD01_54d90215_PNC_26_HighVoltage_Charging_24d89ab8_TX of BswM_RuleStates" UBYTE NO_COMPU_METHOD 0 0 0 255 ECU_ADDRESS 0x0 SYMBOL_LINK "BswM_RuleStates.raw[30]" 0 /end MEASUREMENT
/begin MEASUREMENT BswM_RuleStatesOsApplication_SystemApplication_Core0_R_CC_CN_HCP5_CANFD01_54d90215_RX "The element: R_CC_CN_HCP5_CANFD01_54d90215_RX of BswM_RuleStates" UBYTE NO_COMPU_METHOD 0 0 0 255 ECU_ADDRESS 0x0 SYMBOL_LINK "BswM_RuleStates.raw[33]" 0 /end MEASUREMENT
/begin MEASUREMENT BswM_RuleStatesOsApplication_SystemApplication_Core0_R_CC_CN_HCP5_CANFD01_54d90215_RX_DM "The element: R_CC_CN_HCP5_CANFD01_54d90215_RX_DM of BswM_RuleStates" UBYTE NO_COMPU_METHOD 0 0 0 255 ECU_ADDRESS 0x0 SYMBOL_LINK "BswM_RuleStates.raw[26]" 0 /end MEASUREMENT
/begin MEASUREMENT BswM_RuleStatesOsApplication_SystemApplication_Core0_R_CC_CN_HCP5_CANFD01_54d90215_TX "The element: R_CC_CN_HCP5_CANFD01_54d90215_TX of BswM_RuleStates" UBYTE NO_COMPU_METHOD 0 0 0 255 ECU_ADDRESS 0x0 SYMBOL_LINK "BswM_RuleStates.raw[20]" 0 /end MEASUREMENT
/begin MEASUREMENT BswM_RuleStatesOsApplication_SystemApplication_Core0_R_CC_CN_HCP5_CANFD01_PNC_01_CarWakeUp_TX "The element: R_CC_CN_HCP5_CANFD01_PNC_01_CarWakeUp_TX of BswM_RuleStates" UBYTE NO_COMPU_METHOD 0 0 0 255 ECU_ADDRESS 0x0 SYMBOL_LINK "BswM_RuleStates.raw[32]" 0 /end MEASUREMENT
/begin MEASUREMENT BswM_RuleStatesOsApplication_SystemApplication_Core0_R_CC_CN_HCP5_CANFD01_PNC_02_Basefunction_Powertrain_RX "The element: R_CC_CN_HCP5_CANFD01_PNC_02_Basefunction_Powertrain_RX of BswM_RuleStates" UBYTE NO_COMPU_METHOD 0 0 0 255 ECU_ADDRESS 0x0 SYMBOL_LINK "BswM_RuleStates.raw[21]" 0 /end MEASUREMENT
/begin MEASUREMENT BswM_RuleStatesOsApplication_SystemApplication_Core0_R_CC_CN_HCP5_CANFD01_PNC_02_Basefunction_Powertrain_RX_DM "The element: R_CC_CN_HCP5_CANFD01_PNC_02_Basefunction_Powertrain_RX_DM of BswM_RuleStates" UBYTE NO_COMPU_METHOD 0 0 0 255 ECU_ADDRESS 0x0 SYMBOL_LINK "BswM_RuleStates.raw[24]" 0 /end MEASUREMENT
/begin MEASUREMENT BswM_RuleStatesOsApplication_SystemApplication_Core0_R_CC_CN_HCP5_CANFD01_PNC_06_Basefunction_ComfortLight_RX "The element: R_CC_CN_HCP5_CANFD01_PNC_06_Basefunction_ComfortLight_RX of BswM_RuleStates" UBYTE NO_COMPU_METHOD 0 0 0 255 ECU_ADDRESS 0x0 SYMBOL_LINK "BswM_RuleStates.raw[41]" 0 /end MEASUREMENT
/begin MEASUREMENT BswM_RuleStatesOsApplication_SystemApplication_Core0_R_CC_CN_HCP5_CANFD01_PNC_06_Basefunction_ComfortLight_RX_DM "The element: R_CC_CN_HCP5_CANFD01_PNC_06_Basefunction_ComfortLight_RX_DM of BswM_RuleStates" UBYTE NO_COMPU_METHOD 0 0 0 255 ECU_ADDRESS 0x0 SYMBOL_LINK "BswM_RuleStates.raw[23]" 0 /end MEASUREMENT
/begin MEASUREMENT BswM_RuleStatesOsApplication_SystemApplication_Core0_R_CC_CN_HCP5_CANFD01_PNC_07_Basefunction_CrossSection_RX "The element: R_CC_CN_HCP5_CANFD01_PNC_07_Basefunction_CrossSection_RX of BswM_RuleStates" UBYTE NO_COMPU_METHOD 0 0 0 255 ECU_ADDRESS 0x0 SYMBOL_LINK "BswM_RuleStates.raw[37]" 0 /end MEASUREMENT
/begin MEASUREMENT BswM_RuleStatesOsApplication_SystemApplication_Core0_R_CC_CN_HCP5_CANFD01_PNC_07_Basefunction_CrossSection_RX_DM "The element: R_CC_CN_HCP5_CANFD01_PNC_07_Basefunction_CrossSection_RX_DM of BswM_RuleStates" UBYTE NO_COMPU_METHOD 0 0 0 255 ECU_ADDRESS 0x0 SYMBOL_LINK "BswM_RuleStates.raw[39]" 0 /end MEASUREMENT
/begin MEASUREMENT BswM_RuleStatesOsApplication_SystemApplication_Core0_R_CC_CN_HCP5_CANFD01_PNC_10_Powertrain_RX "The element: R_CC_CN_HCP5_CANFD01_PNC_10_Powertrain_RX of BswM_RuleStates" UBYTE NO_COMPU_METHOD 0 0 0 255 ECU_ADDRESS 0x0 SYMBOL_LINK "BswM_RuleStates.raw[31]" 0 /end MEASUREMENT
/begin MEASUREMENT BswM_RuleStatesOsApplication_SystemApplication_Core0_R_CC_CN_HCP5_CANFD01_PNC_10_Powertrain_RX_DM "The element: R_CC_CN_HCP5_CANFD01_PNC_10_Powertrain_RX_DM of BswM_RuleStates" UBYTE NO_COMPU_METHOD 0 0 0 255 ECU_ADDRESS 0x0 SYMBOL_LINK "BswM_RuleStates.raw[18]" 0 /end MEASUREMENT
/begin MEASUREMENT BswM_RuleStatesOsApplication_SystemApplication_Core0_R_CC_CN_HCP5_CANFD01_PNC_11_Chassis_RX "The element: R_CC_CN_HCP5_CANFD01_PNC_11_Chassis_RX of BswM_RuleStates" UBYTE NO_COMPU_METHOD 0 0 0 255 ECU_ADDRESS 0x0 SYMBOL_LINK "BswM_RuleStates.raw[29]" 0 /end MEASUREMENT
/begin MEASUREMENT BswM_RuleStatesOsApplication_SystemApplication_Core0_R_CC_CN_HCP5_CANFD01_PNC_11_Chassis_RX_DM "The element: R_CC_CN_HCP5_CANFD01_PNC_11_Chassis_RX_DM of BswM_RuleStates" UBYTE NO_COMPU_METHOD 0 0 0 255 ECU_ADDRESS 0x0 SYMBOL_LINK "BswM_RuleStates.raw[28]" 0 /end MEASUREMENT
/begin MEASUREMENT BswM_RuleStatesOsApplication_SystemApplication_Core0_R_CC_CN_HCP5_CANFD01_PNC_13_Airbag_RX "The element: R_CC_CN_HCP5_CANFD01_PNC_13_Airbag_RX of BswM_RuleStates" UBYTE NO_COMPU_METHOD 0 0 0 255 ECU_ADDRESS 0x0 SYMBOL_LINK "BswM_RuleStates.raw[17]" 0 /end MEASUREMENT
/begin MEASUREMENT BswM_RuleStatesOsApplication_SystemApplication_Core0_R_CC_CN_HCP5_CANFD01_PNC_13_Airbag_RX_DM "The element: R_CC_CN_HCP5_CANFD01_PNC_13_Airbag_RX_DM of BswM_RuleStates" UBYTE NO_COMPU_METHOD 0 0 0 255 ECU_ADDRESS 0x0 SYMBOL_LINK "BswM_RuleStates.raw[34]" 0 /end MEASUREMENT
/begin MEASUREMENT BswM_RuleStatesOsApplication_SystemApplication_Core0_R_CC_CN_HCP5_CANFD01_PNC_24_ThermoManagement_RX "The element: R_CC_CN_HCP5_CANFD01_PNC_24_ThermoManagement_RX of BswM_RuleStates" UBYTE NO_COMPU_METHOD 0 0 0 255 ECU_ADDRESS 0x0 SYMBOL_LINK "BswM_RuleStates.raw[13]" 0 /end MEASUREMENT
/begin MEASUREMENT BswM_RuleStatesOsApplication_SystemApplication_Core0_R_CC_CN_HCP5_CANFD01_PNC_24_ThermoManagement_RX_DM "The element: R_CC_CN_HCP5_CANFD01_PNC_24_ThermoManagement_RX_DM of BswM_RuleStates" UBYTE NO_COMPU_METHOD 0 0 0 255 ECU_ADDRESS 0x0 SYMBOL_LINK "BswM_RuleStates.raw[38]" 0 /end MEASUREMENT
/begin MEASUREMENT BswM_RuleStatesOsApplication_SystemApplication_Core0_R_CC_CN_HCP5_CANFD01_PNC_26_HighVoltage_Charging_RX "The element: R_CC_CN_HCP5_CANFD01_PNC_26_HighVoltage_Charging_RX of BswM_RuleStates" UBYTE NO_COMPU_METHOD 0 0 0 255 ECU_ADDRESS 0x0 SYMBOL_LINK "BswM_RuleStates.raw[36]" 0 /end MEASUREMENT
/begin MEASUREMENT BswM_RuleStatesOsApplication_SystemApplication_Core0_R_CC_CN_HCP5_CANFD01_PNC_26_HighVoltage_Charging_RX_DM "The element: R_CC_CN_HCP5_CANFD01_PNC_26_HighVoltage_Charging_RX_DM of BswM_RuleStates" UBYTE NO_COMPU_METHOD 0 0 0 255 ECU_ADDRESS 0x0 SYMBOL_LINK "BswM_RuleStates.raw[27]" 0 /end MEASUREMENT
/begin MEASUREMENT BswM_RuleStatesOsApplication_SystemApplication_Core0_R_CC_CN_HCP5_CANFD01_PNC_27_Timemaster_Timer_RX "The element: R_CC_CN_HCP5_CANFD01_PNC_27_Timemaster_Timer_RX of BswM_RuleStates" UBYTE NO_COMPU_METHOD 0 0 0 255 ECU_ADDRESS 0x0 SYMBOL_LINK "BswM_RuleStates.raw[35]" 0 /end MEASUREMENT
/begin MEASUREMENT BswM_RuleStatesOsApplication_SystemApplication_Core0_R_CC_CN_HCP5_CANFD01_PNC_27_Timemaster_Timer_RX_DM "The element: R_CC_CN_HCP5_CANFD01_PNC_27_Timemaster_Timer_RX_DM of BswM_RuleStates" UBYTE NO_COMPU_METHOD 0 0 0 255 ECU_ADDRESS 0x0 SYMBOL_LINK "BswM_RuleStates.raw[15]" 0 /end MEASUREMENT
/begin MEASUREMENT BswM_RuleStatesOsApplication_SystemApplication_Core0_R_CC_CN_HCP5_CANFD01_PNC_30_EnergyManagement_RX "The element: R_CC_CN_HCP5_CANFD01_PNC_30_EnergyManagement_RX of BswM_RuleStates" UBYTE NO_COMPU_METHOD 0 0 0 255 ECU_ADDRESS 0x0 SYMBOL_LINK "BswM_RuleStates.raw[25]" 0 /end MEASUREMENT
/begin MEASUREMENT BswM_RuleStatesOsApplication_SystemApplication_Core0_R_CC_CN_HCP5_CANFD01_PNC_30_EnergyManagement_RX_DM "The element: R_CC_CN_HCP5_CANFD01_PNC_30_EnergyManagement_RX_DM of BswM_RuleStates" UBYTE NO_COMPU_METHOD 0 0 0 255 ECU_ADDRESS 0x0 SYMBOL_LINK "BswM_RuleStates.raw[14]" 0 /end MEASUREMENT
/begin MEASUREMENT BswM_RuleStatesOsApplication_SystemApplication_Core0_R_CC_CN_HCP5_CANFD01_PNC_30_EnergyManagement_TX "The element: R_CC_CN_HCP5_CANFD01_PNC_30_EnergyManagement_TX of BswM_RuleStates" UBYTE NO_COMPU_METHOD 0 0 0 255 ECU_ADDRESS 0x0 SYMBOL_LINK "BswM_RuleStates.raw[22]" 0 /end MEASUREMENT
/begin MEASUREMENT BswM_RuleStatesOsApplication_SystemApplication_Core0_R_CC_CN_HCP5_CANFD01_PNC_40_Diagnosis_Energy_RX "The element: R_CC_CN_HCP5_CANFD01_PNC_40_Diagnosis_Energy_RX of BswM_RuleStates" UBYTE NO_COMPU_METHOD 0 0 0 255 ECU_ADDRESS 0x0 SYMBOL_LINK "BswM_RuleStates.raw[16]" 0 /end MEASUREMENT
/begin MEASUREMENT BswM_RuleStatesOsApplication_SystemApplication_Core0_R_CC_CN_HCP5_CANFD01_PNC_40_Diagnosis_Energy_RX_DM "The element: R_CC_CN_HCP5_CANFD01_PNC_40_Diagnosis_Energy_RX_DM of BswM_RuleStates" UBYTE NO_COMPU_METHOD 0 0 0 255 ECU_ADDRESS 0x0 SYMBOL_LINK "BswM_RuleStates.raw[40]" 0 /end MEASUREMENT
/begin MEASUREMENT BswM_RuleStatesOsApplication_SystemApplication_Core0_R_CC_CN_HCP5_CANFD01_PNC_40_Diagnosis_Energy_TX "The element: R_CC_CN_HCP5_CANFD01_PNC_40_Diagnosis_Energy_TX of BswM_RuleStates" UBYTE NO_COMPU_METHOD 0 0 0 255 ECU_ADDRESS 0x0 SYMBOL_LINK "BswM_RuleStates.raw[19]" 0 /end MEASUREMENT
/begin MEASUREMENT BswM_RuleStatesOsApplication_SystemApplication_Core0_R_ESH_InitToWakeup "The element: R_ESH_InitToWakeup of BswM_RuleStates" UBYTE NO_COMPU_METHOD 0 0 0 255 ECU_ADDRESS 0x0 SYMBOL_LINK "BswM_RuleStates.raw[6]" 0 /end MEASUREMENT
/begin MEASUREMENT BswM_RuleStatesOsApplication_SystemApplication_Core0_R_ESH_PostRun "The element: R_ESH_PostRun of BswM_RuleStates" UBYTE NO_COMPU_METHOD 0 0 0 255 ECU_ADDRESS 0x0 SYMBOL_LINK "BswM_RuleStates.raw[8]" 0 /end MEASUREMENT
/begin MEASUREMENT BswM_RuleStatesOsApplication_SystemApplication_Core0_R_ESH_PostRunNested "The element: R_ESH_PostRunNested of BswM_RuleStates" UBYTE NO_COMPU_METHOD 0 0 0 255 ECU_ADDRESS 0x0 SYMBOL_LINK "BswM_RuleStates.raw[7]" 0 /end MEASUREMENT
/begin MEASUREMENT BswM_RuleStatesOsApplication_SystemApplication_Core0_R_ESH_PrepToWait "The element: R_ESH_PrepToWait of BswM_RuleStates" UBYTE NO_COMPU_METHOD 0 0 0 255 ECU_ADDRESS 0x0 SYMBOL_LINK "BswM_RuleStates.raw[9]" 0 /end MEASUREMENT
/begin MEASUREMENT BswM_RuleStatesOsApplication_SystemApplication_Core0_R_ESH_RunToPostRun "The element: R_ESH_RunToPostRun of BswM_RuleStates" UBYTE NO_COMPU_METHOD 0 0 0 255 ECU_ADDRESS 0x0 SYMBOL_LINK "BswM_RuleStates.raw[0]" 0 /end MEASUREMENT
/begin MEASUREMENT BswM_RuleStatesOsApplication_SystemApplication_Core0_R_ESH_RunToPostRunNested "The element: R_ESH_RunToPostRunNested of BswM_RuleStates" UBYTE NO_COMPU_METHOD 0 0 0 255 ECU_ADDRESS 0x0 SYMBOL_LINK "BswM_RuleStates.raw[1]" 0 /end MEASUREMENT
/begin MEASUREMENT BswM_RuleStatesOsApplication_SystemApplication_Core0_R_ESH_WaitToShutdown "The element: R_ESH_WaitToShutdown of BswM_RuleStates" UBYTE NO_COMPU_METHOD 0 0 0 255 ECU_ADDRESS 0x0 SYMBOL_LINK "BswM_RuleStates.raw[2]" 0 /end MEASUREMENT
/begin MEASUREMENT BswM_RuleStatesOsApplication_SystemApplication_Core0_R_ESH_WaitToWakeup "The element: R_ESH_WaitToWakeup of BswM_RuleStates" UBYTE NO_COMPU_METHOD 0 0 0 255 ECU_ADDRESS 0x0 SYMBOL_LINK "BswM_RuleStates.raw[4]" 0 /end MEASUREMENT
/begin MEASUREMENT BswM_RuleStatesOsApplication_SystemApplication_Core0_R_ESH_WakeupToPrep "The element: R_ESH_WakeupToPrep of BswM_RuleStates" UBYTE NO_COMPU_METHOD 0 0 0 255 ECU_ADDRESS 0x0 SYMBOL_LINK "BswM_RuleStates.raw[3]" 0 /end MEASUREMENT
/begin MEASUREMENT BswM_RuleStatesOsApplication_SystemApplication_Core0_R_ESH_WakeupToRun "The element: R_ESH_WakeupToRun of BswM_RuleStates" UBYTE NO_COMPU_METHOD 0 0 0 255 ECU_ADDRESS 0x0 SYMBOL_LINK "BswM_RuleStates.raw[5]" 0 /end MEASUREMENT
/begin MEASUREMENT BswM_RulesIndOsApplication_SystemApplication_Core0 "the indexes of the 1:1 sorted relation pointing to BswM_Rules" UBYTE NO_COMPU_METHOD 0 0 0 255 ECU_ADDRESS 0x0 MATRIX_DIM 66 SYMBOL_LINK "BswM_RulesInd" 0 /end MEASUREMENT
/begin MEASUREMENT BswM_TimerStateOsApplication_SystemApplication_Core0 "Variable to store current state of BswMTimer (STARTED, STOPPER OR EXPIRED)." UBYTE NO_COMPU_METHOD 0 0 0 255 ECU_ADDRESS 0x0 MATRIX_DIM 3 SYMBOL_LINK "BswM_TimerState.raw" 0 /end MEASUREMENT
/begin MEASUREMENT BswM_TimerStateOsApplication_SystemApplication_Core0_MRP_ESH_NvM_CancelWriteAllTimer "The element: MRP_ESH_NvM_CancelWriteAllTimer of BswM_TimerState" UBYTE NO_COMPU_METHOD 0 0 0 255 ECU_ADDRESS 0x0 SYMBOL_LINK "BswM_TimerState.raw[0]" 0 /end MEASUREMENT
/begin MEASUREMENT BswM_TimerStateOsApplication_SystemApplication_Core0_MRP_ESH_NvM_WriteAllTimer "The element: MRP_ESH_NvM_WriteAllTimer of BswM_TimerState" UBYTE NO_COMPU_METHOD 0 0 0 255 ECU_ADDRESS 0x0 SYMBOL_LINK "BswM_TimerState.raw[1]" 0 /end MEASUREMENT
/begin MEASUREMENT BswM_TimerStateOsApplication_SystemApplication_Core0_MRP_ESH_SelfRunRequestTimer "The element: MRP_ESH_SelfRunRequestTimer of BswM_TimerState" UBYTE NO_COMPU_METHOD 0 0 0 255 ECU_ADDRESS 0x0 SYMBOL_LINK "BswM_TimerState.raw[2]" 0 /end MEASUREMENT
/begin MEASUREMENT BswM_TimerValueOsApplication_SystemApplication_Core0 "Variable to store current timer values." ULONG NO_COMPU_METHOD 0 0 0 4294967295 ECU_ADDRESS 0x0 MATRIX_DIM 3 SYMBOL_LINK "BswM_TimerValue.raw" 0 /end MEASUREMENT
/begin MEASUREMENT BswM_TimerValueOsApplication_SystemApplication_Core0_MRP_ESH_NvM_CancelWriteAllTimer "The element: MRP_ESH_NvM_CancelWriteAllTimer of BswM_TimerValue" ULONG NO_COMPU_METHOD 0 0 0 4294967295 ECU_ADDRESS 0x0 SYMBOL_LINK "BswM_TimerValue.raw[0]" 0 /end MEASUREMENT
/begin MEASUREMENT BswM_TimerValueOsApplication_SystemApplication_Core0_MRP_ESH_NvM_WriteAllTimer "The element: MRP_ESH_NvM_WriteAllTimer of BswM_TimerValue" ULONG NO_COMPU_METHOD 0 0 0 4294967295 ECU_ADDRESS 0x0 SYMBOL_LINK "BswM_TimerValue.raw[1]" 0 /end MEASUREMENT
/begin MEASUREMENT BswM_TimerValueOsApplication_SystemApplication_Core0_MRP_ESH_SelfRunRequestTimer "The element: MRP_ESH_SelfRunRequestTimer of BswM_TimerValue" ULONG NO_COMPU_METHOD 0 0 0 4294967295 ECU_ADDRESS 0x0 SYMBOL_LINK "BswM_TimerValue.raw[2]" 0 /end MEASUREMENT
/begin MEASUREMENT CanIf_CtrlStates.CtrlModeOfCtrlStates "" ULONG CanIf_ControllerModeEnum 0 0 0 4294967295 ECU_ADDRESS 0x0 MATRIX_DIM 2 /end MEASUREMENT
/begin MEASUREMENT CanIf_CtrlStates.PduModeOfCtrlStates "" ULONG CanIf_PduGetModeEnum 0 0 0 4294967295 ECU_ADDRESS 0x0 MATRIX_DIM 2 /end MEASUREMENT
/begin MEASUREMENT CanNm_ChannelConfig[0].ChannelIdOfChannelConfig "" UBYTE NO_COMPU_METHOD 0 0 0 255 ECU_ADDRESS 0x0 /end MEASUREMENT
/begin MEASUREMENT CanNm_ChannelConfig[0].ComControlEnabledOfChannelConfig "" UBYTE CanNm_ComControlEnabledOfChannelConfigType 0 0 0 1 ECU_ADDRESS 0x0 /end MEASUREMENT
/begin MEASUREMENT CanNm_ChannelConfig[0].ImmediateNmCycleTimeOfChannelConfig "" UBYTE NO_COMPU_METHOD 0 0 0 255 ECU_ADDRESS 0x0 /end MEASUREMENT
/begin MEASUREMENT CanNm_ChannelConfig[0].ImmediateNmTransmissionsOfChannelConfig "" UBYTE NO_COMPU_METHOD 0 0 0 255 ECU_ADDRESS 0x0 /end MEASUREMENT
/begin MEASUREMENT CanNm_ChannelConfig[0].MsgCycleTimeOfChannelConfig "" UBYTE NO_COMPU_METHOD 0 0 0 255 ECU_ADDRESS 0x0 /end MEASUREMENT
/begin MEASUREMENT CanNm_ChannelConfig[0].MsgTimeoutTimeOfChannelConfig "" UBYTE NO_COMPU_METHOD 0 0 0 255 ECU_ADDRESS 0x0 /end MEASUREMENT
/begin MEASUREMENT CanNm_ChannelConfig[0].PduCbvPositionOfChannelConfig "" UBYTE NO_COMPU_METHOD 0 0 0 255 ECU_ADDRESS 0x0 /end MEASUREMENT
/begin MEASUREMENT CanNm_ChannelConfig[0].PduNidPositionOfChannelConfig "" UBYTE NO_COMPU_METHOD 0 0 0 255 ECU_ADDRESS 0x0 /end MEASUREMENT
/begin MEASUREMENT CanNm_ChannelConfig[0].RemoteSleepIndTimeOfChannelConfig "" UBYTE NO_COMPU_METHOD 0 0 0 255 ECU_ADDRESS 0x0 /end MEASUREMENT
/begin MEASUREMENT CanNm_ChannelConfig[0].RepeatMessageTimeOfChannelConfig "" UWORD NO_COMPU_METHOD 0 0 0 65535 ECU_ADDRESS 0x0 /end MEASUREMENT
/begin MEASUREMENT CanNm_ChannelConfig[0].TimeoutTimeOfChannelConfig "" UBYTE NO_COMPU_METHOD 0 0 0 255 ECU_ADDRESS 0x0 /end MEASUREMENT
/begin MEASUREMENT CanNm_ChannelConfig[0].WaitBusSleepTimeOfChannelConfig "" UBYTE NO_COMPU_METHOD 0 0 0 255 ECU_ADDRESS 0x0 /end MEASUREMENT
/begin MEASUREMENT CanNm_ChannelConfig[1].ChannelIdOfChannelConfig "" UBYTE NO_COMPU_METHOD 0 0 0 255 ECU_ADDRESS 0x0 /end MEASUREMENT
/begin MEASUREMENT CanNm_ChannelConfig[1].ComControlEnabledOfChannelConfig "" UBYTE CanNm_ComControlEnabledOfChannelConfigType 0 0 0 1 ECU_ADDRESS 0x0 /end MEASUREMENT
/begin MEASUREMENT CanNm_ChannelConfig[1].ImmediateNmCycleTimeOfChannelConfig "" UBYTE NO_COMPU_METHOD 0 0 0 255 ECU_ADDRESS 0x0 /end MEASUREMENT
/begin MEASUREMENT CanNm_ChannelConfig[1].ImmediateNmTransmissionsOfChannelConfig "" UBYTE NO_COMPU_METHOD 0 0 0 255 ECU_ADDRESS 0x0 /end MEASUREMENT
/begin MEASUREMENT CanNm_ChannelConfig[1].MsgCycleTimeOfChannelConfig "" UBYTE NO_COMPU_METHOD 0 0 0 255 ECU_ADDRESS 0x0 /end MEASUREMENT
/begin MEASUREMENT CanNm_ChannelConfig[1].MsgTimeoutTimeOfChannelConfig "" UBYTE NO_COMPU_METHOD 0 0 0 255 ECU_ADDRESS 0x0 /end MEASUREMENT
/begin MEASUREMENT CanNm_ChannelConfig[1].PduCbvPositionOfChannelConfig "" UBYTE NO_COMPU_METHOD 0 0 0 255 ECU_ADDRESS 0x0 /end MEASUREMENT
/begin MEASUREMENT CanNm_ChannelConfig[1].PduNidPositionOfChannelConfig "" UBYTE NO_COMPU_METHOD 0 0 0 255 ECU_ADDRESS 0x0 /end MEASUREMENT
/begin MEASUREMENT CanNm_ChannelConfig[1].RemoteSleepIndTimeOfChannelConfig "" UBYTE NO_COMPU_METHOD 0 0 0 255 ECU_ADDRESS 0x0 /end MEASUREMENT
/begin MEASUREMENT CanNm_ChannelConfig[1].RepeatMessageTimeOfChannelConfig "" UWORD NO_COMPU_METHOD 0 0 0 65535 ECU_ADDRESS 0x0 /end MEASUREMENT
/begin MEASUREMENT CanNm_ChannelConfig[1].TimeoutTimeOfChannelConfig "" UBYTE NO_COMPU_METHOD 0 0 0 255 ECU_ADDRESS 0x0 /end MEASUREMENT
/begin MEASUREMENT CanNm_ChannelConfig[1].WaitBusSleepTimeOfChannelConfig "" UBYTE NO_COMPU_METHOD 0 0 0 255 ECU_ADDRESS 0x0 /end MEASUREMENT
/begin MEASUREMENT CanNm_CommState "Internal state for the application\'s need for communication." UBYTE NO_COMPU_METHOD 0 0 0 255 ECU_ADDRESS 0x0 MATRIX_DIM 2 SYMBOL_LINK "CanNm_CommState.raw" 0 /end MEASUREMENT
/begin MEASUREMENT CanNm_CommState_CN_BMC_CAN01_78a85e89 "The element: CN_BMC_CAN01_78a85e89 of CanNm_CommState" UBYTE NO_COMPU_METHOD 0 0 0 255 ECU_ADDRESS 0x0 SYMBOL_LINK "CanNm_CommState.raw[0]" 0 /end MEASUREMENT
/begin MEASUREMENT CanNm_CommState_CN_HCP5_CANFD01_54d90215 "The element: CN_HCP5_CANFD01_54d90215 of CanNm_CommState" UBYTE NO_COMPU_METHOD 0 0 0 255 ECU_ADDRESS 0x0 SYMBOL_LINK "CanNm_CommState.raw[1]" 0 /end MEASUREMENT
/begin MEASUREMENT CanNm_CoordReadyToSleepState "State for Rx of Coordinator Sleep Ready Bit:" UBYTE NO_COMPU_METHOD 0 0 0 255 ECU_ADDRESS 0x0 MATRIX_DIM 2 SYMBOL_LINK "CanNm_CoordReadyToSleepState.raw" 0 /end MEASUREMENT
/begin MEASUREMENT CanNm_CoordReadyToSleepState_CN_BMC_CAN01_78a85e89 "The element: CN_BMC_CAN01_78a85e89 of CanNm_CoordReadyToSleepState" UBYTE NO_COMPU_METHOD 0 0 0 255 ECU_ADDRESS 0x0 SYMBOL_LINK "CanNm_CoordReadyToSleepState.raw[0]" 0 /end MEASUREMENT
/begin MEASUREMENT CanNm_CoordReadyToSleepState_CN_HCP5_CANFD01_54d90215 "The element: CN_HCP5_CANFD01_54d90215 of CanNm_CoordReadyToSleepState" UBYTE NO_COMPU_METHOD 0 0 0 255 ECU_ADDRESS 0x0 SYMBOL_LINK "CanNm_CoordReadyToSleepState.raw[1]" 0 /end MEASUREMENT
/begin MEASUREMENT CanNm_ImmediateNmMsgCount "" UBYTE NO_COMPU_METHOD 0 0 0 255 ECU_ADDRESS 0x0 MATRIX_DIM 2 SYMBOL_LINK "CanNm_ImmediateNmMsgCount.raw" 0 /end MEASUREMENT
/begin MEASUREMENT CanNm_ImmediateNmMsgCount_CN_BMC_CAN01_78a85e89 "The element: CN_BMC_CAN01_78a85e89 of CanNm_ImmediateNmMsgCount" UBYTE NO_COMPU_METHOD 0 0 0 255 ECU_ADDRESS 0x0 SYMBOL_LINK "CanNm_ImmediateNmMsgCount.raw[0]" 0 /end MEASUREMENT
/begin MEASUREMENT CanNm_ImmediateNmMsgCount_CN_HCP5_CANFD01_54d90215 "The element: CN_HCP5_CANFD01_54d90215 of CanNm_ImmediateNmMsgCount" UBYTE NO_COMPU_METHOD 0 0 0 255 ECU_ADDRESS 0x0 SYMBOL_LINK "CanNm_ImmediateNmMsgCount.raw[1]" 0 /end MEASUREMENT
/begin MEASUREMENT CanNm_MsgConfirmationFlag "Message Confirmation Flag" UBYTE CanNm_MsgConfirmationFlagType 0 0 0 1 ECU_ADDRESS 0x0 MATRIX_DIM 2 SYMBOL_LINK "CanNm_MsgConfirmationFlag.raw" 0 /end MEASUREMENT
/begin MEASUREMENT CanNm_MsgConfirmationFlag_CN_BMC_CAN01_78a85e89 "The element: CN_BMC_CAN01_78a85e89 of CanNm_MsgConfirmationFlag" UBYTE CanNm_MsgConfirmationFlagType 0 0 0 1 ECU_ADDRESS 0x0 SYMBOL_LINK "CanNm_MsgConfirmationFlag.raw[0]" 0 /end MEASUREMENT
/begin MEASUREMENT CanNm_MsgConfirmationFlag_CN_HCP5_CANFD01_54d90215 "The element: CN_HCP5_CANFD01_54d90215 of CanNm_MsgConfirmationFlag" UBYTE CanNm_MsgConfirmationFlagType 0 0 0 1 ECU_ADDRESS 0x0 SYMBOL_LINK "CanNm_MsgConfirmationFlag.raw[1]" 0 /end MEASUREMENT
/begin MEASUREMENT CanNm_MsgIndicationFlag "Message Indication Flag" UBYTE CanNm_MsgIndicationFlagType 0 0 0 1 ECU_ADDRESS 0x0 MATRIX_DIM 2 SYMBOL_LINK "CanNm_MsgIndicationFlag.raw" 0 /end MEASUREMENT
/begin MEASUREMENT CanNm_MsgIndicationFlag_CN_BMC_CAN01_78a85e89 "The element: CN_BMC_CAN01_78a85e89 of CanNm_MsgIndicationFlag" UBYTE CanNm_MsgIndicationFlagType 0 0 0 1 ECU_ADDRESS 0x0 SYMBOL_LINK "CanNm_MsgIndicationFlag.raw[0]" 0 /end MEASUREMENT
/begin MEASUREMENT CanNm_MsgIndicationFlag_CN_HCP5_CANFD01_54d90215 "The element: CN_HCP5_CANFD01_54d90215 of CanNm_MsgIndicationFlag" UBYTE CanNm_MsgIndicationFlagType 0 0 0 1 ECU_ADDRESS 0x0 SYMBOL_LINK "CanNm_MsgIndicationFlag.raw[1]" 0 /end MEASUREMENT
/begin MEASUREMENT CanNm_MsgRequest "Internal Message Request Variable" UBYTE NO_COMPU_METHOD 0 0 0 255 ECU_ADDRESS 0x0 MATRIX_DIM 2 SYMBOL_LINK "CanNm_MsgRequest.raw" 0 /end MEASUREMENT
/begin MEASUREMENT CanNm_MsgRequest_CN_BMC_CAN01_78a85e89 "The element: CN_BMC_CAN01_78a85e89 of CanNm_MsgRequest" UBYTE NO_COMPU_METHOD 0 0 0 255 ECU_ADDRESS 0x0 SYMBOL_LINK "CanNm_MsgRequest.raw[0]" 0 /end MEASUREMENT
/begin MEASUREMENT CanNm_MsgRequest_CN_HCP5_CANFD01_54d90215 "The element: CN_HCP5_CANFD01_54d90215 of CanNm_MsgRequest" UBYTE NO_COMPU_METHOD 0 0 0 255 ECU_ADDRESS 0x0 SYMBOL_LINK "CanNm_MsgRequest.raw[1]" 0 /end MEASUREMENT
/begin MEASUREMENT CanNm_MsgTimeoutTimer "" UWORD NO_COMPU_METHOD 0 0 0 65535 ECU_ADDRESS 0x0 MATRIX_DIM 2 SYMBOL_LINK "CanNm_MsgTimeoutTimer.raw" 0 /end MEASUREMENT
/begin MEASUREMENT CanNm_MsgTimeoutTimer_CN_BMC_CAN01_78a85e89 "The element: CN_BMC_CAN01_78a85e89 of CanNm_MsgTimeoutTimer" UWORD NO_COMPU_METHOD 0 0 0 65535 ECU_ADDRESS 0x0 SYMBOL_LINK "CanNm_MsgTimeoutTimer.raw[0]" 0 /end MEASUREMENT
/begin MEASUREMENT CanNm_MsgTimeoutTimer_CN_HCP5_CANFD01_54d90215 "The element: CN_HCP5_CANFD01_54d90215 of CanNm_MsgTimeoutTimer" UWORD NO_COMPU_METHOD 0 0 0 65535 ECU_ADDRESS 0x0 SYMBOL_LINK "CanNm_MsgTimeoutTimer.raw[1]" 0 /end MEASUREMENT
/begin MEASUREMENT CanNm_MsgTimer "Timer for NM message transmission." UWORD NO_COMPU_METHOD 0 0 0 65535 ECU_ADDRESS 0x0 MATRIX_DIM 2 SYMBOL_LINK "CanNm_MsgTimer.raw" 0 /end MEASUREMENT
/begin MEASUREMENT CanNm_MsgTimer_CN_BMC_CAN01_78a85e89 "The element: CN_BMC_CAN01_78a85e89 of CanNm_MsgTimer" UWORD NO_COMPU_METHOD 0 0 0 65535 ECU_ADDRESS 0x0 SYMBOL_LINK "CanNm_MsgTimer.raw[0]" 0 /end MEASUREMENT
/begin MEASUREMENT CanNm_MsgTimer_CN_HCP5_CANFD01_54d90215 "The element: CN_HCP5_CANFD01_54d90215 of CanNm_MsgTimer" UWORD NO_COMPU_METHOD 0 0 0 65535 ECU_ADDRESS 0x0 SYMBOL_LINK "CanNm_MsgTimer.raw[1]" 0 /end MEASUREMENT
/begin MEASUREMENT CanNm_NetworkRestartFlag "" UBYTE NO_COMPU_METHOD 0 0 0 255 ECU_ADDRESS 0x0 MATRIX_DIM 2 SYMBOL_LINK "CanNm_NetworkRestartFlag.raw" 0 /end MEASUREMENT
/begin MEASUREMENT CanNm_NetworkRestartFlag_CN_BMC_CAN01_78a85e89 "The element: CN_BMC_CAN01_78a85e89 of CanNm_NetworkRestartFlag" UBYTE NO_COMPU_METHOD 0 0 0 255 ECU_ADDRESS 0x0 SYMBOL_LINK "CanNm_NetworkRestartFlag.raw[0]" 0 /end MEASUREMENT
/begin MEASUREMENT CanNm_NetworkRestartFlag_CN_HCP5_CANFD01_54d90215 "The element: CN_HCP5_CANFD01_54d90215 of CanNm_NetworkRestartFlag" UBYTE NO_COMPU_METHOD 0 0 0 255 ECU_ADDRESS 0x0 SYMBOL_LINK "CanNm_NetworkRestartFlag.raw[1]" 0 /end MEASUREMENT
/begin MEASUREMENT CanNm_NmState "Current state of the state machine" UBYTE NO_COMPU_METHOD 0 0 0 255 ECU_ADDRESS 0x0 MATRIX_DIM 2 SYMBOL_LINK "CanNm_NmState.raw" 0 /end MEASUREMENT
/begin MEASUREMENT CanNm_NmState_CN_BMC_CAN01_78a85e89 "The element: CN_BMC_CAN01_78a85e89 of CanNm_NmState" UBYTE NO_COMPU_METHOD 0 0 0 255 ECU_ADDRESS 0x0 SYMBOL_LINK "CanNm_NmState.raw[0]" 0 /end MEASUREMENT
/begin MEASUREMENT CanNm_NmState_CN_HCP5_CANFD01_54d90215 "The element: CN_HCP5_CANFD01_54d90215 of CanNm_NmState" UBYTE NO_COMPU_METHOD 0 0 0 255 ECU_ADDRESS 0x0 SYMBOL_LINK "CanNm_NmState.raw[1]" 0 /end MEASUREMENT
/begin MEASUREMENT CanNm_PbChannelConfig[0].MsgCycleOffsetOfPbChannelConfig "" UBYTE NO_COMPU_METHOD 0 0 0 255 ECU_ADDRESS 0x0 /end MEASUREMENT
/begin MEASUREMENT CanNm_PbChannelConfig[0].PnEnabledOfPbChannelConfig "" UBYTE CanNm_PnEnabledOfPbChannelConfigType 0 0 0 1 ECU_ADDRESS 0x0 /end MEASUREMENT
/begin MEASUREMENT CanNm_PbChannelConfig[0].RxMessageDataEndIdxOfPbChannelConfig "" UBYTE CanNm_RxMessageDataEndIdxOfPbChannelConfigType 0 0 0 255 ECU_ADDRESS 0x0 /end MEASUREMENT
/begin MEASUREMENT CanNm_PbChannelConfig[0].RxMessageDataLengthOfPbChannelConfig "" UBYTE NO_COMPU_METHOD 0 0 0 255 ECU_ADDRESS 0x0 /end MEASUREMENT
/begin MEASUREMENT CanNm_PbChannelConfig[0].RxMessageDataStartIdxOfPbChannelConfig "" UBYTE CanNm_RxMessageDataStartIdxOfPbChannelConfigType 0 0 0 255 ECU_ADDRESS 0x0 /end MEASUREMENT
/begin MEASUREMENT CanNm_PbChannelConfig[0].RxMessageData_CBVIdxOfPbChannelConfig "" UBYTE CanNm_RxMessageData_CBVIdxOfPbChannelConfigType 0 0 0 255 ECU_ADDRESS 0x0 /end MEASUREMENT
/begin MEASUREMENT CanNm_PbChannelConfig[0].RxMessageData_NIDIdxOfPbChannelConfig "" UBYTE CanNm_RxMessageData_NIDIdxOfPbChannelConfigType 0 0 0 255 ECU_ADDRESS 0x0 /end MEASUREMENT
/begin MEASUREMENT CanNm_PbChannelConfig[0].RxMessageData_UserDataEndIdxOfPbChannelConfig "" UBYTE CanNm_RxMessageData_UserDataEndIdxOfPbChannelConfigType 0 0 0 255 ECU_ADDRESS 0x0 /end MEASUREMENT
/begin MEASUREMENT CanNm_PbChannelConfig[0].RxMessageData_UserDataLengthOfPbChannelConfig "" UBYTE NO_COMPU_METHOD 0 0 0 255 ECU_ADDRESS 0x0 /end MEASUREMENT
/begin MEASUREMENT CanNm_PbChannelConfig[0].RxMessageData_UserDataStartIdxOfPbChannelConfig "" UBYTE CanNm_RxMessageData_UserDataStartIdxOfPbChannelConfigType 0 0 0 255 ECU_ADDRESS 0x0 /end MEASUREMENT
/begin MEASUREMENT CanNm_PbChannelConfig[0].TxMessageDataEndIdxOfPbChannelConfig "" UBYTE CanNm_TxMessageDataEndIdxOfPbChannelConfigType 0 0 0 255 ECU_ADDRESS 0x0 /end MEASUREMENT
/begin MEASUREMENT CanNm_PbChannelConfig[0].TxMessageDataLengthOfPbChannelConfig "" UBYTE NO_COMPU_METHOD 0 0 0 255 ECU_ADDRESS 0x0 /end MEASUREMENT
/begin MEASUREMENT CanNm_PbChannelConfig[0].TxMessageDataStartIdxOfPbChannelConfig "" UBYTE CanNm_TxMessageDataStartIdxOfPbChannelConfigType 0 0 0 255 ECU_ADDRESS 0x0 /end MEASUREMENT
/begin MEASUREMENT CanNm_PbChannelConfig[0].TxMessageData_CBVIdxOfPbChannelConfig "" UBYTE CanNm_TxMessageData_CBVIdxOfPbChannelConfigType 0 0 0 255 ECU_ADDRESS 0x0 /end MEASUREMENT
/begin MEASUREMENT CanNm_PbChannelConfig[0].TxMessageData_NIDIdxOfPbChannelConfig "" UBYTE CanNm_TxMessageData_NIDIdxOfPbChannelConfigType 0 0 0 255 ECU_ADDRESS 0x0 /end MEASUREMENT
/begin MEASUREMENT CanNm_PbChannelConfig[0].TxMessageData_PnFilterMaskEndIdxOfPbChannelConfig "" UBYTE CanNm_TxMessageData_PnFilterMaskEndIdxOfPbChannelConfigType 0 0 0 255 ECU_ADDRESS 0x0 /end MEASUREMENT
/begin MEASUREMENT CanNm_PbChannelConfig[0].TxMessageData_PnFilterMaskStartIdxOfPbChannelConfig "" UBYTE CanNm_TxMessageData_PnFilterMaskStartIdxOfPbChannelConfigType 0 0 0 255 ECU_ADDRESS 0x0 /end MEASUREMENT
/begin MEASUREMENT CanNm_PbChannelConfig[0].TxMessageData_UserDataEndIdxOfPbChannelConfig "" UBYTE CanNm_TxMessageData_UserDataEndIdxOfPbChannelConfigType 0 0 0 255 ECU_ADDRESS 0x0 /end MEASUREMENT
/begin MEASUREMENT CanNm_PbChannelConfig[0].TxMessageData_UserDataLengthOfPbChannelConfig "" UBYTE NO_COMPU_METHOD 0 0 0 255 ECU_ADDRESS 0x0 /end MEASUREMENT
/begin MEASUREMENT CanNm_PbChannelConfig[0].TxMessageData_UserDataStartIdxOfPbChannelConfig "" UBYTE CanNm_TxMessageData_UserDataStartIdxOfPbChannelConfigType 0 0 0 255 ECU_ADDRESS 0x0 /end MEASUREMENT
/begin MEASUREMENT CanNm_PbChannelConfig[0].TxPduIdOfPbChannelConfig "" UBYTE CanNm_TxPduIdOfPbChannelConfigType 0 0 0 255 ECU_ADDRESS 0x0 /end MEASUREMENT
/begin MEASUREMENT CanNm_PbChannelConfig[0].TxUserDataPduIdOfPbChannelConfig "" UBYTE CanNm_TxUserDataPduIdOfPbChannelConfigType 0 0 0 255 ECU_ADDRESS 0x0 /end MEASUREMENT
/begin MEASUREMENT CanNm_PbChannelConfig[1].MsgCycleOffsetOfPbChannelConfig "" UBYTE NO_COMPU_METHOD 0 0 0 255 ECU_ADDRESS 0x0 /end MEASUREMENT
/begin MEASUREMENT CanNm_PbChannelConfig[1].PnEnabledOfPbChannelConfig "" UBYTE CanNm_PnEnabledOfPbChannelConfigType 0 0 0 1 ECU_ADDRESS 0x0 /end MEASUREMENT
/begin MEASUREMENT CanNm_PbChannelConfig[1].RxMessageDataEndIdxOfPbChannelConfig "" UBYTE CanNm_RxMessageDataEndIdxOfPbChannelConfigType 0 0 0 255 ECU_ADDRESS 0x0 /end MEASUREMENT
/begin MEASUREMENT CanNm_PbChannelConfig[1].RxMessageDataLengthOfPbChannelConfig "" UBYTE NO_COMPU_METHOD 0 0 0 255 ECU_ADDRESS 0x0 /end MEASUREMENT
/begin MEASUREMENT CanNm_PbChannelConfig[1].RxMessageDataStartIdxOfPbChannelConfig "" UBYTE CanNm_RxMessageDataStartIdxOfPbChannelConfigType 0 0 0 255 ECU_ADDRESS 0x0 /end MEASUREMENT
/begin MEASUREMENT CanNm_PbChannelConfig[1].RxMessageData_CBVIdxOfPbChannelConfig "" UBYTE CanNm_RxMessageData_CBVIdxOfPbChannelConfigType 0 0 0 255 ECU_ADDRESS 0x0 /end MEASUREMENT
/begin MEASUREMENT CanNm_PbChannelConfig[1].RxMessageData_NIDIdxOfPbChannelConfig "" UBYTE CanNm_RxMessageData_NIDIdxOfPbChannelConfigType 0 0 0 255 ECU_ADDRESS 0x0 /end MEASUREMENT
/begin MEASUREMENT CanNm_PbChannelConfig[1].RxMessageData_UserDataEndIdxOfPbChannelConfig "" UBYTE CanNm_RxMessageData_UserDataEndIdxOfPbChannelConfigType 0 0 0 255 ECU_ADDRESS 0x0 /end MEASUREMENT
/begin MEASUREMENT CanNm_PbChannelConfig[1].RxMessageData_UserDataLengthOfPbChannelConfig "" UBYTE NO_COMPU_METHOD 0 0 0 255 ECU_ADDRESS 0x0 /end MEASUREMENT
/begin MEASUREMENT CanNm_PbChannelConfig[1].RxMessageData_UserDataStartIdxOfPbChannelConfig "" UBYTE CanNm_RxMessageData_UserDataStartIdxOfPbChannelConfigType 0 0 0 255 ECU_ADDRESS 0x0 /end MEASUREMENT
/begin MEASUREMENT CanNm_PbChannelConfig[1].TxMessageDataEndIdxOfPbChannelConfig "" UBYTE CanNm_TxMessageDataEndIdxOfPbChannelConfigType 0 0 0 255 ECU_ADDRESS 0x0 /end MEASUREMENT
/begin MEASUREMENT CanNm_PbChannelConfig[1].TxMessageDataLengthOfPbChannelConfig "" UBYTE NO_COMPU_METHOD 0 0 0 255 ECU_ADDRESS 0x0 /end MEASUREMENT
/begin MEASUREMENT CanNm_PbChannelConfig[1].TxMessageDataStartIdxOfPbChannelConfig "" UBYTE CanNm_TxMessageDataStartIdxOfPbChannelConfigType 0 0 0 255 ECU_ADDRESS 0x0 /end MEASUREMENT
/begin MEASUREMENT CanNm_PbChannelConfig[1].TxMessageData_CBVIdxOfPbChannelConfig "" UBYTE CanNm_TxMessageData_CBVIdxOfPbChannelConfigType 0 0 0 255 ECU_ADDRESS 0x0 /end MEASUREMENT
/begin MEASUREMENT CanNm_PbChannelConfig[1].TxMessageData_NIDIdxOfPbChannelConfig "" UBYTE CanNm_TxMessageData_NIDIdxOfPbChannelConfigType 0 0 0 255 ECU_ADDRESS 0x0 /end MEASUREMENT
/begin MEASUREMENT CanNm_PbChannelConfig[1].TxMessageData_PnFilterMaskEndIdxOfPbChannelConfig "" UBYTE CanNm_TxMessageData_PnFilterMaskEndIdxOfPbChannelConfigType 0 0 0 255 ECU_ADDRESS 0x0 /end MEASUREMENT
/begin MEASUREMENT CanNm_PbChannelConfig[1].TxMessageData_PnFilterMaskStartIdxOfPbChannelConfig "" UBYTE CanNm_TxMessageData_PnFilterMaskStartIdxOfPbChannelConfigType 0 0 0 255 ECU_ADDRESS 0x0 /end MEASUREMENT
/begin MEASUREMENT CanNm_PbChannelConfig[1].TxMessageData_UserDataEndIdxOfPbChannelConfig "" UBYTE CanNm_TxMessageData_UserDataEndIdxOfPbChannelConfigType 0 0 0 255 ECU_ADDRESS 0x0 /end MEASUREMENT
/begin MEASUREMENT CanNm_PbChannelConfig[1].TxMessageData_UserDataLengthOfPbChannelConfig "" UBYTE NO_COMPU_METHOD 0 0 0 255 ECU_ADDRESS 0x0 /end MEASUREMENT
/begin MEASUREMENT CanNm_PbChannelConfig[1].TxMessageData_UserDataStartIdxOfPbChannelConfig "" UBYTE CanNm_TxMessageData_UserDataStartIdxOfPbChannelConfigType 0 0 0 255 ECU_ADDRESS 0x0 /end MEASUREMENT
/begin MEASUREMENT CanNm_PbChannelConfig[1].TxPduIdOfPbChannelConfig "" UBYTE CanNm_TxPduIdOfPbChannelConfigType 0 0 0 255 ECU_ADDRESS 0x0 /end MEASUREMENT
/begin MEASUREMENT CanNm_PbChannelConfig[1].TxUserDataPduIdOfPbChannelConfig "" UBYTE CanNm_TxUserDataPduIdOfPbChannelConfigType 0 0 0 255 ECU_ADDRESS 0x0 /end MEASUREMENT
/begin MEASUREMENT CanNm_PnClusterReq "Internal Cluster Request Buffer" UBYTE NO_COMPU_METHOD 0 0 0 255 ECU_ADDRESS 0x0 MATRIX_DIM 7 SYMBOL_LINK "CanNm_PnClusterReq.raw" 0 /end MEASUREMENT
/begin MEASUREMENT CanNm_PnClusterReqNew "Internal Cluster Request Buffer" UBYTE NO_COMPU_METHOD 0 0 0 255 ECU_ADDRESS 0x0 MATRIX_DIM 7 SYMBOL_LINK "CanNm_PnClusterReqNew.raw" 0 /end MEASUREMENT
/begin MEASUREMENT CanNm_PnClusterReqNew_CanNmPnFilterMaskByte_0 "The element: CanNmPnFilterMaskByte_0 of CanNm_PnClusterReqNew" UBYTE NO_COMPU_METHOD 0 0 0 255 ECU_ADDRESS 0x0 SYMBOL_LINK "CanNm_PnClusterReqNew.raw[4]" 0 /end MEASUREMENT
/begin MEASUREMENT CanNm_PnClusterReqNew_CanNmPnFilterMaskByte_1 "The element: CanNmPnFilterMaskByte_1 of CanNm_PnClusterReqNew" UBYTE NO_COMPU_METHOD 0 0 0 255 ECU_ADDRESS 0x0 SYMBOL_LINK "CanNm_PnClusterReqNew.raw[5]" 0 /end MEASUREMENT
/begin MEASUREMENT CanNm_PnClusterReqNew_CanNmPnFilterMaskByte_2 "The element: CanNmPnFilterMaskByte_2 of CanNm_PnClusterReqNew" UBYTE NO_COMPU_METHOD 0 0 0 255 ECU_ADDRESS 0x0 SYMBOL_LINK "CanNm_PnClusterReqNew.raw[0]" 0 /end MEASUREMENT
/begin MEASUREMENT CanNm_PnClusterReqNew_CanNmPnFilterMaskByte_3 "The element: CanNmPnFilterMaskByte_3 of CanNm_PnClusterReqNew" UBYTE NO_COMPU_METHOD 0 0 0 255 ECU_ADDRESS 0x0 SYMBOL_LINK "CanNm_PnClusterReqNew.raw[1]" 0 /end MEASUREMENT
/begin MEASUREMENT CanNm_PnClusterReqNew_CanNmPnFilterMaskByte_4 "The element: CanNmPnFilterMaskByte_4 of CanNm_PnClusterReqNew" UBYTE NO_COMPU_METHOD 0 0 0 255 ECU_ADDRESS 0x0 SYMBOL_LINK "CanNm_PnClusterReqNew.raw[2]" 0 /end MEASUREMENT
/begin MEASUREMENT CanNm_PnClusterReqNew_CanNmPnFilterMaskByte_5 "The element: CanNmPnFilterMaskByte_5 of CanNm_PnClusterReqNew" UBYTE NO_COMPU_METHOD 0 0 0 255 ECU_ADDRESS 0x0 SYMBOL_LINK "CanNm_PnClusterReqNew.raw[3]" 0 /end MEASUREMENT
/begin MEASUREMENT CanNm_PnClusterReqNew_CanNmPnFilterMaskByte_6 "The element: CanNmPnFilterMaskByte_6 of CanNm_PnClusterReqNew" UBYTE NO_COMPU_METHOD 0 0 0 255 ECU_ADDRESS 0x0 SYMBOL_LINK "CanNm_PnClusterReqNew.raw[6]" 0 /end MEASUREMENT
/begin MEASUREMENT CanNm_PnClusterReq_CanNmPnFilterMaskByte_0 "The element: CanNmPnFilterMaskByte_0 of CanNm_PnClusterReq" UBYTE NO_COMPU_METHOD 0 0 0 255 ECU_ADDRESS 0x0 SYMBOL_LINK "CanNm_PnClusterReq.raw[4]" 0 /end MEASUREMENT
/begin MEASUREMENT CanNm_PnClusterReq_CanNmPnFilterMaskByte_1 "The element: CanNmPnFilterMaskByte_1 of CanNm_PnClusterReq" UBYTE NO_COMPU_METHOD 0 0 0 255 ECU_ADDRESS 0x0 SYMBOL_LINK "CanNm_PnClusterReq.raw[5]" 0 /end MEASUREMENT
/begin MEASUREMENT CanNm_PnClusterReq_CanNmPnFilterMaskByte_2 "The element: CanNmPnFilterMaskByte_2 of CanNm_PnClusterReq" UBYTE NO_COMPU_METHOD 0 0 0 255 ECU_ADDRESS 0x0 SYMBOL_LINK "CanNm_PnClusterReq.raw[0]" 0 /end MEASUREMENT
/begin MEASUREMENT CanNm_PnClusterReq_CanNmPnFilterMaskByte_3 "The element: CanNmPnFilterMaskByte_3 of CanNm_PnClusterReq" UBYTE NO_COMPU_METHOD 0 0 0 255 ECU_ADDRESS 0x0 SYMBOL_LINK "CanNm_PnClusterReq.raw[1]" 0 /end MEASUREMENT
/begin MEASUREMENT CanNm_PnClusterReq_CanNmPnFilterMaskByte_4 "The element: CanNmPnFilterMaskByte_4 of CanNm_PnClusterReq" UBYTE NO_COMPU_METHOD 0 0 0 255 ECU_ADDRESS 0x0 SYMBOL_LINK "CanNm_PnClusterReq.raw[2]" 0 /end MEASUREMENT
/begin MEASUREMENT CanNm_PnClusterReq_CanNmPnFilterMaskByte_5 "The element: CanNmPnFilterMaskByte_5 of CanNm_PnClusterReq" UBYTE NO_COMPU_METHOD 0 0 0 255 ECU_ADDRESS 0x0 SYMBOL_LINK "CanNm_PnClusterReq.raw[3]" 0 /end MEASUREMENT
/begin MEASUREMENT CanNm_PnClusterReq_CanNmPnFilterMaskByte_6 "The element: CanNmPnFilterMaskByte_6 of CanNm_PnClusterReq" UBYTE NO_COMPU_METHOD 0 0 0 255 ECU_ADDRESS 0x0 SYMBOL_LINK "CanNm_PnClusterReq.raw[6]" 0 /end MEASUREMENT
/begin MEASUREMENT CanNm_PnClusterResetTimer "Pn Cluster Reset Timer" UWORD NO_COMPU_METHOD 0 0 0 65535 ECU_ADDRESS 0x0 MATRIX_DIM 56 SYMBOL_LINK "CanNm_PnClusterResetTimer.raw" 0 /end MEASUREMENT
/begin MEASUREMENT CanNm_PnClusterResetTimer_CanNmPnFilterMaskByte_0 "The element: CanNmPnFilterMaskByte_0 of CanNm_PnClusterResetTimer" UWORD NO_COMPU_METHOD 0 0 0 65535 ECU_ADDRESS 0x0 MATRIX_DIM 8 SYMBOL_LINK "CanNm_PnClusterResetTimer.raw[32]" 0 /end MEASUREMENT
/begin MEASUREMENT CanNm_PnClusterResetTimer_CanNmPnFilterMaskByte_1 "The element: CanNmPnFilterMaskByte_1 of CanNm_PnClusterResetTimer" UWORD NO_COMPU_METHOD 0 0 0 65535 ECU_ADDRESS 0x0 MATRIX_DIM 8 SYMBOL_LINK "CanNm_PnClusterResetTimer.raw[40]" 0 /end MEASUREMENT
/begin MEASUREMENT CanNm_PnClusterResetTimer_CanNmPnFilterMaskByte_2 "The element: CanNmPnFilterMaskByte_2 of CanNm_PnClusterResetTimer" UWORD NO_COMPU_METHOD 0 0 0 65535 ECU_ADDRESS 0x0 MATRIX_DIM 8 SYMBOL_LINK "CanNm_PnClusterResetTimer.raw[0]" 0 /end MEASUREMENT
/begin MEASUREMENT CanNm_PnClusterResetTimer_CanNmPnFilterMaskByte_3 "The element: CanNmPnFilterMaskByte_3 of CanNm_PnClusterResetTimer" UWORD NO_COMPU_METHOD 0 0 0 65535 ECU_ADDRESS 0x0 MATRIX_DIM 8 SYMBOL_LINK "CanNm_PnClusterResetTimer.raw[8]" 0 /end MEASUREMENT
/begin MEASUREMENT CanNm_PnClusterResetTimer_CanNmPnFilterMaskByte_4 "The element: CanNmPnFilterMaskByte_4 of CanNm_PnClusterResetTimer" UWORD NO_COMPU_METHOD 0 0 0 65535 ECU_ADDRESS 0x0 MATRIX_DIM 8 SYMBOL_LINK "CanNm_PnClusterResetTimer.raw[16]" 0 /end MEASUREMENT
/begin MEASUREMENT CanNm_PnClusterResetTimer_CanNmPnFilterMaskByte_5 "The element: CanNmPnFilterMaskByte_5 of CanNm_PnClusterResetTimer" UWORD NO_COMPU_METHOD 0 0 0 65535 ECU_ADDRESS 0x0 MATRIX_DIM 8 SYMBOL_LINK "CanNm_PnClusterResetTimer.raw[24]" 0 /end MEASUREMENT
/begin MEASUREMENT CanNm_PnClusterResetTimer_CanNmPnFilterMaskByte_6 "The element: CanNmPnFilterMaskByte_6 of CanNm_PnClusterResetTimer" UWORD NO_COMPU_METHOD 0 0 0 65535 ECU_ADDRESS 0x0 MATRIX_DIM 8 SYMBOL_LINK "CanNm_PnClusterResetTimer.raw[48]" 0 /end MEASUREMENT
/begin MEASUREMENT CanNm_PnInfoByteConfig[0].PnClusterResetTimerEndIdxOfPnInfoByteConfig "" UBYTE CanNm_PnClusterResetTimerEndIdxOfPnInfoByteConfigType 0 0 0 255 ECU_ADDRESS 0x0 /end MEASUREMENT
/begin MEASUREMENT CanNm_PnInfoByteConfig[0].PnClusterResetTimerStartIdxOfPnInfoByteConfig "" UBYTE CanNm_PnClusterResetTimerStartIdxOfPnInfoByteConfigType 0 0 0 255 ECU_ADDRESS 0x0 /end MEASUREMENT
/begin MEASUREMENT CanNm_PnInfoByteConfig[0].PnFilterMaskOfPnInfoByteConfig "" UBYTE NO_COMPU_METHOD 0 0 0 255 ECU_ADDRESS 0x0 /end MEASUREMENT
/begin MEASUREMENT CanNm_PnInfoByteConfig[1].PnClusterResetTimerEndIdxOfPnInfoByteConfig "" UBYTE CanNm_PnClusterResetTimerEndIdxOfPnInfoByteConfigType 0 0 0 255 ECU_ADDRESS 0x0 /end MEASUREMENT
/begin MEASUREMENT CanNm_PnInfoByteConfig[1].PnClusterResetTimerStartIdxOfPnInfoByteConfig "" UBYTE CanNm_PnClusterResetTimerStartIdxOfPnInfoByteConfigType 0 0 0 255 ECU_ADDRESS 0x0 /end MEASUREMENT
/begin MEASUREMENT CanNm_PnInfoByteConfig[1].PnFilterMaskOfPnInfoByteConfig "" UBYTE NO_COMPU_METHOD 0 0 0 255 ECU_ADDRESS 0x0 /end MEASUREMENT
/begin MEASUREMENT CanNm_PnInfoByteConfig[2].PnClusterResetTimerEndIdxOfPnInfoByteConfig "" UBYTE CanNm_PnClusterResetTimerEndIdxOfPnInfoByteConfigType 0 0 0 255 ECU_ADDRESS 0x0 /end MEASUREMENT
/begin MEASUREMENT CanNm_PnInfoByteConfig[2].PnClusterResetTimerStartIdxOfPnInfoByteConfig "" UBYTE CanNm_PnClusterResetTimerStartIdxOfPnInfoByteConfigType 0 0 0 255 ECU_ADDRESS 0x0 /end MEASUREMENT
/begin MEASUREMENT CanNm_PnInfoByteConfig[2].PnFilterMaskOfPnInfoByteConfig "" UBYTE NO_COMPU_METHOD 0 0 0 255 ECU_ADDRESS 0x0 /end MEASUREMENT
/begin MEASUREMENT CanNm_PnInfoByteConfig[3].PnClusterResetTimerEndIdxOfPnInfoByteConfig "" UBYTE CanNm_PnClusterResetTimerEndIdxOfPnInfoByteConfigType 0 0 0 255 ECU_ADDRESS 0x0 /end MEASUREMENT
/begin MEASUREMENT CanNm_PnInfoByteConfig[3].PnClusterResetTimerStartIdxOfPnInfoByteConfig "" UBYTE CanNm_PnClusterResetTimerStartIdxOfPnInfoByteConfigType 0 0 0 255 ECU_ADDRESS 0x0 /end MEASUREMENT
/begin MEASUREMENT CanNm_PnInfoByteConfig[3].PnFilterMaskOfPnInfoByteConfig "" UBYTE NO_COMPU_METHOD 0 0 0 255 ECU_ADDRESS 0x0 /end MEASUREMENT
/begin MEASUREMENT CanNm_PnInfoByteConfig[4].PnClusterResetTimerEndIdxOfPnInfoByteConfig "" UBYTE CanNm_PnClusterResetTimerEndIdxOfPnInfoByteConfigType 0 0 0 255 ECU_ADDRESS 0x0 /end MEASUREMENT
/begin MEASUREMENT CanNm_PnInfoByteConfig[4].PnClusterResetTimerStartIdxOfPnInfoByteConfig "" UBYTE CanNm_PnClusterResetTimerStartIdxOfPnInfoByteConfigType 0 0 0 255 ECU_ADDRESS 0x0 /end MEASUREMENT
/begin MEASUREMENT CanNm_PnInfoByteConfig[4].PnFilterMaskOfPnInfoByteConfig "" UBYTE NO_COMPU_METHOD 0 0 0 255 ECU_ADDRESS 0x0 /end MEASUREMENT
/begin MEASUREMENT CanNm_PnInfoByteConfig[5].PnClusterResetTimerEndIdxOfPnInfoByteConfig "" UBYTE CanNm_PnClusterResetTimerEndIdxOfPnInfoByteConfigType 0 0 0 255 ECU_ADDRESS 0x0 /end MEASUREMENT
/begin MEASUREMENT CanNm_PnInfoByteConfig[5].PnClusterResetTimerStartIdxOfPnInfoByteConfig "" UBYTE CanNm_PnClusterResetTimerStartIdxOfPnInfoByteConfigType 0 0 0 255 ECU_ADDRESS 0x0 /end MEASUREMENT
/begin MEASUREMENT CanNm_PnInfoByteConfig[5].PnFilterMaskOfPnInfoByteConfig "" UBYTE NO_COMPU_METHOD 0 0 0 255 ECU_ADDRESS 0x0 /end MEASUREMENT
/begin MEASUREMENT CanNm_PnInfoByteConfig[6].PnClusterResetTimerEndIdxOfPnInfoByteConfig "" UBYTE CanNm_PnClusterResetTimerEndIdxOfPnInfoByteConfigType 0 0 0 255 ECU_ADDRESS 0x0 /end MEASUREMENT
/begin MEASUREMENT CanNm_PnInfoByteConfig[6].PnClusterResetTimerStartIdxOfPnInfoByteConfig "" UBYTE CanNm_PnClusterResetTimerStartIdxOfPnInfoByteConfigType 0 0 0 255 ECU_ADDRESS 0x0 /end MEASUREMENT
/begin MEASUREMENT CanNm_PnInfoByteConfig[6].PnFilterMaskOfPnInfoByteConfig "" UBYTE NO_COMPU_METHOD 0 0 0 255 ECU_ADDRESS 0x0 /end MEASUREMENT
/begin MEASUREMENT CanNm_PnMessageFilterDeactivationIndicated "Partial Networking: Message Reception Filter shall be disabled." UBYTE CanNm_PnMessageFilterDeactivationIndicatedType 0 0 0 1 ECU_ADDRESS 0x0 MATRIX_DIM 2 SYMBOL_LINK "CanNm_PnMessageFilterDeactivationIndicated.raw" 0 /end MEASUREMENT
/begin MEASUREMENT CanNm_PnMessageFilterDeactivationIndicated_CN_BMC_CAN01_78a85e89 "The element: CN_BMC_CAN01_78a85e89 of CanNm_PnMessageFilterDeactivationIndicated" UBYTE CanNm_PnMessageFilterDeactivationIndicatedType 0 0 0 1 ECU_ADDRESS 0x0 SYMBOL_LINK "CanNm_PnMessageFilterDeactivationIndicated.raw[0]" 0 /end MEASUREMENT
/begin MEASUREMENT CanNm_PnMessageFilterDeactivationIndicated_CN_HCP5_CANFD01_54d90215 "The element: CN_HCP5_CANFD01_54d90215 of CanNm_PnMessageFilterDeactivationIndicated" UBYTE CanNm_PnMessageFilterDeactivationIndicatedType 0 0 0 1 ECU_ADDRESS 0x0 SYMBOL_LINK "CanNm_PnMessageFilterDeactivationIndicated.raw[1]" 0 /end MEASUREMENT
/begin MEASUREMENT CanNm_PnMessageFilterEnabled "Partial Networking: Message Reception Filter is enabled." UBYTE CanNm_PnMessageFilterEnabledType 0 0 0 1 ECU_ADDRESS 0x0 MATRIX_DIM 2 SYMBOL_LINK "CanNm_PnMessageFilterEnabled.raw" 0 /end MEASUREMENT
/begin MEASUREMENT CanNm_PnMessageFilterEnabled_CN_BMC_CAN01_78a85e89 "The element: CN_BMC_CAN01_78a85e89 of CanNm_PnMessageFilterEnabled" UBYTE CanNm_PnMessageFilterEnabledType 0 0 0 1 ECU_ADDRESS 0x0 SYMBOL_LINK "CanNm_PnMessageFilterEnabled.raw[0]" 0 /end MEASUREMENT
/begin MEASUREMENT CanNm_PnMessageFilterEnabled_CN_HCP5_CANFD01_54d90215 "The element: CN_HCP5_CANFD01_54d90215 of CanNm_PnMessageFilterEnabled" UBYTE CanNm_PnMessageFilterEnabledType 0 0 0 1 ECU_ADDRESS 0x0 SYMBOL_LINK "CanNm_PnMessageFilterEnabled.raw[1]" 0 /end MEASUREMENT
/begin MEASUREMENT CanNm_RepeatMsgTimer "" UWORD NO_COMPU_METHOD 0 0 0 65535 ECU_ADDRESS 0x0 MATRIX_DIM 2 SYMBOL_LINK "CanNm_RepeatMsgTimer.raw" 0 /end MEASUREMENT
/begin MEASUREMENT CanNm_RepeatMsgTimer_CN_BMC_CAN01_78a85e89 "The element: CN_BMC_CAN01_78a85e89 of CanNm_RepeatMsgTimer" UWORD NO_COMPU_METHOD 0 0 0 65535 ECU_ADDRESS 0x0 SYMBOL_LINK "CanNm_RepeatMsgTimer.raw[0]" 0 /end MEASUREMENT
/begin MEASUREMENT CanNm_RepeatMsgTimer_CN_HCP5_CANFD01_54d90215 "The element: CN_HCP5_CANFD01_54d90215 of CanNm_RepeatMsgTimer" UWORD NO_COMPU_METHOD 0 0 0 65535 ECU_ADDRESS 0x0 SYMBOL_LINK "CanNm_RepeatMsgTimer.raw[1]" 0 /end MEASUREMENT
/begin MEASUREMENT CanNm_RxMessageData "" UBYTE NO_COMPU_METHOD 0 0 0 255 ECU_ADDRESS 0x0 MATRIX_DIM 32 /end MEASUREMENT
/begin MEASUREMENT CanNm_SysToNmChInd "Channel indirection: System Channel handle to NM channel handle" UBYTE CanNm_SysToNmChIndType 0 0 0 255 ECU_ADDRESS 0x0 MATRIX_DIM 2 /end MEASUREMENT
/begin MEASUREMENT CanNm_TimeoutTimer "Timer for NM Algorithm." UWORD NO_COMPU_METHOD 0 0 0 65535 ECU_ADDRESS 0x0 MATRIX_DIM 2 SYMBOL_LINK "CanNm_TimeoutTimer.raw" 0 /end MEASUREMENT
/begin MEASUREMENT CanNm_TimeoutTimer_CN_BMC_CAN01_78a85e89 "The element: CN_BMC_CAN01_78a85e89 of CanNm_TimeoutTimer" UWORD NO_COMPU_METHOD 0 0 0 65535 ECU_ADDRESS 0x0 SYMBOL_LINK "CanNm_TimeoutTimer.raw[0]" 0 /end MEASUREMENT
/begin MEASUREMENT CanNm_TimeoutTimer_CN_HCP5_CANFD01_54d90215 "The element: CN_HCP5_CANFD01_54d90215 of CanNm_TimeoutTimer" UWORD NO_COMPU_METHOD 0 0 0 65535 ECU_ADDRESS 0x0 SYMBOL_LINK "CanNm_TimeoutTimer.raw[1]" 0 /end MEASUREMENT
/begin MEASUREMENT CanNm_TxControlState "Message transmission control state." UBYTE NO_COMPU_METHOD 0 0 0 255 ECU_ADDRESS 0x0 MATRIX_DIM 2 SYMBOL_LINK "CanNm_TxControlState.raw" 0 /end MEASUREMENT
/begin MEASUREMENT CanNm_TxControlStateRequest "Message transmission control state request." UBYTE NO_COMPU_METHOD 0 0 0 255 ECU_ADDRESS 0x0 MATRIX_DIM 2 SYMBOL_LINK "CanNm_TxControlStateRequest.raw" 0 /end MEASUREMENT
/begin MEASUREMENT CanNm_TxControlStateRequest_CN_BMC_CAN01_78a85e89 "The element: CN_BMC_CAN01_78a85e89 of CanNm_TxControlStateRequest" UBYTE NO_COMPU_METHOD 0 0 0 255 ECU_ADDRESS 0x0 SYMBOL_LINK "CanNm_TxControlStateRequest.raw[0]" 0 /end MEASUREMENT
/begin MEASUREMENT CanNm_TxControlStateRequest_CN_HCP5_CANFD01_54d90215 "The element: CN_HCP5_CANFD01_54d90215 of CanNm_TxControlStateRequest" UBYTE NO_COMPU_METHOD 0 0 0 255 ECU_ADDRESS 0x0 SYMBOL_LINK "CanNm_TxControlStateRequest.raw[1]" 0 /end MEASUREMENT
/begin MEASUREMENT CanNm_TxControlState_CN_BMC_CAN01_78a85e89 "The element: CN_BMC_CAN01_78a85e89 of CanNm_TxControlState" UBYTE NO_COMPU_METHOD 0 0 0 255 ECU_ADDRESS 0x0 SYMBOL_LINK "CanNm_TxControlState.raw[0]" 0 /end MEASUREMENT
/begin MEASUREMENT CanNm_TxControlState_CN_HCP5_CANFD01_54d90215 "The element: CN_HCP5_CANFD01_54d90215 of CanNm_TxControlState" UBYTE NO_COMPU_METHOD 0 0 0 255 ECU_ADDRESS 0x0 SYMBOL_LINK "CanNm_TxControlState.raw[1]" 0 /end MEASUREMENT
/begin MEASUREMENT CanNm_TxMessageData "" UBYTE NO_COMPU_METHOD 0 0 0 255 ECU_ADDRESS 0x0 MATRIX_DIM 32 /end MEASUREMENT
/begin MEASUREMENT CanNm_WaitBusSleepTimer "" UWORD NO_COMPU_METHOD 0 0 0 65535 ECU_ADDRESS 0x0 MATRIX_DIM 2 SYMBOL_LINK "CanNm_WaitBusSleepTimer.raw" 0 /end MEASUREMENT
/begin MEASUREMENT CanNm_WaitBusSleepTimer_CN_BMC_CAN01_78a85e89 "The element: CN_BMC_CAN01_78a85e89 of CanNm_WaitBusSleepTimer" UWORD NO_COMPU_METHOD 0 0 0 65535 ECU_ADDRESS 0x0 SYMBOL_LINK "CanNm_WaitBusSleepTimer.raw[0]" 0 /end MEASUREMENT
/begin MEASUREMENT CanNm_WaitBusSleepTimer_CN_HCP5_CANFD01_54d90215 "The element: CN_HCP5_CANFD01_54d90215 of CanNm_WaitBusSleepTimer" UWORD NO_COMPU_METHOD 0 0 0 65535 ECU_ADDRESS 0x0 SYMBOL_LINK "CanNm_WaitBusSleepTimer.raw[1]" 0 /end MEASUREMENT
/begin COMPU_METHOD BswM_ActionListQueueOfPCPartitionConfigType "" TAB_VERB "%10.1" "" COMPU_TAB_REF BswM_ActionListQueueOfPCPartitionConfigType /end COMPU_METHOD
/begin COMPU_METHOD BswM_ActionListsOfPCPartitionConfigType "" TAB_VERB "%10.1" "" COMPU_TAB_REF BswM_ActionListsOfPCPartitionConfigType /end COMPU_METHOD
/begin COMPU_METHOD BswM_CanSMChannelMappingOfPCPartitionConfigType "" TAB_VERB "%10.1" "" COMPU_TAB_REF BswM_CanSMChannelMappingOfPCPartitionConfigType /end COMPU_METHOD
/begin COMPU_METHOD BswM_CanSMChannelStateOfPCPartitionConfigType "" TAB_VERB "%10.1" "" COMPU_TAB_REF BswM_CanSMChannelStateOfPCPartitionConfigType /end COMPU_METHOD
/begin COMPU_METHOD BswM_ComMChannelMappingOfPCPartitionConfigType "" TAB_VERB "%10.1" "" COMPU_TAB_REF BswM_ComMChannelMappingOfPCPartitionConfigType /end COMPU_METHOD
/begin COMPU_METHOD BswM_ComMChannelStateOfPCPartitionConfigType "" TAB_VERB "%10.1" "" COMPU_TAB_REF BswM_ComMChannelStateOfPCPartitionConfigType /end COMPU_METHOD
/begin COMPU_METHOD BswM_ComMPncMappingOfPCPartitionConfigType "" TAB_VERB "%10.1" "" COMPU_TAB_REF BswM_ComMPncMappingOfPCPartitionConfigType /end COMPU_METHOD
/begin COMPU_METHOD BswM_ComMPncStateOfPCPartitionConfigType "" TAB_VERB "%10.1" "" COMPU_TAB_REF BswM_ComMPncStateOfPCPartitionConfigType /end COMPU_METHOD
/begin COMPU_METHOD BswM_CoreSyncValueOfPCPartitionConfigType "" TAB_VERB "%10.1" "" COMPU_TAB_REF BswM_CoreSyncValueOfPCPartitionConfigType /end COMPU_METHOD
/begin COMPU_METHOD BswM_DeferredRulesOfPCPartitionConfigType "" TAB_VERB "%10.1" "" COMPU_TAB_REF BswM_DeferredRulesOfPCPartitionConfigType /end COMPU_METHOD
/begin COMPU_METHOD BswM_ESH_Mode "" TAB_VERB "%10.1" "" COMPU_TAB_REF BswM_ESH_Mode /end COMPU_METHOD
/begin COMPU_METHOD BswM_ESH_RunRequest "" TAB_VERB "%10.1" "" COMPU_TAB_REF BswM_ESH_RunRequest /end COMPU_METHOD
/begin COMPU_METHOD BswM_ForcedActionListPriorityOfPCPartitionConfigType "" TAB_VERB "%10.1" "" COMPU_TAB_REF BswM_ForcedActionListPriorityOfPCPartitionConfigType /end COMPU_METHOD
/begin COMPU_METHOD BswM_GenericMappingOfPCPartitionConfigType "" TAB_VERB "%10.1" "" COMPU_TAB_REF BswM_GenericMappingOfPCPartitionConfigType /end COMPU_METHOD
/begin COMPU_METHOD BswM_GenericStateOfPCPartitionConfigType "" TAB_VERB "%10.1" "" COMPU_TAB_REF BswM_GenericStateOfPCPartitionConfigType /end COMPU_METHOD
/begin COMPU_METHOD BswM_ImmediateUserOfPCPartitionConfigType "" TAB_VERB "%10.1" "" COMPU_TAB_REF BswM_ImmediateUserOfPCPartitionConfigType /end COMPU_METHOD
/begin COMPU_METHOD BswM_InitGenVarAndInitALOfPCPartitionConfigType "" TAB_VERB "%10.1" "" COMPU_TAB_REF BswM_InitGenVarAndInitALOfPCPartitionConfigType /end COMPU_METHOD
/begin COMPU_METHOD BswM_InitSyncCalloutOfPCPartitionConfigType "" TAB_VERB "%10.1" "" COMPU_TAB_REF BswM_InitSyncCalloutOfPCPartitionConfigType /end COMPU_METHOD
/begin COMPU_METHOD BswM_InitializedOfPCPartitionConfigType "" TAB_VERB "%10.1" "" COMPU_TAB_REF BswM_InitializedOfPCPartitionConfigType /end COMPU_METHOD
/begin COMPU_METHOD BswM_InitializedType "" TAB_VERB "%10.1" "" COMPU_TAB_REF BswM_InitializedType /end COMPU_METHOD
/begin COMPU_METHOD BswM_ModeNotificationFctOfPCPartitionConfigType "" TAB_VERB "%10.1" "" COMPU_TAB_REF BswM_ModeNotificationFctOfPCPartitionConfigType /end COMPU_METHOD
/begin COMPU_METHOD BswM_ModeRequestQueueOfPCPartitionConfigType "" TAB_VERB "%10.1" "" COMPU_TAB_REF BswM_ModeRequestQueueOfPCPartitionConfigType /end COMPU_METHOD
/begin COMPU_METHOD BswM_NvMJobMappingOfPCPartitionConfigType "" TAB_VERB "%10.1" "" COMPU_TAB_REF BswM_NvMJobMappingOfPCPartitionConfigType /end COMPU_METHOD
/begin COMPU_METHOD BswM_NvMJobStateOfPCPartitionConfigType "" TAB_VERB "%10.1" "" COMPU_TAB_REF BswM_NvMJobStateOfPCPartitionConfigType /end COMPU_METHOD
/begin COMPU_METHOD BswM_OnInitOfImmediateUserType "" TAB_VERB "%10.1" "" COMPU_TAB_REF BswM_OnInitOfImmediateUserType /end COMPU_METHOD
/begin COMPU_METHOD BswM_QueueSemaphoreOfPCPartitionConfigType "" TAB_VERB "%10.1" "" COMPU_TAB_REF BswM_QueueSemaphoreOfPCPartitionConfigType /end COMPU_METHOD
/begin COMPU_METHOD BswM_QueueWrittenOfPCPartitionConfigType "" TAB_VERB "%10.1" "" COMPU_TAB_REF BswM_QueueWrittenOfPCPartitionConfigType /end COMPU_METHOD
/begin COMPU_METHOD BswM_QueueWrittenType "" TAB_VERB "%10.1" "" COMPU_TAB_REF BswM_QueueWrittenType /end COMPU_METHOD
/begin COMPU_METHOD BswM_RuleStatesOfPCPartitionConfigType "" TAB_VERB "%10.1" "" COMPU_TAB_REF BswM_RuleStatesOfPCPartitionConfigType /end COMPU_METHOD
/begin COMPU_METHOD BswM_RulesIndEndIdxOfImmediateUserType "" TAB_VERB "%10.1" "" COMPU_TAB_REF BswM_RulesIndEndIdxOfImmediateUserType /end COMPU_METHOD
/begin COMPU_METHOD BswM_RulesIndOfPCPartitionConfigType "" TAB_VERB "%10.1" "" COMPU_TAB_REF BswM_RulesIndOfPCPartitionConfigType /end COMPU_METHOD
/begin COMPU_METHOD BswM_RulesIndStartIdxOfImmediateUserType "" TAB_VERB "%10.1" "" COMPU_TAB_REF BswM_RulesIndStartIdxOfImmediateUserType /end COMPU_METHOD
/begin COMPU_METHOD BswM_RulesOfPCPartitionConfigType "" TAB_VERB "%10.1" "" COMPU_TAB_REF BswM_RulesOfPCPartitionConfigType /end COMPU_METHOD
/begin COMPU_METHOD BswM_SwcModeRequestUpdateFctOfPCPartitionConfigType "" TAB_VERB "%10.1" "" COMPU_TAB_REF BswM_SwcModeRequestUpdateFctOfPCPartitionConfigType /end COMPU_METHOD
/begin COMPU_METHOD BswM_TimerStateOfPCPartitionConfigType "" TAB_VERB "%10.1" "" COMPU_TAB_REF BswM_TimerStateOfPCPartitionConfigType /end COMPU_METHOD
/begin COMPU_METHOD BswM_TimerValueOfPCPartitionConfigType "" TAB_VERB "%10.1" "" COMPU_TAB_REF BswM_TimerValueOfPCPartitionConfigType /end COMPU_METHOD
/begin COMPU_METHOD CM_AB_Deaktivierung_HV "" TAB_VERB "%10.1" "" COMPU_TAB_REF CM_AB_Deaktivierung_HV /end COMPU_METHOD
/begin COMPU_METHOD CM_AckType "" TAB_VERB "%10.1" "" COMPU_TAB_REF CM_AckType /end COMPU_METHOD
/begin COMPU_METHOD CM_Anzeige_SOC "" TAB_INTP "%10.1" "Unit_PerCent" COMPU_TAB_REF CM_Anzeige_SOC STATUS_STRING_REF CM_Anzeige_SOC.StatusText /end COMPU_METHOD
/begin COMPU_METHOD CM_BJB_CALID_Index_01 "" TAB_VERB "%10.1" "" COMPU_TAB_REF CM_BJB_CALID_Index_01 /end COMPU_METHOD
/begin COMPU_METHOD CM_BJB_CALID_Index_02 "" TAB_VERB "%10.1" "" COMPU_TAB_REF CM_BJB_CALID_Index_02 /end COMPU_METHOD
/begin COMPU_METHOD CM_BJB_CALID_Index_03 "" TAB_VERB "%10.1" "" COMPU_TAB_REF CM_BJB_CALID_Index_03 /end COMPU_METHOD
/begin COMPU_METHOD CM_BJB_CALID_Index_04 "" TAB_VERB "%10.1" "" COMPU_TAB_REF CM_BJB_CALID_Index_04 /end COMPU_METHOD
/begin COMPU_METHOD CM_BJB_CALID_Index_05 "" TAB_VERB "%10.1" "" COMPU_TAB_REF CM_BJB_CALID_Index_05 /end COMPU_METHOD
/begin COMPU_METHOD CM_BJB_CALID_Index_06 "" TAB_VERB "%10.1" "" COMPU_TAB_REF CM_BJB_CALID_Index_06 /end COMPU_METHOD
/begin COMPU_METHOD CM_BJB_CALID_Index_07 "" TAB_VERB "%10.1" "" COMPU_TAB_REF CM_BJB_CALID_Index_07 /end COMPU_METHOD
/begin COMPU_METHOD CM_BJB_CALID_Index_08 "" TAB_VERB "%10.1" "" COMPU_TAB_REF CM_BJB_CALID_Index_08 /end COMPU_METHOD
/begin COMPU_METHOD CM_BJB_CALID_Index_09 "" TAB_VERB "%10.1" "" COMPU_TAB_REF CM_BJB_CALID_Index_09 /end COMPU_METHOD
/begin COMPU_METHOD CM_BJB_CALID_Index_10 "" TAB_VERB "%10.1" "" COMPU_TAB_REF CM_BJB_CALID_Index_10 /end COMPU_METHOD
/begin COMPU_METHOD CM_BJB_CALID_Index_11 "" TAB_VERB "%10.1" "" COMPU_TAB_REF CM_BJB_CALID_Index_11 /end COMPU_METHOD
/begin COMPU_METHOD CM_BJB_CALID_Index_12 "" TAB_VERB "%10.1" "" COMPU_TAB_REF CM_BJB_CALID_Index_12 /end COMPU_METHOD
/begin COMPU_METHOD CM_BJB_CALID_Index_13 "" TAB_VERB "%10.1" "" COMPU_TAB_REF CM_BJB_CALID_Index_13 /end COMPU_METHOD
/begin COMPU_METHOD CM_BJB_CALID_Index_14 "" TAB_VERB "%10.1" "" COMPU_TAB_REF CM_BJB_CALID_Index_14 /end COMPU_METHOD
/begin COMPU_METHOD CM_BJB_CALID_Index_15 "" TAB_VERB "%10.1" "" COMPU_TAB_REF CM_BJB_CALID_Index_15 /end COMPU_METHOD
/begin COMPU_METHOD CM_BJB_CALID_Index_16 "" TAB_VERB "%10.1" "" COMPU_TAB_REF CM_BJB_CALID_Index_16 /end COMPU_METHOD
/begin COMPU_METHOD CM_BJB_CVN_Byte_1 "" TAB_INTP "%10.1" "" COMPU_TAB_REF CM_BJB_CVN_Byte_1 /end COMPU_METHOD
/begin COMPU_METHOD CM_BJB_CVN_Byte_2 "" TAB_INTP "%10.1" "" COMPU_TAB_REF CM_BJB_CVN_Byte_2 /end COMPU_METHOD
/begin COMPU_METHOD CM_BJB_CVN_Byte_3 "" TAB_INTP "%10.1" "" COMPU_TAB_REF CM_BJB_CVN_Byte_3 /end COMPU_METHOD
/begin COMPU_METHOD CM_BJB_CVN_Byte_4 "" TAB_INTP "%10.1" "" COMPU_TAB_REF CM_BJB_CVN_Byte_4 /end COMPU_METHOD
/begin COMPU_METHOD CM_BJB_CVN_VLD "" TAB_VERB "%10.1" "" COMPU_TAB_REF CM_BJB_CVN_VLD /end COMPU_METHOD
/begin COMPU_METHOD CM_BJB_ErrMem_State "" TAB_VERB "%10.1" "" COMPU_TAB_REF CM_BJB_ErrMem_State /end COMPU_METHOD
/begin COMPU_METHOD CM_BJB_Lebensdauer_Trennelemente "" TAB_INTP "%10.1" "Unit_None" COMPU_TAB_REF CM_BJB_Lebensdauer_Trennelemente STATUS_STRING_REF CM_BJB_Lebensdauer_Trennelemente.StatusText /end COMPU_METHOD
/begin COMPU_METHOD CM_BJB_Sperrung_Ueberspannung "" TAB_VERB "%10.1" "" COMPU_TAB_REF CM_BJB_Sperrung_Ueberspannung /end COMPU_METHOD
/begin COMPU_METHOD CM_BJB_Sperrung_Uebertemperatur "" TAB_VERB "%10.1" "" COMPU_TAB_REF CM_BJB_Sperrung_Uebertemperatur /end COMPU_METHOD
/begin COMPU_METHOD CM_BJB_Sperrung_Unterspannung "" TAB_VERB "%10.1" "" COMPU_TAB_REF CM_BJB_Sperrung_Unterspannung /end COMPU_METHOD
/begin COMPU_METHOD CM_BJB_Status_HV_Spannungssensorik "" TAB_VERB "%10.1" "" COMPU_TAB_REF CM_BJB_Status_HV_Spannungssensorik /end COMPU_METHOD
/begin COMPU_METHOD CM_BJB_Status_Trennelemente "" TAB_VERB "%10.1" "" COMPU_TAB_REF CM_BJB_Status_Trennelemente /end COMPU_METHOD
/begin COMPU_METHOD CM_BJB_Ueberspannungszaehler_CMC01 "" TAB_INTP "%10.1" "Unit_None" COMPU_TAB_REF CM_BJB_Ueberspannungszaehler_CMC01 STATUS_STRING_REF CM_BJB_Ueberspannungszaehler_CMC01.StatusText /end COMPU_METHOD
/begin COMPU_METHOD CM_BJB_Ueberspannungszaehler_CMC02 "" TAB_INTP "%10.1" "Unit_None" COMPU_TAB_REF CM_BJB_Ueberspannungszaehler_CMC02 STATUS_STRING_REF CM_BJB_Ueberspannungszaehler_CMC02.StatusText /end COMPU_METHOD
/begin COMPU_METHOD CM_BJB_Ueberspannungszaehler_CMC03 "" TAB_INTP "%10.1" "Unit_None" COMPU_TAB_REF CM_BJB_Ueberspannungszaehler_CMC03 STATUS_STRING_REF CM_BJB_Ueberspannungszaehler_CMC03.StatusText /end COMPU_METHOD
/begin COMPU_METHOD CM_BJB_Ueberspannungszaehler_CMC04 "" TAB_INTP "%10.1" "Unit_None" COMPU_TAB_REF CM_BJB_Ueberspannungszaehler_CMC04 STATUS_STRING_REF CM_BJB_Ueberspannungszaehler_CMC04.StatusText /end COMPU_METHOD
/begin COMPU_METHOD CM_BJB_Uebertemperaturzaehler_CMC01 "" TAB_INTP "%10.1" "Unit_None" COMPU_TAB_REF CM_BJB_Uebertemperaturzaehler_CMC01 STATUS_STRING_REF CM_BJB_Uebertemperaturzaehler_CMC01.StatusText /end COMPU_METHOD
/begin COMPU_METHOD CM_BJB_Uebertemperaturzaehler_CMC02 "" TAB_INTP "%10.1" "Unit_None" COMPU_TAB_REF CM_BJB_Uebertemperaturzaehler_CMC02 STATUS_STRING_REF CM_BJB_Uebertemperaturzaehler_CMC02.StatusText /end COMPU_METHOD
/begin COMPU_METHOD CM_BJB_Uebertemperaturzaehler_CMC03 "" TAB_INTP "%10.1" "Unit_None" COMPU_TAB_REF CM_BJB_Uebertemperaturzaehler_CMC03 STATUS_STRING_REF CM_BJB_Uebertemperaturzaehler_CMC03.StatusText /end COMPU_METHOD
/begin COMPU_METHOD CM_BJB_Uebertemperaturzaehler_CMC04 "" TAB_INTP "%10.1" "Unit_None" COMPU_TAB_REF CM_BJB_Uebertemperaturzaehler_CMC04 STATUS_STRING_REF CM_BJB_Uebertemperaturzaehler_CMC04.StatusText /end COMPU_METHOD
/begin COMPU_METHOD CM_BJB_Unterspannungszaehler_CMC01 "" TAB_INTP "%10.1" "Unit_None" COMPU_TAB_REF CM_BJB_Unterspannungszaehler_CMC01 STATUS_STRING_REF CM_BJB_Unterspannungszaehler_CMC01.StatusText /end COMPU_METHOD
/begin COMPU_METHOD CM_BJB_Unterspannungszaehler_CMC02 "" TAB_INTP "%10.1" "Unit_None" COMPU_TAB_REF CM_BJB_Unterspannungszaehler_CMC02 STATUS_STRING_REF CM_BJB_Unterspannungszaehler_CMC02.StatusText /end COMPU_METHOD
/begin COMPU_METHOD CM_BJB_Unterspannungszaehler_CMC03 "" TAB_INTP "%10.1" "Unit_None" COMPU_TAB_REF CM_BJB_Unterspannungszaehler_CMC03 STATUS_STRING_REF CM_BJB_Unterspannungszaehler_CMC03.StatusText /end COMPU_METHOD
/begin COMPU_METHOD CM_BJB_Unterspannungszaehler_CMC04 "" TAB_INTP "%10.1" "Unit_None" COMPU_TAB_REF CM_BJB_Unterspannungszaehler_CMC04 STATUS_STRING_REF CM_BJB_Unterspannungszaehler_CMC04.StatusText /end COMPU_METHOD
/begin COMPU_METHOD CM_BMC_AC_Laden "" TAB_VERB "%10.1" "" COMPU_TAB_REF CM_BMC_AC_Laden /end COMPU_METHOD
/begin COMPU_METHOD CM_BMC_Abschaltankuendigung "" TAB_INTP "%10.1" "Unit_Secon" COMPU_TAB_REF CM_BMC_Abschaltankuendigung STATUS_STRING_REF CM_BMC_Abschaltankuendigung.StatusText /end COMPU_METHOD
/begin COMPU_METHOD CM_BMC_Bank_Notlauf_erlaubt "" TAB_VERB "%10.1" "" COMPU_TAB_REF CM_BMC_Bank_Notlauf_erlaubt /end COMPU_METHOD
/begin COMPU_METHOD CM_BMC_Bank_parallel_erlaubt "" TAB_VERB "%10.1" "" COMPU_TAB_REF CM_BMC_Bank_parallel_erlaubt /end COMPU_METHOD
/begin COMPU_METHOD CM_BMC_Bank_seriell_erlaubt "" TAB_VERB "%10.1" "" COMPU_TAB_REF CM_BMC_Bank_seriell_erlaubt /end COMPU_METHOD
/begin COMPU_METHOD CM_BMC_Bankstatus "" TAB_VERB "%10.1" "" COMPU_TAB_REF CM_BMC_Bankstatus /end COMPU_METHOD
/begin COMPU_METHOD CM_BMC_Bidi_Energie_Absolut "" TAB_INTP "%10.1" "Unit_KiloWattHour" COMPU_TAB_REF CM_BMC_Bidi_Energie_Absolut STATUS_STRING_REF CM_BMC_Bidi_Energie_Absolut.StatusText /end COMPU_METHOD
/begin COMPU_METHOD CM_BMC_Bidi_GenutzteEnergie "" TAB_INTP "%10.1" "Unit_KiloWattHour" COMPU_TAB_REF CM_BMC_Bidi_GenutzteEnergie STATUS_STRING_REF CM_BMC_Bidi_GenutzteEnergie.StatusText /end COMPU_METHOD
/begin COMPU_METHOD CM_BMC_Bidi_Max_SoC "" TAB_INTP "%10.1" "Unit_PerCent" COMPU_TAB_REF CM_BMC_Bidi_Max_SoC STATUS_STRING_REF CM_BMC_Bidi_Max_SoC.StatusText /end COMPU_METHOD
/begin COMPU_METHOD CM_BMC_Bidi_Min_SoC "" TAB_INTP "%10.1" "Unit_PerCent" COMPU_TAB_REF CM_BMC_Bidi_Min_SoC STATUS_STRING_REF CM_BMC_Bidi_Min_SoC.StatusText /end COMPU_METHOD
/begin COMPU_METHOD CM_BMC_CMC_Temperatur_001 "" TAB_INTP "%10.1" "Unit_DegreCelsi" COMPU_TAB_REF CM_BMC_CMC_Temperatur_001 STATUS_STRING_REF CM_BMC_CMC_Temperatur_001.StatusText /end COMPU_METHOD
/begin COMPU_METHOD CM_BMC_CMC_Temperatur_002 "" TAB_INTP "%10.1" "Unit_DegreCelsi" COMPU_TAB_REF CM_BMC_CMC_Temperatur_002 STATUS_STRING_REF CM_BMC_CMC_Temperatur_002.StatusText /end COMPU_METHOD
/begin COMPU_METHOD CM_BMC_CMC_Temperatur_003 "" TAB_INTP "%10.1" "Unit_DegreCelsi" COMPU_TAB_REF CM_BMC_CMC_Temperatur_003 STATUS_STRING_REF CM_BMC_CMC_Temperatur_003.StatusText /end COMPU_METHOD
/begin COMPU_METHOD CM_BMC_CMC_Temperatur_004 "" TAB_INTP "%10.1" "Unit_DegreCelsi" COMPU_TAB_REF CM_BMC_CMC_Temperatur_004 STATUS_STRING_REF CM_BMC_CMC_Temperatur_004.StatusText /end COMPU_METHOD
/begin COMPU_METHOD CM_BMC_CMC_Temperatur_005 "" TAB_INTP "%10.1" "Unit_DegreCelsi" COMPU_TAB_REF CM_BMC_CMC_Temperatur_005 STATUS_STRING_REF CM_BMC_CMC_Temperatur_005.StatusText /end COMPU_METHOD
/begin COMPU_METHOD CM_BMC_CMC_Temperatur_006 "" TAB_INTP "%10.1" "Unit_DegreCelsi" COMPU_TAB_REF CM_BMC_CMC_Temperatur_006 STATUS_STRING_REF CM_BMC_CMC_Temperatur_006.StatusText /end COMPU_METHOD
/begin COMPU_METHOD CM_BMC_CMC_Temperatur_007 "" TAB_INTP "%10.1" "Unit_DegreCelsi" COMPU_TAB_REF CM_BMC_CMC_Temperatur_007 STATUS_STRING_REF CM_BMC_CMC_Temperatur_007.StatusText /end COMPU_METHOD
/begin COMPU_METHOD CM_BMC_CMC_Temperatur_008 "" TAB_INTP "%10.1" "Unit_DegreCelsi" COMPU_TAB_REF CM_BMC_CMC_Temperatur_008 STATUS_STRING_REF CM_BMC_CMC_Temperatur_008.StatusText /end COMPU_METHOD
/begin COMPU_METHOD CM_BMC_CMC_Temperatur_009 "" TAB_INTP "%10.1" "Unit_DegreCelsi" COMPU_TAB_REF CM_BMC_CMC_Temperatur_009 STATUS_STRING_REF CM_BMC_CMC_Temperatur_009.StatusText /end COMPU_METHOD
/begin COMPU_METHOD CM_BMC_CMC_Temperatur_010 "" TAB_INTP "%10.1" "Unit_DegreCelsi" COMPU_TAB_REF CM_BMC_CMC_Temperatur_010 STATUS_STRING_REF CM_BMC_CMC_Temperatur_010.StatusText /end COMPU_METHOD
/begin COMPU_METHOD CM_BMC_CMC_Temperatur_011 "" TAB_INTP "%10.1" "Unit_DegreCelsi" COMPU_TAB_REF CM_BMC_CMC_Temperatur_011 STATUS_STRING_REF CM_BMC_CMC_Temperatur_011.StatusText /end COMPU_METHOD
/begin COMPU_METHOD CM_BMC_CMC_Temperatur_012 "" TAB_INTP "%10.1" "Unit_DegreCelsi" COMPU_TAB_REF CM_BMC_CMC_Temperatur_012 STATUS_STRING_REF CM_BMC_CMC_Temperatur_012.StatusText /end COMPU_METHOD
/begin COMPU_METHOD CM_BMC_CMC_Temperatur_013 "" TAB_INTP "%10.1" "Unit_DegreCelsi" COMPU_TAB_REF CM_BMC_CMC_Temperatur_013 STATUS_STRING_REF CM_BMC_CMC_Temperatur_013.StatusText /end COMPU_METHOD
/begin COMPU_METHOD CM_BMC_CMC_Temperatur_014 "" TAB_INTP "%10.1" "Unit_DegreCelsi" COMPU_TAB_REF CM_BMC_CMC_Temperatur_014 STATUS_STRING_REF CM_BMC_CMC_Temperatur_014.StatusText /end COMPU_METHOD
/begin COMPU_METHOD CM_BMC_CMC_Temperatur_015 "" TAB_INTP "%10.1" "Unit_DegreCelsi" COMPU_TAB_REF CM_BMC_CMC_Temperatur_015 STATUS_STRING_REF CM_BMC_CMC_Temperatur_015.StatusText /end COMPU_METHOD
/begin COMPU_METHOD CM_BMC_CMC_Temperatur_016 "" TAB_INTP "%10.1" "Unit_DegreCelsi" COMPU_TAB_REF CM_BMC_CMC_Temperatur_016 STATUS_STRING_REF CM_BMC_CMC_Temperatur_016.StatusText /end COMPU_METHOD
/begin COMPU_METHOD CM_BMC_CMC_Temperatur_017 "" TAB_INTP "%10.1" "Unit_DegreCelsi" COMPU_TAB_REF CM_BMC_CMC_Temperatur_017 STATUS_STRING_REF CM_BMC_CMC_Temperatur_017.StatusText /end COMPU_METHOD
/begin COMPU_METHOD CM_BMC_CMC_Temperatur_018 "" TAB_INTP "%10.1" "Unit_DegreCelsi" COMPU_TAB_REF CM_BMC_CMC_Temperatur_018 STATUS_STRING_REF CM_BMC_CMC_Temperatur_018.StatusText /end COMPU_METHOD
/begin COMPU_METHOD CM_BMC_CMC_Temperatur_019 "" TAB_INTP "%10.1" "Unit_DegreCelsi" COMPU_TAB_REF CM_BMC_CMC_Temperatur_019 STATUS_STRING_REF CM_BMC_CMC_Temperatur_019.StatusText /end COMPU_METHOD
/begin COMPU_METHOD CM_BMC_CMC_Temperatur_01_Messzeit "" TAB_INTP "%10.1" "Unit_None" COMPU_TAB_REF CM_BMC_CMC_Temperatur_01_Messzeit STATUS_STRING_REF CM_BMC_CMC_Temperatur_01_Messzeit.StatusText /end COMPU_METHOD
/begin COMPU_METHOD CM_BMC_CMC_Temperatur_020 "" TAB_INTP "%10.1" "Unit_DegreCelsi" COMPU_TAB_REF CM_BMC_CMC_Temperatur_020 STATUS_STRING_REF CM_BMC_CMC_Temperatur_020.StatusText /end COMPU_METHOD
/begin COMPU_METHOD CM_BMC_CMC_Temperatur_021 "" TAB_INTP "%10.1" "Unit_DegreCelsi" COMPU_TAB_REF CM_BMC_CMC_Temperatur_021 STATUS_STRING_REF CM_BMC_CMC_Temperatur_021.StatusText /end COMPU_METHOD
/begin COMPU_METHOD CM_BMC_CMC_Temperatur_022 "" TAB_INTP "%10.1" "Unit_DegreCelsi" COMPU_TAB_REF CM_BMC_CMC_Temperatur_022 STATUS_STRING_REF CM_BMC_CMC_Temperatur_022.StatusText /end COMPU_METHOD
/begin COMPU_METHOD CM_BMC_CMC_Temperatur_023 "" TAB_INTP "%10.1" "Unit_DegreCelsi" COMPU_TAB_REF CM_BMC_CMC_Temperatur_023 STATUS_STRING_REF CM_BMC_CMC_Temperatur_023.StatusText /end COMPU_METHOD
/begin COMPU_METHOD CM_BMC_CMC_Temperatur_024 "" TAB_INTP "%10.1" "Unit_DegreCelsi" COMPU_TAB_REF CM_BMC_CMC_Temperatur_024 STATUS_STRING_REF CM_BMC_CMC_Temperatur_024.StatusText /end COMPU_METHOD
/begin COMPU_METHOD CM_BMC_CMC_Temperatur_025 "" TAB_INTP "%10.1" "Unit_DegreCelsi" COMPU_TAB_REF CM_BMC_CMC_Temperatur_025 STATUS_STRING_REF CM_BMC_CMC_Temperatur_025.StatusText /end COMPU_METHOD
/begin COMPU_METHOD CM_BMC_CMC_Temperatur_026 "" TAB_INTP "%10.1" "Unit_DegreCelsi" COMPU_TAB_REF CM_BMC_CMC_Temperatur_026 STATUS_STRING_REF CM_BMC_CMC_Temperatur_026.StatusText /end COMPU_METHOD
/begin COMPU_METHOD CM_BMC_CMC_Temperatur_027 "" TAB_INTP "%10.1" "Unit_DegreCelsi" COMPU_TAB_REF CM_BMC_CMC_Temperatur_027 STATUS_STRING_REF CM_BMC_CMC_Temperatur_027.StatusText /end COMPU_METHOD
/begin COMPU_METHOD CM_BMC_CMC_Temperatur_028 "" TAB_INTP "%10.1" "Unit_DegreCelsi" COMPU_TAB_REF CM_BMC_CMC_Temperatur_028 STATUS_STRING_REF CM_BMC_CMC_Temperatur_028.StatusText /end COMPU_METHOD
/begin COMPU_METHOD CM_BMC_CMC_Temperatur_029 "" TAB_INTP "%10.1" "Unit_DegreCelsi" COMPU_TAB_REF CM_BMC_CMC_Temperatur_029 STATUS_STRING_REF CM_BMC_CMC_Temperatur_029.StatusText /end COMPU_METHOD
/begin COMPU_METHOD CM_BMC_CMC_Temperatur_02_Messzeit "" TAB_INTP "%10.1" "Unit_None" COMPU_TAB_REF CM_BMC_CMC_Temperatur_02_Messzeit STATUS_STRING_REF CM_BMC_CMC_Temperatur_02_Messzeit.StatusText /end COMPU_METHOD
/begin COMPU_METHOD CM_BMC_CMC_Temperatur_030 "" TAB_INTP "%10.1" "Unit_DegreCelsi" COMPU_TAB_REF CM_BMC_CMC_Temperatur_030 STATUS_STRING_REF CM_BMC_CMC_Temperatur_030.StatusText /end COMPU_METHOD
/begin COMPU_METHOD CM_BMC_CMC_Temperatur_031 "" TAB_INTP "%10.1" "Unit_DegreCelsi" COMPU_TAB_REF CM_BMC_CMC_Temperatur_031 STATUS_STRING_REF CM_BMC_CMC_Temperatur_031.StatusText /end COMPU_METHOD
/begin COMPU_METHOD CM_BMC_CMC_Temperatur_032 "" TAB_INTP "%10.1" "Unit_DegreCelsi" COMPU_TAB_REF CM_BMC_CMC_Temperatur_032 STATUS_STRING_REF CM_BMC_CMC_Temperatur_032.StatusText /end COMPU_METHOD
/begin COMPU_METHOD CM_BMC_CMC_Temperatur_033 "" TAB_INTP "%10.1" "Unit_DegreCelsi" COMPU_TAB_REF CM_BMC_CMC_Temperatur_033 STATUS_STRING_REF CM_BMC_CMC_Temperatur_033.StatusText /end COMPU_METHOD
/begin COMPU_METHOD CM_BMC_CMC_Temperatur_034 "" TAB_INTP "%10.1" "Unit_DegreCelsi" COMPU_TAB_REF CM_BMC_CMC_Temperatur_034 STATUS_STRING_REF CM_BMC_CMC_Temperatur_034.StatusText /end COMPU_METHOD
/begin COMPU_METHOD CM_BMC_CMC_Temperatur_035 "" TAB_INTP "%10.1" "Unit_DegreCelsi" COMPU_TAB_REF CM_BMC_CMC_Temperatur_035 STATUS_STRING_REF CM_BMC_CMC_Temperatur_035.StatusText /end COMPU_METHOD
/begin COMPU_METHOD CM_BMC_CMC_Temperatur_036 "" TAB_INTP "%10.1" "Unit_DegreCelsi" COMPU_TAB_REF CM_BMC_CMC_Temperatur_036 STATUS_STRING_REF CM_BMC_CMC_Temperatur_036.StatusText /end COMPU_METHOD
/begin COMPU_METHOD CM_BMC_CMC_Temperatur_037 "" TAB_INTP "%10.1" "Unit_DegreCelsi" COMPU_TAB_REF CM_BMC_CMC_Temperatur_037 STATUS_STRING_REF CM_BMC_CMC_Temperatur_037.StatusText /end COMPU_METHOD
/begin COMPU_METHOD CM_BMC_CMC_Temperatur_038 "" TAB_INTP "%10.1" "Unit_DegreCelsi" COMPU_TAB_REF CM_BMC_CMC_Temperatur_038 STATUS_STRING_REF CM_BMC_CMC_Temperatur_038.StatusText /end COMPU_METHOD
/begin COMPU_METHOD CM_BMC_CMC_Temperatur_039 "" TAB_INTP "%10.1" "Unit_DegreCelsi" COMPU_TAB_REF CM_BMC_CMC_Temperatur_039 STATUS_STRING_REF CM_BMC_CMC_Temperatur_039.StatusText /end COMPU_METHOD
/begin COMPU_METHOD CM_BMC_CMC_Temperatur_03_Messzeit "" TAB_INTP "%10.1" "Unit_None" COMPU_TAB_REF CM_BMC_CMC_Temperatur_03_Messzeit STATUS_STRING_REF CM_BMC_CMC_Temperatur_03_Messzeit.StatusText /end COMPU_METHOD
/begin COMPU_METHOD CM_BMC_CMC_Temperatur_040 "" TAB_INTP "%10.1" "Unit_DegreCelsi" COMPU_TAB_REF CM_BMC_CMC_Temperatur_040 STATUS_STRING_REF CM_BMC_CMC_Temperatur_040.StatusText /end COMPU_METHOD
/begin COMPU_METHOD CM_BMC_CMC_Temperatur_041 "" TAB_INTP "%10.1" "Unit_DegreCelsi" COMPU_TAB_REF CM_BMC_CMC_Temperatur_041 STATUS_STRING_REF CM_BMC_CMC_Temperatur_041.StatusText /end COMPU_METHOD
/begin COMPU_METHOD CM_BMC_CMC_Temperatur_042 "" TAB_INTP "%10.1" "Unit_DegreCelsi" COMPU_TAB_REF CM_BMC_CMC_Temperatur_042 STATUS_STRING_REF CM_BMC_CMC_Temperatur_042.StatusText /end COMPU_METHOD
/begin COMPU_METHOD CM_BMC_CMC_Temperatur_043 "" TAB_INTP "%10.1" "Unit_DegreCelsi" COMPU_TAB_REF CM_BMC_CMC_Temperatur_043 STATUS_STRING_REF CM_BMC_CMC_Temperatur_043.StatusText /end COMPU_METHOD
/begin COMPU_METHOD CM_BMC_CMC_Temperatur_044 "" TAB_INTP "%10.1" "Unit_DegreCelsi" COMPU_TAB_REF CM_BMC_CMC_Temperatur_044 STATUS_STRING_REF CM_BMC_CMC_Temperatur_044.StatusText /end COMPU_METHOD
/begin COMPU_METHOD CM_BMC_CMC_Temperatur_045 "" TAB_INTP "%10.1" "Unit_DegreCelsi" COMPU_TAB_REF CM_BMC_CMC_Temperatur_045 STATUS_STRING_REF CM_BMC_CMC_Temperatur_045.StatusText /end COMPU_METHOD
/begin COMPU_METHOD CM_BMC_CMC_Temperatur_046 "" TAB_INTP "%10.1" "Unit_DegreCelsi" COMPU_TAB_REF CM_BMC_CMC_Temperatur_046 STATUS_STRING_REF CM_BMC_CMC_Temperatur_046.StatusText /end COMPU_METHOD
/begin COMPU_METHOD CM_BMC_CMC_Temperatur_047 "" TAB_INTP "%10.1" "Unit_DegreCelsi" COMPU_TAB_REF CM_BMC_CMC_Temperatur_047 STATUS_STRING_REF CM_BMC_CMC_Temperatur_047.StatusText /end COMPU_METHOD
/begin COMPU_METHOD CM_BMC_CMC_Temperatur_048 "" TAB_INTP "%10.1" "Unit_DegreCelsi" COMPU_TAB_REF CM_BMC_CMC_Temperatur_048 STATUS_STRING_REF CM_BMC_CMC_Temperatur_048.StatusText /end COMPU_METHOD
/begin COMPU_METHOD CM_BMC_CMC_Temperatur_049 "" TAB_INTP "%10.1" "Unit_DegreCelsi" COMPU_TAB_REF CM_BMC_CMC_Temperatur_049 STATUS_STRING_REF CM_BMC_CMC_Temperatur_049.StatusText /end COMPU_METHOD
/begin COMPU_METHOD CM_BMC_CMC_Temperatur_050 "" TAB_INTP "%10.1" "Unit_DegreCelsi" COMPU_TAB_REF CM_BMC_CMC_Temperatur_050 STATUS_STRING_REF CM_BMC_CMC_Temperatur_050.StatusText /end COMPU_METHOD
/begin COMPU_METHOD CM_BMC_CMC_Temperatur_051 "" TAB_INTP "%10.1" "Unit_DegreCelsi" COMPU_TAB_REF CM_BMC_CMC_Temperatur_051 STATUS_STRING_REF CM_BMC_CMC_Temperatur_051.StatusText /end COMPU_METHOD
/begin COMPU_METHOD CM_BMC_CMC_Temperatur_052 "" TAB_INTP "%10.1" "Unit_DegreCelsi" COMPU_TAB_REF CM_BMC_CMC_Temperatur_052 STATUS_STRING_REF CM_BMC_CMC_Temperatur_052.StatusText /end COMPU_METHOD
/begin COMPU_METHOD CM_BMC_CMC_Temperatur_053 "" TAB_INTP "%10.1" "Unit_DegreCelsi" COMPU_TAB_REF CM_BMC_CMC_Temperatur_053 STATUS_STRING_REF CM_BMC_CMC_Temperatur_053.StatusText /end COMPU_METHOD
/begin COMPU_METHOD CM_BMC_CMC_Temperatur_054 "" TAB_INTP "%10.1" "Unit_DegreCelsi" COMPU_TAB_REF CM_BMC_CMC_Temperatur_054 STATUS_STRING_REF CM_BMC_CMC_Temperatur_054.StatusText /end COMPU_METHOD
/begin COMPU_METHOD CM_BMC_CMC_Temperatur_055 "" TAB_INTP "%10.1" "Unit_DegreCelsi" COMPU_TAB_REF CM_BMC_CMC_Temperatur_055 STATUS_STRING_REF CM_BMC_CMC_Temperatur_055.StatusText /end COMPU_METHOD
/begin COMPU_METHOD CM_BMC_CMC_Temperatur_056 "" TAB_INTP "%10.1" "Unit_DegreCelsi" COMPU_TAB_REF CM_BMC_CMC_Temperatur_056 STATUS_STRING_REF CM_BMC_CMC_Temperatur_056.StatusText /end COMPU_METHOD
/begin COMPU_METHOD CM_BMC_CMC_Temperatur_057 "" TAB_INTP "%10.1" "Unit_DegreCelsi" COMPU_TAB_REF CM_BMC_CMC_Temperatur_057 STATUS_STRING_REF CM_BMC_CMC_Temperatur_057.StatusText /end COMPU_METHOD
/begin COMPU_METHOD CM_BMC_CMC_Temperatur_058 "" TAB_INTP "%10.1" "Unit_DegreCelsi" COMPU_TAB_REF CM_BMC_CMC_Temperatur_058 STATUS_STRING_REF CM_BMC_CMC_Temperatur_058.StatusText /end COMPU_METHOD
/begin COMPU_METHOD CM_BMC_CMC_Temperatur_059 "" TAB_INTP "%10.1" "Unit_DegreCelsi" COMPU_TAB_REF CM_BMC_CMC_Temperatur_059 STATUS_STRING_REF CM_BMC_CMC_Temperatur_059.StatusText /end COMPU_METHOD
/begin COMPU_METHOD CM_BMC_CMC_Temperatur_060 "" TAB_INTP "%10.1" "Unit_DegreCelsi" COMPU_TAB_REF CM_BMC_CMC_Temperatur_060 STATUS_STRING_REF CM_BMC_CMC_Temperatur_060.StatusText /end COMPU_METHOD
/begin COMPU_METHOD CM_BMC_CMC_Temperatur_061 "" TAB_INTP "%10.1" "Unit_DegreCelsi" COMPU_TAB_REF CM_BMC_CMC_Temperatur_061 STATUS_STRING_REF CM_BMC_CMC_Temperatur_061.StatusText /end COMPU_METHOD
/begin COMPU_METHOD CM_BMC_CMC_Temperatur_062 "" TAB_INTP "%10.1" "Unit_DegreCelsi" COMPU_TAB_REF CM_BMC_CMC_Temperatur_062 STATUS_STRING_REF CM_BMC_CMC_Temperatur_062.StatusText /end COMPU_METHOD
/begin COMPU_METHOD CM_BMC_CMC_Temperatur_063 "" TAB_INTP "%10.1" "Unit_DegreCelsi" COMPU_TAB_REF CM_BMC_CMC_Temperatur_063 STATUS_STRING_REF CM_BMC_CMC_Temperatur_063.StatusText /end COMPU_METHOD
/begin COMPU_METHOD CM_BMC_CMC_Temperatur_064 "" TAB_INTP "%10.1" "Unit_DegreCelsi" COMPU_TAB_REF CM_BMC_CMC_Temperatur_064 STATUS_STRING_REF CM_BMC_CMC_Temperatur_064.StatusText /end COMPU_METHOD
/begin COMPU_METHOD CM_BMC_CMC_Temperatur_065 "" TAB_INTP "%10.1" "Unit_DegreCelsi" COMPU_TAB_REF CM_BMC_CMC_Temperatur_065 STATUS_STRING_REF CM_BMC_CMC_Temperatur_065.StatusText /end COMPU_METHOD
/begin COMPU_METHOD CM_BMC_CMC_Temperatur_066 "" TAB_INTP "%10.1" "Unit_DegreCelsi" COMPU_TAB_REF CM_BMC_CMC_Temperatur_066 STATUS_STRING_REF CM_BMC_CMC_Temperatur_066.StatusText /end COMPU_METHOD
/begin COMPU_METHOD CM_BMC_CMC_Temperatur_067 "" TAB_INTP "%10.1" "Unit_DegreCelsi" COMPU_TAB_REF CM_BMC_CMC_Temperatur_067 STATUS_STRING_REF CM_BMC_CMC_Temperatur_067.StatusText /end COMPU_METHOD
/begin COMPU_METHOD CM_BMC_CMC_Temperatur_068 "" TAB_INTP "%10.1" "Unit_DegreCelsi" COMPU_TAB_REF CM_BMC_CMC_Temperatur_068 STATUS_STRING_REF CM_BMC_CMC_Temperatur_068.StatusText /end COMPU_METHOD
/begin COMPU_METHOD CM_BMC_CMC_Temperatur_069 "" TAB_INTP "%10.1" "Unit_DegreCelsi" COMPU_TAB_REF CM_BMC_CMC_Temperatur_069 STATUS_STRING_REF CM_BMC_CMC_Temperatur_069.StatusText /end COMPU_METHOD
/begin COMPU_METHOD CM_BMC_CMC_Temperatur_070 "" TAB_INTP "%10.1" "Unit_DegreCelsi" COMPU_TAB_REF CM_BMC_CMC_Temperatur_070 STATUS_STRING_REF CM_BMC_CMC_Temperatur_070.StatusText /end COMPU_METHOD
/begin COMPU_METHOD CM_BMC_CMC_Temperatur_071 "" TAB_INTP "%10.1" "Unit_DegreCelsi" COMPU_TAB_REF CM_BMC_CMC_Temperatur_071 STATUS_STRING_REF CM_BMC_CMC_Temperatur_071.StatusText /end COMPU_METHOD
/begin COMPU_METHOD CM_BMC_CMC_Temperatur_072 "" TAB_INTP "%10.1" "Unit_DegreCelsi" COMPU_TAB_REF CM_BMC_CMC_Temperatur_072 STATUS_STRING_REF CM_BMC_CMC_Temperatur_072.StatusText /end COMPU_METHOD
/begin COMPU_METHOD CM_BMC_CMC_Temperatur_073 "" TAB_INTP "%10.1" "Unit_DegreCelsi" COMPU_TAB_REF CM_BMC_CMC_Temperatur_073 STATUS_STRING_REF CM_BMC_CMC_Temperatur_073.StatusText /end COMPU_METHOD
/begin COMPU_METHOD CM_BMC_CMC_Temperatur_074 "" TAB_INTP "%10.1" "Unit_DegreCelsi" COMPU_TAB_REF CM_BMC_CMC_Temperatur_074 STATUS_STRING_REF CM_BMC_CMC_Temperatur_074.StatusText /end COMPU_METHOD
/begin COMPU_METHOD CM_BMC_CMC_Temperatur_075 "" TAB_INTP "%10.1" "Unit_DegreCelsi" COMPU_TAB_REF CM_BMC_CMC_Temperatur_075 STATUS_STRING_REF CM_BMC_CMC_Temperatur_075.StatusText /end COMPU_METHOD
/begin COMPU_METHOD CM_BMC_CMC_Temperatur_076 "" TAB_INTP "%10.1" "Unit_DegreCelsi" COMPU_TAB_REF CM_BMC_CMC_Temperatur_076 STATUS_STRING_REF CM_BMC_CMC_Temperatur_076.StatusText /end COMPU_METHOD
/begin COMPU_METHOD CM_BMC_CMC_Temperatur_077 "" TAB_INTP "%10.1" "Unit_DegreCelsi" COMPU_TAB_REF CM_BMC_CMC_Temperatur_077 STATUS_STRING_REF CM_BMC_CMC_Temperatur_077.StatusText /end COMPU_METHOD
/begin COMPU_METHOD CM_BMC_CMC_Temperatur_078 "" TAB_INTP "%10.1" "Unit_DegreCelsi" COMPU_TAB_REF CM_BMC_CMC_Temperatur_078 STATUS_STRING_REF CM_BMC_CMC_Temperatur_078.StatusText /end COMPU_METHOD
/begin COMPU_METHOD CM_BMC_CMC_Temperatur_079 "" TAB_INTP "%10.1" "Unit_DegreCelsi" COMPU_TAB_REF CM_BMC_CMC_Temperatur_079 STATUS_STRING_REF CM_BMC_CMC_Temperatur_079.StatusText /end COMPU_METHOD
/begin COMPU_METHOD CM_BMC_CMC_Temperatur_080 "" TAB_INTP "%10.1" "Unit_DegreCelsi" COMPU_TAB_REF CM_BMC_CMC_Temperatur_080 STATUS_STRING_REF CM_BMC_CMC_Temperatur_080.StatusText /end COMPU_METHOD
/begin COMPU_METHOD CM_BMC_CMC_Temperatur_081 "" TAB_INTP "%10.1" "Unit_DegreCelsi" COMPU_TAB_REF CM_BMC_CMC_Temperatur_081 STATUS_STRING_REF CM_BMC_CMC_Temperatur_081.StatusText /end COMPU_METHOD
/begin COMPU_METHOD CM_BMC_CMC_Temperatur_082 "" TAB_INTP "%10.1" "Unit_DegreCelsi" COMPU_TAB_REF CM_BMC_CMC_Temperatur_082 STATUS_STRING_REF CM_BMC_CMC_Temperatur_082.StatusText /end COMPU_METHOD
/begin COMPU_METHOD CanIf_ControllerModeEnum "" TAB_VERB "%10.1" "" COMPU_TAB_REF CanIf_ControllerModeEnum /end COMPU_METHOD
/begin COMPU_METHOD CanIf_PduGetModeEnum "" TAB_VERB "%10.1" "" COMPU_TAB_REF CanIf_PduGetModeEnum /end COMPU_METHOD
/begin COMPU_METHOD CanNm_ComControlEnabledOfChannelConfigType "" TAB_VERB "%10.1" "" COMPU_TAB_REF CanNm_ComControlEnabledOfChannelConfigType /end COMPU_METHOD
/begin COMPU_METHOD CanNm_MsgConfirmationFlagType "" TAB_VERB "%10.1" "" COMPU_TAB_REF CanNm_MsgConfirmationFlagType /end COMPU_METHOD
/begin COMPU_METHOD CanNm_MsgIndicationFlagType "" TAB_VERB "%10.1" "" COMPU_TAB_REF CanNm_MsgIndicationFlagType /end COMPU_METHOD
/begin COMPU_METHOD CanNm_PnClusterResetTimerEndIdxOfPnInfoByteConfigType "" TAB_VERB "%10.1" "" COMPU_TAB_REF CanNm_PnClusterResetTimerEndIdxOfPnInfoByteConfigType /end COMPU_METHOD
/begin COMPU_METHOD CanNm_PnClusterResetTimerStartIdxOfPnInfoByteConfigType "" TAB_VERB "%10.1" "" COMPU_TAB_REF CanNm_PnClusterResetTimerStartIdxOfPnInfoByteConfigType /end COMPU_METHOD
/begin COMPU_METHOD CanNm_PnEnabledOfPbChannelConfigType "" TAB_VERB "%10.1" "" COMPU_TAB_REF CanNm_PnEnabledOfPbChannelConfigType /end COMPU_METHOD
/begin COMPU_METHOD CanNm_PnMessageFilterDeactivationIndicatedType "" TAB_VERB "%10.1" "" COMPU_TAB_REF CanNm_PnMessageFilterDeactivationIndicatedType /end COMPU_METHOD
/begin COMPU_METHOD CanNm_PnMessageFilterEnabledType "" TAB_VERB "%10.1" "" COMPU_TAB_REF CanNm_PnMessageFilterEnabledType /end COMPU_METHOD
/begin COMPU_METHOD CanNm_RxMessageDataEndIdxOfPbChannelConfigType "" TAB_VERB "%10.1" "" COMPU_TAB_REF CanNm_RxMessageDataEndIdxOfPbChannelConfigType /end COMPU_METHOD
/begin COMPU_METHOD CanNm_RxMessageDataStartIdxOfPbChannelConfigType "" TAB_VERB "%10.1" "" COMPU_TAB_REF CanNm_RxMessageDataStartIdxOfPbChannelConfigType /end COMPU_METHOD
/begin COMPU_METHOD CanNm_RxMessageData_CBVIdxOfPbChannelConfigType "" TAB_VERB "%10.1" "" COMPU_TAB_REF CanNm_RxMessageData_CBVIdxOfPbChannelConfigType /end COMPU_METHOD
/begin COMPU_METHOD CanNm_RxMessageData_NIDIdxOfPbChannelConfigType "" TAB_VERB "%10.1" "" COMPU_TAB_REF CanNm_RxMessageData_NIDIdxOfPbChannelConfigType /end COMPU_METHOD
/begin COMPU_METHOD CanNm_RxMessageData_UserDataEndIdxOfPbChannelConfigType "" TAB_VERB "%10.1" "" COMPU_TAB_REF CanNm_RxMessageData_UserDataEndIdxOfPbChannelConfigType /end COMPU_METHOD
/begin COMPU_METHOD CanNm_RxMessageData_UserDataStartIdxOfPbChannelConfigType "" TAB_VERB "%10.1" "" COMPU_TAB_REF CanNm_RxMessageData_UserDataStartIdxOfPbChannelConfigType /end COMPU_METHOD
/begin COMPU_METHOD CanNm_SysToNmChIndType "" TAB_VERB "%10.1" "" COMPU_TAB_REF CanNm_SysToNmChIndType /end COMPU_METHOD
/begin COMPU_METHOD CanNm_TxMessageDataEndIdxOfPbChannelConfigType "" TAB_VERB "%10.1" "" COMPU_TAB_REF CanNm_TxMessageDataEndIdxOfPbChannelConfigType /end COMPU_METHOD
/begin COMPU_METHOD CanNm_TxMessageDataStartIdxOfPbChannelConfigType "" TAB_VERB "%10.1" "" COMPU_TAB_REF CanNm_TxMessageDataStartIdxOfPbChannelConfigType /end COMPU_METHOD
/begin COMPU_METHOD CanNm_TxMessageData_CBVIdxOfPbChannelConfigType "" TAB_VERB "%10.1" "" COMPU_TAB_REF CanNm_TxMessageData_CBVIdxOfPbChannelConfigType /end COMPU_METHOD
/begin COMPU_METHOD CanNm_TxMessageData_NIDIdxOfPbChannelConfigType "" TAB_VERB "%10.1" "" COMPU_TAB_REF CanNm_TxMessageData_NIDIdxOfPbChannelConfigType /end COMPU_METHOD
/begin COMPU_METHOD CanNm_TxMessageData_PnFilterMaskEndIdxOfPbChannelConfigType "" TAB_VERB "%10.1" "" COMPU_TAB_REF CanNm_TxMessageData_PnFilterMaskEndIdxOfPbChannelConfigType /end COMPU_METHOD
/begin COMPU_METHOD CanNm_TxMessageData_PnFilterMaskStartIdxOfPbChannelConfigType "" TAB_VERB "%10.1" "" COMPU_TAB_REF CanNm_TxMessageData_PnFilterMaskStartIdxOfPbChannelConfigType /end COMPU_METHOD
/begin COMPU_METHOD CanNm_TxMessageData_UserDataEndIdxOfPbChannelConfigType "" TAB_VERB "%10.1" "" COMPU_TAB_REF CanNm_TxMessageData_UserDataEndIdxOfPbChannelConfigType /end COMPU_METHOD
/begin COMPU_METHOD CanNm_TxMessageData_UserDataStartIdxOfPbChannelConfigType "" TAB_VERB "%10.1" "" COMPU_TAB_REF CanNm_TxMessageData_UserDataStartIdxOfPbChannelConfigType /end COMPU_METHOD
/begin COMPU_METHOD CanNm_TxPduIdOfPbChannelConfigType "" TAB_VERB "%10.1" "" COMPU_TAB_REF CanNm_TxPduIdOfPbChannelConfigType /end COMPU_METHOD
/begin COMPU_METHOD CanNm_TxUserDataPduIdOfPbChannelConfigType "" TAB_VERB "%10.1" "" COMPU_TAB_REF CanNm_TxUserDataPduIdOfPbChannelConfigType /end COMPU_METHOD
/begin COMPU_VTAB BswM_ActionListQueueOfPCPartitionConfigType "" TAB_VERB 1 0 "NULL_PTR" /end COMPU_VTAB
/begin COMPU_VTAB BswM_ActionListsOfPCPartitionConfigType "" TAB_VERB 1 0 "NULL_PTR" /end COMPU_VTAB
/begin COMPU_VTAB BswM_CanSMChannelMappingOfPCPartitionConfigType "" TAB_VERB 1 0 "NULL_PTR" /end COMPU_VTAB
/begin COMPU_VTAB BswM_CanSMChannelStateOfPCPartitionConfigType "" TAB_VERB 1 0 "NULL_PTR" /end COMPU_VTAB
/begin COMPU_VTAB BswM_ComMChannelMappingOfPCPartitionConfigType "" TAB_VERB 1 0 "NULL_PTR" /end COMPU_VTAB
/begin COMPU_VTAB BswM_ComMChannelStateOfPCPartitionConfigType "" TAB_VERB 1 0 "NULL_PTR" /end COMPU_VTAB
/begin COMPU_VTAB BswM_ComMPncMappingOfPCPartitionConfigType "" TAB_VERB 1 0 "NULL_PTR" /end COMPU_VTAB
/begin COMPU_VTAB BswM_ComMPncStateOfPCPartitionConfigType "" TAB_VERB 1 0 "NULL_PTR" /end COMPU_VTAB
/begin COMPU_VTAB BswM_CoreSyncValueOfPCPartitionConfigType "" TAB_VERB 1 0 "NULL_PTR" /end COMPU_VTAB
/begin COMPU_VTAB BswM_DeferredRulesOfPCPartitionConfigType "" TAB_VERB 1 0 "NULL_PTR" /end COMPU_VTAB
/begin COMPU_VTAB BswM_ESH_Mode "" TAB_VERB 5 0 "STARTUP" 1 "RUN" 2 "POSTRUN" 3 "WAKEUP" 4 "SHUTDOWN" /end COMPU_VTAB
/begin COMPU_VTAB BswM_ESH_RunRequest "" TAB_VERB 2 0 "RELEASED" 1 "REQUESTED" /end COMPU_VTAB
/begin COMPU_VTAB BswM_ForcedActionListPriorityOfPCPartitionConfigType "" TAB_VERB 1 0 "NULL_PTR" /end COMPU_VTAB
/begin COMPU_VTAB BswM_GenericMappingOfPCPartitionConfigType "" TAB_VERB 1 0 "NULL_PTR" /end COMPU_VTAB
/begin COMPU_VTAB BswM_GenericStateOfPCPartitionConfigType "" TAB_VERB 1 0 "NULL_PTR" /end COMPU_VTAB
/begin COMPU_VTAB BswM_ImmediateUserOfPCPartitionConfigType "" TAB_VERB 1 0 "NULL_PTR" /end COMPU_VTAB
/begin COMPU_VTAB BswM_InitGenVarAndInitALOfPCPartitionConfigType "" TAB_VERB 1 0 "NULL_PTR" /end COMPU_VTAB
/begin COMPU_VTAB BswM_InitSyncCalloutOfPCPartitionConfigType "" TAB_VERB 1 0 "NULL_PTR" /end COMPU_VTAB
/begin COMPU_VTAB BswM_InitializedOfPCPartitionConfigType "" TAB_VERB 1 0 "NULL_PTR" /end COMPU_VTAB
/begin COMPU_VTAB_RANGE BswM_InitializedType "" 2 0 0 "FALSE" 1 255 "TRUE" /end COMPU_VTAB_RANGE
/begin COMPU_VTAB BswM_ModeNotificationFctOfPCPartitionConfigType "" TAB_VERB 1 0 "NULL_PTR" /end COMPU_VTAB
/begin COMPU_VTAB BswM_ModeRequestQueueOfPCPartitionConfigType "" TAB_VERB 1 0 "NULL_PTR" /end COMPU_VTAB
/begin COMPU_VTAB BswM_NvMJobMappingOfPCPartitionConfigType "" TAB_VERB 1 0 "NULL_PTR" /end COMPU_VTAB
/begin COMPU_VTAB BswM_NvMJobStateOfPCPartitionConfigType "" TAB_VERB 1 0 "NULL_PTR" /end COMPU_VTAB
/begin COMPU_VTAB_RANGE BswM_OnInitOfImmediateUserType "" 2 0 0 "FALSE" 1 255 "TRUE" /end COMPU_VTAB_RANGE
/begin COMPU_VTAB BswM_QueueSemaphoreOfPCPartitionConfigType "" TAB_VERB 1 0 "NULL_PTR" /end COMPU_VTAB
/begin COMPU_VTAB BswM_QueueWrittenOfPCPartitionConfigType "" TAB_VERB 1 0 "NULL_PTR" /end COMPU_VTAB
/begin COMPU_VTAB_RANGE BswM_QueueWrittenType "" 2 0 0 "FALSE" 1 255 "TRUE" /end COMPU_VTAB_RANGE
/begin COMPU_VTAB BswM_RuleStatesOfPCPartitionConfigType "" TAB_VERB 1 0 "NULL_PTR" /end COMPU_VTAB
/begin COMPU_VTAB BswM_RulesIndEndIdxOfImmediateUserType "" TAB_VERB 1 255 "BSWM_NO_RULESINDENDIDXOFIMMEDIATEUSER" /end COMPU_VTAB
/begin COMPU_VTAB BswM_RulesIndOfPCPartitionConfigType "" TAB_VERB 1 0 "NULL_PTR" /end COMPU_VTAB
/begin COMPU_VTAB BswM_RulesIndStartIdxOfImmediateUserType "" TAB_VERB 1 255 "BSWM_NO_RULESINDSTARTIDXOFIMMEDIATEUSER" /end COMPU_VTAB
/begin COMPU_VTAB BswM_RulesOfPCPartitionConfigType "" TAB_VERB 1 0 "NULL_PTR" /end COMPU_VTAB
/begin COMPU_VTAB BswM_SwcModeRequestUpdateFctOfPCPartitionConfigType "" TAB_VERB 1 0 "NULL_PTR" /end COMPU_VTAB
/begin COMPU_VTAB BswM_TimerStateOfPCPartitionConfigType "" TAB_VERB 1 0 "NULL_PTR" /end COMPU_VTAB
/begin COMPU_VTAB BswM_TimerValueOfPCPartitionConfigType "" TAB_VERB 1 0 "NULL_PTR" /end COMPU_VTAB
/begin COMPU_VTAB CM_AB_Deaktivierung_HV "" TAB_VERB 8 0 "CM_AB_Deaktivierung_HV_Cx0_keine_Deaktivierung" 1 "CM_AB_Deaktivierung_HV_Cx1_Deaktivierung_1" 2 "CM_AB_Deaktivierung_HV_Cx2_Deaktivierung_2" 3 "CM_AB_Deaktivierung_HV_Cx3_Deaktivierung_3" 4 "CM_AB_Deaktivierung_HV_Cx4_Deaktivierung_4" 5 "CM_AB_Deaktivierung_HV_Cx5_Deaktivierung_5" 6 "CM_AB_Deaktivierung_HV_Cx6_Deaktivierung_6" 7 "CM_AB_Deaktivierung_HV_Cx7_Fehler" /end COMPU_VTAB
/begin COMPU_VTAB CM_AckType "" TAB_VERB 12 0 "BapAck_Property_DataSetGet" 1 "BapAck_Array_DataSetGet" 2 "BapAck_Property_DataSet" 3 "BapAck_Array_DataSet" 4 "BapAck_Method_Start" 5 "BapAck_Method_StartResult" 6 "BapAck_Method_Abort" 7 "BapAck_Property_DataGet" 8 "BapAck_Array_DataGet" 9 "BapAck_Cache_DataGet" 10 "BapAck_Property_Ack" 20 "BapAck_Nothing" /end COMPU_VTAB
/begin COMPU_TAB CM_Anzeige_SOC "" TAB_INTP 2 0 0 1000 100 /end COMPU_TAB
/begin COMPU_VTAB CM_Anzeige_SOC.StatusText "" TAB_VERB 23 1001 "CM_Anzeige_SOC_Cx3e9_reserviert" 1002 "CM_Anzeige_SOC_Cx3ea_reserviert" 1003 "CM_Anzeige_SOC_Cx3eb_reserviert" 1004 "CM_Anzeige_SOC_Cx3ec_reserviert" 1005 "CM_Anzeige_SOC_Cx3ed_reserviert" 1006 "CM_Anzeige_SOC_Cx3ee_reserviert" 1007 "CM_Anzeige_SOC_Cx3ef_reserviert" 1008 "CM_Anzeige_SOC_Cx3f0_reserviert" 1009 "CM_Anzeige_SOC_Cx3f1_reserviert" 1010 "CM_Anzeige_SOC_Cx3f2_reserviert" 1011 "CM_Anzeige_SOC_Cx3f3_reserviert" 1012 "CM_Anzeige_SOC_Cx3f4_reserviert" 1013 "CM_Anzeige_SOC_Cx3f5_reserviert" 1014 "CM_Anzeige_SOC_Cx3f6_reserviert" 1015 "CM_Anzeige_SOC_Cx3f7_reserviert" 1016 "CM_Anzeige_SOC_Cx3f8_reserviert" 1017 "CM_Anzeige_SOC_Cx3f9_reserviert" 1018 "CM_Anzeige_SOC_Cx3fa_reserviert" 1019 "CM_Anzeige_SOC_Cx3fb_reserviert" 1020 "CM_Anzeige_SOC_Cx3fc_reserviert" 1021 "CM_Anzeige_SOC_Cx3fd_reserviert" 1022 "CM_Anzeige_SOC_Cx3fe_Init" 1023 "CM_Anzeige_SOC_Cx3ff_Fehler" /end COMPU_VTAB
/begin COMPU_VTAB CM_BJB_CALID_Index_01 "" TAB_VERB 1 0 "CM_BJB_CALID_Index_01_Cx0_Init" /end COMPU_VTAB
/begin COMPU_VTAB CM_BJB_CALID_Index_02 "" TAB_VERB 1 0 "CM_BJB_CALID_Index_02_Cx0_Init" /end COMPU_VTAB
/begin COMPU_VTAB CM_BJB_CALID_Index_03 "" TAB_VERB 1 0 "CM_BJB_CALID_Index_03_Cx0_Init" /end COMPU_VTAB
/begin COMPU_VTAB CM_BJB_CALID_Index_04 "" TAB_VERB 1 0 "CM_BJB_CALID_Index_04_Cx0_Init" /end COMPU_VTAB
/begin COMPU_VTAB CM_BJB_CALID_Index_05 "" TAB_VERB 1 0 "CM_BJB_CALID_Index_05_Cx0_Init" /end COMPU_VTAB
/begin COMPU_VTAB CM_BJB_CALID_Index_06 "" TAB_VERB 1 0 "CM_BJB_CALID_Index_06_Cx0_Init" /end COMPU_VTAB
/begin COMPU_VTAB CM_BJB_CALID_Index_07 "" TAB_VERB 1 0 "CM_BJB_CALID_Index_07_Cx0_Init" /end COMPU_VTAB
/begin COMPU_VTAB CM_BJB_CALID_Index_08 "" TAB_VERB 1 0 "CM_BJB_CALID_Index_08_Cx0_Init" /end COMPU_VTAB
/begin COMPU_VTAB CM_BJB_CALID_Index_09 "" TAB_VERB 1 0 "CM_BJB_CALID_Index_09_Cx0_Init" /end COMPU_VTAB
/begin COMPU_VTAB CM_BJB_CALID_Index_10 "" TAB_VERB 1 0 "CM_BJB_CALID_Index_10_Cx0_Init" /end COMPU_VTAB
/begin COMPU_VTAB CM_BJB_CALID_Index_11 "" TAB_VERB 1 0 "CM_BJB_CALID_Index_11_Cx0_Init" /end COMPU_VTAB
/begin COMPU_VTAB CM_BJB_CALID_Index_12 "" TAB_VERB 1 0 "CM_BJB_CALID_Index_12_Cx0_Init" /end COMPU_VTAB
/begin COMPU_VTAB CM_BJB_CALID_Index_13 "" TAB_VERB 1 0 "CM_BJB_CALID_Index_13_Cx0_Init" /end COMPU_VTAB
/begin COMPU_VTAB CM_BJB_CALID_Index_14 "" TAB_VERB 1 0 "CM_BJB_CALID_Index_14_Cx0_Init" /end COMPU_VTAB
/begin COMPU_VTAB CM_BJB_CALID_Index_15 "" TAB_VERB 1 0 "CM_BJB_CALID_Index_15_Cx0_Init" /end COMPU_VTAB
/begin COMPU_VTAB CM_BJB_CALID_Index_16 "" TAB_VERB 1 0 "CM_BJB_CALID_Index_16_Cx0_Init" /end COMPU_VTAB
/begin COMPU_TAB CM_BJB_CVN_Byte_1 "" TAB_INTP 2 0 0 255 255 /end COMPU_TAB
/begin COMPU_TAB CM_BJB_CVN_Byte_2 "" TAB_INTP 2 0 0 255 255 /end COMPU_TAB
/begin COMPU_TAB CM_BJB_CVN_Byte_3 "" TAB_INTP 2 0 0 255 255 /end COMPU_TAB
/begin COMPU_TAB CM_BJB_CVN_Byte_4 "" TAB_INTP 2 0 0 255 255 /end COMPU_TAB
/begin COMPU_VTAB CM_BJB_CVN_VLD "" TAB_VERB 2 0 "CM_BJB_CVN_VLD_Cx0_Ungueltig" 1 "CM_BJB_CVN_VLD_Cx1_Gueltig" /end COMPU_VTAB
/begin COMPU_VTAB CM_BJB_ErrMem_State "" TAB_VERB 3 1 "CM_BJB_ErrMem_State_Cx1_ErrMem_Active" 2 "CM_BJB_ErrMem_State_Cx2_ErrMem_Init_Progress" 3 "CM_BJB_ErrMem_State_Cx3_ErrMem_Init_Done" /end COMPU_VTAB
/begin COMPU_TAB CM_BJB_Lebensdauer_Trennelemente "" TAB_INTP 2 0 0 100000 100000 /end COMPU_TAB
/begin COMPU_VTAB CM_BJB_Lebensdauer_Trennelemente.StatusText "" TAB_VERB 2 131070 "CM_BJB_Lebensdauer_Trennelemente_Cx1fffe_InitWert" 131071 "CM_BJB_Lebensdauer_Trennelemente_Cx1ffff_Fehler" /end COMPU_VTAB
/begin COMPU_VTAB CM_BJB_Sperrung_Ueberspannung "" TAB_VERB 4 0 "CM_BJB_Sperrung_Ueberspannung_Cx0_keine_Sperrung" 1 "CM_BJB_Sperrung_Ueberspannung_Cx1_Sperrung" 2 "CM_BJB_Sperrung_Ueberspannung_Cx2_InitWert" 3 "CM_BJB_Sperrung_Ueberspannung_Cx3_Fehler" /end COMPU_VTAB
/begin COMPU_VTAB CM_BJB_Sperrung_Uebertemperatur "" TAB_VERB 4 0 "CM_BJB_Sperrung_Uebertemperatur_Cx0_keine_Sperrung" 1 "CM_BJB_Sperrung_Uebertemperatur_Cx1_Sperrung" 2 "CM_BJB_Sperrung_Uebertemperatur_Cx2_InitWert" 3 "CM_BJB_Sperrung_Uebertemperatur_Cx3_Fehler" /end COMPU_VTAB
/begin COMPU_VTAB CM_BJB_Sperrung_Unterspannung "" TAB_VERB 4 0 "CM_BJB_Sperrung_Unterspannung_Cx0_keine_Sperrung" 1 "CM_BJB_Sperrung_Unterspannung_Cx1_Sperrung" 2 "CM_BJB_Sperrung_Unterspannung_Cx2_InitWert" 3 "CM_BJB_Sperrung_Unterspannung_Cx3_Fehler" /end COMPU_VTAB
/begin COMPU_VTAB CM_BJB_Status_HV_Spannungssensorik "" TAB_VERB 2 0 "CM_BJB_Status_HV_Spannungssensorik_Cx0_InitWert_kein_Fehler" 1 "CM_BJB_Status_HV_Spannungssensorik_Cx1_Fehler" /end COMPU_VTAB
/begin COMPU_VTAB CM_BJB_Status_Trennelemente "" TAB_VERB 6 0 "CM_BJB_Status_Trennelemente_Cx0_kein_Fehler" 1 "CM_BJB_Status_Trennelemente_Cx1_Haupt_TrEl_klemmt_geschl" 2 "CM_BJB_Status_Trennelemente_Cx2_AC_TrEl_klemmt_geschl" 3 "CM_BJB_Status_Trennelemente_Cx3_Haupt_und_AC_TrEl_klemmt_geschl" 6 "CM_BJB_Status_Trennelemente_Cx6_InitWert" 7 "CM_BJB_Status_Trennelemente_Cx7_Fehler" /end COMPU_VTAB
/begin COMPU_TAB CM_BJB_Ueberspannungszaehler_CMC01 "" TAB_INTP 2 0 0 400 400 /end COMPU_TAB
/begin COMPU_VTAB CM_BJB_Ueberspannungszaehler_CMC01.StatusText "" TAB_VERB 2 510 "CM_BJB_Ueberspannungszaehler_CMC01_Cx1fe_InitWert" 511 "CM_BJB_Ueberspannungszaehler_CMC01_Cx1ff_Fehler" /end COMPU_VTAB
/begin COMPU_TAB CM_BJB_Ueberspannungszaehler_CMC02 "" TAB_INTP 2 0 0 400 400 /end COMPU_TAB
/begin COMPU_VTAB CM_BJB_Ueberspannungszaehler_CMC02.StatusText "" TAB_VERB 2 510 "CM_BJB_Ueberspannungszaehler_CMC02_Cx1fe_InitWert" 511 "CM_BJB_Ueberspannungszaehler_CMC02_Cx1ff_Fehler" /end COMPU_VTAB
/begin COMPU_TAB CM_BJB_Ueberspannungszaehler_CMC03 "" TAB_INTP 2 0 0 400 400 /end COMPU_TAB
/begin COMPU_VTAB CM_BJB_Ueberspannungszaehler_CMC03.StatusText "" TAB_VERB 2 510 "CM_BJB_Ueberspannungszaehler_CMC03_Cx1fe_InitWert" 511 "CM_BJB_Ueberspannungszaehler_CMC03_Cx1ff_Fehler" /end COMPU_VTAB
/begin COMPU_TAB CM_BJB_Ueberspannungszaehler_CMC04 "" TAB_INTP 2 0 0 400 400 /end COMPU_TAB
/begin COMPU_VTAB CM_BJB_Ueberspannungszaehler_CMC04.StatusText "" TAB_VERB 2 510 "CM_BJB_Ueberspannungszaehler_CMC04_Cx1fe_InitWert" 511 "CM_BJB_Ueberspannungszaehler_CMC04_Cx1ff_Fehler" /end COMPU_VTAB
/begin COMPU_TAB CM_BJB_Uebertemperaturzaehler_CMC01 "" TAB_INTP 2 0 0 60480 604800 /end COMPU_TAB
/begin COMPU_VTAB CM_BJB_Uebertemperaturzaehler_CMC01.StatusText "" TAB_VERB 2 65534 "CM_BJB_Uebertemperaturzaehler_CMC01_Cxfffe_InitWert" 65535 "CM_BJB_Uebertemperaturzaehler_CMC01_Cxffff_Fehler" /end COMPU_VTAB
/begin COMPU_TAB CM_BJB_Uebertemperaturzaehler_CMC02 "" TAB_INTP 2 0 0 60480 604800 /end COMPU_TAB
/begin COMPU_VTAB CM_BJB_Uebertemperaturzaehler_CMC02.StatusText "" TAB_VERB 2 65534 "CM_BJB_Uebertemperaturzaehler_CMC02_Cxfffe_InitWert" 65535 "CM_BJB_Uebertemperaturzaehler_CMC02_Cxffff_Fehler" /end COMPU_VTAB
/begin COMPU_TAB CM_BJB_Uebertemperaturzaehler_CMC03 "" TAB_INTP 2 0 0 60480 604800 /end COMPU_TAB
/begin COMPU_VTAB CM_BJB_Uebertemperaturzaehler_CMC03.StatusText "" TAB_VERB 2 65534 "CM_BJB_Uebertemperaturzaehler_CMC03_Cxfffe_InitWert" 65535 "CM_BJB_Uebertemperaturzaehler_CMC03_Cxffff_Fehler" /end COMPU_VTAB
/begin COMPU_TAB CM_BJB_Uebertemperaturzaehler_CMC04 "" TAB_INTP 2 0 0 60480 604800 /end COMPU_TAB
/begin COMPU_VTAB CM_BJB_Uebertemperaturzaehler_CMC04.StatusText "" TAB_VERB 2 65534 "CM_BJB_Uebertemperaturzaehler_CMC04_Cxfffe_InitWert" 65535 "CM_BJB_Uebertemperaturzaehler_CMC04_Cxffff_Fehler" /end COMPU_VTAB
/begin COMPU_TAB CM_BJB_Unterspannungszaehler_CMC01 "" TAB_INTP 2 0 0 400 400 /end COMPU_TAB
/begin COMPU_VTAB CM_BJB_Unterspannungszaehler_CMC01.StatusText "" TAB_VERB 2 510 "CM_BJB_Unterspannungszaehler_CMC01_Cx1fe_InitWert" 511 "CM_BJB_Unterspannungszaehler_CMC01_Cx1ff_Fehler" /end COMPU_VTAB
/begin COMPU_TAB CM_BJB_Unterspannungszaehler_CMC02 "" TAB_INTP 2 0 0 400 400 /end COMPU_TAB
/begin COMPU_VTAB CM_BJB_Unterspannungszaehler_CMC02.StatusText "" TAB_VERB 2 510 "CM_BJB_Unterspannungszaehler_CMC02_Cx1fe_InitWert" 511 "CM_BJB_Unterspannungszaehler_CMC02_Cx1ff_Fehler" /end COMPU_VTAB
/begin COMPU_TAB CM_BJB_Unterspannungszaehler_CMC03 "" TAB_INTP 2 0 0 400 400 /end COMPU_TAB
/begin COMPU_VTAB CM_BJB_Unterspannungszaehler_CMC03.StatusText "" TAB_VERB 2 510 "CM_BJB_Unterspannungszaehler_CMC03_Cx1fe_InitWert" 511 "CM_BJB_Unterspannungszaehler_CMC03_Cx1ff_Fehler" /end COMPU_VTAB
/begin COMPU_TAB CM_BJB_Unterspannungszaehler_CMC04 "" TAB_INTP 2 0 0 400 400 /end COMPU_TAB
/begin COMPU_VTAB CM_BJB_Unterspannungszaehler_CMC04.StatusText "" TAB_VERB 2 510 "CM_BJB_Unterspannungszaehler_CMC04_Cx1fe_InitWert" 511 "CM_BJB_Unterspannungszaehler_CMC04_Cx1ff_Fehler" /end COMPU_VTAB
/begin COMPU_VTAB CM_BMC_AC_Laden "" TAB_VERB 4 0 "CM_BMC_AC_Laden_Cx0_Init" 1 "CM_BMC_AC_Laden_Cx1_nicht_vorhanden" 2 "CM_BMC_AC_Laden_Cx2_vorhanden" 3 "CM_BMC_AC_Laden_Cx3_Fehler" /end COMPU_VTAB
/begin COMPU_TAB CM_BMC_Abschaltankuendigung "" TAB_INTP 2 0 0 1021 510.5 /end COMPU_TAB
/begin COMPU_VTAB CM_BMC_Abschaltankuendigung.StatusText "" TAB_VERB 2 1022 "CM_BMC_Abschaltankuendigung_Cx3fe_keine_Abschaltung" 1023 "CM_BMC_Abschaltankuendigung_Cx3ff_Fehler" /end COMPU_VTAB
/begin COMPU_VTAB CM_BMC_Bank_Notlauf_erlaubt "" TAB_VERB 2 0 "CM_BMC_Bank_Notlauf_erlaubt_Cx0_inaktiv" 1 "CM_BMC_Bank_Notlauf_erlaubt_Cx1_aktiv" /end COMPU_VTAB
/begin COMPU_VTAB CM_BMC_Bank_parallel_erlaubt "" TAB_VERB 2 0 "CM_BMC_Bank_parallel_erlaubt_Cx0_inaktiv" 1 "CM_BMC_Bank_parallel_erlaubt_Cx1_aktiv" /end COMPU_VTAB
/begin COMPU_VTAB CM_BMC_Bank_seriell_erlaubt "" TAB_VERB 2 0 "CM_BMC_Bank_seriell_erlaubt_Cx0_inaktiv" 1 "CM_BMC_Bank_seriell_erlaubt_Cx1_aktiv" /end COMPU_VTAB
/begin COMPU_VTAB CM_BMC_Bankstatus "" TAB_VERB 8 0 "CM_BMC_Bankstatus_Cx0_Keine_Bank_aktiv" 1 "CM_BMC_Bankstatus_Cx1_800V_Seriellbetrieb" 2 "CM_BMC_Bankstatus_Cx2_400V_Parallelbetrieb" 3 "CM_BMC_Bankstatus_Cx3_400V_Ausgleichsbetrieb" 4 "CM_BMC_Bankstatus_Cx4_400V_Notlaufbetrieb_Bank0" 5 "CM_BMC_Bankstatus_Cx5_400V_Notlaufbetrieb_Bank1" 14 "CM_BMC_Bankstatus_Cxe_Init" 15 "CM_BMC_Bankstatus_Cxf_Fehler" /end COMPU_VTAB
/begin COMPU_TAB CM_BMC_Bidi_Energie_Absolut "" TAB_INTP 2 0 0 65533 65533 /end COMPU_TAB
/begin COMPU_VTAB CM_BMC_Bidi_Energie_Absolut.StatusText "" TAB_VERB 2 65534 "CM_BMC_Bidi_Energie_Absolut_Cxfffe_Init" 65535 "CM_BMC_Bidi_Energie_Absolut_Cxffff_Fehler" /end COMPU_VTAB
/begin COMPU_TAB CM_BMC_Bidi_GenutzteEnergie "" TAB_INTP 2 0 0 65533 65533 /end COMPU_TAB
/begin COMPU_VTAB CM_BMC_Bidi_GenutzteEnergie.StatusText "" TAB_VERB 2 65534 "CM_BMC_Bidi_GenutzteEnergie_Cxfffe_Init" 65535 "CM_BMC_Bidi_GenutzteEnergie_Cxffff_Fehler" /end COMPU_VTAB
/begin COMPU_TAB CM_BMC_Bidi_Max_SoC "" TAB_INTP 2 0 0 100 100 /end COMPU_TAB
/begin COMPU_VTAB CM_BMC_Bidi_Max_SoC.StatusText "" TAB_VERB 2 126 "CM_BMC_Bidi_Max_SoC_Cx7e_Init" 127 "CM_BMC_Bidi_Max_SoC_Cx7f_Fehler" /end COMPU_VTAB
/begin COMPU_TAB CM_BMC_Bidi_Min_SoC "" TAB_INTP 2 0 0 100 100 /end COMPU_TAB
/begin COMPU_VTAB CM_BMC_Bidi_Min_SoC.StatusText "" TAB_VERB 2 126 "CM_BMC_Bidi_Min_SoC_Cx7e_Init" 127 "CM_BMC_Bidi_Min_SoC_Cx7f_Fehler" /end COMPU_VTAB
/begin COMPU_TAB CM_BMC_CMC_Temperatur_001 "" TAB_INTP 2 0 -40 252 86 /end COMPU_TAB
/begin COMPU_VTAB CM_BMC_CMC_Temperatur_001.StatusText "" TAB_VERB 3 253 "CM_BMC_CMC_Temperatur_001_Cxfd_nicht_vorhanden" 254 "CM_BMC_CMC_Temperatur_001_Cxfe_Init" 255 "CM_BMC_CMC_Temperatur_001_Cxff_Fehler" /end COMPU_VTAB
/begin COMPU_TAB CM_BMC_CMC_Temperatur_002 "" TAB_INTP 2 0 -40 252 86 /end COMPU_TAB
/begin COMPU_VTAB CM_BMC_CMC_Temperatur_002.StatusText "" TAB_VERB 3 253 "CM_BMC_CMC_Temperatur_002_Cxfd_nicht_vorhanden" 254 "CM_BMC_CMC_Temperatur_002_Cxfe_Init" 255 "CM_BMC_CMC_Temperatur_002_Cxff_Fehler" /end COMPU_VTAB
/begin COMPU_TAB CM_BMC_CMC_Temperatur_003 "" TAB_INTP 2 0 -40 252 86 /end COMPU_TAB
/begin COMPU_VTAB CM_BMC_CMC_Temperatur_003.StatusText "" TAB_VERB 3 253 "CM_BMC_CMC_Temperatur_003_Cxfd_nicht_vorhanden" 254 "CM_BMC_CMC_Temperatur_003_Cxfe_Init" 255 "CM_BMC_CMC_Temperatur_003_Cxff_Fehler" /end COMPU_VTAB
/begin COMPU_TAB CM_BMC_CMC_Temperatur_004 "" TAB_INTP 2 0 -40 252 86 /end COMPU_TAB
/begin COMPU_VTAB CM_BMC_CMC_Temperatur_004.StatusText "" TAB_VERB 3 253 "CM_BMC_CMC_Temperatur_004_Cxfd_nicht_vorhanden" 254 "CM_BMC_CMC_Temperatur_004_Cxfe_Init" 255 "CM_BMC_CMC_Temperatur_004_Cxff_Fehler" /end COMPU_VTAB
/begin COMPU_TAB CM_BMC_CMC_Temperatur_005 "" TAB_INTP 2 0 -40 252 86 /end COMPU_TAB
/begin COMPU_VTAB CM_BMC_CMC_Temperatur_005.StatusText "" TAB_VERB 3 253 "CM_BMC_CMC_Temperatur_005_Cxfd_nicht_vorhanden" 254 "CM_BMC_CMC_Temperatur_005_Cxfe_Init" 255 "CM_BMC_CMC_Temperatur_005_Cxff_Fehler" /end COMPU_VTAB
/begin COMPU_TAB CM_BMC_CMC_Temperatur_006 "" TAB_INTP 2 0 -40 252 86 /end COMPU_TAB
/begin COMPU_VTAB CM_BMC_CMC_Temperatur_006.StatusText "" TAB_VERB 3 253 "CM_BMC_CMC_Temperatur_006_Cxfd_nicht_vorhanden" 254 "CM_BMC_CMC_Temperatur_006_Cxfe_Init" 255 "CM_BMC_CMC_Temperatur_006_Cxff_Fehler" /end COMPU_VTAB
/begin COMPU_TAB CM_BMC_CMC_Temperatur_007 "" TAB_INTP 2 0 -40 252 86 /end COMPU_TAB
/begin COMPU_VTAB CM_BMC_CMC_Temperatur_007.StatusText "" TAB_VERB 3 253 "CM_BMC_CMC_Temperatur_007_Cxfd_nicht_vorhanden" 254 "CM_BMC_CMC_Temperatur_007_Cxfe_Init" 255 "CM_BMC_CMC_Temperatur_007_Cxff_Fehler" /end COMPU_VTAB
/begin COMPU_TAB CM_BMC_CMC_Temperatur_008 "" TAB_INTP 2 0 -40 252 86 /end COMPU_TAB
/begin COMPU_VTAB CM_BMC_CMC_Temperatur_008.StatusText "" TAB_VERB 3 253 "CM_BMC_CMC_Temperatur_008_Cxfd_nicht_vorhanden" 254 "CM_BMC_CMC_Temperatur_008_Cxfe_Init" 255 "CM_BMC_CMC_Temperatur_008_Cxff_Fehler" /end COMPU_VTAB
/begin COMPU_TAB CM_BMC_CMC_Temperatur_009 "" TAB_INTP 2 0 -40 252 86 /end COMPU_TAB
/begin COMPU_VTAB CM_BMC_CMC_Temperatur_009.StatusText "" TAB_VERB 3 253 "CM_BMC_CMC_Temperatur_009_Cxfd_nicht_vorhanden" 254 "CM_BMC_CMC_Temperatur_009_Cxfe_Init" 255 "CM_BMC_CMC_Temperatur_009_Cxff_Fehler" /end COMPU_VTAB
/begin COMPU_TAB CM_BMC_CMC_Temperatur_010 "" TAB_INTP 2 0 -40 252 86 /end COMPU_TAB
/begin COMPU_VTAB CM_BMC_CMC_Temperatur_010.StatusText "" TAB_VERB 3 253 "CM_BMC_CMC_Temperatur_010_Cxfd_nicht_vorhanden" 254 "CM_BMC_CMC_Temperatur_010_Cxfe_Init" 255 "CM_BMC_CMC_Temperatur_010_Cxff_Fehler" /end COMPU_VTAB
/begin COMPU_TAB CM_BMC_CMC_Temperatur_011 "" TAB_INTP 2 0 -40 252 86 /end COMPU_TAB
/begin COMPU_VTAB CM_BMC_CMC_Temperatur_011.StatusText "" TAB_VERB 3 253 "CM_BMC_CMC_Temperatur_011_Cxfd_nicht_vorhanden" 254 "CM_BMC_CMC_Temperatur_011_Cxfe_Init" 255 "CM_BMC_CMC_Temperatur_011_Cxff_Fehler" /end COMPU_VTAB
/begin COMPU_TAB CM_BMC_CMC_Temperatur_012 "" TAB_INTP 2 0 -40 252 86 /end COMPU_TAB
/begin COMPU_VTAB CM_BMC_CMC_Temperatur_012.StatusText "" TAB_VERB 3 253 "CM_BMC_CMC_Temperatur_012_Cxfd_nicht_vorhanden" 254 "CM_BMC_CMC_Temperatur_012_Cxfe_Init" 255 "CM_BMC_CMC_Temperatur_012_Cxff_Fehler" /end COMPU_VTAB
/begin COMPU_TAB CM_BMC_CMC_Temperatur_013 "" TAB_INTP 2 0 -40 252 86 /end COMPU_TAB
/begin COMPU_VTAB CM_BMC_CMC_Temperatur_013.StatusText "" TAB_VERB 3 253 "CM_BMC_CMC_Temperatur_013_Cxfd_nicht_vorhanden" 254 "CM_BMC_CMC_Temperatur_013_Cxfe_Init" 255 "CM_BMC_CMC_Temperatur_013_Cxff_Fehler" /end COMPU_VTAB
/begin COMPU_TAB CM_BMC_CMC_Temperatur_014 "" TAB_INTP 2 0 -40 252 86 /end COMPU_TAB
/begin COMPU_VTAB CM_BMC_CMC_Temperatur_014.StatusText "" TAB_VERB 3 253 "CM_BMC_CMC_Temperatur_014_Cxfd_nicht_vorhanden" 254 "CM_BMC_CMC_Temperatur_014_Cxfe_Init" 255 "CM_BMC_CMC_Temperatur_014_Cxff_Fehler" /end COMPU_VTAB
/begin COMPU_TAB CM_BMC_CMC_Temperatur_015 "" TAB_INTP 2 0 -40 252 86 /end COMPU_TAB
/begin COMPU_VTAB CM_BMC_CMC_Temperatur_015.StatusText "" TAB_VERB 3 253 "CM_BMC_CMC_Temperatur_015_Cxfd_nicht_vorhanden" 254 "CM_BMC_CMC_Temperatur_015_Cxfe_Init" 255 "CM_BMC_CMC_Temperatur_015_Cxff_Fehler" /end COMPU_VTAB
/begin COMPU_TAB CM_BMC_CMC_Temperatur_016 "" TAB_INTP 2 0 -40 252 86 /end COMPU_TAB
/begin COMPU_VTAB CM_BMC_CMC_Temperatur_016.StatusText "" TAB_VERB 3 253 "CM_BMC_CMC_Temperatur_016_Cxfd_nicht_vorhanden" 254 "CM_BMC_CMC_Temperatur_016_Cxfe_Init" 255 "CM_BMC_CMC_Temperatur_016_Cxff_Fehler" /end COMPU_VTAB
/begin COMPU_TAB CM_BMC_CMC_Temperatur_017 "" TAB_INTP 2 0 -40 252 86 /end COMPU_TAB
/begin COMPU_VTAB CM_BMC_CMC_Temperatur_017.StatusText "" TAB_VERB 3 253 "CM_BMC_CMC_Temperatur_017_Cxfd_nicht_vorhanden" 254 "CM_BMC_CMC_Temperatur_017_Cxfe_Init" 255 "CM_BMC_CMC_Temperatur_017_Cxff_Fehler" /end COMPU_VTAB
/begin COMPU_TAB CM_BMC_CMC_Temperatur_018 "" TAB_INTP 2 0 -40 252 86 /end COMPU_TAB
/begin COMPU_VTAB CM_BMC_CMC_Temperatur_018.StatusText "" TAB_VERB 3 253 "CM_BMC_CMC_Temperatur_018_Cxfd_nicht_vorhanden" 254 "CM_BMC_CMC_Temperatur_018_Cxfe_Init" 255 "CM_BMC_CMC_Temperatur_018_Cxff_Fehler" /end COMPU_VTAB
/begin COMPU_TAB CM_BMC_CMC_Temperatur_019 "" TAB_INTP 2 0 -40 252 86 /end COMPU_TAB
/begin COMPU_VTAB CM_BMC_CMC_Temperatur_019.StatusText "" TAB_VERB 3 253 "CM_BMC_CMC_Temperatur_019_Cxfd_nicht_vorhanden" 254 "CM_BMC_CMC_Temperatur_019_Cxfe_Init" 255 "CM_BMC_CMC_Temperatur_019_Cxff_Fehler" /end COMPU_VTAB
/begin COMPU_TAB CM_BMC_CMC_Temperatur_01_Messzeit "" TAB_INTP 2 0 0 253 253 /end COMPU_TAB
/begin COMPU_VTAB CM_BMC_CMC_Temperatur_01_Messzeit.StatusText "" TAB_VERB 2 254 "CM_BMC_CMC_Temperatur_01_Messzeit_Cxfe_Init" 255 "CM_BMC_CMC_Temperatur_01_Messzeit_Cxff_Fehler" /end COMPU_VTAB
/begin COMPU_TAB CM_BMC_CMC_Temperatur_020 "" TAB_INTP 2 0 -40 252 86 /end COMPU_TAB
/begin COMPU_VTAB CM_BMC_CMC_Temperatur_020.StatusText "" TAB_VERB 3 253 "CM_BMC_CMC_Temperatur_020_Cxfd_nicht_vorhanden" 254 "CM_BMC_CMC_Temperatur_020_Cxfe_Init" 255 "CM_BMC_CMC_Temperatur_020_Cxff_Fehler" /end COMPU_VTAB
/begin COMPU_TAB CM_BMC_CMC_Temperatur_021 "" TAB_INTP 2 0 -40 252 86 /end COMPU_TAB
/begin COMPU_VTAB CM_BMC_CMC_Temperatur_021.StatusText "" TAB_VERB 3 253 "CM_BMC_CMC_Temperatur_021_Cxfd_nicht_vorhanden" 254 "CM_BMC_CMC_Temperatur_021_Cxfe_Init" 255 "CM_BMC_CMC_Temperatur_021_Cxff_Fehler" /end COMPU_VTAB
/begin COMPU_TAB CM_BMC_CMC_Temperatur_022 "" TAB_INTP 2 0 -40 252 86 /end COMPU_TAB
/begin COMPU_VTAB CM_BMC_CMC_Temperatur_022.StatusText "" TAB_VERB 3 253 "CM_BMC_CMC_Temperatur_022_Cxfd_nicht_vorhanden" 254 "CM_BMC_CMC_Temperatur_022_Cxfe_Init" 255 "CM_BMC_CMC_Temperatur_022_Cxff_Fehler" /end COMPU_VTAB
/begin COMPU_TAB CM_BMC_CMC_Temperatur_023 "" TAB_INTP 2 0 -40 252 86 /end COMPU_TAB
/begin COMPU_VTAB CM_BMC_CMC_Temperatur_023.StatusText "" TAB_VERB 3 253 "CM_BMC_CMC_Temperatur_023_Cxfd_nicht_vorhanden" 254 "CM_BMC_CMC_Temperatur_023_Cxfe_Init" 255 "CM_BMC_CMC_Temperatur_023_Cxff_Fehler" /end COMPU_VTAB
/begin COMPU_TAB CM_BMC_CMC_Temperatur_024 "" TAB_INTP 2 0 -40 252 86 /end COMPU_TAB
/begin COMPU_VTAB CM_BMC_CMC_Temperatur_024.StatusText "" TAB_VERB 3 253 "CM_BMC_CMC_Temperatur_024_Cxfd_nicht_vorhanden" 254 "CM_BMC_CMC_Temperatur_024_Cxfe_Init" 255 "CM_BMC_CMC_Temperatur_024_Cxff_Fehler" /end COMPU_VTAB
/begin COMPU_TAB CM_BMC_CMC_Temperatur_025 "" TAB_INTP 2 0 -40 252 86 /end COMPU_TAB
/begin COMPU_VTAB CM_BMC_CMC_Temperatur_025.StatusText "" TAB_VERB 3 253 "CM_BMC_CMC_Temperatur_025_Cxfd_nicht_vorhanden" 254 "CM_BMC_CMC_Temperatur_025_Cxfe_Init" 255 "CM_BMC_CMC_Temperatur_025_Cxff_Fehler" /end COMPU_VTAB
/begin COMPU_TAB CM_BMC_CMC_Temperatur_026 "" TAB_INTP 2 0 -40 252 86 /end COMPU_TAB
/begin COMPU_VTAB CM_BMC_CMC_Temperatur_026.StatusText "" TAB_VERB 3 253 "CM_BMC_CMC_Temperatur_026_Cxfd_nicht_vorhanden" 254 "CM_BMC_CMC_Temperatur_026_Cxfe_Init" 255 "CM_BMC_CMC_Temperatur_026_Cxff_Fehler" /end COMPU_VTAB
/begin COMPU_TAB CM_BMC_CMC_Temperatur_027 "" TAB_INTP 2 0 -40 252 86 /end COMPU_TAB
/begin COMPU_VTAB CM_BMC_CMC_Temperatur_027.StatusText "" TAB_VERB 3 253 "CM_BMC_CMC_Temperatur_027_Cxfd_nicht_vorhanden" 254 "CM_BMC_CMC_Temperatur_027_Cxfe_Init" 255 "CM_BMC_CMC_Temperatur_027_Cxff_Fehler" /end COMPU_VTAB
/begin COMPU_TAB CM_BMC_CMC_Temperatur_028 "" TAB_INTP 2 0 -40 252 86 /end COMPU_TAB
/begin COMPU_VTAB CM_BMC_CMC_Temperatur_028.StatusText "" TAB_VERB 3 253 "CM_BMC_CMC_Temperatur_028_Cxfd_nicht_vorhanden" 254 "CM_BMC_CMC_Temperatur_028_Cxfe_Init" 255 "CM_BMC_CMC_Temperatur_028_Cxff_Fehler" /end COMPU_VTAB
/begin COMPU_TAB CM_BMC_CMC_Temperatur_029 "" TAB_INTP 2 0 -40 252 86 /end COMPU_TAB
/begin COMPU_VTAB CM_BMC_CMC_Temperatur_029.StatusText "" TAB_VERB 3 253 "CM_BMC_CMC_Temperatur_029_Cxfd_nicht_vorhanden" 254 "CM_BMC_CMC_Temperatur_029_Cxfe_Init" 255 "CM_BMC_CMC_Temperatur_029_Cxff_Fehler" /end COMPU_VTAB
/begin COMPU_TAB CM_BMC_CMC_Temperatur_02_Messzeit "" TAB_INTP 2 0 0 253 253 /end COMPU_TAB
/begin COMPU_VTAB CM_BMC_CMC_Temperatur_02_Messzeit.StatusText "" TAB_VERB 2 254 "CM_BMC_CMC_Temperatur_02_Messzeit_Cxfe_Init" 255 "CM_BMC_CMC_Temperatur_02_Messzeit_Cxff_Fehler" /end COMPU_VTAB
/begin COMPU_TAB CM_BMC_CMC_Temperatur_030 "" TAB_INTP 2 0 -40 252 86 /end COMPU_TAB
/begin COMPU_VTAB CM_BMC_CMC_Temperatur_030.StatusText "" TAB_VERB 3 253 "CM_BMC_CMC_Temperatur_030_Cxfd_nicht_vorhanden" 254 "CM_BMC_CMC_Temperatur_030_Cxfe_Init" 255 "CM_BMC_CMC_Temperatur_030_Cxff_Fehler" /end COMPU_VTAB
/begin COMPU_TAB CM_BMC_CMC_Temperatur_031 "" TAB_INTP 2 0 -40 252 86 /end COMPU_TAB
/begin COMPU_VTAB CM_BMC_CMC_Temperatur_031.StatusText "" TAB_VERB 3 253 "CM_BMC_CMC_Temperatur_031_Cxfd_nicht_vorhanden" 254 "CM_BMC_CMC_Temperatur_031_Cxfe_Init" 255 "CM_BMC_CMC_Temperatur_031_Cxff_Fehler" /end COMPU_VTAB
/begin COMPU_TAB CM_BMC_CMC_Temperatur_032 "" TAB_INTP 2 0 -40 252 86 /end COMPU_TAB
/begin COMPU_VTAB CM_BMC_CMC_Temperatur_032.StatusText "" TAB_VERB 3 253 "CM_BMC_CMC_Temperatur_032_Cxfd_nicht_vorhanden" 254 "CM_BMC_CMC_Temperatur_032_Cxfe_Init" 255 "CM_BMC_CMC_Temperatur_032_Cxff_Fehler" /end COMPU_VTAB
/begin COMPU_TAB CM_BMC_CMC_Temperatur_033 "" TAB_INTP 2 0 -40 252 86 /end COMPU_TAB
/begin COMPU_VTAB CM_BMC_CMC_Temperatur_033.StatusText "" TAB_VERB 3 253 "CM_BMC_CMC_Temperatur_033_Cxfd_nicht_vorhanden" 254 "CM_BMC_CMC_Temperatur_033_Cxfe_Init" 255 "CM_BMC_CMC_Temperatur_033_Cxff_Fehler" /end COMPU_VTAB
/begin COMPU_TAB CM_BMC_CMC_Temperatur_034 "" TAB_INTP 2 0 -40 252 86 /end COMPU_TAB
/begin COMPU_VTAB CM_BMC_CMC_Temperatur_034.StatusText "" TAB_VERB 3 253 "CM_BMC_CMC_Temperatur_034_Cxfd_nicht_vorhanden" 254 "CM_BMC_CMC_Temperatur_034_Cxfe_Init" 255 "CM_BMC_CMC_Temperatur_034_Cxff_Fehler" /end COMPU_VTAB
/begin COMPU_TAB CM_BMC_CMC_Temperatur_035 "" TAB_INTP 2 0 -40 252 86 /end COMPU_TAB
/begin COMPU_VTAB CM_BMC_CMC_Temperatur_035.StatusText "" TAB_VERB 3 253 "CM_BMC_CMC_Temperatur_035_Cxfd_nicht_vorhanden" 254 "CM_BMC_CMC_Temperatur_035_Cxfe_Init" 255 "CM_BMC_CMC_Temperatur_035_Cxff_Fehler" /end COMPU_VTAB
/begin COMPU_TAB CM_BMC_CMC_Temperatur_036 "" TAB_INTP 2 0 -40 252 86 /end COMPU_TAB
/begin COMPU_VTAB CM_BMC_CMC_Temperatur_036.StatusText "" TAB_VERB 3 253 "CM_BMC_CMC_Temperatur_036_Cxfd_nicht_vorhanden" 254 "CM_BMC_CMC_Temperatur_036_Cxfe_Init" 255 "CM_BMC_CMC_Temperatur_036_Cxff_Fehler" /end COMPU_VTAB
/begin COMPU_TAB CM_BMC_CMC_Temperatur_037 "" TAB_INTP 2 0 -40 252 86 /end COMPU_TAB
/begin COMPU_VTAB CM_BMC_CMC_Temperatur_037.StatusText "" TAB_VERB 3 253 "CM_BMC_CMC_Temperatur_037_Cxfd_nicht_vorhanden" 254 "CM_BMC_CMC_Temperatur_037_Cxfe_Init" 255 "CM_BMC_CMC_Temperatur_037_Cxff_Fehler" /end COMPU_VTAB
/begin COMPU_TAB CM_BMC_CMC_Temperatur_038 "" TAB_INTP 2 0 -40 252 86 /end COMPU_TAB
/begin COMPU_VTAB CM_BMC_CMC_Temperatur_038.StatusText "" TAB_VERB 3 253 "CM_BMC_CMC_Temperatur_038_Cxfd_nicht_vorhanden" 254 "CM_BMC_CMC_Temperatur_038_Cxfe_Init" 255 "CM_BMC_CMC_Temperatur_038_Cxff_Fehler" /end COMPU_VTAB
/begin COMPU_TAB CM_BMC_CMC_Temperatur_039 "" TAB_INTP 2 0 -40 252 86 /end COMPU_TAB
/begin COMPU_VTAB CM_BMC_CMC_Temperatur_039.StatusText "" TAB_VERB 3 253 "CM_BMC_CMC_Temperatur_039_Cxfd_nicht_vorhanden" 254 "CM_BMC_CMC_Temperatur_039_Cxfe_Init" 255 "CM_BMC_CMC_Temperatur_039_Cxff_Fehler" /end COMPU_VTAB
/begin COMPU_TAB CM_BMC_CMC_Temperatur_03_Messzeit "" TAB_INTP 2 0 0 253 253 /end COMPU_TAB
/begin COMPU_VTAB CM_BMC_CMC_Temperatur_03_Messzeit.StatusText "" TAB_VERB 2 254 "CM_BMC_CMC_Temperatur_03_Messzeit_Cxfe_Init" 255 "CM_BMC_CMC_Temperatur_03_Messzeit_Cxff_Fehler" /end COMPU_VTAB
/begin COMPU_TAB CM_BMC_CMC_Temperatur_040 "" TAB_INTP 2 0 -40 252 86 /end COMPU_TAB
/begin COMPU_VTAB CM_BMC_CMC_Temperatur_040.StatusText "" TAB_VERB 3 253 "CM_BMC_CMC_Temperatur_040_Cxfd_nicht_vorhanden" 254 "CM_BMC_CMC_Temperatur_040_Cxfe_Init" 255 "CM_BMC_CMC_Temperatur_040_Cxff_Fehler" /end COMPU_VTAB
/begin COMPU_TAB CM_BMC_CMC_Temperatur_041 "" TAB_INTP 2 0 -40 252 86 /end COMPU_TAB
/begin COMPU_VTAB CM_BMC_CMC_Temperatur_041.StatusText "" TAB_VERB 3 253 "CM_BMC_CMC_Temperatur_041_Cxfd_nicht_vorhanden" 254 "CM_BMC_CMC_Temperatur_041_Cxfe_Init" 255 "CM_BMC_CMC_Temperatur_041_Cxff_Fehler" /end COMPU_VTAB
/begin COMPU_TAB CM_BMC_CMC_Temperatur_042 "" TAB_INTP 2 0 -40 252 86 /end COMPU_TAB
/begin COMPU_VTAB CM_BMC_CMC_Temperatur_042.StatusText "" TAB_VERB 3 253 "CM_BMC_CMC_Temperatur_042_Cxfd_nicht_vorhanden" 254 "CM_BMC_CMC_Temperatur_042_Cxfe_Init" 255 "CM_BMC_CMC_Temperatur_042_Cxff_Fehler" /end COMPU_VTAB
/begin COMPU_TAB CM_BMC_CMC_Temperatur_043 "" TAB_INTP 2 0 -40 252 86 /end COMPU_TAB
/begin COMPU_VTAB CM_BMC_CMC_Temperatur_043.StatusText "" TAB_VERB 3 253 "CM_BMC_CMC_Temperatur_043_Cxfd_nicht_vorhanden" 254 "CM_BMC_CMC_Temperatur_043_Cxfe_Init" 255 "CM_BMC_CMC_Temperatur_043_Cxff_Fehler" /end COMPU_VTAB
/begin COMPU_TAB CM_BMC_CMC_Temperatur_044 "" TAB_INTP 2 0 -40 252 86 /end COMPU_TAB
/begin COMPU_VTAB CM_BMC_CMC_Temperatur_044.StatusText "" TAB_VERB 3 253 "CM_BMC_CMC_Temperatur_044_Cxfd_nicht_vorhanden" 254 "CM_BMC_CMC_Temperatur_044_Cxfe_Init" 255 "CM_BMC_CMC_Temperatur_044_Cxff_Fehler" /end COMPU_VTAB
/begin COMPU_TAB CM_BMC_CMC_Temperatur_045 "" TAB_INTP 2 0 -40 252 86 /end COMPU_TAB
/begin COMPU_VTAB CM_BMC_CMC_Temperatur_045.StatusText "" TAB_VERB 3 253 "CM_BMC_CMC_Temperatur_045_Cxfd_nicht_vorhanden" 254 "CM_BMC_CMC_Temperatur_045_Cxfe_Init" 255 "CM_BMC_CMC_Temperatur_045_Cxff_Fehler" /end COMPU_VTAB
/begin COMPU_TAB CM_BMC_CMC_Temperatur_046 "" TAB_INTP 2 0 -40 252 86 /end COMPU_TAB
/begin COMPU_VTAB CM_BMC_CMC_Temperatur_046.StatusText "" TAB_VERB 3 253 "CM_BMC_CMC_Temperatur_046_Cxfd_nicht_vorhanden" 254 "CM_BMC_CMC_Temperatur_046_Cxfe_Init" 255 "CM_BMC_CMC_Temperatur_046_Cxff_Fehler" /end COMPU_VTAB
/begin COMPU_TAB CM_BMC_CMC_Temperatur_047 "" TAB_INTP 2 0 -40 252 86 /end COMPU_TAB
/begin COMPU_VTAB CM_BMC_CMC_Temperatur_047.StatusText "" TAB_VERB 3 253 "CM_BMC_CMC_Temperatur_047_Cxfd_nicht_vorhanden" 254 "CM_BMC_CMC_Temperatur_047_Cxfe_Init" 255 "CM_BMC_CMC_Temperatur_047_Cxff_Fehler" /end COMPU_VTAB
/begin COMPU_TAB CM_BMC_CMC_Temperatur_048 "" TAB_INTP 2 0 -40 252 86 /end COMPU_TAB
/begin COMPU_VTAB CM_BMC_CMC_Temperatur_048.StatusText "" TAB_VERB 3 253 "CM_BMC_CMC_Temperatur_048_Cxfd_nicht_vorhanden" 254 "CM_BMC_CMC_Temperatur_048_Cxfe_Init" 255 "CM_BMC_CMC_Temperatur_048_Cxff_Fehler" /end COMPU_VTAB
/begin COMPU_TAB CM_BMC_CMC_Temperatur_049 "" TAB_INTP 2 0 -40 252 86 /end COMPU_TAB
/begin COMPU_VTAB CM_BMC_CMC_Temperatur_049.StatusText "" TAB_VERB 3 253 "CM_BMC_CMC_Temperatur_049_Cxfd_nicht_vorhanden" 254 "CM_BMC_CMC_Temperatur_049_Cxfe_Init" 255 "CM_BMC_CMC_Temperatur_049_Cxff_Fehler" /end COMPU_VTAB
/begin COMPU_TAB CM_BMC_CMC_Temperatur_050 "" TAB_INTP 2 0 -40 252 86 /end COMPU_TAB
/begin COMPU_VTAB CM_BMC_CMC_Temperatur_050.StatusText "" TAB_VERB 3 253 "CM_BMC_CMC_Temperatur_050_Cxfd_nicht_vorhanden" 254 "CM_BMC_CMC_Temperatur_050_Cxfe_Init" 255 "CM_BMC_CMC_Temperatur_050_Cxff_Fehler" /end COMPU_VTAB
/begin COMPU_TAB CM_BMC_CMC_Temperatur_051 "" TAB_INTP 2 0 -40 252 86 /end COMPU_TAB
/begin COMPU_VTAB CM_BMC_CMC_Temperatur_051.StatusText "" TAB_VERB 3 253 "CM_BMC_CMC_Temperatur_051_Cxfd_nicht_vorhanden" 254 "CM_BMC_CMC_Temperatur_051_Cxfe_Init" 255 "CM_BMC_CMC_Temperatur_051_Cxff_Fehler" /end COMPU_VTAB
/begin COMPU_TAB CM_BMC_CMC_Temperatur_052 "" TAB_INTP 2 0 -40 252 86 /end COMPU_TAB
/begin COMPU_VTAB CM_BMC_CMC_Temperatur_052.StatusText "" TAB_VERB 3 253 "CM_BMC_CMC_Temperatur_052_Cxfd_nicht_vorhanden" 254 "CM_BMC_CMC_Temperatur_052_Cxfe_Init" 255 "CM_BMC_CMC_Temperatur_052_Cxff_Fehler" /end COMPU_VTAB
/begin COMPU_TAB CM_BMC_CMC_Temperatur_053 "" TAB_INTP 2 0 -40 252 86 /end COMPU_TAB
/begin COMPU_VTAB CM_BMC_CMC_Temperatur_053.StatusText "" TAB_VERB 3 253 "CM_BMC_CMC_Temperatur_053_Cxfd_nicht_vorhanden" 254 "CM_BMC_CMC_Temperatur_053_Cxfe_Init" 255 "CM_BMC_CMC_Temperatur_053_Cxff_Fehler" /end COMPU_VTAB
/begin COMPU_TAB CM_BMC_CMC_Temperatur_054 "" TAB_INTP 2 0 -40 252 86 /end COMPU_TAB
/begin COMPU_VTAB CM_BMC_CMC_Temperatur_054.StatusText "" TAB_VERB 3 253 "CM_BMC_CMC_Temperatur_054_Cxfd_nicht_vorhanden" 254 "CM_BMC_CMC_Temperatur_054_Cxfe_Init" 255 "CM_BMC_CMC_Temperatur_054_Cxff_Fehler" /end COMPU_VTAB
/begin COMPU_TAB CM_BMC_CMC_Temperatur_055 "" TAB_INTP 2 0 -40 252 86 /end COMPU_TAB
/begin COMPU_VTAB CM_BMC_CMC_Temperatur_055.StatusText "" TAB_VERB 3 253 "CM_BMC_CMC_Temperatur_055_Cxfd_nicht_vorhanden" 254 "CM_BMC_CMC_Temperatur_055_Cxfe_Init" 255 "CM_BMC_CMC_Temperatur_055_Cxff_Fehler" /end COMPU_VTAB
/begin COMPU_TAB CM_BMC_CMC_Temperatur_056 "" TAB_INTP 2 0 -40 252 86 /end COMPU_TAB
/begin COMPU_VTAB CM_BMC_CMC_Temperatur_056.StatusText "" TAB_VERB 3 253 "CM_BMC_CMC_Temperatur_056_Cxfd_nicht_vorhanden" 254 "CM_BMC_CMC_Temperatur_056_Cxfe_Init" 255 "CM_BMC_CMC_Temperatur_056_Cxff_Fehler" /end COMPU_VTAB
/begin COMPU_TAB CM_BMC_CMC_Temperatur_057 "" TAB_INTP 2 0 -40 252 86 /end COMPU_TAB
/begin COMPU_VTAB CM_BMC_CMC_Temperatur_057.StatusText "" TAB_VERB 3 253 "CM_BMC_CMC_Temperatur_057_Cxfd_nicht_vorhanden" 254 "CM_BMC_CMC_Temperatur_057_Cxfe_Init" 255 "CM_BMC_CMC_Temperatur_057_Cxff_Fehler" /end COMPU_VTAB
/begin COMPU_TAB CM_BMC_CMC_Temperatur_058 "" TAB_INTP 2 0 -40 252 86 /end COMPU_TAB
/begin COMPU_VTAB CM_BMC_CMC_Temperatur_058.StatusText "" TAB_VERB 3 253 "CM_BMC_CMC_Temperatur_058_Cxfd_nicht_vorhanden" 254 "CM_BMC_CMC_Temperatur_058_Cxfe_Init" 255 "CM_BMC_CMC_Temperatur_058_Cxff_Fehler" /end COMPU_VTAB
/begin COMPU_TAB CM_BMC_CMC_Temperatur_059 "" TAB_INTP 2 0 -40 252 86 /end COMPU_TAB
/begin COMPU_VTAB CM_BMC_CMC_Temperatur_059.StatusText "" TAB_VERB 3 253 "CM_BMC_CMC_Temperatur_059_Cxfd_nicht_vorhanden" 254 "CM_BMC_CMC_Temperatur_059_Cxfe_Init" 255 "CM_BMC_CMC_Temperatur_059_Cxff_Fehler" /end COMPU_VTAB
/begin COMPU_TAB CM_BMC_CMC_Temperatur_060 "" TAB_INTP 2 0 -40 252 86 /end COMPU_TAB
/begin COMPU_VTAB CM_BMC_CMC_Temperatur_060.StatusText "" TAB_VERB 3 253 "CM_BMC_CMC_Temperatur_060_Cxfd_nicht_vorhanden" 254 "CM_BMC_CMC_Temperatur_060_Cxfe_Init" 255 "CM_BMC_CMC_Temperatur_060_Cxff_Fehler" /end COMPU_VTAB
/begin COMPU_TAB CM_BMC_CMC_Temperatur_061 "" TAB_INTP 2 0 -40 252 86 /end COMPU_TAB
/begin COMPU_VTAB CM_BMC_CMC_Temperatur_061.StatusText "" TAB_VERB 3 253 "CM_BMC_CMC_Temperatur_061_Cxfd_nicht_vorhanden" 254 "CM_BMC_CMC_Temperatur_061_Cxfe_Init" 255 "CM_BMC_CMC_Temperatur_061_Cxff_Fehler" /end COMPU_VTAB
/begin COMPU_TAB CM_BMC_CMC_Temperatur_062 "" TAB_INTP 2 0 -40 252 86 /end COMPU_TAB
/begin COMPU_VTAB CM_BMC_CMC_Temperatur_062.StatusText "" TAB_VERB 3 253 "CM_BMC_CMC_Temperatur_062_Cxfd_nicht_vorhanden" 254 "CM_BMC_CMC_Temperatur_062_Cxfe_Init" 255 "CM_BMC_CMC_Temperatur_062_Cxff_Fehler" /end COMPU_VTAB
/begin COMPU_TAB CM_BMC_CMC_Temperatur_063 "" TAB_INTP 2 0 -40 252 86 /end COMPU_TAB
/begin COMPU_VTAB CM_BMC_CMC_Temperatur_063.StatusText "" TAB_VERB 3 253 "CM_BMC_CMC_Temperatur_063_Cxfd_nicht_vorhanden" 254 "CM_BMC_CMC_Temperatur_063_Cxfe_Init" 255 "CM_BMC_CMC_Temperatur_063_Cxff_Fehler" /end COMPU_VTAB
/begin COMPU_TAB CM_BMC_CMC_Temperatur_064 "" TAB_INTP 2 0 -40 252 86 /end COMPU_TAB
/begin COMPU_VTAB CM_BMC_CMC_Temperatur_064.StatusText "" TAB_VERB 3 253 "CM_BMC_CMC_Temperatur_064_Cxfd_nicht_vorhanden" 254 "CM_BMC_CMC_Temperatur_064_Cxfe_Init" 255 "CM_BMC_CMC_Temperatur_064_Cxff_Fehler" /end COMPU_VTAB
/begin COMPU_TAB CM_BMC_CMC_Temperatur_065 "" TAB_INTP 2 0 -40 252 86 /end COMPU_TAB
/begin COMPU_VTAB CM_BMC_CMC_Temperatur_065.StatusText "" TAB_VERB 3 253 "CM_BMC_CMC_Temperatur_065_Cxfd_nicht_vorhanden" 254 "CM_BMC_CMC_Temperatur_065_Cxfe_Init" 255 "CM_BMC_CMC_Temperatur_065_Cxff_Fehler" /end COMPU_VTAB
/begin COMPU_TAB CM_BMC_CMC_Temperatur_066 "" TAB_INTP 2 0 -40 252 86 /end COMPU_TAB
/begin COMPU_VTAB CM_BMC_CMC_Temperatur_066.StatusText "" TAB_VERB 3 253 "CM_BMC_CMC_Temperatur_066_Cxfd_nicht_vorhanden" 254 "CM_BMC_CMC_Temperatur_066_Cxfe_Init" 255 "CM_BMC_CMC_Temperatur_066_Cxff_Fehler" /end COMPU_VTAB
/begin COMPU_TAB CM_BMC_CMC_Temperatur_067 "" TAB_INTP 2 0 -40 252 86 /end COMPU_TAB
/begin COMPU_VTAB CM_BMC_CMC_Temperatur_067.StatusText "" TAB_VERB 3 253 "CM_BMC_CMC_Temperatur_067_Cxfd_nicht_vorhanden" 254 "CM_BMC_CMC_Temperatur_067_Cxfe_Init" 255 "CM_BMC_CMC_Temperatur_067_Cxff_Fehler" /end COMPU_VTAB
/begin COMPU_TAB CM_BMC_CMC_Temperatur_068 "" TAB_INTP 2 0 -40 252 86 /end COMPU_TAB
/begin COMPU_VTAB CM_BMC_CMC_Temperatur_068.StatusText "" TAB_VERB 3 253 "CM_BMC_CMC_Temperatur_068_Cxfd_nicht_vorhanden" 254 "CM_BMC_CMC_Temperatur_068_Cxfe_Init" 255 "CM_BMC_CMC_Temperatur_068_Cxff_Fehler" /end COMPU_VTAB
/begin COMPU_TAB CM_BMC_CMC_Temperatur_069 "" TAB_INTP 2 0 -40 252 86 /end COMPU_TAB
/begin COMPU_VTAB CM_BMC_CMC_Temperatur_069.StatusText "" TAB_VERB 3 253 "CM_BMC_CMC_Temperatur_069_Cxfd_nicht_vorhanden" 254 "CM_BMC_CMC_Temperatur_069_Cxfe_Init" 255 "CM_BMC_CMC_Temperatur_069_Cxff_Fehler" /end COMPU_VTAB
/begin COMPU_TAB CM_BMC_CMC_Temperatur_070 "" TAB_INTP 2 0 -40 252 86 /end COMPU_TAB
/begin COMPU_VTAB CM_BMC_CMC_Temperatur_070.StatusText "" TAB_VERB 3 253 "CM_BMC_CMC_Temperatur_070_Cxfd_nicht_vorhanden" 254 "CM_BMC_CMC_Temperatur_070_Cxfe_Init" 255 "CM_BMC_CMC_Temperatur_070_Cxff_Fehler" /end COMPU_VTAB
/begin COMPU_TAB CM_BMC_CMC_Temperatur_071 "" TAB_INTP 2 0 -40 252 86 /end COMPU_TAB
/begin COMPU_VTAB CM_BMC_CMC_Temperatur_071.StatusText "" TAB_VERB 3 253 "CM_BMC_CMC_Temperatur_071_Cxfd_nicht_vorhanden" 254 "CM_BMC_CMC_Temperatur_071_Cxfe_Init" 255 "CM_BMC_CMC_Temperatur_071_Cxff_Fehler" /end COMPU_VTAB
/begin COMPU_TAB CM_BMC_CMC_Temperatur_072 "" TAB_INTP 2 0 -40 252 86 /end COMPU_TAB
/begin COMPU_VTAB CM_BMC_CMC_Temperatur_072.StatusText "" TAB_VERB 3 253 "CM_BMC_CMC_Temperatur_072_Cxfd_nicht_vorhanden" 254 "CM_BMC_CMC_Temperatur_072_Cxfe_Init" 255 "CM_BMC_CMC_Temperatur_072_Cxff_Fehler" /end COMPU_VTAB
/begin COMPU_TAB CM_BMC_CMC_Temperatur_073 "" TAB_INTP 2 0 -40 252 86 /end COMPU_TAB
/begin COMPU_VTAB CM_BMC_CMC_Temperatur_073.StatusText "" TAB_VERB 3 253 "CM_BMC_CMC_Temperatur_073_Cxfd_nicht_vorhanden" 254 "CM_BMC_CMC_Temperatur_073_Cxfe_Init" 255 "CM_BMC_CMC_Temperatur_073_Cxff_Fehler" /end COMPU_VTAB
/begin COMPU_TAB CM_BMC_CMC_Temperatur_074 "" TAB_INTP 2 0 -40 252 86 /end COMPU_TAB
/begin COMPU_VTAB CM_BMC_CMC_Temperatur_074.StatusText "" TAB_VERB 3 253 "CM_BMC_CMC_Temperatur_074_Cxfd_nicht_vorhanden" 254 "CM_BMC_CMC_Temperatur_074_Cxfe_Init" 255 "CM_BMC_CMC_Temperatur_074_Cxff_Fehler" /end COMPU_VTAB
/begin COMPU_TAB CM_BMC_CMC_Temperatur_075 "" TAB_INTP 2 0 -40 252 86 /end COMPU_TAB
/begin COMPU_VTAB CM_BMC_CMC_Temperatur_075.StatusText "" TAB_VERB 3 253 "CM_BMC_CMC_Temperatur_075_Cxfd_nicht_vorhanden" 254 "CM_BMC_CMC_Temperatur_075_Cxfe_Init" 255 "CM_BMC_CMC_Temperatur_075_Cxff_Fehler" /end COMPU_VTAB
/begin COMPU_TAB CM_BMC_CMC_Temperatur_076 "" TAB_INTP 2 0 -40 252 86 /end COMPU_TAB
/begin COMPU_VTAB CM_BMC_CMC_Temperatur_076.StatusText "" TAB_VERB 3 253 "CM_BMC_CMC_Temperatur_076_Cxfd_nicht_vorhanden" 254 "CM_BMC_CMC_Temperatur_076_Cxfe_Init" 255 "CM_BMC_CMC_Temperatur_076_Cxff_Fehler" /end COMPU_VTAB
/begin COMPU_TAB CM_BMC_CMC_Temperatur_077 "" TAB_INTP 2 0 -40 252 86 /end COMPU_TAB
/begin COMPU_VTAB CM_BMC_CMC_Temperatur_077.StatusText "" TAB_VERB 3 253 "CM_BMC_CMC_Temperatur_077_Cxfd_nicht_vorhanden" 254 "CM_BMC_CMC_Temperatur_077_Cxfe_Init" 255 "CM_BMC_CMC_Temperatur_077_Cxff_Fehler" /end COMPU_VTAB
/begin COMPU_TAB CM_BMC_CMC_Temperatur_078 "" TAB_INTP 2 0 -40 252 86 /end COMPU_TAB
/begin COMPU_VTAB CM_BMC_CMC_Temperatur_078.StatusText "" TAB_VERB 3 253 "CM_BMC_CMC_Temperatur_078_Cxfd_nicht_vorhanden" 254 "CM_BMC_CMC_Temperatur_078_Cxfe_Init" 255 "CM_BMC_CMC_Temperatur_078_Cxff_Fehler" /end COMPU_VTAB
/begin COMPU_TAB CM_BMC_CMC_Temperatur_079 "" TAB_INTP 2 0 -40 252 86 /end COMPU_TAB
/begin COMPU_VTAB CM_BMC_CMC_Temperatur_079.StatusText "" TAB_VERB 3 253 "CM_BMC_CMC_Temperatur_079_Cxfd_nicht_vorhanden" 254 "CM_BMC_CMC_Temperatur_079_Cxfe_Init" 255 "CM_BMC_CMC_Temperatur_079_Cxff_Fehler" /end COMPU_VTAB
/begin COMPU_TAB CM_BMC_CMC_Temperatur_080 "" TAB_INTP 2 0 -40 252 86 /end COMPU_TAB
/begin COMPU_VTAB CM_BMC_CMC_Temperatur_080.StatusText "" TAB_VERB 3 253 "CM_BMC_CMC_Temperatur_080_Cxfd_nicht_vorhanden" 254 "CM_BMC_CMC_Temperatur_080_Cxfe_Init" 255 "CM_BMC_CMC_Temperatur_080_Cxff_Fehler" /end COMPU_VTAB
/begin COMPU_TAB CM_BMC_CMC_Temperatur_081 "" TAB_INTP 2 0 -40 252 86 /end COMPU_TAB
/begin COMPU_VTAB CM_BMC_CMC_Temperatur_081.StatusText "" TAB_VERB 3 253 "CM_BMC_CMC_Temperatur_081_Cxfd_nicht_vorhanden" 254 "CM_BMC_CMC_Temperatur_081_Cxfe_Init" 255 "CM_BMC_CMC_Temperatur_081_Cxff_Fehler" /end COMPU_VTAB
/begin COMPU_TAB CM_BMC_CMC_Temperatur_082 "" TAB_INTP 2 0 -40 252 86 /end COMPU_TAB
/begin COMPU_VTAB CM_BMC_CMC_Temperatur_082.StatusText "" TAB_VERB 3 253 "CM_BMC_CMC_Temperatur_082_Cxfd_nicht_vorhanden" 254 "CM_BMC_CMC_Temperatur_082_Cxfe_Init" 255 "CM_BMC_CMC_Temperatur_082_Cxff_Fehler" /end COMPU_VTAB
/begin COMPU_VTAB CanIf_ControllerModeEnum "" TAB_VERB 4 0 "CANIF_CS_UNINIT" 1 "CANIF_CS_STOPPED" 2 "CANIF_CS_STARTED" 3 "CANIF_CS_SLEEP" /end COMPU_VTAB
/begin COMPU_VTAB CanIf_PduGetModeEnum "" TAB_VERB 6 0 "CANIF_GET_OFFLINE" 1 "CANIF_GET_RX_ONLINE" 2 "CANIF_GET_TX_ONLINE" 3 "CANIF_GET_ONLINE" 4 "CANIF_GET_OFFLINE_ACTIVE" 5 "CANIF_GET_OFFLINE_ACTIVE_RX_ONLINE" /end COMPU_VTAB
/begin COMPU_VTAB_RANGE CanNm_ComControlEnabledOfChannelConfigType "" 2 0 0 "FALSE" 1 255 "TRUE" /end COMPU_VTAB_RANGE
/begin COMPU_VTAB_RANGE CanNm_MsgConfirmationFlagType "" 2 0 0 "FALSE" 1 255 "TRUE" /end COMPU_VTAB_RANGE
/begin COMPU_VTAB_RANGE CanNm_MsgIndicationFlagType "" 2 0 0 "FALSE" 1 255 "TRUE" /end COMPU_VTAB_RANGE
/begin COMPU_VTAB CanNm_PnClusterResetTimerEndIdxOfPnInfoByteConfigType "" TAB_VERB 1 255 "CANNM_NO_PNCLUSTERRESETTIMERENDIDXOFPNINFOBYTECONFIG" /end COMPU_VTAB
/begin COMPU_VTAB CanNm_PnClusterResetTimerStartIdxOfPnInfoByteConfigType "" TAB_VERB 1 255 "CANNM_NO_PNCLUSTERRESETTIMERSTARTIDXOFPNINFOBYTECONFIG" /end COMPU_VTAB
/begin COMPU_VTAB_RANGE CanNm_PnEnabledOfPbChannelConfigType "" 2 0 0 "FALSE" 1 255 "TRUE" /end COMPU_VTAB_RANGE
/begin COMPU_VTAB_RANGE CanNm_PnMessageFilterDeactivationIndicatedType "" 2 0 0 "FALSE" 1 255 "TRUE" /end COMPU_VTAB_RANGE
/begin COMPU_VTAB_RANGE CanNm_PnMessageFilterEnabledType "" 2 0 0 "FALSE" 1 255 "TRUE" /end COMPU_VTAB_RANGE
/begin COMPU_VTAB CanNm_RxMessageDataEndIdxOfPbChannelConfigType "" TAB_VERB 1 255 "CANNM_NO_RXMESSAGEDATAENDIDXOFPBCHANNELCONFIG" /end COMPU_VTAB
/begin COMPU_VTAB CanNm_RxMessageDataStartIdxOfPbChannelConfigType "" TAB_VERB 1 255 "CANNM_NO_RXMESSAGEDATASTARTIDXOFPBCHANNELCONFIG" /end COMPU_VTAB
/begin COMPU_VTAB CanNm_RxMessageData_CBVIdxOfPbChannelConfigType "" TAB_VERB 1 255 "CANNM_NO_RXMESSAGEDATA_CBVIDXOFPBCHANNELCONFIG" /end COMPU_VTAB
/begin COMPU_VTAB CanNm_RxMessageData_NIDIdxOfPbChannelConfigType "" TAB_VERB 1 255 "CANNM_NO_RXMESSAGEDATA_NIDIDXOFPBCHANNELCONFIG" /end COMPU_VTAB
/begin COMPU_VTAB CanNm_RxMessageData_UserDataEndIdxOfPbChannelConfigType "" TAB_VERB 1 255 "CANNM_NO_RXMESSAGEDATA_USERDATAENDIDXOFPBCHANNELCONFIG" /end COMPU_VTAB
/begin COMPU_VTAB CanNm_RxMessageData_UserDataStartIdxOfPbChannelConfigType "" TAB_VERB 1 255 "CANNM_NO_RXMESSAGEDATA_USERDATASTARTIDXOFPBCHANNELCONFIG" /end COMPU_VTAB
/begin COMPU_VTAB CanNm_SysToNmChIndType "" TAB_VERB 1 255 "CANNM_NO_SYSTONMCHIND" /end COMPU_VTAB
/begin COMPU_VTAB CanNm_TxMessageDataEndIdxOfPbChannelConfigType "" TAB_VERB 1 255 "CANNM_NO_TXMESSAGEDATAENDIDXOFPBCHANNELCONFIG" /end COMPU_VTAB
/begin COMPU_VTAB CanNm_TxMessageDataStartIdxOfPbChannelConfigType "" TAB_VERB 1 255 "CANNM_NO_TXMESSAGEDATASTARTIDXOFPBCHANNELCONFIG" /end COMPU_VTAB
/begin COMPU_VTAB CanNm_TxMessageData_CBVIdxOfPbChannelConfigType "" TAB_VERB 1 255 "CANNM_NO_TXMESSAGEDATA_CBVIDXOFPBCHANNELCONFIG" /end COMPU_VTAB
/begin COMPU_VTAB CanNm_TxMessageData_NIDIdxOfPbChannelConfigType "" TAB_VERB 1 255 "CANNM_NO_TXMESSAGEDATA_NIDIDXOFPBCHANNELCONFIG" /end COMPU_VTAB
/begin COMPU_VTAB CanNm_TxMessageData_PnFilterMaskEndIdxOfPbChannelConfigType "" TAB_VERB 1 255 "CANNM_NO_TXMESSAGEDATA_PNFILTERMASKENDIDXOFPBCHANNELCONFIG" /end COMPU_VTAB
/begin COMPU_VTAB CanNm_TxMessageData_PnFilterMaskStartIdxOfPbChannelConfigType "" TAB_VERB 1 255 "CANNM_NO_TXMESSAGEDATA_PNFILTERMASKSTARTIDXOFPBCHANNELCONFIG" /end COMPU_VTAB
/begin COMPU_VTAB CanNm_TxMessageData_UserDataEndIdxOfPbChannelConfigType "" TAB_VERB 1 255 "CANNM_NO_TXMESSAGEDATA_USERDATAENDIDXOFPBCHANNELCONFIG" /end COMPU_VTAB
/begin COMPU_VTAB CanNm_TxMessageData_UserDataStartIdxOfPbChannelConfigType "" TAB_VERB 1 255 "CANNM_NO_TXMESSAGEDATA_USERDATASTARTIDXOFPBCHANNELCONFIG" /end COMPU_VTAB
/begin COMPU_VTAB CanNm_TxPduIdOfPbChannelConfigType "" TAB_VERB 1 255 "CANNM_NO_TXPDUIDOFPBCHANNELCONFIG" /end COMPU_VTAB
/begin COMPU_VTAB CanNm_TxUserDataPduIdOfPbChannelConfigType "" TAB_VERB 1 255 "CANNM_NO_TXUSERDATAPDUIDOFPBCHANNELCONFIG" /end COMPU_VTAB
/begin GROUP BswM ""
 /begin REF_MEASUREMENT BswM_ActionListQueueOsApplication_SystemApplication_Core0 BswM_ActionListQueueOsApplication_SystemApplication_Core0_AL_AL_Dcm_Reset BswM_ActionListQueueOsApplication_SystemApplication_Core0_AL_CC_AL_CN_BMC_CAN01_78a85e89_Disable_DM BswM_ActionListQueueOsApplication_SystemApplication_Core0_AL_CC_AL_CN_BMC_CAN01_78a85e89_Enable_DM BswM_ActionListQueueOsApplication_SystemApplication_Core0_AL_CC_AL_CN_BMC_CAN01_78a85e89_RX_Disable BswM_ActionListQueueOsApplication_SystemApplication_Core0_AL_CC_AL_CN_BMC_CAN01_78a85e89_RX_EnableNoinit BswM_ActionListQueueOsApplication_SystemApplication_Core0_AL_CC_AL_CN_BMC_CAN01_78a85e89_TX_Disable BswM_ActionListQueueOsApplication_SystemApplication_Core0_AL_CC_AL_CN_BMC_CAN01_78a85e89_TX_EnableNoinit BswM_ActionListQueueOsApplication_SystemApplication_Core0_AL_CC_AL_CN_HCP5_CANFD01_54d90215_Disable_DM BswM_ActionListQueueOsApplication_SystemApplication_Core0_AL_CC_AL_CN_HCP5_CANFD01_54d90215_Enable_DM BswM_ActionListQueueOsApplication_SystemApplication_Core0_AL_CC_AL_CN_HCP5_CANFD01_54d90215_PNC_11_Chassis_dce36bbc_Enable_DM BswM_ActionListQueueOsApplication_SystemApplication_Core0_AL_CC_AL_CN_HCP5_CANFD01_54d90215_PNC_13_Airbag_727cecad_Disable_DM BswM_ActionListQueueOsApplication_SystemApplication_Core0_AL_CC_AL_CN_HCP5_CANFD01_54d90215_PNC_13_Airbag_727cecad_Enable_DM BswM_ActionListQueueOsApplication_SystemApplication_Core0_AL_CC_AL_CN_HCP5_CANFD01_54d90215_PNC_13_Airbag_727cecad_RX_Disable BswM_ActionListQueueOsApplication_SystemApplication_Core0_AL_CC_AL_CN_HCP5_CANFD01_54d90215_RX_Disable BswM_ActionListQueueOsApplication_SystemApplication_Core0_AL_CC_AL_CN_HCP5_CANFD01_54d90215_RX_EnableNoinit BswM_ActionListQueueOsApplication_SystemApplication_Core0_AL_CC_AL_CN_HCP5_CANFD01_54d90215_TX_Disable BswM_ActionListQueueOsApplication_SystemApplication_Core0_AL_CC_AL_CN_HCP5_CANFD01_54d90215_TX_EnableNoinit BswM_ActionListQueueOsApplication_SystemApplication_Core0_AL_ESH_AL_ExitPostRun BswM_ActionListQueueOsApplication_SystemApplication_Core0_AL_ESH_AL_ExitRun BswM_ActionListQueueOsApplication_SystemApplication_Core0_AL_ESH_AL_InitToWakeup BswM_ActionListQueueOsApplication_SystemApplication_Core0_AL_ESH_AL_PostRunToPrepShutdown BswM_ActionListQueueOsApplication_SystemApplication_Core0_AL_ESH_AL_PostRunToRun BswM_ActionListQueueOsApplication_SystemApplication_Core0_AL_ESH_AL_PrepShutdownToWaitForNvM BswM_ActionListQueueOsApplication_SystemApplication_Core0_AL_ESH_AL_RunToPostRun BswM_ActionListQueueOsApplication_SystemApplication_Core0_AL_ESH_AL_WaitForNvMToShutdown BswM_ActionListQueueOsApplication_SystemApplication_Core0_AL_ESH_AL_WaitForNvMWakeup BswM_ActionListQueueOsApplication_SystemApplication_Core0_AL_ESH_AL_WakeupToPrep BswM_ActionListQueueOsApplication_SystemApplication_Core0_AL_ESH_AL_WakeupToRun BswM_ActionListQueueOsApplication_SystemApplication_Core1 BswM_CoreSyncValueOsApplication_SystemApplication_Core0 BswM_CoreSyncValueOsApplication_SystemApplication_Core1 BswM_DeferredRulesOsApplication_SystemApplication_Core0[0].RulesIdxOfDeferredRules BswM_DeferredRulesOsApplication_SystemApplication_Core0[1].RulesIdxOfDeferredRules BswM_DeferredRulesOsApplication_SystemApplication_Core0[2].RulesIdxOfDeferredRules BswM_DeferredRulesOsApplication_SystemApplication_Core0[3].RulesIdxOfDeferredRules BswM_DeferredRulesOsApplication_SystemApplication_Core0[4].RulesIdxOfDeferredRules BswM_DeferredRulesOsApplication_SystemApplication_Core0[5].RulesIdxOfDeferredRules BswM_DeferredRulesOsApplication_SystemApplication_Core0[6].RulesIdxOfDeferredRules BswM_DeferredRulesOsApplication_SystemApplication_Core0[7].RulesIdxOfDeferredRules BswM_ForcedActionListPriorityOsApplication_SystemApplication_Core0 BswM_ForcedActionListPriorityOsApplication_SystemApplication_Core1 BswM_ImmediateUserOsApplication_SystemApplication_Core0[0].OnInitOfImmediateUser BswM_ImmediateUserOsApplication_SystemApplication_Core0[0].RulesIndEndIdxOfImmediateUser BswM_ImmediateUserOsApplication_SystemApplication_Core0[0].RulesIndStartIdxOfImmediateUser BswM_ImmediateUserOsApplication_SystemApplication_Core0[10].OnInitOfImmediateUser BswM_ImmediateUserOsApplication_SystemApplication_Core0[10].RulesIndEndIdxOfImmediateUser BswM_ImmediateUserOsApplication_SystemApplication_Core0[10].RulesIndStartIdxOfImmediateUser BswM_ImmediateUserOsApplication_SystemApplication_Core0[11].OnInitOfImmediateUser BswM_ImmediateUserOsApplication_SystemApplication_Core0[11].RulesIndEndIdxOfImmediateUser BswM_ImmediateUserOsApplication_SystemApplication_Core0[11].RulesIndStartIdxOfImmediateUser BswM_ImmediateUserOsApplication_SystemApplication_Core0[12].OnInitOfImmediateUser BswM_ImmediateUserOsApplication_SystemApplication_Core0[12].RulesIndEndIdxOfImmediateUser BswM_ImmediateUserOsApplication_SystemApplication_Core0[12].RulesIndStartIdxOfImmediateUser BswM_ImmediateUserOsApplication_SystemApplication_Core0[13].OnInitOfImmediateUser BswM_ImmediateUserOsApplication_SystemApplication_Core0[13].RulesIndEndIdxOfImmediateUser BswM_ImmediateUserOsApplication_SystemApplication_Core0[13].RulesIndStartIdxOfImmediateUser BswM_ImmediateUserOsApplication_SystemApplication_Core0[14].OnInitOfImmediateUser BswM_ImmediateUserOsApplication_SystemApplication_Core0[14].RulesIndEndIdxOfImmediateUser BswM_ImmediateUserOsApplication_SystemApplication_Core0[14].RulesIndStartIdxOfImmediateUser BswM_ImmediateUserOsApplication_SystemApplication_Core0[1].OnInitOfImmediateUser BswM_ImmediateUserOsApplication_SystemApplication_Core0[1].RulesIndEndIdxOfImmediateUser BswM_ImmediateUserOsApplication_SystemApplication_Core0[1].RulesIndStartIdxOfImmediateUser BswM_ImmediateUserOsApplication_SystemApplication_Core0[2].OnInitOfImmediateUser BswM_ImmediateUserOsApplication_SystemApplication_Core0[2].RulesIndEndIdxOfImmediateUser BswM_ImmediateUserOsApplication_SystemApplication_Core0[2].RulesIndStartIdxOfImmediateUser BswM_ImmediateUserOsApplication_SystemApplication_Core0[3].OnInitOfImmediateUser BswM_ImmediateUserOsApplication_SystemApplication_Core0[3].RulesIndEndIdxOfImmediateUser BswM_ImmediateUserOsApplication_SystemApplication_Core0[3].RulesIndStartIdxOfImmediateUser BswM_ImmediateUserOsApplication_SystemApplication_Core0[4].OnInitOfImmediateUser BswM_ImmediateUserOsApplication_SystemApplication_Core0[4].RulesIndEndIdxOfImmediateUser BswM_ImmediateUserOsApplication_SystemApplication_Core0[4].RulesIndStartIdxOfImmediateUser BswM_ImmediateUserOsApplication_SystemApplication_Core0[5].OnInitOfImmediateUser BswM_ImmediateUserOsApplication_SystemApplication_Core0[5].RulesIndEndIdxOfImmediateUser BswM_ImmediateUserOsApplication_SystemApplication_Core0[5].RulesIndStartIdxOfImmediateUser BswM_ImmediateUserOsApplication_SystemApplication_Core0[6].OnInitOfImmediateUser BswM_ImmediateUserOsApplication_SystemApplication_Core0[6].RulesIndEndIdxOfImmediateUser BswM_ImmediateUserOsApplication_SystemApplication_Core0[6].RulesIndStartIdxOfImmediateUser BswM_ImmediateUserOsApplication_SystemApplication_Core0[7].OnInitOfImmediateUser BswM_ImmediateUserOsApplication_SystemApplication_Core0[7].RulesIndEndIdxOfImmediateUser BswM_ImmediateUserOsApplication_SystemApplication_Core0[7].RulesIndStartIdxOfImmediateUser BswM_ImmediateUserOsApplication_SystemApplication_Core0[8].OnInitOfImmediateUser BswM_ImmediateUserOsApplication_SystemApplication_Core0[8].RulesIndEndIdxOfImmediateUser BswM_ImmediateUserOsApplication_SystemApplication_Core0[8].RulesIndStartIdxOfImmediateUser BswM_ImmediateUserOsApplication_SystemApplication_Core0[9].OnInitOfImmediateUser BswM_ImmediateUserOsApplication_SystemApplication_Core0[9].RulesIndEndIdxOfImmediateUser BswM_ImmediateUserOsApplication_SystemApplication_Core0[9].RulesIndStartIdxOfImmediateUser BswM_InitializedOsApplication_SystemApplication_Core0 BswM_InitializedOsApplication_SystemApplication_Core1 BswM_ModeRequestQueueOsApplication_SystemApplication_Core0 BswM_PCPartitionConfig.ActionListQueueOfPCPartitionConfig BswM_PCPartitionConfig.ActionListsOfPCPartitionConfig BswM_PCPartitionConfig.CanSMChannelMappingOfPCPartitionConfig BswM_PCPartitionConfig.CanSMChannelStateOfPCPartitionConfig BswM_PCPartitionConfig.ComMChannelMappingOfPCPartitionConfig BswM_PCPartitionConfig.ComMChannelStateOfPCPartitionConfig BswM_PCPartitionConfig.ComMPncMappingOfPCPartitionConfig BswM_PCPartitionConfig.ComMPncStateOfPCPartitionConfig BswM_PCPartitionConfig.CoreSyncValueOfPCPartitionConfig BswM_PCPartitionConfig.DeferredRulesOfPCPartitionConfig BswM_PCPartitionConfig.ForcedActionListPriorityOfPCPartitionConfig BswM_PCPartitionConfig.GenericMappingOfPCPartitionConfig BswM_PCPartitionConfig.GenericStateOfPCPartitionConfig BswM_PCPartitionConfig.ImmediateUserOfPCPartitionConfig BswM_PCPartitionConfig.InitGenVarAndInitALOfPCPartitionConfig BswM_PCPartitionConfig.InitSyncCalloutOfPCPartitionConfig BswM_PCPartitionConfig.InitializedOfPCPartitionConfig BswM_PCPartitionConfig.ModeNotificationFctOfPCPartitionConfig BswM_PCPartitionConfig.ModeRequestQueueOfPCPartitionConfig BswM_PCPartitionConfig.NvMJobMappingOfPCPartitionConfig BswM_PCPartitionConfig.NvMJobStateOfPCPartitionConfig BswM_PCPartitionConfig.QueueSemaphoreOfPCPartitionConfig BswM_PCPartitionConfig.QueueWrittenOfPCPartitionConfig BswM_PCPartitionConfig.RuleStatesOfPCPartitionConfig BswM_PCPartitionConfig.RulesIndOfPCPartitionConfig BswM_PCPartitionConfig.RulesOfPCPartitionConfig BswM_PCPartitionConfig.SizeOfActionListsOfPCPartitionConfig BswM_PCPartitionConfig.SizeOfCanSMChannelMappingOfPCPartitionConfig BswM_PCPartitionConfig.SizeOfCanSMChannelStateOfPCPartitionConfig BswM_PCPartitionConfig.SizeOfComMChannelMappingOfPCPartitionConfig BswM_PCPartitionConfig.SizeOfComMChannelStateOfPCPartitionConfig BswM_PCPartitionConfig.SizeOfComMPncMappingOfPCPartitionConfig BswM_PCPartitionConfig.SizeOfComMPncStateOfPCPartitionConfig BswM_PCPartitionConfig.SizeOfDeferredRulesOfPCPartitionConfig BswM_PCPartitionConfig.SizeOfGenericMappingOfPCPartitionConfig BswM_PCPartitionConfig.SizeOfGenericStateOfPCPartitionConfig BswM_PCPartitionConfig.SizeOfImmediateUserOfPCPartitionConfig BswM_PCPartitionConfig.SizeOfModeNotificationFctOfPCPartitionConfig BswM_PCPartitionConfig.SizeOfNvMJobMappingOfPCPartitionConfig BswM_PCPartitionConfig.SizeOfNvMJobStateOfPCPartitionConfig BswM_PCPartitionConfig.SizeOfRuleStatesOfPCPartitionConfig BswM_PCPartitionConfig.SizeOfRulesIndOfPCPartitionConfig BswM_PCPartitionConfig.SizeOfRulesOfPCPartitionConfig BswM_PCPartitionConfig.SizeOfSwcModeRequestUpdateFctOfPCPartitionConfig BswM_PCPartitionConfig.SizeOfTimerStateOfPCPartitionConfig BswM_PCPartitionConfig.SizeOfTimerValueOfPCPartitionConfig BswM_PCPartitionConfig.SwcModeRequestUpdateFctOfPCPartitionConfig BswM_PCPartitionConfig.TimerStateOfPCPartitionConfig BswM_PCPartitionConfig.TimerValueOfPCPartitionConfig BswM_QueueSemaphoreOsApplication_SystemApplication_Core0 BswM_QueueSemaphoreOsApplication_SystemApplication_Core1 BswM_QueueWrittenOsApplication_SystemApplication_Core0 BswM_QueueWrittenOsApplication_SystemApplication_Core1 BswM_RuleStatesOsApplication_SystemApplication_Core0 BswM_RuleStatesOsApplication_SystemApplication_Core0_R_BswMRule_DCMRESET BswM_RuleStatesOsApplication_SystemApplication_Core0_R_CC_CN_BMC_CAN01_78a85e89_RX BswM_RuleStatesOsApplication_SystemApplication_Core0_R_CC_CN_BMC_CAN01_78a85e89_RX_DM BswM_RuleStatesOsApplication_SystemApplication_Core0_R_CC_CN_BMC_CAN01_78a85e89_TX BswM_RuleStatesOsApplication_SystemApplication_Core0_R_CC_CN_HCP5_CANFD01_54d90215_PNC_26_HighVoltage_Charging_24d89ab8_TX BswM_RuleStatesOsApplication_SystemApplication_Core0_R_CC_CN_HCP5_CANFD01_54d90215_RX BswM_RuleStatesOsApplication_SystemApplication_Core0_R_CC_CN_HCP5_CANFD01_54d90215_RX_DM BswM_RuleStatesOsApplication_SystemApplication_Core0_R_CC_CN_HCP5_CANFD01_54d90215_TX BswM_RuleStatesOsApplication_SystemApplication_Core0_R_CC_CN_HCP5_CANFD01_PNC_01_CarWakeUp_TX BswM_RuleStatesOsApplication_SystemApplication_Core0_R_CC_CN_HCP5_CANFD01_PNC_02_Basefunction_Powertrain_RX BswM_RuleStatesOsApplication_SystemApplication_Core0_R_CC_CN_HCP5_CANFD01_PNC_02_Basefunction_Powertrain_RX_DM BswM_RuleStatesOsApplication_SystemApplication_Core0_R_CC_CN_HCP5_CANFD01_PNC_06_Basefunction_ComfortLight_RX BswM_RuleStatesOsApplication_SystemApplication_Core0_R_CC_CN_HCP5_CANFD01_PNC_06_Basefunction_ComfortLight_RX_DM BswM_RuleStatesOsApplication_SystemApplication_Core0_R_CC_CN_HCP5_CANFD01_PNC_07_Basefunction_CrossSection_RX BswM_RuleStatesOsApplication_SystemApplication_Core0_R_CC_CN_HCP5_CANFD01_PNC_07_Basefunction_CrossSection_RX_DM BswM_RuleStatesOsApplication_SystemApplication_Core0_R_CC_CN_HCP5_CANFD01_PNC_10_Powertrain_RX BswM_RuleStatesOsApplication_SystemApplication_Core0_R_CC_CN_HCP5_CANFD01_PNC_10_Powertrain_RX_DM BswM_RuleStatesOsApplication_SystemApplication_Core0_R_CC_CN_HCP5_CANFD01_PNC_11_Chassis_RX BswM_RuleStatesOsApplication_SystemApplication_Core0_R_CC_CN_HCP5_CANFD01_PNC_11_Chassis_RX_DM BswM_RuleStatesOsApplication_SystemApplication_Core0_R_CC_CN_HCP5_CANFD01_PNC_13_Airbag_RX BswM_RuleStatesOsApplication_SystemApplication_Core0_R_CC_CN_HCP5_CANFD01_PNC_13_Airbag_RX_DM BswM_RuleStatesOsApplication_SystemApplication_Core0_R_CC_CN_HCP5_CANFD01_PNC_24_ThermoManagement_RX BswM_RuleStatesOsApplication_SystemApplication_Core0_R_CC_CN_HCP5_CANFD01_PNC_24_ThermoManagement_RX_DM BswM_RuleStatesOsApplication_SystemApplication_Core0_R_CC_CN_HCP5_CANFD01_PNC_26_HighVoltage_Charging_RX BswM_RuleStatesOsApplication_SystemApplication_Core0_R_CC_CN_HCP5_CANFD01_PNC_26_HighVoltage_Charging_RX_DM BswM_RuleStatesOsApplication_SystemApplication_Core0_R_CC_CN_HCP5_CANFD01_PNC_27_Timemaster_Timer_RX BswM_RuleStatesOsApplication_SystemApplication_Core0_R_CC_CN_HCP5_CANFD01_PNC_27_Timemaster_Timer_RX_DM BswM_RuleStatesOsApplication_SystemApplication_Core0_R_CC_CN_HCP5_CANFD01_PNC_30_EnergyManagement_RX BswM_RuleStatesOsApplication_SystemApplication_Core0_R_CC_CN_HCP5_CANFD01_PNC_30_EnergyManagement_RX_DM BswM_RuleStatesOsApplication_SystemApplication_Core0_R_CC_CN_HCP5_CANFD01_PNC_30_EnergyManagement_TX BswM_RuleStatesOsApplication_SystemApplication_Core0_R_CC_CN_HCP5_CANFD01_PNC_40_Diagnosis_Energy_RX BswM_RuleStatesOsApplication_SystemApplication_Core0_R_CC_CN_HCP5_CANFD01_PNC_40_Diagnosis_Energy_RX_DM BswM_RuleStatesOsApplication_SystemApplication_Core0_R_CC_CN_HCP5_CANFD01_PNC_40_Diagnosis_Energy_TX BswM_RuleStatesOsApplication_SystemApplication_Core0_R_ESH_InitToWakeup BswM_RuleStatesOsApplication_SystemApplication_Core0_R_ESH_PostRun BswM_RuleStatesOsApplication_SystemApplication_Core0_R_ESH_PostRunNested BswM_RuleStatesOsApplication_SystemApplication_Core0_R_ESH_PrepToWait BswM_RuleStatesOsApplication_SystemApplication_Core0_R_ESH_RunToPostRun BswM_RuleStatesOsApplication_SystemApplication_Core0_R_ESH_RunToPostRunNested BswM_RuleStatesOsApplication_SystemApplication_Core0_R_ESH_WaitToShutdown BswM_RuleStatesOsApplication_SystemApplication_Core0_R_ESH_WaitToWakeup BswM_RuleStatesOsApplication_SystemApplication_Core0_R_ESH_WakeupToPrep BswM_RuleStatesOsApplication_SystemApplication_Core0_R_ESH_WakeupToRun BswM_RulesIndOsApplication_SystemApplication_Core0 BswM_TimerStateOsApplication_SystemApplication_Core0 BswM_TimerStateOsApplication_SystemApplication_Core0_MRP_ESH_NvM_CancelWriteAllTimer BswM_TimerStateOsApplication_SystemApplication_Core0_MRP_ESH_NvM_WriteAllTimer BswM_TimerStateOsApplication_SystemApplication_Core0_MRP_ESH_SelfRunRequestTimer BswM_TimerValueOsApplication_SystemApplication_Core0 BswM_TimerValueOsApplication_SystemApplication_Core0_MRP_ESH_NvM_CancelWriteAllTimer BswM_TimerValueOsApplication_SystemApplication_Core0_MRP_ESH_NvM_WriteAllTimer BswM_TimerValueOsApplication_SystemApplication_Core0_MRP_ESH_SelfRunRequestTimer /end REF_MEASUREMENT
/end GROUP
/begin GROUP CanIf ""
 /begin REF_MEASUREMENT CanIf_CtrlStates.CtrlModeOfCtrlStates CanIf_CtrlStates.PduModeOfCtrlStates /end REF_MEASUREMENT
/end GROUP
/begin GROUP CanNm ""
 /begin REF_MEASUREMENT CanNm_ChannelConfig[0].ChannelIdOfChannelConfig CanNm_ChannelConfig[0].ComControlEnabledOfChannelConfig CanNm_ChannelConfig[0].ImmediateNmCycleTimeOfChannelConfig CanNm_ChannelConfig[0].ImmediateNmTransmissionsOfChannelConfig CanNm_ChannelConfig[0].MsgCycleTimeOfChannelConfig CanNm_ChannelConfig[0].MsgTimeoutTimeOfChannelConfig CanNm_ChannelConfig[0].PduCbvPositionOfChannelConfig CanNm_ChannelConfig[0].PduNidPositionOfChannelConfig CanNm_ChannelConfig[0].RemoteSleepIndTimeOfChannelConfig CanNm_ChannelConfig[0].RepeatMessageTimeOfChannelConfig CanNm_ChannelConfig[0].TimeoutTimeOfChannelConfig CanNm_ChannelConfig[0].WaitBusSleepTimeOfChannelConfig CanNm_ChannelConfig[1].ChannelIdOfChannelConfig CanNm_ChannelConfig[1].ComControlEnabledOfChannelConfig CanNm_ChannelConfig[1].ImmediateNmCycleTimeOfChannelConfig CanNm_ChannelConfig[1].ImmediateNmTransmissionsOfChannelConfig CanNm_ChannelConfig[1].MsgCycleTimeOfChannelConfig CanNm_ChannelConfig[1].MsgTimeoutTimeOfChannelConfig CanNm_ChannelConfig[1].PduCbvPositionOfChannelConfig CanNm_ChannelConfig[1].PduNidPositionOfChannelConfig CanNm_ChannelConfig[1].RemoteSleepIndTimeOfChannelConfig CanNm_ChannelConfig[1].RepeatMessageTimeOfChannelConfig CanNm_ChannelConfig[1].TimeoutTimeOfChannelConfig CanNm_ChannelConfig[1].WaitBusSleepTimeOfChannelConfig CanNm_CommState CanNm_CommState_CN_BMC_CAN01_78a85e89 CanNm_CommState_CN_HCP5_CANFD01_54d90215 CanNm_CoordReadyToSleepState CanNm_CoordReadyToSleepState_CN_BMC_CAN01_78a85e89 CanNm_CoordReadyToSleepState_CN_HCP5_CANFD01_54d90215 CanNm_ImmediateNmMsgCount CanNm_ImmediateNmMsgCount_CN_BMC_CAN01_78a85e89 CanNm_ImmediateNmMsgCount_CN_HCP5_CANFD01_54d90215 CanNm_MsgConfirmationFlag CanNm_MsgConfirmationFlag_CN_BMC_CAN01_78a85e89 CanNm_MsgConfirmationFlag_CN_HCP5_CANFD01_54d90215 CanNm_MsgIndicationFlag CanNm_MsgIndicationFlag_CN_BMC_CAN01_78a85e89 CanNm_MsgIndicationFlag_CN_HCP5_CANFD01_54d90215 CanNm_MsgRequest CanNm_MsgRequest_CN_BMC_CAN01_78a85e89 CanNm_MsgRequest_CN_HCP5_CANFD01_54d90215 CanNm_MsgTimeoutTimer CanNm_MsgTimeoutTimer_CN_BMC_CAN01_78a85e89 CanNm_MsgTimeoutTimer_CN_HCP5_CANFD01_54d90215 CanNm_MsgTimer CanNm_MsgTimer_CN_BMC_CAN01_78a85e89 CanNm_MsgTimer_CN_HCP5_CANFD01_54d90215 CanNm_NetworkRestartFlag CanNm_NetworkRestartFlag_CN_BMC_CAN01_78a85e89 CanNm_NetworkRestartFlag_CN_HCP5_CANFD01_54d90215 CanNm_NmState CanNm_NmState_CN_BMC_CAN01_78a85e89 CanNm_NmState_CN_HCP5_CANFD01_54d90215 CanNm_PbChannelConfig[0].MsgCycleOffsetOfPbChannelConfig CanNm_PbChannelConfig[0].PnEnabledOfPbChannelConfig CanNm_PbChannelConfig[0].RxMessageDataEndIdxOfPbChannelConfig CanNm_PbChannelConfig[0].RxMessageDataLengthOfPbChannelConfig CanNm_PbChannelConfig[0].RxMessageDataStartIdxOfPbChannelConfig CanNm_PbChannelConfig[0].RxMessageData_CBVIdxOfPbChannelConfig CanNm_PbChannelConfig[0].RxMessageData_NIDIdxOfPbChannelConfig CanNm_PbChannelConfig[0].RxMessageData_UserDataEndIdxOfPbChannelConfig CanNm_PbChannelConfig[0].RxMessageData_UserDataLengthOfPbChannelConfig CanNm_PbChannelConfig[0].RxMessageData_UserDataStartIdxOfPbChannelConfig CanNm_PbChannelConfig[0].TxMessageDataEndIdxOfPbChannelConfig CanNm_PbChannelConfig[0].TxMessageDataLengthOfPbChannelConfig CanNm_PbChannelConfig[0].TxMessageDataStartIdxOfPbChannelConfig CanNm_PbChannelConfig[0].TxMessageData_CBVIdxOfPbChannelConfig CanNm_PbChannelConfig[0].TxMessageData_NIDIdxOfPbChannelConfig CanNm_PbChannelConfig[0].TxMessageData_PnFilterMaskEndIdxOfPbChannelConfig CanNm_PbChannelConfig[0].TxMessageData_PnFilterMaskStartIdxOfPbChannelConfig CanNm_PbChannelConfig[0].TxMessageData_UserDataEndIdxOfPbChannelConfig CanNm_PbChannelConfig[0].TxMessageData_UserDataLengthOfPbChannelConfig CanNm_PbChannelConfig[0].TxMessageData_UserDataStartIdxOfPbChannelConfig CanNm_PbChannelConfig[0].TxPduIdOfPbChannelConfig CanNm_PbChannelConfig[0].TxUserDataPduIdOfPbChannelConfig CanNm_PbChannelConfig[1].MsgCycleOffsetOfPbChannelConfig CanNm_PbChannelConfig[1].PnEnabledOfPbChannelConfig CanNm_PbChannelConfig[1].RxMessageDataEndIdxOfPbChannelConfig CanNm_PbChannelConfig[1].RxMessageDataLengthOfPbChannelConfig CanNm_PbChannelConfig[1].RxMessageDataStartIdxOfPbChannelConfig CanNm_PbChannelConfig[1].RxMessageData_CBVIdxOfPbChannelConfig CanNm_PbChannelConfig[1].RxMessageData_NIDIdxOfPbChannelConfig CanNm_PbChannelConfig[1].RxMessageData_UserDataEndIdxOfPbChannelConfig CanNm_PbChannelConfig[1].RxMessageData_UserDataLengthOfPbChannelConfig CanNm_PbChannelConfig[1].RxMessageData_UserDataStartIdxOfPbChannelConfig CanNm_PbChannelConfig[1].TxMessageDataEndIdxOfPbChannelConfig CanNm_PbChannelConfig[1].TxMessageDataLengthOfPbChannelConfig CanNm_PbChannelConfig[1].TxMessageDataStartIdxOfPbChannelConfig CanNm_PbChannelConfig[1].TxMessageData_CBVIdxOfPbChannelConfig CanNm_PbChannelConfig[1].TxMessageData_NIDIdxOfPbChannelConfig CanNm_PbChannelConfig[1].TxMessageData_PnFilterMaskEndIdxOfPbChannelConfig CanNm_PbChannelConfig[1].TxMessageData_PnFilterMaskStartIdxOfPbChannelConfig CanNm_PbChannelConfig[1].TxMessageData_UserDataEndIdxOfPbChannelConfig CanNm_PbChannelConfig[1].TxMessageData_UserDataLengthOfPbChannelConfig CanNm_PbChannelConfig[1].TxMessageData_UserDataStartIdxOfPbChannelConfig CanNm_PbChannelConfig[1].TxPduIdOfPbChannelConfig CanNm_PbChannelConfig[1].TxUserDataPduIdOfPbChannelConfig CanNm_PnClusterReq CanNm_PnClusterReqNew CanNm_PnClusterReqNew_CanNmPnFilterMaskByte_0 CanNm_PnClusterReqNew_CanNmPnFilterMaskByte_1 CanNm_PnClusterReqNew_CanNmPnFilterMaskByte_2 CanNm_PnClusterReqNew_CanNmPnFilterMaskByte_3 CanNm_PnClusterReqNew_CanNmPnFilterMaskByte_4 CanNm_PnClusterReqNew_CanNmPnFilterMaskByte_5 CanNm_PnClusterReqNew_CanNmPnFilterMaskByte_6 CanNm_PnClusterReq_CanNmPnFilterMaskByte_0 CanNm_PnClusterReq_CanNmPnFilterMaskByte_1 CanNm_PnClusterReq_CanNmPnFilterMaskByte_2 CanNm_PnClusterReq_CanNmPnFilterMaskByte_3 CanNm_PnClusterReq_CanNmPnFilterMaskByte_4 CanNm_PnClusterReq_CanNmPnFilterMaskByte_5 CanNm_PnClusterReq_CanNmPnFilterMaskByte_6 CanNm_PnClusterResetTimer CanNm_PnClusterResetTimer_CanNmPnFilterMaskByte_0 CanNm_PnClusterResetTimer_CanNmPnFilterMaskByte_1 CanNm_PnClusterResetTimer_CanNmPnFilterMaskByte_2 CanNm_PnClusterResetTimer_CanNmPnFilterMaskByte_3 CanNm_PnClusterResetTimer_CanNmPnFilterMaskByte_4 CanNm_PnClusterResetTimer_CanNmPnFilterMaskByte_5 CanNm_PnClusterResetTimer_CanNmPnFilterMaskByte_6 CanNm_PnInfoByteConfig[0].PnClusterResetTimerEndIdxOfPnInfoByteConfig CanNm_PnInfoByteConfig[0].PnClusterResetTimerStartIdxOfPnInfoByteConfig CanNm_PnInfoByteConfig[0].PnFilterMaskOfPnInfoByteConfig CanNm_PnInfoByteConfig[1].PnClusterResetTimerEndIdxOfPnInfoByteConfig CanNm_PnInfoByteConfig[1].PnClusterResetTimerStartIdxOfPnInfoByteConfig CanNm_PnInfoByteConfig[1].PnFilterMaskOfPnInfoByteConfig CanNm_PnInfoByteConfig[2].PnClusterResetTimerEndIdxOfPnInfoByteConfig CanNm_PnInfoByteConfig[2].PnClusterResetTimerStartIdxOfPnInfoByteConfig CanNm_PnInfoByteConfig[2].PnFilterMaskOfPnInfoByteConfig CanNm_PnInfoByteConfig[3].PnClusterResetTimerEndIdxOfPnInfoByteConfig CanNm_PnInfoByteConfig[3].PnClusterResetTimerStartIdxOfPnInfoByteConfig CanNm_PnInfoByteConfig[3].PnFilterMaskOfPnInfoByteConfig CanNm_PnInfoByteConfig[4].PnClusterResetTimerEndIdxOfPnInfoByteConfig CanNm_PnInfoByteConfig[4].PnClusterResetTimerStartIdxOfPnInfoByteConfig CanNm_PnInfoByteConfig[4].PnFilterMaskOfPnInfoByteConfig CanNm_PnInfoByteConfig[5].PnClusterResetTimerEndIdxOfPnInfoByteConfig CanNm_PnInfoByteConfig[5].PnClusterResetTimerStartIdxOfPnInfoByteConfig CanNm_PnInfoByteConfig[5].PnFilterMaskOfPnInfoByteConfig CanNm_PnInfoByteConfig[6].PnClusterResetTimerEndIdxOfPnInfoByteConfig CanNm_PnInfoByteConfig[6].PnClusterResetTimerStartIdxOfPnInfoByteConfig CanNm_PnInfoByteConfig[6].PnFilterMaskOfPnInfoByteConfig CanNm_PnMessageFilterDeactivationIndicated CanNm_PnMessageFilterDeactivationIndicated_CN_BMC_CAN01_78a85e89 CanNm_PnMessageFilterDeactivationIndicated_CN_HCP5_CANFD01_54d90215 CanNm_PnMessageFilterEnabled CanNm_PnMessageFilterEnabled_CN_BMC_CAN01_78a85e89 CanNm_PnMessageFilterEnabled_CN_HCP5_CANFD01_54d90215 CanNm_RepeatMsgTimer CanNm_RepeatMsgTimer_CN_BMC_CAN01_78a85e89 CanNm_RepeatMsgTimer_CN_HCP5_CANFD01_54d90215 CanNm_RxMessageData CanNm_SysToNmChInd CanNm_TimeoutTimer CanNm_TimeoutTimer_CN_BMC_CAN01_78a85e89 CanNm_TimeoutTimer_CN_HCP5_CANFD01_54d90215 CanNm_TxControlState CanNm_TxControlStateRequest CanNm_TxControlStateRequest_CN_BMC_CAN01_78a85e89 CanNm_TxControlStateRequest_CN_HCP5_CANFD01_54d90215 CanNm_TxControlState_CN_BMC_CAN01_78a85e89 CanNm_TxControlState_CN_HCP5_CANFD01_54d90215 CanNm_TxMessageData CanNm_WaitBusSleepTimer CanNm_WaitBusSleepTimer_CN_BMC_CAN01_78a85e89 CanNm_WaitBusSleepTimer_CN_HCP5_CANFD01_54d90215 /end REF_MEASUREMENT
/end GROUP
/end MODULE
/end PROJECT
