[part 2 of 4: package /MICROSAR/Dcm_swc/Interfaces]
AUTOSAR XML (schema 00048)
package /MICROSAR/Dcm_swc/Interfaces  (continued)
  378 x client server interface, all with is-service=true, service-kind=DIAGNOSTIC-COMMUNICATION-MANAGER:  (continued)
    DataServices_Data_TABROW_IsolaResisSysteMinus_ReadDataByIdent
      operation ReadData: possible-error=[DataServices_Data_TABROW_IsolaResisSysteMinus_ReadDataByIdent/E_NOT_OK, DataServices_Data_TABROW_IsolaResisSysteMinus_ReadDataByIdent/DCM_E_PENDING]
        arg OpStatus: type=Dcm_OpStatusType, direction=IN
        arg Data: type=Dcm_Data2ByteType, direction=OUT
      operation ConditionCheckRead: possible-error=[DataServices_Data_TABROW_IsolaResisSysteMinus_ReadDataByIdent/E_NOT_OK, DataServices_Data_TABROW_IsolaResisSysteMinus_ReadDataByIdent/DCM_E_PENDING]
        arg OpStatus: type=Dcm_OpStatusType, direction=IN
        arg ErrorCode: type=Dcm_NegativeResponseCodeType, direction=OUT
      error E_NOT_OK: error-code=1
      error DCM_E_PENDING: error-code=10
    DataServices_Data_DiagnServi_TABROW_NeuMeasu_Read_43_1_1_1_1_1
      operation ReadData: possible-error=[DataServices_Data_DiagnServi_TABROW_NeuMeasu_Read_43_1_1_1_1_1/E_NOT_OK, DataServices_Data_DiagnServi_TABROW_NeuMeasu_Read_43_1_1_1_1_1/DCM_E_PENDING]
        arg OpStatus: type=Dcm_OpStatusType, direction=IN
        arg Data: type=Dcm_Data64ByteType, direction=OUT
      operation ConditionCheckRead: possible-error=[DataServices_Data_DiagnServi_TABROW_NeuMeasu_Read_43_1_1_1_1_1/E_NOT_OK, DataServices_Data_DiagnServi_TABROW_NeuMeasu_Read_43_1_1_1_1_1/DCM_E_PENDING]
        arg OpStatus: type=Dcm_OpStatusType, direction=IN
        arg ErrorCode: type=Dcm_NegativeResponseCodeType, direction=OUT
      error E_NOT_OK: error-code=1
      error DCM_E_PENDING: error-code=10
    DataServices_Data_BMC_IWU_Status_Read_Data_By_Identifier
      operation ReadData: possible-error=[DataServices_Data_BMC_IWU_Status_Read_Data_By_Identifier/E_NOT_OK, DataServices_Data_BMC_IWU_Status_Read_Data_By_Identifier/DCM_E_PENDING]
        arg OpStatus: type=Dcm_OpStatusType, direction=IN
        arg Data: type=Dcm_Data1ByteType, direction=OUT
      operation ConditionCheckRead: possible-error=[DataServices_Data_BMC_IWU_Status_Read_Data_By_Identifier/E_NOT_OK, DataServices_Data_BMC_IWU_Status_Read_Data_By_Identifier/DCM_E_PENDING]
        arg OpStatus: type=Dcm_OpStatusType, direction=IN
        arg ErrorCode: type=Dcm_NegativeResponseCodeType, direction=OUT
      error E_NOT_OK: error-code=1
      error DCM_E_PENDING: error-code=10
    DataServices_Data_DiagnServi_Type_number_BMCE_Read
      operation ReadData: possible-error=[DataServices_Data_DiagnServi_Type_number_BMCE_Read/E_NOT_OK, DataServices_Data_DiagnServi_Type_number_BMCE_Read/DCM_E_PENDING]
        arg OpStatus: type=Dcm_OpStatusType, direction=IN
        arg Data: type=Dcm_Data11ByteType, direction=OUT
      operation ConditionCheckRead: possible-error=[DataServices_Data_DiagnServi_Type_number_BMCE_Read/E_NOT_OK, DataServices_Data_DiagnServi_Type_number_BMCE_Read/DCM_E_PENDING]
        arg OpStatus: type=Dcm_OpStatusType, direction=IN
        arg ErrorCode: type=Dcm_NegativeResponseCodeType, direction=OUT
      operation WriteData: possible-error=[DataServices_Data_DiagnServi_Type_number_BMCE_Read/E_NOT_OK, DataServices_Data_DiagnServi_Type_number_BMCE_Read/DCM_E_PENDING]
        arg Data: type=Dcm_Data11ByteType, direction=IN
        arg OpStatus: type=Dcm_OpStatusType, direction=IN
        arg ErrorCode: type=Dcm_NegativeResponseCodeType, direction=OUT
      error E_NOT_OK: error-code=1
      error DCM_E_PENDING: error-code=10
    DataServices_Data_HV_battery_continuous_discharge_power_Read_Data_By_Identifier
      operation ReadData: possible-error=[DataServices_Data_HV_battery_continuous_discharge_power_Read_Data_By_Identifier/E_NOT_OK, DataServices_Data_HV_battery_continuous_discharge_power_Read_Data_By_Identifier/DCM_E_PENDING]
        arg OpStatus: type=Dcm_OpStatusType, direction=IN
        arg Data: type=Dcm_Data2ByteType, direction=OUT
      operation ConditionCheckRead: possible-error=[DataServices_Data_HV_battery_continuous_discharge_power_Read_Data_By_Identifier/E_NOT_OK, DataServices_Data_HV_battery_continuous_discharge_power_Read_Data_By_Identifier/DCM_E_PENDING]
        arg OpStatus: type=Dcm_OpStatusType, direction=IN
        arg ErrorCode: type=Dcm_NegativeResponseCodeType, direction=OUT
      error E_NOT_OK: error-code=1
      error DCM_E_PENDING: error-code=10
    DataServices_Data_DiagnServi_TABROW_BootlTPBlock_Read
      operation ReadData: possible-error=[DataServices_Data_DiagnServi_TABROW_BootlTPBlock_Read/E_NOT_OK, DataServices_Data_DiagnServi_TABROW_BootlTPBlock_Read/DCM_E_PENDING]
        arg OpStatus: type=Dcm_OpStatusType, direction=IN
        arg Data: type=Dcm_Data1ByteType, direction=OUT
      operation ConditionCheckRead: possible-error=[DataServices_Data_DiagnServi_TABROW_BootlTPBlock_Read/E_NOT_OK, DataServices_Data_DiagnServi_TABROW_BootlTPBlock_Read/DCM_E_PENDING]
        arg OpStatus: type=Dcm_OpStatusType, direction=IN
        arg ErrorCode: type=Dcm_NegativeResponseCodeType, direction=OUT
      operation WriteData: possible-error=[DataServices_Data_DiagnServi_TABROW_BootlTPBlock_Read/E_NOT_OK, DataServices_Data_DiagnServi_TABROW_BootlTPBlock_Read/DCM_E_PENDING]
        arg Data: type=Dcm_Data1ByteType, direction=IN
        arg OpStatus: type=Dcm_OpStatusType, direction=IN
        arg ErrorCode: type=Dcm_NegativeResponseCodeType, direction=OUT
      error E_NOT_OK: error-code=1
      error DCM_E_PENDING: error-code=10
    DataServices_Data_DiagnServi_ReadDataByIdentVWLogicBlockDowngProteVersi
      operation ReadData: possible-error=[DataServices_Data_DiagnServi_ReadDataByIdentVWLogicBlockDowngProteVersi/E_NOT_OK, DataServices_Data_DiagnServi_ReadDataByIdentVWLogicBlockDowngProteVersi/DCM_E_PENDING]
        arg OpStatus: type=Dcm_OpStatusType, direction=IN
        arg Data: type=Dcm_Data8192ByteType, direction=OUT
      operation ReadDataLength: possible-error=[DataServices_Data_DiagnServi_ReadDataByIdentVWLogicBlockDowngProteVersi/E_NOT_OK, DataServices_Data_DiagnServi_ReadDataByIdentVWLogicBlockDowngProteVersi/DCM_E_PENDING]
        arg OpStatus: type=Dcm_OpStatusType, direction=IN
        arg DataLength: type=uint16, direction=OUT
      operation ConditionCheckRead: possible-error=[DataServices_Data_DiagnServi_ReadDataByIdentVWLogicBlockDowngProteVersi/E_NOT_OK, DataServices_Data_DiagnServi_ReadDataByIdentVWLogicBlockDowngProteVersi/DCM_E_PENDING]
        arg OpStatus: type=Dcm_OpStatusType, direction=IN
        arg ErrorCode: type=Dcm_NegativeResponseCodeType, direction=OUT
      error E_NOT_OK: error-code=1
      error DCM_E_PENDING: error-code=10
    DataServices_Data_DiagnServi_TABROW_NeuMeasu_Read_29_1_1_1_1
      operation ReadData: possible-error=[DataServices_Data_DiagnServi_TABROW_NeuMeasu_Read_29_1_1_1_1/E_NOT_OK, DataServices_Data_DiagnServi_TABROW_NeuMeasu_Read_29_1_1_1_1/DCM_E_PENDING]
        arg OpStatus: type=Dcm_OpStatusType, direction=IN
        arg Data: type=Dcm_Data4ByteType, direction=OUT
      operation ConditionCheckRead: possible-error=[DataServices_Data_DiagnServi_TABROW_NeuMeasu_Read_29_1_1_1_1/E_NOT_OK, DataServices_Data_DiagnServi_TABROW_NeuMeasu_Read_29_1_1_1_1/DCM_E_PENDING]
        arg OpStatus: type=Dcm_OpStatusType, direction=IN
        arg ErrorCode: type=Dcm_NegativeResponseCodeType, direction=OUT
      error E_NOT_OK: error-code=1
      error DCM_E_PENDING: error-code=10
    DataServices_Data_TABROW_ModeOfProteOfVehicDiagn_ReadDataByIdentifier
      operation ReadData: possible-error=[DataServices_Data_TABROW_ModeOfProteOfVehicDiagn_ReadDataByIdentifier/E_NOT_OK, DataServices_Data_TABROW_ModeOfProteOfVehicDiagn_ReadDataByIdentifier/DCM_E_PENDING]
        arg OpStatus: type=Dcm_OpStatusType, direction=IN
        arg Data: type=Dcm_Data1ByteType, direction=OUT
      operation ConditionCheckRead: possible-error=[DataServices_Data_TABROW_ModeOfProteOfVehicDiagn_ReadDataByIdentifier/E_NOT_OK, DataServices_Data_TABROW_ModeOfProteOfVehicDiagn_ReadDataByIdentifier/DCM_E_PENDING]
        arg OpStatus: type=Dcm_OpStatusType, direction=IN
        arg ErrorCode: type=Dcm_NegativeResponseCodeType, direction=OUT
      error E_NOT_OK: error-code=1
      error DCM_E_PENDING: error-code=10
    DataServices_Data_TABROW_TABROSyste_Read_1_1_1_1_1_1_1_1_1_1_1_1_1
      operation ReadData: possible-error=[DataServices_Data_TABROW_TABROSyste_Read_1_1_1_1_1_1_1_1_1_1_1_1_1/E_NOT_OK, DataServices_Data_TABROW_TABROSyste_Read_1_1_1_1_1_1_1_1_1_1_1_1_1/DCM_E_PENDING]
        arg OpStatus: type=Dcm_OpStatusType, direction=IN
        arg Data: type=Dcm_Data14ByteType, direction=OUT
      operation ConditionCheckRead: possible-error=[DataServices_Data_TABROW_TABROSyste_Read_1_1_1_1_1_1_1_1_1_1_1_1_1/E_NOT_OK, DataServices_Data_TABROW_TABROSyste_Read_1_1_1_1_1_1_1_1_1_1_1_1_1/DCM_E_PENDING]
        arg OpStatus: type=Dcm_OpStatusType, direction=IN
        arg ErrorCode: type=Dcm_NegativeResponseCodeType, direction=OUT
      error E_NOT_OK: error-code=1
      error DCM_E_PENDING: error-code=10
    DataServices_Data_Battery_energy_content_maximum_Read_Data_By_Identifier
      operation ReadData: possible-error=[DataServices_Data_Battery_energy_content_maximum_Read_Data_By_Identifier/E_NOT_OK, DataServices_Data_Battery_energy_content_maximum_Read_Data_By_Identifier/DCM_E_PENDING]
        arg OpStatus: type=Dcm_OpStatusType, direction=IN
        arg Data: type=Dcm_Data2ByteType, direction=OUT
      operation ConditionCheckRead: possible-error=[DataServices_Data_Battery_energy_content_maximum_Read_Data_By_Identifier/E_NOT_OK, DataServices_Data_Battery_energy_content_maximum_Read_Data_By_Identifier/DCM_E_PENDING]
        arg OpStatus: type=Dcm_OpStatusType, direction=IN
        arg ErrorCode: type=Dcm_NegativeResponseCodeType, direction=OUT
      error E_NOT_OK: error-code=1
      error DCM_E_PENDING: error-code=10
    DataServices_Data_DiagnServi_TABROW_TechnSpeciVersi_Read
      operation ReadData: possible-error=[DataServices_Data_DiagnServi_TABROW_TechnSpeciVersi_Read/E_NOT_OK, DataServices_Data_DiagnServi_TABROW_TechnSpeciVersi_Read/DCM_E_PENDING]
        arg OpStatus: type=Dcm_OpStatusType, direction=IN
        arg Data: type=Dcm_Data26ByteType, direction=OUT
      operation ConditionCheckRead: possible-error=[DataServices_Data_DiagnServi_TABROW_TechnSpeciVersi_Read/E_NOT_OK, DataServices_Data_DiagnServi_TABROW_TechnSpeciVersi_Read/DCM_E_PENDING]
        arg OpStatus: type=Dcm_OpStatusType, direction=IN
        arg ErrorCode: type=Dcm_NegativeResponseCodeType, direction=OUT
      error E_NOT_OK: error-code=1
      error DCM_E_PENDING: error-code=10
    DataServices_Data_BMC_Strom_Read_Data_By_Identifier
      operation ReadData: possible-error=[DataServices_Data_BMC_Strom_Read_Data_By_Identifier/E_NOT_OK, DataServices_Data_BMC_Strom_Read_Data_By_Identifier/DCM_E_PENDING]
        arg OpStatus: type=Dcm_OpStatusType, direction=IN
        arg Data: type=Dcm_Data2ByteType, direction=OUT
      operation ConditionCheckRead: possible-error=[DataServices_Data_BMC_Strom_Read_Data_By_Identifier/E_NOT_OK, DataServices_Data_BMC_Strom_Read_Data_By_Identifier/DCM_E_PENDING]
        arg OpStatus: type=Dcm_OpStatusType, direction=IN
        arg ErrorCode: type=Dcm_NegativeResponseCodeType, direction=OUT
      error E_NOT_OK: error-code=1
      error DCM_E_PENDING: error-code=10
    DataServices_Data_DiagnServi_TABROW_UnlocStatuOfECUOfProteOfVehicDiagn_Read
      operation ReadData: possible-error=[DataServices_Data_DiagnServi_TABROW_UnlocStatuOfECUOfProteOfVehicDiagn_Read/E_NOT_OK, DataServices_Data_DiagnServi_TABROW_UnlocStatuOfECUOfProteOfVehicDiagn_Read/DCM_E_PENDING]
        arg OpStatus: type=Dcm_OpStatusType, direction=IN
        arg Data: type=Dcm_Data4ByteType, direction=OUT
      operation ConditionCheckRead: possible-error=[DataServices_Data_DiagnServi_TABROW_UnlocStatuOfECUOfProteOfVehicDiagn_Read/E_NOT_OK, DataServices_Data_DiagnServi_TABROW_UnlocStatuOfECUOfProteOfVehicDiagn_Read/DCM_E_PENDING]
        arg OpStatus: type=Dcm_OpStatusType, direction=IN
        arg ErrorCode: type=Dcm_NegativeResponseCodeType, direction=OUT
      error E_NOT_OK: error-code=1
      error DCM_E_PENDING: error-code=10
    DataServices_Data_DiagnServi_TABROW_DID0x0EF_Read
      operation ReadData: possible-error=[DataServices_Data_DiagnServi_TABROW_DID0x0EF_Read/E_NOT_OK, DataServices_Data_DiagnServi_TABROW_DID0x0EF_Read/DCM_E_PENDING]
        arg OpStatus: type=Dcm_OpStatusType, direction=IN
        arg Data: type=Dcm_Data24ByteType, direction=OUT
      operation ConditionCheckRead: possible-error=[DataServices_Data_DiagnServi_TABROW_DID0x0EF_Read/E_NOT_OK, DataServices_Data_DiagnServi_TABROW_DID0x0EF_Read/DCM_E_PENDING]
        arg OpStatus: type=Dcm_OpStatusType, direction=IN
        arg ErrorCode: type=Dcm_NegativeResponseCodeType, direction=OUT
      error E_NOT_OK: error-code=1
      error DCM_E_PENDING: error-code=10
    DataServices_Data_DiagnServi_TABROW_ContrModulVolta_Read
      operation ReadData: possible-error=[DataServices_Data_DiagnServi_TABROW_ContrModulVolta_Read/E_NOT_OK, DataServices_Data_DiagnServi_TABROW_ContrModulVolta_Read/DCM_E_PENDING]
        arg OpStatus: type=Dcm_OpStatusType, direction=IN
        arg Data: type=Dcm_Data2ByteType, direction=OUT
      operation ConditionCheckRead: possible-error=[DataServices_Data_DiagnServi_TABROW_ContrModulVolta_Read/E_NOT_OK, DataServices_Data_DiagnServi_TABROW_ContrModulVolta_Read/DCM_E_PENDING]
        arg OpStatus: type=Dcm_OpStatusType, direction=IN
        arg ErrorCode: type=Dcm_NegativeResponseCodeType, direction=OUT
      error E_NOT_OK: error-code=1
      error DCM_E_PENDING: error-code=10
    DataServices_Data_TABROW_VkmsMissiKeyHisto_Read_Data_By_Identifier
      operation ReadData: possible-error=[DataServices_Data_TABROW_VkmsMissiKeyHisto_Read_Data_By_Identifier/E_NOT_OK, DataServices_Data_TABROW_VkmsMissiKeyHisto_Read_Data_By_Identifier/DCM_E_PENDING]
        arg OpStatus: type=Dcm_OpStatusType, direction=IN
        arg Data: type=Dcm_Data512ByteType, direction=OUT
      operation ReadDataLength: possible-error=[DataServices_Data_TABROW_VkmsMissiKeyHisto_Read_Data_By_Identifier/E_NOT_OK, DataServices_Data_TABROW_VkmsMissiKeyHisto_Read_Data_By_Identifier/DCM_E_PENDING]
        arg OpStatus: type=Dcm_OpStatusType, direction=IN
        arg DataLength: type=uint16, direction=OUT
      operation ConditionCheckRead: possible-error=[DataServices_Data_TABROW_VkmsMissiKeyHisto_Read_Data_By_Identifier/E_NOT_OK, DataServices_Data_TABROW_VkmsMissiKeyHisto_Read_Data_By_Identifier/DCM_E_PENDING]
        arg OpStatus: type=Dcm_OpStatusType, direction=IN
        arg ErrorCode: type=Dcm_NegativeResponseCodeType, direction=OUT
      error E_NOT_OK: error-code=1
      error DCM_E_PENDING: error-code=10
    DataServices_Data_DiagnServi_TABROW_AUTOSStandAppliSoftwIdent_Read
      operation ReadData: possible-error=[DataServices_Data_DiagnServi_TABROW_AUTOSStandAppliSoftwIdent_Read/E_NOT_OK, DataServices_Data_DiagnServi_TABROW_AUTOSStandAppliSoftwIdent_Read/DCM_E_PENDING]
        arg OpStatus: type=Dcm_OpStatusType, direction=IN
        arg Data: type=Dcm_Data8192ByteType, direction=OUT
      operation ReadDataLength: possible-error=[DataServices_Data_DiagnServi_TABROW_AUTOSStandAppliSoftwIdent_Read/E_NOT_OK, DataServices_Data_DiagnServi_TABROW_AUTOSStandAppliSoftwIdent_Read/DCM_E_PENDING]
        arg OpStatus: type=Dcm_OpStatusType, direction=IN
        arg DataLength: type=uint16, direction=OUT
      operation ConditionCheckRead: possible-error=[DataServices_Data_DiagnServi_TABROW_AUTOSStandAppliSoftwIdent_Read/E_NOT_OK, DataServices_Data_DiagnServi_TABROW_AUTOSStandAppliSoftwIdent_Read/DCM_E_PENDING]
        arg OpStatus: type=Dcm_OpStatusType, direction=IN
        arg ErrorCode: type=Dcm_NegativeResponseCodeType, direction=OUT
      error E_NOT_OK: error-code=1
      error DCM_E_PENDING: error-code=10
    DataServices_Data_DiagnServi_TABROW_TABRORespo_Read_Data_By_Identifier
      operation ReadData: possible-error=[DataServices_Data_DiagnServi_TABROW_TABRORespo_Read_Data_By_Identifier/E_NOT_OK, DataServices_Data_DiagnServi_TABROW_TABRORespo_Read_Data_By_Identifier/DCM_E_PENDING]
        arg OpStatus: type=Dcm_OpStatusType, direction=IN
        arg Data: type=Dcm_Data1ByteType, direction=OUT
      operation ConditionCheckRead: possible-error=[DataServices_Data_DiagnServi_TABROW_TABRORespo_Read_Data_By_Identifier/E_NOT_OK, DataServices_Data_DiagnServi_TABROW_TABRORespo_Read_Data_By_Identifier/DCM_E_PENDING]
        arg OpStatus: type=Dcm_OpStatusType, direction=IN
        arg ErrorCode: type=Dcm_NegativeResponseCodeType, direction=OUT
      error E_NOT_OK: error-code=1
      error DCM_E_PENDING: error-code=10
    DataServices_Data_Battery_energy_content_actual_Read_Data_By_Identifier
      operation ReadData: possible-error=[DataServices_Data_Battery_energy_content_actual_Read_Data_By_Identifier/E_NOT_OK, DataServices_Data_Battery_energy_content_actual_Read_Data_By_Identifier/DCM_E_PENDING]
        arg OpStatus: type=Dcm_OpStatusType, direction=IN
        arg Data: type=Dcm_Data4ByteType, direction=OUT
      operation ConditionCheckRead: possible-error=[DataServices_Data_Battery_energy_content_actual_Read_Data_By_Identifier/E_NOT_OK, DataServices_Data_Battery_energy_content_actual_Read_Data_By_Identifier/DCM_E_PENDING]
        arg OpStatus: type=Dcm_OpStatusType, direction=IN
        arg ErrorCode: type=Dcm_NegativeResponseCodeType, direction=OUT
      error E_NOT_OK: error-code=1
      error DCM_E_PENDING: error-code=10
    DataServices_Data_TABROW_SOKGenerInfor_Read_Data_By_Identifier
      operation ReadData: possible-error=[DataServices_Data_TABROW_SOKGenerInfor_Read_Data_By_Identifier/E_NOT_OK, DataServices_Data_TABROW_SOKGenerInfor_Read_Data_By_Identifier/DCM_E_PENDING]
        arg OpStatus: type=Dcm_OpStatusType, direction=IN
        arg Data: type=Dcm_Data3ByteType, direction=OUT
      operation ConditionCheckRead: possible-error=[DataServices_Data_TABROW_SOKGenerInfor_Read_Data_By_Identifier/E_NOT_OK, DataServices_Data_TABROW_SOKGenerInfor_Read_Data_By_Identifier/DCM_E_PENDING]
        arg OpStatus: type=Dcm_OpStatusType, direction=IN
        arg ErrorCode: type=Dcm_NegativeResponseCodeType, direction=OUT
      error E_NOT_OK: error-code=1
      error DCM_E_PENDING: error-code=10
    DataServices_Data_DiagnServi_ReadDataByIdentVWLogicSoftwBlockVersi
      operation ReadData: possible-error=[DataServices_Data_DiagnServi_ReadDataByIdentVWLogicSoftwBlockVersi/E_NOT_OK, DataServices_Data_DiagnServi_ReadDataByIdentVWLogicSoftwBlockVersi/DCM_E_PENDING]
        arg OpStatus: type=Dcm_OpStatusType, direction=IN
        arg Data: type=Dcm_Data24ByteType, direction=OUT
      operation ConditionCheckRead: possible-error=[DataServices_Data_DiagnServi_ReadDataByIdentVWLogicSoftwBlockVersi/E_NOT_OK, DataServices_Data_DiagnServi_ReadDataByIdentVWLogicSoftwBlockVersi/DCM_E_PENDING]
        arg OpStatus: type=Dcm_OpStatusType, direction=IN
        arg ErrorCode: type=Dcm_NegativeResponseCodeType, direction=OUT
      error E_NOT_OK: error-code=1
      error DCM_E_PENDING: error-code=10
    DataServices_Data_HV_battery_maximum_charging_current_Read_Data_By_Identifier
      operation ReadData: possible-error=[DataServices_Data_HV_battery_maximum_charging_current_Read_Data_By_Identifier/E_NOT_OK, DataServices_Data_HV_battery_maximum_charging_current_Read_Data_By_Identifier/DCM_E_PENDING]
        arg OpStatus: type=Dcm_OpStatusType, direction=IN
        arg Data: type=Dcm_Data2ByteType, direction=OUT
      operation ConditionCheckRead: possible-error=[DataServices_Data_HV_battery_maximum_charging_current_Read_Data_By_Identifier/E_NOT_OK, DataServices_Data_HV_battery_maximum_charging_current_Read_Data_By_Identifier/DCM_E_PENDING]
        arg OpStatus: type=Dcm_OpStatusType, direction=IN
        arg ErrorCode: type=Dcm_NegativeResponseCodeType, direction=OUT
      error E_NOT_OK: error-code=1
      error DCM_E_PENDING: error-code=10
    DataServices_Data_DiagnServi_TABROW_VWFAZITIdentStrin_Read
      operation ReadData: possible-error=[DataServices_Data_DiagnServi_TABROW_VWFAZITIdentStrin_Read/E_NOT_OK, DataServices_Data_DiagnServi_TABROW_VWFAZITIdentStrin_Read/DCM_E_PENDING]
        arg OpStatus: type=Dcm_OpStatusType, direction=IN
        arg Data: type=Dcm_Data23ByteType, direction=OUT
      operation ConditionCheckRead: possible-error=[DataServices_Data_DiagnServi_TABROW_VWFAZITIdentStrin_Read/E_NOT_OK, DataServices_Data_DiagnServi_TABROW_VWFAZITIdentStrin_Read/DCM_E_PENDING]
        arg OpStatus: type=Dcm_OpStatusType, direction=IN
        arg ErrorCode: type=Dcm_NegativeResponseCodeType, direction=OUT
      error E_NOT_OK: error-code=1
      error DCM_E_PENDING: error-code=10
    DataServices_Data_DiagnServi_TABROW_NeuMeasu_Read_27_2_1
      operation ReadData: possible-error=[DataServices_Data_DiagnServi_TABROW_NeuMeasu_Read_27_2_1/E_NOT_OK, DataServices_Data_DiagnServi_TABROW_NeuMeasu_Read_27_2_1/DCM_E_PENDING]
        arg OpStatus: type=Dcm_OpStatusType, direction=IN
        arg Data: type=Dcm_Data27ByteType, direction=OUT
      operation ConditionCheckRead: possible-error=[DataServices_Data_DiagnServi_TABROW_NeuMeasu_Read_27_2_1/E_NOT_OK, DataServices_Data_DiagnServi_TABROW_NeuMeasu_Read_27_2_1/DCM_E_PENDING]
        arg OpStatus: type=Dcm_OpStatusType, direction=IN
        arg ErrorCode: type=Dcm_NegativeResponseCodeType, direction=OUT
      error E_NOT_OK: error-code=1
      error DCM_E_PENDING: error-code=10
    DataServices_Data_TABROW_StateOfBatteShutoCrash_ReadDataByIdent
      operation ReadData: possible-error=[DataServices_Data_TABROW_StateOfBatteShutoCrash_ReadDataByIdent/E_NOT_OK, DataServices_Data_TABROW_StateOfBatteShutoCrash_ReadDataByIdent/DCM_E_PENDING]
        arg OpStatus: type=Dcm_OpStatusType, direction=IN
        arg Data: type=Dcm_Data1ByteType, direction=OUT
      operation ConditionCheckRead: possible-error=[DataServices_Data_TABROW_StateOfBatteShutoCrash_ReadDataByIdent/E_NOT_OK, DataServices_Data_TABROW_StateOfBatteShutoCrash_ReadDataByIdent/DCM_E_PENDING]
        arg OpStatus: type=Dcm_OpStatusType, direction=IN
        arg ErrorCode: type=Dcm_NegativeResponseCodeType, direction=OUT
      error E_NOT_OK: error-code=1
      error DCM_E_PENDING: error-code=10
    DataServices_Data_BMC_Vorlade_Zielspannung_Read_Data_By_Identifier
      operation ReadData: possible-error=[DataServices_Data_BMC_Vorlade_Zielspannung_Read_Data_By_Identifier/E_NOT_OK, DataServices_Data_BMC_Vorlade_Zielspannung_Read_Data_By_Identifier/DCM_E_PENDING]
        arg OpStatus: type=Dcm_OpStatusType, direction=IN
        arg Data: type=Dcm_Data2ByteType, direction=OUT
      operation ConditionCheckRead: possible-error=[DataServices_Data_BMC_Vorlade_Zielspannung_Read_Data_By_Identifier/E_NOT_OK, DataServices_Data_BMC_Vorlade_Zielspannung_Read_Data_By_Identifier/DCM_E_PENDING]
        arg OpStatus: type=Dcm_OpStatusType, direction=IN
        arg ErrorCode: type=Dcm_NegativeResponseCodeType, direction=OUT
      error E_NOT_OK: error-code=1
      error DCM_E_PENDING: error-code=10
    DataServices_Data_TABROW_TABROSyste_Read_1_1_1_1_1_1_1_1_1_1
      operation ReadData: possible-error=[DataServices_Data_TABROW_TABROSyste_Read_1_1_1_1_1_1_1_1_1_1/E_NOT_OK, DataServices_Data_TABROW_TABROSyste_Read_1_1_1_1_1_1_1_1_1_1/DCM_E_PENDING]
        arg OpStatus: type=Dcm_OpStatusType, direction=IN
        arg Data: type=Dcm_Data14ByteType, direction=OUT
      operation ConditionCheckRead: possible-error=[DataServices_Data_TABROW_TABROSyste_Read_1_1_1_1_1_1_1_1_1_1/E_NOT_OK, DataServices_Data_TABROW_TABROSyste_Read_1_1_1_1_1_1_1_1_1_1/DCM_E_PENDING]
        arg OpStatus: type=Dcm_OpStatusType, direction=IN
        arg ErrorCode: type=Dcm_NegativeResponseCodeType, direction=OUT
      operation WriteData: possible-error=[DataServices_Data_TABROW_TABROSyste_Read_1_1_1_1_1_1_1_1_1_1/E_NOT_OK, DataServices_Data_TABROW_TABROSyste_Read_1_1_1_1_1_1_1_1_1_1/DCM_E_PENDING]
        arg Data: type=Dcm_Data14ByteType, direction=IN
        arg OpStatus: type=Dcm_OpStatusType, direction=IN
        arg ErrorCode: type=Dcm_NegativeResponseCodeType, direction=OUT
      error E_NOT_OK: error-code=1
      error DCM_E_PENDING: error-code=10
    DataServices_Data_DiagnServi_TABROW_NeuMeasu_Read_43_1_1_1_1_1_1_1
      operation ReadData: possible-error=[DataServices_Data_DiagnServi_TABROW_NeuMeasu_Read_43_1_1_1_1_1_1_1/E_NOT_OK, DataServices_Data_DiagnServi_TABROW_NeuMeasu_Read_43_1_1_1_1_1_1_1/DCM_E_PENDING]
        arg OpStatus: type=Dcm_OpStatusType, direction=IN
        arg Data: type=Dcm_Data64ByteType, direction=OUT
      operation ConditionCheckRead: possible-error=[DataServices_Data_DiagnServi_TABROW_NeuMeasu_Read_43_1_1_1_1_1_1_1/E_NOT_OK, DataServices_Data_DiagnServi_TABROW_NeuMeasu_Read_43_1_1_1_1_1_1_1/DCM_E_PENDING]
        arg OpStatus: type=Dcm_OpStatusType, direction=IN
        arg ErrorCode: type=Dcm_NegativeResponseCodeType, direction=OUT
      error E_NOT_OK: error-code=1
      error DCM_E_PENDING: error-code=10
    DataServices_Data_HV_Battery_thermal_load_Read_Data_By_Identifier
      operation ReadData: possible-error=[DataServices_Data_HV_Battery_thermal_load_Read_Data_By_Identifier/E_NOT_OK, DataServices_Data_HV_Battery_thermal_load_Read_Data_By_Identifier/DCM_E_PENDING]
        arg OpStatus: type=Dcm_OpStatusType, direction=IN
        arg Data: type=Dcm_Data100ByteType, direction=OUT
      operation ConditionCheckRead: possible-error=[DataServices_Data_HV_Battery_thermal_load_Read_Data_By_Identifier/E_NOT_OK, DataServices_Data_HV_Battery_thermal_load_Read_Data_By_Identifier/DCM_E_PENDING]
        arg OpStatus: type=Dcm_OpStatusType, direction=IN
        arg ErrorCode: type=Dcm_NegativeResponseCodeType, direction=OUT
      error E_NOT_OK: error-code=1
      error DCM_E_PENDING: error-code=10
    DataServices_Data_DiagnServi_TABROW_NeuMeasu_Read_29_1_1_1_1_1
      operation ReadData: possible-error=[DataServices_Data_DiagnServi_TABROW_NeuMeasu_Read_29_1_1_1_1_1/E_NOT_OK, DataServices_Data_DiagnServi_TABROW_NeuMeasu_Read_29_1_1_1_1_1/DCM_E_PENDING]
        arg OpStatus: type=Dcm_OpStatusType, direction=IN
        arg Data: type=Dcm_Data4ByteType, direction=OUT
      operation ConditionCheckRead: possible-error=[DataServices_Data_DiagnServi_TABROW_NeuMeasu_Read_29_1_1_1_1_1/E_NOT_OK, DataServices_Data_DiagnServi_TABROW_NeuMeasu_Read_29_1_1_1_1_1/DCM_E_PENDING]
        arg OpStatus: type=Dcm_OpStatusType, direction=IN
        arg ErrorCode: type=Dcm_NegativeResponseCodeType, direction=OUT
      error E_NOT_OK: error-code=1
      error DCM_E_PENDING: error-code=10
    DataServices_Data_Prozessorauslastung_Read_Data_By_Identifier
      operation ReadData: possible-error=[DataServices_Data_Prozessorauslastung_Read_Data_By_Identifier/E_NOT_OK, DataServices_Data_Prozessorauslastung_Read_Data_By_Identifier/DCM_E_PENDING]
        arg OpStatus: type=Dcm_OpStatusType, direction=IN
        arg Data: type=Dcm_Data4ByteType, direction=OUT
      operation ConditionCheckRead: possible-error=[DataServices_Data_Prozessorauslastung_Read_Data_By_Identifier/E_NOT_OK, DataServices_Data_Prozessorauslastung_Read_Data_By_Identifier/DCM_E_PENDING]
        arg OpStatus: type=Dcm_OpStatusType, direction=IN
        arg ErrorCode: type=Dcm_NegativeResponseCodeType, direction=OUT
      error E_NOT_OK: error-code=1
      error DCM_E_PENDING: error-code=10
    DataServices_Data_State_Of_Charge_Battery_customer_Read_Data_By_Identifier
      operation ReadData: possible-error=[DataServices_Data_State_Of_Charge_Battery_customer_Read_Data_By_Identifier/E_NOT_OK, DataServices_Data_State_Of_Charge_Battery_customer_Read_Data_By_Identifier/DCM_E_PENDING]
        arg OpStatus: type=Dcm_OpStatusType, direction=IN
        arg Data: type=Dcm_Data2ByteType, direction=OUT
      operation ConditionCheckRead: possible-error=[DataServices_Data_State_Of_Charge_Battery_customer_Read_Data_By_Identifier/E_NOT_OK, DataServices_Data_State_Of_Charge_Battery_customer_Read_Data_By_Identifier/DCM_E_PENDING]
        arg OpStatus: type=Dcm_OpStatusType, direction=IN
        arg ErrorCode: type=Dcm_NegativeResponseCodeType, direction=OUT
      error E_NOT_OK: error-code=1
      error DCM_E_PENDING: error-code=10
    DataServices_Data_DiagnServi_TABROW_ActivOfDevelMessa_Read
      operation ReadData: possible-error=[DataServices_Data_DiagnServi_TABROW_ActivOfDevelMessa_Read/E_NOT_OK, DataServices_Data_DiagnServi_TABROW_ActivOfDevelMessa_Read/DCM_E_PENDING]
        arg OpStatus: type=Dcm_OpStatusType, direction=IN
        arg Data: type=Dcm_Data1ByteType, direction=OUT
      operation ConditionCheckRead: possible-error=[DataServices_Data_DiagnServi_TABROW_ActivOfDevelMessa_Read/E_NOT_OK, DataServices_Data_DiagnServi_TABROW_ActivOfDevelMessa_Read/DCM_E_PENDING]
        arg OpStatus: type=Dcm_OpStatusType, direction=IN
        arg ErrorCode: type=Dcm_NegativeResponseCodeType, direction=OUT
      operation WriteData: possible-error=[DataServices_Data_DiagnServi_TABROW_ActivOfDevelMessa_Read/E_NOT_OK, DataServices_Data_DiagnServi_TABROW_ActivOfDevelMessa_Read/DCM_E_PENDING]
        arg Data: type=Dcm_Data1ByteType, direction=IN
        arg OpStatus: type=Dcm_OpStatusType, direction=IN
        arg ErrorCode: type=Dcm_NegativeResponseCodeType, direction=OUT
      error E_NOT_OK: error-code=1
      error DCM_E_PENDING: error-code=10
    DataServices_Data_DiagnServi_TABROW_NeuMeasu_Read_60_3
      operation ReadData: possible-error=[DataServices_Data_DiagnServi_TABROW_NeuMeasu_Read_60_3/E_NOT_OK, DataServices_Data_DiagnServi_TABROW_NeuMeasu_Read_60_3/DCM_E_PENDING]
        arg OpStatus: type=Dcm_OpStatusType, direction=IN
        arg Data: type=Dcm_Data2ByteType, direction=OUT
      operation ConditionCheckRead: possible-error=[DataServices_Data_DiagnServi_TABROW_NeuMeasu_Read_60_3/E_NOT_OK, DataServices_Data_DiagnServi_TABROW_NeuMeasu_Read_60_3/DCM_E_PENDING]
        arg OpStatus: type=Dcm_OpStatusType, direction=IN
        arg ErrorCode: type=Dcm_NegativeResponseCodeType, direction=OUT
      error E_NOT_OK: error-code=1
      error DCM_E_PENDING: error-code=10
    DataServices_Data_DiagnServi_TABROW_NeuMeasu_Read_60_1
      operation ReadData: possible-error=[DataServices_Data_DiagnServi_TABROW_NeuMeasu_Read_60_1/E_NOT_OK, DataServices_Data_DiagnServi_TABROW_NeuMeasu_Read_60_1/DCM_E_PENDING]
        arg OpStatus: type=Dcm_OpStatusType, direction=IN
        arg Data: type=Dcm_Data2ByteType, direction=OUT
      operation ConditionCheckRead: possible-error=[DataServices_Data_DiagnServi_TABROW_NeuMeasu_Read_60_1/E_NOT_OK, DataServices_Data_DiagnServi_TABROW_NeuMeasu_Read_60_1/DCM_E_PENDING]
        arg OpStatus: type=Dcm_OpStatusType, direction=IN
        arg ErrorCode: type=Dcm_NegativeResponseCodeType, direction=OUT
      error E_NOT_OK: error-code=1
      error DCM_E_PENDING: error-code=10
    DataServices_Data_DiagnServi_TABROW_CalcuLOADValue_Read
      operation ReadData: possible-error=[DataServices_Data_DiagnServi_TABROW_CalcuLOADValue_Read/E_NOT_OK, DataServices_Data_DiagnServi_TABROW_CalcuLOADValue_Read/DCM_E_PENDING]
        arg OpStatus: type=Dcm_OpStatusType, direction=IN
        arg Data: type=Dcm_Data1ByteType, direction=OUT
      operation ConditionCheckRead: possible-error=[DataServices_Data_DiagnServi_TABROW_CalcuLOADValue_Read/E_NOT_OK, DataServices_Data_DiagnServi_TABROW_CalcuLOADValue_Read/DCM_E_PENDING]
        arg OpStatus: type=Dcm_OpStatusType, direction=IN
        arg ErrorCode: type=Dcm_NegativeResponseCodeType, direction=OUT
      error E_NOT_OK: error-code=1
      error DCM_E_PENDING: error-code=10
    DataServices_Data_HV_battery_performance_indicator_charging_Read_Data_By_Identifier
      operation ReadData: possible-error=[DataServices_Data_HV_battery_performance_indicator_charging_Read_Data_By_Identifier/E_NOT_OK, DataServices_Data_HV_battery_performance_indicator_charging_Read_Data_By_Identifier/DCM_E_PENDING]
        arg OpStatus: type=Dcm_OpStatusType, direction=IN
        arg Data: type=Dcm_Data2ByteType, direction=OUT
      operation ConditionCheckRead: possible-error=[DataServices_Data_HV_battery_performance_indicator_charging_Read_Data_By_Identifier/E_NOT_OK, DataServices_Data_HV_battery_performance_indicator_charging_Read_Data_By_Identifier/DCM_E_PENDING]
        arg OpStatus: type=Dcm_OpStatusType, direction=IN
        arg ErrorCode: type=Dcm_NegativeResponseCodeType, direction=OUT
      error E_NOT_OK: error-code=1
      error DCM_E_PENDING: error-code=10
    DataServices_Data_Zero_Potential_Status_Read_Data_By_Identifier
      operation ReadData: possible-error=[DataServices_Data_Zero_Potential_Status_Read_Data_By_Identifier/E_NOT_OK, DataServices_Data_Zero_Potential_Status_Read_Data_By_Identifier/DCM_E_PENDING]
        arg OpStatus: type=Dcm_OpStatusType, direction=IN
        arg Data: type=Dcm_Data1ByteType, direction=OUT
      operation ConditionCheckRead: possible-error=[DataServices_Data_Zero_Potential_Status_Read_Data_By_Identifier/E_NOT_OK, DataServices_Data_Zero_Potential_Status_Read_Data_By_Identifier/DCM_E_PENDING]
        arg OpStatus: type=Dcm_OpStatusType, direction=IN
        arg ErrorCode: type=Dcm_NegativeResponseCodeType, direction=OUT
      error E_NOT_OK: error-code=1
      error DCM_E_PENDING: error-code=10
    DataServices_Data_DiagnServi_TABROW_NeuMeasu_Read_57_2_1
      operation ReadData: possible-error=[DataServices_Data_DiagnServi_TABROW_NeuMeasu_Read_57_2_1/E_NOT_OK, DataServices_Data_DiagnServi_TABROW_NeuMeasu_Read_57_2_1/DCM_E_PENDING]
        arg OpStatus: type=Dcm_OpStatusType, direction=IN
        arg Data: type=Dcm_Data3ByteType, direction=OUT
      operation ConditionCheckRead: possible-error=[DataServices_Data_DiagnServi_TABROW_NeuMeasu_Read_57_2_1/E_NOT_OK, DataServices_Data_DiagnServi_TABROW_NeuMeasu_Read_57_2_1/DCM_E_PENDING]
        arg OpStatus: type=Dcm_OpStatusType, direction=IN
        arg ErrorCode: type=Dcm_NegativeResponseCodeType, direction=OUT
      error E_NOT_OK: error-code=1
      error DCM_E_PENDING: error-code=10
    DataServices_Data_DiagnServi_BMC_serial_number_Read
      operation ReadData: possible-error=[DataServices_Data_DiagnServi_BMC_serial_number_Read/E_NOT_OK, DataServices_Data_DiagnServi_BMC_serial_number_Read/DCM_E_PENDING]
        arg OpStatus: type=Dcm_OpStatusType, direction=IN
        arg Data: type=Dcm_Data10ByteType, direction=OUT
      operation ConditionCheckRead: possible-error=[DataServices_Data_DiagnServi_BMC_serial_number_Read/E_NOT_OK, DataServices_Data_DiagnServi_BMC_serial_number_Read/DCM_E_PENDING]
        arg OpStatus: type=Dcm_OpStatusType, direction=IN
        arg ErrorCode: type=Dcm_NegativeResponseCodeType, direction=OUT
      operation WriteData: possible-error=[DataServices_Data_DiagnServi_BMC_serial_number_Read/E_NOT_OK, DataServices_Data_DiagnServi_BMC_serial_number_Read/DCM_E_PENDING]
        arg Data: type=Dcm_Data10ByteType, direction=IN
        arg OpStatus: type=Dcm_OpStatusType, direction=IN
        arg ErrorCode: type=Dcm_NegativeResponseCodeType, direction=OUT
      error E_NOT_OK: error-code=1
      error DCM_E_PENDING: error-code=10
    DataServices_Data_HV_coordinator_requestet_voltage_hv_battery_Read_Data_By_Identifier
      operation ReadData: possible-error=[DataServices_Data_HV_coordinator_requestet_voltage_hv_battery_Read_Data_By_Identifier/E_NOT_OK, DataServices_Data_HV_coordinator_requestet_voltage_hv_battery_Read_Data_By_Identifier/DCM_E_PENDING]
        arg OpStatus: type=Dcm_OpStatusType, direction=IN
        arg Data: type=Dcm_Data1ByteType, direction=OUT
      operation ConditionCheckRead: possible-error=[DataServices_Data_HV_coordinator_requestet_voltage_hv_battery_Read_Data_By_Identifier/E_NOT_OK, DataServices_Data_HV_coordinator_requestet_voltage_hv_battery_Read_Data_By_Identifier/DCM_E_PENDING]
        arg OpStatus: type=Dcm_OpStatusType, direction=IN
        arg ErrorCode: type=Dcm_NegativeResponseCodeType, direction=OUT
      error E_NOT_OK: error-code=1
      error DCM_E_PENDING: error-code=10
    DataServices_Data_DiagnServi_TABROW_DID0xEFD_Read_1
      operation ReadData: possible-error=[DataServices_Data_DiagnServi_TABROW_DID0xEFD_Read_1/E_NOT_OK, DataServices_Data_DiagnServi_TABROW_DID0xEFD_Read_1/DCM_E_PENDING]
        arg OpStatus: type=Dcm_OpStatusType, direction=IN
        arg Data: type=Dcm_Data4ByteType, direction=OUT
      operation ConditionCheckRead: possible-error=[DataServices_Data_DiagnServi_TABROW_DID0xEFD_Read_1/E_NOT_OK, DataServices_Data_DiagnServi_TABROW_DID0xEFD_Read_1/DCM_E_PENDING]
        arg OpStatus: type=Dcm_OpStatusType, direction=IN
        arg ErrorCode: type=Dcm_NegativeResponseCodeType, direction=OUT
      error E_NOT_OK: error-code=1
      error DCM_E_PENDING: error-code=10
    DataServices_Data_DiagnServi_TABROW_DID0xEFD_Read_2
      operation ReadData: possible-error=[DataServices_Data_DiagnServi_TABROW_DID0xEFD_Read_2/E_NOT_OK, DataServices_Data_DiagnServi_TABROW_DID0xEFD_Read_2/DCM_E_PENDING]
        arg OpStatus: type=Dcm_OpStatusType, direction=IN
        arg Data: type=Dcm_Data4ByteType, direction=OUT
      operation ConditionCheckRead: possible-error=[DataServices_Data_DiagnServi_TABROW_DID0xEFD_Read_2/E_NOT_OK, DataServices_Data_DiagnServi_TABROW_DID0xEFD_Read_2/DCM_E_PENDING]
        arg OpStatus: type=Dcm_OpStatusType, direction=IN
        arg ErrorCode: type=Dcm_NegativeResponseCodeType, direction=OUT
      error E_NOT_OK: error-code=1
      error DCM_E_PENDING: error-code=10
    DataServices_Data_DiagnServi_TABROW_DID0xEFD_Read_3
      operation ReadData: possible-error=[DataServices_Data_DiagnServi_TABROW_DID0xEFD_Read_3/E_NOT_OK, DataServices_Data_DiagnServi_TABROW_DID0xEFD_Read_3/DCM_E_PENDING]
        arg OpStatus: type=Dcm_OpStatusType, direction=IN
        arg Data: type=Dcm_Data2ByteType, direction=OUT
      operation ConditionCheckRead: possible-error=[DataServices_Data_DiagnServi_TABROW_DID0xEFD_Read_3/E_NOT_OK, DataServices_Data_DiagnServi_TABROW_DID0xEFD_Read_3/DCM_E_PENDING]
        arg OpStatus: type=Dcm_OpStatusType, direction=IN
        arg ErrorCode: type=Dcm_NegativeResponseCodeType, direction=OUT
      error E_NOT_OK: error-code=1
      error DCM_E_PENDING: error-code=10
    DataServices_Data_DiagnServi_TABROW_NeuMeasu_Read_46_1_1_1_1
      operation ReadData: possible-error=[DataServices_Data_DiagnServi_TABROW_NeuMeasu_Read_46_1_1_1_1/E_NOT_OK, DataServices_Data_DiagnServi_TABROW_NeuMeasu_Read_46_1_1_1_1/DCM_E_PENDING]
        arg OpStatus: type=Dcm_OpStatusType, direction=IN
        arg Data: type=Dcm_Data152ByteType, direction=OUT
      operation ConditionCheckRead: possible-error=[DataServices_Data_DiagnServi_TABROW_NeuMeasu_Read_46_1_1_1_1/E_NOT_OK, DataServices_Data_DiagnServi_TABROW_NeuMeasu_Read_46_1_1_1_1/DCM_E_PENDING]
        arg OpStatus: type=Dcm_OpStatusType, direction=IN
        arg ErrorCode: type=Dcm_NegativeResponseCodeType, direction=OUT
      error E_NOT_OK: error-code=1
      error DCM_E_PENDING: error-code=10
    DataServices_Data_TABROW_ECUStandMode1_Read
      operation ReadData: possible-error=[DataServices_Data_TABROW_ECUStandMode1_Read/E_NOT_OK, DataServices_Data_TABROW_ECUStandMode1_Read/DCM_E_PENDING]
        arg OpStatus: type=Dcm_OpStatusType, direction=IN
        arg Data: type=Dcm_Data4ByteType, direction=OUT
      operation ConditionCheckRead: possible-error=[DataServices_Data_TABROW_ECUStandMode1_Read/E_NOT_OK, DataServices_Data_TABROW_ECUStandMode1_Read/DCM_E_PENDING]
        arg OpStatus: type=Dcm_OpStatusType, direction=IN
        arg ErrorCode: type=Dcm_NegativeResponseCodeType, direction=OUT
      operation WriteData: possible-error=[DataServices_Data_TABROW_ECUStandMode1_Read/E_NOT_OK, DataServices_Data_TABROW_ECUStandMode1_Read/DCM_E_PENDING]
        arg Data: type=Dcm_Data4ByteType, direction=IN
        arg OpStatus: type=Dcm_OpStatusType, direction=IN
        arg ErrorCode: type=Dcm_NegativeResponseCodeType, direction=OUT
      error E_NOT_OK: error-code=1
      error DCM_E_PENDING: error-code=10
    DataServices_Data_TABROW_TABROSyste_Read_1_1_1_1_1
      operation ReadData: possible-error=[DataServices_Data_TABROW_TABROSyste_Read_1_1_1_1_1/E_NOT_OK, DataServices_Data_TABROW_TABROSyste_Read_1_1_1_1_1/DCM_E_PENDING]
        arg OpStatus: type=Dcm_OpStatusType, direction=IN
        arg Data: type=Dcm_Data14ByteType, direction=OUT
      operation ConditionCheckRead: possible-error=[DataServices_Data_TABROW_TABROSyste_Read_1_1_1_1_1/E_NOT_OK, DataServices_Data_TABROW_TABROSyste_Read_1_1_1_1_1/DCM_E_PENDING]
        arg OpStatus: type=Dcm_OpStatusType, direction=IN
        arg ErrorCode: type=Dcm_NegativeResponseCodeType, direction=OUT
      error E_NOT_OK: error-code=1
      error DCM_E_PENDING: error-code=10
    DataServices_Data_DiagnServi_TABROW_NeuMeasu_Read_29_1
      operation ReadData: possible-error=[DataServices_Data_DiagnServi_TABROW_NeuMeasu_Read_29_1/E_NOT_OK, DataServices_Data_DiagnServi_TABROW_NeuMeasu_Read_29_1/DCM_E_PENDING]
        arg OpStatus: type=Dcm_OpStatusType, direction=IN
        arg Data: type=Dcm_Data12ByteType, direction=OUT
      operation ConditionCheckRead: possible-error=[DataServices_Data_DiagnServi_TABROW_NeuMeasu_Read_29_1/E_NOT_OK, DataServices_Data_DiagnServi_TABROW_NeuMeasu_Read_29_1/DCM_E_PENDING]
        arg OpStatus: type=Dcm_OpStatusType, direction=IN
        arg ErrorCode: type=Dcm_NegativeResponseCodeType, direction=OUT
      error E_NOT_OK: error-code=1
      error DCM_E_PENDING: error-code=10
    DataServices_Data_DiagnServi_TABROW_NeuMeasu_Read_29_3
      operation ReadData: possible-error=[DataServices_Data_DiagnServi_TABROW_NeuMeasu_Read_29_3/E_NOT_OK, DataServices_Data_DiagnServi_TABROW_NeuMeasu_Read_29_3/DCM_E_PENDING]
        arg OpStatus: type=Dcm_OpStatusType, direction=IN
        arg Data: type=Dcm_Data2ByteType, direction=OUT
      operation ConditionCheckRead: possible-error=[DataServices_Data_DiagnServi_TABROW_NeuMeasu_Read_29_3/E_NOT_OK, DataServices_Data_DiagnServi_TABROW_NeuMeasu_Read_29_3/DCM_E_PENDING]
        arg OpStatus: type=Dcm_OpStatusType, direction=IN
        arg ErrorCode: type=Dcm_NegativeResponseCodeType, direction=OUT
      error E_NOT_OK: error-code=1
      error DCM_E_PENDING: error-code=10
    DataServices_Data_DiagnServi_TABROW_NeuMeasu_Read_46_1_1_1_1_1_1_2_1
      operation ReadData: possible-error=[DataServices_Data_DiagnServi_TABROW_NeuMeasu_Read_46_1_1_1_1_1_1_2_1/E_NOT_OK, DataServices_Data_DiagnServi_TABROW_NeuMeasu_Read_46_1_1_1_1_1_1_2_1/DCM_E_PENDING]
        arg OpStatus: type=Dcm_OpStatusType, direction=IN
        arg Data: type=Dcm_Data152ByteType, direction=OUT
      operation ConditionCheckRead: possible-error=[DataServices_Data_DiagnServi_TABROW_NeuMeasu_Read_46_1_1_1_1_1_1_2_1/E_NOT_OK, DataServices_Data_DiagnServi_TABROW_NeuMeasu_Read_46_1_1_1_1_1_1_2_1/DCM_E_PENDING]
        arg OpStatus: type=Dcm_OpStatusType, direction=IN
        arg ErrorCode: type=Dcm_NegativeResponseCodeType, direction=OUT
      error E_NOT_OK: error-code=1
      error DCM_E_PENDING: error-code=10
    DataServices_Data_DiagnServi_TABROW_NeuMeasu_Read_29_2
      operation ReadData: possible-error=[DataServices_Data_DiagnServi_TABROW_NeuMeasu_Read_29_2/E_NOT_OK, DataServices_Data_DiagnServi_TABROW_NeuMeasu_Read_29_2/DCM_E_PENDING]
        arg OpStatus: type=Dcm_OpStatusType, direction=IN
        arg Data: type=Dcm_Data2ByteType, direction=OUT
      operation ConditionCheckRead: possible-error=[DataServices_Data_DiagnServi_TABROW_NeuMeasu_Read_29_2/E_NOT_OK, DataServices_Data_DiagnServi_TABROW_NeuMeasu_Read_29_2/DCM_E_PENDING]
        arg OpStatus: type=Dcm_OpStatusType, direction=IN
        arg ErrorCode: type=Dcm_NegativeResponseCodeType, direction=OUT
      error E_NOT_OK: error-code=1
      error DCM_E_PENDING: error-code=10
    DataServices_Data_DiagnServi_TABROW_NeuMeasu_Read_29_5
      operation ReadData: possible-error=[DataServices_Data_DiagnServi_TABROW_NeuMeasu_Read_29_5/E_NOT_OK, DataServices_Data_DiagnServi_TABROW_NeuMeasu_Read_29_5/DCM_E_PENDING]
        arg OpStatus: type=Dcm_OpStatusType, direction=IN
        arg Data: type=Dcm_Data4ByteType, direction=OUT
      operation ConditionCheckRead: possible-error=[DataServices_Data_DiagnServi_TABROW_NeuMeasu_Read_29_5/E_NOT_OK, DataServices_Data_DiagnServi_TABROW_NeuMeasu_Read_29_5/DCM_E_PENDING]
        arg OpStatus: type=Dcm_OpStatusType, direction=IN
        arg ErrorCode: type=Dcm_NegativeResponseCodeType, direction=OUT
      error E_NOT_OK: error-code=1
      error DCM_E_PENDING: error-code=10
    DataServices_Data_DiagnServi_TABROW_NeuMeasu_Read_46_1_1_1_1_1_1_2_3
      operation ReadData: possible-error=[DataServices_Data_DiagnServi_TABROW_NeuMeasu_Read_46_1_1_1_1_1_1_2_3/E_NOT_OK, DataServices_Data_DiagnServi_TABROW_NeuMeasu_Read_46_1_1_1_1_1_1_2_3/DCM_E_PENDING]
        arg OpStatus: type=Dcm_OpStatusType, direction=IN
        arg Data: type=Dcm_Data152ByteType, direction=OUT
      operation ConditionCheckRead: possible-error=[DataServices_Data_DiagnServi_TABROW_NeuMeasu_Read_46_1_1_1_1_1_1_2_3/E_NOT_OK, DataServices_Data_DiagnServi_TABROW_NeuMeasu_Read_46_1_1_1_1_1_1_2_3/DCM_E_PENDING]
        arg OpStatus: type=Dcm_OpStatusType, direction=IN
        arg ErrorCode: type=Dcm_NegativeResponseCodeType, direction=OUT
      error E_NOT_OK: error-code=1
      error DCM_E_PENDING: error-code=10
    DataServices_Data_DiagnServi_TABROW_NeuMeasu_Read_29_4
      operation ReadData: possible-error=[DataServices_Data_DiagnServi_TABROW_NeuMeasu_Read_29_4/E_NOT_OK, DataServices_Data_DiagnServi_TABROW_NeuMeasu_Read_29_4/DCM_E_PENDING]
        arg OpStatus: type=Dcm_OpStatusType, direction=IN
        arg Data: type=Dcm_Data2ByteType, direction=OUT
      operation ConditionCheckRead: possible-error=[DataServices_Data_DiagnServi_TABROW_NeuMeasu_Read_29_4/E_NOT_OK, DataServices_Data_DiagnServi_TABROW_NeuMeasu_Read_29_4/DCM_E_PENDING]
        arg OpStatus: type=Dcm_OpStatusType, direction=IN
        arg ErrorCode: type=Dcm_NegativeResponseCodeType, direction=OUT
      error E_NOT_OK: error-code=1
      error DCM_E_PENDING: error-code=10
    DataServices_Data_DiagnServi_TABROW_NeuMeasu_Read_46_1_1_1_1_1_1_2_2
      operation ReadData: possible-error=[DataServices_Data_DiagnServi_TABROW_NeuMeasu_Read_46_1_1_1_1_1_1_2_2/E_NOT_OK, DataServices_Data_DiagnServi_TABROW_NeuMeasu_Read_46_1_1_1_1_1_1_2_2/DCM_E_PENDING]
        arg OpStatus: type=Dcm_OpStatusType, direction=IN
        arg Data: type=Dcm_Data152ByteType, direction=OUT
      operation ConditionCheckRead: possible-error=[DataServices_Data_DiagnServi_TABROW_NeuMeasu_Read_46_1_1_1_1_1_1_2_2/E_NOT_OK, DataServices_Data_DiagnServi_TABROW_NeuMeasu_Read_46_1_1_1_1_1_1_2_2/DCM_E_PENDING]
        arg OpStatus: type=Dcm_OpStatusType, direction=IN
        arg ErrorCode: type=Dcm_NegativeResponseCodeType, direction=OUT
      error E_NOT_OK: error-code=1
      error DCM_E_PENDING: error-code=10
    DataServices_Data_DiagnServi_TABROW_MonitStatuThisDriviCycle_Read
      operation ReadData: possible-error=[DataServices_Data_DiagnServi_TABROW_MonitStatuThisDriviCycle_Read/E_NOT_OK, DataServices_Data_DiagnServi_TABROW_MonitStatuThisDriviCycle_Read/DCM_E_PENDING]
        arg OpStatus: type=Dcm_OpStatusType, direction=IN
        arg Data: type=Dcm_Data4ByteType, direction=OUT
      operation ConditionCheckRead: possible-error=[DataServices_Data_DiagnServi_TABROW_MonitStatuThisDriviCycle_Read/E_NOT_OK, DataServices_Data_DiagnServi_TABROW_MonitStatuThisDriviCycle_Read/DCM_E_PENDING]
        arg OpStatus: type=Dcm_OpStatusType, direction=IN
        arg ErrorCode: type=Dcm_NegativeResponseCodeType, direction=OUT
      error E_NOT_OK: error-code=1
      error DCM_E_PENDING: error-code=10
    DataServices_Data_TABROW_TABROSyste_Read_1_1_1_1_1_1_1_1_1
      operation ReadData: possible-error=[DataServices_Data_TABROW_TABROSyste_Read_1_1_1_1_1_1_1_1_1/E_NOT_OK, DataServices_Data_TABROW_TABROSyste_Read_1_1_1_1_1_1_1_1_1/DCM_E_PENDING]
        arg OpStatus: type=Dcm_OpStatusType, direction=IN
        arg Data: type=Dcm_Data9ByteType, direction=OUT
      operation ConditionCheckRead: possible-error=[DataServices_Data_TABROW_TABROSyste_Read_1_1_1_1_1_1_1_1_1/E_NOT_OK, DataServices_Data_TABROW_TABROSyste_Read_1_1_1_1_1_1_1_1_1/DCM_E_PENDING]
        arg OpStatus: type=Dcm_OpStatusType, direction=IN
        arg ErrorCode: type=Dcm_NegativeResponseCodeType, direction=OUT
      error E_NOT_OK: error-code=1
      error DCM_E_PENDING: error-code=10
    DataServices_Data_TABROW_TABROSyste_Read_1_1_1
      operation ReadData: possible-error=[DataServices_Data_TABROW_TABROSyste_Read_1_1_1/E_NOT_OK, DataServices_Data_TABROW_TABROSyste_Read_1_1_1/DCM_E_PENDING]
        arg OpStatus: type=Dcm_OpStatusType, direction=IN
        arg Data: type=Dcm_Data9ByteType, direction=OUT
      operation ConditionCheckRead: possible-error=[DataServices_Data_TABROW_TABROSyste_Read_1_1_1/E_NOT_OK, DataServices_Data_TABROW_TABROSyste_Read_1_1_1/DCM_E_PENDING]
        arg OpStatus: type=Dcm_OpStatusType, direction=IN
        arg ErrorCode: type=Dcm_NegativeResponseCodeType, direction=OUT
      error E_NOT_OK: error-code=1
      error DCM_E_PENDING: error-code=10
    DataServices_Data_DiagnServi_TABROW_VWAppliDataSetIdent_Read
      operation ReadData: possible-error=[DataServices_Data_DiagnServi_TABROW_VWAppliDataSetIdent_Read/E_NOT_OK, DataServices_Data_DiagnServi_TABROW_VWAppliDataSetIdent_Read/DCM_E_PENDING]
        arg OpStatus: type=Dcm_OpStatusType, direction=IN
        arg Data: type=Dcm_Data8192ByteType, direction=OUT
      operation ReadDataLength: possible-error=[DataServices_Data_DiagnServi_TABROW_VWAppliDataSetIdent_Read/E_NOT_OK, DataServices_Data_DiagnServi_TABROW_VWAppliDataSetIdent_Read/DCM_E_PENDING]
        arg OpStatus: type=Dcm_OpStatusType, direction=IN
        arg DataLength: type=uint16, direction=OUT
      operation ConditionCheckRead: possible-error=[DataServices_Data_DiagnServi_TABROW_VWAppliDataSetIdent_Read/E_NOT_OK, DataServices_Data_DiagnServi_TABROW_VWAppliDataSetIdent_Read/DCM_E_PENDING]
        arg OpStatus: type=Dcm_OpStatusType, direction=IN
        arg ErrorCode: type=Dcm_NegativeResponseCodeType, direction=OUT
      error E_NOT_OK: error-code=1
      error DCM_E_PENDING: error-code=10
    DataServices_Data_DiagnServi_TABROW_NeuMeasu_Read_43_1_1_1_1_1_1_1_1
      operation ReadData: possible-error=[DataServices_Data_DiagnServi_TABROW_NeuMeasu_Read_43_1_1_1_1_1_1_1_1/E_NOT_OK, DataServices_Data_DiagnServi_TABROW_NeuMeasu_Read_43_1_1_1_1_1_1_1_1/DCM_E_PENDING]
        arg OpStatus: type=Dcm_OpStatusType, direction=IN
        arg Data: type=Dcm_Data64ByteType, direction=OUT
      operation ConditionCheckRead: possible-error=[DataServices_Data_DiagnServi_TABROW_NeuMeasu_Read_43_1_1_1_1_1_1_1_1/E_NOT_OK, DataServices_Data_DiagnServi_TABROW_NeuMeasu_Read_43_1_1_1_1_1_1_1_1/DCM_E_PENDING]
        arg OpStatus: type=Dcm_OpStatusType, direction=IN
        arg ErrorCode: type=Dcm_NegativeResponseCodeType, direction=OUT
      error E_NOT_OK: error-code=1
      error DCM_E_PENDING: error-code=10
    DataServices_Data_TABROW_BatteTempeAvera_ReadDataByIdent
      operation ReadData: possible-error=[DataServices_Data_TABROW_BatteTempeAvera_ReadDataByIdent/E_NOT_OK, DataServices_Data_TABROW_BatteTempeAvera_ReadDataByIdent/DCM_E_PENDING]
        arg OpStatus: type=Dcm_OpStatusType, direction=IN
        arg Data: type=Dcm_Data2ByteType, direction=OUT
      operation ConditionCheckRead: possible-error=[DataServices_Data_TABROW_BatteTempeAvera_ReadDataByIdent/E_NOT_OK, DataServices_Data_TABROW_BatteTempeAvera_ReadDataByIdent/DCM_E_PENDING]
        arg OpStatus: type=Dcm_OpStatusType, direction=IN
        arg ErrorCode: type=Dcm_NegativeResponseCodeType, direction=OUT
      error E_NOT_OK: error-code=1
      error DCM_E_PENDING: error-code=10
    DataServices_Data_HV_battery_maximum_discharge_current_Read_Data_By_Identifier
      operation ReadData: possible-error=[DataServices_Data_HV_battery_maximum_discharge_current_Read_Data_By_Identifier/E_NOT_OK, DataServices_Data_HV_battery_maximum_discharge_current_Read_Data_By_Identifier/DCM_E_PENDING]
        arg OpStatus: type=Dcm_OpStatusType, direction=IN
        arg Data: type=Dcm_Data2ByteType, direction=OUT
      operation ConditionCheckRead: possible-error=[DataServices_Data_HV_battery_maximum_discharge_current_Read_Data_By_Identifier/E_NOT_OK, DataServices_Data_HV_battery_maximum_discharge_current_Read_Data_By_Identifier/DCM_E_PENDING]
        arg OpStatus: type=Dcm_OpStatusType, direction=IN
        arg ErrorCode: type=Dcm_NegativeResponseCodeType, direction=OUT
      error E_NOT_OK: error-code=1
      error DCM_E_PENDING: error-code=10
    DataServices_Data_DiagnServi_TABROW_NeuMeasu_Read_49_1
      operation ReadData: possible-error=[DataServices_Data_DiagnServi_TABROW_NeuMeasu_Read_49_1/E_NOT_OK, DataServices_Data_DiagnServi_TABROW_NeuMeasu_Read_49_1/DCM_E_PENDING]
        arg OpStatus: type=Dcm_OpStatusType, direction=IN
        arg Data: type=Dcm_Data2ByteType, direction=OUT
      operation ConditionCheckRead: possible-error=[DataServices_Data_DiagnServi_TABROW_NeuMeasu_Read_49_1/E_NOT_OK, DataServices_Data_DiagnServi_TABROW_NeuMeasu_Read_49_1/DCM_E_PENDING]
        arg OpStatus: type=Dcm_OpStatusType, direction=IN
        arg ErrorCode: type=Dcm_NegativeResponseCodeType, direction=OUT
      error E_NOT_OK: error-code=1
      error DCM_E_PENDING: error-code=10
    DataServices_Data_TABROW_VWLogicSoftwBlockCountOfProgrAttem_Read
      operation ReadData: possible-error=[DataServices_Data_TABROW_VWLogicSoftwBlockCountOfProgrAttem_Read/E_NOT_OK, DataServices_Data_TABROW_VWLogicSoftwBlockCountOfProgrAttem_Read/DCM_E_PENDING]
        arg OpStatus: type=Dcm_OpStatusType, direction=IN
        arg Data: type=Dcm_Data8192ByteType, direction=OUT
      operation ReadDataLength: possible-error=[DataServices_Data_TABROW_VWLogicSoftwBlockCountOfProgrAttem_Read/E_NOT_OK, DataServices_Data_TABROW_VWLogicSoftwBlockCountOfProgrAttem_Read/DCM_E_PENDING]
        arg OpStatus: type=Dcm_OpStatusType, direction=IN
        arg DataLength: type=uint16, direction=OUT
      operation ConditionCheckRead: possible-error=[DataServices_Data_TABROW_VWLogicSoftwBlockCountOfProgrAttem_Read/E_NOT_OK, DataServices_Data_TABROW_VWLogicSoftwBlockCountOfProgrAttem_Read/DCM_E_PENDING]
        arg OpStatus: type=Dcm_OpStatusType, direction=IN
        arg ErrorCode: type=Dcm_NegativeResponseCodeType, direction=OUT
      error E_NOT_OK: error-code=1
      error DCM_E_PENDING: error-code=10
    DataServices_Data_DiagnServi_TABROW_VWSparePartNumbe_Read
      operation ReadData: possible-error=[DataServices_Data_DiagnServi_TABROW_VWSparePartNumbe_Read/E_NOT_OK, DataServices_Data_DiagnServi_TABROW_VWSparePartNumbe_Read/DCM_E_PENDING]
        arg OpStatus: type=Dcm_OpStatusType, direction=IN
        arg Data: type=Dcm_Data11ByteType, direction=OUT
      operation ConditionCheckRead: possible-error=[DataServices_Data_DiagnServi_TABROW_VWSparePartNumbe_Read/E_NOT_OK, DataServices_Data_DiagnServi_TABROW_VWSparePartNumbe_Read/DCM_E_PENDING]
        arg OpStatus: type=Dcm_OpStatusType, direction=IN
        arg ErrorCode: type=Dcm_NegativeResponseCodeType, direction=OUT
      error E_NOT_OK: error-code=1
      error DCM_E_PENDING: error-code=10
    DataServices_Data_Battery_banks_actual_voltage_Read_Data_By_Identifier
      operation ReadData: possible-error=[DataServices_Data_Battery_banks_actual_voltage_Read_Data_By_Identifier/E_NOT_OK, DataServices_Data_Battery_banks_actual_voltage_Read_Data_By_Identifier/DCM_E_PENDING]
        arg OpStatus: type=Dcm_OpStatusType, direction=IN
        arg Data: type=Dcm_Data8ByteType, direction=OUT
      operation ConditionCheckRead: possible-error=[DataServices_Data_Battery_banks_actual_voltage_Read_Data_By_Identifier/E_NOT_OK, DataServices_Data_Battery_banks_actual_voltage_Read_Data_By_Identifier/DCM_E_PENDING]
        arg OpStatus: type=Dcm_OpStatusType, direction=IN
        arg ErrorCode: type=Dcm_NegativeResponseCodeType, direction=OUT
      error E_NOT_OK: error-code=1
      error DCM_E_PENDING: error-code=10
    DataServices_Data_DiagnServi_TABROW_ECUNA_Read
      operation ReadData: possible-error=[DataServices_Data_DiagnServi_TABROW_ECUNA_Read/E_NOT_OK, DataServices_Data_DiagnServi_TABROW_ECUNA_Read/DCM_E_PENDING]
        arg OpStatus: type=Dcm_OpStatusType, direction=IN
        arg Data: type=Dcm_Data20ByteType, direction=OUT
      operation ConditionCheckRead: possible-error=[DataServices_Data_DiagnServi_TABROW_ECUNA_Read/E_NOT_OK, DataServices_Data_DiagnServi_TABROW_ECUNA_Read/DCM_E_PENDING]
        arg OpStatus: type=Dcm_OpStatusType, direction=IN
        arg ErrorCode: type=Dcm_NegativeResponseCodeType, direction=OUT
      error E_NOT_OK: error-code=1
      error DCM_E_PENDING: error-code=10
    DataServices_Data_HV_battery_maximum_charging_power_Read_Data_By_Identifier
      operation ReadData: possible-error=[DataServices_Data_HV_battery_maximum_charging_power_Read_Data_By_Identifier/E_NOT_OK, DataServices_Data_HV_battery_maximum_charging_power_Read_Data_By_Identifier/DCM_E_PENDING]
        arg OpStatus: type=Dcm_OpStatusType, direction=IN
        arg Data: type=Dcm_Data2ByteType, direction=OUT
      operation ConditionCheckRead: possible-error=[DataServices_Data_HV_battery_maximum_charging_power_Read_Data_By_Identifier/E_NOT_OK, DataServices_Data_HV_battery_maximum_charging_power_Read_Data_By_Identifier/DCM_E_PENDING]
        arg OpStatus: type=Dcm_OpStatusType, direction=IN
        arg ErrorCode: type=Dcm_NegativeResponseCodeType, direction=OUT
      error E_NOT_OK: error-code=1
      error DCM_E_PENDING: error-code=10
    DataServices_Data_DiagnServi_TABROW_NeuMeasu_Read_9_2_1_1_2
      operation ReadData: possible-error=[DataServices_Data_DiagnServi_TABROW_NeuMeasu_Read_9_2_1_1_2/E_NOT_OK, DataServices_Data_DiagnServi_TABROW_NeuMeasu_Read_9_2_1_1_2/DCM_E_PENDING]
        arg OpStatus: type=Dcm_OpStatusType, direction=IN
        arg Data: type=Dcm_Data2ByteType, direction=OUT
      operation ConditionCheckRead: possible-error=[DataServices_Data_DiagnServi_TABROW_NeuMeasu_Read_9_2_1_1_2/E_NOT_OK, DataServices_Data_DiagnServi_TABROW_NeuMeasu_Read_9_2_1_1_2/DCM_E_PENDING]
        arg OpStatus: type=Dcm_OpStatusType, direction=IN
        arg ErrorCode: type=Dcm_NegativeResponseCodeType, direction=OUT
      error E_NOT_OK: error-code=1
      error DCM_E_PENDING: error-code=10
    DataServices_Data_DiagnServi_TABROW_NeuMeasu_Read_9_2_1_1_1
      operation ReadData: possible-error=[DataServices_Data_DiagnServi_TABROW_NeuMeasu_Read_9_2_1_1_1/E_NOT_OK, DataServices_Data_DiagnServi_TABROW_NeuMeasu_Read_9_2_1_1_1/DCM_E_PENDING]
        arg OpStatus: type=Dcm_OpStatusType, direction=IN
        arg Data: type=Dcm_Data2ByteType, direction=OUT
      operation ConditionCheckRead: possible-error=[DataServices_Data_DiagnServi_TABROW_NeuMeasu_Read_9_2_1_1_1/E_NOT_OK, DataServices_Data_DiagnServi_TABROW_NeuMeasu_Read_9_2_1_1_1/DCM_E_PENDING]
        arg OpStatus: type=Dcm_OpStatusType, direction=IN
        arg ErrorCode: type=Dcm_NegativeResponseCodeType, direction=OUT
      error E_NOT_OK: error-code=1
      error DCM_E_PENDING: error-code=10
    DataServices_Data_DiagnServi_TABROW_NeuMeasu_Read_63_1_1
      operation ReadData: possible-error=[DataServices_Data_DiagnServi_TABROW_NeuMeasu_Read_63_1_1/E_NOT_OK, DataServices_Data_DiagnServi_TABROW_NeuMeasu_Read_63_1_1/DCM_E_PENDING]
        arg OpStatus: type=Dcm_OpStatusType, direction=IN
        arg Data: type=Dcm_Data16ByteType, direction=OUT
      operation ConditionCheckRead: possible-error=[DataServices_Data_DiagnServi_TABROW_NeuMeasu_Read_63_1_1/E_NOT_OK, DataServices_Data_DiagnServi_TABROW_NeuMeasu_Read_63_1_1/DCM_E_PENDING]
        arg OpStatus: type=Dcm_OpStatusType, direction=IN
        arg ErrorCode: type=Dcm_NegativeResponseCodeType, direction=OUT
      error E_NOT_OK: error-code=1
      error DCM_E_PENDING: error-code=10
    DataServices_Data_DiagnServi_Module_part_number_Read
      operation ReadData: possible-error=[DataServices_Data_DiagnServi_Module_part_number_Read/E_NOT_OK, DataServices_Data_DiagnServi_Module_part_number_Read/DCM_E_PENDING]
        arg OpStatus: type=Dcm_OpStatusType, direction=IN
        arg Data: type=Dcm_Data11ByteType, direction=OUT
      operation ConditionCheckRead: possible-error=[DataServices_Data_DiagnServi_Module_part_number_Read/E_NOT_OK, DataServices_Data_DiagnServi_Module_part_number_Read/DCM_E_PENDING]
        arg OpStatus: type=Dcm_OpStatusType, direction=IN
        arg ErrorCode: type=Dcm_NegativeResponseCodeType, direction=OUT
      operation WriteData: possible-error=[DataServices_Data_DiagnServi_Module_part_number_Read/E_NOT_OK, DataServices_Data_DiagnServi_Module_part_number_Read/DCM_E_PENDING]
        arg Data: type=Dcm_Data11ByteType, direction=IN
        arg OpStatus: type=Dcm_OpStatusType, direction=IN
        arg ErrorCode: type=Dcm_NegativeResponseCodeType, direction=OUT
      error E_NOT_OK: error-code=1
      error DCM_E_PENDING: error-code=10
    DataServices_Data_Battery_displayed_state_of_charge_Read_Data_By_Identifier
      operation ReadData: possible-error=[DataServices_Data_Battery_displayed_state_of_charge_Read_Data_By_Identifier/E_NOT_OK, DataServices_Data_Battery_displayed_state_of_charge_Read_Data_By_Identifier/DCM_E_PENDING]
        arg OpStatus: type=Dcm_OpStatusType, direction=IN
        arg Data: type=Dcm_Data2ByteType, direction=OUT
      operation ConditionCheckRead: possible-error=[DataServices_Data_Battery_displayed_state_of_charge_Read_Data_By_Identifier/E_NOT_OK, DataServices_Data_Battery_displayed_state_of_charge_Read_Data_By_Identifier/DCM_E_PENDING]
        arg OpStatus: type=Dcm_OpStatusType, direction=IN
        arg ErrorCode: type=Dcm_NegativeResponseCodeType, direction=OUT
      error E_NOT_OK: error-code=1
      error DCM_E_PENDING: error-code=10
    DataServices_Data_DiagnServi_TABROW_NeuMeasu_Read_27_4_1
      operation ReadData: possible-error=[DataServices_Data_DiagnServi_TABROW_NeuMeasu_Read_27_4_1/E_NOT_OK, DataServices_Data_DiagnServi_TABROW_NeuMeasu_Read_27_4_1/DCM_E_PENDING]
        arg OpStatus: type=Dcm_OpStatusType, direction=IN
        arg Data: type=Dcm_Data27ByteType, direction=OUT
      operation ConditionCheckRead: possible-error=[DataServices_Data_DiagnServi_TABROW_NeuMeasu_Read_27_4_1/E_NOT_OK, DataServices_Data_DiagnServi_TABROW_NeuMeasu_Read_27_4_1/DCM_E_PENDING]
        arg OpStatus: type=Dcm_OpStatusType, direction=IN
        arg ErrorCode: type=Dcm_NegativeResponseCodeType, direction=OUT
      error E_NOT_OK: error-code=1
      error DCM_E_PENDING: error-code=10
    DataServices_Data_DiagnServi_TABROW_NeuMeasu_Read_27_1
      operation ReadData: possible-error=[DataServices_Data_DiagnServi_TABROW_NeuMeasu_Read_27_1/E_NOT_OK, DataServices_Data_DiagnServi_TABROW_NeuMeasu_Read_27_1/DCM_E_PENDING]
        arg OpStatus: type=Dcm_OpStatusType, direction=IN
        arg Data: type=Dcm_Data27ByteType, direction=OUT
      operation ConditionCheckRead: possible-error=[DataServices_Data_DiagnServi_TABROW_NeuMeasu_Read_27_1/E_NOT_OK, DataServices_Data_DiagnServi_TABROW_NeuMeasu_Read_27_1/DCM_E_PENDING]
        arg OpStatus: type=Dcm_OpStatusType, direction=IN
        arg ErrorCode: type=Dcm_NegativeResponseCodeType, direction=OUT
      error E_NOT_OK: error-code=1
      error DCM_E_PENDING: error-code=10
    DataServices_Data_DiagnServi_TABROW_NeuMeasu_Read_27_3
      operation ReadData: possible-error=[DataServices_Data_DiagnServi_TABROW_NeuMeasu_Read_27_3/E_NOT_OK, DataServices_Data_DiagnServi_TABROW_NeuMeasu_Read_27_3/DCM_E_PENDING]
        arg OpStatus: type=Dcm_OpStatusType, direction=IN
        arg Data: type=Dcm_Data27ByteType, direction=OUT
      operation ConditionCheckRead: possible-error=[DataServices_Data_DiagnServi_TABROW_NeuMeasu_Read_27_3/E_NOT_OK, DataServices_Data_DiagnServi_TABROW_NeuMeasu_Read_27_3/DCM_E_PENDING]
        arg OpStatus: type=Dcm_OpStatusType, direction=IN
        arg ErrorCode: type=Dcm_NegativeResponseCodeType, direction=OUT
      error E_NOT_OK: error-code=1
      error DCM_E_PENDING: error-code=10
    DataServices_Data_DiagnServi_TABROW_NeuMeasu_Read_27_2
      operation ReadData: possible-error=[DataServices_Data_DiagnServi_TABROW_NeuMeasu_Read_27_2/E_NOT_OK, DataServices_Data_DiagnServi_TABROW_NeuMeasu_Read_27_2/DCM_E_PENDING]
        arg OpStatus: type=Dcm_OpStatusType, direction=IN
        arg Data: type=Dcm_Data27ByteType, direction=OUT
      operation ConditionCheckRead: possible-error=[DataServices_Data_DiagnServi_TABROW_NeuMeasu_Read_27_2/E_NOT_OK, DataServices_Data_DiagnServi_TABROW_NeuMeasu_Read_27_2/DCM_E_PENDING]
        arg OpStatus: type=Dcm_OpStatusType, direction=IN
        arg ErrorCode: type=Dcm_NegativeResponseCodeType, direction=OUT
      error E_NOT_OK: error-code=1
      error DCM_E_PENDING: error-code=10
    DataServices_Data_DiagnServi_TABROW_NeuMeasu_Read_27_5
      operation ReadData: possible-error=[DataServices_Data_DiagnServi_TABROW_NeuMeasu_Read_27_5/E_NOT_OK, DataServices_Data_DiagnServi_TABROW_NeuMeasu_Read_27_5/DCM_E_PENDING]
        arg OpStatus: type=Dcm_OpStatusType, direction=IN
        arg Data: type=Dcm_Data4ByteType, direction=OUT
      operation ConditionCheckRead: possible-error=[DataServices_Data_DiagnServi_TABROW_NeuMeasu_Read_27_5/E_NOT_OK, DataServices_Data_DiagnServi_TABROW_NeuMeasu_Read_27_5/DCM_E_PENDING]
        arg OpStatus: type=Dcm_OpStatusType, direction=IN
        arg ErrorCode: type=Dcm_NegativeResponseCodeType, direction=OUT
      error E_NOT_OK: error-code=1
      error DCM_E_PENDING: error-code=10
    DataServices_Data_DiagnServi_TABROW_NeuMeasu_Read_27_4
      operation ReadData: possible-error=[DataServices_Data_DiagnServi_TABROW_NeuMeasu_Read_27_4/E_NOT_OK, DataServices_Data_DiagnServi_TABROW_NeuMeasu_Read_27_4/DCM_E_PENDING]
        arg OpStatus: type=Dcm_OpStatusType, direction=IN
        arg Data: type=Dcm_Data27ByteType, direction=OUT
      operation ConditionCheckRead: possible-error=[DataServices_Data_DiagnServi_TABROW_NeuMeasu_Read_27_4/E_NOT_OK, DataServices_Data_DiagnServi_TABROW_NeuMeasu_Read_27_4/DCM_E_PENDING]
        arg OpStatus: type=Dcm_OpStatusType, direction=IN
        arg ErrorCode: type=Dcm_NegativeResponseCodeType, direction=OUT
      error E_NOT_OK: error-code=1
      error DCM_E_PENDING: error-code=10
    DataServices_Data_DiagnServi_TABROW_NeuMeasu_Read_27_7
      operation ReadData: possible-error=[DataServices_Data_DiagnServi_TABROW_NeuMeasu_Read_27_7/E_NOT_OK, DataServices_Data_DiagnServi_TABROW_NeuMeasu_Read_27_7/DCM_E_PENDING]
        arg OpStatus: type=Dcm_OpStatusType, direction=IN
        arg Data: type=Dcm_Data4ByteType, direction=OUT
      operation ConditionCheckRead: possible-error=[DataServices_Data_DiagnServi_TABROW_NeuMeasu_Read_27_7/E_NOT_OK, DataServices_Data_DiagnServi_TABROW_NeuMeasu_Read_27_7/DCM_E_PENDING]
        arg OpStatus: type=Dcm_OpStatusType, direction=IN
        arg ErrorCode: type=Dcm_NegativeResponseCodeType, direction=OUT
      error E_NOT_OK: error-code=1
      error DCM_E_PENDING: error-code=10
    DataServices_Data_DiagnServi_TABROW_NeuMeasu_Read_27_6
      operation ReadData: possible-error=[DataServices_Data_DiagnServi_TABROW_NeuMeasu_Read_27_6/E_NOT_OK, DataServices_Data_DiagnServi_TABROW_NeuMeasu_Read_27_6/DCM_E_PENDING]
        arg OpStatus: type=Dcm_OpStatusType, direction=IN
        arg Data: type=Dcm_Data2ByteType, direction=OUT
      operation ConditionCheckRead: possible-error=[DataServices_Data_DiagnServi_TABROW_NeuMeasu_Read_27_6/E_NOT_OK, DataServices_Data_DiagnServi_TABROW_NeuMeasu_Read_27_6/DCM_E_PENDING]
        arg OpStatus: type=Dcm_OpStatusType, direction=IN
        arg ErrorCode: type=Dcm_NegativeResponseCodeType, direction=OUT
      error E_NOT_OK: error-code=1
      error DCM_E_PENDING: error-code=10
    DataServices_Data_DiagnServi_TABROW_NeuMeasu_Read_27_8
      operation ReadData: possible-error=[DataServices_Data_DiagnServi_TABROW_NeuMeasu_Read_27_8/E_NOT_OK, DataServices_Data_DiagnServi_TABROW_NeuMeasu_Read_27_8/DCM_E_PENDING]
        arg OpStatus: type=Dcm_OpStatusType, direction=IN
        arg Data: type=Dcm_Data1ByteType, direction=OUT
      operation ConditionCheckRead: possible-error=[DataServices_Data_DiagnServi_TABROW_NeuMeasu_Read_27_8/E_NOT_OK, DataServices_Data_DiagnServi_TABROW_NeuMeasu_Read_27_8/DCM_E_PENDING]
        arg OpStatus: type=Dcm_OpStatusType, direction=IN
        arg ErrorCode: type=Dcm_NegativeResponseCodeType, direction=OUT
      error E_NOT_OK: error-code=1
      error DCM_E_PENDING: error-code=10
    DataServices_Data_TABROW_StandAmbieCondi_ReadDataByIdent
      operation ReadData: possible-error=[DataServices_Data_TABROW_StandAmbieCondi_ReadDataByIdent/E_NOT_OK, DataServices_Data_TABROW_StandAmbieCondi_ReadDataByIdent/DCM_E_PENDING]
        arg OpStatus: type=Dcm_OpStatusType, direction=IN
        arg Data: type=Dcm_Data9ByteType, direction=OUT
      operation ConditionCheckRead: possible-error=[DataServices_Data_TABROW_StandAmbieCondi_ReadDataByIdent/E_NOT_OK, DataServices_Data_TABROW_StandAmbieCondi_ReadDataByIdent/DCM_E_PENDING]
        arg OpStatus: type=Dcm_OpStatusType, direction=IN
        arg ErrorCode: type=Dcm_NegativeResponseCodeType, direction=OUT
      error E_NOT_OK: error-code=1
      error DCM_E_PENDING: error-code=10
    DataServices_Data_DiagnServi_SOH_Read
      operation ReadData: possible-error=[DataServices_Data_DiagnServi_SOH_Read/E_NOT_OK, DataServices_Data_DiagnServi_SOH_Read/DCM_E_PENDING]
        arg OpStatus: type=Dcm_OpStatusType, direction=IN
        arg Data: type=Dcm_Data1ByteType, direction=OUT
      operation ConditionCheckRead: possible-error=[DataServices_Data_DiagnServi_SOH_Read/E_NOT_OK, DataServices_Data_DiagnServi_SOH_Read/DCM_E_PENDING]
        arg OpStatus: type=Dcm_OpStatusType, direction=IN
        arg ErrorCode: type=Dcm_NegativeResponseCodeType, direction=OUT
      error E_NOT_OK: error-code=1
      error DCM_E_PENDING: error-code=10
    DataServices_Data_DiagnServi_TABROW_DID0xEFD_Read_1_1_1
      operation ReadData: possible-error=[DataServices_Data_DiagnServi_TABROW_DID0xEFD_Read_1_1_1/E_NOT_OK, DataServices_Data_DiagnServi_TABROW_DID0xEFD_Read_1_1_1/DCM_E_PENDING]
        arg OpStatus: type=Dcm_OpStatusType, direction=IN
        arg Data: type=Dcm_Data4ByteType, direction=OUT
      operation ConditionCheckRead: possible-error=[DataServices_Data_DiagnServi_TABROW_DID0xEFD_Read_1_1_1/E_NOT_OK, DataServices_Data_DiagnServi_TABROW_DID0xEFD_Read_1_1_1/DCM_E_PENDING]
        arg OpStatus: type=Dcm_OpStatusType, direction=IN
        arg ErrorCode: type=Dcm_NegativeResponseCodeType, direction=OUT
      error E_NOT_OK: error-code=1
      error DCM_E_PENDING: error-code=10
    DataServices_Data_DiagnServi_TABROW_NeuMeasu_Read_8_1
      operation ReadData: possible-error=[DataServices_Data_DiagnServi_TABROW_NeuMeasu_Read_8_1/E_NOT_OK, DataServices_Data_DiagnServi_TABROW_NeuMeasu_Read_8_1/DCM_E_PENDING]
        arg OpStatus: type=Dcm_OpStatusType, direction=IN
        arg Data: type=Dcm_Data2ByteType, direction=OUT
      operation ConditionCheckRead: possible-error=[DataServices_Data_DiagnServi_TABROW_NeuMeasu_Read_8_1/E_NOT_OK, DataServices_Data_DiagnServi_TABROW_NeuMeasu_Read_8_1/DCM_E_PENDING]
        arg OpStatus: type=Dcm_OpStatusType, direction=IN
        arg ErrorCode: type=Dcm_NegativeResponseCodeType, direction=OUT
      error E_NOT_OK: error-code=1
      error DCM_E_PENDING: error-code=10
    DataServices_Data_DiagnServi_TABROW_NeuMeasu_Read_8_2
      operation ReadData: possible-error=[DataServices_Data_DiagnServi_TABROW_NeuMeasu_Read_8_2/E_NOT_OK, DataServices_Data_DiagnServi_TABROW_NeuMeasu_Read_8_2/DCM_E_PENDING]
        arg OpStatus: type=Dcm_OpStatusType, direction=IN
        arg Data: type=Dcm_Data3ByteType, direction=OUT
      operation ConditionCheckRead: possible-error=[DataServices_Data_DiagnServi_TABROW_NeuMeasu_Read_8_2/E_NOT_OK, DataServices_Data_DiagnServi_TABROW_NeuMeasu_Read_8_2/DCM_E_PENDING]
        arg OpStatus: type=Dcm_OpStatusType, direction=IN
        arg ErrorCode: type=Dcm_NegativeResponseCodeType, direction=OUT
      error E_NOT_OK: error-code=1
      error DCM_E_PENDING: error-code=10
    DataServices_Data_DiagnServi_TABROW_ProduDeact_Read
      operation ReadData: possible-error=[DataServices_Data_DiagnServi_TABROW_ProduDeact_Read/E_NOT_OK, DataServices_Data_DiagnServi_TABROW_ProduDeact_Read/DCM_E_PENDING]
        arg OpStatus: type=Dcm_OpStatusType, direction=IN
        arg Data: type=Dcm_Data3ByteType, direction=OUT
      operation ConditionCheckRead: possible-error=[DataServices_Data_DiagnServi_TABROW_ProduDeact_Read/E_NOT_OK, DataServices_Data_DiagnServi_TABROW_ProduDeact_Read/DCM_E_PENDING]
        arg OpStatus: type=Dcm_OpStatusType, direction=IN
        arg ErrorCode: type=Dcm_NegativeResponseCodeType, direction=OUT
      operation WriteData: possible-error=[DataServices_Data_DiagnServi_TABROW_ProduDeact_Read/E_NOT_OK, DataServices_Data_DiagnServi_TABROW_ProduDeact_Read/DCM_E_PENDING]
        arg Data: type=Dcm_Data3ByteType, direction=IN
        arg OpStatus: type=Dcm_OpStatusType, direction=IN
        arg ErrorCode: type=Dcm_NegativeResponseCodeType, direction=OUT
      error E_NOT_OK: error-code=1
      error DCM_E_PENDING: error-code=10
    DataServices_Data_DiagnServi_TABROW_NeuMeasu_Read_57_11
      operation ReadData: possible-error=[DataServices_Data_DiagnServi_TABROW_NeuMeasu_Read_57_11/E_NOT_OK, DataServices_Data_DiagnServi_TABROW_NeuMeasu_Read_57_11/DCM_E_PENDING]
        arg OpStatus: type=Dcm_OpStatusType, direction=IN
        arg Data: type=Dcm_Data240ByteType, direction=OUT
      operation ReadDataLength: possible-error=[DataServices_Data_DiagnServi_TABROW_NeuMeasu_Read_57_11/E_NOT_OK, DataServices_Data_DiagnServi_TABROW_NeuMeasu_Read_57_11/DCM_E_PENDING]
        arg OpStatus: type=Dcm_OpStatusType, direction=IN
        arg DataLength: type=uint16, direction=OUT
      operation ConditionCheckRead: possible-error=[DataServices_Data_DiagnServi_TABROW_NeuMeasu_Read_57_11/E_NOT_OK, DataServices_Data_DiagnServi_TABROW_NeuMeasu_Read_57_11/DCM_E_PENDING]
        arg OpStatus: type=Dcm_OpStatusType, direction=IN
        arg ErrorCode: type=Dcm_NegativeResponseCodeType, direction=OUT
      error E_NOT_OK: error-code=1
      error DCM_E_PENDING: error-code=10
    DataServices_Data_DiagnServi_TABROW_NeuMeasu_Read_57_13
      operation ReadData: possible-error=[DataServices_Data_DiagnServi_TABROW_NeuMeasu_Read_57_13/E_NOT_OK, DataServices_Data_DiagnServi_TABROW_NeuMeasu_Read_57_13/DCM_E_PENDING]
        arg OpStatus: type=Dcm_OpStatusType, direction=IN
        arg Data: type=Dcm_Data3ByteType, direction=OUT
      operation ConditionCheckRead: possible-error=[DataServices_Data_DiagnServi_TABROW_NeuMeasu_Read_57_13/E_NOT_OK, DataServices_Data_DiagnServi_TABROW_NeuMeasu_Read_57_13/DCM_E_PENDING]
        arg OpStatus: type=Dcm_OpStatusType, direction=IN
        arg ErrorCode: type=Dcm_NegativeResponseCodeType, direction=OUT
      error E_NOT_OK: error-code=1
      error DCM_E_PENDING: error-code=10
    DataServices_Data_DiagnServi_TABROW_NeuMeasu_Read_57_14
      operation ReadData: possible-error=[DataServices_Data_DiagnServi_TABROW_NeuMeasu_Read_57_14/E_NOT_OK, DataServices_Data_DiagnServi_TABROW_NeuMeasu_Read_57_14/DCM_E_PENDING]
        arg OpStatus: type=Dcm_OpStatusType, direction=IN
        arg Data: type=Dcm_Data3ByteType, direction=OUT
      operation ConditionCheckRead: possible-error=[DataServices_Data_DiagnServi_TABROW_NeuMeasu_Read_57_14/E_NOT_OK, DataServices_Data_DiagnServi_TABROW_NeuMeasu_Read_57_14/DCM_E_PENDING]
        arg OpStatus: type=Dcm_OpStatusType, direction=IN
        arg ErrorCode: type=Dcm_NegativeResponseCodeType, direction=OUT
      error E_NOT_OK: error-code=1
      error DCM_E_PENDING: error-code=10
    DataServices_Data_DiagnServi_TABROW_AccelPedalPositD_Read
      operation ReadData: possible-error=[DataServices_Data_DiagnServi_TABROW_AccelPedalPositD_Read/E_NOT_OK, DataServices_Data_DiagnServi_TABROW_AccelPedalPositD_Read/DCM_E_PENDING]
        arg OpStatus: type=Dcm_OpStatusType, direction=IN
        arg Data: type=Dcm_Data1ByteType, direction=OUT
      operation ConditionCheckRead: possible-error=[DataServices_Data_DiagnServi_TABROW_AccelPedalPositD_Read/E_NOT_OK, DataServices_Data_DiagnServi_TABROW_AccelPedalPositD_Read/DCM_E_PENDING]
        arg OpStatus: type=Dcm_OpStatusType, direction=IN
        arg ErrorCode: type=Dcm_NegativeResponseCodeType, direction=OUT
      error E_NOT_OK: error-code=1
      error DCM_E_PENDING: error-code=10
    DataServices_Data_DiagnServi_TABROW_Finge_Read
      operation ReadData: possible-error=[DataServices_Data_DiagnServi_TABROW_Finge_Read/E_NOT_OK, DataServices_Data_DiagnServi_TABROW_Finge_Read/DCM_E_PENDING]
        arg OpStatus: type=Dcm_OpStatusType, direction=IN
        arg Data: type=Dcm_Data9ByteType, direction=OUT
      operation ConditionCheckRead: possible-error=[DataServices_Data_DiagnServi_TABROW_Finge_Read/E_NOT_OK, DataServices_Data_DiagnServi_TABROW_Finge_Read/DCM_E_PENDING]
        arg OpStatus: type=Dcm_OpStatusType, direction=IN
        arg ErrorCode: type=Dcm_NegativeResponseCodeType, direction=OUT
      operation WriteData: possible-error=[DataServices_Data_DiagnServi_TABROW_Finge_Read/E_NOT_OK, DataServices_Data_DiagnServi_TABROW_Finge_Read/DCM_E_PENDING]
        arg Data: type=Dcm_Data9ByteType, direction=IN
        arg OpStatus: type=Dcm_OpStatusType, direction=IN
        arg ErrorCode: type=Dcm_NegativeResponseCodeType, direction=OUT
      error E_NOT_OK: error-code=1
      error DCM_E_PENDING: error-code=10
    DataServices_Data_TABROW_TABROSyste_Read_1_1
      operation ReadData: possible-error=[DataServices_Data_TABROW_TABROSyste_Read_1_1/E_NOT_OK, DataServices_Data_TABROW_TABROSyste_Read_1_1/DCM_E_PENDING]
        arg OpStatus: type=Dcm_OpStatusType, direction=IN
        arg Data: type=Dcm_Data9ByteType, direction=OUT
      operation ConditionCheckRead: possible-error=[DataServices_Data_TABROW_TABROSyste_Read_1_1/E_NOT_OK, DataServices_Data_TABROW_TABROSyste_Read_1_1/DCM_E_PENDING]
        arg OpStatus: type=Dcm_OpStatusType, direction=IN
        arg ErrorCode: type=Dcm_NegativeResponseCodeType, direction=OUT
      error E_NOT_OK: error-code=1
      error DCM_E_PENDING: error-code=10
    DataServices_Data_TABROW_ECUStandMode2_Read
      operation ReadData: possible-error=[DataServices_Data_TABROW_ECUStandMode2_Read/E_NOT_OK, DataServices_Data_TABROW_ECUStandMode2_Read/DCM_E_PENDING]
        arg OpStatus: type=Dcm_OpStatusType, direction=IN
        arg Data: type=Dcm_Data4ByteType, direction=OUT
      operation ConditionCheckRead: possible-error=[DataServices_Data_TABROW_ECUStandMode2_Read/E_NOT_OK, DataServices_Data_TABROW_ECUStandMode2_Read/DCM_E_PENDING]
        arg OpStatus: type=Dcm_OpStatusType, direction=IN
        arg ErrorCode: type=Dcm_NegativeResponseCodeType, direction=OUT
      operation WriteData: possible-error=[DataServices_Data_TABROW_ECUStandMode2_Read/E_NOT_OK, DataServices_Data_TABROW_ECUStandMode2_Read/DCM_E_PENDING]
        arg Data: type=Dcm_Data4ByteType, direction=IN
        arg OpStatus: type=Dcm_OpStatusType, direction=IN
        arg ErrorCode: type=Dcm_NegativeResponseCodeType, direction=OUT
      error E_NOT_OK: error-code=1
      error DCM_E_PENDING: error-code=10
    DataServices_Data_DiagnServi_TABROW_NeuMeasu2_Read
      operation ReadData: possible-error=[DataServices_Data_DiagnServi_TABROW_NeuMeasu2_Read/E_NOT_OK, DataServices_Data_DiagnServi_TABROW_NeuMeasu2_Read/DCM_E_PENDING]
        arg OpStatus: type=Dcm_OpStatusType, direction=IN
        arg Data: type=Dcm_Data1ByteType, direction=OUT
      operation ConditionCheckRead: possible-error=[DataServices_Data_DiagnServi_TABROW_NeuMeasu2_Read/E_NOT_OK, DataServices_Data_DiagnServi_TABROW_NeuMeasu2_Read/DCM_E_PENDING]
        arg OpStatus: type=Dcm_OpStatusType, direction=IN
        arg ErrorCode: type=Dcm_NegativeResponseCodeType, direction=OUT
      error E_NOT_OK: error-code=1
      error DCM_E_PENDING: error-code=10
    DataServices_Data_DiagnServi_TABROW_NeuCalibData_Read
      operation ReadData: possible-error=[DataServices_Data_DiagnServi_TABROW_NeuCalibData_Read/E_NOT_OK, DataServices_Data_DiagnServi_TABROW_NeuCalibData_Read/DCM_E_PENDING]
        arg OpStatus: type=Dcm_OpStatusType, direction=IN
        arg Data: type=Dcm_Data1ByteType, direction=OUT
      operation ConditionCheckRead: possible-error=[DataServices_Data_DiagnServi_TABROW_NeuCalibData_Read/E_NOT_OK, DataServices_Data_DiagnServi_TABROW_NeuCalibData_Read/DCM_E_PENDING]
        arg OpStatus: type=Dcm_OpStatusType, direction=IN
        arg ErrorCode: type=Dcm_NegativeResponseCodeType, direction=OUT
      operation WriteData: possible-error=[DataServices_Data_DiagnServi_TABROW_NeuCalibData_Read/E_NOT_OK, DataServices_Data_DiagnServi_TABROW_NeuCalibData_Read/DCM_E_PENDING]
        arg Data: type=Dcm_Data1ByteType, direction=IN
        arg OpStatus: type=Dcm_OpStatusType, direction=IN
        arg ErrorCode: type=Dcm_NegativeResponseCodeType, direction=OUT
      error E_NOT_OK: error-code=1
      error DCM_E_PENDING: error-code=10
    DataServices_Data_DiagnServi_TABROW_NeuMeasu_Read_46_1_1_1_1_1_1
      operation ReadData: possible-error=[DataServices_Data_DiagnServi_TABROW_NeuMeasu_Read_46_1_1_1_1_1_1/E_NOT_OK, DataServices_Data_DiagnServi_TABROW_NeuMeasu_Read_46_1_1_1_1_1_1/DCM_E_PENDING]
        arg OpStatus: type=Dcm_OpStatusType, direction=IN
        arg Data: type=Dcm_Data152ByteType, direction=OUT
      operation ConditionCheckRead: possible-error=[DataServices_Data_DiagnServi_TABROW_NeuMeasu_Read_46_1_1_1_1_1_1/E_NOT_OK, DataServices_Data_DiagnServi_TABROW_NeuMeasu_Read_46_1_1_1_1_1_1/DCM_E_PENDING]
        arg OpStatus: type=Dcm_OpStatusType, direction=IN
        arg ErrorCode: type=Dcm_NegativeResponseCodeType, direction=OUT
      error E_NOT_OK: error-code=1
      error DCM_E_PENDING: error-code=10
    DataServices_Data_DiagnServi_TABROW_TABROOBDDr_Read_Data_By_Identifier
      operation ReadData: possible-error=[DataServices_Data_DiagnServi_TABROW_TABROOBDDr_Read_Data_By_Identifier/E_NOT_OK, DataServices_Data_DiagnServi_TABROW_TABROOBDDr_Read_Data_By_Identifier/DCM_E_PENDING]
        arg OpStatus: type=Dcm_OpStatusType, direction=IN
        arg Data: type=Dcm_Data1ByteType, direction=OUT
      operation ConditionCheckRead: possible-error=[DataServices_Data_DiagnServi_TABROW_TABROOBDDr_Read_Data_By_Identifier/E_NOT_OK, DataServices_Data_DiagnServi_TABROW_TABROOBDDr_Read_Data_By_Identifier/DCM_E_PENDING]
        arg OpStatus: type=Dcm_OpStatusType, direction=IN
        arg ErrorCode: type=Dcm_NegativeResponseCodeType, direction=OUT
      error E_NOT_OK: error-code=1
      error DCM_E_PENDING: error-code=10
    DataServices_Data_DiagnServi_TABROW_NeuMeasu_Read_36_3
      operation ReadData: possible-error=[DataServices_Data_DiagnServi_TABROW_NeuMeasu_Read_36_3/E_NOT_OK, DataServices_Data_DiagnServi_TABROW_NeuMeasu_Read_36_3/DCM_E_PENDING]
        arg OpStatus: type=Dcm_OpStatusType, direction=IN
        arg Data: type=Dcm_Data2ByteType, direction=OUT
      operation ConditionCheckRead: possible-error=[DataServices_Data_DiagnServi_TABROW_NeuMeasu_Read_36_3/E_NOT_OK, DataServices_Data_DiagnServi_TABROW_NeuMeasu_Read_36_3/DCM_E_PENDING]
        arg OpStatus: type=Dcm_OpStatusType, direction=IN
        arg ErrorCode: type=Dcm_NegativeResponseCodeType, direction=OUT
      error E_NOT_OK: error-code=1
      error DCM_E_PENDING: error-code=10
    DataServices_Data_DiagnServi_TABROW_NeuMeasu_Read_36_1
      operation ReadData: possible-error=[DataServices_Data_DiagnServi_TABROW_NeuMeasu_Read_36_1/E_NOT_OK, DataServices_Data_DiagnServi_TABROW_NeuMeasu_Read_36_1/DCM_E_PENDING]
        arg OpStatus: type=Dcm_OpStatusType, direction=IN
        arg Data: type=Dcm_Data2ByteType, direction=OUT
      operation ConditionCheckRead: possible-error=[DataServices_Data_DiagnServi_TABROW_NeuMeasu_Read_36_1/E_NOT_OK, DataServices_Data_DiagnServi_TABROW_NeuMeasu_Read_36_1/DCM_E_PENDING]
        arg OpStatus: type=Dcm_OpStatusType, direction=IN
        arg ErrorCode: type=Dcm_NegativeResponseCodeType, direction=OUT
      error E_NOT_OK: error-code=1
      error DCM_E_PENDING: error-code=10
    DataServices_Data_DiagnServi_TABROW_NeuMeasu_Read_43_1_1_1_1_1_1_1_1_1_1
      operation ReadData: possible-error=[DataServices_Data_DiagnServi_TABROW_NeuMeasu_Read_43_1_1_1_1_1_1_1_1_1_1/E_NOT_OK, DataServices_Data_DiagnServi_TABROW_NeuMeasu_Read_43_1_1_1_1_1_1_1_1_1_1/DCM_E_PENDING]
        arg OpStatus: type=Dcm_OpStatusType, direction=IN
        arg Data: type=Dcm_Data64ByteType, direction=OUT
      operation ConditionCheckRead: possible-error=[DataServices_Data_DiagnServi_TABROW_NeuMeasu_Read_43_1_1_1_1_1_1_1_1_1_1/E_NOT_OK, DataServices_Data_DiagnServi_TABROW_NeuMeasu_Read_43_1_1_1_1_1_1_1_1_1_1/DCM_E_PENDING]
        arg OpStatus: type=Dcm_OpStatusType, direction=IN
        arg ErrorCode: type=Dcm_NegativeResponseCodeType, direction=OUT
      error E_NOT_OK: error-code=1
      error DCM_E_PENDING: error-code=10
    DataServices_Data_DiagnServi_TABROW_NeuMeasu_Read_43_1_1_1_1_1_1
      operation ReadData: possible-error=[DataServices_Data_DiagnServi_TABROW_NeuMeasu_Read_43_1_1_1_1_1_1/E_NOT_OK, DataServices_Data_DiagnServi_TABROW_NeuMeasu_Read_43_1_1_1_1_1_1/DCM_E_PENDING]
        arg OpStatus: type=Dcm_OpStatusType, direction=IN
        arg Data: type=Dcm_Data64ByteType, direction=OUT
      operation ConditionCheckRead: possible-error=[DataServices_Data_DiagnServi_TABROW_NeuMeasu_Read_43_1_1_1_1_1_1/E_NOT_OK, DataServices_Data_DiagnServi_TABROW_NeuMeasu_Read_43_1_1_1_1_1_1/DCM_E_PENDING]
        arg OpStatus: type=Dcm_OpStatusType, direction=IN
        arg ErrorCode: type=Dcm_NegativeResponseCodeType, direction=OUT
      error E_NOT_OK: error-code=1
      error DCM_E_PENDING: error-code=10
    DataServices_Data_TABROW_InUseMonitPerfoRatio_Read_Data_By_Identifier
      operation ReadData: possible-error=[DataServices_Data_TABROW_InUseMonitPerfoRatio_Read_Data_By_Identifier/E_NOT_OK, DataServices_Data_TABROW_InUseMonitPerfoRatio_Read_Data_By_Identifier/DCM_E_PENDING]
        arg OpStatus: type=Dcm_OpStatusType, direction=IN
        arg Data: type=Dcm_Data8192ByteType, direction=OUT
      operation ReadDataLength: possible-error=[DataServices_Data_TABROW_InUseMonitPerfoRatio_Read_Data_By_Identifier/E_NOT_OK, DataServices_Data_TABROW_InUseMonitPerfoRatio_Read_Data_By_Identifier/DCM_E_PENDING]
        arg OpStatus: type=Dcm_OpStatusType, direction=IN
        arg DataLength: type=uint16, direction=OUT
      operation ConditionCheckRead: possible-error=[DataServices_Data_TABROW_InUseMonitPerfoRatio_Read_Data_By_Identifier/E_NOT_OK, DataServices_Data_TABROW_InUseMonitPerfoRatio_Read_Data_By_Identifier/DCM_E_PENDING]
        arg OpStatus: type=Dcm_OpStatusType, direction=IN
        arg ErrorCode: type=Dcm_NegativeResponseCodeType, direction=OUT
      error E_NOT_OK: error-code=1
      error DCM_E_PENDING: error-code=10
    DataServices_Data_DiagnServi_TABROW_NeuMeasu_Read_27_1_1_1_1
      operation ReadData: possible-error=[DataServices_Data_DiagnServi_TABROW_NeuMeasu_Read_27_1_1_1_1/E_NOT_OK, DataServices_Data_DiagnServi_TABROW_NeuMeasu_Read_27_1_1_1_1/DCM_E_PENDING]
        arg OpStatus: type=Dcm_OpStatusType, direction=IN
        arg Data: type=Dcm_Data1ByteType, direction=OUT
      operation ConditionCheckRead: possible-error=[DataServices_Data_DiagnServi_TABROW_NeuMeasu_Read_27_1_1_1_1/E_NOT_OK, DataServices_Data_DiagnServi_TABROW_NeuMeasu_Read_27_1_1_1_1/DCM_E_PENDING]
        arg OpStatus: type=Dcm_OpStatusType, direction=IN
        arg ErrorCode: type=Dcm_NegativeResponseCodeType, direction=OUT
      error E_NOT_OK: error-code=1
      error DCM_E_PENDING: error-code=10
    DataServices_Data_TABROW_BMCHVKEoHVLState_Read_Data_By_Identifier
      operation ReadData: possible-error=[DataServices_Data_TABROW_BMCHVKEoHVLState_Read_Data_By_Identifier/E_NOT_OK, DataServices_Data_TABROW_BMCHVKEoHVLState_Read_Data_By_Identifier/DCM_E_PENDING]
        arg OpStatus: type=Dcm_OpStatusType, direction=IN
        arg Data: type=Dcm_Data1ByteType, direction=OUT
      operation ConditionCheckRead: possible-error=[DataServices_Data_TABROW_BMCHVKEoHVLState_Read_Data_By_Identifier/E_NOT_OK, DataServices_Data_TABROW_BMCHVKEoHVLState_Read_Data_By_Identifier/DCM_E_PENDING]
        arg OpStatus: type=Dcm_OpStatusType, direction=IN
        arg ErrorCode: type=Dcm_NegativeResponseCodeType, direction=OUT
      error E_NOT_OK: error-code=1
      error DCM_E_PENDING: error-code=10
    DataServices_Data_DiagnServi_TABROW_NeuMeasu_Read_27_1_1_1_2
      operation ReadData: possible-error=[DataServices_Data_DiagnServi_TABROW_NeuMeasu_Read_27_1_1_1_2/E_NOT_OK, DataServices_Data_DiagnServi_TABROW_NeuMeasu_Read_27_1_1_1_2/DCM_E_PENDING]
        arg OpStatus: type=Dcm_OpStatusType, direction=IN
        arg Data: type=Dcm_Data1ByteType, direction=OUT
      operation ConditionCheckRead: possible-error=[DataServices_Data_DiagnServi_TABROW_NeuMeasu_Read_27_1_1_1_2/E_NOT_OK, DataServices_Data_DiagnServi_TABROW_NeuMeasu_Read_27_1_1_1_2/DCM_E_PENDING]
        arg OpStatus: type=Dcm_OpStatusType, direction=IN
        arg ErrorCode: type=Dcm_NegativeResponseCodeType, direction=OUT
      error E_NOT_OK: error-code=1
      error DCM_E_PENDING: error-code=10
    DataServices_Data_DiagnServi_BMCE_part_number_Read
      operation ReadData: possible-error=[DataServices_Data_DiagnServi_BMCE_part_number_Read/E_NOT_OK, DataServices_Data_DiagnServi_BMCE_part_number_Read/DCM_E_PENDING]
        arg OpStatus: type=Dcm_OpStatusType, direction=IN
        arg Data: type=Dcm_Data11ByteType, direction=OUT
      operation ConditionCheckRead: possible-error=[DataServices_Data_DiagnServi_BMCE_part_number_Read/E_NOT_OK, DataServices_Data_DiagnServi_BMCE_part_number_Read/DCM_E_PENDING]
        arg OpStatus: type=Dcm_OpStatusType, direction=IN
        arg ErrorCode: type=Dcm_NegativeResponseCodeType, direction=OUT
      operation WriteData: possible-error=[DataServices_Data_DiagnServi_BMCE_part_number_Read/E_NOT_OK, DataServices_Data_DiagnServi_BMCE_part_number_Read/DCM_E_PENDING]
        arg Data: type=Dcm_Data11ByteType, direction=IN
        arg OpStatus: type=Dcm_OpStatusType, direction=IN
        arg ErrorCode: type=Dcm_NegativeResponseCodeType, direction=OUT
      error E_NOT_OK: error-code=1
      error DCM_E_PENDING: error-code=10
    DataServices_Data_DiagnServi_TABROW_NeuMeasu_Read_8
      operation ReadData: possible-error=[DataServices_Data_DiagnServi_TABROW_NeuMeasu_Read_8/E_NOT_OK, DataServices_Data_DiagnServi_TABROW_NeuMeasu_Read_8/DCM_E_PENDING]
        arg OpStatus: type=Dcm_OpStatusType, direction=IN
        arg Data: type=Dcm_Data3ByteType, direction=OUT
      operation ConditionCheckRead: possible-error=[DataServices_Data_DiagnServi_TABROW_NeuMeasu_Read_8/E_NOT_OK, DataServices_Data_DiagnServi_TABROW_NeuMeasu_Read_8/DCM_E_PENDING]
        arg OpStatus: type=Dcm_OpStatusType, direction=IN
        arg ErrorCode: type=Dcm_NegativeResponseCodeType, direction=OUT
      error E_NOT_OK: error-code=1
      error DCM_E_PENDING: error-code=10
    DataServices_Data_DiagnServi_TABROW_NeuMeasu_Read_9
      operation ReadData: possible-error=[DataServices_Data_DiagnServi_TABROW_NeuMeasu_Read_9/E_NOT_OK, DataServices_Data_DiagnServi_TABROW_NeuMeasu_Read_9/DCM_E_PENDING]
        arg OpStatus: type=Dcm_OpStatusType, direction=IN
        arg Data: type=Dcm_Data1ByteType, direction=OUT
      operation ConditionCheckRead: possible-error=[DataServices_Data_DiagnServi_TABROW_NeuMeasu_Read_9/E_NOT_OK, DataServices_Data_DiagnServi_TABROW_NeuMeasu_Read_9/DCM_E_PENDING]
        arg OpStatus: type=Dcm_OpStatusType, direction=IN
        arg ErrorCode: type=Dcm_NegativeResponseCodeType, direction=OUT
      error E_NOT_OK: error-code=1
      error DCM_E_PENDING: error-code=10
    DataServices_Data_TABROW_BMCHVKFehleInter_Read_Data_By_Identifier
      operation ReadData: possible-error=[DataServices_Data_TABROW_BMCHVKFehleInter_Read_Data_By_Identifier/E_NOT_OK, DataServices_Data_TABROW_BMCHVKFehleInter_Read_Data_By_Identifier/DCM_E_PENDING]
        arg OpStatus: type=Dcm_OpStatusType, direction=IN
        arg Data: type=Dcm_Data1ByteType, direction=OUT
      operation ConditionCheckRead: possible-error=[DataServices_Data_TABROW_BMCHVKFehleInter_Read_Data_By_Identifier/E_NOT_OK, DataServices_Data_TABROW_BMCHVKFehleInter_Read_Data_By_Identifier/DCM_E_PENDING]
        arg OpStatus: type=Dcm_OpStatusType, direction=IN
        arg ErrorCode: type=Dcm_NegativeResponseCodeType, direction=OUT
      error E_NOT_OK: error-code=1
      error DCM_E_PENDING: error-code=10
    DataServices_Data_DiagnServi_TABROW_NeuMeasu_Read_2
      operation ReadData: possible-error=[DataServices_Data_DiagnServi_TABROW_NeuMeasu_Read_2/E_NOT_OK, DataServices_Data_DiagnServi_TABROW_NeuMeasu_Read_2/DCM_E_PENDING]
        arg OpStatus: type=Dcm_OpStatusType, direction=IN
        arg Data: type=Dcm_Data1ByteType, direction=OUT
      operation ConditionCheckRead: possible-error=[DataServices_Data_DiagnServi_TABROW_NeuMeasu_Read_2/E_NOT_OK, DataServices_Data_DiagnServi_TABROW_NeuMeasu_Read_2/DCM_E_PENDING]
        arg OpStatus: type=Dcm_OpStatusType, direction=IN
        arg ErrorCode: type=Dcm_NegativeResponseCodeType, direction=OUT
      error E_NOT_OK: error-code=1
      error DCM_E_PENDING: error-code=10
    DataServices_Data_DiagnServi_TABROW_NeuMeasu_Read_3
      operation ReadData: possible-error=[DataServices_Data_DiagnServi_TABROW_NeuMeasu_Read_3/E_NOT_OK, DataServices_Data_DiagnServi_TABROW_NeuMeasu_Read_3/DCM_E_PENDING]
        arg OpStatus: type=Dcm_OpStatusType, direction=IN
        arg Data: type=Dcm_Data1ByteType, direction=OUT
      operation ConditionCheckRead: possible-error=[DataServices_Data_DiagnServi_TABROW_NeuMeasu_Read_3/E_NOT_OK, DataServices_Data_DiagnServi_TABROW_NeuMeasu_Read_3/DCM_E_PENDING]
        arg OpStatus: type=Dcm_OpStatusType, direction=IN
        arg ErrorCode: type=Dcm_NegativeResponseCodeType, direction=OUT
      error E_NOT_OK: error-code=1
      error DCM_E_PENDING: error-code=10
    DataServices_Data_TABROW_VkmsVkmsv_Read_Data_By_Identifier
      operation ReadData: possible-error=[DataServices_Data_TABROW_VkmsVkmsv_Read_Data_By_Identifier/E_NOT_OK, DataServices_Data_TABROW_VkmsVkmsv_Read_Data_By_Identifier/DCM_E_PENDING]
        arg OpStatus: type=Dcm_OpStatusType, direction=IN
        arg Data: type=Dcm_Data18ByteType, direction=OUT
      operation ConditionCheckRead: possible-error=[DataServices_Data_TABROW_VkmsVkmsv_Read_Data_By_Identifier/E_NOT_OK, DataServices_Data_TABROW_VkmsVkmsv_Read_Data_By_Identifier/DCM_E_PENDING]
        arg OpStatus: type=Dcm_OpStatusType, direction=IN
        arg ErrorCode: type=Dcm_NegativeResponseCodeType, direction=OUT
      error E_NOT_OK: error-code=1
      error DCM_E_PENDING: error-code=10
    DataServices_Data_DiagnServi_TABROW_NeuMeasu_Read_1
      operation ReadData: possible-error=[DataServices_Data_DiagnServi_TABROW_NeuMeasu_Read_1/E_NOT_OK, DataServices_Data_DiagnServi_TABROW_NeuMeasu_Read_1/DCM_E_PENDING]
        arg OpStatus: type=Dcm_OpStatusType, direction=IN
        arg Data: type=Dcm_Data4ByteType, direction=OUT
      operation ConditionCheckRead: possible-error=[DataServices_Data_DiagnServi_TABROW_NeuMeasu_Read_1/E_NOT_OK, DataServices_Data_DiagnServi_TABROW_NeuMeasu_Read_1/DCM_E_PENDING]
        arg OpStatus: type=Dcm_OpStatusType, direction=IN
        arg ErrorCode: type=Dcm_NegativeResponseCodeType, direction=OUT
      error E_NOT_OK: error-code=1
      error DCM_E_PENDING: error-code=10
    DataServices_Data_DiagnServi_TABROW_NeuMeasu_Read_6
      operation ReadData: possible-error=[DataServices_Data_DiagnServi_TABROW_NeuMeasu_Read_6/E_NOT_OK, DataServices_Data_DiagnServi_TABROW_NeuMeasu_Read_6/DCM_E_PENDING]
        arg OpStatus: type=Dcm_OpStatusType, direction=IN
        arg Data: type=Dcm_Data2ByteType, direction=OUT
      operation ConditionCheckRead: possible-error=[DataServices_Data_DiagnServi_TABROW_NeuMeasu_Read_6/E_NOT_OK, DataServices_Data_DiagnServi_TABROW_NeuMeasu_Read_6/DCM_E_PENDING]
        arg OpStatus: type=Dcm_OpStatusType, direction=IN
        arg ErrorCode: type=Dcm_NegativeResponseCodeType, direction=OUT
      error E_NOT_OK: error-code=1
      error DCM_E_PENDING: error-code=10
    DataServices_Data_TABROW_StatuProdu_Read_Data_By_Identifier
      operation ReadData: possible-error=[DataServices_Data_TABROW_StatuProdu_Read_Data_By_Identifier/E_NOT_OK, DataServices_Data_TABROW_StatuProdu_Read_Data_By_Identifier/DCM_E_PENDING]
        arg OpStatus: type=Dcm_OpStatusType, direction=IN
        arg Data: type=Dcm_Data1ByteType, direction=OUT
      operation ConditionCheckRead: possible-error=[DataServices_Data_TABROW_StatuProdu_Read_Data_By_Identifier/E_NOT_OK, DataServices_Data_TABROW_StatuProdu_Read_Data_By_Identifier/DCM_E_PENDING]
        arg OpStatus: type=Dcm_OpStatusType, direction=IN
        arg ErrorCode: type=Dcm_NegativeResponseCodeType, direction=OUT
      error E_NOT_OK: error-code=1
      error DCM_E_PENDING: error-code=10
    DataServices_Data_DiagnServi_TABROW_NeuMeasu_Read_7
      operation ReadData: possible-error=[DataServices_Data_DiagnServi_TABROW_NeuMeasu_Read_7/E_NOT_OK, DataServices_Data_DiagnServi_TABROW_NeuMeasu_Read_7/DCM_E_PENDING]
        arg OpStatus: type=Dcm_OpStatusType, direction=IN
        arg Data: type=Dcm_Data1ByteType, direction=OUT
      operation ConditionCheckRead: possible-error=[DataServices_Data_DiagnServi_TABROW_NeuMeasu_Read_7/E_NOT_OK, DataServices_Data_DiagnServi_TABROW_NeuMeasu_Read_7/DCM_E_PENDING]
        arg OpStatus: type=Dcm_OpStatusType, direction=IN
        arg ErrorCode: type=Dcm_NegativeResponseCodeType, direction=OUT
      error E_NOT_OK: error-code=1
      error DCM_E_PENDING: error-code=10
    DataServices_Data_DiagnServi_TABROW_NeuMeasu_Read_4
      operation ReadData: possible-error=[DataServices_Data_DiagnServi_TABROW_NeuMeasu_Read_4/E_NOT_OK, DataServices_Data_DiagnServi_TABROW_NeuMeasu_Read_4/DCM_E_PENDING]
        arg OpStatus: type=Dcm_OpStatusType, direction=IN
        arg Data: type=Dcm_Data1ByteType, direction=OUT
      operation ConditionCheckRead: possible-error=[DataServices_Data_DiagnServi_TABROW_NeuMeasu_Read_4/E_NOT_OK, DataServices_Data_DiagnServi_TABROW_NeuMeasu_Read_4/DCM_E_PENDING]
        arg OpStatus: type=Dcm_OpStatusType, direction=IN
        arg ErrorCode: type=Dcm_NegativeResponseCodeType, direction=OUT
      error E_NOT_OK: error-code=1
      error DCM_E_PENDING: error-code=10
    DataServices_Data_DiagnServi_TABROW_NeuMeasu_Read_5
      operation ReadData: possible-error=[DataServices_Data_DiagnServi_TABROW_NeuMeasu_Read_5/E_NOT_OK, DataServices_Data_DiagnServi_TABROW_NeuMeasu_Read_5/DCM_E_PENDING]
        arg OpStatus: type=Dcm_OpStatusType, direction=IN
        arg Data: type=Dcm_Data1ByteType, direction=OUT
      operation ConditionCheckRead: possible-error=[DataServices_Data_DiagnServi_TABROW_NeuMeasu_Read_5/E_NOT_OK, DataServices_Data_DiagnServi_TABROW_NeuMeasu_Read_5/DCM_E_PENDING]
        arg OpStatus: type=Dcm_OpStatusType, direction=IN
        arg ErrorCode: type=Dcm_NegativeResponseCodeType, direction=OUT
      error E_NOT_OK: error-code=1
      error DCM_E_PENDING: error-code=10
    DataServices_Data_TABROW_SysteIdent_Read
      operation ReadData: possible-error=[DataServices_Data_TABROW_SysteIdent_Read/E_NOT_OK, DataServices_Data_TABROW_SysteIdent_Read/DCM_E_PENDING]
        arg OpStatus: type=Dcm_OpStatusType, direction=IN
        arg Data: type=Dcm_Data4ByteType, direction=OUT
      operation ConditionCheckRead: possible-error=[DataServices_Data_TABROW_SysteIdent_Read/E_NOT_OK, DataServices_Data_TABROW_SysteIdent_Read/DCM_E_PENDING]
        arg OpStatus: type=Dcm_OpStatusType, direction=IN
        arg ErrorCode: type=Dcm_NegativeResponseCodeType, direction=OUT
      error E_NOT_OK: error-code=1
      error DCM_E_PENDING: error-code=10
    DataServices_Data_DiagnServi_TABROW_MonitStatuSinceDTCsClear_Read
      operation ReadData: possible-error=[DataServices_Data_DiagnServi_TABROW_MonitStatuSinceDTCsClear_Read/E_NOT_OK, DataServices_Data_DiagnServi_TABROW_MonitStatuSinceDTCsClear_Read/DCM_E_PENDING]
        arg OpStatus: type=Dcm_OpStatusType, direction=IN
        arg Data: type=Dcm_Data4ByteType, direction=OUT
      operation ConditionCheckRead: possible-error=[DataServices_Data_DiagnServi_TABROW_MonitStatuSinceDTCsClear_Read/E_NOT_OK, DataServices_Data_DiagnServi_TABROW_MonitStatuSinceDTCsClear_Read/DCM_E_PENDING]
        arg OpStatus: type=Dcm_OpStatusType, direction=IN
        arg ErrorCode: type=Dcm_NegativeResponseCodeType, direction=OUT
      error E_NOT_OK: error-code=1
      error DCM_E_PENDING: error-code=10
    DataServices_Data_TABROW_TABROSyste_Read_1_1_1_1_1_1_1_1_1_1_1_1_1_1_1
      operation ReadData: possible-error=[DataServices_Data_TABROW_TABROSyste_Read_1_1_1_1_1_1_1_1_1_1_1_1_1_1_1/E_NOT_OK, DataServices_Data_TABROW_TABROSyste_Read_1_1_1_1_1_1_1_1_1_1_1_1_1_1_1/DCM_E_PENDING]
        arg OpStatus: type=Dcm_OpStatusType, direction=IN
        arg Data: type=Dcm_Data24ByteType, direction=OUT
      operation ConditionCheckRead: possible-error=[DataServices_Data_TABROW_TABROSyste_Read_1_1_1_1_1_1_1_1_1_1_1_1_1_1_1/E_NOT_OK, DataServices_Data_TABROW_TABROSyste_Read_1_1_1_1_1_1_1_1_1_1_1_1_1_1_1/DCM_E_PENDING]
        arg OpStatus: type=Dcm_OpStatusType, direction=IN
        arg ErrorCode: type=Dcm_NegativeResponseCodeType, direction=OUT
      error E_NOT_OK: error-code=1
      error DCM_E_PENDING: error-code=10
    DataServices_Data_DiagnServi_TABROW_NeuMeasu_Read_29_1_1_1_1_1_1
      operation ReadData: possible-error=[DataServices_Data_DiagnServi_TABROW_NeuMeasu_Read_29_1_1_1_1_1_1/E_NOT_OK, DataServices_Data_DiagnServi_TABROW_NeuMeasu_Read_29_1_1_1_1_1_1/DCM_E_PENDING]
        arg OpStatus: type=Dcm_OpStatusType, direction=IN
        arg Data: type=Dcm_Data4ByteType, direction=OUT
      operation ConditionCheckRead: possible-error=[DataServices_Data_DiagnServi_TABROW_NeuMeasu_Read_29_1_1_1_1_1_1/E_NOT_OK, DataServices_Data_DiagnServi_TABROW_NeuMeasu_Read_29_1_1_1_1_1_1/DCM_E_PENDING]
        arg OpStatus: type=Dcm_OpStatusType, direction=IN
        arg ErrorCode: type=Dcm_NegativeResponseCodeType, direction=OUT
      error E_NOT_OK: error-code=1
      error DCM_E_PENDING: error-code=10
    DataServices_Data_DiagnServi_TABROW_DID0xEFD_Read
      operation ReadData: possible-error=[DataServices_Data_DiagnServi_TABROW_DID0xEFD_Read/E_NOT_OK, DataServices_Data_DiagnServi_TABROW_DID0xEFD_Read/DCM_E_PENDING]
        arg OpStatus: type=Dcm_OpStatusType, direction=IN
        arg Data: type=Dcm_Data4ByteType, direction=OUT
      operation ConditionCheckRead: possible-error=[DataServices_Data_DiagnServi_TABROW_DID0xEFD_Read/E_NOT_OK, DataServices_Data_DiagnServi_TABROW_DID0xEFD_Read/DCM_E_PENDING]
        arg OpStatus: type=Dcm_OpStatusType, direction=IN
        arg ErrorCode: type=Dcm_NegativeResponseCodeType, direction=OUT
      error E_NOT_OK: error-code=1
      error DCM_E_PENDING: error-code=10
    DataServices_Data_DiagnServi_ReadDataByIdentASAMODXFileVersi
      operation ReadData: possible-error=[DataServices_Data_DiagnServi_ReadDataByIdentASAMODXFileVersi/E_NOT_OK, DataServices_Data_DiagnServi_ReadDataByIdentASAMODXFileVersi/DCM_E_PENDING]
        arg OpStatus: type=Dcm_OpStatusType, direction=IN
        arg Data: type=Dcm_Data6ByteType, direction=OUT
      operation ConditionCheckRead: possible-error=[DataServices_Data_DiagnServi_ReadDataByIdentASAMODXFileVersi/E_NOT_OK, DataServices_Data_DiagnServi_ReadDataByIdentASAMODXFileVersi/DCM_E_PENDING]
        arg OpStatus: type=Dcm_OpStatusType, direction=IN
        arg ErrorCode: type=Dcm_NegativeResponseCodeType, direction=OUT
      error E_NOT_OK: error-code=1
      error DCM_E_PENDING: error-code=10
    DataServices_Data_DiagnServi_TABROW_AdaptOfChineSeriaNumbe_Read
      operation ReadData: possible-error=[DataServices_Data_DiagnServi_TABROW_AdaptOfChineSeriaNumbe_Read/E_NOT_OK, DataServices_Data_DiagnServi_TABROW_AdaptOfChineSeriaNumbe_Read/DCM_E_PENDING]
        arg OpStatus: type=Dcm_OpStatusType, direction=IN
        arg Data: type=Dcm_Data26ByteType, direction=OUT
      operation ConditionCheckRead: possible-error=[DataServices_Data_DiagnServi_TABROW_AdaptOfChineSeriaNumbe_Read/E_NOT_OK, DataServices_Data_DiagnServi_TABROW_AdaptOfChineSeriaNumbe_Read/DCM_E_PENDING]
        arg OpStatus: type=Dcm_OpStatusType, direction=IN
        arg ErrorCode: type=Dcm_NegativeResponseCodeType, direction=OUT
      operation WriteData: possible-error=[DataServices_Data_DiagnServi_TABROW_AdaptOfChineSeriaNumbe_Read/E_NOT_OK, DataServices_Data_DiagnServi_TABROW_AdaptOfChineSeriaNumbe_Read/DCM_E_PENDING]
        arg Data: type=Dcm_Data26ByteType, direction=IN
        arg OpStatus: type=Dcm_OpStatusType, direction=IN
        arg ErrorCode: type=Dcm_NegativeResponseCodeType, direction=OUT
      error E_NOT_OK: error-code=1
      error DCM_E_PENDING: error-code=10
    DataServices_Data_BMC_Status_DCLS_Read_Data_By_Identifier
      operation ReadData: possible-error=[DataServices_Data_BMC_Status_DCLS_Read_Data_By_Identifier/E_NOT_OK, DataServices_Data_BMC_Status_DCLS_Read_Data_By_Identifier/DCM_E_PENDING]
        arg OpStatus: type=Dcm_OpStatusType, direction=IN
        arg Data: type=Dcm_Data1ByteType, direction=OUT
      operation ConditionCheckRead: possible-error=[DataServices_Data_BMC_Status_DCLS_Read_Data_By_Identifier/E_NOT_OK, DataServices_Data_BMC_Status_DCLS_Read_Data_By_Identifier/DCM_E_PENDING]
        arg OpStatus: type=Dcm_OpStatusType, direction=IN
        arg ErrorCode: type=Dcm_NegativeResponseCodeType, direction=OUT
      error E_NOT_OK: error-code=1
      error DCM_E_PENDING: error-code=10
    DataServices_Data_TABROW_VkmsKeyList_Read_Data_By_Identifier
      operation ReadData: possible-error=[DataServices_Data_TABROW_VkmsKeyList_Read_Data_By_Identifier/E_NOT_OK, DataServices_Data_TABROW_VkmsKeyList_Read_Data_By_Identifier/DCM_E_PENDING]
        arg OpStatus: type=Dcm_OpStatusType, direction=IN
        arg Data: type=Dcm_Data1022ByteType, direction=OUT
      operation ReadDataLength: possible-error=[DataServices_Data_TABROW_VkmsKeyList_Read_Data_By_Identifier/E_NOT_OK, DataServices_Data_TABROW_VkmsKeyList_Read_Data_By_Identifier/DCM_E_PENDING]
        arg OpStatus: type=Dcm_OpStatusType, direction=IN
        arg DataLength: type=uint16, direction=OUT
      operation ConditionCheckRead: possible-error=[DataServices_Data_TABROW_VkmsKeyList_Read_Data_By_Identifier/E_NOT_OK, DataServices_Data_TABROW_VkmsKeyList_Read_Data_By_Identifier/DCM_E_PENDING]
        arg OpStatus: type=Dcm_OpStatusType, direction=IN
        arg ErrorCode: type=Dcm_NegativeResponseCodeType, direction=OUT
      error E_NOT_OK: error-code=1
      error DCM_E_PENDING: error-code=10
    DataServices_Data_DiagnServi_TABROW_Milea_Read
      operation ReadData: possible-error=[DataServices_Data_DiagnServi_TABROW_Milea_Read/E_NOT_OK, DataServices_Data_DiagnServi_TABROW_Milea_Read/DCM_E_PENDING]
        arg OpStatus: type=Dcm_OpStatusType, direction=IN
        arg Data: type=Dcm_Data3ByteType, direction=OUT
      operation ConditionCheckRead: possible-error=[DataServices_Data_DiagnServi_TABROW_Milea_Read/E_NOT_OK, DataServices_Data_DiagnServi_TABROW_Milea_Read/DCM_E_PENDING]
        arg OpStatus: type=Dcm_OpStatusType, direction=IN
        arg ErrorCode: type=Dcm_NegativeResponseCodeType, direction=OUT
      error E_NOT_OK: error-code=1
      error DCM_E_PENDING: error-code=10
    DataServices_Data_DiagnServi_TABROW_VehicSpeedSenso_Read
      operation ReadData: possible-error=[DataServices_Data_DiagnServi_TABROW_VehicSpeedSenso_Read/E_NOT_OK, DataServices_Data_DiagnServi_TABROW_VehicSpeedSenso_Read/DCM_E_PENDING]
        arg OpStatus: type=Dcm_OpStatusType, direction=IN
        arg Data: type=Dcm_Data1ByteType, direction=OUT
      operation ConditionCheckRead: possible-error=[DataServices_Data_DiagnServi_TABROW_VehicSpeedSenso_Read/E_NOT_OK, DataServices_Data_DiagnServi_TABROW_VehicSpeedSenso_Read/DCM_E_PENDING]
        arg OpStatus: type=Dcm_OpStatusType, direction=IN
        arg ErrorCode: type=Dcm_NegativeResponseCodeType, direction=OUT
      error E_NOT_OK: error-code=1
      error DCM_E_PENDING: error-code=10
    DataServices_Data_DiagnServi_TABROW_NeuMeasu_Read_29_1_1_1_1_1_1_1
      operation ReadData: possible-error=[DataServices_Data_DiagnServi_TABROW_NeuMeasu_Read_29_1_1_1_1_1_1_1/E_NOT_OK, DataServices_Data_DiagnServi_TABROW_NeuMeasu_Read_29_1_1_1_1_1_1_1/DCM_E_PENDING]
        arg OpStatus: type=Dcm_OpStatusType, direction=IN
        arg Data: type=Dcm_Data4ByteType, direction=OUT
      operation ConditionCheckRead: possible-error=[DataServices_Data_DiagnServi_TABROW_NeuMeasu_Read_29_1_1_1_1_1_1_1/E_NOT_OK, DataServices_Data_DiagnServi_TABROW_NeuMeasu_Read_29_1_1_1_1_1_1_1/DCM_E_PENDING]
        arg OpStatus: type=Dcm_OpStatusType, direction=IN
        arg ErrorCode: type=Dcm_NegativeResponseCodeType, direction=OUT
      error E_NOT_OK: error-code=1
      error DCM_E_PENDING: error-code=10
    DataServices_Data_DiagnServi_BCUe_part_number_Read
      operation ReadData: possible-error=[DataServices_Data_DiagnServi_BCUe_part_number_Read/E_NOT_OK, DataServices_Data_DiagnServi_BCUe_part_number_Read/DCM_E_PENDING]
        arg OpStatus: type=Dcm_OpStatusType, direction=IN
        arg Data: type=Dcm_Data11ByteType, direction=OUT
      operation ConditionCheckRead: possible-error=[DataServices_Data_DiagnServi_BCUe_part_number_Read/E_NOT_OK, DataServices_Data_DiagnServi_BCUe_part_number_Read/DCM_E_PENDING]
        arg OpStatus: type=Dcm_OpStatusType, direction=IN
        arg ErrorCode: type=Dcm_NegativeResponseCodeType, direction=OUT
      operation WriteData: possible-error=[DataServices_Data_DiagnServi_BCUe_part_number_Read/E_NOT_OK, DataServices_Data_DiagnServi_BCUe_part_number_Read/DCM_E_PENDING]
        arg Data: type=Dcm_Data11ByteType, direction=IN
        arg OpStatus: type=Dcm_OpStatusType, direction=IN
        arg ErrorCode: type=Dcm_NegativeResponseCodeType, direction=OUT
      error E_NOT_OK: error-code=1
      error DCM_E_PENDING: error-code=10
    DataServices_Data_DiagnServi_TABROW_IntegValidDataConfiList_Read
      4 x operation, all with possible-error=[DataServices_Data_DiagnServi_TABROW_IntegValidDataConfiList_Read/E_NOT_OK, DataServices_Data_DiagnServi_TABROW_IntegValidDataConfiList_Read/DCM_E_PENDING]:
        ReadData
          arg OpStatus: type=Dcm_OpStatusType, direction=IN
          arg Data: type=Dcm_Data502ByteType, direction=OUT
        ReadDataLength
          arg OpStatus: type=Dcm_OpStatusType, direction=IN
          arg DataLength: type=uint16, direction=OUT
        ConditionCheckRead
          arg OpStatus: type=Dcm_OpStatusType, direction=IN
          arg ErrorCode: type=Dcm_NegativeResponseCodeType, direction=OUT
        WriteData
          4 x arg:
            Data: type=Dcm_Data502ByteType, direction=IN
            DataLength: type=uint16, direction=IN
            OpStatus: type=Dcm_OpStatusType, direction=IN
            ErrorCode: type=Dcm_NegativeResponseCodeType, direction=OUT
      error E_NOT_OK: error-code=1
      error DCM_E_PENDING: error-code=10
    DataServices_Data_TABROW_SOKFreshInfor_Read_Data_By_Identifier
      operation ReadData: possible-error=[DataServices_Data_TABROW_SOKFreshInfor_Read_Data_By_Identifier/E_NOT_OK, DataServices_Data_TABROW_SOKFreshInfor_Read_Data_By_Identifier/DCM_E_PENDING]
        arg OpStatus: type=Dcm_OpStatusType, direction=IN
        arg Data: type=Dcm_Data3572ByteType, direction=OUT
      operation ReadDataLength: possible-error=[DataServices_Data_TABROW_SOKFreshInfor_Read_Data_By_Identifier/E_NOT_OK, DataServices_Data_TABROW_SOKFreshInfor_Read_Data_By_Identifier/DCM_E_PENDING]
        arg OpStatus: type=Dcm_OpStatusType, direction=IN
        arg DataLength: type=uint16, direction=OUT
      operation ConditionCheckRead: possible-error=[DataServices_Data_TABROW_SOKFreshInfor_Read_Data_By_Identifier/E_NOT_OK, DataServices_Data_TABROW_SOKFreshInfor_Read_Data_By_Identifier/DCM_E_PENDING]
        arg OpStatus: type=Dcm_OpStatusType, direction=IN
        arg ErrorCode: type=Dcm_NegativeResponseCodeType, direction=OUT
      error E_NOT_OK: error-code=1
      error DCM_E_PENDING: error-code=10
    DataServices_Data_DiagnServi_TABROW_NeuMeasu_Read_58_1
      operation ReadData: possible-error=[DataServices_Data_DiagnServi_TABROW_NeuMeasu_Read_58_1/E_NOT_OK, DataServices_Data_DiagnServi_TABROW_NeuMeasu_Read_58_1/DCM_E_PENDING]
        arg OpStatus: type=Dcm_OpStatusType, direction=IN
        arg Data: type=Dcm_Data2ByteType, direction=OUT
      operation ConditionCheckRead: possible-error=[DataServices_Data_DiagnServi_TABROW_NeuMeasu_Read_58_1/E_NOT_OK, DataServices_Data_DiagnServi_TABROW_NeuMeasu_Read_58_1/DCM_E_PENDING]
        arg OpStatus: type=Dcm_OpStatusType, direction=IN
        arg ErrorCode: type=Dcm_NegativeResponseCodeType, direction=OUT
      error E_NOT_OK: error-code=1
      error DCM_E_PENDING: error-code=10
    DataServices_Data_DiagnServi_TABROW_NeuMeasu_Read_43_1_1_1_1_1_1_1_1_1
      operation ReadData: possible-error=[DataServices_Data_DiagnServi_TABROW_NeuMeasu_Read_43_1_1_1_1_1_1_1_1_1/E_NOT_OK, DataServices_Data_DiagnServi_TABROW_NeuMeasu_Read_43_1_1_1_1_1_1_1_1_1/DCM_E_PENDING]
        arg OpStatus: type=Dcm_OpStatusType, direction=IN
        arg Data: type=Dcm_Data64ByteType, direction=OUT
      operation ConditionCheckRead: possible-error=[DataServices_Data_DiagnServi_TABROW_NeuMeasu_Read_43_1_1_1_1_1_1_1_1_1/E_NOT_OK, DataServices_Data_DiagnServi_TABROW_NeuMeasu_Read_43_1_1_1_1_1_1_1_1_1/DCM_E_PENDING]
        arg OpStatus: type=Dcm_OpStatusType, direction=IN
        arg ErrorCode: type=Dcm_NegativeResponseCodeType, direction=OUT
      error E_NOT_OK: error-code=1
      error DCM_E_PENDING: error-code=10
    DataServices_Data_Battery_return_flow_temperature_Read_Data_By_Identifier
      operation ReadData: possible-error=[DataServices_Data_Battery_return_flow_temperature_Read_Data_By_Identifier/E_NOT_OK, DataServices_Data_Battery_return_flow_temperature_Read_Data_By_Identifier/DCM_E_PENDING]
        arg OpStatus: type=Dcm_OpStatusType, direction=IN
        arg Data: type=Dcm_Data5ByteType, direction=OUT
      operation ConditionCheckRead: possible-error=[DataServices_Data_Battery_return_flow_temperature_Read_Data_By_Identifier/E_NOT_OK, DataServices_Data_Battery_return_flow_temperature_Read_Data_By_Identifier/DCM_E_PENDING]
        arg OpStatus: type=Dcm_OpStatusType, direction=IN
        arg ErrorCode: type=Dcm_NegativeResponseCodeType, direction=OUT
      operation WriteData: possible-error=[DataServices_Data_Battery_return_flow_temperature_Read_Data_By_Identifier/E_NOT_OK, DataServices_Data_Battery_return_flow_temperature_Read_Data_By_Identifier/DCM_E_PENDING]
        arg Data: type=Dcm_Data5ByteType, direction=IN
        arg OpStatus: type=Dcm_OpStatusType, direction=IN
        arg ErrorCode: type=Dcm_NegativeResponseCodeType, direction=OUT
      error E_NOT_OK: error-code=1
      error DCM_E_PENDING: error-code=10
    DataServices_Data_DiagnServi_TABROW_NeuMeasu1_Read
      operation ReadData: possible-error=[DataServices_Data_DiagnServi_TABROW_NeuMeasu1_Read/E_NOT_OK, DataServices_Data_DiagnServi_TABROW_NeuMeasu1_Read/DCM_E_PENDING]
        arg OpStatus: type=Dcm_OpStatusType, direction=IN
        arg Data: type=Dcm_Data2ByteType, direction=OUT
      operation ConditionCheckRead: possible-error=[DataServices_Data_DiagnServi_TABROW_NeuMeasu1_Read/E_NOT_OK, DataServices_Data_DiagnServi_TABROW_NeuMeasu1_Read/DCM_E_PENDING]
        arg OpStatus: type=Dcm_OpStatusType, direction=IN
        arg ErrorCode: type=Dcm_NegativeResponseCodeType, direction=OUT
      error E_NOT_OK: error-code=1
      error DCM_E_PENDING: error-code=10
    DataServices_Data_DiagnServi_TABROW_NeuMeasu_Read_43_1
      operation ReadData: possible-error=[DataServices_Data_DiagnServi_TABROW_NeuMeasu_Read_43_1/E_NOT_OK, DataServices_Data_DiagnServi_TABROW_NeuMeasu_Read_43_1/DCM_E_PENDING]
        arg OpStatus: type=Dcm_OpStatusType, direction=IN
        arg Data: type=Dcm_Data64ByteType, direction=OUT
      operation ConditionCheckRead: possible-error=[DataServices_Data_DiagnServi_TABROW_NeuMeasu_Read_43_1/E_NOT_OK, DataServices_Data_DiagnServi_TABROW_NeuMeasu_Read_43_1/DCM_E_PENDING]
        arg OpStatus: type=Dcm_OpStatusType, direction=IN
        arg ErrorCode: type=Dcm_NegativeResponseCodeType, direction=OUT
      error E_NOT_OK: error-code=1
      error DCM_E_PENDING: error-code=10
    DataServices_Data_TABROW_VWECUHardwNumbe_Read
      operation ReadData: possible-error=[DataServices_Data_TABROW_VWECUHardwNumbe_Read/E_NOT_OK, DataServices_Data_TABROW_VWECUHardwNumbe_Read/DCM_E_PENDING]
        arg OpStatus: type=Dcm_OpStatusType, direction=IN
        arg Data: type=Dcm_Data11ByteType, direction=OUT
      operation ConditionCheckRead: possible-error=[DataServices_Data_TABROW_VWECUHardwNumbe_Read/E_NOT_OK, DataServices_Data_TABROW_VWECUHardwNumbe_Read/DCM_E_PENDING]
        arg OpStatus: type=Dcm_OpStatusType, direction=IN
        arg ErrorCode: type=Dcm_NegativeResponseCodeType, direction=OUT
      error E_NOT_OK: error-code=1
      error DCM_E_PENDING: error-code=10
    DataServices_Data_DiagnServi_TABROW_NeuMeasu_Read_9_2_1
      operation ReadData: possible-error=[DataServices_Data_DiagnServi_TABROW_NeuMeasu_Read_9_2_1/E_NOT_OK, DataServices_Data_DiagnServi_TABROW_NeuMeasu_Read_9_2_1/DCM_E_PENDING]
        arg OpStatus: type=Dcm_OpStatusType, direction=IN
        arg Data: type=Dcm_Data2ByteType, direction=OUT
      operation ConditionCheckRead: possible-error=[DataServices_Data_DiagnServi_TABROW_NeuMeasu_Read_9_2_1/E_NOT_OK, DataServices_Data_DiagnServi_TABROW_NeuMeasu_Read_9_2_1/DCM_E_PENDING]
        arg OpStatus: type=Dcm_OpStatusType, direction=IN
        arg ErrorCode: type=Dcm_NegativeResponseCodeType, direction=OUT
      error E_NOT_OK: error-code=1
      error DCM_E_PENDING: error-code=10
    DataServices_Data_Battery_banks_actual_mode_Read_Data_By_Identifier
      operation ReadData: possible-error=[DataServices_Data_Battery_banks_actual_mode_Read_Data_By_Identifier/E_NOT_OK, DataServices_Data_Battery_banks_actual_mode_Read_Data_By_Identifier/DCM_E_PENDING]
        arg OpStatus: type=Dcm_OpStatusType, direction=IN
        arg Data: type=Dcm_Data1ByteType, direction=OUT
      operation ConditionCheckRead: possible-error=[DataServices_Data_Battery_banks_actual_mode_Read_Data_By_Identifier/E_NOT_OK, DataServices_Data_Battery_banks_actual_mode_Read_Data_By_Identifier/DCM_E_PENDING]
        arg OpStatus: type=Dcm_OpStatusType, direction=IN
        arg ErrorCode: type=Dcm_NegativeResponseCodeType, direction=OUT
      error E_NOT_OK: error-code=1
      error DCM_E_PENDING: error-code=10
    DataServices_Data_DiagnServi_ReadDataByIdentASAMODXFileIdent
      operation ReadData: possible-error=[DataServices_Data_DiagnServi_ReadDataByIdentASAMODXFileIdent/E_NOT_OK, DataServices_Data_DiagnServi_ReadDataByIdentASAMODXFileIdent/DCM_E_PENDING]
        arg OpStatus: type=Dcm_OpStatusType, direction=IN
        arg Data: type=Dcm_Data25ByteType, direction=OUT
      operation ReadDataLength: possible-error=[DataServices_Data_DiagnServi_ReadDataByIdentASAMODXFileIdent/E_NOT_OK, DataServices_Data_DiagnServi_ReadDataByIdentASAMODXFileIdent/DCM_E_PENDING]
        arg OpStatus: type=Dcm_OpStatusType, direction=IN
        arg DataLength: type=uint16, direction=OUT
      operation ConditionCheckRead: possible-error=[DataServices_Data_DiagnServi_ReadDataByIdentASAMODXFileIdent/E_NOT_OK, DataServices_Data_DiagnServi_ReadDataByIdentASAMODXFileIdent/DCM_E_PENDING]
        arg OpStatus: type=Dcm_OpStatusType, direction=IN
        arg ErrorCode: type=Dcm_NegativeResponseCodeType, direction=OUT
      error E_NOT_OK: error-code=1
      error DCM_E_PENDING: error-code=10
    DataServices_Data_DiagnServi_TABROW_NeuMeasu_Read_21_1
      operation ReadData: possible-error=[DataServices_Data_DiagnServi_TABROW_NeuMeasu_Read_21_1/E_NOT_OK, DataServices_Data_DiagnServi_TABROW_NeuMeasu_Read_21_1/DCM_E_PENDING]
        arg OpStatus: type=Dcm_OpStatusType, direction=IN
        arg Data: type=Dcm_Data1ByteType, direction=OUT
      operation ConditionCheckRead: possible-error=[DataServices_Data_DiagnServi_TABROW_NeuMeasu_Read_21_1/E_NOT_OK, DataServices_Data_DiagnServi_TABROW_NeuMeasu_Read_21_1/DCM_E_PENDING]
        arg OpStatus: type=Dcm_OpStatusType, direction=IN
        arg ErrorCode: type=Dcm_NegativeResponseCodeType, direction=OUT
      error E_NOT_OK: error-code=1
      error DCM_E_PENDING: error-code=10
    DataServices_Data_DiagnServi_TABROW_NeuMeasu_Read_21_2
      operation ReadData: possible-error=[DataServices_Data_DiagnServi_TABROW_NeuMeasu_Read_21_2/E_NOT_OK, DataServices_Data_DiagnServi_TABROW_NeuMeasu_Read_21_2/DCM_E_PENDING]
        arg OpStatus: type=Dcm_OpStatusType, direction=IN
        arg Data: type=Dcm_Data110ByteType, direction=OUT
      operation ConditionCheckRead: possible-error=[DataServices_Data_DiagnServi_TABROW_NeuMeasu_Read_21_2/E_NOT_OK, DataServices_Data_DiagnServi_TABROW_NeuMeasu_Read_21_2/DCM_E_PENDING]
        arg OpStatus: type=Dcm_OpStatusType, direction=IN
        arg ErrorCode: type=Dcm_NegativeResponseCodeType, direction=OUT
      error E_NOT_OK: error-code=1
      error DCM_E_PENDING: error-code=10
    DataServices_Data_DiagnServi_TABROW_NeuMeasu_Read_33_1_1_1_1_1_1_1_1_1_1_1_1_1_1_1_1_1_1_1_1_1_1_1_2_1_1_1
      operation ReadData: possible-error=[DataServices_Data_DiagnServi_TABROW_NeuMeasu_Read_33_1_1_1_1_1_1_1_1_1_1_1_1_1_1_1_1_1_1_1_1_1_1_1_2_1_1_1/E_NOT_OK, DataServices_Data_DiagnServi_TABROW_NeuMeasu_Read_33_1_1_1_1_1_1_1_1_1_1_1_1_1_1_1_1_1_1_1_1_1_1_1_2_1_1_1/DCM_E_PENDING]
        arg OpStatus: type=Dcm_OpStatusType, direction=IN
        arg Data: type=Dcm_Data48ByteType, direction=OUT
      operation ConditionCheckRead: possible-error=[DataServices_Data_DiagnServi_TABROW_NeuMeasu_Read_33_1_1_1_1_1_1_1_1_1_1_1_1_1_1_1_1_1_1_1_1_1_1_1_2_1_1_1/E_NOT_OK, DataServices_Data_DiagnServi_TABROW_NeuMeasu_Read_33_1_1_1_1_1_1_1_1_1_1_1_1_1_1_1_1_1_1_1_1_1_1_1_2_1_1_1/DCM_E_PENDING]
        arg OpStatus: type=Dcm_OpStatusType, direction=IN
        arg ErrorCode: type=Dcm_NegativeResponseCodeType, direction=OUT
      error E_NOT_OK: error-code=1
      error DCM_E_PENDING: error-code=10
    DataServices_Data_TABROW_CellVoltaMinim_ReadDataByIdent
      operation ReadData: possible-error=[DataServices_Data_TABROW_CellVoltaMinim_ReadDataByIdent/E_NOT_OK, DataServices_Data_TABROW_CellVoltaMinim_ReadDataByIdent/DCM_E_PENDING]
        arg OpStatus: type=Dcm_OpStatusType, direction=IN
        arg Data: type=Dcm_Data7ByteType, direction=OUT
      operation ConditionCheckRead: possible-error=[DataServices_Data_TABROW_CellVoltaMinim_ReadDataByIdent/E_NOT_OK, DataServices_Data_TABROW_CellVoltaMinim_ReadDataByIdent/DCM_E_PENDING]
        arg OpStatus: type=Dcm_OpStatusType, direction=IN
        arg ErrorCode: type=Dcm_NegativeResponseCodeType, direction=OUT
      error E_NOT_OK: error-code=1
      error DCM_E_PENDING: error-code=10
    DataServices_Data_DiagnServi_ReadDataByIdentBasicSettiStatu
      operation ReadData: possible-error=[DataServices_Data_DiagnServi_ReadDataByIdentBasicSettiStatu/E_NOT_OK, DataServices_Data_DiagnServi_ReadDataByIdentBasicSettiStatu/DCM_E_PENDING]
        arg OpStatus: type=Dcm_OpStatusType, direction=IN
        arg Data: type=Dcm_Data1ByteType, direction=OUT
      operation ConditionCheckRead: possible-error=[DataServices_Data_DiagnServi_ReadDataByIdentBasicSettiStatu/E_NOT_OK, DataServices_Data_DiagnServi_ReadDataByIdentBasicSettiStatu/DCM_E_PENDING]
        arg OpStatus: type=Dcm_OpStatusType, direction=IN
        arg ErrorCode: type=Dcm_NegativeResponseCodeType, direction=OUT
      error E_NOT_OK: error-code=1
      error DCM_E_PENDING: error-code=10
    DataServices_Data_DiagnServi_TABROW_NeuMeasu_Read_43_1_1_1_1
      operation ReadData: possible-error=[DataServices_Data_DiagnServi_TABROW_NeuMeasu_Read_43_1_1_1_1/E_NOT_OK, DataServices_Data_DiagnServi_TABROW_NeuMeasu_Read_43_1_1_1_1/DCM_E_PENDING]
        arg OpStatus: type=Dcm_OpStatusType, direction=IN
        arg Data: type=Dcm_Data64ByteType, direction=OUT
      operation ConditionCheckRead: possible-error=[DataServices_Data_DiagnServi_TABROW_NeuMeasu_Read_43_1_1_1_1/E_NOT_OK, DataServices_Data_DiagnServi_TABROW_NeuMeasu_Read_43_1_1_1_1/DCM_E_PENDING]
        arg OpStatus: type=Dcm_OpStatusType, direction=IN
        arg ErrorCode: type=Dcm_NegativeResponseCodeType, direction=OUT
      error E_NOT_OK: error-code=1
      error DCM_E_PENDING: error-code=10
    DataServices_Data_TABROW_FingeAndProgrDateOfLogicSoftwBlock_Read
      operation ReadData: possible-error=[DataServices_Data_TABROW_FingeAndProgrDateOfLogicSoftwBlock_Read/E_NOT_OK, DataServices_Data_TABROW_FingeAndProgrDateOfLogicSoftwBlock_Read/DCM_E_PENDING]
        arg OpStatus: type=Dcm_OpStatusType, direction=IN
        arg Data: type=Dcm_Data8192ByteType, direction=OUT
      operation ReadDataLength: possible-error=[DataServices_Data_TABROW_FingeAndProgrDateOfLogicSoftwBlock_Read/E_NOT_OK, DataServices_Data_TABROW_FingeAndProgrDateOfLogicSoftwBlock_Read/DCM_E_PENDING]
        arg OpStatus: type=Dcm_OpStatusType, direction=IN
        arg DataLength: type=uint16, direction=OUT
      operation ConditionCheckRead: possible-error=[DataServices_Data_TABROW_FingeAndProgrDateOfLogicSoftwBlock_Read/E_NOT_OK, DataServices_Data_TABROW_FingeAndProgrDateOfLogicSoftwBlock_Read/DCM_E_PENDING]
        arg OpStatus: type=Dcm_OpStatusType, direction=IN
        arg ErrorCode: type=Dcm_NegativeResponseCodeType, direction=OUT
      error E_NOT_OK: error-code=1
      error DCM_E_PENDING: error-code=10
    DataServices_Data_DiagnServi_TABROW_NeuMeasu_Read_30_2
      operation ReadData: possible-error=[DataServices_Data_DiagnServi_TABROW_NeuMeasu_Read_30_2/E_NOT_OK, DataServices_Data_DiagnServi_TABROW_NeuMeasu_Read_30_2/DCM_E_PENDING]
        arg OpStatus: type=Dcm_OpStatusType, direction=IN
        arg Data: type=Dcm_Data2ByteType, direction=OUT
      operation ConditionCheckRead: possible-error=[DataServices_Data_DiagnServi_TABROW_NeuMeasu_Read_30_2/E_NOT_OK, DataServices_Data_DiagnServi_TABROW_NeuMeasu_Read_30_2/DCM_E_PENDING]
        arg OpStatus: type=Dcm_OpStatusType, direction=IN
        arg ErrorCode: type=Dcm_NegativeResponseCodeType, direction=OUT
      error E_NOT_OK: error-code=1
      error DCM_E_PENDING: error-code=10
    DataServices_Data_DiagnServi_TABROW_NeuMeasu_Read_30_3
      operation ReadData: possible-error=[DataServices_Data_DiagnServi_TABROW_NeuMeasu_Read_30_3/E_NOT_OK, DataServices_Data_DiagnServi_TABROW_NeuMeasu_Read_30_3/DCM_E_PENDING]
        arg OpStatus: type=Dcm_OpStatusType, direction=IN
        arg Data: type=Dcm_Data2ByteType, direction=OUT
      operation ConditionCheckRead: possible-error=[DataServices_Data_DiagnServi_TABROW_NeuMeasu_Read_30_3/E_NOT_OK, DataServices_Data_DiagnServi_TABROW_NeuMeasu_Read_30_3/DCM_E_PENDING]
        arg OpStatus: type=Dcm_OpStatusType, direction=IN
        arg ErrorCode: type=Dcm_NegativeResponseCodeType, direction=OUT
      error E_NOT_OK: error-code=1
      error DCM_E_PENDING: error-code=10
    DataServices_Data_DiagnServi_TABROW_ActivDiagnSessi_Read
      operation ReadData: possible-error=[DataServices_Data_DiagnServi_TABROW_ActivDiagnSessi_Read/E_NOT_OK, DataServices_Data_DiagnServi_TABROW_ActivDiagnSessi_Read/DCM_E_PENDING]
        arg OpStatus: type=Dcm_OpStatusType, direction=IN
        arg Data: type=Dcm_Data1ByteType, direction=OUT
      operation ConditionCheckRead: possible-error=[DataServices_Data_DiagnServi_TABROW_ActivDiagnSessi_Read/E_NOT_OK, DataServices_Data_DiagnServi_TABROW_ActivDiagnSessi_Read/DCM_E_PENDING]
        arg OpStatus: type=Dcm_OpStatusType, direction=IN
        arg ErrorCode: type=Dcm_NegativeResponseCodeType, direction=OUT
      error E_NOT_OK: error-code=1
      error DCM_E_PENDING: error-code=10
    DataServices_Data_TABROW_VWSysteNameOrEnginType_Read
      operation ReadData: possible-error=[DataServices_Data_TABROW_VWSysteNameOrEnginType_Read/E_NOT_OK, DataServices_Data_TABROW_VWSysteNameOrEnginType_Read/DCM_E_PENDING]
        arg OpStatus: type=Dcm_OpStatusType, direction=IN
        arg Data: type=Dcm_Data13ByteType, direction=OUT
      operation ConditionCheckRead: possible-error=[DataServices_Data_TABROW_VWSysteNameOrEnginType_Read/E_NOT_OK, DataServices_Data_TABROW_VWSysteNameOrEnginType_Read/DCM_E_PENDING]
        arg OpStatus: type=Dcm_OpStatusType, direction=IN
        arg ErrorCode: type=Dcm_NegativeResponseCodeType, direction=OUT
      error E_NOT_OK: error-code=1
      error DCM_E_PENDING: error-code=10
    DataServices_Data_DiagnServi_TABROW_NeuMeasu_Read_27_1_1_1_1_1
      operation ReadData: possible-error=[DataServices_Data_DiagnServi_TABROW_NeuMeasu_Read_27_1_1_1_1_1/E_NOT_OK, DataServices_Data_DiagnServi_TABROW_NeuMeasu_Read_27_1_1_1_1_1/DCM_E_PENDING]
        arg OpStatus: type=Dcm_OpStatusType, direction=IN
        arg Data: type=Dcm_Data1ByteType, direction=OUT
      operation ConditionCheckRead: possible-error=[DataServices_Data_DiagnServi_TABROW_NeuMeasu_Read_27_1_1_1_1_1/E_NOT_OK, DataServices_Data_DiagnServi_TABROW_NeuMeasu_Read_27_1_1_1_1_1/DCM_E_PENDING]
        arg OpStatus: type=Dcm_OpStatusType, direction=IN
        arg ErrorCode: type=Dcm_NegativeResponseCodeType, direction=OUT
      error E_NOT_OK: error-code=1
      error DCM_E_PENDING: error-code=10
    DataServices_Data_DiagnServi_TABROW_NeuMeasu_Read_43_1_1_1
      operation ReadData: possible-error=[DataServices_Data_DiagnServi_TABROW_NeuMeasu_Read_43_1_1_1/E_NOT_OK, DataServices_Data_DiagnServi_TABROW_NeuMeasu_Read_43_1_1_1/DCM_E_PENDING]
        arg OpStatus: type=Dcm_OpStatusType, direction=IN
        arg Data: type=Dcm_Data64ByteType, direction=OUT
      operation ConditionCheckRead: possible-error=[DataServices_Data_DiagnServi_TABROW_NeuMeasu_Read_43_1_1_1/E_NOT_OK, DataServices_Data_DiagnServi_TABROW_NeuMeasu_Read_43_1_1_1/DCM_E_PENDING]
        arg OpStatus: type=Dcm_OpStatusType, direction=IN
        arg ErrorCode: type=Dcm_NegativeResponseCodeType, direction=OUT
      error E_NOT_OK: error-code=1
      error DCM_E_PENDING: error-code=10
    DataServices_Data_HV_battery_maximum_discharge_power_Read_Data_By_Identifier
      operation ReadData: possible-error=[DataServices_Data_HV_battery_maximum_discharge_power_Read_Data_By_Identifier/E_NOT_OK, DataServices_Data_HV_battery_maximum_discharge_power_Read_Data_By_Identifier/DCM_E_PENDING]
        arg OpStatus: type=Dcm_OpStatusType, direction=IN
        arg Data: type=Dcm_Data2ByteType, direction=OUT
      operation ConditionCheckRead: possible-error=[DataServices_Data_HV_battery_maximum_discharge_power_Read_Data_By_Identifier/E_NOT_OK, DataServices_Data_HV_battery_maximum_discharge_power_Read_Data_By_Identifier/DCM_E_PENDING]
        arg OpStatus: type=Dcm_OpStatusType, direction=IN
        arg ErrorCode: type=Dcm_NegativeResponseCodeType, direction=OUT
      error E_NOT_OK: error-code=1
      error DCM_E_PENDING: error-code=10
    DataServices_Data_DiagnServi_TABROW_NeuMeasu_Read_30_1
      operation ReadData: possible-error=[DataServices_Data_DiagnServi_TABROW_NeuMeasu_Read_30_1/E_NOT_OK, DataServices_Data_DiagnServi_TABROW_NeuMeasu_Read_30_1/DCM_E_PENDING]
        arg OpStatus: type=Dcm_OpStatusType, direction=IN
        arg Data: type=Dcm_Data2ByteType, direction=OUT
      operation ConditionCheckRead: possible-error=[DataServices_Data_DiagnServi_TABROW_NeuMeasu_Read_30_1/E_NOT_OK, DataServices_Data_DiagnServi_TABROW_NeuMeasu_Read_30_1/DCM_E_PENDING]
        arg OpStatus: type=Dcm_OpStatusType, direction=IN
        arg ErrorCode: type=Dcm_NegativeResponseCodeType, direction=OUT
      error E_NOT_OK: error-code=1
      error DCM_E_PENDING: error-code=10
    DataServices_Data_TABROW_StateOfBatteMIL_ReadDataByIdent
      operation ReadData: possible-error=[DataServices_Data_TABROW_StateOfBatteMIL_ReadDataByIdent/E_NOT_OK, DataServices_Data_TABROW_StateOfBatteMIL_ReadDataByIdent/DCM_E_PENDING]
        arg OpStatus: type=Dcm_OpStatusType, direction=IN
        arg Data: type=Dcm_Data1ByteType, direction=OUT
      operation ConditionCheckRead: possible-error=[DataServices_Data_TABROW_StateOfBatteMIL_ReadDataByIdent/E_NOT_OK, DataServices_Data_TABROW_StateOfBatteMIL_ReadDataByIdent/DCM_E_PENDING]
        arg OpStatus: type=Dcm_OpStatusType, direction=IN
        arg ErrorCode: type=Dcm_NegativeResponseCodeType, direction=OUT
      error E_NOT_OK: error-code=1
      error DCM_E_PENDING: error-code=10
    DataServices_Data_TABROW_BatteTempeMinim_ReadDataByIdent
      operation ReadData: possible-error=[DataServices_Data_TABROW_BatteTempeMinim_ReadDataByIdent/E_NOT_OK, DataServices_Data_TABROW_BatteTempeMinim_ReadDataByIdent/DCM_E_PENDING]
        arg OpStatus: type=Dcm_OpStatusType, direction=IN
        arg Data: type=Dcm_Data4ByteType, direction=OUT
      operation ConditionCheckRead: possible-error=[DataServices_Data_TABROW_BatteTempeMinim_ReadDataByIdent/E_NOT_OK, DataServices_Data_TABROW_BatteTempeMinim_ReadDataByIdent/DCM_E_PENDING]
        arg OpStatus: type=Dcm_OpStatusType, direction=IN
        arg ErrorCode: type=Dcm_NegativeResponseCodeType, direction=OUT
      error E_NOT_OK: error-code=1
      error DCM_E_PENDING: error-code=10
    DataServices_Data_TABROW_StateOfBattePowerReduc_ReadDataByIdent
      operation ReadData: possible-error=[DataServices_Data_TABROW_StateOfBattePowerReduc_ReadDataByIdent/E_NOT_OK, DataServices_Data_TABROW_StateOfBattePowerReduc_ReadDataByIdent/DCM_E_PENDING]
        arg OpStatus: type=Dcm_OpStatusType, direction=IN
        arg Data: type=Dcm_Data1ByteType, direction=OUT
      operation ConditionCheckRead: possible-error=[DataServices_Data_TABROW_StateOfBattePowerReduc_ReadDataByIdent/E_NOT_OK, DataServices_Data_TABROW_StateOfBattePowerReduc_ReadDataByIdent/DCM_E_PENDING]
        arg OpStatus: type=Dcm_OpStatusType, direction=IN
        arg ErrorCode: type=Dcm_NegativeResponseCodeType, direction=OUT
      error E_NOT_OK: error-code=1
      error DCM_E_PENDING: error-code=10
    DataServices_Data_DiagnServi_TABROW_NeuMeasu_Read_27_3_1
      operation ReadData: possible-error=[DataServices_Data_DiagnServi_TABROW_NeuMeasu_Read_27_3_1/E_NOT_OK, DataServices_Data_DiagnServi_TABROW_NeuMeasu_Read_27_3_1/DCM_E_PENDING]
        arg OpStatus: type=Dcm_OpStatusType, direction=IN
        arg Data: type=Dcm_Data27ByteType, direction=OUT
      operation ConditionCheckRead: possible-error=[DataServices_Data_DiagnServi_TABROW_NeuMeasu_Read_27_3_1/E_NOT_OK, DataServices_Data_DiagnServi_TABROW_NeuMeasu_Read_27_3_1/DCM_E_PENDING]
        arg OpStatus: type=Dcm_OpStatusType, direction=IN
        arg ErrorCode: type=Dcm_NegativeResponseCodeType, direction=OUT
      error E_NOT_OK: error-code=1
      error DCM_E_PENDING: error-code=10
    DataServices_Data_DiagnServi_HV_battery_modules_actual_voltage_Read
      operation ReadData: possible-error=[DataServices_Data_DiagnServi_HV_battery_modules_actual_voltage_Read/E_NOT_OK, DataServices_Data_DiagnServi_HV_battery_modules_actual_voltage_Read/DCM_E_PENDING]
        arg OpStatus: type=Dcm_OpStatusType, direction=IN
        arg Data: type=Dcm_Data24ByteType, direction=OUT
      operation ConditionCheckRead: possible-error=[DataServices_Data_DiagnServi_HV_battery_modules_actual_voltage_Read/E_NOT_OK, DataServices_Data_DiagnServi_HV_battery_modules_actual_voltage_Read/DCM_E_PENDING]
        arg OpStatus: type=Dcm_OpStatusType, direction=IN
        arg ErrorCode: type=Dcm_NegativeResponseCodeType, direction=OUT
      error E_NOT_OK: error-code=1
      error DCM_E_PENDING: error-code=10
    DataServices_Data_TABROW_IsolaResisSystePlus_ReadDataByIdent
      operation ReadData: possible-error=[DataServices_Data_TABROW_IsolaResisSystePlus_ReadDataByIdent/E_NOT_OK, DataServices_Data_TABROW_IsolaResisSystePlus_ReadDataByIdent/DCM_E_PENDING]
        arg OpStatus: type=Dcm_OpStatusType, direction=IN
        arg Data: type=Dcm_Data2ByteType, direction=OUT
      operation ConditionCheckRead: possible-error=[DataServices_Data_TABROW_IsolaResisSystePlus_ReadDataByIdent/E_NOT_OK, DataServices_Data_TABROW_IsolaResisSystePlus_ReadDataByIdent/DCM_E_PENDING]
        arg OpStatus: type=Dcm_OpStatusType, direction=IN
        arg ErrorCode: type=Dcm_NegativeResponseCodeType, direction=OUT
      error E_NOT_OK: error-code=1
      error DCM_E_PENDING: error-code=10
    DataServices_Data_DiagnServi_TABROW_VWDataSetNumbeOrECUDataContaNumbe_Read
      operation ReadData: possible-error=[DataServices_Data_DiagnServi_TABROW_VWDataSetNumbeOrECUDataContaNumbe_Read/E_NOT_OK, DataServices_Data_DiagnServi_TABROW_VWDataSetNumbeOrECUDataContaNumbe_Read/DCM_E_PENDING]
        arg OpStatus: type=Dcm_OpStatusType, direction=IN
        arg Data: type=Dcm_Data11ByteType, direction=OUT
      operation ConditionCheckRead: possible-error=[DataServices_Data_DiagnServi_TABROW_VWDataSetNumbeOrECUDataContaNumbe_Read/E_NOT_OK, DataServices_Data_DiagnServi_TABROW_VWDataSetNumbeOrECUDataContaNumbe_Read/DCM_E_PENDING]
        arg OpStatus: type=Dcm_OpStatusType, direction=IN
        arg ErrorCode: type=Dcm_NegativeResponseCodeType, direction=OUT
      operation WriteData: possible-error=[DataServices_Data_DiagnServi_TABROW_VWDataSetNumbeOrECUDataContaNumbe_Read/E_NOT_OK, DataServices_Data_DiagnServi_TABROW_VWDataSetNumbeOrECUDataContaNumbe_Read/DCM_E_PENDING]
        arg Data: type=Dcm_Data11ByteType, direction=IN
        arg OpStatus: type=Dcm_OpStatusType, direction=IN
        arg ErrorCode: type=Dcm_NegativeResponseCodeType, direction=OUT
      error E_NOT_OK: error-code=1
      error DCM_E_PENDING: error-code=10
    DataServices_Data_DiagnServi_TABROW_NeuMeasu_Read_29_1_1_1
      operation ReadData: possible-error=[DataServices_Data_DiagnServi_TABROW_NeuMeasu_Read_29_1_1_1/E_NOT_OK, DataServices_Data_DiagnServi_TABROW_NeuMeasu_Read_29_1_1_1/DCM_E_PENDING]
        arg OpStatus: type=Dcm_OpStatusType, direction=IN
        arg Data: type=Dcm_Data4ByteType, direction=OUT
      operation ConditionCheckRead: possible-error=[DataServices_Data_DiagnServi_TABROW_NeuMeasu_Read_29_1_1_1/E_NOT_OK, DataServices_Data_DiagnServi_TABROW_NeuMeasu_Read_29_1_1_1/DCM_E_PENDING]
        arg OpStatus: type=Dcm_OpStatusType, direction=IN
        arg ErrorCode: type=Dcm_NegativeResponseCodeType, direction=OUT
      error E_NOT_OK: error-code=1
      error DCM_E_PENDING: error-code=10
    DataServices_Data_DiagnServi_TABROW_NeuMeasu_Read_7_1
      operation ReadData: possible-error=[DataServices_Data_DiagnServi_TABROW_NeuMeasu_Read_7_1/E_NOT_OK, DataServices_Data_DiagnServi_TABROW_NeuMeasu_Read_7_1/DCM_E_PENDING]
        arg OpStatus: type=Dcm_OpStatusType, direction=IN
        arg Data: type=Dcm_Data1ByteType, direction=OUT
      operation ConditionCheckRead: possible-error=[DataServices_Data_DiagnServi_TABROW_NeuMeasu_Read_7_1/E_NOT_OK, DataServices_Data_DiagnServi_TABROW_NeuMeasu_Read_7_1/DCM_E_PENDING]
        arg OpStatus: type=Dcm_OpStatusType, direction=IN
        arg ErrorCode: type=Dcm_NegativeResponseCodeType, direction=OUT
      error E_NOT_OK: error-code=1
      error DCM_E_PENDING: error-code=10
    DataServices_Data_DiagnServi_TABROW_NeuMeasu_Read_7_2
      operation ReadData: possible-error=[DataServices_Data_DiagnServi_TABROW_NeuMeasu_Read_7_2/E_NOT_OK, DataServices_Data_DiagnServi_TABROW_NeuMeasu_Read_7_2/DCM_E_PENDING]
        arg OpStatus: type=Dcm_OpStatusType, direction=IN
        arg Data: type=Dcm_Data1ByteType, direction=OUT
      operation ConditionCheckRead: possible-error=[DataServices_Data_DiagnServi_TABROW_NeuMeasu_Read_7_2/E_NOT_OK, DataServices_Data_DiagnServi_TABROW_NeuMeasu_Read_7_2/DCM_E_PENDING]
        arg OpStatus: type=Dcm_OpStatusType, direction=IN
        arg ErrorCode: type=Dcm_NegativeResponseCodeType, direction=OUT
      error E_NOT_OK: error-code=1
      error DCM_E_PENDING: error-code=10
    DataServices_Data_TABROW_BMCHVKFehleSD_Read_Data_By_Identifier
      operation ReadData: possible-error=[DataServices_Data_TABROW_BMCHVKFehleSD_Read_Data_By_Identifier/E_NOT_OK, DataServices_Data_TABROW_BMCHVKFehleSD_Read_Data_By_Identifier/DCM_E_PENDING]
        arg OpStatus: type=Dcm_OpStatusType, direction=IN
        arg Data: type=Dcm_Data1ByteType, direction=OUT
      operation ConditionCheckRead: possible-error=[DataServices_Data_TABROW_BMCHVKFehleSD_Read_Data_By_Identifier/E_NOT_OK, DataServices_Data_TABROW_BMCHVKFehleSD_Read_Data_By_Identifier/DCM_E_PENDING]
        arg OpStatus: type=Dcm_OpStatusType, direction=IN
        arg ErrorCode: type=Dcm_NegativeResponseCodeType, direction=OUT
      error E_NOT_OK: error-code=1
      error DCM_E_PENDING: error-code=10
    DataServices_Data_TABROW_CellVoltaMaxim_ReadDataByIdent
      operation ReadData: possible-error=[DataServices_Data_TABROW_CellVoltaMaxim_ReadDataByIdent/E_NOT_OK, DataServices_Data_TABROW_CellVoltaMaxim_ReadDataByIdent/DCM_E_PENDING]
        arg OpStatus: type=Dcm_OpStatusType, direction=IN
        arg Data: type=Dcm_Data7ByteType, direction=OUT
      operation ConditionCheckRead: possible-error=[DataServices_Data_TABROW_CellVoltaMaxim_ReadDataByIdent/E_NOT_OK, DataServices_Data_TABROW_CellVoltaMaxim_ReadDataByIdent/DCM_E_PENDING]
        arg OpStatus: type=Dcm_OpStatusType, direction=IN
        arg ErrorCode: type=Dcm_NegativeResponseCodeType, direction=OUT
      error E_NOT_OK: error-code=1
      error DCM_E_PENDING: error-code=10
    DataServices_Data_DiagnServi_TABROW_CalibIdent_Read
      operation ReadData: possible-error=[DataServices_Data_DiagnServi_TABROW_CalibIdent_Read/E_NOT_OK, DataServices_Data_DiagnServi_TABROW_CalibIdent_Read/DCM_E_PENDING]
        arg OpStatus: type=Dcm_OpStatusType, direction=IN
        arg Data: type=Dcm_Data8192ByteType, direction=OUT
      operation ReadDataLength: possible-error=[DataServices_Data_DiagnServi_TABROW_CalibIdent_Read/E_NOT_OK, DataServices_Data_DiagnServi_TABROW_CalibIdent_Read/DCM_E_PENDING]
        arg OpStatus: type=Dcm_OpStatusType, direction=IN
        arg DataLength: type=uint16, direction=OUT
      operation ConditionCheckRead: possible-error=[DataServices_Data_DiagnServi_TABROW_CalibIdent_Read/E_NOT_OK, DataServices_Data_DiagnServi_TABROW_CalibIdent_Read/DCM_E_PENDING]
        arg OpStatus: type=Dcm_OpStatusType, direction=IN
        arg ErrorCode: type=Dcm_NegativeResponseCodeType, direction=OUT
      error E_NOT_OK: error-code=1
      error DCM_E_PENDING: error-code=10
    DataServices_Data_DiagnServi_TABROW_DID0xEFD_Read_1_2
      operation ReadData: possible-error=[DataServices_Data_DiagnServi_TABROW_DID0xEFD_Read_1_2/E_NOT_OK, DataServices_Data_DiagnServi_TABROW_DID0xEFD_Read_1_2/DCM_E_PENDING]
        arg OpStatus: type=Dcm_OpStatusType, direction=IN
        arg Data: type=Dcm_Data4ByteType, direction=OUT
      operation ConditionCheckRead: possible-error=[DataServices_Data_DiagnServi_TABROW_DID0xEFD_Read_1_2/E_NOT_OK, DataServices_Data_DiagnServi_TABROW_DID0xEFD_Read_1_2/DCM_E_PENDING]
        arg OpStatus: type=Dcm_OpStatusType, direction=IN
        arg ErrorCode: type=Dcm_NegativeResponseCodeType, direction=OUT
      error E_NOT_OK: error-code=1
      error DCM_E_PENDING: error-code=10
    DataServices_Data_DiagnServi_TABROW_DID0xEFD_Read_1_1
      operation ReadData: possible-error=[DataServices_Data_DiagnServi_TABROW_DID0xEFD_Read_1_1/E_NOT_OK, DataServices_Data_DiagnServi_TABROW_DID0xEFD_Read_1_1/DCM_E_PENDING]
        arg OpStatus: type=Dcm_OpStatusType, direction=IN
        arg Data: type=Dcm_Data4ByteType, direction=OUT
      operation ConditionCheckRead: possible-error=[DataServices_Data_DiagnServi_TABROW_DID0xEFD_Read_1_1/E_NOT_OK, DataServices_Data_DiagnServi_TABROW_DID0xEFD_Read_1_1/DCM_E_PENDING]
        arg OpStatus: type=Dcm_OpStatusType, direction=IN
        arg ErrorCode: type=Dcm_NegativeResponseCodeType, direction=OUT
      error E_NOT_OK: error-code=1
      error DCM_E_PENDING: error-code=10
    DataServices_Data_DiagnServi_TABROW_VWDataSetName_Read
      operation ReadData: possible-error=[DataServices_Data_DiagnServi_TABROW_VWDataSetName_Read/E_NOT_OK, DataServices_Data_DiagnServi_TABROW_VWDataSetName_Read/DCM_E_PENDING]
        arg OpStatus: type=Dcm_OpStatusType, direction=IN
        arg Data: type=Dcm_Data8192ByteType, direction=OUT
      operation ReadDataLength: possible-error=[DataServices_Data_DiagnServi_TABROW_VWDataSetName_Read/E_NOT_OK, DataServices_Data_DiagnServi_TABROW_VWDataSetName_Read/DCM_E_PENDING]
        arg OpStatus: type=Dcm_OpStatusType, direction=IN
        arg DataLength: type=uint16, direction=OUT
      operation ConditionCheckRead: possible-error=[DataServices_Data_DiagnServi_TABROW_VWDataSetName_Read/E_NOT_OK, DataServices_Data_DiagnServi_TABROW_VWDataSetName_Read/DCM_E_PENDING]
        arg OpStatus: type=Dcm_OpStatusType, direction=IN
        arg ErrorCode: type=Dcm_NegativeResponseCodeType, direction=OUT
      error E_NOT_OK: error-code=1
      error DCM_E_PENDING: error-code=10
    DataServices_Data_DC_charging_station_actual_voltage_Read_Data_By_Identifier
      operation ReadData: possible-error=[DataServices_Data_DC_charging_station_actual_voltage_Read_Data_By_Identifier/E_NOT_OK, DataServices_Data_DC_charging_station_actual_voltage_Read_Data_By_Identifier/DCM_E_PENDING]
        arg OpStatus: type=Dcm_OpStatusType, direction=IN
        arg Data: type=Dcm_Data2ByteType, direction=OUT
      operation ConditionCheckRead: possible-error=[DataServices_Data_DC_charging_station_actual_voltage_Read_Data_By_Identifier/E_NOT_OK, DataServices_Data_DC_charging_station_actual_voltage_Read_Data_By_Identifier/DCM_E_PENDING]
        arg OpStatus: type=Dcm_OpStatusType, direction=IN
        arg ErrorCode: type=Dcm_NegativeResponseCodeType, direction=OUT
      error E_NOT_OK: error-code=1
      error DCM_E_PENDING: error-code=10
    DataServices_Data_TABROW_CellStateOfChargMinim_ReadDataByIdent
      operation ReadData: possible-error=[DataServices_Data_TABROW_CellStateOfChargMinim_ReadDataByIdent/E_NOT_OK, DataServices_Data_TABROW_CellStateOfChargMinim_ReadDataByIdent/DCM_E_PENDING]
        arg OpStatus: type=Dcm_OpStatusType, direction=IN
        arg Data: type=Dcm_Data4ByteType, direction=OUT
      operation ConditionCheckRead: possible-error=[DataServices_Data_TABROW_CellStateOfChargMinim_ReadDataByIdent/E_NOT_OK, DataServices_Data_TABROW_CellStateOfChargMinim_ReadDataByIdent/DCM_E_PENDING]
        arg OpStatus: type=Dcm_OpStatusType, direction=IN
        arg ErrorCode: type=Dcm_NegativeResponseCodeType, direction=OUT
      error E_NOT_OK: error-code=1
      error DCM_E_PENDING: error-code=10
    DataServices_Data_TABROW_TABROSyste_Read_1_1_1_1_1_1_1_1_1_1_1
      operation ReadData: possible-error=[DataServices_Data_TABROW_TABROSyste_Read_1_1_1_1_1_1_1_1_1_1_1/E_NOT_OK, DataServices_Data_TABROW_TABROSyste_Read_1_1_1_1_1_1_1_1_1_1_1/DCM_E_PENDING]
        arg OpStatus: type=Dcm_OpStatusType, direction=IN
        arg Data: type=Dcm_Data14ByteType, direction=OUT
      operation ConditionCheckRead: possible-error=[DataServices_Data_TABROW_TABROSyste_Read_1_1_1_1_1_1_1_1_1_1_1/E_NOT_OK, DataServices_Data_TABROW_TABROSyste_Read_1_1_1_1_1_1_1_1_1_1_1/DCM_E_PENDING]
        arg OpStatus: type=Dcm_OpStatusType, direction=IN
        arg ErrorCode: type=Dcm_NegativeResponseCodeType, direction=OUT
      error E_NOT_OK: error-code=1
      error DCM_E_PENDING: error-code=10
    DataServices_Data_DiagnServi_TABROW_NeuMeasu_Read
      operation ReadData: possible-error=[DataServices_Data_DiagnServi_TABROW_NeuMeasu_Read/E_NOT_OK, DataServices_Data_DiagnServi_TABROW_NeuMeasu_Read/DCM_E_PENDING]
        arg OpStatus: type=Dcm_OpStatusType, direction=IN
        arg Data: type=Dcm_Data3ByteType, direction=OUT
      operation ConditionCheckRead: possible-error=[DataServices_Data_DiagnServi_TABROW_NeuMeasu_Read/E_NOT_OK, DataServices_Data_DiagnServi_TABROW_NeuMeasu_Read/DCM_E_PENDING]
        arg OpStatus: type=Dcm_OpStatusType, direction=IN
        arg ErrorCode: type=Dcm_NegativeResponseCodeType, direction=OUT
      error E_NOT_OK: error-code=1
      error DCM_E_PENDING: error-code=10
    DataServices_Data_TABROW_TABROSyste_Read_1
      operation ReadData: possible-error=[DataServices_Data_TABROW_TABROSyste_Read_1/E_NOT_OK, DataServices_Data_TABROW_TABROSyste_Read_1/DCM_E_PENDING]
        arg OpStatus: type=Dcm_OpStatusType, direction=IN
        arg Data: type=Dcm_Data11ByteType, direction=OUT
      operation ConditionCheckRead: possible-error=[DataServices_Data_TABROW_TABROSyste_Read_1/E_NOT_OK, DataServices_Data_TABROW_TABROSyste_Read_1/DCM_E_PENDING]
        arg OpStatus: type=Dcm_OpStatusType, direction=IN
        arg ErrorCode: type=Dcm_NegativeResponseCodeType, direction=OUT
      operation WriteData: possible-error=[DataServices_Data_TABROW_TABROSyste_Read_1/E_NOT_OK, DataServices_Data_TABROW_TABROSyste_Read_1/DCM_E_PENDING]
        arg Data: type=Dcm_Data11ByteType, direction=IN
        arg OpStatus: type=Dcm_OpStatusType, direction=IN
        arg ErrorCode: type=Dcm_NegativeResponseCodeType, direction=OUT
      error E_NOT_OK: error-code=1
      error DCM_E_PENDING: error-code=10
    DataServices_Data_Maximum_Charge_Voltage_Read_Data_By_Identifier
      operation ReadData: possible-error=[DataServices_Data_Maximum_Charge_Voltage_Read_Data_By_Identifier/E_NOT_OK, DataServices_Data_Maximum_Charge_Voltage_Read_Data_By_Identifier/DCM_E_PENDING]
        arg OpStatus: type=Dcm_OpStatusType, direction=IN
        arg Data: type=Dcm_Data2ByteType, direction=OUT
      operation ConditionCheckRead: possible-error=[DataServices_Data_Maximum_Charge_Voltage_Read_Data_By_Identifier/E_NOT_OK, DataServices_Data_Maximum_Charge_Voltage_Read_Data_By_Identifier/DCM_E_PENDING]
        arg OpStatus: type=Dcm_OpStatusType, direction=IN
        arg ErrorCode: type=Dcm_NegativeResponseCodeType, direction=OUT
      error E_NOT_OK: error-code=1
      error DCM_E_PENDING: error-code=10
    DataServices_Data_DiagnServi_TABROW_ECUSeriaNumbe_Read
      operation ReadData: possible-error=[DataServices_Data_DiagnServi_TABROW_ECUSeriaNumbe_Read/E_NOT_OK, DataServices_Data_DiagnServi_TABROW_ECUSeriaNumbe_Read/DCM_E_PENDING]
        arg OpStatus: type=Dcm_OpStatusType, direction=IN
        arg Data: type=Dcm_Data20ByteType, direction=OUT
      operation ConditionCheckRead: possible-error=[DataServices_Data_DiagnServi_TABROW_ECUSeriaNumbe_Read/E_NOT_OK, DataServices_Data_DiagnServi_TABROW_ECUSeriaNumbe_Read/DCM_E_PENDING]
        arg OpStatus: type=Dcm_OpStatusType, direction=IN
        arg ErrorCode: type=Dcm_NegativeResponseCodeType, direction=OUT
      error E_NOT_OK: error-code=1
      error DCM_E_PENDING: error-code=10
    DataServices_Data_TABROW_SOKVerifFaileList_Read_Data_By_Identifier
      operation ReadData: possible-error=[DataServices_Data_TABROW_SOKVerifFaileList_Read_Data_By_Identifier/E_NOT_OK, DataServices_Data_TABROW_SOKVerifFaileList_Read_Data_By_Identifier/DCM_E_PENDING]
        arg OpStatus: type=Dcm_OpStatusType, direction=IN
        arg Data: type=Dcm_Data512ByteType, direction=OUT
      operation ReadDataLength: possible-error=[DataServices_Data_TABROW_SOKVerifFaileList_Read_Data_By_Identifier/E_NOT_OK, DataServices_Data_TABROW_SOKVerifFaileList_Read_Data_By_Identifier/DCM_E_PENDING]
        arg OpStatus: type=Dcm_OpStatusType, direction=IN
        arg DataLength: type=uint16, direction=OUT
      operation ConditionCheckRead: possible-error=[DataServices_Data_TABROW_SOKVerifFaileList_Read_Data_By_Identifier/E_NOT_OK, DataServices_Data_TABROW_SOKVerifFaileList_Read_Data_By_Identifier/DCM_E_PENDING]
        arg OpStatus: type=Dcm_OpStatusType, direction=IN
        arg ErrorCode: type=Dcm_NegativeResponseCodeType, direction=OUT
      error E_NOT_OK: error-code=1
      error DCM_E_PENDING: error-code=10
    DataServices_Data_DiagnServi_TABROW_VWCodinValue_Read
      operation ReadData: possible-error=[DataServices_Data_DiagnServi_TABROW_VWCodinValue_Read/E_NOT_OK, DataServices_Data_DiagnServi_TABROW_VWCodinValue_Read/DCM_E_PENDING]
        arg OpStatus: type=Dcm_OpStatusType, direction=IN
        arg Data: type=Dcm_Data1ByteType, direction=OUT
      operation ConditionCheckRead: possible-error=[DataServices_Data_DiagnServi_TABROW_VWCodinValue_Read/E_NOT_OK, DataServices_Data_DiagnServi_TABROW_VWCodinValue_Read/DCM_E_PENDING]
        arg OpStatus: type=Dcm_OpStatusType, direction=IN
        arg ErrorCode: type=Dcm_NegativeResponseCodeType, direction=OUT
      operation WriteData: possible-error=[DataServices_Data_DiagnServi_TABROW_VWCodinValue_Read/E_NOT_OK, DataServices_Data_DiagnServi_TABROW_VWCodinValue_Read/DCM_E_PENDING]
        arg Data: type=Dcm_Data1ByteType, direction=IN
        arg OpStatus: type=Dcm_OpStatusType, direction=IN
        arg ErrorCode: type=Dcm_NegativeResponseCodeType, direction=OUT
      error E_NOT_OK: error-code=1
      error DCM_E_PENDING: error-code=10
    DataServices_Data_TABROW_TABROSyste_Read_4
      operation ReadData: possible-error=[DataServices_Data_TABROW_TABROSyste_Read_4/E_NOT_OK, DataServices_Data_TABROW_TABROSyste_Read_4/DCM_E_PENDING]
        arg OpStatus: type=Dcm_OpStatusType, direction=IN
        arg Data: type=Dcm_Data11ByteType, direction=OUT
      operation ConditionCheckRead: possible-error=[DataServices_Data_TABROW_TABROSyste_Read_4/E_NOT_OK, DataServices_Data_TABROW_TABROSyste_Read_4/DCM_E_PENDING]
        arg OpStatus: type=Dcm_OpStatusType, direction=IN
        arg ErrorCode: type=Dcm_NegativeResponseCodeType, direction=OUT
      error E_NOT_OK: error-code=1
      error DCM_E_PENDING: error-code=10
    DataServices_Data_TABROW_TABROSyste_Read_2
      operation ReadData: possible-error=[DataServices_Data_TABROW_TABROSyste_Read_2/E_NOT_OK, DataServices_Data_TABROW_TABROSyste_Read_2/DCM_E_PENDING]
        arg OpStatus: type=Dcm_OpStatusType, direction=IN
        arg Data: type=Dcm_Data11ByteType, direction=OUT
      operation ConditionCheckRead: possible-error=[DataServices_Data_TABROW_TABROSyste_Read_2/E_NOT_OK, DataServices_Data_TABROW_TABROSyste_Read_2/DCM_E_PENDING]
        arg OpStatus: type=Dcm_OpStatusType, direction=IN
        arg ErrorCode: type=Dcm_NegativeResponseCodeType, direction=OUT
      error E_NOT_OK: error-code=1
      error DCM_E_PENDING: error-code=10
    DataServices_Data_TABROW_TABROSyste_Read_3
      operation ReadData: possible-error=[DataServices_Data_TABROW_TABROSyste_Read_3/E_NOT_OK, DataServices_Data_TABROW_TABROSyste_Read_3/DCM_E_PENDING]
        arg OpStatus: type=Dcm_OpStatusType, direction=IN
        arg Data: type=Dcm_Data11ByteType, direction=OUT
      operation ConditionCheckRead: possible-error=[DataServices_Data_TABROW_TABROSyste_Read_3/E_NOT_OK, DataServices_Data_TABROW_TABROSyste_Read_3/DCM_E_PENDING]
        arg OpStatus: type=Dcm_OpStatusType, direction=IN
        arg ErrorCode: type=Dcm_NegativeResponseCodeType, direction=OUT
      error E_NOT_OK: error-code=1
      error DCM_E_PENDING: error-code=10
    DataServices_Data_DiagnServi_TABROW_NeuMeasu_Read_63_1
      operation ReadData: possible-error=[DataServices_Data_DiagnServi_TABROW_NeuMeasu_Read_63_1/E_NOT_OK, DataServices_Data_DiagnServi_TABROW_NeuMeasu_Read_63_1/DCM_E_PENDING]
        arg OpStatus: type=Dcm_OpStatusType, direction=IN
        arg Data: type=Dcm_Data32ByteType, direction=OUT
      operation ConditionCheckRead: possible-error=[DataServices_Data_DiagnServi_TABROW_NeuMeasu_Read_63_1/E_NOT_OK, DataServices_Data_DiagnServi_TABROW_NeuMeasu_Read_63_1/DCM_E_PENDING]
        arg OpStatus: type=Dcm_OpStatusType, direction=IN
        arg ErrorCode: type=Dcm_NegativeResponseCodeType, direction=OUT
      error E_NOT_OK: error-code=1
      error DCM_E_PENDING: error-code=10
    DataServices_Data_Charisma_requestet_driving_program_hv_battery_Read_Data_By_Identifier
      operation ReadData: possible-error=[DataServices_Data_Charisma_requestet_driving_program_hv_battery_Read_Data_By_Identifier/E_NOT_OK, DataServices_Data_Charisma_requestet_driving_program_hv_battery_Read_Data_By_Identifier/DCM_E_PENDING]
        arg OpStatus: type=Dcm_OpStatusType, direction=IN
        arg Data: type=Dcm_Data1ByteType, direction=OUT
      operation ConditionCheckRead: possible-error=[DataServices_Data_Charisma_requestet_driving_program_hv_battery_Read_Data_By_Identifier/E_NOT_OK, DataServices_Data_Charisma_requestet_driving_program_hv_battery_Read_Data_By_Identifier/DCM_E_PENDING]
        arg OpStatus: type=Dcm_OpStatusType, direction=IN
        arg ErrorCode: type=Dcm_NegativeResponseCodeType, direction=OUT
      error E_NOT_OK: error-code=1
      error DCM_E_PENDING: error-code=10
    DataServices_Data_DiagnServi_TABROW_NeuMeasu_Read_27_1_1
      operation ReadData: possible-error=[DataServices_Data_DiagnServi_TABROW_NeuMeasu_Read_27_1_1/E_NOT_OK, DataServices_Data_DiagnServi_TABROW_NeuMeasu_Read_27_1_1/DCM_E_PENDING]
        arg OpStatus: type=Dcm_OpStatusType, direction=IN
        arg Data: type=Dcm_Data27ByteType, direction=OUT
      operation ConditionCheckRead: possible-error=[DataServices_Data_DiagnServi_TABROW_NeuMeasu_Read_27_1_1/E_NOT_OK, DataServices_Data_DiagnServi_TABROW_NeuMeasu_Read_27_1_1/DCM_E_PENDING]
        arg OpStatus: type=Dcm_OpStatusType, direction=IN
        arg ErrorCode: type=Dcm_NegativeResponseCodeType, direction=OUT
      error E_NOT_OK: error-code=1
      error DCM_E_PENDING: error-code=10
    DataServices_Data_DiagnServi_TABROW_NeuMeasu_Read_27_1_2
      operation ReadData: possible-error=[DataServices_Data_DiagnServi_TABROW_NeuMeasu_Read_27_1_2/E_NOT_OK, DataServices_Data_DiagnServi_TABROW_NeuMeasu_Read_27_1_2/DCM_E_PENDING]
        arg OpStatus: type=Dcm_OpStatusType, direction=IN
        arg Data: type=Dcm_Data1ByteType, direction=OUT
      operation ConditionCheckRead: possible-error=[DataServices_Data_DiagnServi_TABROW_NeuMeasu_Read_27_1_2/E_NOT_OK, DataServices_Data_DiagnServi_TABROW_NeuMeasu_Read_27_1_2/DCM_E_PENDING]
        arg OpStatus: type=Dcm_OpStatusType, direction=IN
        arg ErrorCode: type=Dcm_NegativeResponseCodeType, direction=OUT
      error E_NOT_OK: error-code=1
      error DCM_E_PENDING: error-code=10
    DataServices_Data_DiagnServi_TABROW_NeuMeasu_Read_43_1_1
      operation ReadData: possible-error=[DataServices_Data_DiagnServi_TABROW_NeuMeasu_Read_43_1_1/E_NOT_OK, DataServices_Data_DiagnServi_TABROW_NeuMeasu_Read_43_1_1/DCM_E_PENDING]
        arg OpStatus: type=Dcm_OpStatusType, direction=IN
        arg Data: type=Dcm_Data64ByteType, direction=OUT
      operation ConditionCheckRead: possible-error=[DataServices_Data_DiagnServi_TABROW_NeuMeasu_Read_43_1_1/E_NOT_OK, DataServices_Data_DiagnServi_TABROW_NeuMeasu_Read_43_1_1/DCM_E_PENDING]
        arg OpStatus: type=Dcm_OpStatusType, direction=IN
        arg ErrorCode: type=Dcm_NegativeResponseCodeType, direction=OUT
      error E_NOT_OK: error-code=1
      error DCM_E_PENDING: error-code=10
    DataServices_Data_DiagnServi_Type_number_assembly_Read
      operation ReadData: possible-error=[DataServices_Data_DiagnServi_Type_number_assembly_Read/E_NOT_OK, DataServices_Data_DiagnServi_Type_number_assembly_Read/DCM_E_PENDING]
        arg OpStatus: type=Dcm_OpStatusType, direction=IN
        arg Data: type=Dcm_Data11ByteType, direction=OUT
      operation ConditionCheckRead: possible-error=[DataServices_Data_DiagnServi_Type_number_assembly_Read/E_NOT_OK, DataServices_Data_DiagnServi_Type_number_assembly_Read/DCM_E_PENDING]
        arg OpStatus: type=Dcm_OpStatusType, direction=IN
        arg ErrorCode: type=Dcm_NegativeResponseCodeType, direction=OUT
      operation WriteData: possible-error=[DataServices_Data_DiagnServi_Type_number_assembly_Read/E_NOT_OK, DataServices_Data_DiagnServi_Type_number_assembly_Read/DCM_E_PENDING]
        arg Data: type=Dcm_Data11ByteType, direction=IN
        arg OpStatus: type=Dcm_OpStatusType, direction=IN
        arg ErrorCode: type=Dcm_NegativeResponseCodeType, direction=OUT
      error E_NOT_OK: error-code=1
      error DCM_E_PENDING: error-code=10
    DataServices_Data_TABROW_OBDType_Read
      operation ReadData: possible-error=[DataServices_Data_TABROW_OBDType_Read/E_NOT_OK, DataServices_Data_TABROW_OBDType_Read/DCM_E_PENDING]
        arg OpStatus: type=Dcm_OpStatusType, direction=IN
        arg Data: type=Dcm_Data1ByteType, direction=OUT
      operation ConditionCheckRead: possible-error=[DataServices_Data_TABROW_OBDType_Read/E_NOT_OK, DataServices_Data_TABROW_OBDType_Read/DCM_E_PENDING]
        arg OpStatus: type=Dcm_OpStatusType, direction=IN
        arg ErrorCode: type=Dcm_NegativeResponseCodeType, direction=OUT
      error E_NOT_OK: error-code=1
      error DCM_E_PENDING: error-code=10
    DataServices_Data_TABROW_SOKMissiKeyList_Read_Data_By_Identifier
      operation ReadData: possible-error=[DataServices_Data_TABROW_SOKMissiKeyList_Read_Data_By_Identifier/E_NOT_OK, DataServices_Data_TABROW_SOKMissiKeyList_Read_Data_By_Identifier/DCM_E_PENDING]
        arg OpStatus: type=Dcm_OpStatusType, direction=IN
        arg Data: type=Dcm_Data512ByteType, direction=OUT
      operation ReadDataLength: possible-error=[DataServices_Data_TABROW_SOKMissiKeyList_Read_Data_By_Identifier/E_NOT_OK, DataServices_Data_TABROW_SOKMissiKeyList_Read_Data_By_Identifier/DCM_E_PENDING]
        arg OpStatus: type=Dcm_OpStatusType, direction=IN
        arg DataLength: type=uint16, direction=OUT
      operation ConditionCheckRead: possible-error=[DataServices_Data_TABROW_SOKMissiKeyList_Read_Data_By_Identifier/E_NOT_OK, DataServices_Data_TABROW_SOKMissiKeyList_Read_Data_By_Identifier/DCM_E_PENDING]
        arg OpStatus: type=Dcm_OpStatusType, direction=IN
        arg ErrorCode: type=Dcm_NegativeResponseCodeType, direction=OUT
      error E_NOT_OK: error-code=1
      error DCM_E_PENDING: error-code=10
    DataServices_Data_DiagnServi_TABROW_TABROFDSPr_Read
      operation ReadData: possible-error=[DataServices_Data_DiagnServi_TABROW_TABROFDSPr_Read/E_NOT_OK, DataServices_Data_DiagnServi_TABROW_TABROFDSPr_Read/DCM_E_PENDING]
        arg OpStatus: type=Dcm_OpStatusType, direction=IN
        arg Data: type=Dcm_Data517ByteType, direction=OUT
      operation ReadDataLength: possible-error=[DataServices_Data_DiagnServi_TABROW_TABROFDSPr_Read/E_NOT_OK, DataServices_Data_DiagnServi_TABROW_TABROFDSPr_Read/DCM_E_PENDING]
        arg OpStatus: type=Dcm_OpStatusType, direction=IN
        arg DataLength: type=uint16, direction=OUT
      operation ConditionCheckRead: possible-error=[DataServices_Data_DiagnServi_TABROW_TABROFDSPr_Read/E_NOT_OK, DataServices_Data_DiagnServi_TABROW_TABROFDSPr_Read/DCM_E_PENDING]
        arg OpStatus: type=Dcm_OpStatusType, direction=IN
        arg ErrorCode: type=Dcm_NegativeResponseCodeType, direction=OUT
      error E_NOT_OK: error-code=1
      error DCM_E_PENDING: error-code=10
    DataServices_Data_Battery_amount_of_modules_Read_Data_By_Identifier
      operation ReadData: possible-error=[DataServices_Data_Battery_amount_of_modules_Read_Data_By_Identifier/E_NOT_OK, DataServices_Data_Battery_amount_of_modules_Read_Data_By_Identifier/DCM_E_PENDING]
        arg OpStatus: type=Dcm_OpStatusType, direction=IN
        arg Data: type=Dcm_Data1ByteType, direction=OUT
      operation ConditionCheckRead: possible-error=[DataServices_Data_Battery_amount_of_modules_Read_Data_By_Identifier/E_NOT_OK, DataServices_Data_Battery_amount_of_modules_Read_Data_By_Identifier/DCM_E_PENDING]
        arg OpStatus: type=Dcm_OpStatusType, direction=IN
        arg ErrorCode: type=Dcm_NegativeResponseCodeType, direction=OUT
      error E_NOT_OK: error-code=1
      error DCM_E_PENDING: error-code=10
    DataServices_Data_DiagnServi_TABROW_EnginRPM_Read
      operation ReadData: possible-error=[DataServices_Data_DiagnServi_TABROW_EnginRPM_Read/E_NOT_OK, DataServices_Data_DiagnServi_TABROW_EnginRPM_Read/DCM_E_PENDING]
        arg OpStatus: type=Dcm_OpStatusType, direction=IN
        arg Data: type=Dcm_Data2ByteType, direction=OUT
      operation ConditionCheckRead: possible-error=[DataServices_Data_DiagnServi_TABROW_EnginRPM_Read/E_NOT_OK, DataServices_Data_DiagnServi_TABROW_EnginRPM_Read/DCM_E_PENDING]
        arg OpStatus: type=Dcm_OpStatusType, direction=IN
        arg ErrorCode: type=Dcm_NegativeResponseCodeType, direction=OUT
      error E_NOT_OK: error-code=1
      error DCM_E_PENDING: error-code=10
    DataServices_Data_DiagnServi_TABROW_Produ_Read
      operation ReadData: possible-error=[DataServices_Data_DiagnServi_TABROW_Produ_Read/E_NOT_OK, DataServices_Data_DiagnServi_TABROW_Produ_Read/DCM_E_PENDING]
        arg OpStatus: type=Dcm_OpStatusType, direction=IN
        arg Data: type=Dcm_Data3ByteType, direction=OUT
      operation ConditionCheckRead: possible-error=[DataServices_Data_DiagnServi_TABROW_Produ_Read/E_NOT_OK, DataServices_Data_DiagnServi_TABROW_Produ_Read/DCM_E_PENDING]
        arg OpStatus: type=Dcm_OpStatusType, direction=IN
        arg ErrorCode: type=Dcm_NegativeResponseCodeType, direction=OUT
      operation WriteData: possible-error=[DataServices_Data_DiagnServi_TABROW_Produ_Read/E_NOT_OK, DataServices_Data_DiagnServi_TABROW_Produ_Read/DCM_E_PENDING]
        arg Data: type=Dcm_Data3ByteType, direction=IN
        arg OpStatus: type=Dcm_OpStatusType, direction=IN
        arg ErrorCode: type=Dcm_NegativeResponseCodeType, direction=OUT
      error E_NOT_OK: error-code=1
      error DCM_E_PENDING: error-code=10
    DataServices_Data_Battery_contactors_actual_states_Read_Data_By_Identifier
      operation ReadData: possible-error=[DataServices_Data_Battery_contactors_actual_states_Read_Data_By_Identifier/E_NOT_OK, DataServices_Data_Battery_contactors_actual_states_Read_Data_By_Identifier/DCM_E_PENDING]
        arg OpStatus: type=Dcm_OpStatusType, direction=IN
        arg Data: type=Dcm_Data2ByteType, direction=OUT
      operation ConditionCheckRead: possible-error=[DataServices_Data_Battery_contactors_actual_states_Read_Data_By_Identifier/E_NOT_OK, DataServices_Data_Battery_contactors_actual_states_Read_Data_By_Identifier/DCM_E_PENDING]
        arg OpStatus: type=Dcm_OpStatusType, direction=IN
        arg ErrorCode: type=Dcm_NegativeResponseCodeType, direction=OUT
      error E_NOT_OK: error-code=1
      error DCM_E_PENDING: error-code=10
    DataServices_Data_DiagnServi_TABROW_NeuMeasu_Read_27_1_1_1
      operation ReadData: possible-error=[DataServices_Data_DiagnServi_TABROW_NeuMeasu_Read_27_1_1_1/E_NOT_OK, DataServices_Data_DiagnServi_TABROW_NeuMeasu_Read_27_1_1_1/DCM_E_PENDING]
        arg OpStatus: type=Dcm_OpStatusType, direction=IN
        arg Data: type=Dcm_Data27ByteType, direction=OUT
      operation ConditionCheckRead: possible-error=[DataServices_Data_DiagnServi_TABROW_NeuMeasu_Read_27_1_1_1/E_NOT_OK, DataServices_Data_DiagnServi_TABROW_NeuMeasu_Read_27_1_1_1/DCM_E_PENDING]
        arg OpStatus: type=Dcm_OpStatusType, direction=IN
        arg ErrorCode: type=Dcm_NegativeResponseCodeType, direction=OUT
      error E_NOT_OK: error-code=1
      error DCM_E_PENDING: error-code=10
    DataServices_Data_DiagnServi_TABROW_NeuMeasu_Read_27_1_1_2
      operation ReadData: possible-error=[DataServices_Data_DiagnServi_TABROW_NeuMeasu_Read_27_1_1_2/E_NOT_OK, DataServices_Data_DiagnServi_TABROW_NeuMeasu_Read_27_1_1_2/DCM_E_PENDING]
        arg OpStatus: type=Dcm_OpStatusType, direction=IN
        arg Data: type=Dcm_Data1ByteType, direction=OUT
      operation ConditionCheckRead: possible-error=[DataServices_Data_DiagnServi_TABROW_NeuMeasu_Read_27_1_1_2/E_NOT_OK, DataServices_Data_DiagnServi_TABROW_NeuMeasu_Read_27_1_1_2/DCM_E_PENDING]
        arg OpStatus: type=Dcm_OpStatusType, direction=IN
        arg ErrorCode: type=Dcm_NegativeResponseCodeType, direction=OUT
      error E_NOT_OK: error-code=1
      error DCM_E_PENDING: error-code=10
    DataServices_Data_TABROW_OBDClassDescr_Read_Data_By_Identifier
      operation ReadData: possible-error=[DataServices_Data_TABROW_OBDClassDescr_Read_Data_By_Identifier/E_NOT_OK, DataServices_Data_TABROW_OBDClassDescr_Read_Data_By_Identifier/DCM_E_PENDING]
        arg OpStatus: type=Dcm_OpStatusType, direction=IN
        arg Data: type=Dcm_Data2ByteType, direction=OUT
      operation ConditionCheckRead: possible-error=[DataServices_Data_TABROW_OBDClassDescr_Read_Data_By_Identifier/E_NOT_OK, DataServices_Data_TABROW_OBDClassDescr_Read_Data_By_Identifier/DCM_E_PENDING]
        arg OpStatus: type=Dcm_OpStatusType, direction=IN
        arg ErrorCode: type=Dcm_NegativeResponseCodeType, direction=OUT
      error E_NOT_OK: error-code=1
      error DCM_E_PENDING: error-code=10
    DataServices_Data_DiagnServi_TABROW_TimeSinceEnginStart_Read
      operation ReadData: possible-error=[DataServices_Data_DiagnServi_TABROW_TimeSinceEnginStart_Read/E_NOT_OK, DataServices_Data_DiagnServi_TABROW_TimeSinceEnginStart_Read/DCM_E_PENDING]
        arg OpStatus: type=Dcm_OpStatusType, direction=IN
        arg Data: type=Dcm_Data2ByteType, direction=OUT
      operation ConditionCheckRead: possible-error=[DataServices_Data_DiagnServi_TABROW_TimeSinceEnginStart_Read/E_NOT_OK, DataServices_Data_DiagnServi_TABROW_TimeSinceEnginStart_Read/DCM_E_PENDING]
        arg OpStatus: type=Dcm_OpStatusType, direction=IN
        arg ErrorCode: type=Dcm_NegativeResponseCodeType, direction=OUT
      error E_NOT_OK: error-code=1
      error DCM_E_PENDING: error-code=10
    DataServices_Data_TABROW_TABROSyste_Read_1_1_1_1
      operation ReadData: possible-error=[DataServices_Data_TABROW_TABROSyste_Read_1_1_1_1/E_NOT_OK, DataServices_Data_TABROW_TABROSyste_Read_1_1_1_1/DCM_E_PENDING]
        arg OpStatus: type=Dcm_OpStatusType, direction=IN
        arg Data: type=Dcm_Data14ByteType, direction=OUT
      operation ConditionCheckRead: possible-error=[DataServices_Data_TABROW_TABROSyste_Read_1_1_1_1/E_NOT_OK, DataServices_Data_TABROW_TABROSyste_Read_1_1_1_1/DCM_E_PENDING]
        arg OpStatus: type=Dcm_OpStatusType, direction=IN
        arg ErrorCode: type=Dcm_NegativeResponseCodeType, direction=OUT
      error E_NOT_OK: error-code=1
      error DCM_E_PENDING: error-code=10
    DataServices_Data_DiagnServi_TABROW_NeuMeasu_Read_32
      operation ReadData: possible-error=[DataServices_Data_DiagnServi_TABROW_NeuMeasu_Read_32/E_NOT_OK, DataServices_Data_DiagnServi_TABROW_NeuMeasu_Read_32/DCM_E_PENDING]
        arg OpStatus: type=Dcm_OpStatusType, direction=IN
        arg Data: type=Dcm_Data1ByteType, direction=OUT
      operation ConditionCheckRead: possible-error=[DataServices_Data_DiagnServi_TABROW_NeuMeasu_Read_32/E_NOT_OK, DataServices_Data_DiagnServi_TABROW_NeuMeasu_Read_32/DCM_E_PENDING]
        arg OpStatus: type=Dcm_OpStatusType, direction=IN
        arg ErrorCode: type=Dcm_NegativeResponseCodeType, direction=OUT
      error E_NOT_OK: error-code=1
      error DCM_E_PENDING: error-code=10
    DataServices_Data_DiagnServi_TABROW_NeuMeasu_Read_31
      operation ReadData: possible-error=[DataServices_Data_DiagnServi_TABROW_NeuMeasu_Read_31/E_NOT_OK, DataServices_Data_DiagnServi_TABROW_NeuMeasu_Read_31/DCM_E_PENDING]
        arg OpStatus: type=Dcm_OpStatusType, direction=IN
        arg Data: type=Dcm_Data1ByteType, direction=OUT
      operation ConditionCheckRead: possible-error=[DataServices_Data_DiagnServi_TABROW_NeuMeasu_Read_31/E_NOT_OK, DataServices_Data_DiagnServi_TABROW_NeuMeasu_Read_31/DCM_E_PENDING]
        arg OpStatus: type=Dcm_OpStatusType, direction=IN
        arg ErrorCode: type=Dcm_NegativeResponseCodeType, direction=OUT
      error E_NOT_OK: error-code=1
      error DCM_E_PENDING: error-code=10
    DataServices_Data_DiagnServi_TABROW_NeuMeasu_Read_30
      operation ReadData: possible-error=[DataServices_Data_DiagnServi_TABROW_NeuMeasu_Read_30/E_NOT_OK, DataServices_Data_DiagnServi_TABROW_NeuMeasu_Read_30/DCM_E_PENDING]
        arg OpStatus: type=Dcm_OpStatusType, direction=IN
        arg Data: type=Dcm_Data2ByteType, direction=OUT
      operation ConditionCheckRead: possible-error=[DataServices_Data_DiagnServi_TABROW_NeuMeasu_Read_30/E_NOT_OK, DataServices_Data_DiagnServi_TABROW_NeuMeasu_Read_30/DCM_E_PENDING]
        arg OpStatus: type=Dcm_OpStatusType, direction=IN
        arg ErrorCode: type=Dcm_NegativeResponseCodeType, direction=OUT
      error E_NOT_OK: error-code=1
      error DCM_E_PENDING: error-code=10
    DataServices_Data_DiagnServi_TABROW_NeuMeasu_Read_28_2
      operation ReadData: possible-error=[DataServices_Data_DiagnServi_TABROW_NeuMeasu_Read_28_2/E_NOT_OK, DataServices_Data_DiagnServi_TABROW_NeuMeasu_Read_28_2/DCM_E_PENDING]
        arg OpStatus: type=Dcm_OpStatusType, direction=IN
        arg Data: type=Dcm_Data2ByteType, direction=OUT
      operation ConditionCheckRead: possible-error=[DataServices_Data_DiagnServi_TABROW_NeuMeasu_Read_28_2/E_NOT_OK, DataServices_Data_DiagnServi_TABROW_NeuMeasu_Read_28_2/DCM_E_PENDING]
        arg OpStatus: type=Dcm_OpStatusType, direction=IN
        arg ErrorCode: type=Dcm_NegativeResponseCodeType, direction=OUT
      error E_NOT_OK: error-code=1
      error DCM_E_PENDING: error-code=10
    DataServices_Data_DiagnServi_TABROW_NeuMeasu_Read_28_1
      operation ReadData: possible-error=[DataServices_Data_DiagnServi_TABROW_NeuMeasu_Read_28_1/E_NOT_OK, DataServices_Data_DiagnServi_TABROW_NeuMeasu_Read_28_1/DCM_E_PENDING]
        arg OpStatus: type=Dcm_OpStatusType, direction=IN
        arg Data: type=Dcm_Data1ByteType, direction=OUT
      operation ConditionCheckRead: possible-error=[DataServices_Data_DiagnServi_TABROW_NeuMeasu_Read_28_1/E_NOT_OK, DataServices_Data_DiagnServi_TABROW_NeuMeasu_Read_28_1/DCM_E_PENDING]
        arg OpStatus: type=Dcm_OpStatusType, direction=IN
        arg ErrorCode: type=Dcm_NegativeResponseCodeType, direction=OUT
      error E_NOT_OK: error-code=1
      error DCM_E_PENDING: error-code=10
    DataServices_Data_DiagnServi_TABROW_NeuMeasu_Read_28_4
      operation ReadData: possible-error=[DataServices_Data_DiagnServi_TABROW_NeuMeasu_Read_28_4/E_NOT_OK, DataServices_Data_DiagnServi_TABROW_NeuMeasu_Read_28_4/DCM_E_PENDING]
        arg OpStatus: type=Dcm_OpStatusType, direction=IN
        arg Data: type=Dcm_Data4ByteType, direction=OUT
      operation ConditionCheckRead: possible-error=[DataServices_Data_DiagnServi_TABROW_NeuMeasu_Read_28_4/E_NOT_OK, DataServices_Data_DiagnServi_TABROW_NeuMeasu_Read_28_4/DCM_E_PENDING]
        arg OpStatus: type=Dcm_OpStatusType, direction=IN
        arg ErrorCode: type=Dcm_NegativeResponseCodeType, direction=OUT
      error E_NOT_OK: error-code=1
      error DCM_E_PENDING: error-code=10
    DataServices_Data_TABROW_StatuECUStandMode_Read
      operation ReadData: possible-error=[DataServices_Data_TABROW_StatuECUStandMode_Read/E_NOT_OK, DataServices_Data_TABROW_StatuECUStandMode_Read/DCM_E_PENDING]
        arg OpStatus: type=Dcm_OpStatusType, direction=IN
        arg Data: type=Dcm_Data1ByteType, direction=OUT
      operation ConditionCheckRead: possible-error=[DataServices_Data_TABROW_StatuECUStandMode_Read/E_NOT_OK, DataServices_Data_TABROW_StatuECUStandMode_Read/DCM_E_PENDING]
        arg OpStatus: type=Dcm_OpStatusType, direction=IN
        arg ErrorCode: type=Dcm_NegativeResponseCodeType, direction=OUT
      error E_NOT_OK: error-code=1
      error DCM_E_PENDING: error-code=10
    DataServices_Data_DiagnServi_TABROW_NeuMeasu_Read_28_3
      operation ReadData: possible-error=[DataServices_Data_DiagnServi_TABROW_NeuMeasu_Read_28_3/E_NOT_OK, DataServices_Data_DiagnServi_TABROW_NeuMeasu_Read_28_3/DCM_E_PENDING]
        arg OpStatus: type=Dcm_OpStatusType, direction=IN
        arg Data: type=Dcm_Data4ByteType, direction=OUT
      operation ConditionCheckRead: possible-error=[DataServices_Data_DiagnServi_TABROW_NeuMeasu_Read_28_3/E_NOT_OK, DataServices_Data_DiagnServi_TABROW_NeuMeasu_Read_28_3/DCM_E_PENDING]
        arg OpStatus: type=Dcm_OpStatusType, direction=IN
        arg ErrorCode: type=Dcm_NegativeResponseCodeType, direction=OUT
      error E_NOT_OK: error-code=1
      error DCM_E_PENDING: error-code=10
    DataServices_Data_DiagnServi_TABROW_NeuMeasu_Read_28_6
      operation ReadData: possible-error=[DataServices_Data_DiagnServi_TABROW_NeuMeasu_Read_28_6/E_NOT_OK, DataServices_Data_DiagnServi_TABROW_NeuMeasu_Read_28_6/DCM_E_PENDING]
        arg OpStatus: type=Dcm_OpStatusType, direction=IN
        arg Data: type=Dcm_Data2ByteType, direction=OUT
      operation ConditionCheckRead: possible-error=[DataServices_Data_DiagnServi_TABROW_NeuMeasu_Read_28_6/E_NOT_OK, DataServices_Data_DiagnServi_TABROW_NeuMeasu_Read_28_6/DCM_E_PENDING]
        arg OpStatus: type=Dcm_OpStatusType, direction=IN
        arg ErrorCode: type=Dcm_NegativeResponseCodeType, direction=OUT
      error E_NOT_OK: error-code=1
      error DCM_E_PENDING: error-code=10
    DataServices_Data_DiagnServi_TABROW_NeuMeasu_Read_28_5
      operation ReadData: possible-error=[DataServices_Data_DiagnServi_TABROW_NeuMeasu_Read_28_5/E_NOT_OK, DataServices_Data_DiagnServi_TABROW_NeuMeasu_Read_28_5/DCM_E_PENDING]
        arg OpStatus: type=Dcm_OpStatusType, direction=IN
        arg Data: type=Dcm_Data4ByteType, direction=OUT
      operation ConditionCheckRead: possible-error=[DataServices_Data_DiagnServi_TABROW_NeuMeasu_Read_28_5/E_NOT_OK, DataServices_Data_DiagnServi_TABROW_NeuMeasu_Read_28_5/DCM_E_PENDING]
        arg OpStatus: type=Dcm_OpStatusType, direction=IN
        arg ErrorCode: type=Dcm_NegativeResponseCodeType, direction=OUT
      error E_NOT_OK: error-code=1
      error DCM_E_PENDING: error-code=10
    DataServices_Data_DiagnServi_TABROW_NeuMeasu_Read_33_1_1_1_1_1_1_1_1_1_1_1_1_1_1_1_1_1_1_1_1_1_1_1_2_1
      operation ReadData: possible-error=[DataServices_Data_DiagnServi_TABROW_NeuMeasu_Read_33_1_1_1_1_1_1_1_1_1_1_1_1_1_1_1_1_1_1_1_1_1_1_1_2_1/E_NOT_OK, DataServices_Data_DiagnServi_TABROW_NeuMeasu_Read_33_1_1_1_1_1_1_1_1_1_1_1_1_1_1_1_1_1_1_1_1_1_1_1_2_1/DCM_E_PENDING]
        arg OpStatus: type=Dcm_OpStatusType, direction=IN
        arg Data: type=Dcm_Data9ByteType, direction=OUT
      operation ConditionCheckRead: possible-error=[DataServices_Data_DiagnServi_TABROW_NeuMeasu_Read_33_1_1_1_1_1_1_1_1_1_1_1_1_1_1_1_1_1_1_1_1_1_1_1_2_1/E_NOT_OK, DataServices_Data_DiagnServi_TABROW_NeuMeasu_Read_33_1_1_1_1_1_1_1_1_1_1_1_1_1_1_1_1_1_1_1_1_1_1_1_2_1/DCM_E_PENDING]
        arg OpStatus: type=Dcm_OpStatusType, direction=IN
        arg ErrorCode: type=Dcm_NegativeResponseCodeType, direction=OUT
      error E_NOT_OK: error-code=1
      error DCM_E_PENDING: error-code=10
    DataServices_Data_TABROW_TABROVWDat_Read_1
      operation ReadData: possible-error=[DataServices_Data_TABROW_TABROVWDat_Read_1/E_NOT_OK, DataServices_Data_TABROW_TABROVWDat_Read_1/DCM_E_PENDING]
        arg OpStatus: type=Dcm_OpStatusType, direction=IN
        arg Data: type=Dcm_Data4ByteType, direction=OUT
      operation ConditionCheckRead: possible-error=[DataServices_Data_TABROW_TABROVWDat_Read_1/E_NOT_OK, DataServices_Data_TABROW_TABROVWDat_Read_1/DCM_E_PENDING]
        arg OpStatus: type=Dcm_OpStatusType, direction=IN
        arg ErrorCode: type=Dcm_NegativeResponseCodeType, direction=OUT
      operation WriteData: possible-error=[DataServices_Data_TABROW_TABROVWDat_Read_1/E_NOT_OK, DataServices_Data_TABROW_TABROVWDat_Read_1/DCM_E_PENDING]
        arg Data: type=Dcm_Data4ByteType, direction=IN
        arg OpStatus: type=Dcm_OpStatusType, direction=IN
        arg ErrorCode: type=Dcm_NegativeResponseCodeType, direction=OUT
      error E_NOT_OK: error-code=1
      error DCM_E_PENDING: error-code=10
    DataServices_Data_DiagnServi_TABROW_NeuMeasu_Read_36
      operation ReadData: possible-error=[DataServices_Data_DiagnServi_TABROW_NeuMeasu_Read_36/E_NOT_OK, DataServices_Data_DiagnServi_TABROW_NeuMeasu_Read_36/DCM_E_PENDING]
        arg OpStatus: type=Dcm_OpStatusType, direction=IN
        arg Data: type=Dcm_Data2ByteType, direction=OUT
      operation ConditionCheckRead: possible-error=[DataServices_Data_DiagnServi_TABROW_NeuMeasu_Read_36/E_NOT_OK, DataServices_Data_DiagnServi_TABROW_NeuMeasu_Read_36/DCM_E_PENDING]
        arg OpStatus: type=Dcm_OpStatusType, direction=IN
        arg ErrorCode: type=Dcm_NegativeResponseCodeType, direction=OUT
      error E_NOT_OK: error-code=1
      error DCM_E_PENDING: error-code=10
