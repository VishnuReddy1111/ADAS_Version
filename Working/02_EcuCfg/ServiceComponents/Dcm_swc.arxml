[part 1 of 4: packages /MICROSAR/Dcm_swc to /MICROSAR/Dcm_swc/Interfaces]
AUTOSAR XML (schema 00048)
package /MICROSAR/Dcm_swc
  4 x mode declaration group, all with category=EXPLICIT_ORDER:
    DcmControlDtcSetting: initial-mode=ENABLEDTCSETTING, on-transition-value=2
      mode ENABLEDTCSETTING: value=0
      mode DISABLEDTCSETTING: value=1
    DcmEcuReset: initial-mode=NONE, on-transition-value=7
      7 x mode:
        NONE: value=0
        HARD: value=1
        KEYONOFF: value=2
        SOFT: value=3
        JUMPTOBOOTLOADER: value=4
        JUMPTOSYSSUPPLIERBOOTLOADER: value=5
        EXECUTE: value=6
    DcmCommunicationControl: initial-mode=DCM_ENABLE_RX_TX_NORM, on-transition-value=12
      12 x mode:
        DCM_ENABLE_RX_TX_NORM: value=0
        DCM_ENABLE_RX_DISABLE_TX_NORM: value=1
        DCM_DISABLE_RX_ENABLE_TX_NORM: value=2
        DCM_DISABLE_RX_TX_NORMAL: value=3
        DCM_ENABLE_RX_TX_NM: value=4
        DCM_ENABLE_RX_DISABLE_TX_NM: value=5
        DCM_DISABLE_RX_ENABLE_TX_NM: value=6
        DCM_DISABLE_RX_TX_NM: value=7
        DCM_ENABLE_RX_TX_NORM_NM: value=8
        DCM_ENABLE_RX_DISABLE_TX_NORM_NM: value=9
        DCM_DISABLE_RX_ENABLE_TX_NORM_NM: value=10
        DCM_DISABLE_RX_TX_NORM_NM: value=11
    DcmDiagnosticSessionControl: initial-mode=DEFAULT_SESSION, on-transition-value=255
      mode DEFAULT_SESSION: value=1
      mode PROGRAMMING_SESSION: value=2
      mode EXTENDED_SESSION: value=3
  data type mapping set DcmMappingSet  # Contains mapping for ModeDeclarationGroups which are provided by Dcm.
    mode-request-type-maps:
      implementation-data-type=Dcm_ControlDtcSettingType, mode-group=DcmControlDtcSetting
      implementation-data-type=Dcm_EcuResetType, mode-group=DcmEcuReset
      implementation-data-type=Dcm_DiagnosticSessionControlType, mode-group=DcmDiagnosticSessionControl
      implementation-data-type=Dcm_CommunicationModeType, mode-group=DcmCommunicationControl
  7 x mode declaration group, all with category=EXPLICIT_ORDER, on-transition-value=2:
    ExtendedSFD: initial-mode=ExtendedSFD/DISALLOW
      mode ALLOW: value=1
      mode DISALLOW: value=0
    EptiSFD: initial-mode=EptiSFD/DISALLOW
      mode ALLOW: value=1
      mode DISALLOW: value=0
    E2eSFD: initial-mode=E2eSFD/DISALLOW
      mode ALLOW: value=1
      mode DISALLOW: value=0
    OtaSFD: initial-mode=OtaSFD/DISALLOW
      mode ALLOW: value=1
      mode DISALLOW: value=0
    SuperUserSFD: initial-mode=SuperUserSFD/DISALLOW
      mode ALLOW: value=1
      mode DISALLOW: value=0
    BasicSFD: initial-mode=BasicSFD/DISALLOW
      mode ALLOW: value=1
      mode DISALLOW: value=0
    ProductionSFD: initial-mode=ProductionSFD/DISALLOW
      mode ALLOW: value=1
      mode DISALLOW: value=0
package /MICROSAR/Dcm_swc/DataTypes
  293 x impl type:
    Dcm_ConfirmationStatusType: compu {0=DCM_RES_POS_OK, 1=DCM_RES_POS_NOT_OK, 2=DCM_RES_NEG_OK, 3=DCM_RES_NEG_NOT_OK}, range raw 0..3, implementation-data-type=uint8
    Dcm_OpStatusType: compu {0=DCM_INITIAL, 1=DCM_PENDING, 2=DCM_CANCEL, 3=DCM_FORCE_RCRRP_OK, 64=DCM_FORCE_RCRRP_NOT_OK}, range raw 0..64, implementation-data-type=uint8
    Dcm_ProtocolType: compu {0=DCM_OBD_ON_CAN, 1=DCM_OBD_ON_FLEXRAY, 2=DCM_OBD_ON_IP, 3=DCM_UDS_ON_CAN, 4=DCM_UDS_ON_FLEXRAY, 5=DCM_UDS_ON_IP, 12=DCM_NO_ACTIVE_PROTOCOL, 240..254=DCM_SUPPLIER_1..DCM_SUPPLIER_15}, range raw 0..254, implementation-data-type=uint8
    Dcm_RequestKindType: compu {0=DCM_REQ_KIND_NONE, 1=DCM_REQ_KIND_EXTERNAL, 2=DCM_REQ_KIND_ROE}, range raw 0..2, implementation-data-type=uint8
    Dcm_ControlDtcSettingType: compu {0=DCM_ENUM_ENABLEDTCSETTING, 1=DCM_ENUM_DISABLEDTCSETTING}, range raw 0..255, implementation-data-type=uint8
    Dcm_EcuResetType: compu {0=DCM_ENUM_NONE, 1=DCM_ENUM_HARD, 2=DCM_ENUM_KEYONOFF, 3=DCM_ENUM_SOFT, 4=DCM_ENUM_JUMPTOBOOTLOADER, 5=DCM_ENUM_JUMPTOSYSSUPPLIERBOOTLOADER, 6=DCM_ENUM_EXECUTE}, range raw 0..255, implementation-data-type=uint8
    Dcm_CommunicationModeType:
      compu {0=DCM_ENABLE_RX_TX_NORM, 1=DCM_ENABLE_RX_DISABLE_TX_NORM, 2=DCM_DISABLE_RX_ENABLE_TX_NORM, 3=DCM_DISABLE_RX_TX_NORMAL, 4=DCM_ENABLE_RX_TX_NM, 5=DCM_ENABLE_RX_DISABLE_TX_NM, 6=DCM_DISABLE_RX_ENABLE_TX_NM, 7=DCM_DISABLE_RX_TX_NM, 8=DCM_ENABLE_RX_TX_NORM_NM, 9=DCM_ENABLE_RX_DISABLE_TX_NORM_NM, 10=DCM_DISABLE_RX_ENABLE_TX_NORM_NM, 11=DCM_DISABLE_RX_TX_NORM_NM}
      range raw 0..255
      implementation-data-type=uint8
    Dcm_Data4ByteType: category=ARRAY, sw-calibration-access=READ-ONLY
      element Dcm_Data4ByteTypeElement: array-size=4, array-size-semantics=FIXED-SIZE, implementation-data-type=uint8
    Dcm_Data2ByteType: category=ARRAY, sw-calibration-access=READ-ONLY
      element Dcm_Data2ByteTypeElement: array-size=2, array-size-semantics=FIXED-SIZE, implementation-data-type=uint8
    Dcm_Data1ByteType: category=ARRAY, sw-calibration-access=READ-ONLY
      element Dcm_Data1ByteTypeElement: array-size=1, array-size-semantics=FIXED-SIZE, implementation-data-type=uint8
    Dcm_Data13ByteType: category=ARRAY, sw-calibration-access=READ-ONLY
      element Dcm_Data13ByteTypeElement: array-size=13, array-size-semantics=FIXED-SIZE, implementation-data-type=uint8
    Dcm_Data6ByteType: category=ARRAY, sw-calibration-access=READ-ONLY
      element Dcm_Data6ByteTypeElement: array-size=6, array-size-semantics=FIXED-SIZE, implementation-data-type=uint8
    Dcm_NegativeResponseCodeType:
      compu {0=DCM_E_POSITIVERESPONSE, 16=DCM_E_GENERALREJECT, 17=DCM_E_SERVICENOTSUPPORTED, 18=DCM_E_SUBFUNCTIONNOTSUPPORTED, 19=DCM_E_INCORRECTMESSAGELENGTHORINVALIDFORMAT, 20=DCM_E_RESPONSETOOLONG, 33=DCM_E_BUSYREPEATREQUEST, 34=DCM_E_CONDITIONSNOTCORRECT, 36=DCM_E_REQUESTSEQUENCEERROR, 37=DCM_E_NORESPONSEFROMSUBNETCOMPONENT, 38=DCM_E_FAILUREPREVENTSEXECUTIONOFREQUESTEDACTION, 49=DCM_E_REQUESTOUTOFRANGE, 51=DCM_E_SECURITYACCESSDENIED, 52=DCM_E_AUTHENTICATIONREQUIRED, 53=DCM_E_INVALIDKEY, 54=DCM_E_EXCEEDNUMBEROFATTEMPTS, 55=DCM_E_REQUIREDTIMEDELAYNOTEXPIRED, 80=DCM_E_CVF_INVALIDTIMEPERIOD, 81=DCM_E_CVF_INVALIDSIGNATURE, 82=DCM_E_CVF_INVALIDCHAINOFTRUST, 83=DCM_E_CVF_INVALIDTYPE, 84=DCM_E_CVF_INVALIDFORMAT, 85=DCM_E_CVF_INVALIDCONTENT, 86=DCM_E_CVF_INVALIDSCOPE, 87=DCM_E_CVF_INVALIDCERTIFICATEREVOKED, 88=DCM_E_OWNERSHIPVERIFICATIONFAILED, 89=DCM_E_CHALLENGECALCULATIONFAILED, 112=DCM_E_UPLOADDOWNLOADNOTACCEPTED, 113=DCM_E_TRANSFERDATASUSPENDED, 114=DCM_E_GENERALPROGRAMMINGFAILURE, 115=DCM_E_WRONGBLOCKSEQUENCECOUNTER, 120=DCM_E_REQUESTCORRECTLYRECEIVEDRESPONSEPENDING, 126=DCM_E_SUBFUNCTIONNOTSUPPORTEDINACTIVESESSION, 127=DCM_E_SERVICENOTSUPPORTEDINACTIVESESSION, 129=DCM_E_RPMTOOHIGH, 130=DCM_E_RPMTOOLOW, 131=DCM_E_ENGINEISRUNNING, 132=DCM_E_ENGINEISNOTRUNNING, 133=DCM_E_ENGINERUNTIMETOOLOW, 134=DCM_E_TEMPERATURETOOHIGH, 135=DCM_E_TEMPERATURETOOLOW, 136=DCM_E_VEHICLESPEEDTOOHIGH, 137=DCM_E_VEHICLESPEEDTOOLOW, 138=DCM_E_THROTTLE_PEDALTOOHIGH, 139=DCM_E_THROTTLE_PEDALTOOLOW, 140=DCM_E_TRANSMISSIONRANGENOTINNEUTRAL, 141=DCM_E_TRANSMISSIONRANGENOTINGEAR, 143=DCM_E_BRAKESWITCH_NOTCLOSED, 144=DCM_E_SHIFTERLEVERNOTINPARK, 145=DCM_E_TORQUECONVERTERCLUTCHLOCKED, 146=DCM_E_VOLTAGETOOHIGH, 147=DCM_E_VOLTAGETOOLOW, 240..249=DCM_E_VMSCNC_0..DCM_E_VMSCNC_9, 250=DCM_E_VMSCNC_A, 251=DCM_E_VMSCNC_B, 252=DCM_E_VMSCNC_C, 253=DCM_E_VMSCNC_D, 254=DCM_E_VMSCNC_E}
      range raw 0..255
      implementation-data-type=uint8
    Dcm_Data32ByteType: category=ARRAY, sw-calibration-access=READ-ONLY
      element Dcm_Data32ByteTypeElement: array-size=32, array-size-semantics=FIXED-SIZE, implementation-data-type=uint8
    Dcm_Data7ByteType: category=ARRAY, sw-calibration-access=READ-ONLY
      element Dcm_Data7ByteTypeElement: array-size=7, array-size-semantics=FIXED-SIZE, implementation-data-type=uint8
    Dcm_SesCtrlType: compu {1=DCM_DEFAULT_SESSION, 2=DCM_PROGRAMMING_SESSION, 3=DCM_EXTENDED_DIAGNOSTIC_SESSION}, range raw 0..3, implementation-data-type=uint8
    Dcm_DiagnosticSessionControlType: compu {1=DCM_ENUM_DEFAULT_SESSION, 2=DCM_ENUM_PROGRAMMING_SESSION, 3=DCM_ENUM_EXTENDED_SESSION}, range raw 0..255, implementation-data-type=uint8
    Dcm_StartFlexibleOutArrayData_Routine_DiagnServi_RoutiContrCheckProgrPreco_ResDataType: category=ARRAY, sw-calibration-access=READ-ONLY
      element Dcm_StartFlexibleOutArrayData_Routine_DiagnServi_RoutiContrCheckProgrPreco_ResDataTypeElement: array-size=255, array-size-semantics=FIXED-SIZE, implementation-data-type=uint8
    Dcm_StartFlexibleOutArrayData_Routine_DiagnServi_TABROW_CalcuIntegValidData_Start_Routine_ResDataType: category=ARRAY, sw-calibration-access=READ-ONLY
      element Dcm_StartFlexibleOutArrayData_Routine_DiagnServi_TABROW_CalcuIntegValidData_Start_Routine_ResDataTypeElement: array-size=34, array-size-semantics=FIXED-SIZE, implementation-data-type=uint8
    Dcm_StartFlexibleOutArrayData_Routine_DiagnServi_TABROW_CalcuIndivHashValue_Start_Routine_ResDataType: category=ARRAY, sw-calibration-access=READ-ONLY
      element Dcm_StartFlexibleOutArrayData_Routine_DiagnServi_TABROW_CalcuIndivHashValue_Start_Routine_ResDataTypeElement: array-size=325, array-size-semantics=FIXED-SIZE, implementation-data-type=uint8
    Dcm_StartDataIn_Routine_DiagnServi_TABROW_CalcuModulHashValue_Start_Routine_COP_ReqDataArrayType: implementation-data-type=uint8
    Dcm_StartDataIn_Routine_DiagnServi_TABROW_CalcuModulHashValue_Start_Routine_COP_ReqDataType: category=ARRAY, sw-calibration-access=READ-ONLY
      element Dcm_StartDataIn_Routine_DiagnServi_TABROW_CalcuModulHashValue_Start_Routine_COP_ReqDataTypeElement: array-size=2, array-size-semantics=FIXED-SIZE, implementation-data-type=Dcm_StartDataIn_Routine_DiagnServi_TABROW_CalcuModulHashValue_Start_Routine_COP_ReqDataArrayType
    Dcm_RequestFlexibleOutArrayData_Routine_DiagnServi_TABROW_CalcuModulHashValue_Start_Routine_COP_ResDataType: category=ARRAY, sw-calibration-access=READ-ONLY
      element Dcm_RequestFlexibleOutArrayData_Routine_DiagnServi_TABROW_CalcuModulHashValue_Start_Routine_COP_ResDataTypeElement: array-size=37, array-size-semantics=FIXED-SIZE, implementation-data-type=uint8
    Dcm_RequestDataOut_Routine_DiagnServi_TABROW_AdaptOfVoltaMeasuChann_Start_Routine_ResDataArrayType: implementation-data-type=uint8
    Dcm_RequestDataOut_Routine_DiagnServi_TABROW_AdaptOfVoltaMeasuChann_Start_Routine_ResDataType: category=ARRAY, sw-calibration-access=READ-ONLY
      element Dcm_RequestDataOut_Routine_DiagnServi_TABROW_AdaptOfVoltaMeasuChann_Start_Routine_ResDataTypeElement: array-size=6, array-size-semantics=FIXED-SIZE, implementation-data-type=Dcm_RequestDataOut_Routine_DiagnServi_TABROW_AdaptOfVoltaMeasuChann_Start_Routine_ResDataArrayType
    Dcm_RequestDataOut_Routine_DiagnServi_TABROW_NeuRoutiBasicSetti_Start_Routine_2_ResDataArrayType: implementation-data-type=uint8
    Dcm_RequestDataOut_Routine_DiagnServi_TABROW_NeuRoutiBasicSetti_Start_Routine_2_ResDataType: category=ARRAY, sw-calibration-access=READ-ONLY
      element Dcm_RequestDataOut_Routine_DiagnServi_TABROW_NeuRoutiBasicSetti_Start_Routine_2_ResDataTypeElement: array-size=3, array-size-semantics=FIXED-SIZE, implementation-data-type=Dcm_RequestDataOut_Routine_DiagnServi_TABROW_NeuRoutiBasicSetti_Start_Routine_2_ResDataArrayType
    Dcm_StartDataOut_Routine_DiagnServi_TABROW_NeuRoutiImmedResul_Start_Routine_ResDataArrayType: implementation-data-type=uint8
    Dcm_StartDataOut_Routine_DiagnServi_TABROW_NeuRoutiImmedResul_Start_Routine_ResDataType: category=ARRAY, sw-calibration-access=READ-ONLY
      element Dcm_StartDataOut_Routine_DiagnServi_TABROW_NeuRoutiImmedResul_Start_Routine_ResDataTypeElement: array-size=100, array-size-semantics=FIXED-SIZE, implementation-data-type=Dcm_StartDataOut_Routine_DiagnServi_TABROW_NeuRoutiImmedResul_Start_Routine_ResDataArrayType
    Dcm_RequestDataOut_Routine_DiagnServi_TABROW_ResetHVBatteAfterSepar_Start_Routine_ResDataArrayType: implementation-data-type=uint8
    Dcm_RequestDataOut_Routine_DiagnServi_TABROW_ResetHVBatteAfterSepar_Start_Routine_ResDataType: category=ARRAY, sw-calibration-access=READ-ONLY
      element Dcm_RequestDataOut_Routine_DiagnServi_TABROW_ResetHVBatteAfterSepar_Start_Routine_ResDataTypeElement: array-size=5, array-size-semantics=FIXED-SIZE, implementation-data-type=Dcm_RequestDataOut_Routine_DiagnServi_TABROW_ResetHVBatteAfterSepar_Start_Routine_ResDataArrayType
    Dcm_RequestDataOut_Routine_DiagnServi_TABROW_IsolaMeasuDeactMode_Start_Routine_1_ResDataArrayType: implementation-data-type=uint8
    Dcm_RequestDataOut_Routine_DiagnServi_TABROW_IsolaMeasuDeactMode_Start_Routine_1_ResDataType: category=ARRAY, sw-calibration-access=READ-ONLY
      element Dcm_RequestDataOut_Routine_DiagnServi_TABROW_IsolaMeasuDeactMode_Start_Routine_1_ResDataTypeElement: array-size=3, array-size-semantics=FIXED-SIZE, implementation-data-type=Dcm_RequestDataOut_Routine_DiagnServi_TABROW_IsolaMeasuDeactMode_Start_Routine_1_ResDataArrayType
    Dcm_StartDataIn_Routine_DiagnServi_TABROW_ResetOfAllAdapt_Start_Routine_COP_ReqDataArrayType: implementation-data-type=uint8
    Dcm_StartDataIn_Routine_DiagnServi_TABROW_ResetOfAllAdapt_Start_Routine_COP_ReqDataType: category=ARRAY, sw-calibration-access=READ-ONLY
      element Dcm_StartDataIn_Routine_DiagnServi_TABROW_ResetOfAllAdapt_Start_Routine_COP_ReqDataTypeElement: array-size=3, array-size-semantics=FIXED-SIZE, implementation-data-type=Dcm_StartDataIn_Routine_DiagnServi_TABROW_ResetOfAllAdapt_Start_Routine_COP_ReqDataArrayType
    Dcm_RequestDataOut_Routine_DiagnServi_TABROW_AdaptOfBatteBankMode_Start_Routine_ResDataArrayType: implementation-data-type=uint8
    Dcm_RequestDataOut_Routine_DiagnServi_TABROW_AdaptOfBatteBankMode_Start_Routine_ResDataType: category=ARRAY, sw-calibration-access=READ-ONLY
      element Dcm_RequestDataOut_Routine_DiagnServi_TABROW_AdaptOfBatteBankMode_Start_Routine_ResDataTypeElement: array-size=4, array-size-semantics=FIXED-SIZE, implementation-data-type=Dcm_RequestDataOut_Routine_DiagnServi_TABROW_AdaptOfBatteBankMode_Start_Routine_ResDataArrayType
    Dcm_StartDataIn_Routine_DiagnServi_TABROW_AdaptOfCellBalan_Start_Routine_ReqDataArrayType: implementation-data-type=uint8
    Dcm_StartDataIn_Routine_DiagnServi_TABROW_AdaptOfCellBalan_Start_Routine_ReqDataType: category=ARRAY, sw-calibration-access=READ-ONLY
      element Dcm_StartDataIn_Routine_DiagnServi_TABROW_AdaptOfCellBalan_Start_Routine_ReqDataTypeElement: array-size=15, array-size-semantics=FIXED-SIZE, implementation-data-type=Dcm_StartDataIn_Routine_DiagnServi_TABROW_AdaptOfCellBalan_Start_Routine_ReqDataArrayType
    Dcm_RequestDataOut_Routine_DiagnServi_TABROW_AdaptOfCellBalan_Start_Routine_ResDataArrayType: implementation-data-type=uint8
    Dcm_RequestDataOut_Routine_DiagnServi_TABROW_AdaptOfCellBalan_Start_Routine_ResDataType: category=ARRAY, sw-calibration-access=READ-ONLY
      element Dcm_RequestDataOut_Routine_DiagnServi_TABROW_AdaptOfCellBalan_Start_Routine_ResDataTypeElement: array-size=2, array-size-semantics=FIXED-SIZE, implementation-data-type=Dcm_RequestDataOut_Routine_DiagnServi_TABROW_AdaptOfCellBalan_Start_Routine_ResDataArrayType
    Dcm_StartDataIn_Routine_DiagnServi_TABROW_ResetToFactoSetti_Start_Routine_COP_ReqDataArrayType: implementation-data-type=uint8
    Dcm_StartDataIn_Routine_DiagnServi_TABROW_ResetToFactoSetti_Start_Routine_COP_ReqDataType: category=ARRAY, sw-calibration-access=READ-ONLY
      element Dcm_StartDataIn_Routine_DiagnServi_TABROW_ResetToFactoSetti_Start_Routine_COP_ReqDataTypeElement: array-size=3, array-size-semantics=FIXED-SIZE, implementation-data-type=Dcm_StartDataIn_Routine_DiagnServi_TABROW_ResetToFactoSetti_Start_Routine_COP_ReqDataArrayType
    Dcm_StartFlexibleInArrayData_Routine_DiagnServi_Verify_partial_software_checksum_Start_Routine_ReqDataType: category=ARRAY, sw-calibration-access=READ-ONLY
      element Dcm_StartFlexibleInArrayData_Routine_DiagnServi_Verify_partial_software_checksum_Start_Routine_ReqDataTypeElement: array-size=4113, array-size-semantics=FIXED-SIZE, implementation-data-type=uint8
    Dcm_StartFlexibleInArrayData_Routine_TABROW_VkmsDebug_Start_Routine_ReqDataType: category=ARRAY, sw-calibration-access=READ-ONLY
      element Dcm_StartFlexibleInArrayData_Routine_TABROW_VkmsDebug_Start_Routine_ReqDataTypeElement: array-size=513, array-size-semantics=FIXED-SIZE, implementation-data-type=uint8
    Dcm_RequestFlexibleOutArrayData_Routine_TABROW_VkmsDebug_Start_Routine_ResDataType: category=ARRAY, sw-calibration-access=READ-ONLY
      element Dcm_RequestFlexibleOutArrayData_Routine_TABROW_VkmsDebug_Start_Routine_ResDataTypeElement: array-size=51, array-size-semantics=FIXED-SIZE, implementation-data-type=uint8
    Dcm_StartFlexibleOutArrayData_Routine_DiagnServi_TABROW_RequeConfiOfProteOfVehicDiagn_Start_Routine_ResDataType: category=ARRAY, sw-calibration-access=READ-ONLY
      element Dcm_StartFlexibleOutArrayData_Routine_DiagnServi_TABROW_RequeConfiOfProteOfVehicDiagn_Start_Routine_ResDataTypeElement: array-size=964, array-size-semantics=FIXED-SIZE, implementation-data-type=uint8
    Dcm_StartFlexibleInArrayData_Routine_DiagnServi_TABROW_CalcuConfiStateFingeOfProteOfVehicDiagn_Start_Routine_ReqDataType: category=ARRAY, sw-calibration-access=READ-ONLY
      element Dcm_StartFlexibleInArrayData_Routine_DiagnServi_TABROW_CalcuConfiStateFingeOfProteOfVehicDiagn_Start_Routine_ReqDataTypeElement: array-size=515, array-size-semantics=FIXED-SIZE, implementation-data-type=uint8
    Dcm_StartFlexibleOutArrayData_Routine_DiagnServi_TABROW_CalcuConfiStateFingeOfProteOfVehicDiagn_Start_Routine_ResDataType: category=ARRAY, sw-calibration-access=READ-ONLY
      element Dcm_StartFlexibleOutArrayData_Routine_DiagnServi_TABROW_CalcuConfiStateFingeOfProteOfVehicDiagn_Start_Routine_ResDataTypeElement: array-size=34, array-size-semantics=FIXED-SIZE, implementation-data-type=uint8
    Dcm_StartFlexibleInArrayData_Routine_DiagnServi_TABROW_UnlocProteOfVehicDiagn_Start_Routine_ReqDataType: category=ARRAY, sw-calibration-access=READ-ONLY
      element Dcm_StartFlexibleInArrayData_Routine_DiagnServi_TABROW_UnlocProteOfVehicDiagn_Start_Routine_ReqDataTypeElement: array-size=470, array-size-semantics=FIXED-SIZE, implementation-data-type=uint8
    Dcm_StartDataOut_Routine_DiagnServi_TABROW_UnlocProteOfVehicDiagn_Start_Routine_ResDataArrayType: implementation-data-type=uint8
    Dcm_StartDataOut_Routine_DiagnServi_TABROW_UnlocProteOfVehicDiagn_Start_Routine_ResDataType: category=ARRAY, sw-calibration-access=READ-ONLY
      element Dcm_StartDataOut_Routine_DiagnServi_TABROW_UnlocProteOfVehicDiagn_Start_Routine_ResDataTypeElement: array-size=2, array-size-semantics=FIXED-SIZE, implementation-data-type=Dcm_StartDataOut_Routine_DiagnServi_TABROW_UnlocProteOfVehicDiagn_Start_Routine_ResDataArrayType
    Dcm_StartDataOut_Routine_TABROW_LockProteOfVehicDiagn_Start_Routine_ResDataArrayType: implementation-data-type=uint8
    Dcm_StartDataOut_Routine_TABROW_LockProteOfVehicDiagn_Start_Routine_ResDataType: category=ARRAY, sw-calibration-access=READ-ONLY
      element Dcm_StartDataOut_Routine_TABROW_LockProteOfVehicDiagn_Start_Routine_ResDataTypeElement: array-size=2, array-size-semantics=FIXED-SIZE, implementation-data-type=Dcm_StartDataOut_Routine_TABROW_LockProteOfVehicDiagn_Start_Routine_ResDataArrayType
    Dcm_StartFlexibleInArrayData_Routine_DiagnServi_TABROW_ResetProteOfVehicDiagn_Start_Routine_ReqDataType: category=ARRAY, sw-calibration-access=READ-ONLY
      element Dcm_StartFlexibleInArrayData_Routine_DiagnServi_TABROW_ResetProteOfVehicDiagn_Start_Routine_ReqDataTypeElement: array-size=467, array-size-semantics=FIXED-SIZE, implementation-data-type=uint8
    Dcm_StartDataOut_Routine_DiagnServi_TABROW_ResetProteOfVehicDiagn_Start_Routine_ResDataArrayType: implementation-data-type=uint8
    Dcm_StartDataOut_Routine_DiagnServi_TABROW_ResetProteOfVehicDiagn_Start_Routine_ResDataType: category=ARRAY, sw-calibration-access=READ-ONLY
      element Dcm_StartDataOut_Routine_DiagnServi_TABROW_ResetProteOfVehicDiagn_Start_Routine_ResDataTypeElement: array-size=2, array-size-semantics=FIXED-SIZE, implementation-data-type=Dcm_StartDataOut_Routine_DiagnServi_TABROW_ResetProteOfVehicDiagn_Start_Routine_ResDataArrayType
    Dcm_StartFlexibleOutArrayData_Routine_DiagnServi_TABROW_RequeDataOfProteOfVehicDiagn_Start_Routine_ResDataType: category=ARRAY, sw-calibration-access=READ-ONLY
      element Dcm_StartFlexibleOutArrayData_Routine_DiagnServi_TABROW_RequeDataOfProteOfVehicDiagn_Start_Routine_ResDataTypeElement: array-size=443, array-size-semantics=FIXED-SIZE, implementation-data-type=uint8
    Dcm_StartFlexibleOutArrayData_Routine_DiagnServi_TABROW_RequeLoggiDataOfProteOfVehicDiagn_Start_Routine_ResDataType: category=ARRAY, sw-calibration-access=READ-ONLY
      element Dcm_StartFlexibleOutArrayData_Routine_DiagnServi_TABROW_RequeLoggiDataOfProteOfVehicDiagn_Start_Routine_ResDataTypeElement: array-size=98, array-size-semantics=FIXED-SIZE, implementation-data-type=uint8
    Dcm_StartFlexibleInArrayData_Routine_TABROW_VkmsHandlDownl_Start_Routine_ReqDataType: category=ARRAY, sw-calibration-access=READ-ONLY
      element Dcm_StartFlexibleInArrayData_Routine_TABROW_VkmsHandlDownl_Start_Routine_ReqDataTypeElement: array-size=513, array-size-semantics=FIXED-SIZE, implementation-data-type=uint8
    Dcm_RequestDataOut_Routine_TABROW_VkmsHandlDownl_Start_Routine_ResDataArrayType: implementation-data-type=uint8
    Dcm_RequestDataOut_Routine_TABROW_VkmsHandlDownl_Start_Routine_ResDataType: category=ARRAY, sw-calibration-access=READ-ONLY
      element Dcm_RequestDataOut_Routine_TABROW_VkmsHandlDownl_Start_Routine_ResDataTypeElement: array-size=2, array-size-semantics=FIXED-SIZE, implementation-data-type=Dcm_RequestDataOut_Routine_TABROW_VkmsHandlDownl_Start_Routine_ResDataArrayType
    Dcm_StartDataIn_Routine_DiagnServi_TABROW_VkmsCheckVerifHash_Start_Routine_ReqDataArrayType: implementation-data-type=uint8
    Dcm_StartDataIn_Routine_DiagnServi_TABROW_VkmsCheckVerifHash_Start_Routine_ReqDataType: category=ARRAY, sw-calibration-access=READ-ONLY
      element Dcm_StartDataIn_Routine_DiagnServi_TABROW_VkmsCheckVerifHash_Start_Routine_ReqDataTypeElement: array-size=17, array-size-semantics=FIXED-SIZE, implementation-data-type=Dcm_StartDataIn_Routine_DiagnServi_TABROW_VkmsCheckVerifHash_Start_Routine_ReqDataArrayType
    Dcm_RequestDataOut_Routine_DiagnServi_TABROW_VkmsCheckVerifHash_Start_Routine_ResDataArrayType: implementation-data-type=uint8
    Dcm_RequestDataOut_Routine_DiagnServi_TABROW_VkmsCheckVerifHash_Start_Routine_ResDataType: category=ARRAY, sw-calibration-access=READ-ONLY
      element Dcm_RequestDataOut_Routine_DiagnServi_TABROW_VkmsCheckVerifHash_Start_Routine_ResDataTypeElement: array-size=2, array-size-semantics=FIXED-SIZE, implementation-data-type=Dcm_RequestDataOut_Routine_DiagnServi_TABROW_VkmsCheckVerifHash_Start_Routine_ResDataArrayType
    Dcm_StartDataIn_Routine_DiagnServi_TABROW_VkmsGetIdentHash_Start_Routine_ReqDataArrayType: implementation-data-type=uint8
    Dcm_StartDataIn_Routine_DiagnServi_TABROW_VkmsGetIdentHash_Start_Routine_ReqDataType: category=ARRAY, sw-calibration-access=READ-ONLY
      element Dcm_StartDataIn_Routine_DiagnServi_TABROW_VkmsGetIdentHash_Start_Routine_ReqDataTypeElement: array-size=17, array-size-semantics=FIXED-SIZE, implementation-data-type=Dcm_StartDataIn_Routine_DiagnServi_TABROW_VkmsGetIdentHash_Start_Routine_ReqDataArrayType
    Dcm_RequestDataOut_Routine_DiagnServi_TABROW_VkmsGetIdentHash_Start_Routine_ResDataArrayType: implementation-data-type=uint8
    Dcm_RequestDataOut_Routine_DiagnServi_TABROW_VkmsGetIdentHash_Start_Routine_ResDataType: category=ARRAY, sw-calibration-access=READ-ONLY
      element Dcm_RequestDataOut_Routine_DiagnServi_TABROW_VkmsGetIdentHash_Start_Routine_ResDataTypeElement: array-size=18, array-size-semantics=FIXED-SIZE, implementation-data-type=Dcm_RequestDataOut_Routine_DiagnServi_TABROW_VkmsGetIdentHash_Start_Routine_ResDataArrayType
    Dcm_RequestDataOut_Routine_DiagnServi_TABROW_VkmsGetPssHash_Start_Routine_ResDataArrayType: implementation-data-type=uint8
    Dcm_RequestDataOut_Routine_DiagnServi_TABROW_VkmsGetPssHash_Start_Routine_ResDataType: category=ARRAY, sw-calibration-access=READ-ONLY
      element Dcm_RequestDataOut_Routine_DiagnServi_TABROW_VkmsGetPssHash_Start_Routine_ResDataTypeElement: array-size=18, array-size-semantics=FIXED-SIZE, implementation-data-type=Dcm_RequestDataOut_Routine_DiagnServi_TABROW_VkmsGetPssHash_Start_Routine_ResDataArrayType
    Dcm_RequestDataOut_Routine_DiagnServi_TABROW_VkmsGetState_Start_Routine_ResDataArrayType: implementation-data-type=uint8
    Dcm_RequestDataOut_Routine_DiagnServi_TABROW_VkmsGetState_Start_Routine_ResDataType: category=ARRAY, sw-calibration-access=READ-ONLY
      element Dcm_RequestDataOut_Routine_DiagnServi_TABROW_VkmsGetState_Start_Routine_ResDataTypeElement: array-size=12, array-size-semantics=FIXED-SIZE, implementation-data-type=Dcm_RequestDataOut_Routine_DiagnServi_TABROW_VkmsGetState_Start_Routine_ResDataArrayType
    Dcm_StartFlexibleInArrayData_Routine_DiagnServi_TABROW_BeginOfWritiOfSecurDataOfProteOfVehicDiagn_Start_Routine_ReqDataType: category=ARRAY, sw-calibration-access=READ-ONLY
      element Dcm_StartFlexibleInArrayData_Routine_DiagnServi_TABROW_BeginOfWritiOfSecurDataOfProteOfVehicDiagn_Start_Routine_ReqData_de4469a5: array-size=1024, array-size-semantics=FIXED-SIZE, implementation-data-type=uint8
    Dcm_StartDataOut_Routine_DiagnServi_TABROW_BeginOfWritiOfSecurDataOfProteOfVehicDiagn_Start_Routine_ResDataArrayType: implementation-data-type=uint8
    Dcm_StartDataOut_Routine_DiagnServi_TABROW_BeginOfWritiOfSecurDataOfProteOfVehicDiagn_Start_Routine_ResDataType: category=ARRAY, sw-calibration-access=READ-ONLY
      element Dcm_StartDataOut_Routine_DiagnServi_TABROW_BeginOfWritiOfSecurDataOfProteOfVehicDiagn_Start_Routine_ResDataTypeElement: array-size=2, array-size-semantics=FIXED-SIZE, implementation-data-type=Dcm_StartDataOut_Routine_DiagnServi_TABROW_BeginOfWritiOfSecurDataOfProteOfVehicDiagn_Start_Routine_ResDataArrayType
    Dcm_StartDataOut_Routine_TABROW_EndOfWritiSecurDataOfProteOfVehicDiagn_Start_Routine_ResDataArrayType: implementation-data-type=uint8
    Dcm_StartDataOut_Routine_TABROW_EndOfWritiSecurDataOfProteOfVehicDiagn_Start_Routine_ResDataType: category=ARRAY, sw-calibration-access=READ-ONLY
      element Dcm_StartDataOut_Routine_TABROW_EndOfWritiSecurDataOfProteOfVehicDiagn_Start_Routine_ResDataTypeElement: array-size=2, array-size-semantics=FIXED-SIZE, implementation-data-type=Dcm_StartDataOut_Routine_TABROW_EndOfWritiSecurDataOfProteOfVehicDiagn_Start_Routine_ResDataArrayType
    Dcm_StartDataIn_Routine_TABROW_CheckCalibPreCondi_Start_Routine_ReqDataArrayType: implementation-data-type=uint8
    Dcm_StartDataIn_Routine_TABROW_CheckCalibPreCondi_Start_Routine_ReqDataType: category=ARRAY, sw-calibration-access=READ-ONLY
      element Dcm_StartDataIn_Routine_TABROW_CheckCalibPreCondi_Start_Routine_ReqDataTypeElement: array-size=3, array-size-semantics=FIXED-SIZE, implementation-data-type=Dcm_StartDataIn_Routine_TABROW_CheckCalibPreCondi_Start_Routine_ReqDataArrayType
    Dcm_StartFlexibleOutArrayData_Routine_TABROW_CheckCalibPreCondi_Start_Routine_ResDataType: category=ARRAY, sw-calibration-access=READ-ONLY
      element Dcm_StartFlexibleOutArrayData_Routine_TABROW_CheckCalibPreCondi_Start_Routine_ResDataTypeElement: array-size=259, array-size-semantics=FIXED-SIZE, implementation-data-type=uint8
    Dcm_RequestDataOut_Routine_TABROW_SOKFunctDeact_Start_Routine_COP_ResDataArrayType: implementation-data-type=uint8
    Dcm_RequestDataOut_Routine_TABROW_SOKFunctDeact_Start_Routine_COP_ResDataType: category=ARRAY, sw-calibration-access=READ-ONLY
      element Dcm_RequestDataOut_Routine_TABROW_SOKFunctDeact_Start_Routine_COP_ResDataTypeElement: array-size=3, array-size-semantics=FIXED-SIZE, implementation-data-type=Dcm_RequestDataOut_Routine_TABROW_SOKFunctDeact_Start_Routine_COP_ResDataArrayType
    Dcm_StartFlexibleInArrayData_Routine_Get_Energy_from_SOC_Start_Routine_ReqDataType: category=ARRAY, sw-calibration-access=READ-ONLY
      element Dcm_StartFlexibleInArrayData_Routine_Get_Energy_from_SOC_Start_Routine_ReqDataTypeElement: array-size=18, array-size-semantics=FIXED-SIZE, implementation-data-type=uint8
    Dcm_RequestFlexibleOutArrayData_Routine_Get_Energy_from_SOC_Start_Routine_ResDataType: category=ARRAY, sw-calibration-access=READ-ONLY
      element Dcm_RequestFlexibleOutArrayData_Routine_Get_Energy_from_SOC_Start_Routine_ResDataTypeElement: array-size=9, array-size-semantics=FIXED-SIZE, implementation-data-type=uint8
    Dcm_StartFlexibleInArrayData_Routine_DiagnServi_Get_Charge_Power_Start_Routine_ReqDataType: category=ARRAY, sw-calibration-access=READ-ONLY
      element Dcm_StartFlexibleInArrayData_Routine_DiagnServi_Get_Charge_Power_Start_Routine_ReqDataTypeElement: array-size=242, array-size-semantics=FIXED-SIZE, implementation-data-type=uint8
    Dcm_RequestFlexibleOutArrayData_Routine_DiagnServi_Get_Charge_Power_Start_Routine_ResDataType: category=ARRAY, sw-calibration-access=READ-ONLY
      element Dcm_RequestFlexibleOutArrayData_Routine_DiagnServi_Get_Charge_Power_Start_Routine_ResDataTypeElement: array-size=290, array-size-semantics=FIXED-SIZE, implementation-data-type=uint8
    Dcm_Data9ByteType: category=ARRAY, sw-calibration-access=READ-ONLY
      element Dcm_Data9ByteTypeElement: array-size=9, array-size-semantics=FIXED-SIZE, implementation-data-type=uint8
    Dcm_Data512ByteType: category=ARRAY, sw-calibration-access=READ-ONLY
      element Dcm_Data512ByteTypeElement: array-size=512, array-size-semantics=FIXED-SIZE, implementation-data-type=uint8
    Dcm_Data152ByteType: category=ARRAY, sw-calibration-access=READ-ONLY
      element Dcm_Data152ByteTypeElement: array-size=152, array-size-semantics=FIXED-SIZE, implementation-data-type=uint8
    Dcm_Data3ByteType: category=ARRAY, sw-calibration-access=READ-ONLY
      element Dcm_Data3ByteTypeElement: array-size=3, array-size-semantics=FIXED-SIZE, implementation-data-type=uint8
    Dcm_Data16ByteType: category=ARRAY, sw-calibration-access=READ-ONLY
      element Dcm_Data16ByteTypeElement: array-size=16, array-size-semantics=FIXED-SIZE, implementation-data-type=uint8
    Dcm_Data11ByteType: category=ARRAY, sw-calibration-access=READ-ONLY
      element Dcm_Data11ByteTypeElement: array-size=11, array-size-semantics=FIXED-SIZE, implementation-data-type=uint8
    Dcm_Data8192ByteType: category=ARRAY, sw-calibration-access=READ-ONLY
      element Dcm_Data8192ByteTypeElement: array-size=8192, array-size-semantics=FIXED-SIZE, implementation-data-type=uint8
    Dcm_Data64ByteType: category=ARRAY, sw-calibration-access=READ-ONLY
      element Dcm_Data64ByteTypeElement: array-size=64, array-size-semantics=FIXED-SIZE, implementation-data-type=uint8
    Dcm_Data14ByteType: category=ARRAY, sw-calibration-access=READ-ONLY
      element Dcm_Data14ByteTypeElement: array-size=14, array-size-semantics=FIXED-SIZE, implementation-data-type=uint8
    Dcm_Data26ByteType: category=ARRAY, sw-calibration-access=READ-ONLY
      element Dcm_Data26ByteTypeElement: array-size=26, array-size-semantics=FIXED-SIZE, implementation-data-type=uint8
    Dcm_Data24ByteType: category=ARRAY, sw-calibration-access=READ-ONLY
      element Dcm_Data24ByteTypeElement: array-size=24, array-size-semantics=FIXED-SIZE, implementation-data-type=uint8
    Dcm_Data23ByteType: category=ARRAY, sw-calibration-access=READ-ONLY
      element Dcm_Data23ByteTypeElement: array-size=23, array-size-semantics=FIXED-SIZE, implementation-data-type=uint8
    Dcm_Data27ByteType: category=ARRAY, sw-calibration-access=READ-ONLY
      element Dcm_Data27ByteTypeElement: array-size=27, array-size-semantics=FIXED-SIZE, implementation-data-type=uint8
    Dcm_Data10ByteType: category=ARRAY, sw-calibration-access=READ-ONLY
      element Dcm_Data10ByteTypeElement: array-size=10, array-size-semantics=FIXED-SIZE, implementation-data-type=uint8
    Dcm_Data12ByteType: category=ARRAY, sw-calibration-access=READ-ONLY
      element Dcm_Data12ByteTypeElement: array-size=12, array-size-semantics=FIXED-SIZE, implementation-data-type=uint8
    Dcm_Data8ByteType: category=ARRAY, sw-calibration-access=READ-ONLY
      element Dcm_Data8ByteTypeElement: array-size=8, array-size-semantics=FIXED-SIZE, implementation-data-type=uint8
    Dcm_Data20ByteType: category=ARRAY, sw-calibration-access=READ-ONLY
      element Dcm_Data20ByteTypeElement: array-size=20, array-size-semantics=FIXED-SIZE, implementation-data-type=uint8
    Dcm_Data240ByteType: category=ARRAY, sw-calibration-access=READ-ONLY
      element Dcm_Data240ByteTypeElement: array-size=240, array-size-semantics=FIXED-SIZE, implementation-data-type=uint8
    Dcm_Data18ByteType: category=ARRAY, sw-calibration-access=READ-ONLY
      element Dcm_Data18ByteTypeElement: array-size=18, array-size-semantics=FIXED-SIZE, implementation-data-type=uint8
    Dcm_Data1022ByteType: category=ARRAY, sw-calibration-access=READ-ONLY
      element Dcm_Data1022ByteTypeElement: array-size=1022, array-size-semantics=FIXED-SIZE, implementation-data-type=uint8
    Dcm_Data502ByteType: category=ARRAY, sw-calibration-access=READ-ONLY
      element Dcm_Data502ByteTypeElement: array-size=502, array-size-semantics=FIXED-SIZE, implementation-data-type=uint8
    Dcm_Data3572ByteType: category=ARRAY, sw-calibration-access=READ-ONLY
      element Dcm_Data3572ByteTypeElement: array-size=3572, array-size-semantics=FIXED-SIZE, implementation-data-type=uint8
    Dcm_Data25ByteType: category=ARRAY, sw-calibration-access=READ-ONLY
      element Dcm_Data25ByteTypeElement: array-size=25, array-size-semantics=FIXED-SIZE, implementation-data-type=uint8
    Dcm_Data110ByteType: category=ARRAY, sw-calibration-access=READ-ONLY
      element Dcm_Data110ByteTypeElement: array-size=110, array-size-semantics=FIXED-SIZE, implementation-data-type=uint8
    Dcm_Data48ByteType: category=ARRAY, sw-calibration-access=READ-ONLY
      element Dcm_Data48ByteTypeElement: array-size=48, array-size-semantics=FIXED-SIZE, implementation-data-type=uint8
    Dcm_Data517ByteType: category=ARRAY, sw-calibration-access=READ-ONLY
      element Dcm_Data517ByteTypeElement: array-size=517, array-size-semantics=FIXED-SIZE, implementation-data-type=uint8
    Dcm_Data5ByteType: category=ARRAY, sw-calibration-access=READ-ONLY
      element Dcm_Data5ByteTypeElement: array-size=5, array-size-semantics=FIXED-SIZE, implementation-data-type=uint8
    Dcm_Data22ByteType: category=ARRAY, sw-calibration-access=READ-ONLY
      element Dcm_Data22ByteTypeElement: array-size=22, array-size-semantics=FIXED-SIZE, implementation-data-type=uint8
    Dcm_Data256ByteType: category=ARRAY, sw-calibration-access=READ-ONLY
      element Dcm_Data256ByteTypeElement: array-size=256, array-size-semantics=FIXED-SIZE, implementation-data-type=uint8
    Dcm_Data386ByteType: category=ARRAY, sw-calibration-access=READ-ONLY
      element Dcm_Data386ByteTypeElement: array-size=386, array-size-semantics=FIXED-SIZE, implementation-data-type=uint8
    Dcm_StartDataIn_Routine_DiagnServi_TABROW_CalcuIntegValidData_Start_Routine_Type_of_calculationPrimitiveType: implementation-data-type=uint8
    Dcm_StartDataIn_Routine_DiagnServi_TABROW_CalcuIntegValidData_Start_Routine_Type_of_calculationType: implementation-data-type=Dcm_StartDataIn_Routine_DiagnServi_TABROW_CalcuIntegValidData_Start_Routine_Type_of_calculationPrimitiveType
    Dcm_StartDataIn_Routine_DiagnServi_TABROW_CalcuIntegValidData_Start_Routine_Type_of_hash_valuePrimitiveType: implementation-data-type=uint8
    Dcm_StartDataIn_Routine_DiagnServi_TABROW_CalcuIntegValidData_Start_Routine_Type_of_hash_valueType: implementation-data-type=Dcm_StartDataIn_Routine_DiagnServi_TABROW_CalcuIntegValidData_Start_Routine_Type_of_hash_valuePrimitiveType
    Dcm_StartDataIn_Routine_DiagnServi_TABROW_CalcuIndivHashValue_Start_Routine_Type_of_hash_valuePrimitiveType: implementation-data-type=uint8
    Dcm_StartDataIn_Routine_DiagnServi_TABROW_CalcuIndivHashValue_Start_Routine_Type_of_hash_valueType: implementation-data-type=Dcm_StartDataIn_Routine_DiagnServi_TABROW_CalcuIndivHashValue_Start_Routine_Type_of_hash_valuePrimitiveType
    Dcm_StartDataIn_Routine_DiagnServi_TABROW_CalcuIndivHashValue_Start_Routine_Type_of_hashPrimitiveType: implementation-data-type=uint8
    Dcm_StartDataIn_Routine_DiagnServi_TABROW_CalcuIndivHashValue_Start_Routine_Type_of_hashType: implementation-data-type=Dcm_StartDataIn_Routine_DiagnServi_TABROW_CalcuIndivHashValue_Start_Routine_Type_of_hashPrimitiveType
    Dcm_StartDataIn_Routine_DiagnServi_TABROW_CalcuIndivHashValue_Start_Routine_Individual_hash_value_idArrayType: implementation-data-type=uint8
    Dcm_StartDataIn_Routine_DiagnServi_TABROW_CalcuIndivHashValue_Start_Routine_Individual_hash_value_idType: category=ARRAY, sw-calibration-access=READ-ONLY
      element Dcm_StartDataIn_Routine_DiagnServi_TABROW_CalcuIndivHashValue_Start_Routine_Individual_hash_value_idTypeElement: array-size=2, array-size-semantics=FIXED-SIZE, implementation-data-type=Dcm_StartDataIn_Routine_DiagnServi_TABROW_CalcuIndivHashValue_Start_Routine_Individual_hash_value_idArrayType
    Dcm_Data50ByteType: category=ARRAY, sw-calibration-access=READ-ONLY
      element Dcm_Data50ByteTypeElement: array-size=50, array-size-semantics=FIXED-SIZE, implementation-data-type=uint8
    Dcm_Data17ByteType: category=ARRAY, sw-calibration-access=READ-ONLY
      element Dcm_Data17ByteTypeElement: array-size=17, array-size-semantics=FIXED-SIZE, implementation-data-type=uint8
    Dcm_StartDataOut_Routine_DiagnServi_TABROW_CalcuModulHashValue_Start_Routine_COP_ResDataArrayType: implementation-data-type=uint8
    Dcm_StartDataOut_Routine_DiagnServi_TABROW_CalcuModulHashValue_Start_Routine_COP_ResDataType: category=ARRAY, sw-calibration-access=READ-ONLY
      element Dcm_StartDataOut_Routine_DiagnServi_TABROW_CalcuModulHashValue_Start_Routine_COP_ResDataTypeElement: array-size=1, array-size-semantics=FIXED-SIZE, implementation-data-type=Dcm_StartDataOut_Routine_DiagnServi_TABROW_CalcuModulHashValue_Start_Routine_COP_ResDataArrayType
    Dcm_StopDataOut_Routine_DiagnServi_TABROW_CalcuModulHashValue_Start_Routine_COP_ResDataArrayType: implementation-data-type=uint8
    Dcm_StopDataOut_Routine_DiagnServi_TABROW_CalcuModulHashValue_Start_Routine_COP_ResDataType: category=ARRAY, sw-calibration-access=READ-ONLY
      element Dcm_StopDataOut_Routine_DiagnServi_TABROW_CalcuModulHashValue_Start_Routine_COP_ResDataTypeElement: array-size=1, array-size-semantics=FIXED-SIZE, implementation-data-type=Dcm_StopDataOut_Routine_DiagnServi_TABROW_CalcuModulHashValue_Start_Routine_COP_ResDataArrayType
    Dcm_StartDataIn_Routine_DiagnServi_TABROW_IsolaMeasuDeactMode_Start_Routine_ReqDataArrayType: implementation-data-type=uint8
    Dcm_StartDataIn_Routine_DiagnServi_TABROW_IsolaMeasuDeactMode_Start_Routine_ReqDataType: category=ARRAY, sw-calibration-access=READ-ONLY
      element Dcm_StartDataIn_Routine_DiagnServi_TABROW_IsolaMeasuDeactMode_Start_Routine_ReqDataTypeElement: array-size=1, array-size-semantics=FIXED-SIZE, implementation-data-type=Dcm_StartDataIn_Routine_DiagnServi_TABROW_IsolaMeasuDeactMode_Start_Routine_ReqDataArrayType
    Dcm_StartDataOut_Routine_DiagnServi_TABROW_IsolaMeasuDeactMode_Start_Routine_ResDataArrayType: implementation-data-type=uint8
    Dcm_StartDataOut_Routine_DiagnServi_TABROW_IsolaMeasuDeactMode_Start_Routine_ResDataType: category=ARRAY, sw-calibration-access=READ-ONLY
      element Dcm_StartDataOut_Routine_DiagnServi_TABROW_IsolaMeasuDeactMode_Start_Routine_ResDataTypeElement: array-size=1, array-size-semantics=FIXED-SIZE, implementation-data-type=Dcm_StartDataOut_Routine_DiagnServi_TABROW_IsolaMeasuDeactMode_Start_Routine_ResDataArrayType
    Dcm_StopDataOut_Routine_DiagnServi_TABROW_IsolaMeasuDeactMode_Start_Routine_ResDataArrayType: implementation-data-type=uint8
    Dcm_StopDataOut_Routine_DiagnServi_TABROW_IsolaMeasuDeactMode_Start_Routine_ResDataType: category=ARRAY, sw-calibration-access=READ-ONLY
      element Dcm_StopDataOut_Routine_DiagnServi_TABROW_IsolaMeasuDeactMode_Start_Routine_ResDataTypeElement: array-size=1, array-size-semantics=FIXED-SIZE, implementation-data-type=Dcm_StopDataOut_Routine_DiagnServi_TABROW_IsolaMeasuDeactMode_Start_Routine_ResDataArrayType
    Dcm_RequestDataOut_Routine_DiagnServi_TABROW_IsolaMeasuDeactMode_Start_Routine_ResDataArrayType: implementation-data-type=uint8
    Dcm_RequestDataOut_Routine_DiagnServi_TABROW_IsolaMeasuDeactMode_Start_Routine_ResDataType: category=ARRAY, sw-calibration-access=READ-ONLY
      element Dcm_RequestDataOut_Routine_DiagnServi_TABROW_IsolaMeasuDeactMode_Start_Routine_ResDataTypeElement: array-size=1, array-size-semantics=FIXED-SIZE, implementation-data-type=Dcm_RequestDataOut_Routine_DiagnServi_TABROW_IsolaMeasuDeactMode_Start_Routine_ResDataArrayType
    Dcm_StartDataOut_Routine_DiagnServi_TABROW_ResetOfContaError_Start_Routine_ResDataArrayType: implementation-data-type=uint8
    Dcm_StartDataOut_Routine_DiagnServi_TABROW_ResetOfContaError_Start_Routine_ResDataType: category=ARRAY, sw-calibration-access=READ-ONLY
      element Dcm_StartDataOut_Routine_DiagnServi_TABROW_ResetOfContaError_Start_Routine_ResDataTypeElement: array-size=1, array-size-semantics=FIXED-SIZE, implementation-data-type=Dcm_StartDataOut_Routine_DiagnServi_TABROW_ResetOfContaError_Start_Routine_ResDataArrayType
    Dcm_StopDataOut_Routine_DiagnServi_TABROW_ResetOfContaError_Start_Routine_ResDataArrayType: implementation-data-type=uint8
    Dcm_StopDataOut_Routine_DiagnServi_TABROW_ResetOfContaError_Start_Routine_ResDataType: category=ARRAY, sw-calibration-access=READ-ONLY
      element Dcm_StopDataOut_Routine_DiagnServi_TABROW_ResetOfContaError_Start_Routine_ResDataTypeElement: array-size=1, array-size-semantics=FIXED-SIZE, implementation-data-type=Dcm_StopDataOut_Routine_DiagnServi_TABROW_ResetOfContaError_Start_Routine_ResDataArrayType
    Dcm_RequestDataOut_Routine_DiagnServi_TABROW_ResetOfContaError_Start_Routine_ResDataArrayType: implementation-data-type=uint8
    Dcm_RequestDataOut_Routine_DiagnServi_TABROW_ResetOfContaError_Start_Routine_ResDataType: category=ARRAY, sw-calibration-access=READ-ONLY
      element Dcm_RequestDataOut_Routine_DiagnServi_TABROW_ResetOfContaError_Start_Routine_ResDataTypeElement: array-size=1, array-size-semantics=FIXED-SIZE, implementation-data-type=Dcm_RequestDataOut_Routine_DiagnServi_TABROW_ResetOfContaError_Start_Routine_ResDataArrayType
    Dcm_StartDataIn_Routine_DiagnServi_TABROW_AdaptOfVoltaMeasuChann_Start_Routine_ReqDataArrayType: implementation-data-type=uint8
    Dcm_StartDataIn_Routine_DiagnServi_TABROW_AdaptOfVoltaMeasuChann_Start_Routine_ReqDataType: category=ARRAY, sw-calibration-access=READ-ONLY
      element Dcm_StartDataIn_Routine_DiagnServi_TABROW_AdaptOfVoltaMeasuChann_Start_Routine_ReqDataTypeElement: array-size=1, array-size-semantics=FIXED-SIZE, implementation-data-type=Dcm_StartDataIn_Routine_DiagnServi_TABROW_AdaptOfVoltaMeasuChann_Start_Routine_ReqDataArrayType
    Dcm_StartDataOut_Routine_DiagnServi_TABROW_AdaptOfVoltaMeasuChann_Start_Routine_ResDataArrayType: implementation-data-type=uint8
    Dcm_StartDataOut_Routine_DiagnServi_TABROW_AdaptOfVoltaMeasuChann_Start_Routine_ResDataType: category=ARRAY, sw-calibration-access=READ-ONLY
      element Dcm_StartDataOut_Routine_DiagnServi_TABROW_AdaptOfVoltaMeasuChann_Start_Routine_ResDataTypeElement: array-size=1, array-size-semantics=FIXED-SIZE, implementation-data-type=Dcm_StartDataOut_Routine_DiagnServi_TABROW_AdaptOfVoltaMeasuChann_Start_Routine_ResDataArrayType
    Dcm_StopDataOut_Routine_DiagnServi_TABROW_AdaptOfVoltaMeasuChann_Start_Routine_ResDataArrayType: implementation-data-type=uint8
    Dcm_StopDataOut_Routine_DiagnServi_TABROW_AdaptOfVoltaMeasuChann_Start_Routine_ResDataType: category=ARRAY, sw-calibration-access=READ-ONLY
      element Dcm_StopDataOut_Routine_DiagnServi_TABROW_AdaptOfVoltaMeasuChann_Start_Routine_ResDataTypeElement: array-size=1, array-size-semantics=FIXED-SIZE, implementation-data-type=Dcm_StopDataOut_Routine_DiagnServi_TABROW_AdaptOfVoltaMeasuChann_Start_Routine_ResDataArrayType
    Dcm_StartDataOut_Routine_DiagnServi_TABROW_NeuRoutiBasicSetti_Start_Routine_1_ResDataArrayType: implementation-data-type=uint8
    Dcm_StartDataOut_Routine_DiagnServi_TABROW_NeuRoutiBasicSetti_Start_Routine_1_ResDataType: category=ARRAY, sw-calibration-access=READ-ONLY
      element Dcm_StartDataOut_Routine_DiagnServi_TABROW_NeuRoutiBasicSetti_Start_Routine_1_ResDataTypeElement: array-size=1, array-size-semantics=FIXED-SIZE, implementation-data-type=Dcm_StartDataOut_Routine_DiagnServi_TABROW_NeuRoutiBasicSetti_Start_Routine_1_ResDataArrayType
    Dcm_StopDataOut_Routine_DiagnServi_TABROW_NeuRoutiBasicSetti_Start_Routine_1_ResDataArrayType: implementation-data-type=uint8
    Dcm_StopDataOut_Routine_DiagnServi_TABROW_NeuRoutiBasicSetti_Start_Routine_1_ResDataType: category=ARRAY, sw-calibration-access=READ-ONLY
      element Dcm_StopDataOut_Routine_DiagnServi_TABROW_NeuRoutiBasicSetti_Start_Routine_1_ResDataTypeElement: array-size=1, array-size-semantics=FIXED-SIZE, implementation-data-type=Dcm_StopDataOut_Routine_DiagnServi_TABROW_NeuRoutiBasicSetti_Start_Routine_1_ResDataArrayType
    Dcm_RequestDataOut_Routine_DiagnServi_TABROW_NeuRoutiBasicSetti_Start_Routine_1_ResDataArrayType: implementation-data-type=uint8
    Dcm_RequestDataOut_Routine_DiagnServi_TABROW_NeuRoutiBasicSetti_Start_Routine_1_ResDataType: category=ARRAY, sw-calibration-access=READ-ONLY
      element Dcm_RequestDataOut_Routine_DiagnServi_TABROW_NeuRoutiBasicSetti_Start_Routine_1_ResDataTypeElement: array-size=1, array-size-semantics=FIXED-SIZE, implementation-data-type=Dcm_RequestDataOut_Routine_DiagnServi_TABROW_NeuRoutiBasicSetti_Start_Routine_1_ResDataArrayType
    Dcm_StartDataOut_Routine_DiagnServi_TABROW_NeuRoutiBasicSetti_Start_Routine_3_ResDataArrayType: implementation-data-type=uint8
    Dcm_StartDataOut_Routine_DiagnServi_TABROW_NeuRoutiBasicSetti_Start_Routine_3_ResDataType: category=ARRAY, sw-calibration-access=READ-ONLY
      element Dcm_StartDataOut_Routine_DiagnServi_TABROW_NeuRoutiBasicSetti_Start_Routine_3_ResDataTypeElement: array-size=1, array-size-semantics=FIXED-SIZE, implementation-data-type=Dcm_StartDataOut_Routine_DiagnServi_TABROW_NeuRoutiBasicSetti_Start_Routine_3_ResDataArrayType
    Dcm_StopDataOut_Routine_DiagnServi_TABROW_NeuRoutiBasicSetti_Start_Routine_3_ResDataArrayType: implementation-data-type=uint8
    Dcm_StopDataOut_Routine_DiagnServi_TABROW_NeuRoutiBasicSetti_Start_Routine_3_ResDataType: category=ARRAY, sw-calibration-access=READ-ONLY
      element Dcm_StopDataOut_Routine_DiagnServi_TABROW_NeuRoutiBasicSetti_Start_Routine_3_ResDataTypeElement: array-size=1, array-size-semantics=FIXED-SIZE, implementation-data-type=Dcm_StopDataOut_Routine_DiagnServi_TABROW_NeuRoutiBasicSetti_Start_Routine_3_ResDataArrayType
    Dcm_RequestDataOut_Routine_DiagnServi_TABROW_NeuRoutiBasicSetti_Start_Routine_3_ResDataArrayType: implementation-data-type=uint8
    Dcm_RequestDataOut_Routine_DiagnServi_TABROW_NeuRoutiBasicSetti_Start_Routine_3_ResDataType: category=ARRAY, sw-calibration-access=READ-ONLY
      element Dcm_RequestDataOut_Routine_DiagnServi_TABROW_NeuRoutiBasicSetti_Start_Routine_3_ResDataTypeElement: array-size=1, array-size-semantics=FIXED-SIZE, implementation-data-type=Dcm_RequestDataOut_Routine_DiagnServi_TABROW_NeuRoutiBasicSetti_Start_Routine_3_ResDataArrayType
    Dcm_StartDataOut_Routine_DiagnServi_TABROW_NeuRoutiBasicSetti_Start_Routine_2_ResDataArrayType: implementation-data-type=uint8
    Dcm_StartDataOut_Routine_DiagnServi_TABROW_NeuRoutiBasicSetti_Start_Routine_2_ResDataType: category=ARRAY, sw-calibration-access=READ-ONLY
      element Dcm_StartDataOut_Routine_DiagnServi_TABROW_NeuRoutiBasicSetti_Start_Routine_2_ResDataTypeElement: array-size=1, array-size-semantics=FIXED-SIZE, implementation-data-type=Dcm_StartDataOut_Routine_DiagnServi_TABROW_NeuRoutiBasicSetti_Start_Routine_2_ResDataArrayType
    Dcm_StopDataOut_Routine_DiagnServi_TABROW_NeuRoutiBasicSetti_Start_Routine_2_ResDataArrayType: implementation-data-type=uint8
    Dcm_StopDataOut_Routine_DiagnServi_TABROW_NeuRoutiBasicSetti_Start_Routine_2_ResDataType: category=ARRAY, sw-calibration-access=READ-ONLY
      element Dcm_StopDataOut_Routine_DiagnServi_TABROW_NeuRoutiBasicSetti_Start_Routine_2_ResDataTypeElement: array-size=1, array-size-semantics=FIXED-SIZE, implementation-data-type=Dcm_StopDataOut_Routine_DiagnServi_TABROW_NeuRoutiBasicSetti_Start_Routine_2_ResDataArrayType
    Dcm_StartDataIn_Routine_DiagnServi_TABROW_ResetOfModulParam_Start_Routine_ReqDataArrayType: implementation-data-type=uint8
    Dcm_StartDataIn_Routine_DiagnServi_TABROW_ResetOfModulParam_Start_Routine_ReqDataType: category=ARRAY, sw-calibration-access=READ-ONLY
      element Dcm_StartDataIn_Routine_DiagnServi_TABROW_ResetOfModulParam_Start_Routine_ReqDataTypeElement: array-size=1, array-size-semantics=FIXED-SIZE, implementation-data-type=Dcm_StartDataIn_Routine_DiagnServi_TABROW_ResetOfModulParam_Start_Routine_ReqDataArrayType
    Dcm_StartDataOut_Routine_DiagnServi_TABROW_ResetOfModulParam_Start_Routine_ResDataArrayType: implementation-data-type=uint8
    Dcm_StartDataOut_Routine_DiagnServi_TABROW_ResetOfModulParam_Start_Routine_ResDataType: category=ARRAY, sw-calibration-access=READ-ONLY
      element Dcm_StartDataOut_Routine_DiagnServi_TABROW_ResetOfModulParam_Start_Routine_ResDataTypeElement: array-size=1, array-size-semantics=FIXED-SIZE, implementation-data-type=Dcm_StartDataOut_Routine_DiagnServi_TABROW_ResetOfModulParam_Start_Routine_ResDataArrayType
    Dcm_StopDataOut_Routine_DiagnServi_TABROW_ResetOfModulParam_Start_Routine_ResDataArrayType: implementation-data-type=uint8
    Dcm_StopDataOut_Routine_DiagnServi_TABROW_ResetOfModulParam_Start_Routine_ResDataType: category=ARRAY, sw-calibration-access=READ-ONLY
      element Dcm_StopDataOut_Routine_DiagnServi_TABROW_ResetOfModulParam_Start_Routine_ResDataTypeElement: array-size=1, array-size-semantics=FIXED-SIZE, implementation-data-type=Dcm_StopDataOut_Routine_DiagnServi_TABROW_ResetOfModulParam_Start_Routine_ResDataArrayType
    Dcm_RequestDataOut_Routine_DiagnServi_TABROW_ResetOfModulParam_Start_Routine_ResDataArrayType: implementation-data-type=uint8
    Dcm_RequestDataOut_Routine_DiagnServi_TABROW_ResetOfModulParam_Start_Routine_ResDataType: category=ARRAY, sw-calibration-access=READ-ONLY
      element Dcm_RequestDataOut_Routine_DiagnServi_TABROW_ResetOfModulParam_Start_Routine_ResDataTypeElement: array-size=1, array-size-semantics=FIXED-SIZE, implementation-data-type=Dcm_RequestDataOut_Routine_DiagnServi_TABROW_ResetOfModulParam_Start_Routine_ResDataArrayType
    Dcm_StartDataIn_Routine_DiagnServi_TABROW_NeuRoutiBasicSetti_Start_Routine_ReqDataArrayType: implementation-data-type=uint8
    Dcm_StartDataIn_Routine_DiagnServi_TABROW_NeuRoutiBasicSetti_Start_Routine_ReqDataType: category=ARRAY, sw-calibration-access=READ-ONLY
      element Dcm_StartDataIn_Routine_DiagnServi_TABROW_NeuRoutiBasicSetti_Start_Routine_ReqDataTypeElement: array-size=1, array-size-semantics=FIXED-SIZE, implementation-data-type=Dcm_StartDataIn_Routine_DiagnServi_TABROW_NeuRoutiBasicSetti_Start_Routine_ReqDataArrayType
    Dcm_StartDataOut_Routine_DiagnServi_TABROW_NeuRoutiBasicSetti_Start_Routine_ResDataArrayType: implementation-data-type=uint8
    Dcm_StartDataOut_Routine_DiagnServi_TABROW_NeuRoutiBasicSetti_Start_Routine_ResDataType: category=ARRAY, sw-calibration-access=READ-ONLY
      element Dcm_StartDataOut_Routine_DiagnServi_TABROW_NeuRoutiBasicSetti_Start_Routine_ResDataTypeElement: array-size=1, array-size-semantics=FIXED-SIZE, implementation-data-type=Dcm_StartDataOut_Routine_DiagnServi_TABROW_NeuRoutiBasicSetti_Start_Routine_ResDataArrayType
    Dcm_StopDataOut_Routine_DiagnServi_TABROW_NeuRoutiBasicSetti_Start_Routine_ResDataArrayType: implementation-data-type=uint8
    Dcm_StopDataOut_Routine_DiagnServi_TABROW_NeuRoutiBasicSetti_Start_Routine_ResDataType: category=ARRAY, sw-calibration-access=READ-ONLY
      element Dcm_StopDataOut_Routine_DiagnServi_TABROW_NeuRoutiBasicSetti_Start_Routine_ResDataTypeElement: array-size=1, array-size-semantics=FIXED-SIZE, implementation-data-type=Dcm_StopDataOut_Routine_DiagnServi_TABROW_NeuRoutiBasicSetti_Start_Routine_ResDataArrayType
    Dcm_RequestDataOut_Routine_DiagnServi_TABROW_NeuRoutiBasicSetti_Start_Routine_ResDataArrayType: implementation-data-type=uint8
    Dcm_RequestDataOut_Routine_DiagnServi_TABROW_NeuRoutiBasicSetti_Start_Routine_ResDataType: category=ARRAY, sw-calibration-access=READ-ONLY
      element Dcm_RequestDataOut_Routine_DiagnServi_TABROW_NeuRoutiBasicSetti_Start_Routine_ResDataTypeElement: array-size=1, array-size-semantics=FIXED-SIZE, implementation-data-type=Dcm_RequestDataOut_Routine_DiagnServi_TABROW_NeuRoutiBasicSetti_Start_Routine_ResDataArrayType
    Dcm_StartDataOut_Routine_DiagnServi_TABROW_NeuRoutiBasicSetti_Start_Routine_4_ResDataArrayType: implementation-data-type=uint8
    Dcm_StartDataOut_Routine_DiagnServi_TABROW_NeuRoutiBasicSetti_Start_Routine_4_ResDataType: category=ARRAY, sw-calibration-access=READ-ONLY
      element Dcm_StartDataOut_Routine_DiagnServi_TABROW_NeuRoutiBasicSetti_Start_Routine_4_ResDataTypeElement: array-size=1, array-size-semantics=FIXED-SIZE, implementation-data-type=Dcm_StartDataOut_Routine_DiagnServi_TABROW_NeuRoutiBasicSetti_Start_Routine_4_ResDataArrayType
    Dcm_StopDataOut_Routine_DiagnServi_TABROW_NeuRoutiBasicSetti_Start_Routine_4_ResDataArrayType: implementation-data-type=uint8
    Dcm_StopDataOut_Routine_DiagnServi_TABROW_NeuRoutiBasicSetti_Start_Routine_4_ResDataType: category=ARRAY, sw-calibration-access=READ-ONLY
      element Dcm_StopDataOut_Routine_DiagnServi_TABROW_NeuRoutiBasicSetti_Start_Routine_4_ResDataTypeElement: array-size=1, array-size-semantics=FIXED-SIZE, implementation-data-type=Dcm_StopDataOut_Routine_DiagnServi_TABROW_NeuRoutiBasicSetti_Start_Routine_4_ResDataArrayType
    Dcm_RequestDataOut_Routine_DiagnServi_TABROW_NeuRoutiBasicSetti_Start_Routine_4_ResDataArrayType: implementation-data-type=uint8
    Dcm_RequestDataOut_Routine_DiagnServi_TABROW_NeuRoutiBasicSetti_Start_Routine_4_ResDataType: category=ARRAY, sw-calibration-access=READ-ONLY
      element Dcm_RequestDataOut_Routine_DiagnServi_TABROW_NeuRoutiBasicSetti_Start_Routine_4_ResDataTypeElement: array-size=1, array-size-semantics=FIXED-SIZE, implementation-data-type=Dcm_RequestDataOut_Routine_DiagnServi_TABROW_NeuRoutiBasicSetti_Start_Routine_4_ResDataArrayType
    Dcm_StartDataIn_Routine_DiagnServi_TABROW_NeuRoutiImmedResul_Start_Routine_ReqDataArrayType: implementation-data-type=uint8
    Dcm_StartDataIn_Routine_DiagnServi_TABROW_NeuRoutiImmedResul_Start_Routine_ReqDataType: category=ARRAY, sw-calibration-access=READ-ONLY
      element Dcm_StartDataIn_Routine_DiagnServi_TABROW_NeuRoutiImmedResul_Start_Routine_ReqDataTypeElement: array-size=1, array-size-semantics=FIXED-SIZE, implementation-data-type=Dcm_StartDataIn_Routine_DiagnServi_TABROW_NeuRoutiImmedResul_Start_Routine_ReqDataArrayType
    Dcm_StartDataOut_Routine_DiagnServi_TABROW_NeuRoutiBasicSetti_Start_Routine_5_ResDataArrayType: implementation-data-type=uint8
    Dcm_StartDataOut_Routine_DiagnServi_TABROW_NeuRoutiBasicSetti_Start_Routine_5_ResDataType: category=ARRAY, sw-calibration-access=READ-ONLY
      element Dcm_StartDataOut_Routine_DiagnServi_TABROW_NeuRoutiBasicSetti_Start_Routine_5_ResDataTypeElement: array-size=1, array-size-semantics=FIXED-SIZE, implementation-data-type=Dcm_StartDataOut_Routine_DiagnServi_TABROW_NeuRoutiBasicSetti_Start_Routine_5_ResDataArrayType
    Dcm_StopDataOut_Routine_DiagnServi_TABROW_NeuRoutiBasicSetti_Start_Routine_5_ResDataArrayType: implementation-data-type=uint8
    Dcm_StopDataOut_Routine_DiagnServi_TABROW_NeuRoutiBasicSetti_Start_Routine_5_ResDataType: category=ARRAY, sw-calibration-access=READ-ONLY
      element Dcm_StopDataOut_Routine_DiagnServi_TABROW_NeuRoutiBasicSetti_Start_Routine_5_ResDataTypeElement: array-size=1, array-size-semantics=FIXED-SIZE, implementation-data-type=Dcm_StopDataOut_Routine_DiagnServi_TABROW_NeuRoutiBasicSetti_Start_Routine_5_ResDataArrayType
    Dcm_RequestDataOut_Routine_DiagnServi_TABROW_NeuRoutiBasicSetti_Start_Routine_5_ResDataArrayType: implementation-data-type=uint8
    Dcm_RequestDataOut_Routine_DiagnServi_TABROW_NeuRoutiBasicSetti_Start_Routine_5_ResDataType: category=ARRAY, sw-calibration-access=READ-ONLY
      element Dcm_RequestDataOut_Routine_DiagnServi_TABROW_NeuRoutiBasicSetti_Start_Routine_5_ResDataTypeElement: array-size=1, array-size-semantics=FIXED-SIZE, implementation-data-type=Dcm_RequestDataOut_Routine_DiagnServi_TABROW_NeuRoutiBasicSetti_Start_Routine_5_ResDataArrayType
    Dcm_StartDataOut_Routine_DiagnServi_TABROW_NeuRoutiBasicSetti_Start_Routine_4_2_ResDataArrayType: implementation-data-type=uint8
    Dcm_StartDataOut_Routine_DiagnServi_TABROW_NeuRoutiBasicSetti_Start_Routine_4_2_ResDataType: category=ARRAY, sw-calibration-access=READ-ONLY
      element Dcm_StartDataOut_Routine_DiagnServi_TABROW_NeuRoutiBasicSetti_Start_Routine_4_2_ResDataTypeElement: array-size=1, array-size-semantics=FIXED-SIZE, implementation-data-type=Dcm_StartDataOut_Routine_DiagnServi_TABROW_NeuRoutiBasicSetti_Start_Routine_4_2_ResDataArrayType
    Dcm_StopDataOut_Routine_DiagnServi_TABROW_NeuRoutiBasicSetti_Start_Routine_4_2_ResDataArrayType: implementation-data-type=uint8
    Dcm_StopDataOut_Routine_DiagnServi_TABROW_NeuRoutiBasicSetti_Start_Routine_4_2_ResDataType: category=ARRAY, sw-calibration-access=READ-ONLY
      element Dcm_StopDataOut_Routine_DiagnServi_TABROW_NeuRoutiBasicSetti_Start_Routine_4_2_ResDataTypeElement: array-size=1, array-size-semantics=FIXED-SIZE, implementation-data-type=Dcm_StopDataOut_Routine_DiagnServi_TABROW_NeuRoutiBasicSetti_Start_Routine_4_2_ResDataArrayType
    Dcm_RequestDataOut_Routine_DiagnServi_TABROW_NeuRoutiBasicSetti_Start_Routine_4_2_ResDataArrayType: implementation-data-type=uint8
    Dcm_RequestDataOut_Routine_DiagnServi_TABROW_NeuRoutiBasicSetti_Start_Routine_4_2_ResDataType: category=ARRAY, sw-calibration-access=READ-ONLY
      element Dcm_RequestDataOut_Routine_DiagnServi_TABROW_NeuRoutiBasicSetti_Start_Routine_4_2_ResDataTypeElement: array-size=1, array-size-semantics=FIXED-SIZE, implementation-data-type=Dcm_RequestDataOut_Routine_DiagnServi_TABROW_NeuRoutiBasicSetti_Start_Routine_4_2_ResDataArrayType
    Dcm_StartDataOut_Routine_DiagnServi_TABROW_ResetHVBatteAfterSepar_Start_Routine_ResDataArrayType: implementation-data-type=uint8
    Dcm_StartDataOut_Routine_DiagnServi_TABROW_ResetHVBatteAfterSepar_Start_Routine_ResDataType: category=ARRAY, sw-calibration-access=READ-ONLY
      element Dcm_StartDataOut_Routine_DiagnServi_TABROW_ResetHVBatteAfterSepar_Start_Routine_ResDataTypeElement: array-size=1, array-size-semantics=FIXED-SIZE, implementation-data-type=Dcm_StartDataOut_Routine_DiagnServi_TABROW_ResetHVBatteAfterSepar_Start_Routine_ResDataArrayType
    Dcm_StopDataOut_Routine_DiagnServi_TABROW_ResetHVBatteAfterSepar_Start_Routine_ResDataArrayType: implementation-data-type=uint8
    Dcm_StopDataOut_Routine_DiagnServi_TABROW_ResetHVBatteAfterSepar_Start_Routine_ResDataType: category=ARRAY, sw-calibration-access=READ-ONLY
      element Dcm_StopDataOut_Routine_DiagnServi_TABROW_ResetHVBatteAfterSepar_Start_Routine_ResDataTypeElement: array-size=1, array-size-semantics=FIXED-SIZE, implementation-data-type=Dcm_StopDataOut_Routine_DiagnServi_TABROW_ResetHVBatteAfterSepar_Start_Routine_ResDataArrayType
    Dcm_StartDataIn_Routine_DiagnServi_TABROW_IsolaMeasuDeactMode_Start_Routine_1_ReqDataArrayType: implementation-data-type=uint8
    Dcm_StartDataIn_Routine_DiagnServi_TABROW_IsolaMeasuDeactMode_Start_Routine_1_ReqDataType: category=ARRAY, sw-calibration-access=READ-ONLY
      element Dcm_StartDataIn_Routine_DiagnServi_TABROW_IsolaMeasuDeactMode_Start_Routine_1_ReqDataTypeElement: array-size=1, array-size-semantics=FIXED-SIZE, implementation-data-type=Dcm_StartDataIn_Routine_DiagnServi_TABROW_IsolaMeasuDeactMode_Start_Routine_1_ReqDataArrayType
    Dcm_StartDataOut_Routine_DiagnServi_TABROW_IsolaMeasuDeactMode_Start_Routine_1_ResDataArrayType: implementation-data-type=uint8
    Dcm_StartDataOut_Routine_DiagnServi_TABROW_IsolaMeasuDeactMode_Start_Routine_1_ResDataType: category=ARRAY, sw-calibration-access=READ-ONLY
      element Dcm_StartDataOut_Routine_DiagnServi_TABROW_IsolaMeasuDeactMode_Start_Routine_1_ResDataTypeElement: array-size=1, array-size-semantics=FIXED-SIZE, implementation-data-type=Dcm_StartDataOut_Routine_DiagnServi_TABROW_IsolaMeasuDeactMode_Start_Routine_1_ResDataArrayType
    Dcm_StopDataOut_Routine_DiagnServi_TABROW_IsolaMeasuDeactMode_Start_Routine_1_ResDataArrayType: implementation-data-type=uint8
    Dcm_StopDataOut_Routine_DiagnServi_TABROW_IsolaMeasuDeactMode_Start_Routine_1_ResDataType: category=ARRAY, sw-calibration-access=READ-ONLY
      element Dcm_StopDataOut_Routine_DiagnServi_TABROW_IsolaMeasuDeactMode_Start_Routine_1_ResDataTypeElement: array-size=1, array-size-semantics=FIXED-SIZE, implementation-data-type=Dcm_StopDataOut_Routine_DiagnServi_TABROW_IsolaMeasuDeactMode_Start_Routine_1_ResDataArrayType
    Dcm_StartDataOut_Routine_DiagnServi_TABROW_ResetOfAllAdapt_Start_Routine_COP_ResDataArrayType: implementation-data-type=uint8
    Dcm_StartDataOut_Routine_DiagnServi_TABROW_ResetOfAllAdapt_Start_Routine_COP_ResDataType: category=ARRAY, sw-calibration-access=READ-ONLY
      element Dcm_StartDataOut_Routine_DiagnServi_TABROW_ResetOfAllAdapt_Start_Routine_COP_ResDataTypeElement: array-size=1, array-size-semantics=FIXED-SIZE, implementation-data-type=Dcm_StartDataOut_Routine_DiagnServi_TABROW_ResetOfAllAdapt_Start_Routine_COP_ResDataArrayType
    Dcm_StopDataOut_Routine_DiagnServi_TABROW_ResetOfAllAdapt_Start_Routine_COP_ResDataArrayType: implementation-data-type=uint8
    Dcm_StopDataOut_Routine_DiagnServi_TABROW_ResetOfAllAdapt_Start_Routine_COP_ResDataType: category=ARRAY, sw-calibration-access=READ-ONLY
      element Dcm_StopDataOut_Routine_DiagnServi_TABROW_ResetOfAllAdapt_Start_Routine_COP_ResDataTypeElement: array-size=1, array-size-semantics=FIXED-SIZE, implementation-data-type=Dcm_StopDataOut_Routine_DiagnServi_TABROW_ResetOfAllAdapt_Start_Routine_COP_ResDataArrayType
    Dcm_RequestDataOut_Routine_DiagnServi_TABROW_ResetOfAllAdapt_Start_Routine_COP_ResDataArrayType: implementation-data-type=uint8
    Dcm_RequestDataOut_Routine_DiagnServi_TABROW_ResetOfAllAdapt_Start_Routine_COP_ResDataType: category=ARRAY, sw-calibration-access=READ-ONLY
      element Dcm_RequestDataOut_Routine_DiagnServi_TABROW_ResetOfAllAdapt_Start_Routine_COP_ResDataTypeElement: array-size=1, array-size-semantics=FIXED-SIZE, implementation-data-type=Dcm_RequestDataOut_Routine_DiagnServi_TABROW_ResetOfAllAdapt_Start_Routine_COP_ResDataArrayType
    Dcm_StartDataIn_Routine_DiagnServi_TABROW_AdaptOfBatteBankMode_Start_Routine_ReqDataArrayType: implementation-data-type=uint8
    Dcm_StartDataIn_Routine_DiagnServi_TABROW_AdaptOfBatteBankMode_Start_Routine_ReqDataType: category=ARRAY, sw-calibration-access=READ-ONLY
      element Dcm_StartDataIn_Routine_DiagnServi_TABROW_AdaptOfBatteBankMode_Start_Routine_ReqDataTypeElement: array-size=1, array-size-semantics=FIXED-SIZE, implementation-data-type=Dcm_StartDataIn_Routine_DiagnServi_TABROW_AdaptOfBatteBankMode_Start_Routine_ReqDataArrayType
    Dcm_StartDataOut_Routine_DiagnServi_TABROW_AdaptOfBatteBankMode_Start_Routine_ResDataArrayType: implementation-data-type=uint8
    Dcm_StartDataOut_Routine_DiagnServi_TABROW_AdaptOfBatteBankMode_Start_Routine_ResDataType: category=ARRAY, sw-calibration-access=READ-ONLY
      element Dcm_StartDataOut_Routine_DiagnServi_TABROW_AdaptOfBatteBankMode_Start_Routine_ResDataTypeElement: array-size=1, array-size-semantics=FIXED-SIZE, implementation-data-type=Dcm_StartDataOut_Routine_DiagnServi_TABROW_AdaptOfBatteBankMode_Start_Routine_ResDataArrayType
    Dcm_StopDataOut_Routine_DiagnServi_TABROW_AdaptOfBatteBankMode_Start_Routine_ResDataArrayType: implementation-data-type=uint8
    Dcm_StopDataOut_Routine_DiagnServi_TABROW_AdaptOfBatteBankMode_Start_Routine_ResDataType: category=ARRAY, sw-calibration-access=READ-ONLY
      element Dcm_StopDataOut_Routine_DiagnServi_TABROW_AdaptOfBatteBankMode_Start_Routine_ResDataTypeElement: array-size=1, array-size-semantics=FIXED-SIZE, implementation-data-type=Dcm_StopDataOut_Routine_DiagnServi_TABROW_AdaptOfBatteBankMode_Start_Routine_ResDataArrayType
    Dcm_StartDataOut_Routine_DiagnServi_TABROW_AdaptOfCellBalan_Start_Routine_ResDataArrayType: implementation-data-type=uint8
    Dcm_StartDataOut_Routine_DiagnServi_TABROW_AdaptOfCellBalan_Start_Routine_ResDataType: category=ARRAY, sw-calibration-access=READ-ONLY
      element Dcm_StartDataOut_Routine_DiagnServi_TABROW_AdaptOfCellBalan_Start_Routine_ResDataTypeElement: array-size=1, array-size-semantics=FIXED-SIZE, implementation-data-type=Dcm_StartDataOut_Routine_DiagnServi_TABROW_AdaptOfCellBalan_Start_Routine_ResDataArrayType
    Dcm_StopDataOut_Routine_DiagnServi_TABROW_AdaptOfCellBalan_Start_Routine_ResDataArrayType: implementation-data-type=uint8
    Dcm_StopDataOut_Routine_DiagnServi_TABROW_AdaptOfCellBalan_Start_Routine_ResDataType: category=ARRAY, sw-calibration-access=READ-ONLY
      element Dcm_StopDataOut_Routine_DiagnServi_TABROW_AdaptOfCellBalan_Start_Routine_ResDataTypeElement: array-size=1, array-size-semantics=FIXED-SIZE, implementation-data-type=Dcm_StopDataOut_Routine_DiagnServi_TABROW_AdaptOfCellBalan_Start_Routine_ResDataArrayType
    Dcm_StartDataOut_Routine_DiagnServi_TABROW_ResetToFactoSetti_Start_Routine_COP_ResDataArrayType: implementation-data-type=uint8
    Dcm_StartDataOut_Routine_DiagnServi_TABROW_ResetToFactoSetti_Start_Routine_COP_ResDataType: category=ARRAY, sw-calibration-access=READ-ONLY
      element Dcm_StartDataOut_Routine_DiagnServi_TABROW_ResetToFactoSetti_Start_Routine_COP_ResDataTypeElement: array-size=1, array-size-semantics=FIXED-SIZE, implementation-data-type=Dcm_StartDataOut_Routine_DiagnServi_TABROW_ResetToFactoSetti_Start_Routine_COP_ResDataArrayType
    Dcm_StopDataOut_Routine_DiagnServi_TABROW_ResetToFactoSetti_Start_Routine_COP_ResDataArrayType: implementation-data-type=uint8
    Dcm_StopDataOut_Routine_DiagnServi_TABROW_ResetToFactoSetti_Start_Routine_COP_ResDataType: category=ARRAY, sw-calibration-access=READ-ONLY
      element Dcm_StopDataOut_Routine_DiagnServi_TABROW_ResetToFactoSetti_Start_Routine_COP_ResDataTypeElement: array-size=1, array-size-semantics=FIXED-SIZE, implementation-data-type=Dcm_StopDataOut_Routine_DiagnServi_TABROW_ResetToFactoSetti_Start_Routine_COP_ResDataArrayType
    Dcm_RequestDataOut_Routine_DiagnServi_TABROW_ResetToFactoSetti_Start_Routine_COP_ResDataArrayType: implementation-data-type=uint8
    Dcm_RequestDataOut_Routine_DiagnServi_TABROW_ResetToFactoSetti_Start_Routine_COP_ResDataType: category=ARRAY, sw-calibration-access=READ-ONLY
      element Dcm_RequestDataOut_Routine_DiagnServi_TABROW_ResetToFactoSetti_Start_Routine_COP_ResDataTypeElement: array-size=1, array-size-semantics=FIXED-SIZE, implementation-data-type=Dcm_RequestDataOut_Routine_DiagnServi_TABROW_ResetToFactoSetti_Start_Routine_COP_ResDataArrayType
    Dcm_StartDataOut_Routine_DiagnServi_TABROW_ResetHardCrashFlag_Start_Routine_ResDataArrayType: implementation-data-type=uint8
    Dcm_StartDataOut_Routine_DiagnServi_TABROW_ResetHardCrashFlag_Start_Routine_ResDataType: category=ARRAY, sw-calibration-access=READ-ONLY
      element Dcm_StartDataOut_Routine_DiagnServi_TABROW_ResetHardCrashFlag_Start_Routine_ResDataTypeElement: array-size=1, array-size-semantics=FIXED-SIZE, implementation-data-type=Dcm_StartDataOut_Routine_DiagnServi_TABROW_ResetHardCrashFlag_Start_Routine_ResDataArrayType
    Dcm_StopDataOut_Routine_DiagnServi_TABROW_ResetHardCrashFlag_Start_Routine_ResDataArrayType: implementation-data-type=uint8
    Dcm_StopDataOut_Routine_DiagnServi_TABROW_ResetHardCrashFlag_Start_Routine_ResDataType: category=ARRAY, sw-calibration-access=READ-ONLY
      element Dcm_StopDataOut_Routine_DiagnServi_TABROW_ResetHardCrashFlag_Start_Routine_ResDataTypeElement: array-size=1, array-size-semantics=FIXED-SIZE, implementation-data-type=Dcm_StopDataOut_Routine_DiagnServi_TABROW_ResetHardCrashFlag_Start_Routine_ResDataArrayType
    Dcm_RequestDataOut_Routine_DiagnServi_TABROW_ResetHardCrashFlag_Start_Routine_ResDataArrayType: implementation-data-type=uint8
    Dcm_RequestDataOut_Routine_DiagnServi_TABROW_ResetHardCrashFlag_Start_Routine_ResDataType: category=ARRAY, sw-calibration-access=READ-ONLY
      element Dcm_RequestDataOut_Routine_DiagnServi_TABROW_ResetHardCrashFlag_Start_Routine_ResDataTypeElement: array-size=1, array-size-semantics=FIXED-SIZE, implementation-data-type=Dcm_RequestDataOut_Routine_DiagnServi_TABROW_ResetHardCrashFlag_Start_Routine_ResDataArrayType
    Dcm_StartDataOut_Routine_DiagnServi_Verify_partial_software_checksum_Start_Routine_ResDataArrayType: implementation-data-type=uint8
    Dcm_StartDataOut_Routine_DiagnServi_Verify_partial_software_checksum_Start_Routine_ResDataType: category=ARRAY, sw-calibration-access=READ-ONLY
      element Dcm_StartDataOut_Routine_DiagnServi_Verify_partial_software_checksum_Start_Routine_ResDataTypeElement: array-size=1, array-size-semantics=FIXED-SIZE, implementation-data-type=Dcm_StartDataOut_Routine_DiagnServi_Verify_partial_software_checksum_Start_Routine_ResDataArrayType
    Dcm_StartDataOut_Routine_DiagnServi_TABROW_ClearDowngProteData_Start_Routine_COP_ResDataArrayType: implementation-data-type=uint8
    Dcm_StartDataOut_Routine_DiagnServi_TABROW_ClearDowngProteData_Start_Routine_COP_ResDataType: category=ARRAY, sw-calibration-access=READ-ONLY
      element Dcm_StartDataOut_Routine_DiagnServi_TABROW_ClearDowngProteData_Start_Routine_COP_ResDataTypeElement: array-size=1, array-size-semantics=FIXED-SIZE, implementation-data-type=Dcm_StartDataOut_Routine_DiagnServi_TABROW_ClearDowngProteData_Start_Routine_COP_ResDataArrayType
    Dcm_StopDataOut_Routine_DiagnServi_TABROW_ClearDowngProteData_Start_Routine_COP_ResDataArrayType: implementation-data-type=uint8
    Dcm_StopDataOut_Routine_DiagnServi_TABROW_ClearDowngProteData_Start_Routine_COP_ResDataType: category=ARRAY, sw-calibration-access=READ-ONLY
      element Dcm_StopDataOut_Routine_DiagnServi_TABROW_ClearDowngProteData_Start_Routine_COP_ResDataTypeElement: array-size=1, array-size-semantics=FIXED-SIZE, implementation-data-type=Dcm_StopDataOut_Routine_DiagnServi_TABROW_ClearDowngProteData_Start_Routine_COP_ResDataArrayType
    Dcm_RequestDataOut_Routine_DiagnServi_TABROW_ClearDowngProteData_Start_Routine_COP_ResDataArrayType: implementation-data-type=uint8
    Dcm_RequestDataOut_Routine_DiagnServi_TABROW_ClearDowngProteData_Start_Routine_COP_ResDataType: category=ARRAY, sw-calibration-access=READ-ONLY
      element Dcm_RequestDataOut_Routine_DiagnServi_TABROW_ClearDowngProteData_Start_Routine_COP_ResDataTypeElement: array-size=1, array-size-semantics=FIXED-SIZE, implementation-data-type=Dcm_RequestDataOut_Routine_DiagnServi_TABROW_ClearDowngProteData_Start_Routine_COP_ResDataArrayType
    Dcm_StartDataIn_Routine_DiagnServi_TABROW_ResetHealiInhib_Start_Routine_ReqDataArrayType: implementation-data-type=uint8
    Dcm_StartDataIn_Routine_DiagnServi_TABROW_ResetHealiInhib_Start_Routine_ReqDataType: category=ARRAY, sw-calibration-access=READ-ONLY
      element Dcm_StartDataIn_Routine_DiagnServi_TABROW_ResetHealiInhib_Start_Routine_ReqDataTypeElement: array-size=1, array-size-semantics=FIXED-SIZE, implementation-data-type=Dcm_StartDataIn_Routine_DiagnServi_TABROW_ResetHealiInhib_Start_Routine_ReqDataArrayType
    Dcm_StartDataOut_Routine_DiagnServi_TABROW_ResetHealiInhib_Start_Routine_ResDataArrayType: implementation-data-type=uint8
    Dcm_StartDataOut_Routine_DiagnServi_TABROW_ResetHealiInhib_Start_Routine_ResDataType: category=ARRAY, sw-calibration-access=READ-ONLY
      element Dcm_StartDataOut_Routine_DiagnServi_TABROW_ResetHealiInhib_Start_Routine_ResDataTypeElement: array-size=1, array-size-semantics=FIXED-SIZE, implementation-data-type=Dcm_StartDataOut_Routine_DiagnServi_TABROW_ResetHealiInhib_Start_Routine_ResDataArrayType
    Dcm_StartDataIn_Routine_DiagnServi_TABROW_RequeConfiOfProteOfVehicDiagn_Start_Routine_ReqDataArrayType: implementation-data-type=uint8
    Dcm_StartDataIn_Routine_DiagnServi_TABROW_RequeConfiOfProteOfVehicDiagn_Start_Routine_ReqDataType: category=ARRAY, sw-calibration-access=READ-ONLY
      element Dcm_StartDataIn_Routine_DiagnServi_TABROW_RequeConfiOfProteOfVehicDiagn_Start_Routine_ReqDataTypeElement: array-size=1, array-size-semantics=FIXED-SIZE, implementation-data-type=Dcm_StartDataIn_Routine_DiagnServi_TABROW_RequeConfiOfProteOfVehicDiagn_Start_Routine_ReqDataArrayType
    Dcm_StartDataIn_Routine_DiagnServi_TABROW_RequeDataOfProteOfVehicDiagn_Start_Routine_ReqDataArrayType: implementation-data-type=uint8
    Dcm_StartDataIn_Routine_DiagnServi_TABROW_RequeDataOfProteOfVehicDiagn_Start_Routine_ReqDataType: category=ARRAY, sw-calibration-access=READ-ONLY
      element Dcm_StartDataIn_Routine_DiagnServi_TABROW_RequeDataOfProteOfVehicDiagn_Start_Routine_ReqDataTypeElement: array-size=1, array-size-semantics=FIXED-SIZE, implementation-data-type=Dcm_StartDataIn_Routine_DiagnServi_TABROW_RequeDataOfProteOfVehicDiagn_Start_Routine_ReqDataArrayType
    Dcm_StartDataIn_Routine_DiagnServi_TABROW_RequeLoggiDataOfProteOfVehicDiagn_Start_Routine_ReqDataArrayType: implementation-data-type=uint8
    Dcm_StartDataIn_Routine_DiagnServi_TABROW_RequeLoggiDataOfProteOfVehicDiagn_Start_Routine_ReqDataType: category=ARRAY, sw-calibration-access=READ-ONLY
      element Dcm_StartDataIn_Routine_DiagnServi_TABROW_RequeLoggiDataOfProteOfVehicDiagn_Start_Routine_ReqDataTypeElement: array-size=1, array-size-semantics=FIXED-SIZE, implementation-data-type=Dcm_StartDataIn_Routine_DiagnServi_TABROW_RequeLoggiDataOfProteOfVehicDiagn_Start_Routine_ReqDataArrayType
    Dcm_StartDataIn_Routine_DiagnServi_TABROW_VkmsGetPssHash_Start_Routine_ReqDataArrayType: implementation-data-type=uint8
    Dcm_StartDataIn_Routine_DiagnServi_TABROW_VkmsGetPssHash_Start_Routine_ReqDataType: category=ARRAY, sw-calibration-access=READ-ONLY
      element Dcm_StartDataIn_Routine_DiagnServi_TABROW_VkmsGetPssHash_Start_Routine_ReqDataTypeElement: array-size=1, array-size-semantics=FIXED-SIZE, implementation-data-type=Dcm_StartDataIn_Routine_DiagnServi_TABROW_VkmsGetPssHash_Start_Routine_ReqDataArrayType
    Dcm_StartDataIn_Routine_DiagnServi_TABROW_VkmsGetState_Start_Routine_ReqDataArrayType: implementation-data-type=uint8
    Dcm_StartDataIn_Routine_DiagnServi_TABROW_VkmsGetState_Start_Routine_ReqDataType: category=ARRAY, sw-calibration-access=READ-ONLY
      element Dcm_StartDataIn_Routine_DiagnServi_TABROW_VkmsGetState_Start_Routine_ReqDataTypeElement: array-size=1, array-size-semantics=FIXED-SIZE, implementation-data-type=Dcm_StartDataIn_Routine_DiagnServi_TABROW_VkmsGetState_Start_Routine_ReqDataArrayType
    Dcm_StartDataIn_Routine_TABROW_EndOfWritiSecurDataOfProteOfVehicDiagn_Start_Routine_ReqDataArrayType: implementation-data-type=uint8
    Dcm_StartDataIn_Routine_TABROW_EndOfWritiSecurDataOfProteOfVehicDiagn_Start_Routine_ReqDataType: category=ARRAY, sw-calibration-access=READ-ONLY
      element Dcm_StartDataIn_Routine_TABROW_EndOfWritiSecurDataOfProteOfVehicDiagn_Start_Routine_ReqDataTypeElement: array-size=1, array-size-semantics=FIXED-SIZE, implementation-data-type=Dcm_StartDataIn_Routine_TABROW_EndOfWritiSecurDataOfProteOfVehicDiagn_Start_Routine_ReqDataArrayType
    Dcm_StartDataIn_Routine_TABROW_SOKFunctDeact_Start_Routine_COP_ReqDataArrayType: implementation-data-type=uint8
    Dcm_StartDataIn_Routine_TABROW_SOKFunctDeact_Start_Routine_COP_ReqDataType: category=ARRAY, sw-calibration-access=READ-ONLY
      element Dcm_StartDataIn_Routine_TABROW_SOKFunctDeact_Start_Routine_COP_ReqDataTypeElement: array-size=1, array-size-semantics=FIXED-SIZE, implementation-data-type=Dcm_StartDataIn_Routine_TABROW_SOKFunctDeact_Start_Routine_COP_ReqDataArrayType
    Dcm_StartDataOut_Routine_TABROW_SOKFunctDeact_Start_Routine_COP_ResDataArrayType: implementation-data-type=uint8
    Dcm_StartDataOut_Routine_TABROW_SOKFunctDeact_Start_Routine_COP_ResDataType: category=ARRAY, sw-calibration-access=READ-ONLY
      element Dcm_StartDataOut_Routine_TABROW_SOKFunctDeact_Start_Routine_COP_ResDataTypeElement: array-size=1, array-size-semantics=FIXED-SIZE, implementation-data-type=Dcm_StartDataOut_Routine_TABROW_SOKFunctDeact_Start_Routine_COP_ResDataArrayType
    Dcm_StopDataOut_Routine_TABROW_SOKFunctDeact_Start_Routine_COP_ResDataArrayType: implementation-data-type=uint8
    Dcm_StopDataOut_Routine_TABROW_SOKFunctDeact_Start_Routine_COP_ResDataType: category=ARRAY, sw-calibration-access=READ-ONLY
      element Dcm_StopDataOut_Routine_TABROW_SOKFunctDeact_Start_Routine_COP_ResDataTypeElement: array-size=1, array-size-semantics=FIXED-SIZE, implementation-data-type=Dcm_StopDataOut_Routine_TABROW_SOKFunctDeact_Start_Routine_COP_ResDataArrayType
    Dcm_StartDataOut_Routine_Get_Energy_from_SOC_Start_Routine_ResDataArrayType: implementation-data-type=uint8
    Dcm_StartDataOut_Routine_Get_Energy_from_SOC_Start_Routine_ResDataType: category=ARRAY, sw-calibration-access=READ-ONLY
      element Dcm_StartDataOut_Routine_Get_Energy_from_SOC_Start_Routine_ResDataTypeElement: array-size=1, array-size-semantics=FIXED-SIZE, implementation-data-type=Dcm_StartDataOut_Routine_Get_Energy_from_SOC_Start_Routine_ResDataArrayType
    Dcm_StopDataOut_Routine_Get_Energy_from_SOC_Start_Routine_ResDataArrayType: implementation-data-type=uint8
    Dcm_StopDataOut_Routine_Get_Energy_from_SOC_Start_Routine_ResDataType: category=ARRAY, sw-calibration-access=READ-ONLY
      element Dcm_StopDataOut_Routine_Get_Energy_from_SOC_Start_Routine_ResDataTypeElement: array-size=1, array-size-semantics=FIXED-SIZE, implementation-data-type=Dcm_StopDataOut_Routine_Get_Energy_from_SOC_Start_Routine_ResDataArrayType
    Dcm_StartDataOut_Routine_DiagnServi_Get_Charge_Power_Start_Routine_ResDataArrayType: implementation-data-type=uint8
    Dcm_StartDataOut_Routine_DiagnServi_Get_Charge_Power_Start_Routine_ResDataType: category=ARRAY, sw-calibration-access=READ-ONLY
      element Dcm_StartDataOut_Routine_DiagnServi_Get_Charge_Power_Start_Routine_ResDataTypeElement: array-size=1, array-size-semantics=FIXED-SIZE, implementation-data-type=Dcm_StartDataOut_Routine_DiagnServi_Get_Charge_Power_Start_Routine_ResDataArrayType
    Dcm_StopDataOut_Routine_DiagnServi_Get_Charge_Power_Start_Routine_ResDataArrayType: implementation-data-type=uint8
    Dcm_StopDataOut_Routine_DiagnServi_Get_Charge_Power_Start_Routine_ResDataType: category=ARRAY, sw-calibration-access=READ-ONLY
      element Dcm_StopDataOut_Routine_DiagnServi_Get_Charge_Power_Start_Routine_ResDataTypeElement: array-size=1, array-size-semantics=FIXED-SIZE, implementation-data-type=Dcm_StopDataOut_Routine_DiagnServi_Get_Charge_Power_Start_Routine_ResDataArrayType
    Dcm_StartDataOut_Routine_DiagnServi_RoutiContrCheckProgrDepen_ResDataArrayType: implementation-data-type=uint8
    Dcm_StartDataOut_Routine_DiagnServi_RoutiContrCheckProgrDepen_ResDataType: category=ARRAY, sw-calibration-access=READ-ONLY
      element Dcm_StartDataOut_Routine_DiagnServi_RoutiContrCheckProgrDepen_ResDataTypeElement: array-size=1, array-size-semantics=FIXED-SIZE, implementation-data-type=Dcm_StartDataOut_Routine_DiagnServi_RoutiContrCheckProgrDepen_ResDataArrayType
    Dcm_Data100ByteType: category=ARRAY, sw-calibration-access=READ-ONLY
      element Dcm_Data100ByteTypeElement: array-size=100, array-size-semantics=FIXED-SIZE, implementation-data-type=uint8
    Dcm_StartDataOut_Routine_DiagnServi_TABROW_NewRoutiBasicSetti_Start_Routine_ResDataArrayType: implementation-data-type=uint8
    Dcm_StartDataOut_Routine_DiagnServi_TABROW_NewRoutiBasicSetti_Start_Routine_ResDataType: category=ARRAY, sw-calibration-access=READ-ONLY
      element Dcm_StartDataOut_Routine_DiagnServi_TABROW_NewRoutiBasicSetti_Start_Routine_ResDataTypeElement: array-size=1, array-size-semantics=FIXED-SIZE, implementation-data-type=Dcm_StartDataOut_Routine_DiagnServi_TABROW_NewRoutiBasicSetti_Start_Routine_ResDataArrayType
    Dcm_StopDataOut_Routine_DiagnServi_TABROW_NewRoutiBasicSetti_Start_Routine_ResDataArrayType: implementation-data-type=uint8
    Dcm_StopDataOut_Routine_DiagnServi_TABROW_NewRoutiBasicSetti_Start_Routine_ResDataType: category=ARRAY, sw-calibration-access=READ-ONLY
      element Dcm_StopDataOut_Routine_DiagnServi_TABROW_NewRoutiBasicSetti_Start_Routine_ResDataTypeElement: array-size=1, array-size-semantics=FIXED-SIZE, implementation-data-type=Dcm_StopDataOut_Routine_DiagnServi_TABROW_NewRoutiBasicSetti_Start_Routine_ResDataArrayType
    Dcm_RequestDataOut_Routine_DiagnServi_TABROW_NewRoutiBasicSetti_Start_Routine_ResDataArrayType: implementation-data-type=uint8
    Dcm_RequestDataOut_Routine_DiagnServi_TABROW_NewRoutiBasicSetti_Start_Routine_ResDataType: category=ARRAY, sw-calibration-access=READ-ONLY
      element Dcm_RequestDataOut_Routine_DiagnServi_TABROW_NewRoutiBasicSetti_Start_Routine_ResDataTypeElement: array-size=1, array-size-semantics=FIXED-SIZE, implementation-data-type=Dcm_RequestDataOut_Routine_DiagnServi_TABROW_NewRoutiBasicSetti_Start_Routine_ResDataArrayType
    Dcm_SecLevelType: compu {0=DCM_SEC_LEV_LOCKED, 1=DCM_SEC_LEV_L1, 2=DCM_SEC_LEV_L2}, range raw 0..2, implementation-data-type=uint8
    Dcm_Data150ByteType: category=ARRAY, sw-calibration-access=READ-ONLY
      element Dcm_Data150ByteTypeElement: array-size=150, array-size-semantics=FIXED-SIZE, implementation-data-type=uint8
package /MICROSAR/Dcm_swc/Interfaces
  mode switch interface DcmControlDtcSetting: is-service=true, service-kind=DIAGNOSTIC-COMMUNICATION-MANAGER
    mode group DcmControlDtcSetting: type=DcmControlDtcSetting
  mode switch interface DcmEcuReset: is-service=true, service-kind=DIAGNOSTIC-COMMUNICATION-MANAGER
    mode group DcmEcuReset: type=DcmEcuReset
  mode switch interface DcmDiagnosticSessionControl: is-service=true, service-kind=DIAGNOSTIC-COMMUNICATION-MANAGER
    mode group DcmDiagnosticSessionControl: type=DcmDiagnosticSessionControl
  client server interface DCMServices: is-service=true, service-kind=DIAGNOSTIC-COMMUNICATION-MANAGER
    6 x operation:
      GetActiveProtocol: possible-error=E_OK
        arg ActiveProtocol: type=Dcm_ProtocolType, direction=OUT
      GetSesCtrlType: possible-error=E_OK
        arg SesCtrlType: type=Dcm_SesCtrlType, direction=OUT
      ResetToDefaultSession: possible-error=E_OK
      SetActiveDiagnostic: possible-error=E_OK
        arg active: type=boolean, direction=IN
      GetRequestKind: possible-error=DCMServices/E_NOT_OK
        arg TesterSourceAddress: type=uint16, direction=IN
        arg RequestKind: type=Dcm_RequestKindType, direction=OUT
      GetSecurityLevel: possible-error=E_OK
        arg SecLevel: type=Dcm_SecLevelType, direction=OUT
    error E_OK: error-code=0
    error E_NOT_OK: error-code=1
  client server interface DataServices_Data_DID_StartApplication: is-service=true, service-kind=DIAGNOSTIC-COMMUNICATION-MANAGER
    operation ReadData: possible-error=DataServices_Data_DID_StartApplication/E_NOT_OK
      arg Data: type=Dcm_Data2ByteType, direction=OUT
    operation ConditionCheckRead: possible-error=DataServices_Data_DID_StartApplication/E_NOT_OK
      arg ErrorCode: type=Dcm_NegativeResponseCodeType, direction=OUT
    operation WriteData: possible-error=DataServices_Data_DID_StartApplication/E_NOT_OK
      arg Data: type=Dcm_Data2ByteType, direction=IN
      arg ErrorCode: type=Dcm_NegativeResponseCodeType, direction=OUT
    error E_NOT_OK: error-code=1
  mode switch interface DcmCommunicationControl_ComMConf_ComMChannel_CN_BMC_CAN01_78a85e89: is-service=true, service-kind=DIAGNOSTIC-COMMUNICATION-MANAGER
    mode group DcmCommunicationControl_ComMConf_ComMChannel_CN_BMC_CAN01_78a85e89: type=DcmCommunicationControl
  mode switch interface DcmCommunicationControl_ComMConf_ComMChannel_CN_HCP5_CANFD01_54d90215: is-service=true, service-kind=DIAGNOSTIC-COMMUNICATION-MANAGER
    mode group DcmCommunicationControl_ComMConf_ComMChannel_CN_HCP5_CANFD01_54d90215: type=DcmCommunicationControl
  378 x client server interface, all with is-service=true, service-kind=DIAGNOSTIC-COMMUNICATION-MANAGER:
    RoutineServices_Routine_DiagnServi_RoutiContrCheckProgrPreco
      operation Start: possible-error=[RoutineServices_Routine_DiagnServi_RoutiContrCheckProgrPreco/E_NOT_OK, RoutineServices_Routine_DiagnServi_RoutiContrCheckProgrPreco/DCM_E_PENDING, RoutineServices_Routine_DiagnServi_RoutiContrCheckProgrPreco/DCM_E_FORCE_RCRRP]
        4 x arg:
          OpStatus: type=Dcm_OpStatusType, direction=IN
          ResData: type=Dcm_StartFlexibleOutArrayData_Routine_DiagnServi_RoutiContrCheckProgrPreco_ResDataType, direction=OUT
          DataLength: type=uint16, direction=OUT
          ErrorCode: type=Dcm_NegativeResponseCodeType, direction=OUT
      error E_NOT_OK: error-code=1
      error DCM_E_PENDING: error-code=10
      error DCM_E_FORCE_RCRRP: error-code=12
    RoutineServices_Routine_DiagnServi_TABROW_CalcuIntegValidData_Start_Routine
      operation Start: possible-error=[RoutineServices_Routine_DiagnServi_TABROW_CalcuIntegValidData_Start_Routine/E_NOT_OK, RoutineServices_Routine_DiagnServi_TABROW_CalcuIntegValidData_Start_Routine/DCM_E_PENDING, RoutineServices_Routine_DiagnServi_TABROW_CalcuIntegValidData_Start_Routine/DCM_E_FORCE_RCRRP]
        6 x arg:
          Type_of_calculation: type=Dcm_StartDataIn_Routine_DiagnServi_TABROW_CalcuIntegValidData_Start_Routine_Type_of_calculationType, direction=IN
          Type_of_hash_value: type=Dcm_StartDataIn_Routine_DiagnServi_TABROW_CalcuIntegValidData_Start_Routine_Type_of_hash_valueType, direction=IN
          OpStatus: type=Dcm_OpStatusType, direction=IN
          ResData: type=Dcm_StartFlexibleOutArrayData_Routine_DiagnServi_TABROW_CalcuIntegValidData_Start_Routine_ResDataType, direction=OUT
          DataLength: type=uint16, direction=OUT
          ErrorCode: type=Dcm_NegativeResponseCodeType, direction=OUT
      error E_NOT_OK: error-code=1
      error DCM_E_PENDING: error-code=10
      error DCM_E_FORCE_RCRRP: error-code=12
    RoutineServices_Routine_DiagnServi_TABROW_CalcuIndivHashValue_Start_Routine
      operation Start: possible-error=[RoutineServices_Routine_DiagnServi_TABROW_CalcuIndivHashValue_Start_Routine/E_NOT_OK, RoutineServices_Routine_DiagnServi_TABROW_CalcuIndivHashValue_Start_Routine/DCM_E_PENDING, RoutineServices_Routine_DiagnServi_TABROW_CalcuIndivHashValue_Start_Routine/DCM_E_FORCE_RCRRP]
        7 x arg:
          Type_of_hash_value: type=Dcm_StartDataIn_Routine_DiagnServi_TABROW_CalcuIndivHashValue_Start_Routine_Type_of_hash_valueType, direction=IN
          Type_of_hash: type=Dcm_StartDataIn_Routine_DiagnServi_TABROW_CalcuIndivHashValue_Start_Routine_Type_of_hashType, direction=IN
          Individual_hash_value_id: type=Dcm_StartDataIn_Routine_DiagnServi_TABROW_CalcuIndivHashValue_Start_Routine_Individual_hash_value_idType, direction=IN
          OpStatus: type=Dcm_OpStatusType, direction=IN
          ResData: type=Dcm_StartFlexibleOutArrayData_Routine_DiagnServi_TABROW_CalcuIndivHashValue_Start_Routine_ResDataType, direction=OUT
          DataLength: type=uint16, direction=OUT
          ErrorCode: type=Dcm_NegativeResponseCodeType, direction=OUT
      error E_NOT_OK: error-code=1
      error DCM_E_PENDING: error-code=10
      error DCM_E_FORCE_RCRRP: error-code=12
    RoutineServices_Routine_DiagnServi_TABROW_CalcuModulHashValue_Start_Routine_COP
      operation Start: possible-error=[RoutineServices_Routine_DiagnServi_TABROW_CalcuModulHashValue_Start_Routine_COP/E_NOT_OK, RoutineServices_Routine_DiagnServi_TABROW_CalcuModulHashValue_Start_Routine_COP/DCM_E_PENDING, RoutineServices_Routine_DiagnServi_TABROW_CalcuModulHashValue_Start_Routine_COP/DCM_E_FORCE_RCRRP]
        4 x arg:
          ReqData: type=Dcm_StartDataIn_Routine_DiagnServi_TABROW_CalcuModulHashValue_Start_Routine_COP_ReqDataType, direction=IN
          OpStatus: type=Dcm_OpStatusType, direction=IN
          ResData: type=Dcm_StartDataOut_Routine_DiagnServi_TABROW_CalcuModulHashValue_Start_Routine_COP_ResDataType, direction=OUT
          ErrorCode: type=Dcm_NegativeResponseCodeType, direction=OUT
      operation Stop: possible-error=[RoutineServices_Routine_DiagnServi_TABROW_CalcuModulHashValue_Start_Routine_COP/E_NOT_OK, RoutineServices_Routine_DiagnServi_TABROW_CalcuModulHashValue_Start_Routine_COP/DCM_E_PENDING, RoutineServices_Routine_DiagnServi_TABROW_CalcuModulHashValue_Start_Routine_COP/DCM_E_FORCE_RCRRP]
        arg OpStatus: type=Dcm_OpStatusType, direction=IN
        arg ResData: type=Dcm_StopDataOut_Routine_DiagnServi_TABROW_CalcuModulHashValue_Start_Routine_COP_ResDataType, direction=OUT
        arg ErrorCode: type=Dcm_NegativeResponseCodeType, direction=OUT
      operation RequestResults: possible-error=[RoutineServices_Routine_DiagnServi_TABROW_CalcuModulHashValue_Start_Routine_COP/E_NOT_OK, RoutineServices_Routine_DiagnServi_TABROW_CalcuModulHashValue_Start_Routine_COP/DCM_E_PENDING, RoutineServices_Routine_DiagnServi_TABROW_CalcuModulHashValue_Start_Routine_COP/DCM_E_FORCE_RCRRP]
        4 x arg:
          OpStatus: type=Dcm_OpStatusType, direction=IN
          ResData: type=Dcm_RequestFlexibleOutArrayData_Routine_DiagnServi_TABROW_CalcuModulHashValue_Start_Routine_COP_ResDataType, direction=OUT
          DataLength: type=uint16, direction=OUT
          ErrorCode: type=Dcm_NegativeResponseCodeType, direction=OUT
      error E_NOT_OK: error-code=1
      error DCM_E_PENDING: error-code=10
      error DCM_E_FORCE_RCRRP: error-code=12
    RoutineServices_Routine_DiagnServi_TABROW_IsolaMeasuDeactMode_Start_Routine
      operation Start: possible-error=[RoutineServices_Routine_DiagnServi_TABROW_IsolaMeasuDeactMode_Start_Routine/E_NOT_OK, RoutineServices_Routine_DiagnServi_TABROW_IsolaMeasuDeactMode_Start_Routine/DCM_E_PENDING, RoutineServices_Routine_DiagnServi_TABROW_IsolaMeasuDeactMode_Start_Routine/DCM_E_FORCE_RCRRP]
        4 x arg:
          ReqData: type=Dcm_StartDataIn_Routine_DiagnServi_TABROW_IsolaMeasuDeactMode_Start_Routine_ReqDataType, direction=IN
          OpStatus: type=Dcm_OpStatusType, direction=IN
          ResData: type=Dcm_StartDataOut_Routine_DiagnServi_TABROW_IsolaMeasuDeactMode_Start_Routine_ResDataType, direction=OUT
          ErrorCode: type=Dcm_NegativeResponseCodeType, direction=OUT
      operation Stop: possible-error=[RoutineServices_Routine_DiagnServi_TABROW_IsolaMeasuDeactMode_Start_Routine/E_NOT_OK, RoutineServices_Routine_DiagnServi_TABROW_IsolaMeasuDeactMode_Start_Routine/DCM_E_PENDING, RoutineServices_Routine_DiagnServi_TABROW_IsolaMeasuDeactMode_Start_Routine/DCM_E_FORCE_RCRRP]
        arg OpStatus: type=Dcm_OpStatusType, direction=IN
        arg ResData: type=Dcm_StopDataOut_Routine_DiagnServi_TABROW_IsolaMeasuDeactMode_Start_Routine_ResDataType, direction=OUT
        arg ErrorCode: type=Dcm_NegativeResponseCodeType, direction=OUT
      operation RequestResults: possible-error=[RoutineServices_Routine_DiagnServi_TABROW_IsolaMeasuDeactMode_Start_Routine/E_NOT_OK, RoutineServices_Routine_DiagnServi_TABROW_IsolaMeasuDeactMode_Start_Routine/DCM_E_PENDING, RoutineServices_Routine_DiagnServi_TABROW_IsolaMeasuDeactMode_Start_Routine/DCM_E_FORCE_RCRRP]
        arg OpStatus: type=Dcm_OpStatusType, direction=IN
        arg ResData: type=Dcm_RequestDataOut_Routine_DiagnServi_TABROW_IsolaMeasuDeactMode_Start_Routine_ResDataType, direction=OUT
        arg ErrorCode: type=Dcm_NegativeResponseCodeType, direction=OUT
      error E_NOT_OK: error-code=1
      error DCM_E_PENDING: error-code=10
      error DCM_E_FORCE_RCRRP: error-code=12
    RoutineServices_Routine_DiagnServi_TABROW_ResetOfContaError_Start_Routine
      operation Start: possible-error=[RoutineServices_Routine_DiagnServi_TABROW_ResetOfContaError_Start_Routine/E_NOT_OK, RoutineServices_Routine_DiagnServi_TABROW_ResetOfContaError_Start_Routine/DCM_E_PENDING, RoutineServices_Routine_DiagnServi_TABROW_ResetOfContaError_Start_Routine/DCM_E_FORCE_RCRRP]
        arg OpStatus: type=Dcm_OpStatusType, direction=IN
        arg ResData: type=Dcm_StartDataOut_Routine_DiagnServi_TABROW_ResetOfContaError_Start_Routine_ResDataType, direction=OUT
        arg ErrorCode: type=Dcm_NegativeResponseCodeType, direction=OUT
      operation Stop: possible-error=[RoutineServices_Routine_DiagnServi_TABROW_ResetOfContaError_Start_Routine/E_NOT_OK, RoutineServices_Routine_DiagnServi_TABROW_ResetOfContaError_Start_Routine/DCM_E_PENDING, RoutineServices_Routine_DiagnServi_TABROW_ResetOfContaError_Start_Routine/DCM_E_FORCE_RCRRP]
        arg OpStatus: type=Dcm_OpStatusType, direction=IN
        arg ResData: type=Dcm_StopDataOut_Routine_DiagnServi_TABROW_ResetOfContaError_Start_Routine_ResDataType, direction=OUT
        arg ErrorCode: type=Dcm_NegativeResponseCodeType, direction=OUT
      operation RequestResults: possible-error=[RoutineServices_Routine_DiagnServi_TABROW_ResetOfContaError_Start_Routine/E_NOT_OK, RoutineServices_Routine_DiagnServi_TABROW_ResetOfContaError_Start_Routine/DCM_E_PENDING, RoutineServices_Routine_DiagnServi_TABROW_ResetOfContaError_Start_Routine/DCM_E_FORCE_RCRRP]
        arg OpStatus: type=Dcm_OpStatusType, direction=IN
        arg ResData: type=Dcm_RequestDataOut_Routine_DiagnServi_TABROW_ResetOfContaError_Start_Routine_ResDataType, direction=OUT
        arg ErrorCode: type=Dcm_NegativeResponseCodeType, direction=OUT
      error E_NOT_OK: error-code=1
      error DCM_E_PENDING: error-code=10
      error DCM_E_FORCE_RCRRP: error-code=12
    RoutineServices_Routine_DiagnServi_TABROW_AdaptOfVoltaMeasuChann_Start_Routine
      operation Start: possible-error=[RoutineServices_Routine_DiagnServi_TABROW_AdaptOfVoltaMeasuChann_Start_Routine/E_NOT_OK, RoutineServices_Routine_DiagnServi_TABROW_AdaptOfVoltaMeasuChann_Start_Routine/DCM_E_PENDING, RoutineServices_Routine_DiagnServi_TABROW_AdaptOfVoltaMeasuChann_Start_Routine/DCM_E_FORCE_RCRRP]
        4 x arg:
          ReqData: type=Dcm_StartDataIn_Routine_DiagnServi_TABROW_AdaptOfVoltaMeasuChann_Start_Routine_ReqDataType, direction=IN
          OpStatus: type=Dcm_OpStatusType, direction=IN
          ResData: type=Dcm_StartDataOut_Routine_DiagnServi_TABROW_AdaptOfVoltaMeasuChann_Start_Routine_ResDataType, direction=OUT
          ErrorCode: type=Dcm_NegativeResponseCodeType, direction=OUT
      operation Stop: possible-error=[RoutineServices_Routine_DiagnServi_TABROW_AdaptOfVoltaMeasuChann_Start_Routine/E_NOT_OK, RoutineServices_Routine_DiagnServi_TABROW_AdaptOfVoltaMeasuChann_Start_Routine/DCM_E_PENDING, RoutineServices_Routine_DiagnServi_TABROW_AdaptOfVoltaMeasuChann_Start_Routine/DCM_E_FORCE_RCRRP]
        arg OpStatus: type=Dcm_OpStatusType, direction=IN
        arg ResData: type=Dcm_StopDataOut_Routine_DiagnServi_TABROW_AdaptOfVoltaMeasuChann_Start_Routine_ResDataType, direction=OUT
        arg ErrorCode: type=Dcm_NegativeResponseCodeType, direction=OUT
      operation RequestResults: possible-error=[RoutineServices_Routine_DiagnServi_TABROW_AdaptOfVoltaMeasuChann_Start_Routine/E_NOT_OK, RoutineServices_Routine_DiagnServi_TABROW_AdaptOfVoltaMeasuChann_Start_Routine/DCM_E_PENDING, RoutineServices_Routine_DiagnServi_TABROW_AdaptOfVoltaMeasuChann_Start_Routine/DCM_E_FORCE_RCRRP]
        arg OpStatus: type=Dcm_OpStatusType, direction=IN
        arg ResData: type=Dcm_RequestDataOut_Routine_DiagnServi_TABROW_AdaptOfVoltaMeasuChann_Start_Routine_ResDataType, direction=OUT
        arg ErrorCode: type=Dcm_NegativeResponseCodeType, direction=OUT
      error E_NOT_OK: error-code=1
      error DCM_E_PENDING: error-code=10
      error DCM_E_FORCE_RCRRP: error-code=12
    RoutineServices_Routine_DiagnServi_TABROW_NeuRoutiBasicSetti_Start_Routine_1
      operation Start: possible-error=[RoutineServices_Routine_DiagnServi_TABROW_NeuRoutiBasicSetti_Start_Routine_1/E_NOT_OK, RoutineServices_Routine_DiagnServi_TABROW_NeuRoutiBasicSetti_Start_Routine_1/DCM_E_PENDING, RoutineServices_Routine_DiagnServi_TABROW_NeuRoutiBasicSetti_Start_Routine_1/DCM_E_FORCE_RCRRP]
        arg OpStatus: type=Dcm_OpStatusType, direction=IN
        arg ResData: type=Dcm_StartDataOut_Routine_DiagnServi_TABROW_NeuRoutiBasicSetti_Start_Routine_1_ResDataType, direction=OUT
        arg ErrorCode: type=Dcm_NegativeResponseCodeType, direction=OUT
      operation Stop: possible-error=[RoutineServices_Routine_DiagnServi_TABROW_NeuRoutiBasicSetti_Start_Routine_1/E_NOT_OK, RoutineServices_Routine_DiagnServi_TABROW_NeuRoutiBasicSetti_Start_Routine_1/DCM_E_PENDING, RoutineServices_Routine_DiagnServi_TABROW_NeuRoutiBasicSetti_Start_Routine_1/DCM_E_FORCE_RCRRP]
        arg OpStatus: type=Dcm_OpStatusType, direction=IN
        arg ResData: type=Dcm_StopDataOut_Routine_DiagnServi_TABROW_NeuRoutiBasicSetti_Start_Routine_1_ResDataType, direction=OUT
        arg ErrorCode: type=Dcm_NegativeResponseCodeType, direction=OUT
      operation RequestResults: possible-error=[RoutineServices_Routine_DiagnServi_TABROW_NeuRoutiBasicSetti_Start_Routine_1/E_NOT_OK, RoutineServices_Routine_DiagnServi_TABROW_NeuRoutiBasicSetti_Start_Routine_1/DCM_E_PENDING, RoutineServices_Routine_DiagnServi_TABROW_NeuRoutiBasicSetti_Start_Routine_1/DCM_E_FORCE_RCRRP]
        arg OpStatus: type=Dcm_OpStatusType, direction=IN
        arg ResData: type=Dcm_RequestDataOut_Routine_DiagnServi_TABROW_NeuRoutiBasicSetti_Start_Routine_1_ResDataType, direction=OUT
        arg ErrorCode: type=Dcm_NegativeResponseCodeType, direction=OUT
      error E_NOT_OK: error-code=1
      error DCM_E_PENDING: error-code=10
      error DCM_E_FORCE_RCRRP: error-code=12
    RoutineServices_Routine_DiagnServi_TABROW_NeuRoutiBasicSetti_Start_Routine_3
      operation Start: possible-error=[RoutineServices_Routine_DiagnServi_TABROW_NeuRoutiBasicSetti_Start_Routine_3/E_NOT_OK, RoutineServices_Routine_DiagnServi_TABROW_NeuRoutiBasicSetti_Start_Routine_3/DCM_E_PENDING, RoutineServices_Routine_DiagnServi_TABROW_NeuRoutiBasicSetti_Start_Routine_3/DCM_E_FORCE_RCRRP]
        arg OpStatus: type=Dcm_OpStatusType, direction=IN
        arg ResData: type=Dcm_StartDataOut_Routine_DiagnServi_TABROW_NeuRoutiBasicSetti_Start_Routine_3_ResDataType, direction=OUT
        arg ErrorCode: type=Dcm_NegativeResponseCodeType, direction=OUT
      operation Stop: possible-error=[RoutineServices_Routine_DiagnServi_TABROW_NeuRoutiBasicSetti_Start_Routine_3/E_NOT_OK, RoutineServices_Routine_DiagnServi_TABROW_NeuRoutiBasicSetti_Start_Routine_3/DCM_E_PENDING, RoutineServices_Routine_DiagnServi_TABROW_NeuRoutiBasicSetti_Start_Routine_3/DCM_E_FORCE_RCRRP]
        arg OpStatus: type=Dcm_OpStatusType, direction=IN
        arg ResData: type=Dcm_StopDataOut_Routine_DiagnServi_TABROW_NeuRoutiBasicSetti_Start_Routine_3_ResDataType, direction=OUT
        arg ErrorCode: type=Dcm_NegativeResponseCodeType, direction=OUT
      operation RequestResults: possible-error=[RoutineServices_Routine_DiagnServi_TABROW_NeuRoutiBasicSetti_Start_Routine_3/E_NOT_OK, RoutineServices_Routine_DiagnServi_TABROW_NeuRoutiBasicSetti_Start_Routine_3/DCM_E_PENDING, RoutineServices_Routine_DiagnServi_TABROW_NeuRoutiBasicSetti_Start_Routine_3/DCM_E_FORCE_RCRRP]
        arg OpStatus: type=Dcm_OpStatusType, direction=IN
        arg ResData: type=Dcm_RequestDataOut_Routine_DiagnServi_TABROW_NeuRoutiBasicSetti_Start_Routine_3_ResDataType, direction=OUT
        arg ErrorCode: type=Dcm_NegativeResponseCodeType, direction=OUT
      error E_NOT_OK: error-code=1
      error DCM_E_PENDING: error-code=10
      error DCM_E_FORCE_RCRRP: error-code=12
    RoutineServices_Routine_DiagnServi_TABROW_NeuRoutiBasicSetti_Start_Routine_2
      operation Start: possible-error=[RoutineServices_Routine_DiagnServi_TABROW_NeuRoutiBasicSetti_Start_Routine_2/E_NOT_OK, RoutineServices_Routine_DiagnServi_TABROW_NeuRoutiBasicSetti_Start_Routine_2/DCM_E_PENDING, RoutineServices_Routine_DiagnServi_TABROW_NeuRoutiBasicSetti_Start_Routine_2/DCM_E_FORCE_RCRRP]
        arg OpStatus: type=Dcm_OpStatusType, direction=IN
        arg ResData: type=Dcm_StartDataOut_Routine_DiagnServi_TABROW_NeuRoutiBasicSetti_Start_Routine_2_ResDataType, direction=OUT
        arg ErrorCode: type=Dcm_NegativeResponseCodeType, direction=OUT
      operation Stop: possible-error=[RoutineServices_Routine_DiagnServi_TABROW_NeuRoutiBasicSetti_Start_Routine_2/E_NOT_OK, RoutineServices_Routine_DiagnServi_TABROW_NeuRoutiBasicSetti_Start_Routine_2/DCM_E_PENDING, RoutineServices_Routine_DiagnServi_TABROW_NeuRoutiBasicSetti_Start_Routine_2/DCM_E_FORCE_RCRRP]
        arg OpStatus: type=Dcm_OpStatusType, direction=IN
        arg ResData: type=Dcm_StopDataOut_Routine_DiagnServi_TABROW_NeuRoutiBasicSetti_Start_Routine_2_ResDataType, direction=OUT
        arg ErrorCode: type=Dcm_NegativeResponseCodeType, direction=OUT
      operation RequestResults: possible-error=[RoutineServices_Routine_DiagnServi_TABROW_NeuRoutiBasicSetti_Start_Routine_2/E_NOT_OK, RoutineServices_Routine_DiagnServi_TABROW_NeuRoutiBasicSetti_Start_Routine_2/DCM_E_PENDING, RoutineServices_Routine_DiagnServi_TABROW_NeuRoutiBasicSetti_Start_Routine_2/DCM_E_FORCE_RCRRP]
        arg OpStatus: type=Dcm_OpStatusType, direction=IN
        arg ResData: type=Dcm_RequestDataOut_Routine_DiagnServi_TABROW_NeuRoutiBasicSetti_Start_Routine_2_ResDataType, direction=OUT
        arg ErrorCode: type=Dcm_NegativeResponseCodeType, direction=OUT
      error E_NOT_OK: error-code=1
      error DCM_E_PENDING: error-code=10
      error DCM_E_FORCE_RCRRP: error-code=12
    RoutineServices_Routine_DiagnServi_TABROW_ResetOfModulParam_Start_Routine
      operation Start: possible-error=[RoutineServices_Routine_DiagnServi_TABROW_ResetOfModulParam_Start_Routine/E_NOT_OK, RoutineServices_Routine_DiagnServi_TABROW_ResetOfModulParam_Start_Routine/DCM_E_PENDING, RoutineServices_Routine_DiagnServi_TABROW_ResetOfModulParam_Start_Routine/DCM_E_FORCE_RCRRP]
        4 x arg:
          ReqData: type=Dcm_StartDataIn_Routine_DiagnServi_TABROW_ResetOfModulParam_Start_Routine_ReqDataType, direction=IN
          OpStatus: type=Dcm_OpStatusType, direction=IN
          ResData: type=Dcm_StartDataOut_Routine_DiagnServi_TABROW_ResetOfModulParam_Start_Routine_ResDataType, direction=OUT
          ErrorCode: type=Dcm_NegativeResponseCodeType, direction=OUT
      operation Stop: possible-error=[RoutineServices_Routine_DiagnServi_TABROW_ResetOfModulParam_Start_Routine/E_NOT_OK, RoutineServices_Routine_DiagnServi_TABROW_ResetOfModulParam_Start_Routine/DCM_E_PENDING, RoutineServices_Routine_DiagnServi_TABROW_ResetOfModulParam_Start_Routine/DCM_E_FORCE_RCRRP]
        arg OpStatus: type=Dcm_OpStatusType, direction=IN
        arg ResData: type=Dcm_StopDataOut_Routine_DiagnServi_TABROW_ResetOfModulParam_Start_Routine_ResDataType, direction=OUT
        arg ErrorCode: type=Dcm_NegativeResponseCodeType, direction=OUT
      operation RequestResults: possible-error=[RoutineServices_Routine_DiagnServi_TABROW_ResetOfModulParam_Start_Routine/E_NOT_OK, RoutineServices_Routine_DiagnServi_TABROW_ResetOfModulParam_Start_Routine/DCM_E_PENDING, RoutineServices_Routine_DiagnServi_TABROW_ResetOfModulParam_Start_Routine/DCM_E_FORCE_RCRRP]
        arg OpStatus: type=Dcm_OpStatusType, direction=IN
        arg ResData: type=Dcm_RequestDataOut_Routine_DiagnServi_TABROW_ResetOfModulParam_Start_Routine_ResDataType, direction=OUT
        arg ErrorCode: type=Dcm_NegativeResponseCodeType, direction=OUT
      error E_NOT_OK: error-code=1
      error DCM_E_PENDING: error-code=10
      error DCM_E_FORCE_RCRRP: error-code=12
    RoutineServices_Routine_DiagnServi_TABROW_NeuRoutiBasicSetti_Start_Routine
      operation Start: possible-error=[RoutineServices_Routine_DiagnServi_TABROW_NeuRoutiBasicSetti_Start_Routine/E_NOT_OK, RoutineServices_Routine_DiagnServi_TABROW_NeuRoutiBasicSetti_Start_Routine/DCM_E_PENDING, RoutineServices_Routine_DiagnServi_TABROW_NeuRoutiBasicSetti_Start_Routine/DCM_E_FORCE_RCRRP]
        4 x arg:
          ReqData: type=Dcm_StartDataIn_Routine_DiagnServi_TABROW_NeuRoutiBasicSetti_Start_Routine_ReqDataType, direction=IN
          OpStatus: type=Dcm_OpStatusType, direction=IN
          ResData: type=Dcm_StartDataOut_Routine_DiagnServi_TABROW_NeuRoutiBasicSetti_Start_Routine_ResDataType, direction=OUT
          ErrorCode: type=Dcm_NegativeResponseCodeType, direction=OUT
      operation Stop: possible-error=[RoutineServices_Routine_DiagnServi_TABROW_NeuRoutiBasicSetti_Start_Routine/E_NOT_OK, RoutineServices_Routine_DiagnServi_TABROW_NeuRoutiBasicSetti_Start_Routine/DCM_E_PENDING, RoutineServices_Routine_DiagnServi_TABROW_NeuRoutiBasicSetti_Start_Routine/DCM_E_FORCE_RCRRP]
        arg OpStatus: type=Dcm_OpStatusType, direction=IN
        arg ResData: type=Dcm_StopDataOut_Routine_DiagnServi_TABROW_NeuRoutiBasicSetti_Start_Routine_ResDataType, direction=OUT
        arg ErrorCode: type=Dcm_NegativeResponseCodeType, direction=OUT
      operation RequestResults: possible-error=[RoutineServices_Routine_DiagnServi_TABROW_NeuRoutiBasicSetti_Start_Routine/E_NOT_OK, RoutineServices_Routine_DiagnServi_TABROW_NeuRoutiBasicSetti_Start_Routine/DCM_E_PENDING, RoutineServices_Routine_DiagnServi_TABROW_NeuRoutiBasicSetti_Start_Routine/DCM_E_FORCE_RCRRP]
        arg OpStatus: type=Dcm_OpStatusType, direction=IN
        arg ResData: type=Dcm_RequestDataOut_Routine_DiagnServi_TABROW_NeuRoutiBasicSetti_Start_Routine_ResDataType, direction=OUT
        arg ErrorCode: type=Dcm_NegativeResponseCodeType, direction=OUT
      error E_NOT_OK: error-code=1
      error DCM_E_PENDING: error-code=10
      error DCM_E_FORCE_RCRRP: error-code=12
    RoutineServices_Routine_DiagnServi_TABROW_NeuRoutiBasicSetti_Start_Routine_4
      operation Start: possible-error=[RoutineServices_Routine_DiagnServi_TABROW_NeuRoutiBasicSetti_Start_Routine_4/E_NOT_OK, RoutineServices_Routine_DiagnServi_TABROW_NeuRoutiBasicSetti_Start_Routine_4/DCM_E_PENDING, RoutineServices_Routine_DiagnServi_TABROW_NeuRoutiBasicSetti_Start_Routine_4/DCM_E_FORCE_RCRRP]
        arg OpStatus: type=Dcm_OpStatusType, direction=IN
        arg ResData: type=Dcm_StartDataOut_Routine_DiagnServi_TABROW_NeuRoutiBasicSetti_Start_Routine_4_ResDataType, direction=OUT
        arg ErrorCode: type=Dcm_NegativeResponseCodeType, direction=OUT
      operation Stop: possible-error=[RoutineServices_Routine_DiagnServi_TABROW_NeuRoutiBasicSetti_Start_Routine_4/E_NOT_OK, RoutineServices_Routine_DiagnServi_TABROW_NeuRoutiBasicSetti_Start_Routine_4/DCM_E_PENDING, RoutineServices_Routine_DiagnServi_TABROW_NeuRoutiBasicSetti_Start_Routine_4/DCM_E_FORCE_RCRRP]
        arg OpStatus: type=Dcm_OpStatusType, direction=IN
        arg ResData: type=Dcm_StopDataOut_Routine_DiagnServi_TABROW_NeuRoutiBasicSetti_Start_Routine_4_ResDataType, direction=OUT
        arg ErrorCode: type=Dcm_NegativeResponseCodeType, direction=OUT
      operation RequestResults: possible-error=[RoutineServices_Routine_DiagnServi_TABROW_NeuRoutiBasicSetti_Start_Routine_4/E_NOT_OK, RoutineServices_Routine_DiagnServi_TABROW_NeuRoutiBasicSetti_Start_Routine_4/DCM_E_PENDING, RoutineServices_Routine_DiagnServi_TABROW_NeuRoutiBasicSetti_Start_Routine_4/DCM_E_FORCE_RCRRP]
        arg OpStatus: type=Dcm_OpStatusType, direction=IN
        arg ResData: type=Dcm_RequestDataOut_Routine_DiagnServi_TABROW_NeuRoutiBasicSetti_Start_Routine_4_ResDataType, direction=OUT
        arg ErrorCode: type=Dcm_NegativeResponseCodeType, direction=OUT
      error E_NOT_OK: error-code=1
      error DCM_E_PENDING: error-code=10
      error DCM_E_FORCE_RCRRP: error-code=12
    RoutineServices_Routine_DiagnServi_TABROW_NeuRoutiImmedResul_Start_Routine
      operation Start: possible-error=[RoutineServices_Routine_DiagnServi_TABROW_NeuRoutiImmedResul_Start_Routine/E_NOT_OK, RoutineServices_Routine_DiagnServi_TABROW_NeuRoutiImmedResul_Start_Routine/DCM_E_PENDING, RoutineServices_Routine_DiagnServi_TABROW_NeuRoutiImmedResul_Start_Routine/DCM_E_FORCE_RCRRP]
        4 x arg:
          ReqData: type=Dcm_StartDataIn_Routine_DiagnServi_TABROW_NeuRoutiImmedResul_Start_Routine_ReqDataType, direction=IN
          OpStatus: type=Dcm_OpStatusType, direction=IN
          ResData: type=Dcm_StartDataOut_Routine_DiagnServi_TABROW_NeuRoutiImmedResul_Start_Routine_ResDataType, direction=OUT
          ErrorCode: type=Dcm_NegativeResponseCodeType, direction=OUT
      error E_NOT_OK: error-code=1
      error DCM_E_PENDING: error-code=10
      error DCM_E_FORCE_RCRRP: error-code=12
    RoutineServices_Routine_DiagnServi_TABROW_NeuRoutiBasicSetti_Start_Routine_5
      operation Start: possible-error=[RoutineServices_Routine_DiagnServi_TABROW_NeuRoutiBasicSetti_Start_Routine_5/E_NOT_OK, RoutineServices_Routine_DiagnServi_TABROW_NeuRoutiBasicSetti_Start_Routine_5/DCM_E_PENDING, RoutineServices_Routine_DiagnServi_TABROW_NeuRoutiBasicSetti_Start_Routine_5/DCM_E_FORCE_RCRRP]
        arg OpStatus: type=Dcm_OpStatusType, direction=IN
        arg ResData: type=Dcm_StartDataOut_Routine_DiagnServi_TABROW_NeuRoutiBasicSetti_Start_Routine_5_ResDataType, direction=OUT
        arg ErrorCode: type=Dcm_NegativeResponseCodeType, direction=OUT
      operation Stop: possible-error=[RoutineServices_Routine_DiagnServi_TABROW_NeuRoutiBasicSetti_Start_Routine_5/E_NOT_OK, RoutineServices_Routine_DiagnServi_TABROW_NeuRoutiBasicSetti_Start_Routine_5/DCM_E_PENDING, RoutineServices_Routine_DiagnServi_TABROW_NeuRoutiBasicSetti_Start_Routine_5/DCM_E_FORCE_RCRRP]
        arg OpStatus: type=Dcm_OpStatusType, direction=IN
        arg ResData: type=Dcm_StopDataOut_Routine_DiagnServi_TABROW_NeuRoutiBasicSetti_Start_Routine_5_ResDataType, direction=OUT
        arg ErrorCode: type=Dcm_NegativeResponseCodeType, direction=OUT
      operation RequestResults: possible-error=[RoutineServices_Routine_DiagnServi_TABROW_NeuRoutiBasicSetti_Start_Routine_5/E_NOT_OK, RoutineServices_Routine_DiagnServi_TABROW_NeuRoutiBasicSetti_Start_Routine_5/DCM_E_PENDING, RoutineServices_Routine_DiagnServi_TABROW_NeuRoutiBasicSetti_Start_Routine_5/DCM_E_FORCE_RCRRP]
        arg OpStatus: type=Dcm_OpStatusType, direction=IN
        arg ResData: type=Dcm_RequestDataOut_Routine_DiagnServi_TABROW_NeuRoutiBasicSetti_Start_Routine_5_ResDataType, direction=OUT
        arg ErrorCode: type=Dcm_NegativeResponseCodeType, direction=OUT
      error E_NOT_OK: error-code=1
      error DCM_E_PENDING: error-code=10
      error DCM_E_FORCE_RCRRP: error-code=12
    RoutineServices_Routine_DiagnServi_TABROW_NeuRoutiBasicSetti_Start_Routine_4_2
      operation Start: possible-error=[RoutineServices_Routine_DiagnServi_TABROW_NeuRoutiBasicSetti_Start_Routine_4_2/E_NOT_OK, RoutineServices_Routine_DiagnServi_TABROW_NeuRoutiBasicSetti_Start_Routine_4_2/DCM_E_PENDING, RoutineServices_Routine_DiagnServi_TABROW_NeuRoutiBasicSetti_Start_Routine_4_2/DCM_E_FORCE_RCRRP]
        arg OpStatus: type=Dcm_OpStatusType, direction=IN
        arg ResData: type=Dcm_StartDataOut_Routine_DiagnServi_TABROW_NeuRoutiBasicSetti_Start_Routine_4_2_ResDataType, direction=OUT
        arg ErrorCode: type=Dcm_NegativeResponseCodeType, direction=OUT
      operation Stop: possible-error=[RoutineServices_Routine_DiagnServi_TABROW_NeuRoutiBasicSetti_Start_Routine_4_2/E_NOT_OK, RoutineServices_Routine_DiagnServi_TABROW_NeuRoutiBasicSetti_Start_Routine_4_2/DCM_E_PENDING, RoutineServices_Routine_DiagnServi_TABROW_NeuRoutiBasicSetti_Start_Routine_4_2/DCM_E_FORCE_RCRRP]
        arg OpStatus: type=Dcm_OpStatusType, direction=IN
        arg ResData: type=Dcm_StopDataOut_Routine_DiagnServi_TABROW_NeuRoutiBasicSetti_Start_Routine_4_2_ResDataType, direction=OUT
        arg ErrorCode: type=Dcm_NegativeResponseCodeType, direction=OUT
      operation RequestResults: possible-error=[RoutineServices_Routine_DiagnServi_TABROW_NeuRoutiBasicSetti_Start_Routine_4_2/E_NOT_OK, RoutineServices_Routine_DiagnServi_TABROW_NeuRoutiBasicSetti_Start_Routine_4_2/DCM_E_PENDING, RoutineServices_Routine_DiagnServi_TABROW_NeuRoutiBasicSetti_Start_Routine_4_2/DCM_E_FORCE_RCRRP]
        arg OpStatus: type=Dcm_OpStatusType, direction=IN
        arg ResData: type=Dcm_RequestDataOut_Routine_DiagnServi_TABROW_NeuRoutiBasicSetti_Start_Routine_4_2_ResDataType, direction=OUT
        arg ErrorCode: type=Dcm_NegativeResponseCodeType, direction=OUT
      error E_NOT_OK: error-code=1
      error DCM_E_PENDING: error-code=10
      error DCM_E_FORCE_RCRRP: error-code=12
    RoutineServices_Routine_DiagnServi_TABROW_ResetHVBatteAfterSepar_Start_Routine
      operation Start: possible-error=[RoutineServices_Routine_DiagnServi_TABROW_ResetHVBatteAfterSepar_Start_Routine/E_NOT_OK, RoutineServices_Routine_DiagnServi_TABROW_ResetHVBatteAfterSepar_Start_Routine/DCM_E_PENDING, RoutineServices_Routine_DiagnServi_TABROW_ResetHVBatteAfterSepar_Start_Routine/DCM_E_FORCE_RCRRP]
        arg OpStatus: type=Dcm_OpStatusType, direction=IN
        arg ResData: type=Dcm_StartDataOut_Routine_DiagnServi_TABROW_ResetHVBatteAfterSepar_Start_Routine_ResDataType, direction=OUT
        arg ErrorCode: type=Dcm_NegativeResponseCodeType, direction=OUT
      operation Stop: possible-error=[RoutineServices_Routine_DiagnServi_TABROW_ResetHVBatteAfterSepar_Start_Routine/E_NOT_OK, RoutineServices_Routine_DiagnServi_TABROW_ResetHVBatteAfterSepar_Start_Routine/DCM_E_PENDING, RoutineServices_Routine_DiagnServi_TABROW_ResetHVBatteAfterSepar_Start_Routine/DCM_E_FORCE_RCRRP]
        arg OpStatus: type=Dcm_OpStatusType, direction=IN
        arg ResData: type=Dcm_StopDataOut_Routine_DiagnServi_TABROW_ResetHVBatteAfterSepar_Start_Routine_ResDataType, direction=OUT
        arg ErrorCode: type=Dcm_NegativeResponseCodeType, direction=OUT
      operation RequestResults: possible-error=[RoutineServices_Routine_DiagnServi_TABROW_ResetHVBatteAfterSepar_Start_Routine/E_NOT_OK, RoutineServices_Routine_DiagnServi_TABROW_ResetHVBatteAfterSepar_Start_Routine/DCM_E_PENDING, RoutineServices_Routine_DiagnServi_TABROW_ResetHVBatteAfterSepar_Start_Routine/DCM_E_FORCE_RCRRP]
        arg OpStatus: type=Dcm_OpStatusType, direction=IN
        arg ResData: type=Dcm_RequestDataOut_Routine_DiagnServi_TABROW_ResetHVBatteAfterSepar_Start_Routine_ResDataType, direction=OUT
        arg ErrorCode: type=Dcm_NegativeResponseCodeType, direction=OUT
      error E_NOT_OK: error-code=1
      error DCM_E_PENDING: error-code=10
      error DCM_E_FORCE_RCRRP: error-code=12
    RoutineServices_Routine_DiagnServi_TABROW_IsolaMeasuDeactMode_Start_Routine_1
      operation Start: possible-error=[RoutineServices_Routine_DiagnServi_TABROW_IsolaMeasuDeactMode_Start_Routine_1/E_NOT_OK, RoutineServices_Routine_DiagnServi_TABROW_IsolaMeasuDeactMode_Start_Routine_1/DCM_E_PENDING, RoutineServices_Routine_DiagnServi_TABROW_IsolaMeasuDeactMode_Start_Routine_1/DCM_E_FORCE_RCRRP]
        4 x arg:
          ReqData: type=Dcm_StartDataIn_Routine_DiagnServi_TABROW_IsolaMeasuDeactMode_Start_Routine_1_ReqDataType, direction=IN
          OpStatus: type=Dcm_OpStatusType, direction=IN
          ResData: type=Dcm_StartDataOut_Routine_DiagnServi_TABROW_IsolaMeasuDeactMode_Start_Routine_1_ResDataType, direction=OUT
          ErrorCode: type=Dcm_NegativeResponseCodeType, direction=OUT
      operation Stop: possible-error=[RoutineServices_Routine_DiagnServi_TABROW_IsolaMeasuDeactMode_Start_Routine_1/E_NOT_OK, RoutineServices_Routine_DiagnServi_TABROW_IsolaMeasuDeactMode_Start_Routine_1/DCM_E_PENDING, RoutineServices_Routine_DiagnServi_TABROW_IsolaMeasuDeactMode_Start_Routine_1/DCM_E_FORCE_RCRRP]
        arg OpStatus: type=Dcm_OpStatusType, direction=IN
        arg ResData: type=Dcm_StopDataOut_Routine_DiagnServi_TABROW_IsolaMeasuDeactMode_Start_Routine_1_ResDataType, direction=OUT
        arg ErrorCode: type=Dcm_NegativeResponseCodeType, direction=OUT
      operation RequestResults: possible-error=[RoutineServices_Routine_DiagnServi_TABROW_IsolaMeasuDeactMode_Start_Routine_1/E_NOT_OK, RoutineServices_Routine_DiagnServi_TABROW_IsolaMeasuDeactMode_Start_Routine_1/DCM_E_PENDING, RoutineServices_Routine_DiagnServi_TABROW_IsolaMeasuDeactMode_Start_Routine_1/DCM_E_FORCE_RCRRP]
        arg OpStatus: type=Dcm_OpStatusType, direction=IN
        arg ResData: type=Dcm_RequestDataOut_Routine_DiagnServi_TABROW_IsolaMeasuDeactMode_Start_Routine_1_ResDataType, direction=OUT
        arg ErrorCode: type=Dcm_NegativeResponseCodeType, direction=OUT
      error E_NOT_OK: error-code=1
      error DCM_E_PENDING: error-code=10
      error DCM_E_FORCE_RCRRP: error-code=12
    RoutineServices_Routine_DiagnServi_TABROW_ResetOfAllAdapt_Start_Routine_COP
      operation Start: possible-error=[RoutineServices_Routine_DiagnServi_TABROW_ResetOfAllAdapt_Start_Routine_COP/E_NOT_OK, RoutineServices_Routine_DiagnServi_TABROW_ResetOfAllAdapt_Start_Routine_COP/DCM_E_PENDING, RoutineServices_Routine_DiagnServi_TABROW_ResetOfAllAdapt_Start_Routine_COP/DCM_E_FORCE_RCRRP]
        4 x arg:
          ReqData: type=Dcm_StartDataIn_Routine_DiagnServi_TABROW_ResetOfAllAdapt_Start_Routine_COP_ReqDataType, direction=IN
          OpStatus: type=Dcm_OpStatusType, direction=IN
          ResData: type=Dcm_StartDataOut_Routine_DiagnServi_TABROW_ResetOfAllAdapt_Start_Routine_COP_ResDataType, direction=OUT
          ErrorCode: type=Dcm_NegativeResponseCodeType, direction=OUT
      operation Stop: possible-error=[RoutineServices_Routine_DiagnServi_TABROW_ResetOfAllAdapt_Start_Routine_COP/E_NOT_OK, RoutineServices_Routine_DiagnServi_TABROW_ResetOfAllAdapt_Start_Routine_COP/DCM_E_PENDING, RoutineServices_Routine_DiagnServi_TABROW_ResetOfAllAdapt_Start_Routine_COP/DCM_E_FORCE_RCRRP]
        arg OpStatus: type=Dcm_OpStatusType, direction=IN
        arg ResData: type=Dcm_StopDataOut_Routine_DiagnServi_TABROW_ResetOfAllAdapt_Start_Routine_COP_ResDataType, direction=OUT
        arg ErrorCode: type=Dcm_NegativeResponseCodeType, direction=OUT
      operation RequestResults: possible-error=[RoutineServices_Routine_DiagnServi_TABROW_ResetOfAllAdapt_Start_Routine_COP/E_NOT_OK, RoutineServices_Routine_DiagnServi_TABROW_ResetOfAllAdapt_Start_Routine_COP/DCM_E_PENDING, RoutineServices_Routine_DiagnServi_TABROW_ResetOfAllAdapt_Start_Routine_COP/DCM_E_FORCE_RCRRP]
        arg OpStatus: type=Dcm_OpStatusType, direction=IN
        arg ResData: type=Dcm_RequestDataOut_Routine_DiagnServi_TABROW_ResetOfAllAdapt_Start_Routine_COP_ResDataType, direction=OUT
        arg ErrorCode: type=Dcm_NegativeResponseCodeType, direction=OUT
      error E_NOT_OK: error-code=1
      error DCM_E_PENDING: error-code=10
      error DCM_E_FORCE_RCRRP: error-code=12
    RoutineServices_Routine_DiagnServi_TABROW_AdaptOfBatteBankMode_Start_Routine
      operation Start: possible-error=[RoutineServices_Routine_DiagnServi_TABROW_AdaptOfBatteBankMode_Start_Routine/E_NOT_OK, RoutineServices_Routine_DiagnServi_TABROW_AdaptOfBatteBankMode_Start_Routine/DCM_E_PENDING, RoutineServices_Routine_DiagnServi_TABROW_AdaptOfBatteBankMode_Start_Routine/DCM_E_FORCE_RCRRP]
        4 x arg:
          ReqData: type=Dcm_StartDataIn_Routine_DiagnServi_TABROW_AdaptOfBatteBankMode_Start_Routine_ReqDataType, direction=IN
          OpStatus: type=Dcm_OpStatusType, direction=IN
          ResData: type=Dcm_StartDataOut_Routine_DiagnServi_TABROW_AdaptOfBatteBankMode_Start_Routine_ResDataType, direction=OUT
          ErrorCode: type=Dcm_NegativeResponseCodeType, direction=OUT
      operation Stop: possible-error=[RoutineServices_Routine_DiagnServi_TABROW_AdaptOfBatteBankMode_Start_Routine/E_NOT_OK, RoutineServices_Routine_DiagnServi_TABROW_AdaptOfBatteBankMode_Start_Routine/DCM_E_PENDING, RoutineServices_Routine_DiagnServi_TABROW_AdaptOfBatteBankMode_Start_Routine/DCM_E_FORCE_RCRRP]
        arg OpStatus: type=Dcm_OpStatusType, direction=IN
        arg ResData: type=Dcm_StopDataOut_Routine_DiagnServi_TABROW_AdaptOfBatteBankMode_Start_Routine_ResDataType, direction=OUT
        arg ErrorCode: type=Dcm_NegativeResponseCodeType, direction=OUT
      operation RequestResults: possible-error=[RoutineServices_Routine_DiagnServi_TABROW_AdaptOfBatteBankMode_Start_Routine/E_NOT_OK, RoutineServices_Routine_DiagnServi_TABROW_AdaptOfBatteBankMode_Start_Routine/DCM_E_PENDING, RoutineServices_Routine_DiagnServi_TABROW_AdaptOfBatteBankMode_Start_Routine/DCM_E_FORCE_RCRRP]
        arg OpStatus: type=Dcm_OpStatusType, direction=IN
        arg ResData: type=Dcm_RequestDataOut_Routine_DiagnServi_TABROW_AdaptOfBatteBankMode_Start_Routine_ResDataType, direction=OUT
        arg ErrorCode: type=Dcm_NegativeResponseCodeType, direction=OUT
      error E_NOT_OK: error-code=1
      error DCM_E_PENDING: error-code=10
      error DCM_E_FORCE_RCRRP: error-code=12
    RoutineServices_Routine_DiagnServi_TABROW_AdaptOfCellBalan_Start_Routine
      operation Start: possible-error=[RoutineServices_Routine_DiagnServi_TABROW_AdaptOfCellBalan_Start_Routine/E_NOT_OK, RoutineServices_Routine_DiagnServi_TABROW_AdaptOfCellBalan_Start_Routine/DCM_E_PENDING, RoutineServices_Routine_DiagnServi_TABROW_AdaptOfCellBalan_Start_Routine/DCM_E_FORCE_RCRRP]
        4 x arg:
          ReqData: type=Dcm_StartDataIn_Routine_DiagnServi_TABROW_AdaptOfCellBalan_Start_Routine_ReqDataType, direction=IN
          OpStatus: type=Dcm_OpStatusType, direction=IN
          ResData: type=Dcm_StartDataOut_Routine_DiagnServi_TABROW_AdaptOfCellBalan_Start_Routine_ResDataType, direction=OUT
          ErrorCode: type=Dcm_NegativeResponseCodeType, direction=OUT
      operation Stop: possible-error=[RoutineServices_Routine_DiagnServi_TABROW_AdaptOfCellBalan_Start_Routine/E_NOT_OK, RoutineServices_Routine_DiagnServi_TABROW_AdaptOfCellBalan_Start_Routine/DCM_E_PENDING, RoutineServices_Routine_DiagnServi_TABROW_AdaptOfCellBalan_Start_Routine/DCM_E_FORCE_RCRRP]
        arg OpStatus: type=Dcm_OpStatusType, direction=IN
        arg ResData: type=Dcm_StopDataOut_Routine_DiagnServi_TABROW_AdaptOfCellBalan_Start_Routine_ResDataType, direction=OUT
        arg ErrorCode: type=Dcm_NegativeResponseCodeType, direction=OUT
      operation RequestResults: possible-error=[RoutineServices_Routine_DiagnServi_TABROW_AdaptOfCellBalan_Start_Routine/E_NOT_OK, RoutineServices_Routine_DiagnServi_TABROW_AdaptOfCellBalan_Start_Routine/DCM_E_PENDING, RoutineServices_Routine_DiagnServi_TABROW_AdaptOfCellBalan_Start_Routine/DCM_E_FORCE_RCRRP]
        arg OpStatus: type=Dcm_OpStatusType, direction=IN
        arg ResData: type=Dcm_RequestDataOut_Routine_DiagnServi_TABROW_AdaptOfCellBalan_Start_Routine_ResDataType, direction=OUT
        arg ErrorCode: type=Dcm_NegativeResponseCodeType, direction=OUT
      error E_NOT_OK: error-code=1
      error DCM_E_PENDING: error-code=10
      error DCM_E_FORCE_RCRRP: error-code=12
    RoutineServices_Routine_DiagnServi_TABROW_ResetToFactoSetti_Start_Routine_COP
      operation Start: possible-error=[RoutineServices_Routine_DiagnServi_TABROW_ResetToFactoSetti_Start_Routine_COP/E_NOT_OK, RoutineServices_Routine_DiagnServi_TABROW_ResetToFactoSetti_Start_Routine_COP/DCM_E_PENDING, RoutineServices_Routine_DiagnServi_TABROW_ResetToFactoSetti_Start_Routine_COP/DCM_E_FORCE_RCRRP]
        4 x arg:
          ReqData: type=Dcm_StartDataIn_Routine_DiagnServi_TABROW_ResetToFactoSetti_Start_Routine_COP_ReqDataType, direction=IN
          OpStatus: type=Dcm_OpStatusType, direction=IN
          ResData: type=Dcm_StartDataOut_Routine_DiagnServi_TABROW_ResetToFactoSetti_Start_Routine_COP_ResDataType, direction=OUT
          ErrorCode: type=Dcm_NegativeResponseCodeType, direction=OUT
      operation Stop: possible-error=[RoutineServices_Routine_DiagnServi_TABROW_ResetToFactoSetti_Start_Routine_COP/E_NOT_OK, RoutineServices_Routine_DiagnServi_TABROW_ResetToFactoSetti_Start_Routine_COP/DCM_E_PENDING, RoutineServices_Routine_DiagnServi_TABROW_ResetToFactoSetti_Start_Routine_COP/DCM_E_FORCE_RCRRP]
        arg OpStatus: type=Dcm_OpStatusType, direction=IN
        arg ResData: type=Dcm_StopDataOut_Routine_DiagnServi_TABROW_ResetToFactoSetti_Start_Routine_COP_ResDataType, direction=OUT
        arg ErrorCode: type=Dcm_NegativeResponseCodeType, direction=OUT
      operation RequestResults: possible-error=[RoutineServices_Routine_DiagnServi_TABROW_ResetToFactoSetti_Start_Routine_COP/E_NOT_OK, RoutineServices_Routine_DiagnServi_TABROW_ResetToFactoSetti_Start_Routine_COP/DCM_E_PENDING, RoutineServices_Routine_DiagnServi_TABROW_ResetToFactoSetti_Start_Routine_COP/DCM_E_FORCE_RCRRP]
        arg OpStatus: type=Dcm_OpStatusType, direction=IN
        arg ResData: type=Dcm_RequestDataOut_Routine_DiagnServi_TABROW_ResetToFactoSetti_Start_Routine_COP_ResDataType, direction=OUT
        arg ErrorCode: type=Dcm_NegativeResponseCodeType, direction=OUT
      error E_NOT_OK: error-code=1
      error DCM_E_PENDING: error-code=10
      error DCM_E_FORCE_RCRRP: error-code=12
    RoutineServices_Routine_DiagnServi_TABROW_ResetHardCrashFlag_Start_Routine
      operation Start: possible-error=[RoutineServices_Routine_DiagnServi_TABROW_ResetHardCrashFlag_Start_Routine/E_NOT_OK, RoutineServices_Routine_DiagnServi_TABROW_ResetHardCrashFlag_Start_Routine/DCM_E_PENDING, RoutineServices_Routine_DiagnServi_TABROW_ResetHardCrashFlag_Start_Routine/DCM_E_FORCE_RCRRP]
        arg OpStatus: type=Dcm_OpStatusType, direction=IN
        arg ResData: type=Dcm_StartDataOut_Routine_DiagnServi_TABROW_ResetHardCrashFlag_Start_Routine_ResDataType, direction=OUT
        arg ErrorCode: type=Dcm_NegativeResponseCodeType, direction=OUT
      operation Stop: possible-error=[RoutineServices_Routine_DiagnServi_TABROW_ResetHardCrashFlag_Start_Routine/E_NOT_OK, RoutineServices_Routine_DiagnServi_TABROW_ResetHardCrashFlag_Start_Routine/DCM_E_PENDING, RoutineServices_Routine_DiagnServi_TABROW_ResetHardCrashFlag_Start_Routine/DCM_E_FORCE_RCRRP]
        arg OpStatus: type=Dcm_OpStatusType, direction=IN
        arg ResData: type=Dcm_StopDataOut_Routine_DiagnServi_TABROW_ResetHardCrashFlag_Start_Routine_ResDataType, direction=OUT
        arg ErrorCode: type=Dcm_NegativeResponseCodeType, direction=OUT
      operation RequestResults: possible-error=[RoutineServices_Routine_DiagnServi_TABROW_ResetHardCrashFlag_Start_Routine/E_NOT_OK, RoutineServices_Routine_DiagnServi_TABROW_ResetHardCrashFlag_Start_Routine/DCM_E_PENDING, RoutineServices_Routine_DiagnServi_TABROW_ResetHardCrashFlag_Start_Routine/DCM_E_FORCE_RCRRP]
        arg OpStatus: type=Dcm_OpStatusType, direction=IN
        arg ResData: type=Dcm_RequestDataOut_Routine_DiagnServi_TABROW_ResetHardCrashFlag_Start_Routine_ResDataType, direction=OUT
        arg ErrorCode: type=Dcm_NegativeResponseCodeType, direction=OUT
      error E_NOT_OK: error-code=1
      error DCM_E_PENDING: error-code=10
      error DCM_E_FORCE_RCRRP: error-code=12
    RoutineServices_Routine_DiagnServi_Verify_partial_software_checksum_Start_Routine
      operation Start: possible-error=[RoutineServices_Routine_DiagnServi_Verify_partial_software_checksum_Start_Routine/E_NOT_OK, RoutineServices_Routine_DiagnServi_Verify_partial_software_checksum_Start_Routine/DCM_E_PENDING, RoutineServices_Routine_DiagnServi_Verify_partial_software_checksum_Start_Routine/DCM_E_FORCE_RCRRP]
        5 x arg:
          ReqData: type=Dcm_StartFlexibleInArrayData_Routine_DiagnServi_Verify_partial_software_checksum_Start_Routine_ReqDataType, direction=IN
          OpStatus: type=Dcm_OpStatusType, direction=IN
          ResData: type=Dcm_StartDataOut_Routine_DiagnServi_Verify_partial_software_checksum_Start_Routine_ResDataType, direction=OUT
          DataLength: type=uint16, direction=IN
          ErrorCode: type=Dcm_NegativeResponseCodeType, direction=OUT
      error E_NOT_OK: error-code=1
      error DCM_E_PENDING: error-code=10
      error DCM_E_FORCE_RCRRP: error-code=12
    RoutineServices_Routine_TABROW_VkmsDebug_Start_Routine
      operation Start: possible-error=[RoutineServices_Routine_TABROW_VkmsDebug_Start_Routine/E_NOT_OK, RoutineServices_Routine_TABROW_VkmsDebug_Start_Routine/DCM_E_PENDING, RoutineServices_Routine_TABROW_VkmsDebug_Start_Routine/DCM_E_FORCE_RCRRP]
        4 x arg:
          ReqData: type=Dcm_StartFlexibleInArrayData_Routine_TABROW_VkmsDebug_Start_Routine_ReqDataType, direction=IN
          OpStatus: type=Dcm_OpStatusType, direction=IN
          DataLength: type=uint16, direction=IN
          ErrorCode: type=Dcm_NegativeResponseCodeType, direction=OUT
      operation RequestResults: possible-error=[RoutineServices_Routine_TABROW_VkmsDebug_Start_Routine/E_NOT_OK, RoutineServices_Routine_TABROW_VkmsDebug_Start_Routine/DCM_E_PENDING, RoutineServices_Routine_TABROW_VkmsDebug_Start_Routine/DCM_E_FORCE_RCRRP]
        4 x arg:
          OpStatus: type=Dcm_OpStatusType, direction=IN
          ResData: type=Dcm_RequestFlexibleOutArrayData_Routine_TABROW_VkmsDebug_Start_Routine_ResDataType, direction=OUT
          DataLength: type=uint16, direction=OUT
          ErrorCode: type=Dcm_NegativeResponseCodeType, direction=OUT
      error E_NOT_OK: error-code=1
      error DCM_E_PENDING: error-code=10
      error DCM_E_FORCE_RCRRP: error-code=12
    RoutineServices_Routine_DiagnServi_TABROW_ClearDowngProteData_Start_Routine_COP
      operation Start: possible-error=[RoutineServices_Routine_DiagnServi_TABROW_ClearDowngProteData_Start_Routine_COP/E_NOT_OK, RoutineServices_Routine_DiagnServi_TABROW_ClearDowngProteData_Start_Routine_COP/DCM_E_PENDING, RoutineServices_Routine_DiagnServi_TABROW_ClearDowngProteData_Start_Routine_COP/DCM_E_FORCE_RCRRP]
        arg OpStatus: type=Dcm_OpStatusType, direction=IN
        arg ResData: type=Dcm_StartDataOut_Routine_DiagnServi_TABROW_ClearDowngProteData_Start_Routine_COP_ResDataType, direction=OUT
        arg ErrorCode: type=Dcm_NegativeResponseCodeType, direction=OUT
      operation Stop: possible-error=[RoutineServices_Routine_DiagnServi_TABROW_ClearDowngProteData_Start_Routine_COP/E_NOT_OK, RoutineServices_Routine_DiagnServi_TABROW_ClearDowngProteData_Start_Routine_COP/DCM_E_PENDING, RoutineServices_Routine_DiagnServi_TABROW_ClearDowngProteData_Start_Routine_COP/DCM_E_FORCE_RCRRP]
        arg OpStatus: type=Dcm_OpStatusType, direction=IN
        arg ResData: type=Dcm_StopDataOut_Routine_DiagnServi_TABROW_ClearDowngProteData_Start_Routine_COP_ResDataType, direction=OUT
        arg ErrorCode: type=Dcm_NegativeResponseCodeType, direction=OUT
      operation RequestResults: possible-error=[RoutineServices_Routine_DiagnServi_TABROW_ClearDowngProteData_Start_Routine_COP/E_NOT_OK, RoutineServices_Routine_DiagnServi_TABROW_ClearDowngProteData_Start_Routine_COP/DCM_E_PENDING, RoutineServices_Routine_DiagnServi_TABROW_ClearDowngProteData_Start_Routine_COP/DCM_E_FORCE_RCRRP]
        arg OpStatus: type=Dcm_OpStatusType, direction=IN
        arg ResData: type=Dcm_RequestDataOut_Routine_DiagnServi_TABROW_ClearDowngProteData_Start_Routine_COP_ResDataType, direction=OUT
        arg ErrorCode: type=Dcm_NegativeResponseCodeType, direction=OUT
      error E_NOT_OK: error-code=1
      error DCM_E_PENDING: error-code=10
      error DCM_E_FORCE_RCRRP: error-code=12
    RoutineServices_Routine_DiagnServi_TABROW_ResetHealiInhib_Start_Routine
      operation Start: possible-error=[RoutineServices_Routine_DiagnServi_TABROW_ResetHealiInhib_Start_Routine/E_NOT_OK, RoutineServices_Routine_DiagnServi_TABROW_ResetHealiInhib_Start_Routine/DCM_E_PENDING, RoutineServices_Routine_DiagnServi_TABROW_ResetHealiInhib_Start_Routine/DCM_E_FORCE_RCRRP]
        4 x arg:
          ReqData: type=Dcm_StartDataIn_Routine_DiagnServi_TABROW_ResetHealiInhib_Start_Routine_ReqDataType, direction=IN
          OpStatus: type=Dcm_OpStatusType, direction=IN
          ResData: type=Dcm_StartDataOut_Routine_DiagnServi_TABROW_ResetHealiInhib_Start_Routine_ResDataType, direction=OUT
          ErrorCode: type=Dcm_NegativeResponseCodeType, direction=OUT
      error E_NOT_OK: error-code=1
      error DCM_E_PENDING: error-code=10
      error DCM_E_FORCE_RCRRP: error-code=12
    RoutineServices_Routine_DiagnServi_TABROW_RequeConfiOfProteOfVehicDiagn_Start_Routine
      operation Start: possible-error=[RoutineServices_Routine_DiagnServi_TABROW_RequeConfiOfProteOfVehicDiagn_Start_Routine/E_NOT_OK, RoutineServices_Routine_DiagnServi_TABROW_RequeConfiOfProteOfVehicDiagn_Start_Routine/DCM_E_PENDING, RoutineServices_Routine_DiagnServi_TABROW_RequeConfiOfProteOfVehicDiagn_Start_Routine/DCM_E_FORCE_RCRRP]
        5 x arg:
          ReqData: type=Dcm_StartDataIn_Routine_DiagnServi_TABROW_RequeConfiOfProteOfVehicDiagn_Start_Routine_ReqDataType, direction=IN
          OpStatus: type=Dcm_OpStatusType, direction=IN
          ResData: type=Dcm_StartFlexibleOutArrayData_Routine_DiagnServi_TABROW_RequeConfiOfProteOfVehicDiagn_Start_Routine_ResDataType, direction=OUT
          DataLength: type=uint16, direction=OUT
          ErrorCode: type=Dcm_NegativeResponseCodeType, direction=OUT
      error E_NOT_OK: error-code=1
      error DCM_E_PENDING: error-code=10
      error DCM_E_FORCE_RCRRP: error-code=12
    RoutineServices_Routine_DiagnServi_TABROW_CalcuConfiStateFingeOfProteOfVehicDiagn_Start_Routine
      operation Start: possible-error=[RoutineServices_Routine_DiagnServi_TABROW_CalcuConfiStateFingeOfProteOfVehicDiagn_Start_Routine/E_NOT_OK, RoutineServices_Routine_DiagnServi_TABROW_CalcuConfiStateFingeOfProteOfVehicDiagn_Start_Routine/DCM_E_PENDING, RoutineServices_Routine_DiagnServi_TABROW_CalcuConfiStateFingeOfProteOfVehicDiagn_Start_Routine/DCM_E_FORCE_RCRRP]
        5 x arg:
          ReqData: type=Dcm_StartFlexibleInArrayData_Routine_DiagnServi_TABROW_CalcuConfiStateFingeOfProteOfVehicDiagn_Start_Routine_ReqDataType, direction=IN
          OpStatus: type=Dcm_OpStatusType, direction=IN
          ResData: type=Dcm_StartFlexibleOutArrayData_Routine_DiagnServi_TABROW_CalcuConfiStateFingeOfProteOfVehicDiagn_Start_Routine_ResDataType, direction=OUT
          DataLength: type=uint16, direction=INOUT
          ErrorCode: type=Dcm_NegativeResponseCodeType, direction=OUT
      error E_NOT_OK: error-code=1
      error DCM_E_PENDING: error-code=10
      error DCM_E_FORCE_RCRRP: error-code=12
    RoutineServices_Routine_DiagnServi_TABROW_UnlocProteOfVehicDiagn_Start_Routine
      operation Start: possible-error=[RoutineServices_Routine_DiagnServi_TABROW_UnlocProteOfVehicDiagn_Start_Routine/E_NOT_OK, RoutineServices_Routine_DiagnServi_TABROW_UnlocProteOfVehicDiagn_Start_Routine/DCM_E_PENDING, RoutineServices_Routine_DiagnServi_TABROW_UnlocProteOfVehicDiagn_Start_Routine/DCM_E_FORCE_RCRRP]
        5 x arg:
          ReqData: type=Dcm_StartFlexibleInArrayData_Routine_DiagnServi_TABROW_UnlocProteOfVehicDiagn_Start_Routine_ReqDataType, direction=IN
          OpStatus: type=Dcm_OpStatusType, direction=IN
          ResData: type=Dcm_StartDataOut_Routine_DiagnServi_TABROW_UnlocProteOfVehicDiagn_Start_Routine_ResDataType, direction=OUT
          DataLength: type=uint16, direction=IN
          ErrorCode: type=Dcm_NegativeResponseCodeType, direction=OUT
      error E_NOT_OK: error-code=1
      error DCM_E_PENDING: error-code=10
      error DCM_E_FORCE_RCRRP: error-code=12
    RoutineServices_Routine_TABROW_LockProteOfVehicDiagn_Start_Routine
      operation Start: possible-error=[RoutineServices_Routine_TABROW_LockProteOfVehicDiagn_Start_Routine/E_NOT_OK, RoutineServices_Routine_TABROW_LockProteOfVehicDiagn_Start_Routine/DCM_E_PENDING, RoutineServices_Routine_TABROW_LockProteOfVehicDiagn_Start_Routine/DCM_E_FORCE_RCRRP]
        arg OpStatus: type=Dcm_OpStatusType, direction=IN
        arg ResData: type=Dcm_StartDataOut_Routine_TABROW_LockProteOfVehicDiagn_Start_Routine_ResDataType, direction=OUT
        arg ErrorCode: type=Dcm_NegativeResponseCodeType, direction=OUT
      error E_NOT_OK: error-code=1
      error DCM_E_PENDING: error-code=10
      error DCM_E_FORCE_RCRRP: error-code=12
    RoutineServices_Routine_DiagnServi_TABROW_ResetProteOfVehicDiagn_Start_Routine
      operation Start: possible-error=[RoutineServices_Routine_DiagnServi_TABROW_ResetProteOfVehicDiagn_Start_Routine/E_NOT_OK, RoutineServices_Routine_DiagnServi_TABROW_ResetProteOfVehicDiagn_Start_Routine/DCM_E_PENDING, RoutineServices_Routine_DiagnServi_TABROW_ResetProteOfVehicDiagn_Start_Routine/DCM_E_FORCE_RCRRP]
        5 x arg:
          ReqData: type=Dcm_StartFlexibleInArrayData_Routine_DiagnServi_TABROW_ResetProteOfVehicDiagn_Start_Routine_ReqDataType, direction=IN
          OpStatus: type=Dcm_OpStatusType, direction=IN
          ResData: type=Dcm_StartDataOut_Routine_DiagnServi_TABROW_ResetProteOfVehicDiagn_Start_Routine_ResDataType, direction=OUT
          DataLength: type=uint16, direction=IN
          ErrorCode: type=Dcm_NegativeResponseCodeType, direction=OUT
      error E_NOT_OK: error-code=1
      error DCM_E_PENDING: error-code=10
      error DCM_E_FORCE_RCRRP: error-code=12
    RoutineServices_Routine_DiagnServi_TABROW_RequeDataOfProteOfVehicDiagn_Start_Routine
      operation Start: possible-error=[RoutineServices_Routine_DiagnServi_TABROW_RequeDataOfProteOfVehicDiagn_Start_Routine/E_NOT_OK, RoutineServices_Routine_DiagnServi_TABROW_RequeDataOfProteOfVehicDiagn_Start_Routine/DCM_E_PENDING, RoutineServices_Routine_DiagnServi_TABROW_RequeDataOfProteOfVehicDiagn_Start_Routine/DCM_E_FORCE_RCRRP]
        5 x arg:
          ReqData: type=Dcm_StartDataIn_Routine_DiagnServi_TABROW_RequeDataOfProteOfVehicDiagn_Start_Routine_ReqDataType, direction=IN
          OpStatus: type=Dcm_OpStatusType, direction=IN
          ResData: type=Dcm_StartFlexibleOutArrayData_Routine_DiagnServi_TABROW_RequeDataOfProteOfVehicDiagn_Start_Routine_ResDataType, direction=OUT
          DataLength: type=uint16, direction=OUT
          ErrorCode: type=Dcm_NegativeResponseCodeType, direction=OUT
      error E_NOT_OK: error-code=1
      error DCM_E_PENDING: error-code=10
      error DCM_E_FORCE_RCRRP: error-code=12
    RoutineServices_Routine_DiagnServi_TABROW_RequeLoggiDataOfProteOfVehicDiagn_Start_Routine
      operation Start: possible-error=[RoutineServices_Routine_DiagnServi_TABROW_RequeLoggiDataOfProteOfVehicDiagn_Start_Routine/E_NOT_OK, RoutineServices_Routine_DiagnServi_TABROW_RequeLoggiDataOfProteOfVehicDiagn_Start_Routine/DCM_E_PENDING, RoutineServices_Routine_DiagnServi_TABROW_RequeLoggiDataOfProteOfVehicDiagn_Start_Routine/DCM_E_FORCE_RCRRP]
        5 x arg:
          ReqData: type=Dcm_StartDataIn_Routine_DiagnServi_TABROW_RequeLoggiDataOfProteOfVehicDiagn_Start_Routine_ReqDataType, direction=IN
          OpStatus: type=Dcm_OpStatusType, direction=IN
          ResData: type=Dcm_StartFlexibleOutArrayData_Routine_DiagnServi_TABROW_RequeLoggiDataOfProteOfVehicDiagn_Start_Routine_ResDataType, direction=OUT
          DataLength: type=uint16, direction=OUT
          ErrorCode: type=Dcm_NegativeResponseCodeType, direction=OUT
      error E_NOT_OK: error-code=1
      error DCM_E_PENDING: error-code=10
      error DCM_E_FORCE_RCRRP: error-code=12
    RoutineServices_Routine_TABROW_VkmsHandlDownl_Start_Routine
      operation Start: possible-error=[RoutineServices_Routine_TABROW_VkmsHandlDownl_Start_Routine/E_NOT_OK, RoutineServices_Routine_TABROW_VkmsHandlDownl_Start_Routine/DCM_E_PENDING, RoutineServices_Routine_TABROW_VkmsHandlDownl_Start_Routine/DCM_E_FORCE_RCRRP]
        4 x arg:
          ReqData: type=Dcm_StartFlexibleInArrayData_Routine_TABROW_VkmsHandlDownl_Start_Routine_ReqDataType, direction=IN
          OpStatus: type=Dcm_OpStatusType, direction=IN
          DataLength: type=uint16, direction=IN
          ErrorCode: type=Dcm_NegativeResponseCodeType, direction=OUT
      operation RequestResults: possible-error=[RoutineServices_Routine_TABROW_VkmsHandlDownl_Start_Routine/E_NOT_OK, RoutineServices_Routine_TABROW_VkmsHandlDownl_Start_Routine/DCM_E_PENDING, RoutineServices_Routine_TABROW_VkmsHandlDownl_Start_Routine/DCM_E_FORCE_RCRRP]
        arg OpStatus: type=Dcm_OpStatusType, direction=IN
        arg ResData: type=Dcm_RequestDataOut_Routine_TABROW_VkmsHandlDownl_Start_Routine_ResDataType, direction=OUT
        arg ErrorCode: type=Dcm_NegativeResponseCodeType, direction=OUT
      error E_NOT_OK: error-code=1
      error DCM_E_PENDING: error-code=10
      error DCM_E_FORCE_RCRRP: error-code=12
    RoutineServices_Routine_DiagnServi_TABROW_VkmsCheckVerifHash_Start_Routine
      operation Start: possible-error=[RoutineServices_Routine_DiagnServi_TABROW_VkmsCheckVerifHash_Start_Routine/E_NOT_OK, RoutineServices_Routine_DiagnServi_TABROW_VkmsCheckVerifHash_Start_Routine/DCM_E_PENDING, RoutineServices_Routine_DiagnServi_TABROW_VkmsCheckVerifHash_Start_Routine/DCM_E_FORCE_RCRRP]
        arg ReqData: type=Dcm_StartDataIn_Routine_DiagnServi_TABROW_VkmsCheckVerifHash_Start_Routine_ReqDataType, direction=IN
        arg OpStatus: type=Dcm_OpStatusType, direction=IN
        arg ErrorCode: type=Dcm_NegativeResponseCodeType, direction=OUT
      operation RequestResults: possible-error=[RoutineServices_Routine_DiagnServi_TABROW_VkmsCheckVerifHash_Start_Routine/E_NOT_OK, RoutineServices_Routine_DiagnServi_TABROW_VkmsCheckVerifHash_Start_Routine/DCM_E_PENDING, RoutineServices_Routine_DiagnServi_TABROW_VkmsCheckVerifHash_Start_Routine/DCM_E_FORCE_RCRRP]
        arg OpStatus: type=Dcm_OpStatusType, direction=IN
        arg ResData: type=Dcm_RequestDataOut_Routine_DiagnServi_TABROW_VkmsCheckVerifHash_Start_Routine_ResDataType, direction=OUT
        arg ErrorCode: type=Dcm_NegativeResponseCodeType, direction=OUT
      error E_NOT_OK: error-code=1
      error DCM_E_PENDING: error-code=10
      error DCM_E_FORCE_RCRRP: error-code=12
    RoutineServices_Routine_DiagnServi_TABROW_VkmsGetIdentHash_Start_Routine
      operation Start: possible-error=[RoutineServices_Routine_DiagnServi_TABROW_VkmsGetIdentHash_Start_Routine/E_NOT_OK, RoutineServices_Routine_DiagnServi_TABROW_VkmsGetIdentHash_Start_Routine/DCM_E_PENDING, RoutineServices_Routine_DiagnServi_TABROW_VkmsGetIdentHash_Start_Routine/DCM_E_FORCE_RCRRP]
        arg ReqData: type=Dcm_StartDataIn_Routine_DiagnServi_TABROW_VkmsGetIdentHash_Start_Routine_ReqDataType, direction=IN
        arg OpStatus: type=Dcm_OpStatusType, direction=IN
        arg ErrorCode: type=Dcm_NegativeResponseCodeType, direction=OUT
      operation RequestResults: possible-error=[RoutineServices_Routine_DiagnServi_TABROW_VkmsGetIdentHash_Start_Routine/E_NOT_OK, RoutineServices_Routine_DiagnServi_TABROW_VkmsGetIdentHash_Start_Routine/DCM_E_PENDING, RoutineServices_Routine_DiagnServi_TABROW_VkmsGetIdentHash_Start_Routine/DCM_E_FORCE_RCRRP]
        arg OpStatus: type=Dcm_OpStatusType, direction=IN
        arg ResData: type=Dcm_RequestDataOut_Routine_DiagnServi_TABROW_VkmsGetIdentHash_Start_Routine_ResDataType, direction=OUT
        arg ErrorCode: type=Dcm_NegativeResponseCodeType, direction=OUT
      error E_NOT_OK: error-code=1
      error DCM_E_PENDING: error-code=10
      error DCM_E_FORCE_RCRRP: error-code=12
    RoutineServices_Routine_DiagnServi_TABROW_VkmsGetPssHash_Start_Routine
      operation Start: possible-error=[RoutineServices_Routine_DiagnServi_TABROW_VkmsGetPssHash_Start_Routine/E_NOT_OK, RoutineServices_Routine_DiagnServi_TABROW_VkmsGetPssHash_Start_Routine/DCM_E_PENDING, RoutineServices_Routine_DiagnServi_TABROW_VkmsGetPssHash_Start_Routine/DCM_E_FORCE_RCRRP]
        arg ReqData: type=Dcm_StartDataIn_Routine_DiagnServi_TABROW_VkmsGetPssHash_Start_Routine_ReqDataType, direction=IN
        arg OpStatus: type=Dcm_OpStatusType, direction=IN
        arg ErrorCode: type=Dcm_NegativeResponseCodeType, direction=OUT
      operation RequestResults: possible-error=[RoutineServices_Routine_DiagnServi_TABROW_VkmsGetPssHash_Start_Routine/E_NOT_OK, RoutineServices_Routine_DiagnServi_TABROW_VkmsGetPssHash_Start_Routine/DCM_E_PENDING, RoutineServices_Routine_DiagnServi_TABROW_VkmsGetPssHash_Start_Routine/DCM_E_FORCE_RCRRP]
        arg OpStatus: type=Dcm_OpStatusType, direction=IN
        arg ResData: type=Dcm_RequestDataOut_Routine_DiagnServi_TABROW_VkmsGetPssHash_Start_Routine_ResDataType, direction=OUT
        arg ErrorCode: type=Dcm_NegativeResponseCodeType, direction=OUT
      error E_NOT_OK: error-code=1
      error DCM_E_PENDING: error-code=10
      error DCM_E_FORCE_RCRRP: error-code=12
    RoutineServices_Routine_DiagnServi_TABROW_VkmsGetState_Start_Routine
      operation Start: possible-error=[RoutineServices_Routine_DiagnServi_TABROW_VkmsGetState_Start_Routine/E_NOT_OK, RoutineServices_Routine_DiagnServi_TABROW_VkmsGetState_Start_Routine/DCM_E_PENDING, RoutineServices_Routine_DiagnServi_TABROW_VkmsGetState_Start_Routine/DCM_E_FORCE_RCRRP]
        arg ReqData: type=Dcm_StartDataIn_Routine_DiagnServi_TABROW_VkmsGetState_Start_Routine_ReqDataType, direction=IN
        arg OpStatus: type=Dcm_OpStatusType, direction=IN
        arg ErrorCode: type=Dcm_NegativeResponseCodeType, direction=OUT
      operation RequestResults: possible-error=[RoutineServices_Routine_DiagnServi_TABROW_VkmsGetState_Start_Routine/E_NOT_OK, RoutineServices_Routine_DiagnServi_TABROW_VkmsGetState_Start_Routine/DCM_E_PENDING, RoutineServices_Routine_DiagnServi_TABROW_VkmsGetState_Start_Routine/DCM_E_FORCE_RCRRP]
        arg OpStatus: type=Dcm_OpStatusType, direction=IN
        arg ResData: type=Dcm_RequestDataOut_Routine_DiagnServi_TABROW_VkmsGetState_Start_Routine_ResDataType, direction=OUT
        arg ErrorCode: type=Dcm_NegativeResponseCodeType, direction=OUT
      error E_NOT_OK: error-code=1
      error DCM_E_PENDING: error-code=10
      error DCM_E_FORCE_RCRRP: error-code=12
    RoutineServices_Routine_DiagnServi_TABROW_BeginOfWritiOfSecurDataOfProteOfVehicDiagn_Start_Routine
      operation Start: possible-error=[RoutineServices_Routine_DiagnServi_TABROW_BeginOfWritiOfSecurDataOfProteOfVehicDiagn_Start_Routine/E_NOT_OK, RoutineServices_Routine_DiagnServi_TABROW_BeginOfWritiOfSecurDataOfProteOfVehicDiagn_Start_Routine/DCM_E_PENDING, RoutineServices_Routine_DiagnServi_TABROW_BeginOfWritiOfSecurDataOfProteOfVehicDiagn_Start_Routine/DCM_E_FORCE_RCRRP]
        5 x arg:
          ReqData: type=Dcm_StartFlexibleInArrayData_Routine_DiagnServi_TABROW_BeginOfWritiOfSecurDataOfProteOfVehicDiagn_Start_Routine_ReqDataType, direction=IN
          OpStatus: type=Dcm_OpStatusType, direction=IN
          ResData: type=Dcm_StartDataOut_Routine_DiagnServi_TABROW_BeginOfWritiOfSecurDataOfProteOfVehicDiagn_Start_Routine_ResDataType, direction=OUT
          DataLength: type=uint16, direction=IN
          ErrorCode: type=Dcm_NegativeResponseCodeType, direction=OUT
      error E_NOT_OK: error-code=1
      error DCM_E_PENDING: error-code=10
      error DCM_E_FORCE_RCRRP: error-code=12
    RoutineServices_Routine_TABROW_EndOfWritiSecurDataOfProteOfVehicDiagn_Start_Routine
      operation Start: possible-error=[RoutineServices_Routine_TABROW_EndOfWritiSecurDataOfProteOfVehicDiagn_Start_Routine/E_NOT_OK, RoutineServices_Routine_TABROW_EndOfWritiSecurDataOfProteOfVehicDiagn_Start_Routine/DCM_E_PENDING, RoutineServices_Routine_TABROW_EndOfWritiSecurDataOfProteOfVehicDiagn_Start_Routine/DCM_E_FORCE_RCRRP]
        4 x arg:
          ReqData: type=Dcm_StartDataIn_Routine_TABROW_EndOfWritiSecurDataOfProteOfVehicDiagn_Start_Routine_ReqDataType, direction=IN
          OpStatus: type=Dcm_OpStatusType, direction=IN
          ResData: type=Dcm_StartDataOut_Routine_TABROW_EndOfWritiSecurDataOfProteOfVehicDiagn_Start_Routine_ResDataType, direction=OUT
          ErrorCode: type=Dcm_NegativeResponseCodeType, direction=OUT
      error E_NOT_OK: error-code=1
      error DCM_E_PENDING: error-code=10
      error DCM_E_FORCE_RCRRP: error-code=12
    RoutineServices_Routine_TABROW_CheckCalibPreCondi_Start_Routine
      operation Start: possible-error=[RoutineServices_Routine_TABROW_CheckCalibPreCondi_Start_Routine/E_NOT_OK, RoutineServices_Routine_TABROW_CheckCalibPreCondi_Start_Routine/DCM_E_PENDING, RoutineServices_Routine_TABROW_CheckCalibPreCondi_Start_Routine/DCM_E_FORCE_RCRRP]
        5 x arg:
          ReqData: type=Dcm_StartDataIn_Routine_TABROW_CheckCalibPreCondi_Start_Routine_ReqDataType, direction=IN
          OpStatus: type=Dcm_OpStatusType, direction=IN
          ResData: type=Dcm_StartFlexibleOutArrayData_Routine_TABROW_CheckCalibPreCondi_Start_Routine_ResDataType, direction=OUT
          DataLength: type=uint16, direction=OUT
          ErrorCode: type=Dcm_NegativeResponseCodeType, direction=OUT
      error E_NOT_OK: error-code=1
      error DCM_E_PENDING: error-code=10
      error DCM_E_FORCE_RCRRP: error-code=12
    RoutineServices_Routine_TABROW_SOKFunctDeact_Start_Routine_COP
      operation Start: possible-error=[RoutineServices_Routine_TABROW_SOKFunctDeact_Start_Routine_COP/E_NOT_OK, RoutineServices_Routine_TABROW_SOKFunctDeact_Start_Routine_COP/DCM_E_PENDING, RoutineServices_Routine_TABROW_SOKFunctDeact_Start_Routine_COP/DCM_E_FORCE_RCRRP]
        4 x arg:
          ReqData: type=Dcm_StartDataIn_Routine_TABROW_SOKFunctDeact_Start_Routine_COP_ReqDataType, direction=IN
          OpStatus: type=Dcm_OpStatusType, direction=IN
          ResData: type=Dcm_StartDataOut_Routine_TABROW_SOKFunctDeact_Start_Routine_COP_ResDataType, direction=OUT
          ErrorCode: type=Dcm_NegativeResponseCodeType, direction=OUT
      operation Stop: possible-error=[RoutineServices_Routine_TABROW_SOKFunctDeact_Start_Routine_COP/E_NOT_OK, RoutineServices_Routine_TABROW_SOKFunctDeact_Start_Routine_COP/DCM_E_PENDING, RoutineServices_Routine_TABROW_SOKFunctDeact_Start_Routine_COP/DCM_E_FORCE_RCRRP]
        arg OpStatus: type=Dcm_OpStatusType, direction=IN
        arg ResData: type=Dcm_StopDataOut_Routine_TABROW_SOKFunctDeact_Start_Routine_COP_ResDataType, direction=OUT
        arg ErrorCode: type=Dcm_NegativeResponseCodeType, direction=OUT
      operation RequestResults: possible-error=[RoutineServices_Routine_TABROW_SOKFunctDeact_Start_Routine_COP/E_NOT_OK, RoutineServices_Routine_TABROW_SOKFunctDeact_Start_Routine_COP/DCM_E_PENDING, RoutineServices_Routine_TABROW_SOKFunctDeact_Start_Routine_COP/DCM_E_FORCE_RCRRP]
        arg OpStatus: type=Dcm_OpStatusType, direction=IN
        arg ResData: type=Dcm_RequestDataOut_Routine_TABROW_SOKFunctDeact_Start_Routine_COP_ResDataType, direction=OUT
        arg ErrorCode: type=Dcm_NegativeResponseCodeType, direction=OUT
      error E_NOT_OK: error-code=1
      error DCM_E_PENDING: error-code=10
      error DCM_E_FORCE_RCRRP: error-code=12
    RoutineServices_Routine_Get_Energy_from_SOC_Start_Routine
      operation Start: possible-error=[RoutineServices_Routine_Get_Energy_from_SOC_Start_Routine/E_NOT_OK, RoutineServices_Routine_Get_Energy_from_SOC_Start_Routine/DCM_E_PENDING, RoutineServices_Routine_Get_Energy_from_SOC_Start_Routine/DCM_E_FORCE_RCRRP]
        5 x arg:
          ReqData: type=Dcm_StartFlexibleInArrayData_Routine_Get_Energy_from_SOC_Start_Routine_ReqDataType, direction=IN
          OpStatus: type=Dcm_OpStatusType, direction=IN
          ResData: type=Dcm_StartDataOut_Routine_Get_Energy_from_SOC_Start_Routine_ResDataType, direction=OUT
          DataLength: type=uint16, direction=IN
          ErrorCode: type=Dcm_NegativeResponseCodeType, direction=OUT
      operation Stop: possible-error=[RoutineServices_Routine_Get_Energy_from_SOC_Start_Routine/E_NOT_OK, RoutineServices_Routine_Get_Energy_from_SOC_Start_Routine/DCM_E_PENDING, RoutineServices_Routine_Get_Energy_from_SOC_Start_Routine/DCM_E_FORCE_RCRRP]
        arg OpStatus: type=Dcm_OpStatusType, direction=IN
        arg ResData: type=Dcm_StopDataOut_Routine_Get_Energy_from_SOC_Start_Routine_ResDataType, direction=OUT
        arg ErrorCode: type=Dcm_NegativeResponseCodeType, direction=OUT
      operation RequestResults: possible-error=[RoutineServices_Routine_Get_Energy_from_SOC_Start_Routine/E_NOT_OK, RoutineServices_Routine_Get_Energy_from_SOC_Start_Routine/DCM_E_PENDING, RoutineServices_Routine_Get_Energy_from_SOC_Start_Routine/DCM_E_FORCE_RCRRP]
        4 x arg:
          OpStatus: type=Dcm_OpStatusType, direction=IN
          ResData: type=Dcm_RequestFlexibleOutArrayData_Routine_Get_Energy_from_SOC_Start_Routine_ResDataType, direction=OUT
          DataLength: type=uint16, direction=OUT
          ErrorCode: type=Dcm_NegativeResponseCodeType, direction=OUT
      error E_NOT_OK: error-code=1
      error DCM_E_PENDING: error-code=10
      error DCM_E_FORCE_RCRRP: error-code=12
    RoutineServices_Routine_DiagnServi_Get_Charge_Power_Start_Routine
      operation Start: possible-error=[RoutineServices_Routine_DiagnServi_Get_Charge_Power_Start_Routine/E_NOT_OK, RoutineServices_Routine_DiagnServi_Get_Charge_Power_Start_Routine/DCM_E_PENDING, RoutineServices_Routine_DiagnServi_Get_Charge_Power_Start_Routine/DCM_E_FORCE_RCRRP]
        5 x arg:
          ReqData: type=Dcm_StartFlexibleInArrayData_Routine_DiagnServi_Get_Charge_Power_Start_Routine_ReqDataType, direction=IN
          OpStatus: type=Dcm_OpStatusType, direction=IN
          ResData: type=Dcm_StartDataOut_Routine_DiagnServi_Get_Charge_Power_Start_Routine_ResDataType, direction=OUT
          DataLength: type=uint16, direction=IN
          ErrorCode: type=Dcm_NegativeResponseCodeType, direction=OUT
      operation Stop: possible-error=[RoutineServices_Routine_DiagnServi_Get_Charge_Power_Start_Routine/E_NOT_OK, RoutineServices_Routine_DiagnServi_Get_Charge_Power_Start_Routine/DCM_E_PENDING, RoutineServices_Routine_DiagnServi_Get_Charge_Power_Start_Routine/DCM_E_FORCE_RCRRP]
        arg OpStatus: type=Dcm_OpStatusType, direction=IN
        arg ResData: type=Dcm_StopDataOut_Routine_DiagnServi_Get_Charge_Power_Start_Routine_ResDataType, direction=OUT
        arg ErrorCode: type=Dcm_NegativeResponseCodeType, direction=OUT
      operation RequestResults: possible-error=[RoutineServices_Routine_DiagnServi_Get_Charge_Power_Start_Routine/E_NOT_OK, RoutineServices_Routine_DiagnServi_Get_Charge_Power_Start_Routine/DCM_E_PENDING, RoutineServices_Routine_DiagnServi_Get_Charge_Power_Start_Routine/DCM_E_FORCE_RCRRP]
        4 x arg:
          OpStatus: type=Dcm_OpStatusType, direction=IN
          ResData: type=Dcm_RequestFlexibleOutArrayData_Routine_DiagnServi_Get_Charge_Power_Start_Routine_ResDataType, direction=OUT
          DataLength: type=uint16, direction=OUT
          ErrorCode: type=Dcm_NegativeResponseCodeType, direction=OUT
      error E_NOT_OK: error-code=1
      error DCM_E_PENDING: error-code=10
      error DCM_E_FORCE_RCRRP: error-code=12
    RoutineServices_Routine_DiagnServi_RoutiContrCheckProgrDepen
      operation Start: possible-error=[RoutineServices_Routine_DiagnServi_RoutiContrCheckProgrDepen/E_NOT_OK, RoutineServices_Routine_DiagnServi_RoutiContrCheckProgrDepen/DCM_E_PENDING, RoutineServices_Routine_DiagnServi_RoutiContrCheckProgrDepen/DCM_E_FORCE_RCRRP]
        arg OpStatus: type=Dcm_OpStatusType, direction=IN
        arg ResData: type=Dcm_StartDataOut_Routine_DiagnServi_RoutiContrCheckProgrDepen_ResDataType, direction=OUT
        arg ErrorCode: type=Dcm_NegativeResponseCodeType, direction=OUT
      error E_NOT_OK: error-code=1
      error DCM_E_PENDING: error-code=10
      error DCM_E_FORCE_RCRRP: error-code=12
    DataServices_Data_HV_battery_continuous_charging_power_Read_Data_By_Identifier
      operation ReadData: possible-error=[DataServices_Data_HV_battery_continuous_charging_power_Read_Data_By_Identifier/E_NOT_OK, DataServices_Data_HV_battery_continuous_charging_power_Read_Data_By_Identifier/DCM_E_PENDING]
        arg OpStatus: type=Dcm_OpStatusType, direction=IN
        arg Data: type=Dcm_Data2ByteType, direction=OUT
      operation ConditionCheckRead: possible-error=[DataServices_Data_HV_battery_continuous_charging_power_Read_Data_By_Identifier/E_NOT_OK, DataServices_Data_HV_battery_continuous_charging_power_Read_Data_By_Identifier/DCM_E_PENDING]
        arg OpStatus: type=Dcm_OpStatusType, direction=IN
        arg ErrorCode: type=Dcm_NegativeResponseCodeType, direction=OUT
      error E_NOT_OK: error-code=1
      error DCM_E_PENDING: error-code=10
    DataServices_Data_HV_battery_performance_indicator_discharging_Read_Data_By_Identifier
      operation ReadData: possible-error=[DataServices_Data_HV_battery_performance_indicator_discharging_Read_Data_By_Identifier/E_NOT_OK, DataServices_Data_HV_battery_performance_indicator_discharging_Read_Data_By_Identifier/DCM_E_PENDING]
        arg OpStatus: type=Dcm_OpStatusType, direction=IN
        arg Data: type=Dcm_Data2ByteType, direction=OUT
      operation ConditionCheckRead: possible-error=[DataServices_Data_HV_battery_performance_indicator_discharging_Read_Data_By_Identifier/E_NOT_OK, DataServices_Data_HV_battery_performance_indicator_discharging_Read_Data_By_Identifier/DCM_E_PENDING]
        arg OpStatus: type=Dcm_OpStatusType, direction=IN
        arg ErrorCode: type=Dcm_NegativeResponseCodeType, direction=OUT
      error E_NOT_OK: error-code=1
      error DCM_E_PENDING: error-code=10
    DataServices_Data_BMC_Mode_Read_Data_By_Identifier
      operation ReadData: possible-error=[DataServices_Data_BMC_Mode_Read_Data_By_Identifier/E_NOT_OK, DataServices_Data_BMC_Mode_Read_Data_By_Identifier/DCM_E_PENDING]
        arg OpStatus: type=Dcm_OpStatusType, direction=IN
        arg Data: type=Dcm_Data1ByteType, direction=OUT
      operation ConditionCheckRead: possible-error=[DataServices_Data_BMC_Mode_Read_Data_By_Identifier/E_NOT_OK, DataServices_Data_BMC_Mode_Read_Data_By_Identifier/DCM_E_PENDING]
        arg OpStatus: type=Dcm_OpStatusType, direction=IN
        arg ErrorCode: type=Dcm_NegativeResponseCodeType, direction=OUT
      error E_NOT_OK: error-code=1
      error DCM_E_PENDING: error-code=10
    DataServices_Data_DiagnServi_TABROW_NeuMeasu_Read_59_2
      operation ReadData: possible-error=[DataServices_Data_DiagnServi_TABROW_NeuMeasu_Read_59_2/E_NOT_OK, DataServices_Data_DiagnServi_TABROW_NeuMeasu_Read_59_2/DCM_E_PENDING]
        arg OpStatus: type=Dcm_OpStatusType, direction=IN
        arg Data: type=Dcm_Data2ByteType, direction=OUT
      operation ConditionCheckRead: possible-error=[DataServices_Data_DiagnServi_TABROW_NeuMeasu_Read_59_2/E_NOT_OK, DataServices_Data_DiagnServi_TABROW_NeuMeasu_Read_59_2/DCM_E_PENDING]
        arg OpStatus: type=Dcm_OpStatusType, direction=IN
        arg ErrorCode: type=Dcm_NegativeResponseCodeType, direction=OUT
      error E_NOT_OK: error-code=1
      error DCM_E_PENDING: error-code=10
    DataServices_Data_TABROW_TABROSyste_Read_1_1_1_1_1_1_1
      operation ReadData: possible-error=[DataServices_Data_TABROW_TABROSyste_Read_1_1_1_1_1_1_1/E_NOT_OK, DataServices_Data_TABROW_TABROSyste_Read_1_1_1_1_1_1_1/DCM_E_PENDING]
        arg OpStatus: type=Dcm_OpStatusType, direction=IN
        arg Data: type=Dcm_Data9ByteType, direction=OUT
      operation ConditionCheckRead: possible-error=[DataServices_Data_TABROW_TABROSyste_Read_1_1_1_1_1_1_1/E_NOT_OK, DataServices_Data_TABROW_TABROSyste_Read_1_1_1_1_1_1_1/DCM_E_PENDING]
        arg OpStatus: type=Dcm_OpStatusType, direction=IN
        arg ErrorCode: type=Dcm_NegativeResponseCodeType, direction=OUT
      error E_NOT_OK: error-code=1
      error DCM_E_PENDING: error-code=10
    DataServices_Data_TABROW_SOKSignaFaileList_Read_Data_By_Identifier
      operation ReadData: possible-error=[DataServices_Data_TABROW_SOKSignaFaileList_Read_Data_By_Identifier/E_NOT_OK, DataServices_Data_TABROW_SOKSignaFaileList_Read_Data_By_Identifier/DCM_E_PENDING]
        arg OpStatus: type=Dcm_OpStatusType, direction=IN
        arg Data: type=Dcm_Data512ByteType, direction=OUT
      operation ReadDataLength: possible-error=[DataServices_Data_TABROW_SOKSignaFaileList_Read_Data_By_Identifier/E_NOT_OK, DataServices_Data_TABROW_SOKSignaFaileList_Read_Data_By_Identifier/DCM_E_PENDING]
        arg OpStatus: type=Dcm_OpStatusType, direction=IN
        arg DataLength: type=uint16, direction=OUT
      operation ConditionCheckRead: possible-error=[DataServices_Data_TABROW_SOKSignaFaileList_Read_Data_By_Identifier/E_NOT_OK, DataServices_Data_TABROW_SOKSignaFaileList_Read_Data_By_Identifier/DCM_E_PENDING]
        arg OpStatus: type=Dcm_OpStatusType, direction=IN
        arg ErrorCode: type=Dcm_NegativeResponseCodeType, direction=OUT
      error E_NOT_OK: error-code=1
      error DCM_E_PENDING: error-code=10
    DataServices_Data_DiagnServi_TABROW_NeuMeasu_Read_46_1_1_1_1_1
      operation ReadData: possible-error=[DataServices_Data_DiagnServi_TABROW_NeuMeasu_Read_46_1_1_1_1_1/E_NOT_OK, DataServices_Data_DiagnServi_TABROW_NeuMeasu_Read_46_1_1_1_1_1/DCM_E_PENDING]
        arg OpStatus: type=Dcm_OpStatusType, direction=IN
        arg Data: type=Dcm_Data152ByteType, direction=OUT
      operation ConditionCheckRead: possible-error=[DataServices_Data_DiagnServi_TABROW_NeuMeasu_Read_46_1_1_1_1_1/E_NOT_OK, DataServices_Data_DiagnServi_TABROW_NeuMeasu_Read_46_1_1_1_1_1/DCM_E_PENDING]
        arg OpStatus: type=Dcm_OpStatusType, direction=IN
        arg ErrorCode: type=Dcm_NegativeResponseCodeType, direction=OUT
      error E_NOT_OK: error-code=1
      error DCM_E_PENDING: error-code=10
    DataServices_Data_TABROW_VWECUHardwVersiNumbe_Read
      operation ReadData: possible-error=[DataServices_Data_TABROW_VWECUHardwVersiNumbe_Read/E_NOT_OK, DataServices_Data_TABROW_VWECUHardwVersiNumbe_Read/DCM_E_PENDING]
        arg OpStatus: type=Dcm_OpStatusType, direction=IN
        arg Data: type=Dcm_Data3ByteType, direction=OUT
      operation ConditionCheckRead: possible-error=[DataServices_Data_TABROW_VWECUHardwVersiNumbe_Read/E_NOT_OK, DataServices_Data_TABROW_VWECUHardwVersiNumbe_Read/DCM_E_PENDING]
        arg OpStatus: type=Dcm_OpStatusType, direction=IN
        arg ErrorCode: type=Dcm_NegativeResponseCodeType, direction=OUT
      error E_NOT_OK: error-code=1
      error DCM_E_PENDING: error-code=10
    DataServices_Data_DiagnServi_TABROW_NeuMeasu_Read_63_1_1_1
      operation ReadData: possible-error=[DataServices_Data_DiagnServi_TABROW_NeuMeasu_Read_63_1_1_1/E_NOT_OK, DataServices_Data_DiagnServi_TABROW_NeuMeasu_Read_63_1_1_1/DCM_E_PENDING]
        arg OpStatus: type=Dcm_OpStatusType, direction=IN
        arg Data: type=Dcm_Data16ByteType, direction=OUT
      operation ConditionCheckRead: possible-error=[DataServices_Data_DiagnServi_TABROW_NeuMeasu_Read_63_1_1_1/E_NOT_OK, DataServices_Data_DiagnServi_TABROW_NeuMeasu_Read_63_1_1_1/DCM_E_PENDING]
        arg OpStatus: type=Dcm_OpStatusType, direction=IN
        arg ErrorCode: type=Dcm_NegativeResponseCodeType, direction=OUT
      error E_NOT_OK: error-code=1
      error DCM_E_PENDING: error-code=10
    DataServices_Data_TABROW_TABROSyste_Read_1_1_1_1_1_1
      operation ReadData: possible-error=[DataServices_Data_TABROW_TABROSyste_Read_1_1_1_1_1_1/E_NOT_OK, DataServices_Data_TABROW_TABROSyste_Read_1_1_1_1_1_1/DCM_E_PENDING]
        arg OpStatus: type=Dcm_OpStatusType, direction=IN
        arg Data: type=Dcm_Data9ByteType, direction=OUT
      operation ConditionCheckRead: possible-error=[DataServices_Data_TABROW_TABROSyste_Read_1_1_1_1_1_1/E_NOT_OK, DataServices_Data_TABROW_TABROSyste_Read_1_1_1_1_1_1/DCM_E_PENDING]
        arg OpStatus: type=Dcm_OpStatusType, direction=IN
        arg ErrorCode: type=Dcm_NegativeResponseCodeType, direction=OUT
      error E_NOT_OK: error-code=1
      error DCM_E_PENDING: error-code=10
    DataServices_Data_DiagnServi_TABROW_NeuECUIdent_Read
      operation ReadData: possible-error=[DataServices_Data_DiagnServi_TABROW_NeuECUIdent_Read/E_NOT_OK, DataServices_Data_DiagnServi_TABROW_NeuECUIdent_Read/DCM_E_PENDING]
        arg OpStatus: type=Dcm_OpStatusType, direction=IN
        arg Data: type=Dcm_Data11ByteType, direction=OUT
      operation ConditionCheckRead: possible-error=[DataServices_Data_DiagnServi_TABROW_NeuECUIdent_Read/E_NOT_OK, DataServices_Data_DiagnServi_TABROW_NeuECUIdent_Read/DCM_E_PENDING]
        arg OpStatus: type=Dcm_OpStatusType, direction=IN
        arg ErrorCode: type=Dcm_NegativeResponseCodeType, direction=OUT
      error E_NOT_OK: error-code=1
      error DCM_E_PENDING: error-code=10
    DataServices_Data_DiagnServi_TABROW_NeuMeasu_Read_22_1
      operation ReadData: possible-error=[DataServices_Data_DiagnServi_TABROW_NeuMeasu_Read_22_1/E_NOT_OK, DataServices_Data_DiagnServi_TABROW_NeuMeasu_Read_22_1/DCM_E_PENDING]
        arg OpStatus: type=Dcm_OpStatusType, direction=IN
        arg Data: type=Dcm_Data2ByteType, direction=OUT
      operation ConditionCheckRead: possible-error=[DataServices_Data_DiagnServi_TABROW_NeuMeasu_Read_22_1/E_NOT_OK, DataServices_Data_DiagnServi_TABROW_NeuMeasu_Read_22_1/DCM_E_PENDING]
        arg OpStatus: type=Dcm_OpStatusType, direction=IN
        arg ErrorCode: type=Dcm_NegativeResponseCodeType, direction=OUT
      error E_NOT_OK: error-code=1
      error DCM_E_PENDING: error-code=10
    DataServices_Data_TABROW_VWLogicSoftwBlockLockValue_Read
      operation ReadData: possible-error=[DataServices_Data_TABROW_VWLogicSoftwBlockLockValue_Read/E_NOT_OK, DataServices_Data_TABROW_VWLogicSoftwBlockLockValue_Read/DCM_E_PENDING]
        arg OpStatus: type=Dcm_OpStatusType, direction=IN
        arg Data: type=Dcm_Data8192ByteType, direction=OUT
      operation ReadDataLength: possible-error=[DataServices_Data_TABROW_VWLogicSoftwBlockLockValue_Read/E_NOT_OK, DataServices_Data_TABROW_VWLogicSoftwBlockLockValue_Read/DCM_E_PENDING]
        arg OpStatus: type=Dcm_OpStatusType, direction=IN
        arg DataLength: type=uint16, direction=OUT
      operation ConditionCheckRead: possible-error=[DataServices_Data_TABROW_VWLogicSoftwBlockLockValue_Read/E_NOT_OK, DataServices_Data_TABROW_VWLogicSoftwBlockLockValue_Read/DCM_E_PENDING]
        arg OpStatus: type=Dcm_OpStatusType, direction=IN
        arg ErrorCode: type=Dcm_NegativeResponseCodeType, direction=OUT
      error E_NOT_OK: error-code=1
      error DCM_E_PENDING: error-code=10
    DataServices_Data_DiagnServi_TABROW_NeuMeasu_Read_57_1
      operation ReadData: possible-error=[DataServices_Data_DiagnServi_TABROW_NeuMeasu_Read_57_1/E_NOT_OK, DataServices_Data_DiagnServi_TABROW_NeuMeasu_Read_57_1/DCM_E_PENDING]
        arg OpStatus: type=Dcm_OpStatusType, direction=IN
        arg Data: type=Dcm_Data2ByteType, direction=OUT
      operation ConditionCheckRead: possible-error=[DataServices_Data_DiagnServi_TABROW_NeuMeasu_Read_57_1/E_NOT_OK, DataServices_Data_DiagnServi_TABROW_NeuMeasu_Read_57_1/DCM_E_PENDING]
        arg OpStatus: type=Dcm_OpStatusType, direction=IN
        arg ErrorCode: type=Dcm_NegativeResponseCodeType, direction=OUT
      error E_NOT_OK: error-code=1
      error DCM_E_PENDING: error-code=10
    DataServices_Data_TABROW_StatePCM_ReadDataByIdent
      operation ReadData: possible-error=[DataServices_Data_TABROW_StatePCM_ReadDataByIdent/E_NOT_OK, DataServices_Data_TABROW_StatePCM_ReadDataByIdent/DCM_E_PENDING]
        arg OpStatus: type=Dcm_OpStatusType, direction=IN
        arg Data: type=Dcm_Data1ByteType, direction=OUT
      operation ConditionCheckRead: possible-error=[DataServices_Data_TABROW_StatePCM_ReadDataByIdent/E_NOT_OK, DataServices_Data_TABROW_StatePCM_ReadDataByIdent/DCM_E_PENDING]
        arg OpStatus: type=Dcm_OpStatusType, direction=IN
        arg ErrorCode: type=Dcm_NegativeResponseCodeType, direction=OUT
      error E_NOT_OK: error-code=1
      error DCM_E_PENDING: error-code=10
    DataServices_Data_DiagnServi_TABROW_SysteSupplIdent_Read
      operation ReadData: possible-error=[DataServices_Data_DiagnServi_TABROW_SysteSupplIdent_Read/E_NOT_OK, DataServices_Data_DiagnServi_TABROW_SysteSupplIdent_Read/DCM_E_PENDING]
        arg OpStatus: type=Dcm_OpStatusType, direction=IN
        arg Data: type=Dcm_Data32ByteType, direction=OUT
      operation ReadDataLength: possible-error=[DataServices_Data_DiagnServi_TABROW_SysteSupplIdent_Read/E_NOT_OK, DataServices_Data_DiagnServi_TABROW_SysteSupplIdent_Read/DCM_E_PENDING]
        arg OpStatus: type=Dcm_OpStatusType, direction=IN
        arg DataLength: type=uint16, direction=OUT
      operation ConditionCheckRead: possible-error=[DataServices_Data_DiagnServi_TABROW_SysteSupplIdent_Read/E_NOT_OK, DataServices_Data_DiagnServi_TABROW_SysteSupplIdent_Read/DCM_E_PENDING]
        arg OpStatus: type=Dcm_OpStatusType, direction=IN
        arg ErrorCode: type=Dcm_NegativeResponseCodeType, direction=OUT
      error E_NOT_OK: error-code=1
      error DCM_E_PENDING: error-code=10
    DataServices_Data_High_voltage_battery_total_voltage_Read_Data_By_Identifier
      operation ReadData: possible-error=[DataServices_Data_High_voltage_battery_total_voltage_Read_Data_By_Identifier/E_NOT_OK, DataServices_Data_High_voltage_battery_total_voltage_Read_Data_By_Identifier/DCM_E_PENDING]
        arg OpStatus: type=Dcm_OpStatusType, direction=IN
        arg Data: type=Dcm_Data4ByteType, direction=OUT
      operation ConditionCheckRead: possible-error=[DataServices_Data_High_voltage_battery_total_voltage_Read_Data_By_Identifier/E_NOT_OK, DataServices_Data_High_voltage_battery_total_voltage_Read_Data_By_Identifier/DCM_E_PENDING]
        arg OpStatus: type=Dcm_OpStatusType, direction=IN
        arg ErrorCode: type=Dcm_NegativeResponseCodeType, direction=OUT
      error E_NOT_OK: error-code=1
      error DCM_E_PENDING: error-code=10
    DataServices_Data_Battery_technical_state_of_charge_Read_Data_By_Identifier
      operation ReadData: possible-error=[DataServices_Data_Battery_technical_state_of_charge_Read_Data_By_Identifier/E_NOT_OK, DataServices_Data_Battery_technical_state_of_charge_Read_Data_By_Identifier/DCM_E_PENDING]
        arg OpStatus: type=Dcm_OpStatusType, direction=IN
        arg Data: type=Dcm_Data2ByteType, direction=OUT
      operation ConditionCheckRead: possible-error=[DataServices_Data_Battery_technical_state_of_charge_Read_Data_By_Identifier/E_NOT_OK, DataServices_Data_Battery_technical_state_of_charge_Read_Data_By_Identifier/DCM_E_PENDING]
        arg OpStatus: type=Dcm_OpStatusType, direction=IN
        arg ErrorCode: type=Dcm_NegativeResponseCodeType, direction=OUT
      error E_NOT_OK: error-code=1
      error DCM_E_PENDING: error-code=10
    DataServices_Data_DiagnServi_TABROW_NeuMeasu_Read_46_1
      operation ReadData: possible-error=[DataServices_Data_DiagnServi_TABROW_NeuMeasu_Read_46_1/E_NOT_OK, DataServices_Data_DiagnServi_TABROW_NeuMeasu_Read_46_1/DCM_E_PENDING]
        arg OpStatus: type=Dcm_OpStatusType, direction=IN
        arg Data: type=Dcm_Data152ByteType, direction=OUT
      operation ConditionCheckRead: possible-error=[DataServices_Data_DiagnServi_TABROW_NeuMeasu_Read_46_1/E_NOT_OK, DataServices_Data_DiagnServi_TABROW_NeuMeasu_Read_46_1/DCM_E_PENDING]
        arg OpStatus: type=Dcm_OpStatusType, direction=IN
        arg ErrorCode: type=Dcm_NegativeResponseCodeType, direction=OUT
      error E_NOT_OK: error-code=1
      error DCM_E_PENDING: error-code=10
    DataServices_Data_TABROW_BMCHVKFehleHVIL_Read_Data_By_Identifier
      operation ReadData: possible-error=[DataServices_Data_TABROW_BMCHVKFehleHVIL_Read_Data_By_Identifier/E_NOT_OK, DataServices_Data_TABROW_BMCHVKFehleHVIL_Read_Data_By_Identifier/DCM_E_PENDING]
        arg OpStatus: type=Dcm_OpStatusType, direction=IN
        arg Data: type=Dcm_Data1ByteType, direction=OUT
      operation ConditionCheckRead: possible-error=[DataServices_Data_TABROW_BMCHVKFehleHVIL_Read_Data_By_Identifier/E_NOT_OK, DataServices_Data_TABROW_BMCHVKFehleHVIL_Read_Data_By_Identifier/DCM_E_PENDING]
        arg OpStatus: type=Dcm_OpStatusType, direction=IN
        arg ErrorCode: type=Dcm_NegativeResponseCodeType, direction=OUT
      error E_NOT_OK: error-code=1
      error DCM_E_PENDING: error-code=10
    DataServices_Data_DiagnServi_TABROW_VWAppliSoftwVersiNumbe_Read
      operation ReadData: possible-error=[DataServices_Data_DiagnServi_TABROW_VWAppliSoftwVersiNumbe_Read/E_NOT_OK, DataServices_Data_DiagnServi_TABROW_VWAppliSoftwVersiNumbe_Read/DCM_E_PENDING]
        arg OpStatus: type=Dcm_OpStatusType, direction=IN
        arg Data: type=Dcm_Data4ByteType, direction=OUT
      operation ConditionCheckRead: possible-error=[DataServices_Data_DiagnServi_TABROW_VWAppliSoftwVersiNumbe_Read/E_NOT_OK, DataServices_Data_DiagnServi_TABROW_VWAppliSoftwVersiNumbe_Read/DCM_E_PENDING]
        arg OpStatus: type=Dcm_OpStatusType, direction=IN
        arg ErrorCode: type=Dcm_NegativeResponseCodeType, direction=OUT
      error E_NOT_OK: error-code=1
      error DCM_E_PENDING: error-code=10
    DataServices_Data_HV_Spannung_Nebenverbraucher_Read_Data_By_Identifier
      operation ReadData: possible-error=[DataServices_Data_HV_Spannung_Nebenverbraucher_Read_Data_By_Identifier/E_NOT_OK, DataServices_Data_HV_Spannung_Nebenverbraucher_Read_Data_By_Identifier/DCM_E_PENDING]
        arg OpStatus: type=Dcm_OpStatusType, direction=IN
        arg Data: type=Dcm_Data2ByteType, direction=OUT
      operation ConditionCheckRead: possible-error=[DataServices_Data_HV_Spannung_Nebenverbraucher_Read_Data_By_Identifier/E_NOT_OK, DataServices_Data_HV_Spannung_Nebenverbraucher_Read_Data_By_Identifier/DCM_E_PENDING]
        arg OpStatus: type=Dcm_OpStatusType, direction=IN
        arg ErrorCode: type=Dcm_NegativeResponseCodeType, direction=OUT
      error E_NOT_OK: error-code=1
      error DCM_E_PENDING: error-code=10
    DataServices_Data_TABROW_TABROSyste_Read_1_1_1_1_1_1_1_1
      operation ReadData: possible-error=[DataServices_Data_TABROW_TABROSyste_Read_1_1_1_1_1_1_1_1/E_NOT_OK, DataServices_Data_TABROW_TABROSyste_Read_1_1_1_1_1_1_1_1/DCM_E_PENDING]
        arg OpStatus: type=Dcm_OpStatusType, direction=IN
        arg Data: type=Dcm_Data9ByteType, direction=OUT
      operation ConditionCheckRead: possible-error=[DataServices_Data_TABROW_TABROSyste_Read_1_1_1_1_1_1_1_1/E_NOT_OK, DataServices_Data_TABROW_TABROSyste_Read_1_1_1_1_1_1_1_1/DCM_E_PENDING]
        arg OpStatus: type=Dcm_OpStatusType, direction=IN
        arg ErrorCode: type=Dcm_NegativeResponseCodeType, direction=OUT
      error E_NOT_OK: error-code=1
      error DCM_E_PENDING: error-code=10
    DataServices_Data_DiagnServi_TABROW_EnginCoolaTempe_Read
      operation ReadData: possible-error=[DataServices_Data_DiagnServi_TABROW_EnginCoolaTempe_Read/E_NOT_OK, DataServices_Data_DiagnServi_TABROW_EnginCoolaTempe_Read/DCM_E_PENDING]
        arg OpStatus: type=Dcm_OpStatusType, direction=IN
        arg Data: type=Dcm_Data1ByteType, direction=OUT
      operation ConditionCheckRead: possible-error=[DataServices_Data_DiagnServi_TABROW_EnginCoolaTempe_Read/E_NOT_OK, DataServices_Data_DiagnServi_TABROW_EnginCoolaTempe_Read/DCM_E_PENDING]
        arg OpStatus: type=Dcm_OpStatusType, direction=IN
        arg ErrorCode: type=Dcm_NegativeResponseCodeType, direction=OUT
      error E_NOT_OK: error-code=1
      error DCM_E_PENDING: error-code=10
    DataServices_Data_TABROW_SOKTimeInfor_Read_Data_By_Identifier
      operation ReadData: possible-error=[DataServices_Data_TABROW_SOKTimeInfor_Read_Data_By_Identifier/E_NOT_OK, DataServices_Data_TABROW_SOKTimeInfor_Read_Data_By_Identifier/DCM_E_PENDING]
        arg OpStatus: type=Dcm_OpStatusType, direction=IN
        arg Data: type=Dcm_Data11ByteType, direction=OUT
      operation ConditionCheckRead: possible-error=[DataServices_Data_TABROW_SOKTimeInfor_Read_Data_By_Identifier/E_NOT_OK, DataServices_Data_TABROW_SOKTimeInfor_Read_Data_By_Identifier/DCM_E_PENDING]
        arg OpStatus: type=Dcm_OpStatusType, direction=IN
        arg ErrorCode: type=Dcm_NegativeResponseCodeType, direction=OUT
      error E_NOT_OK: error-code=1
      error DCM_E_PENDING: error-code=10
    DataServices_Data_Battery_banks_allowed_modes_Read_Data_By_Identifier
      operation ReadData: possible-error=[DataServices_Data_Battery_banks_allowed_modes_Read_Data_By_Identifier/E_NOT_OK, DataServices_Data_Battery_banks_allowed_modes_Read_Data_By_Identifier/DCM_E_PENDING]
        arg OpStatus: type=Dcm_OpStatusType, direction=IN
        arg Data: type=Dcm_Data1ByteType, direction=OUT
      operation ConditionCheckRead: possible-error=[DataServices_Data_Battery_banks_allowed_modes_Read_Data_By_Identifier/E_NOT_OK, DataServices_Data_Battery_banks_allowed_modes_Read_Data_By_Identifier/DCM_E_PENDING]
        arg OpStatus: type=Dcm_OpStatusType, direction=IN
        arg ErrorCode: type=Dcm_NegativeResponseCodeType, direction=OUT
      error E_NOT_OK: error-code=1
      error DCM_E_PENDING: error-code=10
    DataServices_Data_Battery_flow_temperature_Read_Data_By_Identifier
      operation ReadData: possible-error=[DataServices_Data_Battery_flow_temperature_Read_Data_By_Identifier/E_NOT_OK, DataServices_Data_Battery_flow_temperature_Read_Data_By_Identifier/DCM_E_PENDING]
        arg OpStatus: type=Dcm_OpStatusType, direction=IN
        arg Data: type=Dcm_Data2ByteType, direction=OUT
      operation ConditionCheckRead: possible-error=[DataServices_Data_Battery_flow_temperature_Read_Data_By_Identifier/E_NOT_OK, DataServices_Data_Battery_flow_temperature_Read_Data_By_Identifier/DCM_E_PENDING]
        arg OpStatus: type=Dcm_OpStatusType, direction=IN
        arg ErrorCode: type=Dcm_NegativeResponseCodeType, direction=OUT
      error E_NOT_OK: error-code=1
      error DCM_E_PENDING: error-code=10
    DataServices_Data_DiagnServi_TABROW_NeuMeasu_Read_9_2_1_1
      operation ReadData: possible-error=[DataServices_Data_DiagnServi_TABROW_NeuMeasu_Read_9_2_1_1/E_NOT_OK, DataServices_Data_DiagnServi_TABROW_NeuMeasu_Read_9_2_1_1/DCM_E_PENDING]
        arg OpStatus: type=Dcm_OpStatusType, direction=IN
        arg Data: type=Dcm_Data2ByteType, direction=OUT
      operation ConditionCheckRead: possible-error=[DataServices_Data_DiagnServi_TABROW_NeuMeasu_Read_9_2_1_1/E_NOT_OK, DataServices_Data_DiagnServi_TABROW_NeuMeasu_Read_9_2_1_1/DCM_E_PENDING]
        arg OpStatus: type=Dcm_OpStatusType, direction=IN
        arg ErrorCode: type=Dcm_NegativeResponseCodeType, direction=OUT
      error E_NOT_OK: error-code=1
      error DCM_E_PENDING: error-code=10
    DataServices_Data_DiagnServi_TABROW_NeuMeasu_Read_46_1_1
      operation ReadData: possible-error=[DataServices_Data_DiagnServi_TABROW_NeuMeasu_Read_46_1_1/E_NOT_OK, DataServices_Data_DiagnServi_TABROW_NeuMeasu_Read_46_1_1/DCM_E_PENDING]
        arg OpStatus: type=Dcm_OpStatusType, direction=IN
        arg Data: type=Dcm_Data152ByteType, direction=OUT
      operation ConditionCheckRead: possible-error=[DataServices_Data_DiagnServi_TABROW_NeuMeasu_Read_46_1_1/E_NOT_OK, DataServices_Data_DiagnServi_TABROW_NeuMeasu_Read_46_1_1/DCM_E_PENDING]
        arg OpStatus: type=Dcm_OpStatusType, direction=IN
        arg ErrorCode: type=Dcm_NegativeResponseCodeType, direction=OUT
      error E_NOT_OK: error-code=1
      error DCM_E_PENDING: error-code=10
    DataServices_Data_DiagnServi_TABROW_NeuMeasu_Read_46_1_1_1
      operation ReadData: possible-error=[DataServices_Data_DiagnServi_TABROW_NeuMeasu_Read_46_1_1_1/E_NOT_OK, DataServices_Data_DiagnServi_TABROW_NeuMeasu_Read_46_1_1_1/DCM_E_PENDING]
        arg OpStatus: type=Dcm_OpStatusType, direction=IN
        arg Data: type=Dcm_Data152ByteType, direction=OUT
      operation ConditionCheckRead: possible-error=[DataServices_Data_DiagnServi_TABROW_NeuMeasu_Read_46_1_1_1/E_NOT_OK, DataServices_Data_DiagnServi_TABROW_NeuMeasu_Read_46_1_1_1/DCM_E_PENDING]
        arg OpStatus: type=Dcm_OpStatusType, direction=IN
        arg ErrorCode: type=Dcm_NegativeResponseCodeType, direction=OUT
      error E_NOT_OK: error-code=1
      error DCM_E_PENDING: error-code=10
    DataServices_Data_Strommesung_Read_Data_By_Identifier
      operation ReadData: possible-error=[DataServices_Data_Strommesung_Read_Data_By_Identifier/E_NOT_OK, DataServices_Data_Strommesung_Read_Data_By_Identifier/DCM_E_PENDING]
        arg OpStatus: type=Dcm_OpStatusType, direction=IN
        arg Data: type=Dcm_Data4ByteType, direction=OUT
      operation ConditionCheckRead: possible-error=[DataServices_Data_Strommesung_Read_Data_By_Identifier/E_NOT_OK, DataServices_Data_Strommesung_Read_Data_By_Identifier/DCM_E_PENDING]
        arg OpStatus: type=Dcm_OpStatusType, direction=IN
        arg ErrorCode: type=Dcm_NegativeResponseCodeType, direction=OUT
      error E_NOT_OK: error-code=1
      error DCM_E_PENDING: error-code=10
    DataServices_Data_BMC_Hybrid_Kundendienstfehler_Read_Data_By_Identifier
      operation ReadData: possible-error=[DataServices_Data_BMC_Hybrid_Kundendienstfehler_Read_Data_By_Identifier/E_NOT_OK, DataServices_Data_BMC_Hybrid_Kundendienstfehler_Read_Data_By_Identifier/DCM_E_PENDING]
        arg OpStatus: type=Dcm_OpStatusType, direction=IN
        arg Data: type=Dcm_Data1ByteType, direction=OUT
      operation ConditionCheckRead: possible-error=[DataServices_Data_BMC_Hybrid_Kundendienstfehler_Read_Data_By_Identifier/E_NOT_OK, DataServices_Data_BMC_Hybrid_Kundendienstfehler_Read_Data_By_Identifier/DCM_E_PENDING]
        arg OpStatus: type=Dcm_OpStatusType, direction=IN
        arg ErrorCode: type=Dcm_NegativeResponseCodeType, direction=OUT
      error E_NOT_OK: error-code=1
      error DCM_E_PENDING: error-code=10
